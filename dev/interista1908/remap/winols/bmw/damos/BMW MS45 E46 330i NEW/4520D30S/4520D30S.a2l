/* -------------------------------------------------------------------------
E T A S
Data Declaration System (DDS)
- ASAP2 export -
DDS-Version 2.2.12
Component-Version Build<000024.02> 2000/12/18 08:58:02
CreationDate 12 Oct 2001, 12:02:19
Project MS45
Number 452
Structure D30
Serial Nr. 00
Option Project (DataBase) D:\p\452\d30_pis\mc1\work\dds
Option Verbose false
Option ASAP2File D:\p\452\d30_pis\mc1\out\cal\452D3030.a2l
Option IgnoreAddressCheck false
Option ASAP2Version 1.31
Option ExportSoftwareGrouping false
Option ExportComponentGrouping false
Option SuppressFunctionGrouping false
Option SuppressAxisFunctionGrouping false
Option ExportDisplayIdentifier <1>
Option ExportLongIdentifier <0>
Option ExportAnnotation false
Option PartialExportViaFunction
Option MemoryRegionAutoAssignment <0>
Option ExportReference2MemorySegment false
Option AddressOffset <0>
Option SuppressEcuAddress false
Option IfDataSetList 'CCP'
'ETK_P2'
'ETAS KWP2000'
Option IfDataOutputFormat <0>
Option CalibrationMethodList
Option SuppressFloat false
Option OnlineOnly false
Option ExportHiddenData false
Option Map2PointLinearConv2RatFunc true
Option NonLinearConvMode <0>
Option MapVTabRange2VTab false
Option MaxCompuTabValuePairs <255>
Option DefaultFormat4VerbalConvers...
Option WriteEscapeCharacters false
Option AllowASAP1_3IdentsAlso4NonI... false
Option IgnorePartialIdentLengthCheck false
Option A2MLIncludeMode <1>
------------------------------------------------------------------------- */
ASAP2_VERSION 1 31
/begin PROJECT MS45 "BMW Motorsteuerung R6"
/begin HEADER "_default_HeaderComment" PROJECT_NO _52 /end HEADER
/begin MODULE _default_ModuleName "_default_ModuleLongIdentifier"
/begin MOD_PAR "_default_ModParComment"
 /begin MEMORY_SEGMENT _INT_RAM "" VARIABLES RAM INTERN 0x3f9800 0x6800 -1 -1 -1 -1 -1 /begin IF_DATA ETK DP_BLOB 0x3f9800 0x6800 /end IF_DATA /end MEMORY_SEGMENT
 /begin MEMORY_SEGMENT _ROM "" DATA FLASH EXTERN 0x40000 0x1cc00 -1 -1 -1 -1 -1 /begin IF_DATA ETK DP_BLOB 0x40000 0x1cc00 /end IF_DATA /end MEMORY_SEGMENT
 /begin MEMORY_SEGMENT _RAM "" VARIABLES RAM EXTERN 0x5f200 0xdc0 -1 -1 -1 -1 -1 /begin IF_DATA ETK DP_BLOB 0x5f200 0xdc0 /end IF_DATA /end MEMORY_SEGMENT
 /begin MEMORY_SEGMENT _INT_RAM_BIT "" VARIABLES RAM INTERN 0xfd00 0x100 -1 -1 -1 -1 -1 /begin IF_DATA ETK DP_BLOB 0xfd00 0x100 /end IF_DATA /end MEMORY_SEGMENT
/end MOD_PAR
/begin MOD_COMMON "_default_ModCommonComment" DEPOSIT ABSOLUTE BYTE_ORDER MSB_FIRST ALIGNMENT_BYTE 1 ALIGNMENT_WORD 2 ALIGNMENT_LONG 4 ALIGNMENT_FLOAT32_IEEE 4 ALIGNMENT_FLOAT64_IEEE 8 /end MOD_COMMON
/begin IF_DATA ASAP1B_CCP
 /begin SOURCE "Crankshaft Synchronous Cyl.1" 0 0 DISPLAY_IDENTIFIER DAQ1 /begin QP_BLOB 1 LENGTH 10 CAN_ID_FIXED 0x7EB RASTER 1 FIRST_PID 0 /end QP_BLOB /end SOURCE
 /begin SOURCE "Crankshaft Synchronous Cyl.2" 0 0 DISPLAY_IDENTIFIER DAQ2 /begin QP_BLOB 2 LENGTH 10 CAN_ID_FIXED 0x7EB RASTER 2 FIRST_PID 16 /end QP_BLOB /end SOURCE
 /begin SOURCE "Crankshaft Synchronous Cyl.3" 0 0 DISPLAY_IDENTIFIER DAQ3 /begin QP_BLOB 3 LENGTH 10 CAN_ID_FIXED 0x7EB RASTER 3 FIRST_PID 32 /end QP_BLOB /end SOURCE
 /begin SOURCE "Crankshaft Synchronous Cyl.4" 0 0 DISPLAY_IDENTIFIER DAQ4 /begin QP_BLOB 4 LENGTH 10 CAN_ID_FIXED 0x7EB RASTER 4 FIRST_PID 48 /end QP_BLOB /end SOURCE
 /begin SOURCE "Crankshaft Synchronous Cyl.5" 0 0 DISPLAY_IDENTIFIER DAQ5 /begin QP_BLOB 5 LENGTH 10 CAN_ID_FIXED 0x7EB RASTER 5 FIRST_PID 64 /end QP_BLOB /end SOURCE
 /begin SOURCE "Crankshaft Synchronous Cyl.6" 0 0 DISPLAY_IDENTIFIER DAQ6 /begin QP_BLOB 6 LENGTH 10 CAN_ID_FIXED 0x7EB RASTER 6 FIRST_PID 80 /end QP_BLOB /end SOURCE
 /begin SOURCE "Time Synchronous 10ms" 3 10 DISPLAY_IDENTIFIER _10ms /begin QP_BLOB 30 LENGTH 10 CAN_ID_FIXED 0x7EC RASTER 30 FIRST_PID 96 /end QP_BLOB /end SOURCE
 /begin SOURCE "Display" 0 0 DISPLAY_IDENTIFIER Disp /begin QP_BLOB 31 LENGTH 60 CAN_ID_FIXED 0x7ED RASTER 31 FIRST_PID 112 /end QP_BLOB /end SOURCE
 /begin RASTER "Crankshaft Synchronous Cyl. 1" "CYL1" 1 103 1 /end RASTER
 /begin RASTER "Crankshaft Synchronous Cyl. 2" "CYL2" 2 103 1 /end RASTER
 /begin RASTER "Crankshaft Synchronous Cyl. 3" "CYL3" 3 103 1 /end RASTER
 /begin RASTER "Crankshaft Synchronous Cyl. 4" "CYL4" 4 103 1 /end RASTER
 /begin RASTER "Crankshaft Synchronous Cyl. 5" "CYL5" 5 103 1 /end RASTER
 /begin RASTER "Crankshaft Synchronous Cyl. 6" "CYL6" 6 103 1 /end RASTER
 /begin RASTER "Time Synchronous 10ms" "10ms" 30 3 10 /end RASTER
 /begin RASTER "Display 100ms" "DISP" 31 3 100 /end RASTER
 /begin EVENT_GROUP "Crankshaft Synchronous Cyl 1-6" "CRANK" RASTER 1 RASTER 2 RASTER 3 RASTER 4 RASTER 5 RASTER 6 /end EVENT_GROUP
 /begin SEED_KEY "" "" "" /end SEED_KEY
 /begin TP_BLOB 0x0201 0x0202 0x07E8 0x7EA 0x0001 2 BAUDRATE 500000 SAMPLE_POINT 66 SAMPLE_RATE 1 BTL_CYCLES 16 SJW 2 SYNC_EDGE 0 DAQ_MODE BURST RESUME_SUPPORTED CONSISTENCY DAQ ADDRESS_EXTENSION DAQ /begin CHECKSUM_PARAM 0x9001 0x80 CHECKSUM_CALCULATION BIT_OR_WITH_OPT_PAGE /end CHECKSUM_PARAM STORE_SUPPORTED
  /begin DEFINED_PAGES 1 "Working Page" 0 0x40000 0x1CE40 RAM RAM_INIT_BY_ECU FLASH_BACK /end DEFINED_PAGES
  /begin DEFINED_PAGES 2 "Reference Page" 0 0x440000 0x1CE40 FLASH DEFAULT /end DEFINED_PAGES
  OPTIONAL_CMD 0x05 OPTIONAL_CMD 0x08 OPTIONAL_CMD 0x09 OPTIONAL_CMD 0x0C OPTIONAL_CMD 0x0D OPTIONAL_CMD 0x0E OPTIONAL_CMD 0x11 OPTIONAL_CMD 0x12 OPTIONAL_CMD 0x13 OPTIONAL_CMD 0x18 OPTIONAL_CMD 0x19 OPTIONAL_CMD 0x20 OPTIONAL_CMD 0x21 OPTIONAL_CMD 0x22 /end TP_BLOB
/end IF_DATA
/begin IF_DATA ETK
 /begin SOURCE "Segment Synchronous" 103 1 QP_BLOB 1 0x3a 0x5c600 0x5f300 0x5f240 0 0x0 0x0 /end SOURCE
 /begin SOURCE "Time Synchronous Cylinder 10ms" 4 1 QP_BLOB 2 0x5a 0x5c6f0 0x5f33a 0x5f242 10 0x0 0x0 /end SOURCE
 /begin SOURCE "Time Synchronous Cylinder 100ms" 5 1 QP_BLOB 3 0x5a 0x5c860 0x5f394 0x5f244 100 0x0 0x0 /end SOURCE
 /begin SOURCE "Bypass Segment Synchronous" 103 1 QP_BLOB 4 0x30 0x5c9d0 0x5f3ee 0x5f246 0 0x10 0x5cb60 /end SOURCE
 /begin SOURCE "Bypass Time Synchronous" 4 1 QP_BLOB 5 0x30 0x5ca98 0x5f41e 0x5f248 10 0x20 0x5cb88 /end SOURCE
 /begin TP_BLOB 0x01000001 0x0 0x00000800
  /begin DISTAB_CFG 0xD 0x0111 0x1 0x5F200 0x1010100 TRG_MOD 0x0 0xB7 0x0 0x0 0x0 /end DISTAB_CFG
  CODE_CHK 0x0 0x0 0x0 0x0 ETK_CFG 0x02 0xE2 0x4E 0xDF 0xEF 0x4E 0xDF 0xEF 0x4E 0xCF 0xFB 0xFE 0xFF 0xFF 0xFB 0xFF 0xFF 0xFF 0xFF 0xFF 0x03 0xFF 0x01 0xFF RESERVED 0x5c600 0x0600 EXTERN -1 -1 -1 -1 -1 /end TP_BLOB
/end IF_DATA
/begin IF_DATA ASAP1B_KWP2000
 /begin SOURCE "timeslot" 0 0 QP_BLOB 0 BLOCKMODE 0xF0 0 40 /end SOURCE
 /begin TP_BLOB 0x0101 0x12 0xF1 WuP MSB_FIRST 1 DATA_ACCESS 0x000000 0x000000 1 0 0 1 SERAM 0x40000 0x40000 0x5C3FF 0x5C3FF 0 0 1 0 0 1 /begin CHECKSUM 0x010201 1 0x26 RequestRoutineResults RNC_RESULT 0x23 /end CHECKSUM
  /begin FLASH_COPY TOOLFLASHBACK 0x27 RequestRoutineResults RAM_InitByECU 0x86 COPY_FRAME 1 RNC_RESULT 0x23 0xfb 0xfc COPY_PARA 1 /end FLASH_COPY
  /begin DIAG_BAUD 113636 0x86 BD_PARA 0x06 0x01 0xbb 0xe4 /end DIAG_BAUD
  /begin DIAG_BAUD 57600 0x86 BD_PARA 0x06 0x00 0xe1 0x00 /end DIAG_BAUD
  /begin DIAG_BAUD 38400 0x86 BD_PARA 0x06 0x00 0x96 0x00 /end DIAG_BAUD
  /begin DIAG_BAUD 19200 0x86 BD_PARA 0x06 0x00 0x4B 0x00 /end DIAG_BAUD
  /begin DIAG_BAUD 10400 0x86 BD_PARA 0x06 0x00 0x28 0xA0 /end DIAG_BAUD
  TIME_DEF 20 2 49 12 250 0 /begin PAGE_SWITCH ESCAPE_CODE ESCAPE_CODE_PARA 0x90 PAGE_CODE 0x00 0x01 /end PAGE_SWITCH /end TP_BLOB
/end IF_DATA
/begin CHARACTERISTIC C_TCO_BOL_ECT "TCO setpoint for LV_REQ_TCO_L = 1" VALUE 0x42a45 _REC_VAL_20_u1 190.5 _CNV_A_R_LINEAR_____0_CM -48. 142.5 FORMAT "%5.1" /end CHARACTERISTIC
/begin CHARACTERISTIC C_TCO_EX_HYS_ECT "Hysteresis for end of the special case" VALUE 0x42a51 _REC_VAL_20_u1 28.575 _CNV_A_R_LINEAR_____1_CM 0. 190.5 FORMAT "%4.1" /end CHARACTERISTIC
/begin CHARACTERISTIC C_TCO_EX_MAX_ECT "TCO_EX threshold" VALUE 0x42a52 _REC_VAL_20_u1 28.575 _CNV_A_R_LINEAR_____0_CM -48. 142.5 FORMAT "%5.1" /end CHARACTERISTIC
/begin CHARACTERISTIC C_TCO_MIN_ECT "Min. TCO threshold for full energization of the thermostat" VALUE 0x42a6a _REC_VAL_20_u1 190.5 _CNV_A_R_LINEAR_____0_CM -48. 142.5 FORMAT "%5.1" /end CHARACTERISTIC
/begin CHARACTERISTIC C_TCO_SP_TCO_EX_MAX "TCO target temperature if TCO_EX threshold exceeded" VALUE 0x42a76 _REC_VAL_20_u1 28.575 _CNV_A_R_LINEAR_____0_CM -48. 142.5 FORMAT "%5.1" /end CHARACTERISTIC
/begin CHARACTERISTIC C_TCO_SP_TIA_MAX "TCO target temperature if TIA threshold exceeded" VALUE 0x42a77 _REC_VAL_20_u1 28.575 _CNV_A_R_LINEAR_____0_CM -48. 142.5 FORMAT "%5.1" /end CHARACTERISTIC
/begin CHARACTERISTIC C_TCO_SP_TOIL_MIN "Set value for TCO_SP" VALUE 0x42a78 _REC_VAL_20_u1 190.5 _CNV_A_R_LINEAR_____0_CM -48. 142.5 FORMAT "%5.1" /end CHARACTERISTIC
/begin CHARACTERISTIC C_TIA_HYS_ECT "Hysteresis for end of the special case" VALUE 0x42aaf _REC_VAL_20_u1 28.575 _CNV_A_R_LINEAR_____1_CM 0. 190.5 FORMAT "%4.1" /end CHARACTERISTIC
/begin CHARACTERISTIC C_TOIL_HYS_ECT "TOIL hystheresis for hot operation" VALUE 0x42ac2 _REC_VAL_20_u1 255. _CNV_A_R_LINEAR_____2_CM 0. 255. FORMAT "%3.0" /end CHARACTERISTIC
/begin CHARACTERISTIC C_TOIL_MIN_ECT "Lower TOIL threshold" VALUE 0x42ac9 _REC_VAL_20_u1 200. _CNV_A_R_LINEAR_____3_CM -40. 160. FORMAT "%3.0" /end CHARACTERISTIC
/begin MEASUREMENT TCO_SP "TCO target temperature" UBYTE _CNV_A_R_LINEAR_____0_CM 1 100. -48. 142.5 ECU_ADDRESS 0x3fcf94 FORMAT "%4.1" /end MEASUREMENT
/begin CHARACTERISTIC ID_ECTPWM_ADD "Precontrol pulse width modulation" MAP 0x4cc69 _REC_MAP_20_u1_u1_u1 99.609375 _CNV_A_R_LINEAR_____4_CM 0. 99.609375 FORMAT "%5.2"
 /begin AXIS_DESCR COM_AXIS N_32 _CNV_A_R_LINEAR_____5_CM 8 0. 8160. FORMAT "%4.0" AXIS_PTS_REF ldp_n_32__ectpwm_add /end AXIS_DESCR
 /begin AXIS_DESCR COM_AXIS TCO_SP _CNV_A_R_LINEAR_____0_CM 8 -48. 142.5 FORMAT "%5.1" AXIS_PTS_REF ldp_tco_sp__ectpwm_add /end AXIS_DESCR
/end CHARACTERISTIC
/begin CHARACTERISTIC IP_DIST_MIN "Distance limit" CURVE 0x4da87 _REC_CUR_20_u1_u1 25500. _CNV_A_R_LINEAR_____6_CM 0. 25500. FORMAT "%6.0"
 /begin AXIS_DESCR COM_AXIS TCO_ST _CNV_A_R_LINEAR_____0_CM 8 -48. 142.5 FORMAT "%5.1" AXIS_PTS_REF ldp_tco_st__dist /end AXIS_DESCR
/end CHARACTERISTIC
/begin CHARACTERISTIC IP_ECTPWM_I "Controller I component" CURVE 0x4db8f _REC_CUR_20_u1_u1 12.45 _CNV_A_R_LINEAR_____7_CM -6.25 6.2 FORMAT "%5.2"
 /begin AXIS_DESCR COM_AXIS TCO_DIF _CNV_A_R_LINEAR_____8_CM 8 -96. 95.25 FORMAT "%6.2" AXIS_PTS_REF ldp_tco_dif__ectpwm_i /end AXIS_DESCR
/end CHARACTERISTIC
/begin CHARACTERISTIC IP_ECTPWM_P "Controller P component" CURVE 0x4db97 _REC_CUR_20_u1_u1 99.60939999999999 _CNV_A_R_LINEAR_____9_CM -50. 49.6094 FORMAT "%5.1"
 /begin AXIS_DESCR COM_AXIS TCO_DIF _CNV_A_R_LINEAR_____8_CM 8 -96. 95.25 FORMAT "%6.2" AXIS_PTS_REF ldp_tco_dif__ectpwm_p /end AXIS_DESCR
/end CHARACTERISTIC
/begin MEASUREMENT ECTPWM "Actuation pulse width modulation for thermostat" UBYTE _CNV_A_R_LINEAR_____4_CM 1 100. 0. 99.609375 ECU_ADDRESS 0x3fcf95 FORMAT "%5.1" /end MEASUREMENT
/begin CHARACTERISTIC C_TOIL_MAX_ECT "TOIL threshold for hot operation" VALUE 0x42ac6 _REC_VAL_20_u1 200. _CNV_A_R_LINEAR_____3_CM -40. 160. FORMAT "%3.0" /end CHARACTERISTIC
/begin CHARACTERISTIC ID_TCO_SP_ECT__N__PV_MAX "Target coolant temperature for vehicles without air conditioner" MAP 0x4cfcb _REC_MAP_20_u1_u1_u1 190.5 _CNV_A_R_LINEAR_____0_CM -48. 142.5 FORMAT "%5.1"
 /begin AXIS_DESCR COM_AXIS N_32 _CNV_A_R_LINEAR_____5_CM 12 0. 8160. FORMAT "%4.0" AXIS_PTS_REF ldpm_n_32_28 /end AXIS_DESCR
 /begin AXIS_DESCR COM_AXIS PV_MAX _CNV_A_R_LINEAR_____4_CM 6 0. 99.609375 FORMAT "%5.1" AXIS_PTS_REF ldpm_pv_max_1 /end AXIS_DESCR
/end CHARACTERISTIC
/begin CHARACTERISTIC ID_TCO_SP_ECT_ACIN__N__PV_MAX "Target coolant temperature for vehicles with air conditioner" MAP 0x4d013 _REC_MAP_20_u1_u1_u1 190.5 _CNV_A_R_LINEAR_____0_CM -48. 142.5 FORMAT "%5.1"
 /begin AXIS_DESCR COM_AXIS N_32 _CNV_A_R_LINEAR_____5_CM 12 0. 8160. FORMAT "%4.0" AXIS_PTS_REF ldpm_n_32_28 /end AXIS_DESCR
 /begin AXIS_DESCR COM_AXIS PV_MAX _CNV_A_R_LINEAR_____4_CM 6 0. 99.609375 FORMAT "%5.1" AXIS_PTS_REF ldpm_pv_max_1 /end AXIS_DESCR
/end CHARACTERISTIC
/begin CHARACTERISTIC C_TIA_MAX_ECT "TIA threshold" VALUE 0x42ab2 _REC_VAL_20_u1 28.575 _CNV_A_R_LINEAR_____0_CM -48. 142.5 FORMAT "%5.1" /end CHARACTERISTIC
/begin CHARACTERISTIC C_TCO_TEMP_GB_1 "TCO at cooling step 1" VALUE 0x42a89 _REC_VAL_20_u1 28.575 _CNV_A_R_LINEAR_____0_CM -48. 142.5 FORMAT "%5.1" /end CHARACTERISTIC
/begin CHARACTERISTIC C_TCO_TEMP_GB_2 "TCO at cooling step 2" VALUE 0x42a8a _REC_VAL_20_u1 28.575 _CNV_A_R_LINEAR_____0_CM -48. 142.5 FORMAT "%5.1" /end CHARACTERISTIC
/begin CHARACTERISTIC C_ECTPWM_MAN "Manual ECTPWM" VALUE 0x4288b _REC_VAL_20_u1 99.609375 _CNV_A_R_LINEAR_____4_CM 0. 99.609375 FORMAT "%4.1" /end CHARACTERISTIC
/begin CHARACTERISTIC LC_ECTPWM_MAN "Constant to switch to manual PWM activation" VALUE 0x42b73 _REC_VAL_20_u1 1. _CNV_A_R_LINEAR_____10_CM 0. 1. FORMAT "%2.0" /end CHARACTERISTIC
/begin AXIS_PTS ldp_n_32__ectpwm_add "" 0x434d3 N_32 _REC_AXS_20_u1 8160. _CNV_A_R_LINEAR_____5_CM 8 0. 8160. FORMAT "%4.0" /end AXIS_PTS
/begin AXIS_PTS ldp_tco_dif__ectpwm_i "" 0x438ed TCO_DIF _REC_AXS_20_u1 191.25 _CNV_A_R_LINEAR_____8_CM 8 -96. 95.25 FORMAT "%6.2" /end AXIS_PTS
/begin AXIS_PTS ldp_tco_dif__ectpwm_p "" 0x438f6 TCO_DIF _REC_AXS_20_u1 191.25 _CNV_A_R_LINEAR_____8_CM 8 -96. 95.25 FORMAT "%6.2" /end AXIS_PTS
/begin AXIS_PTS ldp_tco_sp__ectpwm_add "" 0x43944 TCO_SP _REC_AXS_20_u1 190.5 _CNV_A_R_LINEAR_____0_CM 8 -48. 142.5 FORMAT "%5.1" /end AXIS_PTS
/begin AXIS_PTS ldp_tco_st__dist "" 0x4394d TCO_ST _REC_AXS_20_u1 190.5 _CNV_A_R_LINEAR_____0_CM 8 -48. 142.5 FORMAT "%5.1" /end AXIS_PTS
/begin AXIS_PTS ldpm_pv_max_1 "" 0x43f0e PV_MAX _REC_AXS_20_u1 99.609375 _CNV_A_R_LINEAR_____4_CM 6 0. 99.609375 FORMAT "%5.1" /end AXIS_PTS
/begin AXIS_PTS ldpm_n_32_28 "" 0x43d19 N_32 _REC_AXS_20_u1 8160. _CNV_A_R_LINEAR_____5_CM 12 0. 8160. FORMAT "%4.0" /end AXIS_PTS
/begin MEASUREMENT LV_ACCOUT_RLY_ENA "LV indicating that the conditions for activating the ACC-relay are fullfilled" UBYTE _CNV_S_2_RANGE______28_CM 1 100. 0. 1. ECU_ADDRESS 0x3fcf85 /end MEASUREMENT
/begin CHARACTERISTIC C_VS_MAX_ACCIN "Speed condition for ACC suppression at high load" VALUE 0x42b26 _REC_VAL_20_u1 255. _CNV_A_R_LINEAR_____13_CM 0. 255. FORMAT "%3.0" /end CHARACTERISTIC
/begin CHARACTERISTIC C_ACCIN_DLY_1 "Delay for ACC suppression in transition after full load" VALUE 0x42c0e _REC_VAL_20_u2 655.34 _CNV_A_R_LINEAR_____27_CM 1.e-002 655.35 FORMAT "%6.2" /end CHARACTERISTIC
/begin CHARACTERISTIC C_ACCIN_DLY_1_LOCK_FL "Blocking time for renewed triggering of the ACC suppression at high load" VALUE 0x42c10 _REC_VAL_20_u2 655.35 _CNV_A_R_LINEAR_____27_CM 0. 655.35 FORMAT "%6.2" /end CHARACTERISTIC
/begin CHARACTERISTIC C_ACCIN_DLY_4 "Delay in transition from start" VALUE 0x42c12 _REC_VAL_20_u2 6553.5 _CNV_A_R_LINEAR_____14_CM 0. 6553.5 FORMAT "%6.1" /end CHARACTERISTIC
/begin CHARACTERISTIC C_PVS_FL_ACCIN "PV-threshold for ACC suppression" VALUE 0x42990 _REC_VAL_20_u1 99.609375 _CNV_A_R_LINEAR_____4_CM 0. 99.609375 FORMAT "%4.1" /end CHARACTERISTIC
/begin CHARACTERISTIC C_ACCIN_DLY_5 "Delay before renewed reactivation of the ACC" VALUE 0x42c14 _REC_VAL_20_u2 655.35 _CNV_A_R_LINEAR_____27_CM 0. 655.35 FORMAT "%6.2" /end CHARACTERISTIC
/begin CHARACTERISTIC C_TCO_MAX_ACCIN "TCC threshold for ACC suppression" VALUE 0x42a5a _REC_VAL_20_u1 190.5 _CNV_A_R_LINEAR_____0_CM -48. 142.5 FORMAT "%5.1" /end CHARACTERISTIC
/begin MEASUREMENT LV_ACCOUT_RLY "LV to activate the ACC-relay" UBYTE _CNV_S_2_RANGE______28_CM 1 100. 0. 1. ECU_ADDRESS 0x3fcf86 BIT_MASK 0x1 /end MEASUREMENT
/begin MEASUREMENT T_ACC_ON "Turn-On-Delay for the ACC-relay" UBYTE _CNV_A_R_LINEAR_____27_CM 1 100. 0. 2.55 ECU_ADDRESS 0x3fcf82 FORMAT "%4.2" /end MEASUREMENT
/begin MEASUREMENT T_ACC_OFF "Turn-Off-Delay for the ACC-relay" UBYTE _CNV_A_R_LINEAR_____27_CM 1 100. 0. 2.55 ECU_ADDRESS 0x3fcf83 FORMAT "%4.2" /end MEASUREMENT
/begin CHARACTERISTIC IP_T_ACC_ON__N_32 "Turn-On-Delay for ACC-relay depending on N_32" CURVE 0x4fe37 _REC_CUR_20_u1_u1 2.55 _CNV_A_R_LINEAR_____27_CM 0. 2.55 FORMAT "%4.2"
 /begin AXIS_DESCR COM_AXIS N_32 _CNV_A_R_LINEAR_____5_CM 3 0. 8160. FORMAT "%4.0" AXIS_PTS_REF ldpm_n_32__t_acc /end AXIS_DESCR
/end CHARACTERISTIC
/begin CHARACTERISTIC IP_T_ACC_OFF__N_32 "Turn-Off-Delay for ACC-relay depending on N_32" CURVE 0x4fe34 _REC_CUR_20_u1_u1 2.55 _CNV_A_R_LINEAR_____27_CM 0. 2.55 FORMAT "%4.2"
 /begin AXIS_DESCR COM_AXIS N_32 _CNV_A_R_LINEAR_____5_CM 3 0. 8160. FORMAT "%4.0" AXIS_PTS_REF ldpm_n_32__t_acc /end AXIS_DESCR
/end CHARACTERISTIC
/begin CHARACTERISTIC C_TCO_MAX_ACCIN_HYS "Hysteresis for leaving ACC suppression" VALUE 0x42a5b _REC_VAL_20_u1 60. _CNV_A_R_LINEAR_____1_CM 0. 60. FORMAT "%4.1" /end CHARACTERISTIC
/begin AXIS_PTS ldpm_n_32__t_acc "" 0x43de4 N_32 _REC_AXS_20_u1 8160. _CNV_A_R_LINEAR_____5_CM 3 0. 8160. FORMAT "%4.0" /end AXIS_PTS
/begin MEASUREMENT STATE_CP "State of Evaporative Emission Control Function" UBYTE _CNV_S_8_RANGE_STAT_105_CM 1 100. 0. 7. ECU_ADDRESS 0x3fc52c /end MEASUREMENT
/begin MEASUREMENT STATE_TRA_CP "State of transitions between partial functions of the Evaporative Emission Control" UBYTE _CNV_S_12_RANGE_STAT_106_CM 1 100. 0. 11. ECU_ADDRESS 0x3fda0a /end MEASUREMENT
/begin MEASUREMENT STATE_NORM_DEAC_CP "Deactivation states of NORMAL_PURGE" UBYTE _CNV_S_3_RANGE_STAT_107_CM 1 100. 0. 2. ECU_ADDRESS 0x3fda0b /end MEASUREMENT
/begin MEASUREMENT REL_FLOW_OPEN_CPS "Setpoint value for the relative flow (FLOW_CPS/MAF_CYL) through the CPS during RAMP_PEN_FAST" UWORD _CNV_A_R_LINEAR_____31_CM 1 100. 0. 0.99998474 ECU_ADDRESS 0x3fd9e0 FORMAT "%7.5" /end MEASUREMENT
/begin MEASUREMENT REL_FLOW_MAX_CPS "Maximum value for the relative flow (FLOW_CPS/MAF_CYL) through the CPS" UWORD _CNV_A_R_LINEAR_____31_CM 1 100. 0. 0.99998474 ECU_ADDRESS 0x3fc528 FORMAT "%7.5" /end MEASUREMENT
/begin MEASUREMENT REL_FLOW_CPS "Setpoint value for the relative flow (FLOW_CPS/MAF_CYL) through the CPS" UWORD _CNV_A_R_LINEAR_____31_CM 1 100. 0. 0.99998474 ECU_ADDRESS 0x3fc51c FORMAT "%7.5" /end MEASUREMENT
/begin MEASUREMENT REL_FLOW_CPS_DI "Relative flow (FLOW_CPS/MAF_CYL) through the CPS for disabled NORMAL_PURGE operation" UWORD _CNV_A_R_LINEAR_____31_CM 1 100. 0. 0.99998474 ECU_ADDRESS 0x3fd9e2 FORMAT "%7.5" /end MEASUREMENT
/begin MEASUREMENT REL_FLOW_CPS_OLD "Relative flow (FLOW_CPS/MAF_CYL) for additive mass fuel correction" UWORD _CNV_A_R_LINEAR_____31_CM 1 100. 0. 0.99998474 ECU_ADDRESS 0x3fd9e4 FORMAT "%7.5" /end MEASUREMENT
/begin MEASUREMENT REL_FLOW_CPS_OLD_DI "Relative flow (FLOW_CPS/MAF_CYL) for additive mass fuel correction for disabled NORMAL_PURGE operation" UWORD _CNV_A_R_LINEAR_____31_CM 1 100. 0. 0.99998474 ECU_ADDRESS 0x3fd9e6 FORMAT "%7.5" /end MEASUREMENT
/begin MEASUREMENT LAM_DIF_CP "Lambda deviation with active canister purge" SWORD _CNV_A_R_LINEAR_____98_CM 1 100. -50. 49.99847412 ECU_ADDRESS 0x3fc524 FORMAT "%7.3" /end MEASUREMENT
/begin MEASUREMENT FUEL_FLOW_MAX_CP "Maximum fuel flow coming from the canister" UWORD _CNV_A_R_LINEAR_____99_CM 1 100. 0. 7.99987793 ECU_ADDRESS 0x3fd9e8 FORMAT "%7.4" /end MEASUREMENT
/begin MEASUREMENT FUEL_FLOW_CP "Fuel flow from the ACF" UWORD _CNV_A_R_LINEAR_____99_CM 1 100. 0. 7.99987793 ECU_ADDRESS 0x3fd9ec FORMAT "%7.4" /end MEASUREMENT
/begin MEASUREMENT CL "Canister load						" UWORD _CNV_A_R_LINEAR_____108_CM 1 100. 0. 1.999878 ECU_ADDRESS 0x3fd9f2 FORMAT "%6.5" /end MEASUREMENT
/begin MEASUREMENT CL_MMV "Moving mean value of the canister load CL" UWORD _CNV_A_R_LINEAR_____108_CM 1 100. 0. 1.999878 ECU_ADDRESS 0x3fc51e FORMAT "%6.5" /end MEASUREMENT
/begin MEASUREMENT CL_MMV_DI "Moving mean value of the canister load CL for disabled NORMAL_PURGE operation" UWORD _CNV_A_R_LINEAR_____108_CM 1 100. 0. 1.999878 ECU_ADDRESS 0x3fd9f6 FORMAT "%6.5" /end MEASUREMENT
/begin MEASUREMENT CL_MMV_OLD "Canister load for additive mass fuel correction calculation" UWORD _CNV_A_R_LINEAR_____108_CM 1 100. 0. 1.999878 ECU_ADDRESS 0x3fd9f8 FORMAT "%6.5" /end MEASUREMENT
/begin MEASUREMENT CL_MMV_OLD_DI "Canister load for additive mass fuel correction calculation for disabled NORMAL_PURGE operation  " UWORD _CNV_A_R_LINEAR_____109_CM 1 100. 0. 7.99987793 ECU_ADDRESS 0x3fd9fa FORMAT "%6.5" /end MEASUREMENT
/begin MEASUREMENT CL_MMV_NORM_PURGE_END "Canister load at the end of NORMAL_PURGE_MAX_PURGE operation" UWORD _CNV_A_R_LINEAR_____108_CM 1 100. 0. 1.999878 ECU_ADDRESS 0x3fc522 FORMAT "%6.5" /end MEASUREMENT
/begin MEASUREMENT LAM_0_CP "Start value of the lambda control correction LAM_CP before the CPS is opened" SWORD _CNV_A_R_LINEAR_____98_CM 1 100. -50. 49.99847412 ECU_ADDRESS 0x3fd9ea /end MEASUREMENT
/begin MEASUREMENT LAM_CP " Lambda control correction value used for canister load calculation" SWORD _CNV_A_R_LINEAR_____98_CM 1 100. -50. 49.99847412 ECU_ADDRESS 0x3fc520 /end MEASUREMENT
/begin MEASUREMENT LV_RAMP_CLOSE_END "Logical value for end of  RAMP_CLOSE operation" UBYTE _CNV_S_2_RANGE______28_CM 1 100. 0. 1. ECU_ADDRESS 0x3fda0d BIT_MASK 0x1 /end MEASUREMENT
/begin MEASUREMENT LV_RAMP_OPEN_ACT "Logical value for active RAMP_OPEN operation" UBYTE _CNV_S_2_RANGE______28_CM 1 100. 0. 1. ECU_ADDRESS 0x3fc52e BIT_MASK 0x1 /end MEASUREMENT
/begin MEASUREMENT LV_MAX_PURGE_ACT "Logical value for active MAX_PURGE operation" UBYTE _CNV_S_2_RANGE______28_CM 1 100. 0. 1. ECU_ADDRESS 0x3fc52d BIT_MASK 0x1 /end MEASUREMENT
/begin MEASUREMENT FUEL_FLOW_ADD_AD_CP "Additive adaptive fuel flow from the ACF for the additive mass fuel correction" UWORD _CNV_A_R_LINEAR_____99_CM 1 100. 0. 7.99987793 ECU_ADDRESS 0x3fc526 FORMAT "%7.4" /end MEASUREMENT
/begin MEASUREMENT T_DLY_MAX_CP "Time counter between the end of a MAX_PURGE and a new learning request" UWORD _CNV_A_R_LINEAR_____14_CM 1 100. 0. 6553.5 ECU_ADDRESS 0x3fda00 FORMAT "%6.1" /end MEASUREMENT
/begin MEASUREMENT FUEL_FLOW_LAM_CP "Fuel flow lambda control part from the ACF" SWORD _CNV_A_R_LINEAR_____110_CM 1 100. -4. 3.99987793 ECU_ADDRESS 0x3fd9ee FORMAT "%6.4" /end MEASUREMENT
/begin MEASUREMENT LV_TRA_LAM_CP "First lambda control shift during RAMP_OPEN" UBYTE _CNV_S_2_RANGE______28_CM 1 100. 0. 1. ECU_ADDRESS 0x3fda0c BIT_MASK 0x1 /end MEASUREMENT
/begin MEASUREMENT CL_MMV_DYW_MIN "Minimum value of the dynamic window during RAMP_OPEN" UWORD _CNV_A_R_LINEAR_____108_CM 1 100. 0. 1.999878 ECU_ADDRESS 0x3fd9fc FORMAT "%6.4" /end MEASUREMENT
/begin MEASUREMENT CL_MMV_DYW_MAX "Maximum value of the dynamic window during RAMP_OPEN" UWORD _CNV_A_R_LINEAR_____108_CM 1 100. 0. 1.999878 ECU_ADDRESS 0x3fd9fe FORMAT "%6.4" /end MEASUREMENT
/begin MEASUREMENT LV_T_RAMP_OPEN_END "Time of RAMP_OPEN finished" UBYTE _CNV_S_2_RANGE______28_CM 1 100. 0. 1. ECU_ADDRESS 0x3fda0e BIT_MASK 0x1 /end MEASUREMENT
/begin MEASUREMENT LV_MIN_PURGE_STAB_ACT "MIN_PRGE active without transition" UBYTE _CNV_S_2_RANGE______28_CM 1 100. 0. 1. ECU_ADDRESS 0x3fc530 BIT_MASK 0x1 /end MEASUREMENT
/begin MEASUREMENT LV_T_DLY_REQ_CP "C_T_DLY_REQ_CP time elapsed" UBYTE _CNV_S_2_RANGE______28_CM 1 100. 0. 1. ECU_ADDRESS 0x3fc531 BIT_MASK 0x1 /end MEASUREMENT
/begin CHARACTERISTIC C_PRS_MAX_2_CPS "" VALUE 0x432b6 _REC_VAL_20_s2 5434. _CNV_A_R_LINEAR_____97_CM -2717.04 2716.96 FORMAT "%8.2" /end CHARACTERISTIC
/begin CHARACTERISTIC C_T_DI_RAMP_OPEN_CP "" VALUE 0x42f76 _REC_VAL_20_u2 6553.400000000001 _CNV_A_R_LINEAR_____14_CM 0.1 6553.5 FORMAT "%6.1" /end CHARACTERISTIC
/begin CHARACTERISTIC C_T_DI_MAX_CP "" VALUE 0x42f74 _REC_VAL_20_u2 6553.400000000001 _CNV_A_R_LINEAR_____14_CM 0.1 6553.5 FORMAT "%6.1" /end CHARACTERISTIC
/begin CHARACTERISTIC C_T_DLY_CP "" VALUE 0x42f7e _REC_VAL_20_u2 6553.400000000001 _CNV_A_R_LINEAR_____14_CM 0.1 6553.5 FORMAT "%6.1" /end CHARACTERISTIC
/begin CHARACTERISTIC C_T_DLY_MAX_CP "" VALUE 0x42f94 _REC_VAL_20_u2 6553.5 _CNV_A_R_LINEAR_____14_CM 0. 6553.5 FORMAT "%6.1" /end CHARACTERISTIC
/begin CHARACTERISTIC C_FUEL_FAC_CP "" VALUE 0x42d82 _REC_VAL_20_u2 255.996094 _CNV_A_R_LINEAR_____111_CM 0. 255.996094 FORMAT "%7.3" /end CHARACTERISTIC
/begin CHARACTERISTIC C_CL_MAX_CP "" VALUE 0x42c4c _REC_VAL_20_u2 1.99996948 _CNV_A_R_LINEAR_____45_CM 0. 1.99996948 FORMAT "%7.5" /end CHARACTERISTIC
/begin CHARACTERISTIC C_CL_DYW_MAX_CP "" VALUE 0x42c48 _REC_VAL_20_u2 1.99996948 _CNV_A_R_LINEAR_____45_CM 0. 1.99996948 FORMAT "%7.5" /end CHARACTERISTIC
/begin CHARACTERISTIC C_CL_ST_CP "" VALUE 0x42c60 _REC_VAL_20_u2 1.99996948 _CNV_A_R_LINEAR_____45_CM 0. 1.99996948 FORMAT "%7.5" /end CHARACTERISTIC
/begin CHARACTERISTIC C_LAM_DIF_MAX_CP "" VALUE 0x4326c _REC_VAL_20_s2 99.99847412 _CNV_A_R_LINEAR_____98_CM -50. 49.99847412 FORMAT "%7.3" /end CHARACTERISTIC
/begin CHARACTERISTIC C_REL_FLOW_INI_CPS "" VALUE 0x42f26 _REC_VAL_20_u2 0.999755 _CNV_A_R_LINEAR_____112_CM 0. 0.999755 FORMAT "%7.5" /end CHARACTERISTIC
/begin CHARACTERISTIC C_T_DLY_MAX_RAMP_OPEN "" VALUE 0x42f98 _REC_VAL_20_u2 655.34 _CNV_A_R_LINEAR_____27_CM 1.e-002 655.35 FORMAT "%5.2" /end CHARACTERISTIC
/begin CHARACTERISTIC C_CL_MMV_DYW "" VALUE 0x42c52 _REC_VAL_20_u2 1.99996948 _CNV_A_R_LINEAR_____45_CM 0. 1.99996948 FORMAT "%7.5" /end CHARACTERISTIC
/begin CHARACTERISTIC C_FLOW_MIN_CPS "" VALUE 0x42d62 _REC_VAL_20_u2 7.99987793 _CNV_A_R_LINEAR_____99_CM 0. 7.99987793 FORMAT "%7.4" /end CHARACTERISTIC
/begin CHARACTERISTIC C_DIF_MAX_TI_LAM_CP "" VALUE 0x43238 _REC_VAL_20_s2 99.99847412 _CNV_A_R_LINEAR_____98_CM -50. 49.99847412 FORMAT "%6.2" /end CHARACTERISTIC
/begin CHARACTERISTIC C_DIF_MIN_TI_LAM_CP "" VALUE 0x4323a _REC_VAL_20_s2 99.99847412 _CNV_A_R_LINEAR_____98_CM -50. 49.99847412 FORMAT "%6.2" /end CHARACTERISTIC
/begin CHARACTERISTIC C_T_DLY_REQ_CP "" VALUE 0x42f9c _REC_VAL_20_u2 65534. _CNV_A_R_LINEAR_____47_CM 1. 65535. FORMAT "%5.0" /end CHARACTERISTIC
/begin CHARACTERISTIC LC_INIT_CL_CRLC "Correlation factor calculation in case of  NO_PURGE ->MAX_PURGE Transition" VALUE 0x42ba2 _REC_VAL_20_u1 1. _CNV_S_2_RANGE______11_CM 0. 1. /end CHARACTERISTIC
/begin CHARACTERISTIC LC_LAM_CBK_CPS "Lambda controller selection (0 -> bank 0 , 1->bank1)" VALUE 0x42ba7 _REC_VAL_20_u1 1. _CNV_S_2_RANGE______11_CM 0. 1. /end CHARACTERISTIC
/begin CHARACTERISTIC IP_REL_FLOW_INC_CP__MAF_CYL "Increment value for ramp increase of REL_FLOW_CPS" CURVE 0x4a00c _REC_CUR_20_u2_u2 0.99998474 _CNV_A_R_LINEAR_____31_CM 0. 0.99998474 FORMAT "%7.5"
 /begin AXIS_DESCR COM_AXIS MAF_CYL _CNV_A_R_LINEAR_____101_CM 6 0. 2047.96875 FORMAT "%6.2" AXIS_PTS_REF ldpm_maf_cyl_ip_rel_flow_inc_cp /end AXIS_DESCR
/end CHARACTERISTIC
/begin CHARACTERISTIC IP_REL_FLOW_FAC_CP__CL "Correction factor for ramp increase of REL_FLOW_CPS" CURVE 0x49ff4 _REC_CUR_20_u2_u2 4. _CNV_A_R_LINEAR_____113_CM 0. 4. FORMAT "%6.4"
 /begin AXIS_DESCR COM_AXIS CL _CNV_A_R_LINEAR_____108_CM 6 0. 1.999878 FORMAT "%6.4" AXIS_PTS_REF ldp_cl_ip_rel_flow_fac_cp /end AXIS_DESCR
/end CHARACTERISTIC
/begin CHARACTERISTIC IP_CL_CRLC_RAMP_OPEN__MAF_CYL "Correlation constant for CL-filter during RAMP_OPEN" CURVE 0x46172 _REC_CUR_20_u2_u2 0.99998474 _CNV_A_R_LINEAR_____31_CM 0. 0.99998474 FORMAT "%7.5"
 /begin AXIS_DESCR COM_AXIS MAF_CYL _CNV_A_R_LINEAR_____101_CM 6 0. 2047.96875 FORMAT "%6.2" AXIS_PTS_REF ldpm_maf_cyl_ip_rel_flow_inc_cp /end AXIS_DESCR
/end CHARACTERISTIC
/begin CHARACTERISTIC IP_CL_CRLC_OPEN_FAST__MAF_CYL "Correlation constant for CL-filter during RAMP_OPEN_FAST" CURVE 0x46166 _REC_CUR_20_u2_u2 0.99998474 _CNV_A_R_LINEAR_____31_CM 0. 0.99998474 FORMAT "%7.5"
 /begin AXIS_DESCR COM_AXIS MAF_CYL _CNV_A_R_LINEAR_____101_CM 6 0. 2047.96875 FORMAT "%6.2" AXIS_PTS_REF ldpm_maf_cyl_ip_rel_flow_inc_cp /end AXIS_DESCR
/end CHARACTERISTIC
/begin CHARACTERISTIC IP_CL_CRLC__MAF_CYL "Correlation constant for CL-filter out of RAMP_OPEN" CURVE 0x46154 _REC_CUR_20_u2_u2 0.99998474 _CNV_A_R_LINEAR_____31_CM 0. 0.99998474 FORMAT "%7.5"
 /begin AXIS_DESCR COM_AXIS MAF_CYL _CNV_A_R_LINEAR_____101_CM 6 0. 2047.96875 FORMAT "%6.2" AXIS_PTS_REF ldpm_maf_cyl_ip_rel_flow_inc_cp /end AXIS_DESCR
/end CHARACTERISTIC
/begin CHARACTERISTIC IP_REL_FLOW_DEC_CP__MAF_CYL "Decrement value for ramp decrease of REL_FLOW_CPS" CURVE 0x49fd0 _REC_CUR_20_u2_u2 0.99998474 _CNV_A_R_LINEAR_____31_CM 0. 0.99998474 FORMAT "%7.5"
 /begin AXIS_DESCR COM_AXIS MAF_CYL _CNV_A_R_LINEAR_____101_CM 6 0. 2047.96875 FORMAT "%6.2" AXIS_PTS_REF ldpm_maf_cyl_ip_rel_flow_inc_cp /end AXIS_DESCR
/end CHARACTERISTIC
/begin CHARACTERISTIC IP_REL_FLOW_MAX_CPS__N_32__MAF "Maximum limit for REL_FLOW_CPS value" MAP 0x4a018 _REC_MAP_20_u2_u1_u1 0.99998474 _CNV_A_R_LINEAR_____31_CM 0. 0.99998474 FORMAT "%7.5"
 /begin AXIS_DESCR COM_AXIS N_32 _CNV_A_R_LINEAR_____5_CM 12 0. 8160. FORMAT "%4.0" AXIS_PTS_REF ldpm_n_32_ip_rel_flow_max_cps /end AXIS_DESCR
 /begin AXIS_DESCR COM_AXIS MAF _CNV_A_R_LINEAR_____18_CM 12 0. 1389. FORMAT "%4.0" AXIS_PTS_REF ldpm_maf_ip_rel_flow_max_cps /end AXIS_DESCR
/end CHARACTERISTIC
/begin CHARACTERISTIC IP_REL_FLOW_MIN_CPS__N_32__MAF "Map for REL_FLOW_CPS  during MIN_PURGE operation" MAP 0x4a258 _REC_MAP_20_u2_u1_u1 0.99998474 _CNV_A_R_LINEAR_____31_CM 0. 0.99998474 FORMAT "%7.5"
 /begin AXIS_DESCR COM_AXIS N_32 _CNV_A_R_LINEAR_____5_CM 12 0. 8160. FORMAT "%4.0" AXIS_PTS_REF ldpm_n_32_ip_rel_flow_max_cps /end AXIS_DESCR
 /begin AXIS_DESCR COM_AXIS MAF _CNV_A_R_LINEAR_____18_CM 12 0. 1389. FORMAT "%4.0" AXIS_PTS_REF ldpm_maf_ip_rel_flow_max_cps /end AXIS_DESCR
/end CHARACTERISTIC
/begin CHARACTERISTIC IP_REL_FLOW_INC_2_CP__MAF_CYL "REL_FLOW_CPS increment value in RAMP_OPEN_FAST" CURVE 0x4a000 _REC_CUR_20_u2_u2 0.99998474 _CNV_A_R_LINEAR_____31_CM 0. 0.99998474 FORMAT "%7.5"
 /begin AXIS_DESCR COM_AXIS MAF_CYL _CNV_A_R_LINEAR_____101_CM 6 0. 2047.96875 FORMAT "%6.2" AXIS_PTS_REF ldpm_maf_cyl_ip_rel_flow_inc_cp /end AXIS_DESCR
/end CHARACTERISTIC
/begin CHARACTERISTIC IP_REL_FLOW_DEC_V1_CP__MAF_CYL "REL_FLOW_CPS decrement value ( high speed )" CURVE 0x49fdc _REC_CUR_20_u2_u2 0.99998474 _CNV_A_R_LINEAR_____31_CM 0. 0.99998474 FORMAT "%7.5"
 /begin AXIS_DESCR COM_AXIS MAF_CYL _CNV_A_R_LINEAR_____101_CM 6 0. 2047.96875 FORMAT "%6.2" AXIS_PTS_REF ldpm_maf_cyl_ip_rel_flow_inc_cp /end AXIS_DESCR
/end CHARACTERISTIC
/begin CHARACTERISTIC IP_REL_FLOW_DEC_V2_CP__MAF_CYL "REL_FLOW_CPS decrement value ( middle speed )" CURVE 0x49fe8 _REC_CUR_20_u2_u2 0.99998474 _CNV_A_R_LINEAR_____31_CM 0. 0.99998474 FORMAT "%7.5"
 /begin AXIS_DESCR COM_AXIS MAF_CYL _CNV_A_R_LINEAR_____101_CM 6 0. 2047.96875 FORMAT "%6.2" AXIS_PTS_REF ldpm_maf_cyl_ip_rel_flow_inc_cp /end AXIS_DESCR
/end CHARACTERISTIC
/begin CHARACTERISTIC IP_T_DLY_CL_MMV_DYW__MAF_CYL "Stabilization delay on CL_MMV vale during RAMP_OPEN" CURVE 0x4a66c _REC_CUR_20_u2_u2 655.34 _CNV_A_R_LINEAR_____27_CM 1.e-002 655.35 FORMAT "%5.2"
 /begin AXIS_DESCR COM_AXIS MAF_CYL _CNV_A_R_LINEAR_____101_CM 6 0. 2047.96875 FORMAT "%6.2" AXIS_PTS_REF ldpm_maf_cyl_ip_rel_flow_inc_cp /end AXIS_DESCR
/end CHARACTERISTIC
/begin CHARACTERISTIC IP_NR_STEP_CL__CL_MMV "Number of step to change of correlation factor value" CURVE 0x4992e _REC_CUR_20_u2_u2 0.999755 _CNV_A_R_LINEAR_____112_CM 0. 0.999755 FORMAT "%7.5"
 /begin AXIS_DESCR COM_AXIS MAF _CNV_A_R_LINEAR_____45_CM 3 0. 1.99996948 FORMAT "%7.5" AXIS_PTS_REF ldpm_cl_mmv_ip_nr_step_cl /end AXIS_DESCR
/end CHARACTERISTIC
/begin CHARACTERISTIC IP_CL_CRLC_INIT__CL_MMV "Initialization value for correlation factor value" CURVE 0x46160 _REC_CUR_20_u2_u2 0.999755 _CNV_A_R_LINEAR_____112_CM 0. 0.999755 FORMAT "%7.5"
 /begin AXIS_DESCR COM_AXIS MAF _CNV_A_R_LINEAR_____45_CM 3 0. 1.99996948 FORMAT "%7.5" AXIS_PTS_REF ldpm_cl_mmv_ip_nr_step_cl /end AXIS_DESCR
/end CHARACTERISTIC
/begin MEASUREMENT LAM_ADJ_CP "Correction value for TI_LAM correction during RAMP_OPEN operation" SWORD _CNV_A_R_LINEAR_____98_CM 1 100. -50. 49.99847412 ECU_ADDRESS 0x3fc52a /end MEASUREMENT
/begin MEASUREMENT LV_LAM_ADJ_CP "Logical value for TI_LAM_COR correction during RAMP_OPEN operation" UBYTE _CNV_S_2_RANGE______11_CM 1 100. 0. 1. ECU_ADDRESS 0x3fc532 BIT_MASK 0x1 /end MEASUREMENT
/begin CHARACTERISTIC IP_REL_FUEL_FLOW_MAX_CP_COR "Correction factor for FUEL_FLOW_MAX_CP" CURVE 0x4fe07 _REC_CUR_20_u1_u1 0.9960940000000002 _CNV_A_R_LINEAR_____114_CM 0. 0.996094 FORMAT "%5.3"
 /begin AXIS_DESCR COM_AXIS TCO _CNV_A_R_LINEAR_____0_CM 5 -48. 142.5 FORMAT "%5.1" AXIS_PTS_REF ldp_tco_ip_rel_fuel_max_cp_cor /end AXIS_DESCR
/end CHARACTERISTIC
/begin CHARACTERISTIC IP_REL_FLOW_MAX_OPEN_CPS "Maximum limit for REL_FLOW_CPS value for RAMP_OPEN" MAP 0x4a138 _REC_MAP_20_u2_u1_u1 0.99998474 _CNV_A_R_LINEAR_____31_CM 0. 0.99998474 FORMAT "%7.5"
 /begin AXIS_DESCR COM_AXIS N_32 _CNV_A_R_LINEAR_____5_CM 12 0. 8160. FORMAT "%4.0" AXIS_PTS_REF ldpm_n_32_ip_rel_flow_max_cps /end AXIS_DESCR
 /begin AXIS_DESCR COM_AXIS MAF _CNV_A_R_LINEAR_____18_CM 12 0. 1389. FORMAT "%4.0" AXIS_PTS_REF ldpm_maf_ip_rel_flow_max_cps /end AXIS_DESCR
/end CHARACTERISTIC
/begin CHARACTERISTIC IP_REL_FUEL_FLOW_MAX_CP "Maximum fuel flow through the CPS" MAP 0x4a378 _REC_MAP_20_u2_u1_u1 0.99998474 _CNV_A_R_LINEAR_____31_CM 0. 0.99998474 FORMAT "%7.5"
 /begin AXIS_DESCR COM_AXIS N_32 _CNV_A_R_LINEAR_____5_CM 12 0. 8160. FORMAT "%4.0" AXIS_PTS_REF ldpm_n_32_ip_rel_flow_max_cps /end AXIS_DESCR
 /begin AXIS_DESCR COM_AXIS MAF _CNV_A_R_LINEAR_____18_CM 12 0. 1389. FORMAT "%4.0" AXIS_PTS_REF ldpm_maf_ip_rel_flow_max_cps /end AXIS_DESCR
/end CHARACTERISTIC
/begin AXIS_PTS ldp_cl_ip_rel_flow_fac_cp "" 0x441f4 CL _REC_AXS_20_u2 1.999878 _CNV_A_R_LINEAR_____108_CM 6 0. 1.999878 FORMAT "%6.4" /end AXIS_PTS
/begin AXIS_PTS ldpm_maf_ip_rel_flow_max_cps "" 0x43c93 MAF _REC_AXS_20_u1 69.45 _CNV_A_R_LINEAR_____18_CM 12 0. 1389. FORMAT "%4.0" /end AXIS_PTS
/begin AXIS_PTS ldpm_cl_mmv_ip_nr_step_cl "" 0x44ea8 CL_MMV _REC_AXS_20_u2 9.9998474e-002 _CNV_A_R_LINEAR_____45_CM 3 0. 1.99996948 FORMAT "%7.5" /end AXIS_PTS
/begin AXIS_PTS ldp_tco_ip_rel_fuel_max_cp_cor "" 0x43921 TCO _REC_AXS_20_u1 190.5 _CNV_A_R_LINEAR_____0_CM 5 -48. 142.5 FORMAT "%5.1" /end AXIS_PTS
/begin MEASUREMENT TEMP_MMV_SUB_CAT_ECF "Calculated cat. temperature substitute value" UBYTE _CNV_A_R_LINEAR_____160_CM 1 100. -33. 987. ECU_ADDRESS 0x3fcf89 FORMAT "%3.0" /end MEASUREMENT
/begin MEASUREMENT TEMP_MMV_SUB_CAT_ECF_STOP "Calculated cat. temperature substitute value at engine stop" UBYTE _CNV_A_R_LINEAR_____160_CM 1 100. -33. 987. ECU_ADDRESS 0x3fcf8b FORMAT "%3.0" /end MEASUREMENT
/begin MEASUREMENT ECFPWM_ECF "Electric fan control pulse width modulation" UBYTE _CNV_A_R_LINEAR_____4_CM 1 100. 0. 99.609375 ECU_ADDRESS 0x3fcf8a FORMAT "%5.1" /end MEASUREMENT
/begin MEASUREMENT N_ECF_MIN_HYS "Hysteresis of set point Electric fan seed stage" UBYTE _CNV_A_R_LINEAR_____40_CM 1 100. 0. 15.9375 ECU_ADDRESS 0x3fe51d /end MEASUREMENT
/begin MEASUREMENT N_ECF_COR "Set point Electric fan seed stage" UBYTE _CNV_A_R_LINEAR_____40_CM 1 100. 0. 15.9375 ECU_ADDRESS 0x3fe51b /end MEASUREMENT
/begin MEASUREMENT N_PERC "Percentage filtered value of set point Electric fan seed stage" UBYTE _CNV_A_R_LINEAR_____4_CM 1 100. 0. 99.609375 ECU_ADDRESS 0x3fe51c FORMAT "%5.1" /end MEASUREMENT
/begin MEASUREMENT ECFPWM_IGK_OFF "Electric fan pulse width modulation in the self-holding phase" UBYTE _CNV_A_R_LINEAR_____4_CM 1 100. 0. 99.609375 ECU_ADDRESS 0x3fe51f FORMAT "%5.1" /end MEASUREMENT
/begin CHARACTERISTIC ID_ECFPWM_IGK_OFF__TEMP_CAT_ "Map of Electric fan pulse width modulation in the self-holding phase" CURVE 0x4cc63 _REC_CUR_20_u1_u1 99.609375 _CNV_A_R_LINEAR_____4_CM 0. 99.609375 FORMAT "%5.1"
 /begin AXIS_DESCR COM_AXIS TEMP_MMV_SUB_CAT_ECF _CNV_A_R_LINEAR_____160_CM 6 -33. 987. FORMAT "%3.0" AXIS_PTS_REF ldpm_temp_mmv_sub_cat_ecf_1 /end AXIS_DESCR
/end CHARACTERISTIC
/begin CHARACTERISTIC IP_N_ECF_TEMP_CAT_ "Electric fan minimum speed stage cat temperature" CURVE 0x4fc2f _REC_CUR_20_u1_u1 15.9375 _CNV_A_R_LINEAR_____40_CM 0. 15.9375 FORMAT "%5.2"
 /begin AXIS_DESCR COM_AXIS TEMP_MMV_SUB_CAT_ECF _CNV_A_R_LINEAR_____160_CM 6 -33. 987. FORMAT "%3.0" AXIS_PTS_REF ldpm_temp_mmv_sub_cat_ecf_1 /end AXIS_DESCR
/end CHARACTERISTIC
/begin CHARACTERISTIC ID_N_ECF_MIN_ACCIN_ "Electric fan minimum speed stage CAN" CURVE 0x4cdb8 _REC_CUR_20_u1_u1 15.9375 _CNV_A_R_LINEAR_____40_CM 0. 15.9375 FORMAT "%5.2"
 /begin AXIS_DESCR COM_AXIS N_ECF _CNV_A_R_LINEAR_____10_CM 16 0. 15. FORMAT "%2.0" AXIS_PTS_REF ldp_n_ecf__n_ecf_min_accin /end AXIS_DESCR
/end CHARACTERISTIC
/begin CHARACTERISTIC IP_TEMP_SUB_ECF_INI_ "Cat substitute temperature initialization map" MAP 0x50880 _REC_MAP_20_u1_u1_u1 1020. _CNV_A_R_LINEAR_____160_CM -33. 987. FORMAT "%3.0"
 /begin AXIS_DESCR COM_AXIS TAM _CNV_A_R_LINEAR_____0_CM 6 -48. 142.5 FORMAT "%5.1" AXIS_PTS_REF ldp_tam__temp_sub_ecf_ini /end AXIS_DESCR
 /begin AXIS_DESCR COM_AXIS TCO _CNV_A_R_LINEAR_____0_CM 6 -48. 142.5 FORMAT "%5.1" AXIS_PTS_REF ldp_tco__temp_sub_ecf_ini /end AXIS_DESCR
/end CHARACTERISTIC
/begin CHARACTERISTIC IP_N_PERC_ECF_ "Electric fan control pulse width modulation" CURVE 0x4fcf1 _REC_CUR_20_u1_u1 99.609375 _CNV_A_R_LINEAR_____4_CM 0. 99.609375 FORMAT "%4.1"
 /begin AXIS_DESCR COM_AXIS N_ECF_COR_FIL _CNV_A_R_LINEAR_____40_CM 6 0. 15.9375 FORMAT "%5.2" AXIS_PTS_REF ldp_n_ecf_cor_fil__n_perc_ecf /end AXIS_DESCR
/end CHARACTERISTIC
/begin CHARACTERISTIC C_TCO_HYS_CAT "TCO hysteresis" VALUE 0x42a59 _REC_VAL_20_u1 60. _CNV_A_R_LINEAR_____1_CM 0. 60. FORMAT "%4.1" /end CHARACTERISTIC
/begin CHARACTERISTIC C_CRLC_INC_CAT_ECF_ "CRLC for substitute temperature on cat warming up" VALUE 0x42c72 _REC_VAL_20_u2 0.99998474 _CNV_A_R_LINEAR_____31_CM 0. 0.99998474 FORMAT "%7.5" /end CHARACTERISTIC
/begin CHARACTERISTIC C_CRLC_DEC_CAT_ECF_ "CRLC for substitute temperature on cat cooling down" VALUE 0x42c68 _REC_VAL_20_u2 0.99998474 _CNV_A_R_LINEAR_____31_CM 0. 0.99998474 FORMAT "%7.5" /end CHARACTERISTIC
/begin CHARACTERISTIC C_N_ECF_HYS "Electric fan speed hysteresis" VALUE 0x4293a _REC_VAL_20_u1 15.9375 _CNV_A_R_LINEAR_____40_CM 0. 15.9375 FORMAT "%5.2" /end CHARACTERISTIC
/begin CHARACTERISTIC C_N_PERC_ECF_LGRD "Limitation gradient of C_N_PERC_ECF_LGRD" VALUE 0x42969 _REC_VAL_20_u1 25. _CNV_A_R_LINEAR_____161_CM 0. 25. FORMAT "%5.2" /end CHARACTERISTIC
/begin CHARACTERISTIC C_T_N_PERC_ECF_AS "Application correction" VALUE 0x42a23 _REC_VAL_20_u1 99.60939999999999 _CNV_A_R_LINEAR_____9_CM -50. 49.6094 FORMAT "%5.1" /end CHARACTERISTIC
/begin CHARACTERISTIC C_T_N_PERC_ECF_ACT "Time condition for electric fan during self diagnostic" VALUE 0x42a22 _REC_VAL_20_u1 50.8 _CNV_A_R_LINEAR_____162_CM 0.2 51. FORMAT "%4.1" /end CHARACTERISTIC
/begin CHARACTERISTIC C_T_N_ECF_AST "Time condition after start for electric fan active" VALUE 0x42a21 _REC_VAL_20_u1 50.8 _CNV_A_R_LINEAR_____162_CM 0.2 51. FORMAT "%4.1" /end CHARACTERISTIC
/begin CHARACTERISTIC C_ECFPWM_MAX "Upper ECFPWM_ECF limitation" VALUE 0x42885 _REC_VAL_20_u1 99.609375 _CNV_A_R_LINEAR_____4_CM 0. 99.609375 FORMAT "%4.1" /end CHARACTERISTIC
/begin CHARACTERISTIC C_N_PERC_ACT_ECF "Set value for N_PERC_ECF" VALUE 0x42968 _REC_VAL_20_u1 99.609375 _CNV_A_R_LINEAR_____4_CM 0. 99.609375 FORMAT "%4.1" /end CHARACTERISTIC
/begin CHARACTERISTIC C_ECFPWM_ACT_ECF "Min limitation ECFPWM_ECF from speed stage C_N_PERC_ACT_ECF" VALUE 0x42883 _REC_VAL_20_u1 99.609375 _CNV_A_R_LINEAR_____4_CM 0. 99.609375 FORMAT "%4.1" /end CHARACTERISTIC
/begin CHARACTERISTIC C_TCO_EX_MAX_VS_HYS "hysteresis of temperature threshold" VALUE 0x42a54 _REC_VAL_20_u1 190.5 _CNV_A_R_LINEAR_____0_CM -48. 142.5 FORMAT "%5.1" /end CHARACTERISTIC
/begin CHARACTERISTIC C_TCO_EX_MAX_VS "threshold for coolant temperature" VALUE 0x42a53 _REC_VAL_20_u1 190.5 _CNV_A_R_LINEAR_____0_CM -48. 142.5 FORMAT "%5.1" /end CHARACTERISTIC
/begin CHARACTERISTIC IP_N_ECF "Electric fan speed stage" CURVE 0x4fc29 _REC_CUR_20_u1_u1 15.9375 _CNV_A_R_LINEAR_____40_CM 0. 15.9375 FORMAT "%5.2"
 /begin AXIS_DESCR COM_AXIS TCO_EX _CNV_A_R_LINEAR_____0_CM 6 -48. 142.5 FORMAT "%5.1" AXIS_PTS_REF ldp_tco_ex__n_ecf /end AXIS_DESCR
/end CHARACTERISTIC
/begin CHARACTERISTIC C_VB_ECF_GRD_MAX "VB gradient for VB filtering" VALUE 0x42b06 _REC_VAL_20_u1 26. _CNV_A_R_LINEAR_____53_CM 0. 26. FORMAT "%4.1" /end CHARACTERISTIC
/begin CHARACTERISTIC C_VB_ECF "Refernce VB (1.2* nominal voltage)" VALUE 0x42b05 _REC_VAL_20_u1 26. _CNV_A_R_LINEAR_____53_CM 0. 26. FORMAT "%4.1" /end CHARACTERISTIC
/begin CHARACTERISTIC IP_N_ECF_VS_COR_ "Speed correction of electric fan speed" CURVE 0x4fc3b _REC_CUR_20_u1_u1 0.9960940000000002 _CNV_A_R_LINEAR_____44_CM 0. 0.996094 FORMAT "%5.3"
 /begin AXIS_DESCR COM_AXIS VS _CNV_A_R_LINEAR_____13_CM 5 0. 255. FORMAT "%3.0" AXIS_PTS_REF ldp_vs__n_ecf_vs_cor /end AXIS_DESCR
/end CHARACTERISTIC
/begin CHARACTERISTIC IP_N_ECF_TEMP_GB "Electric fan speed stage depending on gear box temperature" CURVE 0x4fc35 _REC_CUR_20_u1_u1 15.9375 _CNV_A_R_LINEAR_____40_CM 0. 15.9375 FORMAT "%5.2"
 /begin AXIS_DESCR COM_AXIS TEMP_GB _CNV_A_R_LINEAR_____3_CM 6 -40. 215. FORMAT "%3.0" AXIS_PTS_REF ldp_temp_gb__n_ecf_temp_gb /end AXIS_DESCR
/end CHARACTERISTIC
/begin MEASUREMENT N_ECF_COR_FIL "Filter value of set point Electric fan seed stage" UBYTE _CNV_A_R_LINEAR_____40_CM 1 100. 0. 15.9375 ECU_ADDRESS 0x3fe51e /end MEASUREMENT
/begin MEASUREMENT N_ECF_TEMP_GB_MAX "Value of set point Electric fan seed stage in case of additional cooling request by EGS" UBYTE _CNV_A_R_LINEAR_____40_CM 1 100. 0. 15.9375 ECU_ADDRESS 0x3fcf8c /end MEASUREMENT
/begin CHARACTERISTIC C_TOIL_HYS_CAT "TOIL hysteresis" VALUE 0x42ac1 _REC_VAL_20_u1 60. _CNV_A_R_LINEAR_____1_CM 0. 60. FORMAT "%4.1" /end CHARACTERISTIC
/begin CHARACTERISTIC C_N_ECF_TEMP_GB_MAX "Value of setpoint electric fan stage in case of additional cooling request by EGS" VALUE 0x4293b _REC_VAL_20_u1 15.9375 _CNV_A_R_LINEAR_____40_CM 0. 15.9375 FORMAT "%5.2" /end CHARACTERISTIC
/begin AXIS_PTS ldp_n_ecf__n_ecf_min_accin "" 0x43725 N_ECF _REC_AXS_20_u1 15. _CNV_A_R_LINEAR_____10_CM 16 0. 15. FORMAT "%2.0" /end AXIS_PTS
/begin AXIS_PTS ldp_tco__temp_sub_ecf_ini "" 0x438d2 TCO _REC_AXS_20_u1 190.5 _CNV_A_R_LINEAR_____0_CM 6 -48. 142.5 FORMAT "%5.1" /end AXIS_PTS
/begin AXIS_PTS ldp_n_ecf_cor_fil__n_perc_ecf "" 0x43736 N_ECF_COR_FIL _REC_AXS_20_u1 15.9375 _CNV_A_R_LINEAR_____40_CM 6 0. 15.9375 FORMAT "%5.2" /end AXIS_PTS
/begin AXIS_PTS ldp_tco_ex__n_ecf "" 0x438ff TCO_EX _REC_AXS_20_u1 190.5 _CNV_A_R_LINEAR_____0_CM 6 -48. 142.5 FORMAT "%5.1" /end AXIS_PTS
/begin AXIS_PTS ldp_tam__temp_sub_ecf_ini "" 0x43823 TAM _REC_AXS_20_u1 190.5 _CNV_A_R_LINEAR_____0_CM 6 -48. 142.5 FORMAT "%5.1" /end AXIS_PTS
/begin AXIS_PTS ldpm_temp_mmv_sub_cat_ecf_1 "" 0x44044 TEMP_MMV_SUB_CAT_ECF _REC_AXS_20_u1 1020. _CNV_A_R_LINEAR_____160_CM 6 -33. 987. FORMAT "%3.0" /end AXIS_PTS
/begin AXIS_PTS ldp_vs__n_ecf_vs_cor "" 0x43b34 VS _REC_AXS_20_u1 255. _CNV_A_R_LINEAR_____13_CM 5 0. 255. FORMAT "%3.0" /end AXIS_PTS
/begin AXIS_PTS ldp_temp_gb__n_ecf_temp_gb "" 0x439aa TEMP_GB _REC_AXS_20_u1 255. _CNV_A_R_LINEAR_____3_CM 6 -40. 215. FORMAT "%3.0" /end AXIS_PTS
/begin CHARACTERISTIC C_ECFPWM_MIN "Lower ECFPWM_ECF limitation" VALUE 0x42887 _REC_VAL_20_u1 99.609375 _CNV_A_R_LINEAR_____4_CM 0. 99.609375 FORMAT "%4.1" /end CHARACTERISTIC
/begin CHARACTERISTIC C_ECFPWM_ECF_MAN "Manual ECFPWM_ECF" VALUE 0x42884 _REC_VAL_20_u1 99.609375 _CNV_A_R_LINEAR_____4_CM 0. 99.609375 FORMAT "%4.1" /end CHARACTERISTIC
/begin CHARACTERISTIC LC_ECFPWM_ECF_MAN "constant switch to manual ECFPWM_ECF activation" VALUE 0x42b70 _REC_VAL_20_u1 1. _CNV_A_R_LINEAR_____10_CM 0. 1. FORMAT "%2.0" /end CHARACTERISTIC
/begin MEASUREMENT T_DLY_EFP "Timer for delays in EFP" UWORD _CNV_A_R_LINEAR_____27_CM 1 100. 0. 655.35 ECU_ADDRESS 0x3fe54c FORMAT "%6.2" /end MEASUREMENT
/begin MEASUREMENT STATE_EFP "States of electrical fuel pump function" ULONG _CNV_S_6_RANGE_STAT_164_CM 1 100. 0. 5. ECU_ADDRESS 0x3fe548 /end MEASUREMENT
/begin CHARACTERISTIC C_VB_EFP_REF "Reference battery voltage for EFP control" VALUE 0x42b07 _REC_VAL_20_u1 25.8984 _CNV_A_R_LINEAR_____26_CM 0. 25.8984 FORMAT "%3.1" /end CHARACTERISTIC
/begin CHARACTERISTIC C_T_EFP "Time delay to shut off the electrical fuel pump relay after ignition key off" VALUE 0x42fbe _REC_VAL_20_u2 655.35 _CNV_A_R_LINEAR_____27_CM 0. 655.35 FORMAT "%6.2" /end CHARACTERISTIC
/begin CHARACTERISTIC LC_LEVEL_ON_EFP "Switch-on level for the EFP (0 = low active, 1 = high active)" VALUE 0x42baa _REC_VAL_20_u1 1. _CNV_A_R_LINEAR_____10_CM 0. 1. FORMAT "%2.0" /end CHARACTERISTIC
/begin MEASUREMENT EFPPWM "control PWM for electrial fuel pump" UBYTE _CNV_A_R_LINEAR_____165_CM 1 100. 0.392 99.568 ECU_ADDRESS 0x3fcf97 FORMAT "%4.1" /end MEASUREMENT
/begin MEASUREMENT VFF_EFP "Required amount of fuel" UBYTE _CNV_A_R_LINEAR_____166_CM 1 100. 0. 255. ECU_ADDRESS 0x3fcf98 FORMAT "%4.0" /end MEASUREMENT
/begin MEASUREMENT VFF_VEPU_ADD_EFP "additive VFF_EFP for venturi pump in the canister system" UBYTE _CNV_A_R_LINEAR_____166_CM 1 100. 0. 255. ECU_ADDRESS 0x3fe54f FORMAT "%4.0" /end MEASUREMENT
/begin MEASUREMENT VFF_VEPU_FCO_AV "required amount of fuelin dependance of the actual fuel consumption" UBYTE _CNV_A_R_LINEAR_____166_CM 1 100. 0. 255. ECU_ADDRESS 0x3fe550 FORMAT "%4.0" /end MEASUREMENT
/begin CHARACTERISTIC IP_T_EFP_AST_MAX "On-time for electrical fuel pump at the beginning of EFP_ON with EFPPWM = 99,568  %" CURVE 0x4a6e4 _REC_CUR_20_u2_u1 655.35 _CNV_A_R_LINEAR_____27_CM 0. 655.35 FORMAT "%6.2"
 /begin AXIS_DESCR COM_AXIS TCO _CNV_A_R_LINEAR_____0_CM 6 -48. 142.5 FORMAT "%5.1" AXIS_PTS_REF ldp_tco_t_efp_ast_max /end AXIS_DESCR
/end CHARACTERISTIC
/begin CHARACTERISTIC IP_VFF_EFP_FL "Fuel mass setpoint" CURVE 0x50d3b _REC_CUR_20_u1_u1 255. _CNV_A_R_LINEAR_____166_CM 0. 255. FORMAT "%4.0"
 /begin AXIS_DESCR COM_AXIS N_32 _CNV_A_R_LINEAR_____5_CM 8 0. 8160. FORMAT "%4.0" AXIS_PTS_REF ldp_n_32_vff_efp /end AXIS_DESCR
/end CHARACTERISTIC
/begin CHARACTERISTIC IP_VFF_VEPU_FTL "Fuel mass setpoint in dependance of the FTL" CURVE 0x50d43 _REC_CUR_20_u1_u1 255. _CNV_A_R_LINEAR_____166_CM 0. 255. FORMAT "%4.0"
 /begin AXIS_DESCR COM_AXIS FTL _CNV_A_R_LINEAR_____85_CM 6 0. 127. FORMAT "%3.0" AXIS_PTS_REF ldp_ftl_vff_vepu_ftl /end AXIS_DESCR
/end CHARACTERISTIC
/begin CHARACTERISTIC IP_VFF_VEPU_FTL_DIF "Fuel mass setpoint in dependance of the FTL difference left and right canister" CURVE 0x50d49 _REC_CUR_20_u1_u1 255. _CNV_A_R_LINEAR_____166_CM 0. 255. FORMAT "%4.0"
 /begin AXIS_DESCR COM_AXIS FTL_DIF _CNV_A_R_LINEAR_____85_CM 6 0. 127. FORMAT "%3.0" AXIS_PTS_REF ldp_ftl_dif_vff_vepu_ftl_dif /end AXIS_DESCR
/end CHARACTERISTIC
/begin MEASUREMENT FTL_DIF "Difference in FTL between left and right canister" UBYTE _CNV_A_R_LINEAR_____85_CM 1 100. 0. 127. ECU_ADDRESS 0x3fe54e FORMAT "%3.0" /end MEASUREMENT
/begin MEASUREMENT FCO_DIF "fuel consumption difference within 10ms" UBYTE _CNV_A_R_LINEAR_____166_CM 1 100. 0. 127. ECU_ADDRESS 0x3fe551 FORMAT "%3.0" /end MEASUREMENT
/begin MEASUREMENT FCO_DIF_MMV "moving mean value of FCO_DIF" UBYTE _CNV_A_R_LINEAR_____166_CM 1 100. 0. 127. ECU_ADDRESS 0x3fe552 FORMAT "%3.0" /end MEASUREMENT
/begin CHARACTERISTIC C_T_EFP_PREV "On-time for elctrical fuel pump after reset with engine stopped" VALUE 0x42fc0 _REC_VAL_20_u2 655.35 _CNV_A_R_LINEAR_____27_CM 0. 655.35 FORMAT "%6.2" /end CHARACTERISTIC
/begin CHARACTERISTIC C_CRLC_FCO_DIF "correlation constant for the FCO_DIF calculation" VALUE 0x42830 _REC_VAL_20_u1 0.99610001 _CNV_A_R_LINEAR_____20_CM 0. 0.99610001 FORMAT "%5.3" /end CHARACTERISTIC
/begin AXIS_PTS ldp_n_32_vff_efp "" 0x436e9 N_32 _REC_AXS_20_u1 8160. _CNV_A_R_LINEAR_____5_CM 8 0. 8160. FORMAT "%4.0" /end AXIS_PTS
/begin AXIS_PTS ldp_tco_t_efp_ast_max "" 0x43992 TCO _REC_AXS_20_u1 190.5 _CNV_A_R_LINEAR_____0_CM 6 -48. 142.5 FORMAT "%5.1" /end AXIS_PTS
/begin AXIS_PTS ldp_ftl_vff_vepu_ftl "" 0x433cd FTL _REC_AXS_20_u1 127. _CNV_A_R_LINEAR_____85_CM 6 0. 127. FORMAT "%3.0" /end AXIS_PTS
/begin AXIS_PTS ldp_ftl_dif_vff_vepu_ftl_dif "" 0x433c6 FTL_DIF _REC_AXS_20_u1 127. _CNV_A_R_LINEAR_____85_CM 6 0. 127. FORMAT "%3.0" /end AXIS_PTS
/begin MEASUREMENT LV_EGR_ACT "Logical value for EGR-control active" UBYTE _CNV_S_2_RANGE______11_CM 1 100. 0. 1. ECU_ADDRESS 0x3fc5be BIT_MASK 0x1 /end MEASUREMENT
/begin MEASUREMENT ER_STND_DIF_0 "Difference of normalized and filtered normalized engine roughness value" SWORD _CNV_A_R_LINEAR_____167_CM 1 100. -325.78 325.77 ECU_ADDRESS 0x3fda8a FORMAT "%8.3" /end MEASUREMENT
/begin MEASUREMENT ER_STND_DIF_1 "Difference of normalized and filtered normalized engine roughness value" SWORD _CNV_A_R_LINEAR_____167_CM 1 100. -325.78 325.77 ECU_ADDRESS 0x3fda8c FORMAT "%8.3" /end MEASUREMENT
/begin MEASUREMENT ER_STND_DIF_2 "Difference of normalized and filtered normalized engine roughness value" SWORD _CNV_A_R_LINEAR_____167_CM 1 100. -325.78 325.77 ECU_ADDRESS 0x3fda8e FORMAT "%8.3" /end MEASUREMENT
/begin MEASUREMENT ER_STND_DIF_3 "Difference of normalized and filtered normalized engine roughness value" SWORD _CNV_A_R_LINEAR_____167_CM 1 100. -325.78 325.77 ECU_ADDRESS 0x3fda90 FORMAT "%8.3" /end MEASUREMENT
/begin MEASUREMENT ER_STND_DIF_4 "Difference of normalized and filtered normalized engine roughness value" SWORD _CNV_A_R_LINEAR_____167_CM 1 100. -325.78 325.77 ECU_ADDRESS 0x3fda92 FORMAT "%8.3" /end MEASUREMENT
/begin MEASUREMENT ER_STND_DIF_5 "Difference of normalized and filtered normalized engine roughness value" SWORD _CNV_A_R_LINEAR_____167_CM 1 100. -325.78 325.77 ECU_ADDRESS 0x3fda94 FORMAT "%8.3" /end MEASUREMENT
/begin MEASUREMENT ER_STND_MMV_0 "Filtered normalized engine roughness value" SWORD _CNV_A_R_LINEAR_____167_CM 1 100. -325.78 325.77 ECU_ADDRESS 0x3fda96 FORMAT "%8.3" /end MEASUREMENT
/begin MEASUREMENT ER_STND_MMV_1 "Filtered normalized engine roughness value" SWORD _CNV_A_R_LINEAR_____167_CM 1 100. -325.78 325.77 ECU_ADDRESS 0x3fda98 FORMAT "%8.3" /end MEASUREMENT
/begin MEASUREMENT ER_STND_MMV_2 "Filtered normalized engine roughness value" SWORD _CNV_A_R_LINEAR_____167_CM 1 100. -325.78 325.77 ECU_ADDRESS 0x3fda9a FORMAT "%8.3" /end MEASUREMENT
/begin MEASUREMENT ER_STND_MMV_3 "Filtered normalized engine roughness value" SWORD _CNV_A_R_LINEAR_____167_CM 1 100. -325.78 325.77 ECU_ADDRESS 0x3fda9c FORMAT "%8.3" /end MEASUREMENT
/begin MEASUREMENT ER_STND_MMV_4 "Filtered normalized engine roughness value" SWORD _CNV_A_R_LINEAR_____167_CM 1 100. -325.78 325.77 ECU_ADDRESS 0x3fda9e FORMAT "%8.3" /end MEASUREMENT
/begin MEASUREMENT ER_STND_MMV_5 "Filtered normalized engine roughness value" SWORD _CNV_A_R_LINEAR_____167_CM 1 100. -325.78 325.77 ECU_ADDRESS 0x3fdaa0 FORMAT "%8.3" /end MEASUREMENT
/begin MEASUREMENT ER_STD_0 "Standard deviation of engine roughness" SWORD _CNV_A_R_LINEAR_____167_CM 1 100. -325.78 325.77 ECU_ADDRESS 0x3fdaa2 FORMAT "%8.3" /end MEASUREMENT
/begin MEASUREMENT ER_STD_1 "Standard deviation of engine roughness" SWORD _CNV_A_R_LINEAR_____167_CM 1 100. -325.78 325.77 ECU_ADDRESS 0x3fdaa4 FORMAT "%8.3" /end MEASUREMENT
/begin MEASUREMENT ER_STD_2 "Standard deviation of engine roughness" SWORD _CNV_A_R_LINEAR_____167_CM 1 100. -325.78 325.77 ECU_ADDRESS 0x3fdaa6 FORMAT "%8.3" /end MEASUREMENT
/begin MEASUREMENT ER_STD_3 "Standard deviation of engine roughness" SWORD _CNV_A_R_LINEAR_____167_CM 1 100. -325.78 325.77 ECU_ADDRESS 0x3fdaa8 FORMAT "%8.3" /end MEASUREMENT
/begin MEASUREMENT ER_STD_4 "Standard deviation of engine roughness" SWORD _CNV_A_R_LINEAR_____167_CM 1 100. -325.78 325.77 ECU_ADDRESS 0x3fdaaa FORMAT "%8.3" /end MEASUREMENT
/begin MEASUREMENT ER_STD_5 "Standard deviation of engine roughness" SWORD _CNV_A_R_LINEAR_____167_CM 1 100. -325.78 325.77 ECU_ADDRESS 0x3fdaac FORMAT "%8.3" /end MEASUREMENT
/begin MEASUREMENT EGR_RATIO_SP "EGR-Ratio Setpoint" UWORD _CNV_A_R_LINEAR_____94_CM 1 100. 0. 99.99847412 ECU_ADDRESS 0x3fc5b4 /end MEASUREMENT
/begin MEASUREMENT ER_STD_MAX "Maximum standard deviation of engine roughness of all cylinders " SWORD _CNV_A_R_LINEAR_____167_CM 1 100. -325.78 325.77 ECU_ADDRESS 0x3fdaae FORMAT "%8.3" /end MEASUREMENT
/begin MEASUREMENT ER_DIF_MAX "Maximum difference of standard deviation of engine roughness and threshold value of all cylinders" SWORD _CNV_A_R_LINEAR_____167_CM 1 100. -325.78 325.77 ECU_ADDRESS 0x3fdab0 FORMAT "%8.3" /end MEASUREMENT
/begin MEASUREMENT ER_EGR "Filtered engine roughness value with EGR" SWORD _CNV_A_R_LINEAR_____167_CM 1 100. -325.78 325.77 ECU_ADDRESS 0x3fdab2 FORMAT "%8.3" /end MEASUREMENT
/begin MEASUREMENT FAC_EGR_RATIO "Increment factor for EGR-ratio Adaptation" UBYTE _CNV_A_R_LINEAR_____168_CM 1 100. 1. 1.996 ECU_ADDRESS 0x3fdac8 FORMAT "%5.3" /end MEASUREMENT
/begin MEASUREMENT EGR_RATIO_AD_MEM "Stored EGR-ratio Adaptation value" SBYTE _CNV_A_R_LINEAR_____4_CM 1 100. -50. 49.609375 ECU_ADDRESS 0x3fc5ba FORMAT "%5.1" /end MEASUREMENT
/begin MEASUREMENT EGR_RATIO_ADD_AD "Additive EGR-ratio Adaptation value" SBYTE _CNV_A_R_LINEAR_____4_CM 1 100. -50. 49.609375 ECU_ADDRESS 0x3fdac9 FORMAT "%5.1" /end MEASUREMENT
/begin MEASUREMENT ER_EGR_CTR "Counter for ER_EGR>0" UBYTE _CNV_A_R_LINEAR_____10_CM 1 100. 0. 255. ECU_ADDRESS 0x3fc5bb FORMAT "%3.0" /end MEASUREMENT
/begin MEASUREMENT T_EGR_RATIO_AD_POS "Time counter with constant FAC_EGR_RATIO" UWORD _CNV_A_R_LINEAR_____169_CM 1 100. 0. 1310.7 ECU_ADDRESS 0x3fdab4 FORMAT "%7.2" /end MEASUREMENT
/begin MEASUREMENT MAF_SP_EGR "EGR-flow setpoint" UWORD _CNV_A_R_LINEAR_____101_CM 1 100. 0. 2047.96875 ECU_ADDRESS 0x3fdab6 FORMAT "%7.2" /end MEASUREMENT
/begin MEASUREMENT PSI_SP_EGR "EGR-flow rate setpoint" UWORD _CNV_A_R_LINEAR_____170_CM 1 100. 0. 8.880330000000001 ECU_ADDRESS 0x3fdab8 FORMAT "%6.4" /end MEASUREMENT
/begin MEASUREMENT AR_RED_SP_EGR "EGR-valve opening area setpoint" UWORD _CNV_A_R_LINEAR_____171_CM 1 100. 0. 58.592855 ECU_ADDRESS 0x3fdaba FORMAT "%7.4" /end MEASUREMENT
/begin MEASUREMENT EGRPWM_PREV "Pre-control duty-cycle of EGR-valve" UWORD _CNV_A_R_LINEAR_____172_CM 1 100. 0. 99.99694824 ECU_ADDRESS 0x3fdabc /end MEASUREMENT
/begin MEASUREMENT STK_DIF_EGR "Difference between nominal and actual value of the EGR valve stroke" UBYTE _CNV_A_R_LINEAR_____9_CM 1 100. -50. 49.6094 ECU_ADDRESS 0x3fc5bd FORMAT "%5.1" /end MEASUREMENT
/begin MEASUREMENT EGRPWM_I "Integral term of PI controller" SWORD _CNV_A_R_LINEAR_____173_CM 1 100. -100. 99.99694824 ECU_ADDRESS 0x3fdabe FORMAT "%8.3" /end MEASUREMENT
/begin MEASUREMENT EGRPWM_P "Proportional term of PI controller" SWORD _CNV_A_R_LINEAR_____173_CM 1 100. -100. 99.99694824 ECU_ADDRESS 0x3fdac0 FORMAT "%8.3" /end MEASUREMENT
/begin MEASUREMENT EGRPWM_TMP "Duty cycle for EGR valve control" SWORD _CNV_A_R_LINEAR_____173_CM 1 100. -100. 99.99694824 ECU_ADDRESS 0x3fc5b6 FORMAT "%8.3" /end MEASUREMENT
/begin MEASUREMENT EGRPWM "Duty cycle for EGR valve control" SWORD _CNV_A_R_LINEAR_____173_CM 1 100. -100. 99.99694824 ECU_ADDRESS 0x3fc5b8 FORMAT "%8.3" /end MEASUREMENT
/begin MEASUREMENT STATE_OVL_EGR "Overload state" UBYTE _CNV_A_R_LINEAR_____10_CM 1 100. 0. 255. ECU_ADDRESS 0x3fdacf FORMAT "%3.0" /end MEASUREMENT
/begin CHARACTERISTIC C_TCO_MIN_EGR "Minimum temperature for EGR-control active" VALUE 0x42a6b _REC_VAL_20_u1 190.5 _CNV_A_R_LINEAR_____0_CM -48. 142.5 FORMAT "%5.1" /end CHARACTERISTIC
/begin CHARACTERISTIC C_T_AST_EGR "time delay for EGR active after start" VALUE 0x42f5a _REC_VAL_20_u2 6553.5 _CNV_A_R_LINEAR_____14_CM 0. 6553.5 FORMAT "%6.1" /end CHARACTERISTIC
/begin CHARACTERISTIC C_ER_STND_CRLC "Correlation constant for ER_STND filter" VALUE 0x42897 _REC_VAL_20_u1 0.9960940000000002 _CNV_A_R_LINEAR_____44_CM 0. 0.996094 FORMAT "%5.3" /end CHARACTERISTIC
/begin CHARACTERISTIC C_ER_DIF_MAX_CRLC "Correlation constant for ER_DIF_MAX filter" VALUE 0x42895 _REC_VAL_20_u1 0.9960940000000002 _CNV_A_R_LINEAR_____44_CM 0. 0.996094 FORMAT "%5.3" /end CHARACTERISTIC
/begin CHARACTERISTIC C_FAC_ER_NEG "Weighting factor for negative ER_STND_DIF values" VALUE 0x428a4 _REC_VAL_20_u1 0.9960940000000002 _CNV_A_R_LINEAR_____44_CM 0. 0.996094 FORMAT "%5.3" /end CHARACTERISTIC
/begin CHARACTERISTIC C_MAF_EGR_AD_POS_BOL "Minimum mass air flow for EGR-Adaptation active (max. flow)" VALUE 0x42e18 _REC_VAL_20_u2 1389. _CNV_A_R_LINEAR_____95_CM 0. 1389. FORMAT "%7.2" /end CHARACTERISTIC
/begin CHARACTERISTIC C_MAF_EGR_AD_POS_TOL "Maximum mass air flow for EGR-Adaptation active (max. flow)" VALUE 0x42e1a _REC_VAL_20_u2 1389. _CNV_A_R_LINEAR_____95_CM 0. 1389. FORMAT "%7.2" /end CHARACTERISTIC
/begin CHARACTERISTIC C_N_EGR_AD_POS_TOL "Maximum engine speed for EGR-Adaptation active (max. flow)" VALUE 0x4293e _REC_VAL_20_u1 8160. _CNV_A_R_LINEAR_____5_CM 0. 8160. FORMAT "%4.0" /end CHARACTERISTIC
/begin CHARACTERISTIC C_MAF_EGR_AD_BOL "Minimum mass air flow for EGR-Adaptation active" VALUE 0x42e16 _REC_VAL_20_u2 1389. _CNV_A_R_LINEAR_____95_CM 0. 1389. FORMAT "%7.2" /end CHARACTERISTIC
/begin CHARACTERISTIC C_MAF_EGR_AD_TOL "Maximum mass air flow for EGR-Adaptation active" VALUE 0x42e1c _REC_VAL_20_u2 1389. _CNV_A_R_LINEAR_____95_CM 0. 1389. FORMAT "%7.2" /end CHARACTERISTIC
/begin CHARACTERISTIC C_N_EGR_AD_POS_BOL "Minimum engine speed for EGR-Adaptation active (max. flow)" VALUE 0x4293d _REC_VAL_20_u1 8160. _CNV_A_R_LINEAR_____5_CM 0. 8160. FORMAT "%4.0" /end CHARACTERISTIC
/begin CHARACTERISTIC C_N_EGR_AD_BOL "Minimum engine speed for EGR-Adaptation active" VALUE 0x4293c _REC_VAL_20_u1 8160. _CNV_A_R_LINEAR_____5_CM 0. 8160. FORMAT "%4.0" /end CHARACTERISTIC
/begin CHARACTERISTIC C_N_EGR_AD_TOL "Maximum engine speed for EGR-Adaptation active" VALUE 0x4293f _REC_VAL_20_u1 8160. _CNV_A_R_LINEAR_____5_CM 0. 8160. FORMAT "%4.0" /end CHARACTERISTIC
/begin CHARACTERISTIC C_T_EGR_RATIO_AD_POS "Time limit for max. EGR-Ratio Adaptation" VALUE 0x42fc6 _REC_VAL_20_u2 1310.7 _CNV_A_R_LINEAR_____169_CM 0. 1310.7 FORMAT "%7.2" /end CHARACTERISTIC
/begin CHARACTERISTIC C_EGR_RATIO_AD_CRLC "Correlation constant for EGR_RATIO_AD_MEM filter" VALUE 0x4288f _REC_VAL_20_u1 0.9960940000000002 _CNV_A_R_LINEAR_____44_CM 0. 0.996094 FORMAT "%5.3" /end CHARACTERISTIC
/begin CHARACTERISTIC C_ER_EGR_CTR_TOL "Maximum ER_EGR_CTR-value" VALUE 0x42896 _REC_VAL_20_u1 255. _CNV_A_R_LINEAR_____10_CM 0. 255. FORMAT "%3.0" /end CHARACTERISTIC
/begin CHARACTERISTIC C_EGR_RATIO_SP_AD_MIN "Minimum EGR-Ratio Setpoint value for EGR-Adaptation active" VALUE 0x42cde _REC_VAL_20_u2 99.99694824000001 _CNV_A_R_LINEAR_____172_CM 0. 99.99694824 /end CHARACTERISTIC
/begin MEASUREMENT STK_SP_EGR_TMP "EGR-valve lift setpoint" UBYTE _CNV_A_R_LINEAR_____4_CM 1 100. 0. 99.609375 ECU_ADDRESS 0x3fdaca FORMAT "%4.1" /end MEASUREMENT
/begin MEASUREMENT STK_SP_EGR "EGR throttle position setpoint after limitation with absolute limits" UBYTE _CNV_A_R_LINEAR_____4_CM 1 100. 0. 99.609375 ECU_ADDRESS 0x3fdacb FORMAT "%4.1" /end MEASUREMENT
/begin CHARACTERISTIC C_PSI_SP_MIN_EGR "Minimum limit for EGR-flow rate" VALUE 0x42f00 _REC_VAL_20_u2 8.880330000000001 _CNV_A_R_LINEAR_____170_CM 0. 8.880330000000001 FORMAT "%6.4" /end CHARACTERISTIC
/begin CHARACTERISTIC C_EGR_THR_TOL "Above this limit, the opening velocity of the throttle position setpoint is limited%" VALUE 0x42892 _REC_VAL_20_u1 99.609375 _CNV_A_R_LINEAR_____4_CM 0. 99.609375 FORMAT "%4.1" /end CHARACTERISTIC
/begin CHARACTERISTIC C_EGR_THR_BOL "Below this limit, the closing velocity of the throttle position setpoint is limited" VALUE 0x42890 _REC_VAL_20_u1 99.609375 _CNV_A_R_LINEAR_____4_CM 0. 99.609375 FORMAT "%4.1" /end CHARACTERISTIC
/begin CHARACTERISTIC C_EGR_THR_LGRD_STOP "Max. permitted gradient of throttle position setpoint near upper and lower stop position" VALUE 0x42891 _REC_VAL_20_u1 99.609375 _CNV_A_R_LINEAR_____4_CM 0. 99.609375 FORMAT "%4.1" /end CHARACTERISTIC
/begin CHARACTERISTIC C_V_AD_SLOP_EGR "Slope value of the EGR-POTI" VALUE 0x4311a _REC_VAL_20_u2 79.998779 _CNV_A_R_LINEAR_____174_CM 0. 79.998779 /end CHARACTERISTIC
/begin CHARACTERISTIC C_EGRPWM_MAX_POS "maximum PWM-value for opening direction" VALUE 0x4324a _REC_VAL_20_s2 199.99694824 _CNV_A_R_LINEAR_____173_CM -100. 99.99694824 FORMAT "%8.3" /end CHARACTERISTIC
/begin CHARACTERISTIC C_EGRPWM_MAX_NEG "maximum PWM-value for closing direction" VALUE 0x43248 _REC_VAL_20_s2 199.99694824 _CNV_A_R_LINEAR_____173_CM -100. 99.99694824 FORMAT "%8.3" /end CHARACTERISTIC
/begin CHARACTERISTIC C_EGRPWM_I_MAX_NEG "maximum PWM-value for I-part (closing direction)" VALUE 0x43244 _REC_VAL_20_s2 199.99694824 _CNV_A_R_LINEAR_____173_CM -100. 99.99694824 FORMAT "%8.3" /end CHARACTERISTIC
/begin CHARACTERISTIC C_EGRPWM_I_MAX_POS "maximum PWM-value for I-part (opening direction)" VALUE 0x43246 _REC_VAL_20_s2 199.99694824 _CNV_A_R_LINEAR_____173_CM -100. 99.99694824 FORMAT "%8.3" /end CHARACTERISTIC
/begin CHARACTERISTIC C_T_EGR_DLY1 "Limitation timer for EGR motor overload" VALUE 0x42fc2 _REC_VAL_20_u2 655.35 _CNV_A_R_LINEAR_____27_CM 0. 655.35 FORMAT "%6.2" /end CHARACTERISTIC
/begin CHARACTERISTIC C_T_EGR_DLY2 "Limitation timer for EGR motor overload" VALUE 0x42fc4 _REC_VAL_20_u2 655.35 _CNV_A_R_LINEAR_____27_CM 0. 655.35 FORMAT "%6.2" /end CHARACTERISTIC
/begin CHARACTERISTIC C_EGRPWM_DFT "Limitation for EGR motor overload" VALUE 0x42ce0 _REC_VAL_20_u2 99.99694824000001 _CNV_A_R_LINEAR_____172_CM 0. 99.99694824 /end CHARACTERISTIC
/begin CHARACTERISTIC C_EGRPWM_OVL_LIM "Threshold for EGR motor overload" VALUE 0x42ce2 _REC_VAL_20_u2 99.99694824000001 _CNV_A_R_LINEAR_____172_CM 0. 99.99694824 /end CHARACTERISTIC
/begin CHARACTERISTIC IP_EGR_RATIO_HOM__MAF__N_32 "Basic map for EGR-Ratio Setpoint LV_S_ACT=0 (homomgenous engine operation)" MAP 0x4dc2d _REC_MAP_20_u1_u2_u1 99.609375 _CNV_A_R_LINEAR_____4_CM 0. 99.609375 FORMAT "%4.1"
 /begin AXIS_DESCR COM_AXIS MAF _CNV_A_R_LINEAR_____95_CM 12 0. 1389. FORMAT "%7.2" AXIS_PTS_REF ldpm_maf__egr_ratio_hom /end AXIS_DESCR
 /begin AXIS_DESCR COM_AXIS N_32 _CNV_A_R_LINEAR_____5_CM 12 0. 8160. FORMAT "%4.0" AXIS_PTS_REF ldpm_n_32__egr_ratio_hom /end AXIS_DESCR
/end CHARACTERISTIC
/begin CHARACTERISTIC IP_EGR_RATIO_S "Basic map for EGR-Ratio Setpoint LV_S_ACT=1 (stratified engine operation)" MAP 0x4dcd3 _REC_MAP_20_u1_u2_u1 99.609375 _CNV_A_R_LINEAR_____4_CM 0. 99.609375 FORMAT "%4.1"
 /begin AXIS_DESCR COM_AXIS MFF_SP_S _CNV_A_R_LINEAR_____95_CM 12 0. 1389. FORMAT "%7.2" AXIS_PTS_REF ldpm_mff_sp_s__egr_ratio_s /end AXIS_DESCR
 /begin AXIS_DESCR COM_AXIS N_32 _CNV_A_R_LINEAR_____5_CM 12 0. 8160. FORMAT "%4.0" AXIS_PTS_REF ldpm_n_32__egr_ratio_s /end AXIS_DESCR
/end CHARACTERISTIC
/begin CHARACTERISTIC IP_EGR_RATIO_MIN__MAF__N_32 "Basic map for minimum EGR-Ratio Setpoint" MAP 0x4dcc3 _REC_MAP_20_u1_u2_u1 99.609375 _CNV_A_R_LINEAR_____4_CM 0. 99.609375 FORMAT "%4.1"
 /begin AXIS_DESCR COM_AXIS MAF _CNV_A_R_LINEAR_____95_CM 4 0. 1389. FORMAT "%7.2" AXIS_PTS_REF ldp_maf_ip_egr_ratio_min /end AXIS_DESCR
 /begin AXIS_DESCR COM_AXIS N_32 _CNV_A_R_LINEAR_____5_CM 4 0. 8160. FORMAT "%4.0" AXIS_PTS_REF ldp_n_32_ip_egr_ratio_min /end AXIS_DESCR
/end CHARACTERISTIC
/begin CHARACTERISTIC IP_FAC_TCO_EGR__TCO "TCO-correction factor for EGR-Ratio Setpoint" CURVE 0x4e525 _REC_CUR_20_u1_u1 1.99220002 _CNV_A_R_LINEAR_____34_CM 0. 1.99220002 FORMAT "%5.3"
 /begin AXIS_DESCR COM_AXIS TCO _CNV_A_R_LINEAR_____0_CM 6 -48. 142.5 FORMAT "%5.1" AXIS_PTS_REF ldp_tco__fac_tco_egr /end AXIS_DESCR
/end CHARACTERISTIC
/begin CHARACTERISTIC IP_ER_STD_THD__MAF__N_32 "Map of  engine roughness standard deviation  threshold" MAP 0x47398 _REC_MAP_20_u2_u2_u1 651.55 _CNV_A_R_LINEAR_____175_CM -325.78 325.77 FORMAT "%8.3"
 /begin AXIS_DESCR COM_AXIS MAF _CNV_A_R_LINEAR_____95_CM 2 0. 1389. FORMAT "%7.2" AXIS_PTS_REF ldp_maf_ip_er_std_thd /end AXIS_DESCR
 /begin AXIS_DESCR COM_AXIS N_32 _CNV_A_R_LINEAR_____5_CM 2 0. 8160. FORMAT "%4.0" AXIS_PTS_REF ldp_n_32_ip_er_std_thd /end AXIS_DESCR
/end CHARACTERISTIC
/begin CHARACTERISTIC IP_EGR_RATIO_INC__MAF_CYL "Increment  value to increase FAC_EGR_RATIO" CURVE 0x4dcbd _REC_CUR_20_u1_u2 0.996 _CNV_A_R_LINEAR_____168_CM 1. 1.996 FORMAT "%5.3"
 /begin AXIS_DESCR COM_AXIS MAF_CYL _CNV_A_R_LINEAR_____101_CM 6 0. 2047.96875 FORMAT "%7.2" AXIS_PTS_REF ldp_maf_cyl__egr_ratio_inc /end AXIS_DESCR
/end CHARACTERISTIC
/begin CHARACTERISTIC IP_EGR_ADD_NEG__ER_EGR "Additive value to decrease EGR-Ratio Setpoint" CURVE 0x4dc27 _REC_CUR_20_u1_u2 99.609375 _CNV_A_R_LINEAR_____4_CM 0. 99.609375 FORMAT "%4.1"
 /begin AXIS_DESCR COM_AXIS ER_EGR _CNV_A_R_LINEAR_____175_CM 6 -325.78 325.77 FORMAT "%8.3" AXIS_PTS_REF ldpm_er_egr /end AXIS_DESCR
/end CHARACTERISTIC
/begin CHARACTERISTIC IP_ER_EGR_CTR_INC__ER_EGR "Value to increase ER_EGR_CTR" CURVE 0x4dd63 _REC_CUR_20_u1_u2 255. _CNV_A_R_LINEAR_____10_CM 0. 255. FORMAT "%3.0"
 /begin AXIS_DESCR COM_AXIS ER_EGR _CNV_A_R_LINEAR_____175_CM 6 -325.78 325.77 FORMAT "%8.3" AXIS_PTS_REF ldpm_er_egr /end AXIS_DESCR
/end CHARACTERISTIC
/begin CHARACTERISTIC IP_STK_SP_EGR__AR_RED_SP_EGR "EGR-valve lift setpoint table (inverse table of IP_AR_RED_EGR)" CURVE 0x4fe28 _REC_CUR_20_u1_u2 99.609375 _CNV_A_R_LINEAR_____4_CM 0. 99.609375 FORMAT "%4.1"
 /begin AXIS_DESCR COM_AXIS AR_RED_SP_EGR _CNV_A_R_LINEAR_____171_CM 12 0. 58.592855 FORMAT "%7.4" AXIS_PTS_REF ldp_ar_red_sp_egr_stk_sp_egr /end AXIS_DESCR
/end CHARACTERISTIC
/begin CHARACTERISTIC IP_EGRPWM_PREV__STK_SP_EGR "Pre-control duty cycle of the EGR valve" CURVE 0x47150 _REC_CUR_20_u2_u1 99.99847412 _CNV_A_R_LINEAR_____94_CM 0. 99.99847412
 /begin AXIS_DESCR COM_AXIS STK_SP_EGR _CNV_A_R_LINEAR_____4_CM 12 0. 99.609375 FORMAT "%4.1" AXIS_PTS_REF ldp_stk_sp_egr__egrpwm_prev /end AXIS_DESCR
/end CHARACTERISTIC
/begin CHARACTERISTIC IP_EGRPWM_P__STK_DIF_EGR "Index table for P - term of EGR valve lift position-control" CURVE 0x4713e _REC_CUR_20_u2_u1 199.99694824 _CNV_A_R_LINEAR_____176_CM -100. 99.99694824 FORMAT "%8.3"
 /begin AXIS_DESCR COM_AXIS STK_DIF_EGR _CNV_A_R_LINEAR_____117_CM 9 -50. 49.609375 FORMAT "%6.2" AXIS_PTS_REF ldpm_stk_dif_egr /end AXIS_DESCR
/end CHARACTERISTIC
/begin CHARACTERISTIC IP_EGRPWM_I__STK_DIF_EGR "Index table for I - term of EGR valve lift position-control" CURVE 0x4712c _REC_CUR_20_u2_u1 199.99694824 _CNV_A_R_LINEAR_____176_CM -100. 99.99694824 FORMAT "%8.3"
 /begin AXIS_DESCR COM_AXIS STK_DIF_EGR _CNV_A_R_LINEAR_____117_CM 9 -50. 49.609375 FORMAT "%6.2" AXIS_PTS_REF ldpm_stk_dif_egr /end AXIS_DESCR
/end CHARACTERISTIC
/begin CHARACTERISTIC C_FAC_ER_POS "Weighting factor for positive ER_STND_DIF values" VALUE 0x428a5 _REC_VAL_20_u1 0.9960940000000002 _CNV_A_R_LINEAR_____44_CM 0. 0.996094 FORMAT "%5.3" /end CHARACTERISTIC
/begin CHARACTERISTIC IP_EGR_RATIO_LGRD__MAF_CYL "Limited gradient for increasing EGR_RATIO_SP" CURVE 0x47120 _REC_CUR_20_u2_u2 99.99694824000001 _CNV_A_R_LINEAR_____172_CM 0. 99.99694824
 /begin AXIS_DESCR COM_AXIS MAF_CYL _CNV_A_R_LINEAR_____101_CM 6 0. 2047.96875 FORMAT "%7.2" AXIS_PTS_REF ldp_maf_cyl__egr_ratio_inc /end AXIS_DESCR
/end CHARACTERISTIC
/begin AXIS_PTS ldpm_n_32__egr_ratio_s "" 0x43d96 N_32 _REC_AXS_20_u1 8160. _CNV_A_R_LINEAR_____5_CM 12 0. 8160. FORMAT "%4.0" /end AXIS_PTS
/begin AXIS_PTS ldpm_mff_sp_s__egr_ratio_s "" 0x45196 MFF_SP_S _REC_AXS_20_u2 1389. _CNV_A_R_LINEAR_____95_CM 12 0. 1389. FORMAT "%7.2" /end AXIS_PTS
/begin AXIS_PTS ldpm_maf__egr_ratio_hom "" 0x4507e MAF _REC_AXS_20_u2 1389. _CNV_A_R_LINEAR_____95_CM 12 0. 1389. FORMAT "%7.2" /end AXIS_PTS
/begin AXIS_PTS ldp_maf_ip_egr_ratio_min "" 0x4459e MAF _REC_AXS_20_u2 1389. _CNV_A_R_LINEAR_____95_CM 4 0. 1389. FORMAT "%7.2" /end AXIS_PTS
/begin AXIS_PTS ldpm_n_32__egr_ratio_hom "" 0x43d89 N_32 _REC_AXS_20_u1 8160. _CNV_A_R_LINEAR_____5_CM 12 0. 8160. FORMAT "%4.0" /end AXIS_PTS
/begin AXIS_PTS ldp_maf_ip_er_std_thd "" 0x445a8 MAF _REC_AXS_20_u2 1389. _CNV_A_R_LINEAR_____95_CM 2 0. 1389. FORMAT "%7.2" /end AXIS_PTS
/begin AXIS_PTS ldp_n_32_ip_egr_ratio_min "" 0x43664 N_32 _REC_AXS_20_u1 8160. _CNV_A_R_LINEAR_____5_CM 4 0. 8160. FORMAT "%4.0" /end AXIS_PTS
/begin AXIS_PTS ldp_n_32_ip_er_std_thd "" 0x43669 N_32 _REC_AXS_20_u1 8160. _CNV_A_R_LINEAR_____5_CM 2 0. 8160. FORMAT "%4.0" /end AXIS_PTS
/begin AXIS_PTS ldp_ar_red_sp_egr_stk_sp_egr "" 0x441b8 AR_RED_SP_EGR _REC_AXS_20_u2 58.592855 _CNV_A_R_LINEAR_____171_CM 12 0. 58.592855 FORMAT "%7.4" /end AXIS_PTS
/begin AXIS_PTS ldpm_stk_dif_egr "" 0x43f15 STK_DIF_EGR _REC_AXS_20_u1 99.609375 _CNV_A_R_LINEAR_____117_CM 9 -50. 49.609375 FORMAT "%6.2" /end AXIS_PTS
/begin AXIS_PTS ldp_stk_sp_egr__egrpwm_prev "" 0x437fd STK_SP_EGR _REC_AXS_20_u1 99.609375 _CNV_A_R_LINEAR_____4_CM 12 0. 99.609375 FORMAT "%4.1" /end AXIS_PTS
/begin AXIS_PTS ldpm_er_egr "" 0x44f28 ER_EGR _REC_AXS_20_u2 651.55 _CNV_A_R_LINEAR_____175_CM 6 -325.78 325.77 FORMAT "%8.3" /end AXIS_PTS
/begin AXIS_PTS ldp_tco__fac_tco_egr "" 0x43856 TCO _REC_AXS_20_u1 190.5 _CNV_A_R_LINEAR_____0_CM 6 -48. 142.5 FORMAT "%5.1" /end AXIS_PTS
/begin AXIS_PTS ldp_maf_cyl__egr_ratio_inc "" 0x44512 MAF_CYL _REC_AXS_20_u2 2047.96875 _CNV_A_R_LINEAR_____101_CM 6 0. 2047.96875 FORMAT "%7.2" /end AXIS_PTS
/begin MEASUREMENT V_AD_BOL_EGR "lower Adaptation value EGR-POTI" UWORD _CNV_A_R_LINEAR_____33_CM 1 100. 0. 4.99511719 ECU_ADDRESS 0x3fc5c0 FORMAT "%5.3" /end MEASUREMENT
/begin MEASUREMENT AD_BOL_EGR "measured lower value for EGR-POTI Adaptation" UWORD _CNV_A_R_LINEAR_____33_CM 1 100. 0. 4.99511719 ECU_ADDRESS 0x3fdad8 FORMAT "%5.3" /end MEASUREMENT
/begin CHARACTERISTIC C_V_AD_DYW_EGR "Relative threshold for EGR POTI Adaptation" VALUE 0x42ae1 _REC_VAL_20_u1 1.24511719 _CNV_A_R_LINEAR_____177_CM 0. 1.24511719 FORMAT "%5.3" /end CHARACTERISTIC
/begin CHARACTERISTIC C_DLY_AD_BOL_EGR "Delay time corresponding to the response time of EGR-Valve  (for appl. values see chapter 1)" VALUE 0x4287e _REC_VAL_20_u1 25.5 _CNV_A_R_LINEAR_____14_CM 0. 25.5 FORMAT "%4.1" /end CHARACTERISTIC
/begin CHARACTERISTIC C_V_AD_MIN_BOL_EGR "Minimum permissible voltage for EGR-poti in lower limit stop (for appl. values see chapter 1)" VALUE 0x43118 _REC_VAL_20_u2 4.99511719 _CNV_A_R_LINEAR_____33_CM 0. 4.99511719 FORMAT "%5.3" /end CHARACTERISTIC
/begin CHARACTERISTIC C_V_AD_MAX_BOL_EGR "Maximum permissible voltage for EGR-poti in lower limit stop (for appl. values see chapter 1)" VALUE 0x43116 _REC_VAL_20_u2 4.99511719 _CNV_A_R_LINEAR_____33_CM 0. 4.99511719 FORMAT "%5.3" /end CHARACTERISTIC
/begin CHARACTERISTIC C_V_AD_INI_BOL_EGR "Init-value for EGR-poti in lower limit stop  (for appl. values see chapter 1)" VALUE 0x43114 _REC_VAL_20_u2 4.99511719 _CNV_A_R_LINEAR_____33_CM 0. 4.99511719 FORMAT "%5.3" /end CHARACTERISTIC
/begin MEASUREMENT FRQ_REQ_FPA "Frequency for the FPAPWM signal" UWORD _CNV_A_R_LINEAR_____115_CM 1 100. 256. 1023. ECU_ADDRESS 0x3fc5f2 FORMAT "%4.0" /end MEASUREMENT
/begin MEASUREMENT FPAPWM "Global fuel pressure regulation" UWORD _CNV_A_R_LINEAR_____189_CM 1 100. 0. 99.99825 ECU_ADDRESS 0x3fc5f4 FORMAT "%6.2" /end MEASUREMENT
/begin MEASUREMENT FPAPWM_BAS "Basic fuel pressure regulation term" UWORD _CNV_A_R_LINEAR_____189_CM 1 100. 0. 99.99825 ECU_ADDRESS 0x3fdae6 FORMAT "%6.2" /end MEASUREMENT
/begin MEASUREMENT FPAPWM_P "Proportional fuel pressure regulation term" SWORD _CNV_A_R_LINEAR_____98_CM 1 100. -50. 49.99847412 ECU_ADDRESS 0x3fdae8 FORMAT "%7.3" /end MEASUREMENT
/begin MEASUREMENT FPAPWM_I_AD "Adaptive term on integral fuel pressure regulation" SWORD _CNV_A_R_LINEAR_____98_CM 1 100. -50. 49.99847412 ECU_ADDRESS 0x3fc5f0 FORMAT "%7.3" /end MEASUREMENT
/begin MEASUREMENT FPAPWM_I "Integral fuel pressure regulation term" SWORD _CNV_A_R_LINEAR_____98_CM 1 100. -50. 49.99847412 ECU_ADDRESS 0x3fc5f6 FORMAT "%7.3" /end MEASUREMENT
/begin MEASUREMENT FPAPWM_LIM "Required FPAPWM to reach FUP_SP in case of current limitation" SWORD _CNV_A_R_LINEAR_____98_CM 1 100. -50. 49.99847412 ECU_ADDRESS 0x3fc5f8 FORMAT "%7.3" /end MEASUREMENT
/begin MEASUREMENT FUP_SP_DLY "Fuel pressure setpoint with the delay time of the fuel system" UWORD _CNV_A_R_LINEAR_____190_CM 1 100. 0. 173888. ECU_ADDRESS 0x3fdaee FORMAT "%6.0" /end MEASUREMENT
/begin MEASUREMENT FUP_SP_FIL "Fuel pressure setpoint with delay time and filtering" UWORD _CNV_A_R_LINEAR_____190_CM 1 100. 0. 173888. ECU_ADDRESS 0x3fc5fc FORMAT "%6.0" /end MEASUREMENT
/begin MEASUREMENT FUP_SP_LGRD "Fuel pressure setpoint gradient limitation" UWORD _CNV_A_R_LINEAR_____190_CM 1 100. 0. 173888. ECU_ADDRESS 0x3fdaf0 FORMAT "%6.0" /end MEASUREMENT
/begin MEASUREMENT FUP_SP "Fuel pressure setpoint" UWORD _CNV_A_R_LINEAR_____190_CM 1 100. 0. 173888. ECU_ADDRESS 0x3fc5fa FORMAT "%6.0" /end MEASUREMENT
/begin MEASUREMENT FUP_SP_PCTL "Fuel pressure setpoint value for the feed forward controller" UWORD _CNV_A_R_LINEAR_____190_CM 1 100. 0. 173888. ECU_ADDRESS 0x3fdaf2 FORMAT "%6.0" /end MEASUREMENT
/begin MEASUREMENT FUP_DIF_DLY "Fuel pressure regulation error after delay time and and filtering of FUP_SP" SWORD _CNV_A_R_LINEAR_____191_CM 1 100. -86945.33 86942.67 ECU_ADDRESS 0x3fdaf6 FORMAT "%9.2" /end MEASUREMENT
/begin MEASUREMENT FPA_MFF_MEM "Memorized term for fuel pressure actuator fuel flow" UWORD _CNV_A_R_LINEAR_____192_CM 1 100. 0. 377.81 ECU_ADDRESS 0x3fdaea FORMAT "%7.2" /end MEASUREMENT
/begin MEASUREMENT FPA_MFF "Fuel pressure actuator fuel flow" UWORD _CNV_A_R_LINEAR_____192_CM 1 100. 0. 377.81 ECU_ADDRESS 0x3fc5fe FORMAT "%7.2" /end MEASUREMENT
/begin MEASUREMENT FPAPWM_MEM "Memorized term for high pressure regulator duty cycle" UWORD _CNV_A_R_LINEAR_____189_CM 1 100. 0. 99.99825 ECU_ADDRESS 0x3fdaec FORMAT "%6.2" /end MEASUREMENT
/begin MEASUREMENT LV_FPAPWM_AD_AUTH "Adaptation authorization" UBYTE _CNV_A_R_LINEAR_____12_CM 1 100. 0. 1. ECU_ADDRESS 0x3fdb07 FORMAT "%1.0" BIT_MASK 0x1 /end MEASUREMENT
/begin MEASUREMENT LV_FPAPWM_LIM "Limitation of current in regulator solenoid" UBYTE _CNV_A_R_LINEAR_____12_CM 1 100. 0. 1. ECU_ADDRESS 0x3fc601 FORMAT "%1.0" BIT_MASK 0x1 /end MEASUREMENT
/begin MEASUREMENT T_DLY_FPAPWM_AD "Delay under steady state conditions before adaptation occurs" UBYTE _CNV_A_R_LINEAR_____14_CM 1 100. 0. 25.5 ECU_ADDRESS 0x3fdb03 FORMAT "%4.1" /end MEASUREMENT
/begin CHARACTERISTIC IP_FUP_SP_HOM "Fuel pressure setpoint for homogenous engine operation" MAP 0x48086 _REC_MAP_20_u2_u2_u1 173888. _CNV_A_R_LINEAR_____190_CM 0. 173888. FORMAT "%6.0"
 /begin AXIS_DESCR COM_AXIS MFF_SP _CNV_A_R_LINEAR_____95_CM 10 0. 1389. FORMAT "%7.2" AXIS_PTS_REF ldp_mff_sp_ip_fup_sp_hom /end AXIS_DESCR
 /begin AXIS_DESCR COM_AXIS N_32 _CNV_A_R_LINEAR_____5_CM 8 0. 8160. FORMAT "%4.0" AXIS_PTS_REF ldp_n_32_ip_fup_sp_hom /end AXIS_DESCR
/end CHARACTERISTIC
/begin CHARACTERISTIC IP_FAC_FUP_SP_PCTL "Factor for the fuel pressure setpoint change influence to the feed forward controller" CURVE 0x4751c _REC_CUR_20_u2_u2 1. _CNV_A_R_LINEAR_____193_CM 0. 1. FORMAT "%6.4"
 /begin AXIS_DESCR COM_AXIS ONLINE_DUMMY _CNV_A_R_LINEAR_____194_CM 8 -86945.33 86942.67 FORMAT "%9.2" AXIS_PTS_REF ldp_fup_sp_dif_ip_fac_fup_sp /end AXIS_DESCR
/end CHARACTERISTIC
/begin CHARACTERISTIC IP_FUP_SP_S "Fuel pressure setpoint for stratified engine operation" MAP 0x48126 _REC_MAP_20_u2_u2_u1 173888. _CNV_A_R_LINEAR_____190_CM 0. 173888. FORMAT "%6.0"
 /begin AXIS_DESCR COM_AXIS ONLINE_DUMMY _CNV_A_R_LINEAR_____95_CM 8 0. 1389. FORMAT "%7.2" AXIS_PTS_REF ldpm_mff_sp_s_2_s /end AXIS_DESCR
 /begin AXIS_DESCR COM_AXIS N_32 _CNV_A_R_LINEAR_____5_CM 8 0. 8160. FORMAT "%4.0" AXIS_PTS_REF ldpm_n_32_2_s /end AXIS_DESCR
/end CHARACTERISTIC
/begin CHARACTERISTIC IP_FUP_SP_ST "Fuel pressure setpoint for stratified engine operation" CURVE 0x481a6 _REC_CUR_20_u2_u1 173888. _CNV_A_R_LINEAR_____190_CM 0. 173888. FORMAT "%6.0"
 /begin AXIS_DESCR COM_AXIS TCO _CNV_A_R_LINEAR_____0_CM 8 -48. 142.5 FORMAT "%5.1" AXIS_PTS_REF ldp_tco_ip_fup_sp_st /end AXIS_DESCR
/end CHARACTERISTIC
/begin CHARACTERISTIC IP_FPAPWM_BAS "Duty cycle basic value" CURVE 0x48036 _REC_CUR_20_u2_u2 99.99825000000001 _CNV_A_R_LINEAR_____189_CM 0. 99.99825 FORMAT "%6.2"
 /begin AXIS_DESCR COM_AXIS FUP_SP_PCTL _CNV_A_R_LINEAR_____190_CM 8 0. 173888. FORMAT "%6.0" AXIS_PTS_REF ldp_fup_sp_pctl_ip_fpapwm_bas /end AXIS_DESCR
/end CHARACTERISTIC
/begin CHARACTERISTIC IP_FPAPWM "Battery voltage correction" CURVE 0x4e7d5 _REC_CUR_20_u1_u1 1.9921875 _CNV_A_R_LINEAR_____103_CM 0. 1.9921875 FORMAT "%5.3"
 /begin AXIS_DESCR COM_AXIS VB _CNV_A_R_LINEAR_____53_CM 8 0. 26. FORMAT "%4.1" AXIS_PTS_REF ldp_vb_ip_fpapwm /end AXIS_DESCR
/end CHARACTERISTIC
/begin CHARACTERISTIC IP_FAC_FPAPWM_BAS "FPAPWM_BAS correction versus N_32 and MFF_SP" MAP 0x4df72 _REC_MAP_20_u1_u1_u2 1.9921875 _CNV_A_R_LINEAR_____103_CM 0. 1.9921875 FORMAT "%5.3"
 /begin AXIS_DESCR COM_AXIS N_32 _CNV_A_R_LINEAR_____5_CM 8 0. 8160. FORMAT "%4.0" AXIS_PTS_REF ldp_n_32_ip_fac_fpapwm_bas /end AXIS_DESCR
 /begin AXIS_DESCR COM_AXIS MFF_SP _CNV_A_R_LINEAR_____95_CM 8 0. 1389. FORMAT "%7.2" AXIS_PTS_REF ldp_mff_sp_ip_fac_fpapwm_bas /end AXIS_DESCR
/end CHARACTERISTIC
/begin CHARACTERISTIC IP_FAC_FPAPWM_P "Proportional parameter correction" CURVE 0x4dfba _REC_CUR_20_u1_u2 3.984375 _CNV_A_R_LINEAR_____195_CM 0. 3.984375 FORMAT "%4.2"
 /begin AXIS_DESCR COM_AXIS FPA_MFF _CNV_A_R_LINEAR_____192_CM 8 0. 377.81 FORMAT "%7.2" AXIS_PTS_REF ldpm_fpa_mff_fusl /end AXIS_DESCR
/end CHARACTERISTIC
/begin CHARACTERISTIC IP_FAC_FPAPWM "Actuator temperature correction" CURVE 0x4df6c _REC_CUR_20_u1_u1 3.984375 _CNV_A_R_LINEAR_____195_CM 0. 3.984375 FORMAT "%4.2"
 /begin AXIS_DESCR COM_AXIS TFPA _CNV_A_R_LINEAR_____0_CM 6 -48. 142.5 FORMAT "%5.1" AXIS_PTS_REF ldp_tfpa_ip_fac_fpapwm /end AXIS_DESCR
/end CHARACTERISTIC
/begin CHARACTERISTIC IP_FAC_FPAPWM_I "Integral parameter correction" CURVE 0x4dfb2 _REC_CUR_20_u1_u2 3.984375 _CNV_A_R_LINEAR_____195_CM 0. 3.984375 FORMAT "%4.2"
 /begin AXIS_DESCR COM_AXIS FPA_MFF _CNV_A_R_LINEAR_____192_CM 8 0. 377.81 FORMAT "%7.2" AXIS_PTS_REF ldpm_fpa_mff_fusl /end AXIS_DESCR
/end CHARACTERISTIC
/begin CHARACTERISTIC IP_FPAPWM_I "Integral parameter" CURVE 0x48046 _REC_CUR_20_u2_u2 99.99847412 _CNV_A_R_LINEAR_____143_CM -50. 49.99847412 FORMAT "%7.3"
 /begin AXIS_DESCR COM_AXIS FUP_DIF_DLY _CNV_A_R_LINEAR_____194_CM 8 -86945.33 86942.67 FORMAT "%9.2" AXIS_PTS_REF ldpm_fup_dif_dly_fusl /end AXIS_DESCR
/end CHARACTERISTIC
/begin CHARACTERISTIC IP_FPAPWM_P "Proportional parameter" CURVE 0x48066 _REC_CUR_20_u2_u2 99.99847412 _CNV_A_R_LINEAR_____143_CM -50. 49.99847412 FORMAT "%7.3"
 /begin AXIS_DESCR COM_AXIS FUP_DIF_DLY _CNV_A_R_LINEAR_____194_CM 8 -86945.33 86942.67 FORMAT "%9.2" AXIS_PTS_REF ldpm_fup_dif_dly_fusl /end AXIS_DESCR
/end CHARACTERISTIC
/begin CHARACTERISTIC IP_FPAPWM_MAX "Battery voltage correction" CURVE 0x48056 _REC_CUR_20_u2_u1 99.99825000000001 _CNV_A_R_LINEAR_____189_CM 0. 99.99825 FORMAT "%6.2"
 /begin AXIS_DESCR COM_AXIS VB _CNV_A_R_LINEAR_____53_CM 8 0. 26. FORMAT "%4.1" AXIS_PTS_REF ldp_vb_ip_fpapwm_max /end AXIS_DESCR
/end CHARACTERISTIC
/begin CHARACTERISTIC C_FPAPWM_MIN "Duty cycle minimum value during initialization and state 3" VALUE 0x42d78 _REC_VAL_20_u2 99.99825000000001 _CNV_A_R_LINEAR_____189_CM 0. 99.99825 FORMAT "%6.2" /end CHARACTERISTIC
/begin CHARACTERISTIC C_FPAPWM_MIN_2 "Duty cycle minimum value during state 2" VALUE 0x42d7a _REC_VAL_20_u2 99.99825000000001 _CNV_A_R_LINEAR_____189_CM 0. 99.99825 FORMAT "%6.2" /end CHARACTERISTIC
/begin CHARACTERISTIC C_FAC_FUP_FPAPWM "Factor for conversion Delta FUP versus Delta FPAPWM" VALUE 0x428aa _REC_VAL_20_u1 5.75e-004 _CNV_A_R_LINEAR_____196_CM 0. 5.75e-004 FORMAT "%7.6" /end CHARACTERISTIC
/begin CHARACTERISTIC C_FPA_MFF_MIN_AD "Minimum fuel flow through the solenoid to enable the adaptation" VALUE 0x42d6e _REC_VAL_20_u2 377.81 _CNV_A_R_LINEAR_____192_CM 0. 377.81 FORMAT "%7.2" /end CHARACTERISTIC
/begin CHARACTERISTIC C_FPAPWM_I_MIN "Adaptive integral term minimum during state 2" VALUE 0x43264 _REC_VAL_20_s2 99.99847412 _CNV_A_R_LINEAR_____98_CM -50. 49.99847412 FORMAT "%7.3" /end CHARACTERISTIC
/begin CHARACTERISTIC C_FPAPWM_I_MAX "Adaptive integral term maximum during state 2" VALUE 0x43262 _REC_VAL_20_s2 99.99847412 _CNV_A_R_LINEAR_____98_CM -50. 49.99847412 FORMAT "%7.3" /end CHARACTERISTIC
/begin CHARACTERISTIC C_FPAPWM_I_AD_MIN "Adaptive integral term minimum during state 2" VALUE 0x43260 _REC_VAL_20_s2 99.99847412 _CNV_A_R_LINEAR_____98_CM -50. 49.99847412 FORMAT "%7.3" /end CHARACTERISTIC
/begin CHARACTERISTIC C_FPAPWM_I_AD_MAX "Adaptive integral term maximum during state 2" VALUE 0x4325e _REC_VAL_20_s2 99.99847412 _CNV_A_R_LINEAR_____98_CM -50. 49.99847412 FORMAT "%7.3" /end CHARACTERISTIC
/begin CHARACTERISTIC C_FPA_MFF_DIF_AD "Threshold on fuel flow variation for adaptive function" VALUE 0x42d68 _REC_VAL_20_u2 377.81 _CNV_A_R_LINEAR_____192_CM 0. 377.81 FORMAT "%7.2" /end CHARACTERISTIC
/begin CHARACTERISTIC C_FUP_DIF_AD "Maximum fuel pressure variation to allow adaptive correction" VALUE 0x42d88 _REC_VAL_20_u2 173888. _CNV_A_R_LINEAR_____190_CM 0. 173888. FORMAT "%6.0" /end CHARACTERISTIC
/begin CHARACTERISTIC C_FUP_SP_AST_LGRD "Increase (or decrease) of fuel pressure set point between starting phase and out of starting phase" VALUE 0x42d92 _REC_VAL_20_u2 173888. _CNV_A_R_LINEAR_____190_CM 0. 173888. FORMAT "%6.0" /end CHARACTERISTIC
/begin CHARACTERISTIC C_FUP_SP_PCTL_CRLC "Fuel pressure setpoint filter factor fotr the feed forward controller" VALUE 0x428cd _REC_VAL_20_u1 0.9960940000000002 _CNV_A_R_LINEAR_____44_CM 0. 0.996094 FORMAT "%5.3" /end CHARACTERISTIC
/begin CHARACTERISTIC C_FUP_SP_CRLC "Fuel pressure setpoint filter factor" VALUE 0x428cc _REC_VAL_20_u1 0.9960940000000002 _CNV_A_R_LINEAR_____44_CM 0. 0.996094 FORMAT "%5.3" /end CHARACTERISTIC
/begin CHARACTERISTIC C_FUP_SP_MAX "Maximum fuel pressure setpoint" VALUE 0x42d96 _REC_VAL_20_u2 173888. _CNV_A_R_LINEAR_____190_CM 0. 173888. FORMAT "%6.0" /end CHARACTERISTIC
/begin CHARACTERISTIC C_N_FUP_AD_MIN "Minimum engine speed for learning of adaptative value" VALUE 0x42944 _REC_VAL_20_u1 979.2000000000001 _CNV_A_R_LINEAR_____5_CM 0. 8160. FORMAT "%4.0" /end CHARACTERISTIC
/begin CHARACTERISTIC C_N_FUP_AD_MAX "Maximum engine speed for learning of adaptative value" VALUE 0x42943 _REC_VAL_20_u1 979.2000000000001 _CNV_A_R_LINEAR_____5_CM 0. 8160. FORMAT "%4.0" /end CHARACTERISTIC
/begin CHARACTERISTIC C_TQ_FUP_AD_MIN "Minimum engine torque for learning of adaptative value" VALUE 0x430f8 _REC_VAL_20_u2 1023.96875 _CNV_A_R_LINEAR_____48_CM 0. 1023.96875 FORMAT "%7.2" /end CHARACTERISTIC
/begin CHARACTERISTIC C_TQ_FUP_AD_MAX "Maximum engine torque for learning of adaptative value" VALUE 0x430f6 _REC_VAL_20_u2 1023.96875 _CNV_A_R_LINEAR_____48_CM 0. 1023.96875 FORMAT "%7.2" /end CHARACTERISTIC
/begin CHARACTERISTIC C_FPAPWM_MAN_ACT "Manual FPAPWM" VALUE 0x42d74 _REC_VAL_20_u2 99.99825000000001 _CNV_A_R_LINEAR_____189_CM 0. 99.99825 FORMAT "%6.2" /end CHARACTERISTIC
/begin CHARACTERISTIC LC_FUP_SP_MAN_ACT "Switch for manual FUP_SP" VALUE 0x42b84 _REC_VAL_20_u1 1. _CNV_A_R_LINEAR_____12_CM 0. 1. FORMAT "%1.0" /end CHARACTERISTIC
/begin CHARACTERISTIC LC_FPAPWM_MAN_ACT "Switch for manual FPAPWM" VALUE 0x42b83 _REC_VAL_20_u1 1. _CNV_A_R_LINEAR_____12_CM 0. 1. FORMAT "%1.0" /end CHARACTERISTIC
/begin CHARACTERISTIC C_FUP_SP_MAN_ACT "Manual FUP_SP" VALUE 0x42d94 _REC_VAL_20_u2 173888. _CNV_A_R_LINEAR_____190_CM 0. 173888. FORMAT "%6.0" /end CHARACTERISTIC
/begin CHARACTERISTIC C_FPA_MFF_MIN "Minimum fuel flow through the solenoid to enable the fuel pressure controller" VALUE 0x42d6c _REC_VAL_20_u2 377.81 _CNV_A_R_LINEAR_____192_CM 0. 377.81 FORMAT "%7.2" /end CHARACTERISTIC
/begin CHARACTERISTIC C_FPA_MFF_INI "Fuel flow initialisation" VALUE 0x42d6a _REC_VAL_20_u2 377.81 _CNV_A_R_LINEAR_____192_CM 0. 377.81 FORMAT "%7.2" /end CHARACTERISTIC
/begin CHARACTERISTIC C_MFP "mass flow of the fuel mechanical pump each crankshaft revolution" VALUE 0x42e8e _REC_VAL_20_u2 11112. _CNV_A_R_LINEAR_____197_CM 0. 11112. FORMAT "%7.1" /end CHARACTERISTIC
/begin CHARACTERISTIC C_FPAPWM_MAX "Duty cycle maximum value" VALUE 0x42d76 _REC_VAL_20_u2 99.99825000000001 _CNV_A_R_LINEAR_____189_CM 0. 99.99825 FORMAT "%6.2" /end CHARACTERISTIC
/begin CHARACTERISTIC C_FPAPWM_FRQ_STND "FPAPWM frequency during normal operation (800 Hz)" VALUE 0x42d72 _REC_VAL_20_u2 767. _CNV_A_R_LINEAR_____115_CM 256. 1023. FORMAT "%4.0" /end CHARACTERISTIC
/begin MEASUREMENT LV_FPAPWM_AD "Flag indicating that the adapation conditions are fullfilled" UBYTE _CNV_A_R_LINEAR_____12_CM 1 100. 0. 1. ECU_ADDRESS 0x3fdb06 FORMAT "%1.0" BIT_MASK 0x1 /end MEASUREMENT
/begin MEASUREMENT STATE_FUP "Status of the fuel pressure controller operation" UBYTE _CNV_S_6_STATE_FUP_198_CM 1 100. 0. 5. ECU_ADDRESS 0x3fc600 /end MEASUREMENT
/begin MEASUREMENT FUP_DIF "Fuel pressure regulation error" SWORD _CNV_A_R_LINEAR_____191_CM 1 100. -86945.33 86942.67 ECU_ADDRESS 0x3fdaf4 FORMAT "%9.2" /end MEASUREMENT
/begin CHARACTERISTIC C_T_DLY_FPAPWM_AD "Delay under steady state conditions before adaptation occurs" VALUE 0x429db _REC_VAL_20_u1 25.5 _CNV_A_R_LINEAR_____14_CM 0. 25.5 FORMAT "%4.1" /end CHARACTERISTIC
/begin CHARACTERISTIC C_FPAPWM_I_AD "Filter factor for adaptive function" VALUE 0x428c8 _REC_VAL_20_u1 0.9960940000000002 _CNV_A_R_LINEAR_____44_CM 0. 0.996094 FORMAT "%5.3" /end CHARACTERISTIC
/begin CHARACTERISTIC C_FPAPWM_DIF_AD "Threshold on duty cycle variation for adaptive function" VALUE 0x42d70 _REC_VAL_20_u2 99.99825000000001 _CNV_A_R_LINEAR_____189_CM 0. 99.99825 FORMAT "%6.2" /end CHARACTERISTIC
/begin CHARACTERISTIC C_T_DLY_FUP "Time delay for overpressure detection" VALUE 0x429de _REC_VAL_20_u1 4.e-002 _CNV_A_R_LINEAR_____27_CM 0. 4.e-002 FORMAT "%4.3" /end CHARACTERISTIC
/begin AXIS_PTS ldp_tfpa_ip_fac_fpapwm "" 0x439b1 TFPA _REC_AXS_20_u1 190.5 _CNV_A_R_LINEAR_____0_CM 6 -48. 142.5 FORMAT "%5.1" /end AXIS_PTS
/begin AXIS_PTS ldpm_fpa_mff_fusl "" 0x44f94 FPA_MFF _REC_AXS_20_u2 377.81 _CNV_A_R_LINEAR_____192_CM 8 0. 377.81 FORMAT "%7.2" /end AXIS_PTS
/begin AXIS_PTS ldpm_fup_dif_dly_fusl "" 0x44fb8 FUP_DIF_DLY _REC_AXS_20_u2 173888. _CNV_A_R_LINEAR_____194_CM 8 -86945.33 86942.67 FORMAT "%9.2" /end AXIS_PTS
/begin AXIS_PTS ldp_vb_ip_fpapwm "" 0x43add VB _REC_AXS_20_u1 26. _CNV_A_R_LINEAR_____53_CM 8 0. 26. FORMAT "%4.1" /end AXIS_PTS
/begin AXIS_PTS ldp_vb_ip_fpapwm_max "" 0x43ae6 VB _REC_AXS_20_u1 26. _CNV_A_R_LINEAR_____53_CM 8 0. 26. FORMAT "%4.1" /end AXIS_PTS
/begin AXIS_PTS ldp_mff_sp_ip_fup_sp_hom "" 0x44746 MFF_SP _REC_AXS_20_u2 1389. _CNV_A_R_LINEAR_____95_CM 10 0. 1389. FORMAT "%7.2" /end AXIS_PTS
/begin AXIS_PTS ldp_n_32_ip_fup_sp_hom "" 0x43689 N_32 _REC_AXS_20_u1 8160. _CNV_A_R_LINEAR_____5_CM 8 0. 8160. FORMAT "%4.0" /end AXIS_PTS
/begin AXIS_PTS ldpm_n_32_2_s "" 0x43d4a N_32 _REC_AXS_20_u1 8160. _CNV_A_R_LINEAR_____5_CM 8 0. 8160. FORMAT "%4.0" /end AXIS_PTS
/begin AXIS_PTS ldpm_mff_sp_s_2_s "" 0x45184 MFF_SP_S_2 _REC_AXS_20_u2 1389. _CNV_A_R_LINEAR_____95_CM 8 0. 1389. FORMAT "%7.2" /end AXIS_PTS
/begin AXIS_PTS ldp_tco_ip_fup_sp_st "" 0x43906 TCO _REC_AXS_20_u1 190.5 _CNV_A_R_LINEAR_____0_CM 8 -48. 142.5 FORMAT "%5.1" /end AXIS_PTS
/begin AXIS_PTS ldp_fup_sp_dif_ip_fac_fup_sp "" 0x443f4 ONLINE_DUMMY _REC_AXS_20_u2 173888. _CNV_A_R_LINEAR_____194_CM 8 -86945.33 86942.67 FORMAT "%9.2" /end AXIS_PTS
/begin AXIS_PTS ldp_fup_sp_pctl_ip_fpapwm_bas "" 0x44406 FUP_SP_PCTL _REC_AXS_20_u2 173888. _CNV_A_R_LINEAR_____190_CM 8 0. 173888. FORMAT "%6.0" /end AXIS_PTS
/begin AXIS_PTS ldp_n_32_ip_fac_fpapwm_bas "" 0x4366c N_32 _REC_AXS_20_u1 8160. _CNV_A_R_LINEAR_____5_CM 8 0. 8160. FORMAT "%4.0" /end AXIS_PTS
/begin AXIS_PTS ldp_mff_sp_ip_fac_fpapwm_bas "" 0x44734 MFF_SP _REC_AXS_20_u2 1389. _CNV_A_R_LINEAR_____95_CM 8 0. 1389. FORMAT "%7.2" /end AXIS_PTS
/begin MEASUREMENT LV_FPAPWM_AD_INH "Inhibition of the adaptation" UBYTE _CNV_A_R_LINEAR_____12_CM 1 100. 0. 1. ECU_ADDRESS 0x3fc605 FORMAT "%1.0" BIT_MASK 0x1 /end MEASUREMENT
/begin MEASUREMENT LV_DLY_FPA_CLL_REQ "Maximum time for 'Fast pressure increase' expired" UBYTE _CNV_A_R_LINEAR_____10_CM 1 100. 0. 1. ECU_ADDRESS 0x3fc604 FORMAT "%1.0" BIT_MASK 0x1 /end MEASUREMENT
/begin MEASUREMENT TFPA "Fuel pressure actuator temperature" UBYTE _CNV_A_R_LINEAR_____0_CM 1 100. -48. 142.5 ECU_ADDRESS 0x3fc603 FORMAT "%5.1" /end MEASUREMENT
/begin MEASUREMENT STATE_FUP_TRAN "STATE_FUP transition conditions" UBYTE _CNV_S_9_STATE_FUP__199_CM 1 100. 0. 8. ECU_ADDRESS 0x3fc602 /end MEASUREMENT
/begin CHARACTERISTIC C_LGRD_CAM_SP_VO_INC "Limiting gradient for camshaft setpoint changes leading to increased valve overlap " VALUE 0x43280 _REC_VAL_20_s2 1535.9765625 _CNV_A_R_LINEAR_____230_CM -768. 767.9765625 FORMAT "%7.2" /end CHARACTERISTIC
/begin CHARACTERISTIC C_LGRD_CAM_SP_VO_DEC "Limiting gradient for camshaft setpoint changes leading to decreased valve overlap" VALUE 0x4327e _REC_VAL_20_s2 1535.9765625 _CNV_A_R_LINEAR_____230_CM -768. 767.9765625 FORMAT "%7.2" /end CHARACTERISTIC
/begin CHARACTERISTIC IP_CAM_SP_2_EX_IS__N__MAF_IVVT "Target spread for thermal condition 2, idle,exhaust camschaft" MAP 0x4d54b _REC_MAP_20_u1_u2_u2 -95.625 _CNV_A_R_LINEAR_____231_CM -40. -135.625 FORMAT "%5.1"
 /begin AXIS_DESCR COM_AXIS N _CNV_A_R_LINEAR_____17_CM 6 0. 8160. FORMAT "%4.0" AXIS_PTS_REF ldpm_n_13 /end AXIS_DESCR
 /begin AXIS_DESCR COM_AXIS MAF_IVVT _CNV_A_R_LINEAR_____95_CM 6 0. 1389. FORMAT "%7.2" AXIS_PTS_REF ldpm_maf_ivvt_1 /end AXIS_DESCR
/end CHARACTERISTIC
/begin MEASUREMENT LV_PVS_FL_IVVT "Logical variable for camshaft spread calculation at  high engine load demand (1 = active)" UBYTE _CNV_S_2_RANGE______11_CM 1 100. 0. 1. ECU_ADDRESS 0x3fdbf9 /end MEASUREMENT
/begin MEASUREMENT T_CAM_SP_ACT "Time after transition of STATE_IVVT  0 Þ 1 (passive Þ active)" UBYTE _CNV_A_R_LINEAR_____23_CM 1 100. 0. 2550. ECU_ADDRESS 0x3fdbf4 FORMAT "%4.0" /end MEASUREMENT
/begin CHARACTERISTIC C_CAM_SP_AS_EX "Additive share target spread exhaust camshaft" VALUE 0x43228 _REC_VAL_20_s2 1535.9765625 _CNV_A_R_LINEAR_____232_CM -768. 767.9765625 FORMAT "%7.2" /end CHARACTERISTIC
/begin CHARACTERISTIC C_CAM_SP_AS_IN "Additive share target spread intake camshaft" VALUE 0x4322a _REC_VAL_20_s2 1535.9765625 _CNV_A_R_LINEAR_____232_CM -768. 767.9765625 FORMAT "%7.2" /end CHARACTERISTIC
/begin CHARACTERISTIC C_CAM_SP_DIF_MAX "CAM_Setpoint hysteresis" VALUE 0x4322c _REC_VAL_20_s2 1535.9765625 _CNV_A_R_LINEAR_____232_CM -768. 767.9765625 FORMAT "%7.2" /end CHARACTERISTIC
/begin CHARACTERISTIC C_LGRD_CAM_SP_TRA "Limiting gradient for camshaft setpoint during active IVVT transition function" VALUE 0x4327c _REC_VAL_20_s2 1535.9765625 _CNV_A_R_LINEAR_____230_CM -768. 767.9765625 FORMAT "%7.2" /end CHARACTERISTIC
/begin CHARACTERISTIC C_T_CAM_SP_LGRD "Adjusting time for 0.375 °CRK in active transition function" VALUE 0x429bd _REC_VAL_20_u1 2540. _CNV_A_R_LINEAR_____23_CM 10. 2550. FORMAT "%4.0" /end CHARACTERISTIC
/begin CHARACTERISTIC IP_FAC_CAM_IN_IS__TCO_TCO_ST "Weighting factor for target spread calculation, idle, intake camschaft" MAP 0x4de69 _REC_MAP_20_u1_u1_u1 7.96875 _CNV_A_R_LINEAR_____233_CM -4. 3.96875 FORMAT "%5.2"
 /begin AXIS_DESCR COM_AXIS TCO _CNV_A_R_LINEAR_____0_CM 8 -48. 142.5 FORMAT "%5.1" AXIS_PTS_REF ldpm_tco_17 /end AXIS_DESCR
 /begin AXIS_DESCR COM_AXIS TCO_ST _CNV_A_R_LINEAR_____0_CM 8 -48. 142.5 FORMAT "%5.1" AXIS_PTS_REF ldpm_tco_st_4 /end AXIS_DESCR
/end CHARACTERISTIC
/begin CHARACTERISTIC IP_CAM_SP_2_EX_FL__N "Target spread for thermal condition 2, high load, exhaust camschaft" CURVE 0x4d53b _REC_CUR_20_u1_u2 -95.625 _CNV_A_R_LINEAR_____231_CM -40. -135.625 FORMAT "%5.1"
 /begin AXIS_DESCR COM_AXIS N _CNV_A_R_LINEAR_____17_CM 16 0. 8160. FORMAT "%4.0" AXIS_PTS_REF ldpm_n_5 /end AXIS_DESCR
/end CHARACTERISTIC
/begin CHARACTERISTIC IP_FAC_CAM_IN_PL__TCO_TCO_ST "Weighting factor for target spread calculation, part load, intake camschaft" MAP 0x4dea9 _REC_MAP_20_u1_u1_u1 7.96875 _CNV_A_R_LINEAR_____233_CM -4. 3.96875 FORMAT "%5.2"
 /begin AXIS_DESCR COM_AXIS TCO _CNV_A_R_LINEAR_____0_CM 8 -48. 142.5 FORMAT "%5.1" AXIS_PTS_REF ldpm_tco_17 /end AXIS_DESCR
 /begin AXIS_DESCR COM_AXIS TCO_ST _CNV_A_R_LINEAR_____0_CM 8 -48. 142.5 FORMAT "%5.1" AXIS_PTS_REF ldpm_tco_st_4 /end AXIS_DESCR
/end CHARACTERISTIC
/begin CHARACTERISTIC IP_CAM_SP_2_EX_PL__N__MAF_IVVT "Target spread for thermal condition 2, part load, exhaust camschaft" MAP 0x4d593 _REC_MAP_20_u1_u2_u2 -95.625 _CNV_A_R_LINEAR_____231_CM -40. -135.625 FORMAT "%5.1"
 /begin AXIS_DESCR COM_AXIS N _CNV_A_R_LINEAR_____17_CM 16 0. 8160. FORMAT "%4.0" AXIS_PTS_REF ldpm_n_5 /end AXIS_DESCR
 /begin AXIS_DESCR COM_AXIS MAF _CNV_A_R_LINEAR_____95_CM 12 0. 1389. FORMAT "%7.2" AXIS_PTS_REF ldpm_maf_ivvt_2 /end AXIS_DESCR
/end CHARACTERISTIC
/begin CHARACTERISTIC IP_CAM_SP_2_IN_FL__N "Target spread for thermal condition 2, high load, intake camschaft" CURVE 0x4d737 _REC_CUR_20_u1_u2 95.625 _CNV_A_R_LINEAR_____234_CM 60. 155.625 FORMAT "%5.1"
 /begin AXIS_DESCR COM_AXIS N _CNV_A_R_LINEAR_____17_CM 16 0. 8160. FORMAT "%4.0" AXIS_PTS_REF ldpm_n_5 /end AXIS_DESCR
/end CHARACTERISTIC
/begin CHARACTERISTIC IP_CAM_SP_1_EX_FL__N "Target spread for thermal condition 1, high load, exhaust camschaft" CURVE 0x4d143 _REC_CUR_20_u1_u2 -95.625 _CNV_A_R_LINEAR_____231_CM -40. -135.625 FORMAT "%5.1"
 /begin AXIS_DESCR COM_AXIS N _CNV_A_R_LINEAR_____17_CM 16 0. 8160. FORMAT "%4.0" AXIS_PTS_REF ldpm_n_5 /end AXIS_DESCR
/end CHARACTERISTIC
/begin CHARACTERISTIC IP_CAM_SP_2_IN_IS__N__MAF_IVVT "Target spread for thermal condition 1, idle, intake camschaft" MAP 0x4d747 _REC_MAP_20_u1_u2_u2 95.625 _CNV_A_R_LINEAR_____234_CM 60. 155.625 FORMAT "%5.1"
 /begin AXIS_DESCR COM_AXIS N _CNV_A_R_LINEAR_____17_CM 6 0. 8160. FORMAT "%4.0" AXIS_PTS_REF ldpm_n_13 /end AXIS_DESCR
 /begin AXIS_DESCR COM_AXIS MAF_IVVT _CNV_A_R_LINEAR_____95_CM 6 0. 1389. FORMAT "%7.2" AXIS_PTS_REF ldpm_maf_ivvt_1 /end AXIS_DESCR
/end CHARACTERISTIC
/begin CHARACTERISTIC IP_CAM_SP_2_IN_PL__N__MAF_IVVT "Target spread for thermal condition 2, part load, intake camschaft" MAP 0x4d78f _REC_MAP_20_u1_u2_u2 95.625 _CNV_A_R_LINEAR_____234_CM 60. 155.625 FORMAT "%5.1"
 /begin AXIS_DESCR COM_AXIS N _CNV_A_R_LINEAR_____17_CM 16 0. 8160. FORMAT "%4.0" AXIS_PTS_REF ldpm_n_5 /end AXIS_DESCR
 /begin AXIS_DESCR COM_AXIS MAF _CNV_A_R_LINEAR_____95_CM 12 0. 1389. FORMAT "%7.2" AXIS_PTS_REF ldpm_maf_ivvt_2 /end AXIS_DESCR
/end CHARACTERISTIC
/begin CHARACTERISTIC IP_CAM_SP_1_EX_PL__N__MAF_IVVT "Target spread for thermal condition 1, part load, exhaust camschaft" MAP 0x4d19b _REC_MAP_20_u1_u2_u2 -95.625 _CNV_A_R_LINEAR_____231_CM -40. -135.625 FORMAT "%5.1"
 /begin AXIS_DESCR COM_AXIS N _CNV_A_R_LINEAR_____17_CM 16 0. 8160. FORMAT "%4.0" AXIS_PTS_REF ldpm_n_5 /end AXIS_DESCR
 /begin AXIS_DESCR COM_AXIS MAF _CNV_A_R_LINEAR_____95_CM 12 0. 1389. FORMAT "%7.2" AXIS_PTS_REF ldpm_maf_ivvt_2 /end AXIS_DESCR
/end CHARACTERISTIC
/begin CHARACTERISTIC IP_CAM_SP_1_IN_FL__N "Target spread for thermal condition 1, high load, intake camschaft" CURVE 0x4d33f _REC_CUR_20_u1_u2 95.625 _CNV_A_R_LINEAR_____234_CM 60. 155.625 FORMAT "%5.1"
 /begin AXIS_DESCR COM_AXIS N _CNV_A_R_LINEAR_____17_CM 16 0. 8160. FORMAT "%4.0" AXIS_PTS_REF ldpm_n_5 /end AXIS_DESCR
/end CHARACTERISTIC
/begin CHARACTERISTIC IP_FAC_CAM_EX_IS__TCO_TCO_ST "Weighting factor for target spread calculation, idle, exhaust camschaft" MAP 0x4dde9 _REC_MAP_20_u1_u1_u1 7.96875 _CNV_A_R_LINEAR_____233_CM -4. 3.96875 FORMAT "%5.2"
 /begin AXIS_DESCR COM_AXIS TCO _CNV_A_R_LINEAR_____0_CM 8 -48. 142.5 FORMAT "%5.1" AXIS_PTS_REF ldpm_tco_17 /end AXIS_DESCR
 /begin AXIS_DESCR COM_AXIS TCO_ST _CNV_A_R_LINEAR_____0_CM 8 -48. 142.5 FORMAT "%5.1" AXIS_PTS_REF ldpm_tco_st_4 /end AXIS_DESCR
/end CHARACTERISTIC
/begin CHARACTERISTIC IP_FAC_CAM_EX_PL__TCO_TCO_ST "Weighting factor for target spread calculation, part load, exhaust camschaft" MAP 0x4de29 _REC_MAP_20_u1_u1_u1 7.96875 _CNV_A_R_LINEAR_____233_CM -4. 3.96875 FORMAT "%5.2"
 /begin AXIS_DESCR COM_AXIS TCO _CNV_A_R_LINEAR_____0_CM 8 -48. 142.5 FORMAT "%5.1" AXIS_PTS_REF ldpm_tco_17 /end AXIS_DESCR
 /begin AXIS_DESCR COM_AXIS TCO_ST _CNV_A_R_LINEAR_____0_CM 8 -48. 142.5 FORMAT "%5.1" AXIS_PTS_REF ldpm_tco_st_4 /end AXIS_DESCR
/end CHARACTERISTIC
/begin CHARACTERISTIC IP_CAM_SP_1_IN_PL__N__MAF_IVVT "Target spread for thermal condition 1, part load, intake camschaft" MAP 0x4d397 _REC_MAP_20_u1_u2_u2 95.625 _CNV_A_R_LINEAR_____234_CM 60. 155.625 FORMAT "%5.1"
 /begin AXIS_DESCR COM_AXIS N _CNV_A_R_LINEAR_____17_CM 16 0. 8160. FORMAT "%4.0" AXIS_PTS_REF ldpm_n_5 /end AXIS_DESCR
 /begin AXIS_DESCR COM_AXIS MAF _CNV_A_R_LINEAR_____95_CM 12 0. 1389. FORMAT "%7.2" AXIS_PTS_REF ldpm_maf_ivvt_2 /end AXIS_DESCR
/end CHARACTERISTIC
/begin CHARACTERISTIC IP_CAM_SP_1_EX_IS__N__MAF_IVVT "Target spread for thermal condition 1, idle,exhaust camschaft" MAP 0x4d153 _REC_MAP_20_u1_u2_u2 -95.625 _CNV_A_R_LINEAR_____231_CM -40. -135.625 FORMAT "%5.1"
 /begin AXIS_DESCR COM_AXIS N _CNV_A_R_LINEAR_____17_CM 6 0. 8160. FORMAT "%4.0" AXIS_PTS_REF ldpm_n_13 /end AXIS_DESCR
 /begin AXIS_DESCR COM_AXIS MAF_IVVT _CNV_A_R_LINEAR_____95_CM 6 0. 1389. FORMAT "%7.2" AXIS_PTS_REF ldpm_maf_ivvt_1 /end AXIS_DESCR
/end CHARACTERISTIC
/begin CHARACTERISTIC IP_CAM_SP_1_IN_IS__N__MAF_IVVT "Target spread for thermal condition 1, idle, intake camschaft" MAP 0x4d34f _REC_MAP_20_u1_u2_u2 95.625 _CNV_A_R_LINEAR_____234_CM 60. 155.625 FORMAT "%5.1"
 /begin AXIS_DESCR COM_AXIS N _CNV_A_R_LINEAR_____17_CM 6 0. 8160. FORMAT "%4.0" AXIS_PTS_REF ldpm_n_13 /end AXIS_DESCR
 /begin AXIS_DESCR COM_AXIS MAF_IVVT _CNV_A_R_LINEAR_____95_CM 6 0. 1389. FORMAT "%7.2" AXIS_PTS_REF ldpm_maf_ivvt_1 /end AXIS_DESCR
/end CHARACTERISTIC
/begin CHARACTERISTIC IP_CAM_SP_CH_IN " Target spread during CAT heating, LV_DRI = 0, intake camshaft" MAP 0x4d933 _REC_MAP_20_u1_u1_u2 95.625 _CNV_A_R_LINEAR_____234_CM 60. 155.625 FORMAT "%5.1"
 /begin AXIS_DESCR COM_AXIS TCO_ST _CNV_A_R_LINEAR_____0_CM 8 -48. 142.5 FORMAT "%5.1" AXIS_PTS_REF ldpm_tco_st_1_ivvt /end AXIS_DESCR
 /begin AXIS_DESCR COM_AXIS T_AST _CNV_A_R_LINEAR_____14_CM 8 0. 6553.5 FORMAT "%6.1" AXIS_PTS_REF ldpm_t_ast_1_ivvt /end AXIS_DESCR
/end CHARACTERISTIC
/begin CHARACTERISTIC IP_CAM_SP_CH_DRI_IN " Target spread during CAT heating, LV_DRI = 1, intake camshaft" MAP 0x4d8b3 _REC_MAP_20_u1_u1_u2 95.625 _CNV_A_R_LINEAR_____234_CM 60. 155.625 FORMAT "%5.1"
 /begin AXIS_DESCR COM_AXIS TCO_ST _CNV_A_R_LINEAR_____0_CM 8 -48. 142.5 FORMAT "%5.1" AXIS_PTS_REF ldpm_tco_st_1_ivvt /end AXIS_DESCR
 /begin AXIS_DESCR COM_AXIS T_AST _CNV_A_R_LINEAR_____14_CM 8 0. 6553.5 FORMAT "%6.1" AXIS_PTS_REF ldpm_t_ast_1_ivvt /end AXIS_DESCR
/end CHARACTERISTIC
/begin CHARACTERISTIC IP_CAM_SP_CH_EX " Target spread during CAT heating, LV_DRI = 0, exhaust camshaft " MAP 0x4d8f3 _REC_MAP_20_u1_u1_u2 -95.625 _CNV_A_R_LINEAR_____231_CM -40. -135.625 FORMAT "%8.3"
 /begin AXIS_DESCR COM_AXIS TCO_ST _CNV_A_R_LINEAR_____0_CM 8 -48. 142.5 FORMAT "%5.1" AXIS_PTS_REF ldpm_tco_st_1_ivvt /end AXIS_DESCR
 /begin AXIS_DESCR COM_AXIS T_AST _CNV_A_R_LINEAR_____14_CM 8 0. 6553.5 FORMAT "%6.1" AXIS_PTS_REF ldpm_t_ast_1_ivvt /end AXIS_DESCR
/end CHARACTERISTIC
/begin CHARACTERISTIC IP_CAM_SP_CH_DRI_EX " Target spread during CAT heating, LV_DRI = 1, exhaust camshaft " MAP 0x4d873 _REC_MAP_20_u1_u1_u2 -95.625 _CNV_A_R_LINEAR_____231_CM -40. -135.625 FORMAT "%8.3"
 /begin AXIS_DESCR COM_AXIS TCO_ST _CNV_A_R_LINEAR_____0_CM 8 -48. 142.5 FORMAT "%5.1" AXIS_PTS_REF ldpm_tco_st_1_ivvt /end AXIS_DESCR
 /begin AXIS_DESCR COM_AXIS T_AST _CNV_A_R_LINEAR_____14_CM 8 0. 6553.5 FORMAT "%6.1" AXIS_PTS_REF ldpm_t_ast_1_ivvt /end AXIS_DESCR
/end CHARACTERISTIC
/begin CHARACTERISTIC IP_FAC_CAM_SP_CH_KM "Factor vehicle mileage" CURVE 0x4dee9 _REC_CUR_20_u1_u2 0.99610001 _CNV_A_R_LINEAR_____20_CM 0. 0.99610001 FORMAT "%5.3"
 /begin AXIS_DESCR COM_AXIS CTR_KM_CAN _CNV_A_R_LINEAR_____80_CM 4 0. 655350. FORMAT "%7.0" AXIS_PTS_REF ldpm_ctr_km_can_1 /end AXIS_DESCR
/end CHARACTERISTIC
/begin CHARACTERISTIC C_T_DRI_CH_IVVT "Duration of ramp LV_DRI 0«1" VALUE 0x42fbc _REC_VAL_20_u2 655.35 _CNV_A_R_LINEAR_____27_CM 0. 655.35 FORMAT "%6.2" /end CHARACTERISTIC
/begin CHARACTERISTIC IP_FAC_CAM_SP_CH_OPP "Factor operating point" MAP 0x4deed _REC_MAP_20_u1_u2_u2 0.99610001 _CNV_A_R_LINEAR_____20_CM 0. 0.99610001 FORMAT "%5.3"
 /begin AXIS_DESCR COM_AXIS N_32 _CNV_A_R_LINEAR_____17_CM 4 0. 8160. FORMAT "%4.0" AXIS_PTS_REF ldp_n_32__fac_cam_sp_ch_opp /end AXIS_DESCR
 /begin AXIS_DESCR COM_AXIS ONLINE_DUMMY _CNV_A_R_LINEAR_____43_CM 4 0. 5434. FORMAT "%7.2" AXIS_PTS_REF ldp_dip__fac_cam_sp_ch_opp /end AXIS_DESCR
/end CHARACTERISTIC
/begin CHARACTERISTIC C_T_RAMP_CH_IVVT "Duration of ramp LV_CH_IVVT 0«1" VALUE 0x43018 _REC_VAL_20_u2 655.34 _CNV_A_R_LINEAR_____27_CM 1.e-002 655.35 FORMAT "%5.2" /end CHARACTERISTIC
/begin MEASUREMENT FAC_CH_IVVT_DRI "Ramp factor when LV_DRI changes" UBYTE _CNV_A_R_LINEAR_____20_CM 1 100. 0. 0.99610001 ECU_ADDRESS 0x3fdbf5 FORMAT "%5.3" /end MEASUREMENT
/begin MEASUREMENT FAC_DEAC_CH_IVVT "Ramp factor when LV_CH_IVVT changes" UBYTE _CNV_A_R_LINEAR_____20_CM 1 100. 0. 0.99610001 ECU_ADDRESS 0x3fdbf6 FORMAT "%5.3" /end MEASUREMENT
/begin MEASUREMENT FAC_IVVT_SP_CH "Interpolation factor CAM_SP catalyst heating" UBYTE _CNV_A_R_LINEAR_____20_CM 1 100. 0. 0.99610001 ECU_ADDRESS 0x3fdbf7 FORMAT "%5.3" /end MEASUREMENT
/begin CHARACTERISTIC ID_CMB_IVVT "Definition which setpoint is to be calculated at individual STATE_CMB CTL" CURVE 0x4cc28 _REC_CUR_20_u1_u1 2. _CNV_A_R_LINEAR_____10_CM 0. 2. FORMAT "%2.0"
 /begin AXIS_DESCR COM_AXIS STATE_CMB_CTL _CNV_A_R_LINEAR_____10_CM 9 0. 8. FORMAT "%2.0" AXIS_PTS_REF ldp_state_cmb_ctl_id_cmb_ivvt /end AXIS_DESCR
/end CHARACTERISTIC
/begin CHARACTERISTIC IP_PV_MAX_FL_IVVT__N "PV-threshold for control IVVT at high load" CURVE 0x4fdc5 _REC_CUR_20_u1_u2 99.609375 _CNV_A_R_LINEAR_____4_CM 0. 99.609375 FORMAT "%5.1"
 /begin AXIS_DESCR COM_AXIS N _CNV_A_R_LINEAR_____17_CM 16 0. 8160. FORMAT "%4.0" AXIS_PTS_REF ldpm_n_11 /end AXIS_DESCR
/end CHARACTERISTIC
/begin AXIS_PTS ldpm_tco_st_4 "" 0x44024 TCO_ST _REC_AXS_20_u1 190.5 _CNV_A_R_LINEAR_____0_CM 8 -48. 142.5 FORMAT "%5.1" /end AXIS_PTS
/begin AXIS_PTS ldpm_n_11 "ldpm 6 points N for IGA" 0x451d2 N _REC_AXS_20_u2 8160. _CNV_A_R_LINEAR_____17_CM 16 0. 8160. FORMAT "%4.0" /end AXIS_PTS
/begin AXIS_PTS ldpm_maf_ivvt_1 "" 0x45104 MAF_IVVT _REC_AXS_20_u2 1389. _CNV_A_R_LINEAR_____95_CM 6 0. 1389. FORMAT "%7.2" /end AXIS_PTS
/begin AXIS_PTS ldpm_tco_17 "" 0x43f3e TCO _REC_AXS_20_u1 190.5 _CNV_A_R_LINEAR_____0_CM 8 -48. 142.5 FORMAT "%5.1" /end AXIS_PTS
/begin AXIS_PTS ldpm_tco_st_1_ivvt "" 0x4400b TCO_ST _REC_AXS_20_u1 190.5 _CNV_A_R_LINEAR_____0_CM 8 -48. 142.5 FORMAT "%5.1" /end AXIS_PTS
/begin AXIS_PTS ldpm_t_ast_1_ivvt "" 0x45428 T_AST _REC_AXS_20_u2 6553.5 _CNV_A_R_LINEAR_____14_CM 8 0. 6553.5 FORMAT "%6.1" /end AXIS_PTS
/begin AXIS_PTS ldp_n_32__fac_cam_sp_ch_opp "" 0x447ac N_32 _REC_AXS_20_u2 8160. _CNV_A_R_LINEAR_____17_CM 4 0. 8160. FORMAT "%4.0" /end AXIS_PTS
/begin AXIS_PTS ldp_dip__fac_cam_sp_ch_opp "" 0x4428a DIP _REC_AXS_20_u2 5434. _CNV_A_R_LINEAR_____43_CM 4 0. 5434. FORMAT "%7.2" /end AXIS_PTS
/begin AXIS_PTS ldp_state_cmb_ctl_id_cmb_ivvt "" 0x437ea STATE_CMB_CTL _REC_AXS_20_u1 8. _CNV_A_R_LINEAR_____10_CM 9 0. 8. FORMAT "%2.0" /end AXIS_PTS
/begin MEASUREMENT CAM_SP_IVVT_IN "" UBYTE _CNV_A_R_LINEAR_____234_CM 1 100. 60. 155.625 ECU_ADDRESS 0x3fc8d8 FORMAT "%5.1" /end MEASUREMENT
/begin MEASUREMENT CAM_SP_PARK_IN "Intake camshaft target spread - for IVVT parking function" UBYTE _CNV_A_R_LINEAR_____234_CM 1 100. 60. 155.625 ECU_ADDRESS 0x3fc8d9 FORMAT "%5.1" /end MEASUREMENT
/begin MEASUREMENT CAM_SP_IVVT_IN_LIM "Intake camshaft target spread  - after limitation" SWORD _CNV_A_R_LINEAR_____232_CM 1 100. -768. 767.9765625 ECU_ADDRESS 0x3fc8de FORMAT "%7.2" /end MEASUREMENT
/begin MEASUREMENT CAM_SP_IVVT_IN_HYS "Intake camshaft target spread  - after hysteresis" SWORD _CNV_A_R_LINEAR_____232_CM 1 100. -768. 767.9765625 ECU_ADDRESS 0x3fc8e0 FORMAT "%7.2" /end MEASUREMENT
/begin MEASUREMENT CAM_SP_AV_IN "Intake camshaft target spread calculated from the maps" SWORD _CNV_A_R_LINEAR_____232_CM 1 100. -768. 767.9765625 ECU_ADDRESS 0x3fc8e2 FORMAT "%7.2" /end MEASUREMENT
/begin MEASUREMENT CAM_SP_AV_IN_HOM "Intake camshaft target spread for homogeneous stochiometric combustion" SWORD _CNV_A_R_LINEAR_____232_CM 1 100. -768. 767.9765625 ECU_ADDRESS 0x3fc8e4 FORMAT "%7.2" /end MEASUREMENT
/begin MEASUREMENT CAM_SP_AV_LGRD_IN "Intake camshaft target spread with limiting gradient during transition function (Þ \"enable\")" SWORD _CNV_A_R_LINEAR_____232_CM 1 100. -768. 767.9765625 ECU_ADDRESS 0x3fc8e6 FORMAT "%7.2" /end MEASUREMENT
/begin MEASUREMENT LV_TRAN_IVVT_IN "Logical variable for active transition function inlet cam (1 = active)" UBYTE _CNV_S_2_RANGE______28_CM 1 100. 0. 1. ECU_ADDRESS 0x3fc8ea BIT_MASK 0x1 /end MEASUREMENT
/begin MEASUREMENT FAC_CAM_IN_IS "Temperature weighting factor intake camshaft  - idle speed" SBYTE _CNV_A_R_LINEAR_____240_CM 1 100. -4. 3.96875 ECU_ADDRESS 0x3fc8eb FORMAT "%5.2" /end MEASUREMENT
/begin MEASUREMENT FAC_CAM_IN_PL "Temperature weighting factor intake camshaft  - part load " SBYTE _CNV_A_R_LINEAR_____240_CM 1 100. -4. 3.96875 ECU_ADDRESS 0x3fc8ec FORMAT "%5.2" /end MEASUREMENT
/begin MEASUREMENT CAM_SP_REF_IN "Intake camshaft target spread at reference conditions (warm engine)" SWORD _CNV_A_R_LINEAR_____232_CM 1 100. -768. 767.9765625 ECU_ADDRESS 0x3fc8dc FORMAT "%7.2" /end MEASUREMENT
/begin MEASUREMENT CAM_SP_1_IN_HOM "Intake camshaft target spread  - without catalyst heating influence" SWORD _CNV_A_R_LINEAR_____232_CM 1 100. -768. 767.9765625 ECU_ADDRESS 0x3fc8da FORMAT "%7.2" /end MEASUREMENT
/begin MEASUREMENT CAM_SP_IVVT_EX "" UBYTE _CNV_A_R_LINEAR_____231_CM 1 100. -40. -135.625 ECU_ADDRESS 0x3fcae8 FORMAT "%5.1" /end MEASUREMENT
/begin MEASUREMENT CAM_SP_PARK_EX "Intake camshaft target spread - for IVVT parking function" UBYTE _CNV_A_R_LINEAR_____231_CM 1 100. -40. -135.625 ECU_ADDRESS 0x3fcae9 FORMAT "%5.1" /end MEASUREMENT
/begin MEASUREMENT CAM_SP_IVVT_EX_LIM "Exhaust camshaft target spread - after limitation" SWORD _CNV_A_R_LINEAR_____232_CM 1 100. -768. 767.9765625 ECU_ADDRESS 0x3fcaee FORMAT "%7.2" /end MEASUREMENT
/begin MEASUREMENT CAM_SP_IVVT_EX_HYS "Exhaust camshaft target spread - after hysteresis" SWORD _CNV_A_R_LINEAR_____232_CM 1 100. -768. 767.9765625 ECU_ADDRESS 0x3fcaf0 FORMAT "%7.2" /end MEASUREMENT
/begin MEASUREMENT CAM_SP_AV_EX "Exhaust camshaft target spread calculated from the maps" SWORD _CNV_A_R_LINEAR_____232_CM 1 100. -768. 767.9765625 ECU_ADDRESS 0x3fcaf2 FORMAT "%7.2" /end MEASUREMENT
/begin MEASUREMENT CAM_SP_AV_EX_HOM "Exhaust camshaft target spread for homogeneous stochiometric combustion" SWORD _CNV_A_R_LINEAR_____232_CM 1 100. -768. 767.9765625 ECU_ADDRESS 0x3fcaf4 FORMAT "%7.2" /end MEASUREMENT
/begin MEASUREMENT CAM_SP_AV_LGRD_EX "Exhaust camshaft target spread with limiting gradient during transition function (Þ \"enable\")" SWORD _CNV_A_R_LINEAR_____232_CM 1 100. -768. 767.9765625 ECU_ADDRESS 0x3fcaf6 FORMAT "%7.2" /end MEASUREMENT
/begin MEASUREMENT LV_TRAN_IVVT_EX "Logical variable for active transition function exhaust cam (1 = active)" UBYTE _CNV_S_2_RANGE______28_CM 1 100. 0. 1. ECU_ADDRESS 0x3fcafa BIT_MASK 0x1 /end MEASUREMENT
/begin MEASUREMENT FAC_CAM_EX_IS "Temperature weighting factor exhaust camshaft  - idle speed " SBYTE _CNV_A_R_LINEAR_____240_CM 1 100. -4. 3.96875 ECU_ADDRESS 0x3fcafb FORMAT "%5.2" /end MEASUREMENT
/begin MEASUREMENT FAC_CAM_EX_PL "Temperature weighting factor intake camshaft  - part load " SBYTE _CNV_A_R_LINEAR_____240_CM 1 100. -4. 3.96875 ECU_ADDRESS 0x3fcafc FORMAT "%5.2" /end MEASUREMENT
/begin MEASUREMENT CAM_SP_REF_EX "Exhaust camshaft target spread at reference conditions (warm engine)" SWORD _CNV_A_R_LINEAR_____232_CM 1 100. -768. 767.9765625 ECU_ADDRESS 0x3fcaec FORMAT "%7.2" /end MEASUREMENT
/begin MEASUREMENT CAM_SP_1_EX_HOM "Exhaust camshaft target spread  - without catalyst heating influence" SWORD _CNV_A_R_LINEAR_____232_CM 1 100. -768. 767.9765625 ECU_ADDRESS 0x3fcaea FORMAT "%7.2" /end MEASUREMENT
/begin CHARACTERISTIC C_ADD_N_MAX_FCUT "Additive threshold to maximum engine speed for activation fuel cut-off all cylinders" VALUE 0x42c1c _REC_VAL_20_u2 8160. _CNV_A_R_LINEAR_____17_CM 0. 8160. FORMAT "%4.0" /end CHARACTERISTIC
/begin CHARACTERISTIC C_N_GRD_HYS "Hysteresis for N_GRD Filtering" VALUE 0x4334f _REC_VAL_20_s1 8160. _CNV_A_R_LINEAR_____215_CM -4096. 4064. FORMAT "%5.0" /end CHARACTERISTIC
/begin CHARACTERISTIC C_TQI_MAX_PAS "Passive value indicated engine torque when engine speed limitation is inactive" VALUE 0x4310c _REC_VAL_20_u2 1023.96875 _CNV_A_R_LINEAR_____48_CM 0. 1023.96875 FORMAT "%7.2" /end CHARACTERISTIC
/begin MEASUREMENT LV_N_MAX_REQ_FCUT "Logical variable fuel cut-off of all cylinder requested for engine speed limitation" UBYTE _CNV_S_2_RANGE______11_CM 1 100. 0. 1. ECU_ADDRESS 0x3fcc39 BIT_MASK 0x1 /end MEASUREMENT
/begin MEASUREMENT N_DIF_MAX_LIM "Engine speed difference as an input for PI-controller" SWORD _CNV_A_R_LINEAR_____17_CM 1 100. -8160. 8160. ECU_ADDRESS 0x3fdd7e FORMAT "%4.0" /end MEASUREMENT
/begin MEASUREMENT N_PRED_MAX_LIM "Predicted engine speed " UWORD _CNV_A_R_LINEAR_____17_CM 1 100. 0. 8160. ECU_ADDRESS 0x3fdd7c FORMAT "%4.0" /end MEASUREMENT
/begin MEASUREMENT TQ_N_MAX_DIF "Torque output of N_MAX-PI-Controller" SWORD _CNV_A_R_LINEAR_____48_CM 1 100. -1024. 1023.96875 ECU_ADDRESS 0x3fdd84 FORMAT "%6.2" /end MEASUREMENT
/begin MEASUREMENT TQ_N_MAX_DIF_I "Torque output of N_MAX-I-Controller" SLONG _CNV_A_R_LINEAR_____225_CM 1 100. -1024. 1023.99999952 ECU_ADDRESS 0x3fdd78 FORMAT "%11.7" /end MEASUREMENT
/begin MEASUREMENT TQ_N_MAX_DIF_P "Torque output of N_MAX-P-Controller" SWORD _CNV_A_R_LINEAR_____48_CM 1 100. -1024. 1023.96875 ECU_ADDRESS 0x3fdd86 FORMAT "%6.2" /end MEASUREMENT
/begin MEASUREMENT TQ_N_MAX_INP_I "Torque input for N_MAX I-controller" SWORD _CNV_A_R_LINEAR_____214_CM 1 100. -4. 3.99987793 ECU_ADDRESS 0x3fdd80 FORMAT "%5.4" /end MEASUREMENT
/begin MEASUREMENT TQI_N_MAX "Indicated engine torque setpoint  for N_MAX-limitation" SWORD _CNV_A_R_LINEAR_____48_CM 1 100. -1024. 1023.96875 ECU_ADDRESS 0x3fcc36 FORMAT "%8.2" /end MEASUREMENT
/begin MEASUREMENT TQI_N_MAX_REF "Reference indicated engine  torque on which controller output is applied" SWORD _CNV_A_R_LINEAR_____48_CM 1 100. -1024. 1023.96875 ECU_ADDRESS 0x3fdd82 FORMAT "%8.2" /end MEASUREMENT
/begin MEASUREMENT N_GRD_FIL "Filtered engine speed gradient for predicted engine speed" SBYTE _CNV_A_R_LINEAR_____369_CM 1 100. -4096. 4064. ECU_ADDRESS 0x3fdd8c FORMAT "%4.0" /end MEASUREMENT
/begin CHARACTERISTIC C_CRLC_N_GRD_FIL_1 "N_GRD_FIL low pass filter constant if LV_N_MAX = 0" VALUE 0x42c7c _REC_VAL_20_u2 0.99998474 _CNV_A_R_LINEAR_____31_CM 0. 0.99998474 FORMAT "%7.5" /end CHARACTERISTIC
/begin CHARACTERISTIC C_CRLC_N_GRD_FIL_2 "N_GRD_FIL low pass filter constant if LV_N_MAX = 1" VALUE 0x42c7e _REC_VAL_20_u2 0.99998474 _CNV_A_R_LINEAR_____31_CM 0. 0.99998474 FORMAT "%7.5" /end CHARACTERISTIC
/begin CHARACTERISTIC C_TQI_N_MAX_INC "Maximum increment for the output when limiting increasing rate" VALUE 0x4310e _REC_VAL_20_u2 1023.96875 _CNV_A_R_LINEAR_____48_CM 0. 1023.96875 FORMAT "%7.2" /end CHARACTERISTIC
/begin CHARACTERISTIC ID_FAC_N_MAX_I_AT__GEAR "I-control parameter for N_MAX-controller automatic transmission" CURVE 0x4572e _REC_CUR_20_u2_u1 7.99987793 _CNV_A_R_LINEAR_____376_CM 0. 7.99987793 FORMAT "%6.4"
 /begin AXIS_DESCR COM_AXIS GEAR _CNV_A_R_LINEAR_____10_CM 9 0. 255. FORMAT "%3.0" AXIS_PTS_REF ldpm_gear /end AXIS_DESCR
/end CHARACTERISTIC
/begin CHARACTERISTIC ID_FAC_N_MAX_P_MT__GEAR "P-control parameter for N_MAX-controller manual transmission" CURVE 0x4ccc2 _REC_CUR_20_u1_u1 7.96875 _CNV_A_R_LINEAR_____377_CM 0. 7.96875 FORMAT "%4.2"
 /begin AXIS_DESCR COM_AXIS GEAR _CNV_A_R_LINEAR_____10_CM 9 0. 255. FORMAT "%3.0" AXIS_PTS_REF ldpm_gear /end AXIS_DESCR
/end CHARACTERISTIC
/begin CHARACTERISTIC ID_FAC_N_MAX_I_MT__GEAR "I-control parameter for N_MAX-controller manual transmission" CURVE 0x45740 _REC_CUR_20_u2_u1 7.99987793 _CNV_A_R_LINEAR_____376_CM 0. 7.99987793 FORMAT "%6.4"
 /begin AXIS_DESCR COM_AXIS GEAR _CNV_A_R_LINEAR_____10_CM 9 0. 255. FORMAT "%3.0" AXIS_PTS_REF ldpm_gear /end AXIS_DESCR
/end CHARACTERISTIC
/begin CHARACTERISTIC ID_FAC_N_MAX_P_AT__GEAR "P-control parameter for N_MAX-controller automatic transmission" CURVE 0x4ccb9 _REC_CUR_20_u1_u1 7.96875 _CNV_A_R_LINEAR_____377_CM 0. 7.96875 FORMAT "%4.2"
 /begin AXIS_DESCR COM_AXIS GEAR _CNV_A_R_LINEAR_____10_CM 9 0. 255. FORMAT "%3.0" AXIS_PTS_REF ldpm_gear /end AXIS_DESCR
/end CHARACTERISTIC
/begin CHARACTERISTIC ID_T_N_MAX_PRED_AT__GEAR "Prediction time for predicted engine speed for automatic transmission" CURVE 0x4cf8f _REC_CUR_20_u1_u1 7.96875 _CNV_A_R_LINEAR_____221_CM 0. 7.96875 FORMAT "%4.2"
 /begin AXIS_DESCR COM_AXIS GEAR _CNV_A_R_LINEAR_____10_CM 9 0. 255. FORMAT "%3.0" AXIS_PTS_REF ldpm_gear /end AXIS_DESCR
/end CHARACTERISTIC
/begin CHARACTERISTIC ID_T_N_MAX_PRED_MT__GEAR "Prediction time for predicted engine speed for manual transmission" CURVE 0x4cf98 _REC_CUR_20_u1_u1 7.96875 _CNV_A_R_LINEAR_____221_CM 0. 7.96875 FORMAT "%4.2"
 /begin AXIS_DESCR COM_AXIS GEAR _CNV_A_R_LINEAR_____10_CM 9 0. 255. FORMAT "%3.0" AXIS_PTS_REF ldpm_gear /end AXIS_DESCR
/end CHARACTERISTIC
/begin CHARACTERISTIC IP_N_GRD_THD__N_32 "Engine speed gradient threshold for filtering of basic engine speed gradient" CURVE 0x4fc40 _REC_CUR_20_u1_u1 8160. _CNV_A_R_LINEAR_____378_CM -4096. 4064. FORMAT "%5.0"
 /begin AXIS_DESCR COM_AXIS N_32 _CNV_A_R_LINEAR_____5_CM 8 0. 8160. FORMAT "%4.0" AXIS_PTS_REF ldp_n_32_n_grd_thd /end AXIS_DESCR
/end CHARACTERISTIC
/begin MEASUREMENT N_GRD_FIL_FIL "Low pass filtered engine speed gradient for predicted engine speed" SBYTE _CNV_A_R_LINEAR_____369_CM 1 100. -4096. 4064. ECU_ADDRESS 0x3fdd8d FORMAT "%4.0" /end MEASUREMENT
/begin MEASUREMENT TQI_N_MAX_1 "Intermitted indicated engine torque after considering PI-controller output" SWORD _CNV_A_R_LINEAR_____48_CM 1 100. -1024. 1023.96875 ECU_ADDRESS 0x3fdd88 FORMAT "%8.2" /end MEASUREMENT
/begin MEASUREMENT TQI_N_MAX_2 "Intermitted indicated engine torque after considering PI-controller output" SWORD _CNV_A_R_LINEAR_____48_CM 1 100. -1024. 1023.96875 ECU_ADDRESS 0x3fdd8a FORMAT "%8.2" /end MEASUREMENT
/begin MEASUREMENT LV_N_MAX "Logical variable engine speed limitation active" UBYTE _CNV_S_2_RANGE______11_CM 1 100. 0. 1. ECU_ADDRESS 0x3fcc38 BIT_MASK 0x1 /end MEASUREMENT
/begin AXIS_PTS ldp_n_32_n_grd_thd "" 0x436d2 N_32 _REC_AXS_20_u1 8160. _CNV_A_R_LINEAR_____5_CM 8 0. 8160. FORMAT "%4.0" /end AXIS_PTS
/begin AXIS_PTS ldpm_gear "" 0x43baa GEAR _REC_AXS_20_u1 255. _CNV_A_R_LINEAR_____10_CM 9 0. 255. FORMAT "%3.0" /end AXIS_PTS
/begin MEASUREMENT N_MAX "highest engine speed reached" UWORD _CNV_A_R_LINEAR_____17_CM 1 100. 1. 8160. ECU_ADDRESS 0x3fcc48 FORMAT "%4.0" /end MEASUREMENT
/begin MEASUREMENT TRT_N_MAX "total running time in case of maximum engine speed reached" ULONG _CNV_A_R_LINEAR_____155_CM 1 100. 0. 119304.6471 ECU_ADDRESS 0x3fcc44 FORMAT "%12.5" /end MEASUREMENT
/begin CHARACTERISTIC C_N_LIM_MIN "Engine speed threshold for overrevving event" VALUE 0x42eb0 _REC_VAL_20_u2 8160. _CNV_A_R_LINEAR_____17_CM 0. 8160. FORMAT "%4.0" /end CHARACTERISTIC
/begin MEASUREMENT CTR_N_MAX "event frequency counter" UBYTE _CNV_A_R_LINEAR_____10_CM 1 100. 0. 255. ECU_ADDRESS 0x3fcc50 FORMAT "%3.0" /end MEASUREMENT
/begin MEASUREMENT CTR_KM_N_MAX "km counter at highest event" UWORD _CNV_A_R_LINEAR_____80_CM 1 100. 0. 655350. ECU_ADDRESS 0x3fcc4a FORMAT "%7.0" /end MEASUREMENT
/begin MEASUREMENT N_GRD_N_MAX "engine speed gradient at highest event" SBYTE _CNV_A_R_LINEAR_____5_CM 1 100. -4096. 4064. ECU_ADDRESS 0x3fcc51 FORMAT "%5.0" /end MEASUREMENT
/begin MEASUREMENT VS_N_MAX "vehicle speed at highest event" UBYTE _CNV_A_R_LINEAR_____13_CM 1 100. 0. 255. ECU_ADDRESS 0x3fcc52 FORMAT "%3.0" /end MEASUREMENT
/begin MEASUREMENT PV_AV_N_MAX "pedal value at highest event" UBYTE _CNV_A_R_LINEAR_____4_CM 1 100. 0. 99.609375 ECU_ADDRESS 0x3fcc53 FORMAT "%4.1" /end MEASUREMENT
/begin MEASUREMENT GEAR_EF_N_MAX "gear ratio at highest event" UBYTE _CNV_A_R_LINEAR_____10_CM 1 100. 0. 255. ECU_ADDRESS 0x3fcc54 FORMAT "%3.0" /end MEASUREMENT
/begin MEASUREMENT LV_CS_N_MAX "clutch switch detection at highest event" UBYTE _CNV_S_2_RANGE______28_CM 1 100. 0. 1. ECU_ADDRESS 0x3fcc56 /end MEASUREMENT
/begin MEASUREMENT T_SUM_N_MAX "time sum of all events maximum engine speed reached" UWORD _CNV_A_R_LINEAR_____14_CM 1 100. 0. 6553.5 ECU_ADDRESS 0x3fcc4c FORMAT "%6.1" /end MEASUREMENT
/begin MEASUREMENT T_N_MAX "time sum at highest event" UWORD _CNV_A_R_LINEAR_____14_CM 1 100. 0. 6553.5 ECU_ADDRESS 0x3fcc4e FORMAT "%6.1" /end MEASUREMENT
/begin MEASUREMENT NR_PAT_SCC_N_MAX "selected index off fuel cut off pattern at highest event" UBYTE _CNV_A_R_LINEAR_____10_CM 1 100. 0. 255. ECU_ADDRESS 0x3fcc55 FORMAT "%3.0" /end MEASUREMENT
/begin MEASUREMENT PORTPWM "PWM setpoint for port flap" UWORD _CNV_A_R_LINEAR_____94_CM 1 100. 0. 99.99847412 ECU_ADDRESS 0x3fcf9c /end MEASUREMENT
/begin MEASUREMENT PORT_SP "relative port deactivation setpoint" UWORD _CNV_A_R_LINEAR_____94_CM 1 100. 0. 99.99847412 ECU_ADDRESS 0x3fe554 /end MEASUREMENT
/begin MEASUREMENT VLFT_SP "valve lift setpoint (raw value)" UWORD _CNV_A_R_LINEAR_____387_CM 1 100. 0. 65.535 ECU_ADDRESS 0x3fe556 /end MEASUREMENT
/begin MEASUREMENT PORT_SP_PHY "physical port flap angle setpoint (raw value)" UWORD _CNV_A_R_LINEAR_____207_CM 1 100. 0. 99.99847412 ECU_ADDRESS 0x3fe558 /end MEASUREMENT
/begin MEASUREMENT PORT_SP_RAW "relative port deactivation setpoint (raw value)" UWORD _CNV_A_R_LINEAR_____94_CM 1 100. 0. 99.99847412 ECU_ADDRESS 0x3fe55a /end MEASUREMENT
/begin MEASUREMENT EXC_SP_REL "relative eccenter setpoint for variable valve lift" UWORD _CNV_A_R_LINEAR_____94_CM 1 100. 0. 99.99847412 ECU_ADDRESS 0x3fcf9a /end MEASUREMENT
/begin CHARACTERISTIC IP_VLFT_SP__EXC_SP_REL "valve lift vs. excenter setpoint" CURVE 0x4c964 _REC_CUR_20_u2_u2 65.535 _CNV_A_R_LINEAR_____387_CM 0. 65.535
 /begin AXIS_DESCR COM_AXIS EXC_SP_REL _CNV_A_R_LINEAR_____94_CM 12 0. 99.99847412 AXIS_PTS_REF ldp_exc_sp_rel__vlft_sp /end AXIS_DESCR
/end CHARACTERISTIC
/begin CHARACTERISTIC IP_PORT_SP_PHY__PORTPWM "port flap angle vs. port setpoint PWM" CURVE 0x49d28 _REC_CUR_20_u2_u2 99.99847412 _CNV_A_R_LINEAR_____207_CM 0. 99.99847412
 /begin AXIS_DESCR COM_AXIS PORTPWM _CNV_A_R_LINEAR_____94_CM 12 0. 99.99847412 AXIS_PTS_REF ldp_portpwm__port_sp_phy /end AXIS_DESCR
/end CHARACTERISTIC
/begin CHARACTERISTIC IP_PORT_SP_RGN_NT "relative port deactivation setpoint map for regeneration NOX trap " MAP 0x49d40 _REC_MAP_20_u2_u1_u2 99.99847412 _CNV_A_R_LINEAR_____94_CM 0. 99.99847412
 /begin AXIS_DESCR COM_AXIS N_32 _CNV_A_R_LINEAR_____5_CM 6 0. 8160. FORMAT "%4.0" AXIS_PTS_REF ldp_n_32__port_sp_s /end AXIS_DESCR
 /begin AXIS_DESCR COM_AXIS FAC_TQ_REQ _CNV_A_R_LINEAR_____45_CM 6 0. 1.99996948 FORMAT "%7.5" AXIS_PTS_REF ldp_fac_tq_req__port_sp_s /end AXIS_DESCR
/end CHARACTERISTIC
/begin CHARACTERISTIC IP_PORT_AV__V_PORT "conversion table for linearization of PORT_AV value acquisition" CURVE 0x49c80 _REC_CUR_20_u2_u2 99.99847412 _CNV_A_R_LINEAR_____207_CM 0. 99.99847412
 /begin AXIS_DESCR COM_AXIS V_PORT _CNV_A_R_LINEAR_____33_CM 12 0. 4.99511719 FORMAT "%5.3" AXIS_PTS_REF ldp_v_port__port_av /end AXIS_DESCR
/end CHARACTERISTIC
/begin CHARACTERISTIC C_TCO_MIN_PORT "coolant temperature minimum value for port deactivation (activation condtion)" VALUE 0x42a71 _REC_VAL_20_u1 190.5 _CNV_A_R_LINEAR_____0_CM -48. 142.5 FORMAT "%5.1" /end CHARACTERISTIC
/begin CHARACTERISTIC C_CRLC_PORT_SP "Correlation constant for PORT_SP filtering" VALUE 0x42836 _REC_VAL_20_u1 0.99610001 _CNV_A_R_LINEAR_____20_CM 0. 0.99610001 FORMAT "%5.3" /end CHARACTERISTIC
/begin CHARACTERISTIC C_EXC_SP_INI "initialization value for eccenter setpoint (variable valve lift)" VALUE 0x42cfc _REC_VAL_20_u2 99.99847412 _CNV_A_R_LINEAR_____94_CM 0. 99.99847412 /end CHARACTERISTIC
/begin CHARACTERISTIC C_PORTPWM_INI "initialization value for port flap PWM setpoint " VALUE 0x42eda _REC_VAL_20_u2 99.99847412 _CNV_A_R_LINEAR_____94_CM 0. 99.99847412 /end CHARACTERISTIC
/begin CHARACTERISTIC LC_PORT_INH_AS "logical constant for to deactivate PORTPWM by application system (LC_PORT_INH_AS = 0  -> active)" VALUE 0x42bba _REC_VAL_20_u1 1. _CNV_A_R_LINEAR_____10_CM 0. 1. FORMAT "%2.0" /end CHARACTERISTIC
/begin CHARACTERISTIC IP_PORT_SP_S "relative port deactivation setpoint map for stratified combustion mode" MAP 0x49d88 _REC_MAP_20_u2_u1_u2 99.99847412 _CNV_A_R_LINEAR_____94_CM 0. 99.99847412
 /begin AXIS_DESCR COM_AXIS N_32 _CNV_A_R_LINEAR_____5_CM 6 0. 8160. FORMAT "%4.0" AXIS_PTS_REF ldp_n_32__port_sp_s /end AXIS_DESCR
 /begin AXIS_DESCR COM_AXIS FAC_TQ_REQ _CNV_A_R_LINEAR_____45_CM 6 0. 1.99996948 FORMAT "%7.5" AXIS_PTS_REF ldp_fac_tq_req__port_sp_s /end AXIS_DESCR
/end CHARACTERISTIC
/begin CHARACTERISTIC IP_PORT_SP_AFS "relative port deactivation setpoint for air/fuel stoichiometric combustion mode" MAP 0x49ce0 _REC_MAP_20_u2_u1_u2 99.99847412 _CNV_A_R_LINEAR_____94_CM 0. 99.99847412
 /begin AXIS_DESCR COM_AXIS N_32 _CNV_A_R_LINEAR_____5_CM 6 0. 8160. FORMAT "%4.0" AXIS_PTS_REF ldp_n_32__port_sp_afs /end AXIS_DESCR
 /begin AXIS_DESCR COM_AXIS FAC_TQ_REQ _CNV_A_R_LINEAR_____45_CM 6 0. 1.99996948 FORMAT "%7.5" AXIS_PTS_REF ldp_fac_tq_req__port_sp_afs /end AXIS_DESCR
/end CHARACTERISTIC
/begin CHARACTERISTIC IP_PORT_SP_AFL "relative port deactivation setpoint for air/fuel lean combustion mode" MAP 0x49c98 _REC_MAP_20_u2_u1_u2 99.99847412 _CNV_A_R_LINEAR_____94_CM 0. 99.99847412
 /begin AXIS_DESCR COM_AXIS N_32 _CNV_A_R_LINEAR_____5_CM 6 0. 8160. FORMAT "%4.0" AXIS_PTS_REF ldp_n_32__port_sp_afl /end AXIS_DESCR
 /begin AXIS_DESCR COM_AXIS FAC_TQ_REQ _CNV_A_R_LINEAR_____45_CM 6 0. 1.99996948 FORMAT "%7.5" AXIS_PTS_REF ldp_fac_tq_req__port_sp_afl /end AXIS_DESCR
/end CHARACTERISTIC
/begin CHARACTERISTIC IP_FAC_TCO_PORT_SP "temperature correction of PORT_SP" CURVE 0x4e52b _REC_CUR_20_u1_u1 0.99610001 _CNV_A_R_LINEAR_____20_CM 0. 0.99610001 FORMAT "%5.3"
 /begin AXIS_DESCR COM_AXIS TCO _CNV_A_R_LINEAR_____0_CM 8 -48. 142.5 FORMAT "%5.1" AXIS_PTS_REF ldp_tco__tcoport_sp /end AXIS_DESCR
/end CHARACTERISTIC
/begin MEASUREMENT PORT_AV "actual value port flap" UWORD _CNV_A_R_LINEAR_____207_CM 1 100. 0. 99.99847412 ECU_ADDRESS 0x3fcfa0 /end MEASUREMENT
/begin MEASUREMENT FAC_PORT_DEAC "Relative dynamic position of the port flap" UWORD _CNV_A_R_LINEAR_____31_CM 1 100. 0. 0.99998474 ECU_ADDRESS 0x3fcf9e FORMAT "%7.5" /end MEASUREMENT
/begin AXIS_PTS ldp_n_32__port_sp_s "" 0x435ea N_32 _REC_AXS_20_u1 816. _CNV_A_R_LINEAR_____5_CM 6 0. 8160. FORMAT "%4.0" /end AXIS_PTS
/begin AXIS_PTS ldp_exc_sp_rel__vlft_sp "" 0x4432a EXC_SP_REL _REC_AXS_20_u2 99.99847412 _CNV_A_R_LINEAR_____94_CM 12 0. 99.99847412 /end AXIS_PTS
/begin AXIS_PTS ldp_portpwm__port_sp_phy "" 0x449b8 PORTPWM _REC_AXS_20_u2 99.99847412 _CNV_A_R_LINEAR_____94_CM 12 0. 99.99847412 /end AXIS_PTS
/begin AXIS_PTS ldp_fac_tq_req__port_sp_s "" 0x44382 FAC_TQ_REQ _REC_AXS_20_u2 1.99996948 _CNV_A_R_LINEAR_____45_CM 6 0. 1.99996948 FORMAT "%7.5" /end AXIS_PTS
/begin AXIS_PTS ldp_v_port__port_av "" 0x44d2c V_PORT _REC_AXS_20_u2 4.99511719 _CNV_A_R_LINEAR_____33_CM 12 0. 4.99511719 FORMAT "%5.3" /end AXIS_PTS
/begin AXIS_PTS ldp_tco__tcoport_sp "" 0x438c9 TCO _REC_AXS_20_u1 190.5 _CNV_A_R_LINEAR_____0_CM 8 -48. 142.5 FORMAT "%5.1" /end AXIS_PTS
/begin AXIS_PTS ldp_n_32__port_sp_afs "" 0x435e3 N_32 _REC_AXS_20_u1 816. _CNV_A_R_LINEAR_____5_CM 6 0. 8160. FORMAT "%4.0" /end AXIS_PTS
/begin AXIS_PTS ldp_n_32__port_sp_afl "" 0x435dc N_32 _REC_AXS_20_u1 816. _CNV_A_R_LINEAR_____5_CM 6 0. 8160. FORMAT "%4.0" /end AXIS_PTS
/begin AXIS_PTS ldp_fac_tq_req__port_sp_afs "" 0x44374 FAC_TQ_REQ _REC_AXS_20_u2 1.99996948 _CNV_A_R_LINEAR_____45_CM 6 0. 1.99996948 FORMAT "%7.5" /end AXIS_PTS
/begin AXIS_PTS ldp_fac_tq_req__port_sp_afl "" 0x44366 FAC_TQ_REQ _REC_AXS_20_u2 1.99996948 _CNV_A_R_LINEAR_____45_CM 6 0. 1.99996948 FORMAT "%7.5" /end AXIS_PTS
/begin MEASUREMENT LV_SAP "Flag for secondary air pump activation" UBYTE _CNV_S_2_RANGE______11_CM 1 100. 0. 1. ECU_ADDRESS 0x3fcc7d BIT_MASK 0x1 /end MEASUREMENT
/begin MEASUREMENT LV_SA_END "secondary air function ended for this cycle" UBYTE _CNV_S_2_RANGE______11_CM 1 100. 0. 1. ECU_ADDRESS 0x3fcc7f BIT_MASK 0x1 /end MEASUREMENT
/begin MEASUREMENT T_STATE_SA_ACT "Time counter which is incremented when SA function is active" UWORD _CNV_A_R_LINEAR_____27_CM 1 100. 0. 655.35 ECU_ADDRESS 0x3fddda FORMAT "%6.2" /end MEASUREMENT
/begin MEASUREMENT LV_SAWUP "secondary air injection time correction active" UBYTE _CNV_S_2_RANGE______11_CM 1 100. 0. 1. ECU_ADDRESS 0x3fcc80 BIT_MASK 0x1 /end MEASUREMENT
/begin CHARACTERISTIC C_N_MAX_SA_DEAC "Engine speed threshold to interupt SA function" VALUE 0x4295a _REC_VAL_20_u1 8160. _CNV_A_R_LINEAR_____5_CM 0. 8160. FORMAT "%4.0" /end CHARACTERISTIC
/begin CHARACTERISTIC C_N_MAX_SA_ACT "Engine speed threshold to reactivate SA function" VALUE 0x42959 _REC_VAL_20_u1 8160. _CNV_A_R_LINEAR_____5_CM 0. 8160. FORMAT "%4.0" /end CHARACTERISTIC
/begin CHARACTERISTIC IP_MAF_SA_DEAC__N_32 "MAF threshold to interupt SA function" CURVE 0x49186 _REC_CUR_20_u2_u1 1389. _CNV_A_R_LINEAR_____95_CM 0. 1389. FORMAT "%7.2"
 /begin AXIS_DESCR COM_AXIS N_32 _CNV_A_R_LINEAR_____5_CM 8 0. 8160. FORMAT "%4.0" AXIS_PTS_REF ldpm_n_32_maf_sa_deac /end AXIS_DESCR
/end CHARACTERISTIC
/begin CHARACTERISTIC IP_MAF_SA_ACT__N_32 "MAF threshold to reactivate SA function" CURVE 0x49176 _REC_CUR_20_u2_u1 1389. _CNV_A_R_LINEAR_____95_CM 0. 1389. FORMAT "%7.2"
 /begin AXIS_DESCR COM_AXIS N_32 _CNV_A_R_LINEAR_____5_CM 8 0. 8160. FORMAT "%4.0" AXIS_PTS_REF ldpm_n_32_maf_sa_act /end AXIS_DESCR
/end CHARACTERISTIC
/begin MEASUREMENT LV_SAV "Flag for secondary air valve activation" UBYTE _CNV_S_2_RANGE______11_CM 1 100. 0. 1. ECU_ADDRESS 0x3fcc7c BIT_MASK 0x1 /end MEASUREMENT
/begin MEASUREMENT CTR_REST_SA "Restart-counter for SA activation" UBYTE _CNV_A_R_LINEAR_____10_CM 1 100. 0. 255. ECU_ADDRESS 0x3fcc7b FORMAT "%3.0" /end MEASUREMENT
/begin CHARACTERISTIC C_TCO_DIF_MIN_SA "TCO threshold for incrementation the SA restart counter" VALUE 0x42a4a _REC_VAL_20_u1 190.5 _CNV_A_R_LINEAR_____1_CM 0. 190.5 FORMAT "%5.1" /end CHARACTERISTIC
/begin CHARACTERISTIC C_CTR_MAX_REST_SA "Number of permissible restarts before aborting SA normal operation" VALUE 0x4286e _REC_VAL_20_u1 255. _CNV_A_R_LINEAR_____10_CM 0. 255. FORMAT "%3.0" /end CHARACTERISTIC
/begin MEASUREMENT LV_PUC_SA_INH "inhibition of PUC during SA active for the first time" UBYTE _CNV_S_2_RANGE______11_CM 1 100. 0. 1. ECU_ADDRESS 0x3fcc81 BIT_MASK 0x1 /end MEASUREMENT
/begin CHARACTERISTIC IP_T_SA_OFF_0 "Time delay to terminate SA function" CURVE 0x4b12c _REC_CUR_20_u2_u1 655.35 _CNV_A_R_LINEAR_____27_CM 0. 655.35 FORMAT "%6.2"
 /begin AXIS_DESCR COM_AXIS TCO_ST _CNV_A_R_LINEAR_____0_CM 8 -48. 142.5 FORMAT "%5.1" AXIS_PTS_REF ldpm_tco_st_1_sair /end AXIS_DESCR
/end CHARACTERISTIC
/begin MEASUREMENT STATE_SA "State of Secondary Air Function" UBYTE _CNV_S_9_RANGE_STAT_395_CM 1 100. 0. 8. ECU_ADDRESS 0x3fcc7a /end MEASUREMENT
/begin CHARACTERISTIC C_T_DLY_SAP_OFF "Time delay for closing of SAP after SAV shut down" VALUE 0x42fa2 _REC_VAL_20_u2 655.35 _CNV_A_R_LINEAR_____27_CM 0. 655.35 FORMAT "%6.2" /end CHARACTERISTIC
/begin CHARACTERISTIC IP_T_SA_OFF_1 "Time delay to terminate SA function" CURVE 0x4b13c _REC_CUR_20_u2_u1 655.35 _CNV_A_R_LINEAR_____27_CM 0. 655.35 FORMAT "%6.2"
 /begin AXIS_DESCR COM_AXIS TCO_ST _CNV_A_R_LINEAR_____0_CM 8 -48. 142.5 FORMAT "%5.1" AXIS_PTS_REF ldpm_tco_st_1_sair /end AXIS_DESCR
/end CHARACTERISTIC
/begin CHARACTERISTIC IP_T_SA_OFF_DYN_DIAG "Time delay to teminate SA function (in reason of not complete SA diagnosis)" CURVE 0x4b14c _REC_CUR_20_u2_u1 655.35 _CNV_A_R_LINEAR_____27_CM 0. 655.35 FORMAT "%6.2"
 /begin AXIS_DESCR COM_AXIS TCO_ST _CNV_A_R_LINEAR_____0_CM 8 -48. 142.5 FORMAT "%5.1" AXIS_PTS_REF ldpm_tco_st_1_sair /end AXIS_DESCR
/end CHARACTERISTIC
/begin MEASUREMENT LV_SA "Calculations for SA functions are currently active" UBYTE _CNV_S_2_RANGE______11_CM 1 100. 0. 1. ECU_ADDRESS 0x3fcc7e BIT_MASK 0x1 /end MEASUREMENT
/begin MEASUREMENT T_DLY_SA_END "Time delay after end of secondary air injection for lambda control activation" UWORD _CNV_A_R_LINEAR_____27_CM 1 100. 0. 655.35 ECU_ADDRESS 0x3fddd6 FORMAT "%6.2" /end MEASUREMENT
/begin MEASUREMENT T_DLY_SAV_ON "Time delay for SAV activation" UWORD _CNV_A_R_LINEAR_____27_CM 1 100. 0. 655.35 ECU_ADDRESS 0x3fddd8 FORMAT "%6.2" /end MEASUREMENT
/begin MEASUREMENT T_DLY_SAP_ON "Time delay for SAP activation" UWORD _CNV_A_R_LINEAR_____27_CM 1 100. 0. 655.35 ECU_ADDRESS 0x3fddd4 FORMAT "%6.2" /end MEASUREMENT
/begin MEASUREMENT T_SA_DYN_DIAG "Time delay for secondary air deactivation in reason of  not fulfilled SA diagnosis (LV_SA_MIN_FLOW_DIAG=1)" UWORD _CNV_A_R_LINEAR_____27_CM 1 100. 0. 655.35 ECU_ADDRESS 0x3fcc78 FORMAT "%6.2" /end MEASUREMENT
/begin MEASUREMENT T_DLY_SAP_OFF "Time delay for closing of SAP after SAV shut down" UWORD _CNV_A_R_LINEAR_____27_CM 1 100. 0. 655.35 ECU_ADDRESS 0x3fdde2 FORMAT "%6.2" /end MEASUREMENT
/begin CHARACTERISTIC C_T_DLY_SA_END "Time delay after end of secondary air injection for lambda control activation" VALUE 0x42fa0 _REC_VAL_20_u2 655.35 _CNV_A_R_LINEAR_____27_CM 0. 655.35 FORMAT "%6.2" /end CHARACTERISTIC
/begin CHARACTERISTIC C_T_DLY_SAP_ON "Time delay for start of SAP " VALUE 0x42fa4 _REC_VAL_20_u2 655.35 _CNV_A_R_LINEAR_____27_CM 0. 655.35 FORMAT "%6.2" /end CHARACTERISTIC
/begin CHARACTERISTIC C_T_DLY_SAV_ON "Time delay for start of SAV" VALUE 0x42fa6 _REC_VAL_20_u2 655.35 _CNV_A_R_LINEAR_____27_CM 0. 655.35 FORMAT "%6.2" /end CHARACTERISTIC
/begin AXIS_PTS ldpm_tco_st_1_sair "" 0x4401b TCO_ST _REC_AXS_20_u1 190.5 _CNV_A_R_LINEAR_____0_CM 8 -48. 142.5 FORMAT "%5.1" /end AXIS_PTS
/begin AXIS_PTS ldpm_n_32_maf_sa_deac "" 0x43e88 N_32 _REC_AXS_20_u1 8160. _CNV_A_R_LINEAR_____5_CM 8 0. 8160. FORMAT "%4.0" /end AXIS_PTS
/begin AXIS_PTS ldpm_n_32_maf_sa_act "" 0x43e7f N_32 _REC_AXS_20_u1 8160. _CNV_A_R_LINEAR_____5_CM 8 0. 8160. FORMAT "%4.0" /end AXIS_PTS
/begin MEASUREMENT LV_FCT_LIH_SA "Secondary air function: application indices to apply a limp home for SA function" UBYTE _CNV_S_2_RANGE______11_CM 1 100. 0. 1. ECU_ADDRESS 0x3fcc8c BIT_MASK 0x1 /end MEASUREMENT
/begin MEASUREMENT FAC_T_SA_OFF "Secondary air function: actual correction factor for the sec. air activation depending on CTR_KM_CAN" UBYTE _CNV_A_R_LINEAR_____396_CM 1 100. 1. 1.99220002 ECU_ADDRESS 0x3fcc8d FORMAT "%5.3" /end MEASUREMENT
/begin CHARACTERISTIC IP_FAC_T_SA_OFF "Factor to modify the SA active-time due to catalyst age" CURVE 0x4e51d _REC_CUR_20_u1_u2 0.9922000200000001 _CNV_A_R_LINEAR_____396_CM 1. 1.99220002 FORMAT "%5.3"
 /begin AXIS_DESCR COM_AXIS CTR_KM_CAN _CNV_A_R_LINEAR_____80_CM 8 0. 655350. FORMAT "%7.0" AXIS_PTS_REF ldp_ctr_km_can /end AXIS_DESCR
/end CHARACTERISTIC
/begin AXIS_PTS ldp_ctr_km_can "" 0x44258 CTR_KM_CAN _REC_AXS_20_u2 655350. _CNV_A_R_LINEAR_____80_CM 8 0. 655350. FORMAT "%7.0" /end AXIS_PTS
/begin MEASUREMENT T_DLY_SA_ACT "Time after Start of secondary air function for very slow SAF-calculation" UWORD _CNV_A_R_LINEAR_____27_CM 1 100. 0. 655.35 ECU_ADDRESS 0x3fddce FORMAT "%6.2" /end MEASUREMENT
/begin CHARACTERISTIC C_T_DLY_SA_ACT "Delaytime after start of secondary air function for very slow SAF-calculation  " VALUE 0x42f9e _REC_VAL_20_u2 655.35 _CNV_A_R_LINEAR_____27_CM 0. 655.35 FORMAT "%6.2" /end CHARACTERISTIC
/begin CHARACTERISTIC C_CRLC_SAF_ST "Correlation constant of secondary air mass flow after the start of SA" VALUE 0x4283a _REC_VAL_20_u1 0.9960940000000002 _CNV_A_R_LINEAR_____44_CM 0. 0.996094 FORMAT "%5.3" /end CHARACTERISTIC
/begin CHARACTERISTIC IP_SAF_MDL "secondary air mass flow depending of MAF_CYL" CURVE 0x4a4a8 _REC_CUR_20_u2_u2 1023.984375 _CNV_A_R_LINEAR_____41_CM 0. 1023.984375 FORMAT "%7.2"
 /begin AXIS_DESCR COM_AXIS MAF_CYL _CNV_A_R_LINEAR_____101_CM 8 0. 2047.96875 FORMAT "%7.2" AXIS_PTS_REF ldp_maf_cyl__saf_mdl /end AXIS_DESCR
/end CHARACTERISTIC
/begin CHARACTERISTIC IP_SAF_COR_VB "correction of secondary air mass flow depending of VB" CURVE 0x4a498 _REC_CUR_20_u2_u1 1023.984375 _CNV_A_R_LINEAR_____41_CM 0. 1023.984375 FORMAT "%7.2"
 /begin AXIS_DESCR COM_AXIS VB _CNV_A_R_LINEAR_____53_CM 8 0. 26. FORMAT "%4.1" AXIS_PTS_REF ldp_vb__saf_cor_vb /end AXIS_DESCR
/end CHARACTERISTIC
/begin CHARACTERISTIC IP_SAF_COR_AMP "correction of secondary air mass flow depending of AMP" CURVE 0x4fe14 _REC_CUR_20_u1_u2 0.99610001 _CNV_A_R_LINEAR_____20_CM 0. 0.99610001 FORMAT "%5.3"
 /begin AXIS_DESCR COM_AXIS AMP _CNV_A_R_LINEAR_____43_CM 8 0. 5434. FORMAT "%7.2" AXIS_PTS_REF ldp_amp__saf_cor_amp /end AXIS_DESCR
/end CHARACTERISTIC
/begin CHARACTERISTIC C_CRLC_SAF "Correlation constant of secondary air mass flow" VALUE 0x42838 _REC_VAL_20_u1 0.9960940000000002 _CNV_A_R_LINEAR_____44_CM 0. 0.996094 FORMAT "%5.3" /end CHARACTERISTIC
/begin MEASUREMENT SAF_KGH_MDL "" UWORD _CNV_A_R_LINEAR_____41_CM 1 100. 0. 1023.984375 ECU_ADDRESS 0x3fcc6e FORMAT "%7.2" /end MEASUREMENT
/begin MEASUREMENT SAF_KGH_MDL_CLC "secondary mass air flow" UWORD _CNV_A_R_LINEAR_____41_CM 1 100. 0. 1023.984375 ECU_ADDRESS 0x3fddd0 FORMAT "%7.2" /end MEASUREMENT
/begin AXIS_PTS ldp_maf_cyl__saf_mdl "secondary air mass flow depending of MAF_CYL" 0x44520 MAF_CYL _REC_AXS_20_u2 2047.96875 _CNV_A_R_LINEAR_____101_CM 8 0. 2047.96875 FORMAT "%7.2" /end AXIS_PTS
/begin AXIS_PTS ldp_amp__saf_cor_amp "correction of secondary air mass flow depending of ambient pressure" 0x44102 AMP _REC_AXS_20_u2 5434. _CNV_A_R_LINEAR_____43_CM 8 0. 5434. FORMAT "%7.2" /end AXIS_PTS
/begin AXIS_PTS ldp_vb__saf_cor_vb "correction of secondary air mass flow depending of battery voltage" 0x43acb VB _REC_AXS_20_u1 26. _CNV_A_R_LINEAR_____53_CM 8 0. 26. FORMAT "%4.1" /end AXIS_PTS
/begin CHARACTERISTIC IP_SAF_COR_TAM "correction of secondary air mass flow depending of ambient temperature" CURVE 0x4fe1c _REC_CUR_20_u1_u1 0.99610001 _CNV_A_R_LINEAR_____20_CM 0. 0.99610001 FORMAT "%5.3"
 /begin AXIS_DESCR COM_AXIS TIA _CNV_A_R_LINEAR_____0_CM 8 -48. 142.5 FORMAT "%5.1" AXIS_PTS_REF ldp_tam_ip_saf_cor_tam /end AXIS_DESCR
/end CHARACTERISTIC
/begin AXIS_PTS ldp_tam_ip_saf_cor_tam "correction of secondary air mass flow depending of ambient temperature" 0x4382a TIA _REC_AXS_20_u1 190.5 _CNV_A_R_LINEAR_____0_CM 8 -48. 142.5 FORMAT "%5.1" /end AXIS_PTS
/begin CHARACTERISTIC C_CRLC_SAF_KGH "Correlation constant of measured secondary air mass flow" VALUE 0x42839 _REC_VAL_20_u1 0.9960940000000002 _CNV_A_R_LINEAR_____44_CM 0. 0.996094 FORMAT "%5.3" /end CHARACTERISTIC
/begin MEASUREMENT SAF_KGH_FIL "actual value of SA mass flow" UWORD _CNV_A_R_LINEAR_____41_CM 1 100. 0. 1023.984375 ECU_ADDRESS 0x3fcc70 FORMAT "%7.2" /end MEASUREMENT
/begin MEASUREMENT CONF_SWI_EFP_OUT "configuration of EFP-control" UBYTE _CNV_A_R_LINEAR_____10_CM 1 100. 0. 2. ECU_ADDRESS 0x3fcd0b FORMAT "%2.0" /end MEASUREMENT
/begin CHARACTERISTIC LC_VVL_INH_AS "logical constant for to deactivate EXC_SP_REL by application system (LC_VVL_INH_AS = 0  -> active)" VALUE 0x42bf8 _REC_VAL_20_u1 1. _CNV_A_R_LINEAR_____10_CM 0. 1. FORMAT "%2.0" /end CHARACTERISTIC
/begin CHARACTERISTIC C_CAM_SP_HYS_NEUT_IVVT_EX "" VALUE 0x42808 _REC_VAL_20_u1 60. _CNV_A_R_LINEAR_____75_CM 0. 60. FORMAT "%4.1" /end CHARACTERISTIC
/begin CHARACTERISTIC C_CAM_SP_HYS_NEUT_IVVT_IN "" VALUE 0x42809 _REC_VAL_20_u1 60. _CNV_A_R_LINEAR_____75_CM 0. 60. FORMAT "%4.1" /end CHARACTERISTIC
/begin CHARACTERISTIC C_CAM_SP_PARK_IN " Target spread for IVVT parking function shut down, inlet camshaft" VALUE 0x43230 _REC_VAL_20_s2 1535.9765625 _CNV_A_R_LINEAR_____232_CM -768. 767.9765625 FORMAT "%7.2" /end CHARACTERISTIC
/begin CHARACTERISTIC C_CAM_SP_PARK_EX " Target spread for IVVT parking function, exhaust camshaft" VALUE 0x4322e _REC_VAL_20_s2 1535.9765625 _CNV_A_R_LINEAR_____232_CM -768. 767.9765625 FORMAT "%7.2" /end CHARACTERISTIC
/begin AXIS_PTS ldpm_ctr_km_can_1 "" 0x44edc CTR_KM_CAN _REC_AXS_20_u2 655350. _CNV_A_R_LINEAR_____80_CM 4 0. 655350. FORMAT "%7.0" /end AXIS_PTS
/begin AXIS_PTS ldpm_maf_cyl_ip_rel_flow_inc_cp "" 0x450bc MAF_CYL _REC_AXS_20_u2 2047.96875 _CNV_A_R_LINEAR_____101_CM 6 0. 2047.96875 FORMAT "%6.2" /end AXIS_PTS
/begin AXIS_PTS ldpm_n_32_ip_rel_flow_max_cps "" 0x43e64 N_32 _REC_AXS_20_u1 8160. _CNV_A_R_LINEAR_____5_CM 12 0. 8160. FORMAT "%4.0" /end AXIS_PTS
/begin AXIS_PTS ldpm_n_13 "" 0x451f4 N _REC_AXS_20_u2 8160. _CNV_A_R_LINEAR_____17_CM 6 0. 8160. FORMAT "%4.0" /end AXIS_PTS
/begin AXIS_PTS ldpm_n_5 "" 0x45280 N _REC_AXS_20_u2 8160. _CNV_A_R_LINEAR_____17_CM 16 0. 8160. FORMAT "%4.0" /end AXIS_PTS
/begin AXIS_PTS ldpm_maf_ivvt_2 "" 0x45112 MAF _REC_AXS_20_u2 1389. _CNV_A_R_LINEAR_____95_CM 12 0. 1389. FORMAT "%7.2" /end AXIS_PTS
/begin CHARACTERISTIC C_CL_MMV_THD "" VALUE 0x42c5c _REC_VAL_20_u2 1.99996948 _CNV_A_R_LINEAR_____45_CM 0. 1.99996948 FORMAT "%7.5" /end CHARACTERISTIC
/begin CHARACTERISTIC C_T_ON_SAWUP "Time delay before injection time correction after STATE_SA = active" VALUE 0x43010 _REC_VAL_20_u2 655.35 _CNV_A_R_LINEAR_____27_CM 0. 655.35 FORMAT "%6.2" /end CHARACTERISTIC
/begin CHARACTERISTIC C_T_ON_SAWUP_IS "Time delay before injection time correction after STATE_SA = active in idle" VALUE 0x43012 _REC_VAL_20_u2 655.35 _CNV_A_R_LINEAR_____27_CM 0. 655.35 FORMAT "%6.2" /end CHARACTERISTIC
/begin COMPU_METHOD _CNV_A_R_LINEAR_____0_CM "" RAT_FUNC "%6.3" "°C" COEFFS 0 1.333333333333333 64. 0 0 1 /end COMPU_METHOD
/begin COMPU_METHOD _CNV_A_R_LINEAR_____1_CM "" RAT_FUNC "%6.3" "°C" COEFFS 0 1.333333333333333 0. 0 0 1 /end COMPU_METHOD
/begin COMPU_METHOD _CNV_A_R_LINEAR_____2_CM "" RAT_FUNC "%6.3" "°C" COEFFS 0 1. 0. 0 0 1 /end COMPU_METHOD
/begin COMPU_METHOD _CNV_A_R_LINEAR_____3_CM "" RAT_FUNC "%6.3" "°C" COEFFS 0 1. 40. 0 0 1 /end COMPU_METHOD
/begin COMPU_METHOD _CNV_A_R_LINEAR_____4_CM "" RAT_FUNC "%6.3" "%" COEFFS 0 2.56 0. 0 0 1 /end COMPU_METHOD
/begin COMPU_METHOD _CNV_A_R_LINEAR_____5_CM "" RAT_FUNC "%6.3" "rpm" COEFFS 0 3.125e-002 0. 0 0 1 /end COMPU_METHOD
/begin COMPU_METHOD _CNV_A_R_LINEAR_____6_CM "" RAT_FUNC "%6.3" "m" COEFFS 0 1.e-002 0. 0 0 1 /end COMPU_METHOD
/begin COMPU_METHOD _CNV_A_R_LINEAR_____7_CM "" RAT_FUNC "%6.3" "%" COEFFS 0 20.48192771084338 128.0120481927711 0 0 1 /end COMPU_METHOD
/begin COMPU_METHOD _CNV_A_R_LINEAR_____8_CM "" RAT_FUNC "%6.3" "-" COEFFS 0 1.333333333333333 128. 0 0 1 /end COMPU_METHOD
/begin COMPU_METHOD _CNV_A_R_LINEAR_____9_CM "" RAT_FUNC "%6.3" "%" COEFFS 0 2.559999357490358 127.9999678745179 0 0 1 /end COMPU_METHOD
/begin COMPU_METHOD _CNV_A_R_LINEAR_____10_CM "" RAT_FUNC "%6.3" "-" COEFFS 0 1. 0. 0 0 1 /end COMPU_METHOD
/begin COMPU_METHOD _CNV_S_2_RANGE______11_CM "" TAB_VERB "%6.3" "-" COMPU_TAB_REF _CNV_S_2_RANGE______11 /end COMPU_METHOD
/begin COMPU_VTAB _CNV_S_2_RANGE______11 "" TAB_VERB 2 0 "0" 1 "1" /end COMPU_VTAB
/begin COMPU_METHOD _CNV_A_R_LINEAR_____12_CM "" RAT_FUNC "%6.3" "[-]" COEFFS 0 1. 0. 0 0 1 /end COMPU_METHOD
/begin COMPU_METHOD _CNV_A_R_LINEAR_____13_CM "" RAT_FUNC "%6.3" "km/h" COEFFS 0 1. 0. 0 0 1 /end COMPU_METHOD
/begin COMPU_METHOD _CNV_A_R_LINEAR_____14_CM "" RAT_FUNC "%6.3" "s" COEFFS 0 10. 0. 0 0 1 /end COMPU_METHOD
/begin COMPU_METHOD _CNV_A_R_LINEAR_____17_CM "" RAT_FUNC "%6.3" "rpm" COEFFS 0 1. 0. 0 0 1 /end COMPU_METHOD
/begin COMPU_METHOD _CNV_A_R_LINEAR_____18_CM "" RAT_FUNC "%6.3" "mg/stk" COEFFS 0 0.183585313174946 0. 0 0 1 /end COMPU_METHOD
/begin COMPU_METHOD _CNV_A_R_LINEAR_____20_CM "" RAT_FUNC "%6.3" "-" COEFFS 0 255.9983911655618 0. 0 0 1 /end COMPU_METHOD
/begin COMPU_METHOD _CNV_A_R_LINEAR_____23_CM "" RAT_FUNC "%6.3" "ms" COEFFS 0 0.1 0. 0 0 1 /end COMPU_METHOD
/begin COMPU_METHOD _CNV_A_R_LINEAR_____26_CM "" RAT_FUNC "%6.3" "V" COEFFS 0 9.846168103048838 0. 0 0 1 /end COMPU_METHOD
/begin COMPU_METHOD _CNV_A_R_LINEAR_____27_CM "" RAT_FUNC "%6.3" "s" COEFFS 0 100. 0. 0 0 1 /end COMPU_METHOD
/begin COMPU_METHOD _CNV_S_2_RANGE______28_CM "" TAB_VERB "%6.3" "[-]" COMPU_TAB_REF _CNV_S_2_RANGE______28 /end COMPU_METHOD
/begin COMPU_VTAB _CNV_S_2_RANGE______28 "" TAB_VERB 2 0 "0" 1 "1" /end COMPU_VTAB
/begin COMPU_METHOD _CNV_A_R_LINEAR_____31_CM "" RAT_FUNC "%6.3" "-" COEFFS 0 65536.00007936121 0. 0 0 1 /end COMPU_METHOD
/begin COMPU_METHOD _CNV_A_R_LINEAR_____33_CM "" RAT_FUNC "%6.3" "V" COEFFS 0 204.7999998974999 0. 0 0 1 /end COMPU_METHOD
/begin COMPU_METHOD _CNV_A_R_LINEAR_____34_CM "" RAT_FUNC "%6.3" "-" COEFFS 0 127.9991955827809 0. 0 0 1 /end COMPU_METHOD
/begin COMPU_METHOD _CNV_A_R_LINEAR_____40_CM "" RAT_FUNC "%6.3" "-" COEFFS 0 16. 0. 0 0 1 /end COMPU_METHOD
/begin COMPU_METHOD _CNV_A_R_LINEAR_____41_CM "" RAT_FUNC "%6.3" "kg/h" COEFFS 0 64. 0. 0 0 1 /end COMPU_METHOD
/begin COMPU_METHOD _CNV_A_R_LINEAR_____43_CM "" RAT_FUNC "%6.3" "hPa" COEFFS 0 12.06017666543982 0. 0 0 1 /end COMPU_METHOD
/begin COMPU_METHOD _CNV_A_R_LINEAR_____44_CM "" RAT_FUNC "%6.3" "[-]" COEFFS 0 255.9999357490357 0. 0 0 1 /end COMPU_METHOD
/begin COMPU_METHOD _CNV_A_R_LINEAR_____45_CM "" RAT_FUNC "%6.3" "-" COEFFS 0 32768.00003968061 0. 0 0 1 /end COMPU_METHOD
/begin COMPU_METHOD _CNV_A_R_LINEAR_____47_CM "" RAT_FUNC "%6.3" "s" COEFFS 0 1. 0. 0 0 1 /end COMPU_METHOD
/begin COMPU_METHOD _CNV_A_R_LINEAR_____48_CM "" RAT_FUNC "%6.3" "Nm" COEFFS 0 32. 0. 0 0 1 /end COMPU_METHOD
/begin COMPU_METHOD _CNV_A_R_LINEAR_____53_CM "" RAT_FUNC "%6.3" "V" COEFFS 0 9.807692307692308 0. 0 0 1 /end COMPU_METHOD
/begin COMPU_METHOD _CNV_A_R_LINEAR_____75_CM "" RAT_FUNC "%6.3" "°CRK" COEFFS 0 2.666666666666667 0. 0 0 1 /end COMPU_METHOD
/begin COMPU_METHOD _CNV_A_R_LINEAR_____80_CM "" RAT_FUNC "%6.3" "km" COEFFS 0 0.1 0. 0 0 1 /end COMPU_METHOD
/begin COMPU_METHOD _CNV_A_R_LINEAR_____85_CM "" RAT_FUNC "%6.3" "l" COEFFS 0 1. 0. 0 0 1 /end COMPU_METHOD
/begin COMPU_METHOD _CNV_A_R_LINEAR_____94_CM "" RAT_FUNC "%6.3" "%" COEFFS 0 655.3600000071681 0. 0 0 1 /end COMPU_METHOD
/begin COMPU_METHOD _CNV_A_R_LINEAR_____95_CM "" RAT_FUNC "%6.3" "mg/stk" COEFFS 0 47.18142548596112 0. 0 0 1 /end COMPU_METHOD
/begin COMPU_METHOD _CNV_A_R_LINEAR_____97_CM "" RAT_FUNC "%6.3" "hPa" COEFFS 0 12.06017666543982 -1.759293338545831e-002 0 0 1 /end COMPU_METHOD
/begin COMPU_METHOD _CNV_A_R_LINEAR_____98_CM "" RAT_FUNC "%6.3" "%" COEFFS 0 655.3600000071681 3.584063961170614e-007 0 0 1 /end COMPU_METHOD
/begin COMPU_METHOD _CNV_A_R_LINEAR_____99_CM "" RAT_FUNC "%6.3" "kg/h" COEFFS 0 8191.999999679995 0. 0 0 1 /end COMPU_METHOD
/begin COMPU_METHOD _CNV_A_R_LINEAR_____101_CM "" RAT_FUNC "%6.3" "kg/h" COEFFS 0 32. 0. 0 0 1 /end COMPU_METHOD
/begin COMPU_METHOD _CNV_A_R_LINEAR_____103_CM "" RAT_FUNC "%6.3" "-" COEFFS 0 128. 0. 0 0 1 /end COMPU_METHOD
/begin COMPU_METHOD _CNV_S_8_RANGE_STAT_105_CM "" TAB_VERB "%6.3" "-" COMPU_TAB_REF _CNV_S_8_RANGE_STAT_105 /end COMPU_METHOD
/begin COMPU_VTAB _CNV_S_8_RANGE_STAT_105 "" TAB_VERB 8 0 "CP_NOT_ACT" 1 "NO_PURGE" 2 "MIN_PURGE" 3 "RAMP_OPEN" 4 "RAMP_OPEN_FAST" 5 "MAX_PURGE" 6 "RAMP_CLOSE" 7 "WAIT_RAMP_OPEN" /end COMPU_VTAB
/begin COMPU_METHOD _CNV_S_12_RANGE_STAT_106_CM "" TAB_VERB "%6.3" "-" COMPU_TAB_REF _CNV_S_12_RANGE_STAT_106 /end COMPU_METHOD
/begin COMPU_VTAB _CNV_S_12_RANGE_STAT_106 "" TAB_VERB 12 0 "CP_NO_TRA" 1 "MIN_PURGE_TO_NO_PURGE" 2 "NO_PURGE_TO_MIN_PURGE" 3 "RAMP_OPEN_TO_NO_PURGE" 4 "RAMP_OPEN_TO_MIN_PURGE" 5 "RAMP_OPEN_FAST_TO_NO_PURGE" 6 "RAMP_OPEN_FAST_TO_MIN_PURGE" 7 "MAX_PURGE_TO_NO_PURGE" 8 "MAX_PURGE_TO_MIN_PURGE" 9 "RAMP_CLOSE_TO_NO_PURGE" 10 "WAIT_RAMP_OPEN_TO_NO_PURGE" 11 "WAIT_RAMP_OPEN_TO_MIN_PURGE" /end COMPU_VTAB
/begin COMPU_METHOD _CNV_S_3_RANGE_STAT_107_CM "" TAB_VERB "%6.3" "-" COMPU_TAB_REF _CNV_S_3_RANGE_STAT_107 /end COMPU_METHOD
/begin COMPU_VTAB _CNV_S_3_RANGE_STAT_107 "" TAB_VERB 3 0 "CP_NO_DEAC" 1 "RAMP_OPEN_DEAC" 2 "MAX_PURGE_DEAC" /end COMPU_VTAB
/begin COMPU_METHOD _CNV_A_R_LINEAR_____108_CM "" RAT_FUNC "%6.3" "[-]" COEFFS 0 32769.4989394353 0. 0 0 1 /end COMPU_METHOD
/begin COMPU_METHOD _CNV_A_R_LINEAR_____109_CM "" RAT_FUNC "%6.3" "[-]" COEFFS 0 8191.999999679995 0. 0 0 1 /end COMPU_METHOD
/begin COMPU_METHOD _CNV_A_R_LINEAR_____110_CM "" RAT_FUNC "%6.3" "kg/h" COEFFS 0 8191.999999679995 -1.280019205296412e-006 0 0 1 /end COMPU_METHOD
/begin COMPU_METHOD _CNV_A_R_LINEAR_____111_CM "" RAT_FUNC "%6.3" "-" COEFFS 0 255.9999997499962 0. 0 0 1 /end COMPU_METHOD
/begin COMPU_METHOD _CNV_A_R_LINEAR_____112_CM "" RAT_FUNC "%6.3" "-" COEFFS 0 65551.06000970239 0. 0 0 1 /end COMPU_METHOD
/begin COMPU_METHOD _CNV_A_R_LINEAR_____113_CM "" RAT_FUNC "%6.3" "-" COEFFS 0 16383.75 0. 0 0 1 /end COMPU_METHOD
/begin COMPU_METHOD _CNV_A_R_LINEAR_____114_CM "" RAT_FUNC "%6.3" "s" COEFFS 0 255.9999357490357 0. 0 0 1 /end COMPU_METHOD
/begin COMPU_METHOD _CNV_A_R_LINEAR_____115_CM "" RAT_FUNC "%6.3" "Hz" COEFFS 0 1. 0. 0 0 1 /end COMPU_METHOD
/begin COMPU_METHOD _CNV_A_R_LINEAR_____117_CM "" RAT_FUNC "%6.3" "%" COEFFS 0 2.56 128. 0 0 1 /end COMPU_METHOD
/begin COMPU_METHOD _CNV_A_R_LINEAR_____143_CM "" RAT_FUNC "%6.3" "%" COEFFS 0 655.3600000071681 32768.00000035841 0 0 1 /end COMPU_METHOD
/begin COMPU_METHOD _CNV_A_R_LINEAR_____155_CM "" RAT_FUNC "%6.3" "h" COEFFS 0 35999.99999497086 0. 0 0 1 /end COMPU_METHOD
/begin COMPU_METHOD _CNV_A_R_LINEAR_____160_CM "" RAT_FUNC "%6.3" "°C" COEFFS 0 0.25 8.25 0 0 1 /end COMPU_METHOD
/begin COMPU_METHOD _CNV_A_R_LINEAR_____161_CM "" RAT_FUNC "%6.3" "%/200ms" COEFFS 0 10.2 0. 0 0 1 /end COMPU_METHOD
/begin COMPU_METHOD _CNV_A_R_LINEAR_____162_CM "" RAT_FUNC "%6.3" "s" COEFFS 0 5. -1. 0 0 1 /end COMPU_METHOD
/begin COMPU_METHOD _CNV_S_6_RANGE_STAT_164_CM "" TAB_VERB "%6.3" "-" COMPU_TAB_REF _CNV_S_6_RANGE_STAT_164 /end COMPU_METHOD
/begin COMPU_VTAB _CNV_S_6_RANGE_STAT_164 "" TAB_VERB 6 0 "EFP_OFF" 1 "EFP_ON_DLY" 2 "EFP_ON" 3 "EFP_OFF_DLY" 4 "EFP_EXT_ADJ" 5 "EFP_CRASH" /end COMPU_VTAB
/begin COMPU_METHOD _CNV_A_R_LINEAR_____165_CM "" RAT_FUNC "%6.3" "%" COEFFS 0 2.551020408163265 0. 0 0 1 /end COMPU_METHOD
/begin COMPU_METHOD _CNV_A_R_LINEAR_____166_CM "" RAT_FUNC "%6.3" "l/h" COEFFS 0 1. 0. 0 0 1 /end COMPU_METHOD
/begin COMPU_METHOD _CNV_A_R_LINEAR_____167_CM "" RAT_FUNC "%6.3" "1/s^2" COEFFS 0 100.5832246182181 2.916123092290945e-003 0 0 1 /end COMPU_METHOD
/begin COMPU_METHOD _CNV_A_R_LINEAR_____168_CM "" RAT_FUNC "%6.3" "-" COEFFS 0 127.5100401606426 0.4899598393574252 0 0 1 /end COMPU_METHOD
/begin COMPU_METHOD _CNV_A_R_LINEAR_____169_CM "" RAT_FUNC "%6.3" "s" COEFFS 0 50. 0. 0 0 1 /end COMPU_METHOD
/begin COMPU_METHOD _CNV_A_R_LINEAR_____170_CM "" RAT_FUNC "%6.3" "-" COEFFS 0 7379.793318491542 0. 0 0 1 /end COMPU_METHOD
/begin COMPU_METHOD _CNV_A_R_LINEAR_____171_CM "" RAT_FUNC "%6.3" "cm²" COEFFS 0 1118.481084425738 0. 0 0 1 /end COMPU_METHOD
/begin COMPU_METHOD _CNV_A_R_LINEAR_____172_CM "" RAT_FUNC "%6.3" "%" COEFFS 0 327.6800000071683 0. 0 0 1 /end COMPU_METHOD
/begin COMPU_METHOD _CNV_A_R_LINEAR_____173_CM "" RAT_FUNC "%6.3" "%" COEFFS 0 327.680000003584 3.584063961170614e-007 0 0 1 /end COMPU_METHOD
/begin COMPU_METHOD _CNV_A_R_LINEAR_____174_CM "" RAT_FUNC "%6.3" "%/V" COEFFS 0 819.2000030400465 0. 0 0 1 /end COMPU_METHOD
/begin COMPU_METHOD _CNV_A_R_LINEAR_____175_CM "" RAT_FUNC "%6.3" "1/s^2" COEFFS 0 100.5832246182181 32768.00291612309 0 0 1 /end COMPU_METHOD
/begin COMPU_METHOD _CNV_A_R_LINEAR_____176_CM "" RAT_FUNC "%6.3" "%" COEFFS 0 327.680000003584 32768.00000035841 0 0 1 /end COMPU_METHOD
/begin COMPU_METHOD _CNV_A_R_LINEAR_____177_CM "" RAT_FUNC "%6.3" "V" COEFFS 0 204.7999995887937 0. 0 0 1 /end COMPU_METHOD
/begin COMPU_METHOD _CNV_A_R_LINEAR_____189_CM "" RAT_FUNC "%6.3" "%" COEFFS 0 10.23017902813299 0. 0 0 1 /end COMPU_METHOD
/begin COMPU_METHOD _CNV_A_R_LINEAR_____190_CM "" RAT_FUNC "%6.3" "hPa" COEFFS 0 0.3768805207949945 0. 0 0 1 /end COMPU_METHOD
/begin COMPU_METHOD _CNV_A_R_LINEAR_____191_CM "" RAT_FUNC "%6.3" "hPa" COEFFS 0 0.3768805207949945 1.251092653546948e-003 0 0 1 /end COMPU_METHOD
/begin COMPU_METHOD _CNV_A_R_LINEAR_____192_CM "" RAT_FUNC "%6.3" "g/s" COEFFS 0 43.36306609142162 0. 0 0 1 /end COMPU_METHOD
/begin COMPU_METHOD _CNV_A_R_LINEAR_____193_CM "" RAT_FUNC "%6.3" "[-]" COEFFS 0 65535. 0. 0 0 1 /end COMPU_METHOD
/begin COMPU_METHOD _CNV_A_R_LINEAR_____194_CM "" RAT_FUNC "%6.3" "hPa" COEFFS 0 0.3768805207949945 32768.00125109265 0 0 1 /end COMPU_METHOD
/begin COMPU_METHOD _CNV_A_R_LINEAR_____195_CM "" RAT_FUNC "%6.3" "[-]" COEFFS 0 64. 0. 0 0 1 /end COMPU_METHOD
/begin COMPU_METHOD _CNV_A_R_LINEAR_____196_CM "" RAT_FUNC "%6.3" "%/hPa" COEFFS 0 443478.2608695653 0. 0 0 1 /end COMPU_METHOD
/begin COMPU_METHOD _CNV_A_R_LINEAR_____197_CM "" RAT_FUNC "%6.3" "mg" COEFFS 0 5.89767818574514 0. 0 0 1 /end COMPU_METHOD
/begin COMPU_METHOD _CNV_S_6_STATE_FUP_198_CM "" TAB_VERB "%6.3" "[-]" COMPU_TAB_REF _CNV_S_6_STATE_FUP_198 /end COMPU_METHOD
/begin COMPU_VTAB _CNV_S_6_STATE_FUP_198 "" TAB_VERB 6 0 "Low pressure state" 1 "Fast pressure increase" 2 "Pressure_control" 3 "Over_pressure" 4 "Limp_home" 5 "Crash event" /end COMPU_VTAB
/begin COMPU_METHOD _CNV_S_9_STATE_FUP__199_CM "" TAB_VERB "%6.3" "[-]" COMPU_TAB_REF _CNV_S_9_STATE_FUP__199 /end COMPU_METHOD
/begin COMPU_VTAB _CNV_S_9_STATE_FUP__199 "" TAB_VERB 9 0 "Crash" 1 "LP" 2 "LP-FPln" 3 "FPln-PCtl" 4 "Lih" 5 "PCtl-OvP" 6 "OvP-PCtl" 7 "Lih_PCtl" 8 "PCtl-FPln" /end COMPU_VTAB
/begin COMPU_METHOD _CNV_A_R_LINEAR_____207_CM "" RAT_FUNC "%6.3" "°PORT" COEFFS 0 655.3600000071681 0. 0 0 1 /end COMPU_METHOD
/begin COMPU_METHOD _CNV_A_R_LINEAR_____214_CM "" RAT_FUNC "%6.3" "Nm" COEFFS 0 8191.999999679995 -1.280019205296412e-006 0 0 1 /end COMPU_METHOD
/begin COMPU_METHOD _CNV_A_R_LINEAR_____215_CM "" RAT_FUNC "%6.3" "rpm/s" COEFFS 0 3.125e-002 0. 0 0 1 /end COMPU_METHOD
/begin COMPU_METHOD _CNV_A_R_LINEAR_____221_CM "" RAT_FUNC "%6.3" "s" COEFFS 0 32. 0. 0 0 1 /end COMPU_METHOD
/begin COMPU_METHOD _CNV_A_R_LINEAR_____225_CM "" RAT_FUNC "%6.3" "Nm" COEFFS 0 2097152.000003239 3.316402435302734e-003 0 0 1 /end COMPU_METHOD
/begin COMPU_METHOD _CNV_A_R_LINEAR_____230_CM "" RAT_FUNC "%6.3" "°CRK/10ms" COEFFS 0 42.66666666666666 0. 0 0 1 /end COMPU_METHOD
/begin COMPU_METHOD _CNV_A_R_LINEAR_____231_CM "" RAT_FUNC "%6.3" "°CRK" COEFFS 0 -2.666666666666667 -106.6666666666667 0 0 1 /end COMPU_METHOD
/begin COMPU_METHOD _CNV_A_R_LINEAR_____232_CM "" RAT_FUNC "%6.3" "°CRK" COEFFS 0 42.66666666666666 0. 0 0 1 /end COMPU_METHOD
/begin COMPU_METHOD _CNV_A_R_LINEAR_____233_CM "" RAT_FUNC "%6.3" "-" COEFFS 0 32. 128. 0 0 1 /end COMPU_METHOD
/begin COMPU_METHOD _CNV_A_R_LINEAR_____234_CM "" RAT_FUNC "%6.3" "°CRK" COEFFS 0 2.666666666666667 -160. 0 0 1 /end COMPU_METHOD
/begin COMPU_METHOD _CNV_A_R_LINEAR_____240_CM "" RAT_FUNC "%6.3" "-" COEFFS 0 32. 0. 0 0 1 /end COMPU_METHOD
/begin COMPU_METHOD _CNV_A_R_LINEAR_____369_CM "" RAT_FUNC "%6.3" "1/min/s" COEFFS 0 3.125e-002 0. 0 0 1 /end COMPU_METHOD
/begin COMPU_METHOD _CNV_A_R_LINEAR_____376_CM "" RAT_FUNC "%6.3" "Nm/rpm" COEFFS 0 8191.999999679995 0. 0 0 1 /end COMPU_METHOD
/begin COMPU_METHOD _CNV_A_R_LINEAR_____377_CM "" RAT_FUNC "%6.3" "Nm/rpm" COEFFS 0 32. 0. 0 0 1 /end COMPU_METHOD
/begin COMPU_METHOD _CNV_A_R_LINEAR_____378_CM "" RAT_FUNC "%6.3" "rpm" COEFFS 0 3.125e-002 128. 0 0 1 /end COMPU_METHOD
/begin COMPU_METHOD _CNV_A_R_LINEAR_____387_CM "" RAT_FUNC "%6.3" "mm" COEFFS 0 1000. 0. 0 0 1 /end COMPU_METHOD
/begin COMPU_METHOD _CNV_S_9_RANGE_STAT_395_CM "" TAB_VERB "%6.3" "[-]" COMPU_TAB_REF _CNV_S_9_RANGE_STAT_395 /end COMPU_METHOD
/begin COMPU_VTAB _CNV_S_9_RANGE_STAT_395 "" TAB_VERB 9 0 "SA_INACTIVE" 1 "SA_DELAY" 2 "SA_ACTIVE" 3 "INTERRUPT" 4 "SAP_DELAY" 5 "FINISHED" 6 "CANCELLED" 7 "EXT_ADJ" 8 "EXT_ADJ_FIN" /end COMPU_VTAB
/begin COMPU_METHOD _CNV_A_R_LINEAR_____396_CM "" RAT_FUNC "%6.3" "-" COEFFS 0 257.0046309815635 -257.0046309815635 0 0 1 /end COMPU_METHOD
/begin RECORD_LAYOUT _REC_VAL_20_u1 FNC_VALUES 1 UBYTE COLUMN_DIR DIRECT /end RECORD_LAYOUT
/begin RECORD_LAYOUT _REC_MAP_20_u1_u1_u1 FNC_VALUES 1 UBYTE COLUMN_DIR DIRECT /end RECORD_LAYOUT
/begin RECORD_LAYOUT _REC_AXS_20_u1 NO_AXIS_PTS_X 1 UBYTE AXIS_PTS_X 2 UBYTE INDEX_INCR DIRECT /end RECORD_LAYOUT
/begin RECORD_LAYOUT _REC_CUR_20_u1_u1 FNC_VALUES 1 UBYTE COLUMN_DIR DIRECT /end RECORD_LAYOUT
/begin RECORD_LAYOUT _REC_MAP_20_u2_u2_u1 FNC_VALUES 1 UWORD COLUMN_DIR DIRECT /end RECORD_LAYOUT
/begin RECORD_LAYOUT _REC_AXS_20_u2 NO_AXIS_PTS_X 1 UWORD AXIS_PTS_X 2 UWORD INDEX_INCR DIRECT /end RECORD_LAYOUT
/begin RECORD_LAYOUT _REC_CUR_20_u2_u2 FNC_VALUES 1 UWORD COLUMN_DIR DIRECT /end RECORD_LAYOUT
/begin RECORD_LAYOUT _REC_VAL_20_u2 FNC_VALUES 1 UWORD COLUMN_DIR DIRECT /end RECORD_LAYOUT
/begin RECORD_LAYOUT _REC_CUR_20_u2_u1 FNC_VALUES 1 UWORD COLUMN_DIR DIRECT /end RECORD_LAYOUT
/begin RECORD_LAYOUT _REC_MAP_20_u1_u1_u2 FNC_VALUES 1 UBYTE COLUMN_DIR DIRECT /end RECORD_LAYOUT
/begin RECORD_LAYOUT _REC_CUR_20_u1_u2 FNC_VALUES 1 UBYTE COLUMN_DIR DIRECT /end RECORD_LAYOUT
/begin RECORD_LAYOUT _REC_MAP_20_u2_u1_u1 FNC_VALUES 1 UWORD COLUMN_DIR DIRECT /end RECORD_LAYOUT
/begin RECORD_LAYOUT _REC_MAP_20_u2_u1_u2 FNC_VALUES 1 UWORD COLUMN_DIR DIRECT /end RECORD_LAYOUT
/begin RECORD_LAYOUT _REC_VAL_20_s2 FNC_VALUES 1 SWORD COLUMN_DIR DIRECT /end RECORD_LAYOUT
/begin RECORD_LAYOUT _REC_MAP_20_u1_u2_u2 FNC_VALUES 1 UBYTE COLUMN_DIR DIRECT /end RECORD_LAYOUT
/begin RECORD_LAYOUT _REC_VAL_20_s1 FNC_VALUES 1 SBYTE COLUMN_DIR DIRECT /end RECORD_LAYOUT
/begin RECORD_LAYOUT _REC_MAP_20_u1_u2_u1 FNC_VALUES 1 UBYTE COLUMN_DIR DIRECT /end RECORD_LAYOUT
/begin FUNCTION AUX_Auxiliary_Functions "AUX"
 /begin SUB_FUNCTION AUX_Blocking_of_the_air_conditio AUX_Engine_speed_limitation_cont AUX_Electrical_fuel_pump_control AUX_Electronically_controled_the AUX_Fuel_pressure_control AUX_Evaporative_emission_control AUX_Disa AUX_IVVT_setpoint_coordination AUX_Exhaust_gas_recirculation AUX_Control_of_electric_fan AUX_Secondary_air AUX_Determination_of_secondary_a AUX_Port_Deactivation_Setpoint_C AUX_Power_Management AUX_Calculating_the_pulse_width_ AUX_Coil_substitute_temperature AUX_Calculation_of_delay AUX_IVVT_Controller AUX_Adaptation_of_reference_and_ AUX_Infinitely_variable_valve_ti AUX_Exhaust_flap_actuation AUX_IVVT_application_Incidences AUX_Starter_Relay_Control AUX_E_box_cooling_fan AUX_Electrical_fuel_pump_Interfa AUX_IVVT_setpoint_for_homogeneou AUX_IVVT_setpoint_for_stratified AUX_Application_incidences_for_t AUX_Sound_Flap_Control AUX_Coordination_of_secondary_ai AUX_Electronically_controlled_ra AUX_Flow_Calculations___Evaporat AUX_Time_Control_between_lambda_ AUX_Canister_Purge_ON_OFF_Valve_ AUX_Variable_Intake_Manifold AUX_QLT_SENSOR AUX_Application_incidences_for_E AUX_Mastershift /end SUB_FUNCTION
/end FUNCTION
/begin FUNCTION AUX_Blocking_of_the_air_conditio "_Blocking of the air conditioner compressor"
 /begin DEF_CHARACTERISTIC C_VS_MAX_ACCIN C_ACCIN_DLY_1 C_ACCIN_DLY_1_LOCK_FL C_ACCIN_DLY_4 C_PVS_FL_ACCIN C_ACCIN_DLY_5 C_TCO_MAX_ACCIN IP_T_ACC_ON__N_32 IP_T_ACC_OFF__N_32 C_TCO_MAX_ACCIN_HYS /end DEF_CHARACTERISTIC
 /begin OUT_MEASUREMENT LV_ACCOUT_RLY_ENA LV_ACCOUT_RLY T_ACC_ON T_ACC_OFF /end OUT_MEASUREMENT
/end FUNCTION
/begin FUNCTION AUX_Engine_speed_limitation_cont "_Engine speed limitation controller"
 /begin DEF_CHARACTERISTIC C_ADD_N_MAX_FCUT C_N_GRD_HYS C_TQI_MAX_PAS C_CRLC_N_GRD_FIL_1 C_CRLC_N_GRD_FIL_2 C_TQI_N_MAX_INC ID_FAC_N_MAX_I_AT__GEAR ID_FAC_N_MAX_P_MT__GEAR ID_FAC_N_MAX_I_MT__GEAR ID_FAC_N_MAX_P_AT__GEAR ID_T_N_MAX_PRED_AT__GEAR ID_T_N_MAX_PRED_MT__GEAR IP_N_GRD_THD__N_32 C_N_LIM_MIN /end DEF_CHARACTERISTIC
 /begin OUT_MEASUREMENT LV_N_MAX_REQ_FCUT N_DIF_MAX_LIM N_PRED_MAX_LIM TQ_N_MAX_DIF TQ_N_MAX_DIF_I TQ_N_MAX_DIF_P TQ_N_MAX_INP_I TQI_N_MAX TQI_N_MAX_REF N_GRD_FIL N_GRD_FIL_FIL TQI_N_MAX_1 TQI_N_MAX_2 LV_N_MAX N_MAX TRT_N_MAX CTR_N_MAX CTR_KM_N_MAX N_GRD_N_MAX VS_N_MAX PV_AV_N_MAX GEAR_EF_N_MAX LV_CS_N_MAX T_SUM_N_MAX T_N_MAX NR_PAT_SCC_N_MAX /end OUT_MEASUREMENT
/end FUNCTION
/begin FUNCTION AUX_Electrical_fuel_pump_control "_Electrical fuel pump control"
 /begin DEF_CHARACTERISTIC C_VB_EFP_REF C_T_EFP LC_LEVEL_ON_EFP IP_T_EFP_AST_MAX IP_VFF_EFP_FL IP_VFF_VEPU_FTL IP_VFF_VEPU_FTL_DIF C_T_EFP_PREV C_CRLC_FCO_DIF /end DEF_CHARACTERISTIC
 /begin OUT_MEASUREMENT T_DLY_EFP STATE_EFP EFPPWM VFF_EFP VFF_VEPU_ADD_EFP VFF_VEPU_FCO_AV FTL_DIF FCO_DIF FCO_DIF_MMV CONF_SWI_EFP_OUT /end OUT_MEASUREMENT
/end FUNCTION
/begin FUNCTION AUX_Electronically_controled_the "_Electronically controled thermostat"
 /begin DEF_CHARACTERISTIC C_TCO_BOL_ECT C_TCO_EX_HYS_ECT C_TCO_EX_MAX_ECT C_TCO_MIN_ECT C_TCO_SP_TCO_EX_MAX C_TCO_SP_TIA_MAX C_TCO_SP_TOIL_MIN C_TIA_HYS_ECT C_TOIL_HYS_ECT C_TOIL_MIN_ECT ID_ECTPWM_ADD IP_DIST_MIN IP_ECTPWM_I IP_ECTPWM_P C_TOIL_MAX_ECT ID_TCO_SP_ECT__N__PV_MAX ID_TCO_SP_ECT_ACIN__N__PV_MAX C_TIA_MAX_ECT C_TCO_TEMP_GB_1 C_TCO_TEMP_GB_2 C_ECTPWM_MAN LC_ECTPWM_MAN ldp_n_32__ectpwm_add ldp_tco_dif__ectpwm_i ldp_tco_dif__ectpwm_p ldp_tco_sp__ectpwm_add ldp_tco_st__dist ldpm_pv_max_1 /end DEF_CHARACTERISTIC
 /begin OUT_MEASUREMENT TCO_SP ECTPWM /end OUT_MEASUREMENT
/end FUNCTION
/begin FUNCTION AUX_Fuel_pressure_control "_Fuel pressure control"
 /begin DEF_CHARACTERISTIC IP_FUP_SP_HOM IP_FAC_FUP_SP_PCTL IP_FUP_SP_S IP_FUP_SP_ST IP_FPAPWM_BAS IP_FPAPWM IP_FAC_FPAPWM_BAS IP_FAC_FPAPWM_P IP_FAC_FPAPWM IP_FAC_FPAPWM_I IP_FPAPWM_I IP_FPAPWM_P IP_FPAPWM_MAX C_FPAPWM_MIN C_FPAPWM_MIN_2 C_FAC_FUP_FPAPWM C_FPA_MFF_MIN_AD C_FPAPWM_I_MIN C_FPAPWM_I_MAX C_FPAPWM_I_AD_MIN C_FPAPWM_I_AD_MAX C_FPA_MFF_DIF_AD C_FUP_DIF_AD C_FUP_SP_AST_LGRD C_FUP_SP_PCTL_CRLC C_FUP_SP_CRLC C_FUP_SP_MAX C_N_FUP_AD_MIN C_N_FUP_AD_MAX C_TQ_FUP_AD_MIN C_TQ_FUP_AD_MAX C_FPAPWM_MAN_ACT LC_FUP_SP_MAN_ACT LC_FPAPWM_MAN_ACT C_FUP_SP_MAN_ACT C_FPA_MFF_MIN C_FPA_MFF_INI C_MFP C_FPAPWM_MAX C_FPAPWM_FRQ_STND C_T_DLY_FPAPWM_AD C_FPAPWM_I_AD C_FPAPWM_DIF_AD C_T_DLY_FUP /end DEF_CHARACTERISTIC
 /begin OUT_MEASUREMENT FRQ_REQ_FPA FPAPWM FPAPWM_BAS FPAPWM_P FPAPWM_I_AD FPAPWM_I FPAPWM_LIM FUP_SP_DLY FUP_SP_FIL FUP_SP_LGRD FUP_SP FUP_SP_PCTL FUP_DIF_DLY FPA_MFF_MEM FPA_MFF FPAPWM_MEM LV_FPAPWM_AD_AUTH LV_FPAPWM_LIM T_DLY_FPAPWM_AD LV_FPAPWM_AD STATE_FUP FUP_DIF LV_FPAPWM_AD_INH LV_DLY_FPA_CLL_REQ TFPA STATE_FUP_TRAN /end OUT_MEASUREMENT
/end FUNCTION
/begin FUNCTION AUX_Evaporative_emission_control "_Evaporative emission control"
 /begin DEF_CHARACTERISTIC C_PRS_MAX_2_CPS C_T_DI_RAMP_OPEN_CP C_T_DI_MAX_CP C_T_DLY_CP C_T_DLY_MAX_CP C_FUEL_FAC_CP C_CL_MAX_CP C_CL_DYW_MAX_CP C_CL_ST_CP C_LAM_DIF_MAX_CP C_REL_FLOW_INI_CPS C_T_DLY_MAX_RAMP_OPEN C_CL_MMV_DYW C_FLOW_MIN_CPS C_DIF_MAX_TI_LAM_CP C_DIF_MIN_TI_LAM_CP C_T_DLY_REQ_CP LC_INIT_CL_CRLC LC_LAM_CBK_CPS IP_REL_FLOW_INC_CP__MAF_CYL IP_REL_FLOW_FAC_CP__CL IP_CL_CRLC_RAMP_OPEN__MAF_CYL IP_CL_CRLC_OPEN_FAST__MAF_CYL IP_CL_CRLC__MAF_CYL IP_REL_FLOW_DEC_CP__MAF_CYL IP_REL_FLOW_MAX_CPS__N_32__MAF IP_REL_FLOW_MIN_CPS__N_32__MAF IP_REL_FLOW_INC_2_CP__MAF_CYL IP_REL_FLOW_DEC_V1_CP__MAF_CYL IP_REL_FLOW_DEC_V2_CP__MAF_CYL IP_T_DLY_CL_MMV_DYW__MAF_CYL IP_NR_STEP_CL__CL_MMV IP_CL_CRLC_INIT__CL_MMV IP_REL_FUEL_FLOW_MAX_CP_COR IP_REL_FLOW_MAX_OPEN_CPS IP_REL_FUEL_FLOW_MAX_CP C_CL_MMV_THD /end DEF_CHARACTERISTIC
 /begin OUT_MEASUREMENT STATE_CP STATE_TRA_CP STATE_NORM_DEAC_CP REL_FLOW_OPEN_CPS REL_FLOW_MAX_CPS REL_FLOW_CPS REL_FLOW_CPS_DI REL_FLOW_CPS_OLD REL_FLOW_CPS_OLD_DI LAM_DIF_CP FUEL_FLOW_MAX_CP FUEL_FLOW_CP CL CL_MMV CL_MMV_DI CL_MMV_OLD CL_MMV_OLD_DI CL_MMV_NORM_PURGE_END LAM_0_CP LAM_CP LV_RAMP_CLOSE_END LV_RAMP_OPEN_ACT LV_MAX_PURGE_ACT FUEL_FLOW_ADD_AD_CP T_DLY_MAX_CP FUEL_FLOW_LAM_CP LV_TRA_LAM_CP CL_MMV_DYW_MIN CL_MMV_DYW_MAX LV_T_RAMP_OPEN_END LV_MIN_PURGE_STAB_ACT LV_T_DLY_REQ_CP LAM_ADJ_CP LV_LAM_ADJ_CP /end OUT_MEASUREMENT
/end FUNCTION
/begin FUNCTION AUX_Disa "_Disa" /end FUNCTION
/begin FUNCTION AUX_IVVT_setpoint_coordination "_IVVT setpoint coordination"
 /begin DEF_CHARACTERISTIC C_LGRD_CAM_SP_VO_INC C_LGRD_CAM_SP_VO_DEC IP_CAM_SP_2_EX_IS__N__MAF_IVVT C_CAM_SP_AS_EX C_CAM_SP_AS_IN C_CAM_SP_DIF_MAX C_LGRD_CAM_SP_TRA C_T_CAM_SP_LGRD IP_FAC_CAM_IN_IS__TCO_TCO_ST IP_CAM_SP_2_EX_FL__N IP_FAC_CAM_IN_PL__TCO_TCO_ST IP_CAM_SP_2_EX_PL__N__MAF_IVVT IP_CAM_SP_2_IN_FL__N IP_CAM_SP_1_EX_FL__N IP_CAM_SP_2_IN_IS__N__MAF_IVVT IP_CAM_SP_2_IN_PL__N__MAF_IVVT IP_CAM_SP_1_EX_PL__N__MAF_IVVT IP_CAM_SP_1_IN_FL__N IP_FAC_CAM_EX_IS__TCO_TCO_ST IP_FAC_CAM_EX_PL__TCO_TCO_ST IP_CAM_SP_1_IN_PL__N__MAF_IVVT IP_CAM_SP_1_EX_IS__N__MAF_IVVT IP_CAM_SP_1_IN_IS__N__MAF_IVVT IP_CAM_SP_CH_IN IP_CAM_SP_CH_DRI_IN IP_CAM_SP_CH_EX IP_CAM_SP_CH_DRI_EX IP_FAC_CAM_SP_CH_KM C_T_DRI_CH_IVVT IP_FAC_CAM_SP_CH_OPP C_T_RAMP_CH_IVVT ID_CMB_IVVT IP_PV_MAX_FL_IVVT__N C_CAM_SP_HYS_NEUT_IVVT_EX C_CAM_SP_HYS_NEUT_IVVT_IN C_CAM_SP_PARK_IN C_CAM_SP_PARK_EX /end DEF_CHARACTERISTIC
 /begin OUT_MEASUREMENT LV_PVS_FL_IVVT T_CAM_SP_ACT FAC_CH_IVVT_DRI FAC_DEAC_CH_IVVT FAC_IVVT_SP_CH CAM_SP_IVVT_IN CAM_SP_PARK_IN CAM_SP_IVVT_IN_LIM CAM_SP_IVVT_IN_HYS CAM_SP_AV_IN CAM_SP_AV_IN_HOM CAM_SP_AV_LGRD_IN LV_TRAN_IVVT_IN FAC_CAM_IN_IS FAC_CAM_IN_PL CAM_SP_REF_IN CAM_SP_1_IN_HOM CAM_SP_IVVT_EX CAM_SP_PARK_EX CAM_SP_IVVT_EX_LIM CAM_SP_IVVT_EX_HYS CAM_SP_AV_EX CAM_SP_AV_EX_HOM CAM_SP_AV_LGRD_EX LV_TRAN_IVVT_EX FAC_CAM_EX_IS FAC_CAM_EX_PL CAM_SP_REF_EX CAM_SP_1_EX_HOM /end OUT_MEASUREMENT
/end FUNCTION
/begin FUNCTION AUX_Exhaust_gas_recirculation "_Exhaust gas recirculation"
 /begin DEF_CHARACTERISTIC C_TCO_MIN_EGR C_T_AST_EGR C_ER_STND_CRLC C_ER_DIF_MAX_CRLC C_FAC_ER_NEG C_MAF_EGR_AD_POS_BOL C_MAF_EGR_AD_POS_TOL C_N_EGR_AD_POS_TOL C_MAF_EGR_AD_BOL C_MAF_EGR_AD_TOL C_N_EGR_AD_POS_BOL C_N_EGR_AD_BOL C_N_EGR_AD_TOL C_T_EGR_RATIO_AD_POS C_EGR_RATIO_AD_CRLC C_ER_EGR_CTR_TOL C_EGR_RATIO_SP_AD_MIN C_PSI_SP_MIN_EGR C_EGR_THR_TOL C_EGR_THR_BOL C_EGR_THR_LGRD_STOP C_V_AD_SLOP_EGR C_EGRPWM_MAX_POS C_EGRPWM_MAX_NEG C_EGRPWM_I_MAX_NEG C_EGRPWM_I_MAX_POS C_T_EGR_DLY1 C_T_EGR_DLY2 C_EGRPWM_DFT C_EGRPWM_OVL_LIM IP_EGR_RATIO_HOM__MAF__N_32 IP_EGR_RATIO_S IP_EGR_RATIO_MIN__MAF__N_32 IP_FAC_TCO_EGR__TCO IP_ER_STD_THD__MAF__N_32 IP_EGR_RATIO_INC__MAF_CYL IP_EGR_ADD_NEG__ER_EGR IP_ER_EGR_CTR_INC__ER_EGR IP_STK_SP_EGR__AR_RED_SP_EGR IP_EGRPWM_PREV__STK_SP_EGR IP_EGRPWM_P__STK_DIF_EGR IP_EGRPWM_I__STK_DIF_EGR C_FAC_ER_POS IP_EGR_RATIO_LGRD__MAF_CYL C_V_AD_DYW_EGR C_DLY_AD_BOL_EGR C_V_AD_MIN_BOL_EGR C_V_AD_MAX_BOL_EGR C_V_AD_INI_BOL_EGR /end DEF_CHARACTERISTIC
 /begin OUT_MEASUREMENT LV_EGR_ACT ER_STND_DIF_0 ER_STND_DIF_1 ER_STND_DIF_2 ER_STND_DIF_3 ER_STND_DIF_4 ER_STND_DIF_5 ER_STND_MMV_0 ER_STND_MMV_1 ER_STND_MMV_2 ER_STND_MMV_3 ER_STND_MMV_4 ER_STND_MMV_5 ER_STD_0 ER_STD_1 ER_STD_2 ER_STD_3 ER_STD_4 ER_STD_5 EGR_RATIO_SP ER_STD_MAX ER_DIF_MAX ER_EGR FAC_EGR_RATIO EGR_RATIO_AD_MEM EGR_RATIO_ADD_AD ER_EGR_CTR T_EGR_RATIO_AD_POS MAF_SP_EGR PSI_SP_EGR AR_RED_SP_EGR EGRPWM_PREV STK_DIF_EGR EGRPWM_I EGRPWM_P EGRPWM_TMP EGRPWM STATE_OVL_EGR STK_SP_EGR_TMP STK_SP_EGR V_AD_BOL_EGR AD_BOL_EGR /end OUT_MEASUREMENT
/end FUNCTION
/begin FUNCTION AUX_Control_of_electric_fan "_Control of electric fan"
 /begin DEF_CHARACTERISTIC ID_ECFPWM_IGK_OFF__TEMP_CAT_ IP_N_ECF_TEMP_CAT_ ID_N_ECF_MIN_ACCIN_ IP_TEMP_SUB_ECF_INI_ IP_N_PERC_ECF_ C_TCO_HYS_CAT C_CRLC_INC_CAT_ECF_ C_CRLC_DEC_CAT_ECF_ C_N_ECF_HYS C_N_PERC_ECF_LGRD C_T_N_PERC_ECF_AS C_T_N_PERC_ECF_ACT C_T_N_ECF_AST C_ECFPWM_MAX C_N_PERC_ACT_ECF C_ECFPWM_ACT_ECF C_TCO_EX_MAX_VS_HYS C_TCO_EX_MAX_VS IP_N_ECF C_VB_ECF_GRD_MAX C_VB_ECF IP_N_ECF_VS_COR_ IP_N_ECF_TEMP_GB C_TOIL_HYS_CAT C_N_ECF_TEMP_GB_MAX C_ECFPWM_MIN C_ECFPWM_ECF_MAN LC_ECFPWM_ECF_MAN /end DEF_CHARACTERISTIC
 /begin OUT_MEASUREMENT TEMP_MMV_SUB_CAT_ECF TEMP_MMV_SUB_CAT_ECF_STOP ECFPWM_ECF N_ECF_MIN_HYS N_ECF_COR N_PERC ECFPWM_IGK_OFF N_ECF_COR_FIL N_ECF_TEMP_GB_MAX /end OUT_MEASUREMENT
/end FUNCTION
/begin FUNCTION AUX_Secondary_air "_Secondary air"
 /begin DEF_CHARACTERISTIC C_N_MAX_SA_DEAC C_N_MAX_SA_ACT IP_MAF_SA_DEAC__N_32 IP_MAF_SA_ACT__N_32 C_TCO_DIF_MIN_SA C_CTR_MAX_REST_SA IP_T_SA_OFF_0 C_T_DLY_SAP_OFF IP_T_SA_OFF_1 IP_T_SA_OFF_DYN_DIAG C_T_DLY_SA_END C_T_DLY_SAP_ON C_T_DLY_SAV_ON IP_FAC_T_SA_OFF C_T_ON_SAWUP C_T_ON_SAWUP_IS /end DEF_CHARACTERISTIC
 /begin OUT_MEASUREMENT LV_SAP LV_SA_END T_STATE_SA_ACT LV_SAWUP LV_SAV CTR_REST_SA LV_PUC_SA_INH STATE_SA LV_SA T_DLY_SA_END T_DLY_SAV_ON T_DLY_SAP_ON T_SA_DYN_DIAG T_DLY_SAP_OFF LV_FCT_LIH_SA FAC_T_SA_OFF /end OUT_MEASUREMENT
/end FUNCTION
/begin FUNCTION AUX_Determination_of_secondary_a "_Determination of secondary air mass flow"
 /begin DEF_CHARACTERISTIC C_T_DLY_SA_ACT C_CRLC_SAF_ST IP_SAF_MDL IP_SAF_COR_VB IP_SAF_COR_AMP C_CRLC_SAF IP_SAF_COR_TAM C_CRLC_SAF_KGH /end DEF_CHARACTERISTIC
 /begin OUT_MEASUREMENT T_DLY_SA_ACT SAF_KGH_MDL SAF_KGH_MDL_CLC SAF_KGH_FIL /end OUT_MEASUREMENT
/end FUNCTION
/begin FUNCTION AUX_Port_Deactivation_Setpoint_C "_Port Deactivation Setpoint Calculation"
 /begin DEF_CHARACTERISTIC IP_VLFT_SP__EXC_SP_REL IP_PORT_SP_PHY__PORTPWM IP_PORT_SP_RGN_NT IP_PORT_AV__V_PORT C_TCO_MIN_PORT C_CRLC_PORT_SP C_EXC_SP_INI C_PORTPWM_INI LC_PORT_INH_AS IP_PORT_SP_S IP_PORT_SP_AFS IP_PORT_SP_AFL IP_FAC_TCO_PORT_SP LC_VVL_INH_AS /end DEF_CHARACTERISTIC
 /begin OUT_MEASUREMENT PORTPWM PORT_SP VLFT_SP PORT_SP_PHY PORT_SP_RAW EXC_SP_REL PORT_AV FAC_PORT_DEAC /end OUT_MEASUREMENT
/end FUNCTION
/end MODULE
/end PROJECT
/* -------------------------------------------------------------------------
ETAS - Data Declaration System (DDS)
Quality FE<0> NCE<0> E<615> W<934>
Quantity Maps <1636> Parameter<3066> Axes<1005> Online<6844>
------------------------------------------------------------------------- */
