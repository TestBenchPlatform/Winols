ASAP2_VERSION 1 31
/begin PROJECT MS45 "BMW Motorsteuerung R6"
/begin HEADER "_default_HeaderComment" PROJECT_NO _52 /end HEADER
/begin MODULE _default_ModuleName "_default_ModuleLongIdentifier"
/begin MOD_COMMON "_default_ModCommonComment" DEPOSIT ABSOLUTE BYTE_ORDER MSB_FIRST ALIGNMENT_BYTE 1 ALIGNMENT_WORD 2 ALIGNMENT_LONG 4 ALIGNMENT_FLOAT32_IEEE 4 ALIGNMENT_FLOAT64_IEEE 8 /end MOD_COMMON
/begin CHARACTERISTIC LC_SOF_CONF "Configuration switch for activation logic of sound flap (0 = normal,  1 = inverted)" VALUE 0x42bc4 _REC_VAL_20_u1 1. _CNV_A_R_LINEAR_____12_CM 0. 1. FORMAT "%1.0" /end CHARACTERISTIC
/begin MEASUREMENT V_TPS_GAIN_1 "Actual value of amplified TPS-channel 1" UWORD _CNV_A_R_LINEAR_____33_CM 1 100. 0. 4.99511719 ECU_ADDRESS 0x3fccd0 FORMAT "%5.3" /end MEASUREMENT
/begin CHARACTERISTIC C_T_MAX_REST "Time delay after switching on from LV_ST to detect LV_REST" VALUE 0x42a0c _REC_VAL_20_u1 25.4 _CNV_A_R_LINEAR_____47_CM 1. 255. FORMAT "%4.0" /end CHARACTERISTIC
/begin CHARACTERISTIC C_TCO_DIF_MAX_REST "Coolant temperature threshold to detect LV_REST" VALUE 0x42a49 _REC_VAL_20_u1 0.6 _CNV_A_R_LINEAR_____1_CM 0. 60. FORMAT "%4.1" /end CHARACTERISTIC
/begin MEASUREMENT T_AST "Time after start" UWORD _CNV_A_R_LINEAR_____14_CM 1 100. 0. 6553.5 ECU_ADDRESS 0x3fcdee FORMAT "%6.1" /end MEASUREMENT
/begin MEASUREMENT LV_REST "Auxiliary function \"Re-start\"" UBYTE _CNV_S_2_RANGE______28_CM 1 100. 0. 1. ECU_ADDRESS 0x3fcdf4 BIT_MASK 0x1 /end MEASUREMENT
/begin MEASUREMENT CYC_CAST "cycle counter at start and after start" UWORD _CNV_A_R_LINEAR_____10_CM 1 100. 0. 65535. ECU_ADDRESS 0x3fcdf2 FORMAT "%5.0" /end MEASUREMENT
/begin MEASUREMENT T_ST_ES "Time after transition from LV_ST to LV_ES" UWORD _CNV_A_R_LINEAR_____14_CM 1 100. 0.1 6553.5 ECU_ADDRESS 0x3fe2fe FORMAT "%6.1" /end MEASUREMENT
/begin CHARACTERISTIC C_T_MIN_ECU_REST "Time threshold to detect new start after start-break off." VALUE 0x43004 _REC_VAL_20_u2 6553.400000000001 _CNV_A_R_LINEAR_____14_CM 0.1 6553.5 FORMAT "%6.1" /end CHARACTERISTIC
/begin CHARACTERISTIC C_CYC_CAST_MIN_ST_ES "Min value of CYC_CAST for the detection of  LV_ST_ES" VALUE 0x42cb6 _REC_VAL_20_u2 65535. _CNV_A_R_LINEAR_____10_CM 0. 65535. FORMAT "%5.0" /end CHARACTERISTIC
/begin MEASUREMENT LV_ST_ES "Detection of engine start break off (passive / active)" UBYTE _CNV_S_2_RANGE______28_CM 1 100. 0. 1. ECU_ADDRESS 0x3fe2fa /end MEASUREMENT
/begin MEASUREMENT LV_STALL "Auxiliary function \"Engine Stall detected\"" UBYTE _CNV_S_2_RANGE______28_CM 1 100. 0. 1. ECU_ADDRESS 0x3fcdf5 /end MEASUREMENT
/begin MEASUREMENT T_AST_REST "After start time for re-start" UWORD _CNV_A_R_LINEAR_____14_CM 1 100. 0. 6553.5 ECU_ADDRESS 0x3fcdf0 FORMAT "%6.1" /end MEASUREMENT
/begin CHARACTERISTIC C_CYC_CAST_MAX_ST_ES "Max value of CYC_CAST for the beginning of  incrementation if LV_ST_ES is set" VALUE 0x42cb4 _REC_VAL_20_u2 65535. _CNV_A_R_LINEAR_____10_CM 0. 65535. FORMAT "%5.0" /end CHARACTERISTIC
/begin CHARACTERISTIC C_N_MAX_FL_DLY "Maximum engine speed for Full load recognition" VALUE 0x42951 _REC_VAL_20_u1 8160. _CNV_A_R_LINEAR_____5_CM 0. 8160. FORMAT "%4.0" /end CHARACTERISTIC
/begin CHARACTERISTIC C_N_MIN_FL_DLY "Minimum engine speed for Full load recognition" VALUE 0x42963 _REC_VAL_20_u1 8160. _CNV_A_R_LINEAR_____5_CM 0. 8160. FORMAT "%4.0" /end CHARACTERISTIC
/begin CHARACTERISTIC C_T_MAX_FL_DLY "Time after Start- Threshold value for Full load recognition" VALUE 0x42ff0 _REC_VAL_20_u2 6553.5 _CNV_A_R_LINEAR_____14_CM 0. 6553.5 FORMAT "%5.1" /end CHARACTERISTIC
/begin CHARACTERISTIC C_T_TI_DLY_FL_2 "Delay time Full load" VALUE 0x4303c _REC_VAL_20_u2 655.35 _CNV_A_R_LINEAR_____27_CM 0. 655.35 FORMAT "%6.2" /end CHARACTERISTIC
/begin CHARACTERISTIC C_T_TI_DLY_FL_AT_1 "Delay time Full load AT" VALUE 0x4303e _REC_VAL_20_u2 655.35 _CNV_A_R_LINEAR_____27_CM 0. 655.35 FORMAT "%6.2" /end CHARACTERISTIC
/begin CHARACTERISTIC C_T_TI_DLY_FL_AT_2 "Delay time Full load AT" VALUE 0x43040 _REC_VAL_20_u2 655.35 _CNV_A_R_LINEAR_____27_CM 0. 655.35 FORMAT "%6.2" /end CHARACTERISTIC
/begin CHARACTERISTIC C_TCO_MIN_FL "Minimum temperature for FL" VALUE 0x42a6d _REC_VAL_20_u1 28.575 _CNV_A_R_LINEAR_____0_CM -48. 142.5 FORMAT "%5.1" /end CHARACTERISTIC
/begin CHARACTERISTIC C_VS_MIN_FL "Minimum velocity for FL" VALUE 0x42b39 _REC_VAL_20_u1 25.5 _CNV_A_R_LINEAR_____13_CM 0. 255. FORMAT "%3.0" /end CHARACTERISTIC
/begin MEASUREMENT LV_FL_RAW "LV condition a) is fullfilled" UBYTE _CNV_S_2_RANGE______28_CM 1 100. 0. 1. ECU_ADDRESS 0x3fcdf7 /end MEASUREMENT
/begin MEASUREMENT LV_TI_RIS "Basic function \"Reactivation fuel feed at idle\"" UBYTE _CNV_S_2_RANGE______11_CM 1 100. 0. 1. ECU_ADDRESS 0x3fcdf9 /end MEASUREMENT
/begin MEASUREMENT LV_TI_RPU "Basic function \"Reactivation fuel feed at trailing throttle\"" UBYTE _CNV_S_2_RANGE______11_CM 1 100. 0. 1. ECU_ADDRESS 0x3fcdfa /end MEASUREMENT
/begin MEASUREMENT LV_TI_RPL "Basic function \"Reactivation fuel feed at part load\"" UBYTE _CNV_S_2_RANGE______11_CM 1 100. 0. 1. ECU_ADDRESS 0x3fcdfb /end MEASUREMENT
/begin MEASUREMENT LV_TI_RAE "Basic function \"Reactivation fuel feed at acceleration enrichment\"" UBYTE _CNV_S_2_RANGE______11_CM 1 100. 0. 1. ECU_ADDRESS 0x3fcdfc /end MEASUREMENT
/begin MEASUREMENT LV_FL "Basic function FL" UBYTE _CNV_S_2_RANGE______11_CM 1 100. 0. 1. ECU_ADDRESS 0x3fcdf6 BIT_MASK 0x1 /end MEASUREMENT
/begin CHARACTERISTIC C_N_MIN_FL "Minimum engine speed for FL" VALUE 0x42962 _REC_VAL_20_u1 816. _CNV_A_R_LINEAR_____5_CM 0. 8160. FORMAT "%4.0" /end CHARACTERISTIC
/begin CHARACTERISTIC C_T_MIN_FL_DLY "Time after Start- Threshold for Full load recognition" VALUE 0x43006 _REC_VAL_20_u2 6553.5 _CNV_A_R_LINEAR_____14_CM 0. 6553.5 FORMAT "%5.1" /end CHARACTERISTIC
/begin MEASUREMENT LV_INF "Basic function \" Intercept \"" UBYTE _CNV_S_2_RANGE______28_CM 1 100. 0. 1. ECU_ADDRESS 0x3fcdf8 BIT_MASK 0x1 /end MEASUREMENT
/begin MEASUREMENT LV_TI_REAC "Basic function \"Reactivation fuel feed\"" UBYTE _CNV_S_2_RANGE______11_CM 1 100. 0. 1. ECU_ADDRESS 0x3fe303 /end MEASUREMENT
/begin CHARACTERISTIC C_T_TI_DLY_FL_1 "Delay time Full load" VALUE 0x4303a _REC_VAL_20_u2 655.35 _CNV_A_R_LINEAR_____27_CM 0. 655.35 FORMAT "%6.2" /end CHARACTERISTIC
/begin CHARACTERISTIC C_N_MIN_CP_FL "Minimum engine speed for FL at high canister purge load" VALUE 0x42960 _REC_VAL_20_u1 8160. _CNV_A_R_LINEAR_____5_CM 0. 8160. FORMAT "%4.0" /end CHARACTERISTIC
/begin CHARACTERISTIC C_CL_MMV_THD_FL "threshold for high canister load" VALUE 0x42c5e _REC_VAL_20_u2 1.99996948 _CNV_A_R_LINEAR_____45_CM 0. 1.99996948 FORMAT "%7.5" /end CHARACTERISTIC
/begin CHARACTERISTIC IP_PV_MAX_FL__N "PWG-demand for Full load recognition" CURVE 0x4fdb5 _REC_CUR_20_u1_u2 9.9609375 _CNV_A_R_LINEAR_____4_CM 0. 99.609375 FORMAT "%5.2"
 /begin AXIS_DESCR COM_AXIS N _CNV_A_R_LINEAR_____17_CM 16 0. 8160. FORMAT "%4.0" AXIS_PTS_REF ldpm_n_2_3 /end AXIS_DESCR
/end CHARACTERISTIC
/begin AXIS_PTS ldpm_n_2_3 "" 0x45250 N _REC_AXS_20_u2 816. _CNV_A_R_LINEAR_____17_CM 16 0. 8160. FORMAT "%4.0" /end AXIS_PTS
/begin MEASUREMENT CYC_CTR_EFP_DIAG "counter of not received EFP messages" UBYTE _CNV_A_R_LINEAR_____10_CM 1 100. 0. 255. ECU_ADDRESS 0x3fd8d9 FORMAT "%3.0" /end MEASUREMENT
/begin CHARACTERISTIC C_EFP_CYCNR_MAX "maximumnumber of missing EFP messages for error debounce counter increment" VALUE 0x4288e _REC_VAL_20_u1 254. _CNV_A_R_LINEAR_____10_CM 1. 255. FORMAT "%3.0" /end CHARACTERISTIC
/begin MEASUREMENT LV_TI_CH "Auxiliary Function \" Catalyst Heating Injection\"." UBYTE _CNV_S_2_RANGE______28_CM 1 100. 0. 1. ECU_ADDRESS 0x3fce02 BIT_MASK 0x1 /end MEASUREMENT
/begin MEASUREMENT LV_CH "Auxiliary Function \" Catalyst Heating Spark\"." UBYTE _CNV_S_2_RANGE______11_CM 1 100. 0. 1. ECU_ADDRESS 0x3fce01 BIT_MASK 0x1 /end MEASUREMENT
/begin MEASUREMENT LV_CH_TQ_ADD "Catalyst Heating Function \"torque reserve\" (late ignition angle)" UBYTE _CNV_S_2_RANGE______11_CM 1 100. 0. 1. ECU_ADDRESS 0x3fcdfd BIT_MASK 0x1 /end MEASUREMENT
/begin MEASUREMENT LV_CH_TQ_ADD_IS "Catalyst Heating Function \"torque reserve for first idle phases\"" UBYTE _CNV_S_2_RANGE______11_CM 1 100. 0. 1. ECU_ADDRESS 0x3fcdfe BIT_MASK 0x1 /end MEASUREMENT
/begin MEASUREMENT LV_CH_N_SP_IS "Catalyst Heating Function \"increased idle speed setpoint\"" UBYTE _CNV_S_2_RANGE______11_CM 1 100. 0. 1. ECU_ADDRESS 0x3fcdff BIT_MASK 0x1 /end MEASUREMENT
/begin MEASUREMENT LV_CH_IVVT "Catalyst Heating Function \"increased valve overlap\"" UBYTE _CNV_S_2_RANGE______11_CM 1 100. 0. 1. ECU_ADDRESS 0x3fce00 BIT_MASK 0x1 /end MEASUREMENT
/begin CHARACTERISTIC IP_T_CH_TQ_ADD "Activation time for CAT heating function 'IGA'" MAP 0x4a56c _REC_MAP_20_u2_u1_u2 6553.5 _CNV_A_R_LINEAR_____14_CM 0. 6553.5 FORMAT "%6.1"
 /begin AXIS_DESCR COM_AXIS TCO _CNV_A_R_LINEAR_____0_CM 8 -48. 142.5 FORMAT "%5.1" AXIS_PTS_REF ldpm_tco_2 /end AXIS_DESCR
 /begin AXIS_DESCR COM_AXIS CTR_KM_CAN _CNV_A_R_LINEAR_____80_CM 4 0. 655350. FORMAT "%7.0" AXIS_PTS_REF ldpm_ctr_km_can_1 /end AXIS_DESCR
/end CHARACTERISTIC
/begin CHARACTERISTIC IP_T_CH_TQ_ADD_IS "Activation time for CAT heating function 'IGA at first idle phases'" MAP 0x4a5ac _REC_MAP_20_u2_u1_u2 6553.5 _CNV_A_R_LINEAR_____14_CM 0. 6553.5 FORMAT "%6.1"
 /begin AXIS_DESCR COM_AXIS TCO _CNV_A_R_LINEAR_____0_CM 8 -48. 142.5 FORMAT "%5.1" AXIS_PTS_REF ldpm_tco_2 /end AXIS_DESCR
 /begin AXIS_DESCR COM_AXIS CTR_KM_CAN _CNV_A_R_LINEAR_____80_CM 4 0. 655350. FORMAT "%7.0" AXIS_PTS_REF ldpm_ctr_km_can_1 /end AXIS_DESCR
/end CHARACTERISTIC
/begin CHARACTERISTIC IP_T_CH_N_SP_IS "Activation time for CAT heating function 'idle speed setpoint'" MAP 0x4a52c _REC_MAP_20_u2_u1_u2 6553.5 _CNV_A_R_LINEAR_____14_CM 0. 6553.5 FORMAT "%6.1"
 /begin AXIS_DESCR COM_AXIS TCO _CNV_A_R_LINEAR_____0_CM 8 -48. 142.5 FORMAT "%5.1" AXIS_PTS_REF ldpm_tco_2 /end AXIS_DESCR
 /begin AXIS_DESCR COM_AXIS CTR_KM_CAN _CNV_A_R_LINEAR_____80_CM 4 0. 655350. FORMAT "%7.0" AXIS_PTS_REF ldpm_ctr_km_can_1 /end AXIS_DESCR
/end CHARACTERISTIC
/begin CHARACTERISTIC ID_T_CH_TI "Activation time after start to switch on the injection time correction for catalyst heating" CURVE 0x45e74 _REC_CUR_20_u2_u1 6553.5 _CNV_A_R_LINEAR_____14_CM 0. 6553.5 FORMAT "%6.1"
 /begin AXIS_DESCR COM_AXIS TCO _CNV_A_R_LINEAR_____0_CM 8 -48. 142.5 FORMAT "%5.1" AXIS_PTS_REF ldpm_tco_2 /end AXIS_DESCR
/end CHARACTERISTIC
/begin CHARACTERISTIC C_VS_MAX_CH_IVVT "Threshold for temporary abortion of CAT heating function 'VANOS'" VALUE 0x42b29 _REC_VAL_20_u1 255. _CNV_A_R_LINEAR_____13_CM 0. 255. FORMAT "%3.0" /end CHARACTERISTIC
/begin MEASUREMENT LV_WUP "Warm up functions active" UBYTE _CNV_S_2_RANGE______11_CM 1 100. 0. 1. ECU_ADDRESS 0x3fce03 BIT_MASK 0x1 /end MEASUREMENT
/begin CHARACTERISTIC IP_T_CH_IVVT "Activation time for CAT heating function 'VANOS'" MAP 0x4a4ec _REC_MAP_20_u2_u1_u2 6553.5 _CNV_A_R_LINEAR_____14_CM 0. 6553.5 FORMAT "%6.1"
 /begin AXIS_DESCR COM_AXIS TCO _CNV_A_R_LINEAR_____0_CM 8 -48. 142.5 FORMAT "%5.1" AXIS_PTS_REF ldpm_tco_2 /end AXIS_DESCR
 /begin AXIS_DESCR COM_AXIS CTR_KM_CAN _CNV_A_R_LINEAR_____80_CM 4 0. 655350. FORMAT "%7.0" AXIS_PTS_REF ldpm_ctr_km_can_1 /end AXIS_DESCR
/end CHARACTERISTIC
/begin CHARACTERISTIC C_VS_MAX_CH_TQ_ADD_IS "Threshold for final abortion of CAT heating functions 'IGA at first idle phases' and 'VANOS'" VALUE 0x42b2b _REC_VAL_20_u1 255. _CNV_A_R_LINEAR_____13_CM 0. 255. FORMAT "%3.0" /end CHARACTERISTIC
/begin CHARACTERISTIC C_VS_MAX_CH_N_SP_IS "Threshold for final abortion of CAT heating functions 'Catalyst heating increased idle speed setpoint'" VALUE 0x42b2a _REC_VAL_20_u1 255. _CNV_A_R_LINEAR_____13_CM 0. 255. FORMAT "%3.0" /end CHARACTERISTIC
/begin AXIS_PTS ldpm_tco_2 "" 0x43f6d TCO _REC_AXS_20_u1 190.5 _CNV_A_R_LINEAR_____0_CM 8 -48. 142.5 FORMAT "%5.1" /end AXIS_PTS
/begin MEASUREMENT LV_DCC_OFF_ECU "Irreversible DCC error" UBYTE _CNV_S_2_RANGE______28_CM 1 100. 0. 1. ECU_ADDRESS 0x3fd02b /end MEASUREMENT
/begin MEASUREMENT T_DCC_BRAKE_DET "Brake delay timer" UBYTE _CNV_A_R_LINEAR_____27_CM 1 100. 0. 2.55 ECU_ADDRESS 0x3fd02c FORMAT "%4.2" /end MEASUREMENT
/begin CHARACTERISTIC C_T_MAX_BRAKE_DET_DCC "Maximum Brake delay timer" VALUE 0x42a07 _REC_VAL_20_u1 2.55 _CNV_A_R_LINEAR_____27_CM 0. 2.55 FORMAT "%4.2" /end CHARACTERISTIC
/begin CHARACTERISTIC C_T_V_DMTL_MAX_DIAG "bounce time for recognise short to battery" VALUE 0x42a31 _REC_VAL_20_u1 0.254 _CNV_A_R_LINEAR_____27_CM 1.e-002 2.55 FORMAT "%4.2" /end CHARACTERISTIC
/begin CHARACTERISTIC C_V_DMTL_MAX_DIAG "threshold voltage to recognise short to battery" VALUE 0x43120 _REC_VAL_20_u2 0.4995117190000001 _CNV_A_R_LINEAR_____33_CM 0. 4.99511719 FORMAT "%5.3" /end CHARACTERISTIC
/begin MEASUREMENT T_V_DMTL_MAX_DIAG "debouince time" UBYTE _CNV_A_R_LINEAR_____27_CM 1 100. 0. 2.55 ECU_ADDRESS 0x3fe622 FORMAT "%4.2" /end MEASUREMENT
/begin MEASUREMENT LV_MU_INH_PWL_TRAN_ES_EL "LV request to shut off MU, POINT OF NO RETURN, for ECU shut down" UBYTE _CNV_S_2_RANGE______28_CM 1 100. 0. 1. ECU_ADDRESS 0x3fccfc /end MEASUREMENT
/begin MEASUREMENT LV_ES "Engine operating state \"Engine stopped\"" UBYTE _CNV_S_2_RANGE______28_CM 1 100. 0. 1. ECU_ADDRESS 0x3fce07 BIT_MASK 0x1 /end MEASUREMENT
/begin MEASUREMENT LV_ST "Engine operating state \"Start\"" UBYTE _CNV_S_2_RANGE______11_CM 1 100. 0. 1. ECU_ADDRESS 0x3fce08 BIT_MASK 0x1 /end MEASUREMENT
/begin MEASUREMENT LV_ST_END "Engine operating state \"Start\" not active" UBYTE _CNV_S_2_RANGE______28_CM 1 100. 0. 1. ECU_ADDRESS 0x3fce09 BIT_MASK 0x1 /end MEASUREMENT
/begin CHARACTERISTIC IP_CYC_CAST__TCO "Cycle counter to define the duration of the start phase characterised by LV_ST" CURVE 0x46416 _REC_CUR_20_u2_u1 65535. _CNV_A_R_LINEAR_____10_CM 0. 65535. FORMAT "%5.0"
 /begin AXIS_DESCR COM_AXIS TCO _CNV_A_R_LINEAR_____0_CM 9 -48. 142.5 FORMAT "%5.1" AXIS_PTS_REF ldpm_tco_9 /end AXIS_DESCR
/end CHARACTERISTIC
/begin MEASUREMENT LV_IS "Engine operating state \"Idle Speed\"" UBYTE _CNV_S_2_RANGE______28_CM 1 100. 0. 1. ECU_ADDRESS 0x3fce0a BIT_MASK 0x1 /end MEASUREMENT
/begin CHARACTERISTIC C_N_DIF_MAX_IS "Engine speed hysteresis before Idle Speed (LV_IS)" VALUE 0x42ea4 _REC_VAL_20_u2 408. _CNV_A_R_LINEAR_____17_CM 0. 8160. FORMAT "%4.0" /end CHARACTERISTIC
/begin CHARACTERISTIC C_N_MAX_BOL_ST "Engine speed threshold to detect LV_ST or LV_PL from LV_IS" VALUE 0x4294e _REC_VAL_20_u1 408. _CNV_A_R_LINEAR_____5_CM 0. 8160. FORMAT "%4.0" /end CHARACTERISTIC
/begin MEASUREMENT LV_PL "Engine operating state „Part Load\"" UBYTE _CNV_S_2_RANGE______28_CM 1 100. 0. 1. ECU_ADDRESS 0x3fce0b BIT_MASK 0x1 /end MEASUREMENT
/begin MEASUREMENT LV_PU "Engine operating state \"Trailing throttle\"" UBYTE _CNV_S_2_RANGE______28_CM 1 100. 0. 1. ECU_ADDRESS 0x3fce0c BIT_MASK 0x1 /end MEASUREMENT
/begin MEASUREMENT T_PU "Time elapsed into LV_PU" UWORD _CNV_A_R_LINEAR_____27_CM 1 100. 0. 655.35 ECU_ADDRESS 0x3fce04 FORMAT "%5.2" /end MEASUREMENT
/begin CHARACTERISTIC C_T_MIN_PU "Minimum delay time of PUC activation after entry of PU" VALUE 0x43008 _REC_VAL_20_u2 655.35 _CNV_A_R_LINEAR_____27_CM 0. 655.35 FORMAT "%6.2" /end CHARACTERISTIC
/begin CHARACTERISTIC C_T_MAX_PU "Maximum delay time of PUC activation after entry of PU" VALUE 0x42ff2 _REC_VAL_20_u2 655.35 _CNV_A_R_LINEAR_____27_CM 0. 655.35 FORMAT "%6.2" /end CHARACTERISTIC
/begin CHARACTERISTIC LC_INH_DT_PU "Manual inhibition bit for deactivation drivetrain impact for controlling transition to PUC" VALUE 0x42b8a _REC_VAL_20_u1 1. _CNV_S_2_RANGE______28_CM 0. 1. /end CHARACTERISTIC
/begin CHARACTERISTIC C_T_MIN_PU_MSR "Minimum delay time of PUC activation after MSR" VALUE 0x4300a _REC_VAL_20_u2 655.35 _CNV_A_R_LINEAR_____27_CM 0. 655.35 FORMAT "%6.2" /end CHARACTERISTIC
/begin CHARACTERISTIC C_T_MIN_PU_RNG_L "Minimum delay time of PUC activation after entry of PU for LV_RNG_L =1" VALUE 0x4300c _REC_VAL_20_u2 655.35 _CNV_A_R_LINEAR_____27_CM 0. 655.35 FORMAT "%6.2" /end CHARACTERISTIC
/begin MEASUREMENT LV_PUC "engine operating state \"trailing throttle fuel cut off \"" UBYTE _CNV_S_2_RANGE______28_CM 1 100. 0. 1. ECU_ADDRESS 0x3fce0d BIT_MASK 0x1 /end MEASUREMENT
/begin CHARACTERISTIC ID_N_HYS_MAX_PUC__GR_AT "Engine speed hysteresis set entering LV_PUC" CURVE 0x4cdd0 _REC_CUR_20_u1_u1 8160. _CNV_A_R_LINEAR_____5_CM 0. 8160. FORMAT "%4.0"
 /begin AXIS_DESCR COM_AXIS GR_AT _CNV_A_R_LINEAR_____10_CM 13 0. 255. FORMAT "%3.0" AXIS_PTS_REF ldpm_gr_at_3 /end AXIS_DESCR
/end CHARACTERISTIC
/begin CHARACTERISTIC ID_N_HYS_MAX_PUC__GR_MT "Engine speed hysteresis set entering LV_PUC" CURVE 0x4cddd _REC_CUR_20_u1_u1 8160. _CNV_A_R_LINEAR_____5_CM 0. 8160. FORMAT "%4.0"
 /begin AXIS_DESCR COM_AXIS GR_MT _CNV_A_R_LINEAR_____10_CM 13 0. 255. FORMAT "%3.0" AXIS_PTS_REF ldpm_gr_mt_3 /end AXIS_DESCR
/end CHARACTERISTIC
/begin CHARACTERISTIC ID_N_HYS_MIN_PUC__GR_AT "Engine speed hysteresis reset when C_CYCNR_HYS_PUC_xx achieved" CURVE 0x4cdea _REC_CUR_20_u1_u1 8160. _CNV_A_R_LINEAR_____5_CM 0. 8160. FORMAT "%4.0"
 /begin AXIS_DESCR COM_AXIS GR_AT _CNV_A_R_LINEAR_____10_CM 13 0. 255. FORMAT "%3.0" AXIS_PTS_REF ldpm_gr_at_3 /end AXIS_DESCR
/end CHARACTERISTIC
/begin CHARACTERISTIC ID_N_HYS_MIN_PUC__GR_MT "Engine speed hysteresis reset when C_CYCNR_HYS_PUC_xx achieved" CURVE 0x4cdf7 _REC_CUR_20_u1_u1 8160. _CNV_A_R_LINEAR_____5_CM 0. 8160. FORMAT "%4.0"
 /begin AXIS_DESCR COM_AXIS GR_MT _CNV_A_R_LINEAR_____10_CM 13 0. 255. FORMAT "%3.0" AXIS_PTS_REF ldpm_gr_mt_3 /end AXIS_DESCR
/end CHARACTERISTIC
/begin CHARACTERISTIC ID_N_HYS_PUC_ST__GR_AT "Engine speed hysteresis set entering LV_PUC in cold condition" CURVE 0x4ce04 _REC_CUR_20_u1_u1 8160. _CNV_A_R_LINEAR_____5_CM 0. 8160. FORMAT "%4.0"
 /begin AXIS_DESCR COM_AXIS GR_AT _CNV_A_R_LINEAR_____10_CM 13 0. 255. FORMAT "%3.0" AXIS_PTS_REF ldpm_gr_at_3 /end AXIS_DESCR
/end CHARACTERISTIC
/begin CHARACTERISTIC ID_N_HYS_PUC_ST__GR_MT "Engine speed hysteresis set entering LV_PUC in cold condition" CURVE 0x4ce11 _REC_CUR_20_u1_u1 8160. _CNV_A_R_LINEAR_____5_CM 0. 8160. FORMAT "%4.0"
 /begin AXIS_DESCR COM_AXIS GR_MT _CNV_A_R_LINEAR_____10_CM 13 0. 255. FORMAT "%3.0" AXIS_PTS_REF ldpm_gr_mt_3 /end AXIS_DESCR
/end CHARACTERISTIC
/begin CHARACTERISTIC C_CYCNR_HYS_PUC "Cycle counter to reset the LV_PUC engine speed hysteresis " VALUE 0x42cbe _REC_VAL_20_u2 655.35 _CNV_A_R_LINEAR_____178_CM 0. 65535. FORMAT "%5.0" /end CHARACTERISTIC
/begin CHARACTERISTIC C_CYCNR_HYS_PUC_ST "Cycle counter to reset the LV_PUC engine speed hysteresis in cold condition" VALUE 0x42cc0 _REC_VAL_20_u2 655.35 _CNV_A_R_LINEAR_____178_CM 0. 65535. FORMAT "%5.0" /end CHARACTERISTIC
/begin CHARACTERISTIC C_TCO_MIN_PUC_ST "Coolant temperature to select the LV_PUC engine speed hysteresis" VALUE 0x42a72 _REC_VAL_20_u1 28.575 _CNV_A_R_LINEAR_____0_CM -48. 142.5 FORMAT "%5.1" /end CHARACTERISTIC
/begin MEASUREMENT LV_PUC_REQ "Engine operating state \"Trailing throttle\" for torque structure" UBYTE _CNV_S_2_RANGE______28_CM 1 100. 0. 1. ECU_ADDRESS 0x3fce0e BIT_MASK 0x1 /end MEASUREMENT
/begin MEASUREMENT STATE_ENG "" UBYTE _CNV_S_6_RANGE_STAT_179_CM 1 100. 0. 5. ECU_ADDRESS 0x3fce06 /end MEASUREMENT
/begin CHARACTERISTIC IP_N_MIN_PUC__TCO__GR_MT "LV_PUC engine speed threshold" MAP 0x4fca3 _REC_MAP_20_u1_u1_u1 8160. _CNV_A_R_LINEAR_____5_CM 0. 8160. FORMAT "%4.0"
 /begin AXIS_DESCR COM_AXIS TCO _CNV_A_R_LINEAR_____0_CM 6 -48. 142.5 FORMAT "%5.1" AXIS_PTS_REF ldpm_tco_1_6 /end AXIS_DESCR
 /begin AXIS_DESCR COM_AXIS GR_MT _CNV_A_R_LINEAR_____10_CM 13 0. 255. FORMAT "%3.0" AXIS_PTS_REF ldpm_gr_mt_3 /end AXIS_DESCR
/end CHARACTERISTIC
/begin CHARACTERISTIC IP_N_ACCOUT_MIN_PUC__TCO__GR_MT "LV_PUC engine speed threshold with air conditioned compressor active" MAP 0x4fbdb _REC_MAP_20_u1_u1_u1 8160. _CNV_A_R_LINEAR_____5_CM 0. 8160. FORMAT "%4.0"
 /begin AXIS_DESCR COM_AXIS TCO _CNV_A_R_LINEAR_____0_CM 6 -48. 142.5 FORMAT "%5.1" AXIS_PTS_REF ldpm_tco_1_6 /end AXIS_DESCR
 /begin AXIS_DESCR COM_AXIS GR_MT _CNV_A_R_LINEAR_____10_CM 13 0. 255. FORMAT "%3.0" AXIS_PTS_REF ldpm_gr_mt_3 /end AXIS_DESCR
/end CHARACTERISTIC
/begin CHARACTERISTIC IP_N_MIN_PUC__TCO__GR_AT "LV_PUC engine speed threshold" MAP 0x4fc55 _REC_MAP_20_u1_u1_u1 8160. _CNV_A_R_LINEAR_____5_CM 0. 8160. FORMAT "%4.0"
 /begin AXIS_DESCR COM_AXIS TCO _CNV_A_R_LINEAR_____0_CM 6 -48. 142.5 FORMAT "%5.1" AXIS_PTS_REF ldpm_tco_1_6 /end AXIS_DESCR
 /begin AXIS_DESCR COM_AXIS GR_AT _CNV_A_R_LINEAR_____10_CM 13 0. 255. FORMAT "%3.0" AXIS_PTS_REF ldpm_gr_at_3 /end AXIS_DESCR
/end CHARACTERISTIC
/begin CHARACTERISTIC IP_N_ACCOUT_MIN_PUC__TCO__GR_AT "LV_PUC engine speed threshold with air conditioned compressor active" MAP 0x4fb8d _REC_MAP_20_u1_u1_u1 8160. _CNV_A_R_LINEAR_____5_CM 0. 8160. FORMAT "%4.0"
 /begin AXIS_DESCR COM_AXIS TCO _CNV_A_R_LINEAR_____0_CM 6 -48. 142.5 FORMAT "%5.1" AXIS_PTS_REF ldpm_tco_1_6 /end AXIS_DESCR
 /begin AXIS_DESCR COM_AXIS GR_AT _CNV_A_R_LINEAR_____10_CM 13 0. 255. FORMAT "%3.0" AXIS_PTS_REF ldpm_gr_at_3 /end AXIS_DESCR
/end CHARACTERISTIC
/begin AXIS_PTS ldpm_tco_1_6 "" 0x43f47 TCO _REC_AXS_20_u1 28.575 _CNV_A_R_LINEAR_____0_CM 6 -48. 142.5 FORMAT "%5.1" /end AXIS_PTS
/begin AXIS_PTS ldpm_gr_mt_3 "" 0x43c17 GR_MT _REC_AXS_20_u1 255. _CNV_A_R_LINEAR_____10_CM 13 0. 255. FORMAT "%3.0" /end AXIS_PTS
/begin AXIS_PTS ldpm_gr_at_3 "" 0x43bf2 GR_AT _REC_AXS_20_u1 255. _CNV_A_R_LINEAR_____10_CM 13 0. 255. FORMAT "%3.0" /end AXIS_PTS
/begin MEASUREMENT LV_ERR_TPS_ST_CHK_1 "TPS-error-bit (Return spring test)" UBYTE _CNV_S_2_RANGE______184_R_CM 1 100. 0. 255. ECU_ADDRESS 0x3fd493 /end MEASUREMENT
/begin MEASUREMENT LV_ERR_TQI_LIM "Error flag torque request for safety is active" UBYTE _CNV_S_2_RANGE______28_CM 1 100. 0. 1. ECU_ADDRESS 0x3fd5cf BIT_MASK 0x1 /end MEASUREMENT
/begin MEASUREMENT LV_ERR_EBOX_CFA "Logical value for EBOX CFA error" UBYTE _CNV_S_2_RANGE______21_R_CM 1 100. 0. 255. ECU_ADDRESS 0x3fd5c7 /end MEASUREMENT
/begin MEASUREMENT LV_ERR_POIL_SWI "Error oil pressure switch" UBYTE _CNV_S_2_RANGE______21_R_CM 1 100. 0. 255. ECU_ADDRESS 0x3fd607 /end MEASUREMENT
/begin MEASUREMENT LV_ERR_RLY_ST "Status of starter output diagnosis" UBYTE _CNV_S_2_RANGE______21_R_CM 1 100. 0. 255. ECU_ADDRESS 0x3fd5ff /end MEASUREMENT
/begin MEASUREMENT LV_ERR_TOIL_LEVEL "Error condition of TOENS" UBYTE _CNV_S_2_RANGE______21_R_CM 1 100. 0. 255. ECU_ADDRESS 0x3fd3f3 /end MEASUREMENT
/begin MEASUREMENT LV_ERR_ECRAS "Boolean for currently present on ECRAS diagnosis" UBYTE _CNV_S_2_RANGE______21_R_CM 1 100. 0. 255. ECU_ADDRESS 0x3fd61f /end MEASUREMENT
/begin MEASUREMENT LV_ERR_DMTLH "Logical value for DMTL heater stage error" UBYTE _CNV_S_2_RANGE______21_R_CM 1 100. 0. 255. ECU_ADDRESS 0x3fd623 /end MEASUREMENT
/begin MEASUREMENT LV_ERR_TOUT_EFP "logical variable timeout error CAN message EKP" UBYTE _CNV_S_2_RANGE______21_R_CM 1 100. 0. 255. ECU_ADDRESS 0x3fd60b /end MEASUREMENT
/begin MEASUREMENT LV_ERR_CRASH_EFP "logical variable error in case of crash switch off EFP" UBYTE _CNV_S_2_RANGE______21_R_CM 1 100. 0. 255. ECU_ADDRESS 0x3fd67b /end MEASUREMENT
/begin MEASUREMENT LV_ERR_N_EFP_LOW "logical variable error in case of N_EFP_LOW" UBYTE _CNV_S_2_RANGE______21_R_CM 1 100. 0. 255. ECU_ADDRESS 0x3fd67f /end MEASUREMENT
/begin MEASUREMENT LV_ERR_N_EFP_HIGH "logical variable error in case of N_EFP_HIGH" UBYTE _CNV_S_2_RANGE______21_R_CM 1 100. 0. 255. ECU_ADDRESS 0x3fd683 /end MEASUREMENT
/begin MEASUREMENT LV_ERR_EFP_TEMP "logical variable error in case of EFP_TEMP" UBYTE _CNV_S_2_RANGE______21_R_CM 1 100. 0. 255. ECU_ADDRESS 0x3fd687 /end MEASUREMENT
/begin MEASUREMENT LV_ERR_LOCAN_BOFF "present error LOCAN bus off" UBYTE _CNV_S_2_RANGE______21_R_CM 1 100. 0. 255. ECU_ADDRESS 0x3fd68f /end MEASUREMENT
/begin MEASUREMENT LV_ERR_EFP_LIH "logical variable error in case of EFP_LIH" UBYTE _CNV_S_2_RANGE______21_R_CM 1 100. 0. 255. ECU_ADDRESS 0x3fd68b /end MEASUREMENT
/begin MEASUREMENT LV_ERR_VLS_UP_PUC_2 "Boolean error flag, PUC plausibility fault currently present on upstream oxygen sensor signal" UBYTE _CNV_S_2_RANGE______11_CM 1 100. 0. 1. ECU_ADDRESS 0x3fd6cb BIT_MASK 0x1 /end MEASUREMENT
/begin MEASUREMENT LV_ERR_VLS_UP_PUC_1 "Boolean error flag, PUC plausibility fault currently present on upstream oxygen sensor signal" UBYTE _CNV_S_2_RANGE______11_CM 1 100. 0. 1. ECU_ADDRESS 0x3fd6c7 BIT_MASK 0x1 /end MEASUREMENT
/begin MEASUREMENT LV_ERR_DMTLS "Error flag, DMTL change-over valve" UBYTE _CNV_S_2_RANGE______21_R_CM 1 100. 0. 255. ECU_ADDRESS 0x3fd5e7 /end MEASUREMENT
/begin MEASUREMENT LV_ERR_DMTL_PUMP "Error flag, DMTL pump" UBYTE _CNV_S_2_RANGE______21_R_CM 1 100. 0. 255. ECU_ADDRESS 0x3fd5eb /end MEASUREMENT
/begin MEASUREMENT LV_ERR_DCC_REV "Reversible DCC error" UBYTE _CNV_S_2_RANGE______21_R_CM 1 100. 0. 255. ECU_ADDRESS 0x3fd617 /end MEASUREMENT
/begin MEASUREMENT LV_ERR_DCC_IRREV "Irreversible DCC error" UBYTE _CNV_S_2_RANGE______21_R_CM 1 100. 0. 255. ECU_ADDRESS 0x3fd61b /end MEASUREMENT
/begin MEASUREMENT LV_ERR_SLV_IVVT_IN_2 "IVVT 2 Error flag" UBYTE _CNV_S_2_RANGE______21_R_CM 1 100. 0. 255. ECU_ADDRESS 0x3fd3e3 /end MEASUREMENT
/begin MEASUREMENT LV_ERR_SLV_IVVT_IN_1 "IVVT 1 Error flag" UBYTE _CNV_S_2_RANGE______21_R_CM 1 100. 0. 255. ECU_ADDRESS 0x3fd3df /end MEASUREMENT
/begin MEASUREMENT LV_ERR_SLV_IVVT_EX_1 "IVVT 1 Error flag" UBYTE _CNV_S_2_RANGE______21_R_CM 1 100. 0. 255. ECU_ADDRESS 0x3fd3e7 /end MEASUREMENT
/begin MEASUREMENT LV_ERR_SLV_IVVT_EX_2 "IVVT 2 Error flag" UBYTE _CNV_S_2_RANGE______21_R_CM 1 100. 0. 255. ECU_ADDRESS 0x3fd3eb /end MEASUREMENT
/begin MEASUREMENT STATE_CMB_CTL "States of the combustion management" UBYTE _CNV_S_9_RANGE_STAT_235_CM 1 100. 0. 8. ECU_ADDRESS 0x3fcd2f /end MEASUREMENT
/begin CHARACTERISTIC IP_IVVTPWM_MIN_DIAG__VB "Torque conversion factor for anti-jerk funktion" CURVE 0x481ee _REC_CUR_20_u2_u1 99.99847412 _CNV_A_R_LINEAR_____94_CM 0. 99.99847412
 /begin AXIS_DESCR COM_AXIS VB _CNV_A_R_LINEAR_____26_CM 4 0. 25.8984 FORMAT "%3.1" AXIS_PTS_REF ldp_vb__ivvtpwm /end AXIS_DESCR
/end CHARACTERISTIC
/begin AXIS_PTS ldp_vb__ivvtpwm "" 0x43abd VB _REC_AXS_20_u1 25.8984 _CNV_A_R_LINEAR_____26_CM 4 0. 25.8984 FORMAT "%3.1" /end AXIS_PTS
/begin CHARACTERISTIC C_IVVTPWM_MAX_DIAG "IVVT diagnosis max range" VALUE 0x42db6 _REC_VAL_20_u2 99.99847412 _CNV_A_R_LINEAR_____94_CM 0. 99.99847412 /end CHARACTERISTIC
/begin MEASUREMENT LV_AFL_CH "LV for activation SA or catalyst heating lambda coordination" UBYTE _CNV_S_2_RANGE______11_CM 1 100. 0. 1. ECU_ADDRESS 0x3fcb1c BIT_MASK 0x1 /end MEASUREMENT
/begin MEASUREMENT CTR_CYCNR_R_VLS_UP_MIN_1 "Value of handshake counter for last vlaid resistance value used for short circuit to ground diagnosis" UWORD _CNV_A_R_LINEAR_____10_CM 1 100. 0. 65535. ECU_ADDRESS 0x3fa97c FORMAT "%5.0" /end MEASUREMENT
/begin MEASUREMENT CTR_CYCNR_R_VLS_UP_OC_1 "Value of handshake counter for last vlaid resistance value used for open circuit diagnosis" UWORD _CNV_A_R_LINEAR_____10_CM 1 100. 0. 65535. ECU_ADDRESS 0x3fa984 FORMAT "%5.0" /end MEASUREMENT
/begin MEASUREMENT LAM_P_CTR_SUM_1 "Counter indicating the number of observed p jumps reported by the lambda controller" UBYTE _CNV_A_R_LINEAR_____10_CM 1 100. 0. 255. ECU_ADDRESS 0x3fa975 FORMAT "%3.0" /end MEASUREMENT
/begin MEASUREMENT T_DLY_VLS_UP_MIN_COLD_1 "Delay time for final diagnosis activation " UWORD _CNV_A_R_LINEAR_____14_CM 1 100. 0. 6553.5 ECU_ADDRESS 0x3fa978 FORMAT "%5.1" /end MEASUREMENT
/begin MEASUREMENT T_DIAG_VLS_UP_MIN_COLD_1 "Maximum activation time for diagnosis activation " UWORD _CNV_A_R_LINEAR_____14_CM 1 100. 0. 6553.5 ECU_ADDRESS 0x3fa97a FORMAT "%5.1" /end MEASUREMENT
/begin MEASUREMENT T_DLY_VLS_UP_MIN_1 "Delay time for final diagnosis activation " UWORD _CNV_A_R_LINEAR_____14_CM 1 100. 0. 6553.5 ECU_ADDRESS 0x3fa97e FORMAT "%5.1" /end MEASUREMENT
/begin MEASUREMENT T_DLY_LAM_MIN_VLS_UP_MIN_1 "Delay time for detection \"Lambda-controller limit\" " UWORD _CNV_A_R_LINEAR_____14_CM 1 100. 0. 6553.5 ECU_ADDRESS 0x3fa980 FORMAT "%5.1" /end MEASUREMENT
/begin MEASUREMENT MAF_INT_CPS_CLOSE_VLS_UP_MIN_1 "Integral of mass air flow since closing CPS" UWORD _CNV_A_R_LINEAR_____277_CM 1 100. 0. 1820.398 ECU_ADDRESS 0x3fa982 FORMAT "%7.2" /end MEASUREMENT
/begin MEASUREMENT CTR_DLY_VLS_UP_OC_1 "Minimum detection time for OC error symptom detection" UBYTE _CNV_A_R_LINEAR_____10_CM 1 100. 0. 255. ECU_ADDRESS 0x3fa974 FORMAT "%3.0" /end MEASUREMENT
/begin MEASUREMENT LV_TI_LAM_MAX_VLS_UP_MIN_1 "Boolean flag indicating that lambda controller limited and CPS closed or inactive" ULONG _CNV_S_2_RANGE______28_CM 1 100. 0. 1. ECU_ADDRESS 0x3fa970 BIT_MASK 0x80000000 /end MEASUREMENT
/begin MEASUREMENT LV_R_VLS_UP_MIN_VLD_1 "Valid conditions of resitance value of oxygen sensor upstream diagnosis short to ground" ULONG _CNV_S_2_RANGE______28_CM 1 100. 0. 1. ECU_ADDRESS 0x3fa970 BIT_MASK 0x40000000 /end MEASUREMENT
/begin MEASUREMENT LV_REQ_DIAG_VLS_UP_MIN_1 "Request bit to indicate need of CPP  close for upsteam oxygen sensor SCG diagnosis" ULONG _CNV_S_2_RANGE______28_CM 1 100. 0. 1. ECU_ADDRESS 0x3fa970 BIT_MASK 0x20000000 /end MEASUREMENT
/begin MEASUREMENT LV_INH_DIAG_VLS_UP_MIN_1 "Boolean flag indicating project specific application conditions for VLS_UP short to ground diagnosis not met" ULONG _CNV_S_2_RANGE______28_CM 1 100. 0. 1. ECU_ADDRESS 0x3fa988 BIT_MASK 0x80000000 /end MEASUREMENT
/begin MEASUREMENT LV_INH_DIAG_VLS_UP_MAX_1 "Boolean flag indicating project specific application conditions for VLS_UP to plus diagnosis not met" ULONG _CNV_S_2_RANGE______28_CM 1 100. 0. 1. ECU_ADDRESS 0x3fa988 BIT_MASK 0x40000000 /end MEASUREMENT
/begin MEASUREMENT LV_INH_DIAG_VLS_UP_OC_1 "Boolean flag indicating project specific application conditions for VLS_UP open line diagnosis not met" ULONG _CNV_S_2_RANGE______28_CM 1 100. 0. 1. ECU_ADDRESS 0x3fa988 BIT_MASK 0x20000000 /end MEASUREMENT
/begin MEASUREMENT LV_INH_DIAG_VLS_UP_PUC_1 "Boolean flag indicating project specific application conditions for VLS_UP_PUC diagnosis not met" ULONG _CNV_S_2_RANGE______28_CM 1 100. 0. 1. ECU_ADDRESS 0x3fa988 BIT_MASK 0x10000000 /end MEASUREMENT
/begin MEASUREMENT LV_INH_DIAG_VLS_UP_STK_1 "Boolean flag indicating project specific application conditions for VLS_UP_STK diagnosis not met" ULONG _CNV_S_2_RANGE______28_CM 1 100. 0. 1. ECU_ADDRESS 0x3fa988 BIT_MASK 0x8000000 /end MEASUREMENT
/begin MEASUREMENT LV_INH_DIAG_VLS_UP_MIN_COLD_1 "Boolean flag indicating project specific application conditions for VLS_UP_MIN_COLD diagnosis not met" ULONG _CNV_S_2_RANGE______28_CM 1 100. 0. 1. ECU_ADDRESS 0x3fa988 BIT_MASK 0x4000000 /end MEASUREMENT
/begin MEASUREMENT CTR_CYCNR_R_VLS_DOWN_MIN_1 "Status conditions of oxygen sensor short to ground downstream diagnosis for VLS range" UWORD _CNV_A_R_LINEAR_____10_CM 1 100. 0. 65535. ECU_ADDRESS 0x3fa856 FORMAT "%5.0" /end MEASUREMENT
/begin MEASUREMENT CTR_CYCNR_R_VLS_DOWN_OC_1 "Value of handshake counter for last valid resistance value used for diagnosis" UWORD _CNV_A_R_LINEAR_____10_CM 1 100. 0. 65535. ECU_ADDRESS 0x3fa858 FORMAT "%5.0" /end MEASUREMENT
/begin MEASUREMENT T_DLY_VLS_DOWN_MIN_COLD_1 "Delay time for final diagnosis activation" UWORD _CNV_A_R_LINEAR_____14_CM 1 100. 0. 6553.5 ECU_ADDRESS 0x3fa852 FORMAT "%5.1" /end MEASUREMENT
/begin MEASUREMENT T_DIAG_VLS_DOWN_MIN_COLD_1 "Maximum activation time for diagnosis activation" UWORD _CNV_A_R_LINEAR_____14_CM 1 100. 0. 6553.5 ECU_ADDRESS 0x3fa854 FORMAT "%5.1" /end MEASUREMENT
/begin MEASUREMENT T_DLY_VLS_DOWN_MIN_1 "Delay time for final diagnosis activation" UWORD _CNV_A_R_LINEAR_____14_CM 1 100. 0. 6553.5 ECU_ADDRESS 0x3fa85a FORMAT "%5.1" /end MEASUREMENT
/begin MEASUREMENT CTR_MIN_VLS_DOWN_MIN_1 "Detection time for SCG" UBYTE _CNV_A_R_LINEAR_____10_CM 1 100. 0. 255. ECU_ADDRESS 0x3fa850 FORMAT "%3.0" /end MEASUREMENT
/begin MEASUREMENT T_DLY_VLS_DOWN_OC_1 "Delay time for final diagnosis activation" UWORD _CNV_A_R_LINEAR_____14_CM 1 100. 0. 6553.5 ECU_ADDRESS 0x3fa85e FORMAT "%5.1" /end MEASUREMENT
/begin MEASUREMENT T_CDN_VLS_DOWN_OC_1 "Detection time for status OC before diagnosis" UWORD _CNV_A_R_LINEAR_____14_CM 1 100. 0. 6553.5 ECU_ADDRESS 0x3fa85c FORMAT "%5.1" /end MEASUREMENT
/begin MEASUREMENT LV_REQ_CHK_LS_DOWN_1 "Request for starting the downstream sensor active plausibility check" ULONG _CNV_S_2_RANGE______28_CM 1 100. 0. 1. ECU_ADDRESS 0x3fa84c BIT_MASK 0x20000000 /end MEASUREMENT
/begin MEASUREMENT LV_VLS_DOWN_CDN_VLS_DIAG_OC_1 "Status conditions of oxygen sensor short to ground downstream diagnosis for VLS range" ULONG _CNV_S_2_RANGE______28_CM 1 100. 0. 1. ECU_ADDRESS 0x3fa84c BIT_MASK 0x80000000 /end MEASUREMENT
/begin MEASUREMENT LV_R_VLS_DOWN_OC_VLD_1 "Valid conditions of resistance of oxygen sensor signal short to ground downstream diagnosis" ULONG _CNV_S_2_RANGE______28_CM 1 100. 0. 1. ECU_ADDRESS 0x3fa84c BIT_MASK 0x40000000 /end MEASUREMENT
/begin MEASUREMENT LV_INH_DIAG_VLS_DOWN_MIN_1 "Boolean flag indicating project specific application conditions for downstream SCG diagnosis not met" ULONG _CNV_S_2_RANGE______28_CM 1 100. 0. 1. ECU_ADDRESS 0x3fa860 BIT_MASK 0x80000000 /end MEASUREMENT
/begin MEASUREMENT LV_INH_DIAG_VLS_DOWN_MAX_1 "Boolean flag indicating project specific application conditions for downstream short to plus diagnosis not met" ULONG _CNV_S_2_RANGE______28_CM 1 100. 0. 1. ECU_ADDRESS 0x3fa860 BIT_MASK 0x40000000 /end MEASUREMENT
/begin MEASUREMENT LV_INH_DIAG_VLS_DOWN_OC_1 "Boolean flag indicating project specific application conditions for downstream open line diagnosis not met" ULONG _CNV_S_2_RANGE______28_CM 1 100. 0. 1. ECU_ADDRESS 0x3fa860 BIT_MASK 0x20000000 /end MEASUREMENT
/begin MEASUREMENT LV_INH_DIAG_VLS_DOWN_PUC_1 "Boolean flag indicating project specific application conditions for downstream PUC diagnosis not met" ULONG _CNV_S_2_RANGE______28_CM 1 100. 0. 1. ECU_ADDRESS 0x3fa860 BIT_MASK 0x10000000 /end MEASUREMENT
/begin MEASUREMENT LV_INH_DIAG_VLS_DOWN_MIN_COLD_1 "Boolean flag indicating project specific application conditions for downstream SCG (Cold test) diagnosis not met" ULONG _CNV_S_2_RANGE______28_CM 1 100. 0. 1. ECU_ADDRESS 0x3fa860 BIT_MASK 0x4000000 /end MEASUREMENT
/begin MEASUREMENT LV_INH_DIAG_VLS_DOWN_FL_1 "Boolean flag indicating project specific application conditions for downstream FL diagnosis not met" ULONG _CNV_S_2_RANGE______28_CM 1 100. 0. 1. ECU_ADDRESS 0x3fa860 BIT_MASK 0x8000000 /end MEASUREMENT
/begin MEASUREMENT CTR_CYCNR_R_VLS_UP_MIN_2 "Value of handshake counter for last vlaid resistance value used for short circuit to ground diagnosis" UWORD _CNV_A_R_LINEAR_____10_CM 1 100. 0. 65535. ECU_ADDRESS 0x3fac94 FORMAT "%5.0" /end MEASUREMENT
/begin MEASUREMENT CTR_CYCNR_R_VLS_UP_OC_2 "Value of handshake counter for last vlaid resistance value used for open circuit diagnosis" UWORD _CNV_A_R_LINEAR_____10_CM 1 100. 0. 65535. ECU_ADDRESS 0x3fac9c FORMAT "%5.0" /end MEASUREMENT
/begin MEASUREMENT LAM_P_CTR_SUM_2 "Counter indicating the number of observed p jumps reported by the lambda controller" UBYTE _CNV_A_R_LINEAR_____10_CM 1 100. 0. 255. ECU_ADDRESS 0x3fac8d FORMAT "%3.0" /end MEASUREMENT
/begin MEASUREMENT T_DLY_VLS_UP_MIN_COLD_2 "Delay time for final diagnosis activation " UWORD _CNV_A_R_LINEAR_____14_CM 1 100. 0. 6553.5 ECU_ADDRESS 0x3fac90 FORMAT "%5.1" /end MEASUREMENT
/begin MEASUREMENT T_DIAG_VLS_UP_MIN_COLD_2 "Maximum activation time for diagnosis activation " UWORD _CNV_A_R_LINEAR_____14_CM 1 100. 0. 6553.5 ECU_ADDRESS 0x3fac92 FORMAT "%5.1" /end MEASUREMENT
/begin MEASUREMENT T_DLY_VLS_UP_MIN_2 "Delay time for final diagnosis activation " UWORD _CNV_A_R_LINEAR_____14_CM 1 100. 0. 6553.5 ECU_ADDRESS 0x3fac96 FORMAT "%5.1" /end MEASUREMENT
/begin MEASUREMENT T_DLY_LAM_MIN_VLS_UP_MIN_2 "Delay time for detection \"Lambda-controller limit\" " UWORD _CNV_A_R_LINEAR_____14_CM 1 100. 0. 6553.5 ECU_ADDRESS 0x3fac98 FORMAT "%5.1" /end MEASUREMENT
/begin MEASUREMENT MAF_INT_CPS_CLOSE_VLS_UP_MIN_2 "Integral of mass air flow since closing CPS" UWORD _CNV_A_R_LINEAR_____277_CM 1 100. 0. 1820.398 ECU_ADDRESS 0x3fac9a FORMAT "%7.2" /end MEASUREMENT
/begin MEASUREMENT CTR_DLY_VLS_UP_OC_2 "Minimum detection time for OC error symptom detection" UBYTE _CNV_A_R_LINEAR_____10_CM 1 100. 0. 255. ECU_ADDRESS 0x3fac8c FORMAT "%3.0" /end MEASUREMENT
/begin MEASUREMENT LV_TI_LAM_MAX_VLS_UP_MIN_2 "Boolean flag indicating that lambda controller limited and CPS closed or inactive" ULONG _CNV_S_2_RANGE______28_CM 1 100. 0. 1. ECU_ADDRESS 0x3fac88 BIT_MASK 0x80000000 /end MEASUREMENT
/begin MEASUREMENT LV_R_VLS_UP_MIN_VLD_2 "Valid conditions of resitance value of oxygen sensor upstream diagnosis short to ground" ULONG _CNV_S_2_RANGE______28_CM 1 100. 0. 1. ECU_ADDRESS 0x3fac88 BIT_MASK 0x40000000 /end MEASUREMENT
/begin MEASUREMENT LV_REQ_DIAG_VLS_UP_MIN_2 "Request bit to indicate need of CPP  close for upsteam oxygen sensor SCG diagnosis" ULONG _CNV_S_2_RANGE______28_CM 1 100. 0. 1. ECU_ADDRESS 0x3fac88 BIT_MASK 0x20000000 /end MEASUREMENT
/begin MEASUREMENT LV_INH_DIAG_VLS_UP_MIN_2 "Boolean flag indicating project specific application conditions for VLS_UP short to ground diagnosis not met" ULONG _CNV_S_2_RANGE______28_CM 1 100. 0. 1. ECU_ADDRESS 0x3faca0 BIT_MASK 0x80000000 /end MEASUREMENT
/begin MEASUREMENT LV_INH_DIAG_VLS_UP_MAX_2 "Boolean flag indicating project specific application conditions for VLS_UP to plus diagnosis not met" ULONG _CNV_S_2_RANGE______28_CM 1 100. 0. 1. ECU_ADDRESS 0x3faca0 BIT_MASK 0x40000000 /end MEASUREMENT
/begin MEASUREMENT LV_INH_DIAG_VLS_UP_OC_2 "Boolean flag indicating project specific application conditions for VLS_UP open line diagnosis not met" ULONG _CNV_S_2_RANGE______28_CM 1 100. 0. 1. ECU_ADDRESS 0x3faca0 BIT_MASK 0x20000000 /end MEASUREMENT
/begin MEASUREMENT LV_INH_DIAG_VLS_UP_PUC_2 "Boolean flag indicating project specific application conditions for VLS_UP_PUC diagnosis not met" ULONG _CNV_S_2_RANGE______28_CM 1 100. 0. 1. ECU_ADDRESS 0x3faca0 BIT_MASK 0x10000000 /end MEASUREMENT
/begin MEASUREMENT LV_INH_DIAG_VLS_UP_STK_2 "Boolean flag indicating project specific application conditions for VLS_UP_STK diagnosis not met" ULONG _CNV_S_2_RANGE______28_CM 1 100. 0. 1. ECU_ADDRESS 0x3faca0 BIT_MASK 0x8000000 /end MEASUREMENT
/begin MEASUREMENT LV_INH_DIAG_VLS_UP_MIN_COLD_2 "Boolean flag indicating project specific application conditions for VLS_UP_MIN_COLD diagnosis not met" ULONG _CNV_S_2_RANGE______28_CM 1 100. 0. 1. ECU_ADDRESS 0x3faca0 BIT_MASK 0x4000000 /end MEASUREMENT
/begin MEASUREMENT CTR_CYCNR_R_VLS_DOWN_MIN_2 "Status conditions of oxygen sensor short to ground downstream diagnosis for VLS range" UWORD _CNV_A_R_LINEAR_____10_CM 1 100. 0. 65535. ECU_ADDRESS 0x3fab6e FORMAT "%5.0" /end MEASUREMENT
/begin MEASUREMENT CTR_CYCNR_R_VLS_DOWN_OC_2 "Value of handshake counter for last valid resistance value used for diagnosis" UWORD _CNV_A_R_LINEAR_____10_CM 1 100. 0. 65535. ECU_ADDRESS 0x3fab70 FORMAT "%5.0" /end MEASUREMENT
/begin MEASUREMENT T_DLY_VLS_DOWN_MIN_COLD_2 "Delay time for final diagnosis activation" UWORD _CNV_A_R_LINEAR_____14_CM 1 100. 0. 6553.5 ECU_ADDRESS 0x3fab6a FORMAT "%5.1" /end MEASUREMENT
/begin MEASUREMENT T_DIAG_VLS_DOWN_MIN_COLD_2 "Maximum activation time for diagnosis activation" UWORD _CNV_A_R_LINEAR_____14_CM 1 100. 0. 6553.5 ECU_ADDRESS 0x3fab6c FORMAT "%5.1" /end MEASUREMENT
/begin MEASUREMENT T_DLY_VLS_DOWN_MIN_2 "Delay time for final diagnosis activation" UWORD _CNV_A_R_LINEAR_____14_CM 1 100. 0. 6553.5 ECU_ADDRESS 0x3fab72 FORMAT "%5.1" /end MEASUREMENT
/begin MEASUREMENT CTR_MIN_VLS_DOWN_MIN_2 "Detection time for SCG" UBYTE _CNV_A_R_LINEAR_____10_CM 1 100. 0. 255. ECU_ADDRESS 0x3fab68 FORMAT "%3.0" /end MEASUREMENT
/begin MEASUREMENT T_DLY_VLS_DOWN_OC_2 "Delay time for final diagnosis activation" UWORD _CNV_A_R_LINEAR_____14_CM 1 100. 0. 6553.5 ECU_ADDRESS 0x3fab76 FORMAT "%5.1" /end MEASUREMENT
/begin MEASUREMENT T_CDN_VLS_DOWN_OC_2 "Detection time for status OC before diagnosis" UWORD _CNV_A_R_LINEAR_____14_CM 1 100. 0. 6553.5 ECU_ADDRESS 0x3fab74 FORMAT "%5.1" /end MEASUREMENT
/begin MEASUREMENT LV_REQ_CHK_LS_DOWN_2 "Request for starting the downstream sensor active plausibility check" ULONG _CNV_S_2_RANGE______28_CM 1 100. 0. 1. ECU_ADDRESS 0x3fab64 BIT_MASK 0x20000000 /end MEASUREMENT
/begin MEASUREMENT LV_VLS_DOWN_CDN_VLS_DIAG_OC_2 "Status conditions of oxygen sensor short to ground downstream diagnosis for VLS range" ULONG _CNV_S_2_RANGE______28_CM 1 100. 0. 1. ECU_ADDRESS 0x3fab64 BIT_MASK 0x80000000 /end MEASUREMENT
/begin MEASUREMENT LV_R_VLS_DOWN_OC_VLD_2 "Valid conditions of resistance of oxygen sensor signal short to ground downstream diagnosis" ULONG _CNV_S_2_RANGE______28_CM 1 100. 0. 1. ECU_ADDRESS 0x3fab64 BIT_MASK 0x40000000 /end MEASUREMENT
/begin MEASUREMENT LV_INH_DIAG_VLS_DOWN_MIN_2 "Boolean flag indicating project specific application conditions for downstream SCG diagnosis not met" ULONG _CNV_S_2_RANGE______28_CM 1 100. 0. 1. ECU_ADDRESS 0x3fab78 BIT_MASK 0x80000000 /end MEASUREMENT
/begin MEASUREMENT LV_INH_DIAG_VLS_DOWN_MAX_2 "Boolean flag indicating project specific application conditions for downstream short to plus diagnosis not met" ULONG _CNV_S_2_RANGE______28_CM 1 100. 0. 1. ECU_ADDRESS 0x3fab78 BIT_MASK 0x40000000 /end MEASUREMENT
/begin MEASUREMENT LV_INH_DIAG_VLS_DOWN_OC_2 "Boolean flag indicating project specific application conditions for downstream open line diagnosis not met" ULONG _CNV_S_2_RANGE______28_CM 1 100. 0. 1. ECU_ADDRESS 0x3fab78 BIT_MASK 0x20000000 /end MEASUREMENT
/begin MEASUREMENT LV_INH_DIAG_VLS_DOWN_PUC_2 "Boolean flag indicating project specific application conditions for downstream PUC diagnosis not met" ULONG _CNV_S_2_RANGE______28_CM 1 100. 0. 1. ECU_ADDRESS 0x3fab78 BIT_MASK 0x10000000 /end MEASUREMENT
/begin MEASUREMENT LV_INH_DIAG_VLS_DOWN_MIN_COLD_2 "Boolean flag indicating project specific application conditions for downstream SCG (Cold test) diagnosis not met" ULONG _CNV_S_2_RANGE______28_CM 1 100. 0. 1. ECU_ADDRESS 0x3fab78 BIT_MASK 0x4000000 /end MEASUREMENT
/begin MEASUREMENT LV_INH_DIAG_VLS_DOWN_FL_2 "Boolean flag indicating project specific application conditions for downstream FL diagnosis not met" ULONG _CNV_S_2_RANGE______28_CM 1 100. 0. 1. ECU_ADDRESS 0x3fab78 BIT_MASK 0x8000000 /end MEASUREMENT
/begin MEASUREMENT LV_ERR_VLS_DOWN_1 "General error flag for Lambda downstream sensors" UBYTE _CNV_S_2_RANGE______11_CM 1 100. 0. 1. ECU_ADDRESS 0x3fcb8c BIT_MASK 0x1 /end MEASUREMENT
/begin MEASUREMENT LV_ERR_VLS_DOWN_2 "General error flag for Lambda downstream sensors" UBYTE _CNV_S_2_RANGE______11_CM 1 100. 0. 1. ECU_ADDRESS 0x3fcb8d BIT_MASK 0x1 /end MEASUREMENT
/begin CHARACTERISTIC C_R_DOWN_LS_MAX_VLS_DOWN_MIN "Maximum resistance threshold oxygen sensor internal resistance during short to ground sensor" VALUE 0x42f0e _REC_VAL_20_u2 65535. _CNV_A_R_LINEAR_____285_CM 0. 65535. FORMAT "%5.0" /end CHARACTERISTIC
/begin CHARACTERISTIC C_CTR_MIN_VLS_DOWN_MIN "Minimum duration required for continious low VLS_DOWN_i detection" VALUE 0x42871 _REC_VAL_20_u1 255. _CNV_A_R_LINEAR_____10_CM 0. 255. FORMAT "%3.0" /end CHARACTERISTIC
/begin CHARACTERISTIC C_MAF_KGH_MIN_VLS_DOWN_MIN "Minimum duration required for continious low VLS_DOWN_i detection" VALUE 0x42e5c _REC_VAL_20_u2 2047.96875 _CNV_A_R_LINEAR_____101_CM 0. 2047.96875 FORMAT "%7.2" /end CHARACTERISTIC
/begin CHARACTERISTIC C_VLS_DOWN_MIN_DIAG "Oxygen sensor voltage threshold under which short to GND may be present" VALUE 0x43196 _REC_VAL_20_u2 4.99511719 _CNV_A_R_LINEAR_____33_CM 0. 4.99511719 FORMAT "%5.3" /end CHARACTERISTIC
/begin CHARACTERISTIC C_VLS_DOWN_MAX_DIAG "Oxygen sensor voltage threshold over which short to Vbatt present" VALUE 0x43192 _REC_VAL_20_u2 4.99511719 _CNV_A_R_LINEAR_____33_CM 0. 4.99511719 FORMAT "%5.3" /end CHARACTERISTIC
/begin CHARACTERISTIC C_VLS_DOWN_AFL_DIAG "Oxygen sensor voltage-lean mixture threshold for diagnosis" VALUE 0x4317c _REC_VAL_20_u2 4.99511719 _CNV_A_R_LINEAR_____33_CM 0. 4.99511719 FORMAT "%5.3" /end CHARACTERISTIC
/begin CHARACTERISTIC C_VLS_DOWN_AFR_DIAG "Oxygen sensor voltage-rich mixture threshold for diagnosis" VALUE 0x43180 _REC_VAL_20_u2 4.99511719 _CNV_A_R_LINEAR_____33_CM 0. 4.99511719 FORMAT "%5.3" /end CHARACTERISTIC
/begin CHARACTERISTIC C_R_DOWN_MIN_VLS_DOWN_OC "Minimum resistance threshold oxygen sensor internal resistance during open circuit sensor" VALUE 0x42f10 _REC_VAL_20_u2 65535. _CNV_A_R_LINEAR_____285_CM 0. 65535. FORMAT "%5.0" /end CHARACTERISTIC
/begin CHARACTERISTIC C_T_DLY_VLS_DOWN_MIN "Minimum duration required for low VLS_DOWN_i detection" VALUE 0x42fac _REC_VAL_20_u2 6553.5 _CNV_A_R_LINEAR_____14_CM 0. 6553.5 FORMAT "%5.1" /end CHARACTERISTIC
/begin CHARACTERISTIC C_T_ES_DEW_VLS_DOWN_MIN_COLD "Minimum required ES time for short to ground diagnosis (Cold - test)" VALUE 0x42fd2 _REC_VAL_20_u2 65535. _CNV_A_R_LINEAR_____35_CM 0. 65535. FORMAT "%5.0" /end CHARACTERISTIC
/begin CHARACTERISTIC C_T_DIAG_VLS_DOWN_MIN_COLD "Maximum activation time for diagnosis activation (Cold - test)" VALUE 0x42f7a _REC_VAL_20_u2 6553.5 _CNV_A_R_LINEAR_____14_CM 0. 6553.5 FORMAT "%5.1" /end CHARACTERISTIC
/begin CHARACTERISTIC C_T_DLY_VLS_DOWN_MIN_COLD "Minimum required delay after ST for activation of short to ground diagnosis (Cold - test)" VALUE 0x42fae _REC_VAL_20_u2 6553.5 _CNV_A_R_LINEAR_____14_CM 0. 6553.5 FORMAT "%5.1" /end CHARACTERISTIC
/begin CHARACTERISTIC C_T_DLY_VLS_DOWN_OC "Minimum resistance threshold oxygen sensor internal resistance during open circuit sensor" VALUE 0x42fb0 _REC_VAL_20_u2 6553.5 _CNV_A_R_LINEAR_____14_CM 0. 6553.5 FORMAT "%5.1" /end CHARACTERISTIC
/begin CHARACTERISTIC C_T_CDN_VLS_DOWN_OC "Minimum required duration where voltage lies outside of the limits for operable sensor to detect fault" VALUE 0x42f64 _REC_VAL_20_u2 6553.5 _CNV_A_R_LINEAR_____14_CM 0. 6553.5 FORMAT "%5.1" /end CHARACTERISTIC
/begin CHARACTERISTIC C_TEG_CAT_DOWN_MDL_VLS_DOWN_OC "Minimum requested exhaust gas temperature for diagnosis" VALUE 0x4305e _REC_VAL_20_u2 2047. _CNV_A_R_LINEAR_____211_CM 0. 2047. FORMAT "%7.2" /end CHARACTERISTIC
/begin MEASUREMENT LV_ERR_VLS_DOWN_MIN_2 "Boolean error flag, short to ground fault currently present on downstream oxygen sensor signal" UBYTE _CNV_S_2_RANGE______11_CM 1 100. 0. 1. ECU_ADDRESS 0x3fd37b BIT_MASK 0x1 /end MEASUREMENT
/begin MEASUREMENT LV_ERR_VLS_DOWN_MAX_2 "Boolean error flag, short to plus fault currently present on downstream oxygen sensor signal" UBYTE _CNV_S_2_RANGE______11_CM 1 100. 0. 1. ECU_ADDRESS 0x3fd36b BIT_MASK 0x1 /end MEASUREMENT
/begin MEASUREMENT LV_ERR_VLS_DOWN_MAX_1 "Boolean error flag, short to plus fault currently present on downstream oxygen sensor signal" UBYTE _CNV_S_2_RANGE______11_CM 1 100. 0. 1. ECU_ADDRESS 0x3fd367 BIT_MASK 0x1 /end MEASUREMENT
/begin MEASUREMENT LV_ERR_VLS_DOWN_OC_1 "Boolean error flag, short to ground fault currently present on downstream oxygen sensor signal" UBYTE _CNV_S_2_RANGE______11_CM 1 100. 0. 1. ECU_ADDRESS 0x3fd37f BIT_MASK 0x1 /end MEASUREMENT
/begin MEASUREMENT LV_ERR_VLS_DOWN_OC_2 "Boolean error flag, short to ground fault currently present on downstream oxygen sensor signal" UBYTE _CNV_S_2_RANGE______11_CM 1 100. 0. 1. ECU_ADDRESS 0x3fd383 BIT_MASK 0x1 /end MEASUREMENT
/begin MEASUREMENT LV_ERR_VLS_DOWN_MIN_1 "Boolean error flag, short to ground fault currently present on downstream oxygen sensor signal" UBYTE _CNV_S_2_RANGE______11_CM 1 100. 0. 1. ECU_ADDRESS 0x3fd377 BIT_MASK 0x1 /end MEASUREMENT
/begin MEASUREMENT LV_ERR_VLS_DOWN_MIN_COLD_1 "Boolean error flag, short to ground fault currently present on downstream oxygen sensor signal" UBYTE _CNV_S_2_RANGE______184_R_CM 1 100. 0. 255. ECU_ADDRESS 0x3fd36f /end MEASUREMENT
/begin MEASUREMENT LV_ERR_VLS_DOWN_MIN_COLD_2 "Boolean error flag, short to ground fault currently present on downstream oxygen sensor signal" UBYTE _CNV_S_2_RANGE______184_R_CM 1 100. 0. 255. ECU_ADDRESS 0x3fd373 /end MEASUREMENT
/begin MEASUREMENT LV_ERR_VLS_UP_2 "General error flag for Lambda upstream sensors" UBYTE _CNV_S_2_RANGE______11_CM 1 100. 0. 1. ECU_ADDRESS 0x3fcb95 BIT_MASK 0x1 /end MEASUREMENT
/begin MEASUREMENT LV_ERR_VLS_UP_1 "General error flag for Lambda upstream sensors" UBYTE _CNV_S_2_RANGE______11_CM 1 100. 0. 1. ECU_ADDRESS 0x3fcb94 BIT_MASK 0x1 /end MEASUREMENT
/begin CHARACTERISTIC C_R_UP_LS_MAX_VLS_UP_MIN "Maximum resitance threshold oxygen sensor internal resistance during short to ground sensor" VALUE 0x42f18 _REC_VAL_20_u2 65535. _CNV_A_R_LINEAR_____285_CM 0. 65535. FORMAT "%5.0" /end CHARACTERISTIC
/begin CHARACTERISTIC C_T_DLY_LAM_LIM_VLS_UP_MIN "Minimum required delay for which lambda controller limited at max. value (continuous lean AFR present)" VALUE 0x42f90 _REC_VAL_20_u2 6553.5 _CNV_A_R_LINEAR_____14_CM 0. 6553.5 FORMAT "%5.1" /end CHARACTERISTIC
/begin CHARACTERISTIC C_VLS_UP_MAX_DIAG "Oxygen sensor voltage threshold over which short to Vbatt present" VALUE 0x431b2 _REC_VAL_20_u2 4.99511719 _CNV_A_R_LINEAR_____33_CM 0. 4.99511719 FORMAT "%5.3" /end CHARACTERISTIC
/begin CHARACTERISTIC C_VLS_UP_AFL_DIAG "Oxygen sensor voltage-lean mixture threshold for diagnosis" VALUE 0x431ae _REC_VAL_20_u2 4.99511719 _CNV_A_R_LINEAR_____33_CM 0. 4.99511719 FORMAT "%5.3" /end CHARACTERISTIC
/begin CHARACTERISTIC C_VLS_UP_AFR_DIAG "Oxygen sensor voltage-rich mixture threshold for diagnosis" VALUE 0x431b0 _REC_VAL_20_u2 4.99511719 _CNV_A_R_LINEAR_____33_CM 0. 4.99511719 FORMAT "%5.3" /end CHARACTERISTIC
/begin CHARACTERISTIC C_T_VLS_CYC_MAX_STK "Maximum cycle time to activate the diagnosis" VALUE 0x42a32 _REC_VAL_20_u1 2.55 _CNV_A_R_LINEAR_____27_CM 0. 2.55 FORMAT "%4.2" /end CHARACTERISTIC
/begin CHARACTERISTIC C_ABC_INC_VLS_UP_STK "Debounce counter increment for voltage excursion plausibility" VALUE 0x42737 _REC_VAL_20_u1 255. _CNV_A_R_LINEAR_____10_CM 0. 255. FORMAT "%3.0" /end CHARACTERISTIC
/begin CHARACTERISTIC C_VLS_UP_MIN_DIAG "Oxygen sensor voltage threshold under which short to GND may be present" VALUE 0x431b4 _REC_VAL_20_u2 4.99511719 _CNV_A_R_LINEAR_____33_CM 0. 4.99511719 FORMAT "%5.3" /end CHARACTERISTIC
/begin CHARACTERISTIC C_R_UP_LS_MIN_VLS_UP_OC "Minimum resitance threshold oxygen sensor internal resistance during open circuit sensor" VALUE 0x42f1a _REC_VAL_20_u2 65535. _CNV_A_R_LINEAR_____285_CM 0. 65535. FORMAT "%5.0" /end CHARACTERISTIC
/begin CHARACTERISTIC C_ABC_MAX_VLS_UP_STK "Debounce counter maximum for voltage excursion plausibility" VALUE 0x427b9 _REC_VAL_20_u1 254. _CNV_A_R_LINEAR_____10_CM 1. 255. FORMAT "%3.0" /end CHARACTERISTIC
/begin CHARACTERISTIC C_VLS_DIF_BOL_TOL_MIN "Difference threshold of the L-mean value for error detection" VALUE 0x4317a _REC_VAL_20_u2 4.99992371 _CNV_A_R_LINEAR_____256_CM 0. 4.99992371 FORMAT "%7.5" /end CHARACTERISTIC
/begin CHARACTERISTIC C_LAM_P_CTR_DIAG "Number of P-Jumps after LSCL=1 for diagnosis begin" VALUE 0x428fa _REC_VAL_20_u1 255. _CNV_A_R_LINEAR_____10_CM 0. 255. FORMAT "%3.0" /end CHARACTERISTIC
/begin CHARACTERISTIC C_MAF_KGH_MIN_VLS_UP_MIN "Minimum MAF_KGH threshold required to permit diagnosis to take place" VALUE 0x42e5e _REC_VAL_20_u2 2047.96875 _CNV_A_R_LINEAR_____101_CM 0. 2047.96875 FORMAT "%7.2" /end CHARACTERISTIC
/begin CHARACTERISTIC C_MAF_INT_MIN_VLS_UP_DIAG "Minimum threshold for MAF integral required to start upstream PUC signal plausibility" VALUE 0x42e36 _REC_VAL_20_u2 1820.398 _CNV_A_R_LINEAR_____277_CM 0. 1820.398 FORMAT "%7.2" /end CHARACTERISTIC
/begin CHARACTERISTIC C_MAF_INT_MAX_VLS_UP_DIAG "Maximum threshold for MAF integral required to start upstream PUC signal plausibility" VALUE 0x42e2c _REC_VAL_20_u2 1820.398 _CNV_A_R_LINEAR_____277_CM 0. 1820.398 FORMAT "%7.2" /end CHARACTERISTIC
/begin CHARACTERISTIC C_VLS_UP_MIN_PUC "VLS voltage threshold for PUC fault detection" VALUE 0x431b6 _REC_VAL_20_u2 4.99511719 _CNV_A_R_LINEAR_____33_CM 0. 4.99511719 FORMAT "%5.3" /end CHARACTERISTIC
/begin CHARACTERISTIC C_T_ES_DEW_VLS_UP_MIN_COLD "Minimum required ES time for short to ground diagnosis (Cold - test)" VALUE 0x42fd4 _REC_VAL_20_u2 65535. _CNV_A_R_LINEAR_____35_CM 0. 65535. FORMAT "%5.0" /end CHARACTERISTIC
/begin CHARACTERISTIC C_T_DLY_VLS_UP_MIN "Minimum required delay for forced activation of short to ground diagnosis" VALUE 0x42fb2 _REC_VAL_20_u2 6553.5 _CNV_A_R_LINEAR_____14_CM 0. 6553.5 FORMAT "%5.1" /end CHARACTERISTIC
/begin CHARACTERISTIC C_CTR_DLY_VLS_UP_OC "Minimum required duration where voltage lies within voltage band to detect fault" VALUE 0x4286b _REC_VAL_20_u1 255. _CNV_A_R_LINEAR_____10_CM 0. 255. FORMAT "%3.0" /end CHARACTERISTIC
/begin CHARACTERISTIC C_TEG_CAT_UP_MDL_VLS_UP_MIN "Minimum required exhaust gas temperature for diagnosis" VALUE 0x43062 _REC_VAL_20_u2 2047. _CNV_A_R_LINEAR_____211_CM 0. 2047. FORMAT "%7.2" /end CHARACTERISTIC
/begin CHARACTERISTIC C_MAF_INT_CPS_CLOSE_VLS_UP_MIN "Minimum required Mass aif flow (after CPS closed) for diagnosis" VALUE 0x42e26 _REC_VAL_20_u2 1820.398 _CNV_A_R_LINEAR_____277_CM 0. 1820.398 FORMAT "%7.2" /end CHARACTERISTIC
/begin CHARACTERISTIC C_VLS_DOWN_MAX_VLS_UP_MIN_DIAG "Downstream - sensor voltage threshold for short to GND error detection" VALUE 0x43194 _REC_VAL_20_u2 4.99511719 _CNV_A_R_LINEAR_____33_CM 0. 4.99511719 FORMAT "%5.3" /end CHARACTERISTIC
/begin CHARACTERISTIC C_ABC_INC_VLS_UP_MIN "Debounce counter increment for electrical check short to ground" VALUE 0x42733 _REC_VAL_20_u1 255. _CNV_A_R_LINEAR_____10_CM 0. 255. FORMAT "%3.0" /end CHARACTERISTIC
/begin CHARACTERISTIC C_ABC_INC_VLS_UP_MIN_COLD "Debounce counter increment for electrical check short to ground" VALUE 0x42734 _REC_VAL_20_u1 255. _CNV_A_R_LINEAR_____10_CM 0. 255. FORMAT "%3.0" /end CHARACTERISTIC
/begin CHARACTERISTIC C_ABC_MAX_VLS_UP_MIN "Debounce counter maximum for electrical check short to ground" VALUE 0x427b5 _REC_VAL_20_u1 254. _CNV_A_R_LINEAR_____10_CM 1. 255. FORMAT "%3.0" /end CHARACTERISTIC
/begin CHARACTERISTIC C_ABC_MAX_VLS_UP_MIN_COLD "Debounce counter maximum for electrical check short to ground" VALUE 0x427b6 _REC_VAL_20_u1 254. _CNV_A_R_LINEAR_____10_CM 1. 255. FORMAT "%3.0" /end CHARACTERISTIC
/begin CHARACTERISTIC C_T_DIAG_VLS_UP_MIN_COLD "Maximum activation time for diagnosis activation (Cold - test)" VALUE 0x42f7c _REC_VAL_20_u2 6553.5 _CNV_A_R_LINEAR_____14_CM 0. 6553.5 FORMAT "%5.1" /end CHARACTERISTIC
/begin CHARACTERISTIC C_T_DLY_VLS_UP_MIN_COLD "Minimum required delay after ST for activation of short to ground diagnosis (Cold - test)" VALUE 0x42fb4 _REC_VAL_20_u2 6553.5 _CNV_A_R_LINEAR_____14_CM 0. 6553.5 FORMAT "%5.1" /end CHARACTERISTIC
/begin MEASUREMENT LV_ERR_VLS_UP_MIN_2 "Error flag for Lambda upstream sensors" UBYTE _CNV_S_2_RANGE______11_CM 1 100. 0. 1. ECU_ADDRESS 0x3fd6b3 BIT_MASK 0x1 /end MEASUREMENT
/begin MEASUREMENT LV_ERR_VLS_UP_MAX_1 "Boolean error flag, short to plus fault currently present on upstream oxygen sensor signal" UBYTE _CNV_S_2_RANGE______11_CM 1 100. 0. 1. ECU_ADDRESS 0x3fd6b7 BIT_MASK 0x1 /end MEASUREMENT
/begin MEASUREMENT LV_ERR_VLS_UP_MAX_2 "Boolean error flag, short to plus fault currently present on upstream oxygen sensor signal" UBYTE _CNV_S_2_RANGE______11_CM 1 100. 0. 1. ECU_ADDRESS 0x3fd6bb BIT_MASK 0x1 /end MEASUREMENT
/begin MEASUREMENT LV_ERR_VLS_UP_OC_1 "Boolean error flag, OC plausibility fault currently present on upstream oxygen sensor signal" UBYTE _CNV_S_2_RANGE______11_CM 1 100. 0. 1. ECU_ADDRESS 0x3fd6bf BIT_MASK 0x1 /end MEASUREMENT
/begin MEASUREMENT LV_ERR_VLS_UP_OC_2 "Boolean error flag, OC plausibility fault currently present on upstream oxygen sensor signal" UBYTE _CNV_S_2_RANGE______11_CM 1 100. 0. 1. ECU_ADDRESS 0x3fd6c3 BIT_MASK 0x1 /end MEASUREMENT
/begin MEASUREMENT LV_ERR_VLS_UP_MIN_1 "Error flag for Lambda upstream sensors" UBYTE _CNV_S_2_RANGE______11_CM 1 100. 0. 1. ECU_ADDRESS 0x3fd6af BIT_MASK 0x1 /end MEASUREMENT
/begin MEASUREMENT LV_ERR_VLS_UP_MIN_COLD_1 "Error flag for Lambda upstream sensors" UBYTE _CNV_S_2_RANGE______184_R_CM 1 100. 0. 255. ECU_ADDRESS 0x3fd6a7 /end MEASUREMENT
/begin MEASUREMENT LV_ERR_VLS_UP_MIN_COLD_2 "Error flag for Lambda upstream sensors" UBYTE _CNV_S_2_RANGE______184_R_CM 1 100. 0. 255. ECU_ADDRESS 0x3fd6ab /end MEASUREMENT
/begin CHARACTERISTIC C_ABC_MAX_LSH_DOWN "Maximum value of the anti-bounce counter for upstream O2-sensor heater command signal diagnosis." VALUE 0x42773 _REC_VAL_20_u1 254. _CNV_A_R_LINEAR_____10_CM 1. 255. FORMAT "%3.0" /end CHARACTERISTIC
/begin CHARACTERISTIC C_ABC_INC_LSH_DOWN "Anti-bounce counter increment for upstream O2-sensor heater signal diagnosis." VALUE 0x426ee _REC_VAL_20_u1 255. _CNV_A_R_LINEAR_____10_CM 0. 255. FORMAT "%3.0" /end CHARACTERISTIC
/begin CHARACTERISTIC C_ABC_INC_LSH_UP "Anti-bounce counter increment for upstream O2-sensor heater signal diagnosis." VALUE 0x426ef _REC_VAL_20_u1 255. _CNV_A_R_LINEAR_____10_CM 0. 255. FORMAT "%3.0" /end CHARACTERISTIC
/begin CHARACTERISTIC C_ABC_MAX_LSH_UP "Maximum value of the anti-bounce counter for upstream O2-sensor heater command signal diagnosis." VALUE 0x42774 _REC_VAL_20_u1 254. _CNV_A_R_LINEAR_____10_CM 1. 255. FORMAT "%3.0" /end CHARACTERISTIC
/begin MEASUREMENT T_MIN_LS "Time for the duration with open A/F control loop if the oxygen sensors are not ready" UWORD _CNV_A_R_LINEAR_____14_CM 1 100. 0.1 6553.5 ECU_ADDRESS 0x3fdc8c FORMAT "%6.1" /end MEASUREMENT
/begin MEASUREMENT LV_ERR_VLS_UP_STK_2 "voltage excursion error, UP 2" UBYTE _CNV_S_2_RANGE______184_R_CM 1 100. 0. 255. ECU_ADDRESS 0x3fd6d3 /end MEASUREMENT
/begin MEASUREMENT LV_ERR_VLS_UP_STK_1 "voltage excursion error, UP 1" UBYTE _CNV_S_2_RANGE______184_R_CM 1 100. 0. 255. ECU_ADDRESS 0x3fd6cf /end MEASUREMENT
/begin MEASUREMENT MAF_SP_S "MAF setpoint for stratified mode" UWORD _CNV_A_R_LINEAR_____95_CM 1 100. 0. 1389. ECU_ADDRESS 0x3fc606 FORMAT "%6.2" /end MEASUREMENT
/begin MEASUREMENT FAC_MAF_MAX_S "Ratio between MAF and MAF_MAX for stratified mode" UWORD _CNV_A_R_LINEAR_____45_CM 1 100. 0. 1.99996948 ECU_ADDRESS 0x3fdb12 FORMAT "%7.5" /end MEASUREMENT
/begin MEASUREMENT MAF_DIF_S "Air mass flow difference in stratified combustion" UWORD _CNV_A_R_LINEAR_____354_CM 1 100. -694.5 694.5 ECU_ADDRESS 0x3fdb10 FORMAT "%7.2" /end MEASUREMENT
/begin CHARACTERISTIC IP_PQ_EGR_SP "MAF setpoint for stratified mode" MAP 0x49dd0 _REC_MAP_20_u2_u1_u2 0.99998474 _CNV_A_R_LINEAR_____31_CM 0. 0.99998474 FORMAT "%7.5"
 /begin AXIS_DESCR COM_AXIS N_32 _CNV_A_R_LINEAR_____5_CM 8 0. 8160. FORMAT "%4.0" AXIS_PTS_REF ldp_n_32__pq_egr_sp /end AXIS_DESCR
 /begin AXIS_DESCR COM_AXIS MFF_SP_S _CNV_A_R_LINEAR_____95_CM 6 0. 1389. FORMAT "%7.2" AXIS_PTS_REF ldp_mff_sp_s__pq_egr_sp /end AXIS_DESCR
/end CHARACTERISTIC
/begin CHARACTERISTIC IP_FAC_MAF_MAX_S "Ratio between MAF and MAF_MAX for stratified mode" MAP 0x475ac _REC_MAP_20_u2_u1_u2 1.99996948 _CNV_A_R_LINEAR_____45_CM 0. 1.99996948 FORMAT "%7.5"
 /begin AXIS_DESCR COM_AXIS N_32 _CNV_A_R_LINEAR_____5_CM 8 0. 8160. FORMAT "%4.0" AXIS_PTS_REF ldp_n_32__fac_maf_max_s /end AXIS_DESCR
 /begin AXIS_DESCR COM_AXIS MFF_SP_S _CNV_A_R_LINEAR_____95_CM 6 0. 1389. FORMAT "%7.2" AXIS_PTS_REF ldp_mff_sp_s__fac_maf_max_s /end AXIS_DESCR
/end CHARACTERISTIC
/begin CHARACTERISTIC IP_EFF_MAF_S "AIR efficiency in stratified combustion" CURVE 0x46680 _REC_CUR_20_u2_u2 1.99996948 _CNV_A_R_LINEAR_____45_CM 0. 1.99996948 FORMAT "%7.5"
 /begin AXIS_DESCR COM_AXIS MAF_DIF_S _CNV_A_R_LINEAR_____354_CM 16 -694.5 694.5 FORMAT "%7.2" AXIS_PTS_REF ldp_maf_dif_s__eff_maf_s /end AXIS_DESCR
/end CHARACTERISTIC
/begin CHARACTERISTIC LC_MAF_SP_EGR "Logical variable switch mass flow and partial pressure" VALUE 0x42bb0 _REC_VAL_20_u1 1. _CNV_A_R_LINEAR_____12_CM 0. 1. FORMAT "%1.0" /end CHARACTERISTIC
/begin AXIS_PTS ldp_n_32__pq_egr_sp "" 0x435f1 N_32 _REC_AXS_20_u1 816. _CNV_A_R_LINEAR_____5_CM 8 0. 8160. FORMAT "%4.0" /end AXIS_PTS
/begin AXIS_PTS ldp_n_32__fac_maf_max_s "" 0x434e3 N_32 _REC_AXS_20_u1 816. _CNV_A_R_LINEAR_____5_CM 8 0. 8160. FORMAT "%4.0" /end AXIS_PTS
/begin AXIS_PTS ldp_mff_sp_s__fac_maf_max_s "" 0x44776 MFF_SP_S _REC_AXS_20_u2 1389. _CNV_A_R_LINEAR_____95_CM 6 0. 1389. FORMAT "%7.2" /end AXIS_PTS
/begin AXIS_PTS ldp_maf_dif_s__eff_maf_s "" 0x4455c MAF_DIF_S _REC_AXS_20_u2 1389. _CNV_A_R_LINEAR_____354_CM 16 -694.5 694.5 FORMAT "%7.2" /end AXIS_PTS
/begin AXIS_PTS ldp_mff_sp_s__pq_egr_sp "" 0x44784 MFF_SP_S _REC_AXS_20_u2 1389. _CNV_A_R_LINEAR_____95_CM 6 0. 1389. FORMAT "%7.2" /end AXIS_PTS
/begin MEASUREMENT MAF_SP "MAF setpoint output for inverse air path" UWORD _CNV_A_R_LINEAR_____95_CM 1 100. 0. 1389. ECU_ADDRESS 0x3fc6c2 FORMAT "%6.2" /end MEASUREMENT
/begin MEASUREMENT MAF_SP_ISA "MAF setpoint output for inverse air path of idle speed actuator (ISA)" UWORD _CNV_A_R_LINEAR_____95_CM 1 100. 0. 1389. ECU_ADDRESS 0x3fc6c4 FORMAT "%6.2" /end MEASUREMENT
/begin CHARACTERISTIC LC_ISA_ENA "logical constant enabled idle speed actuator (ISA)" VALUE 0x42ba3 _REC_VAL_20_u1 1. _CNV_A_R_LINEAR_____10_CM 0. 1. FORMAT "%2.0" /end CHARACTERISTIC
/begin MEASUREMENT LV_ISA_ENA "logical variable for enabled idle speed actuator (ISA)" UBYTE _CNV_S_2_RANGE______28_CM 1 100. 0. 1. ECU_ADDRESS 0x3fc6c6 /end MEASUREMENT
/begin CHARACTERISTIC IP_MAF_SP_ISA "Setpoint mass air flow idle speed actuator (ISA)" CURVE 0x49316 _REC_CUR_20_u2_u1 0.99998474 _CNV_A_R_LINEAR_____31_CM 0. 0.99998474 FORMAT "%7.5"
 /begin AXIS_DESCR COM_AXIS MAF_TURB_RATIO_MAX _CNV_A_R_LINEAR_____195_CM 8 0. 3.984375 FORMAT "%4.2" AXIS_PTS_REF ldp_maf_turb_ratio__maf_sp_isa /end AXIS_DESCR
/end CHARACTERISTIC
/begin MEASUREMENT MAF_TURB_RATIO_MAX "maximum mass air flow ratio turbolence system / total MAF" UBYTE _CNV_A_R_LINEAR_____195_CM 1 100. 0. 3.984375 ECU_ADDRESS 0x3fdb74 FORMAT "%4.2" /end MEASUREMENT
/begin AXIS_PTS ldp_maf_turb_ratio__maf_sp_isa "" 0x434b7 MAF_TURBO_RATIO_MAX _REC_AXS_20_u1 3.984375 _CNV_A_R_LINEAR_____195_CM 8 0. 3.984375 FORMAT "%4.2" /end AXIS_PTS
/begin CHARACTERISTIC C_ABC_INC_MAF "Debounce counter increment, mass air flow meter diagnosis" VALUE 0x426f0 _REC_VAL_20_u1 255. _CNV_A_R_LINEAR_____10_CM 0. 255. FORMAT "%3.0" /end CHARACTERISTIC
/begin CHARACTERISTIC C_ABC_MAX_MAF "Debounce counter maximum value, mass air flow meter diagnosis" VALUE 0x42775 _REC_VAL_20_u1 254. _CNV_A_R_LINEAR_____10_CM 1. 255. FORMAT "%3.0" /end CHARACTERISTIC
/begin CHARACTERISTIC C_ABC_INC_MIS_LOW_FUEL "Increment value of the anti - bounce counter for Bench mode" VALUE 0x426f1 _REC_VAL_20_u1 255. _CNV_A_R_LINEAR_____10_CM 0. 255. FORMAT "%3.0" /end CHARACTERISTIC
/begin CHARACTERISTIC C_ABC_MAX_MSW_2 "Debounce counter maximum value - MSW diagnosis" VALUE 0x42776 _REC_VAL_20_u1 254. _CNV_A_R_LINEAR_____10_CM 1. 255. FORMAT "%3.0" /end CHARACTERISTIC
/begin CHARACTERISTIC C_ABC_INC_MSW_2 "Debounce counter increment - MSW diagnosis" VALUE 0x426f2 _REC_VAL_20_u1 255. _CNV_A_R_LINEAR_____10_CM 0. 255. FORMAT "%3.0" /end CHARACTERISTIC
/begin CHARACTERISTIC C_ABC_INC_MSW_TOG "Debounce counter increment - Toggle bit monitoring" VALUE 0x426f4 _REC_VAL_20_u1 255. _CNV_A_R_LINEAR_____10_CM 0. 255. FORMAT "%3.0" /end CHARACTERISTIC
/begin CHARACTERISTIC C_ABC_MAX_MSW_TOG "Debounce counter maximum value - Toggle bit monitoring" VALUE 0x42778 _REC_VAL_20_u1 254. _CNV_A_R_LINEAR_____10_CM 1. 255. FORMAT "%3.0" /end CHARACTERISTIC
/begin CHARACTERISTIC C_ABC_INC_MSW_3 "Debounce counter increment - MSW diagnosis" VALUE 0x426f3 _REC_VAL_20_u1 255. _CNV_A_R_LINEAR_____10_CM 0. 255. FORMAT "%3.0" /end CHARACTERISTIC
/begin CHARACTERISTIC C_ABC_MAX_MSW_3 "Debounce counter maximum value - MSW diagnosis" VALUE 0x42777 _REC_VAL_20_u1 254. _CNV_A_R_LINEAR_____10_CM 1. 255. FORMAT "%3.0" /end CHARACTERISTIC
/begin CHARACTERISTIC C_MTCPWM_I_MAX_POS "Limitation of I-share upwards" VALUE 0x432a0 _REC_VAL_20_s2 199.99694824 _CNV_A_R_LINEAR_____173_CM -100. 99.99694824 FORMAT "%8.3" /end CHARACTERISTIC
/begin MEASUREMENT TPS_DIF "gradient of controller deviation" UWORD _CNV_A_R_LINEAR_____361_CM 1 100. -119.5 119.5 ECU_ADDRESS 0x3fd0ba FORMAT "%8.3" /end MEASUREMENT
/begin CHARACTERISTIC IP_MTCPWM_D__TPS_DIF_GRD "Position controller D-share" CURVE 0x4980a _REC_CUR_20_u2_u2 799.987793 _CNV_A_R_LINEAR_____362_CM -400. 399.987793 FORMAT "%7.2"
 /begin AXIS_DESCR COM_AXIS TPS_DIF_GRD _CNV_A_R_LINEAR_____361_CM 8 -119.5 119.5 FORMAT "%8.3" AXIS_PTS_REF ldp_tps_dif_grd__mtcpwm_d /end AXIS_DESCR
/end CHARACTERISTIC
/begin CHARACTERISTIC IP_MTCPWM_I__TPS_DIF "Position controller I-share" CURVE 0x4981a _REC_CUR_20_u2_u2 199.99694824 _CNV_A_R_LINEAR_____176_CM -100. 99.99694824 FORMAT "%8.3"
 /begin AXIS_DESCR COM_AXIS TPS_DIF _CNV_A_R_LINEAR_____361_CM 8 -119.5 119.5 FORMAT "%8.3" AXIS_PTS_REF ldp_tps_dif__mtcpwm_i /end AXIS_DESCR
/end CHARACTERISTIC
/begin CHARACTERISTIC IP_MTCPWM_P__TPS_DIF "Position controller P-share" CURVE 0x4982a _REC_CUR_20_u2_u2 799.987793 _CNV_A_R_LINEAR_____362_CM -400. 399.987793 FORMAT "%7.2"
 /begin AXIS_DESCR COM_AXIS TPS_DIF _CNV_A_R_LINEAR_____361_CM 8 -119.5 119.5 FORMAT "%8.3" AXIS_PTS_REF ldp_tps_dif__mtcpwm_p /end AXIS_DESCR
/end CHARACTERISTIC
/begin CHARACTERISTIC IP_MTCPWM_VB_FAC__VB "Battery voltage correction" CURVE 0x4fb7f _REC_CUR_20_u1_u1 1.99220002 _CNV_A_R_LINEAR_____34_CM 0. 1.99220002 FORMAT "%5.3"
 /begin AXIS_DESCR COM_AXIS VB _CNV_A_R_LINEAR_____26_CM 8 0. 25.8984 FORMAT "%3.1" AXIS_PTS_REF ldp_vb__mtcpwm_vb_fac /end AXIS_DESCR
/end CHARACTERISTIC
/begin MEASUREMENT MTCPWM_ADD "Duty cycle of the feed-forward-control" SWORD _CNV_A_R_LINEAR_____173_CM 1 100. -100. 99.99694824 ECU_ADDRESS 0x3fd0c2 FORMAT "%8.3" /end MEASUREMENT
/begin MEASUREMENT MTCPWM_CTL "Duty cycle of the PID-controller" SLONG _CNV_A_R_LINEAR_____363_CM 1 100. -400. 400. ECU_ADDRESS 0x3fd0b4 FORMAT "%8.3" /end MEASUREMENT
/begin MEASUREMENT MTCPWM_D "Duty cycle of the D-share" SWORD _CNV_A_R_LINEAR_____364_CM 1 100. -400. 399.987793 ECU_ADDRESS 0x3fe722 FORMAT "%7.2" /end MEASUREMENT
/begin MEASUREMENT MTCPWM_P "Duty cycle of the P-share" SWORD _CNV_A_R_LINEAR_____364_CM 1 100. -400. 399.987793 ECU_ADDRESS 0x3fe71e FORMAT "%7.2" /end MEASUREMENT
/begin MEASUREMENT MTCPWM_I "Duty cycle of the I-share" SWORD _CNV_A_R_LINEAR_____173_CM 1 100. -100. 99.99694824 ECU_ADDRESS 0x3fe720 FORMAT "%8.3" /end MEASUREMENT
/begin MEASUREMENT MTCPWM_I_ADD "Manipulated previous I-share" SWORD _CNV_A_R_LINEAR_____173_CM 1 100. -100. 99.99694824 ECU_ADDRESS 0x3fe728 FORMAT "%8.3" /end MEASUREMENT
/begin MEASUREMENT TPS_SP_LIH_DIF "Difference between TPS_SP and TPS_LIH" UWORD _CNV_A_R_LINEAR_____361_CM 1 100. -119.5 119.5 ECU_ADDRESS 0x3fd0c0 FORMAT "%8.3" /end MEASUREMENT
/begin CHARACTERISTIC C_TPS_SP_LIH_DIF_HYS "Hysteresis for detection of direction change" VALUE 0x430cc _REC_VAL_20_u2 119.5 _CNV_A_R_LINEAR_____226_CM 0. 119.5 FORMAT "%7.3" /end CHARACTERISTIC
/begin CHARACTERISTIC C_MTCPWM_I_MAX_NEG "Limitation of I-share downwards" VALUE 0x4329e _REC_VAL_20_s2 199.99694824 _CNV_A_R_LINEAR_____173_CM -100. 99.99694824 FORMAT "%8.3" /end CHARACTERISTIC
/begin CHARACTERISTIC C_MTCPWM_I_ADD "Init value for I-Part while TPS_SP_LIH_DIF is crossing LH" VALUE 0x4329a _REC_VAL_20_s2 199.99694824 _CNV_A_R_LINEAR_____173_CM -100. 99.99694824 FORMAT "%8.3" /end CHARACTERISTIC
/begin CHARACTERISTIC C_MTCPWM_ADD_FIL "Filter parameter" VALUE 0x42924 _REC_VAL_20_u1 0.9960940000000002 _CNV_A_R_LINEAR_____44_CM 0. 0.996094 FORMAT "%5.3" /end CHARACTERISTIC
/begin CHARACTERISTIC IP_MTCPWM_I_FAC__TPS_AV_LIH_DIF "Angle dependent I-part manipulation" CURVE 0x4fb77 _REC_CUR_20_u1_u2 7.96875 _CNV_A_R_LINEAR_____240_CM 0. 7.96875 FORMAT "%4.2"
 /begin AXIS_DESCR COM_AXIS TPS_AV_LIH_DIF _CNV_A_R_LINEAR_____361_CM 8 -119.5 119.5 FORMAT "%8.3" AXIS_PTS_REF ldp_tps_av_lih_dif_mtcpwm_i /end AXIS_DESCR
/end CHARACTERISTIC
/begin CHARACTERISTIC IP_MTCPWM_ADD__TPS_SP_LIH_DIF "Setpoint dependent Feed Forward Value" CURVE 0x497fa _REC_CUR_20_u2_u2 199.99694824 _CNV_A_R_LINEAR_____176_CM -100. 99.99694824 FORMAT "%8.3"
 /begin AXIS_DESCR COM_AXIS TPS_SP_LIH_DIF _CNV_A_R_LINEAR_____361_CM 8 -119.5 119.5 FORMAT "%8.3" AXIS_PTS_REF ldp_tps_sp_lih_dif__mtcpwm_add /end AXIS_DESCR
/end CHARACTERISTIC
/begin MEASUREMENT MTCPWM_VB_FAC "Battery voltage correction" UBYTE _CNV_A_R_LINEAR_____34_CM 1 100. 0. 1.99220002 ECU_ADDRESS 0x3fd0c4 FORMAT "%5.3" /end MEASUREMENT
/begin MEASUREMENT TPS_DIF_GRD "Controller deviation" UWORD _CNV_A_R_LINEAR_____361_CM 1 100. -119.5 119.5 ECU_ADDRESS 0x3fe724 /end MEASUREMENT
/begin MEASUREMENT T_MTCPWM_CLOSE_ACT "time counter for closing condition" UWORD _CNV_A_R_LINEAR_____365_CM 1 100. 0. 5110. ECU_ADDRESS 0x3fd0bc FORMAT "%5.0" /end MEASUREMENT
/begin MEASUREMENT TPS_SP_CTL "throttle position setpoint ( + or - )" SWORD _CNV_A_R_LINEAR_____366_CM 1 100. -119.5 119.5 ECU_ADDRESS 0x3fe726 FORMAT "%8.3" /end MEASUREMENT
/begin MEASUREMENT LV_TPS_SP_POS "position detection of TPS-setpoint (0: below LIH; 1: above LIH)" UBYTE _CNV_S_2_RANGE______28_CM 1 100. 0. 1. ECU_ADDRESS 0x3fe72a /end MEASUREMENT
/begin MEASUREMENT LV_TPS_CHG_POS "detection of changed direction from LV_TPS_SP_POS" UBYTE _CNV_S_2_RANGE______28_CM 1 100. 0. 1. ECU_ADDRESS 0x3fe72b /end MEASUREMENT
/begin CHARACTERISTIC C_T_MTCPWM_CLOSE_ACT_MAX "Timer threshold for switching to closing duty cycle" VALUE 0x4300e _REC_VAL_20_u2 5. _CNV_A_R_LINEAR_____367_CM 0. 5. FORMAT "%5.3" /end CHARACTERISTIC
/begin CHARACTERISTIC C_MTCPWM_CLOSE_MAX "duty cycle limitation at bottom mechanical limit" VALUE 0x43298 _REC_VAL_20_s2 199.99694824 _CNV_A_R_LINEAR_____173_CM -100. 99.99694824 FORMAT "%8.3" /end CHARACTERISTIC
/begin CHARACTERISTIC C_TPS_SP_STOP_HYS "setpoint hysteresis for closing throttle" VALUE 0x430e0 _REC_VAL_20_u2 119.5 _CNV_A_R_LINEAR_____226_CM 0. 119.5 FORMAT "%7.3" /end CHARACTERISTIC
/begin CHARACTERISTIC C_TPS_SP_STOP_MAX "threshold for testing duty cycle on value" VALUE 0x430e2 _REC_VAL_20_u2 119.5 _CNV_A_R_LINEAR_____226_CM 0. 119.5 FORMAT "%7.3" /end CHARACTERISTIC
/begin CHARACTERISTIC C_MTCPWM_I_INI "initialization of MTCPWM_I" VALUE 0x4329c _REC_VAL_20_s2 199.99694824 _CNV_A_R_LINEAR_____173_CM -100. 99.99694824 FORMAT "%8.3" /end CHARACTERISTIC
/begin CHARACTERISTIC C_TPS_SP_CTL_MAX "limitation of TPS_SP_CTL" VALUE 0x432d2 _REC_VAL_20_s2 119.5 _CNV_A_R_LINEAR_____366_CM -119.5 0. FORMAT "%8.3" /end CHARACTERISTIC
/begin CHARACTERISTIC C_MTCPWM_CLOSE "closing duty cycle" VALUE 0x43296 _REC_VAL_20_s2 199.99694824 _CNV_A_R_LINEAR_____173_CM -100. 99.99694824 FORMAT "%8.3" /end CHARACTERISTIC
/begin CHARACTERISTIC C_MTCPWM_HYS "hysteresis to prevent MTCPWM-switching according to VB-changes" VALUE 0x42e94 _REC_VAL_20_u2 100. _CNV_A_R_LINEAR_____368_CM 0. 100. FORMAT "%7.3" /end CHARACTERISTIC
/begin MEASUREMENT MTCPWM "Duty cycle of the ETC Position Controller" SWORD _CNV_A_R_LINEAR_____173_CM 1 100. -100. 99.99694824 ECU_ADDRESS 0x3fd0b8 FORMAT "%8.3" /end MEASUREMENT
/begin MEASUREMENT LV_MTCPWM_CLOSE_ACT "logical variable (is set, if closing duty cycle is active" UBYTE _CNV_S_2_RANGE______28_CM 1 100. 0. 1. ECU_ADDRESS 0x3fd0c5 /end MEASUREMENT
/begin MEASUREMENT TPS_AV_LIH_DIF "Difference between TPS_AV and TPS_LIH" UWORD _CNV_A_R_LINEAR_____361_CM 1 100. -119.5 119.5 ECU_ADDRESS 0x3fd0be FORMAT "%8.3" /end MEASUREMENT
/begin AXIS_PTS ldp_tps_dif__mtcpwm_p "" 0x44b80 TPS_DIF _REC_AXS_20_u2 239. _CNV_A_R_LINEAR_____361_CM 8 -119.5 119.5 FORMAT "%8.3" /end AXIS_PTS
/begin AXIS_PTS ldp_tps_dif__mtcpwm_i "" 0x44b6e TPS_DIF _REC_AXS_20_u2 239. _CNV_A_R_LINEAR_____361_CM 8 -119.5 119.5 FORMAT "%8.3" /end AXIS_PTS
/begin AXIS_PTS ldp_tps_av_lih_dif_mtcpwm_i "" 0x44b5c TPS_AV_LIH_DIF _REC_AXS_20_u2 239. _CNV_A_R_LINEAR_____361_CM 8 -119.5 119.5 FORMAT "%8.3" /end AXIS_PTS
/begin AXIS_PTS ldp_tps_dif_grd__mtcpwm_d "" 0x44b92 TPS_DIF_GRD _REC_AXS_20_u2 239. _CNV_A_R_LINEAR_____361_CM 8 -119.5 119.5 FORMAT "%8.3" /end AXIS_PTS
/begin AXIS_PTS ldp_tps_sp_lih_dif__mtcpwm_add "" 0x44be0 TPS_SP_LIH_DIF _REC_AXS_20_u2 239. _CNV_A_R_LINEAR_____361_CM 8 -119.5 119.5 FORMAT "%8.3" /end AXIS_PTS
/begin AXIS_PTS ldp_vb__mtcpwm_vb_fac "" 0x43ac2 VB _REC_AXS_20_u1 25.8984 _CNV_A_R_LINEAR_____26_CM 8 0. 25.8984 FORMAT "%3.1" /end AXIS_PTS
/begin CHARACTERISTIC C_ABC_INC_MTC_DR "Debounce counter increment,MTC driver diagnosis" VALUE 0x426f5 _REC_VAL_20_u1 255. _CNV_A_R_LINEAR_____10_CM 0. 255. FORMAT "%3.0" /end CHARACTERISTIC
/begin CHARACTERISTIC C_ABC_MAX_MTC_DR "Debounce counter maximum value, MTC driver diagnosis" VALUE 0x42779 _REC_VAL_20_u1 254. _CNV_A_R_LINEAR_____10_CM 1. 255. FORMAT "%3.0" /end CHARACTERISTIC
/begin CHARACTERISTIC C_MTCPWM_PI_MAX_DIAG "Diagnosis threshold for MTCPWM" VALUE 0x42e96 _REC_VAL_20_u2 100. _CNV_A_R_LINEAR_____368_CM 0. 100. FORMAT "%7.3" /end CHARACTERISTIC
/begin CHARACTERISTIC C_TPS_DIF_MAX_DIAG "Maximum permissible control variance" VALUE 0x430b2 _REC_VAL_20_u2 119.5 _CNV_A_R_LINEAR_____226_CM 0. 119.5 FORMAT "%7.3" /end CHARACTERISTIC
/begin CHARACTERISTIC C_T_TPS_DIF_DIAG "Tolerance time control variance" VALUE 0x42a2e _REC_VAL_20_u1 2.55 _CNV_A_R_LINEAR_____27_CM 0. 2.55 FORMAT "%4.2" /end CHARACTERISTIC
/begin CHARACTERISTIC C_T_MTCPWM_PI_DIAG_CUR_OFF "Time threshold for end \"break-away\"" VALUE 0x42a20 _REC_VAL_20_u1 2.55 _CNV_A_R_LINEAR_____27_CM 0. 2.55 FORMAT "%4.2" /end CHARACTERISTIC
/begin CHARACTERISTIC C_T_MTCPWM_PI_DIAG "Tolerance time MTCPWM-error" VALUE 0x42a1f _REC_VAL_20_u1 2.55 _CNV_A_R_LINEAR_____27_CM 0. 2.55 FORMAT "%4.2" /end CHARACTERISTIC
/begin MEASUREMENT LV_INH_MTC_CTL "State Bit for Deactivation of the ETC Position Controller Output" UBYTE _CNV_S_2_RANGE______28_CM 1 100. 0. 1. ECU_ADDRESS 0x3fd0b1 /end MEASUREMENT
/begin CHARACTERISTIC IP_N_MAX_TOL_ST "upper engine speed limit for ST" CURVE 0x4fc4c _REC_CUR_20_u1_u1 8160. _CNV_A_R_LINEAR_____5_CM 0. 8160. FORMAT "%4.0"
 /begin AXIS_DESCR COM_AXIS TCO _CNV_A_R_LINEAR_____0_CM 9 -48. 142.5 FORMAT "%5.1" AXIS_PTS_REF ldpm_tco_9 /end AXIS_DESCR
/end CHARACTERISTIC
/begin CHARACTERISTIC C_ABC_MAX_LAM_DLY "Maximum value of the anti - bounce counter" VALUE 0x42770 _REC_VAL_20_u1 254. _CNV_A_R_LINEAR_____10_CM 1. 255. FORMAT "%3.0" /end CHARACTERISTIC
/begin CHARACTERISTIC C_ABC_INC_LAM_DLY "Anti - bounce counter increment" VALUE 0x426eb _REC_VAL_20_u1 255. _CNV_A_R_LINEAR_____10_CM 0. 255. FORMAT "%3.0" /end CHARACTERISTIC
/begin CHARACTERISTIC C_ABC_INC_LOAD_TPS_PLAUS "ABC increment value" VALUE 0x426ec _REC_VAL_20_u1 255. _CNV_A_R_LINEAR_____10_CM 0. 255. FORMAT "%3.0" /end CHARACTERISTIC
/begin CHARACTERISTIC C_ABC_MAX_LOAD_TPS_PLAUS "ABC Maximum value" VALUE 0x42771 _REC_VAL_20_u1 254. _CNV_A_R_LINEAR_____10_CM 1. 255. FORMAT "%3.0" /end CHARACTERISTIC
/begin CHARACTERISTIC C_ABC_MAX_TOIL "Debounce counter maximum value - TOIL diagnosis" VALUE 0x42793 _REC_VAL_20_u1 254. _CNV_A_R_LINEAR_____10_CM 1. 255. FORMAT "%3.0" /end CHARACTERISTIC
/begin CHARACTERISTIC C_ABC_INC_TOIL "Debounce counter increment - TOIL diagnosis" VALUE 0x4270d _REC_VAL_20_u1 255. _CNV_A_R_LINEAR_____10_CM 0. 255. FORMAT "%3.0" /end CHARACTERISTIC
/begin MEASUREMENT T_POIL_SWI_PWL "Timer for oil pressure inclination after engine stop" UBYTE _CNV_A_R_LINEAR_____14_CM 1 100. 0. 6.2 ECU_ADDRESS 0x3fcc9e FORMAT "%3.1" /end MEASUREMENT
/begin CHARACTERISTIC C_ABC_INC_POIL_SWI "Anti bounce increment value, POIL_SWI" VALUE 0x426f7 _REC_VAL_20_u1 255. _CNV_A_R_LINEAR_____10_CM 0. 255. FORMAT "%3.0" /end CHARACTERISTIC
/begin CHARACTERISTIC C_ABC_MAX_POIL_SWI "Anti-bounce max. value, POIL_SWI" VALUE 0x4277b _REC_VAL_20_u1 254. _CNV_A_R_LINEAR_____10_CM 1. 255. FORMAT "%3.0" /end CHARACTERISTIC
/begin CHARACTERISTIC C_T_POIL_SWI_PWL "Time for oil pressure inclination" VALUE 0x42a25 _REC_VAL_20_u1 6.2 _CNV_A_R_LINEAR_____14_CM 0. 6.2 FORMAT "%3.1" /end CHARACTERISTIC
/begin CHARACTERISTIC C_TOIL_POIL_SWI_MAX_DIAG "Time for oil pressure inclination" VALUE 0x42acc _REC_VAL_20_u1 200. _CNV_A_R_LINEAR_____3_CM -40. 160. FORMAT "%3.0" /end CHARACTERISTIC
/begin CHARACTERISTIC C_TOIL_POIL_SWI_MIN_DIAG "Minimum diagnosis threshold TOIL" VALUE 0x42acd _REC_VAL_20_u1 200. _CNV_A_R_LINEAR_____3_CM -40. 160. FORMAT "%3.0" /end CHARACTERISTIC
/begin CHARACTERISTIC C_ABC_INC_IV "Debounce counter increment" VALUE 0x426e9 _REC_VAL_20_u1 255. _CNV_A_R_LINEAR_____10_CM 0. 255. FORMAT "%3.0" /end CHARACTERISTIC
/begin CHARACTERISTIC C_ABC_MAX_IV "Debounce counter maximum value" VALUE 0x4276e _REC_VAL_20_u1 254. _CNV_A_R_LINEAR_____10_CM 1. 255. FORMAT "%3.0" /end CHARACTERISTIC
/begin CHARACTERISTIC C_ABC_INC_VIM "Anti - Debounce counter increment for VIM driver diagnosis" VALUE 0x4272b _REC_VAL_20_u1 255. _CNV_A_R_LINEAR_____10_CM 0. 255. FORMAT "%3.0" /end CHARACTERISTIC
/begin CHARACTERISTIC C_ABC_MAX_VIM "Maximum value of anti - Debounce counter increment for VIM driver diagnosis" VALUE 0x427ad _REC_VAL_20_u1 254. _CNV_A_R_LINEAR_____10_CM 1. 255. FORMAT "%3.0" /end CHARACTERISTIC
/begin CHARACTERISTIC C_PV_COR_IS "Threshold for IS-detection" VALUE 0x4298c _REC_VAL_20_u1 99.609375 _CNV_A_R_LINEAR_____4_CM 0. 99.609375 FORMAT "%5.2" /end CHARACTERISTIC
/begin CHARACTERISTIC C_PV_COR_IS_HYS "Hysteresis for IS-detection" VALUE 0x4298d _REC_VAL_20_u1 99.609375 _CNV_A_R_LINEAR_____4_CM 0. 99.609375 FORMAT "%5.2" /end CHARACTERISTIC
/begin CHARACTERISTIC C_ABC_INC_PVS_RATIO "Increment debounce counter" VALUE 0x426fb _REC_VAL_20_u1 255. _CNV_A_R_LINEAR_____10_CM 0. 255. FORMAT "%3.0" /end CHARACTERISTIC
/begin CHARACTERISTIC C_ABC_MAX_PVS_RATIO "Maximum value debounce counter " VALUE 0x42781 _REC_VAL_20_u1 254. _CNV_A_R_LINEAR_____10_CM 1. 255. FORMAT "%3.0" /end CHARACTERISTIC
/begin CHARACTERISTIC C_ABC_MAX_PVS_H_R_1 "debounce counter maximum channel 1" VALUE 0x4277f _REC_VAL_20_u1 254. _CNV_A_R_LINEAR_____10_CM 1. 255. FORMAT "%3.0" /end CHARACTERISTIC
/begin CHARACTERISTIC C_ABC_MAX_PVS_H_R_2 "debounce counter maximum channel 2" VALUE 0x42780 _REC_VAL_20_u1 254. _CNV_A_R_LINEAR_____10_CM 1. 255. FORMAT "%3.0" /end CHARACTERISTIC
/begin CHARACTERISTIC C_ABC_MAX_PVS_BLS_NOT_PLAUS "" VALUE 0x4277e _REC_VAL_20_u1 254. _CNV_A_R_LINEAR_____10_CM 1. 255. FORMAT "%3.0" /end CHARACTERISTIC
/begin CHARACTERISTIC C_ABC_INC_PVS_BLS_NOT_PLAUS "" VALUE 0x426fa _REC_VAL_20_u1 255. _CNV_A_R_LINEAR_____10_CM 0. 255. FORMAT "%3.0" /end CHARACTERISTIC
/begin CHARACTERISTIC C_ABC_INC_V_REF_1 "Anti bounce increment value for V_REF_1" VALUE 0x42729 _REC_VAL_20_u1 255. _CNV_A_R_LINEAR_____10_CM 0. 255. FORMAT "%3.0" /end CHARACTERISTIC
/begin CHARACTERISTIC C_ABC_INC_V_REF_2 "Anti bounce increment value for V_REF_2" VALUE 0x4272a _REC_VAL_20_u1 255. _CNV_A_R_LINEAR_____10_CM 0. 255. FORMAT "%3.0" /end CHARACTERISTIC
/begin CHARACTERISTIC C_ABC_MAX_V_REF_1 "Anti-bounce maximum value (x=1,2)" VALUE 0x427ab _REC_VAL_20_u1 254. _CNV_A_R_LINEAR_____10_CM 1. 255. FORMAT "%3.0" /end CHARACTERISTIC
/begin CHARACTERISTIC C_ABC_MAX_V_REF_2 "Anti-bounce maximum value (x=1,2)" VALUE 0x427ac _REC_VAL_20_u1 254. _CNV_A_R_LINEAR_____10_CM 1. 255. FORMAT "%3.0" /end CHARACTERISTIC
/begin CHARACTERISTIC C_ABC_INC_PVS_1 "Anti-bounce increment value, PVS 1" VALUE 0x426f8 _REC_VAL_20_u1 255. _CNV_A_R_LINEAR_____10_CM 0. 255. FORMAT "%3.0" /end CHARACTERISTIC
/begin CHARACTERISTIC C_ABC_INC_PVS_2 "Anti-bounce increment value, PVS 2" VALUE 0x426f9 _REC_VAL_20_u1 255. _CNV_A_R_LINEAR_____10_CM 0. 255. FORMAT "%3.0" /end CHARACTERISTIC
/begin CHARACTERISTIC C_ABC_MAX_PVS_1 "Anti-bounce maximum value, PVS 1" VALUE 0x4277c _REC_VAL_20_u1 254. _CNV_A_R_LINEAR_____10_CM 1. 255. FORMAT "%3.0" /end CHARACTERISTIC
/begin CHARACTERISTIC C_ABC_MAX_PVS_2 "Anti-bounce maximum value, PVS 2" VALUE 0x4277d _REC_VAL_20_u1 254. _CNV_A_R_LINEAR_____10_CM 1. 255. FORMAT "%3.0" /end CHARACTERISTIC
/begin CHARACTERISTIC C_ABC_INC_RLY_MAIN "Debounce counter increment - RLY_MAIN diagnosis" VALUE 0x426ff _REC_VAL_20_u1 255. _CNV_A_R_LINEAR_____10_CM 0. 255. FORMAT "%3.0" /end CHARACTERISTIC
/begin CHARACTERISTIC C_ABC_MAX_RLY_MAIN "Debounce counter maximum value - RLY_MAIN diagnosis" VALUE 0x42785 _REC_VAL_20_u1 254. _CNV_A_R_LINEAR_____10_CM 1. 255. FORMAT "%3.0" /end CHARACTERISTIC
/begin CHARACTERISTIC C_V_SOF_SWI_MIN "Input voltage threshold min" VALUE 0x43130 _REC_VAL_20_u2 4.99511719 _CNV_A_R_LINEAR_____33_CM 0. 4.99511719 FORMAT "%5.3" /end CHARACTERISTIC
/begin CHARACTERISTIC C_ABC_INC_SOF_REQ "Anti - bounce counter increment" VALUE 0x42705 _REC_VAL_20_u1 255. _CNV_A_R_LINEAR_____10_CM 0. 255. FORMAT "%3.0" /end CHARACTERISTIC
/begin CHARACTERISTIC C_ABC_MAX_SOF_REQ "Debounce counter maximum value" VALUE 0x4278b _REC_VAL_20_u1 254. _CNV_A_R_LINEAR_____10_CM 1. 255. FORMAT "%3.0" /end CHARACTERISTIC
/begin CHARACTERISTIC C_V_SOF_SWI_MAX "Input voltage threshold max" VALUE 0x4312e _REC_VAL_20_u2 4.99511719 _CNV_A_R_LINEAR_____33_CM 0. 4.99511719 FORMAT "%5.3" /end CHARACTERISTIC
/begin MEASUREMENT LV_ERR_SOF_REQ "Erroflag sport-mode switch request" UBYTE _CNV_S_2_RANGE______21_R_CM 1 100. 0. 255. ECU_ADDRESS 0x3fd5fb /end MEASUREMENT
/begin CHARACTERISTIC C_ABC_INC_SOF "Anti - bounce counter increment" VALUE 0x42704 _REC_VAL_20_u1 255. _CNV_A_R_LINEAR_____10_CM 0. 255. FORMAT "%3.0" /end CHARACTERISTIC
/begin CHARACTERISTIC C_ABC_MAX_SOF "Debounce counter maximum value" VALUE 0x4278a _REC_VAL_20_u1 254. _CNV_A_R_LINEAR_____10_CM 1. 255. FORMAT "%3.0" /end CHARACTERISTIC
/begin MEASUREMENT LV_ERR_SOF "Erroflag sound flap" UBYTE _CNV_S_2_RANGE______21_R_CM 1 100. 0. 255. ECU_ADDRESS 0x3fd5f7 /end MEASUREMENT
/begin CHARACTERISTIC C_ABC_INC_TCO_GRD_DIAG "Debounce counter increment - TCO Signal gradient diagnosis" VALUE 0x42708 _REC_VAL_20_u1 255. _CNV_A_R_LINEAR_____10_CM 0. 255. FORMAT "%3.0" /end CHARACTERISTIC
/begin CHARACTERISTIC C_ABC_MAX_TCO_GRD_DIAG "Debounce counter maximum value - TCO Signal gradient diagnosis" VALUE 0x4278e _REC_VAL_20_u1 254. _CNV_A_R_LINEAR_____10_CM 1. 255. FORMAT "%3.0" /end CHARACTERISTIC
/begin CHARACTERISTIC C_ABC_MAX_TCO_EL "Debounce counter maximum value - TCO diagnosis" VALUE 0x4278c _REC_VAL_20_u1 254. _CNV_A_R_LINEAR_____10_CM 1. 255. FORMAT "%3.0" /end CHARACTERISTIC
/begin CHARACTERISTIC C_ABC_INC_TCO_EL "Debounce counter increment- TCO diagnosis" VALUE 0x42706 _REC_VAL_20_u1 255. _CNV_A_R_LINEAR_____10_CM 0. 255. FORMAT "%3.0" /end CHARACTERISTIC
/begin CHARACTERISTIC C_ABC_INC_TCO_EX "Debounce counter increment - TCO_EX diagnosis" VALUE 0x42707 _REC_VAL_20_u1 255. _CNV_A_R_LINEAR_____10_CM 0. 255. FORMAT "%3.0" /end CHARACTERISTIC
/begin CHARACTERISTIC C_ABC_MAX_TCO_EX "Debounce counter maximum value- TCO_EX diagnosis" VALUE 0x4278d _REC_VAL_20_u1 254. _CNV_A_R_LINEAR_____10_CM 1. 255. FORMAT "%3.0" /end CHARACTERISTIC
/begin CHARACTERISTIC C_ABC_INC_TQ_GS_INC_PLAUS "Debounce counter increment - TQ_GS_INC Diagnosis" VALUE 0x42723 _REC_VAL_20_u1 255. _CNV_A_R_LINEAR_____10_CM 0. 255. FORMAT "%3.0" /end CHARACTERISTIC
/begin CHARACTERISTIC C_ABC_MAX_TQ_GS_INC_PLAUS "Debounce counter maximum - TQ_GS_INC Diagnosis" VALUE 0x427a5 _REC_VAL_20_u1 254. _CNV_A_R_LINEAR_____10_CM 1. 255. FORMAT "%3.0" /end CHARACTERISTIC
/begin MEASUREMENT INT_TQ_GS_INC "Integrated Torque request EGS" UWORD _CNV_A_R_LINEAR_____89_CM 1 100. 0. 204.7 ECU_ADDRESS 0x3fd01e FORMAT "%7.3" /end MEASUREMENT
/begin MEASUREMENT LV_AC_MAX_TQ_GS_INC "GS about AC requested torque value to high and not plausible" UBYTE _CNV_S_2_RANGE______28_CM 1 100. 0. 1. ECU_ADDRESS 0x3fd026 /end MEASUREMENT
/begin MEASUREMENT LV_T_MIN_TQ_GS_INC_DEAC "Minimum time between two requests to low" UBYTE _CNV_S_2_RANGE______28_CM 1 100. 0. 1. ECU_ADDRESS 0x3fd027 /end MEASUREMENT
/begin MEASUREMENT CTR_T_DIF_MIN_TQ_GS_INC "Counter Min time limit threshold time delay" UBYTE _CNV_A_R_LINEAR_____27_CM 1 100. 0. 2.55 ECU_ADDRESS 0x3fe646 FORMAT "%4.2" /end MEASUREMENT
/begin MEASUREMENT STATE_GS_PLAUS "State GS torque increase not plausible" UBYTE _CNV_A_R_LINEAR_____10_CM 1 100. 0. 255. ECU_ADDRESS 0x3fd020 FORMAT "%3.0" /end MEASUREMENT
/begin MEASUREMENT LV_VS_MIN_TQ_GS_INC "GS about VS torque increase not plausible" UBYTE _CNV_S_2_RANGE______28_CM 1 100. 0. 1. ECU_ADDRESS 0x3fd024 /end MEASUREMENT
/begin MEASUREMENT CTR_T_VS_TQ_GS_INC "Vehicle speed threshold time delay" UBYTE _CNV_A_R_LINEAR_____27_CM 1 100. 0. 2.55 ECU_ADDRESS 0x3fe644 FORMAT "%4.2" /end MEASUREMENT
/begin CHARACTERISTIC C_INT_TQ_GS_INC_REST "Minimum integrated GS intervention torque" VALUE 0x42da4 _REC_VAL_20_u2 204.7 _CNV_A_R_LINEAR_____89_CM 0. 204.7 FORMAT "%7.3" /end CHARACTERISTIC
/begin CHARACTERISTIC C_VS_MIN_TQ_GS_INC "Vehicle speed threshold" VALUE 0x431d6 _REC_VAL_20_u2 511.99218 _CNV_A_R_LINEAR_____78_CM 0. 511.99218 FORMAT "%7.3" /end CHARACTERISTIC
/begin CHARACTERISTIC C_T_DLY_MIN_VS_TQ_GS_INC "Vehicle speed threshold time delay" VALUE 0x429ee _REC_VAL_20_u1 2.55 _CNV_A_R_LINEAR_____27_CM 0. 2.55 FORMAT "%4.2" /end CHARACTERISTIC
/begin CHARACTERISTIC C_CRLC_TQ_GS_INC_PLAUS "Correlation of torque request " VALUE 0x4283d _REC_VAL_20_u1 0.99610001 _CNV_A_R_LINEAR_____20_CM 0. 0.99610001 FORMAT "%5.3" /end CHARACTERISTIC
/begin CHARACTERISTIC C_INT_MAX_TQ_GS_INC "Max value integrated torque" VALUE 0x42d9c _REC_VAL_20_u2 204.7 _CNV_A_R_LINEAR_____89_CM 0. 204.7 FORMAT "%7.3" /end CHARACTERISTIC
/begin CHARACTERISTIC C_INT_MIN_TQ_GS_INC "Min value integrated torque" VALUE 0x42da0 _REC_VAL_20_u2 204.7 _CNV_A_R_LINEAR_____89_CM 0. 204.7 FORMAT "%7.3" /end CHARACTERISTIC
/begin CHARACTERISTIC C_T_DLY_MIN_AC_TQ_GS_INC "AC threshold time delay" VALUE 0x429ed _REC_VAL_20_u1 2.55 _CNV_A_R_LINEAR_____27_CM 0. 2.55 FORMAT "%4.2" /end CHARACTERISTIC
/begin MEASUREMENT LV_INT_MAX_TQ_GS_INC "Gs requested torque value to high and not plausible" UBYTE _CNV_S_2_RANGE______28_CM 1 100. 0. 1. ECU_ADDRESS 0x3fd025 /end MEASUREMENT
/begin MEASUREMENT CTR_T_AC_TQ_GS_INC "AC counter time delay" UBYTE _CNV_A_R_LINEAR_____27_CM 1 100. 0. 2.55 ECU_ADDRESS 0x3fe645 FORMAT "%4.2" /end MEASUREMENT
/begin CHARACTERISTIC C_T_DIF_MIN_TQ_GS_INC "Min time limit threshold time delay" VALUE 0x429d2 _REC_VAL_20_u1 2.55 _CNV_A_R_LINEAR_____27_CM 0. 2.55 FORMAT "%4.2" /end CHARACTERISTIC
/begin MEASUREMENT LV_T_MAX_TQ_GS_INC "Requesting time to long" UBYTE _CNV_S_2_RANGE______28_CM 1 100. 0. 1. ECU_ADDRESS 0x3fd028 /end MEASUREMENT
/begin MEASUREMENT CTR_T_MAX_TQ_GS_INC "Counter MAX time limit threshold time" UBYTE _CNV_A_R_LINEAR_____27_CM 1 100. 0. 2.55 ECU_ADDRESS 0x3fe647 FORMAT "%4.2" /end MEASUREMENT
/begin CHARACTERISTIC IP_AC_MAX_TQ_GS_INC "Acceleration threshold" CURVE 0x45f50 _REC_CUR_20_u2_u2 31.44 _CNV_A_R_LINEAR_____90_CM -15.72 15.72 FORMAT "%7.4"
 /begin AXIS_DESCR COM_AXIS VS_FIL _CNV_A_R_LINEAR_____78_CM 6 0. 511.99218 FORMAT "%7.3" AXIS_PTS_REF ldp_vs_fil__tq_gs_inc /end AXIS_DESCR
/end CHARACTERISTIC
/begin CHARACTERISTIC IP_TQ_MAX_TQ_GS_INC "Maximum requested torque EGS" CURVE 0x4c374 _REC_CUR_20_u2_u1 1023.96875 _CNV_A_R_LINEAR_____48_CM 0. 1023.96875 FORMAT "%7.2"
 /begin AXIS_DESCR COM_AXIS N_32 _CNV_A_R_LINEAR_____5_CM 6 0. 8160. FORMAT "%4.0" AXIS_PTS_REF ldp_n_32__tq_gs_inc /end AXIS_DESCR
/end CHARACTERISTIC
/begin CHARACTERISTIC C_T_MAX_TQ_GS_INC "Min time limit threshold time delay" VALUE 0x42a14 _REC_VAL_20_u1 2.55 _CNV_A_R_LINEAR_____27_CM 0. 2.55 FORMAT "%4.2" /end CHARACTERISTIC
/begin CHARACTERISTIC C_T_DLY_TQ_MAX_TQ_GS_INC "Min time limit threshold time delay" VALUE 0x429f5 _REC_VAL_20_u1 2.55 _CNV_A_R_LINEAR_____27_CM 0. 2.55 FORMAT "%4.2" /end CHARACTERISTIC
/begin MEASUREMENT STATE_ERR_AMT_CAN "State of AMT Error intervention CAN 11H" UBYTE _CNV_A_R_LINEAR_____10_CM 1 100. 0. 5. ECU_ADDRESS 0x3fd022 FORMAT "%2.0" /end MEASUREMENT
/begin MEASUREMENT LV_AMT_ES_REQ "AMT request of engine stop" UBYTE _CNV_S_2_RANGE______28_CM 1 100. 0. 1. ECU_ADDRESS 0x3fd02a /end MEASUREMENT
/begin MEASUREMENT T_STATE_AMT_1_DIAG "Intervention  in shift phase 1" UWORD _CNV_A_R_LINEAR_____27_CM 1 100. 0. 655.35 ECU_ADDRESS 0x3fe638 FORMAT "%6.2" /end MEASUREMENT
/begin MEASUREMENT T_STATE_AMT_2_DIAG "Intervention  in shift phase 2" UWORD _CNV_A_R_LINEAR_____27_CM 1 100. 0. 655.35 ECU_ADDRESS 0x3fe63a FORMAT "%6.2" /end MEASUREMENT
/begin MEASUREMENT T_STATE_AMT_3_DIAG "Intervention  in shift phase 3" UWORD _CNV_A_R_LINEAR_____27_CM 1 100. 0. 655.35 ECU_ADDRESS 0x3fe63c FORMAT "%6.2" /end MEASUREMENT
/begin MEASUREMENT STATE_ERR_AMT "State of AMT Error intervention" UBYTE _CNV_A_R_LINEAR_____10_CM 1 100. 0. 255. ECU_ADDRESS 0x3fd021 FORMAT "%3.0" /end MEASUREMENT
/begin MEASUREMENT STATE_AMT_OLD "Previos shift phase3" UBYTE _CNV_A_R_LINEAR_____10_CM 1 100. 0. 3. ECU_ADDRESS 0x3fe649 FORMAT "%2.0" /end MEASUREMENT
/begin MEASUREMENT T_STATE_CLU_AMT_DIAG "Timer clutch state " UWORD _CNV_A_R_LINEAR_____27_CM 1 100. 0. 655.35 ECU_ADDRESS 0x3fe642 FORMAT "%6.2" /end MEASUREMENT
/begin CHARACTERISTIC C_VS_FIL_AMT "Vehicle speed threshold  engine stop" VALUE 0x431c8 _REC_VAL_20_u2 511.99218 _CNV_A_R_LINEAR_____78_CM 0. 511.99218 FORMAT "%7.3" /end CHARACTERISTIC
/begin CHARACTERISTIC C_T_MAX_STATE_AMT_1_DIAG "Max Intervention  in shift phase 1" VALUE 0x42ff4 _REC_VAL_20_u2 655.35 _CNV_A_R_LINEAR_____27_CM 0. 655.35 FORMAT "%6.2" /end CHARACTERISTIC
/begin CHARACTERISTIC C_T_MAX_STATE_AMT_2_DIAG "Max Intervention  in shift phase 2" VALUE 0x42ff6 _REC_VAL_20_u2 655.35 _CNV_A_R_LINEAR_____27_CM 0. 655.35 FORMAT "%6.2" /end CHARACTERISTIC
/begin CHARACTERISTIC C_T_MAX_TQI_AMT_DIAG "Max. timer shift intervention phase 1or 3" VALUE 0x42ffc _REC_VAL_20_u2 655.35 _CNV_A_R_LINEAR_____27_CM 0. 655.35 FORMAT "%6.2" /end CHARACTERISTIC
/begin CHARACTERISTIC C_TQI_AMT_DIAG "Plausibility torque intervention hysteresis" VALUE 0x43106 _REC_VAL_20_u2 1023.96875 _CNV_A_R_LINEAR_____48_CM 0. 1023.96875 FORMAT "%7.2" /end CHARACTERISTIC
/begin CHARACTERISTIC C_TQI_AMT_COND_DIAG "Torque at shift phase 0" VALUE 0x43104 _REC_VAL_20_u2 1023.96875 _CNV_A_R_LINEAR_____48_CM 0. 1023.96875 FORMAT "%7.2" /end CHARACTERISTIC
/begin CHARACTERISTIC C_TQI_AMT_CAN_ES "Torque at engine stop" VALUE 0x43102 _REC_VAL_20_u2 1023.96875 _CNV_A_R_LINEAR_____48_CM 0. 1023.96875 FORMAT "%7.2" /end CHARACTERISTIC
/begin CHARACTERISTIC C_T_MAX_STATE_AMT_3_DIAG "Max Intervention  in shift phase 3" VALUE 0x42ff8 _REC_VAL_20_u2 655.35 _CNV_A_R_LINEAR_____27_CM 0. 655.35 FORMAT "%6.2" /end CHARACTERISTIC
/begin CHARACTERISTIC C_T_MAX_STATE_CLU_AMT_DIAG "Max. time at clutch" VALUE 0x42ffa _REC_VAL_20_u2 655.35 _CNV_A_R_LINEAR_____27_CM 0. 655.35 FORMAT "%6.2" /end CHARACTERISTIC
/begin MEASUREMENT LV_TQ_MAX_TQ_GS_INC "Inegrated torque to high" UBYTE _CNV_S_2_RANGE______28_CM 1 100. 0. 1. ECU_ADDRESS 0x3fd029 /end MEASUREMENT
/begin MEASUREMENT CTR_T_TQ_MAX_TQ_GS_INC "Min time limit threshold time delay" UBYTE _CNV_A_R_LINEAR_____27_CM 1 100. 0. 2.55 ECU_ADDRESS 0x3fe648 FORMAT "%4.2" /end MEASUREMENT
/begin MEASUREMENT TQI_AMT_PLAUS "Plausibility torque" UWORD _CNV_A_R_LINEAR_____48_CM 1 100. 0. 1023.96875 ECU_ADDRESS 0x3fe636 FORMAT "%7.2" /end MEASUREMENT
/begin AXIS_PTS ldp_vs_fil__tq_gs_inc "" 0x44e2a VS_FIL _REC_AXS_20_u2 511.99218 _CNV_A_R_LINEAR_____78_CM 6 0. 511.99218 FORMAT "%7.3" /end AXIS_PTS
/begin AXIS_PTS ldp_n_32__tq_gs_inc "" 0x43635 N_32 _REC_AXS_20_u1 8160. _CNV_A_R_LINEAR_____5_CM 6 0. 8160. FORMAT "%4.0" /end AXIS_PTS
/begin MEASUREMENT LV_ERR_TQ_GS_INC_PLAUS "GS torque increase not plausible" UBYTE _CNV_S_2_RANGE______21_R_CM 1 100. 0. 255. ECU_ADDRESS 0x3fd613 /end MEASUREMENT
/begin MEASUREMENT LV_ERR_TECU "TECU error flag" UBYTE _CNV_S_2_RANGE______21_R_CM 1 100. 0. 255. ECU_ADDRESS 0x3fd5c3 /end MEASUREMENT
/begin CHARACTERISTIC C_TIA_MAX_TECU_DIAG "TIA threshold - TECU diagnosis" VALUE 0x42ab3 _REC_VAL_20_u1 190.5 _CNV_A_R_LINEAR_____0_CM -48. 142.5 FORMAT "%5.1" /end CHARACTERISTIC
/begin CHARACTERISTIC C_ABC_MAX_TECU "Maximum value of the anti - bounce counter" VALUE 0x42790 _REC_VAL_20_u1 254. _CNV_A_R_LINEAR_____10_CM 1. 255. FORMAT "%3.0" /end CHARACTERISTIC
/begin CHARACTERISTIC C_ABC_INC_TECU "Anti - bounce counter increment" VALUE 0x4270a _REC_VAL_20_u1 255. _CNV_A_R_LINEAR_____10_CM 0. 255. FORMAT "%3.0" /end CHARACTERISTIC
/begin CHARACTERISTIC C_V_TECU_MIN_DIAG "V_TECU threshold for short to VB or line break - TECU diagnosis" VALUE 0x43138 _REC_VAL_20_u2 4.99511719 _CNV_A_R_LINEAR_____33_CM 0. 4.99511719 FORMAT "%5.3" /end CHARACTERISTIC
/begin CHARACTERISTIC C_V_TECU_MAX_DIAG "V_TECU threshold for short to ground - TECU diagnosis" VALUE 0x43136 _REC_VAL_20_u2 4.99511719 _CNV_A_R_LINEAR_____33_CM 0. 4.99511719 FORMAT "%5.3" /end CHARACTERISTIC
/begin CHARACTERISTIC C_ABC_INC_TEG_PCAT_DOWN "debounce counter increment-TEG diagnosis" VALUE 0x4270b _REC_VAL_20_u1 255. _CNV_A_R_LINEAR_____10_CM 0. 255. FORMAT "%3.0" /end CHARACTERISTIC
/begin CHARACTERISTIC C_ABC_MAX_TEG_PCAT_DOWN "debounce counter maximumt-TEG diagnosis" VALUE 0x42791 _REC_VAL_20_u1 254. _CNV_A_R_LINEAR_____10_CM 1. 255. FORMAT "%3.0" /end CHARACTERISTIC
/begin MEASUREMENT MAP_SP "Setpoint of the manifold pressure" UWORD _CNV_A_R_LINEAR_____43_CM 1 100. 0. 5434. ECU_ADDRESS 0x3fe684 FORMAT "%7.2" /end MEASUREMENT
/begin MEASUREMENT PQ_SP "Setpoint of the pressure quotient" UWORD _CNV_A_R_LINEAR_____31_CM 1 100. 0. 0.99998474 ECU_ADDRESS 0x3fe686 FORMAT "%7.5" /end MEASUREMENT
/begin MEASUREMENT MAF_SP_RATIO "Setpoint of the ratio MAF_SP / MAF_MAX_COR" UWORD _CNV_A_R_LINEAR_____31_CM 1 100. 0. 0.99998474 ECU_ADDRESS 0x3fe680 FORMAT "%7.5" /end MEASUREMENT
/begin MEASUREMENT AMP_MDL_IVS "Ambient pressure used for model adjustment inverse" UWORD _CNV_A_R_LINEAR_____43_CM 1 100. 0. 5434. ECU_ADDRESS 0x3fe68a FORMAT "%7.2" /end MEASUREMENT
/begin MEASUREMENT PRS_UP_THR_IVS "Pressure upstream the throttle inverse" UWORD _CNV_A_R_LINEAR_____43_CM 1 100. 0. 5434. ECU_ADDRESS 0x3fe68c FORMAT "%7.2" /end MEASUREMENT
/begin MEASUREMENT AR_RED_SP_MMV_1 "Moving mean value of AR_RED_SP_1" UWORD _CNV_A_R_LINEAR_____171_CM 1 100. 0. 58.592855 ECU_ADDRESS 0x3fe690 FORMAT "%7.4" /end MEASUREMENT
/begin MEASUREMENT AR_RED_SP_MMV "Moving mean value of desired reduced area" UWORD _CNV_A_R_LINEAR_____171_CM 1 100. 0. 58.592855 ECU_ADDRESS 0x3fe692 FORMAT "%7.4" /end MEASUREMENT
/begin MEASUREMENT TPS_SP_MDL_BAS "Setpoint of the throttle position before maximum check         " UWORD _CNV_A_R_LINEAR_____226_CM 1 100. 0. 119.5 ECU_ADDRESS 0x3fe694 FORMAT "%7.3" /end MEASUREMENT
/begin MEASUREMENT TPS_SP_MDL "Setpoint throttle position" UWORD _CNV_A_R_LINEAR_____226_CM 1 100. 0. 119.5 ECU_ADDRESS 0x3fd044 FORMAT "%7.3" /end MEASUREMENT
/begin MEASUREMENT TPS_SP_MDL_MAX "Setpoint throttle position after limitation" UWORD _CNV_A_R_LINEAR_____226_CM 1 100. 0. 119.5 ECU_ADDRESS 0x3fe696 FORMAT "%7.3" /end MEASUREMENT
/begin MEASUREMENT TPS_SP_MDL_BAS_COR "Setpoint throttle position after linear interpolation      " UWORD _CNV_A_R_LINEAR_____226_CM 1 100. 0. 119.5 ECU_ADDRESS 0x3fe698 FORMAT "%7.3" /end MEASUREMENT
/begin CHARACTERISTIC IP_AMP_DEC__MAF_KGH_SP "pressure decrease in the air cleaner" CURVE 0x45fb0 _REC_CUR_20_u2_u2 5434. _CNV_A_R_LINEAR_____43_CM 0. 5434. FORMAT "%7.2"
 /begin AXIS_DESCR COM_AXIS MAF_KGH_SP _CNV_A_R_LINEAR_____101_CM 4 0. 2047.96875 FORMAT "%6.2" AXIS_PTS_REF ldp_maf_kgh_sp__amp_dec /end AXIS_DESCR
/end CHARACTERISTIC
/begin CHARACTERISTIC IP_TPS_SP_MDL_MAX__N_32__MAF_SP "Maximum throttle position setpoint at ignition key on" MAP 0x4bcec _REC_MAP_20_u2_u1_u2 119.5 _CNV_A_R_LINEAR_____226_CM 0. 119.5 FORMAT "%7.3"
 /begin AXIS_DESCR COM_AXIS N_32 _CNV_A_R_LINEAR_____5_CM 8 0. 8160. FORMAT "%4.0" AXIS_PTS_REF ldp_n_32__tps_sp_mdl_max /end AXIS_DESCR
 /begin AXIS_DESCR COM_AXIS MAF_SP _CNV_A_R_LINEAR_____95_CM 4 0. 1389. FORMAT "%7.2" AXIS_PTS_REF ldp_maf_sp__tps_sp_mdl_max /end AXIS_DESCR
/end CHARACTERISTIC
/begin CHARACTERISTIC LC_AR_RED_FIL_ENA "Logical variable enabled for reduced throttle area filter" VALUE 0x42b66 _REC_VAL_20_u1 1. _CNV_A_R_LINEAR_____12_CM 0. 1. FORMAT "%1.0" /end CHARACTERISTIC
/begin CHARACTERISTIC LC_TPS_FIL_ENA "Logical variable enabled for throttle position setpoint filter" VALUE 0x42bd3 _REC_VAL_20_u1 1. _CNV_A_R_LINEAR_____12_CM 0. 1. FORMAT "%1.0" /end CHARACTERISTIC
/begin MEASUREMENT MAF_KGH_SP "Setpoint mass air flow into the manifold" UWORD _CNV_A_R_LINEAR_____101_CM 1 100. 0. 2047.96875 ECU_ADDRESS 0x3fe682 FORMAT "%7.2" /end MEASUREMENT
/begin CHARACTERISTIC IP_CRLC_AR_RED_SP "correlation constant for the moving mean value calculation of AR_RED_SP" CURVE 0x4da2f _REC_CUR_20_u1_u2 0.9960940000000002 _CNV_A_R_LINEAR_____44_CM 0. 0.996094 FORMAT "%5.3"
 /begin AXIS_DESCR COM_AXIS PQ_SP _CNV_A_R_LINEAR_____31_CM 8 0. 0.99998474 FORMAT "%7.5" AXIS_PTS_REF ldp_pq_sp__crlc_ar_red_sp /end AXIS_DESCR
/end CHARACTERISTIC
/begin CHARACTERISTIC IP_TPS_SP_MDL_BAS "throttle position setpoint (!inverse of IP_AR_RED_THR__TPS_SEG!)" CURVE 0x4bccc _REC_CUR_20_u2_u2 119.5 _CNV_A_R_LINEAR_____226_CM 0. 119.5 FORMAT "%7.3"
 /begin AXIS_DESCR COM_AXIS AR_RED_SP_MMV _CNV_A_R_LINEAR_____171_CM 16 0. 58.592855 FORMAT "%7.4" AXIS_PTS_REF ldp_ar_red_sp_mmv /end AXIS_DESCR
/end CHARACTERISTIC
/begin CHARACTERISTIC LC_INH_ISAPWM_MAN_AS "logical variable to inhibit ISAPWM setpoint by application system" VALUE 0x42b95 _REC_VAL_20_u1 1. _CNV_A_R_LINEAR_____10_CM 0. 1. FORMAT "%2.0" /end CHARACTERISTIC
/begin CHARACTERISTIC C_CYCNR_ISA_OFF "Number of cycles at ignition key off for ISA shakers" VALUE 0x42877 _REC_VAL_20_u1 255. _CNV_A_R_LINEAR_____10_CM 0. 255. FORMAT "%3.0" /end CHARACTERISTIC
/begin CHARACTERISTIC C_ISAPWM_OFF_HIGH "ISAPWM during opening phase" VALUE 0x42db2 _REC_VAL_20_u2 99.99847412 _CNV_A_R_LINEAR_____94_CM 0. 99.99847412 /end CHARACTERISTIC
/begin CHARACTERISTIC C_ISAPWM_OFF_LOW "ISAPWM during closing phase" VALUE 0x42db4 _REC_VAL_20_u2 99.99847412 _CNV_A_R_LINEAR_____94_CM 0. 99.99847412 /end CHARACTERISTIC
/begin CHARACTERISTIC C_T_ISAPWM_OFF "Delay time ISAPWM" VALUE 0x429fe _REC_VAL_20_u1 2550. _CNV_A_R_LINEAR_____23_CM 0. 2550. FORMAT "%4.0" /end CHARACTERISTIC
/begin CHARACTERISTIC C_LGRD_ISAPWM_OFF "Change limitation during shaking" VALUE 0x42de8 _REC_VAL_20_u2 99.99847412 _CNV_A_R_LINEAR_____431_CM 0. 99.99847412 /end CHARACTERISTIC
/begin CHARACTERISTIC C_ISAPWM_MIN_DIAG "???" VALUE 0x42db0 _REC_VAL_20_u2 99.99847412 _CNV_A_R_LINEAR_____94_CM 0. 99.99847412 /end CHARACTERISTIC
/begin CHARACTERISTIC C_ISAPWM_MAX_DIAG "???" VALUE 0x42dae _REC_VAL_20_u2 99.99847412 _CNV_A_R_LINEAR_____94_CM 0. 99.99847412 /end CHARACTERISTIC
/begin MEASUREMENT MAF_KGH_SP_ISA_CLC "maximum setpoint ISA mass air flow at PSI_SP_ISA" UWORD _CNV_A_R_LINEAR_____101_CM 1 100. 0. 2047.96875 ECU_ADDRESS 0x3fd04e FORMAT "%7.2" /end MEASUREMENT
/begin MEASUREMENT PQ_SP_ISA "setpoint air flow function rate ISA" UWORD _CNV_A_R_LINEAR_____31_CM 1 100. 0. 0.99998474 ECU_ADDRESS 0x3fe6a2 FORMAT "%7.5" /end MEASUREMENT
/begin MEASUREMENT MAF_KGH_SP_THR "setpoint throttle mass air" UWORD _CNV_A_R_LINEAR_____101_CM 1 100. 0. 2047.96875 ECU_ADDRESS 0x3fe69e FORMAT "%7.2" /end MEASUREMENT
/begin MEASUREMENT MAF_KGH_SP_ISA_RAW "setpoint mass air flow idle speed actuator" UWORD _CNV_A_R_LINEAR_____101_CM 1 100. 0. 2047.96875 ECU_ADDRESS 0x3fe6a0 FORMAT "%7.2" /end MEASUREMENT
/begin MEASUREMENT PSI_SP "Setpoint air flow function rate" UWORD _CNV_A_R_LINEAR_____170_CM 1 100. 0. 8.880330000000001 ECU_ADDRESS 0x3fe688 FORMAT "%6.4" /end MEASUREMENT
/begin MEASUREMENT PSI_SP_ISA "Setpoint air flow function rate ISA" UWORD _CNV_A_R_LINEAR_____170_CM 1 100. 0. 8.880330000000001 ECU_ADDRESS 0x3fe6a4 FORMAT "%5.4" /end MEASUREMENT
/begin MEASUREMENT AR_RED_ISA_SP_MMV "filtered setpoint reduced area at ISA valve including AR_RED-controller share AR_RED_ISA_DIF_I_REL_MMV" UWORD _CNV_A_R_LINEAR_____171_CM 1 100. 0. 58.592855 ECU_ADDRESS 0x3fe6aa FORMAT "%7.4" /end MEASUREMENT
/begin MEASUREMENT AR_RED_ISA_SP_MMV_1 "filtered setpoint reduced area at ISA valve" UWORD _CNV_A_R_LINEAR_____171_CM 1 100. 0. 58.592855 ECU_ADDRESS 0x3fe6a8 FORMAT "%7.4" /end MEASUREMENT
/begin MEASUREMENT ISAPWM_ISA_1 "idle speed actuator duty cycle coil 1 (opening)" UWORD _CNV_A_R_LINEAR_____94_CM 1 100. 0. 99.99847412 ECU_ADDRESS 0x3fd04a FORMAT "%5.2" /end MEASUREMENT
/begin MEASUREMENT ISAPWM_ISA_2 "idle speed actuator duty cycle coil 2 (closing)" UWORD _CNV_A_R_LINEAR_____94_CM 1 100. 0. 99.99847412 ECU_ADDRESS 0x3fd04c FORMAT "%5.2" /end MEASUREMENT
/begin MEASUREMENT ISAPWM_MMV "moving mean value of idle speed actuator duty cycle" UWORD _CNV_A_R_LINEAR_____94_CM 1 100. 0. 99.99847412 ECU_ADDRESS 0x3fd048 FORMAT "%5.2" /end MEASUREMENT
/begin CHARACTERISTIC IP_CRLC_AR_RED_ISA_SP "correlation constant for the moving mean value calculation of AR_RED_ISA_SP_MMV_1" CURVE 0x4da27 _REC_CUR_20_u1_u2 0.9960940000000002 _CNV_A_R_LINEAR_____44_CM 0. 0.996094 FORMAT "%5.3"
 /begin AXIS_DESCR COM_AXIS PQ_SP_ISA _CNV_A_R_LINEAR_____31_CM 8 0. 0.99998474 FORMAT "%7.5" AXIS_PTS_REF ldp_pq_sp_isa /end AXIS_DESCR
/end CHARACTERISTIC
/begin CHARACTERISTIC LC_AR_RED_ISA_FIL_ENA "logical variable to enable reduced ISA area filter" VALUE 0x42b67 _REC_VAL_20_u1 1. _CNV_A_R_LINEAR_____10_CM 0. 1. FORMAT "%2.0" /end CHARACTERISTIC
/begin CHARACTERISTIC IP_ISAPWM_ISA "ISA position setpoint" CURVE 0x481c6 _REC_CUR_20_u2_u2 99.99847412 _CNV_A_R_LINEAR_____94_CM 0. 99.99847412 FORMAT "%5.2"
 /begin AXIS_DESCR COM_AXIS AR_RED_ISA_SP_MMV _CNV_A_R_LINEAR_____171_CM 16 0. 58.592855 FORMAT "%7.4" AXIS_PTS_REF ldp_ar_red_isa_sp_mmv /end AXIS_DESCR
/end CHARACTERISTIC
/begin CHARACTERISTIC C_ISAPWM_MAN_AS "maximum reduced area at full opened idle speed actuator valve" VALUE 0x42dac _REC_VAL_20_u2 99.99847412 _CNV_A_R_LINEAR_____94_CM 0. 99.99847412 FORMAT "%5.2" /end CHARACTERISTIC
/begin CHARACTERISTIC C_ISAPWM_OFS_AS "additive ISAPWM offset by application system" VALUE 0x43266 _REC_VAL_20_s2 99.99847412 _CNV_A_R_LINEAR_____98_CM -50. 49.99847412 FORMAT "%7.3" /end CHARACTERISTIC
/begin CHARACTERISTIC C_CRLC_ISAPWM_MMV "correlation constant for moving mean value calculation of ISAPWM_ISA" VALUE 0x42833 _REC_VAL_20_u1 0.9960940000000002 _CNV_A_R_LINEAR_____44_CM 0. 0.996094 FORMAT "%5.3" /end CHARACTERISTIC
/begin CHARACTERISTIC C_ISAPWM_ISA_DIAG "diagnosis substitute value in case of  \"STATE_ISA_DIAG = error active / substitute opening\"" VALUE 0x428ec _REC_VAL_20_u1 0.9960940000000002 _CNV_A_R_LINEAR_____44_CM 0. 0.996094 FORMAT "%5.3" /end CHARACTERISTIC
/begin CHARACTERISTIC C_PQ_SP_MAX_ISA "Pressure quotient threshold at ISA valve" VALUE 0x42efa _REC_VAL_20_u2 0.99998474 _CNV_A_R_LINEAR_____31_CM 0. 0.99998474 FORMAT "%7.5" /end CHARACTERISTIC
/begin CHARACTERISTIC IP_FAC_ISAPWM_VB "battery voltage correction for ISAPWM duty cycle" CURVE 0x4e1c2 _REC_CUR_20_u1_u1 1.99220002 _CNV_A_R_LINEAR_____34_CM 0. 1.99220002 FORMAT "%5.3"
 /begin AXIS_DESCR COM_AXIS VB _CNV_A_R_LINEAR_____26_CM 8 0. 25.8984 FORMAT "%3.1" AXIS_PTS_REF ldpm_vb_1 /end AXIS_DESCR
/end CHARACTERISTIC
/begin CHARACTERISTIC IP_ISAPWM_ISA_PWL "ISAPWM setpoint by LV_TPS_PWL" CURVE 0x481e6 _REC_CUR_20_u2_u1 99.99847412 _CNV_A_R_LINEAR_____94_CM 0. 99.99847412
 /begin AXIS_DESCR COM_AXIS N_32 _CNV_A_R_LINEAR_____5_CM 4 0. 8160. FORMAT "%4.0" AXIS_PTS_REF ldp_n_32__isapwm_isa_pwl /end AXIS_DESCR
/end CHARACTERISTIC
/begin MEASUREMENT ISAPWM_ISA "idle speed actuator duty cycle" UWORD _CNV_A_R_LINEAR_____94_CM 1 100. 0. 99.99847412 ECU_ADDRESS 0x3fd046 FORMAT "%5.2" /end MEASUREMENT
/begin MEASUREMENT FAC_ISAPWM_VB "battery voltage correction for idle speed actuator duty cycle" UBYTE _CNV_A_R_LINEAR_____34_CM 1 100. 0. 1.99220002 ECU_ADDRESS 0x3fd051 FORMAT "%5.3" /end MEASUREMENT
/begin MEASUREMENT MAF_TURB_RATIO "mass air flow ratio of MAF_SP_ISA / MAF_SP" UBYTE _CNV_A_R_LINEAR_____44_CM 1 100. 0. 0.996094 ECU_ADDRESS 0x3fd050 FORMAT "%5.3" /end MEASUREMENT
/begin CHARACTERISTIC C_TPS_MAX_DIAG "TPS_SP_MDL Limitation at TPS limp home of channel 1 or 2" VALUE 0x430bc _REC_VAL_20_u2 119.5 _CNV_A_R_LINEAR_____226_CM 0. 119.5 FORMAT "%7.3" /end CHARACTERISTIC
/begin MEASUREMENT AR_RED_ISA_SP_1 "setpoint reduced area at ISA valve previous filtering" UWORD _CNV_A_R_LINEAR_____171_CM 1 100. 0. 58.592855 ECU_ADDRESS 0x3fe6a6 FORMAT "%7.4" /end MEASUREMENT
/begin MEASUREMENT MAF_KGH_SP_ISA_MIN "Minimum setpoint ISA mass air flow at PSI_SP_ISA" UWORD _CNV_A_R_LINEAR_____101_CM 1 100. 0. 2047.96875 ECU_ADDRESS 0x3fe6ac FORMAT "%7.2" /end MEASUREMENT
/begin MEASUREMENT MAF_KGH_SP_THR_MIN "Minimum setpoint throttle mass air flow at PSI_SP" UWORD _CNV_A_R_LINEAR_____101_CM 1 100. 0. 2047.96875 ECU_ADDRESS 0x3fe6b0 FORMAT "%7.2" /end MEASUREMENT
/begin MEASUREMENT AR_RED_ISA_MIN "Minimum reduced area at closed ISA" UWORD _CNV_A_R_LINEAR_____171_CM 1 100. 0. 58.592855 ECU_ADDRESS 0x3fe6ae FORMAT "%7.4" /end MEASUREMENT
/begin MEASUREMENT AR_RED_MIN "Minimum reduced area at closed throttle" UWORD _CNV_A_R_LINEAR_____171_CM 1 100. 0. 58.592855 ECU_ADDRESS 0x3fe6b2 FORMAT "%7.4" /end MEASUREMENT
/begin MEASUREMENT MAF_KGH_SP_ISA "setpoint ISA mass air flow" UWORD _CNV_A_R_LINEAR_____101_CM 1 100. 0. 2047.96875 ECU_ADDRESS 0x3fe69c FORMAT "%7.2" /end MEASUREMENT
/begin MEASUREMENT MAF_KGH_SP_ISA_1 "setpoint ISA mass air flow, intermediate value" UWORD _CNV_A_R_LINEAR_____101_CM 1 100. 0. 2047.96875 ECU_ADDRESS 0x3fe69a FORMAT "%7.2" /end MEASUREMENT
/begin AXIS_PTS ldp_maf_kgh_sp__amp_dec "" 0x4468a MAF_KGH_SP _REC_AXS_20_u2 2047.96875 _CNV_A_R_LINEAR_____101_CM 4 0. 2047.96875 FORMAT "%6.2" /end AXIS_PTS
/begin AXIS_PTS ldp_maf_sp__tps_sp_mdl_max "" 0x44694 MAF_SP _REC_AXS_20_u2 1389. _CNV_A_R_LINEAR_____95_CM 4 0. 1389. FORMAT "%7.2" /end AXIS_PTS
/begin AXIS_PTS ldp_n_32__tps_sp_mdl_max "" 0x43615 N_32 _REC_AXS_20_u1 816. _CNV_A_R_LINEAR_____5_CM 8 0. 8160. FORMAT "%4.0" /end AXIS_PTS
/begin AXIS_PTS ldp_pq_sp__crlc_ar_red_sp "" 0x449e0 PQ_SP _REC_AXS_20_u2 0.99998474 _CNV_A_R_LINEAR_____31_CM 8 0. 0.99998474 FORMAT "%7.5" /end AXIS_PTS
/begin AXIS_PTS ldp_ar_red_sp_mmv "" 0x441d2 AR_RED_SP_MMV _REC_AXS_20_u2 58.592855 _CNV_A_R_LINEAR_____171_CM 16 0. 58.592855 FORMAT "%7.4" /end AXIS_PTS
/begin AXIS_PTS ldp_pq_sp_isa "" 0x449f2 PQ_SP_ISA _REC_AXS_20_u2 0.99998474 _CNV_A_R_LINEAR_____31_CM 8 0. 0.99998474 FORMAT "%7.5" /end AXIS_PTS
/begin AXIS_PTS ldp_ar_red_isa_sp_mmv "" 0x44196 AR_RED_ISA_SP_MMV _REC_AXS_20_u2 58.592855 _CNV_A_R_LINEAR_____171_CM 16 0. 58.592855 FORMAT "%7.4" /end AXIS_PTS
/begin AXIS_PTS ldpm_vb_1 "" 0x4409c VB _REC_AXS_20_u1 25.8984 _CNV_A_R_LINEAR_____26_CM 8 0. 25.8984 FORMAT "%3.1" /end AXIS_PTS
/begin AXIS_PTS ldp_n_32__isapwm_isa_pwl "" 0x43549 N_32 _REC_AXS_20_u1 8160. _CNV_A_R_LINEAR_____5_CM 4 0. 8160. FORMAT "%4.0" /end AXIS_PTS
/begin MEASUREMENT AR_RED_SP_1 "Setpoint reduced throttle area" UWORD _CNV_A_R_LINEAR_____171_CM 1 100. 0. 58.592855 ECU_ADDRESS 0x3fe68e FORMAT "%7.4" /end MEASUREMENT
/begin MEASUREMENT LV_H_LOAD_TPS_SP "logical value for 'very high load'" UBYTE _CNV_S_2_RANGE______28_CM 1 100. 0. 1. ECU_ADDRESS 0x3fe6b7 /end MEASUREMENT
/begin CHARACTERISTIC C_PQ_SP_MAX "Pressure quotient threshold" VALUE 0x42ef6 _REC_VAL_20_u2 0.99998474 _CNV_A_R_LINEAR_____31_CM 0. 0.99998474 FORMAT "%7.5" /end CHARACTERISTIC
/begin CHARACTERISTIC C_PQ_SP_MAX_HYS "Hysteresis for pressure quotient threshold" VALUE 0x42ef8 _REC_VAL_20_u2 0.99998474 _CNV_A_R_LINEAR_____31_CM 0. 0.99998474 FORMAT "%7.5" /end CHARACTERISTIC
/begin MEASUREMENT LV_AST "Auxiliary function \"After-start\"" UBYTE _CNV_S_2_RANGE______28_CM 1 100. 0. 1. ECU_ADDRESS 0x3fcf0a BIT_MASK 0x1 /end MEASUREMENT
/begin MEASUREMENT TCO_REST "Coolant temperature, stored to detect a re-start" UBYTE _CNV_A_R_LINEAR_____0_CM 1 100. -48. 142.5 ECU_ADDRESS 0x3fcf41 FORMAT "%3.0" /end MEASUREMENT
/begin CHARACTERISTIC C_ABC_INC_TIA "Debounce counter increment - TIA diagnosis" VALUE 0x4270c _REC_VAL_20_u1 255. _CNV_A_R_LINEAR_____10_CM 0. 255. FORMAT "%3.0" /end CHARACTERISTIC
/begin CHARACTERISTIC C_ABC_MAX_TIA "Debounce counter maximum value - TIA diagnosis" VALUE 0x42792 _REC_VAL_20_u1 254. _CNV_A_R_LINEAR_____10_CM 1. 255. FORMAT "%3.0" /end CHARACTERISTIC
/begin MEASUREMENT TPS_SP_ST "TPS setpoint at start" UWORD _CNV_A_R_LINEAR_____226_CM 1 100. 0. 119.5 ECU_ADDRESS 0x3fd07a FORMAT "%7.3" /end MEASUREMENT
/begin MEASUREMENT TPS_REL_ST "" UWORD _CNV_A_R_LINEAR_____94_CM 1 100. 0. 99.99847412 ECU_ADDRESS 0x3fe6e2 /end MEASUREMENT
/begin CHARACTERISTIC IP_TPS_REL_ST_AT "Specified relative TPS setpoint at start" MAP 0x4bb24 _REC_MAP_20_u2_u2_u1 99.99847412 _CNV_A_R_LINEAR_____94_CM 0. 99.99847412
 /begin AXIS_DESCR COM_AXIS N _CNV_A_R_LINEAR_____17_CM 8 0. 8160. FORMAT "%4.0" AXIS_PTS_REF ldpm_n_1_thro /end AXIS_DESCR
 /begin AXIS_DESCR COM_AXIS TCO _CNV_A_R_LINEAR_____0_CM 8 -48. 142.5 FORMAT "%5.1" AXIS_PTS_REF ldpm_tco_1_thro /end AXIS_DESCR
/end CHARACTERISTIC
/begin CHARACTERISTIC IP_TPS_REL_ST_MT "Specified relative TPS setpoint at start" MAP 0x4bba4 _REC_MAP_20_u2_u2_u1 99.99847412 _CNV_A_R_LINEAR_____94_CM 0. 99.99847412
 /begin AXIS_DESCR COM_AXIS N _CNV_A_R_LINEAR_____17_CM 8 0. 8160. FORMAT "%4.0" AXIS_PTS_REF ldpm_n_1_thro /end AXIS_DESCR
 /begin AXIS_DESCR COM_AXIS TCO _CNV_A_R_LINEAR_____0_CM 8 -48. 142.5 FORMAT "%5.1" AXIS_PTS_REF ldpm_tco_1_thro /end AXIS_DESCR
/end CHARACTERISTIC
/begin CHARACTERISTIC IP_TPS_REL_ST_PV "correction of the ralative TPS setpoint at start via driver's demand" CURVE 0x4bc24 _REC_CUR_20_u2_u1 99.99847412 _CNV_A_R_LINEAR_____94_CM 0. 99.99847412
 /begin AXIS_DESCR COM_AXIS PV_AV _CNV_A_R_LINEAR_____4_CM 6 0. 99.609375 FORMAT "%4.1" AXIS_PTS_REF ldp_pv_av_ip_tps_sp_st_pv /end AXIS_DESCR
/end CHARACTERISTIC
/begin CHARACTERISTIC IP_FAC_AMP_TPS_REL_ST "Altitude correction of the relative TPS setpoint at start" MAP 0x4dda1 _REC_MAP_20_u1_u2_u2 1.99220002 _CNV_A_R_LINEAR_____34_CM 0. 1.99220002 FORMAT "%5.3"
 /begin AXIS_DESCR COM_AXIS N _CNV_A_R_LINEAR_____17_CM 8 0. 8160. FORMAT "%4.0" AXIS_PTS_REF ldpm_n_1_thro /end AXIS_DESCR
 /begin AXIS_DESCR COM_AXIS AMP _CNV_A_R_LINEAR_____43_CM 6 0. 5434. FORMAT "%7.2" AXIS_PTS_REF ldp_amp_ip_tps_sp_st_amp /end AXIS_DESCR
/end CHARACTERISTIC
/begin CHARACTERISTIC IP_TPS_SP_ST "TPS setpoint at start" MAP 0x4bd34 _REC_MAP_20_u2_u2_u2 119.5 _CNV_A_R_LINEAR_____440_CM 0. 119.5 FORMAT "%7.3"
 /begin AXIS_DESCR COM_AXIS N _CNV_A_R_LINEAR_____17_CM 8 0. 8160. FORMAT "%4.0" AXIS_PTS_REF ldpm_n_1_thro /end AXIS_DESCR
 /begin AXIS_DESCR COM_AXIS TPS_REL_ST _CNV_A_R_LINEAR_____94_CM 12 0. 99.99847412 AXIS_PTS_REF ldp_tps_rel_st_ip_tps_sp_st /end AXIS_DESCR
/end CHARACTERISTIC
/begin CHARACTERISTIC IP_FAC_TIA_TPS_REL_ST "TIA correction of the relative TPS setpoint at start" CURVE 0x4e72d _REC_CUR_20_u1_u1 1.99220002 _CNV_A_R_LINEAR_____34_CM 0. 1.99220002 FORMAT "%5.3"
 /begin AXIS_DESCR COM_AXIS TIA _CNV_A_R_LINEAR_____0_CM 6 -48. 142.5 FORMAT "%5.1" AXIS_PTS_REF ldp_tia_ip_fac_tia_tps_sp_st /end AXIS_DESCR
/end CHARACTERISTIC
/begin AXIS_PTS ldp_pv_av_ip_tps_sp_st_pv "" 0x437b7 PV_AV _REC_AXS_20_u1 99.609375 _CNV_A_R_LINEAR_____4_CM 6 0. 99.609375 FORMAT "%4.1" /end AXIS_PTS
/begin AXIS_PTS ldp_tia_ip_fac_tia_tps_sp_st "" 0x439f1 TIA _REC_AXS_20_u1 190.5 _CNV_A_R_LINEAR_____0_CM 6 -48. 142.5 FORMAT "%5.1" /end AXIS_PTS
/begin AXIS_PTS ldp_amp_ip_tps_sp_st_amp "" 0x4414c AMP _REC_AXS_20_u2 5434. _CNV_A_R_LINEAR_____43_CM 6 0. 5434. FORMAT "%7.2" /end AXIS_PTS
/begin AXIS_PTS ldp_tps_rel_st_ip_tps_sp_st "" 0x44ba4 TPS_REL_ST _REC_AXS_20_u2 99.99847412 _CNV_A_R_LINEAR_____94_CM 12 0. 99.99847412 /end AXIS_PTS
/begin CHARACTERISTIC C_N_MAX_TPS_AD "" VALUE 0x4295c _REC_VAL_20_u1 8160. _CNV_A_R_LINEAR_____5_CM 0. 8160. FORMAT "%4.0" /end CHARACTERISTIC
/begin CHARACTERISTIC C_T_MAX_TPS_AD "Maximum time for Adaptation of the LIH and BOL position" VALUE 0x42a11 _REC_VAL_20_u1 1.275 _CNV_A_R_LINEAR_____367_CM 0. 1.275 FORMAT "%4.3" /end CHARACTERISTIC
/begin CHARACTERISTIC C_T_MAX_TPS_LIH_CHK "Maximum time for Limp Home recognition" VALUE 0x42a12 _REC_VAL_20_u1 1.275 _CNV_A_R_LINEAR_____367_CM 0. 1.275 FORMAT "%4.3" /end CHARACTERISTIC
/begin CHARACTERISTIC C_T_MAX_TPS_SP_RST_CHK "Maximum time to reach the position C_TPS_SP_RST_CHK" VALUE 0x42a13 _REC_VAL_20_u1 1.275 _CNV_A_R_LINEAR_____367_CM 0. 1.275 FORMAT "%4.3" /end CHARACTERISTIC
/begin CHARACTERISTIC C_T_TPS_AD_HYS "Time period for hysteresis band to Adaptation" VALUE 0x42a2c _REC_VAL_20_u1 1.275 _CNV_A_R_LINEAR_____367_CM 0. 1.275 FORMAT "%4.3" /end CHARACTERISTIC
/begin CHARACTERISTIC C_TCO_MAX_TPS_AD "" VALUE 0x42a62 _REC_VAL_20_u1 190.5 _CNV_A_R_LINEAR_____0_CM -48. 142.5 FORMAT "%5.1" /end CHARACTERISTIC
/begin CHARACTERISTIC C_TCO_MIN_TPS_AD "" VALUE 0x42a74 _REC_VAL_20_u1 190.5 _CNV_A_R_LINEAR_____0_CM -48. 142.5 FORMAT "%5.1" /end CHARACTERISTIC
/begin CHARACTERISTIC C_TIA_MIN_TPS_AD "" VALUE 0x42ab8 _REC_VAL_20_u1 190.5 _CNV_A_R_LINEAR_____0_CM -48. 142.5 FORMAT "%4.1" /end CHARACTERISTIC
/begin CHARACTERISTIC C_TPS_SP_BOL_LGRD "Change limitation for stopping the lower position" VALUE 0x42ad4 _REC_VAL_20_u1 1.85271285 _CNV_A_R_LINEAR_____441_CM 7.29415e-003 1.860007 FORMAT "%4.3" /end CHARACTERISTIC
/begin CHARACTERISTIC C_TPS_SP_RST_CHK_BAS "TPS_SP for testing the retracting spring" VALUE 0x430dc _REC_VAL_20_u2 119.5 _CNV_A_R_LINEAR_____226_CM 0. 119.5 /end CHARACTERISTIC
/begin CHARACTERISTIC C_TPS_SP_RST_CHK_HYS "Hysteresis of C_TPS_SP_RST_CHK" VALUE 0x42ad6 _REC_VAL_20_u1 1.85271285 _CNV_A_R_LINEAR_____442_CM 7.29415e-003 1.860007 FORMAT "%4.3" /end CHARACTERISTIC
/begin CHARACTERISTIC C_TPS_SP_RST_CHK_LGRD "Change limitation for stopping the position C_TPS_SP_RST_CHK" VALUE 0x42ad7 _REC_VAL_20_u1 1.85271285 _CNV_A_R_LINEAR_____441_CM 7.29415e-003 1.860007 FORMAT "%4.3" /end CHARACTERISTIC
/begin CHARACTERISTIC C_V_TPS_AD_HYS "Hysteresis band for Adaptation value determination" VALUE 0x42af6 _REC_VAL_20_u1 1.24511719 _CNV_A_R_LINEAR_____177_CM 0. 1.24511719 FORMAT "%4.3" /end CHARACTERISTIC
/begin CHARACTERISTIC C_V_TPS_AD_WIN_LIH "Adaptation window size (+/-) for Adaptation of the Limp Home position" VALUE 0x42af9 _REC_VAL_20_u1 2.49023438 _CNV_A_R_LINEAR_____443_CM 0. 2.49023438 FORMAT "%4.3" /end CHARACTERISTIC
/begin CHARACTERISTIC C_V_TPS_SP_BOL_1 "" VALUE 0x42afb _REC_VAL_20_u1 4.998 _CNV_A_R_LINEAR_____38_CM 0. 4.998 FORMAT "%3.2" /end CHARACTERISTIC
/begin CHARACTERISTIC C_V_TPS_SP_BOL_2 "" VALUE 0x42afc _REC_VAL_20_u1 4.998 _CNV_A_R_LINEAR_____38_CM 0. 4.998 FORMAT "%3.2" /end CHARACTERISTIC
/begin CHARACTERISTIC C_VB_MIN_TPS_AD "" VALUE 0x42b15 _REC_VAL_20_u1 25.8984 _CNV_A_R_LINEAR_____26_CM 0. 25.8984 FORMAT "%3.1" /end CHARACTERISTIC
/begin MEASUREMENT LV_N_LIM_TPS_AD "Demand security trailing throttle fuel cut off (SAS)" UBYTE _CNV_S_2_RANGE______28_CM 1 100. 0. 1. ECU_ADDRESS 0x3fd095 BIT_MASK 0x1 /end MEASUREMENT
/begin MEASUREMENT LV_TPS_AD_CUR_OFF "Demand ETC Limp Home" UBYTE _CNV_S_2_RANGE______28_CM 1 100. 0. 1. ECU_ADDRESS 0x3fd099 BIT_MASK 0x1 /end MEASUREMENT
/begin MEASUREMENT LV_TPS_AD_DIAG_CUR_OFF "Demand ETC LIMP HOME" UBYTE _CNV_S_2_RANGE______28_CM 1 100. 0. 1. ECU_ADDRESS 0x3fd096 BIT_MASK 0x1 /end MEASUREMENT
/begin MEASUREMENT TPS_SP_AD "Throttle position setpoint during Adaptation" UWORD _CNV_A_R_LINEAR_____226_CM 1 100. 0. 119.5 ECU_ADDRESS 0x3fd088 FORMAT "%7.3" /end MEASUREMENT
/begin MEASUREMENT V_TPS_AD_EL_BOL_1 "Adaptation value for the lower electronic stop, TPS-channel 1" UWORD _CNV_A_R_LINEAR_____33_CM 1 100. 0. 4.99511719 ECU_ADDRESS 0x3fd07c FORMAT "%5.3" /end MEASUREMENT
/begin MEASUREMENT V_TPS_AD_EL_BOL_2 "Adaptation value for the lower electronic stop, TPS-channel 2" UWORD _CNV_A_R_LINEAR_____33_CM 1 100. 0. 4.99511719 ECU_ADDRESS 0x3fd07e FORMAT "%5.3" /end MEASUREMENT
/begin MEASUREMENT V_TPS_AD_LIH_1 "Adaptation value for the limp home position, TPS-channel 1" UWORD _CNV_A_R_LINEAR_____33_CM 1 100. 0. 4.99511719 ECU_ADDRESS 0x3fd080 FORMAT "%5.3" /end MEASUREMENT
/begin MEASUREMENT V_TPS_AD_LIH_2 "Adaptation value for the limp home position, TPS-channel 2" UWORD _CNV_A_R_LINEAR_____33_CM 1 100. 0. 4.99511719 ECU_ADDRESS 0x3fd082 FORMAT "%5.3" /end MEASUREMENT
/begin MEASUREMENT LV_TPS_AD_ACT "TPS diagnosis/Adaptation condition is fulfilled" UBYTE _CNV_S_2_RANGE______28_CM 1 100. 0. 1. ECU_ADDRESS 0x3fd098 BIT_MASK 0x1 /end MEASUREMENT
/begin MEASUREMENT TPS_AD_SLOP_GAIN_1 "Adaptation value of the amplification factor of amplified poti 1" UWORD _CNV_A_R_LINEAR_____348_CM 1 100. 0. 7.99987793 ECU_ADDRESS 0x3fd084 FORMAT "%6.4" /end MEASUREMENT
/begin MEASUREMENT TPS_LIH_1 "Limp home position of the throttle valve of TPS-Poti 1" UWORD _CNV_A_R_LINEAR_____226_CM 1 100. 0. 119.5 ECU_ADDRESS 0x3fd08a FORMAT "%7.3" /end MEASUREMENT
/begin MEASUREMENT TPS_LIH_2 "Limp home position  of the throttle valve of TPS-Poti 2" UWORD _CNV_A_R_LINEAR_____226_CM 1 100. 0. 119.5 ECU_ADDRESS 0x3fd08c FORMAT "%7.3" /end MEASUREMENT
/begin MEASUREMENT LV_TPS_AD_REQ "Demand TPS-Adaptation" UBYTE _CNV_S_2_RANGE______28_CM 1 100. 0. 1. ECU_ADDRESS 0x3fd097 BIT_MASK 0x1 /end MEASUREMENT
/begin CHARACTERISTIC C_TPS_SP_SPR_CHK_UP "TPS_SP for limp home spring test on the Adaptation routine" VALUE 0x430de _REC_VAL_20_u2 119.5 _CNV_A_R_LINEAR_____226_CM 0. 119.5 FORMAT "%7.3" /end CHARACTERISTIC
/begin MEASUREMENT TPS_LIH_INI "" UWORD _CNV_A_R_LINEAR_____226_CM 1 100. 0. 119.5 ECU_ADDRESS 0x3fd08e FORMAT "%7.3" /end MEASUREMENT
/begin MEASUREMENT V_TPS_AD_BOL_GAIN_1 "Adaptation value for the lower mechanical stop of the amplification poti 1" UWORD _CNV_A_R_LINEAR_____33_CM 1 100. 0. 4.99511719 ECU_ADDRESS 0x3fe6ec FORMAT "%5.3" /end MEASUREMENT
/begin MEASUREMENT V_TPS_AD_TOL_1 "Non-amplified upper value for the Adaptation of amplified of TPS-channel 1" UWORD _CNV_A_R_LINEAR_____33_CM 1 100. 0. 4.99511719 ECU_ADDRESS 0x3fe6f0 FORMAT "%5.3" /end MEASUREMENT
/begin MEASUREMENT V_TPS_AD_TOL_GAIN_1 "Amplified upper value for the Adaptation of amplified of TPS-channel 1" UWORD _CNV_A_R_LINEAR_____33_CM 1 100. 0. 4.99511719 ECU_ADDRESS 0x3fe6ee FORMAT "%5.3" /end MEASUREMENT
/begin MEASUREMENT INH_IV_TPS_AD "logical variable to inhibit injection and ignition during TPS Adaptation" UBYTE _CNV_S_2_RANGE______21_R_CM 1 100. 0. 255. ECU_ADDRESS 0x3fd094 /end MEASUREMENT
/begin MEASUREMENT V_TPS_AD_OFS_GAIN_1 "Adaptation value of the amplification offset of  of amplified poti 1" SWORD _CNV_A_R_LINEAR_____358_CM 1 100. -2.5 2.5 ECU_ADDRESS 0x3fd086 /end MEASUREMENT
/begin MEASUREMENT LV_TPS_AD_MEC_BOL "logical variable data" UBYTE _CNV_S_2_RANGE______184_R_CM 1 100. 0. 255. ECU_ADDRESS 0x3fd09a /end MEASUREMENT
/begin MEASUREMENT TPS_AD_STEP "Steps of throttle Adaptation" ULONG _CNV_S_11_RANGE_TPS__444_CM 1 100. 0. 10. ECU_ADDRESS 0x3fe6e8 /end MEASUREMENT
/begin CHARACTERISTIC C_TPS_SP_RST_CHK "TPS_SP for testing the retracting spring" VALUE 0x430da _REC_VAL_20_u2 119.5 _CNV_A_R_LINEAR_____226_CM 0. 119.5 /end CHARACTERISTIC
/begin CHARACTERISTIC C_TPS_AV_RST_CHK "Threshold for activation the position controller" VALUE 0x430ac _REC_VAL_20_u2 119.5 _CNV_A_R_LINEAR_____226_CM 0. 119.5 FORMAT "%7.3" /end CHARACTERISTIC
/begin CHARACTERISTIC C_T_TPS_AV_RST_CHK "Time condition for deactivation the position controller" VALUE 0x42a2d _REC_VAL_20_u1 1.275 _CNV_A_R_LINEAR_____367_CM 0. 1.275 FORMAT "%5.3" /end CHARACTERISTIC
/begin CHARACTERISTIC C_ABC_INC_TPS_AD_BOL "Anti - bounce counter increment" VALUE 0x4271f _REC_VAL_20_u1 255. _CNV_A_R_LINEAR_____10_CM 0. 255. FORMAT "%3.0" /end CHARACTERISTIC
/begin CHARACTERISTIC C_ABC_MAX_TPS_AD_BOL "Maximum value of the anti - bounce counter" VALUE 0x427a3 _REC_VAL_20_u1 254. _CNV_A_R_LINEAR_____10_CM 1. 255. FORMAT "%3.0" /end CHARACTERISTIC
/begin CHARACTERISTIC C_V_TPS_AD_WIN_BOL "Adaptation window size (+/-) for Adaptation of lower stop" VALUE 0x42af8 _REC_VAL_20_u1 2.49023438 _CNV_A_R_LINEAR_____443_CM 0. 2.49023438 FORMAT "%4.3" /end CHARACTERISTIC
/begin CHARACTERISTIC C_V_TPS_AD_WIN_2_BOL "Adaptation window size (+/-) for continously mec BOL Adaptation of lower stop" VALUE 0x42af7 _REC_VAL_20_u1 2.49023438 _CNV_A_R_LINEAR_____443_CM 0. 2.49023438 FORMAT "%5.3" /end CHARACTERISTIC
/begin MEASUREMENT CTR_ST_CHK_CHK_LIH_1_READY "Start check check limp home 1 passed" UWORD _CNV_A_R_LINEAR_____10_CM 1 100. 0. 65535. ECU_ADDRESS 0x3fd090 FORMAT "%5.0" /end MEASUREMENT
/begin MEASUREMENT CTR_ST_CHK_CHK_LIH_1_ERR "Start check check limp home 1 not passed" UWORD _CNV_A_R_LINEAR_____10_CM 1 100. 0. 65535. ECU_ADDRESS 0x3fd092 FORMAT "%5.0" /end MEASUREMENT
/begin MEASUREMENT LV_ERR_TPS_ST_CHK_2 "TPS-error-bit (Return spring test)" UBYTE _CNV_S_2_RANGE______184_R_CM 1 100. 0. 255. ECU_ADDRESS 0x3fd497 /end MEASUREMENT
/begin MEASUREMENT LV_ERR_TPS_AD "TPS-error-bit (Adaptation)" UBYTE _CNV_S_2_RANGE______184_R_CM 1 100. 0. 255. ECU_ADDRESS 0x3fd48b /end MEASUREMENT
/begin MEASUREMENT LV_ERR_TPS_AD_BOL "Error bit" UBYTE _CNV_S_2_RANGE______184_R_CM 1 100. 0. 255. ECU_ADDRESS 0x3fd48f /end MEASUREMENT
/begin MEASUREMENT LV_TPS_MTC_N_LIM "LV limp home request TPS" UBYTE _CNV_S_2_RANGE______28_CM 1 100. 0. 1. ECU_ADDRESS 0x3fd0ae BIT_MASK 0x1 /end MEASUREMENT
/begin CHARACTERISTIC C_ABC_INC_TPS_1 "Debounce counter Increment, TPS diagnosis, Channel 1" VALUE 0x4271d _REC_VAL_20_u1 255. _CNV_A_R_LINEAR_____10_CM 0. 255. FORMAT "%3.0" /end CHARACTERISTIC
/begin CHARACTERISTIC C_ABC_INC_TPS_2 "Debounce counter Increment, TPS diagnosis, Channel 2" VALUE 0x4271e _REC_VAL_20_u1 255. _CNV_A_R_LINEAR_____10_CM 0. 255. FORMAT "%3.0" /end CHARACTERISTIC
/begin CHARACTERISTIC C_ABC_MAX_TPS_2 "Debounce counter maximum value, TPS diagnosis, Channel 2" VALUE 0x427a2 _REC_VAL_20_u1 254. _CNV_A_R_LINEAR_____10_CM 1. 255. FORMAT "%3.0" /end CHARACTERISTIC
/begin MEASUREMENT LV_MTC_LIH_CUR_OFF "ETC-Limp home is activ" UBYTE _CNV_S_2_RANGE______28_CM 1 100. 0. 1. ECU_ADDRESS 0x3fd0ac BIT_MASK 0x1 /end MEASUREMENT
/begin MEASUREMENT LV_ERR_TPS "Error currently present on at least one throttle position sensor" UBYTE _CNV_S_2_RANGE______21_R_CM 1 100. 0. 255. ECU_ADDRESS 0x3fd0aa /end MEASUREMENT
/begin MEASUREMENT LV_N_LIM_ETC_LIH "LV safety cut off" UBYTE _CNV_S_2_RANGE______28_CM 1 100. 0. 1. ECU_ADDRESS 0x3fd0ad BIT_MASK 0x1 /end MEASUREMENT
/begin MEASUREMENT LV_N_LIM_ETC_LIH_REV "ETC-LIMP-HOME-3  (Reversible)" UBYTE _CNV_S_2_RANGE______28_CM 1 100. 0. 1. ECU_ADDRESS 0x3fd0b0 BIT_MASK 0x1 /end MEASUREMENT
/begin MEASUREMENT STATE_TPS_DIAG "Status TPS Diagnosis" UBYTE _CNV_S_5_RANGE_STAT_445_CM 1 100. 0. 8. ECU_ADDRESS 0x3fd0a8 /end MEASUREMENT
/begin CHARACTERISTIC C_ABC_MAX_TPS_1 "Debounce counter maximum value, TPS diagnosis, Channel 1" VALUE 0x427a1 _REC_VAL_20_u1 254. _CNV_A_R_LINEAR_____10_CM 1. 255. FORMAT "%3.0" /end CHARACTERISTIC
/begin MEASUREMENT STATE_ETC_LIH "Status ETC Limp-Home" UBYTE _CNV_S_5_RANGE_STAT_446_CM 1 100. 0. 8. ECU_ADDRESS 0x3fd0a9 /end MEASUREMENT
/begin MEASUREMENT LV_MTC_CUR_OFF_REQ "ETC without power request" UBYTE _CNV_S_2_RANGE______28_CM 1 100. 0. 1. ECU_ADDRESS 0x3fd0af /end MEASUREMENT
/begin MEASUREMENT LV_ERR_MTC_CTL_2 "Logical variable (set. if a MTCPWM error is present)" UBYTE _CNV_S_2_RANGE______184_R_CM 1 100. 0. 255. ECU_ADDRESS 0x3fd483 /end MEASUREMENT
/begin MEASUREMENT LV_ERR_MTC_CTL_3 "Logical variable (set. if a MTCPWM error is present)" UBYTE _CNV_S_2_RANGE______184_R_CM 1 100. 0. 255. ECU_ADDRESS 0x3fd487 /end MEASUREMENT
/begin MEASUREMENT LV_MTC_CUR_OFF "Logical variable to switch off  the MTC-controller" UBYTE _CNV_S_2_RANGE______28_CM 1 100. 0. 1. ECU_ADDRESS 0x3fd074 /end MEASUREMENT
/begin MEASUREMENT TPS_SP_PWL "Throttle position setpoint during post operating phase" UWORD _CNV_A_R_LINEAR_____226_CM 1 100. 0. 119.5 ECU_ADDRESS 0x3fd070 FORMAT "%7.3" /end MEASUREMENT
/begin MEASUREMENT LV_TPS_PWL "Bit for throttle position" UBYTE _CNV_S_2_RANGE______11_CM 1 100. 0. 1. ECU_ADDRESS 0x3fd076 /end MEASUREMENT
/begin CHARACTERISTIC C_TPS_SP_PWL_LGRD "Gradiant limitation TPS" VALUE 0x430d6 _REC_VAL_20_u2 119.5 _CNV_A_R_LINEAR_____447_CM 0. 119.5 FORMAT "%7.3" /end CHARACTERISTIC
/begin CHARACTERISTIC C_TPS_SP_PWL_UP "Threshold opening after power latch" VALUE 0x430d8 _REC_VAL_20_u2 119.5 _CNV_A_R_LINEAR_____226_CM 0. 119.5 FORMAT "%7.3" /end CHARACTERISTIC
/begin CHARACTERISTIC C_TPS_SP_AS_MAN "Throttle position setpoint manual" VALUE 0x430c2 _REC_VAL_20_u2 119.5 _CNV_A_R_LINEAR_____226_CM 0. 119.5 FORMAT "%7.3" /end CHARACTERISTIC
/begin CHARACTERISTIC C_TPS_SP_EXT_ADJ_ENA "Variable enabled for throttle position setpoint manual or about PV_AV" VALUE 0x42ad5 _REC_VAL_20_u1 3. _CNV_A_R_LINEAR_____10_CM 0. 3. FORMAT "%2.0" /end CHARACTERISTIC
/begin CHARACTERISTIC C_PV_AV_EXT_ADJ_MIN "Min. threshold for external ajustment about PV_AV" VALUE 0x42983 _REC_VAL_20_u1 99.609375 _CNV_A_R_LINEAR_____4_CM 0. 99.609375 FORMAT "%4.1" /end CHARACTERISTIC
/begin CHARACTERISTIC IP_TPS_SP_PWL "throttle position setpoint during post operating phase" CURVE 0x4bd2c _REC_CUR_20_u2_u1 119.5 _CNV_A_R_LINEAR_____226_CM 0. 119.5 FORMAT "%7.3"
 /begin AXIS_DESCR COM_AXIS N_32 _CNV_A_R_LINEAR_____5_CM 4 0. 8160. FORMAT "%4.0" AXIS_PTS_REF ldp_n_32_tps_sp_pwl /end AXIS_DESCR
/end CHARACTERISTIC
/begin MEASUREMENT TPS_SP_EXT_ADJ "Throttle position setpint of external device" UWORD _CNV_A_R_LINEAR_____226_CM 1 100. 0. 119.5 ECU_ADDRESS 0x3fd06e FORMAT "%7.3" /end MEASUREMENT
/begin MEASUREMENT TPS_SP_EXT_ADJ_1 "Throttle position setpint of external device about PV_AV" UWORD _CNV_A_R_LINEAR_____226_CM 1 100. 0. 119.5 ECU_ADDRESS 0x3fe6d0 FORMAT "%7.3" /end MEASUREMENT
/begin MEASUREMENT LV_TPS_SP_EXT_ADJ "Bit active for external input of throtle position setpoint" UBYTE _CNV_S_2_RANGE______28_CM 1 100. 0. 1. ECU_ADDRESS 0x3fd075 /end MEASUREMENT
/begin MEASUREMENT LV_TPS_SP_EXT_ADJ_1 "Bit active for external input of throtle position setpoint for PV_AV setpoint" UBYTE _CNV_S_2_RANGE______28_CM 1 100. 0. 1. ECU_ADDRESS 0x3fe6d4 /end MEASUREMENT
/begin MEASUREMENT LV_TPS_SP_LIH "Bit collecting the requests of all 3 monitoring levels to switch off MTC" UBYTE _CNV_S_2_RANGE______28_CM 1 100. 0. 1. ECU_ADDRESS 0x3fd073 /end MEASUREMENT
/begin CHARACTERISTIC IP_TPS_SP_EXT_ADJ "external adjustment setpoint" CURVE 0x4bc40 _REC_CUR_20_u2_u1 119.5 _CNV_A_R_LINEAR_____226_CM 0. 119.5 FORMAT "%7.3"
 /begin AXIS_DESCR COM_AXIS PV_AV _CNV_A_R_LINEAR_____4_CM 6 0. 99.609375 FORMAT "%4.1" AXIS_PTS_REF ldp_pv_av__tps_sp_ext /end AXIS_DESCR
/end CHARACTERISTIC
/begin MEASUREMENT TPS_SP_ES "Throttle position setpoint for engine stopped" UWORD _CNV_A_R_LINEAR_____226_CM 1 100. 0. 119.5 ECU_ADDRESS 0x3fd06c FORMAT "%7.3" /end MEASUREMENT
/begin CHARACTERISTIC IP_TPS_SP_ES "Throttle position setpoint for engine stopped" CURVE 0x4bc30 _REC_CUR_20_u2_u1 119.5 _CNV_A_R_LINEAR_____226_CM 0. 119.5 FORMAT "%7.3"
 /begin AXIS_DESCR COM_AXIS TCO _CNV_A_R_LINEAR_____0_CM 8 -48. 142.5 FORMAT "%5.1" AXIS_PTS_REF ldpm_tco_1_thro /end AXIS_DESCR
/end CHARACTERISTIC
/begin AXIS_PTS ldp_n_32_tps_sp_pwl "" 0x436db N_32 _REC_AXS_20_u1 816. _CNV_A_R_LINEAR_____5_CM 4 0. 8160. FORMAT "%4.0" /end AXIS_PTS
/begin AXIS_PTS ldp_pv_av__tps_sp_ext "" 0x437a9 PV_AV _REC_AXS_20_u1 99.609375 _CNV_A_R_LINEAR_____4_CM 6 0. 99.609375 FORMAT "%4.1" /end AXIS_PTS
/begin MEASUREMENT TPS_SP_SEL "selected throttle position setpoint before limitation" UWORD _CNV_A_R_LINEAR_____226_CM 1 100. 0. 119.5 ECU_ADDRESS 0x3fe6d6 FORMAT "%7.3" /end MEASUREMENT
/begin CHARACTERISTIC C_TPS_AV_BOL "Lower limit (actual value) of the closing speed limitation of the throttle setpoint" VALUE 0x430aa _REC_VAL_20_u2 119.5 _CNV_A_R_LINEAR_____226_CM 0. 119.5 FORMAT "%7.3" /end CHARACTERISTIC
/begin CHARACTERISTIC C_TPS_AV_TOL "Upper limit (actual value) of the closing speed limitation of the throttle setpoint" VALUE 0x430ae _REC_VAL_20_u2 119.5 _CNV_A_R_LINEAR_____226_CM 0. 119.5 FORMAT "%7.3" /end CHARACTERISTIC
/begin CHARACTERISTIC C_TPS_SP_MIN "Lower limit of the throttle position setpoint" VALUE 0x430d2 _REC_VAL_20_u2 119.5 _CNV_A_R_LINEAR_____226_CM 0. 119.5 FORMAT "%7.3" /end CHARACTERISTIC
/begin CHARACTERISTIC C_TPS_SP_MIN_TPS_AD_REQ "Lower limit of the throttle position setpoint without throttle Adaptation" VALUE 0x430d4 _REC_VAL_20_u2 119.5 _CNV_A_R_LINEAR_____226_CM 0. 119.5 FORMAT "%7.3" /end CHARACTERISTIC
/begin CHARACTERISTIC C_TPS_SP_MAX_TPS_AD_REQ "Upper limit of the throttle position setpoint without throttle Adaptation" VALUE 0x430d0 _REC_VAL_20_u2 119.5 _CNV_A_R_LINEAR_____226_CM 0. 119.5 FORMAT "%7.3" /end CHARACTERISTIC
/begin CHARACTERISTIC C_TPS_SP_MAX "Upper limit of the throttle position setpoint" VALUE 0x430ce _REC_VAL_20_u2 119.5 _CNV_A_R_LINEAR_____226_CM 0. 119.5 FORMAT "%7.3" /end CHARACTERISTIC
/begin CHARACTERISTIC C_TPS_SP_TOL "Upper limit of opening velocity limitation the throttle position setpoint" VALUE 0x430e4 _REC_VAL_20_u2 119.5 _CNV_A_R_LINEAR_____226_CM 0. 119.5 FORMAT "%7.3" /end CHARACTERISTIC
/begin CHARACTERISTIC C_TPS_SP_TOL_TPS_AD_REQ "Upper limit of opening velocity limitation the throttle position setpoint without throttle Adaptation" VALUE 0x430e6 _REC_VAL_20_u2 119.5 _CNV_A_R_LINEAR_____226_CM 0. 119.5 FORMAT "%7.3" /end CHARACTERISTIC
/begin CHARACTERISTIC C_TPS_SP_BOL_TPS_AD_REQ "Lower limit of opening velocity limitation the throttle position setpoint without throttle Adaptation" VALUE 0x430c6 _REC_VAL_20_u2 119.5 _CNV_A_R_LINEAR_____226_CM 0. 119.5 FORMAT "%7.3" /end CHARACTERISTIC
/begin CHARACTERISTIC C_TPS_SP_BOL "Lower limit of opening velocity limitation the throttle position setpoint" VALUE 0x430c4 _REC_VAL_20_u2 119.5 _CNV_A_R_LINEAR_____226_CM 0. 119.5 FORMAT "%7.3" /end CHARACTERISTIC
/begin CHARACTERISTIC C_TPS_SP_LGRD_TOT "Threshold opening after power latch" VALUE 0x430ca _REC_VAL_20_u2 119.5 _CNV_A_R_LINEAR_____226_CM 0. 119.5 FORMAT "%7.3" /end CHARACTERISTIC
/begin MEASUREMENT TPS_SP "real throttle angle setpoint for MTC-position controller" UWORD _CNV_A_R_LINEAR_____226_CM 1 100. 0. 119.5 ECU_ADDRESS 0x3fd078 FORMAT "%7.3" /end MEASUREMENT
/begin MEASUREMENT TPS_SP_LIM "limited throttle position setpoint" UWORD _CNV_A_R_LINEAR_____226_CM 1 100. 0. 119.5 ECU_ADDRESS 0x3fe6d8 FORMAT "%7.3" /end MEASUREMENT
/begin MEASUREMENT TPS_SP_LIM_2 "Throttle position setpoint after gradient limitation over whole operating range" UWORD _CNV_A_R_LINEAR_____226_CM 1 100. 0. 119.5 ECU_ADDRESS 0x3fe6dc FORMAT "%7.3" /end MEASUREMENT
/begin MEASUREMENT TPS_SP_LIM_1 "Throttle position setpoint after absolute value limitation" UWORD _CNV_A_R_LINEAR_____226_CM 1 100. 0. 119.5 ECU_ADDRESS 0x3fe6da FORMAT "%7.3" /end MEASUREMENT
/begin MEASUREMENT LV_TPS_SP_TRA_ST_MDL "Logical variable indicating transient phase after start" UBYTE _CNV_S_2_RANGE______28_CM 1 100. 0. 1. ECU_ADDRESS 0x3fe6e0 /end MEASUREMENT
/begin MEASUREMENT TPS_SP_TRA_ST_MDL "Throttle position setpoint for transient phase after start" UWORD _CNV_A_R_LINEAR_____226_CM 1 100. 0. 119.5 ECU_ADDRESS 0x3fe6de FORMAT "%7.3" /end MEASUREMENT
/begin CHARACTERISTIC IP_TPS_SP_LGRD_ST "Admissible gradient of throttle position setpoint for transient phase after start" MAP 0x4bc4c _REC_MAP_20_u2_u2_u1 119.5 _CNV_A_R_LINEAR_____226_CM 0. 119.5 FORMAT "%7.3"
 /begin AXIS_DESCR COM_AXIS N _CNV_A_R_LINEAR_____17_CM 8 0. 8160. FORMAT "%4.0" AXIS_PTS_REF ldp_n_ip_tps_sp_lgrd_st /end AXIS_DESCR
 /begin AXIS_DESCR COM_AXIS TCO _CNV_A_R_LINEAR_____0_CM 8 -48. 142.5 FORMAT "%5.1" AXIS_PTS_REF ldp_tco_ip_tps_sp_lgrd_st /end AXIS_DESCR
/end CHARACTERISTIC
/begin AXIS_PTS ldp_n_ip_tps_sp_lgrd_st "" 0x448cc N _REC_AXS_20_u2 8160. _CNV_A_R_LINEAR_____17_CM 8 0. 8160. FORMAT "%4.0" /end AXIS_PTS
/begin AXIS_PTS ldp_tco_ip_tps_sp_lgrd_st "" 0x43932 TCO _REC_AXS_20_u1 190.5 _CNV_A_R_LINEAR_____0_CM 8 -48. 142.5 FORMAT "%5.1" /end AXIS_PTS
/begin MEASUREMENT LV_ERR_MTC_CTL_1 "Logical variable (set. if a MTCPWM error is present)" UBYTE _CNV_S_2_RANGE______21_R_CM 1 100. 0. 255. ECU_ADDRESS 0x3fd47f /end MEASUREMENT
/begin CHARACTERISTIC C_ABC_INC_TQI_LIM "Increment counter for torque request for safety" VALUE 0x42726 _REC_VAL_20_u1 255. _CNV_A_R_LINEAR_____10_CM 0. 255. FORMAT "%3.0" /end CHARACTERISTIC
/begin CHARACTERISTIC C_ABC_MAX_TQI_LIM "Maximum counter for torque request for safety" VALUE 0x427a8 _REC_VAL_20_u1 254. _CNV_A_R_LINEAR_____10_CM 1. 255. FORMAT "%3.0" /end CHARACTERISTIC
/begin CHARACTERISTIC TOGMAXUNPL "" VALUE 0x5b77f _REC_VAL_20_u1 251. _CNV_A_R_LINEAR_____12_CM 4. 255. FORMAT "%5.1" /end CHARACTERISTIC
/begin CHARACTERISTIC TOG_CNTMAX "" VALUE 0x5b77c _REC_VAL_20_u2 655.35 _CNV_R_R_t10msxs_ub_489_CM 0. 655.35 FORMAT "%8.4" /end CHARACTERISTIC
/begin CHARACTERISTIC C_ABC_INC_SEG_T_AD "Increment value of the anti - bounce counter for segment period measurement diagnosis." VALUE 0x42079 _REC_VAL_20_u1 255. _CNV_A_R_LINEAR_____10_CM 0. 255. FORMAT "%3.0" /end CHARACTERISTIC
/begin CHARACTERISTIC C_ABC_INC_SEG_T "Increment value of the anti - bounce counter for segment period measurement diagnosis." VALUE 0x42078 _REC_VAL_20_u1 255. _CNV_A_R_LINEAR_____10_CM 0. 255. FORMAT "%3.0" /end CHARACTERISTIC
/begin CHARACTERISTIC C_ABC_MAX_SEG_T_AD "Maximum value of the anti - bounce counter for segment period measurement diagnosis." VALUE 0x4207b _REC_VAL_20_u1 254. _CNV_A_R_LINEAR_____10_CM 1. 255. FORMAT "%3.0" /end CHARACTERISTIC
/begin CHARACTERISTIC C_ABC_MAX_SEG_T "Maximum value of the anti - bounce counter for segment period measurement diagnosis." VALUE 0x4207a _REC_VAL_20_u1 254. _CNV_A_R_LINEAR_____10_CM 1. 255. FORMAT "%3.0" /end CHARACTERISTIC
/begin MEASUREMENT LV_ERR_BSD "logical variable for BSD error" UBYTE _CNV_S_2_RANGE______21_R_CM 1 100. 0. 255. ECU_ADDRESS 0x3fd603 /end MEASUREMENT
/begin CHARACTERISTIC C_ABC_INC_GEN "Increment debounce counter - Generator error" VALUE 0x426de _REC_VAL_20_u1 255. _CNV_A_R_LINEAR_____10_CM 0. 255. FORMAT "%3.0" /end CHARACTERISTIC
/begin CHARACTERISTIC C_ABC_INC_GEN_IF "Increment debounce counter - Generator error" VALUE 0x426df _REC_VAL_20_u1 255. _CNV_A_R_LINEAR_____10_CM 0. 255. FORMAT "%3.0" /end CHARACTERISTIC
/begin CHARACTERISTIC C_ABC_MAX_GEN "Maximum value debounce counter - Generator error" VALUE 0x42763 _REC_VAL_20_u1 254. _CNV_A_R_LINEAR_____10_CM 1. 255. FORMAT "%3.0" /end CHARACTERISTIC
/begin CHARACTERISTIC C_ABC_MAX_GEN_IF "Maximum value debounce counter - Generator error" VALUE 0x42764 _REC_VAL_20_u1 254. _CNV_A_R_LINEAR_____10_CM 1. 255. FORMAT "%3.0" /end CHARACTERISTIC
/begin CHARACTERISTIC C_ABC_INC_TOIL_LEVEL "Anti bounce increment" VALUE 0x4270e _REC_VAL_20_u1 255. _CNV_A_R_LINEAR_____10_CM 0. 255. FORMAT "%3.0" /end CHARACTERISTIC
/begin CHARACTERISTIC C_ABC_MAX_TOIL_LEVEL "Anti boune maximum" VALUE 0x42794 _REC_VAL_20_u1 254. _CNV_A_R_LINEAR_____10_CM 1. 255. FORMAT "%3.0" /end CHARACTERISTIC
/begin MEASUREMENT B_TOGERR "" UBYTE _CNV_S_2_B_TRUE_519_CM 1 100. 0. 1. ECU_ADDRESS 0x3fc596 BIT_MASK 0x40 /end MEASUREMENT
/begin MEASUREMENT B_TOGUPL "" UBYTE _CNV_S_2_B_TRUE_519_CM 1 100. 0. 1. ECU_ADDRESS 0x3fc597 BIT_MASK 0x80 /end MEASUREMENT
/begin CHARACTERISTIC C_N_GRD_MIN "engine speed  gradient threshold for activating the intercept function" VALUE 0x43350 _REC_VAL_20_s1 204.8 _CNV_A_R_LINEAR_____215_CM -4096. 0. FORMAT "%7.0" /end CHARACTERISTIC
/begin CHARACTERISTIC C_N_MAX_INF "Maximum engine speed possible below the intercept" VALUE 0x42954 _REC_VAL_20_u1 408. _CNV_A_R_LINEAR_____5_CM 0. 8160. FORMAT "%4.0" /end CHARACTERISTIC
/begin CHARACTERISTIC C_T_DYW_TPS_LIH_CHK "Time period for Dynamic window around Limp Home" VALUE 0x429f8 _REC_VAL_20_u1 1.275 _CNV_A_R_LINEAR_____367_CM 0. 1.275 FORMAT "%4.3" /end CHARACTERISTIC
/begin CHARACTERISTIC C_T_MAX_ECU "time delay to switch off the ECU" VALUE 0x42fee _REC_VAL_20_u2 102.2 _CNV_A_R_LINEAR_____47_CM 1. 1023. FORMAT "%4.0" /end CHARACTERISTIC
/begin CHARACTERISTIC C_V_TPS_AD_BOL_INI_1 "Start value for the Adaptation value lower start (Poti 1)" VALUE 0x42af4 _REC_VAL_20_u1 4.998 _CNV_A_R_LINEAR_____38_CM 0. 4.998 FORMAT "%3.2" /end CHARACTERISTIC
/begin CHARACTERISTIC C_V_TPS_AD_BOL_INI_2 "Start value for the Adaptation value lower start (Poti 2)" VALUE 0x42af5 _REC_VAL_20_u1 4.998 _CNV_A_R_LINEAR_____38_CM 0. 4.998 FORMAT "%3.2" /end CHARACTERISTIC
/begin CHARACTERISTIC C_V_TPS_LIH_CHK_HYS "Voltage window around Limp Home position for recognizing a correct MTC" VALUE 0x42afa _REC_VAL_20_u1 1.24511719 _CNV_A_R_LINEAR_____177_CM 0. 1.24511719 FORMAT "%4.3" /end CHARACTERISTIC
/begin CHARACTERISTIC C_V_TPS_SP_LIH_1 "Nominal value of the TPS-voltage in Limp Home for Poti 1" VALUE 0x42afd _REC_VAL_20_u1 4.998 _CNV_A_R_LINEAR_____38_CM 0. 4.998 FORMAT "%3.2" /end CHARACTERISTIC
/begin CHARACTERISTIC C_V_TPS_SP_LIH_2 "Nominal value of the TPS-voltage in Limp Home for Poti 1" VALUE 0x42afe _REC_VAL_20_u1 4.998 _CNV_A_R_LINEAR_____38_CM 0. 4.998 FORMAT "%3.2" /end CHARACTERISTIC
/begin CHARACTERISTIC C_TPS_AD_SLOP_GAIN_INI_1 "" VALUE 0x430a8 _REC_VAL_20_u2 7.99987793 _CNV_A_R_LINEAR_____348_CM 0. 7.99987793 FORMAT "%6.4" /end CHARACTERISTIC
/begin CHARACTERISTIC ID_TPS_GRD_BOL_AE__N__TPS_AV "Throttle position gradient threshold" MAP 0x4d05b _REC_MAP_20_u1_u1_u2 298.75 _CNV_A_R_LINEAR_____264_CM 0. 2987.5 FORMAT "%4.0"
 /begin AXIS_DESCR COM_AXIS N_32 _CNV_A_R_LINEAR_____5_CM 6 0. 8160. FORMAT "%4.0" AXIS_PTS_REF ldp_n_23 /end AXIS_DESCR
 /begin AXIS_DESCR COM_AXIS TPS_AV _CNV_A_R_LINEAR_____226_CM 4 0. 119.5 FORMAT "%7.3" AXIS_PTS_REF ldp_tps_av_id_tps_grd_bol_ae /end AXIS_DESCR
/end CHARACTERISTIC
/begin CHARACTERISTIC C_TPS_SP_LGRD_STOP "max. admissable gradient of throtle setpoint in the range of the top and bottom stop" VALUE 0x430c8 _REC_VAL_20_u2 119.5 _CNV_A_R_LINEAR_____447_CM 0. 119.5 FORMAT "%7.3" /end CHARACTERISTIC
/begin CHARACTERISTIC C_V_TPS_AD_OFS_GAIN_INI_1 "" VALUE 0x43324 _REC_VAL_20_s2 5. _CNV_A_R_LINEAR_____358_CM -2.5 2.5 /end CHARACTERISTIC
/begin CHARACTERISTIC C_CQ_S_MIN "Minimum characteristic quantity value for STRAT acceptation" VALUE 0x42823 _REC_VAL_20_u1 99.609375 _CNV_A_R_LINEAR_____4_CM 0. 99.609375 FORMAT "%5.1" /end CHARACTERISTIC
/begin CHARACTERISTIC C_CQ_HOM_MIN "Minimum characteristic quantity value for HOM acceptation" VALUE 0x42822 _REC_VAL_20_u1 99.609375 _CNV_A_R_LINEAR_____4_CM 0. 99.609375 FORMAT "%5.1" /end CHARACTERISTIC
/begin CHARACTERISTIC C_T_MTC_ISA_OFF "Active time periodThrottle position setpoint" VALUE 0x42a1e _REC_VAL_20_u1 255. _CNV_A_R_LINEAR_____47_CM 0. 255. FORMAT "%3.0" /end CHARACTERISTIC
/begin CHARACTERISTIC DTOG_UBMIN "" VALUE 0x5b77e _REC_VAL_20_u1 24.02 _CNV_A_R_spg_ubatt_575_CM 0. 24.02 FORMAT "%5.2" /end CHARACTERISTIC
/begin AXIS_PTS ldp_tps_av_id_tps_grd_bol_ae "" 0x44b52 TPS_AV _REC_AXS_20_u2 11.95 _CNV_A_R_LINEAR_____226_CM 4 0. 119.5 FORMAT "%7.3" /end AXIS_PTS
/begin AXIS_PTS ldpm_ctr_km_can_1 "" 0x44edc CTR_KM_CAN _REC_AXS_20_u2 655350. _CNV_A_R_LINEAR_____80_CM 4 0. 655350. FORMAT "%7.0" /end AXIS_PTS
/begin AXIS_PTS ldp_n_23 "" 0x434c0 N_32 _REC_AXS_20_u1 816. _CNV_A_R_LINEAR_____5_CM 6 0. 8160. FORMAT "%4.0" /end AXIS_PTS
/begin AXIS_PTS ldpm_tco_9 "" 0x43f7f TCO _REC_AXS_20_u1 28.575 _CNV_A_R_LINEAR_____0_CM 9 -48. 142.5 FORMAT "%5.1" /end AXIS_PTS
/begin AXIS_PTS ldpm_n_1_thro "" 0x4523e N _REC_AXS_20_u2 8160. _CNV_A_R_LINEAR_____17_CM 8 0. 8160. FORMAT "%4.0" /end AXIS_PTS
/begin AXIS_PTS ldpm_tco_1_thro "" 0x43f64 TCO _REC_AXS_20_u1 190.5 _CNV_A_R_LINEAR_____0_CM 8 -48. 142.5 FORMAT "%5.1" /end AXIS_PTS
/begin CHARACTERISTIC C_ABC_MAX_RLY_EFP "Debounce counter maximum value" VALUE 0x42784 _REC_VAL_20_u1 254. _CNV_A_R_LINEAR_____10_CM 1. 255. FORMAT "%3.0" /end CHARACTERISTIC
/begin CHARACTERISTIC C_ABC_INC_RLY_EFP "Debounce counter increment" VALUE 0x426fe _REC_VAL_20_u1 255. _CNV_A_R_LINEAR_____10_CM 0. 255. FORMAT "%3.0" /end CHARACTERISTIC
/begin CHARACTERISTIC C_ABC_INC_SAV "Debounce counter increment- SAV diagnosis" VALUE 0x42702 _REC_VAL_20_u1 255. _CNV_A_R_LINEAR_____10_CM 0. 255. FORMAT "%3.0" /end CHARACTERISTIC
/begin CHARACTERISTIC C_ABC_MAX_SAV "Debounce counter maximum value - SAV diagnosis" VALUE 0x42788 _REC_VAL_20_u1 254. _CNV_A_R_LINEAR_____10_CM 1. 255. FORMAT "%3.0" /end CHARACTERISTIC
/begin CHARACTERISTIC C_ABC_INC_SAP "Debounce counter increment- SAP diagnosis" VALUE 0x42701 _REC_VAL_20_u1 255. _CNV_A_R_LINEAR_____10_CM 0. 255. FORMAT "%3.0" /end CHARACTERISTIC
/begin CHARACTERISTIC C_ABC_INC_RLY_ACCOUT "Debounce counter increment- RLY_ACCOUT diagnosis" VALUE 0x426fd _REC_VAL_20_u1 255. _CNV_A_R_LINEAR_____10_CM 0. 255. FORMAT "%3.0" /end CHARACTERISTIC
/begin CHARACTERISTIC C_ABC_MAX_RLY_ACCOUT "Debounce counter maximum value - RLY_ACCOUT diagnosis" VALUE 0x42783 _REC_VAL_20_u1 254. _CNV_A_R_LINEAR_____10_CM 1. 255. FORMAT "%3.0" /end CHARACTERISTIC
/begin CHARACTERISTIC C_ABC_INC_ECT_EL "Debounce counter increment - Thermostat heating diagnosis" VALUE 0x426d8 _REC_VAL_20_u1 255. _CNV_A_R_LINEAR_____10_CM 0. 255. FORMAT "%3.0" /end CHARACTERISTIC
/begin CHARACTERISTIC C_ABC_MAX_ECT_EL "Debounce counter maximum value - Thermostat heating diagnosis" VALUE 0x4275f _REC_VAL_20_u1 254. _CNV_A_R_LINEAR_____10_CM 1. 255. FORMAT "%3.0" /end CHARACTERISTIC
/begin CHARACTERISTIC C_ABC_INC_ECF "Debounce counter increment- ECF diagnosis" VALUE 0x426d6 _REC_VAL_20_u1 255. _CNV_A_R_LINEAR_____10_CM 0. 255. FORMAT "%3.0" /end CHARACTERISTIC
/begin CHARACTERISTIC C_ABC_INC_EF "Debounce counter increment" VALUE 0x426da _REC_VAL_20_u1 255. _CNV_A_R_LINEAR_____10_CM 0. 255. FORMAT "%3.0" /end CHARACTERISTIC
/begin CHARACTERISTIC C_ABC_MAX_ECF "Debounce counter maximum value - ECF diagnosis" VALUE 0x4275d _REC_VAL_20_u1 254. _CNV_A_R_LINEAR_____10_CM 1. 255. FORMAT "%3.0" /end CHARACTERISTIC
/begin CHARACTERISTIC C_ABC_MAX_EF "Debounce counter maximum value" VALUE 0x42761 _REC_VAL_20_u1 254. _CNV_A_R_LINEAR_____10_CM 1. 255. FORMAT "%3.0" /end CHARACTERISTIC
/begin CHARACTERISTIC C_ABC_INC_EBOX_CFA "Debounce counter increment" VALUE 0x426d5 _REC_VAL_20_u1 255. _CNV_A_R_LINEAR_____10_CM 0. 255. FORMAT "%3.0" /end CHARACTERISTIC
/begin CHARACTERISTIC C_ABC_MAX_EBOX_CFA "Debounce counter maximum value" VALUE 0x4275c _REC_VAL_20_u1 254. _CNV_A_R_LINEAR_____10_CM 1. 255. FORMAT "%3.0" /end CHARACTERISTIC
/begin CHARACTERISTIC C_ABC_MAX_SAP "Debounce counter maximum value - SAP diagnosis" VALUE 0x42787 _REC_VAL_20_u1 254. _CNV_A_R_LINEAR_____10_CM 1. 255. FORMAT "%3.0" /end CHARACTERISTIC
/begin CHARACTERISTIC C_ABC_MAX_CPS "Debounce counter maximum value - CPS diagnosis" VALUE 0x42752 _REC_VAL_20_u1 254. _CNV_A_R_LINEAR_____10_CM 1. 255. FORMAT "%3.0" /end CHARACTERISTIC
/begin CHARACTERISTIC C_ABC_INC_RLY_ST "Anti - bounce counter increment" VALUE 0x42700 _REC_VAL_20_u1 255. _CNV_A_R_LINEAR_____10_CM 0. 255. FORMAT "%3.0" /end CHARACTERISTIC
/begin CHARACTERISTIC C_ABC_MAX_RLY_ST "Debounce counter maximum value" VALUE 0x42786 _REC_VAL_20_u1 254. _CNV_A_R_LINEAR_____10_CM 1. 255. FORMAT "%3.0" /end CHARACTERISTIC
/begin CHARACTERISTIC C_ABC_MAX_DMTL_PUMP "Debounce counter maximum value" VALUE 0x42759 _REC_VAL_20_u1 254. _CNV_A_R_LINEAR_____10_CM 1. 255. FORMAT "%3.0" /end CHARACTERISTIC
/begin CHARACTERISTIC C_ABC_INC_ECRAS "Anti - bounce counter increment ECRAS diagnosis" VALUE 0x426d7 _REC_VAL_20_u1 255. _CNV_A_R_LINEAR_____10_CM 0. 255. FORMAT "%3.0" /end CHARACTERISTIC
/begin CHARACTERISTIC C_ABC_INC_DMTLH "Anti - bounce counter increment" VALUE 0x426d3 _REC_VAL_20_u1 255. _CNV_A_R_LINEAR_____10_CM 0. 255. FORMAT "%3.0" /end CHARACTERISTIC
/begin CHARACTERISTIC C_ABC_MAX_ECRAS "Maximum value of the anti - bounce counter ECRAS diagnosis" VALUE 0x4275e _REC_VAL_20_u1 254. _CNV_A_R_LINEAR_____10_CM 1. 255. FORMAT "%3.0" /end CHARACTERISTIC
/begin CHARACTERISTIC C_ABC_MAX_DMTLH "Maximum value of the anti - bounce counter" VALUE 0x4275a _REC_VAL_20_u1 254. _CNV_A_R_LINEAR_____10_CM 1. 255. FORMAT "%3.0" /end CHARACTERISTIC
/begin CHARACTERISTIC C_NOX_SENS_CYCNR_MAX "maximum number of missing NOX_SENS messages for error debounce counter increment" VALUE 0x42975 _REC_VAL_20_u1 254. _CNV_A_R_LINEAR_____10_CM 1. 255. FORMAT "%3.0" /end CHARACTERISTIC
/begin CHARACTERISTIC C_ABC_INC_CPS "Debounce counter increment - CPS diagnosis" VALUE 0x426cb _REC_VAL_20_u1 255. _CNV_A_R_LINEAR_____10_CM 0. 255. FORMAT "%3.0" /end CHARACTERISTIC
/begin CHARACTERISTIC C_ABC_INC_TOUT_NOX_SENS "Debounce counter increment - diagnosis of timeout CAN message NOX_SENS" VALUE 0x4271a _REC_VAL_20_u1 255. _CNV_A_R_LINEAR_____10_CM 0. 255. FORMAT "%3.0" /end CHARACTERISTIC
/begin CHARACTERISTIC C_ABC_MAX_TOUT_NOX_SENS "debounce counter maximum value - diagnosis of timeout CAN message NOX_SENS" VALUE 0x4279e _REC_VAL_20_u1 254. _CNV_A_R_LINEAR_____10_CM 1. 255. FORMAT "%3.0" /end CHARACTERISTIC
/begin CHARACTERISTIC C_ABC_INC_NOX_SENS "Anti - bounce counter increment of NOx-Sensor OBD I diagnosis" VALUE 0x426f6 _REC_VAL_20_u1 255. _CNV_A_R_LINEAR_____10_CM 0. 255. FORMAT "%3.0" /end CHARACTERISTIC
/begin CHARACTERISTIC C_ABC_MAX_NOX_SENS "Maximum value of the anti - bounce counter for NOx-Sensor OBD I diagnosis" VALUE 0x4277a _REC_VAL_20_u1 254. _CNV_A_R_LINEAR_____10_CM 1. 255. FORMAT "%3.0" /end CHARACTERISTIC
/begin CHARACTERISTIC C_ABC_MAX_VLS_DOWN_PUC "Debounce counter maximum for PUC plausibility" VALUE 0x427b3 _REC_VAL_20_u1 254. _CNV_A_R_LINEAR_____10_CM 1. 255. FORMAT "%3.0" /end CHARACTERISTIC
/begin CHARACTERISTIC C_ABC_MAX_VLS_DOWN_FL "Debounce counter maximum for FL plausibility" VALUE 0x427ae _REC_VAL_20_u1 254. _CNV_A_R_LINEAR_____10_CM 1. 255. FORMAT "%3.0" /end CHARACTERISTIC
/begin CHARACTERISTIC C_ABC_INC_VLS_DOWN_PUC "Debounce counter increment for PUC plausibility" VALUE 0x42731 _REC_VAL_20_u1 255. _CNV_A_R_LINEAR_____10_CM 0. 255. FORMAT "%3.0" /end CHARACTERISTIC
/begin CHARACTERISTIC C_ABC_INC_VLS_DOWN_FL "Debounce counter increment for PUC plausibility" VALUE 0x4272c _REC_VAL_20_u1 255. _CNV_A_R_LINEAR_____10_CM 0. 255. FORMAT "%3.0" /end CHARACTERISTIC
/begin CHARACTERISTIC C_ABC_MAX_DMTLS "Debounce counter maximum value" VALUE 0x4275b _REC_VAL_20_u1 254. _CNV_A_R_LINEAR_____10_CM 1. 255. FORMAT "%3.0" /end CHARACTERISTIC
/begin CHARACTERISTIC C_ABC_INC_DMTLS "Anti - bounce counter increment" VALUE 0x426d4 _REC_VAL_20_u1 255. _CNV_A_R_LINEAR_____10_CM 0. 255. FORMAT "%3.0" /end CHARACTERISTIC
/begin CHARACTERISTIC C_ABC_INC_ISA_2 "Debounce counter increment - electrical error - ISA closing coil" VALUE 0x426e6 _REC_VAL_20_u1 255. _CNV_A_R_LINEAR_____10_CM 0. 255. FORMAT "%3.0" /end CHARACTERISTIC
/begin CHARACTERISTIC C_ABC_MAX_ISA_1 "Debounce counter maximum value - electrical error - ISA opening coil" VALUE 0x4276a _REC_VAL_20_u1 254. _CNV_A_R_LINEAR_____10_CM 1. 255. FORMAT "%3.0" /end CHARACTERISTIC
/begin CHARACTERISTIC C_ABC_MAX_ISA_2 "Debounce counter maximum value - electrical error - ISA opening coil" VALUE 0x4276b _REC_VAL_20_u1 254. _CNV_A_R_LINEAR_____10_CM 1. 255. FORMAT "%3.0" /end CHARACTERISTIC
/begin CHARACTERISTIC C_ABC_INC_ISA_1 "Debounce counter increment - electrical error - ISA opening coil" VALUE 0x426e5 _REC_VAL_20_u1 255. _CNV_A_R_LINEAR_____10_CM 0. 255. FORMAT "%3.0" /end CHARACTERISTIC
/begin CHARACTERISTIC C_ABC_INC_CONV_MON "Anti bounce counter increment (additive value in case of ADC error)" VALUE 0x40240 _REC_VAL_20_u1 255. _CNV_A_R_LINEAR_____10_CM 0. 255. FORMAT "%3.0" /end CHARACTERISTIC
/begin CHARACTERISTIC C_ABC_INC_MAF_MON "Anti bounce counter increment (additive value in case of MAF diagnosis error)" VALUE 0x40242 _REC_VAL_20_u1 255. _CNV_A_R_LINEAR_____10_CM 0. 255. FORMAT "%3.0" /end CHARACTERISTIC
/begin CHARACTERISTIC C_ABC_INC_N_32_MON "Anti bounce counter increment (additive value in case of N_32 ratio error)" VALUE 0x40244 _REC_VAL_20_u1 255. _CNV_A_R_LINEAR_____10_CM 0. 255. FORMAT "%3.0" /end CHARACTERISTIC
/begin CHARACTERISTIC C_ABC_INC_PVS_RATIO_MON "Anti bounce counter increment (additive value in case of error)" VALUE 0x40245 _REC_VAL_20_u1 255. _CNV_A_R_LINEAR_____10_CM 0. 255. FORMAT "%3.0" /end CHARACTERISTIC
/begin CHARACTERISTIC C_ABC_INC_TPS_RATIO_MON "Anti bounce counter increment (additive value in case of ratio error)" VALUE 0x40246 _REC_VAL_20_u1 255. _CNV_A_R_LINEAR_____10_CM 0. 255. FORMAT "%3.0" /end CHARACTERISTIC
/begin CHARACTERISTIC C_ABC_MAX_CONV_MON "Value at which ADC error is recognized, when reached" VALUE 0x4024e _REC_VAL_20_u1 254. _CNV_A_R_LINEAR_____10_CM 1. 255. FORMAT "%3.0" /end CHARACTERISTIC
/begin CHARACTERISTIC C_ABC_MAX_MAF_MON "Value at which MAF diagnosis error is recognized, when reached" VALUE 0x40250 _REC_VAL_20_u1 254. _CNV_A_R_LINEAR_____10_CM 1. 255. FORMAT "%3.0" /end CHARACTERISTIC
/begin CHARACTERISTIC C_ABC_MAX_N_32_MON "Value at which N_32 ratio error is recognized, when reached" VALUE 0x40252 _REC_VAL_20_u1 254. _CNV_A_R_LINEAR_____10_CM 1. 255. FORMAT "%3.0" /end CHARACTERISTIC
/begin CHARACTERISTIC C_ABC_MAX_PVS_RATIO_MON "Value at which ratio error is recognized. when reached" VALUE 0x40253 _REC_VAL_20_u1 254. _CNV_A_R_LINEAR_____10_CM 1. 255. FORMAT "%3.0" /end CHARACTERISTIC
/begin CHARACTERISTIC C_ABC_MAX_TPS_RATIO_MON "Value at which ratio error is recognized, when reached" VALUE 0x40254 _REC_VAL_20_u1 254. _CNV_A_R_LINEAR_____10_CM 1. 255. FORMAT "%3.0" /end CHARACTERISTIC
/begin CHARACTERISTIC C_ABC_MAX_TQI_N_MAX_MON "Maximum value of anti-bounce counter" VALUE 0x4025b _REC_VAL_20_u1 254. _CNV_A_R_LINEAR_____10_CM 1. 255. FORMAT "%3.0" /end CHARACTERISTIC
/begin CHARACTERISTIC C_ABC_INC_TQI_N_MAX_MON "Anti bounce counter increment" VALUE 0x4024d _REC_VAL_20_u1 255. _CNV_A_R_LINEAR_____10_CM 0. 255. FORMAT "%3.0" /end CHARACTERISTIC
/begin CHARACTERISTIC C_ABC_INC_TQ_DIF_P_D_IS_MON "Anti bounce counter increment" VALUE 0x40248 _REC_VAL_20_u1 255. _CNV_A_R_LINEAR_____10_CM 0. 255. FORMAT "%3.0" /end CHARACTERISTIC
/begin CHARACTERISTIC C_ABC_INC_TQ_DIF_I_IS_MON "Anti bounce counter increment" VALUE 0x40247 _REC_VAL_20_u1 255. _CNV_A_R_LINEAR_____10_CM 0. 255. FORMAT "%3.0" /end CHARACTERISTIC
/begin CHARACTERISTIC C_ABC_MAX_TQ_DIF_P_D_IS_MON "Maximum of anti bounce counter" VALUE 0x40256 _REC_VAL_20_u1 254. _CNV_A_R_LINEAR_____10_CM 1. 255. FORMAT "%3.0" /end CHARACTERISTIC
/begin CHARACTERISTIC C_ABC_MAX_TQ_DIF_I_IS_MON "Maximum of anti bounce counter" VALUE 0x40255 _REC_VAL_20_u1 254. _CNV_A_R_LINEAR_____10_CM 1. 255. FORMAT "%3.0" /end CHARACTERISTIC
/begin CHARACTERISTIC C_ABC_INC_TQI_AV_MON "Anti bounce counter increment" VALUE 0x4024c _REC_VAL_20_u1 255. _CNV_A_R_LINEAR_____10_CM 0. 255. FORMAT "%3.0" /end CHARACTERISTIC
/begin CHARACTERISTIC C_ABC_INC_TQ_LOSS_MON "anti bounce counter increment" VALUE 0x40249 _REC_VAL_20_u1 255. _CNV_A_R_LINEAR_____10_CM 0. 255. FORMAT "%3.0" /end CHARACTERISTIC
/begin CHARACTERISTIC C_ABC_MAX_TQI_AV_MON "Maximum value of anti-bounce counter" VALUE 0x4025a _REC_VAL_20_u1 254. _CNV_A_R_LINEAR_____10_CM 1. 255. FORMAT "%3.0" /end CHARACTERISTIC
/begin CHARACTERISTIC C_ABC_MAX_TQ_LOSS_MON "maximum of anti bounce counter" VALUE 0x40257 _REC_VAL_20_u1 254. _CNV_A_R_LINEAR_____10_CM 1. 255. FORMAT "%3.0" /end CHARACTERISTIC
/begin CHARACTERISTIC C_ABC_INC_TQ_MIN_CLU_MON "Anti bounce counter increment" VALUE 0x4024b _REC_VAL_20_u1 255. _CNV_A_R_LINEAR_____10_CM 0. 255. FORMAT "%3.0" /end CHARACTERISTIC
/begin CHARACTERISTIC C_ABC_MAX_TQ_MIN_CLU_MON "Maximum of anti bounce counter" VALUE 0x40259 _REC_VAL_20_u1 254. _CNV_A_R_LINEAR_____10_CM 1. 255. FORMAT "%3.0" /end CHARACTERISTIC
/begin CHARACTERISTIC C_ABC_INC_MSR_INH_MON "Anti bounce counter increment" VALUE 0x40243 _REC_VAL_20_u1 255. _CNV_A_R_LINEAR_____10_CM 0. 255. FORMAT "%3.0" /end CHARACTERISTIC
/begin CHARACTERISTIC C_ABC_MAX_MSR_INH_MON "Maximum value of anti - bounce counter" VALUE 0x40251 _REC_VAL_20_u1 254. _CNV_A_R_LINEAR_____10_CM 1. 255. FORMAT "%3.0" /end CHARACTERISTIC
/begin CHARACTERISTIC C_ABC_INC_CRU_INH_MON "Anti bouncecounter increment" VALUE 0x40241 _REC_VAL_20_u1 255. _CNV_A_R_LINEAR_____10_CM 0. 255. FORMAT "%3.0" /end CHARACTERISTIC
/begin CHARACTERISTIC C_ABC_MAX_CRU_INH_MON "Maximum value of anti-bounce counter" VALUE 0x4024f _REC_VAL_20_u1 254. _CNV_A_R_LINEAR_____10_CM 1. 255. FORMAT "%3.0" /end CHARACTERISTIC
/begin CHARACTERISTIC C_ABC_INC_TQ_MAX_CLU_MON "Anti bounce counter increment" VALUE 0x4024a _REC_VAL_20_u1 255. _CNV_A_R_LINEAR_____10_CM 0. 255. FORMAT "%3.0" /end CHARACTERISTIC
/begin CHARACTERISTIC C_ABC_MAX_TQ_MAX_CLU_MON "Maximum of anti bounce counter" VALUE 0x40258 _REC_VAL_20_u1 254. _CNV_A_R_LINEAR_____10_CM 1. 255. FORMAT "%3.0" /end CHARACTERISTIC
/begin CHARACTERISTIC C_ABC_MAX_TQI_N_MAX_MON2 "" VALUE 0x427a9 _REC_VAL_20_u1 254. _CNV_A_R_LINEAR_____10_CM 1. 255. FORMAT "%3.0" /end CHARACTERISTIC
/begin CHARACTERISTIC C_ABC_MAX_TQI_AV_MON2 "" VALUE 0x427a7 _REC_VAL_20_u1 254. _CNV_A_R_LINEAR_____10_CM 1. 255. FORMAT "%3.0" /end CHARACTERISTIC
/begin CHARACTERISTIC C_ABC_INC_TQI_N_MAX_MON2 "" VALUE 0x42727 _REC_VAL_20_u1 255. _CNV_A_R_LINEAR_____10_CM 0. 255. FORMAT "%3.0" /end CHARACTERISTIC
/begin CHARACTERISTIC C_ABC_INC_TQI_AV_MON2 "" VALUE 0x42725 _REC_VAL_20_u1 255. _CNV_A_R_LINEAR_____10_CM 0. 255. FORMAT "%3.0" /end CHARACTERISTIC
/begin COMPU_METHOD _CNV_A_R_LINEAR_____0_CM "" RAT_FUNC "%6.3" "°C" COEFFS 0 1.333333333333333 64. 0 0 1 /end COMPU_METHOD
/begin COMPU_METHOD _CNV_A_R_LINEAR_____1_CM "" RAT_FUNC "%6.3" "°C" COEFFS 0 1.333333333333333 0. 0 0 1 /end COMPU_METHOD
/begin COMPU_METHOD _CNV_A_R_LINEAR_____3_CM "" RAT_FUNC "%6.3" "°C" COEFFS 0 1. 40. 0 0 1 /end COMPU_METHOD
/begin COMPU_METHOD _CNV_A_R_LINEAR_____4_CM "" RAT_FUNC "%6.3" "%" COEFFS 0 2.56 0. 0 0 1 /end COMPU_METHOD
/begin COMPU_METHOD _CNV_A_R_LINEAR_____5_CM "" RAT_FUNC "%6.3" "rpm" COEFFS 0 3.125e-002 0. 0 0 1 /end COMPU_METHOD
/begin COMPU_METHOD _CNV_A_R_LINEAR_____10_CM "" RAT_FUNC "%6.3" "-" COEFFS 0 1. 0. 0 0 1 /end COMPU_METHOD
/begin COMPU_METHOD _CNV_S_2_RANGE______11_CM "" TAB_VERB "%6.3" "-" COMPU_TAB_REF _CNV_S_2_RANGE______11 /end COMPU_METHOD
/begin COMPU_VTAB _CNV_S_2_RANGE______11 "" TAB_VERB 2 0 "0" 1 "1" /end COMPU_VTAB
/begin COMPU_METHOD _CNV_A_R_LINEAR_____12_CM "" RAT_FUNC "%6.3" "[-]" COEFFS 0 1. 0. 0 0 1 /end COMPU_METHOD
/begin COMPU_METHOD _CNV_A_R_LINEAR_____13_CM "" RAT_FUNC "%6.3" "km/h" COEFFS 0 1. 0. 0 0 1 /end COMPU_METHOD
/begin COMPU_METHOD _CNV_A_R_LINEAR_____14_CM "" RAT_FUNC "%6.3" "s" COEFFS 0 10. 0. 0 0 1 /end COMPU_METHOD
/begin COMPU_METHOD _CNV_A_R_LINEAR_____17_CM "" RAT_FUNC "%6.3" "rpm" COEFFS 0 1. 0. 0 0 1 /end COMPU_METHOD
/begin COMPU_METHOD _CNV_A_R_LINEAR_____20_CM "" RAT_FUNC "%6.3" "-" COEFFS 0 255.9983911655618 0. 0 0 1 /end COMPU_METHOD
/begin COMPU_METHOD _CNV_S_2_RANGE______21_R_CM "" TAB_VERB "%6.3" "[-]" COMPU_TAB_REF _CNV_S_2_RANGE______21_R /end COMPU_METHOD
/begin COMPU_VTAB_RANGE _CNV_S_2_RANGE______21_R "" 2 0 0 "0" 1 255 "1" /end COMPU_VTAB_RANGE
/begin COMPU_METHOD _CNV_A_R_LINEAR_____23_CM "" RAT_FUNC "%6.3" "ms" COEFFS 0 0.1 0. 0 0 1 /end COMPU_METHOD
/begin COMPU_METHOD _CNV_A_R_LINEAR_____26_CM "" RAT_FUNC "%6.3" "V" COEFFS 0 9.846168103048838 0. 0 0 1 /end COMPU_METHOD
/begin COMPU_METHOD _CNV_A_R_LINEAR_____27_CM "" RAT_FUNC "%6.3" "s" COEFFS 0 100. 0. 0 0 1 /end COMPU_METHOD
/begin COMPU_METHOD _CNV_S_2_RANGE______28_CM "" TAB_VERB "%6.3" "[-]" COMPU_TAB_REF _CNV_S_2_RANGE______28 /end COMPU_METHOD
/begin COMPU_VTAB _CNV_S_2_RANGE______28 "" TAB_VERB 2 0 "0" 1 "1" /end COMPU_VTAB
/begin COMPU_METHOD _CNV_A_R_LINEAR_____31_CM "" RAT_FUNC "%6.3" "-" COEFFS 0 65536.00007936121 0. 0 0 1 /end COMPU_METHOD
/begin COMPU_METHOD _CNV_A_R_LINEAR_____33_CM "" RAT_FUNC "%6.3" "V" COEFFS 0 204.7999998974999 0. 0 0 1 /end COMPU_METHOD
/begin COMPU_METHOD _CNV_A_R_LINEAR_____34_CM "" RAT_FUNC "%6.3" "-" COEFFS 0 127.9991955827809 0. 0 0 1 /end COMPU_METHOD
/begin COMPU_METHOD _CNV_A_R_LINEAR_____35_CM "" RAT_FUNC "%6.3" "min" COEFFS 0 1. 0. 0 0 1 /end COMPU_METHOD
/begin COMPU_METHOD _CNV_A_R_LINEAR_____38_CM "" RAT_FUNC "%6.3" "V" COEFFS 0 51.0204081632653 0. 0 0 1 /end COMPU_METHOD
/begin COMPU_METHOD _CNV_A_R_LINEAR_____43_CM "" RAT_FUNC "%6.3" "hPa" COEFFS 0 12.06017666543982 0. 0 0 1 /end COMPU_METHOD
/begin COMPU_METHOD _CNV_A_R_LINEAR_____44_CM "" RAT_FUNC "%6.3" "[-]" COEFFS 0 255.9999357490357 0. 0 0 1 /end COMPU_METHOD
/begin COMPU_METHOD _CNV_A_R_LINEAR_____45_CM "" RAT_FUNC "%6.3" "-" COEFFS 0 32768.00003968061 0. 0 0 1 /end COMPU_METHOD
/begin COMPU_METHOD _CNV_A_R_LINEAR_____47_CM "" RAT_FUNC "%6.3" "s" COEFFS 0 1. 0. 0 0 1 /end COMPU_METHOD
/begin COMPU_METHOD _CNV_A_R_LINEAR_____48_CM "" RAT_FUNC "%6.3" "Nm" COEFFS 0 32. 0. 0 0 1 /end COMPU_METHOD
/begin COMPU_METHOD _CNV_A_R_LINEAR_____78_CM "" RAT_FUNC "%6.3" "km/h" COEFFS 0 128.0000018750286 0. 0 0 1 /end COMPU_METHOD
/begin COMPU_METHOD _CNV_A_R_LINEAR_____80_CM "" RAT_FUNC "%6.3" "km" COEFFS 0 0.1 0. 0 0 1 /end COMPU_METHOD
/begin COMPU_METHOD _CNV_A_R_LINEAR_____89_CM "" RAT_FUNC "%6.3" "Nms" COEFFS 0 320.1514411333659 0. 0 0 1 /end COMPU_METHOD
/begin COMPU_METHOD _CNV_A_R_LINEAR_____90_CM "" RAT_FUNC "%6.3" "m/s²" COEFFS 0 2084.446564885496 32767.5 0 0 1 /end COMPU_METHOD
/begin COMPU_METHOD _CNV_A_R_LINEAR_____94_CM "" RAT_FUNC "%6.3" "%" COEFFS 0 655.3600000071681 0. 0 0 1 /end COMPU_METHOD
/begin COMPU_METHOD _CNV_A_R_LINEAR_____95_CM "" RAT_FUNC "%6.3" "mg/stk" COEFFS 0 47.18142548596112 0. 0 0 1 /end COMPU_METHOD
/begin COMPU_METHOD _CNV_A_R_LINEAR_____98_CM "" RAT_FUNC "%6.3" "%" COEFFS 0 655.3600000071681 3.584063961170614e-007 0 0 1 /end COMPU_METHOD
/begin COMPU_METHOD _CNV_A_R_LINEAR_____101_CM "" RAT_FUNC "%6.3" "kg/h" COEFFS 0 32. 0. 0 0 1 /end COMPU_METHOD
/begin COMPU_METHOD _CNV_A_R_LINEAR_____170_CM "" RAT_FUNC "%6.3" "-" COEFFS 0 7379.793318491542 0. 0 0 1 /end COMPU_METHOD
/begin COMPU_METHOD _CNV_A_R_LINEAR_____171_CM "" RAT_FUNC "%6.3" "cm²" COEFFS 0 1118.481084425738 0. 0 0 1 /end COMPU_METHOD
/begin COMPU_METHOD _CNV_A_R_LINEAR_____173_CM "" RAT_FUNC "%6.3" "%" COEFFS 0 327.680000003584 3.584063961170614e-007 0 0 1 /end COMPU_METHOD
/begin COMPU_METHOD _CNV_A_R_LINEAR_____176_CM "" RAT_FUNC "%6.3" "%" COEFFS 0 327.680000003584 32768.00000035841 0 0 1 /end COMPU_METHOD
/begin COMPU_METHOD _CNV_A_R_LINEAR_____177_CM "" RAT_FUNC "%6.3" "V" COEFFS 0 204.7999995887937 0. 0 0 1 /end COMPU_METHOD
/begin COMPU_METHOD _CNV_A_R_LINEAR_____178_CM "" RAT_FUNC "%6.3" "Seg" COEFFS 0 1. 0. 0 0 1 /end COMPU_METHOD
/begin COMPU_METHOD _CNV_S_6_RANGE_STAT_179_CM "" TAB_VERB "%6.3" "[-]" COMPU_TAB_REF _CNV_S_6_RANGE_STAT_179 /end COMPU_METHOD
/begin COMPU_VTAB _CNV_S_6_RANGE_STAT_179 "" TAB_VERB 6 0 "ES" 1 "ST" 2 "IS" 3 "PL" 4 "PU" 5 "PUC" /end COMPU_VTAB
/begin COMPU_METHOD _CNV_S_2_RANGE______184_R_CM "" TAB_VERB "%6.3" "-" COMPU_TAB_REF _CNV_S_2_RANGE______184_R /end COMPU_METHOD
/begin COMPU_VTAB_RANGE _CNV_S_2_RANGE______184_R "" 2 0 0 "0" 1 255 "1" /end COMPU_VTAB_RANGE
/begin COMPU_METHOD _CNV_A_R_LINEAR_____195_CM "" RAT_FUNC "%6.3" "[-]" COEFFS 0 64. 0. 0 0 1 /end COMPU_METHOD
/begin COMPU_METHOD _CNV_A_R_LINEAR_____211_CM "" RAT_FUNC "%6.3" "°C" COEFFS 0 16. 0. 0 0 1 /end COMPU_METHOD
/begin COMPU_METHOD _CNV_A_R_LINEAR_____215_CM "" RAT_FUNC "%6.3" "rpm/s" COEFFS 0 3.125e-002 0. 0 0 1 /end COMPU_METHOD
/begin COMPU_METHOD _CNV_A_R_LINEAR_____226_CM "" RAT_FUNC "%6.3" "°TPS" COEFFS 0 137.0962343096234 0. 0 0 1 /end COMPU_METHOD
/begin COMPU_METHOD _CNV_S_9_RANGE_STAT_235_CM "" TAB_VERB "%6.3" "[-]" COMPU_TAB_REF _CNV_S_9_RANGE_STAT_235 /end COMPU_METHOD
/begin COMPU_VTAB _CNV_S_9_RANGE_STAT_235 "" TAB_VERB 9 0 "HOM_AFS" 1 "AFS_TO_AFL" 2 "HOM_AFL" 3 "AFL_TO_AFS" 4 "HOM_TO_S" 5 "BACKS" 6 "S" 7 "S_TO_HOM" 8 "BACKHOM" /end COMPU_VTAB
/begin COMPU_METHOD _CNV_A_R_LINEAR_____240_CM "" RAT_FUNC "%6.3" "-" COEFFS 0 32. 0. 0 0 1 /end COMPU_METHOD
/begin COMPU_METHOD _CNV_A_R_LINEAR_____256_CM "" RAT_FUNC "%6.3" "V" COEFFS 0 13107.19998965744 0. 0 0 1 /end COMPU_METHOD
/begin COMPU_METHOD _CNV_A_R_LINEAR_____264_CM "" RAT_FUNC "%6.3" "°TPS/s" COEFFS 0 8.535564853556485e-002 0. 0 0 1 /end COMPU_METHOD
/begin COMPU_METHOD _CNV_A_R_LINEAR_____277_CM "" RAT_FUNC "%6.3" "g" COEFFS 0 36.00036915004301 0. 0 0 1 /end COMPU_METHOD
/begin COMPU_METHOD _CNV_A_R_LINEAR_____285_CM "" RAT_FUNC "%6.3" "ohm" COEFFS 0 1. 0. 0 0 1 /end COMPU_METHOD
/begin COMPU_METHOD _CNV_A_R_LINEAR_____348_CM "" RAT_FUNC "%6.3" "-" COEFFS 0 8191.999999679995 0. 0 0 1 /end COMPU_METHOD
/begin COMPU_METHOD _CNV_A_R_LINEAR_____354_CM "" RAT_FUNC "%6.3" "mg/stk" COEFFS 0 47.18142548596112 32767.5 0 0 1 /end COMPU_METHOD
/begin COMPU_METHOD _CNV_A_R_LINEAR_____358_CM "" RAT_FUNC "%6.3" "V" COEFFS 0 204.8 0. 0 0 1 /end COMPU_METHOD
/begin COMPU_METHOD _CNV_A_R_LINEAR_____361_CM "" RAT_FUNC "%6.3" "°TPS" COEFFS 0 137.0962343096234 16383. 0 0 1 /end COMPU_METHOD
/begin COMPU_METHOD _CNV_A_R_LINEAR_____362_CM "" RAT_FUNC "%6.3" "%" COEFFS 0 81.91999999679995 32767.99999871998 0 0 1 /end COMPU_METHOD
/begin COMPU_METHOD _CNV_A_R_LINEAR_____363_CM "" RAT_FUNC "%6.3" "%" COEFFS 0 327.68 0. 0 0 1 /end COMPU_METHOD
/begin COMPU_METHOD _CNV_A_R_LINEAR_____364_CM "" RAT_FUNC "%6.3" "%" COEFFS 0 81.91999999679995 -1.280022843275219e-006 0 0 1 /end COMPU_METHOD
/begin COMPU_METHOD _CNV_A_R_LINEAR_____365_CM "" RAT_FUNC "%6.3" "ms" COEFFS 0 0.2 0. 0 0 1 /end COMPU_METHOD
/begin COMPU_METHOD _CNV_A_R_LINEAR_____366_CM "" RAT_FUNC "%6.3" "°TPS" COEFFS 0 137.0962343096234 1.818989403545857e-012 0 0 1 /end COMPU_METHOD
/begin COMPU_METHOD _CNV_A_R_LINEAR_____367_CM "" RAT_FUNC "%6.3" "s" COEFFS 0 200. 0. 0 0 1 /end COMPU_METHOD
/begin COMPU_METHOD _CNV_A_R_LINEAR_____368_CM "" RAT_FUNC "%6.3" "%" COEFFS 0 327.67 0. 0 0 1 /end COMPU_METHOD
/begin COMPU_METHOD _CNV_A_R_LINEAR_____431_CM "" RAT_FUNC "%6.3" "%/10ms" COEFFS 0 655.3600000071681 0. 0 0 1 /end COMPU_METHOD
/begin COMPU_METHOD _CNV_A_R_LINEAR_____440_CM "" RAT_FUNC "%6.3" "°TPS" COEFFS 0 548.4100418410042 0. 0 0 1 /end COMPU_METHOD
/begin COMPU_METHOD _CNV_A_R_LINEAR_____441_CM "" RAT_FUNC "%6.3" "°TPS/5ms" COEFFS 0 137.0962586026216 -6.746863121520619e-007 0 0 1 /end COMPU_METHOD
/begin COMPU_METHOD _CNV_A_R_LINEAR_____442_CM "" RAT_FUNC "%6.3" "°TPS" COEFFS 0 137.0962586026216 -6.746863121520619e-007 0 0 1 /end COMPU_METHOD
/begin COMPU_METHOD _CNV_A_R_LINEAR_____443_CM "" RAT_FUNC "%6.3" "V" COEFFS 0 102.3999997943969 0. 0 0 1 /end COMPU_METHOD
/begin COMPU_METHOD _CNV_S_11_RANGE_TPS__444_CM "" TAB_VERB "%6.3" "[-]" COMPU_TAB_REF _CNV_S_11_RANGE_TPS__444 /end COMPU_METHOD
/begin COMPU_VTAB _CNV_S_11_RANGE_TPS__444 "" TAB_VERB 11 0 "ST_CHK_CHK_LIH_1" 1 "ST_CHK_GO_UPPER_POS" 2 "ST_CHK_CHK_LIH_2" 3 "ST_CHK_END" 4 "AD_CHK_LIH_1" 5 "AD_GO_UPPER_POS" 6 "AD_CHK_LIH_2" 7 "AD_GO_LOWER_STOP" 8 "AD_GO_LIH" 9 "AD_CHK_LIH_3" 10 "AD_END" /end COMPU_VTAB
/begin COMPU_METHOD _CNV_S_5_RANGE_STAT_445_CM "" TAB_VERB "%6.3" "-" COMPU_TAB_REF _CNV_S_5_RANGE_STAT_445 /end COMPU_METHOD
/begin COMPU_VTAB _CNV_S_5_RANGE_STAT_445 "" TAB_VERB 5 0 "TPS_NO_ERROR" 1 "TPS_LIH_1" 2 "TPS_LIH_2" 4 "TPS_LIH_MAX" 8 "TPS_DBL_ERROR" /end COMPU_VTAB
/begin COMPU_METHOD _CNV_S_5_RANGE_STAT_446_CM "" TAB_VERB "%6.3" "-" COMPU_TAB_REF _CNV_S_5_RANGE_STAT_446 /end COMPU_METHOD
/begin COMPU_VTAB _CNV_S_5_RANGE_STAT_446 "" TAB_VERB 5 0 "ETC_NO_LIH" 1 "ETC_LIH_1" 2 "ETC_LIH_2_REV" 4 "ETC_LIH_2" 8 "ETC_LIH_3" /end COMPU_VTAB
/begin COMPU_METHOD _CNV_A_R_LINEAR_____447_CM "" RAT_FUNC "%6.3" "°TPS/10ms" COEFFS 0 137.0962343096234 0. 0 0 1 /end COMPU_METHOD
/begin COMPU_METHOD _CNV_R_R_t10msxs_ub_489_CM "" RAT_FUNC "%6.3" "s" COEFFS 0. 1. 0. 0. 0. 1.e-002 /end COMPU_METHOD
/begin COMPU_METHOD _CNV_S_2_B_TRUE_519_CM "" TAB_VERB "%6.3" "[-]" COMPU_TAB_REF _CNV_S_2_B_TRUE_519 /end COMPU_METHOD
/begin COMPU_VTAB _CNV_S_2_B_TRUE_519 "" TAB_VERB 2 0 "----" 1 "TRUE" /end COMPU_VTAB
/begin COMPU_METHOD _CNV_A_R_spg_ubatt_575_CM "" RAT_FUNC "%6.3" "V" COEFFS 0 10.61571125265393 0. 0 0 1 /end COMPU_METHOD
/begin RECORD_LAYOUT _REC_VAL_20_u1 FNC_VALUES 1 UBYTE COLUMN_DIR DIRECT /end RECORD_LAYOUT
/begin RECORD_LAYOUT _REC_MAP_20_u1_u1_u1 FNC_VALUES 1 UBYTE COLUMN_DIR DIRECT /end RECORD_LAYOUT
/begin RECORD_LAYOUT _REC_AXS_20_u1 NO_AXIS_PTS_X 1 UBYTE AXIS_PTS_X 2 UBYTE INDEX_INCR DIRECT /end RECORD_LAYOUT
/begin RECORD_LAYOUT _REC_CUR_20_u1_u1 FNC_VALUES 1 UBYTE COLUMN_DIR DIRECT /end RECORD_LAYOUT
/begin RECORD_LAYOUT _REC_MAP_20_u2_u2_u1 FNC_VALUES 1 UWORD COLUMN_DIR DIRECT /end RECORD_LAYOUT
/begin RECORD_LAYOUT _REC_AXS_20_u2 NO_AXIS_PTS_X 1 UWORD AXIS_PTS_X 2 UWORD INDEX_INCR DIRECT /end RECORD_LAYOUT
/begin RECORD_LAYOUT _REC_CUR_20_u2_u2 FNC_VALUES 1 UWORD COLUMN_DIR DIRECT /end RECORD_LAYOUT
/begin RECORD_LAYOUT _REC_VAL_20_u2 FNC_VALUES 1 UWORD COLUMN_DIR DIRECT /end RECORD_LAYOUT
/begin RECORD_LAYOUT _REC_CUR_20_u2_u1 FNC_VALUES 1 UWORD COLUMN_DIR DIRECT /end RECORD_LAYOUT
/begin RECORD_LAYOUT _REC_MAP_20_u1_u1_u2 FNC_VALUES 1 UBYTE COLUMN_DIR DIRECT /end RECORD_LAYOUT
/begin RECORD_LAYOUT _REC_CUR_20_u1_u2 FNC_VALUES 1 UBYTE COLUMN_DIR DIRECT /end RECORD_LAYOUT
/begin RECORD_LAYOUT _REC_MAP_20_u2_u1_u2 FNC_VALUES 1 UWORD COLUMN_DIR DIRECT /end RECORD_LAYOUT
/begin RECORD_LAYOUT _REC_VAL_20_s2 FNC_VALUES 1 SWORD COLUMN_DIR DIRECT /end RECORD_LAYOUT
/begin RECORD_LAYOUT _REC_MAP_20_u1_u2_u2 FNC_VALUES 1 UBYTE COLUMN_DIR DIRECT /end RECORD_LAYOUT
/begin RECORD_LAYOUT _REC_VAL_20_s1 FNC_VALUES 1 SBYTE COLUMN_DIR DIRECT /end RECORD_LAYOUT
/begin RECORD_LAYOUT _REC_MAP_20_u2_u2_u2 FNC_VALUES 1 UWORD COLUMN_DIR DIRECT /end RECORD_LAYOUT
/begin FUNCTION DIA_Anti_bounce_algorithm "_Anti-bounce-algorithm"
 /begin DEF_CHARACTERISTIC C_ABC_INC_VLS_UP_STK C_ABC_MAX_VLS_UP_STK C_ABC_INC_VLS_UP_MIN C_ABC_INC_VLS_UP_MIN_COLD C_ABC_MAX_VLS_UP_MIN C_ABC_MAX_VLS_UP_MIN_COLD C_ABC_MAX_LSH_DOWN C_ABC_INC_LSH_DOWN C_ABC_INC_LSH_UP C_ABC_MAX_LSH_UP C_ABC_INC_MAF C_ABC_MAX_MAF C_ABC_INC_MIS_LOW_FUEL C_ABC_MAX_MSW_2 C_ABC_INC_MSW_2 C_ABC_INC_MSW_TOG C_ABC_MAX_MSW_TOG C_ABC_INC_MSW_3 C_ABC_MAX_MSW_3 C_ABC_INC_MTC_DR C_ABC_MAX_MTC_DR C_ABC_MAX_LAM_DLY C_ABC_INC_LAM_DLY C_ABC_INC_LOAD_TPS_PLAUS C_ABC_MAX_LOAD_TPS_PLAUS C_ABC_MAX_TOIL C_ABC_INC_TOIL C_ABC_INC_POIL_SWI C_ABC_MAX_POIL_SWI C_ABC_INC_IV C_ABC_MAX_IV C_ABC_INC_VIM C_ABC_MAX_VIM C_ABC_INC_PVS_RATIO C_ABC_MAX_PVS_RATIO C_ABC_MAX_PVS_H_R_1 C_ABC_MAX_PVS_H_R_2 C_ABC_MAX_PVS_BLS_NOT_PLAUS C_ABC_INC_PVS_BLS_NOT_PLAUS C_ABC_INC_V_REF_1 C_ABC_INC_V_REF_2 C_ABC_MAX_V_REF_1 C_ABC_MAX_V_REF_2 C_ABC_INC_PVS_1 C_ABC_INC_PVS_2 C_ABC_MAX_PVS_1 C_ABC_MAX_PVS_2 C_ABC_INC_RLY_MAIN C_ABC_MAX_RLY_MAIN C_ABC_INC_SOF_REQ C_ABC_MAX_SOF_REQ C_ABC_INC_SOF C_ABC_MAX_SOF C_ABC_INC_TCO_GRD_DIAG C_ABC_MAX_TCO_GRD_DIAG C_ABC_MAX_TCO_EL C_ABC_INC_TCO_EL C_ABC_INC_TCO_EX C_ABC_MAX_TCO_EX C_ABC_INC_TQ_GS_INC_PLAUS C_ABC_MAX_TQ_GS_INC_PLAUS C_ABC_MAX_TECU C_ABC_INC_TECU C_ABC_INC_TEG_PCAT_DOWN C_ABC_MAX_TEG_PCAT_DOWN C_ABC_INC_TIA C_ABC_MAX_TIA C_ABC_INC_TPS_AD_BOL C_ABC_MAX_TPS_AD_BOL C_ABC_INC_TPS_1 C_ABC_INC_TPS_2 C_ABC_MAX_TPS_2 C_ABC_MAX_TPS_1 C_ABC_INC_TQI_LIM C_ABC_MAX_TQI_LIM C_ABC_INC_SEG_T_AD C_ABC_INC_SEG_T C_ABC_MAX_SEG_T_AD C_ABC_MAX_SEG_T C_ABC_INC_GEN C_ABC_INC_GEN_IF C_ABC_MAX_GEN C_ABC_MAX_GEN_IF C_ABC_INC_TOIL_LEVEL C_ABC_MAX_TOIL_LEVEL C_ABC_MAX_RLY_EFP C_ABC_INC_RLY_EFP C_ABC_INC_SAV C_ABC_MAX_SAV C_ABC_INC_SAP C_ABC_INC_RLY_ACCOUT C_ABC_MAX_RLY_ACCOUT C_ABC_INC_ECT_EL C_ABC_MAX_ECT_EL C_ABC_INC_ECF C_ABC_INC_EF C_ABC_MAX_ECF C_ABC_MAX_EF C_ABC_INC_EBOX_CFA C_ABC_MAX_EBOX_CFA C_ABC_MAX_SAP C_ABC_MAX_CPS C_ABC_INC_RLY_ST C_ABC_MAX_RLY_ST C_ABC_MAX_DMTL_PUMP C_ABC_INC_ECRAS C_ABC_INC_DMTLH C_ABC_MAX_ECRAS C_ABC_MAX_DMTLH C_ABC_INC_CPS C_ABC_INC_TOUT_NOX_SENS C_ABC_MAX_TOUT_NOX_SENS C_ABC_INC_NOX_SENS C_ABC_MAX_NOX_SENS C_ABC_MAX_VLS_DOWN_PUC C_ABC_MAX_VLS_DOWN_FL C_ABC_INC_VLS_DOWN_PUC C_ABC_INC_VLS_DOWN_FL C_ABC_MAX_DMTLS C_ABC_INC_DMTLS C_ABC_INC_ISA_2 C_ABC_MAX_ISA_1 C_ABC_MAX_ISA_2 C_ABC_INC_ISA_1 C_ABC_INC_CONV_MON C_ABC_INC_MAF_MON C_ABC_INC_N_32_MON C_ABC_INC_PVS_RATIO_MON C_ABC_INC_TPS_RATIO_MON C_ABC_MAX_CONV_MON C_ABC_MAX_MAF_MON C_ABC_MAX_N_32_MON C_ABC_MAX_PVS_RATIO_MON C_ABC_MAX_TPS_RATIO_MON C_ABC_MAX_TQI_N_MAX_MON C_ABC_INC_TQI_N_MAX_MON C_ABC_INC_TQ_DIF_P_D_IS_MON C_ABC_INC_TQ_DIF_I_IS_MON C_ABC_MAX_TQ_DIF_P_D_IS_MON C_ABC_MAX_TQ_DIF_I_IS_MON C_ABC_INC_TQI_AV_MON C_ABC_INC_TQ_LOSS_MON C_ABC_MAX_TQI_AV_MON C_ABC_MAX_TQ_LOSS_MON C_ABC_INC_TQ_MIN_CLU_MON C_ABC_MAX_TQ_MIN_CLU_MON C_ABC_INC_MSR_INH_MON C_ABC_MAX_MSR_INH_MON C_ABC_INC_CRU_INH_MON C_ABC_MAX_CRU_INH_MON C_ABC_INC_TQ_MAX_CLU_MON C_ABC_MAX_TQ_MAX_CLU_MON C_ABC_MAX_TQI_N_MAX_MON2 C_ABC_MAX_TQI_AV_MON2 C_ABC_INC_TQI_N_MAX_MON2 C_ABC_INC_TQI_AV_MON2 /end DEF_CHARACTERISTIC
/end FUNCTION
/begin FUNCTION DIA_Torque_Request_for_Safety_Di "_Torque Request for Safety Diagnosis" /begin OUT_MEASUREMENT LV_ERR_TQI_LIM /end OUT_MEASUREMENT /end FUNCTION
/begin FUNCTION DIA_E_box_cooling_fan_diagnosis "_E-box cooling fan diagnosis" /begin OUT_MEASUREMENT LV_ERR_EBOX_CFA /end OUT_MEASUREMENT /end FUNCTION
/begin FUNCTION DIA_ECU_temperature_sensor_diagn "_ECU temperature sensor diagnosis" /begin DEF_CHARACTERISTIC C_TIA_MAX_TECU_DIAG C_V_TECU_MIN_DIAG C_V_TECU_MAX_DIAG /end DEF_CHARACTERISTIC /begin OUT_MEASUREMENT LV_ERR_TECU /end OUT_MEASUREMENT /end FUNCTION
/begin FUNCTION DIA_Upstream_oxygen_sensor_signa "_Upstream oxygen sensor signal monitoring"
 /begin DEF_CHARACTERISTIC C_R_UP_LS_MAX_VLS_UP_MIN C_T_DLY_LAM_LIM_VLS_UP_MIN C_VLS_UP_MAX_DIAG C_VLS_UP_AFL_DIAG C_VLS_UP_AFR_DIAG C_T_VLS_CYC_MAX_STK C_VLS_UP_MIN_DIAG C_R_UP_LS_MIN_VLS_UP_OC C_VLS_DIF_BOL_TOL_MIN C_LAM_P_CTR_DIAG C_MAF_KGH_MIN_VLS_UP_MIN C_MAF_INT_MIN_VLS_UP_DIAG C_MAF_INT_MAX_VLS_UP_DIAG C_VLS_UP_MIN_PUC C_T_ES_DEW_VLS_UP_MIN_COLD C_T_DLY_VLS_UP_MIN C_CTR_DLY_VLS_UP_OC C_TEG_CAT_UP_MDL_VLS_UP_MIN C_MAF_INT_CPS_CLOSE_VLS_UP_MIN C_VLS_DOWN_MAX_VLS_UP_MIN_DIAG C_T_DIAG_VLS_UP_MIN_COLD C_T_DLY_VLS_UP_MIN_COLD /end DEF_CHARACTERISTIC
 /begin OUT_MEASUREMENT LV_ERR_VLS_UP_PUC_2 LV_ERR_VLS_UP_PUC_1 CTR_CYCNR_R_VLS_UP_MIN_1 CTR_CYCNR_R_VLS_UP_OC_1 LAM_P_CTR_SUM_1 T_DLY_VLS_UP_MIN_COLD_1 T_DIAG_VLS_UP_MIN_COLD_1 T_DLY_VLS_UP_MIN_1 T_DLY_LAM_MIN_VLS_UP_MIN_1 MAF_INT_CPS_CLOSE_VLS_UP_MIN_1 CTR_DLY_VLS_UP_OC_1 LV_TI_LAM_MAX_VLS_UP_MIN_1 LV_R_VLS_UP_MIN_VLD_1 LV_REQ_DIAG_VLS_UP_MIN_1 CTR_CYCNR_R_VLS_UP_MIN_2 CTR_CYCNR_R_VLS_UP_OC_2 LAM_P_CTR_SUM_2 T_DLY_VLS_UP_MIN_COLD_2 T_DIAG_VLS_UP_MIN_COLD_2 T_DLY_VLS_UP_MIN_2 T_DLY_LAM_MIN_VLS_UP_MIN_2 MAF_INT_CPS_CLOSE_VLS_UP_MIN_2 CTR_DLY_VLS_UP_OC_2 LV_TI_LAM_MAX_VLS_UP_MIN_2 LV_R_VLS_UP_MIN_VLD_2 LV_REQ_DIAG_VLS_UP_MIN_2 LV_ERR_VLS_UP_2 LV_ERR_VLS_UP_1 LV_ERR_VLS_UP_MIN_2 LV_ERR_VLS_UP_MAX_1 LV_ERR_VLS_UP_MAX_2 LV_ERR_VLS_UP_OC_1 LV_ERR_VLS_UP_OC_2 LV_ERR_VLS_UP_MIN_1 LV_ERR_VLS_UP_MIN_COLD_1 LV_ERR_VLS_UP_MIN_COLD_2 T_MIN_LS LV_ERR_VLS_UP_STK_2 LV_ERR_VLS_UP_STK_1 /end OUT_MEASUREMENT
/end FUNCTION
/begin FUNCTION DIA_Application_incidences_for_u "_Application incidences for upstream oxygen sensor signal monitoring"
 /begin OUT_MEASUREMENT LV_INH_DIAG_VLS_UP_MIN_1 LV_INH_DIAG_VLS_UP_MAX_1 LV_INH_DIAG_VLS_UP_OC_1 LV_INH_DIAG_VLS_UP_PUC_1 LV_INH_DIAG_VLS_UP_STK_1 LV_INH_DIAG_VLS_UP_MIN_COLD_1 LV_INH_DIAG_VLS_UP_MIN_2 LV_INH_DIAG_VLS_UP_MAX_2 LV_INH_DIAG_VLS_UP_OC_2 LV_INH_DIAG_VLS_UP_PUC_2 LV_INH_DIAG_VLS_UP_STK_2 LV_INH_DIAG_VLS_UP_MIN_COLD_2 /end OUT_MEASUREMENT
/end FUNCTION
/begin FUNCTION DIA_Application_incidences_for_d "_Application incidences for downstream oxygen sensor probe diagnosis"
 /begin OUT_MEASUREMENT LV_INH_DIAG_VLS_DOWN_MIN_1 LV_INH_DIAG_VLS_DOWN_MAX_1 LV_INH_DIAG_VLS_DOWN_OC_1 LV_INH_DIAG_VLS_DOWN_PUC_1 LV_INH_DIAG_VLS_DOWN_MIN_COLD_1 LV_INH_DIAG_VLS_DOWN_FL_1 LV_INH_DIAG_VLS_DOWN_MIN_2 LV_INH_DIAG_VLS_DOWN_MAX_2 LV_INH_DIAG_VLS_DOWN_OC_2 LV_INH_DIAG_VLS_DOWN_PUC_2 LV_INH_DIAG_VLS_DOWN_MIN_COLD_2 LV_INH_DIAG_VLS_DOWN_FL_2 /end OUT_MEASUREMENT
/end FUNCTION
/begin FUNCTION DIA_Downstream_oxygen_sensor_sig "_Downstream oxygen sensor signal monitoring"
 /begin DEF_CHARACTERISTIC C_R_DOWN_LS_MAX_VLS_DOWN_MIN C_CTR_MIN_VLS_DOWN_MIN C_MAF_KGH_MIN_VLS_DOWN_MIN C_VLS_DOWN_MIN_DIAG C_VLS_DOWN_MAX_DIAG C_VLS_DOWN_AFL_DIAG C_VLS_DOWN_AFR_DIAG C_R_DOWN_MIN_VLS_DOWN_OC C_T_DLY_VLS_DOWN_MIN C_T_ES_DEW_VLS_DOWN_MIN_COLD C_T_DIAG_VLS_DOWN_MIN_COLD C_T_DLY_VLS_DOWN_MIN_COLD C_T_DLY_VLS_DOWN_OC C_T_CDN_VLS_DOWN_OC C_TEG_CAT_DOWN_MDL_VLS_DOWN_OC /end DEF_CHARACTERISTIC
 /begin OUT_MEASUREMENT CTR_CYCNR_R_VLS_DOWN_MIN_1 CTR_CYCNR_R_VLS_DOWN_OC_1 T_DLY_VLS_DOWN_MIN_COLD_1 T_DIAG_VLS_DOWN_MIN_COLD_1 T_DLY_VLS_DOWN_MIN_1 CTR_MIN_VLS_DOWN_MIN_1 T_DLY_VLS_DOWN_OC_1 T_CDN_VLS_DOWN_OC_1 LV_REQ_CHK_LS_DOWN_1 LV_VLS_DOWN_CDN_VLS_DIAG_OC_1 LV_R_VLS_DOWN_OC_VLD_1 CTR_CYCNR_R_VLS_DOWN_MIN_2 CTR_CYCNR_R_VLS_DOWN_OC_2 T_DLY_VLS_DOWN_MIN_COLD_2 T_DIAG_VLS_DOWN_MIN_COLD_2 T_DLY_VLS_DOWN_MIN_2 CTR_MIN_VLS_DOWN_MIN_2 T_DLY_VLS_DOWN_OC_2 T_CDN_VLS_DOWN_OC_2 LV_REQ_CHK_LS_DOWN_2 LV_VLS_DOWN_CDN_VLS_DIAG_OC_2 LV_R_VLS_DOWN_OC_VLD_2 LV_ERR_VLS_DOWN_1 LV_ERR_VLS_DOWN_2 LV_ERR_VLS_DOWN_MIN_2 LV_ERR_VLS_DOWN_MAX_2 LV_ERR_VLS_DOWN_MAX_1 LV_ERR_VLS_DOWN_OC_1 LV_ERR_VLS_DOWN_OC_2 LV_ERR_VLS_DOWN_MIN_1 LV_ERR_VLS_DOWN_MIN_COLD_1 LV_ERR_VLS_DOWN_MIN_COLD_2 /end OUT_MEASUREMENT
/end FUNCTION
/begin FUNCTION DIA_Tank_leakage_detection_diagn "_Tank leakage detection diagnosis" /begin DEF_CHARACTERISTIC C_T_V_DMTL_MAX_DIAG C_V_DMTL_MAX_DIAG /end DEF_CHARACTERISTIC /begin OUT_MEASUREMENT T_V_DMTL_MAX_DIAG LV_ERR_DMTLS LV_ERR_DMTL_PUMP /end OUT_MEASUREMENT /end FUNCTION
/begin FUNCTION DIA_SOF_diagnosis "_SOF diagnosis" /begin DEF_CHARACTERISTIC LC_SOF_CONF C_V_SOF_SWI_MIN C_V_SOF_SWI_MAX /end DEF_CHARACTERISTIC /begin OUT_MEASUREMENT LV_ERR_SOF_REQ LV_ERR_SOF /end OUT_MEASUREMENT /end FUNCTION
/begin FUNCTION DIA_Oil_pressure_switch_diagnosi "_Oil pressure switch diagnosis"
 /begin DEF_CHARACTERISTIC C_T_POIL_SWI_PWL C_TOIL_POIL_SWI_MAX_DIAG C_TOIL_POIL_SWI_MIN_DIAG /end DEF_CHARACTERISTIC
 /begin OUT_MEASUREMENT LV_ERR_POIL_SWI T_POIL_SWI_PWL /end OUT_MEASUREMENT
/end FUNCTION
/begin FUNCTION DIA_Starter_Output_Diagnosis "_Starter Output Diagnosis" /begin OUT_MEASUREMENT LV_ERR_RLY_ST /end OUT_MEASUREMENT /end FUNCTION
/begin FUNCTION DIA_BSD_Diagnosis "_BSD Diagnosis" /begin OUT_MEASUREMENT LV_ERR_BSD /end OUT_MEASUREMENT /end FUNCTION
/begin FUNCTION DIA_Diagnosis_Oil_temperature_an "_Diagnosis Oil temperature and level sensor  (DTOENS)" /begin DEF_CHARACTERISTIC TOGMAXUNPL TOG_CNTMAX DTOG_UBMIN /end DEF_CHARACTERISTIC /begin OUT_MEASUREMENT LV_ERR_TOIL_LEVEL B_TOGERR B_TOGUPL /end OUT_MEASUREMENT /end FUNCTION
/begin FUNCTION DIA_CAN_diagnosis_for_EFP_contro "_CAN diagnosis for EFP control" /begin DEF_CHARACTERISTIC C_EFP_CYCNR_MAX /end DEF_CHARACTERISTIC
 /begin OUT_MEASUREMENT CYC_CTR_EFP_DIAG LV_ERR_TOUT_EFP LV_ERR_CRASH_EFP LV_ERR_N_EFP_LOW LV_ERR_N_EFP_HIGH LV_ERR_EFP_TEMP LV_ERR_EFP_LIH /end OUT_MEASUREMENT
/end FUNCTION
/begin FUNCTION DIA_TPS___ETC_Limp_Home_Manager "_TPS / ETC Limp-Home Manager"
 /begin OUT_MEASUREMENT LV_TPS_MTC_N_LIM LV_MTC_LIH_CUR_OFF LV_ERR_TPS LV_N_LIM_ETC_LIH LV_N_LIM_ETC_LIH_REV STATE_TPS_DIAG STATE_ETC_LIH LV_MTC_CUR_OFF_REQ /end OUT_MEASUREMENT
/end FUNCTION
/begin FUNCTION DIA_ETC_Actuator_diagnosis_and_A "_ETC Actuator diagnosis and Adaptation"
 /begin DEF_CHARACTERISTIC C_MTCPWM_PI_MAX_DIAG C_TPS_DIF_MAX_DIAG C_T_TPS_DIF_DIAG C_T_MTCPWM_PI_DIAG_CUR_OFF C_T_MTCPWM_PI_DIAG C_N_MAX_TPS_AD C_T_MAX_TPS_AD C_T_MAX_TPS_LIH_CHK C_T_MAX_TPS_SP_RST_CHK C_T_TPS_AD_HYS C_TCO_MAX_TPS_AD C_TCO_MIN_TPS_AD C_TIA_MIN_TPS_AD C_TPS_SP_BOL_LGRD C_TPS_SP_RST_CHK_BAS C_TPS_SP_RST_CHK_HYS C_TPS_SP_RST_CHK_LGRD C_V_TPS_AD_HYS C_V_TPS_AD_WIN_LIH C_V_TPS_SP_BOL_1 C_V_TPS_SP_BOL_2 C_VB_MIN_TPS_AD C_TPS_SP_SPR_CHK_UP C_TPS_SP_RST_CHK C_TPS_AV_RST_CHK C_T_TPS_AV_RST_CHK C_V_TPS_AD_WIN_BOL C_V_TPS_AD_WIN_2_BOL C_T_DYW_TPS_LIH_CHK C_V_TPS_AD_BOL_INI_1 C_V_TPS_AD_BOL_INI_2 C_V_TPS_LIH_CHK_HYS C_V_TPS_SP_LIH_1 C_V_TPS_SP_LIH_2 C_TPS_AD_SLOP_GAIN_INI_1 C_V_TPS_AD_OFS_GAIN_INI_1 /end DEF_CHARACTERISTIC
 /begin OUT_MEASUREMENT V_TPS_GAIN_1 LV_ERR_TPS_ST_CHK_1 LV_N_LIM_TPS_AD LV_TPS_AD_CUR_OFF LV_TPS_AD_DIAG_CUR_OFF TPS_SP_AD V_TPS_AD_EL_BOL_1 V_TPS_AD_EL_BOL_2 V_TPS_AD_LIH_1 V_TPS_AD_LIH_2 LV_TPS_AD_ACT TPS_AD_SLOP_GAIN_1 TPS_LIH_1 TPS_LIH_2 LV_TPS_AD_REQ TPS_LIH_INI V_TPS_AD_BOL_GAIN_1 V_TPS_AD_TOL_1 V_TPS_AD_TOL_GAIN_1 INH_IV_TPS_AD V_TPS_AD_OFS_GAIN_1 LV_TPS_AD_MEC_BOL TPS_AD_STEP CTR_ST_CHK_CHK_LIH_1_READY CTR_ST_CHK_CHK_LIH_1_ERR LV_ERR_TPS_ST_CHK_2 LV_ERR_TPS_AD LV_ERR_TPS_AD_BOL LV_ERR_MTC_CTL_2 LV_ERR_MTC_CTL_3 LV_ERR_MTC_CTL_1 /end OUT_MEASUREMENT
/end FUNCTION
/begin FUNCTION DIA_Electric_solenoid_valve_diag "_Electric solenoid valve diagnosis" /begin DEF_CHARACTERISTIC IP_IVVTPWM_MIN_DIAG__VB C_IVVTPWM_MAX_DIAG /end DEF_CHARACTERISTIC
 /begin OUT_MEASUREMENT LV_ERR_SLV_IVVT_IN_2 LV_ERR_SLV_IVVT_IN_1 LV_ERR_SLV_IVVT_EX_1 LV_ERR_SLV_IVVT_EX_2 /end OUT_MEASUREMENT
/end FUNCTION
/begin FUNCTION DIA_Distance_cruise_control_diag "_Distance cruise control diagnosis" /begin DEF_CHARACTERISTIC C_T_MAX_BRAKE_DET_DCC /end DEF_CHARACTERISTIC
 /begin OUT_MEASUREMENT LV_DCC_OFF_ECU T_DCC_BRAKE_DET LV_ERR_DCC_REV LV_ERR_DCC_IRREV /end OUT_MEASUREMENT
/end FUNCTION
/begin FUNCTION DIA_GS_intervention_plausibility "_GS intervention plausibility Diagnosis"
 /begin DEF_CHARACTERISTIC C_INT_TQ_GS_INC_REST C_VS_MIN_TQ_GS_INC C_T_DLY_MIN_VS_TQ_GS_INC C_CRLC_TQ_GS_INC_PLAUS C_INT_MAX_TQ_GS_INC C_INT_MIN_TQ_GS_INC C_T_DLY_MIN_AC_TQ_GS_INC C_T_DIF_MIN_TQ_GS_INC IP_AC_MAX_TQ_GS_INC IP_TQ_MAX_TQ_GS_INC C_T_MAX_TQ_GS_INC C_T_DLY_TQ_MAX_TQ_GS_INC /end DEF_CHARACTERISTIC
 /begin OUT_MEASUREMENT INT_TQ_GS_INC LV_AC_MAX_TQ_GS_INC LV_T_MIN_TQ_GS_INC_DEAC CTR_T_DIF_MIN_TQ_GS_INC STATE_GS_PLAUS LV_VS_MIN_TQ_GS_INC CTR_T_VS_TQ_GS_INC LV_INT_MAX_TQ_GS_INC CTR_T_AC_TQ_GS_INC LV_T_MAX_TQ_GS_INC CTR_T_MAX_TQ_GS_INC LV_TQ_MAX_TQ_GS_INC CTR_T_TQ_MAX_TQ_GS_INC LV_ERR_TQ_GS_INC_PLAUS /end OUT_MEASUREMENT
/end FUNCTION
/begin FUNCTION DIA_AMT_intervention_plausibilit "_AMT intervention plausibility"
 /begin DEF_CHARACTERISTIC C_VS_FIL_AMT C_T_MAX_STATE_AMT_1_DIAG C_T_MAX_STATE_AMT_2_DIAG C_T_MAX_TQI_AMT_DIAG C_TQI_AMT_DIAG C_TQI_AMT_COND_DIAG C_TQI_AMT_CAN_ES C_T_MAX_STATE_AMT_3_DIAG C_T_MAX_STATE_CLU_AMT_DIAG /end DEF_CHARACTERISTIC
 /begin OUT_MEASUREMENT STATE_ERR_AMT_CAN LV_AMT_ES_REQ T_STATE_AMT_1_DIAG T_STATE_AMT_2_DIAG T_STATE_AMT_3_DIAG STATE_ERR_AMT STATE_AMT_OLD T_STATE_CLU_AMT_DIAG TQI_AMT_PLAUS /end OUT_MEASUREMENT
/end FUNCTION
/begin FUNCTION DIA_Electronically_controlled_ra "_Electronically controlled radiator shutter diagnosis" /begin OUT_MEASUREMENT LV_ERR_ECRAS /end OUT_MEASUREMENT /end FUNCTION
/begin FUNCTION DIA_DMTL_heater_diagnosis "_DMTL heater diagnosis" /begin OUT_MEASUREMENT LV_ERR_DMTLH /end OUT_MEASUREMENT /end FUNCTION
/begin FUNCTION DIA_Application_incidences_NOx_S "_Application incidences NOx-Sensor Diagnosis - OBD I" /end FUNCTION
/begin FUNCTION DIA_NOx_Sensor_Diagnosis___OBD_I "_NOx-Sensor Diagnosis - OBD I" /end FUNCTION
/begin FUNCTION DIA_CAN_diagnosis_for_NOX_contro "_CAN diagnosis for NOX control" /begin DEF_CHARACTERISTIC C_NOX_SENS_CYCNR_MAX /end DEF_CHARACTERISTIC /begin OUT_MEASUREMENT LV_ERR_LOCAN_BOFF /end OUT_MEASUREMENT /end FUNCTION
/begin FUNCTION EOS_Engine_Operating_States "EOS"
 /begin SUB_FUNCTION EOS_General_engine_operating_sta EOS_Basic_operating_states__LV_S EOS_Basic_functions__FL__INF___R EOS_Auxiliary_start_functions EOS_Combustion_Management EOS_Catalyst_heating_functions EOS_Combustion_Mode_Switch EOS_Combustion_switch_request_to /end SUB_FUNCTION
/end FUNCTION
/begin FUNCTION EOS_General_engine_operating_sta "_General engine operating states" /begin DEF_CHARACTERISTIC IP_N_MAX_TOL_ST C_T_MAX_ECU /end DEF_CHARACTERISTIC /begin OUT_MEASUREMENT LV_MU_INH_PWL_TRAN_ES_EL /end OUT_MEASUREMENT /end FUNCTION
/begin FUNCTION EOS_Basic_operating_states__LV_S "_Basic operating states: LV_ST, LV_IS, LV_REQ_ISC, LV_PL, LV_PU & LV_PUC"
 /begin DEF_CHARACTERISTIC IP_CYC_CAST__TCO C_N_DIF_MAX_IS C_N_MAX_BOL_ST C_T_MIN_PU C_T_MAX_PU LC_INH_DT_PU C_T_MIN_PU_MSR C_T_MIN_PU_RNG_L ID_N_HYS_MAX_PUC__GR_AT ID_N_HYS_MAX_PUC__GR_MT ID_N_HYS_MIN_PUC__GR_AT ID_N_HYS_MIN_PUC__GR_MT ID_N_HYS_PUC_ST__GR_AT ID_N_HYS_PUC_ST__GR_MT C_CYCNR_HYS_PUC C_CYCNR_HYS_PUC_ST C_TCO_MIN_PUC_ST IP_N_MIN_PUC__TCO__GR_MT IP_N_ACCOUT_MIN_PUC__TCO__GR_MT IP_N_MIN_PUC__TCO__GR_AT IP_N_ACCOUT_MIN_PUC__TCO__GR_AT /end DEF_CHARACTERISTIC
 /begin OUT_MEASUREMENT LV_ES LV_ST LV_ST_END LV_IS LV_PL LV_PU T_PU LV_PUC LV_PUC_REQ STATE_ENG /end OUT_MEASUREMENT
/end FUNCTION
/begin FUNCTION EOS_Basic_functions__FL__INF___R "_Basic functions: FL, INF & REACX"
 /begin DEF_CHARACTERISTIC C_N_MAX_FL_DLY C_N_MIN_FL_DLY C_T_MAX_FL_DLY C_T_TI_DLY_FL_2 C_T_TI_DLY_FL_AT_1 C_T_TI_DLY_FL_AT_2 C_TCO_MIN_FL C_VS_MIN_FL C_N_MIN_FL C_T_MIN_FL_DLY C_T_TI_DLY_FL_1 C_N_MIN_CP_FL C_CL_MMV_THD_FL IP_PV_MAX_FL__N C_N_GRD_MIN C_N_MAX_INF ID_TPS_GRD_BOL_AE__N__TPS_AV /end DEF_CHARACTERISTIC
 /begin OUT_MEASUREMENT LV_FL_RAW LV_TI_RIS LV_TI_RPU LV_TI_RPL LV_TI_RAE LV_FL LV_INF LV_TI_REAC /end OUT_MEASUREMENT
/end FUNCTION
/begin FUNCTION EOS_Auxiliary_start_functions "_Auxiliary start functions"
 /begin DEF_CHARACTERISTIC C_T_MAX_REST C_TCO_DIF_MAX_REST C_T_MIN_ECU_REST C_CYC_CAST_MIN_ST_ES C_CYC_CAST_MAX_ST_ES /end DEF_CHARACTERISTIC
 /begin OUT_MEASUREMENT T_AST LV_REST CYC_CAST T_ST_ES LV_ST_ES LV_STALL T_AST_REST LV_AST TCO_REST /end OUT_MEASUREMENT
/end FUNCTION
/begin FUNCTION EOS_Combustion_Management "_Combustion_Management" /begin DEF_CHARACTERISTIC C_CQ_S_MIN C_CQ_HOM_MIN /end DEF_CHARACTERISTIC /begin OUT_MEASUREMENT STATE_CMB_CTL /end OUT_MEASUREMENT /end FUNCTION
/begin FUNCTION EOS_Catalyst_heating_functions "_Catalyst heating functions"
 /begin DEF_CHARACTERISTIC IP_T_CH_TQ_ADD IP_T_CH_TQ_ADD_IS IP_T_CH_N_SP_IS ID_T_CH_TI C_VS_MAX_CH_IVVT IP_T_CH_IVVT C_VS_MAX_CH_TQ_ADD_IS C_VS_MAX_CH_N_SP_IS /end DEF_CHARACTERISTIC
 /begin OUT_MEASUREMENT LV_TI_CH LV_CH LV_CH_TQ_ADD LV_CH_TQ_ADD_IS LV_CH_N_SP_IS LV_CH_IVVT LV_WUP LV_AFL_CH /end OUT_MEASUREMENT
/end FUNCTION
/begin FUNCTION EOS_Combustion_Mode_Switch "_Combustion Mode Switch" /end FUNCTION
/begin FUNCTION EOS_Combustion_switch_request_to "_Combustion switch request to homogeneous stoichiometric for torque plausibility check" /end FUNCTION
/begin FUNCTION ETC_Electronic_Throttle_Control "ETC"
 /begin SUB_FUNCTION ETC_Calculation_of_the_driver_de ETC_Throttle_position_setpoint_c ETC_Position_controller ETC_MAF_setpoint_for_stratified_ ETC_MAF_coordinaton_homogeneous_ ETC_Throttle_position_setpoint_s ETC_Application_incidences_throt ETC_Throttle_setpoint_calculatio ETC_Idle_speed_actuator_opening_ /end SUB_FUNCTION
/end FUNCTION
/begin FUNCTION ETC_Calculation_of_the_driver_de "_Calculation of the driver demand" /begin DEF_CHARACTERISTIC C_PV_COR_IS C_PV_COR_IS_HYS /end DEF_CHARACTERISTIC /end FUNCTION
/begin FUNCTION ETC_Throttle_position_setpoint_c "_Throttle position setpoint calculation"
 /begin DEF_CHARACTERISTIC IP_AMP_DEC__MAF_KGH_SP IP_TPS_SP_MDL_MAX__N_32__MAF_SP LC_AR_RED_FIL_ENA LC_TPS_FIL_ENA IP_CRLC_AR_RED_SP IP_TPS_SP_MDL_BAS LC_INH_ISAPWM_MAN_AS C_CYCNR_ISA_OFF C_ISAPWM_OFF_HIGH C_ISAPWM_OFF_LOW C_T_ISAPWM_OFF C_LGRD_ISAPWM_OFF C_ISAPWM_MIN_DIAG C_ISAPWM_MAX_DIAG IP_CRLC_AR_RED_ISA_SP LC_AR_RED_ISA_FIL_ENA IP_ISAPWM_ISA C_ISAPWM_MAN_AS C_ISAPWM_OFS_AS C_CRLC_ISAPWM_MMV C_ISAPWM_ISA_DIAG C_PQ_SP_MAX_ISA IP_FAC_ISAPWM_VB IP_ISAPWM_ISA_PWL C_TPS_MAX_DIAG C_PQ_SP_MAX C_PQ_SP_MAX_HYS /end DEF_CHARACTERISTIC
 /begin OUT_MEASUREMENT MAP_SP PQ_SP MAF_SP_RATIO AMP_MDL_IVS PRS_UP_THR_IVS AR_RED_SP_MMV_1 AR_RED_SP_MMV TPS_SP_MDL_BAS TPS_SP_MDL TPS_SP_MDL_MAX TPS_SP_MDL_BAS_COR MAF_KGH_SP MAF_KGH_SP_ISA_CLC PQ_SP_ISA MAF_KGH_SP_THR MAF_KGH_SP_ISA_RAW PSI_SP PSI_SP_ISA AR_RED_ISA_SP_MMV AR_RED_ISA_SP_MMV_1 ISAPWM_ISA_1 ISAPWM_ISA_2 ISAPWM_MMV ISAPWM_ISA FAC_ISAPWM_VB MAF_TURB_RATIO AR_RED_ISA_SP_1 MAF_KGH_SP_ISA_MIN MAF_KGH_SP_THR_MIN AR_RED_ISA_MIN AR_RED_MIN MAF_KGH_SP_ISA MAF_KGH_SP_ISA_1 AR_RED_SP_1 LV_H_LOAD_TPS_SP /end OUT_MEASUREMENT
/end FUNCTION
/begin FUNCTION ETC_Position_controller "_Position controller"
 /begin DEF_CHARACTERISTIC C_MTCPWM_I_MAX_POS IP_MTCPWM_D__TPS_DIF_GRD IP_MTCPWM_I__TPS_DIF IP_MTCPWM_P__TPS_DIF IP_MTCPWM_VB_FAC__VB C_TPS_SP_LIH_DIF_HYS C_MTCPWM_I_MAX_NEG C_MTCPWM_I_ADD C_MTCPWM_ADD_FIL IP_MTCPWM_I_FAC__TPS_AV_LIH_DIF IP_MTCPWM_ADD__TPS_SP_LIH_DIF C_T_MTCPWM_CLOSE_ACT_MAX C_MTCPWM_CLOSE_MAX C_TPS_SP_STOP_HYS C_TPS_SP_STOP_MAX C_MTCPWM_I_INI C_TPS_SP_CTL_MAX C_MTCPWM_CLOSE C_MTCPWM_HYS /end DEF_CHARACTERISTIC
 /begin OUT_MEASUREMENT TPS_DIF MTCPWM_ADD MTCPWM_CTL MTCPWM_D MTCPWM_P MTCPWM_I MTCPWM_I_ADD TPS_SP_LIH_DIF MTCPWM_VB_FAC TPS_DIF_GRD T_MTCPWM_CLOSE_ACT TPS_SP_CTL LV_TPS_SP_POS LV_TPS_CHG_POS MTCPWM LV_MTCPWM_CLOSE_ACT TPS_AV_LIH_DIF LV_INH_MTC_CTL /end OUT_MEASUREMENT
/end FUNCTION
/begin FUNCTION ETC_MAF_setpoint_for_stratified_ "_MAF setpoint for stratified mode" /begin DEF_CHARACTERISTIC IP_PQ_EGR_SP IP_FAC_MAF_MAX_S IP_EFF_MAF_S LC_MAF_SP_EGR /end DEF_CHARACTERISTIC /begin OUT_MEASUREMENT MAF_SP_S FAC_MAF_MAX_S MAF_DIF_S /end OUT_MEASUREMENT /end FUNCTION
/begin FUNCTION ETC_MAF_coordinaton_homogeneous_ "_MAF coordinaton homogeneous - stratified" /begin DEF_CHARACTERISTIC LC_ISA_ENA IP_MAF_SP_ISA /end DEF_CHARACTERISTIC /begin OUT_MEASUREMENT MAF_SP MAF_SP_ISA LV_ISA_ENA MAF_TURB_RATIO_MAX /end OUT_MEASUREMENT /end FUNCTION
/begin FUNCTION ETC_Throttle_position_setpoint_s "_Throttle position setpoint selection"
 /begin DEF_CHARACTERISTIC C_TPS_AV_BOL C_TPS_AV_TOL C_TPS_SP_MIN C_TPS_SP_MIN_TPS_AD_REQ C_TPS_SP_MAX_TPS_AD_REQ C_TPS_SP_MAX C_TPS_SP_TOL C_TPS_SP_TOL_TPS_AD_REQ C_TPS_SP_BOL_TPS_AD_REQ C_TPS_SP_BOL C_TPS_SP_LGRD_TOT IP_TPS_SP_LGRD_ST C_TPS_SP_LGRD_STOP /end DEF_CHARACTERISTIC
 /begin OUT_MEASUREMENT LV_MTC_CUR_OFF LV_TPS_SP_LIH TPS_SP_SEL TPS_SP TPS_SP_LIM TPS_SP_LIM_2 TPS_SP_LIM_1 LV_TPS_SP_TRA_ST_MDL TPS_SP_TRA_ST_MDL /end OUT_MEASUREMENT
/end FUNCTION
/begin FUNCTION ETC_Application_incidences_throt "_Application incidences throttle position setpoint selection"
 /begin DEF_CHARACTERISTIC C_TPS_SP_PWL_LGRD C_TPS_SP_PWL_UP C_TPS_SP_AS_MAN C_TPS_SP_EXT_ADJ_ENA C_PV_AV_EXT_ADJ_MIN IP_TPS_SP_PWL IP_TPS_SP_EXT_ADJ IP_TPS_SP_ES C_T_MTC_ISA_OFF /end DEF_CHARACTERISTIC
 /begin OUT_MEASUREMENT TPS_SP_PWL LV_TPS_PWL TPS_SP_EXT_ADJ TPS_SP_EXT_ADJ_1 LV_TPS_SP_EXT_ADJ LV_TPS_SP_EXT_ADJ_1 TPS_SP_ES /end OUT_MEASUREMENT
/end FUNCTION
/begin FUNCTION ETC_Throttle_setpoint_calculatio "_Throttle setpoint calculation at start"
 /begin DEF_CHARACTERISTIC IP_TPS_REL_ST_AT IP_TPS_REL_ST_MT IP_TPS_REL_ST_PV IP_FAC_AMP_TPS_REL_ST IP_TPS_SP_ST IP_FAC_TIA_TPS_REL_ST /end DEF_CHARACTERISTIC
 /begin OUT_MEASUREMENT TPS_SP_ST TPS_REL_ST /end OUT_MEASUREMENT
/end FUNCTION
/end MODULE
/end PROJECT
