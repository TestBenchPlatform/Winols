ASAP2_VERSION 1 31
/begin PROJECT MS45 "BMW Motorsteuerung R6"
/begin HEADER "_default_HeaderComment" PROJECT_NO _52 /end HEADER
/begin MODULE _default_ModuleName "_default_ModuleLongIdentifier"
/begin MOD_COMMON "_default_ModCommonComment" DEPOSIT ABSOLUTE BYTE_ORDER MSB_FIRST ALIGNMENT_BYTE 1 ALIGNMENT_WORD 2 ALIGNMENT_LONG 4 ALIGNMENT_FLOAT32_IEEE 4 ALIGNMENT_FLOAT64_IEEE 8 /end MOD_COMMON
/begin MEASUREMENT LV_CYL_LAM_ACT_1 "LV conditions for cylinder individual mixture control, 1 = fulfilled" ULONG _CNV_S_2_RANGE______28_CM 1 100. 0. 1. ECU_ADDRESS 0x3fcb4c BIT_MASK 0x80000000 /end MEASUREMENT
/begin MEASUREMENT LV_AD_CYL_LAM_ACT_1 "LV conditions for cylinder individual mixture Adaptation, 1 = fulfilled" ULONG _CNV_S_2_RANGE______28_CM 1 100. 0. 1. ECU_ADDRESS 0x3fcb4c BIT_MASK 0x40000000 /end MEASUREMENT
/begin MEASUREMENT VLS_CYC_RATIO_MV_1 "average duration of lambda-oscillation" UBYTE _CNV_A_R_LINEAR_____141_CM 1 100. 0. 1.984375 ECU_ADDRESS 0x3fcb56 FORMAT "%4.2" /end MEASUREMENT
/begin MEASUREMENT LV_CYL_LAM_ACT_2 "LV conditions for cylinder individual mixture control, 1 = fulfilled" ULONG _CNV_S_2_RANGE______28_CM 1 100. 0. 1. ECU_ADDRESS 0x3fcb58 BIT_MASK 0x80000000 /end MEASUREMENT
/begin MEASUREMENT LV_AD_CYL_LAM_ACT_2 "LV conditions for cylinder individual mixture Adaptation, 1 = fulfilled" ULONG _CNV_S_2_RANGE______28_CM 1 100. 0. 1. ECU_ADDRESS 0x3fcb58 BIT_MASK 0x40000000 /end MEASUREMENT
/begin MEASUREMENT VLS_CYC_RATIO_MV_2 "average duration of lambda-oscillation" UBYTE _CNV_A_R_LINEAR_____141_CM 1 100. 0. 1.984375 ECU_ADDRESS 0x3fcb62 FORMAT "%4.2" /end MEASUREMENT
/begin CHARACTERISTIC C_N_MAX_CYL_LAM "engine speed threshold of the function" VALUE 0x42950 _REC_VAL_20_u1 8160. _CNV_A_R_LINEAR_____5_CM 0. 8160. FORMAT "%4.0" /end CHARACTERISTIC
/begin CHARACTERISTIC C_TOIL_MIN_CYL_LAM "minimum oil temperature for cylinder individual injection correction" VALUE 0x42ac7 _REC_VAL_20_u1 200. _CNV_A_R_LINEAR_____3_CM -40. 160. FORMAT "%3.0" /end CHARACTERISTIC
/begin CHARACTERISTIC C_VLS_CYC_RATIO_MV_MAX "maximum admissible duration of a LR oscillation" VALUE 0x42b19 _REC_VAL_20_u1 1.984375 _CNV_A_R_LINEAR_____141_CM 0. 1.984375 FORMAT "%4.2" /end CHARACTERISTIC
/begin CHARACTERISTIC LC_CDN_LSCL_CYL_LAM "calibrateable switch for lambda-control closed loop condition" VALUE 0x42b69 _REC_VAL_20_u1 1. _CNV_A_R_LINEAR_____10_CM 0. 1. FORMAT "%2.0" /end CHARACTERISTIC
/begin CHARACTERISTIC C_VLS_MIN_CYL_LAM "lower limit of admissible sensor voltage range" VALUE 0x42b1c _REC_VAL_20_u1 1.275 _CNV_A_R_LINEAR_____142_CM 0. 1.275 FORMAT "%5.3" /end CHARACTERISTIC
/begin CHARACTERISTIC C_VLS_MAX_CYL_LAM "upper limit of admissible sensor voltage range" VALUE 0x42b1b _REC_VAL_20_u1 1.275 _CNV_A_R_LINEAR_____142_CM 0. 1.275 FORMAT "%5.3" /end CHARACTERISTIC
/begin CHARACTERISTIC C_VLS_DIF_MAX_CYL_LAM "max. admissible voltage deviation of a cylinder within 720°CRK" VALUE 0x42b1a _REC_VAL_20_u1 1.275 _CNV_A_R_LINEAR_____142_CM 0. 1.275 FORMAT "%5.3" /end CHARACTERISTIC
/begin CHARACTERISTIC C_TI_MIN_CYL_LAM "min. limit injection correction, control mode" VALUE 0x430a0 _REC_VAL_20_u2 99.99847412 _CNV_A_R_LINEAR_____143_CM -50. 49.99847412 FORMAT "%7.3" /end CHARACTERISTIC
/begin CHARACTERISTIC C_TI_MAX_CYL_LAM "max. limit injection correction, control mode" VALUE 0x4309c _REC_VAL_20_u2 99.99847412 _CNV_A_R_LINEAR_____143_CM -50. 49.99847412 FORMAT "%7.3" /end CHARACTERISTIC
/begin CHARACTERISTIC C_TI_CYL_LAM_DEC "step to reduce the controller injection correction" VALUE 0x43098 _REC_VAL_20_u2 50. _CNV_A_R_LINEAR_____144_CM 0. 50. /end CHARACTERISTIC
/begin CHARACTERISTIC C_TI_AD_MIN_CYL_LAM "min. limit injection correction, Adaptation mode" VALUE 0x43096 _REC_VAL_20_u2 99.99847412 _CNV_A_R_LINEAR_____143_CM -50. 49.99847412 FORMAT "%7.3" /end CHARACTERISTIC
/begin CHARACTERISTIC C_TI_AD_MAX_CYL_LAM "max. limit injection correction, Adaptation mode" VALUE 0x43094 _REC_VAL_20_u2 99.99847412 _CNV_A_R_LINEAR_____143_CM -50. 49.99847412 FORMAT "%7.3" /end CHARACTERISTIC
/begin CHARACTERISTIC C_MFF_ADD_CP_MAX_CYL_LAM_AD "max. fuel amount from canister purge function" VALUE 0x42e82 _REC_VAL_20_u2 1389. _CNV_A_R_LINEAR_____95_CM 0. 1389. FORMAT "%7.2" /end CHARACTERISTIC
/begin MEASUREMENT CRK_CYL_LAM_0 "read-out position of the cylinder individual sensor signal, referred to ignition TDC" UBYTE _CNV_A_R_LINEAR_____145_CM 1 100. 0. 720. ECU_ADDRESS 0x3fcb82 FORMAT "%4.0" /end MEASUREMENT
/begin MEASUREMENT CRK_CYL_LAM_1 "read-out position of the cylinder individual sensor signal, referred to ignition TDC" UBYTE _CNV_A_R_LINEAR_____145_CM 1 100. 0. 720. ECU_ADDRESS 0x3fcb83 FORMAT "%4.0" /end MEASUREMENT
/begin MEASUREMENT CRK_CYL_LAM_2 "read-out position of the cylinder individual sensor signal, referred to ignition TDC" UBYTE _CNV_A_R_LINEAR_____145_CM 1 100. 0. 720. ECU_ADDRESS 0x3fcb84 FORMAT "%4.0" /end MEASUREMENT
/begin MEASUREMENT CRK_CYL_LAM_3 "read-out position of the cylinder individual sensor signal, referred to ignition TDC" UBYTE _CNV_A_R_LINEAR_____145_CM 1 100. 0. 720. ECU_ADDRESS 0x3fcb85 FORMAT "%4.0" /end MEASUREMENT
/begin MEASUREMENT CRK_CYL_LAM_4 "read-out position of the cylinder individual sensor signal, referred to ignition TDC" UBYTE _CNV_A_R_LINEAR_____145_CM 1 100. 0. 720. ECU_ADDRESS 0x3fcb86 FORMAT "%4.0" /end MEASUREMENT
/begin MEASUREMENT CRK_CYL_LAM_5 "read-out position of the cylinder individual sensor signal, referred to ignition TDC" UBYTE _CNV_A_R_LINEAR_____145_CM 1 100. 0. 720. ECU_ADDRESS 0x3fcb87 FORMAT "%4.0" /end MEASUREMENT
/begin MEASUREMENT VLS_DLY_0 "cylinder individual oxygen sensor voltage at CRK_CYK_LAM_x" UBYTE _CNV_A_R_LINEAR_____142_CM 1 100. 0. 1.275 ECU_ADDRESS 0x3fcb7c FORMAT "%5.3" /end MEASUREMENT
/begin MEASUREMENT VLS_DLY_1 "cylinder individual oxygen sensor voltage at CRK_CYK_LAM_x" UBYTE _CNV_A_R_LINEAR_____142_CM 1 100. 0. 1.275 ECU_ADDRESS 0x3fcb7d FORMAT "%5.3" /end MEASUREMENT
/begin MEASUREMENT VLS_DLY_2 "cylinder individual oxygen sensor voltage at CRK_CYK_LAM_x" UBYTE _CNV_A_R_LINEAR_____142_CM 1 100. 0. 1.275 ECU_ADDRESS 0x3fcb7e FORMAT "%5.3" /end MEASUREMENT
/begin MEASUREMENT VLS_DLY_3 "cylinder individual oxygen sensor voltage at CRK_CYK_LAM_x" UBYTE _CNV_A_R_LINEAR_____142_CM 1 100. 0. 1.275 ECU_ADDRESS 0x3fcb7f FORMAT "%5.3" /end MEASUREMENT
/begin MEASUREMENT VLS_DLY_4 "cylinder individual oxygen sensor voltage at CRK_CYK_LAM_x" UBYTE _CNV_A_R_LINEAR_____142_CM 1 100. 0. 1.275 ECU_ADDRESS 0x3fcb80 FORMAT "%5.3" /end MEASUREMENT
/begin MEASUREMENT VLS_DLY_5 "cylinder individual oxygen sensor voltage at CRK_CYK_LAM_x" UBYTE _CNV_A_R_LINEAR_____142_CM 1 100. 0. 1.275 ECU_ADDRESS 0x3fcb81 FORMAT "%5.3" /end MEASUREMENT
/begin MEASUREMENT VLS_DIF_VAL_0 "normalized voltage deviation of a cylinder" SWORD _CNV_A_R_LINEAR_____146_CM 1 100. -0.6375 0.6375 ECU_ADDRESS 0x3fcb70 FORMAT "%7.5" /end MEASUREMENT
/begin MEASUREMENT VLS_DIF_VAL_1 "normalized voltage deviation of a cylinder" SWORD _CNV_A_R_LINEAR_____146_CM 1 100. -0.6375 0.6375 ECU_ADDRESS 0x3fcb72 FORMAT "%7.5" /end MEASUREMENT
/begin MEASUREMENT VLS_DIF_VAL_2 "normalized voltage deviation of a cylinder" SWORD _CNV_A_R_LINEAR_____146_CM 1 100. -0.6375 0.6375 ECU_ADDRESS 0x3fcb74 FORMAT "%7.5" /end MEASUREMENT
/begin MEASUREMENT VLS_DIF_VAL_3 "normalized voltage deviation of a cylinder" SWORD _CNV_A_R_LINEAR_____146_CM 1 100. -0.6375 0.6375 ECU_ADDRESS 0x3fcb76 FORMAT "%7.5" /end MEASUREMENT
/begin MEASUREMENT VLS_DIF_VAL_4 "normalized voltage deviation of a cylinder" SWORD _CNV_A_R_LINEAR_____146_CM 1 100. -0.6375 0.6375 ECU_ADDRESS 0x3fcb78 FORMAT "%7.5" /end MEASUREMENT
/begin MEASUREMENT VLS_DIF_VAL_5 "normalized voltage deviation of a cylinder" SWORD _CNV_A_R_LINEAR_____146_CM 1 100. -0.6375 0.6375 ECU_ADDRESS 0x3fcb7a FORMAT "%7.5" /end MEASUREMENT
/begin MEASUREMENT TI_CYL_LAM_0 "cylinder individual mixture control" UWORD _CNV_A_R_LINEAR_____143_CM 1 100. -50. 49.99847412 ECU_ADDRESS 0x3fcb34 FORMAT "%7.3" /end MEASUREMENT
/begin MEASUREMENT TI_CYL_LAM_1 "cylinder individual mixture control" UWORD _CNV_A_R_LINEAR_____143_CM 1 100. -50. 49.99847412 ECU_ADDRESS 0x3fcb36 FORMAT "%7.3" /end MEASUREMENT
/begin MEASUREMENT TI_CYL_LAM_2 "cylinder individual mixture control" UWORD _CNV_A_R_LINEAR_____143_CM 1 100. -50. 49.99847412 ECU_ADDRESS 0x3fcb38 FORMAT "%7.3" /end MEASUREMENT
/begin MEASUREMENT TI_CYL_LAM_3 "cylinder individual mixture control" UWORD _CNV_A_R_LINEAR_____143_CM 1 100. -50. 49.99847412 ECU_ADDRESS 0x3fcb3a FORMAT "%7.3" /end MEASUREMENT
/begin MEASUREMENT TI_CYL_LAM_4 "cylinder individual mixture control" UWORD _CNV_A_R_LINEAR_____143_CM 1 100. -50. 49.99847412 ECU_ADDRESS 0x3fcb3c FORMAT "%7.3" /end MEASUREMENT
/begin MEASUREMENT TI_CYL_LAM_5 "cylinder individual mixture control" UWORD _CNV_A_R_LINEAR_____143_CM 1 100. -50. 49.99847412 ECU_ADDRESS 0x3fcb3e FORMAT "%7.3" /end MEASUREMENT
/begin MEASUREMENT TI_AD_CYL_LAM_0 "cylinder individual mixture Adaptation" UWORD _CNV_A_R_LINEAR_____143_CM 1 100. -50. 49.99847412 ECU_ADDRESS 0x3fcb40 FORMAT "%7.3" /end MEASUREMENT
/begin MEASUREMENT TI_AD_CYL_LAM_1 "cylinder individual mixture Adaptation" UWORD _CNV_A_R_LINEAR_____143_CM 1 100. -50. 49.99847412 ECU_ADDRESS 0x3fcb42 FORMAT "%7.3" /end MEASUREMENT
/begin MEASUREMENT TI_AD_CYL_LAM_2 "cylinder individual mixture Adaptation" UWORD _CNV_A_R_LINEAR_____143_CM 1 100. -50. 49.99847412 ECU_ADDRESS 0x3fcb44 FORMAT "%7.3" /end MEASUREMENT
/begin MEASUREMENT TI_AD_CYL_LAM_3 "cylinder individual mixture Adaptation" UWORD _CNV_A_R_LINEAR_____143_CM 1 100. -50. 49.99847412 ECU_ADDRESS 0x3fcb46 FORMAT "%7.3" /end MEASUREMENT
/begin MEASUREMENT TI_AD_CYL_LAM_4 "cylinder individual mixture Adaptation" UWORD _CNV_A_R_LINEAR_____143_CM 1 100. -50. 49.99847412 ECU_ADDRESS 0x3fcb48 FORMAT "%7.3" /end MEASUREMENT
/begin MEASUREMENT TI_AD_CYL_LAM_5 "cylinder individual mixture Adaptation" UWORD _CNV_A_R_LINEAR_____143_CM 1 100. -50. 49.99847412 ECU_ADDRESS 0x3fcb4a FORMAT "%7.3" /end MEASUREMENT
/begin CHARACTERISTIC IP_FAC_FRQ_1_CYL_LAM "map for considering slower lambda-sensors" CURVE 0x4dfc2 _REC_CUR_20_u1_u1 1.99220002 _CNV_A_R_LINEAR_____34_CM 0. 1.99220002 FORMAT "%5.3"
 /begin AXIS_DESCR COM_AXIS CYL_AD_STRUCT[0].VLS_CYC_RATIO_MV _CNV_A_R_LINEAR_____141_CM 6 0. 1.984375 FORMAT "%4.2" AXIS_PTS_REF ldp_vls_cyc_ratio_mv_1_ip_fac /end AXIS_DESCR
/end CHARACTERISTIC
/begin CHARACTERISTIC IP_FAC_FRQ_2_CYL_LAM "map for considering slower lambda-sensors" CURVE 0x4dfc8 _REC_CUR_20_u1_u1 1.99220002 _CNV_A_R_LINEAR_____34_CM 0. 1.99220002 FORMAT "%5.3"
 /begin AXIS_DESCR COM_AXIS CYL_AD_STRUCT[1].VLS_CYC_RATIO_MV _CNV_A_R_LINEAR_____141_CM 6 0. 1.984375 FORMAT "%4.2" AXIS_PTS_REF ldp_vls_cyc_ratio_mv_2_ip_fac /end AXIS_DESCR
/end CHARACTERISTIC
/begin CHARACTERISTIC IP_FAC_MAF_1_CYL_LAM "load dependant factor for slower lambda-sensors" CURVE 0x4e20f _REC_CUR_20_u1_u2 1.99220002 _CNV_A_R_LINEAR_____34_CM 0. 1.99220002 FORMAT "%5.3"
 /begin AXIS_DESCR COM_AXIS MAF_KGH _CNV_A_R_LINEAR_____101_CM 6 0. 2047.96875 FORMAT "%7.2" AXIS_PTS_REF ldp_maf_kgh_ip_fac_maf_1_cyl /end AXIS_DESCR
/end CHARACTERISTIC
/begin CHARACTERISTIC IP_FAC_MAF_2_CYL_LAM "load dependant factor for slower lambda-sensors" CURVE 0x4e215 _REC_CUR_20_u1_u2 1.99220002 _CNV_A_R_LINEAR_____34_CM 0. 1.99220002 FORMAT "%5.3"
 /begin AXIS_DESCR COM_AXIS MAF_KGH _CNV_A_R_LINEAR_____101_CM 6 0. 2047.96875 FORMAT "%7.2" AXIS_PTS_REF ldp_maf_kgh_ip_fac_maf_2_cyl /end AXIS_DESCR
/end CHARACTERISTIC
/begin CHARACTERISTIC IP_MAF_MAX_CYL_LAM "upper load threshold control mode" CURVE 0x4fabf _REC_CUR_20_u1_u2 1389. _CNV_A_R_LINEAR_____18_CM 0. 1389. FORMAT "%4.0"
 /begin AXIS_DESCR COM_AXIS N _CNV_A_R_LINEAR_____17_CM 6 0. 8160. FORMAT "%4.0" AXIS_PTS_REF ldpm_n_2_cybl /end AXIS_DESCR
/end CHARACTERISTIC
/begin CHARACTERISTIC IP_VLS_DIF_VAL "standardization between voltage value and mixture value" MAP 0x50d4f _REC_MAP_20_u1_u2_u2 0.99610001 _CNV_A_R_LINEAR_____20_CM 0. 0.99610001 FORMAT "%5.3"
 /begin AXIS_DESCR COM_AXIS MAF _CNV_A_R_LINEAR_____95_CM 8 0. 1389. FORMAT "%7.2" AXIS_PTS_REF ldp_maf_ip_vls_dif_val /end AXIS_DESCR
 /begin AXIS_DESCR COM_AXIS N _CNV_A_R_LINEAR_____17_CM 8 0. 8160. FORMAT "%4.0" AXIS_PTS_REF ldpm_n_1_cybl /end AXIS_DESCR
/end CHARACTERISTIC
/begin CHARACTERISTIC IP_MAF_MIN_CYL_LAM "lower load threshold control mode" CURVE 0x4fadf _REC_CUR_20_u1_u2 1389. _CNV_A_R_LINEAR_____18_CM 0. 1389. FORMAT "%4.0"
 /begin AXIS_DESCR COM_AXIS N _CNV_A_R_LINEAR_____17_CM 6 0. 8160. FORMAT "%4.0" AXIS_PTS_REF ldpm_n_2_cybl /end AXIS_DESCR
/end CHARACTERISTIC
/begin CHARACTERISTIC IP_MAF_MIN_CYL_LAM_AD "lower load threshold Adaptation mode" CURVE 0x4fae5 _REC_CUR_20_u1_u2 1389. _CNV_A_R_LINEAR_____18_CM 0. 1389. FORMAT "%4.0"
 /begin AXIS_DESCR COM_AXIS N _CNV_A_R_LINEAR_____17_CM 6 0. 8160. FORMAT "%4.0" AXIS_PTS_REF ldpm_n_2_cybl /end AXIS_DESCR
/end CHARACTERISTIC
/begin CHARACTERISTIC IP_MAF_MAX_CYL_LAM_AD "upper load threshold Adaptation mode" CURVE 0x4fac5 _REC_CUR_20_u1_u2 1389. _CNV_A_R_LINEAR_____18_CM 0. 1389. FORMAT "%4.0"
 /begin AXIS_DESCR COM_AXIS N _CNV_A_R_LINEAR_____17_CM 6 0. 8160. FORMAT "%4.0" AXIS_PTS_REF ldpm_n_2_cybl /end AXIS_DESCR
/end CHARACTERISTIC
/begin CHARACTERISTIC IP_TI_AD_CYL "mixture correction value Adaptation mode" CURVE 0x4ba08 _REC_CUR_20_u2_u2 99.99847412 _CNV_A_R_LINEAR_____143_CM -50. 49.99847412 FORMAT "%7.3"
 /begin AXIS_DESCR COM_AXIS ONLINE_DUMMY _CNV_A_R_LINEAR_____147_CM 8 -0.6375 0.6375 FORMAT "%7.5" AXIS_PTS_REF ldp_vls_dif_val_ip_ti_ad_cyl /end AXIS_DESCR
/end CHARACTERISTIC
/begin CHARACTERISTIC IP_DLY_CYL_LAM_1 "delay of read time for lambda-sonsor voltage, referred to exhast valve opens, cylinder bank 1" MAP 0x46430 _REC_MAP_20_u2_u2_u2 720. _CNV_A_R_LINEAR_____75_CM 0. 720. FORMAT "%6.2"
 /begin AXIS_DESCR COM_AXIS MAF _CNV_A_R_LINEAR_____95_CM 8 0. 1389. FORMAT "%7.2" AXIS_PTS_REF ldp_maf_ip_dly_cyl_lam /end AXIS_DESCR
 /begin AXIS_DESCR COM_AXIS N _CNV_A_R_LINEAR_____17_CM 8 0. 8160. FORMAT "%4.0" AXIS_PTS_REF ldpm_n_1_cybl /end AXIS_DESCR
/end CHARACTERISTIC
/begin CHARACTERISTIC IP_DLY_CYL_LAM_2 "delay of read time for lambda-sonsor voltage, referred to exhast valve opens, cylinder bank 2" MAP 0x464b0 _REC_MAP_20_u2_u2_u2 720. _CNV_A_R_LINEAR_____75_CM 0. 720. FORMAT "%6.2"
 /begin AXIS_DESCR COM_AXIS MAF _CNV_A_R_LINEAR_____95_CM 8 0. 1389. FORMAT "%7.2" AXIS_PTS_REF ldp_maf_ip_dly_cyl_lam /end AXIS_DESCR
 /begin AXIS_DESCR COM_AXIS N _CNV_A_R_LINEAR_____17_CM 8 0. 8160. FORMAT "%4.0" AXIS_PTS_REF ldpm_n_1_cybl /end AXIS_DESCR
/end CHARACTERISTIC
/begin CHARACTERISTIC IP_TI_CYL "mixture correction value control mode" CURVE 0x4baf8 _REC_CUR_20_u2_u2 99.99847412 _CNV_A_R_LINEAR_____143_CM -50. 49.99847412 FORMAT "%7.3"
 /begin AXIS_DESCR COM_AXIS ONLINE_DUMMY _CNV_A_R_LINEAR_____147_CM 6 -0.6375 0.6375 FORMAT "%7.5" AXIS_PTS_REF ldp_vls_dif_val_ip_ti_cyl /end AXIS_DESCR
/end CHARACTERISTIC
/begin CHARACTERISTIC IP_FAC_VLS_DIF_LAMB "voltage deviation factor for lambda not 1" CURVE 0x47f7c _REC_CUR_20_u2_u2 255.996094 _CNV_A_R_LINEAR_____111_CM 0. 255.996094 FORMAT "%7.3"
 /begin AXIS_DESCR COM_AXIS LAMB_SP _CNV_A_R_LINEAR_____148_CM 4 0. 31.99902344 FORMAT "%7.4" AXIS_PTS_REF ldp_lamb_sp_ip_fac_vls_dif_lamb /end AXIS_DESCR
/end CHARACTERISTIC
/begin AXIS_PTS ldp_vls_cyc_ratio_mv_1_ip_fac "" 0x43b04 VLS_CYC_RATIO_MV_1 _REC_AXS_20_u1 1.984375 _CNV_A_R_LINEAR_____141_CM 6 0. 1.984375 FORMAT "%4.2" /end AXIS_PTS
/begin AXIS_PTS ldp_vls_cyc_ratio_mv_2_ip_fac "" 0x43b0b VLS_CYC_RATIO_MV_2 _REC_AXS_20_u1 1.984375 _CNV_A_R_LINEAR_____141_CM 6 0. 1.984375 FORMAT "%4.2" /end AXIS_PTS
/begin AXIS_PTS ldp_maf_kgh_ip_fac_maf_1_cyl "" 0x4464c MAF_KGH _REC_AXS_20_u2 2047.96875 _CNV_A_R_LINEAR_____101_CM 6 0. 2047.96875 FORMAT "%7.2" /end AXIS_PTS
/begin AXIS_PTS ldp_maf_kgh_ip_fac_maf_2_cyl "" 0x4465a MAF_KGH _REC_AXS_20_u2 2047.96875 _CNV_A_R_LINEAR_____101_CM 6 0. 2047.96875 FORMAT "%7.2" /end AXIS_PTS
/begin AXIS_PTS ldpm_n_1_cybl "" 0x4522c N _REC_AXS_20_u2 8160. _CNV_A_R_LINEAR_____17_CM 8 0. 8160. FORMAT "%4.0" /end AXIS_PTS
/begin AXIS_PTS ldpm_n_2_cybl "" 0x45272 N _REC_AXS_20_u2 8160. _CNV_A_R_LINEAR_____17_CM 6 0. 8160. FORMAT "%4.0" /end AXIS_PTS
/begin AXIS_PTS ldp_maf_ip_dly_cyl_lam "" 0x4458c MAF _REC_AXS_20_u2 1389. _CNV_A_R_LINEAR_____95_CM 8 0. 1389. FORMAT "%7.2" /end AXIS_PTS
/begin AXIS_PTS ldp_maf_ip_vls_dif_val "" 0x445d8 MAF _REC_AXS_20_u2 1389. _CNV_A_R_LINEAR_____95_CM 8 0. 1389. FORMAT "%7.2" /end AXIS_PTS
/begin AXIS_PTS ldp_vls_dif_val_ip_ti_ad_cyl "" 0x44de0 VLS_DIF_VAL _REC_AXS_20_u2 1.275 _CNV_A_R_LINEAR_____147_CM 8 -0.6375 0.6375 FORMAT "%7.5" /end AXIS_PTS
/begin AXIS_PTS ldp_vls_dif_val_ip_ti_cyl "" 0x44df2 VLS_DIF_VAL _REC_AXS_20_u2 1.275 _CNV_A_R_LINEAR_____147_CM 6 -0.6375 0.6375 FORMAT "%7.5" /end AXIS_PTS
/begin AXIS_PTS ldp_lamb_sp_ip_fac_vls_dif_lamb "" 0x44498 LAMB_SP _REC_AXS_20_u2 31.99902344 _CNV_A_R_LINEAR_____148_CM 4 0. 31.99902344 FORMAT "%7.4" /end AXIS_PTS
/begin CHARACTERISTIC ID_CRLC_VLS_DOWN_T_DLY "Correlation constant downstream signal" CURVE 0x4cc47 _REC_CUR_20_u1_u2 0.99610001 _CNV_A_R_LINEAR_____20_CM 0. 0.99610001 FORMAT "%5.3"
 /begin AXIS_DESCR COM_AXIS MAF_KGH _CNV_A_R_LINEAR_____101_CM 6 0. 2047.96875 FORMAT "%6.2" AXIS_PTS_REF ldp_maf_kgh__crlc_vls_down /end AXIS_DESCR
/end CHARACTERISTIC
/begin AXIS_PTS ldp_maf_kgh__crlc_vls_down "" 0x445ea MAF_KGH _REC_AXS_20_u2 2047.96875 _CNV_A_R_LINEAR_____101_CM 6 0. 2047.96875 FORMAT "%6.2" /end AXIS_PTS
/begin MEASUREMENT LV_INH_LAM_DLY_1 "Activation condition for lambda trim control" UBYTE _CNV_S_2_RANGE______28_CM 1 100. 0. 1. ECU_ADDRESS 0x3fa959 /end MEASUREMENT
/begin MEASUREMENT VLS_DOWN_AV_1 "Filtered VLS_DOWN for input downstream fuel trim" UWORD _CNV_A_R_LINEAR_____33_CM 1 100. 0. 4.99511719 ECU_ADDRESS 0x3fa95a FORMAT "%5.3" /end MEASUREMENT
/begin MEASUREMENT LV_INH_LSH_DOWN_1 "Boolean flag indicating project specific application conditions for heating not met" UBYTE _CNV_S_2_RANGE______28_CM 1 100. 0. 1. ECU_ADDRESS 0x3fa824 /end MEASUREMENT
/begin MEASUREMENT TEMP_LS_DOWN_INI_1 "Oxygen sensor temperature at start" SWORD _CNV_A_R_LINEAR_____286_CM 1 100. -2048. 2047.938 ECU_ADDRESS 0x3fa826 FORMAT "%8.2" /end MEASUREMENT
/begin MEASUREMENT LV_INH_INT_PUC_1 "catalyst purge function inhibited" ULONG _CNV_S_2_RANGE______28_CM 1 100. 0. 1. ECU_ADDRESS 0x3fa94c BIT_MASK 0x40000000 /end MEASUREMENT
/begin MEASUREMENT LV_ACT_INT_PUC_AFL_1 "state of the enrichment function for pre and main cat balancing" ULONG _CNV_S_2_RANGE______28_CM 1 100. 0. 1. ECU_ADDRESS 0x3fa94c BIT_MASK 0x80000000 /end MEASUREMENT
/begin MEASUREMENT TEMP_MAIN_CAT_1 "modeled or assumed temperature of main cat" UWORD _CNV_A_R_LINEAR_____305_CM 1 100. -33. 990.984375 ECU_ADDRESS 0x3fa950 FORMAT "%6.2" /end MEASUREMENT
/begin MEASUREMENT TEMP_PCAT_1 "modeled or assumed temperature of pre cat" UWORD _CNV_A_R_LINEAR_____305_CM 1 100. -33. 990.984375 ECU_ADDRESS 0x3fa952 FORMAT "%6.2" /end MEASUREMENT
/begin MEASUREMENT LV_INH_LAM_DLY_2 "Activation condition for lambda trim control" UBYTE _CNV_S_2_RANGE______28_CM 1 100. 0. 1. ECU_ADDRESS 0x3fac71 /end MEASUREMENT
/begin MEASUREMENT VLS_DOWN_AV_2 "Filtered VLS_DOWN for input downstream fuel trim" UWORD _CNV_A_R_LINEAR_____33_CM 1 100. 0. 4.99511719 ECU_ADDRESS 0x3fac72 FORMAT "%5.3" /end MEASUREMENT
/begin MEASUREMENT LV_INH_LSH_DOWN_2 "Boolean flag indicating project specific application conditions for heating not met" UBYTE _CNV_S_2_RANGE______28_CM 1 100. 0. 1. ECU_ADDRESS 0x3fab3c /end MEASUREMENT
/begin MEASUREMENT TEMP_LS_DOWN_INI_2 "Oxygen sensor temperature at start" SWORD _CNV_A_R_LINEAR_____286_CM 1 100. -2048. 2047.938 ECU_ADDRESS 0x3fab3e FORMAT "%8.2" /end MEASUREMENT
/begin MEASUREMENT LV_INH_INT_PUC_2 "catalyst purge function inhibited" ULONG _CNV_S_2_RANGE______28_CM 1 100. 0. 1. ECU_ADDRESS 0x3fac64 BIT_MASK 0x40000000 /end MEASUREMENT
/begin MEASUREMENT LV_ACT_INT_PUC_AFL_2 "state of the enrichment function for pre and main cat balancing" ULONG _CNV_S_2_RANGE______28_CM 1 100. 0. 1. ECU_ADDRESS 0x3fac64 BIT_MASK 0x80000000 /end MEASUREMENT
/begin MEASUREMENT TEMP_MAIN_CAT_2 "modeled or assumed temperature of main cat" UWORD _CNV_A_R_LINEAR_____305_CM 1 100. -33. 990.984375 ECU_ADDRESS 0x3fac68 FORMAT "%6.2" /end MEASUREMENT
/begin MEASUREMENT TEMP_PCAT_2 "modeled or assumed temperature of pre cat" UWORD _CNV_A_R_LINEAR_____305_CM 1 100. -33. 990.984375 ECU_ADDRESS 0x3fac6a FORMAT "%6.2" /end MEASUREMENT
/begin MEASUREMENT LV_ACT_INT_PUC_2 "state of the enrichment function for pre and main cat balancing" UBYTE _CNV_S_2_RANGE______28_CM 1 100. 0. 1. ECU_ADDRESS 0x3fcba0 /end MEASUREMENT
/begin MEASUREMENT LV_DOWN_RAMP_ACT_1 "Flag indicating that down ramping from lambda set point shift to zero is active" UBYTE _CNV_S_2_RANGE______28_CM 1 100. 0. 1. ECU_ADDRESS 0x3fdc46 /end MEASUREMENT
/begin MEASUREMENT LV_DOWN_RAMP_ACT_2 "Flag indicating that down ramping from lambda set point shift to zero is active" UBYTE _CNV_S_2_RANGE______28_CM 1 100. 0. 1. ECU_ADDRESS 0x3fdc69 /end MEASUREMENT
/begin MEASUREMENT LV_PCAT_PURGE_PUC_1 "state of the enrichment function for pre cat balancing after PUC phase" UBYTE _CNV_S_2_RANGE______28_CM 1 100. 0. 1. ECU_ADDRESS 0x3fcb9a /end MEASUREMENT
/begin MEASUREMENT LV_PCAT_PURGE_PUC_2 "state of the enrichment function for pre cat balancing after PUC phase" UBYTE _CNV_S_2_RANGE______28_CM 1 100. 0. 1. ECU_ADDRESS 0x3fcba1 /end MEASUREMENT
/begin MEASUREMENT LV_PCAT_PURGE_SA_1 "state of the enrichment function for pre cat balancing after SA phase" UBYTE _CNV_S_2_RANGE______28_CM 1 100. 0. 1. ECU_ADDRESS 0x3fcb9b /end MEASUREMENT
/begin MEASUREMENT LV_PCAT_PURGE_SA_2 "state of the enrichment function for pre cat balancing after SA phase" UBYTE _CNV_S_2_RANGE______28_CM 1 100. 0. 1. ECU_ADDRESS 0x3fcba2 /end MEASUREMENT
/begin MEASUREMENT LV_PCAT_PURGE_HST_1 "state of the enrichment function for pre cat balancing after HST phase" UBYTE _CNV_S_2_RANGE______28_CM 1 100. 0. 1. ECU_ADDRESS 0x3fcb9c /end MEASUREMENT
/begin MEASUREMENT LV_PCAT_PURGE_HST_2 "state of the enrichment function for pre cat balancing after HST phase" UBYTE _CNV_S_2_RANGE______28_CM 1 100. 0. 1. ECU_ADDRESS 0x3fcba3 /end MEASUREMENT
/begin MEASUREMENT LV_PCAT_PURGE_CH_2 "state of the enrichment function for pre cat balancing after CH phase" UBYTE _CNV_S_2_RANGE______28_CM 1 100. 0. 1. ECU_ADDRESS 0x3fcba4 /end MEASUREMENT
/begin MEASUREMENT MAF_INT_ACT_PUC_1 "value of the mass air flow integral for the function deactivation" ULONG _CNV_A_R_LINEAR_____316_CM 1 100. 0. 1820.398 ECU_ADDRESS 0x3fdc24 FORMAT "%12.7" /end MEASUREMENT
/begin MEASUREMENT MAF_INT_PUC "integral of mass air flow while active PUC" UWORD _CNV_A_R_LINEAR_____277_CM 1 100. 0. 1820.398 ECU_ADDRESS 0x3fcb96 FORMAT "%7.2" /end MEASUREMENT
/begin MEASUREMENT MAF_INT_CAT_LOAD_1 "measure of the purge amount of the pre catalyst" ULONG _CNV_A_R_LINEAR_____316_CM 1 100. 0. 1820.398 ECU_ADDRESS 0x3fdc28 FORMAT "%12.7" /end MEASUREMENT
/begin MEASUREMENT MAF_INT_CAT_LOAD_2 "measure of the purge amount of the pre catalyst" ULONG _CNV_A_R_LINEAR_____316_CM 1 100. 0. 1820.398 ECU_ADDRESS 0x3fdc4c FORMAT "%12.7" /end MEASUREMENT
/begin MEASUREMENT MAF_INT_CAT_LOAD_MAIN_1 "measure of the purge amount of the main catalyst" ULONG _CNV_A_R_LINEAR_____316_CM 1 100. 0. 1820.398 ECU_ADDRESS 0x3fdc2c FORMAT "%12.7" /end MEASUREMENT
/begin MEASUREMENT MAF_INT_CAT_LOAD_MAIN_2 "measure of the purge amount of the main catalyst" ULONG _CNV_A_R_LINEAR_____316_CM 1 100. 0. 1820.398 ECU_ADDRESS 0x3fdc50 FORMAT "%12.7" /end MEASUREMENT
/begin MEASUREMENT LV_PCAT_PURGE_CH_1 "state of the enrichment function for pre cat balancing after CH phase" UBYTE _CNV_S_2_RANGE______28_CM 1 100. 0. 1. ECU_ADDRESS 0x3fcb9d /end MEASUREMENT
/begin MEASUREMENT LV_MAIN_CAT_PURGE_1 "state of the enrichment function for main cat balancing" UBYTE _CNV_S_2_RANGE______28_CM 1 100. 0. 1. ECU_ADDRESS 0x3fcb9e /end MEASUREMENT
/begin MEASUREMENT LV_MAIN_CAT_PURGE_2 "state of the enrichment function for main cat balancing" UBYTE _CNV_S_2_RANGE______28_CM 1 100. 0. 1. ECU_ADDRESS 0x3fcba5 /end MEASUREMENT
/begin MEASUREMENT LV_VLS_DOWN_PUC_ACT_MAX_2 "logical indicating that downstream sensor signal is/was below calibration limit" UBYTE _CNV_S_2_RANGE______28_CM 1 100. 0. 1. ECU_ADDRESS 0x3fdc67 /end MEASUREMENT
/begin MEASUREMENT DELTA_LAMB_SP_PUC_1 "lambda controller set point shift" UBYTE _CNV_A_R_LINEAR_____317_CM 1 100. 0. 0.125 ECU_ADDRESS 0x3fcb98 FORMAT "%5.3" /end MEASUREMENT
/begin MEASUREMENT DELTA_LAMB_SP_PUC_2 "lambda controller set point shift" UBYTE _CNV_A_R_LINEAR_____317_CM 1 100. 0. 0.125 ECU_ADDRESS 0x3fcb9f FORMAT "%5.3" /end MEASUREMENT
/begin MEASUREMENT MAF_INT_PURGE_REST_1 "Estimated rest integral for catalyst purge" ULONG _CNV_A_R_LINEAR_____316_CM 1 100. 0. 1820.398 ECU_ADDRESS 0x3fdc34 FORMAT "%12.7" /end MEASUREMENT
/begin MEASUREMENT MAF_INT_PURGE_REST_2 "Estimated rest integral for catalyst purge" ULONG _CNV_A_R_LINEAR_____316_CM 1 100. 0. 1820.398 ECU_ADDRESS 0x3fdc58 FORMAT "%12.7" /end MEASUREMENT
/begin MEASUREMENT MAF_INT_SAMPLE_STEP_1 "Maf Integral to be added or subtracted each sample step" ULONG _CNV_A_R_LINEAR_____316_CM 1 100. 0. 1820.398 ECU_ADDRESS 0x3fdc30 FORMAT "%12.7" /end MEASUREMENT
/begin CHARACTERISTIC C_VLS_DOWN_PUC_ACT_MAX "max. VLS_DOWN threshold for deactivation " VALUE 0x4319a _REC_VAL_20_u2 4.99511719 _CNV_A_R_LINEAR_____33_CM 0. 4.99511719 FORMAT "%5.3" /end CHARACTERISTIC
/begin CHARACTERISTIC C_MAF_INT_PUC_MIN "minimum MAF_INT threshold for cat purge activation after PUC phase" VALUE 0x42e40 _REC_VAL_20_u2 1820.398 _CNV_A_R_LINEAR_____277_CM 0. 1820.398 FORMAT "%7.2" /end CHARACTERISTIC
/begin CHARACTERISTIC C_MAF_INT_PCAT_PURGE_SA "initial value for mass air flow integral for pre cat purge after SA phase" VALUE 0x42e3c _REC_VAL_20_u2 1820.398 _CNV_A_R_LINEAR_____277_CM 0. 1820.398 FORMAT "%7.2" /end CHARACTERISTIC
/begin CHARACTERISTIC C_MAF_INT_PCAT_PURGE_HST "initial value for mass air flow integral for pre cat purge after HST phase" VALUE 0x42e3a _REC_VAL_20_u2 1820.398 _CNV_A_R_LINEAR_____277_CM 0. 1820.398 FORMAT "%7.2" /end CHARACTERISTIC
/begin CHARACTERISTIC C_MAF_INT_PCAT_PURGE_CH "initial value for mass air flow integral for pre cat purge after CH phase" VALUE 0x42e38 _REC_VAL_20_u2 1820.398 _CNV_A_R_LINEAR_____277_CM 0. 1820.398 FORMAT "%7.2" /end CHARACTERISTIC
/begin CHARACTERISTIC C_FAC_ADD_PCAT_MAIN_CAT_PUC_SA "additional weighting factor for IP_FAC_PCAT_MAIN_CAT_PUC for main cat purge after SA" VALUE 0x4289e _REC_VAL_20_u1 3.984375 _CNV_A_R_LINEAR_____195_CM 0. 3.984375 FORMAT "%4.2" /end CHARACTERISTIC
/begin CHARACTERISTIC C_FAC_ADD_PCAT_MAIN_CAT_PUC_HST "additional weighting factor for IP_FAC_PCAT_MAIN_CAT_PUC for main cat purge after HST" VALUE 0x4289d _REC_VAL_20_u1 3.984375 _CNV_A_R_LINEAR_____195_CM 0. 3.984375 FORMAT "%4.2" /end CHARACTERISTIC
/begin CHARACTERISTIC C_FAC_ADD_PCAT_MAIN_CAT_PUC_CH "additional weighting factor for IP_FAC_PCAT_MAIN_CAT_PUC for main cat purge after CH" VALUE 0x4289c _REC_VAL_20_u1 3.984375 _CNV_A_R_LINEAR_____195_CM 0. 3.984375 FORMAT "%4.2" /end CHARACTERISTIC
/begin CHARACTERISTIC C_DELTA_LAMB_SP_PUC_INC "limitation for DELTA_LAMB_SP_PUC increase" VALUE 0x4287c _REC_VAL_20_u1 0.125 _CNV_A_R_LINEAR_____317_CM 0. 0.125 FORMAT "%5.3" /end CHARACTERISTIC
/begin CHARACTERISTIC C_DELTA_LAMB_SP_PUC_DEC "limitation for DELTA_LAMB_SP_PUC decrease" VALUE 0x4287b _REC_VAL_20_u1 0.125 _CNV_A_R_LINEAR_____317_CM 0. 0.125 FORMAT "%5.3" /end CHARACTERISTIC
/begin CHARACTERISTIC IP_DELTA_LAMB_SP_PUC "basic value for lambda controller set point shift" MAP 0x4da57 _REC_MAP_20_u1_u2_u1 0.125 _CNV_A_R_LINEAR_____317_CM 0. 0.125 FORMAT "%5.3"
 /begin AXIS_DESCR COM_AXIS MAF_CYL _CNV_A_R_LINEAR_____101_CM 6 0. 2047.96875 FORMAT "%7.2" AXIS_PTS_REF ldp_maf_cyl /end AXIS_DESCR
 /begin AXIS_DESCR COM_AXIS QUO_MAF_INT_PURGE_1 _CNV_A_R_LINEAR_____44_CM 8 0. 0.996094 FORMAT "%5.3" AXIS_PTS_REF ldp_quo_maf_int_purge /end AXIS_DESCR
/end CHARACTERISTIC
/begin CHARACTERISTIC IP_MAF_INT_ACT_PUC "initial value for mass air flow integral for pre cat purge after PUC phase" CURVE 0x49052 _REC_CUR_20_u2_u2 1820.398 _CNV_A_R_LINEAR_____277_CM 0. 1820.398 FORMAT "%7.2"
 /begin AXIS_DESCR COM_AXIS MAF_INT_PUC _CNV_A_R_LINEAR_____277_CM 6 0. 1820.398 FORMAT "%7.2" AXIS_PTS_REF ldp_maf_int_puc /end AXIS_DESCR
/end CHARACTERISTIC
/begin CHARACTERISTIC IP_FAC_CAT_EFF_PUC "weighting factor for the lambda shift depending on the result of the catalyst diagnosis" MAP 0x4defd _REC_MAP_20_u1_u2_u1 0.9960940000000002 _CNV_A_R_LINEAR_____44_CM 0. 0.996094 FORMAT "%5.3"
 /begin AXIS_DESCR COM_AXIS ONLINE_DUMMY _CNV_A_R_LINEAR_____305_CM 6 -33. 990.984375 FORMAT "%6.2" AXIS_PTS_REF ldp_temp_pcat /end AXIS_DESCR
 /begin AXIS_DESCR COM_AXIS ONLINE_DUMMY _CNV_A_R_LINEAR_____141_CM 6 0. 1.984375 FORMAT "%4.2" AXIS_PTS_REF ldpm_cat_diag /end AXIS_DESCR
/end CHARACTERISTIC
/begin CHARACTERISTIC IP_FAC_PCAT_MAIN_CAT_PUC "basic value for lambda controller set point shift" MAP 0x4e2f3 _REC_MAP_20_u1_u2_u1 3.984375 _CNV_A_R_LINEAR_____195_CM 0. 3.984375 FORMAT "%4.2"
 /begin AXIS_DESCR COM_AXIS ONLINE_DUMMY _CNV_A_R_LINEAR_____305_CM 6 -33. 990.984375 FORMAT "%6.2" AXIS_PTS_REF ldp_temp_main_cat /end AXIS_DESCR
 /begin AXIS_DESCR COM_AXIS ONLINE_DUMMY _CNV_A_R_LINEAR_____141_CM 6 0. 1.984375 FORMAT "%4.2" AXIS_PTS_REF ldpm_cat_diag /end AXIS_DESCR
/end CHARACTERISTIC
/begin MEASUREMENT LV_VLS_DOWN_PUC_ACT_MAX_1 "logical indicating that downstream sensor signal is/was below calibration limit" UBYTE _CNV_S_2_RANGE______28_CM 1 100. 0. 1. ECU_ADDRESS 0x3fdc44 /end MEASUREMENT
/begin CHARACTERISTIC C_MAF_INT_ACT_PUC_MAX "upper limit for MAF_INT_ACT_PUC_i" VALUE 0x42e1e _REC_VAL_20_u2 1820.398 _CNV_A_R_LINEAR_____277_CM 0. 1820.398 FORMAT "%7.2" /end CHARACTERISTIC
/begin MEASUREMENT MAF_INT_SAMPLE_STEP_2 "Maf Integral to be added or subtracted each sample step" ULONG _CNV_A_R_LINEAR_____316_CM 1 100. 0. 1820.398 ECU_ADDRESS 0x3fdc54 FORMAT "%12.7" /end MEASUREMENT
/begin MEASUREMENT FAC_ADD_PCAT_MAIN_CAT_PUC_1 "additional weighting factor for IP_FAC_PCAT_MAIN_CAT_PUC" UBYTE _CNV_A_R_LINEAR_____195_CM 1 100. 0. 3.984375 ECU_ADDRESS 0x3fdc3c FORMAT "%4.2" /end MEASUREMENT
/begin MEASUREMENT FAC_ADD_PCAT_MAIN_CAT_PUC_2 "additional weighting factor for IP_FAC_PCAT_MAIN_CAT_PUC" UBYTE _CNV_A_R_LINEAR_____195_CM 1 100. 0. 3.984375 ECU_ADDRESS 0x3fdc60 FORMAT "%4.2" /end MEASUREMENT
/begin MEASUREMENT LV_ACT_INT_PUC_1 "state of the enrichment function for pre and main cat balancing" UBYTE _CNV_S_2_RANGE______28_CM 1 100. 0. 1. ECU_ADDRESS 0x3fcb99 /end MEASUREMENT
/begin MEASUREMENT LV_PUC_TRIG_1 "trigger bit for cat purge after PUC (needed if transition to LV_PUC = 0 but other condition are not yet fullfilled)" UBYTE _CNV_S_2_RANGE______28_CM 1 100. 0. 1. ECU_ADDRESS 0x3fdc43 /end MEASUREMENT
/begin MEASUREMENT LV_PUC_TRIG_2 "trigger bit for cat purge after PUC (needed if transition to LV_PUC = 0 but other condition are not yet fullfilled)" UBYTE _CNV_S_2_RANGE______28_CM 1 100. 0. 1. ECU_ADDRESS 0x3fdc66 /end MEASUREMENT
/begin MEASUREMENT MAF_INT_ACT_PUC_2 "value of the mass air flow integral for the function deactivation" ULONG _CNV_A_R_LINEAR_____316_CM 1 100. 0. 1820.398 ECU_ADDRESS 0x3fdc48 FORMAT "%12.7" /end MEASUREMENT
/begin MEASUREMENT MAF_INT_TOT_PURGE_1 "total MAF integral for pre and main cat purge" ULONG _CNV_A_R_LINEAR_____316_CM 1 100. 0. 1820.398 ECU_ADDRESS 0x3fdc38 FORMAT "%12.7" /end MEASUREMENT
/begin MEASUREMENT MAF_INT_TOT_PURGE_2 "total MAF integral for pre and main cat purge" ULONG _CNV_A_R_LINEAR_____316_CM 1 100. 0. 1820.398 ECU_ADDRESS 0x3fdc5c FORMAT "%12.7" /end MEASUREMENT
/begin MEASUREMENT QUO_MAF_INT_PURGE_1 "quotient: current MAF rest integral / total MAF integral" UBYTE _CNV_A_R_LINEAR_____44_CM 1 100. 0. 0.996094 ECU_ADDRESS 0x3fdc3d FORMAT "%5.3" /end MEASUREMENT
/begin MEASUREMENT QUO_MAF_INT_PURGE_2 "quotient: current MAF rest integral / total MAF integral" UBYTE _CNV_A_R_LINEAR_____44_CM 1 100. 0. 0.996094 ECU_ADDRESS 0x3fdc61 FORMAT "%5.3" /end MEASUREMENT
/begin AXIS_PTS ldp_maf_int_puc "" 0x4457e MAF_INT_PUC _REC_AXS_20_u2 1820.398 _CNV_A_R_LINEAR_____277_CM 6 0. 1820.398 FORMAT "%7.2" /end AXIS_PTS
/begin AXIS_PTS ldp_temp_main_cat "" 0x44b06 TEMP_MAIN_CAT _REC_AXS_20_u2 1023.984375 _CNV_A_R_LINEAR_____305_CM 6 -33. 990.984375 FORMAT "%6.2" /end AXIS_PTS
/begin AXIS_PTS ldp_maf_cyl "" 0x44504 MAF_CYL _REC_AXS_20_u2 2047.96875 _CNV_A_R_LINEAR_____101_CM 6 0. 2047.96875 FORMAT "%7.2" /end AXIS_PTS
/begin AXIS_PTS ldp_quo_maf_int_purge "" 0x437e1 QUO_MAF_INT_PURGE _REC_AXS_20_u1 0.9960940000000002 _CNV_A_R_LINEAR_____44_CM 8 0. 0.996094 FORMAT "%5.3" /end AXIS_PTS
/begin AXIS_PTS ldpm_cat_diag "" 0x43b78 CAT_DIAG _REC_AXS_20_u1 1.984375 _CNV_A_R_LINEAR_____141_CM 6 0. 1.984375 FORMAT "%4.2" /end AXIS_PTS
/begin AXIS_PTS ldp_temp_pcat "" 0x44b14 TEMP_PCAT _REC_AXS_20_u2 1023.984375 _CNV_A_R_LINEAR_____305_CM 6 -33. 990.984375 FORMAT "%6.2" /end AXIS_PTS
/begin CHARACTERISTIC C_TCO_THD_HST "temperature threshold for hot start" VALUE 0x42a8c _REC_VAL_20_u1 190.5 _CNV_A_R_LINEAR_____0_CM -48. 142.5 FORMAT "%5.1" /end CHARACTERISTIC
/begin CHARACTERISTIC C_QUO_MAF_INT_PUC_AFL "calibration MAF integral quotient for the that LV_ACT_INT_PUC_AFL_i is active" VALUE 0x4299b _REC_VAL_20_u1 0.99610001 _CNV_A_R_LINEAR_____20_CM 0. 0.99610001 FORMAT "%5.3" /end CHARACTERISTIC
/begin CHARACTERISTIC C_TCO_ACT_PUC_MIN "minimum TCO threshold for cat purge activation" VALUE 0x42a3c _REC_VAL_20_u1 190.5 _CNV_A_R_LINEAR_____0_CM -48. 142.5 FORMAT "%5.1" /end CHARACTERISTIC
/begin CHARACTERISTIC C_N_MAX_CAT_PURGE "maximum engine speed for cat purge" VALUE 0x4294f _REC_VAL_20_u1 8160. _CNV_A_R_LINEAR_____5_CM 0. 8160. FORMAT "%4.0" /end CHARACTERISTIC
/begin CHARACTERISTIC C_TEMP_DIF_PCAT_MAIN_CAT "temperature difference between pre and main cat" VALUE 0x43084 _REC_VAL_20_u2 1507.3 _CNV_A_R_LINEAR_____269_CM -48. 1459.3 FORMAT "%7.2" /end CHARACTERISTIC
/begin CHARACTERISTIC C_MAF_CYL_ACT_INT_PUC_MAX "maximum MAF_CYL threshold for active cat purge function" VALUE 0x42e06 _REC_VAL_20_u2 2047.96875 _CNV_A_R_LINEAR_____101_CM 0. 2047.96875 FORMAT "%7.2" /end CHARACTERISTIC
/begin CHARACTERISTIC C_THD_VLS_UP_CAT_PURGE "VLS_UP - threshold to inhibit cat purge function" VALUE 0x43092 _REC_VAL_20_u2 4.995 _CNV_A_R_LINEAR_____318_CM 0. 4.995 FORMAT "%5.3" /end CHARACTERISTIC
/begin CHARACTERISTIC C_THD_DELTA_LAMB_SP_PUC "DELTA_LAMB_SP_PUC - threshold to inhibit cat purge function" VALUE 0x42a9d _REC_VAL_20_u1 0.125 _CNV_A_R_LINEAR_____317_CM 0. 0.125 FORMAT "%5.3" /end CHARACTERISTIC
/begin CHARACTERISTIC LC_LSH_DOWN_1 "Boolean variable to enable oxygen sensor heating" VALUE 0x42bac _REC_VAL_20_u1 1. _CNV_A_R_LINEAR_____12_CM 0. 1. FORMAT "%1.0" /end CHARACTERISTIC
/begin CHARACTERISTIC LC_LSH_DOWN_2 "Boolean variable to enable oxygen sensor heating" VALUE 0x42bad _REC_VAL_20_u1 1. _CNV_A_R_LINEAR_____12_CM 0. 1. FORMAT "%1.0" /end CHARACTERISTIC
/begin MEASUREMENT TEG_STAT_ENG_UP_1 "Exhaust temp. pre-control pre catalyst" UWORD _CNV_A_R_LINEAR_____269_CM 1 100. -48. 1459.3 ECU_ADDRESS 0x3fde80 FORMAT "%7.2" /end MEASUREMENT
/begin MEASUREMENT TEG_COR_EFF_IGA_UP_1 "Temp. correction power loss by ignition angle difference" UWORD _CNV_A_R_LINEAR_____412_CM 1 100. 0. 983.025 ECU_ADDRESS 0x3fde86 FORMAT "%6.2" /end MEASUREMENT
/begin MEASUREMENT TEG_STAT_BAS_UP_1 "Exhaust temp. based on load level pre-control pre catalyst" UWORD _CNV_A_R_LINEAR_____269_CM 1 100. -48. 1459.3 ECU_ADDRESS 0x3fde84 FORMAT "%7.2" /end MEASUREMENT
/begin MEASUREMENT EFF_IGA_AV_TEG_COR_1 "Reference ignition angle for   temperature" UWORD _CNV_A_R_LINEAR_____45_CM 1 100. 0. 1.99996948 ECU_ADDRESS 0x3fde8e FORMAT "%7.5" /end MEASUREMENT
/begin MEASUREMENT FAC_SCC_TEG_1 "Multipicative Single cylinder shut off correction" UWORD _CNV_A_R_LINEAR_____31_CM 1 100. 0. 0.99998474 ECU_ADDRESS 0x3fde8a FORMAT "%7.5" /end MEASUREMENT
/begin MEASUREMENT FAC_COR_LAMB_SP_TEG_UP_1 "Lambda set -point correction" UWORD _CNV_A_R_LINEAR_____45_CM 1 100. 0. 1.99996948 ECU_ADDRESS 0x3fde8c FORMAT "%7.5" /end MEASUREMENT
/begin MEASUREMENT TEG_STAT_UP_1 "Pre control exhaust temperature  pre catalyst" UWORD _CNV_A_R_LINEAR_____269_CM 1 100. -48. 1459.3 ECU_ADDRESS 0x3fde90 FORMAT "%7.2" /end MEASUREMENT
/begin MEASUREMENT TAM_REF_TEG_UP_1 "Reference ambient temperature for TEG model" UWORD _CNV_A_R_LINEAR_____269_CM 1 100. -48. 1459.3 ECU_ADDRESS 0x3fde92 FORMAT "%7.2" /end MEASUREMENT
/begin MEASUREMENT TEG_CAT_UP_MDL_1_BAS "Model of exhaust temperature pre catalyst" UWORD _CNV_A_R_LINEAR_____269_CM 1 100. -48. 1459.3 ECU_ADDRESS 0x3fde9c FORMAT "%7.2" /end MEASUREMENT
/begin MEASUREMENT TEG_DIF_UP_1 "Difference between steady to model temperature pre catalyst" UWORD _CNV_A_R_LINEAR_____413_CM 1 100. -1507.328 1507.282 ECU_ADDRESS 0x3fde9e FORMAT "%8.2" /end MEASUREMENT
/begin MEASUREMENT TEG_CAT_UP_MDL_STOP_1 "Model of exhaust temperature pre catalyst" UWORD _CNV_A_R_LINEAR_____269_CM 1 100. -48. 1459.3 ECU_ADDRESS 0x3fdeb8 FORMAT "%7.2" /end MEASUREMENT
/begin MEASUREMENT CRLC_TEG_GRAD_UP_1 "Exhaust Temperature gradient" UWORD _CNV_A_R_LINEAR_____348_CM 1 100. 0. 7.99987793 ECU_ADDRESS 0x3fdea0 FORMAT "%6.4" /end MEASUREMENT
/begin MEASUREMENT CRLC_TEG_LEVEL_UP_1 "Exhaust temperature level" UWORD _CNV_A_R_LINEAR_____348_CM 1 100. 0. 7.99987793 ECU_ADDRESS 0x3fdea2 FORMAT "%6.4" /end MEASUREMENT
/begin MEASUREMENT CRLC_TEG_UP_1 "Entire correlation constant of TEG dynamic change limitation" UWORD _CNV_A_R_LINEAR_____31_CM 1 100. 0. 0.99998474 ECU_ADDRESS 0x3fdea6 FORMAT "%7.5" /end MEASUREMENT
/begin MEASUREMENT CRLC_TEG_TOIL_TCO_UP_1 "Corelation constant received at TCO TOIL calculation" UWORD _CNV_A_R_LINEAR_____31_CM 1 100. 0. 0.99998474 ECU_ADDRESS 0x3fdea8 FORMAT "%7.5" /end MEASUREMENT
/begin MEASUREMENT CRLC_TEG_EGY_UP_1 "Corelation constant received at energy calculation" UWORD _CNV_A_R_LINEAR_____31_CM 1 100. 0. 0.99998474 ECU_ADDRESS 0x3fdeaa FORMAT "%7.5" /end MEASUREMENT
/begin MEASUREMENT EGY_TEG_END_SP_UP_1 "Energy setpoint  for Temperature Model beginning from start" ULONG _CNV_A_R_LINEAR_____414_CM 1 100. 0. 7456.426 ECU_ADDRESS 0x3fdeb0 FORMAT "%12.7" /end MEASUREMENT
/begin MEASUREMENT EGY_TEG_END_AV_UP_1 "Actual value Energy for Temperature Model beginning from start" ULONG _CNV_A_R_LINEAR_____414_CM 1 100. 0. 7456.426 ECU_ADDRESS 0x3fdeb4 FORMAT "%12.7" /end MEASUREMENT
/begin MEASUREMENT LV_TEG_AST_UP_1 "Temperature model after start condition" UBYTE _CNV_S_2_RANGE______11_CM 1 100. 0. 1. ECU_ADDRESS 0x3fdeac /end MEASUREMENT
/begin MEASUREMENT CRLC_TEG_BAS_UP_1 "Entire correlation constant of TEG dynamic change limitation" UWORD _CNV_A_R_LINEAR_____31_CM 1 100. 0. 0.99998474 ECU_ADDRESS 0x3fdea4 FORMAT "%7.5" /end MEASUREMENT
/begin MEASUREMENT TEG_ADD_EGR_UP_1 "EGR influence temperature" UWORD _CNV_A_R_LINEAR_____415_CM 1 100. -491.52 491.505 ECU_ADDRESS 0x3fde82 FORMAT "%7.2" /end MEASUREMENT
/begin MEASUREMENT TEG_COR_VEH_UP_1 "Entire vehicle influences correction" SWORD _CNV_A_R_LINEAR_____416_CM 1 100. -491.519999999553 491.5 ECU_ADDRESS 0x3fde94 FORMAT "%7.2" /end MEASUREMENT
/begin MEASUREMENT TEG_COR_TCO_EX_UP_1 "Cooling temperature outlet correction" SWORD _CNV_A_R_LINEAR_____417_CM 1 100. -202. 202. ECU_ADDRESS 0x3fde98 FORMAT "%7.3" /end MEASUREMENT
/begin MEASUREMENT FAC_COR_VS_TEG_UP_1 "Vehicle speed correction" SWORD _CNV_A_R_LINEAR_____272_CM 1 100. -2. 1.999938965 ECU_ADDRESS 0x3fde96 FORMAT "%8.4" /end MEASUREMENT
/begin MEASUREMENT TEG_SCC_TCO_UP_1 "Additive single cyl. shut off temp. correction" UBYTE _CNV_A_R_LINEAR_____0_CM 1 100. -48. 142.5 ECU_ADDRESS 0x3fde88 FORMAT "%5.1" /end MEASUREMENT
/begin MEASUREMENT VS_COR_ECF_TEG_UP_1 "Electric cooling fan correction" UBYTE _CNV_A_R_LINEAR_____13_CM 1 100. 0. 255. ECU_ADDRESS 0x3fde9a FORMAT "%3.0" /end MEASUREMENT
/begin MEASUREMENT VS_COR_TEG_UP_1 "VS temperature correction" UBYTE _CNV_A_R_LINEAR_____13_CM 1 100. 0. 255. ECU_ADDRESS 0x3fde9b FORMAT "%3.0" /end MEASUREMENT
/begin MEASUREMENT TEG_STAT_ENG_DOWN_1 "Exhaust temp. pre-control pre catalyst" UWORD _CNV_A_R_LINEAR_____269_CM 1 100. -48. 1459.3 ECU_ADDRESS 0x3fdec0 FORMAT "%7.2" /end MEASUREMENT
/begin MEASUREMENT TEG_STAT_BAS_DOWN_1 "Exhaust temp. based on load level pre-control pre catalyst" UWORD _CNV_A_R_LINEAR_____269_CM 1 100. -48. 1459.3 ECU_ADDRESS 0x3fdec2 FORMAT "%7.2" /end MEASUREMENT
/begin MEASUREMENT FAC_COR_LAMB_SP_TEG_DOWN_1 "Lambda set -point correction" UWORD _CNV_A_R_LINEAR_____45_CM 1 100. 0. 1.99996948 ECU_ADDRESS 0x3fdec6 FORMAT "%7.5" /end MEASUREMENT
/begin MEASUREMENT TEG_STAT_DOWN_1 "Pre control exhaust temperature  pre catalyst" UWORD _CNV_A_R_LINEAR_____269_CM 1 100. -48. 1459.3 ECU_ADDRESS 0x3fdeca FORMAT "%7.2" /end MEASUREMENT
/begin MEASUREMENT TAM_REF_TEG_DOWN_1 "Reference ambient temperature for TEG model" UWORD _CNV_A_R_LINEAR_____269_CM 1 100. -48. 1459.3 ECU_ADDRESS 0x3fdecc FORMAT "%7.2" /end MEASUREMENT
/begin MEASUREMENT TEG_CAT_DOWN_MDL_1_BAS "Model of exhaust temperature pre catalyst" UWORD _CNV_A_R_LINEAR_____269_CM 1 100. -48. 1459.3 ECU_ADDRESS 0x3fded6 FORMAT "%7.2" /end MEASUREMENT
/begin MEASUREMENT TEG_DIF_DOWN_1 "Difference between steady to model temperature pre catalyst" UWORD _CNV_A_R_LINEAR_____413_CM 1 100. -1507.328 1507.282 ECU_ADDRESS 0x3fded8 FORMAT "%8.2" /end MEASUREMENT
/begin MEASUREMENT TEG_CAT_DOWN_MDL_STOP_1 "Model of exhaust temperature pre catalyst" UWORD _CNV_A_R_LINEAR_____269_CM 1 100. -48. 1459.3 ECU_ADDRESS 0x3fdef0 FORMAT "%7.2" /end MEASUREMENT
/begin MEASUREMENT CRLC_TEG_GRAD_DOWN_1 "Exhaust Temperature gradient" UWORD _CNV_A_R_LINEAR_____348_CM 1 100. 0. 7.99987793 ECU_ADDRESS 0x3fdeda FORMAT "%6.4" /end MEASUREMENT
/begin MEASUREMENT CRLC_TEG_LEVEL_DOWN_1 "Exhaust temperature level" UWORD _CNV_A_R_LINEAR_____348_CM 1 100. 0. 7.99987793 ECU_ADDRESS 0x3fdedc FORMAT "%6.4" /end MEASUREMENT
/begin MEASUREMENT CRLC_TEG_DOWN_1 "Entire correlation constant of TEG dynamic change limitation" UWORD _CNV_A_R_LINEAR_____31_CM 1 100. 0. 0.99998474 ECU_ADDRESS 0x3fdee0 FORMAT "%7.5" /end MEASUREMENT
/begin MEASUREMENT CRLC_TEG_TOIL_TCO_DOWN_1 "Corelation constant received at TCO TOIL calculation" UWORD _CNV_A_R_LINEAR_____31_CM 1 100. 0. 0.99998474 ECU_ADDRESS 0x3fdee2 FORMAT "%7.5" /end MEASUREMENT
/begin MEASUREMENT CRLC_TEG_EGY_DOWN_1 "Corelation constant received at energy calculation" UWORD _CNV_A_R_LINEAR_____31_CM 1 100. 0. 0.99998474 ECU_ADDRESS 0x3fdee4 FORMAT "%7.5" /end MEASUREMENT
/begin MEASUREMENT EGY_TEG_END_SP_DOWN_1 "Energy setpoint  for Temperature Model beginning from start" ULONG _CNV_A_R_LINEAR_____414_CM 1 100. 0. 7456.426 ECU_ADDRESS 0x3fdee8 FORMAT "%12.7" /end MEASUREMENT
/begin MEASUREMENT EGY_TEG_END_AV_DOWN_1 "Actual value Energy for Temperature Model beginning from start" ULONG _CNV_A_R_LINEAR_____414_CM 1 100. 0. 7456.426 ECU_ADDRESS 0x3fdeec FORMAT "%12.7" /end MEASUREMENT
/begin MEASUREMENT LV_TEG_AST_DOWN_1 "Temperature model after start condition" UBYTE _CNV_S_2_RANGE______11_CM 1 100. 0. 1. ECU_ADDRESS 0x3fdee6 /end MEASUREMENT
/begin MEASUREMENT CRLC_TEG_BAS_DOWN_1 "Entire correlation constant of TEG dynamic change limitation" UWORD _CNV_A_R_LINEAR_____31_CM 1 100. 0. 0.99998474 ECU_ADDRESS 0x3fdede FORMAT "%7.5" /end MEASUREMENT
/begin MEASUREMENT TEG_COR_EFF_IGA_DOWN_1 "Temp. correction power loss by ignition angle difference" UWORD _CNV_A_R_LINEAR_____412_CM 1 100. 0. 983.025 ECU_ADDRESS 0x3fdec4 FORMAT "%6.2" /end MEASUREMENT
/begin MEASUREMENT TEG_SCC_TCO_DOWN_1 "Additive Single cylinder shut off temp. correction" UBYTE _CNV_A_R_LINEAR_____0_CM 1 100. -48. 142.5 ECU_ADDRESS 0x3fdec8 FORMAT "%5.1" /end MEASUREMENT
/begin MEASUREMENT TEG_COR_VEH_DOWN_1 "Entire vehicle influences correction" SWORD _CNV_A_R_LINEAR_____416_CM 1 100. -491.519999999553 491.5 ECU_ADDRESS 0x3fdece FORMAT "%7.2" /end MEASUREMENT
/begin MEASUREMENT FAC_COR_VS_TEG_DOWN_1 "Vehicle speed correction" SWORD _CNV_A_R_LINEAR_____272_CM 1 100. -2. 1.999938965 ECU_ADDRESS 0x3fded0 FORMAT "%8.4" /end MEASUREMENT
/begin MEASUREMENT TEG_COR_TCO_EX_DOWN_1 "Cooling temperature outlet correction" SWORD _CNV_A_R_LINEAR_____417_CM 1 100. -202. 202. ECU_ADDRESS 0x3fded2 FORMAT "%7.3" /end MEASUREMENT
/begin MEASUREMENT VS_COR_ECF_TEG_DOWN_1 "Vehicle speed correction ecf" UBYTE _CNV_A_R_LINEAR_____13_CM 1 100. 0. 255. ECU_ADDRESS 0x3fded4 FORMAT "%3.0" /end MEASUREMENT
/begin MEASUREMENT VS_COR_TEG_DOWN_1 "Vehicle speed correction" UBYTE _CNV_A_R_LINEAR_____13_CM 1 100. 0. 255. ECU_ADDRESS 0x3fded5 FORMAT "%3.0" /end MEASUREMENT
/begin MEASUREMENT TEG_WALL_STAT_BAS_UP_1 "Exhaust temp. based on load level pre-control pre catalyst" UWORD _CNV_A_R_LINEAR_____269_CM 1 100. -48. 1459.3 ECU_ADDRESS 0x3fdefa FORMAT "%7.2" /end MEASUREMENT
/begin MEASUREMENT FAC_SCC_TEG_WALL_1 "Multipicative Single cylinder shut off correction" UWORD _CNV_A_R_LINEAR_____31_CM 1 100. 0. 0.99998474 ECU_ADDRESS 0x3fdf00 FORMAT "%7.5" /end MEASUREMENT
/begin MEASUREMENT FAC_COR_LAMB_SP_TEG_WALL_UP_1 "Lambda set -point correction" UWORD _CNV_A_R_LINEAR_____45_CM 1 100. 0. 1.99996948 ECU_ADDRESS 0x3fdf02 FORMAT "%7.5" /end MEASUREMENT
/begin MEASUREMENT TEG_WALL_STAT_UP_1 "Pre control exhaust temperature  pre catalyst" UWORD _CNV_A_R_LINEAR_____269_CM 1 100. -48. 1459.3 ECU_ADDRESS 0x3fdf04 FORMAT "%7.2" /end MEASUREMENT
/begin MEASUREMENT TAM_REF_TEG_WALL_UP_1 "Reference ambient temperature for TEG_WALL model" UWORD _CNV_A_R_LINEAR_____269_CM 1 100. -48. 1459.3 ECU_ADDRESS 0x3fdf06 FORMAT "%7.2" /end MEASUREMENT
/begin MEASUREMENT TEG_WALL_CAT_UP_MDL_1 "Model of exhaust temperature pre catalyst" UWORD _CNV_A_R_LINEAR_____269_CM 1 100. -48. 1459.3 ECU_ADDRESS 0x3fdf10 FORMAT "%7.2" /end MEASUREMENT
/begin MEASUREMENT TEG_WALL_DIF_UP_1 "Difference between steady to model temperature pre catalyst" UWORD _CNV_A_R_LINEAR_____413_CM 1 100. -1507.328 1507.282 ECU_ADDRESS 0x3fdf12 FORMAT "%8.2" /end MEASUREMENT
/begin MEASUREMENT TEG_WALL_CAT_UP_MDL_STOP_1 "Model of exhaust temperature pre catalyst" UWORD _CNV_A_R_LINEAR_____269_CM 1 100. -48. 1459.3 ECU_ADDRESS 0x3fdf24 FORMAT "%7.2" /end MEASUREMENT
/begin MEASUREMENT CRLC_TEG_WALL_UP_1 "Entire correlation constant of TEG_WALL dynamic change limitation" UWORD _CNV_A_R_LINEAR_____31_CM 1 100. 0. 0.99998474 ECU_ADDRESS 0x3fdf16 FORMAT "%7.5" /end MEASUREMENT
/begin MEASUREMENT CRLC_TEG_WALL_TOIL_TCO_UP_1 "Corelation constant received at TCO TOIL calculation" UWORD _CNV_A_R_LINEAR_____31_CM 1 100. 0. 0.99998474 ECU_ADDRESS 0x3fdf18 FORMAT "%7.5" /end MEASUREMENT
/begin MEASUREMENT CRLC_TEG_WALL_EGY_UP_1 "Corelation constant received at energy calculation" UWORD _CNV_A_R_LINEAR_____31_CM 1 100. 0. 0.99998474 ECU_ADDRESS 0x3fdf1a FORMAT "%7.5" /end MEASUREMENT
/begin MEASUREMENT EGY_TEG_WALL_END_SP_UP_1 "Energy setpoint  for Temperature Model beginning from start" ULONG _CNV_A_R_LINEAR_____414_CM 1 100. 0. 7456.426 ECU_ADDRESS 0x3fdf1c FORMAT "%12.7" /end MEASUREMENT
/begin MEASUREMENT EGY_TEG_WALL_END_AV_UP_1 "Actual value Energy for Temperature Model beginning from start" ULONG _CNV_A_R_LINEAR_____414_CM 1 100. 0. 7456.426 ECU_ADDRESS 0x3fdf20 FORMAT "%12.7" /end MEASUREMENT
/begin MEASUREMENT CRLC_TEG_WALL_BAS_UP_1 "Entire correlation constant of TEG_WALL dynamic change limitation" UWORD _CNV_A_R_LINEAR_____31_CM 1 100. 0. 0.99998474 ECU_ADDRESS 0x3fdf14 FORMAT "%7.5" /end MEASUREMENT
/begin MEASUREMENT TEG_WALL_STAT_ENG_UP_1 "" UWORD _CNV_A_R_LINEAR_____269_CM 1 100. -48. 1459.3 ECU_ADDRESS 0x3fdef8 FORMAT "%7.2" /end MEASUREMENT
/begin MEASUREMENT TEG_WALL_COR_EFF_IGA_UP_1 "Temp. correction power loss by ignition angle difference" UWORD _CNV_A_R_LINEAR_____412_CM 1 100. 0. 983.025 ECU_ADDRESS 0x3fdefc FORMAT "%6.2" /end MEASUREMENT
/begin MEASUREMENT TEG_WALL_SCC_TCO_UP_1 "Additive Single cylinder shut off temp. correction" UBYTE _CNV_A_R_LINEAR_____0_CM 1 100. -48. 142.5 ECU_ADDRESS 0x3fdefe FORMAT "%5.1" /end MEASUREMENT
/begin MEASUREMENT TEG_WALL_COR_VEH_UP_1 "Entire vehicle influences correction" SWORD _CNV_A_R_LINEAR_____416_CM 1 100. -491.519999999553 491.5 ECU_ADDRESS 0x3fdf08 FORMAT "%7.2" /end MEASUREMENT
/begin MEASUREMENT FAC_COR_VS_TEG_WALL_UP_1 "Vehicle speed correction" SWORD _CNV_A_R_LINEAR_____272_CM 1 100. -2. 1.999938965 ECU_ADDRESS 0x3fdf0a FORMAT "%8.4" /end MEASUREMENT
/begin MEASUREMENT TEG_WALL_COR_TCO_EX_UP_1 "Cooling temperature outlet correction" SWORD _CNV_A_R_LINEAR_____417_CM 1 100. -202. 202. ECU_ADDRESS 0x3fdf0c FORMAT "%7.3" /end MEASUREMENT
/begin MEASUREMENT VS_COR_ECF_TEG_WALL_UP_1 "Vehicle speed correction ecf" UBYTE _CNV_A_R_LINEAR_____13_CM 1 100. 0. 255. ECU_ADDRESS 0x3fdf0e FORMAT "%3.0" /end MEASUREMENT
/begin MEASUREMENT VS_COR_TEG_WALL_UP_1 "Vehicle speed correction" UBYTE _CNV_A_R_LINEAR_____13_CM 1 100. 0. 255. ECU_ADDRESS 0x3fdf0f FORMAT "%3.0" /end MEASUREMENT
/begin MEASUREMENT TEG_WALL_STAT_ENG_DOWN_1 "Exhaust temp. pre-control pre catalyst" UWORD _CNV_A_R_LINEAR_____269_CM 1 100. -48. 1459.3 ECU_ADDRESS 0x3fdf2c FORMAT "%7.2" /end MEASUREMENT
/begin MEASUREMENT TEG_WALL_STAT_BAS_DOWN_1 "Exhaust temp. based on load level pre-control pre catalyst" UWORD _CNV_A_R_LINEAR_____269_CM 1 100. -48. 1459.3 ECU_ADDRESS 0x3fdf2e FORMAT "%7.2" /end MEASUREMENT
/begin MEASUREMENT FAC_COR_LAMB_SP_TEG_WALL_DOWN_1 "Lambda set -point correction" UWORD _CNV_A_R_LINEAR_____45_CM 1 100. 0. 1.99996948 ECU_ADDRESS 0x3fdf32 FORMAT "%7.5" /end MEASUREMENT
/begin MEASUREMENT TEG_WALL_STAT_DOWN_1 "Pre control exhaust temperature  pre catalyst" UWORD _CNV_A_R_LINEAR_____269_CM 1 100. -48. 1459.3 ECU_ADDRESS 0x3fdf36 FORMAT "%7.2" /end MEASUREMENT
/begin MEASUREMENT TAM_REF_TEG_WALL_DOWN_1 "Reference ambient temperature for TEG_WALL model" UWORD _CNV_A_R_LINEAR_____269_CM 1 100. -48. 1459.3 ECU_ADDRESS 0x3fdf38 FORMAT "%7.2" /end MEASUREMENT
/begin MEASUREMENT TEG_WALL_CAT_DOWN_MDL_1 "Model of exhaust temperature pre catalyst" UWORD _CNV_A_R_LINEAR_____269_CM 1 100. -48. 1459.3 ECU_ADDRESS 0x3fdf42 FORMAT "%7.2" /end MEASUREMENT
/begin MEASUREMENT TEG_WALL_DIF_DOWN_1 "Difference between steady to model temperature pre catalyst" UWORD _CNV_A_R_LINEAR_____413_CM 1 100. -1507.328 1507.282 ECU_ADDRESS 0x3fdf44 FORMAT "%8.2" /end MEASUREMENT
/begin MEASUREMENT TEG_WALL_CAT_DOWN_MDL_STOP_1 "Model of exhaust temperature pre catalyst" UWORD _CNV_A_R_LINEAR_____269_CM 1 100. -48. 1459.3 ECU_ADDRESS 0x3fdf58 FORMAT "%7.2" /end MEASUREMENT
/begin MEASUREMENT CRLC_TEG_WALL_DOWN_1 "Entire correlation constant of TEG_WALL dynamic change limitation" UWORD _CNV_A_R_LINEAR_____31_CM 1 100. 0. 0.99998474 ECU_ADDRESS 0x3fdf48 FORMAT "%7.5" /end MEASUREMENT
/begin MEASUREMENT CRLC_TEG_WALL_TOIL_TCO_DOWN_1 "Corelation constant received at TCO TOIL calculation" UWORD _CNV_A_R_LINEAR_____31_CM 1 100. 0. 0.99998474 ECU_ADDRESS 0x3fdf4a FORMAT "%7.5" /end MEASUREMENT
/begin MEASUREMENT CRLC_TEG_WALL_EGY_DOWN_1 "Corelation constant received at energy calculation" UWORD _CNV_A_R_LINEAR_____31_CM 1 100. 0. 0.99998474 ECU_ADDRESS 0x3fdf4c FORMAT "%7.5" /end MEASUREMENT
/begin MEASUREMENT EGY_TEG_WALL_END_SP_DOWN_1 "Energy setpoint  for Temperature Model beginning from start" ULONG _CNV_A_R_LINEAR_____414_CM 1 100. 0. 7456.426 ECU_ADDRESS 0x3fdf50 FORMAT "%12.7" /end MEASUREMENT
/begin MEASUREMENT EGY_TEG_WALL_END_AV_DOWN_1 "Actual value Energy for Temperature Model beginning from start" ULONG _CNV_A_R_LINEAR_____414_CM 1 100. 0. 7456.426 ECU_ADDRESS 0x3fdf54 FORMAT "%12.7" /end MEASUREMENT
/begin MEASUREMENT CRLC_TEG_WALL_BAS_DOWN_1 "" UWORD _CNV_A_R_LINEAR_____31_CM 1 100. 0. 0.99998474 ECU_ADDRESS 0x3fdf46 FORMAT "%7.5" /end MEASUREMENT
/begin MEASUREMENT TEG_WALL_COR_EFF_IGA_DOWN_1 "Temp. correction power loss by ignition angle difference" UWORD _CNV_A_R_LINEAR_____412_CM 1 100. 0. 983.025 ECU_ADDRESS 0x3fdf30 FORMAT "%6.2" /end MEASUREMENT
/begin MEASUREMENT TEG_WALL_SCC_TCO_DOWN_1 "Additive Single cylinder shut off temp. correction" UBYTE _CNV_A_R_LINEAR_____0_CM 1 100. -48. 142.5 ECU_ADDRESS 0x3fdf34 FORMAT "%5.1" /end MEASUREMENT
/begin MEASUREMENT TEG_WALL_COR_VEH_DOWN_1 "Entire vehicle influences correction" SWORD _CNV_A_R_LINEAR_____416_CM 1 100. -491.519999999553 491.5 ECU_ADDRESS 0x3fdf3a FORMAT "%7.2" /end MEASUREMENT
/begin MEASUREMENT FAC_COR_VS_TEG_WALL_DOWN_1 "Vehicle speed correction" SWORD _CNV_A_R_LINEAR_____272_CM 1 100. -2. 1.999938965 ECU_ADDRESS 0x3fdf3c FORMAT "%8.4" /end MEASUREMENT
/begin MEASUREMENT TEG_WALL_COR_TCO_EX_DOWN_1 "Cooling temperature outlet correction" SWORD _CNV_A_R_LINEAR_____417_CM 1 100. -202. 202. ECU_ADDRESS 0x3fdf3e FORMAT "%7.3" /end MEASUREMENT
/begin MEASUREMENT VS_COR_ECF_TEG_WALL_DOWN_1 "Vehicle speed correction ecf" UBYTE _CNV_A_R_LINEAR_____13_CM 1 100. 0. 255. ECU_ADDRESS 0x3fdf40 FORMAT "%3.0" /end MEASUREMENT
/begin MEASUREMENT VS_COR_TEG_WALL_DOWN_1 "Vehicle speed correction" UBYTE _CNV_A_R_LINEAR_____13_CM 1 100. 0. 255. ECU_ADDRESS 0x3fdf41 FORMAT "%3.0" /end MEASUREMENT
/begin MEASUREMENT LV_TEG_MIN_THD_1 "dew point has been reached" UBYTE _CNV_S_2_RANGE______28_CM 1 100. 0. 1. ECU_ADDRESS 0x3fdf60 /end MEASUREMENT
/begin MEASUREMENT LV_TEG_CAT_DOWN_MIN_THD_1 "dew point has been reached bat and pre/post cat. specific" UBYTE _CNV_S_2_RANGE______28_CM 1 100. 0. 1. ECU_ADDRESS 0x3fdf62 /end MEASUREMENT
/begin MEASUREMENT LV_TEG_CAT_UP_MIN_THD_1 "dew point has been reached bat and pre/post cat. specific" UBYTE _CNV_S_2_RANGE______28_CM 1 100. 0. 1. ECU_ADDRESS 0x3fdf61 /end MEASUREMENT
/begin MEASUREMENT TEG_STAT_ENG_UP_2 "Exhaust temp. pre-control pre catalyst" UWORD _CNV_A_R_LINEAR_____269_CM 1 100. -48. 1459.3 ECU_ADDRESS 0x3fdf7c FORMAT "%7.2" /end MEASUREMENT
/begin MEASUREMENT TEG_COR_EFF_IGA_UP_2 "Temp. correction power loss by ignition angle difference" UWORD _CNV_A_R_LINEAR_____412_CM 1 100. 0. 983.025 ECU_ADDRESS 0x3fdf82 FORMAT "%6.2" /end MEASUREMENT
/begin MEASUREMENT TEG_STAT_BAS_UP_2 "Exhaust temp. based on load level pre-control pre catalyst" UWORD _CNV_A_R_LINEAR_____269_CM 1 100. -48. 1459.3 ECU_ADDRESS 0x3fdf80 FORMAT "%7.2" /end MEASUREMENT
/begin MEASUREMENT EFF_IGA_AV_TEG_COR_2 "Reference ignition angle for   temperature" UWORD _CNV_A_R_LINEAR_____45_CM 1 100. 0. 1.99996948 ECU_ADDRESS 0x3fdf8a FORMAT "%7.5" /end MEASUREMENT
/begin MEASUREMENT FAC_SCC_TEG_2 "Multipicative Single cylinder shut off correction" UWORD _CNV_A_R_LINEAR_____31_CM 1 100. 0. 0.99998474 ECU_ADDRESS 0x3fdf86 FORMAT "%7.5" /end MEASUREMENT
/begin MEASUREMENT FAC_COR_LAMB_SP_TEG_UP_2 "Lambda set -point correction" UWORD _CNV_A_R_LINEAR_____45_CM 1 100. 0. 1.99996948 ECU_ADDRESS 0x3fdf88 FORMAT "%7.5" /end MEASUREMENT
/begin MEASUREMENT TEG_STAT_UP_2 "Pre control exhaust temperature  pre catalyst" UWORD _CNV_A_R_LINEAR_____269_CM 1 100. -48. 1459.3 ECU_ADDRESS 0x3fdf8c FORMAT "%7.2" /end MEASUREMENT
/begin MEASUREMENT TAM_REF_TEG_UP_2 "Reference ambient temperature for TEG model" UWORD _CNV_A_R_LINEAR_____269_CM 1 100. -48. 1459.3 ECU_ADDRESS 0x3fdf8e FORMAT "%7.2" /end MEASUREMENT
/begin MEASUREMENT TEG_CAT_UP_MDL_2_BAS "Model of exhaust temperature pre catalyst" UWORD _CNV_A_R_LINEAR_____269_CM 1 100. -48. 1459.3 ECU_ADDRESS 0x3fdf98 FORMAT "%7.2" /end MEASUREMENT
/begin MEASUREMENT TEG_DIF_UP_2 "Difference between steady to model temperature pre catalyst" UWORD _CNV_A_R_LINEAR_____413_CM 1 100. -1507.328 1507.282 ECU_ADDRESS 0x3fdf9a FORMAT "%8.2" /end MEASUREMENT
/begin MEASUREMENT TEG_CAT_UP_MDL_STOP_2 "Model of exhaust temperature pre catalyst" UWORD _CNV_A_R_LINEAR_____269_CM 1 100. -48. 1459.3 ECU_ADDRESS 0x3fdfb4 FORMAT "%7.2" /end MEASUREMENT
/begin MEASUREMENT CRLC_TEG_GRAD_UP_2 "Exhaust Temperature gradient" UWORD _CNV_A_R_LINEAR_____348_CM 1 100. 0. 7.99987793 ECU_ADDRESS 0x3fdf9c FORMAT "%6.4" /end MEASUREMENT
/begin MEASUREMENT CRLC_TEG_LEVEL_UP_2 "Exhaust temperature level" UWORD _CNV_A_R_LINEAR_____348_CM 1 100. 0. 7.99987793 ECU_ADDRESS 0x3fdf9e FORMAT "%6.4" /end MEASUREMENT
/begin MEASUREMENT CRLC_TEG_UP_2 "Entire correlation constant of TEG dynamic change limitation" UWORD _CNV_A_R_LINEAR_____31_CM 1 100. 0. 0.99998474 ECU_ADDRESS 0x3fdfa2 FORMAT "%7.5" /end MEASUREMENT
/begin MEASUREMENT CRLC_TEG_TOIL_TCO_UP_2 "Corelation constant received at TCO TOIL calculation" UWORD _CNV_A_R_LINEAR_____31_CM 1 100. 0. 0.99998474 ECU_ADDRESS 0x3fdfa4 FORMAT "%7.5" /end MEASUREMENT
/begin MEASUREMENT CRLC_TEG_EGY_UP_2 "Corelation constant received at energy calculation" UWORD _CNV_A_R_LINEAR_____31_CM 1 100. 0. 0.99998474 ECU_ADDRESS 0x3fdfa6 FORMAT "%7.5" /end MEASUREMENT
/begin MEASUREMENT EGY_TEG_END_SP_UP_2 "Energy setpoint  for Temperature Model beginning from start" ULONG _CNV_A_R_LINEAR_____414_CM 1 100. 0. 7456.426 ECU_ADDRESS 0x3fdfac FORMAT "%12.7" /end MEASUREMENT
/begin MEASUREMENT EGY_TEG_END_AV_UP_2 "Actual value Energy for Temperature Model beginning from start" ULONG _CNV_A_R_LINEAR_____414_CM 1 100. 0. 7456.426 ECU_ADDRESS 0x3fdfb0 FORMAT "%12.7" /end MEASUREMENT
/begin MEASUREMENT LV_TEG_AST_UP_2 "Temperature model after start condition" UBYTE _CNV_S_2_RANGE______11_CM 1 100. 0. 1. ECU_ADDRESS 0x3fdfa8 /end MEASUREMENT
/begin MEASUREMENT CRLC_TEG_BAS_UP_2 "Entire correlation constant of TEG dynamic change limitation" UWORD _CNV_A_R_LINEAR_____31_CM 1 100. 0. 0.99998474 ECU_ADDRESS 0x3fdfa0 FORMAT "%7.5" /end MEASUREMENT
/begin MEASUREMENT TEG_ADD_EGR_UP_2 "EGR influence temperature" UWORD _CNV_A_R_LINEAR_____415_CM 1 100. -491.52 491.505 ECU_ADDRESS 0x3fdf7e FORMAT "%7.2" /end MEASUREMENT
/begin MEASUREMENT TEG_COR_VEH_UP_2 "Entire vehicle influences correction" SWORD _CNV_A_R_LINEAR_____416_CM 1 100. -491.519999999553 491.5 ECU_ADDRESS 0x3fdf90 FORMAT "%7.2" /end MEASUREMENT
/begin MEASUREMENT TEG_COR_TCO_EX_UP_2 "Cooling temperature outlet correction" SWORD _CNV_A_R_LINEAR_____417_CM 1 100. -202. 202. ECU_ADDRESS 0x3fdf94 FORMAT "%7.3" /end MEASUREMENT
/begin MEASUREMENT FAC_COR_VS_TEG_UP_2 "Vehicle speed correction" SWORD _CNV_A_R_LINEAR_____272_CM 1 100. -2. 1.999938965 ECU_ADDRESS 0x3fdf92 FORMAT "%8.4" /end MEASUREMENT
/begin MEASUREMENT TEG_SCC_TCO_UP_2 "Additive single cyl. shut off temp. correction" UBYTE _CNV_A_R_LINEAR_____0_CM 1 100. -48. 142.5 ECU_ADDRESS 0x3fdf84 FORMAT "%5.1" /end MEASUREMENT
/begin MEASUREMENT VS_COR_ECF_TEG_UP_2 "Electric cooling fan correction" UBYTE _CNV_A_R_LINEAR_____13_CM 1 100. 0. 255. ECU_ADDRESS 0x3fdf96 FORMAT "%3.0" /end MEASUREMENT
/begin MEASUREMENT VS_COR_TEG_UP_2 "VS temperature correction" UBYTE _CNV_A_R_LINEAR_____13_CM 1 100. 0. 255. ECU_ADDRESS 0x3fdf97 FORMAT "%3.0" /end MEASUREMENT
/begin MEASUREMENT TEG_STAT_ENG_DOWN_2 "Exhaust temp. pre-control pre catalyst" UWORD _CNV_A_R_LINEAR_____269_CM 1 100. -48. 1459.3 ECU_ADDRESS 0x3fdfbc FORMAT "%7.2" /end MEASUREMENT
/begin MEASUREMENT TEG_STAT_BAS_DOWN_2 "Exhaust temp. based on load level pre-control pre catalyst" UWORD _CNV_A_R_LINEAR_____269_CM 1 100. -48. 1459.3 ECU_ADDRESS 0x3fdfbe FORMAT "%7.2" /end MEASUREMENT
/begin MEASUREMENT FAC_COR_LAMB_SP_TEG_DOWN_2 "Lambda set -point correction" UWORD _CNV_A_R_LINEAR_____45_CM 1 100. 0. 1.99996948 ECU_ADDRESS 0x3fdfc2 FORMAT "%7.5" /end MEASUREMENT
/begin MEASUREMENT TEG_STAT_DOWN_2 "Pre control exhaust temperature  pre catalyst" UWORD _CNV_A_R_LINEAR_____269_CM 1 100. -48. 1459.3 ECU_ADDRESS 0x3fdfc6 FORMAT "%7.2" /end MEASUREMENT
/begin MEASUREMENT TAM_REF_TEG_DOWN_2 "Reference ambient temperature for TEG model" UWORD _CNV_A_R_LINEAR_____269_CM 1 100. -48. 1459.3 ECU_ADDRESS 0x3fdfc8 FORMAT "%7.2" /end MEASUREMENT
/begin MEASUREMENT TEG_CAT_DOWN_MDL_2_BAS "Model of exhaust temperature pre catalyst" UWORD _CNV_A_R_LINEAR_____269_CM 1 100. -48. 1459.3 ECU_ADDRESS 0x3fdfd2 FORMAT "%7.2" /end MEASUREMENT
/begin MEASUREMENT TEG_DIF_DOWN_2 "Difference between steady to model temperature pre catalyst" UWORD _CNV_A_R_LINEAR_____413_CM 1 100. -1507.328 1507.282 ECU_ADDRESS 0x3fdfd4 FORMAT "%8.2" /end MEASUREMENT
/begin MEASUREMENT TEG_CAT_DOWN_MDL_STOP_2 "Model of exhaust temperature pre catalyst" UWORD _CNV_A_R_LINEAR_____269_CM 1 100. -48. 1459.3 ECU_ADDRESS 0x3fdfec FORMAT "%7.2" /end MEASUREMENT
/begin MEASUREMENT CRLC_TEG_GRAD_DOWN_2 "Exhaust Temperature gradient" UWORD _CNV_A_R_LINEAR_____348_CM 1 100. 0. 7.99987793 ECU_ADDRESS 0x3fdfd6 FORMAT "%6.4" /end MEASUREMENT
/begin MEASUREMENT CRLC_TEG_LEVEL_DOWN_2 "Exhaust temperature level" UWORD _CNV_A_R_LINEAR_____348_CM 1 100. 0. 7.99987793 ECU_ADDRESS 0x3fdfd8 FORMAT "%6.4" /end MEASUREMENT
/begin MEASUREMENT CRLC_TEG_DOWN_2 "Entire correlation constant of TEG dynamic change limitation" UWORD _CNV_A_R_LINEAR_____31_CM 1 100. 0. 0.99998474 ECU_ADDRESS 0x3fdfdc FORMAT "%7.5" /end MEASUREMENT
/begin MEASUREMENT CRLC_TEG_TOIL_TCO_DOWN_2 "Corelation constant received at TCO TOIL calculation" UWORD _CNV_A_R_LINEAR_____31_CM 1 100. 0. 0.99998474 ECU_ADDRESS 0x3fdfde FORMAT "%7.5" /end MEASUREMENT
/begin MEASUREMENT CRLC_TEG_EGY_DOWN_2 "Corelation constant received at energy calculation" UWORD _CNV_A_R_LINEAR_____31_CM 1 100. 0. 0.99998474 ECU_ADDRESS 0x3fdfe0 FORMAT "%7.5" /end MEASUREMENT
/begin MEASUREMENT EGY_TEG_END_SP_DOWN_2 "Energy setpoint  for Temperature Model beginning from start" ULONG _CNV_A_R_LINEAR_____414_CM 1 100. 0. 7456.426 ECU_ADDRESS 0x3fdfe4 FORMAT "%12.7" /end MEASUREMENT
/begin MEASUREMENT EGY_TEG_END_AV_DOWN_2 "Actual value Energy for Temperature Model beginning from start" ULONG _CNV_A_R_LINEAR_____414_CM 1 100. 0. 7456.426 ECU_ADDRESS 0x3fdfe8 FORMAT "%12.7" /end MEASUREMENT
/begin MEASUREMENT LV_TEG_AST_DOWN_2 "Temperature model after start condition" UBYTE _CNV_S_2_RANGE______11_CM 1 100. 0. 1. ECU_ADDRESS 0x3fdfe2 /end MEASUREMENT
/begin MEASUREMENT CRLC_TEG_BAS_DOWN_2 "Entire correlation constant of TEG dynamic change limitation" UWORD _CNV_A_R_LINEAR_____31_CM 1 100. 0. 0.99998474 ECU_ADDRESS 0x3fdfda FORMAT "%7.5" /end MEASUREMENT
/begin MEASUREMENT TEG_COR_EFF_IGA_DOWN_2 "Temp. correction power loss by ignition angle difference" UWORD _CNV_A_R_LINEAR_____412_CM 1 100. 0. 983.025 ECU_ADDRESS 0x3fdfc0 FORMAT "%6.2" /end MEASUREMENT
/begin MEASUREMENT TEG_SCC_TCO_DOWN_2 "Additive Single cylinder shut off temp. correction" UBYTE _CNV_A_R_LINEAR_____0_CM 1 100. -48. 142.5 ECU_ADDRESS 0x3fdfc4 FORMAT "%5.1" /end MEASUREMENT
/begin MEASUREMENT TEG_COR_VEH_DOWN_2 "Entire vehicle influences correction" SWORD _CNV_A_R_LINEAR_____416_CM 1 100. -491.519999999553 491.5 ECU_ADDRESS 0x3fdfca FORMAT "%7.2" /end MEASUREMENT
/begin MEASUREMENT FAC_COR_VS_TEG_DOWN_2 "Vehicle speed correction" SWORD _CNV_A_R_LINEAR_____272_CM 1 100. -2. 1.999938965 ECU_ADDRESS 0x3fdfcc FORMAT "%8.4" /end MEASUREMENT
/begin MEASUREMENT TEG_COR_TCO_EX_DOWN_2 "Cooling temperature outlet correction" SWORD _CNV_A_R_LINEAR_____417_CM 1 100. -202. 202. ECU_ADDRESS 0x3fdfce FORMAT "%7.3" /end MEASUREMENT
/begin MEASUREMENT VS_COR_ECF_TEG_DOWN_2 "Vehicle speed correction ecf" UBYTE _CNV_A_R_LINEAR_____13_CM 1 100. 0. 255. ECU_ADDRESS 0x3fdfd0 FORMAT "%3.0" /end MEASUREMENT
/begin MEASUREMENT VS_COR_TEG_DOWN_2 "Vehicle speed correction" UBYTE _CNV_A_R_LINEAR_____13_CM 1 100. 0. 255. ECU_ADDRESS 0x3fdfd1 FORMAT "%3.0" /end MEASUREMENT
/begin MEASUREMENT TEG_WALL_STAT_BAS_UP_2 "Exhaust temp. based on load level pre-control pre catalyst" UWORD _CNV_A_R_LINEAR_____269_CM 1 100. -48. 1459.3 ECU_ADDRESS 0x3fdff6 FORMAT "%7.2" /end MEASUREMENT
/begin MEASUREMENT FAC_SCC_TEG_WALL_2 "Multipicative Single cylinder shut off correction" UWORD _CNV_A_R_LINEAR_____31_CM 1 100. 0. 0.99998474 ECU_ADDRESS 0x3fdffc FORMAT "%7.5" /end MEASUREMENT
/begin MEASUREMENT FAC_COR_LAMB_SP_TEG_WALL_UP_2 "Lambda set -point correction" UWORD _CNV_A_R_LINEAR_____45_CM 1 100. 0. 1.99996948 ECU_ADDRESS 0x3fdffe FORMAT "%7.5" /end MEASUREMENT
/begin MEASUREMENT TEG_WALL_STAT_UP_2 "Pre control exhaust temperature  pre catalyst" UWORD _CNV_A_R_LINEAR_____269_CM 1 100. -48. 1459.3 ECU_ADDRESS 0x3fe000 FORMAT "%7.2" /end MEASUREMENT
/begin MEASUREMENT TAM_REF_TEG_WALL_UP_2 "Reference ambient temperature for TEG_WALL model" UWORD _CNV_A_R_LINEAR_____269_CM 1 100. -48. 1459.3 ECU_ADDRESS 0x3fe002 FORMAT "%7.2" /end MEASUREMENT
/begin MEASUREMENT TEG_WALL_CAT_UP_MDL_2 "Model of exhaust temperature pre catalyst" UWORD _CNV_A_R_LINEAR_____269_CM 1 100. -48. 1459.3 ECU_ADDRESS 0x3fe00c FORMAT "%7.2" /end MEASUREMENT
/begin MEASUREMENT TEG_WALL_DIF_UP_2 "Difference between steady to model temperature pre catalyst" UWORD _CNV_A_R_LINEAR_____413_CM 1 100. -1507.328 1507.282 ECU_ADDRESS 0x3fe00e FORMAT "%8.2" /end MEASUREMENT
/begin MEASUREMENT TEG_WALL_CAT_UP_MDL_STOP_2 "Model of exhaust temperature pre catalyst" UWORD _CNV_A_R_LINEAR_____269_CM 1 100. -48. 1459.3 ECU_ADDRESS 0x3fe020 FORMAT "%7.2" /end MEASUREMENT
/begin MEASUREMENT CRLC_TEG_WALL_UP_2 "Entire correlation constant of TEG_WALL dynamic change limitation" UWORD _CNV_A_R_LINEAR_____31_CM 1 100. 0. 0.99998474 ECU_ADDRESS 0x3fe012 FORMAT "%7.5" /end MEASUREMENT
/begin MEASUREMENT CRLC_TEG_WALL_TOIL_TCO_UP_2 "Corelation constant received at TCO TOIL calculation" UWORD _CNV_A_R_LINEAR_____31_CM 1 100. 0. 0.99998474 ECU_ADDRESS 0x3fe014 FORMAT "%7.5" /end MEASUREMENT
/begin MEASUREMENT CRLC_TEG_WALL_EGY_UP_2 "Corelation constant received at energy calculation" UWORD _CNV_A_R_LINEAR_____31_CM 1 100. 0. 0.99998474 ECU_ADDRESS 0x3fe016 FORMAT "%7.5" /end MEASUREMENT
/begin MEASUREMENT EGY_TEG_WALL_END_SP_UP_2 "Energy setpoint  for Temperature Model beginning from start" ULONG _CNV_A_R_LINEAR_____414_CM 1 100. 0. 7456.426 ECU_ADDRESS 0x3fe018 FORMAT "%12.7" /end MEASUREMENT
/begin MEASUREMENT EGY_TEG_WALL_END_AV_UP_2 "Actual value Energy for Temperature Model beginning from start" ULONG _CNV_A_R_LINEAR_____414_CM 1 100. 0. 7456.426 ECU_ADDRESS 0x3fe01c FORMAT "%12.7" /end MEASUREMENT
/begin MEASUREMENT CRLC_TEG_WALL_BAS_UP_2 "Entire correlation constant of TEG_WALL dynamic change limitation" UWORD _CNV_A_R_LINEAR_____31_CM 1 100. 0. 0.99998474 ECU_ADDRESS 0x3fe010 FORMAT "%7.5" /end MEASUREMENT
/begin MEASUREMENT TEG_WALL_STAT_ENG_UP_2 "" UWORD _CNV_A_R_LINEAR_____269_CM 1 100. -48. 1459.3 ECU_ADDRESS 0x3fdff4 FORMAT "%7.2" /end MEASUREMENT
/begin MEASUREMENT TEG_WALL_COR_EFF_IGA_UP_2 "Temp. correction power loss by ignition angle difference" UWORD _CNV_A_R_LINEAR_____412_CM 1 100. 0. 983.025 ECU_ADDRESS 0x3fdff8 FORMAT "%6.2" /end MEASUREMENT
/begin MEASUREMENT TEG_WALL_SCC_TCO_UP_2 "Additive Single cylinder shut off temp. correction" UBYTE _CNV_A_R_LINEAR_____0_CM 1 100. -48. 142.5 ECU_ADDRESS 0x3fdffa FORMAT "%5.1" /end MEASUREMENT
/begin MEASUREMENT TEG_WALL_COR_VEH_UP_2 "Entire vehicle influences correction" SWORD _CNV_A_R_LINEAR_____416_CM 1 100. -491.519999999553 491.5 ECU_ADDRESS 0x3fe004 FORMAT "%7.2" /end MEASUREMENT
/begin MEASUREMENT FAC_COR_VS_TEG_WALL_UP_2 "Vehicle speed correction" SWORD _CNV_A_R_LINEAR_____272_CM 1 100. -2. 1.999938965 ECU_ADDRESS 0x3fe006 FORMAT "%8.4" /end MEASUREMENT
/begin MEASUREMENT TEG_WALL_COR_TCO_EX_UP_2 "Cooling temperature outlet correction" SWORD _CNV_A_R_LINEAR_____417_CM 1 100. -202. 202. ECU_ADDRESS 0x3fe008 FORMAT "%7.3" /end MEASUREMENT
/begin MEASUREMENT VS_COR_ECF_TEG_WALL_UP_2 "Vehicle speed correction ecf" UBYTE _CNV_A_R_LINEAR_____13_CM 1 100. 0. 255. ECU_ADDRESS 0x3fe00a FORMAT "%3.0" /end MEASUREMENT
/begin MEASUREMENT VS_COR_TEG_WALL_UP_2 "Vehicle speed correction" UBYTE _CNV_A_R_LINEAR_____13_CM 1 100. 0. 255. ECU_ADDRESS 0x3fe00b FORMAT "%3.0" /end MEASUREMENT
/begin MEASUREMENT TEG_WALL_STAT_ENG_DOWN_2 "Exhaust temp. pre-control pre catalyst" UWORD _CNV_A_R_LINEAR_____269_CM 1 100. -48. 1459.3 ECU_ADDRESS 0x3fe028 FORMAT "%7.2" /end MEASUREMENT
/begin MEASUREMENT TEG_WALL_STAT_BAS_DOWN_2 "Exhaust temp. based on load level pre-control pre catalyst" UWORD _CNV_A_R_LINEAR_____269_CM 1 100. -48. 1459.3 ECU_ADDRESS 0x3fe02a FORMAT "%7.2" /end MEASUREMENT
/begin MEASUREMENT FAC_COR_LAMB_SP_TEG_WALL_DOWN_2 "Lambda set -point correction" UWORD _CNV_A_R_LINEAR_____45_CM 1 100. 0. 1.99996948 ECU_ADDRESS 0x3fe02e FORMAT "%7.5" /end MEASUREMENT
/begin MEASUREMENT TEG_WALL_STAT_DOWN_2 "Pre control exhaust temperature  pre catalyst" UWORD _CNV_A_R_LINEAR_____269_CM 1 100. -48. 1459.3 ECU_ADDRESS 0x3fe032 FORMAT "%7.2" /end MEASUREMENT
/begin MEASUREMENT TAM_REF_TEG_WALL_DOWN_2 "Reference ambient temperature for TEG_WALL model" UWORD _CNV_A_R_LINEAR_____269_CM 1 100. -48. 1459.3 ECU_ADDRESS 0x3fe034 FORMAT "%7.2" /end MEASUREMENT
/begin MEASUREMENT TEG_WALL_CAT_DOWN_MDL_2 "Model of exhaust temperature pre catalyst" UWORD _CNV_A_R_LINEAR_____269_CM 1 100. -48. 1459.3 ECU_ADDRESS 0x3fe03e FORMAT "%7.2" /end MEASUREMENT
/begin MEASUREMENT TEG_WALL_DIF_DOWN_2 "Difference between steady to model temperature pre catalyst" UWORD _CNV_A_R_LINEAR_____413_CM 1 100. -1507.328 1507.282 ECU_ADDRESS 0x3fe040 FORMAT "%8.2" /end MEASUREMENT
/begin MEASUREMENT TEG_WALL_CAT_DOWN_MDL_STOP_2 "Model of exhaust temperature pre catalyst" UWORD _CNV_A_R_LINEAR_____269_CM 1 100. -48. 1459.3 ECU_ADDRESS 0x3fe054 FORMAT "%7.2" /end MEASUREMENT
/begin MEASUREMENT CRLC_TEG_WALL_DOWN_2 "Entire correlation constant of TEG_WALL dynamic change limitation" UWORD _CNV_A_R_LINEAR_____31_CM 1 100. 0. 0.99998474 ECU_ADDRESS 0x3fe044 FORMAT "%7.5" /end MEASUREMENT
/begin MEASUREMENT CRLC_TEG_WALL_TOIL_TCO_DOWN_2 "Corelation constant received at TCO TOIL calculation" UWORD _CNV_A_R_LINEAR_____31_CM 1 100. 0. 0.99998474 ECU_ADDRESS 0x3fe046 FORMAT "%7.5" /end MEASUREMENT
/begin MEASUREMENT CRLC_TEG_WALL_EGY_DOWN_2 "Corelation constant received at energy calculation" UWORD _CNV_A_R_LINEAR_____31_CM 1 100. 0. 0.99998474 ECU_ADDRESS 0x3fe048 FORMAT "%7.5" /end MEASUREMENT
/begin MEASUREMENT EGY_TEG_WALL_END_SP_DOWN_2 "Energy setpoint  for Temperature Model beginning from start" ULONG _CNV_A_R_LINEAR_____414_CM 1 100. 0. 7456.426 ECU_ADDRESS 0x3fe04c FORMAT "%12.7" /end MEASUREMENT
/begin MEASUREMENT EGY_TEG_WALL_END_AV_DOWN_2 "Actual value Energy for Temperature Model beginning from start" ULONG _CNV_A_R_LINEAR_____414_CM 1 100. 0. 7456.426 ECU_ADDRESS 0x3fe050 FORMAT "%12.7" /end MEASUREMENT
/begin MEASUREMENT CRLC_TEG_WALL_BAS_DOWN_2 "" UWORD _CNV_A_R_LINEAR_____31_CM 1 100. 0. 0.99998474 ECU_ADDRESS 0x3fe042 FORMAT "%7.5" /end MEASUREMENT
/begin MEASUREMENT TEG_WALL_COR_EFF_IGA_DOWN_2 "Temp. correction power loss by ignition angle difference" UWORD _CNV_A_R_LINEAR_____412_CM 1 100. 0. 983.025 ECU_ADDRESS 0x3fe02c FORMAT "%6.2" /end MEASUREMENT
/begin MEASUREMENT TEG_WALL_SCC_TCO_DOWN_2 "Additive Single cylinder shut off temp. correction" UBYTE _CNV_A_R_LINEAR_____0_CM 1 100. -48. 142.5 ECU_ADDRESS 0x3fe030 FORMAT "%5.1" /end MEASUREMENT
/begin MEASUREMENT TEG_WALL_COR_VEH_DOWN_2 "Entire vehicle influences correction" SWORD _CNV_A_R_LINEAR_____416_CM 1 100. -491.519999999553 491.5 ECU_ADDRESS 0x3fe036 FORMAT "%7.2" /end MEASUREMENT
/begin MEASUREMENT FAC_COR_VS_TEG_WALL_DOWN_2 "Vehicle speed correction" SWORD _CNV_A_R_LINEAR_____272_CM 1 100. -2. 1.999938965 ECU_ADDRESS 0x3fe038 FORMAT "%8.4" /end MEASUREMENT
/begin MEASUREMENT TEG_WALL_COR_TCO_EX_DOWN_2 "Cooling temperature outlet correction" SWORD _CNV_A_R_LINEAR_____417_CM 1 100. -202. 202. ECU_ADDRESS 0x3fe03a FORMAT "%7.3" /end MEASUREMENT
/begin MEASUREMENT VS_COR_ECF_TEG_WALL_DOWN_2 "Vehicle speed correction ecf" UBYTE _CNV_A_R_LINEAR_____13_CM 1 100. 0. 255. ECU_ADDRESS 0x3fe03c FORMAT "%3.0" /end MEASUREMENT
/begin MEASUREMENT VS_COR_TEG_WALL_DOWN_2 "Vehicle speed correction" UBYTE _CNV_A_R_LINEAR_____13_CM 1 100. 0. 255. ECU_ADDRESS 0x3fe03d FORMAT "%3.0" /end MEASUREMENT
/begin MEASUREMENT LV_TEG_MIN_THD_2 "dew point has been reached" UBYTE _CNV_S_2_RANGE______28_CM 1 100. 0. 1. ECU_ADDRESS 0x3fe05c /end MEASUREMENT
/begin MEASUREMENT LV_TEG_CAT_DOWN_MIN_THD_2 "dew point has been reached bat and pre/post cat. specific" UBYTE _CNV_S_2_RANGE______28_CM 1 100. 0. 1. ECU_ADDRESS 0x3fe05e /end MEASUREMENT
/begin MEASUREMENT LV_TEG_CAT_UP_MIN_THD_2 "dew point has been reached bat and pre/post cat. specific" UBYTE _CNV_S_2_RANGE______28_CM 1 100. 0. 1. ECU_ADDRESS 0x3fe05d /end MEASUREMENT
/begin MEASUREMENT TEG_COR_VO_UP "Valve overlap temp. correction" SWORD _CNV_A_R_LINEAR_____416_CM 1 100. -491.519999999553 491.5 ECU_ADDRESS 0x3fe090 FORMAT "%7.2" /end MEASUREMENT
/begin MEASUREMENT TEMP_TOIL_DIF "Oil temperature  difference" SWORD _CNV_A_R_LINEAR_____418_CM 1 100. -202. 202. ECU_ADDRESS 0x3fe096 FORMAT "%8.3" /end MEASUREMENT
/begin MEASUREMENT TEMP_TCO_EX_DIF "Coolant outlet temperature difference" SWORD _CNV_A_R_LINEAR_____419_CM 1 100. -202. 202. ECU_ADDRESS 0x3fe09c FORMAT "%6.1" /end MEASUREMENT
/begin MEASUREMENT CRLC_TEG_TOIL_DIF_UP "Correlation constant by TOIL_DIF" UWORD _CNV_A_R_LINEAR_____348_CM 1 100. 0. 7.99987793 ECU_ADDRESS 0x3fe09e FORMAT "%6.4" /end MEASUREMENT
/begin MEASUREMENT CRLC_TEG_TCO_DIF_UP "Correlation constant by TCO_DIF" UWORD _CNV_A_R_LINEAR_____348_CM 1 100. 0. 7.99987793 ECU_ADDRESS 0x3fe0a0 FORMAT "%6.4" /end MEASUREMENT
/begin MEASUREMENT CRLC_TEG_TOIL_DIF_DOWN "Correlation constant by TOIL_DIF post cat." UWORD _CNV_A_R_LINEAR_____348_CM 1 100. 0. 7.99987793 ECU_ADDRESS 0x3fe0ac FORMAT "%6.4" /end MEASUREMENT
/begin MEASUREMENT CRLC_TEG_TCO_DIF_DOWN "Correlation constant by TCO_DIF post cat." UWORD _CNV_A_R_LINEAR_____348_CM 1 100. 0. 7.99987793 ECU_ADDRESS 0x3fe0ae FORMAT "%6.4" /end MEASUREMENT
/begin MEASUREMENT CRLC_TEG_WALL_TOIL_DIF_UP "Correlation constant by TOIL_DIF" UWORD _CNV_A_R_LINEAR_____348_CM 1 100. 0. 7.99987793 ECU_ADDRESS 0x3fe0b8 FORMAT "%6.4" /end MEASUREMENT
/begin MEASUREMENT CRLC_TEG_WALL_TCO_DIF_UP "Correlation constant by TCO_DIF" UWORD _CNV_A_R_LINEAR_____348_CM 1 100. 0. 7.99987793 ECU_ADDRESS 0x3fe0ba FORMAT "%6.4" /end MEASUREMENT
/begin MEASUREMENT TEG_WALL_COR_VO_DOWN "Valve overlap temp. correction " SWORD _CNV_A_R_LINEAR_____416_CM 1 100. -491.519999999553 491.5 ECU_ADDRESS 0x3fe0bc FORMAT "%7.2" /end MEASUREMENT
/begin MEASUREMENT TEG_STAT_MAX "Maximum avalible steady state exhaust gas temperature for Nox-Cat. desulfation" UWORD _CNV_A_R_LINEAR_____211_CM 1 100. 0. 2047. ECU_ADDRESS 0x3fe0c8 FORMAT "%7.2" /end MEASUREMENT
/begin CHARACTERISTIC IP_TEMP_SP_TOIL "Reference engine oil temperature" MAP 0x50840 _REC_MAP_20_u1_u2_u2 200. _CNV_A_R_LINEAR_____3_CM -40. 160. FORMAT "%3.0"
 /begin AXIS_DESCR COM_AXIS MAF_TEG _CNV_A_R_LINEAR_____95_CM 8 0. 1389. FORMAT "%7.2" AXIS_PTS_REF ldpm_maf_teg__teg_stat /end AXIS_DESCR
 /begin AXIS_DESCR COM_AXIS N_TEG _CNV_A_R_LINEAR_____17_CM 8 0. 8160. FORMAT "%4.0" AXIS_PTS_REF ldpm_n_teg__teg_stat /end AXIS_DESCR
/end CHARACTERISTIC
/begin CHARACTERISTIC IP_FAC_COR_LAMB_SP_UP "Lambda influences correction" CURVE 0x47408 _REC_CUR_20_u2_u2 1.99996948 _CNV_A_R_LINEAR_____45_CM 0. 1.99996948 FORMAT "%7.5"
 /begin AXIS_DESCR COM_AXIS TEG_1.APPL_INC_STRUCT.LAMB_SP_TEG _CNV_A_R_LINEAR_____148_CM 16 0. 31.99902344 FORMAT "%7.4" AXIS_PTS_REF ldpm_lamb_sp_teg__fac_cor /end AXIS_DESCR
/end CHARACTERISTIC
/begin CHARACTERISTIC IP_FAC_SCC_TEG "Single cylinder shut off influence of exhaust temperature " CURVE 0x4786c _REC_CUR_20_u2_u1 0.99998474 _CNV_A_R_LINEAR_____31_CM 0. 0.99998474 FORMAT "%7.5"
 /begin AXIS_DESCR COM_AXIS TEG_1.APPL_INC_STRUCT.NR_CYL_SCC_TEG _CNV_A_R_LINEAR_____411_CM 14 0. 13. FORMAT "%4.1" AXIS_PTS_REF ldpm_nr_cyl_scc_teg__fac_scc /end AXIS_DESCR
/end CHARACTERISTIC
/begin CHARACTERISTIC IP_FAC_TOIL_VS "Vs influence of oil temeperature" CURVE 0x47b84 _REC_CUR_20_u2_u1 1.99996948 _CNV_A_R_LINEAR_____45_CM 0. 1.99996948 FORMAT "%7.5"
 /begin AXIS_DESCR COM_AXIS VS _CNV_A_R_LINEAR_____13_CM 6 0. 255. FORMAT "%3.0" AXIS_PTS_REF ldpm_vs__fac_cor_vs_teg /end AXIS_DESCR
/end CHARACTERISTIC
/begin CHARACTERISTIC IP_TEMP_SP_TCO_EX "Reference TCO_EX temperature" MAP 0x50800 _REC_MAP_20_u1_u2_u2 190.5 _CNV_A_R_LINEAR_____0_CM -48. 142.5 FORMAT "%5.1"
 /begin AXIS_DESCR COM_AXIS MAF_TEG _CNV_A_R_LINEAR_____95_CM 8 0. 1389. FORMAT "%7.2" AXIS_PTS_REF ldpm_maf_teg__teg_stat /end AXIS_DESCR
 /begin AXIS_DESCR COM_AXIS N_TEG _CNV_A_R_LINEAR_____17_CM 8 0. 8160. FORMAT "%4.0" AXIS_PTS_REF ldpm_n_teg__teg_stat /end AXIS_DESCR
/end CHARACTERISTIC
/begin CHARACTERISTIC IP_FAC_TAM_TEG "Reference ambient temperature correction" CURVE 0x478a4 _REC_CUR_20_u2_u2 1.99996948 _CNV_A_R_LINEAR_____45_CM 0. 1.99996948 FORMAT "%7.5"
 /begin AXIS_DESCR COM_AXIS ONLINE_DUMMY _CNV_A_R_LINEAR_____269_CM 6 -48. 1459.3 FORMAT "%7.2" AXIS_PTS_REF ldp_teg_stat__fac_tam /end AXIS_DESCR
/end CHARACTERISTIC
/begin CHARACTERISTIC IP_TEG_STAT_UP_1 "Basic pre control engine temperature" MAP 0x4b520 _REC_MAP_20_u2_u2_u2 1507.3 _CNV_A_R_LINEAR_____269_CM -48. 1459.3 FORMAT "%7.2"
 /begin AXIS_DESCR COM_AXIS MAF_TEG _CNV_A_R_LINEAR_____95_CM 8 0. 1389. FORMAT "%7.2" AXIS_PTS_REF ldpm_maf_teg__teg_stat /end AXIS_DESCR
 /begin AXIS_DESCR COM_AXIS N_TEG _CNV_A_R_LINEAR_____17_CM 8 0. 8160. FORMAT "%4.0" AXIS_PTS_REF ldpm_n_teg__teg_stat /end AXIS_DESCR
/end CHARACTERISTIC
/begin CHARACTERISTIC IP_TEG_WALL_STAT_UP_1 "Basic pre control engine temperature " MAP 0x4b8e8 _REC_MAP_20_u2_u2_u2 1507.3 _CNV_A_R_LINEAR_____269_CM -48. 1459.3 FORMAT "%7.2"
 /begin AXIS_DESCR COM_AXIS MAF_TEG _CNV_A_R_LINEAR_____95_CM 8 0. 1389. FORMAT "%7.2" AXIS_PTS_REF ldpm_maf_teg__teg_stat /end AXIS_DESCR
 /begin AXIS_DESCR COM_AXIS N_TEG _CNV_A_R_LINEAR_____17_CM 8 0. 8160. FORMAT "%4.0" AXIS_PTS_REF ldpm_n_teg__teg_stat /end AXIS_DESCR
/end CHARACTERISTIC
/begin CHARACTERISTIC IP_FAC_TEG_WALL_COR_LAMB_SP_UP "Lambda influences correction depending on load engine" MAP 0x479fc _REC_MAP_20_u2_u2_u2 1.99996948 _CNV_A_R_LINEAR_____45_CM 0. 1.99996948 FORMAT "%7.5"
 /begin AXIS_DESCR COM_AXIS MAF_TEG _CNV_A_R_LINEAR_____95_CM 8 0. 1389. FORMAT "%7.2" AXIS_PTS_REF ldpm_maf_teg__teg_stat /end AXIS_DESCR
 /begin AXIS_DESCR COM_AXIS N_TEG _CNV_A_R_LINEAR_____17_CM 8 0. 8160. FORMAT "%4.0" AXIS_PTS_REF ldpm_n_teg__teg_stat /end AXIS_DESCR
/end CHARACTERISTIC
/begin CHARACTERISTIC IP_TEG_ADD_EGR "EGR influence Temperature" MAP 0x4b22c _REC_MAP_20_u2_u2_u2 983.025 _CNV_A_R_LINEAR_____415_CM -491.52 491.505 FORMAT "%7.2"
 /begin AXIS_DESCR COM_AXIS ONLINE_DUMMY _CNV_A_R_LINEAR_____269_CM 6 -48. 1459.3 FORMAT "%7.2" AXIS_PTS_REF ldpm_teg_stat_eng_pre /end AXIS_DESCR
 /begin AXIS_DESCR COM_AXIS EGR_RATIO _CNV_A_R_LINEAR_____94_CM 6 0. 99.99847412 AXIS_PTS_REF ldpm_egr_ratio__teg /end AXIS_DESCR
/end CHARACTERISTIC
/begin CHARACTERISTIC IP_TEG_WALL_ADD_EGR "EGR influence Temperature" MAP 0x4b620 _REC_MAP_20_u2_u2_u2 983.025 _CNV_A_R_LINEAR_____415_CM -491.52 491.505 FORMAT "%7.2"
 /begin AXIS_DESCR COM_AXIS ONLINE_DUMMY _CNV_A_R_LINEAR_____269_CM 6 -48. 1459.3 FORMAT "%7.2" AXIS_PTS_REF ldpm_teg_stat_eng_pre /end AXIS_DESCR
 /begin AXIS_DESCR COM_AXIS EGR_RATIO _CNV_A_R_LINEAR_____94_CM 6 0. 99.99847412 AXIS_PTS_REF ldpm_egr_ratio__teg /end AXIS_DESCR
/end CHARACTERISTIC
/begin CHARACTERISTIC IP_FAC_COR_LAMB_SP_WALL_UP "Lambda influences correction" CURVE 0x47428 _REC_CUR_20_u2_u2 1.99996948 _CNV_A_R_LINEAR_____45_CM 0. 1.99996948 FORMAT "%7.5"
 /begin AXIS_DESCR COM_AXIS TEG_1.APPL_INC_STRUCT.LAMB_SP_TEG _CNV_A_R_LINEAR_____148_CM 16 0. 31.99902344 FORMAT "%7.4" AXIS_PTS_REF ldpm_lamb_sp_teg__fac_cor /end AXIS_DESCR
/end CHARACTERISTIC
/begin CHARACTERISTIC IP_CRLC_TEG_DEC_PUC_UP_1 "Map of correlation constant by fuel cut off" CURVE 0x461e6 _REC_CUR_20_u2_u2 0.99998474 _CNV_A_R_LINEAR_____31_CM 0. 0.99998474 FORMAT "%7.5"
 /begin AXIS_DESCR COM_AXIS ONLINE_DUMMY _CNV_A_R_LINEAR_____277_CM 8 0. 1820.398 FORMAT "%7.2" AXIS_PTS_REF ldpm_maf_int_puc__crlc_teg /end AXIS_DESCR
/end CHARACTERISTIC
/begin CHARACTERISTIC IP_CRLC_TEG_WALL_DEC_PUC_UP_1 "Map of correlation constant by fuel cut off" CURVE 0x46326 _REC_CUR_20_u2_u2 0.99998474 _CNV_A_R_LINEAR_____31_CM 0. 0.99998474 FORMAT "%7.5"
 /begin AXIS_DESCR COM_AXIS ONLINE_DUMMY _CNV_A_R_LINEAR_____277_CM 8 0. 1820.398 FORMAT "%7.2" AXIS_PTS_REF ldpm_maf_int_puc__crlc_teg /end AXIS_DESCR
/end CHARACTERISTIC
/begin CHARACTERISTIC IP_CRLC_TEG_INC_UP_1 "Map of correlation constant by heating" CURVE 0x46266 _REC_CUR_20_u2_u2 0.99998474 _CNV_A_R_LINEAR_____31_CM 0. 0.99998474 FORMAT "%7.5"
 /begin AXIS_DESCR COM_AXIS ONLINE_DUMMY _CNV_A_R_LINEAR_____269_CM 12 -48. 1459.3 FORMAT "%7.2" AXIS_PTS_REF ldpm_teg_stat__crlc_inc /end AXIS_DESCR
/end CHARACTERISTIC
/begin CHARACTERISTIC IP_CRLC_TEG_WALL_INC_UP_1 "Map of correlation constant by heating" CURVE 0x463a6 _REC_CUR_20_u2_u2 0.99998474 _CNV_A_R_LINEAR_____31_CM 0. 0.99998474 FORMAT "%7.5"
 /begin AXIS_DESCR COM_AXIS ONLINE_DUMMY _CNV_A_R_LINEAR_____269_CM 12 -48. 1459.3 FORMAT "%7.2" AXIS_PTS_REF ldpm_teg_wall_stat__crlc_inc /end AXIS_DESCR
/end CHARACTERISTIC
/begin CHARACTERISTIC IP_CRLC_TEG_DEC_UP_1 "Map of correlation constant by cooling" CURVE 0x46206 _REC_CUR_20_u2_u2 0.99998474 _CNV_A_R_LINEAR_____31_CM 0. 0.99998474 FORMAT "%7.5"
 /begin AXIS_DESCR COM_AXIS ONLINE_DUMMY _CNV_A_R_LINEAR_____269_CM 12 -48. 1459.3 FORMAT "%7.2" AXIS_PTS_REF ldpm_teg_stat__crlc_dec /end AXIS_DESCR
/end CHARACTERISTIC
/begin CHARACTERISTIC IP_CRLC_TEG_WALL_DEC_UP_1 "Map of correlation constant by cooling" CURVE 0x46346 _REC_CUR_20_u2_u2 0.99998474 _CNV_A_R_LINEAR_____31_CM 0. 0.99998474 FORMAT "%7.5"
 /begin AXIS_DESCR COM_AXIS ONLINE_DUMMY _CNV_A_R_LINEAR_____269_CM 12 -48. 1459.3 FORMAT "%7.2" AXIS_PTS_REF ldpm_teg_wall_stat__crlc_dec /end AXIS_DESCR
/end CHARACTERISTIC
/begin CHARACTERISTIC IP_TEG_STAT_DOWN_1 "Basic pre control engine temperature " MAP 0x4b420 _REC_MAP_20_u2_u2_u2 1507.3 _CNV_A_R_LINEAR_____269_CM -48. 1459.3 FORMAT "%7.2"
 /begin AXIS_DESCR COM_AXIS MAF_TEG _CNV_A_R_LINEAR_____95_CM 8 0. 1389. FORMAT "%7.2" AXIS_PTS_REF ldpm_maf_teg__teg_stat /end AXIS_DESCR
 /begin AXIS_DESCR COM_AXIS N_TEG _CNV_A_R_LINEAR_____17_CM 8 0. 8160. FORMAT "%4.0" AXIS_PTS_REF ldpm_n_teg__teg_stat /end AXIS_DESCR
/end CHARACTERISTIC
/begin CHARACTERISTIC IP_TEG_WALL_STAT_DOWN_1 "Basic pre control engine temperature " MAP 0x4b7e8 _REC_MAP_20_u2_u2_u2 1507.3 _CNV_A_R_LINEAR_____269_CM -48. 1459.3 FORMAT "%7.2"
 /begin AXIS_DESCR COM_AXIS MAF_TEG _CNV_A_R_LINEAR_____95_CM 8 0. 1389. FORMAT "%7.2" AXIS_PTS_REF ldpm_maf_teg__teg_stat /end AXIS_DESCR
 /begin AXIS_DESCR COM_AXIS N_TEG _CNV_A_R_LINEAR_____17_CM 8 0. 8160. FORMAT "%4.0" AXIS_PTS_REF ldpm_n_teg__teg_stat /end AXIS_DESCR
/end CHARACTERISTIC
/begin CHARACTERISTIC IP_CRLC_TEG_TOIL_DIF_DOWN "Map of correlation constant depending on TOIL difference post cat" CURVE 0x462b6 _REC_CUR_20_u2_u2 7.99987793 _CNV_A_R_LINEAR_____348_CM 0. 7.99987793 FORMAT "%6.4"
 /begin AXIS_DESCR COM_AXIS TEMP_TOIL_DIF _CNV_A_R_LINEAR_____420_CM 8 -202. 202. FORMAT "%6.1" AXIS_PTS_REF ldpm_temp_toil_dif__crlc_teg /end AXIS_DESCR
/end CHARACTERISTIC
/begin CHARACTERISTIC IP_CRLC_TEG_WALL_TOIL_DIF_DOWN "Map of correlation constant depending on TOIL difference post cat" CURVE 0x463f6 _REC_CUR_20_u2_u2 7.99987793 _CNV_A_R_LINEAR_____348_CM 0. 7.99987793 FORMAT "%6.4"
 /begin AXIS_DESCR COM_AXIS TEMP_TOIL_DIF _CNV_A_R_LINEAR_____420_CM 8 -202. 202. FORMAT "%6.1" AXIS_PTS_REF ldpm_temp_toil_dif__crlc_teg /end AXIS_DESCR
/end CHARACTERISTIC
/begin CHARACTERISTIC IP_CRLC_TEG_TCO_DIF_DOWN "Map of correlation constant depending on TCO difference post cat" CURVE 0x46296 _REC_CUR_20_u2_u2 7.99987793 _CNV_A_R_LINEAR_____348_CM 0. 7.99987793 FORMAT "%6.4"
 /begin AXIS_DESCR COM_AXIS TEMP_TCO_DIF _CNV_A_R_LINEAR_____421_CM 8 -202. 202. FORMAT "%6.1" AXIS_PTS_REF ldpm_temp_tco_dif__crlc_teg /end AXIS_DESCR
/end CHARACTERISTIC
/begin CHARACTERISTIC IP_CRLC_TEG_WALL_TCO_DIF_DOWN "Map of correlation constant depending on TCO difference post cat" CURVE 0x463d6 _REC_CUR_20_u2_u2 7.99987793 _CNV_A_R_LINEAR_____348_CM 0. 7.99987793 FORMAT "%6.4"
 /begin AXIS_DESCR COM_AXIS TEMP_TCO_DIF _CNV_A_R_LINEAR_____421_CM 8 -202. 202. FORMAT "%6.1" AXIS_PTS_REF ldpm_temp_tco_dif__crlc_teg /end AXIS_DESCR
/end CHARACTERISTIC
/begin CHARACTERISTIC IP_CRLC_TEG_DEC_PUC_DOWN_1 "Map of correlation constant by fuel cut off post cat." CURVE 0x461c6 _REC_CUR_20_u2_u2 0.99998474 _CNV_A_R_LINEAR_____31_CM 0. 0.99998474 FORMAT "%7.5"
 /begin AXIS_DESCR COM_AXIS ONLINE_DUMMY _CNV_A_R_LINEAR_____277_CM 8 0. 1820.398 FORMAT "%7.2" AXIS_PTS_REF ldpm_maf_int_puc__crlc_teg /end AXIS_DESCR
/end CHARACTERISTIC
/begin CHARACTERISTIC IP_CRLC_TEG_WALL_DEC_PUC_DOWN_1 "Map of correlation constant by fuel cut off post cat." CURVE 0x46306 _REC_CUR_20_u2_u2 0.99998474 _CNV_A_R_LINEAR_____31_CM 0. 0.99998474 FORMAT "%7.5"
 /begin AXIS_DESCR COM_AXIS ONLINE_DUMMY _CNV_A_R_LINEAR_____277_CM 8 0. 1820.398 FORMAT "%7.2" AXIS_PTS_REF ldpm_maf_int_puc__crlc_teg /end AXIS_DESCR
/end CHARACTERISTIC
/begin CHARACTERISTIC IP_CRLC_TEG_DEC_DOWN_1 "Map of correlation constant by cooling post cat." CURVE 0x46196 _REC_CUR_20_u2_u2 0.99998474 _CNV_A_R_LINEAR_____31_CM 0. 0.99998474 FORMAT "%7.5"
 /begin AXIS_DESCR COM_AXIS ONLINE_DUMMY _CNV_A_R_LINEAR_____269_CM 12 -48. 1459.3 FORMAT "%7.2" AXIS_PTS_REF ldpm_teg_stat__crlc_dec /end AXIS_DESCR
/end CHARACTERISTIC
/begin CHARACTERISTIC IP_CRLC_TEG_WALL_DEC_DOWN_1 "Map of correlation constant by cooling post cat." CURVE 0x462d6 _REC_CUR_20_u2_u2 0.99998474 _CNV_A_R_LINEAR_____31_CM 0. 0.99998474 FORMAT "%7.5"
 /begin AXIS_DESCR COM_AXIS ONLINE_DUMMY _CNV_A_R_LINEAR_____269_CM 12 -48. 1459.3 FORMAT "%7.2" AXIS_PTS_REF ldpm_teg_wall_stat__crlc_dec /end AXIS_DESCR
/end CHARACTERISTIC
/begin CHARACTERISTIC IP_CRLC_TEG_INC_DOWN_1 "Map of correlation constant by heating post cat." CURVE 0x46236 _REC_CUR_20_u2_u2 0.99998474 _CNV_A_R_LINEAR_____31_CM 0. 0.99998474 FORMAT "%7.5"
 /begin AXIS_DESCR COM_AXIS ONLINE_DUMMY _CNV_A_R_LINEAR_____269_CM 12 -48. 1459.3 FORMAT "%7.2" AXIS_PTS_REF ldpm_teg_stat__crlc_inc /end AXIS_DESCR
/end CHARACTERISTIC
/begin CHARACTERISTIC IP_CRLC_TEG_WALL_INC_DOWN_1 "Map of correlation constant by heating post cat." CURVE 0x46376 _REC_CUR_20_u2_u2 0.99998474 _CNV_A_R_LINEAR_____31_CM 0. 0.99998474 FORMAT "%7.5"
 /begin AXIS_DESCR COM_AXIS ONLINE_DUMMY _CNV_A_R_LINEAR_____269_CM 12 -48. 1459.3 FORMAT "%7.2" AXIS_PTS_REF ldpm_teg_wall_stat__crlc_inc /end AXIS_DESCR
/end CHARACTERISTIC
/begin CHARACTERISTIC C_TAM_REF "Reference ambient temperature" VALUE 0x42a3b _REC_VAL_20_u1 190.5 _CNV_A_R_LINEAR_____0_CM -48. 142.5 FORMAT "%5.1" /end CHARACTERISTIC
/begin CHARACTERISTIC C_MAF_INT_TEG_ST_UP "Correlation constant at start" VALUE 0x42e48 _REC_VAL_20_u2 1820.398 _CNV_A_R_LINEAR_____277_CM 0. 1820.398 FORMAT "%7.2" /end CHARACTERISTIC
/begin CHARACTERISTIC C_CRLC_TEG_ST_UP "Correlation constant at start" VALUE 0x42c88 _REC_VAL_20_u2 0.999755 _CNV_A_R_LINEAR_____112_CM 0. 0.999755 FORMAT "%7.5" /end CHARACTERISTIC
/begin CHARACTERISTIC C_EGY_TEG_END_SP_UP "Threshold of energy setpoint after start" VALUE 0x42cea _REC_VAL_20_u2 9.83 _CNV_A_R_LINEAR_____422_CM 0. 9.83 FORMAT "%6.4" /end CHARACTERISTIC
/begin CHARACTERISTIC C_TEG_WALL_ST_OFF "Temperature until temperature start  detection" VALUE 0x4307c _REC_VAL_20_u2 1507.3 _CNV_A_R_LINEAR_____269_CM -48. 1459.3 FORMAT "%7.2" /end CHARACTERISTIC
/begin CHARACTERISTIC C_CRLC_TEG_WALL_ST_END_UP "Correlation constant at start" VALUE 0x42c8e _REC_VAL_20_u2 0.999755 _CNV_A_R_LINEAR_____112_CM 0. 0.999755 FORMAT "%7.5" /end CHARACTERISTIC
/begin CHARACTERISTIC C_CRLC_TEG_WALL_ST_UP "Correlation constant at start" VALUE 0x42c90 _REC_VAL_20_u2 0.999755 _CNV_A_R_LINEAR_____112_CM 0. 0.999755 FORMAT "%7.5" /end CHARACTERISTIC
/begin CHARACTERISTIC C_EGY_TEG_WALL_END_SP_UP "Threshold of energy setpoint after start" VALUE 0x42cee _REC_VAL_20_u2 9.83 _CNV_A_R_LINEAR_____422_CM 0. 9.83 FORMAT "%6.4" /end CHARACTERISTIC
/begin CHARACTERISTIC C_FAC_COR_VO_TEG_DOWN "Valve overlap correction depending on load engine post cat" VALUE 0x42d10 _REC_VAL_20_u2 1.99996948 _CNV_A_R_LINEAR_____45_CM 0. 1.99996948 FORMAT "%7.5" /end CHARACTERISTIC
/begin CHARACTERISTIC C_FAC_COR_VO_TEG_WALL_DOWN "Valve overlap correction depending on load engine post cat" VALUE 0x42d12 _REC_VAL_20_u2 1.99996948 _CNV_A_R_LINEAR_____45_CM 0. 1.99996948 FORMAT "%7.5" /end CHARACTERISTIC
/begin CHARACTERISTIC C_FAC_COR_LAMB_SP_TEG_DOWN "Lambda influences correction depending on load engine post cat." VALUE 0x42d08 _REC_VAL_20_u2 1.99996948 _CNV_A_R_LINEAR_____45_CM 0. 1.99996948 FORMAT "%7.5" /end CHARACTERISTIC
/begin CHARACTERISTIC C_FAC_COR_LAMB_SP_TEG_WALL_DOWN "Lambda influences correction depending on load engine post cat." VALUE 0x42d0a _REC_VAL_20_u2 1.99996948 _CNV_A_R_LINEAR_____45_CM 0. 1.99996948 FORMAT "%7.5" /end CHARACTERISTIC
/begin CHARACTERISTIC C_FAC_COR_SAF_TEG_DOWN "Secondary air influences correction post cat" VALUE 0x42d0c _REC_VAL_20_u2 1.99996948 _CNV_A_R_LINEAR_____45_CM 0. 1.99996948 FORMAT "%7.5" /end CHARACTERISTIC
/begin CHARACTERISTIC C_FAC_COR_SAF_TEG_WALL_DOWN "SAF influences correction depending on load engine post cat." VALUE 0x42d0e _REC_VAL_20_u2 1.99996948 _CNV_A_R_LINEAR_____45_CM 0. 1.99996948 FORMAT "%7.5" /end CHARACTERISTIC
/begin CHARACTERISTIC C_FAC_VS_TEG_DOWN "Vehicle speed correction depending on load Engine post cat" VALUE 0x42d58 _REC_VAL_20_u2 1.99996948 _CNV_A_R_LINEAR_____45_CM 0. 1.99996948 FORMAT "%7.5" /end CHARACTERISTIC
/begin CHARACTERISTIC C_FAC_VS_TEG_WALL_DOWN "Vehicle speed correction depending on load Engine post cat" VALUE 0x42d5a _REC_VAL_20_u2 1.99996948 _CNV_A_R_LINEAR_____45_CM 0. 1.99996948 FORMAT "%7.5" /end CHARACTERISTIC
/begin CHARACTERISTIC C_CRLC_TEG_WALL_ST_END_DOWN "Correlation constant at start" VALUE 0x42c8c _REC_VAL_20_u2 0.999755 _CNV_A_R_LINEAR_____112_CM 0. 0.999755 FORMAT "%7.5" /end CHARACTERISTIC
/begin CHARACTERISTIC C_MAF_INT_TEG_ST_DOWN "Threshold of mass air post cat." VALUE 0x42e46 _REC_VAL_20_u2 1820.398 _CNV_A_R_LINEAR_____277_CM 0. 1820.398 FORMAT "%7.2" /end CHARACTERISTIC
/begin CHARACTERISTIC C_MAF_INT_TEG_WALL_ST_DOWN "Threshold of mass air" VALUE 0x42e4a _REC_VAL_20_u2 1820.398 _CNV_A_R_LINEAR_____277_CM 0. 1820.398 FORMAT "%7.2" /end CHARACTERISTIC
/begin CHARACTERISTIC C_CRLC_TEG_ST_DOWN "Correlation constant at start post cat." VALUE 0x42c82 _REC_VAL_20_u2 0.999755 _CNV_A_R_LINEAR_____112_CM 0. 0.999755 FORMAT "%7.5" /end CHARACTERISTIC
/begin CHARACTERISTIC C_CRLC_TEG_WALL_ST_DOWN "Correlation constant at start" VALUE 0x42c8a _REC_VAL_20_u2 0.999755 _CNV_A_R_LINEAR_____112_CM 0. 0.999755 FORMAT "%7.5" /end CHARACTERISTIC
/begin CHARACTERISTIC C_EGY_TEG_END_SP_DOWN "Threshold of energy setpoint after start post cat." VALUE 0x42ce8 _REC_VAL_20_u2 9.83 _CNV_A_R_LINEAR_____422_CM 0. 9.83 FORMAT "%6.4" /end CHARACTERISTIC
/begin CHARACTERISTIC C_EGY_TEG_WALL_END_SP_DOWN "Threshold of energy setpoint after start" VALUE 0x42cec _REC_VAL_20_u2 9.83 _CNV_A_R_LINEAR_____422_CM 0. 9.83 FORMAT "%6.4" /end CHARACTERISTIC
/begin MEASUREMENT POW_DIF_MAX "Maximum power loss for active Nox desulfation" UWORD _CNV_A_R_LINEAR_____423_CM 1 100. 0. 434.0555 ECU_ADDRESS 0x3fe0a2 FORMAT "%7.3" /end MEASUREMENT
/begin MEASUREMENT TAM_DEW "Ambient temperature for the end of dew point module" UBYTE _CNV_A_R_LINEAR_____0_CM 1 100. -48. 142.5 ECU_ADDRESS 0x3fe0cd FORMAT "%5.1" /end MEASUREMENT
/begin MEASUREMENT T_ES_DEW "Engine shut-off duration" UWORD _CNV_A_R_LINEAR_____35_CM 1 100. 0. 65535. ECU_ADDRESS 0x3fe0ca FORMAT "%5.0" /end MEASUREMENT
/begin MEASUREMENT EGY_DEW_STOP_UP "Additional amount of heat if dew point has not been reached" ULONG _CNV_A_R_LINEAR_____414_CM 1 100. 0. 7456.426 ECU_ADDRESS 0x3fe064 FORMAT "%12.7" /end MEASUREMENT
/begin MEASUREMENT EGY_DEW_STOP_DOWN "Additional amount of heat if dew point has not been reached" ULONG _CNV_A_R_LINEAR_____414_CM 1 100. 0. 7456.426 ECU_ADDRESS 0x3fe068 FORMAT "%12.7" /end MEASUREMENT
/begin MEASUREMENT EGY_DEW_END_DOWN "Total amount of energy until end of dew point" ULONG _CNV_A_R_LINEAR_____414_CM 1 100. 0. 7456.426 ECU_ADDRESS 0x3fe070 FORMAT "%12.7" /end MEASUREMENT
/begin MEASUREMENT EGY_DEW_END_UP "Total amount of energy until end of dew point" ULONG _CNV_A_R_LINEAR_____414_CM 1 100. 0. 7456.426 ECU_ADDRESS 0x3fe06c FORMAT "%12.7" /end MEASUREMENT
/begin MEASUREMENT EGY_DEW_UP "Energy which is converted in the exhaust gas until reaching the dew point" ULONG _CNV_A_R_LINEAR_____414_CM 1 100. 0. 7456.426 ECU_ADDRESS 0x3fe074 FORMAT "%12.7" /end MEASUREMENT
/begin MEASUREMENT EGY_DEW_DOWN "Energy which is converted in the exhaust gas until reaching the dew point" ULONG _CNV_A_R_LINEAR_____414_CM 1 100. 0. 7456.426 ECU_ADDRESS 0x3fe078 FORMAT "%12.7" /end MEASUREMENT
/begin CHARACTERISTIC C_FAC_LAMB_TEG_STAT_MAX "temperature influence by lambda adjustments" VALUE 0x42d1a _REC_VAL_20_u2 3.999939 _CNV_A_R_LINEAR_____310_CM 0. 3.999939 FORMAT "%7.5" /end CHARACTERISTIC
/begin CHARACTERISTIC C_DELTA_TIA "Differential temperature to Intake air temperature" VALUE 0x4287d _REC_VAL_20_u1 190.5 _CNV_A_R_LINEAR_____0_CM -48. 142.5 FORMAT "%5.1" /end CHARACTERISTIC
/begin CHARACTERISTIC C_T_ES_DEW_MIN "Minimum shut-off time for end of dew point calculation" VALUE 0x42fd0 _REC_VAL_20_u2 65535. _CNV_A_R_LINEAR_____35_CM 0. 65535. FORMAT "%5.0" /end CHARACTERISTIC
/begin CHARACTERISTIC C_T_ES_DEW_MAX "Maximum shut-off time for end of dew point calculation" VALUE 0x42fce _REC_VAL_20_u2 65535. _CNV_A_R_LINEAR_____35_CM 0. 65535. FORMAT "%5.0" /end CHARACTERISTIC
/begin CHARACTERISTIC IP_FAC_COR_VO_UP "Valve overlap correction" CURVE 0x47478 _REC_CUR_20_u2_u2 4. _CNV_A_R_LINEAR_____271_CM -2. 2. FORMAT "%8.5"
 /begin AXIS_DESCR COM_AXIS VO_DIF_TEG _CNV_A_R_LINEAR_____424_CM 6 -95.625 95.625 FORMAT "%5.1" AXIS_PTS_REF ldpm_vo_dif_teg__teg_stat /end AXIS_DESCR
/end CHARACTERISTIC
/begin CHARACTERISTIC IP_FAC_COR_VO_WALL_UP "Valve overlap correction" CURVE 0x47484 _REC_CUR_20_u2_u2 4. _CNV_A_R_LINEAR_____271_CM -2. 2. FORMAT "%8.5"
 /begin AXIS_DESCR COM_AXIS VO_DIF_TEG _CNV_A_R_LINEAR_____424_CM 6 -95.625 95.625 FORMAT "%5.1" AXIS_PTS_REF ldpm_vo_dif_teg__teg_stat /end AXIS_DESCR
/end CHARACTERISTIC
/begin CHARACTERISTIC IP_FAC_COR_SAF_WALL "SAF_KGH correktion" CURVE 0x47454 _REC_CUR_20_u2_u2 1.99996948 _CNV_A_R_LINEAR_____45_CM 0. 1.99996948 FORMAT "%7.5"
 /begin AXIS_DESCR COM_AXIS SAF_KGH _CNV_A_R_LINEAR_____41_CM 6 0. 1023.984375 FORMAT "%7.2" AXIS_PTS_REF ldpm_saf_kgh__fac_cor_saf /end AXIS_DESCR
/end CHARACTERISTIC
/begin CHARACTERISTIC IP_FAC_SCC_TEG_WALL "Single cylinder shut off influence of exhaust temperature " CURVE 0x47888 _REC_CUR_20_u2_u1 0.99998474 _CNV_A_R_LINEAR_____31_CM 0. 0.99998474 FORMAT "%7.5"
 /begin AXIS_DESCR COM_AXIS TEG_1.APPL_INC_STRUCT.NR_CYL_SCC_TEG _CNV_A_R_LINEAR_____411_CM 14 0. 13. FORMAT "%4.1" AXIS_PTS_REF ldpm_nr_cyl_scc_teg__fac_scc /end AXIS_DESCR
/end CHARACTERISTIC
/begin CHARACTERISTIC IP_CRLC_TEG_TCO_DIF_UP "Map of correlation constant depending on TCO difference" CURVE 0x462a6 _REC_CUR_20_u2_u2 7.99987793 _CNV_A_R_LINEAR_____348_CM 0. 7.99987793 FORMAT "%6.4"
 /begin AXIS_DESCR COM_AXIS TEMP_TCO_DIF _CNV_A_R_LINEAR_____421_CM 8 -202. 202. FORMAT "%6.1" AXIS_PTS_REF ldpm_temp_tco_dif__crlc_teg /end AXIS_DESCR
/end CHARACTERISTIC
/begin CHARACTERISTIC IP_CRLC_TEG_TOIL_DIF_UP "Map of correlation constant depending on TOIL difference" CURVE 0x462c6 _REC_CUR_20_u2_u2 7.99987793 _CNV_A_R_LINEAR_____348_CM 0. 7.99987793 FORMAT "%6.4"
 /begin AXIS_DESCR COM_AXIS TEMP_TOIL_DIF _CNV_A_R_LINEAR_____420_CM 8 -202. 202. FORMAT "%6.1" AXIS_PTS_REF ldpm_temp_toil_dif__crlc_teg /end AXIS_DESCR
/end CHARACTERISTIC
/begin CHARACTERISTIC C_CRLC_TEG_ST_END_DOWN "Correlation constant at start post cat." VALUE 0x42c84 _REC_VAL_20_u2 0.999755 _CNV_A_R_LINEAR_____112_CM 0. 0.999755 FORMAT "%7.5" /end CHARACTERISTIC
/begin CHARACTERISTIC C_CRLC_TEG_ST_END_UP "Correlation constant at start post cat." VALUE 0x42c86 _REC_VAL_20_u2 0.999755 _CNV_A_R_LINEAR_____112_CM 0. 0.999755 FORMAT "%7.5" /end CHARACTERISTIC
/begin CHARACTERISTIC IP_CRLC_TEG_WALL_TOIL_DIF_UP "Map of correlation constant depending on TOIL difference" CURVE 0x46406 _REC_CUR_20_u2_u2 7.99987793 _CNV_A_R_LINEAR_____348_CM 0. 7.99987793 FORMAT "%6.4"
 /begin AXIS_DESCR COM_AXIS TEMP_TOIL_DIF _CNV_A_R_LINEAR_____420_CM 8 -202. 202. FORMAT "%6.1" AXIS_PTS_REF ldpm_temp_toil_dif__crlc_teg /end AXIS_DESCR
/end CHARACTERISTIC
/begin CHARACTERISTIC C_TCO_ST "Temperature threshold for coolant at start" VALUE 0x42a79 _REC_VAL_20_u1 190.5 _CNV_A_R_LINEAR_____0_CM -48. 142.5 FORMAT "%5.1" /end CHARACTERISTIC
/begin CHARACTERISTIC C_TCO_ES_DEW "TCO differential threshold for long engine shut-off times" VALUE 0x42a4d _REC_VAL_20_u1 190.5 _CNV_A_R_LINEAR_____1_CM 0. 190.5 FORMAT "%5.1" /end CHARACTERISTIC
/begin CHARACTERISTIC C_T_ES_DIF_DEW "Minimum differential time for engine shut-off time" VALUE 0x42fd6 _REC_VAL_20_u2 65535. _CNV_A_R_LINEAR_____35_CM 0. 65535. FORMAT "%5.0" /end CHARACTERISTIC
/begin CHARACTERISTIC C_FAC_EGY_DEW_STOP "Weighting factor on restart" VALUE 0x428a3 _REC_VAL_20_u1 0.99610001 _CNV_A_R_LINEAR_____20_CM 0. 0.99610001 FORMAT "%5.3" /end CHARACTERISTIC
/begin CHARACTERISTIC IP_CRLC_TEG_WALL_TCO_DIF_UP "Map of correlation constant depending on TCO difference" CURVE 0x463e6 _REC_CUR_20_u2_u2 7.99987793 _CNV_A_R_LINEAR_____348_CM 0. 7.99987793 FORMAT "%6.4"
 /begin AXIS_DESCR COM_AXIS TEMP_TCO_DIF _CNV_A_R_LINEAR_____421_CM 8 -202. 202. FORMAT "%6.1" AXIS_PTS_REF ldpm_temp_tco_dif__crlc_teg /end AXIS_DESCR
/end CHARACTERISTIC
/begin CHARACTERISTIC IP_EGY_DEW_END_ST_UP "Pre-catalyst amount of heat depending on start temperature and manifold wall temperature" MAP 0x471e8 _REC_MAP_20_u2_u1_u2 7456.426000000001 _CNV_A_R_LINEAR_____425_CM 0. 7456.426 FORMAT "%6.1"
 /begin AXIS_DESCR COM_AXIS TCO_ST _CNV_A_R_LINEAR_____0_CM 8 -48. 142.5 FORMAT "%5.1" AXIS_PTS_REF ldpm_tco_st__dew /end AXIS_DESCR
 /begin AXIS_DESCR COM_AXIS ONLINE_DUMMY _CNV_A_R_LINEAR_____269_CM 8 -48. 1459.3 FORMAT "%7.2" AXIS_PTS_REF ldpm_teg_wall_cat_up_mdl_1 /end AXIS_DESCR
/end CHARACTERISTIC
/begin CHARACTERISTIC IP_EGY_DEW_END_ST_DOWN "Post-catalyst amount of heat depending on start temperature and manifold wall temperature" MAP 0x47168 _REC_MAP_20_u2_u1_u2 7456.426000000001 _CNV_A_R_LINEAR_____425_CM 0. 7456.426 FORMAT "%6.1"
 /begin AXIS_DESCR COM_AXIS TCO_ST _CNV_A_R_LINEAR_____0_CM 8 -48. 142.5 FORMAT "%5.1" AXIS_PTS_REF ldpm_tco_st__dew /end AXIS_DESCR
 /begin AXIS_DESCR COM_AXIS ONLINE_DUMMY _CNV_A_R_LINEAR_____269_CM 8 -48. 1459.3 FORMAT "%7.2" AXIS_PTS_REF ldpm_teg_wall_cat_down_mdl_1 /end AXIS_DESCR
/end CHARACTERISTIC
/begin CHARACTERISTIC LC_PUC_TEG_ENA "logical constant for PUC_TEG" VALUE 0x42bbe _REC_VAL_20_u1 1. _CNV_A_R_LINEAR_____10_CM 0. 1. FORMAT "%2.0" /end CHARACTERISTIC
/begin MEASUREMENT CRLC_TEG_WALL_TCO_DIF_DOWN "Correlation constant by TOIL_DIF" UWORD _CNV_A_R_LINEAR_____348_CM 1 100. 0. 7.99987793 ECU_ADDRESS 0x3fe0c6 FORMAT "%6.4" /end MEASUREMENT
/begin MEASUREMENT CRLC_TEG_WALL_TOIL_DIF_DOWN "Correlation constant by TOIL_DIF" UWORD _CNV_A_R_LINEAR_____348_CM 1 100. 0. 7.99987793 ECU_ADDRESS 0x3fe0c4 FORMAT "%6.4" /end MEASUREMENT
/begin CHARACTERISTIC IP_FAC_VS_TEG_STAT_MAX "temperature influence by the vehicle speed" CURVE 0x4e7cf _REC_CUR_20_u1_u1 3.984375 _CNV_A_R_LINEAR_____195_CM 0. 3.984375 FORMAT "%4.2"
 /begin AXIS_DESCR COM_AXIS VS _CNV_A_R_LINEAR_____13_CM 6 0. 255. FORMAT "%3.0" AXIS_PTS_REF ldp_vs__fac_vs_teg /end AXIS_DESCR
/end CHARACTERISTIC
/begin CHARACTERISTIC IP_ADD_TEG_IGA "temperature influence by ignition angle adjustments" CURVE 0x45f9c _REC_CUR_20_u2_u2 2047. _CNV_A_R_LINEAR_____211_CM 0. 2047. FORMAT "%7.2"
 /begin AXIS_DESCR COM_AXIS POW_DIF_MAX _CNV_A_R_LINEAR_____423_CM 6 0. 434.0555 FORMAT "%7.3" AXIS_PTS_REF ldp_pow_dif_max__add_teg_iga /end AXIS_DESCR
/end CHARACTERISTIC
/begin CHARACTERISTIC IP_TEG_COR_VO_UP "Valve overlap correction depending on load engine" MAP 0x4b310 _REC_MAP_20_u2_u2_u2 983.025 _CNV_A_R_LINEAR_____415_CM -491.52 491.505 FORMAT "%7.2"
 /begin AXIS_DESCR COM_AXIS MAF_TEG _CNV_A_R_LINEAR_____95_CM 8 0. 1389. FORMAT "%7.2" AXIS_PTS_REF ldpm_maf_teg__teg_stat /end AXIS_DESCR
 /begin AXIS_DESCR COM_AXIS N_TEG _CNV_A_R_LINEAR_____17_CM 8 0. 8160. FORMAT "%4.0" AXIS_PTS_REF ldpm_n_teg__teg_stat /end AXIS_DESCR
/end CHARACTERISTIC
/begin MEASUREMENT VO_DIF_TEG "Difference of valve overlap for temperature influence" UWORD _CNV_A_R_LINEAR_____424_CM 1 100. -95.625 95.625 ECU_ADDRESS 0x3fe0dc FORMAT "%5.1" /end MEASUREMENT
/begin CHARACTERISTIC IP_EFF_IGA_AV_TEG_COR "Basic pre control engine temperature" MAP 0x465e0 _REC_MAP_20_u2_u2_u2 4. _CNV_A_R_LINEAR_____271_CM -2. 2. FORMAT "%8.5"
 /begin AXIS_DESCR COM_AXIS MAF_TEG _CNV_A_R_LINEAR_____95_CM 8 0. 1389. FORMAT "%7.2" AXIS_PTS_REF ldpm_maf_teg__teg_stat /end AXIS_DESCR
 /begin AXIS_DESCR COM_AXIS N_TEG _CNV_A_R_LINEAR_____17_CM 8 0. 8160. FORMAT "%4.0" AXIS_PTS_REF ldpm_n_teg__teg_stat /end AXIS_DESCR
/end CHARACTERISTIC
/begin CHARACTERISTIC IP_TEG_COR_EFF_IGA_UP "Power loss influences by IGA temperature correction depending on load engine" MAP 0x4b290 _REC_MAP_20_u2_u2_u2 983.025 _CNV_A_R_LINEAR_____412_CM 0. 983.025 FORMAT "%6.2"
 /begin AXIS_DESCR COM_AXIS MAF_TEG _CNV_A_R_LINEAR_____95_CM 8 0. 1389. FORMAT "%7.2" AXIS_PTS_REF ldpm_maf_teg__teg_stat /end AXIS_DESCR
 /begin AXIS_DESCR COM_AXIS N_TEG _CNV_A_R_LINEAR_____17_CM 8 0. 8160. FORMAT "%4.0" AXIS_PTS_REF ldpm_n_teg__teg_stat /end AXIS_DESCR
/end CHARACTERISTIC
/begin CHARACTERISTIC IP_TEMP_SP_TCO "Reference engine TCO temperature" MAP 0x507c0 _REC_MAP_20_u1_u2_u2 190.5 _CNV_A_R_LINEAR_____0_CM -48. 142.5 FORMAT "%5.1"
 /begin AXIS_DESCR COM_AXIS MAF_TEG _CNV_A_R_LINEAR_____95_CM 8 0. 1389. FORMAT "%7.2" AXIS_PTS_REF ldpm_maf_teg__teg_stat /end AXIS_DESCR
 /begin AXIS_DESCR COM_AXIS N_TEG _CNV_A_R_LINEAR_____17_CM 8 0. 8160. FORMAT "%4.0" AXIS_PTS_REF ldpm_n_teg__teg_stat /end AXIS_DESCR
/end CHARACTERISTIC
/begin CHARACTERISTIC IP_FAC_COR_EFF_IGA_UP "influences by IGA temperature correction" CURVE 0x473f0 _REC_CUR_20_u2_u2 1.99996948 _CNV_A_R_LINEAR_____45_CM 0. 1.99996948 FORMAT "%7.5"
 /begin AXIS_DESCR COM_AXIS ONLINE_DUMMY _CNV_A_R_LINEAR_____45_CM 6 0. 1.99996948 FORMAT "%7.5" AXIS_PTS_REF ldpm_eff_iga_av_teg_cor /end AXIS_DESCR
/end CHARACTERISTIC
/begin CHARACTERISTIC C_FAC_REF_TCO_UP "Reference correction TCO" VALUE 0x428b3 _REC_VAL_20_u1 1.99220002 _CNV_A_R_LINEAR_____34_CM 0. 1.99220002 FORMAT "%5.3" /end CHARACTERISTIC
/begin CHARACTERISTIC C_FAC_REF_SCC_TCO_UP "Reference correction TCO for SCC" VALUE 0x428af _REC_VAL_20_u1 1.99220002 _CNV_A_R_LINEAR_____34_CM 0. 1.99220002 FORMAT "%5.3" /end CHARACTERISTIC
/begin CHARACTERISTIC C_FAC_TCO_EX_TEG_UP_1 "Temperature TEMP_TCO_EX_DIF correction" VALUE 0x42d2c _REC_VAL_20_u2 1.99996948 _CNV_A_R_LINEAR_____45_CM 0. 1.99996948 FORMAT "%7.5" /end CHARACTERISTIC
/begin CHARACTERISTIC C_FAC_TCO_EX_TEG_UP_2 "Temperature TEMP_TCO_EX_DIF correction" VALUE 0x42d2e _REC_VAL_20_u2 1.99996948 _CNV_A_R_LINEAR_____45_CM 0. 1.99996948 FORMAT "%7.5" /end CHARACTERISTIC
/begin CHARACTERISTIC IP_FAC_TEG_STOP_DOWN "Factor for engine off duration time" MAP 0x4793c _REC_MAP_20_u2_u1_u2 7.99987793 _CNV_A_R_LINEAR_____348_CM 0. 7.99987793 FORMAT "%6.4"
 /begin AXIS_DESCR COM_AXIS TAM_DEW _CNV_A_R_LINEAR_____0_CM 6 -48. 142.5 FORMAT "%5.1" AXIS_PTS_REF ldpm_tam_dew__fac_teg /end AXIS_DESCR
 /begin AXIS_DESCR COM_AXIS T_ES_DEW _CNV_A_R_LINEAR_____35_CM 8 0. 65535. FORMAT "%5.0" AXIS_PTS_REF ldpm_t_es_dew__fac_teg /end AXIS_DESCR
/end CHARACTERISTIC
/begin CHARACTERISTIC C_TEG_ST_ON_UP "Duct temperature threshold after start " VALUE 0x43072 _REC_VAL_20_u2 1507.3 _CNV_A_R_LINEAR_____269_CM -48. 1459.3 FORMAT "%7.2" /end CHARACTERISTIC
/begin CHARACTERISTIC C_TEG_ST_ON_DOWN "Duct temperature threshold after start " VALUE 0x43070 _REC_VAL_20_u2 1507.3 _CNV_A_R_LINEAR_____269_CM -48. 1459.3 FORMAT "%7.2" /end CHARACTERISTIC
/begin CHARACTERISTIC C_TEG_EGY_SP_END "Temperature threshold of energy setpoint after start" VALUE 0x4306a _REC_VAL_20_u2 1507.3 _CNV_A_R_LINEAR_____269_CM -48. 1459.3 FORMAT "%7.2" /end CHARACTERISTIC
/begin CHARACTERISTIC C_MAF_INT_TEG_WALL_ST_UP "Threshold of mass air" VALUE 0x42e4c _REC_VAL_20_u2 1820.398 _CNV_A_R_LINEAR_____277_CM 0. 1820.398 FORMAT "%7.2" /end CHARACTERISTIC
/begin MEASUREMENT TEG_COR_VO_DOWN "Valve overlap temp. correction " SWORD _CNV_A_R_LINEAR_____416_CM 1 100. -491.519999999553 491.5 ECU_ADDRESS 0x3fe0a4 FORMAT "%7.2" /end MEASUREMENT
/begin CHARACTERISTIC C_FAC_COR_EFF_IGA_TEG_DOWN "EFF_ IGA temperature correction depending on load engine" VALUE 0x42d04 _REC_VAL_20_u2 1.99996948 _CNV_A_R_LINEAR_____45_CM 0. 1.99996948 FORMAT "%7.5" /end CHARACTERISTIC
/begin CHARACTERISTIC C_FAC_REF_SCC_TCO_DOWN "Reference correction TCO for SCC" VALUE 0x428ae _REC_VAL_20_u1 1.99220002 _CNV_A_R_LINEAR_____34_CM 0. 1.99220002 FORMAT "%5.3" /end CHARACTERISTIC
/begin CHARACTERISTIC C_FAC_TCO_EX_TEG_DOWN_1 "TCO outlet correction post cat" VALUE 0x42d28 _REC_VAL_20_u2 1.99996948 _CNV_A_R_LINEAR_____45_CM 0. 1.99996948 FORMAT "%7.5" /end CHARACTERISTIC
/begin CHARACTERISTIC C_FAC_TCO_EX_TEG_DOWN_2 "TCO outlet correction post cat" VALUE 0x42d2a _REC_VAL_20_u2 1.99996948 _CNV_A_R_LINEAR_____45_CM 0. 1.99996948 FORMAT "%7.5" /end CHARACTERISTIC
/begin MEASUREMENT TEG_WALL_COR_TCO_UP "TCO temp. correction" SWORD _CNV_A_R_LINEAR_____419_CM 1 100. -202. 202. ECU_ADDRESS 0x3fe0b2 FORMAT "%6.1" /end MEASUREMENT
/begin CHARACTERISTIC IP_TEG_WALL_COR_EFF_IGA_UP "Power loss influences by IGA temperature correction depending on load engine" MAP 0x4b668 _REC_MAP_20_u2_u2_u2 983.025 _CNV_A_R_LINEAR_____412_CM 0. 983.025 FORMAT "%6.2"
 /begin AXIS_DESCR COM_AXIS MAF_TEG _CNV_A_R_LINEAR_____95_CM 8 0. 1389. FORMAT "%7.2" AXIS_PTS_REF ldpm_maf_teg__teg_stat /end AXIS_DESCR
 /begin AXIS_DESCR COM_AXIS N_TEG _CNV_A_R_LINEAR_____17_CM 8 0. 8160. FORMAT "%4.0" AXIS_PTS_REF ldpm_n_teg__teg_stat /end AXIS_DESCR
/end CHARACTERISTIC
/begin CHARACTERISTIC IP_FAC_COR_EFF_IGA_WALL_UP "Power loss influences by IGA temperature correction" CURVE 0x473fc _REC_CUR_20_u2_u2 1.99996948 _CNV_A_R_LINEAR_____45_CM 0. 1.99996948 FORMAT "%7.5"
 /begin AXIS_DESCR COM_AXIS ONLINE_DUMMY _CNV_A_R_LINEAR_____45_CM 6 0. 1.99996948 FORMAT "%7.5" AXIS_PTS_REF ldpm_eff_iga_av_teg_cor /end AXIS_DESCR
/end CHARACTERISTIC
/begin CHARACTERISTIC C_FAC_REF_TCO_DOWN "Reference correction TCO" VALUE 0x428b2 _REC_VAL_20_u1 1.99220002 _CNV_A_R_LINEAR_____34_CM 0. 1.99220002 FORMAT "%5.3" /end CHARACTERISTIC
/begin CHARACTERISTIC IP_TEG_WALL_COR_VO_UP "Valve overlap correction depending on load engine" MAP 0x4b6e8 _REC_MAP_20_u2_u2_u2 983.025 _CNV_A_R_LINEAR_____415_CM -491.52 491.505 FORMAT "%7.2"
 /begin AXIS_DESCR COM_AXIS MAF_TEG _CNV_A_R_LINEAR_____95_CM 8 0. 1389. FORMAT "%7.2" AXIS_PTS_REF ldpm_maf_teg__teg_stat /end AXIS_DESCR
 /begin AXIS_DESCR COM_AXIS N_TEG _CNV_A_R_LINEAR_____17_CM 8 0. 8160. FORMAT "%4.0" AXIS_PTS_REF ldpm_n_teg__teg_stat /end AXIS_DESCR
/end CHARACTERISTIC
/begin CHARACTERISTIC IP_TEG_WALL_COR_VS_UP "Vehicle speed correction depending on load Engine" MAP 0x4b768 _REC_MAP_20_u2_u2_u2 983.025 _CNV_A_R_LINEAR_____415_CM -491.52 491.505 FORMAT "%7.2"
 /begin AXIS_DESCR COM_AXIS MAF_TEG _CNV_A_R_LINEAR_____95_CM 8 0. 1389. FORMAT "%7.2" AXIS_PTS_REF ldpm_maf_teg__vs_teg /end AXIS_DESCR
 /begin AXIS_DESCR COM_AXIS N_TEG _CNV_A_R_LINEAR_____17_CM 8 0. 8160. FORMAT "%4.0" AXIS_PTS_REF ldpm_n_teg__vs_teg /end AXIS_DESCR
/end CHARACTERISTIC
/begin CHARACTERISTIC C_FAC_TCO_EX_TEG_WALL_UP_2 "TCO_EX correction" VALUE 0x42d36 _REC_VAL_20_u2 1.99996948 _CNV_A_R_LINEAR_____45_CM 0. 1.99996948 FORMAT "%7.5" /end CHARACTERISTIC
/begin CHARACTERISTIC IP_FAC_TEG_WALL_STOP_UP "Factor for engine off duration time" MAP 0x47adc _REC_MAP_20_u2_u1_u2 7.99987793 _CNV_A_R_LINEAR_____348_CM 0. 7.99987793 FORMAT "%6.4"
 /begin AXIS_DESCR COM_AXIS TAM_DEW _CNV_A_R_LINEAR_____0_CM 6 -48. 142.5 FORMAT "%5.1" AXIS_PTS_REF ldpm_tam_dew__fac_teg /end AXIS_DESCR
 /begin AXIS_DESCR COM_AXIS T_ES_DEW _CNV_A_R_LINEAR_____35_CM 8 0. 65535. FORMAT "%5.0" AXIS_PTS_REF ldpm_t_es_dew__fac_teg /end AXIS_DESCR
/end CHARACTERISTIC
/begin CHARACTERISTIC C_TEG_WALL_EGY_SP_END "Temperature threshold of energy setpoint after start" VALUE 0x43076 _REC_VAL_20_u2 1507.3 _CNV_A_R_LINEAR_____269_CM -48. 1459.3 FORMAT "%7.2" /end CHARACTERISTIC
/begin MEASUREMENT TEG_WALL_COR_VO_UP "Valve overlap temp. correction" SWORD _CNV_A_R_LINEAR_____416_CM 1 100. -491.519999999553 491.5 ECU_ADDRESS 0x3fe0b0 FORMAT "%7.2" /end MEASUREMENT
/begin MEASUREMENT TEG_WALL_COR_TCO_DOWN "TCO temp. correction" SWORD _CNV_A_R_LINEAR_____419_CM 1 100. -202. 202. ECU_ADDRESS 0x3fe0be FORMAT "%6.1" /end MEASUREMENT
/begin CHARACTERISTIC C_FAC_COR_EFF_IGA_TEG_WALL_DOWN "Power loss influences by IGA temperature correction depending on load engine" VALUE 0x42d06 _REC_VAL_20_u2 1.99996948 _CNV_A_R_LINEAR_____45_CM 0. 1.99996948 FORMAT "%7.5" /end CHARACTERISTIC
/begin CHARACTERISTIC C_FAC_REF_SCC_TCO_WALL_UP "Referenz TCO correction for SCC" VALUE 0x428b1 _REC_VAL_20_u1 1.99220002 _CNV_A_R_LINEAR_____34_CM 0. 1.99220002 FORMAT "%5.3" /end CHARACTERISTIC
/begin CHARACTERISTIC C_FAC_REF_SCC_TCO_WALL_DOWN "Referenz TCO correction for SCC" VALUE 0x428b0 _REC_VAL_20_u1 1.99220002 _CNV_A_R_LINEAR_____34_CM 0. 1.99220002 FORMAT "%5.3" /end CHARACTERISTIC
/begin CHARACTERISTIC C_FAC_REF_TCO_WALL_UP "Referenz TCO correction" VALUE 0x428b5 _REC_VAL_20_u1 1.99220002 _CNV_A_R_LINEAR_____34_CM 0. 1.99220002 FORMAT "%5.3" /end CHARACTERISTIC
/begin CHARACTERISTIC C_FAC_REF_TCO_WALL_DOWN "Referenz TCO correction" VALUE 0x428b4 _REC_VAL_20_u1 1.99220002 _CNV_A_R_LINEAR_____34_CM 0. 1.99220002 FORMAT "%5.3" /end CHARACTERISTIC
/begin CHARACTERISTIC C_TEG_WALL_RED "Reference temperature, by_reduced temperature" VALUE 0x4307a _REC_VAL_20_u2 1507.3 _CNV_A_R_LINEAR_____269_CM -48. 1459.3 FORMAT "%7.2" /end CHARACTERISTIC
/begin CHARACTERISTIC C_TEG_WALL_DEW_ST "Reference temperature, condensation on start" VALUE 0x43074 _REC_VAL_20_u2 1507.3 _CNV_A_R_LINEAR_____269_CM -48. 1459.3 FORMAT "%7.2" /end CHARACTERISTIC
/begin CHARACTERISTIC C_TEG_WALL_HYS "Reference temperature, by reduced temperature" VALUE 0x43078 _REC_VAL_20_u2 188.39 _CNV_A_R_LINEAR_____426_CM 0. 188.39 FORMAT "%6.2" /end CHARACTERISTIC
/begin CHARACTERISTIC C_TEG_DIF_GRAD_MIN "temperature range limit" VALUE 0x43064 _REC_VAL_20_u2 1507.3 _CNV_A_R_LINEAR_____427_CM 0. 1507.3 FORMAT "%7.3" /end CHARACTERISTIC
/begin CHARACTERISTIC C_TEG_DIF_LEVEL_MIN "temperature range limit" VALUE 0x43066 _REC_VAL_20_u2 1507.3 _CNV_A_R_LINEAR_____427_CM 0. 1507.3 FORMAT "%7.3" /end CHARACTERISTIC
/begin CHARACTERISTIC C_FAC_TCO_EX_TEG_WALL_UP_1 "TCO_EX correction" VALUE 0x42d34 _REC_VAL_20_u2 1.99996948 _CNV_A_R_LINEAR_____45_CM 0. 1.99996948 FORMAT "%7.5" /end CHARACTERISTIC
/begin CHARACTERISTIC C_FAC_TCO_EX_TEG_WALL_DOWN_1 "TCO_EX correction" VALUE 0x42d30 _REC_VAL_20_u2 1.99996948 _CNV_A_R_LINEAR_____45_CM 0. 1.99996948 FORMAT "%7.5" /end CHARACTERISTIC
/begin CHARACTERISTIC C_FAC_TCO_EX_TEG_WALL_DOWN_2 "TCO_EX correction" VALUE 0x42d32 _REC_VAL_20_u2 1.99996948 _CNV_A_R_LINEAR_____45_CM 0. 1.99996948 FORMAT "%7.5" /end CHARACTERISTIC
/begin MEASUREMENT TEMP_TCO_DIF "Coolant  temperature  difference" SWORD _CNV_A_R_LINEAR_____419_CM 1 100. -202. 202. ECU_ADDRESS 0x3fe098 FORMAT "%6.1" /end MEASUREMENT
/begin MEASUREMENT TEG_COR_TCO_UP "TCO temperature  correction" SWORD _CNV_A_R_LINEAR_____419_CM 1 100. -202. 202. ECU_ADDRESS 0x3fe092 FORMAT "%6.1" /end MEASUREMENT
/begin MEASUREMENT TEG_COR_TCO_DOWN "TCO temperature  correction" SWORD _CNV_A_R_LINEAR_____419_CM 1 100. -202. 202. ECU_ADDRESS 0x3fe0a6 FORMAT "%6.1" /end MEASUREMENT
/begin MEASUREMENT TEG_COR_VS_DOWN "Vehicle speed correction depending on load engine" SWORD _CNV_A_R_LINEAR_____416_CM 1 100. -491.519999999553 491.5 ECU_ADDRESS 0x3fe0aa FORMAT "%7.2" /end MEASUREMENT
/begin MEASUREMENT TEG_COR_VS_UP "Vehicle speed correction depending on load engine" SWORD _CNV_A_R_LINEAR_____416_CM 1 100. -491.519999999553 491.5 ECU_ADDRESS 0x3fe09a FORMAT "%7.2" /end MEASUREMENT
/begin MEASUREMENT TEG_WALL_COR_VS_DOWN "Vehicle speed correction depending on load engine" SWORD _CNV_A_R_LINEAR_____416_CM 1 100. -491.519999999553 491.5 ECU_ADDRESS 0x3fe0c2 FORMAT "%7.2" /end MEASUREMENT
/begin MEASUREMENT TEG_WALL_COR_VS_UP "Vehicle speed correction depending on load engine" SWORD _CNV_A_R_LINEAR_____416_CM 1 100. -491.519999999553 491.5 ECU_ADDRESS 0x3fe0b6 FORMAT "%7.2" /end MEASUREMENT
/begin CHARACTERISTIC IP_TEG_STAT_UP_2 "Basic pre control engine temperature" MAP 0x4b5a0 _REC_MAP_20_u2_u2_u2 1507.3 _CNV_A_R_LINEAR_____269_CM -48. 1459.3 FORMAT "%7.2"
 /begin AXIS_DESCR COM_AXIS MAF_TEG _CNV_A_R_LINEAR_____95_CM 8 0. 1389. FORMAT "%7.2" AXIS_PTS_REF ldpm_maf_teg__teg_stat /end AXIS_DESCR
 /begin AXIS_DESCR COM_AXIS N_TEG _CNV_A_R_LINEAR_____17_CM 8 0. 8160. FORMAT "%4.0" AXIS_PTS_REF ldpm_n_teg__teg_stat /end AXIS_DESCR
/end CHARACTERISTIC
/begin CHARACTERISTIC IP_TEG_WALL_STAT_UP_2 "Basic pre control engine temperature " MAP 0x4b968 _REC_MAP_20_u2_u2_u2 1507.3 _CNV_A_R_LINEAR_____269_CM -48. 1459.3 FORMAT "%7.2"
 /begin AXIS_DESCR COM_AXIS MAF_TEG _CNV_A_R_LINEAR_____95_CM 8 0. 1389. FORMAT "%7.2" AXIS_PTS_REF ldpm_maf_teg__teg_stat /end AXIS_DESCR
 /begin AXIS_DESCR COM_AXIS N_TEG _CNV_A_R_LINEAR_____17_CM 8 0. 8160. FORMAT "%4.0" AXIS_PTS_REF ldpm_n_teg__teg_stat /end AXIS_DESCR
/end CHARACTERISTIC
/begin CHARACTERISTIC IP_CRLC_TEG_DEC_PUC_UP_2 "Map of correlation constant by fuel cut off" CURVE 0x461f6 _REC_CUR_20_u2_u2 0.99998474 _CNV_A_R_LINEAR_____31_CM 0. 0.99998474 FORMAT "%7.5"
 /begin AXIS_DESCR COM_AXIS ONLINE_DUMMY _CNV_A_R_LINEAR_____277_CM 8 0. 1820.398 FORMAT "%7.2" AXIS_PTS_REF ldpm_maf_int_puc__crlc_teg /end AXIS_DESCR
/end CHARACTERISTIC
/begin CHARACTERISTIC IP_CRLC_TEG_WALL_DEC_PUC_UP_2 "Map of correlation constant by fuel cut off" CURVE 0x46336 _REC_CUR_20_u2_u2 0.99998474 _CNV_A_R_LINEAR_____31_CM 0. 0.99998474 FORMAT "%7.5"
 /begin AXIS_DESCR COM_AXIS ONLINE_DUMMY _CNV_A_R_LINEAR_____277_CM 8 0. 1820.398 FORMAT "%7.2" AXIS_PTS_REF ldpm_maf_int_puc__crlc_teg /end AXIS_DESCR
/end CHARACTERISTIC
/begin CHARACTERISTIC IP_CRLC_TEG_INC_UP_2 "Map of correlation constant by heating" CURVE 0x4627e _REC_CUR_20_u2_u2 0.99998474 _CNV_A_R_LINEAR_____31_CM 0. 0.99998474 FORMAT "%7.5"
 /begin AXIS_DESCR COM_AXIS ONLINE_DUMMY _CNV_A_R_LINEAR_____269_CM 12 -48. 1459.3 FORMAT "%7.2" AXIS_PTS_REF ldpm_teg_stat__crlc_inc /end AXIS_DESCR
/end CHARACTERISTIC
/begin CHARACTERISTIC IP_CRLC_TEG_WALL_INC_UP_2 "Map of correlation constant by heating" CURVE 0x463be _REC_CUR_20_u2_u2 0.99998474 _CNV_A_R_LINEAR_____31_CM 0. 0.99998474 FORMAT "%7.5"
 /begin AXIS_DESCR COM_AXIS ONLINE_DUMMY _CNV_A_R_LINEAR_____269_CM 12 -48. 1459.3 FORMAT "%7.2" AXIS_PTS_REF ldpm_teg_wall_stat__crlc_inc /end AXIS_DESCR
/end CHARACTERISTIC
/begin CHARACTERISTIC IP_CRLC_TEG_DEC_UP_2 "Map of correlation constant by cooling" CURVE 0x4621e _REC_CUR_20_u2_u2 0.99998474 _CNV_A_R_LINEAR_____31_CM 0. 0.99998474 FORMAT "%7.5"
 /begin AXIS_DESCR COM_AXIS ONLINE_DUMMY _CNV_A_R_LINEAR_____269_CM 12 -48. 1459.3 FORMAT "%7.2" AXIS_PTS_REF ldpm_teg_stat__crlc_dec /end AXIS_DESCR
/end CHARACTERISTIC
/begin CHARACTERISTIC IP_CRLC_TEG_WALL_DEC_UP_2 "Map of correlation constant by cooling" CURVE 0x4635e _REC_CUR_20_u2_u2 0.99998474 _CNV_A_R_LINEAR_____31_CM 0. 0.99998474 FORMAT "%7.5"
 /begin AXIS_DESCR COM_AXIS ONLINE_DUMMY _CNV_A_R_LINEAR_____269_CM 12 -48. 1459.3 FORMAT "%7.2" AXIS_PTS_REF ldpm_teg_wall_stat__crlc_dec /end AXIS_DESCR
/end CHARACTERISTIC
/begin CHARACTERISTIC IP_TEG_STAT_DOWN_2 "Basic pre control engine temperature " MAP 0x4b4a0 _REC_MAP_20_u2_u2_u2 1507.3 _CNV_A_R_LINEAR_____269_CM -48. 1459.3 FORMAT "%7.2"
 /begin AXIS_DESCR COM_AXIS MAF_TEG _CNV_A_R_LINEAR_____95_CM 8 0. 1389. FORMAT "%7.2" AXIS_PTS_REF ldpm_maf_teg__teg_stat /end AXIS_DESCR
 /begin AXIS_DESCR COM_AXIS N_TEG _CNV_A_R_LINEAR_____17_CM 8 0. 8160. FORMAT "%4.0" AXIS_PTS_REF ldpm_n_teg__teg_stat /end AXIS_DESCR
/end CHARACTERISTIC
/begin CHARACTERISTIC IP_TEG_WALL_STAT_DOWN_2 "Basic pre control engine temperature " MAP 0x4b868 _REC_MAP_20_u2_u2_u2 1507.3 _CNV_A_R_LINEAR_____269_CM -48. 1459.3 FORMAT "%7.2"
 /begin AXIS_DESCR COM_AXIS MAF_TEG _CNV_A_R_LINEAR_____95_CM 8 0. 1389. FORMAT "%7.2" AXIS_PTS_REF ldpm_maf_teg__teg_stat /end AXIS_DESCR
 /begin AXIS_DESCR COM_AXIS N_TEG _CNV_A_R_LINEAR_____17_CM 8 0. 8160. FORMAT "%4.0" AXIS_PTS_REF ldpm_n_teg__teg_stat /end AXIS_DESCR
/end CHARACTERISTIC
/begin CHARACTERISTIC IP_CRLC_TEG_DEC_PUC_DOWN_2 "Map of correlation constant by fuel cut off post cat." CURVE 0x461d6 _REC_CUR_20_u2_u2 0.99998474 _CNV_A_R_LINEAR_____31_CM 0. 0.99998474 FORMAT "%7.5"
 /begin AXIS_DESCR COM_AXIS ONLINE_DUMMY _CNV_A_R_LINEAR_____277_CM 8 0. 1820.398 FORMAT "%7.2" AXIS_PTS_REF ldpm_maf_int_puc__crlc_teg /end AXIS_DESCR
/end CHARACTERISTIC
/begin CHARACTERISTIC IP_CRLC_TEG_WALL_DEC_PUC_DOWN_2 "Map of correlation constant by fuel cut off post cat." CURVE 0x46316 _REC_CUR_20_u2_u2 0.99998474 _CNV_A_R_LINEAR_____31_CM 0. 0.99998474 FORMAT "%7.5"
 /begin AXIS_DESCR COM_AXIS ONLINE_DUMMY _CNV_A_R_LINEAR_____277_CM 8 0. 1820.398 FORMAT "%7.2" AXIS_PTS_REF ldpm_maf_int_puc__crlc_teg /end AXIS_DESCR
/end CHARACTERISTIC
/begin CHARACTERISTIC IP_CRLC_TEG_DEC_DOWN_2 "Map of correlation constant by cooling post cat." CURVE 0x461ae _REC_CUR_20_u2_u2 0.99998474 _CNV_A_R_LINEAR_____31_CM 0. 0.99998474 FORMAT "%7.5"
 /begin AXIS_DESCR COM_AXIS ONLINE_DUMMY _CNV_A_R_LINEAR_____269_CM 12 -48. 1459.3 FORMAT "%7.2" AXIS_PTS_REF ldpm_teg_stat__crlc_dec /end AXIS_DESCR
/end CHARACTERISTIC
/begin CHARACTERISTIC IP_CRLC_TEG_WALL_DEC_DOWN_2 "Map of correlation constant by cooling post cat." CURVE 0x462ee _REC_CUR_20_u2_u2 0.99998474 _CNV_A_R_LINEAR_____31_CM 0. 0.99998474 FORMAT "%7.5"
 /begin AXIS_DESCR COM_AXIS ONLINE_DUMMY _CNV_A_R_LINEAR_____269_CM 12 -48. 1459.3 FORMAT "%7.2" AXIS_PTS_REF ldpm_teg_wall_stat__crlc_dec /end AXIS_DESCR
/end CHARACTERISTIC
/begin CHARACTERISTIC IP_CRLC_TEG_INC_DOWN_2 "Map of correlation constant by heating post cat." CURVE 0x4624e _REC_CUR_20_u2_u2 0.99998474 _CNV_A_R_LINEAR_____31_CM 0. 0.99998474 FORMAT "%7.5"
 /begin AXIS_DESCR COM_AXIS ONLINE_DUMMY _CNV_A_R_LINEAR_____269_CM 12 -48. 1459.3 FORMAT "%7.2" AXIS_PTS_REF ldpm_teg_stat__crlc_inc /end AXIS_DESCR
/end CHARACTERISTIC
/begin CHARACTERISTIC IP_CRLC_TEG_WALL_INC_DOWN_2 "Map of correlation constant by heating post cat." CURVE 0x4638e _REC_CUR_20_u2_u2 0.99998474 _CNV_A_R_LINEAR_____31_CM 0. 0.99998474 FORMAT "%7.5"
 /begin AXIS_DESCR COM_AXIS ONLINE_DUMMY _CNV_A_R_LINEAR_____269_CM 12 -48. 1459.3 FORMAT "%7.2" AXIS_PTS_REF ldpm_teg_wall_stat__crlc_inc /end AXIS_DESCR
/end CHARACTERISTIC
/begin CHARACTERISTIC IP_FAC_TEG_STOP_UP "Factor for engine off duration time" MAP 0x4799c _REC_MAP_20_u2_u1_u2 7.99987793 _CNV_A_R_LINEAR_____348_CM 0. 7.99987793 FORMAT "%6.4"
 /begin AXIS_DESCR COM_AXIS TAM_DEW _CNV_A_R_LINEAR_____0_CM 6 -48. 142.5 FORMAT "%5.1" AXIS_PTS_REF ldpm_tam_dew__fac_teg /end AXIS_DESCR
 /begin AXIS_DESCR COM_AXIS T_ES_DEW _CNV_A_R_LINEAR_____35_CM 8 0. 65535. FORMAT "%5.0" AXIS_PTS_REF ldpm_t_es_dew__fac_teg /end AXIS_DESCR
/end CHARACTERISTIC
/begin CHARACTERISTIC IP_FAC_TEG_WALL_STOP_DOWN "Factor for engine off duration time" MAP 0x47a7c _REC_MAP_20_u2_u1_u2 7.99987793 _CNV_A_R_LINEAR_____348_CM 0. 7.99987793 FORMAT "%6.4"
 /begin AXIS_DESCR COM_AXIS TAM_DEW _CNV_A_R_LINEAR_____0_CM 6 -48. 142.5 FORMAT "%5.1" AXIS_PTS_REF ldpm_tam_dew__fac_teg /end AXIS_DESCR
 /begin AXIS_DESCR COM_AXIS T_ES_DEW _CNV_A_R_LINEAR_____35_CM 8 0. 65535. FORMAT "%5.0" AXIS_PTS_REF ldpm_t_es_dew__fac_teg /end AXIS_DESCR
/end CHARACTERISTIC
/begin AXIS_PTS ldpm_teg_stat_eng_pre "" 0x454dc TEG_STAT _REC_AXS_20_u2 1507.3 _CNV_A_R_LINEAR_____269_CM 6 -48. 1459.3 FORMAT "%7.2" /end AXIS_PTS
/begin AXIS_PTS ldpm_egr_ratio__teg "" 0x44f1a EGR_RATIO _REC_AXS_20_u2 99.99847412 _CNV_A_R_LINEAR_____94_CM 6 0. 99.99847412 /end AXIS_PTS
/begin AXIS_PTS ldpm_temp_toil_dif__fac_temp "" 0x45590 TEMP_TOIL_DIF _REC_AXS_20_u2 404. _CNV_A_R_LINEAR_____420_CM 6 -202. 202. FORMAT "%6.1" /end AXIS_PTS
/begin AXIS_PTS ldpm_lamb_sp_teg__fac_cor "" 0x44fca LAMB_SP_TEG _REC_AXS_20_u2 31.99902344 _CNV_A_R_LINEAR_____148_CM 16 0. 31.99902344 FORMAT "%7.4" /end AXIS_PTS
/begin AXIS_PTS ldpm_nr_cyl_scc_teg__fac_scc "" 0x43ee4 NR_CYL_SCC_TEG _REC_AXS_20_u1 13. _CNV_A_R_LINEAR_____411_CM 14 0. 13. FORMAT "%4.1" /end AXIS_PTS
/begin AXIS_PTS ldpm_ecfpwm_ecf__fac_cor "" 0x43b9e ECFPWM_ECF _REC_AXS_20_u1 99.609375 _CNV_A_R_LINEAR_____4_CM 6 0. 99.609375 FORMAT "%4.1" /end AXIS_PTS
/begin AXIS_PTS ldp_teg_stat__fac_tam "" 0x44af8 TEG_STAT _REC_AXS_20_u2 1507.3 _CNV_A_R_LINEAR_____269_CM 6 -48. 1459.3 FORMAT "%7.2" /end AXIS_PTS
/begin AXIS_PTS ldpm_tam_dew__fac_teg "" 0x43f2e TAM_DEW _REC_AXS_20_u1 190.5 _CNV_A_R_LINEAR_____0_CM 6 -48. 142.5 FORMAT "%5.1" /end AXIS_PTS
/begin AXIS_PTS ldpm_t_es_dew__fac_teg "" 0x4544c T_ES_DEW _REC_AXS_20_u2 65535. _CNV_A_R_LINEAR_____35_CM 8 0. 65535. FORMAT "%5.0" /end AXIS_PTS
/begin AXIS_PTS ldpm_temp_toil_dif__crlc_teg "" 0x4557e TEMP_TOIL_DIF _REC_AXS_20_u2 404. _CNV_A_R_LINEAR_____420_CM 8 -202. 202. FORMAT "%6.1" /end AXIS_PTS
/begin AXIS_PTS ldpm_temp_tco_dif__crlc_teg "" 0x4556c TEMP_TCO_DIF _REC_AXS_20_u2 404. _CNV_A_R_LINEAR_____421_CM 8 -202. 202. FORMAT "%6.1" /end AXIS_PTS
/begin AXIS_PTS ldpm_maf_int_puc__crlc_teg "" 0x450d8 MAF_INT_PUC _REC_AXS_20_u2 1820.398 _CNV_A_R_LINEAR_____277_CM 8 0. 1820.398 FORMAT "%7.2" /end AXIS_PTS
/begin AXIS_PTS ldpm_n_teg__vs_teg "" 0x4534a N_TEG _REC_AXS_20_u2 8160. _CNV_A_R_LINEAR_____17_CM 8 0. 8160. FORMAT "%4.0" /end AXIS_PTS
/begin AXIS_PTS ldpm_tco_st__dew "" 0x4402d TCO_ST _REC_AXS_20_u1 190.5 _CNV_A_R_LINEAR_____0_CM 8 -48. 142.5 FORMAT "%5.1" /end AXIS_PTS
/begin AXIS_PTS ldpm_teg_wall_cat_up_mdl_1 "" 0x454fc TEG_WALL_CAT_UP_MDL _REC_AXS_20_u2 1507.3 _CNV_A_R_LINEAR_____269_CM 8 -48. 1459.3 FORMAT "%7.2" /end AXIS_PTS
/begin AXIS_PTS ldpm_teg_wall_cat_down_mdl_1 "" 0x454ea TEG_WALL_CAT_DOWN_MDL _REC_AXS_20_u2 1507.3 _CNV_A_R_LINEAR_____269_CM 8 -48. 1459.3 FORMAT "%7.2" /end AXIS_PTS
/begin AXIS_PTS ldp_vs__fac_vs_teg "" 0x43b2d VS _REC_AXS_20_u1 255. _CNV_A_R_LINEAR_____13_CM 6 0. 255. FORMAT "%3.0" /end AXIS_PTS
/begin AXIS_PTS ldp_pow_dif_max__add_teg_iga "" 0x449d2 POW_DIF_MAX _REC_AXS_20_u2 434.0555000000001 _CNV_A_R_LINEAR_____423_CM 6 0. 434.0555 FORMAT "%7.3" /end AXIS_PTS
/begin AXIS_PTS ldpm_vo_dif_teg__teg_stat "" 0x4565a VO_DIF_TEG _REC_AXS_20_u2 191.25 _CNV_A_R_LINEAR_____424_CM 6 -95.625 95.625 FORMAT "%5.1" /end AXIS_PTS
/begin AXIS_PTS ldpm_eff_iga_av_teg_cor "" 0x44f02 EFF_IGA_AV_TEG_COR _REC_AXS_20_u2 1.99996948 _CNV_A_R_LINEAR_____45_CM 6 0. 1.99996948 FORMAT "%7.5" /end AXIS_PTS
/begin AXIS_PTS ldpm_teg_stat__crlc_dec "" 0x454a8 TEG_STAT _REC_AXS_20_u2 1507.3 _CNV_A_R_LINEAR_____269_CM 12 -48. 1459.3 FORMAT "%7.2" /end AXIS_PTS
/begin AXIS_PTS ldpm_teg_wall_stat__crlc_dec "" 0x4550e TEG_WALL_STAT _REC_AXS_20_u2 1507.3 _CNV_A_R_LINEAR_____269_CM 12 -48. 1459.3 FORMAT "%7.2" /end AXIS_PTS
/begin AXIS_PTS ldpm_teg_stat__crlc_inc "" 0x454c2 TEG_STAT _REC_AXS_20_u2 1507.3 _CNV_A_R_LINEAR_____269_CM 12 -48. 1459.3 FORMAT "%7.2" /end AXIS_PTS
/begin AXIS_PTS ldpm_teg_wall_stat__crlc_inc "" 0x45528 TEG_WALL_STAT _REC_AXS_20_u2 1507.3 _CNV_A_R_LINEAR_____269_CM 12 -48. 1459.3 FORMAT "%7.2" /end AXIS_PTS
/begin CHARACTERISTIC IP_FAC_TEMP_TOIL_DIF_UP "Reference Oil temperature correction" CURVE 0x47b48 _REC_CUR_20_u2_u2 1.99996948 _CNV_A_R_LINEAR_____45_CM 0. 1.99996948 FORMAT "%7.5"
 /begin AXIS_DESCR COM_AXIS TEMP_TOIL_DIF _CNV_A_R_LINEAR_____420_CM 6 -202. 202. FORMAT "%6.1" AXIS_PTS_REF ldpm_temp_toil_dif__fac_temp /end AXIS_DESCR
/end CHARACTERISTIC
/begin AXIS_PTS ldpm_maf_teg__vs_teg "" 0x45164 MAF_TEG _REC_AXS_20_u2 1389. _CNV_A_R_LINEAR_____95_CM 8 0. 1389. FORMAT "%7.2" /end AXIS_PTS
/begin CHARACTERISTIC IP_TEG_COR_VS_UP "Vehicle speed correction depending on load Engine" MAP 0x4b390 _REC_MAP_20_u2_u2_u2 983.025 _CNV_A_R_LINEAR_____415_CM -491.52 491.505 FORMAT "%7.2"
 /begin AXIS_DESCR COM_AXIS MAF_TEG _CNV_A_R_LINEAR_____95_CM 8 0. 1389. FORMAT "%7.2" AXIS_PTS_REF ldpm_maf_teg__vs_teg /end AXIS_DESCR
 /begin AXIS_DESCR COM_AXIS N_TEG _CNV_A_R_LINEAR_____17_CM 8 0. 8160. FORMAT "%4.0" AXIS_PTS_REF ldpm_n_teg__vs_teg /end AXIS_DESCR
/end CHARACTERISTIC
/begin AXIS_PTS ldpm_vs__fac_cor_vs_teg_ecf "" 0x440d2 VS _REC_AXS_20_u1 255. _CNV_A_R_LINEAR_____13_CM 6 0. 255. FORMAT "%3.0" /end AXIS_PTS
/begin CHARACTERISTIC IP_VS_ECF_TEG_UP_2 "Electric cooling fan correction" CURVE 0x50da9 _REC_CUR_20_u1_u1 255. _CNV_A_R_LINEAR_____13_CM 0. 255. FORMAT "%3.0"
 /begin AXIS_DESCR COM_AXIS ECFPWM_ECF _CNV_A_R_LINEAR_____4_CM 6 0. 99.609375 FORMAT "%4.1" AXIS_PTS_REF ldpm_ecfpwm_ecf__fac_cor /end AXIS_DESCR
/end CHARACTERISTIC
/begin CHARACTERISTIC IP_FAC_TCO_EX_VS "VS influence of TCO_EX temperature" CURVE 0x478b0 _REC_CUR_20_u2_u1 7.99987793 _CNV_A_R_LINEAR_____428_CM -4. 3.99987793 FORMAT "%6.4"
 /begin AXIS_DESCR COM_AXIS TEG_1.GAS_UP_STRUCT.VS_COR_TEG_UP _CNV_A_R_LINEAR_____13_CM 6 0. 255. FORMAT "%3.0" AXIS_PTS_REF ldp_vs_cor_teg_up_1__fac_cor /end AXIS_DESCR
/end CHARACTERISTIC
/begin MEASUREMENT FAC_COR_TOIL_DIF_TEG_UP "TOIL difference correction" UWORD _CNV_A_R_LINEAR_____45_CM 1 100. 0. 1.99996948 ECU_ADDRESS 0x3fe094 FORMAT "%7.5" /end MEASUREMENT
/begin MEASUREMENT FAC_COR_TOIL_DIF_TEG_DOWN "Lambda setpoint correction" UWORD _CNV_A_R_LINEAR_____45_CM 1 100. 0. 1.99996948 ECU_ADDRESS 0x3fe0a8 FORMAT "%7.5" /end MEASUREMENT
/begin AXIS_PTS ldpm_vs_cor_teg__fac_cor "" 0x440d9 VS_COR_TEG _REC_AXS_20_u1 255. _CNV_A_R_LINEAR_____13_CM 6 0. 255. FORMAT "%3.0" /end AXIS_PTS
/begin CHARACTERISTIC IP_FAC_COR_TCO_EX_VS_UP "VS correction of TCO_EX venicle influence" CURVE 0x4746c _REC_CUR_20_u2_u1 0.9998700000000002 _CNV_A_R_LINEAR_____430_CM 0. 0.99987 FORMAT "%8.6"
 /begin AXIS_DESCR COM_AXIS ONLINE_DUMMY _CNV_A_R_LINEAR_____13_CM 6 0. 255. FORMAT "%3.0" AXIS_PTS_REF ldpm_vs_cor_teg__fac_cor /end AXIS_DESCR
/end CHARACTERISTIC
/begin CHARACTERISTIC IP_FAC_COR_TCO_EX_VS_DOWN "VS correction TCO_EX down" CURVE 0x47460 _REC_CUR_20_u2_u1 0.9998700000000002 _CNV_A_R_LINEAR_____430_CM 0. 0.99987 FORMAT "%8.6"
 /begin AXIS_DESCR COM_AXIS ONLINE_DUMMY _CNV_A_R_LINEAR_____13_CM 6 0. 255. FORMAT "%3.0" AXIS_PTS_REF ldpm_vs_cor_teg__fac_cor /end AXIS_DESCR
/end CHARACTERISTIC
/begin CHARACTERISTIC IP_VS_ECF_TEG_UP_1 "Electric cooling fan correction" CURVE 0x50da3 _REC_CUR_20_u1_u1 255. _CNV_A_R_LINEAR_____13_CM 0. 255. FORMAT "%3.0"
 /begin AXIS_DESCR COM_AXIS ECFPWM_ECF _CNV_A_R_LINEAR_____4_CM 6 0. 99.609375 FORMAT "%4.1" AXIS_PTS_REF ldpm_ecfpwm_ecf__fac_cor /end AXIS_DESCR
/end CHARACTERISTIC
/begin CHARACTERISTIC IP_VS_ECF_TEG_DOWN_2 "VS correction TCO_EX down" CURVE 0x50d9d _REC_CUR_20_u1_u1 255. _CNV_A_R_LINEAR_____13_CM 0. 255. FORMAT "%3.0"
 /begin AXIS_DESCR COM_AXIS ECFPWM_ECF _CNV_A_R_LINEAR_____4_CM 6 0. 99.609375 FORMAT "%4.1" AXIS_PTS_REF ldpm_ecfpwm_ecf__fac_cor /end AXIS_DESCR
/end CHARACTERISTIC
/begin CHARACTERISTIC IP_FAC_TEMP_TOIL_DIF_WALL_UP "Reference Oil temperature correction" CURVE 0x47b60 _REC_CUR_20_u2_u2 1.99996948 _CNV_A_R_LINEAR_____45_CM 0. 1.99996948 FORMAT "%7.5"
 /begin AXIS_DESCR COM_AXIS TEMP_TOIL_DIF _CNV_A_R_LINEAR_____420_CM 6 -202. 202. FORMAT "%6.1" AXIS_PTS_REF ldpm_temp_toil_dif__fac_temp /end AXIS_DESCR
/end CHARACTERISTIC
/begin CHARACTERISTIC IP_FAC_COR_ECF_VS_TEG "Vehicle speed correction" CURVE 0x473d8 _REC_CUR_20_u2_u1 4. _CNV_A_R_LINEAR_____271_CM -2. 2. FORMAT "%8.5"
 /begin AXIS_DESCR COM_AXIS VS _CNV_A_R_LINEAR_____13_CM 6 0. 255. FORMAT "%3.0" AXIS_PTS_REF ldpm_vs__fac_cor_vs_teg_ecf /end AXIS_DESCR
/end CHARACTERISTIC
/begin CHARACTERISTIC IP_FAC_COR_ECF_VS_TEG_WALL "Vehicle speed correction" CURVE 0x473e4 _REC_CUR_20_u2_u1 4. _CNV_A_R_LINEAR_____271_CM -2. 2. FORMAT "%8.5"
 /begin AXIS_DESCR COM_AXIS VS _CNV_A_R_LINEAR_____13_CM 6 0. 255. FORMAT "%3.0" AXIS_PTS_REF ldpm_vs__fac_cor_vs_teg_ecf /end AXIS_DESCR
/end CHARACTERISTIC
/begin CHARACTERISTIC IP_VS_ECF_TEG_DOWN_1 "VS correction TCO_EX down" CURVE 0x50d97 _REC_CUR_20_u1_u1 255. _CNV_A_R_LINEAR_____13_CM 0. 255. FORMAT "%3.0"
 /begin AXIS_DESCR COM_AXIS ECFPWM_ECF _CNV_A_R_LINEAR_____4_CM 6 0. 99.609375 FORMAT "%4.1" AXIS_PTS_REF ldpm_ecfpwm_ecf__fac_cor /end AXIS_DESCR
/end CHARACTERISTIC
/begin CHARACTERISTIC IP_VS_ECF_TEG_WALL_UP_2 "VS correction TCO_EX down" CURVE 0x50dc1 _REC_CUR_20_u1_u1 255. _CNV_A_R_LINEAR_____13_CM 0. 255. FORMAT "%3.0"
 /begin AXIS_DESCR COM_AXIS ECFPWM_ECF _CNV_A_R_LINEAR_____4_CM 6 0. 99.609375 FORMAT "%4.1" AXIS_PTS_REF ldpm_ecfpwm_ecf__fac_cor /end AXIS_DESCR
/end CHARACTERISTIC
/begin MEASUREMENT FAC_COR_TOIL_DIF_TEG_WALL_UP "TOIL difference correction" UWORD _CNV_A_R_LINEAR_____45_CM 1 100. 0. 1.99996948 ECU_ADDRESS 0x3fe0b4 FORMAT "%7.5" /end MEASUREMENT
/begin MEASUREMENT FAC_COR_TOIL_DIF_TEG_WALL_DOWN "TOIL difference correction" UWORD _CNV_A_R_LINEAR_____45_CM 1 100. 0. 1.99996948 ECU_ADDRESS 0x3fe0c0 FORMAT "%7.5" /end MEASUREMENT
/begin CHARACTERISTIC IP_FAC_TEMP_TOIL_DIF_DOWN "Reference Oil temperature correction" CURVE 0x47b3c _REC_CUR_20_u2_u2 1.99996948 _CNV_A_R_LINEAR_____45_CM 0. 1.99996948 FORMAT "%7.5"
 /begin AXIS_DESCR COM_AXIS TEMP_TOIL_DIF _CNV_A_R_LINEAR_____420_CM 6 -202. 202. FORMAT "%6.1" AXIS_PTS_REF ldpm_temp_toil_dif__fac_temp /end AXIS_DESCR
/end CHARACTERISTIC
/begin CHARACTERISTIC IP_FAC_TEMP_TOIL_DIF_WALL_DOWN "Reference Oil temperature correction" CURVE 0x47b54 _REC_CUR_20_u2_u2 1.99996948 _CNV_A_R_LINEAR_____45_CM 0. 1.99996948 FORMAT "%7.5"
 /begin AXIS_DESCR COM_AXIS TEMP_TOIL_DIF _CNV_A_R_LINEAR_____420_CM 6 -202. 202. FORMAT "%6.1" AXIS_PTS_REF ldpm_temp_toil_dif__fac_temp /end AXIS_DESCR
/end CHARACTERISTIC
/begin CHARACTERISTIC IP_VS_ECF_TEG_WALL_UP_1 "VS correction TCO_EX down" CURVE 0x50dbb _REC_CUR_20_u1_u1 255. _CNV_A_R_LINEAR_____13_CM 0. 255. FORMAT "%3.0"
 /begin AXIS_DESCR COM_AXIS ECFPWM_ECF _CNV_A_R_LINEAR_____4_CM 6 0. 99.609375 FORMAT "%4.1" AXIS_PTS_REF ldpm_ecfpwm_ecf__fac_cor /end AXIS_DESCR
/end CHARACTERISTIC
/begin CHARACTERISTIC IP_VS_ECF_TEG_WALL_DOWN_1 "VS correction TCO_EX down" CURVE 0x50daf _REC_CUR_20_u1_u1 255. _CNV_A_R_LINEAR_____13_CM 0. 255. FORMAT "%3.0"
 /begin AXIS_DESCR COM_AXIS ECFPWM_ECF _CNV_A_R_LINEAR_____4_CM 6 0. 99.609375 FORMAT "%4.1" AXIS_PTS_REF ldpm_ecfpwm_ecf__fac_cor /end AXIS_DESCR
/end CHARACTERISTIC
/begin CHARACTERISTIC IP_VS_ECF_TEG_WALL_DOWN_2 "VS correction TCO_EX down" CURVE 0x50db5 _REC_CUR_20_u1_u1 255. _CNV_A_R_LINEAR_____13_CM 0. 255. FORMAT "%3.0"
 /begin AXIS_DESCR COM_AXIS ECFPWM_ECF _CNV_A_R_LINEAR_____4_CM 6 0. 99.609375 FORMAT "%4.1" AXIS_PTS_REF ldpm_ecfpwm_ecf__fac_cor /end AXIS_DESCR
/end CHARACTERISTIC
/begin CHARACTERISTIC C_CRLC_MIN_TEG_LEVEL "Min range limit of level calculation" VALUE 0x42c78 _REC_VAL_20_u2 0.99998474 _CNV_A_R_LINEAR_____31_CM 0. 0.99998474 FORMAT "%7.5" /end CHARACTERISTIC
/begin CHARACTERISTIC C_CRLC_DIF_TEG_LEVEL "Correlation constant max. difference one step of Level calculation" VALUE 0x42c6c _REC_VAL_20_u2 0.99998474 _CNV_A_R_LINEAR_____31_CM 0. 0.99998474 FORMAT "%7.5" /end CHARACTERISTIC
/begin CHARACTERISTIC C_CRLC_DIF_TEG_GRAD "Correlation constant max. difference one step of grad calculation" VALUE 0x42c6a _REC_VAL_20_u2 0.99998474 _CNV_A_R_LINEAR_____31_CM 0. 0.99998474 FORMAT "%7.5" /end CHARACTERISTIC
/begin CHARACTERISTIC IP_FAC_COR_VS_TEG_UP_1 "Vehicle speed correction" CURVE 0x474a8 _REC_CUR_20_u2_u1 4. _CNV_A_R_LINEAR_____271_CM -2. 2. FORMAT "%8.5"
 /begin AXIS_DESCR COM_AXIS ONLINE_DUMMY _CNV_A_R_LINEAR_____13_CM 6 0. 255. FORMAT "%3.0" AXIS_PTS_REF ldpm_vs_cor_teg__fac_cor /end AXIS_DESCR
/end CHARACTERISTIC
/begin CHARACTERISTIC IP_FAC_COR_VS_TEG_UP_2 "Vehicle speed correction" CURVE 0x474b4 _REC_CUR_20_u2_u1 4. _CNV_A_R_LINEAR_____271_CM -2. 2. FORMAT "%8.5"
 /begin AXIS_DESCR COM_AXIS ONLINE_DUMMY _CNV_A_R_LINEAR_____13_CM 6 0. 255. FORMAT "%3.0" AXIS_PTS_REF ldpm_vs_cor_teg__fac_cor /end AXIS_DESCR
/end CHARACTERISTIC
/begin CHARACTERISTIC IP_FAC_COR_VS_TEG_DOWN_1 "VS correction TCO_EX down" CURVE 0x47490 _REC_CUR_20_u2_u1 4. _CNV_A_R_LINEAR_____271_CM -2. 2. FORMAT "%8.5"
 /begin AXIS_DESCR COM_AXIS ONLINE_DUMMY _CNV_A_R_LINEAR_____13_CM 6 0. 255. FORMAT "%3.0" AXIS_PTS_REF ldpm_vs_cor_teg__fac_cor /end AXIS_DESCR
/end CHARACTERISTIC
/begin CHARACTERISTIC IP_FAC_COR_VS_TEG_DOWN_2 "VS correction TCO_EX down" CURVE 0x4749c _REC_CUR_20_u2_u1 4. _CNV_A_R_LINEAR_____271_CM -2. 2. FORMAT "%8.5"
 /begin AXIS_DESCR COM_AXIS ONLINE_DUMMY _CNV_A_R_LINEAR_____13_CM 6 0. 255. FORMAT "%3.0" AXIS_PTS_REF ldpm_vs_cor_teg__fac_cor /end AXIS_DESCR
/end CHARACTERISTIC
/begin CHARACTERISTIC IP_FAC_COR_VS_TEG_WALL_UP_1 "VS correction TCO_EX down" CURVE 0x474d8 _REC_CUR_20_u2_u1 4. _CNV_A_R_LINEAR_____271_CM -2. 2. FORMAT "%8.5"
 /begin AXIS_DESCR COM_AXIS ONLINE_DUMMY _CNV_A_R_LINEAR_____13_CM 6 0. 255. FORMAT "%3.0" AXIS_PTS_REF ldpm_vs_cor_teg__fac_cor /end AXIS_DESCR
/end CHARACTERISTIC
/begin CHARACTERISTIC IP_FAC_COR_VS_TEG_WALL_UP_2 "VS correction TCO_EX down" CURVE 0x474e4 _REC_CUR_20_u2_u1 4. _CNV_A_R_LINEAR_____271_CM -2. 2. FORMAT "%8.5"
 /begin AXIS_DESCR COM_AXIS ONLINE_DUMMY _CNV_A_R_LINEAR_____13_CM 6 0. 255. FORMAT "%3.0" AXIS_PTS_REF ldpm_vs_cor_teg__fac_cor /end AXIS_DESCR
/end CHARACTERISTIC
/begin CHARACTERISTIC IP_FAC_COR_VS_TEG_WALL_DOWN_1 "VS correction TCO_EX down" CURVE 0x474c0 _REC_CUR_20_u2_u1 4. _CNV_A_R_LINEAR_____271_CM -2. 2. FORMAT "%8.5"
 /begin AXIS_DESCR COM_AXIS ONLINE_DUMMY _CNV_A_R_LINEAR_____13_CM 6 0. 255. FORMAT "%3.0" AXIS_PTS_REF ldpm_vs_cor_teg__fac_cor /end AXIS_DESCR
/end CHARACTERISTIC
/begin CHARACTERISTIC IP_FAC_COR_VS_TEG_WALL_DOWN_2 "VS correction TCO_EX down" CURVE 0x474cc _REC_CUR_20_u2_u1 4. _CNV_A_R_LINEAR_____271_CM -2. 2. FORMAT "%8.5"
 /begin AXIS_DESCR COM_AXIS ONLINE_DUMMY _CNV_A_R_LINEAR_____13_CM 6 0. 255. FORMAT "%3.0" AXIS_PTS_REF ldpm_vs_cor_teg__fac_cor /end AXIS_DESCR
/end CHARACTERISTIC
/begin AXIS_PTS ldp_vs_cor_teg_up_1__fac_cor "" 0x43b3a VS_COR_TEG_UP_1 _REC_AXS_20_u1 255. _CNV_A_R_LINEAR_____13_CM 6 0. 255. FORMAT "%3.0" /end AXIS_PTS
/begin AXIS_PTS ldpm_vs__fac_cor_vs_teg "" 0x440cb VS _REC_AXS_20_u1 255. _CNV_A_R_LINEAR_____13_CM 6 0. 255. FORMAT "%3.0" /end AXIS_PTS
/begin CHARACTERISTIC C_TOIL_TEG_GRAD_MIN_UP "Minimum condition of  Oil temperature for TEG gradient" VALUE 0x42ad0 _REC_VAL_20_u1 200. _CNV_A_R_LINEAR_____3_CM -40. 160. FORMAT "%3.0" /end CHARACTERISTIC
/begin CHARACTERISTIC C_TOIL_TEG_GRAD_MIN_DOWN "Minimum condition of  Oil temperature for TEG gradient" VALUE 0x42acf _REC_VAL_20_u1 200. _CNV_A_R_LINEAR_____3_CM -40. 160. FORMAT "%3.0" /end CHARACTERISTIC
/begin CHARACTERISTIC C_TOIL_TEG_LEVEL_MIN_UP "Minimum condition of Oil temperature for TEG level" VALUE 0x42ad2 _REC_VAL_20_u1 200. _CNV_A_R_LINEAR_____3_CM -40. 160. FORMAT "%3.0" /end CHARACTERISTIC
/begin CHARACTERISTIC C_TOIL_TEG_LEVEL_MIN_DOWN "Minimum condition of Oil temperature for TEG level" VALUE 0x42ad1 _REC_VAL_20_u1 200. _CNV_A_R_LINEAR_____3_CM -40. 160. FORMAT "%3.0" /end CHARACTERISTIC
/begin MEASUREMENT LV_ST_H_PRS "Logical variable indicating high pressure start active" UBYTE _CNV_S_2_RANGE______11_CM 1 100. 0. 1. ECU_ADDRESS 0x3fcf0c BIT_MASK 0x1 /end MEASUREMENT
/begin MEASUREMENT MFF_CST "Basic injection at start (LV_ST)" UWORD _CNV_A_R_LINEAR_____95_CM 1 100. 0. 1389. ECU_ADDRESS 0x3fcf06 FORMAT "%7.2" /end MEASUREMENT
/begin CHARACTERISTIC C_CYC_CAST_H_PRS "Cycle counter break off threshold to switch over to \"low pressure start\"" VALUE 0x42cb2 _REC_VAL_20_u2 65535. _CNV_A_R_LINEAR_____10_CM 0. 65535. FORMAT "%5.0" /end CHARACTERISTIC
/begin CHARACTERISTIC IP_MFF_CST "Basic value for cranking injection" MAP 0x4962a _REC_MAP_20_u2_u2_u1 1389. _CNV_A_R_LINEAR_____95_CM 0. 1389. FORMAT "%7.2"
 /begin AXIS_DESCR COM_AXIS N_TOOTH _CNV_A_R_LINEAR_____17_CM 3 0. 8160. FORMAT "%4.0" AXIS_PTS_REF ldp_n_tooth__mff_cst /end AXIS_DESCR
 /begin AXIS_DESCR COM_AXIS TCO _CNV_A_R_LINEAR_____0_CM 8 -48. 142.5 FORMAT "%5.1" AXIS_PTS_REF ldpm_tco__mff_cst /end AXIS_DESCR
/end CHARACTERISTIC
/begin CHARACTERISTIC IP_MFF_DEAC_CST "Cranking injection time deactivation factor" MAP 0x4fb4f _REC_MAP_20_u1_u1_u1 0.1494141 _CNV_A_R_LINEAR_____44_CM 0. 0.996094 FORMAT "%5.3"
 /begin AXIS_DESCR COM_AXIS CYCNR_ST _CNV_A_R_LINEAR_____10_CM 4 0. 255. FORMAT "%3.0" AXIS_PTS_REF ldp_cyc__mff_cst /end AXIS_DESCR
 /begin AXIS_DESCR COM_AXIS TCO _CNV_A_R_LINEAR_____0_CM 8 -48. 142.5 FORMAT "%5.1" AXIS_PTS_REF ldpm_tco__mff_cst /end AXIS_DESCR
/end CHARACTERISTIC
/begin CHARACTERISTIC IP_FUP_MIN_INJ_ST "Fuel pressure threshold to reach before injection is started" CURVE 0x4e7e9 _REC_CUR_20_u1_u1 173888. _CNV_A_R_LINEAR_____433_CM 0. 173888. FORMAT "%6.0"
 /begin AXIS_DESCR COM_AXIS TCO _CNV_A_R_LINEAR_____0_CM 8 -48. 142.5 FORMAT "%5.1" AXIS_PTS_REF ldpm_tco__mff_cst /end AXIS_DESCR
/end CHARACTERISTIC
/begin MEASUREMENT LV_MFF_CST_FUP_ACT "Logical variable indicating fuel pressure has reached threshold once" UBYTE _CNV_S_2_RANGE______11_CM 1 100. 0. 1. ECU_ADDRESS 0x3fcf0d BIT_MASK 0x1 /end MEASUREMENT
/begin MEASUREMENT CYC_CAST_FUP_THD "cycle counter value when high pressure injection starts" UWORD _CNV_A_R_LINEAR_____10_CM 1 100. 0. 65535. ECU_ADDRESS 0x3fe46e FORMAT "%5.0" /end MEASUREMENT
/begin CHARACTERISTIC C_TCO_ST_H_PRS "Coolant temp. threshold to select high or low pressure start " VALUE 0x42a7c _REC_VAL_20_u1 190.5 _CNV_A_R_LINEAR_____0_CM -48. 142.5 FORMAT "%5.1" /end CHARACTERISTIC
/begin AXIS_PTS ldpm_tco__mff_cst "" 0x43fb0 TCO _REC_AXS_20_u1 19.05 _CNV_A_R_LINEAR_____0_CM 8 -48. 142.5 FORMAT "%5.1" /end AXIS_PTS
/begin AXIS_PTS ldp_cyc__mff_cst "" 0x4338c CYC _REC_AXS_20_u1 255. _CNV_A_R_LINEAR_____10_CM 4 0. 255. FORMAT "%3.0" /end AXIS_PTS
/begin AXIS_PTS ldp_n_tooth__mff_cst "" 0x44964 N_TOOTH _REC_AXS_20_u2 816. _CNV_A_R_LINEAR_____17_CM 3 0. 8160. FORMAT "%4.0" /end AXIS_PTS
/begin CHARACTERISTIC ID_FAC_TIPR_DEAC "Pre injection time deactivation factor" CURVE 0x4cceb _REC_CUR_20_u1_u1 1.99220002 _CNV_A_R_LINEAR_____34_CM 0. 1.99220002 FORMAT "%5.3"
 /begin AXIS_DESCR COM_AXIS CYCNR_CST _CNV_A_R_LINEAR_____10_CM 6 0. 7. FORMAT "%2.0" AXIS_PTS_REF ldp_cycnr_cst__fac_tipr_deac /end AXIS_DESCR
/end CHARACTERISTIC
/begin MEASUREMENT BIOS_TIPR_BAS_0 "injection time preinjection" UWORD _CNV_A_R_LINEAR_____208_CM 1 100. 0. 262.14 ECU_ADDRESS 0x3fe488 FORMAT "%7.3" /end MEASUREMENT
/begin MEASUREMENT BIOS_TIPR_BAS_1 "injection time preinjection" UWORD _CNV_A_R_LINEAR_____208_CM 1 100. 0. 262.14 ECU_ADDRESS 0x3fe48a FORMAT "%7.3" /end MEASUREMENT
/begin MEASUREMENT BIOS_TIPR_BAS_2 "injection time preinjection" UWORD _CNV_A_R_LINEAR_____208_CM 1 100. 0. 262.14 ECU_ADDRESS 0x3fe48c FORMAT "%7.3" /end MEASUREMENT
/begin MEASUREMENT BIOS_TIPR_BAS_3 "injection time preinjection" UWORD _CNV_A_R_LINEAR_____208_CM 1 100. 0. 262.14 ECU_ADDRESS 0x3fe48e FORMAT "%7.3" /end MEASUREMENT
/begin MEASUREMENT BIOS_TIPR_BAS_4 "injection time preinjection" UWORD _CNV_A_R_LINEAR_____208_CM 1 100. 0. 262.14 ECU_ADDRESS 0x3fe490 FORMAT "%7.3" /end MEASUREMENT
/begin MEASUREMENT BIOS_TIPR_BAS_5 "injection time preinjection" UWORD _CNV_A_R_LINEAR_____208_CM 1 100. 0. 262.14 ECU_ADDRESS 0x3fe492 FORMAT "%7.3" /end MEASUREMENT
/begin MEASUREMENT BIOS_EOI_MIN_TIPR "Latest permitted predicted end of injection for pre-injection" UWORD _CNV_A_R_LINEAR_____75_CM 1 100. 0. 720. ECU_ADDRESS 0x3fe482 FORMAT "%6.2" /end MEASUREMENT
/begin MEASUREMENT BIOS_NR_MAX_TOOTH_TIPR "Maximum tooth number till preliminary synchronisation for preinjection" UBYTE _CNV_A_R_LINEAR_____10_CM 1 100. 1. 64. ECU_ADDRESS 0x3fe4a0 FORMAT "%3.0" /end MEASUREMENT
/begin MEASUREMENT CYCNR_CST "Pre injection counter" UBYTE _CNV_A_R_LINEAR_____10_CM 1 100. 0. 7. ECU_ADDRESS 0x3fe4a1 FORMAT "%2.0" /end MEASUREMENT
/begin MEASUREMENT TIPR_0 "Pre-injection time" UWORD _CNV_A_R_LINEAR_____208_CM 1 100. 0. 262.14 ECU_ADDRESS 0x3fe494 FORMAT "%7.3" /end MEASUREMENT
/begin MEASUREMENT TIPR_1 "Pre-injection time" UWORD _CNV_A_R_LINEAR_____208_CM 1 100. 0. 262.14 ECU_ADDRESS 0x3fe496 FORMAT "%7.3" /end MEASUREMENT
/begin MEASUREMENT TIPR_2 "Pre-injection time" UWORD _CNV_A_R_LINEAR_____208_CM 1 100. 0. 262.14 ECU_ADDRESS 0x3fe498 FORMAT "%7.3" /end MEASUREMENT
/begin MEASUREMENT TIPR_3 "Pre-injection time" UWORD _CNV_A_R_LINEAR_____208_CM 1 100. 0. 262.14 ECU_ADDRESS 0x3fe49a FORMAT "%7.3" /end MEASUREMENT
/begin MEASUREMENT TIPR_4 "Pre-injection time" UWORD _CNV_A_R_LINEAR_____208_CM 1 100. 0. 262.14 ECU_ADDRESS 0x3fe49c FORMAT "%7.3" /end MEASUREMENT
/begin MEASUREMENT TIPR_5 "Pre-injection time" UWORD _CNV_A_R_LINEAR_____208_CM 1 100. 0. 262.14 ECU_ADDRESS 0x3fe49e FORMAT "%7.3" /end MEASUREMENT
/begin MEASUREMENT MFFPR "Calculated mass fuel flow setpoint for pre injection" UWORD _CNV_A_R_LINEAR_____95_CM 1 100. 0. 1389. ECU_ADDRESS 0x3fe486 FORMAT "%7.2" /end MEASUREMENT
/begin MEASUREMENT MFFPR_CST "Basic value of pre-injection at LV_ES" UWORD _CNV_A_R_LINEAR_____95_CM 1 100. 0. 1389. ECU_ADDRESS 0x3fe484 FORMAT "%7.2" /end MEASUREMENT
/begin CHARACTERISTIC IP_MFFPR_CST "Pre-injection basic value" CURVE 0x497ea _REC_CUR_20_u2_u1 1389. _CNV_A_R_LINEAR_____95_CM 0. 1389. FORMAT "%7.2"
 /begin AXIS_DESCR COM_AXIS TCO _CNV_A_R_LINEAR_____0_CM 8 -48. 142.5 FORMAT "%5.1" AXIS_PTS_REF ldp_tco__mffpr_cst /end AXIS_DESCR
/end CHARACTERISTIC
/begin CHARACTERISTIC IP_MFFPR_FAC_ST_ES "Pre-injection basic value correction in case of previous transition ST --> ES" CURVE 0x4fb6f _REC_CUR_20_u1_u1 0.99610001 _CNV_A_R_LINEAR_____20_CM 0. 0.99610001 FORMAT "%5.3"
 /begin AXIS_DESCR COM_AXIS TCO _CNV_A_R_LINEAR_____0_CM 8 -48. 142.5 FORMAT "%5.1" AXIS_PTS_REF ldp_tco__mffpr_fac_st_es /end AXIS_DESCR
/end CHARACTERISTIC
/begin AXIS_PTS ldp_cycnr_cst__fac_tipr_deac "" 0x43398 CYCNR_CST _REC_AXS_20_u1 7. _CNV_A_R_LINEAR_____10_CM 6 0. 7. FORMAT "%2.0" /end AXIS_PTS
/begin AXIS_PTS ldp_tco__mffpr_cst "" 0x438a5 TCO _REC_AXS_20_u1 190.5 _CNV_A_R_LINEAR_____0_CM 8 -48. 142.5 FORMAT "%5.1" /end AXIS_PTS
/begin AXIS_PTS ldp_tco__mffpr_fac_st_es "" 0x438ae TCO _REC_AXS_20_u1 190.5 _CNV_A_R_LINEAR_____0_CM 8 -48. 142.5 FORMAT "%5.1" /end AXIS_PTS
/begin MEASUREMENT MFF_ADD_REAC_CYL_0 "Reactivation enrichment" UWORD _CNV_A_R_LINEAR_____95_CM 1 100. 0. 1389. ECU_ADDRESS 0x3fcee6 FORMAT "%7.2" /end MEASUREMENT
/begin MEASUREMENT MFF_ADD_REAC_CYL_1 "Reactivation enrichment" UWORD _CNV_A_R_LINEAR_____95_CM 1 100. 0. 1389. ECU_ADDRESS 0x3fcee8 FORMAT "%7.2" /end MEASUREMENT
/begin MEASUREMENT MFF_ADD_REAC_CYL_2 "Reactivation enrichment" UWORD _CNV_A_R_LINEAR_____95_CM 1 100. 0. 1389. ECU_ADDRESS 0x3fceea FORMAT "%7.2" /end MEASUREMENT
/begin MEASUREMENT MFF_ADD_REAC_CYL_3 "Reactivation enrichment" UWORD _CNV_A_R_LINEAR_____95_CM 1 100. 0. 1389. ECU_ADDRESS 0x3fceec FORMAT "%7.2" /end MEASUREMENT
/begin MEASUREMENT MFF_ADD_REAC_CYL_4 "Reactivation enrichment" UWORD _CNV_A_R_LINEAR_____95_CM 1 100. 0. 1389. ECU_ADDRESS 0x3fceee FORMAT "%7.2" /end MEASUREMENT
/begin MEASUREMENT MFF_ADD_REAC_CYL_5 "Reactivation enrichment" UWORD _CNV_A_R_LINEAR_____95_CM 1 100. 0. 1389. ECU_ADDRESS 0x3fcef0 FORMAT "%7.2" /end MEASUREMENT
/begin MEASUREMENT MFF_DIF_WF_0 "wall film degradation" SLONG _CNV_A_R_LINEAR_____95_CM 1 100. -1389. 0. ECU_ADDRESS 0x3fe404 FORMAT "%9.2" /end MEASUREMENT
/begin MEASUREMENT MFF_DIF_WF_1 "wall film degradation" SLONG _CNV_A_R_LINEAR_____95_CM 1 100. -1389. 0. ECU_ADDRESS 0x3fe408 FORMAT "%9.2" /end MEASUREMENT
/begin MEASUREMENT MFF_DIF_WF_2 "wall film degradation" SLONG _CNV_A_R_LINEAR_____95_CM 1 100. -1389. 0. ECU_ADDRESS 0x3fe40c FORMAT "%9.2" /end MEASUREMENT
/begin MEASUREMENT MFF_DIF_WF_3 "wall film degradation" SLONG _CNV_A_R_LINEAR_____95_CM 1 100. -1389. 0. ECU_ADDRESS 0x3fe410 FORMAT "%9.2" /end MEASUREMENT
/begin MEASUREMENT MFF_DIF_WF_4 "wall film degradation" SLONG _CNV_A_R_LINEAR_____95_CM 1 100. -1389. 0. ECU_ADDRESS 0x3fe414 FORMAT "%9.2" /end MEASUREMENT
/begin MEASUREMENT MFF_DIF_WF_5 "wall film degradation" SLONG _CNV_A_R_LINEAR_____95_CM 1 100. -1389. 0. ECU_ADDRESS 0x3fe418 FORMAT "%9.2" /end MEASUREMENT
/begin MEASUREMENT FAC_TI_REAC_0 "Value of Table ID_FAC_TI_RIS__CYCNR" UBYTE _CNV_A_R_LINEAR_____34_CM 1 100. 0. 1.99220002 ECU_ADDRESS 0x3fcef2 FORMAT "%5.3" /end MEASUREMENT
/begin MEASUREMENT FAC_TI_REAC_1 "Value of Table ID_FAC_TI_RIS__CYCNR" UBYTE _CNV_A_R_LINEAR_____34_CM 1 100. 0. 1.99220002 ECU_ADDRESS 0x3fcef3 FORMAT "%5.3" /end MEASUREMENT
/begin MEASUREMENT FAC_TI_REAC_2 "Value of Table ID_FAC_TI_RIS__CYCNR" UBYTE _CNV_A_R_LINEAR_____34_CM 1 100. 0. 1.99220002 ECU_ADDRESS 0x3fcef4 FORMAT "%5.3" /end MEASUREMENT
/begin MEASUREMENT FAC_TI_REAC_3 "Value of Table ID_FAC_TI_RIS__CYCNR" UBYTE _CNV_A_R_LINEAR_____34_CM 1 100. 0. 1.99220002 ECU_ADDRESS 0x3fcef5 FORMAT "%5.3" /end MEASUREMENT
/begin MEASUREMENT FAC_TI_REAC_4 "Value of Table ID_FAC_TI_RIS__CYCNR" UBYTE _CNV_A_R_LINEAR_____34_CM 1 100. 0. 1.99220002 ECU_ADDRESS 0x3fcef6 FORMAT "%5.3" /end MEASUREMENT
/begin MEASUREMENT FAC_TI_REAC_5 "Value of Table ID_FAC_TI_RIS__CYCNR" UBYTE _CNV_A_R_LINEAR_____34_CM 1 100. 0. 1.99220002 ECU_ADDRESS 0x3fcef7 FORMAT "%5.3" /end MEASUREMENT
/begin CHARACTERISTIC ID_FAC_MFF_TCO_NEG_WF "Wall film factor, begin of fuel cutoff" CURVE 0x4cca9 _REC_CUR_20_u1_u1 0.4980468800000001 _CNV_A_R_LINEAR_____439_CM 0. 0.49804688 FORMAT "%5.3"
 /begin AXIS_DESCR COM_AXIS TCO _CNV_A_R_LINEAR_____0_CM 8 -48. 142.5 FORMAT "%5.1" AXIS_PTS_REF ldpm_tco__reac /end AXIS_DESCR
/end CHARACTERISTIC
/begin CHARACTERISTIC ID_FAC_MFF_TCO_POS_WF "Wall film factor, begin of fuel cutoff" CURVE 0x4ccb1 _REC_CUR_20_u1_u1 0.4980468800000001 _CNV_A_R_LINEAR_____439_CM 0. 0.49804688 FORMAT "%5.3"
 /begin AXIS_DESCR COM_AXIS TCO _CNV_A_R_LINEAR_____0_CM 8 -48. 142.5 FORMAT "%5.1" AXIS_PTS_REF ldpm_tco__reac /end AXIS_DESCR
/end CHARACTERISTIC
/begin CHARACTERISTIC IP_FAC_MFF_MAP_WF "MAP dependant factor" CURVE 0x4e237 _REC_CUR_20_u1_u2 0.99610001 _CNV_A_R_LINEAR_____20_CM 0. 0.99610001 FORMAT "%5.3"
 /begin AXIS_DESCR COM_AXIS MAP _CNV_A_R_LINEAR_____43_CM 4 0. 5434. FORMAT "%7.2" AXIS_PTS_REF ldp_map__fac_mff_map_wf /end AXIS_DESCR
/end CHARACTERISTIC
/begin CHARACTERISTIC ID_FAC_TI_RIS "Reactivation correction, soft reactivation" CURVE 0x4cccb _REC_CUR_20_u1_u1 1.99220002 _CNV_A_R_LINEAR_____34_CM 0. 1.99220002 FORMAT "%5.3"
 /begin AXIS_DESCR COM_AXIS ONLINE_DUMMY _CNV_A_R_LINEAR_____10_CM 16 1. 16. FORMAT "%2.0" AXIS_PTS_REF ldpm_cycnr_reac__reac /end AXIS_DESCR
/end CHARACTERISTIC
/begin CHARACTERISTIC ID_FAC_TI_RPL "Reactivation correction, hard reactivation" CURVE 0x4ccdb _REC_CUR_20_u1_u1 1.99220002 _CNV_A_R_LINEAR_____34_CM 0. 1.99220002 FORMAT "%5.3"
 /begin AXIS_DESCR COM_AXIS ONLINE_DUMMY _CNV_A_R_LINEAR_____10_CM 16 1. 16. FORMAT "%2.0" AXIS_PTS_REF ldpm_cycnr_reac__reac /end AXIS_DESCR
/end CHARACTERISTIC
/begin CHARACTERISTIC ID_MFF_INC_WF "Wall-film degradation" CURVE 0x45b7e _REC_CUR_20_u2_u1 1389. _CNV_A_R_LINEAR_____95_CM 0. 1389. FORMAT "%7.2"
 /begin AXIS_DESCR COM_AXIS N_32 _CNV_A_R_LINEAR_____5_CM 8 0. 8160. FORMAT "%4.0" AXIS_PTS_REF ldpm_n_32__reac /end AXIS_DESCR
/end CHARACTERISTIC
/begin CHARACTERISTIC ID_MFF_DEC_WF "Wall-film build-up" CURVE 0x45b6e _REC_CUR_20_u2_u1 1389. _CNV_A_R_LINEAR_____95_CM 0. 1389. FORMAT "%7.2"
 /begin AXIS_DESCR COM_AXIS N_32 _CNV_A_R_LINEAR_____5_CM 8 0. 8160. FORMAT "%4.0" AXIS_PTS_REF ldpm_n_32__reac /end AXIS_DESCR
/end CHARACTERISTIC
/begin AXIS_PTS ldpm_tco__reac "" 0x43fb9 TCO _REC_AXS_20_u1 190.5 _CNV_A_R_LINEAR_____0_CM 8 -48. 142.5 FORMAT "%5.1" /end AXIS_PTS
/begin AXIS_PTS ldp_map__fac_mff_map_wf "" 0x446b0 MAP _REC_AXS_20_u2 5434. _CNV_A_R_LINEAR_____43_CM 4 0. 5434. FORMAT "%7.2" /end AXIS_PTS
/begin AXIS_PTS ldpm_n_32__reac "" 0x43ddb N_32 _REC_AXS_20_u1 8160. _CNV_A_R_LINEAR_____5_CM 8 0. 8160. FORMAT "%4.0" /end AXIS_PTS
/begin AXIS_PTS ldpm_cycnr_reac__reac "" 0x43b86 CYCNR_REAC _REC_AXS_20_u1 15. _CNV_A_R_LINEAR_____10_CM 16 1. 16. FORMAT "%2.0" /end AXIS_PTS
/begin CHARACTERISTIC IP_FAC_TEG_COR_LAMB_SP_UP "Lambda influences correction depending on load engine" MAP 0x478bc _REC_MAP_20_u2_u2_u2 1.99996948 _CNV_A_R_LINEAR_____45_CM 0. 1.99996948 FORMAT "%7.5"
 /begin AXIS_DESCR COM_AXIS MAF_TEG _CNV_A_R_LINEAR_____95_CM 8 0. 1389. FORMAT "%7.2" AXIS_PTS_REF ldpm_maf_teg__teg_stat /end AXIS_DESCR
 /begin AXIS_DESCR COM_AXIS N_TEG _CNV_A_R_LINEAR_____17_CM 8 0. 8160. FORMAT "%4.0" AXIS_PTS_REF ldpm_n_teg__teg_stat /end AXIS_DESCR
/end CHARACTERISTIC
/begin CHARACTERISTIC IP_FAC_COR_SAF "SAF_KGH correktion" CURVE 0x47448 _REC_CUR_20_u2_u2 1.99996948 _CNV_A_R_LINEAR_____45_CM 0. 1.99996948 FORMAT "%7.5"
 /begin AXIS_DESCR COM_AXIS SAF_KGH _CNV_A_R_LINEAR_____41_CM 6 0. 1023.984375 FORMAT "%7.2" AXIS_PTS_REF ldpm_saf_kgh__fac_cor_saf /end AXIS_DESCR
/end CHARACTERISTIC
/begin AXIS_PTS ldpm_maf_teg__teg_stat "" 0x45152 MAF_TEG _REC_AXS_20_u2 1389. _CNV_A_R_LINEAR_____95_CM 8 0. 1389. FORMAT "%7.2" /end AXIS_PTS
/begin AXIS_PTS ldpm_n_teg__teg_stat "" 0x45338 N_TEG _REC_AXS_20_u2 8160. _CNV_A_R_LINEAR_____17_CM 8 0. 8160. FORMAT "%4.0" /end AXIS_PTS
/begin AXIS_PTS ldpm_saf_kgh__fac_cor_saf "" 0x45408 SAF_KGH _REC_AXS_20_u2 1023.984375 _CNV_A_R_LINEAR_____41_CM 6 0. 1023.984375 FORMAT "%7.2" /end AXIS_PTS
/begin COMPU_METHOD _CNV_A_R_LINEAR_____0_CM "" RAT_FUNC "%6.3" "°C" COEFFS 0 1.333333333333333 64. 0 0 1 /end COMPU_METHOD
/begin COMPU_METHOD _CNV_A_R_LINEAR_____1_CM "" RAT_FUNC "%6.3" "°C" COEFFS 0 1.333333333333333 0. 0 0 1 /end COMPU_METHOD
/begin COMPU_METHOD _CNV_A_R_LINEAR_____3_CM "" RAT_FUNC "%6.3" "°C" COEFFS 0 1. 40. 0 0 1 /end COMPU_METHOD
/begin COMPU_METHOD _CNV_A_R_LINEAR_____4_CM "" RAT_FUNC "%6.3" "%" COEFFS 0 2.56 0. 0 0 1 /end COMPU_METHOD
/begin COMPU_METHOD _CNV_A_R_LINEAR_____5_CM "" RAT_FUNC "%6.3" "rpm" COEFFS 0 3.125e-002 0. 0 0 1 /end COMPU_METHOD
/begin COMPU_METHOD _CNV_A_R_LINEAR_____10_CM "" RAT_FUNC "%6.3" "-" COEFFS 0 1. 0. 0 0 1 /end COMPU_METHOD
/begin COMPU_METHOD _CNV_S_2_RANGE______11_CM "" TAB_VERB "%6.3" "-" COMPU_TAB_REF _CNV_S_2_RANGE______11 /end COMPU_METHOD
/begin COMPU_VTAB _CNV_S_2_RANGE______11 "" TAB_VERB 2 0 "0" 1 "1" /end COMPU_VTAB
/begin COMPU_METHOD _CNV_A_R_LINEAR_____12_CM "" RAT_FUNC "%6.3" "[-]" COEFFS 0 1. 0. 0 0 1 /end COMPU_METHOD
/begin COMPU_METHOD _CNV_A_R_LINEAR_____13_CM "" RAT_FUNC "%6.3" "km/h" COEFFS 0 1. 0. 0 0 1 /end COMPU_METHOD
/begin COMPU_METHOD _CNV_A_R_LINEAR_____17_CM "" RAT_FUNC "%6.3" "rpm" COEFFS 0 1. 0. 0 0 1 /end COMPU_METHOD
/begin COMPU_METHOD _CNV_A_R_LINEAR_____18_CM "" RAT_FUNC "%6.3" "mg/stk" COEFFS 0 0.183585313174946 0. 0 0 1 /end COMPU_METHOD
/begin COMPU_METHOD _CNV_A_R_LINEAR_____20_CM "" RAT_FUNC "%6.3" "-" COEFFS 0 255.9983911655618 0. 0 0 1 /end COMPU_METHOD
/begin COMPU_METHOD _CNV_S_2_RANGE______28_CM "" TAB_VERB "%6.3" "[-]" COMPU_TAB_REF _CNV_S_2_RANGE______28 /end COMPU_METHOD
/begin COMPU_VTAB _CNV_S_2_RANGE______28 "" TAB_VERB 2 0 "0" 1 "1" /end COMPU_VTAB
/begin COMPU_METHOD _CNV_A_R_LINEAR_____31_CM "" RAT_FUNC "%6.3" "-" COEFFS 0 65536.00007936121 0. 0 0 1 /end COMPU_METHOD
/begin COMPU_METHOD _CNV_A_R_LINEAR_____33_CM "" RAT_FUNC "%6.3" "V" COEFFS 0 204.7999998974999 0. 0 0 1 /end COMPU_METHOD
/begin COMPU_METHOD _CNV_A_R_LINEAR_____34_CM "" RAT_FUNC "%6.3" "-" COEFFS 0 127.9991955827809 0. 0 0 1 /end COMPU_METHOD
/begin COMPU_METHOD _CNV_A_R_LINEAR_____35_CM "" RAT_FUNC "%6.3" "min" COEFFS 0 1. 0. 0 0 1 /end COMPU_METHOD
/begin COMPU_METHOD _CNV_A_R_LINEAR_____41_CM "" RAT_FUNC "%6.3" "kg/h" COEFFS 0 64. 0. 0 0 1 /end COMPU_METHOD
/begin COMPU_METHOD _CNV_A_R_LINEAR_____43_CM "" RAT_FUNC "%6.3" "hPa" COEFFS 0 12.06017666543982 0. 0 0 1 /end COMPU_METHOD
/begin COMPU_METHOD _CNV_A_R_LINEAR_____44_CM "" RAT_FUNC "%6.3" "[-]" COEFFS 0 255.9999357490357 0. 0 0 1 /end COMPU_METHOD
/begin COMPU_METHOD _CNV_A_R_LINEAR_____45_CM "" RAT_FUNC "%6.3" "-" COEFFS 0 32768.00003968061 0. 0 0 1 /end COMPU_METHOD
/begin COMPU_METHOD _CNV_A_R_LINEAR_____75_CM "" RAT_FUNC "%6.3" "°CRK" COEFFS 0 2.666666666666667 0. 0 0 1 /end COMPU_METHOD
/begin COMPU_METHOD _CNV_A_R_LINEAR_____94_CM "" RAT_FUNC "%6.3" "%" COEFFS 0 655.3600000071681 0. 0 0 1 /end COMPU_METHOD
/begin COMPU_METHOD _CNV_A_R_LINEAR_____95_CM "" RAT_FUNC "%6.3" "mg/stk" COEFFS 0 47.18142548596112 0. 0 0 1 /end COMPU_METHOD
/begin COMPU_METHOD _CNV_A_R_LINEAR_____101_CM "" RAT_FUNC "%6.3" "kg/h" COEFFS 0 32. 0. 0 0 1 /end COMPU_METHOD
/begin COMPU_METHOD _CNV_A_R_LINEAR_____111_CM "" RAT_FUNC "%6.3" "-" COEFFS 0 255.9999997499962 0. 0 0 1 /end COMPU_METHOD
/begin COMPU_METHOD _CNV_A_R_LINEAR_____112_CM "" RAT_FUNC "%6.3" "-" COEFFS 0 65551.06000970239 0. 0 0 1 /end COMPU_METHOD
/begin COMPU_METHOD _CNV_A_R_LINEAR_____141_CM "" RAT_FUNC "%6.3" "-" COEFFS 0 64. 0. 0 0 1 /end COMPU_METHOD
/begin COMPU_METHOD _CNV_A_R_LINEAR_____142_CM "" RAT_FUNC "%6.3" "V" COEFFS 0 200. 0. 0 0 1 /end COMPU_METHOD
/begin COMPU_METHOD _CNV_A_R_LINEAR_____143_CM "" RAT_FUNC "%6.3" "%" COEFFS 0 655.3600000071681 32768.00000035841 0 0 1 /end COMPU_METHOD
/begin COMPU_METHOD _CNV_A_R_LINEAR_____144_CM "" RAT_FUNC "%6.3" "%" COEFFS 0 655.34 0. 0 0 1 /end COMPU_METHOD
/begin COMPU_METHOD _CNV_A_R_LINEAR_____145_CM "" RAT_FUNC "%6.3" "°CRK" COEFFS 0 0.1666666666666667 0. 0 0 1 /end COMPU_METHOD
/begin COMPU_METHOD _CNV_A_R_LINEAR_____146_CM "" RAT_FUNC "%6.3" "V" COEFFS 0 51400. -0.500000000003638 0 0 1 /end COMPU_METHOD
/begin COMPU_METHOD _CNV_A_R_LINEAR_____147_CM "" RAT_FUNC "%6.3" "V" COEFFS 0 51400. 32767.5 0 0 1 /end COMPU_METHOD
/begin COMPU_METHOD _CNV_A_R_LINEAR_____148_CM "" RAT_FUNC "%6.3" "-" COEFFS 0 1023.999999919998 0. 0 0 1 /end COMPU_METHOD
/begin COMPU_METHOD _CNV_A_R_LINEAR_____195_CM "" RAT_FUNC "%6.3" "[-]" COEFFS 0 64. 0. 0 0 1 /end COMPU_METHOD
/begin COMPU_METHOD _CNV_A_R_LINEAR_____208_CM "" RAT_FUNC "%6.3" "ms" COEFFS 0 250. 0. 0 0 1 /end COMPU_METHOD
/begin COMPU_METHOD _CNV_A_R_LINEAR_____211_CM "" RAT_FUNC "%6.3" "°C" COEFFS 0 16. 0. 0 0 1 /end COMPU_METHOD
/begin COMPU_METHOD _CNV_A_R_LINEAR_____269_CM "" RAT_FUNC "%6.3" "°C" COEFFS 0 43.47840509520334 2086.96344456976 0 0 1 /end COMPU_METHOD
/begin COMPU_METHOD _CNV_A_R_LINEAR_____271_CM "" RAT_FUNC "%6.3" "-" COEFFS 0 16383.75 32767.5 0 0 1 /end COMPU_METHOD
/begin COMPU_METHOD _CNV_A_R_LINEAR_____272_CM "" RAT_FUNC "%6.3" "-" COEFFS 0 16383.99999935999 -1.280019205296412e-006 0 0 1 /end COMPU_METHOD
/begin COMPU_METHOD _CNV_A_R_LINEAR_____277_CM "" RAT_FUNC "%6.3" "g" COEFFS 0 36.00036915004301 0. 0 0 1 /end COMPU_METHOD
/begin COMPU_METHOD _CNV_A_R_LINEAR_____286_CM "" RAT_FUNC "%6.3" "°C" COEFFS 0 15.99999804684544 -4.000060547696194e-003 0 0 1 /end COMPU_METHOD
/begin COMPU_METHOD _CNV_A_R_LINEAR_____305_CM "" RAT_FUNC "%6.3" "°C" COEFFS 0 64. 2112. 0 0 1 /end COMPU_METHOD
/begin COMPU_METHOD _CNV_A_R_LINEAR_____310_CM "" RAT_FUNC "%6.3" "-" COEFFS 0 16383.99985599781 0. 0 0 1 /end COMPU_METHOD
/begin COMPU_METHOD _CNV_A_R_LINEAR_____316_CM "" RAT_FUNC "%6.3" "g" COEFFS 0 4608.117565499413 0. 0 0 1 /end COMPU_METHOD
/begin COMPU_METHOD _CNV_A_R_LINEAR_____317_CM "" RAT_FUNC "%6.3" "-" COEFFS 0 1024. 0. 0 0 1 /end COMPU_METHOD
/begin COMPU_METHOD _CNV_A_R_LINEAR_____318_CM "" RAT_FUNC "%6.3" "V" COEFFS 0 204.8048048048048 0. 0 0 1 /end COMPU_METHOD
/begin COMPU_METHOD _CNV_A_R_LINEAR_____348_CM "" RAT_FUNC "%6.3" "-" COEFFS 0 8191.999999679995 0. 0 0 1 /end COMPU_METHOD
/begin COMPU_METHOD _CNV_A_R_LINEAR_____411_CM "" RAT_FUNC "%6.3" "-" COEFFS 0 2. 0. 0 0 1 /end COMPU_METHOD
/begin COMPU_METHOD _CNV_A_R_LINEAR_____412_CM "" RAT_FUNC "%6.3" "°C" COEFFS 0 66.66666666666667 0. 0 0 1 /end COMPU_METHOD
/begin COMPU_METHOD _CNV_A_R_LINEAR_____413_CM "" RAT_FUNC "%6.3" "°C" COEFFS 0 21.73913043478261 32768. 0 0 1 /end COMPU_METHOD
/begin COMPU_METHOD _CNV_A_R_LINEAR_____414_CM "" RAT_FUNC "%6.3" "kJ" COEFFS 0 576008.8405624894 0. 0 0 1 /end COMPU_METHOD
/begin COMPU_METHOD _CNV_A_R_LINEAR_____415_CM "" RAT_FUNC "%6.3" "°C" COEFFS 0 66.66666666666667 32768. 0 0 1 /end COMPU_METHOD
/begin COMPU_METHOD _CNV_A_R_LINEAR_____416_CM "" RAT_FUNC "%6.3" "°C" COEFFS 0 66.6670057577972 0.1666700426794705 0 0 1 /end COMPU_METHOD
/begin COMPU_METHOD _CNV_A_R_LINEAR_____417_CM "" RAT_FUNC "%6.3" "°C" COEFFS 0 85.33168316831683 0. 0 0 1 /end COMPU_METHOD
/begin COMPU_METHOD _CNV_A_R_LINEAR_____418_CM "" RAT_FUNC "%6.3" "°C" COEFFS 0 1.262376237623762 0. 0 0 1 /end COMPU_METHOD
/begin COMPU_METHOD _CNV_A_R_LINEAR_____419_CM "" RAT_FUNC "%6.3" "°C" COEFFS 0 1.331683168316832 0. 0 0 1 /end COMPU_METHOD
/begin COMPU_METHOD _CNV_A_R_LINEAR_____420_CM "" RAT_FUNC "%6.3" "°C" COEFFS 0 1.262376237623762 255. 0 0 1 /end COMPU_METHOD
/begin COMPU_METHOD _CNV_A_R_LINEAR_____421_CM "" RAT_FUNC "%6.3" "°C" COEFFS 0 1.331683168316832 269. 0 0 1 /end COMPU_METHOD
/begin COMPU_METHOD _CNV_A_R_LINEAR_____422_CM "" RAT_FUNC "%6.3" "kJ/K" COEFFS 0 6666.836215666328 0. 0 0 1 /end COMPU_METHOD
/begin COMPU_METHOD _CNV_A_R_LINEAR_____423_CM "" RAT_FUNC "%6.3" "KW" COEFFS 0 149.2228528379436 0. 0 0 1 /end COMPU_METHOD
/begin COMPU_METHOD _CNV_A_R_LINEAR_____424_CM "" RAT_FUNC "%6.3" "°CRK" COEFFS 0 2.666666666666667 255. 0 0 1 /end COMPU_METHOD
/begin COMPU_METHOD _CNV_A_R_LINEAR_____425_CM "" RAT_FUNC "%6.3" "kJ" COEFFS 0 8.789063285815482 0. 0 0 1 /end COMPU_METHOD
/begin COMPU_METHOD _CNV_A_R_LINEAR_____426_CM "" RAT_FUNC "%6.3" "°C" COEFFS 0 43.47895323530973 0. 0 0 1 /end COMPU_METHOD
/begin COMPU_METHOD _CNV_A_R_LINEAR_____427_CM "" RAT_FUNC "%6.3" "°C" COEFFS 0 43.47840509520334 0. 0 0 1 /end COMPU_METHOD
/begin COMPU_METHOD _CNV_A_R_LINEAR_____428_CM "" RAT_FUNC "%6.3" "-" COEFFS 0 8191.999999679995 32767.99999871998 0 0 1 /end COMPU_METHOD
/begin COMPU_METHOD _CNV_A_R_LINEAR_____430_CM "" RAT_FUNC "%6.3" "-" COEFFS 0 8192.064968445899 0. 0 0 1 /end COMPU_METHOD
/begin COMPU_METHOD _CNV_A_R_LINEAR_____433_CM "" RAT_FUNC "%6.3" "hPa" COEFFS 0 1.466461170408539e-003 0. 0 0 1 /end COMPU_METHOD
/begin COMPU_METHOD _CNV_A_R_LINEAR_____439_CM "" RAT_FUNC "%6.3" "-" COEFFS 0 511.9999948599216 0. 0 0 1 /end COMPU_METHOD
/begin RECORD_LAYOUT _REC_VAL_20_u1 FNC_VALUES 1 UBYTE COLUMN_DIR DIRECT /end RECORD_LAYOUT
/begin RECORD_LAYOUT _REC_MAP_20_u1_u1_u1 FNC_VALUES 1 UBYTE COLUMN_DIR DIRECT /end RECORD_LAYOUT
/begin RECORD_LAYOUT _REC_AXS_20_u1 NO_AXIS_PTS_X 1 UBYTE AXIS_PTS_X 2 UBYTE INDEX_INCR DIRECT /end RECORD_LAYOUT
/begin RECORD_LAYOUT _REC_CUR_20_u1_u1 FNC_VALUES 1 UBYTE COLUMN_DIR DIRECT /end RECORD_LAYOUT
/begin RECORD_LAYOUT _REC_MAP_20_u2_u2_u1 FNC_VALUES 1 UWORD COLUMN_DIR DIRECT /end RECORD_LAYOUT
/begin RECORD_LAYOUT _REC_AXS_20_u2 NO_AXIS_PTS_X 1 UWORD AXIS_PTS_X 2 UWORD INDEX_INCR DIRECT /end RECORD_LAYOUT
/begin RECORD_LAYOUT _REC_CUR_20_u2_u2 FNC_VALUES 1 UWORD COLUMN_DIR DIRECT /end RECORD_LAYOUT
/begin RECORD_LAYOUT _REC_VAL_20_u2 FNC_VALUES 1 UWORD COLUMN_DIR DIRECT /end RECORD_LAYOUT
/begin RECORD_LAYOUT _REC_CUR_20_u2_u1 FNC_VALUES 1 UWORD COLUMN_DIR DIRECT /end RECORD_LAYOUT
/begin RECORD_LAYOUT _REC_CUR_20_u1_u2 FNC_VALUES 1 UBYTE COLUMN_DIR DIRECT /end RECORD_LAYOUT
/begin RECORD_LAYOUT _REC_MAP_20_u2_u1_u2 FNC_VALUES 1 UWORD COLUMN_DIR DIRECT /end RECORD_LAYOUT
/begin RECORD_LAYOUT _REC_MAP_20_u1_u2_u2 FNC_VALUES 1 UBYTE COLUMN_DIR DIRECT /end RECORD_LAYOUT
/begin RECORD_LAYOUT _REC_MAP_20_u2_u2_u2 FNC_VALUES 1 UWORD COLUMN_DIR DIRECT /end RECORD_LAYOUT
/begin RECORD_LAYOUT _REC_MAP_20_u1_u2_u1 FNC_VALUES 1 UBYTE COLUMN_DIR DIRECT /end RECORD_LAYOUT
/begin FUNCTION INJ_Exhaust_Gas_temperature_mode "_Exhaust Gas temperature model"
 /begin DEF_CHARACTERISTIC IP_TEMP_SP_TOIL IP_FAC_COR_LAMB_SP_UP IP_FAC_SCC_TEG IP_FAC_TOIL_VS IP_TEMP_SP_TCO_EX IP_FAC_TAM_TEG IP_TEG_STAT_UP_1 IP_TEG_WALL_STAT_UP_1 IP_FAC_TEG_WALL_COR_LAMB_SP_UP IP_TEG_ADD_EGR IP_TEG_WALL_ADD_EGR IP_FAC_COR_LAMB_SP_WALL_UP IP_CRLC_TEG_DEC_PUC_UP_1 IP_CRLC_TEG_WALL_DEC_PUC_UP_1 IP_CRLC_TEG_INC_UP_1 IP_CRLC_TEG_WALL_INC_UP_1 IP_CRLC_TEG_DEC_UP_1 IP_CRLC_TEG_WALL_DEC_UP_1 IP_TEG_STAT_DOWN_1 IP_TEG_WALL_STAT_DOWN_1 IP_CRLC_TEG_TOIL_DIF_DOWN IP_CRLC_TEG_WALL_TOIL_DIF_DOWN IP_CRLC_TEG_TCO_DIF_DOWN IP_CRLC_TEG_WALL_TCO_DIF_DOWN IP_CRLC_TEG_DEC_PUC_DOWN_1 IP_CRLC_TEG_WALL_DEC_PUC_DOWN_1 IP_CRLC_TEG_DEC_DOWN_1 IP_CRLC_TEG_WALL_DEC_DOWN_1 IP_CRLC_TEG_INC_DOWN_1 IP_CRLC_TEG_WALL_INC_DOWN_1 C_TAM_REF C_MAF_INT_TEG_ST_UP C_CRLC_TEG_ST_UP C_EGY_TEG_END_SP_UP C_TEG_WALL_ST_OFF C_CRLC_TEG_WALL_ST_END_UP C_CRLC_TEG_WALL_ST_UP C_EGY_TEG_WALL_END_SP_UP C_FAC_COR_VO_TEG_DOWN C_FAC_COR_VO_TEG_WALL_DOWN C_FAC_COR_LAMB_SP_TEG_DOWN C_FAC_COR_LAMB_SP_TEG_WALL_DOWN C_FAC_COR_SAF_TEG_DOWN C_FAC_COR_SAF_TEG_WALL_DOWN C_FAC_VS_TEG_DOWN C_FAC_VS_TEG_WALL_DOWN C_CRLC_TEG_WALL_ST_END_DOWN C_MAF_INT_TEG_ST_DOWN C_MAF_INT_TEG_WALL_ST_DOWN C_CRLC_TEG_ST_DOWN C_CRLC_TEG_WALL_ST_DOWN C_EGY_TEG_END_SP_DOWN C_EGY_TEG_WALL_END_SP_DOWN C_FAC_LAMB_TEG_STAT_MAX IP_FAC_COR_VO_UP IP_FAC_COR_VO_WALL_UP IP_FAC_COR_SAF_WALL IP_FAC_SCC_TEG_WALL IP_CRLC_TEG_TCO_DIF_UP IP_CRLC_TEG_TOIL_DIF_UP C_CRLC_TEG_ST_END_DOWN C_CRLC_TEG_ST_END_UP IP_CRLC_TEG_WALL_TOIL_DIF_UP IP_CRLC_TEG_WALL_TCO_DIF_UP LC_PUC_TEG_ENA IP_FAC_VS_TEG_STAT_MAX IP_ADD_TEG_IGA IP_TEG_COR_VO_UP IP_EFF_IGA_AV_TEG_COR IP_TEG_COR_EFF_IGA_UP IP_TEMP_SP_TCO IP_FAC_COR_EFF_IGA_UP C_FAC_REF_TCO_UP C_FAC_REF_SCC_TCO_UP C_FAC_TCO_EX_TEG_UP_1 C_FAC_TCO_EX_TEG_UP_2 IP_FAC_TEG_STOP_DOWN C_TEG_ST_ON_UP C_TEG_ST_ON_DOWN C_TEG_EGY_SP_END C_MAF_INT_TEG_WALL_ST_UP C_FAC_COR_EFF_IGA_TEG_DOWN C_FAC_REF_SCC_TCO_DOWN C_FAC_TCO_EX_TEG_DOWN_1 C_FAC_TCO_EX_TEG_DOWN_2 IP_TEG_WALL_COR_EFF_IGA_UP IP_FAC_COR_EFF_IGA_WALL_UP C_FAC_REF_TCO_DOWN IP_TEG_WALL_COR_VO_UP IP_TEG_WALL_COR_VS_UP C_FAC_TCO_EX_TEG_WALL_UP_2 IP_FAC_TEG_WALL_STOP_UP C_TEG_WALL_EGY_SP_END C_FAC_COR_EFF_IGA_TEG_WALL_DOWN C_FAC_REF_SCC_TCO_WALL_UP C_FAC_REF_SCC_TCO_WALL_DOWN C_FAC_REF_TCO_WALL_UP C_FAC_REF_TCO_WALL_DOWN C_TEG_DIF_GRAD_MIN C_TEG_DIF_LEVEL_MIN C_FAC_TCO_EX_TEG_WALL_UP_1 C_FAC_TCO_EX_TEG_WALL_DOWN_1 C_FAC_TCO_EX_TEG_WALL_DOWN_2 IP_TEG_STAT_UP_2 IP_TEG_WALL_STAT_UP_2 IP_CRLC_TEG_DEC_PUC_UP_2 IP_CRLC_TEG_WALL_DEC_PUC_UP_2 IP_CRLC_TEG_INC_UP_2 IP_CRLC_TEG_WALL_INC_UP_2 IP_CRLC_TEG_DEC_UP_2 IP_CRLC_TEG_WALL_DEC_UP_2 IP_TEG_STAT_DOWN_2 IP_TEG_WALL_STAT_DOWN_2 IP_CRLC_TEG_DEC_PUC_DOWN_2 IP_CRLC_TEG_WALL_DEC_PUC_DOWN_2 IP_CRLC_TEG_DEC_DOWN_2 IP_CRLC_TEG_WALL_DEC_DOWN_2 IP_CRLC_TEG_INC_DOWN_2 IP_CRLC_TEG_WALL_INC_DOWN_2 IP_FAC_TEG_STOP_UP IP_FAC_TEG_WALL_STOP_DOWN IP_FAC_TEMP_TOIL_DIF_UP IP_TEG_COR_VS_UP IP_VS_ECF_TEG_UP_2 IP_FAC_TCO_EX_VS IP_FAC_COR_TCO_EX_VS_UP IP_FAC_COR_TCO_EX_VS_DOWN IP_VS_ECF_TEG_UP_1 IP_VS_ECF_TEG_DOWN_2 IP_FAC_TEMP_TOIL_DIF_WALL_UP IP_FAC_COR_ECF_VS_TEG IP_FAC_COR_ECF_VS_TEG_WALL IP_VS_ECF_TEG_DOWN_1 IP_VS_ECF_TEG_WALL_UP_2 IP_FAC_TEMP_TOIL_DIF_DOWN IP_FAC_TEMP_TOIL_DIF_WALL_DOWN IP_VS_ECF_TEG_WALL_UP_1 IP_VS_ECF_TEG_WALL_DOWN_1 IP_VS_ECF_TEG_WALL_DOWN_2 C_CRLC_MIN_TEG_LEVEL C_CRLC_DIF_TEG_LEVEL C_CRLC_DIF_TEG_GRAD IP_FAC_COR_VS_TEG_UP_1 IP_FAC_COR_VS_TEG_UP_2 IP_FAC_COR_VS_TEG_DOWN_1 IP_FAC_COR_VS_TEG_DOWN_2 IP_FAC_COR_VS_TEG_WALL_UP_1 IP_FAC_COR_VS_TEG_WALL_UP_2 IP_FAC_COR_VS_TEG_WALL_DOWN_1 IP_FAC_COR_VS_TEG_WALL_DOWN_2 C_TOIL_TEG_GRAD_MIN_UP C_TOIL_TEG_GRAD_MIN_DOWN C_TOIL_TEG_LEVEL_MIN_UP C_TOIL_TEG_LEVEL_MIN_DOWN IP_FAC_TEG_COR_LAMB_SP_UP IP_FAC_COR_SAF /end DEF_CHARACTERISTIC
 /begin OUT_MEASUREMENT TEG_STAT_ENG_UP_1 TEG_COR_EFF_IGA_UP_1 TEG_STAT_BAS_UP_1 EFF_IGA_AV_TEG_COR_1 FAC_SCC_TEG_1 FAC_COR_LAMB_SP_TEG_UP_1 TEG_STAT_UP_1 TAM_REF_TEG_UP_1 TEG_CAT_UP_MDL_1_BAS TEG_DIF_UP_1 TEG_CAT_UP_MDL_STOP_1 CRLC_TEG_GRAD_UP_1 CRLC_TEG_LEVEL_UP_1 CRLC_TEG_UP_1 CRLC_TEG_TOIL_TCO_UP_1 CRLC_TEG_EGY_UP_1 EGY_TEG_END_SP_UP_1 EGY_TEG_END_AV_UP_1 LV_TEG_AST_UP_1 CRLC_TEG_BAS_UP_1 TEG_ADD_EGR_UP_1 TEG_COR_VEH_UP_1 TEG_COR_TCO_EX_UP_1 FAC_COR_VS_TEG_UP_1 TEG_SCC_TCO_UP_1 VS_COR_ECF_TEG_UP_1 VS_COR_TEG_UP_1 TEG_STAT_ENG_DOWN_1 TEG_STAT_BAS_DOWN_1 FAC_COR_LAMB_SP_TEG_DOWN_1 TEG_STAT_DOWN_1 TAM_REF_TEG_DOWN_1 TEG_CAT_DOWN_MDL_1_BAS TEG_DIF_DOWN_1 TEG_CAT_DOWN_MDL_STOP_1 CRLC_TEG_GRAD_DOWN_1 CRLC_TEG_LEVEL_DOWN_1 CRLC_TEG_DOWN_1 CRLC_TEG_TOIL_TCO_DOWN_1 CRLC_TEG_EGY_DOWN_1 EGY_TEG_END_SP_DOWN_1 EGY_TEG_END_AV_DOWN_1 LV_TEG_AST_DOWN_1 CRLC_TEG_BAS_DOWN_1 TEG_COR_EFF_IGA_DOWN_1 TEG_SCC_TCO_DOWN_1 TEG_COR_VEH_DOWN_1 FAC_COR_VS_TEG_DOWN_1 TEG_COR_TCO_EX_DOWN_1 VS_COR_ECF_TEG_DOWN_1 VS_COR_TEG_DOWN_1 TEG_WALL_STAT_BAS_UP_1 FAC_SCC_TEG_WALL_1 FAC_COR_LAMB_SP_TEG_WALL_UP_1 TEG_WALL_STAT_UP_1 TAM_REF_TEG_WALL_UP_1 TEG_WALL_CAT_UP_MDL_1 TEG_WALL_DIF_UP_1 TEG_WALL_CAT_UP_MDL_STOP_1 CRLC_TEG_WALL_UP_1 CRLC_TEG_WALL_TOIL_TCO_UP_1 CRLC_TEG_WALL_EGY_UP_1 EGY_TEG_WALL_END_SP_UP_1 EGY_TEG_WALL_END_AV_UP_1 CRLC_TEG_WALL_BAS_UP_1 TEG_WALL_STAT_ENG_UP_1 TEG_WALL_COR_EFF_IGA_UP_1 TEG_WALL_SCC_TCO_UP_1 TEG_WALL_COR_VEH_UP_1 FAC_COR_VS_TEG_WALL_UP_1 TEG_WALL_COR_TCO_EX_UP_1 VS_COR_ECF_TEG_WALL_UP_1 VS_COR_TEG_WALL_UP_1 TEG_WALL_STAT_ENG_DOWN_1 TEG_WALL_STAT_BAS_DOWN_1 FAC_COR_LAMB_SP_TEG_WALL_DOWN_1 TEG_WALL_STAT_DOWN_1 TAM_REF_TEG_WALL_DOWN_1 TEG_WALL_CAT_DOWN_MDL_1 TEG_WALL_DIF_DOWN_1 TEG_WALL_CAT_DOWN_MDL_STOP_1 CRLC_TEG_WALL_DOWN_1 CRLC_TEG_WALL_TOIL_TCO_DOWN_1 CRLC_TEG_WALL_EGY_DOWN_1 EGY_TEG_WALL_END_SP_DOWN_1 EGY_TEG_WALL_END_AV_DOWN_1 CRLC_TEG_WALL_BAS_DOWN_1 TEG_WALL_COR_EFF_IGA_DOWN_1 TEG_WALL_SCC_TCO_DOWN_1 TEG_WALL_COR_VEH_DOWN_1 FAC_COR_VS_TEG_WALL_DOWN_1 TEG_WALL_COR_TCO_EX_DOWN_1 VS_COR_ECF_TEG_WALL_DOWN_1 VS_COR_TEG_WALL_DOWN_1 TEG_STAT_ENG_UP_2 TEG_COR_EFF_IGA_UP_2 TEG_STAT_BAS_UP_2 EFF_IGA_AV_TEG_COR_2 FAC_SCC_TEG_2 FAC_COR_LAMB_SP_TEG_UP_2 TEG_STAT_UP_2 TAM_REF_TEG_UP_2 TEG_CAT_UP_MDL_2_BAS TEG_DIF_UP_2 TEG_CAT_UP_MDL_STOP_2 CRLC_TEG_GRAD_UP_2 CRLC_TEG_LEVEL_UP_2 CRLC_TEG_UP_2 CRLC_TEG_TOIL_TCO_UP_2 CRLC_TEG_EGY_UP_2 EGY_TEG_END_SP_UP_2 EGY_TEG_END_AV_UP_2 LV_TEG_AST_UP_2 CRLC_TEG_BAS_UP_2 TEG_ADD_EGR_UP_2 TEG_COR_VEH_UP_2 TEG_COR_TCO_EX_UP_2 FAC_COR_VS_TEG_UP_2 TEG_SCC_TCO_UP_2 VS_COR_ECF_TEG_UP_2 VS_COR_TEG_UP_2 TEG_STAT_ENG_DOWN_2 TEG_STAT_BAS_DOWN_2 FAC_COR_LAMB_SP_TEG_DOWN_2 TEG_STAT_DOWN_2 TAM_REF_TEG_DOWN_2 TEG_CAT_DOWN_MDL_2_BAS TEG_DIF_DOWN_2 TEG_CAT_DOWN_MDL_STOP_2 CRLC_TEG_GRAD_DOWN_2 CRLC_TEG_LEVEL_DOWN_2 CRLC_TEG_DOWN_2 CRLC_TEG_TOIL_TCO_DOWN_2 CRLC_TEG_EGY_DOWN_2 EGY_TEG_END_SP_DOWN_2 EGY_TEG_END_AV_DOWN_2 LV_TEG_AST_DOWN_2 CRLC_TEG_BAS_DOWN_2 TEG_COR_EFF_IGA_DOWN_2 TEG_SCC_TCO_DOWN_2 TEG_COR_VEH_DOWN_2 FAC_COR_VS_TEG_DOWN_2 TEG_COR_TCO_EX_DOWN_2 VS_COR_ECF_TEG_DOWN_2 VS_COR_TEG_DOWN_2 TEG_WALL_STAT_BAS_UP_2 FAC_SCC_TEG_WALL_2 FAC_COR_LAMB_SP_TEG_WALL_UP_2 TEG_WALL_STAT_UP_2 TAM_REF_TEG_WALL_UP_2 TEG_WALL_CAT_UP_MDL_2 TEG_WALL_DIF_UP_2 TEG_WALL_CAT_UP_MDL_STOP_2 CRLC_TEG_WALL_UP_2 CRLC_TEG_WALL_TOIL_TCO_UP_2 CRLC_TEG_WALL_EGY_UP_2 EGY_TEG_WALL_END_SP_UP_2 EGY_TEG_WALL_END_AV_UP_2 CRLC_TEG_WALL_BAS_UP_2 TEG_WALL_STAT_ENG_UP_2 TEG_WALL_COR_EFF_IGA_UP_2 TEG_WALL_SCC_TCO_UP_2 TEG_WALL_COR_VEH_UP_2 FAC_COR_VS_TEG_WALL_UP_2 TEG_WALL_COR_TCO_EX_UP_2 VS_COR_ECF_TEG_WALL_UP_2 VS_COR_TEG_WALL_UP_2 TEG_WALL_STAT_ENG_DOWN_2 TEG_WALL_STAT_BAS_DOWN_2 FAC_COR_LAMB_SP_TEG_WALL_DOWN_2 TEG_WALL_STAT_DOWN_2 TAM_REF_TEG_WALL_DOWN_2 TEG_WALL_CAT_DOWN_MDL_2 TEG_WALL_DIF_DOWN_2 TEG_WALL_CAT_DOWN_MDL_STOP_2 CRLC_TEG_WALL_DOWN_2 CRLC_TEG_WALL_TOIL_TCO_DOWN_2 CRLC_TEG_WALL_EGY_DOWN_2 EGY_TEG_WALL_END_SP_DOWN_2 EGY_TEG_WALL_END_AV_DOWN_2 CRLC_TEG_WALL_BAS_DOWN_2 TEG_WALL_COR_EFF_IGA_DOWN_2 TEG_WALL_SCC_TCO_DOWN_2 TEG_WALL_COR_VEH_DOWN_2 FAC_COR_VS_TEG_WALL_DOWN_2 TEG_WALL_COR_TCO_EX_DOWN_2 VS_COR_ECF_TEG_WALL_DOWN_2 VS_COR_TEG_WALL_DOWN_2 TEG_COR_VO_UP TEMP_TOIL_DIF TEMP_TCO_EX_DIF CRLC_TEG_TOIL_DIF_UP CRLC_TEG_TCO_DIF_UP CRLC_TEG_TOIL_DIF_DOWN CRLC_TEG_TCO_DIF_DOWN CRLC_TEG_WALL_TOIL_DIF_UP CRLC_TEG_WALL_TCO_DIF_UP TEG_WALL_COR_VO_DOWN TEG_STAT_MAX POW_DIF_MAX CRLC_TEG_WALL_TCO_DIF_DOWN CRLC_TEG_WALL_TOIL_DIF_DOWN VO_DIF_TEG TEG_COR_VO_DOWN TEG_WALL_COR_TCO_UP TEG_WALL_COR_VO_UP TEG_WALL_COR_TCO_DOWN TEMP_TCO_DIF TEG_COR_TCO_UP TEG_COR_TCO_DOWN TEG_COR_VS_DOWN TEG_COR_VS_UP TEG_WALL_COR_VS_DOWN TEG_WALL_COR_VS_UP FAC_COR_TOIL_DIF_TEG_UP FAC_COR_TOIL_DIF_TEG_DOWN FAC_COR_TOIL_DIF_TEG_WALL_UP FAC_COR_TOIL_DIF_TEG_WALL_DOWN /end OUT_MEASUREMENT
/end FUNCTION
/begin FUNCTION INJ_Detection_of_dew_point "_Detection of dew point"
 /begin DEF_CHARACTERISTIC C_DELTA_TIA C_T_ES_DEW_MIN C_T_ES_DEW_MAX C_TCO_ST C_TCO_ES_DEW C_T_ES_DIF_DEW C_FAC_EGY_DEW_STOP IP_EGY_DEW_END_ST_UP IP_EGY_DEW_END_ST_DOWN C_TEG_WALL_RED C_TEG_WALL_DEW_ST C_TEG_WALL_HYS /end DEF_CHARACTERISTIC
 /begin OUT_MEASUREMENT LV_TEG_MIN_THD_1 LV_TEG_CAT_DOWN_MIN_THD_1 LV_TEG_CAT_UP_MIN_THD_1 LV_TEG_MIN_THD_2 LV_TEG_CAT_DOWN_MIN_THD_2 LV_TEG_CAT_UP_MIN_THD_2 TAM_DEW T_ES_DEW EGY_DEW_STOP_UP EGY_DEW_STOP_DOWN EGY_DEW_END_DOWN EGY_DEW_END_UP EGY_DEW_UP EGY_DEW_DOWN /end OUT_MEASUREMENT
/end FUNCTION
/begin FUNCTION INJ_Cylinder_selective_mixture_c "_Cylinder-selective mixture control and Adaptation function"
 /begin DEF_CHARACTERISTIC C_N_MAX_CYL_LAM C_TOIL_MIN_CYL_LAM C_VLS_CYC_RATIO_MV_MAX LC_CDN_LSCL_CYL_LAM C_VLS_MIN_CYL_LAM C_VLS_MAX_CYL_LAM C_VLS_DIF_MAX_CYL_LAM C_TI_MIN_CYL_LAM C_TI_MAX_CYL_LAM C_TI_CYL_LAM_DEC C_TI_AD_MIN_CYL_LAM C_TI_AD_MAX_CYL_LAM C_MFF_ADD_CP_MAX_CYL_LAM_AD IP_FAC_FRQ_1_CYL_LAM IP_FAC_FRQ_2_CYL_LAM IP_FAC_MAF_1_CYL_LAM IP_FAC_MAF_2_CYL_LAM IP_MAF_MAX_CYL_LAM IP_VLS_DIF_VAL IP_MAF_MIN_CYL_LAM IP_MAF_MIN_CYL_LAM_AD IP_MAF_MAX_CYL_LAM_AD IP_TI_AD_CYL IP_DLY_CYL_LAM_1 IP_DLY_CYL_LAM_2 IP_TI_CYL IP_FAC_VLS_DIF_LAMB /end DEF_CHARACTERISTIC
 /begin OUT_MEASUREMENT LV_CYL_LAM_ACT_1 LV_AD_CYL_LAM_ACT_1 VLS_CYC_RATIO_MV_1 LV_CYL_LAM_ACT_2 LV_AD_CYL_LAM_ACT_2 VLS_CYC_RATIO_MV_2 CRK_CYL_LAM_0 CRK_CYL_LAM_1 CRK_CYL_LAM_2 CRK_CYL_LAM_3 CRK_CYL_LAM_4 CRK_CYL_LAM_5 VLS_DLY_0 VLS_DLY_1 VLS_DLY_2 VLS_DLY_3 VLS_DLY_4 VLS_DLY_5 VLS_DIF_VAL_0 VLS_DIF_VAL_1 VLS_DIF_VAL_2 VLS_DIF_VAL_3 VLS_DIF_VAL_4 VLS_DIF_VAL_5 TI_CYL_LAM_0 TI_CYL_LAM_1 TI_CYL_LAM_2 TI_CYL_LAM_3 TI_CYL_LAM_4 TI_CYL_LAM_5 TI_AD_CYL_LAM_0 TI_AD_CYL_LAM_1 TI_AD_CYL_LAM_2 TI_AD_CYL_LAM_3 TI_AD_CYL_LAM_4 TI_AD_CYL_LAM_5 /end OUT_MEASUREMENT
/end FUNCTION
/begin FUNCTION INJ_Injection_at_restart_fuel_fe "_Injection at restart fuel feed"
 /begin DEF_CHARACTERISTIC ID_FAC_MFF_TCO_NEG_WF ID_FAC_MFF_TCO_POS_WF IP_FAC_MFF_MAP_WF ID_FAC_TI_RIS ID_FAC_TI_RPL ID_MFF_INC_WF ID_MFF_DEC_WF /end DEF_CHARACTERISTIC
 /begin OUT_MEASUREMENT MFF_ADD_REAC_CYL_0 MFF_ADD_REAC_CYL_1 MFF_ADD_REAC_CYL_2 MFF_ADD_REAC_CYL_3 MFF_ADD_REAC_CYL_4 MFF_ADD_REAC_CYL_5 MFF_DIF_WF_0 MFF_DIF_WF_1 MFF_DIF_WF_2 MFF_DIF_WF_3 MFF_DIF_WF_4 MFF_DIF_WF_5 FAC_TI_REAC_0 FAC_TI_REAC_1 FAC_TI_REAC_2 FAC_TI_REAC_3 FAC_TI_REAC_4 FAC_TI_REAC_5 /end OUT_MEASUREMENT
/end FUNCTION
/begin FUNCTION INJ_Catalyst_enrichment_function "_Catalyst enrichment function"
 /begin DEF_CHARACTERISTIC C_VLS_DOWN_PUC_ACT_MAX C_MAF_INT_PUC_MIN C_MAF_INT_PCAT_PURGE_SA C_MAF_INT_PCAT_PURGE_HST C_MAF_INT_PCAT_PURGE_CH C_FAC_ADD_PCAT_MAIN_CAT_PUC_SA C_FAC_ADD_PCAT_MAIN_CAT_PUC_HST C_FAC_ADD_PCAT_MAIN_CAT_PUC_CH C_DELTA_LAMB_SP_PUC_INC C_DELTA_LAMB_SP_PUC_DEC IP_DELTA_LAMB_SP_PUC IP_MAF_INT_ACT_PUC IP_FAC_CAT_EFF_PUC IP_FAC_PCAT_MAIN_CAT_PUC C_MAF_INT_ACT_PUC_MAX C_TCO_THD_HST C_QUO_MAF_INT_PUC_AFL /end DEF_CHARACTERISTIC
 /begin OUT_MEASUREMENT LV_ACT_INT_PUC_2 LV_DOWN_RAMP_ACT_1 LV_DOWN_RAMP_ACT_2 LV_PCAT_PURGE_PUC_1 LV_PCAT_PURGE_PUC_2 LV_PCAT_PURGE_SA_1 LV_PCAT_PURGE_SA_2 LV_PCAT_PURGE_HST_1 LV_PCAT_PURGE_HST_2 LV_PCAT_PURGE_CH_2 MAF_INT_ACT_PUC_1 MAF_INT_PUC MAF_INT_CAT_LOAD_1 MAF_INT_CAT_LOAD_2 MAF_INT_CAT_LOAD_MAIN_1 MAF_INT_CAT_LOAD_MAIN_2 LV_PCAT_PURGE_CH_1 LV_MAIN_CAT_PURGE_1 LV_MAIN_CAT_PURGE_2 LV_VLS_DOWN_PUC_ACT_MAX_2 DELTA_LAMB_SP_PUC_1 DELTA_LAMB_SP_PUC_2 MAF_INT_PURGE_REST_1 MAF_INT_PURGE_REST_2 MAF_INT_SAMPLE_STEP_1 LV_VLS_DOWN_PUC_ACT_MAX_1 MAF_INT_SAMPLE_STEP_2 FAC_ADD_PCAT_MAIN_CAT_PUC_1 FAC_ADD_PCAT_MAIN_CAT_PUC_2 LV_ACT_INT_PUC_1 LV_PUC_TRIG_1 LV_PUC_TRIG_2 MAF_INT_ACT_PUC_2 MAF_INT_TOT_PURGE_1 MAF_INT_TOT_PURGE_2 QUO_MAF_INT_PURGE_1 QUO_MAF_INT_PURGE_2 /end OUT_MEASUREMENT
/end FUNCTION
/begin FUNCTION INJ_Application_incidences_for_c "_Application incidences for catalyst enrichment function"
 /begin DEF_CHARACTERISTIC C_TCO_ACT_PUC_MIN C_N_MAX_CAT_PURGE C_TEMP_DIF_PCAT_MAIN_CAT C_MAF_CYL_ACT_INT_PUC_MAX C_THD_VLS_UP_CAT_PURGE C_THD_DELTA_LAMB_SP_PUC /end DEF_CHARACTERISTIC
 /begin OUT_MEASUREMENT LV_INH_INT_PUC_1 LV_ACT_INT_PUC_AFL_1 TEMP_MAIN_CAT_1 TEMP_PCAT_1 LV_INH_INT_PUC_2 LV_ACT_INT_PUC_AFL_2 TEMP_MAIN_CAT_2 TEMP_PCAT_2 /end OUT_MEASUREMENT
/end FUNCTION
/begin FUNCTION INJ_Fuel_mass_setpoint_and_pre_i "_Fuel mass setpoint and pre injection time calculation"
 /begin DEF_CHARACTERISTIC C_CYC_CAST_H_PRS IP_MFF_CST IP_MFF_DEAC_CST IP_FUP_MIN_INJ_ST C_TCO_ST_H_PRS ID_FAC_TIPR_DEAC IP_MFFPR_CST IP_MFFPR_FAC_ST_ES /end DEF_CHARACTERISTIC
 /begin OUT_MEASUREMENT LV_ST_H_PRS MFF_CST LV_MFF_CST_FUP_ACT CYC_CAST_FUP_THD BIOS_TIPR_BAS_0 BIOS_TIPR_BAS_1 BIOS_TIPR_BAS_2 BIOS_TIPR_BAS_3 BIOS_TIPR_BAS_4 BIOS_TIPR_BAS_5 BIOS_EOI_MIN_TIPR BIOS_NR_MAX_TOOTH_TIPR CYCNR_CST TIPR_0 TIPR_1 TIPR_2 TIPR_3 TIPR_4 TIPR_5 MFFPR MFFPR_CST /end OUT_MEASUREMENT
/end FUNCTION
/begin FUNCTION INJ_Application_Incidences_for_D "_Application Incidences for Downstream fuel trim" /begin DEF_CHARACTERISTIC ID_CRLC_VLS_DOWN_T_DLY /end DEF_CHARACTERISTIC
 /begin OUT_MEASUREMENT LV_INH_LAM_DLY_1 VLS_DOWN_AV_1 LV_INH_LAM_DLY_2 VLS_DOWN_AV_2 /end OUT_MEASUREMENT
/end FUNCTION
/begin FUNCTION INJ_Application_incidences_for_u "_Application incidences for upstream oxygen sensor heater management" /end FUNCTION
/begin FUNCTION INJ_Application_incidences_for_d "_Application incidences for downstream oxygen sensor heater management" /begin DEF_CHARACTERISTIC LC_LSH_DOWN_1 LC_LSH_DOWN_2 /end DEF_CHARACTERISTIC
 /begin OUT_MEASUREMENT LV_INH_LSH_DOWN_1 TEMP_LS_DOWN_INI_1 LV_INH_LSH_DOWN_2 TEMP_LS_DOWN_INI_2 /end OUT_MEASUREMENT
/end FUNCTION
/end MODULE
/end PROJECT
