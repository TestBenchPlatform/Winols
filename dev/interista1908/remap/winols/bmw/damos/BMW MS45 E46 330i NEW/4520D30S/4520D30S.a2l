ASAP2_VERSION 1 31
/begin PROJECT MS45 "BMW Motorsteuerung R6"
/begin HEADER "_default_HeaderComment" PROJECT_NO _52 /end HEADER
/begin MODULE _default_ModuleName "_default_ModuleLongIdentifier"
/begin MOD_COMMON "_default_ModCommonComment" DEPOSIT ABSOLUTE BYTE_ORDER MSB_FIRST ALIGNMENT_BYTE 1 ALIGNMENT_WORD 2 ALIGNMENT_LONG 4 ALIGNMENT_FLOAT32_IEEE 4 ALIGNMENT_FLOAT64_IEEE 8 /end MOD_COMMON
/begin MEASUREMENT LV_EF "Logical value exhaust flap, 1 = closed flap" UBYTE _CNV_S_2_RANGE______11_CM 1 100. 0. 1. ECU_ADDRESS 0x3fcfa3 BIT_MASK 0x1 /end MEASUREMENT
/begin CHARACTERISTIC ID_NR_IP_GEAR_EF_AT "Index of switching threshold map, AT vehicle" CURVE 0x4ce1e _REC_CUR_20_u1_u1 4. _CNV_A_R_LINEAR_____10_CM 1. 5. FORMAT "%2.0"
 /begin AXIS_DESCR COM_AXIS GEAR_EF _CNV_A_R_LINEAR_____12_CM 13 0. 12. FORMAT "%3.0" AXIS_PTS_REF ldpm_gear_ef_1 /end AXIS_DESCR
/end CHARACTERISTIC
/begin CHARACTERISTIC ID_NR_IP_GEAR_EF_MT "Index of switching threshold map, MT vehicle" CURVE 0x4ce2b _REC_CUR_20_u1_u1 4. _CNV_A_R_LINEAR_____10_CM 1. 5. FORMAT "%2.0"
 /begin AXIS_DESCR COM_AXIS GEAR_EF _CNV_A_R_LINEAR_____12_CM 13 0. 12. FORMAT "%3.0" AXIS_PTS_REF ldpm_gear_ef_1 /end AXIS_DESCR
/end CHARACTERISTIC
/begin CHARACTERISTIC IP_PV_MIN_AT_2_EF "Switching threshold of exhaust flap, AT vehicle, gear group 2" CURVE 0x4fdda _REC_CUR_20_u1_u1 99.609375 _CNV_A_R_LINEAR_____4_CM 0. 99.609375 FORMAT "%4.1"
 /begin AXIS_DESCR COM_AXIS N_32 _CNV_A_R_LINEAR_____5_CM 5 0. 8160. FORMAT "%4.0" AXIS_PTS_REF ldpm_n_32__ef /end AXIS_DESCR
/end CHARACTERISTIC
/begin CHARACTERISTIC IP_PV_MIN_AT_3_EF "Switching threshold of exhaust flap, AT vehicle, gear group 3" CURVE 0x4fddf _REC_CUR_20_u1_u1 99.609375 _CNV_A_R_LINEAR_____4_CM 0. 99.609375 FORMAT "%4.1"
 /begin AXIS_DESCR COM_AXIS N_32 _CNV_A_R_LINEAR_____5_CM 5 0. 8160. FORMAT "%4.0" AXIS_PTS_REF ldpm_n_32__ef /end AXIS_DESCR
/end CHARACTERISTIC
/begin CHARACTERISTIC IP_PV_MIN_AT_4_EF "Switching threshold of exhaust flap, AT vehicle, gear group 4" CURVE 0x4fde4 _REC_CUR_20_u1_u1 99.609375 _CNV_A_R_LINEAR_____4_CM 0. 99.609375 FORMAT "%4.1"
 /begin AXIS_DESCR COM_AXIS N_32 _CNV_A_R_LINEAR_____5_CM 5 0. 8160. FORMAT "%4.0" AXIS_PTS_REF ldpm_n_32__ef /end AXIS_DESCR
/end CHARACTERISTIC
/begin CHARACTERISTIC IP_PV_MIN_AT_5_EF "Switching threshold of exhaust flap, AT vehicle, gear group 5" CURVE 0x4fde9 _REC_CUR_20_u1_u1 99.609375 _CNV_A_R_LINEAR_____4_CM 0. 99.609375 FORMAT "%4.1"
 /begin AXIS_DESCR COM_AXIS N_32 _CNV_A_R_LINEAR_____5_CM 5 0. 8160. FORMAT "%4.0" AXIS_PTS_REF ldpm_n_32__ef /end AXIS_DESCR
/end CHARACTERISTIC
/begin CHARACTERISTIC IP_PV_MIN_MT_1_EF "Switching threshold of exhaust flap, MT vehicle, gear group 1" CURVE 0x4fdee _REC_CUR_20_u1_u1 99.609375 _CNV_A_R_LINEAR_____4_CM 0. 99.609375 FORMAT "%4.1"
 /begin AXIS_DESCR COM_AXIS N_32 _CNV_A_R_LINEAR_____5_CM 5 0. 8160. FORMAT "%4.0" AXIS_PTS_REF ldpm_n_32__ef /end AXIS_DESCR
/end CHARACTERISTIC
/begin CHARACTERISTIC IP_PV_MIN_MT_2_EF "Switching threshold of exhaust flap, MT vehicle, gear group 2" CURVE 0x4fdf3 _REC_CUR_20_u1_u1 99.609375 _CNV_A_R_LINEAR_____4_CM 0. 99.609375 FORMAT "%4.1"
 /begin AXIS_DESCR COM_AXIS N_32 _CNV_A_R_LINEAR_____5_CM 5 0. 8160. FORMAT "%4.0" AXIS_PTS_REF ldpm_n_32__ef /end AXIS_DESCR
/end CHARACTERISTIC
/begin CHARACTERISTIC IP_PV_MIN_MT_3_EF "Switching threshold of exhaust flap, MT vehicle, gear group 3" CURVE 0x4fdf8 _REC_CUR_20_u1_u1 99.609375 _CNV_A_R_LINEAR_____4_CM 0. 99.609375 FORMAT "%4.1"
 /begin AXIS_DESCR COM_AXIS N_32 _CNV_A_R_LINEAR_____5_CM 5 0. 8160. FORMAT "%4.0" AXIS_PTS_REF ldpm_n_32__ef /end AXIS_DESCR
/end CHARACTERISTIC
/begin CHARACTERISTIC IP_PV_MIN_MT_4_EF "Switching threshold of exhaust flap, MT vehicle, gear group 4" CURVE 0x4fdfd _REC_CUR_20_u1_u1 99.609375 _CNV_A_R_LINEAR_____4_CM 0. 99.609375 FORMAT "%4.1"
 /begin AXIS_DESCR COM_AXIS N_32 _CNV_A_R_LINEAR_____5_CM 5 0. 8160. FORMAT "%4.0" AXIS_PTS_REF ldpm_n_32__ef /end AXIS_DESCR
/end CHARACTERISTIC
/begin CHARACTERISTIC C_PV_HYS_EF "Hysteresis for switching threshold" VALUE 0x4298e _REC_VAL_20_u1 99.609375 _CNV_A_R_LINEAR_____4_CM 0. 99.609375 FORMAT "%4.1" /end CHARACTERISTIC
/begin CHARACTERISTIC C_VS_MIN_EF_AT "Speed threshold for continuously opened exhaust flap, automatically shifted transmission" VALUE 0x42b37 _REC_VAL_20_u1 255. _CNV_A_R_LINEAR_____13_CM 0. 255. FORMAT "%3.0" /end CHARACTERISTIC
/begin CHARACTERISTIC C_VS_MIN_EF_MT "Speed threshold for continuously opened exhaust flap, manually shifted transmission" VALUE 0x42b38 _REC_VAL_20_u1 255. _CNV_A_R_LINEAR_____13_CM 0. 255. FORMAT "%3.0" /end CHARACTERISTIC
/begin CHARACTERISTIC C_T_EF_AST "Cranking time for EF actuation active" VALUE 0x429f9 _REC_VAL_20_u1 25.5 _CNV_A_R_LINEAR_____14_CM 0. 25.5 FORMAT "%4.1" /end CHARACTERISTIC
/begin CHARACTERISTIC C_STATE_VS_MIN_EF_AT "Exhaust flap actuation in case of vs < C_VS_MIN_EF_AT for AT version" VALUE 0x429a3 _REC_VAL_20_u1 1. _CNV_A_R_LINEAR_____10_CM 0. 1. FORMAT "%2.0" /end CHARACTERISTIC
/begin CHARACTERISTIC C_STATE_VS_MIN_EF_MT "Exhaust flap actuation in case of vs < C_VS_MIN_EF_MT for MT version" VALUE 0x429a4 _REC_VAL_20_u1 1. _CNV_A_R_LINEAR_____10_CM 0. 1. FORMAT "%2.0" /end CHARACTERISTIC
/begin CHARACTERISTIC IP_PV_MIN_MT_5_EF "Switching threshold of exhaust flap, MT vehicle, gear group 5" CURVE 0x4fe02 _REC_CUR_20_u1_u1 99.609375 _CNV_A_R_LINEAR_____4_CM 0. 99.609375 FORMAT "%4.1"
 /begin AXIS_DESCR COM_AXIS N_32 _CNV_A_R_LINEAR_____5_CM 5 0. 8160. FORMAT "%4.0" AXIS_PTS_REF ldpm_n_32__ef /end AXIS_DESCR
/end CHARACTERISTIC
/begin CHARACTERISTIC C_STATE_CH_EF "Exhaust flap actuation in case catalyst heating with increased idle speed" VALUE 0x429a1 _REC_VAL_20_u1 1. _CNV_A_R_LINEAR_____10_CM 0. 1. FORMAT "%2.0" /end CHARACTERISTIC
/begin CHARACTERISTIC IP_PV_MIN_AT_1_EF "Switching threshold of exhaust flap, AT vehicle, gear group 1" CURVE 0x4fdd5 _REC_CUR_20_u1_u1 99.609375 _CNV_A_R_LINEAR_____4_CM 0. 99.609375 FORMAT "%4.1"
 /begin AXIS_DESCR COM_AXIS N_32 _CNV_A_R_LINEAR_____5_CM 5 0. 8160. FORMAT "%4.0" AXIS_PTS_REF ldpm_n_32__ef /end AXIS_DESCR
/end CHARACTERISTIC
/begin AXIS_PTS ldpm_gear_ef_1 "" 0x43bd6 GEAR_EF _REC_AXS_20_u1 12. _CNV_A_R_LINEAR_____12_CM 13 0. 12. FORMAT "%3.0" /end AXIS_PTS
/begin AXIS_PTS ldpm_n_32__ef "" 0x43d7a N_32 _REC_AXS_20_u1 8160. _CNV_A_R_LINEAR_____5_CM 5 0. 8160. FORMAT "%4.0" /end AXIS_PTS
/begin MEASUREMENT SOFPWM "Sound flap" UBYTE _CNV_A_R_LINEAR_____4_CM 1 100. 0. 99.609375 ECU_ADDRESS 0x3fcfa8 FORMAT "%4.1" /end MEASUREMENT
/begin MEASUREMENT LV_SOF_INH "Sound flap inhibitation" UBYTE _CNV_S_2_RANGE______11_CM 1 100. 0. 1. ECU_ADDRESS 0x3fcfb0 /end MEASUREMENT
/begin MEASUREMENT PV_AV_SOF_REQ "" UBYTE _CNV_A_R_LINEAR_____4_CM 1 100. 0. 99.609375 ECU_ADDRESS 0x3fcfa9 FORMAT "%4.1" /end MEASUREMENT
/begin MEASUREMENT N_SOF_REQ "" UWORD _CNV_A_R_LINEAR_____17_CM 1 100. 0. 8160. ECU_ADDRESS 0x3fcfa4 FORMAT "%4.0" /end MEASUREMENT
/begin MEASUREMENT LV_SOF_ACT "Logical value sound flap (1 = activated)" UBYTE _CNV_S_2_RANGE______11_CM 1 100. 0. 1. ECU_ADDRESS 0x3fcfb1 /end MEASUREMENT
/begin MEASUREMENT LV_SOF_REQ "Request activ/inactiv (0 = inactiv, 1 = activ)" UBYTE _CNV_S_2_RANGE______11_CM 1 100. 0. 1. ECU_ADDRESS 0x3fcfb2 /end MEASUREMENT
/begin MEASUREMENT T_SOF_ACT "Timer for Sound-flap activ" UWORD _CNV_A_R_LINEAR_____27_CM 1 100. 0. 655.35 ECU_ADDRESS 0x3fcfa6 FORMAT "%6.2" /end MEASUREMENT
/begin MEASUREMENT SOFPWM_SOF "PWM for Sound-flap" UBYTE _CNV_A_R_LINEAR_____4_CM 1 100. 0. 99.609375 ECU_ADDRESS 0x3fcfaa FORMAT "%4.1" /end MEASUREMENT
/begin MEASUREMENT SOFPWM_COR "PWM for Sound-flap, correction" UBYTE _CNV_A_R_LINEAR_____4_CM 1 100. 0. 99.609375 ECU_ADDRESS 0x3fcfab FORMAT "%4.1" /end MEASUREMENT
/begin CHARACTERISTIC C_V_SOF_SWI_ON_BOL "Voltage-Treshold bottom limit for sport mode ON" VALUE 0x43132 _REC_VAL_20_u2 4.99511719 _CNV_A_R_LINEAR_____33_CM 0. 4.99511719 FORMAT "%5.3" /end CHARACTERISTIC
/begin CHARACTERISTIC C_PV_AV_SOF_HYS "pedal value hysteresis SOF" VALUE 0x42989 _REC_VAL_20_u1 99.609375 _CNV_A_R_LINEAR_____4_CM 0. 99.609375 FORMAT "%4.1" /end CHARACTERISTIC
/begin CHARACTERISTIC C_N_SOF_HYS "n hysteresis SOF" VALUE 0x42ebe _REC_VAL_20_u2 8160. _CNV_A_R_LINEAR_____17_CM 0. 8160. FORMAT "%4.0" /end CHARACTERISTIC
/begin CHARACTERISTIC C_VS_SOF_MAX "vs treshold for SOF activation" VALUE 0x42b3f _REC_VAL_20_u1 255. _CNV_A_R_LINEAR_____13_CM 0. 255. FORMAT "%3.0" /end CHARACTERISTIC
/begin CHARACTERISTIC C_T_AST_SOF "time after start for SOF" VALUE 0x42f5c _REC_VAL_20_u2 6553.5 _CNV_A_R_LINEAR_____14_CM 0. 6553.5 FORMAT "%6.1" /end CHARACTERISTIC
/begin CHARACTERISTIC C_TIA_SOF_MIN "TIA treshold for SOF activation" VALUE 0x42ab9 _REC_VAL_20_u1 190.5 _CNV_A_R_LINEAR_____0_CM -48. 142.5 FORMAT "%5.1" /end CHARACTERISTIC
/begin CHARACTERISTIC C_SOFPWM_MIN "min pwm for SOF control" VALUE 0x4299e _REC_VAL_20_u1 99.609375 _CNV_A_R_LINEAR_____4_CM 0. 99.609375 FORMAT "%4.1" /end CHARACTERISTIC
/begin CHARACTERISTIC C_T_SOF_ACT_MAX "Timer for sound flap activation, max value" VALUE 0x4302a _REC_VAL_20_u2 655.35 _CNV_A_R_LINEAR_____27_CM 0. 655.35 FORMAT "%6.2" /end CHARACTERISTIC
/begin CHARACTERISTIC ID_SOF_REQ_GEAR_0 "Request SOF in dependency of N and PV_AV_SOF_REQ (x = 0..6)" MAP 0x4ced1 _REC_MAP_20_u1_u1_u2 1. _CNV_A_R_LINEAR_____10_CM 0. 1. FORMAT "%2.0"
 /begin AXIS_DESCR COM_AXIS PV_AV_SOF_REQ _CNV_A_R_LINEAR_____4_CM 4 0. 99.609375 FORMAT "%4.1" AXIS_PTS_REF ldp_pv_av_sof_req_0 /end AXIS_DESCR
 /begin AXIS_DESCR COM_AXIS N_SOF_REQ _CNV_A_R_LINEAR_____17_CM 6 0. 8160. FORMAT "%4.0" AXIS_PTS_REF ldp_n_sof_req_0 /end AXIS_DESCR
/end CHARACTERISTIC
/begin CHARACTERISTIC ID_SOF_REQ_GEAR_1 "Request SOF in dependency of N and PV_AV_SOF_REQ (x = 0..6)" MAP 0x4cee9 _REC_MAP_20_u1_u1_u2 1. _CNV_A_R_LINEAR_____10_CM 0. 1. FORMAT "%2.0"
 /begin AXIS_DESCR COM_AXIS PV_AV_SOF_REQ _CNV_A_R_LINEAR_____4_CM 4 0. 99.609375 FORMAT "%4.1" AXIS_PTS_REF ldp_pv_av_sof_req_1 /end AXIS_DESCR
 /begin AXIS_DESCR COM_AXIS N_SOF_REQ _CNV_A_R_LINEAR_____17_CM 6 0. 8160. FORMAT "%4.0" AXIS_PTS_REF ldp_n_sof_req_1 /end AXIS_DESCR
/end CHARACTERISTIC
/begin CHARACTERISTIC ID_SOF_REQ_GEAR_2 "Request SOF in dependency of N and PV_AV_SOF_REQ (x = 0..6)" MAP 0x4cf01 _REC_MAP_20_u1_u1_u2 1. _CNV_A_R_LINEAR_____10_CM 0. 1. FORMAT "%2.0"
 /begin AXIS_DESCR COM_AXIS PV_AV_SOF_REQ _CNV_A_R_LINEAR_____4_CM 4 0. 99.609375 FORMAT "%4.1" AXIS_PTS_REF ldp_pv_av_sof_req_2 /end AXIS_DESCR
 /begin AXIS_DESCR COM_AXIS N_SOF_REQ _CNV_A_R_LINEAR_____17_CM 6 0. 8160. FORMAT "%4.0" AXIS_PTS_REF ldp_n_sof_req_2 /end AXIS_DESCR
/end CHARACTERISTIC
/begin CHARACTERISTIC ID_SOF_REQ_GEAR_3 "Request SOF in dependency of N and PV_AV_SOF_REQ (x = 0..6)" MAP 0x4cf19 _REC_MAP_20_u1_u1_u2 1. _CNV_A_R_LINEAR_____10_CM 0. 1. FORMAT "%2.0"
 /begin AXIS_DESCR COM_AXIS PV_AV_SOF_REQ _CNV_A_R_LINEAR_____4_CM 4 0. 99.609375 FORMAT "%4.1" AXIS_PTS_REF ldp_pv_av_sof_req_3 /end AXIS_DESCR
 /begin AXIS_DESCR COM_AXIS N_SOF_REQ _CNV_A_R_LINEAR_____17_CM 6 0. 8160. FORMAT "%4.0" AXIS_PTS_REF ldp_n_sof_req_3 /end AXIS_DESCR
/end CHARACTERISTIC
/begin CHARACTERISTIC ID_SOF_REQ_GEAR_4 "Request SOF in dependency of N and PV_AV_SOF_REQ (x = 0..6)" MAP 0x4cf31 _REC_MAP_20_u1_u1_u2 1. _CNV_A_R_LINEAR_____10_CM 0. 1. FORMAT "%2.0"
 /begin AXIS_DESCR COM_AXIS PV_AV_SOF_REQ _CNV_A_R_LINEAR_____4_CM 4 0. 99.609375 FORMAT "%4.1" AXIS_PTS_REF ldp_pv_av_sof_req_4 /end AXIS_DESCR
 /begin AXIS_DESCR COM_AXIS N_SOF_REQ _CNV_A_R_LINEAR_____17_CM 6 0. 8160. FORMAT "%4.0" AXIS_PTS_REF ldp_n_sof_req_4 /end AXIS_DESCR
/end CHARACTERISTIC
/begin CHARACTERISTIC ID_SOF_REQ_GEAR_5 "Request SOF in dependency of N and PV_AV_SOF_REQ (x = 0..6)" MAP 0x4cf49 _REC_MAP_20_u1_u1_u2 1. _CNV_A_R_LINEAR_____10_CM 0. 1. FORMAT "%2.0"
 /begin AXIS_DESCR COM_AXIS PV_AV_SOF_REQ _CNV_A_R_LINEAR_____4_CM 4 0. 99.609375 FORMAT "%4.1" AXIS_PTS_REF ldp_pv_av_sof_req_5 /end AXIS_DESCR
 /begin AXIS_DESCR COM_AXIS N_SOF_REQ _CNV_A_R_LINEAR_____17_CM 6 0. 8160. FORMAT "%4.0" AXIS_PTS_REF ldp_n_sof_req_5 /end AXIS_DESCR
/end CHARACTERISTIC
/begin CHARACTERISTIC ID_SOF_REQ_GEAR_6 "Request SOF in dependency of N and PV_AV_SOF_REQ (x = 0..6)" MAP 0x4cf61 _REC_MAP_20_u1_u1_u2 1. _CNV_A_R_LINEAR_____10_CM 0. 1. FORMAT "%2.0"
 /begin AXIS_DESCR COM_AXIS PV_AV_SOF_REQ _CNV_A_R_LINEAR_____4_CM 4 0. 99.609375 FORMAT "%4.1" AXIS_PTS_REF ldp_pv_av_sof_req_6 /end AXIS_DESCR
 /begin AXIS_DESCR COM_AXIS N_SOF_REQ _CNV_A_R_LINEAR_____17_CM 6 0. 8160. FORMAT "%4.0" AXIS_PTS_REF ldp_n_sof_req_6 /end AXIS_DESCR
/end CHARACTERISTIC
/begin CHARACTERISTIC IP_FAC_SOFPWM_ON "FAC-PWM Soundflap ON" CURVE 0x4e4d6 _REC_CUR_20_u1_u2 0.99610001 _CNV_A_R_LINEAR_____20_CM 0. 0.99610001 FORMAT "%5.3"
 /begin AXIS_DESCR COM_AXIS T_SOF_ACT _CNV_A_R_LINEAR_____27_CM 15 0. 655.35 FORMAT "%6.2" AXIS_PTS_REF ldpm_t_sof_act /end AXIS_DESCR
/end CHARACTERISTIC
/begin CHARACTERISTIC IP_FAC_SOFPWM_OFF "FAC-PWM Soundflap OFF" CURVE 0x4e4c7 _REC_CUR_20_u1_u2 0.99610001 _CNV_A_R_LINEAR_____20_CM 0. 0.99610001 FORMAT "%5.3"
 /begin AXIS_DESCR COM_AXIS T_SOF_ACT _CNV_A_R_LINEAR_____27_CM 15 0. 655.35 FORMAT "%6.2" AXIS_PTS_REF ldpm_t_sof_act /end AXIS_DESCR
/end CHARACTERISTIC
/begin CHARACTERISTIC IP_FAC_SOFPWM_VB "correction of SOFPWM concerning Ubatt" CURVE 0x4e4ed _REC_CUR_20_u1_u1 1.99220002 _CNV_A_R_LINEAR_____34_CM 0. 1.99220002 FORMAT "%5.3"
 /begin AXIS_DESCR COM_AXIS VB _CNV_A_R_LINEAR_____26_CM 8 0. 25.8984 FORMAT "%3.1" AXIS_PTS_REF ldp_vb_sof /end AXIS_DESCR
/end CHARACTERISTIC
/begin CHARACTERISTIC IP_FAC_SOFPWM_TIA "correction of SOFPWM concerning TIA" CURVE 0x4e4e5 _REC_CUR_20_u1_u1 1.99220002 _CNV_A_R_LINEAR_____34_CM 0. 1.99220002 FORMAT "%5.3"
 /begin AXIS_DESCR COM_AXIS TIA _CNV_A_R_LINEAR_____0_CM 8 -48. 142.5 FORMAT "%5.1" AXIS_PTS_REF ldp_tia_sof /end AXIS_DESCR
/end CHARACTERISTIC
/begin CHARACTERISTIC C_VS_SOF_MAX_HYS "VS treshold, hysteresis" VALUE 0x42b40 _REC_VAL_20_u1 255. _CNV_A_R_LINEAR_____13_CM 0. 255. FORMAT "%3.0" /end CHARACTERISTIC
/begin CHARACTERISTIC C_T_ES_SOF "Voltage-Treshold bottom limit for sport mode ON" VALUE 0x42fda _REC_VAL_20_u2 65535. _CNV_A_R_LINEAR_____35_CM 0. 65535. FORMAT "%5.0" /end CHARACTERISTIC
/begin CHARACTERISTIC LC_SOF_ACT_KWP "Flag for TIA and VB correction of sound-flap PWM" VALUE 0x42bc3 _REC_VAL_20_u1 1. _CNV_A_R_LINEAR_____10_CM 0. 1. FORMAT "%2.0" /end CHARACTERISTIC
/begin CHARACTERISTIC C_SOFPWM_MAX "max. pwm for SOF control" VALUE 0x4299d _REC_VAL_20_u1 99.609375 _CNV_A_R_LINEAR_____4_CM 0. 99.609375 FORMAT "%4.1" /end CHARACTERISTIC
/begin MEASUREMENT LV_SOF_SWI_REQ "Sport Mode required by switch" UBYTE _CNV_S_2_RANGE______11_CM 1 100. 0. 1. ECU_ADDRESS 0x3fcfac /end MEASUREMENT
/begin AXIS_PTS ldp_vb_sof "" 0x43af4 VB _REC_AXS_20_u1 25.8984 _CNV_A_R_LINEAR_____26_CM 8 0. 25.8984 FORMAT "%3.1" /end AXIS_PTS
/begin AXIS_PTS ldp_tia_sof "" 0x439fb TIA _REC_AXS_20_u1 190.5 _CNV_A_R_LINEAR_____0_CM 8 -48. 142.5 FORMAT "%5.1" /end AXIS_PTS
/begin AXIS_PTS ldpm_t_sof_act "" 0x4545e T_SOF_ACT _REC_AXS_20_u2 655.35 _CNV_A_R_LINEAR_____27_CM 15 0. 655.35 FORMAT "%6.2" /end AXIS_PTS
/begin AXIS_PTS ldp_pv_av_sof_req_1 "" 0x437c3 PV_AV_SOF_REQ _REC_AXS_20_u1 99.609375 _CNV_A_R_LINEAR_____4_CM 4 0. 99.609375 FORMAT "%4.1" /end AXIS_PTS
/begin AXIS_PTS ldp_pv_av_sof_req_2 "" 0x437c8 PV_AV_SOF_REQ _REC_AXS_20_u1 99.609375 _CNV_A_R_LINEAR_____4_CM 4 0. 99.609375 FORMAT "%4.1" /end AXIS_PTS
/begin AXIS_PTS ldp_pv_av_sof_req_3 "" 0x437cd PV_AV_SOF_REQ _REC_AXS_20_u1 99.609375 _CNV_A_R_LINEAR_____4_CM 4 0. 99.609375 FORMAT "%4.1" /end AXIS_PTS
/begin AXIS_PTS ldp_pv_av_sof_req_4 "" 0x437d2 PV_AV_SOF_REQ _REC_AXS_20_u1 99.609375 _CNV_A_R_LINEAR_____4_CM 4 0. 99.609375 FORMAT "%4.1" /end AXIS_PTS
/begin AXIS_PTS ldp_pv_av_sof_req_5 "" 0x437d7 PV_AV_SOF_REQ _REC_AXS_20_u1 99.609375 _CNV_A_R_LINEAR_____4_CM 4 0. 99.609375 FORMAT "%4.1" /end AXIS_PTS
/begin AXIS_PTS ldp_pv_av_sof_req_0 "" 0x437be PV_AV_SOF_REQ _REC_AXS_20_u1 99.609375 _CNV_A_R_LINEAR_____4_CM 4 0. 99.609375 FORMAT "%4.1" /end AXIS_PTS
/begin AXIS_PTS ldp_pv_av_sof_req_6 "" 0x437dc PV_AV_SOF_REQ _REC_AXS_20_u1 99.609375 _CNV_A_R_LINEAR_____4_CM 4 0. 99.609375 FORMAT "%4.1" /end AXIS_PTS
/begin AXIS_PTS ldp_n_sof_req_1 "" 0x448ec N_SOF_REQ _REC_AXS_20_u2 8160. _CNV_A_R_LINEAR_____17_CM 6 0. 8160. FORMAT "%4.0" /end AXIS_PTS
/begin AXIS_PTS ldp_n_sof_req_2 "" 0x448fa N_SOF_REQ _REC_AXS_20_u2 8160. _CNV_A_R_LINEAR_____17_CM 6 0. 8160. FORMAT "%4.0" /end AXIS_PTS
/begin AXIS_PTS ldp_n_sof_req_3 "" 0x44908 N_SOF_REQ _REC_AXS_20_u2 8160. _CNV_A_R_LINEAR_____17_CM 6 0. 8160. FORMAT "%4.0" /end AXIS_PTS
/begin AXIS_PTS ldp_n_sof_req_4 "" 0x44916 N_SOF_REQ _REC_AXS_20_u2 8160. _CNV_A_R_LINEAR_____17_CM 6 0. 8160. FORMAT "%4.0" /end AXIS_PTS
/begin AXIS_PTS ldp_n_sof_req_5 "" 0x44924 N_SOF_REQ _REC_AXS_20_u2 8160. _CNV_A_R_LINEAR_____17_CM 6 0. 8160. FORMAT "%4.0" /end AXIS_PTS
/begin AXIS_PTS ldp_n_sof_req_0 "" 0x448de N_SOF_REQ _REC_AXS_20_u2 8160. _CNV_A_R_LINEAR_____17_CM 6 0. 8160. FORMAT "%4.0" /end AXIS_PTS
/begin AXIS_PTS ldp_n_sof_req_6 "" 0x44932 N_SOF_REQ _REC_AXS_20_u2 8160. _CNV_A_R_LINEAR_____17_CM 6 0. 8160. FORMAT "%4.0" /end AXIS_PTS
/begin MEASUREMENT LV_SOF_SWI "Sport Mode switch acting" UBYTE _CNV_S_2_RANGE______11_CM 1 100. 0. 1. ECU_ADDRESS 0x3fcfad /end MEASUREMENT
/begin MEASUREMENT LV_SOF_SWI_AMT "Sport-mode switch AMT acting" UBYTE _CNV_S_2_RANGE______11_CM 1 100. 0. 1. ECU_ADDRESS 0x3fcfae /end MEASUREMENT
/begin MEASUREMENT LV_SOF_SWI_AMT_REQ "Sport-mode AMT required by switch" UBYTE _CNV_S_2_RANGE______11_CM 1 100. 0. 1. ECU_ADDRESS 0x3fcfaf /end MEASUREMENT
/begin CHARACTERISTIC C_V_SOF_SWI_ON_TOL "Voltage-Treshold top limit for sport mode ON (AMT)" VALUE 0x43134 _REC_VAL_20_u2 4.99511719 _CNV_A_R_LINEAR_____33_CM 0. 4.99511719 FORMAT "%5.3" /end CHARACTERISTIC
/begin CHARACTERISTIC C_V_SOF_SWI_AMT_ON_TOL "Voltage-Treshold top limit for sport mode ON" VALUE 0x4312c _REC_VAL_20_u2 4.99511719 _CNV_A_R_LINEAR_____33_CM 0. 4.99511719 FORMAT "%5.3" /end CHARACTERISTIC
/begin CHARACTERISTIC LC_VAR_SOF_SWI "Calibration switch (1 on / 0 off)" VALUE 0x42bf5 _REC_VAL_20_u1 1. _CNV_A_R_LINEAR_____10_CM 0. 1. FORMAT "%2.0" /end CHARACTERISTIC
/begin CHARACTERISTIC LC_VAR_SOF_SWI_AMT "Calibration switch (1 on / 0 off)" VALUE 0x42bf6 _REC_VAL_20_u1 1. _CNV_A_R_LINEAR_____10_CM 0. 1. FORMAT "%2.0" /end CHARACTERISTIC
/begin MEASUREMENT V_AMP "Ambient pressure sensor raw acquisition" UWORD _CNV_A_R_LINEAR_____33_CM 1 100. 0. 4.99511719 ECU_ADDRESS 0x3fccbc FORMAT "%5.3" /end MEASUREMENT
/begin MEASUREMENT V_TIA "Intake air temperature sensor raw acquisition." UBYTE _CNV_A_R_LINEAR_____36_CM 1 100. 0. 4.998 ECU_ADDRESS 0x3fccee FORMAT "%5.3" /end MEASUREMENT
/begin MEASUREMENT V_PVS_1 "Pedal value sensor 1 raw acquisition" UWORD _CNV_A_R_LINEAR_____33_CM 1 100. 0. 4.99511719 ECU_ADDRESS 0x3fccc2 FORMAT "%5.3" /end MEASUREMENT
/begin MEASUREMENT V_PVS_2 "Pedal value sensor 2 raw acquisition" UWORD _CNV_A_R_LINEAR_____33_CM 1 100. 0. 4.99511719 ECU_ADDRESS 0x3fccc4 FORMAT "%5.3" /end MEASUREMENT
/begin MEASUREMENT V_TCO "Coolant temperature sensor raw acquisition." UWORD _CNV_A_R_LINEAR_____33_CM 1 100. 0. 4.99511719 ECU_ADDRESS 0x3fccd4 FORMAT "%5.3" /end MEASUREMENT
/begin MEASUREMENT V_TCO_EX "coolant temperature at cooler outlet" UWORD _CNV_A_R_LINEAR_____33_CM 1 100. 0. 4.99511719 ECU_ADDRESS 0x3fccd2 FORMAT "%5.3" /end MEASUREMENT
/begin MEASUREMENT V_TPS_1 "Throttle position sensor 1 raw acquisition." UWORD _CNV_A_R_LINEAR_____33_CM 1 100. 0. 4.99511719 ECU_ADDRESS 0x3fcccc FORMAT "%5.3" /end MEASUREMENT
/begin MEASUREMENT V_TPS_2 "Throttle position sensor 2 raw acquisition." UWORD _CNV_A_R_LINEAR_____33_CM 1 100. 0. 4.99511719 ECU_ADDRESS 0x3fccce FORMAT "%5.3" /end MEASUREMENT
/begin MEASUREMENT V_LS_UP_1 "Upstream oxygen sensor voltage raw acquisition - Bank n° 1" UWORD _CNV_A_R_LINEAR_____33_CM 1 100. 0. 4.99511719 ECU_ADDRESS 0x3fccb8 FORMAT "%5.3" /end MEASUREMENT
/begin MEASUREMENT V_LS_UP_2 "Upstream oxygen sensor voltage raw acquisition - Bank n° 2" UWORD _CNV_A_R_LINEAR_____33_CM 1 100. 0. 4.99511719 ECU_ADDRESS 0x3fccba FORMAT "%5.3" /end MEASUREMENT
/begin MEASUREMENT V_LS_DOWN_2 "Downstream oxygen sensor voltage raw acquisition - Bank n° 2" UWORD _CNV_A_R_LINEAR_____33_CM 1 100. 0. 4.99511719 ECU_ADDRESS 0x3fccc0 FORMAT "%5.3" /end MEASUREMENT
/begin MEASUREMENT V_LS_DOWN_1 "Downstream oxygen sensor voltage raw acquisition - Bank n° 1" UWORD _CNV_A_R_LINEAR_____33_CM 1 100. 0. 4.99511719 ECU_ADDRESS 0x3fccbe FORMAT "%5.3" /end MEASUREMENT
/begin MEASUREMENT VCC_PVS_1 "Voltage supply for pedal value sensor 1 (and TPS) raw acquisition" UWORD _CNV_A_R_LINEAR_____37_CM 1 100. 0. 9.9902 ECU_ADDRESS 0x3fccc6 FORMAT "%5.3" /end MEASUREMENT
/begin MEASUREMENT VCC_PVS_2 "Voltage supply for pedal value sensor 2 raw acquisition" UWORD _CNV_A_R_LINEAR_____37_CM 1 100. 0. 9.9902 ECU_ADDRESS 0x3fccc8 FORMAT "%5.3" /end MEASUREMENT
/begin MEASUREMENT V_VIM_FB "Variable intake manifold feedback sensor raw acquisition." UWORD _CNV_A_R_LINEAR_____33_CM 1 100. 0. 4.99511719 ECU_ADDRESS 0x3fccda FORMAT "%5.3" /end MEASUREMENT
/begin MEASUREMENT V_EGR "Position feedback EGR valve" UWORD _CNV_A_R_LINEAR_____33_CM 1 100. 0. 4.99511719 ECU_ADDRESS 0x3fcce0 FORMAT "%5.3" /end MEASUREMENT
/begin MEASUREMENT V_TEG_PCAT_DOWN_1 "Catalyst temperature sensor raw acquisition - cylinder bank 1" UWORD _CNV_A_R_LINEAR_____33_CM 1 100. 0. 4.99511719 ECU_ADDRESS 0x3fccd6 FORMAT "%5.3" /end MEASUREMENT
/begin MEASUREMENT V_TEG_PCAT_DOWN_2 "Catalyst temperature sensor raw acquisition - cylinder bank 2" UWORD _CNV_A_R_LINEAR_____33_CM 1 100. 0. 4.99511719 ECU_ADDRESS 0x3fccd8 FORMAT "%5.3" /end MEASUREMENT
/begin MEASUREMENT V_PORT "Position feedback port flaps" UWORD _CNV_A_R_LINEAR_____33_CM 1 100. 0. 4.99511719 ECU_ADDRESS 0x3fcce2 FORMAT "%5.3" /end MEASUREMENT
/begin MEASUREMENT V_TECU "ECU temperature sensor raw acquisition" UWORD _CNV_A_R_LINEAR_____33_CM 1 100. 0. 4.99511719 ECU_ADDRESS 0x3fcce4 FORMAT "%5.3" /end MEASUREMENT
/begin MEASUREMENT V_FPS "Fuel pressure sensor raw acquisition" UWORD _CNV_A_R_LINEAR_____33_CM 1 100. 0. 4.99511719 ECU_ADDRESS 0x3fccdc FORMAT "%5.3" /end MEASUREMENT
/begin MEASUREMENT V_SAF "" UBYTE _CNV_A_R_LINEAR_____38_CM 1 100. 0. 4.998 ECU_ADDRESS 0x3fbf69 FORMAT "%6.4" /end MEASUREMENT
/begin MEASUREMENT MAF_CTR_1 "accumulated mass air flow measurements for segment number (2n-1), n = 1,2,3,..." UWORD _CNV_A_R_LINEAR_____10_CM 1 100. 0. 65535. ECU_ADDRESS 0x3fbf5e FORMAT "%5.0" /end MEASUREMENT
/begin MEASUREMENT MAF_SUM_1 "accumulated mass air flow measurements for segment number (2n-1), n = 1,2,3,..." ULONG _CNV_A_R_LINEAR_____39_CM 1 100. 0. 67108863.98 ECU_ADDRESS 0x3fbf50 FORMAT "%11.2" /end MEASUREMENT
/begin MEASUREMENT MAF_SUM "accumulated mass air flow measurements for segment number (2n), n = 1,2,3,..." ULONG _CNV_A_R_LINEAR_____39_CM 1 100. 0. 67108863.98 ECU_ADDRESS 0x3fbf4c FORMAT "%11.2" /end MEASUREMENT
/begin MEASUREMENT V_MAF "Mass air flow sensor raw acquisition" UBYTE _CNV_A_R_LINEAR_____38_CM 1 100. 0. 4.998 ECU_ADDRESS 0x3fbf68 FORMAT "%6.4" /end MEASUREMENT
/begin MEASUREMENT VB_BAS "Battery voltage after relay raw acquisition" UWORD _CNV_A_R_LINEAR_____33_CM 1 100. 0. 4.99511719 ECU_ADDRESS 0x3fbf62 FORMAT "%5.3" /end MEASUREMENT
/begin MEASUREMENT MAF_CTR "accumulated mass air flow measurements for segment number (2n), n = 1,2,3,..." UWORD _CNV_A_R_LINEAR_____10_CM 1 100. 0. 65535. ECU_ADDRESS 0x3fbf5c FORMAT "%5.0" /end MEASUREMENT
/begin MEASUREMENT LV_MAF_SEG "indicates if segment number is even or odd in order to choose MAF_SUM / MAF_CTR or MAF_SUM_1 / MAF_CTR_1" UBYTE _CNV_S_2_RANGE______28_CM 1 100. 0. 1. ECU_ADDRESS 0x3fbf6c BIT_MASK 0x1 /end MEASUREMENT
/begin CHARACTERISTIC C_CAM_SYNC_DLY "" VALUE 0x4280a _REC_VAL_20_u1 2. _CNV_A_R_LINEAR_____10_CM 0. 2. FORMAT "%2.0" /end CHARACTERISTIC
/begin CHARACTERISTIC C_N_MIN_CRK_TOOTH_VLD "" VALUE 0x42eb8 _REC_VAL_20_u2 8160. _CNV_A_R_LINEAR_____17_CM 0. 8160. FORMAT "%4.0" /end CHARACTERISTIC
/begin CHARACTERISTIC ID_CRK_GAP_RATIO "" CURVE 0x4cc31 _REC_CUR_20_u1_u2 0.9375 _CNV_A_R_LINEAR_____40_CM 0. 0.9375 FORMAT "%6.4"
 /begin AXIS_DESCR COM_AXIS N _CNV_A_R_LINEAR_____17_CM 6 0. 8160. FORMAT "%4.0" AXIS_PTS_REF ldpm_n_id_crk_acq /end AXIS_DESCR
/end CHARACTERISTIC
/begin CHARACTERISTIC ID_CAM_TOOTH_PER_SP_FAC__N "" CURVE 0x4cbc0 _REC_CUR_20_u1_u2 1.99220002 _CNV_A_R_LINEAR_____34_CM 0. 1.99220002 FORMAT "%5.3"
 /begin AXIS_DESCR COM_AXIS N _CNV_A_R_LINEAR_____17_CM 12 0. 8160. FORMAT "%4.0" AXIS_PTS_REF ldpm_n_id_cam_acq /end AXIS_DESCR
/end CHARACTERISTIC
/begin CHARACTERISTIC ID_CRK_TOOTH_PER_SP_FAC "" CURVE 0x4cc37 _REC_CUR_20_u1_u2 0.9375 _CNV_A_R_LINEAR_____40_CM 0. 0.9375 FORMAT "%6.4"
 /begin AXIS_DESCR COM_AXIS N _CNV_A_R_LINEAR_____17_CM 6 0. 8160. FORMAT "%4.0" AXIS_PTS_REF ldpm_n_id_crk_acq /end AXIS_DESCR
/end CHARACTERISTIC
/begin CHARACTERISTIC ID_SAF_TAB "conversion table for SAF value" MAP 0x45c2c _REC_MAP_20_u2_u1_u1 1023.984375 _CNV_A_R_LINEAR_____41_CM 0. 1023.984375 FORMAT "%7.2"
 /begin AXIS_DESCR COM_AXIS ONLINE_DUMMY _CNV_A_R_LINEAR_____10_CM 16 0. 255. FORMAT "%3.0" AXIS_PTS_REF ldp_id_saf_tab_1 /end AXIS_DESCR
 /begin AXIS_DESCR COM_AXIS ONLINE_DUMMY _CNV_A_R_LINEAR_____10_CM 16 0. 255. FORMAT "%3.0" AXIS_PTS_REF ldp_id_saf_tab_2 /end AXIS_DESCR
/end CHARACTERISTIC
/begin CHARACTERISTIC ID_CAM_TOOTH_RATIO__N "" CURVE 0x4cbcc _REC_CUR_20_u1_u2 7.96875 _CNV_A_R_LINEAR_____42_CM 0. 7.96875 FORMAT "%5.3"
 /begin AXIS_DESCR COM_AXIS N _CNV_A_R_LINEAR_____17_CM 12 0. 8160. FORMAT "%4.0" AXIS_PTS_REF ldpm_n_id_cam_acq /end AXIS_DESCR
/end CHARACTERISTIC
/begin CHARACTERISTIC ID_CRK_TOOTH_RATIO "" CURVE 0x4cc3d _REC_CUR_20_u1_u2 0.9375 _CNV_A_R_LINEAR_____40_CM 0. 0.9375 FORMAT "%6.4"
 /begin AXIS_DESCR COM_AXIS N _CNV_A_R_LINEAR_____17_CM 6 0. 8160. FORMAT "%4.0" AXIS_PTS_REF ldpm_n_id_crk_acq /end AXIS_DESCR
/end CHARACTERISTIC
/begin MEASUREMENT V_IGK_BAS "Battery voltage after key raw acquisition" UWORD _CNV_A_R_LINEAR_____33_CM 1 100. 0. 4.99511719 ECU_ADDRESS 0x3fbf60 FORMAT "%5.3" /end MEASUREMENT
/begin MEASUREMENT VCC_MAF "Voltage supply for pedal value sensor 1 (and TPS) raw acquisitin" UWORD _CNV_A_R_LINEAR_____37_CM 1 100. 0. 9.9902 ECU_ADDRESS 0x3fccca FORMAT "%5.3" /end MEASUREMENT
/begin MEASUREMENT V_TOIL "Oil temperature sensor raw acquisition" UBYTE _CNV_A_R_LINEAR_____38_CM 1 100. 0. 4.998 ECU_ADDRESS 0x3fccef FORMAT "%6.4" /end MEASUREMENT
/begin MEASUREMENT V_PVS_2_MC "Pedal value sensor 2 raw acquisition for Monitoring Level 2 MC" UBYTE _CNV_A_R_LINEAR_____38_CM 1 100. 0. 4.998 ECU_ADDRESS 0x3fccf0 FORMAT "%6.4" /end MEASUREMENT
/begin MEASUREMENT V_PVS_2_MU "Pedal value sensor 2 raw acquisition for Monitoring Level 2 MU" UBYTE _CNV_A_R_LINEAR_____38_CM 1 100. 0. 4.998 ECU_ADDRESS 0x3fccf1 FORMAT "%6.4" /end MEASUREMENT
/begin CHARACTERISTIC C_AMP_REF "reference value of the ambient pressure" VALUE 0x42c36 _REC_VAL_20_u2 5434. _CNV_A_R_LINEAR_____43_CM 0. 5434. FORMAT "%7.2" /end CHARACTERISTIC
/begin CHARACTERISTIC C_V_AMP_MAX_DIAG "maximum diagnostic value for the ambient pressure value" VALUE 0x4311c _REC_VAL_20_u2 4.99511719 _CNV_A_R_LINEAR_____33_CM 0. 4.99511719 FORMAT "%5.3" /end CHARACTERISTIC
/begin CHARACTERISTIC C_V_AMP_MIN_DIAG "minimum diagnostic value for the ambient pressure value" VALUE 0x4311e _REC_VAL_20_u2 4.99511719 _CNV_A_R_LINEAR_____33_CM 0. 4.99511719 FORMAT "%5.3" /end CHARACTERISTIC
/begin MEASUREMENT CAM_EDGE_NR_1 "identifier of  actual edge CAM_1" UBYTE _CNV_A_R_LINEAR_____10_CM 1 100. 0. 255. ECU_ADDRESS 0x3fcfc5 FORMAT "%3.0" /end MEASUREMENT
/begin MEASUREMENT CAM_EDGE_NR_0 "identifier of  actual edge CAM_0" UBYTE _CNV_A_R_LINEAR_____10_CM 1 100. 0. 255. ECU_ADDRESS 0x3fcfc4 FORMAT "%3.0" /end MEASUREMENT
/begin MEASUREMENT LV_EFP_ON_EXT_ADJ_CAN "switch ON of EFP via CAN (tester diagnosis9" UBYTE _CNV_S_2_RANGE______28_CM 1 100. 0. 1. ECU_ADDRESS 0x3fc4a1 /end MEASUREMENT
/begin MEASUREMENT LV_EFP_OFF_EXT_ADJ_CAN "switch OFF of EFP via CAN (tester diagnosis9" UBYTE _CNV_S_2_RANGE______28_CM 1 100. 0. 1. ECU_ADDRESS 0x3fc4a2 /end MEASUREMENT
/begin MEASUREMENT STATE_DIAG_EFP "diagnosis status of the electical fuel pump" UBYTE _CNV_A_R_LINEAR_____10_CM 1 100. 0. 255. ECU_ADDRESS 0x3fc49b FORMAT "%3.0" /end MEASUREMENT
/begin MEASUREMENT STATE_EFP_CAN "EFP - state for EOL and ASA diagnosis" UBYTE _CNV_A_R_LINEAR_____10_CM 1 100. 0. 3. ECU_ADDRESS 0x3fc49c FORMAT "%1.0" /end MEASUREMENT
/begin MEASUREMENT V_ENG_EFP "Engine voltage of the EFP" UBYTE _CNV_A_R_LINEAR_____81_CM 1 100. 5. 30.5 ECU_ADDRESS 0x3fc49d FORMAT "%4.1" /end MEASUREMENT
/begin MEASUREMENT CUR_ENG_EFP "Engine current of the EFP" UBYTE _CNV_A_R_LINEAR_____82_CM 1 100. 0. 25.5 ECU_ADDRESS 0x3fc49e FORMAT "%4.1" /end MEASUREMENT
/begin MEASUREMENT VB_EFP "VB measured by EFP" UBYTE _CNV_A_R_LINEAR_____81_CM 1 100. 5. 30.5 ECU_ADDRESS 0x3fc4a0 FORMAT "%4.1" /end MEASUREMENT
/begin MEASUREMENT N_EFP_AV "Engine speed of the EFP" UBYTE _CNV_A_R_LINEAR_____83_CM 1 100. 0. 12750. ECU_ADDRESS 0x3fc49f FORMAT "%6.0" /end MEASUREMENT
/begin MEASUREMENT REL_FLOW_CPS_AV "Actual value of the relative flow (FLOW_CPS/MAF_CYL) through the CPS" UWORD _CNV_A_R_LINEAR_____31_CM 1 100. 0. 0.99998474 ECU_ADDRESS 0x3fc514 FORMAT "%7.5" /end MEASUREMENT
/begin MEASUREMENT MFF_ADD_CP "Additive adaptie correction of the mass fuel flow injection with active canister purge" UWORD _CNV_A_R_LINEAR_____95_CM 1 100. 0. 1389. ECU_ADDRESS 0x3fc50c FORMAT "%7.2" /end MEASUREMENT
/begin MEASUREMENT FLOW_SP_CPS "Flow setpoint through the CPS" UWORD _CNV_A_R_LINEAR_____99_CM 1 100. 0. 7.99987793 ECU_ADDRESS 0x3fd9c8 FORMAT "%7.4" /end MEASUREMENT
/begin MEASUREMENT FLOW_COR_CPS "Corrected flow setpoint through the CPS" UWORD _CNV_A_R_LINEAR_____99_CM 1 100. 0. 7.99987793 ECU_ADDRESS 0x3fd9ca FORMAT "%7.4" /end MEASUREMENT
/begin MEASUREMENT FLOW_REQ_CPS "Reuest flow setpoint through the CPS" UWORD _CNV_A_R_LINEAR_____99_CM 1 100. 0. 7.99987793 ECU_ADDRESS 0x3fd998 FORMAT "%7.4" /end MEASUREMENT
/begin MEASUREMENT FLOW_CPS "Flow through the CPS" UWORD _CNV_A_R_LINEAR_____99_CM 1 100. 0. 7.99987793 ECU_ADDRESS 0x3fc510 FORMAT "%7.4" /end MEASUREMENT
/begin MEASUREMENT CPPWM_SP "Setpoint PWM signal for CPS opening" UBYTE _CNV_A_R_LINEAR_____4_CM 1 100. 0. 99.609375 ECU_ADDRESS 0x3fd9df FORMAT "%3.1" /end MEASUREMENT
/begin MEASUREMENT FUEL_CPS "Fuel flow from the CPS to the Cylinder" UWORD _CNV_A_R_LINEAR_____99_CM 1 100. 0. 7.99987793 ECU_ADDRESS 0x3fc50e FORMAT "%7.4" /end MEASUREMENT
/begin MEASUREMENT FUEL_FLOW_ADD_BUF_0_ "Array of FUEL_FLOW_ADD_AD_CP values(20 values) " UWORD _CNV_A_R_LINEAR_____99_CM 1 100. 0. 7.99987793 ECU_ADDRESS 0x3fd99a FORMAT "%7.4" /end MEASUREMENT
/begin MEASUREMENT FUEL_FLOW_ADD_BUF_1_ "Array of FUEL_FLOW_ADD_AD_CP values(20 values) " UWORD _CNV_A_R_LINEAR_____99_CM 1 100. 0. 7.99987793 ECU_ADDRESS 0x3fd99c FORMAT "%7.4" /end MEASUREMENT
/begin MEASUREMENT FUEL_FLOW_ADD_BUF_2_ "Array of FUEL_FLOW_ADD_AD_CP values(20 values) " UWORD _CNV_A_R_LINEAR_____99_CM 1 100. 0. 7.99987793 ECU_ADDRESS 0x3fd99e FORMAT "%7.4" /end MEASUREMENT
/begin MEASUREMENT FUEL_FLOW_ADD_BUF_3_ "Array of FUEL_FLOW_ADD_AD_CP values(20 values) " UWORD _CNV_A_R_LINEAR_____99_CM 1 100. 0. 7.99987793 ECU_ADDRESS 0x3fd9a0 FORMAT "%7.4" /end MEASUREMENT
/begin MEASUREMENT FUEL_FLOW_ADD_BUF_4_ "Array of FUEL_FLOW_ADD_AD_CP values(20 values) " UWORD _CNV_A_R_LINEAR_____99_CM 1 100. 0. 7.99987793 ECU_ADDRESS 0x3fd9a2 FORMAT "%7.4" /end MEASUREMENT
/begin MEASUREMENT FUEL_FLOW_ADD_BUF_5_ "Array of FUEL_FLOW_ADD_AD_CP values(20 values) " UWORD _CNV_A_R_LINEAR_____99_CM 1 100. 0. 7.99987793 ECU_ADDRESS 0x3fd9a4 FORMAT "%7.4" /end MEASUREMENT
/begin MEASUREMENT FUEL_FLOW_ADD_BUF_6_ "Array of FUEL_FLOW_ADD_AD_CP values(20 values) " UWORD _CNV_A_R_LINEAR_____99_CM 1 100. 0. 7.99987793 ECU_ADDRESS 0x3fd9a6 FORMAT "%7.4" /end MEASUREMENT
/begin MEASUREMENT FUEL_FLOW_ADD_BUF_7_ "Array of FUEL_FLOW_ADD_AD_CP values(20 values) " UWORD _CNV_A_R_LINEAR_____99_CM 1 100. 0. 7.99987793 ECU_ADDRESS 0x3fd9a8 FORMAT "%7.4" /end MEASUREMENT
/begin MEASUREMENT FUEL_FLOW_ADD_BUF_8_ "Array of FUEL_FLOW_ADD_AD_CP values(20 values) " UWORD _CNV_A_R_LINEAR_____99_CM 1 100. 0. 7.99987793 ECU_ADDRESS 0x3fd9aa FORMAT "%7.4" /end MEASUREMENT
/begin MEASUREMENT FUEL_FLOW_ADD_BUF_9_ "Array of FUEL_FLOW_ADD_AD_CP values(20 values) " UWORD _CNV_A_R_LINEAR_____99_CM 1 100. 0. 7.99987793 ECU_ADDRESS 0x3fd9ac FORMAT "%7.4" /end MEASUREMENT
/begin MEASUREMENT FUEL_FLOW_ADD_BUF_10_ "Array of FUEL_FLOW_ADD_AD_CP values(20 values) " UWORD _CNV_A_R_LINEAR_____99_CM 1 100. 0. 7.99987793 ECU_ADDRESS 0x3fd9ae FORMAT "%7.4" /end MEASUREMENT
/begin MEASUREMENT FUEL_FLOW_ADD_BUF_11_ "Array of FUEL_FLOW_ADD_AD_CP values(20 values) " UWORD _CNV_A_R_LINEAR_____99_CM 1 100. 0. 7.99987793 ECU_ADDRESS 0x3fd9b0 FORMAT "%7.4" /end MEASUREMENT
/begin MEASUREMENT FUEL_FLOW_ADD_BUF_12_ "Array of FUEL_FLOW_ADD_AD_CP values(20 values) " UWORD _CNV_A_R_LINEAR_____99_CM 1 100. 0. 7.99987793 ECU_ADDRESS 0x3fd9b2 FORMAT "%7.4" /end MEASUREMENT
/begin MEASUREMENT FUEL_FLOW_ADD_BUF_13_ "Array of FUEL_FLOW_ADD_AD_CP values(20 values) " UWORD _CNV_A_R_LINEAR_____99_CM 1 100. 0. 7.99987793 ECU_ADDRESS 0x3fd9b4 FORMAT "%7.4" /end MEASUREMENT
/begin MEASUREMENT FUEL_FLOW_ADD_BUF_14_ "Array of FUEL_FLOW_ADD_AD_CP values(20 values) " UWORD _CNV_A_R_LINEAR_____99_CM 1 100. 0. 7.99987793 ECU_ADDRESS 0x3fd9b6 FORMAT "%7.4" /end MEASUREMENT
/begin MEASUREMENT FUEL_FLOW_ADD_BUF_15_ "Array of FUEL_FLOW_ADD_AD_CP values(20 values) " UWORD _CNV_A_R_LINEAR_____99_CM 1 100. 0. 7.99987793 ECU_ADDRESS 0x3fd9b8 FORMAT "%7.4" /end MEASUREMENT
/begin MEASUREMENT FUEL_FLOW_ADD_BUF_16_ "Array of FUEL_FLOW_ADD_AD_CP values(20 values) " UWORD _CNV_A_R_LINEAR_____99_CM 1 100. 0. 7.99987793 ECU_ADDRESS 0x3fd9ba FORMAT "%7.4" /end MEASUREMENT
/begin MEASUREMENT FUEL_FLOW_ADD_BUF_17_ "Array of FUEL_FLOW_ADD_AD_CP values(20 values) " UWORD _CNV_A_R_LINEAR_____99_CM 1 100. 0. 7.99987793 ECU_ADDRESS 0x3fd9bc FORMAT "%7.4" /end MEASUREMENT
/begin MEASUREMENT FUEL_FLOW_ADD_BUF_18_ "Array of FUEL_FLOW_ADD_AD_CP values(20 values) " UWORD _CNV_A_R_LINEAR_____99_CM 1 100. 0. 7.99987793 ECU_ADDRESS 0x3fd9be FORMAT "%7.4" /end MEASUREMENT
/begin MEASUREMENT FUEL_FLOW_ADD_BUF_19_ "Array of FUEL_FLOW_ADD_AD_CP values(20 values) " UWORD _CNV_A_R_LINEAR_____99_CM 1 100. 0. 7.99987793 ECU_ADDRESS 0x3fd9c0 FORMAT "%7.4" /end MEASUREMENT
/begin MEASUREMENT FLOW_TOT_CPS "Total of FLOW_CPS during emission cycle" ULONG _CNV_A_R_LINEAR_____100_CM 1 100. 0. 1456. ECU_ADDRESS 0x3fd994 FORMAT "%12.7" /end MEASUREMENT
/begin MEASUREMENT FUEL_TOT_CPS "Total of FUEL_CPS during emission cycle" ULONG _CNV_A_R_LINEAR_____100_CM 1 100. 0. 1456. ECU_ADDRESS 0x3fd990 FORMAT "%12.7" /end MEASUREMENT
/begin MEASUREMENT MAF_CPS "Air flow from the CPS to the Cylinder" UWORD _CNV_A_R_LINEAR_____99_CM 1 100. 0. 7.99987793 ECU_ADDRESS 0x3fc512 FORMAT "%7.4" /end MEASUREMENT
/begin MEASUREMENT FAC_TIA_AMP_CP "Flow correction versus air temperature and ambient pressure" UBYTE _CNV_A_R_LINEAR_____34_CM 1 100. 0. 1.99220002 ECU_ADDRESS 0x3fd9de FORMAT "%5.3" /end MEASUREMENT
/begin MEASUREMENT MAF_TOT_CP_DLY_OLD "Old vale of MAF_TOT_CP_DLY for  Padé filter calculation for MAF_TOT_CP_DLY" UWORD _CNV_A_R_LINEAR_____101_CM 1 100. 0. 2047.96875 ECU_ADDRESS 0x3fd9d2 FORMAT "%7.2" /end MEASUREMENT
/begin MEASUREMENT MAF_TOT_CP_OLD2 "Old vale of MAF_TOT_CP for  Padé filter calculation for MAF_TOT_CP_DLY" UWORD _CNV_A_R_LINEAR_____101_CM 1 100. 0. 2047.96875 ECU_ADDRESS 0x3fd9d6 FORMAT "%7.2" /end MEASUREMENT
/begin MEASUREMENT FLOW_CPS_DLY "Filtered value of FLOW_CPS (Padé Filter)" UWORD _CNV_A_R_LINEAR_____99_CM 1 100. 0. 7.99987793 ECU_ADDRESS 0x3fc51a FORMAT "%7.4" /end MEASUREMENT
/begin MEASUREMENT FLOW_CPS_DLY_OLD "Old value of FLOW_CPS_DLY for Padé Filter calculation for FLOW_CPS_DLY" UWORD _CNV_A_R_LINEAR_____99_CM 1 100. 0. 7.99987793 ECU_ADDRESS 0x3fd9d8 FORMAT "%7.4" /end MEASUREMENT
/begin MEASUREMENT FLOW_CPS_OLD "Old value of FLOW_CPS for Padé Filter calculation for FLOW_CPS_DLY" UWORD _CNV_A_R_LINEAR_____99_CM 1 100. 0. 7.99987793 ECU_ADDRESS 0x3fd9da FORMAT "%7.4" /end MEASUREMENT
/begin MEASUREMENT FLOW_CPS_OLD2 "Old value of FLOW_CPS for Padé Filter calculation for FLOW_CPS_DLY" UWORD _CNV_A_R_LINEAR_____99_CM 1 100. 0. 7.99987793 ECU_ADDRESS 0x3fd9dc FORMAT "%7.4" /end MEASUREMENT
/begin MEASUREMENT FLOW_CPS_DLY_MMV "Moving mean value of FLOW_CPS_DLY" UWORD _CNV_A_R_LINEAR_____99_CM 1 100. 0. 7.99987793 ECU_ADDRESS 0x3fc518 FORMAT "%7.4" /end MEASUREMENT
/begin MEASUREMENT MAF_TOT_CP "(MAF throttle)MAF_THR + (MAF through the canister prge valve) MAF_CPS" UWORD _CNV_A_R_LINEAR_____101_CM 1 100. 0. 2047.96875 ECU_ADDRESS 0x3fd9ce FORMAT "%7.2" /end MEASUREMENT
/begin MEASUREMENT MAF_TOT_CP_DLY "Filtered value of MAF_TOT_CP(Padé Filter)" UWORD _CNV_A_R_LINEAR_____99_CM 1 100. 0. 7.99987793 ECU_ADDRESS 0x3fd9d0 FORMAT "%7.4" /end MEASUREMENT
/begin MEASUREMENT MAF_TOT_CP_DLY_MMV "Moving mean value of  MAF_TOT_CP_DLY" UWORD _CNV_A_R_LINEAR_____101_CM 1 100. 0. 2047.96875 ECU_ADDRESS 0x3fc516 FORMAT "%7.2" /end MEASUREMENT
/begin MEASUREMENT MAF_TOT_CP_OLD "Old vale of MAF_TOT_CP for  Padé filter calculation for MAF_TOT_CP_DLY" UWORD _CNV_A_R_LINEAR_____101_CM 1 100. 0. 2047.96875 ECU_ADDRESS 0x3fd9d4 FORMAT "%7.2" /end MEASUREMENT
/begin CHARACTERISTIC C_FLOW_CPS_AS "" VALUE 0x42d5c _REC_VAL_20_u2 7.99987793 _CNV_A_R_LINEAR_____99_CM 0. 7.99987793 FORMAT "%7.4" /end CHARACTERISTIC
/begin CHARACTERISTIC C_MAF_TOT_CP_DLY_CRLC "" VALUE 0x42e7e _REC_VAL_20_u2 0.99998474 _CNV_A_R_LINEAR_____31_CM 0. 0.99998474 FORMAT "%7.5" /end CHARACTERISTIC
/begin CHARACTERISTIC C_FLOW_CPS_DLY_CRLC "" VALUE 0x42d5e _REC_VAL_20_u2 0.99998474 _CNV_A_R_LINEAR_____31_CM 0. 0.99998474 FORMAT "%7.5" /end CHARACTERISTIC
/begin CHARACTERISTIC LC_FLOW_CPS_AS "" VALUE 0x42b81 _REC_VAL_20_u1 1. _CNV_A_R_LINEAR_____10_CM 0. 1. FORMAT "%2.0" /end CHARACTERISTIC
/begin CHARACTERISTIC IP_CPPWM__FLOW_COR_CPS__PRS_CPS "CPS duty cycle" MAP 0x4d973 _REC_MAP_20_u1_u2_u2 99.609375 _CNV_A_R_LINEAR_____4_CM 0. 99.609375 FORMAT "%5.2"
 /begin AXIS_DESCR COM_AXIS FLOW_COR_CPS _CNV_A_R_LINEAR_____99_CM 12 0. 7.99987793 FORMAT "%7.4" AXIS_PTS_REF ldp_flow_cor_cps_ip_cppwm /end AXIS_DESCR
 /begin AXIS_DESCR COM_AXIS PRS_CPS _CNV_A_R_LINEAR_____102_CM 12 -2717. 2717. FORMAT "%7.2" AXIS_PTS_REF ldpm_prs_cps_ip_cppwm /end AXIS_DESCR
/end CHARACTERISTIC
/begin CHARACTERISTIC IP_FAC_AMP_CP__AMP "Correction factor for ambient pressure" CURVE 0x4dd6b _REC_CUR_20_u1_u2 1.9921875 _CNV_A_R_LINEAR_____103_CM 0. 1.9921875 FORMAT "%5.3"
 /begin AXIS_DESCR COM_AXIS AMP _CNV_A_R_LINEAR_____43_CM 6 0. 5434. FORMAT "%7.2" AXIS_PTS_REF ldp_amp_ip_fac_amp_cp /end AXIS_DESCR
/end CHARACTERISTIC
/begin CHARACTERISTIC IP_FAC_TIA_CP__TIA_THR "Correction factor for intake air temperature" CURVE 0x4e721 _REC_CUR_20_u1_u1 1.9921875 _CNV_A_R_LINEAR_____103_CM 0. 1.9921875 FORMAT "%5.3"
 /begin AXIS_DESCR COM_AXIS TIA _CNV_A_R_LINEAR_____0_CM 6 -48. 142.5 FORMAT "%5.1" AXIS_PTS_REF ldp_tia_thr_ip_fac_tia_cp /end AXIS_DESCR
/end CHARACTERISTIC
/begin CHARACTERISTIC IP_FLOW_CPS__PRS_CPS "FLOW_CPS for fully opened CPS" CURVE 0x48006 _REC_CUR_20_u2_u2 7.99987793 _CNV_A_R_LINEAR_____99_CM 0. 7.99987793 FORMAT "%7.4"
 /begin AXIS_DESCR COM_AXIS PRS_CPS _CNV_A_R_LINEAR_____102_CM 12 -2717. 2717. FORMAT "%7.2" AXIS_PTS_REF ldpm_prs_cps_ip_cppwm /end AXIS_DESCR
/end CHARACTERISTIC
/begin CHARACTERISTIC IP_FUEL_DLY_CPS__N_32 "" CURVE 0x4e7dd _REC_CUR_20_u1_u1 19. _CNV_A_R_LINEAR_____10_CM 0. 19. FORMAT "%2.0"
 /begin AXIS_DESCR COM_AXIS N_32 _CNV_A_R_LINEAR_____5_CM 6 0. 8160. FORMAT "%4.0" AXIS_PTS_REF ldpm_n_32_ip_fuel_dly_cps /end AXIS_DESCR
/end CHARACTERISTIC
/begin CHARACTERISTIC IP_FUEL_FAC_CPS__N_32 "Ratio of FUEL_CPS calculation" CURVE 0x4e7e3 _REC_CUR_20_u1_u1 0.9960940000000002 _CNV_A_R_LINEAR_____44_CM 0. 0.996094 FORMAT "%5.3"
 /begin AXIS_DESCR COM_AXIS N_32 _CNV_A_R_LINEAR_____5_CM 6 0. 8160. FORMAT "%4.0" AXIS_PTS_REF ldpm_n_32_ip_fuel_dly_cps /end AXIS_DESCR
/end CHARACTERISTIC
/begin CHARACTERISTIC IP_FLOW_CPS_DEC__MAF_CYL "Decrement value on FLOW_SP_CPS" CURVE 0x4801e _REC_CUR_20_u2_u2 7.99987793 _CNV_A_R_LINEAR_____99_CM 0. 7.99987793 FORMAT "%7.4"
 /begin AXIS_DESCR COM_AXIS MAF_CYL _CNV_A_R_LINEAR_____101_CM 6 0. 2047.96875 FORMAT "%6.2" AXIS_PTS_REF ldpm_maf_cyl_ip_rel_flow_inc_cp /end AXIS_DESCR
/end CHARACTERISTIC
/begin CHARACTERISTIC IP_FLOW_CPS_INC__MAF_CYL "Increment value on FLOW_SP_CPS" CURVE 0x4802a _REC_CUR_20_u2_u2 7.99987793 _CNV_A_R_LINEAR_____99_CM 0. 7.99987793 FORMAT "%7.4"
 /begin AXIS_DESCR COM_AXIS MAF_CYL _CNV_A_R_LINEAR_____101_CM 6 0. 2047.96875 FORMAT "%6.2" AXIS_PTS_REF ldpm_maf_cyl_ip_rel_flow_inc_cp /end AXIS_DESCR
/end CHARACTERISTIC
/begin CHARACTERISTIC IP_T_DLY_CP__MAF_CYL "Stabilization delay on CL_MMV vale during RAMP_OPEN" CURVE 0x4a678 _REC_CUR_20_u2_u2 63.99902344 _CNV_A_R_LINEAR_____104_CM 0. 63.99902344 FORMAT "%7.4"
 /begin AXIS_DESCR COM_AXIS MAF_CYL _CNV_A_R_LINEAR_____101_CM 6 0. 2047.96875 FORMAT "%6.2" AXIS_PTS_REF ldpm_maf_cyl_ip_rel_flow_inc_cp /end AXIS_DESCR
/end CHARACTERISTIC
/begin AXIS_PTS ldp_flow_cor_cps_ip_cppwm "" 0x4439a FLOW_COR_CPS _REC_AXS_20_u2 7.99987793 _CNV_A_R_LINEAR_____99_CM 12 0. 7.99987793 FORMAT "%7.4" /end AXIS_PTS
/begin AXIS_PTS ldpm_prs_cps_ip_cppwm "" 0x453d4 PRS_CPS _REC_AXS_20_u2 5434. _CNV_A_R_LINEAR_____102_CM 12 -2717. 2717. FORMAT "%7.2" /end AXIS_PTS
/begin AXIS_PTS ldp_amp_ip_fac_amp_cp "" 0x44114 AMP _REC_AXS_20_u2 5434. _CNV_A_R_LINEAR_____43_CM 6 0. 5434. FORMAT "%7.2" /end AXIS_PTS
/begin AXIS_PTS ldp_tia_thr_ip_fac_tia_cp "" 0x43a04 TIA _REC_AXS_20_u1 190.5 _CNV_A_R_LINEAR_____0_CM 6 -48. 142.5 FORMAT "%5.1" /end AXIS_PTS
/begin MEASUREMENT LV_OBD_CDN_CLOSE_MOD "Logical value for NO_PURGE authorization by projectspecific conditions " UBYTE _CNV_S_2_RANGE______28_CM 1 100. 0. 1. ECU_ADDRESS 0x3fc538 BIT_MASK 0x1 /end MEASUREMENT
/begin MEASUREMENT LV_OBD_CDN_MIN_MOD "Logical value for MIN_PURGE authorization by projectspecific conditions " UBYTE _CNV_S_2_RANGE______28_CM 1 100. 0. 1. ECU_ADDRESS 0x3fc539 BIT_MASK 0x1 /end MEASUREMENT
/begin MEASUREMENT LV_ACT_EVAP "Logical value for calculation of the functional check CPS in the canister function" UBYTE _CNV_S_2_RANGE______28_CM 1 100. 0. 1. ECU_ADDRESS 0x3fc53a BIT_MASK 0x1 /end MEASUREMENT
/begin MEASUREMENT FLOW_SP_CPS_EVAP "Flow Set point through the CPS duting functional check CPS" UWORD _CNV_A_R_LINEAR_____99_CM 1 100. 0. 7.99987793 ECU_ADDRESS 0x3fc536 FORMAT "%7.4" /end MEASUREMENT
/begin MEASUREMENT CPPWM_CPS "Corrected PWM signal for CPS opening" UBYTE _CNV_A_R_LINEAR_____4_CM 1 100. 0. 99.609375 ECU_ADDRESS 0x3fc53b FORMAT "%4.1" /end MEASUREMENT
/begin MEASUREMENT CPPWM_REF "Reference PWM signal for CPS opening" UBYTE _CNV_A_R_LINEAR_____4_CM 1 100. 0. 99.609375 ECU_ADDRESS 0x3fda21 FORMAT "%4.1" /end MEASUREMENT
/begin MEASUREMENT LV_FRQ_1_CPS "Logical value for CPS PWM frequency" UBYTE _CNV_S_2_RANGE______11_CM 1 100. 0. 1. ECU_ADDRESS 0x3fda24 BIT_MASK 0x1 /end MEASUREMENT
/begin MEASUREMENT FRQ_REQ_CP "CPS Output frequency" UBYTE _CNV_A_R_LINEAR_____115_CM 1 100. 0. 255. ECU_ADDRESS 0x3fda20 FORMAT "%3.0" /end MEASUREMENT
/begin MEASUREMENT LV_CLOSE_ACT_CP "Logical value for CPS valve closed" UBYTE _CNV_S_2_RANGE______28_CM 1 100. 0. 1. ECU_ADDRESS 0x3fc53c BIT_MASK 0x1 /end MEASUREMENT
/begin MEASUREMENT CPPWM "PWM signal for CPS opening" UBYTE _CNV_A_R_LINEAR_____4_CM 1 100. 0. 99.609375 ECU_ADDRESS 0x3fda1f FORMAT "%4.1" /end MEASUREMENT
/begin CHARACTERISTIC C_N_FRQ_1_CPS "Threshold on engine speed to shift CPS frequency output" VALUE 0x42940 _REC_VAL_20_u1 8160. _CNV_A_R_LINEAR_____5_CM 0. 8160. FORMAT "%4.0" /end CHARACTERISTIC
/begin CHARACTERISTIC C_N_FRQ_2_CPS "Second threshold on engine speed to shift CPS frequency output" VALUE 0x42941 _REC_VAL_20_u1 8160. _CNV_A_R_LINEAR_____5_CM 0. 8160. FORMAT "%4.0" /end CHARACTERISTIC
/begin CHARACTERISTIC C_N_FRQ_HYS_CPS "Hysteresis threshold on engine speed to shift CPS frequency output" VALUE 0x42942 _REC_VAL_20_u1 8160. _CNV_A_R_LINEAR_____5_CM 0. 8160. FORMAT "%4.0" /end CHARACTERISTIC
/begin CHARACTERISTIC C_CPPWM_FRQ_1_CPS "Threshold on CPPWM to shift CPS output frequency" VALUE 0x42818 _REC_VAL_20_u1 99.609375 _CNV_A_R_LINEAR_____4_CM 0. 99.609375 FORMAT "%5.1" /end CHARACTERISTIC
/begin CHARACTERISTIC C_CPPWM_FRQ_2_CPS "Threshold on CPPWM to shift CPS output frequency" VALUE 0x4281a _REC_VAL_20_u1 99.609375 _CNV_A_R_LINEAR_____4_CM 0. 99.609375 FORMAT "%5.1" /end CHARACTERISTIC
/begin CHARACTERISTIC C_CPPWM_FRQ_HYS_CPS "Hysteresis threshold on engine speed to shift CPS frequency output" VALUE 0x4281b _REC_VAL_20_u1 99.609375 _CNV_A_R_LINEAR_____4_CM 0. 99.609375 FORMAT "%5.1" /end CHARACTERISTIC
/begin CHARACTERISTIC C_CPPWM_FRQ_1 "First CPS output frequency" VALUE 0x42817 _REC_VAL_20_u1 255. _CNV_A_R_LINEAR_____115_CM 0. 255. FORMAT "%3.0" /end CHARACTERISTIC
/begin CHARACTERISTIC C_CPPWM_FRQ_2 "Second CPS output frequency" VALUE 0x42819 _REC_VAL_20_u1 255. _CNV_A_R_LINEAR_____115_CM 0. 255. FORMAT "%3.0" /end CHARACTERISTIC
/begin CHARACTERISTIC C_CPPWM_MAX_CPS_DIAG_FRQ_1 "CPPWM_CPS maximum limit to assure the diagnosis with frequency 1" VALUE 0x4281c _REC_VAL_20_u1 99.609375 _CNV_A_R_LINEAR_____4_CM 0. 99.609375 FORMAT "%5.1" /end CHARACTERISTIC
/begin CHARACTERISTIC C_CPPWM_MAX_CPS_DIAG_FRQ_2 "CPPWM_CPS maximum limit to assure the diagnosis with frequency 2" VALUE 0x4281d _REC_VAL_20_u1 99.609375 _CNV_A_R_LINEAR_____4_CM 0. 99.609375 FORMAT "%5.1" /end CHARACTERISTIC
/begin CHARACTERISTIC C_CPPWM_MIN_CPS_DIAG_FRQ_1 "CPPWM_CPS minimum limit to assure the diagnosis with frequency 1" VALUE 0x4281e _REC_VAL_20_u1 99.609375 _CNV_A_R_LINEAR_____4_CM 0. 99.609375 FORMAT "%5.1" /end CHARACTERISTIC
/begin CHARACTERISTIC C_CPPWM_MIN_CPS_DIAG_FRQ_2 "CPPWM_CPS minimum limit to assure the diagnosis with frequency 2" VALUE 0x4281f _REC_VAL_20_u1 99.609375 _CNV_A_R_LINEAR_____4_CM 0. 99.609375 FORMAT "%5.1" /end CHARACTERISTIC
/begin CHARACTERISTIC C_CPPWM_AS "CPPWM_REF correction of application system" VALUE 0x43340 _REC_VAL_20_s1 199.21875 _CNV_A_R_LINEAR_____116_CM -100. 99.21875 FORMAT "%6.1" /end CHARACTERISTIC
/begin CHARACTERISTIC LC_CPPWM_LIM_DIAG "Selection of diagnosis limit values on  CPPWM_CPS" VALUE 0x42b6e _REC_VAL_20_u1 1. _CNV_S_2_RANGE______11_CM 0. 1. /end CHARACTERISTIC
/begin CHARACTERISTIC LC_CPPWM_AS "C_CPPWM_AS activation" VALUE 0x42b6d _REC_VAL_20_u1 1. _CNV_S_2_RANGE______11_CM 0. 1. /end CHARACTERISTIC
/begin CHARACTERISTIC IP_CPPWM_VB_ADD_1__VB "Additive VB correction for CPPWM" CURVE 0x4da0b _REC_CUR_20_u1_u1 99.609375 _CNV_A_R_LINEAR_____117_CM -50. 49.609375 FORMAT "%6.2"
 /begin AXIS_DESCR COM_AXIS VB _CNV_A_R_LINEAR_____26_CM 8 0. 25.8984 FORMAT "%3.1" AXIS_PTS_REF ldpm_vb_ip_cppwm_vb /end AXIS_DESCR
/end CHARACTERISTIC
/begin CHARACTERISTIC IP_CPPWM_VB_ADD_2__VB "Additive VB correction for CPPWM" CURVE 0x4da13 _REC_CUR_20_u1_u1 99.609375 _CNV_A_R_LINEAR_____117_CM -50. 49.609375 FORMAT "%6.2"
 /begin AXIS_DESCR COM_AXIS VB _CNV_A_R_LINEAR_____26_CM 8 0. 25.8984 FORMAT "%3.1" AXIS_PTS_REF ldpm_vb_ip_cppwm_vb /end AXIS_DESCR
/end CHARACTERISTIC
/begin CHARACTERISTIC IP_CPPWM_VB_FAC__VB "Multiplicate VB correction for CPPWM" CURVE 0x4da1b _REC_CUR_20_u1_u1 1.9921875 _CNV_A_R_LINEAR_____103_CM 0. 1.9921875 FORMAT "%5.3"
 /begin AXIS_DESCR COM_AXIS VB _CNV_A_R_LINEAR_____26_CM 8 0. 25.8984 FORMAT "%3.1" AXIS_PTS_REF ldpm_vb_ip_cppwm_vb /end AXIS_DESCR
/end CHARACTERISTIC
/begin CHARACTERISTIC IP_CPPWM_COR_FRQ__CPPWM_REF "PWM correction following frequency output" CURVE 0x4da03 _REC_CUR_20_u1_u1 1.9921875 _CNV_A_R_LINEAR_____103_CM 0. 1.9921875 FORMAT "%5.3"
 /begin AXIS_DESCR COM_AXIS CPPWM_REF _CNV_A_R_LINEAR_____4_CM 8 0. 99.609375 FORMAT "%5.1" AXIS_PTS_REF ldp_cppwm_ref_ip_cppwm_cor_frq /end AXIS_DESCR
/end CHARACTERISTIC
/begin AXIS_PTS ldpm_vb_ip_cppwm_vb "" 0x440a5 VB _REC_AXS_20_u1 25.8984 _CNV_A_R_LINEAR_____26_CM 8 0. 25.8984 FORMAT "%3.1" /end AXIS_PTS
/begin AXIS_PTS ldp_cppwm_ref_ip_cppwm_cor_frq "" 0x43383 CPPWM_REF _REC_AXS_20_u1 99.609375 _CNV_A_R_LINEAR_____4_CM 8 0. 99.609375 FORMAT "%5.1" /end AXIS_PTS
/begin MEASUREMENT STATE_T_SDL_CP "State of Time control function" UBYTE _CNV_S_7_RANGE_STAT_118_CM 1 100. 0. 6. ECU_ADDRESS 0x3fc533 /end MEASUREMENT
/begin MEASUREMENT T_CP "Time of actual CP time range " UWORD _CNV_A_R_LINEAR_____14_CM 1 100. 0. 6553.5 ECU_ADDRESS 0x3fda16 FORMAT "%6.1" /end MEASUREMENT
/begin MEASUREMENT T_MAX_CP "Maximum purge time " UWORD _CNV_A_R_LINEAR_____14_CM 1 100. 0. 6553.5 ECU_ADDRESS 0x3fda18 FORMAT "%6.1" /end MEASUREMENT
/begin MEASUREMENT LV_MFF_AD_ENA "Lambda adaptation enabled " UBYTE _CNV_S_2_RANGE______28_CM 1 100. 0. 1. ECU_ADDRESS 0x3fc534 BIT_MASK 0x1 /end MEASUREMENT
/begin MEASUREMENT LV_CP_ENA "Canister purge enabled " UBYTE _CNV_S_2_RANGE______28_CM 1 100. 0. 1. ECU_ADDRESS 0x3fc535 BIT_MASK 0x1 /end MEASUREMENT
/begin CHARACTERISTIC C_T_1_CP "" VALUE 0x42f4a _REC_VAL_20_u2 6553.5 _CNV_A_R_LINEAR_____14_CM 0. 6553.5 FORMAT "%6.1" /end CHARACTERISTIC
/begin CHARACTERISTIC C_T_2_CP "" VALUE 0x42f4e _REC_VAL_20_u2 6553.5 _CNV_A_R_LINEAR_____14_CM 0. 6553.5 FORMAT "%6.1" /end CHARACTERISTIC
/begin CHARACTERISTIC C_T_DI_CP "" VALUE 0x42f72 _REC_VAL_20_u2 6553.5 _CNV_A_R_LINEAR_____14_CM 0. 6553.5 FORMAT "%6.1" /end CHARACTERISTIC
/begin CHARACTERISTIC C_T_MFF_AD_MAX "" VALUE 0x43000 _REC_VAL_20_u2 6553.5 _CNV_A_R_LINEAR_____14_CM 0. 6553.5 FORMAT "%6.1" /end CHARACTERISTIC
/begin CHARACTERISTIC C_T_1_MFF_AD "" VALUE 0x42f4c _REC_VAL_20_u2 6553.5 _CNV_A_R_LINEAR_____14_CM 0. 6553.5 FORMAT "%6.1" /end CHARACTERISTIC
/begin CHARACTERISTIC C_CL_MMV_T_BOL "" VALUE 0x42c58 _REC_VAL_20_u2 1.99996948 _CNV_A_R_LINEAR_____45_CM 0. 1.99996948 FORMAT "%7.5" /end CHARACTERISTIC
/begin CHARACTERISTIC C_CL_MMV_T_TOL "" VALUE 0x42c5a _REC_VAL_20_u2 1.99996948 _CNV_A_R_LINEAR_____45_CM 0. 1.99996948 FORMAT "%7.5" /end CHARACTERISTIC
/begin CHARACTERISTIC IP_T_MAX_CP__CL_MMV "Duration of maximum purge versus Canister Load" CURVE 0x4b120 _REC_CUR_20_u2_u2 6553.5 _CNV_A_R_LINEAR_____14_CM 0. 6553.5 FORMAT "%6.1"
 /begin AXIS_DESCR COM_AXIS CL_MMV _CNV_A_R_LINEAR_____45_CM 6 0. 1.99996948 FORMAT "%6.4" AXIS_PTS_REF ldp_cl_mmv_ip_t_max_cp /end AXIS_DESCR
/end CHARACTERISTIC
/begin AXIS_PTS ldp_cl_mmv_ip_t_max_cp "" 0x4421e CL_MMV _REC_AXS_20_u2 1.99996948 _CNV_A_R_LINEAR_____45_CM 6 0. 1.99996948 FORMAT "%6.4" /end AXIS_PTS
/begin MEASUREMENT T_AD "Time of actual lambda adaption time range" UWORD _CNV_A_R_LINEAR_____14_CM 1 100. 0. 6553.5 ECU_ADDRESS 0x3fda1a FORMAT "%6.1" /end MEASUREMENT
/begin MEASUREMENT T_MAX_AD "maximum adaption time " UWORD _CNV_A_R_LINEAR_____14_CM 1 100. 0. 6553.5 ECU_ADDRESS 0x3fda1c FORMAT "%6.1" /end MEASUREMENT
/begin MEASUREMENT LV_EBOX_CFA "control bit EBOX cooling fan" UBYTE _CNV_S_2_RANGE______11_CM 1 100. 0. 1. ECU_ADDRESS 0x3fcf88 BIT_MASK 0x1 /end MEASUREMENT
/begin CHARACTERISTIC C_TECU_THD_EBOX_CFA "TECU threshold for EBOX cooling fan ON" VALUE 0x42a95 _REC_VAL_20_u1 190.5 _CNV_A_R_LINEAR_____0_CM -48. 142.5 FORMAT "%5.1" /end CHARACTERISTIC
/begin CHARACTERISTIC C_TECU_HYS_EBOX_CFA "TECU hysteresis for EBOX cooling fan" VALUE 0x42a93 _REC_VAL_20_u1 190.5 _CNV_A_R_LINEAR_____0_CM -48. 142.5 FORMAT "%5.1" /end CHARACTERISTIC
/begin CHARACTERISTIC C_TIA_THD_EBOX_CFA "TIA threshold for EBOX cooling fan ON" VALUE 0x42abd _REC_VAL_20_u1 190.5 _CNV_A_R_LINEAR_____0_CM -48. 142.5 FORMAT "%5.1" /end CHARACTERISTIC
/begin CHARACTERISTIC C_TIA_HYS_EBOX_CFA "TIA hysteresis for EBOX cooling fan" VALUE 0x42aae _REC_VAL_20_u1 190.5 _CNV_A_R_LINEAR_____0_CM -48. 142.5 FORMAT "%5.1" /end CHARACTERISTIC
/begin MEASUREMENT LV_CDN_ECRAS_ON "Condition bit for radiator air flaps to be closed" UBYTE _CNV_S_2_RANGE______28_CM 1 100. 0. 1. ECU_ADDRESS 0x3fcf8f BIT_MASK 0x1 /end MEASUREMENT
/begin MEASUREMENT LV_CDN_ECRAS_OFF "Condition bit for radiator air flaps to be opened" UBYTE _CNV_S_2_RANGE______28_CM 1 100. 0. 1. ECU_ADDRESS 0x3fcf90 BIT_MASK 0x1 /end MEASUREMENT
/begin MEASUREMENT LV_ECRAS_OFF "Auxillary bit : openeing of air flap enabled/disabled" UBYTE _CNV_S_2_RANGE______28_CM 1 100. 0. 1. ECU_ADDRESS 0x3fcf92 BIT_MASK 0x1 /end MEASUREMENT
/begin MEASUREMENT LV_ECRAS_ON "Auxillary bit : openeing of air flap enabled/disabled" UBYTE _CNV_S_2_RANGE______28_CM 1 100. 0. 1. ECU_ADDRESS 0x3fcf91 BIT_MASK 0x1 /end MEASUREMENT
/begin MEASUREMENT LV_ECRAS "Indication of ait flaps to be closed" UBYTE _CNV_S_2_RANGE______28_CM 1 100. 0. 1. ECU_ADDRESS 0x3fcf93 BIT_MASK 0x1 /end MEASUREMENT
/begin MEASUREMENT CTR_T_DLY_ECRAS_ON "Delay time for closing the air flaps" UBYTE _CNV_A_R_LINEAR_____47_CM 1 100. 0. 255. ECU_ADDRESS 0x3fcf8d FORMAT "%3.0" /end MEASUREMENT
/begin MEASUREMENT CTR_T_DLY_ECRAS_OFF "Delay time for opening the air flaps" UBYTE _CNV_A_R_LINEAR_____47_CM 1 100. 0. 255. ECU_ADDRESS 0x3fcf8e FORMAT "%3.0" /end MEASUREMENT
/begin CHARACTERISTIC C_T_DLY_MAX_ECRAS_ON "" VALUE 0x429ec _REC_VAL_20_u1 255. _CNV_A_R_LINEAR_____47_CM 0. 255. FORMAT "%3.0" /end CHARACTERISTIC
/begin CHARACTERISTIC C_T_DLY_MAX_ECRAS_OFF "" VALUE 0x429eb _REC_VAL_20_u1 255. _CNV_A_R_LINEAR_____47_CM 0. 255. FORMAT "%3.0" /end CHARACTERISTIC
/begin CHARACTERISTIC C_N_32_ECRAS_ON "" VALUE 0x42925 _REC_VAL_20_u1 8160. _CNV_A_R_LINEAR_____5_CM 0. 8160. FORMAT "%4.0" /end CHARACTERISTIC
/begin CHARACTERISTIC C_VS_FIL_ECRAS_ON "" VALUE 0x431ce _REC_VAL_20_u2 511.99218 _CNV_A_R_LINEAR_____78_CM 0. 511.99218 FORMAT "%7.3" /end CHARACTERISTIC
/begin CHARACTERISTIC C_TCO_EX_ECRAS_ON "" VALUE 0x42a50 _REC_VAL_20_u1 190.5 _CNV_A_R_LINEAR_____0_CM -48. 142.5 FORMAT "%5.1" /end CHARACTERISTIC
/begin CHARACTERISTIC C_TCO_EX_ECRAS_OFF "" VALUE 0x42a4f _REC_VAL_20_u1 190.5 _CNV_A_R_LINEAR_____0_CM -48. 142.5 FORMAT "%5.1" /end CHARACTERISTIC
/begin CHARACTERISTIC C_N_ECF_ECRAS_ON "" VALUE 0x42939 _REC_VAL_20_u1 15. _CNV_A_R_LINEAR_____10_CM 0. 15. FORMAT "%2.0" /end CHARACTERISTIC
/begin CHARACTERISTIC C_N_ECF_ECRAS_OFF "" VALUE 0x42938 _REC_VAL_20_u1 15. _CNV_A_R_LINEAR_____10_CM 0. 15. FORMAT "%2.0" /end CHARACTERISTIC
/begin CHARACTERISTIC C_TIA_ECRAS_ON "" VALUE 0x42aac _REC_VAL_20_u1 190.5 _CNV_A_R_LINEAR_____0_CM -48. 142.5 FORMAT "%5.1" /end CHARACTERISTIC
/begin CHARACTERISTIC C_TIA_ECRAS_OFF "" VALUE 0x42aab _REC_VAL_20_u1 190.5 _CNV_A_R_LINEAR_____0_CM -48. 142.5 FORMAT "%5.1" /end CHARACTERISTIC
/begin CHARACTERISTIC C_TEMP_GB_ECRAS_ON "" VALUE 0x42a98 _REC_VAL_20_u1 254. _CNV_A_R_LINEAR_____163_CM -40. 214. FORMAT "%3.0" /end CHARACTERISTIC
/begin CHARACTERISTIC C_TEMP_GB_ECRAS_OFF "" VALUE 0x42a97 _REC_VAL_20_u1 254. _CNV_A_R_LINEAR_____163_CM -40. 214. FORMAT "%3.0" /end CHARACTERISTIC
/begin CHARACTERISTIC C_ECTPWM_ECRAS_ON "" VALUE 0x4288a _REC_VAL_20_u1 99.609375 _CNV_A_R_LINEAR_____4_CM 0. 99.609375 FORMAT "%4.1" /end CHARACTERISTIC
/begin CHARACTERISTIC C_ECTPWM_ECRAS_OFF "" VALUE 0x42889 _REC_VAL_20_u1 99.609375 _CNV_A_R_LINEAR_____4_CM 0. 99.609375 FORMAT "%4.1" /end CHARACTERISTIC
/begin CHARACTERISTIC LC_ECRAS_MAN_ACT "Switch for manual activation of air flaps" VALUE 0x42b72 _REC_VAL_20_u1 1. _CNV_S_2_RANGE______11_CM 0. 1. /end CHARACTERISTIC
/begin CHARACTERISTIC LC_TEST_ECRAS "Switch for activation of tester ECRAS" VALUE 0x42bd0 _REC_VAL_20_u1 1. _CNV_S_2_RANGE______11_CM 0. 1. /end CHARACTERISTIC
/begin CHARACTERISTIC LC_ECRAS_ERR_TCO "Switch for LV_ERR_TCO as additional input variable" VALUE 0x42b71 _REC_VAL_20_u1 1. _CNV_S_2_RANGE______11_CM 0. 1. /end CHARACTERISTIC
/begin CHARACTERISTIC LC_INH_ECRAS "Switch for LV_ERR_TCO as additional input variable" VALUE 0x42b8b _REC_VAL_20_u1 1. _CNV_S_2_RANGE______11_CM 0. 1. /end CHARACTERISTIC
/begin CHARACTERISTIC C_VS_FIL_ECRAS_OFF "" VALUE 0x431cc _REC_VAL_20_u2 511.99218 _CNV_A_R_LINEAR_____78_CM 0. 511.99218 FORMAT "%7.3" /end CHARACTERISTIC
/begin CHARACTERISTIC C_TCO_ST_ECT_PLAUS_DIAG "Constant to detect a cold engine" VALUE 0x42a7b _REC_VAL_20_u1 190.5 _CNV_A_R_LINEAR_____0_CM -48. 142.5 FORMAT "%5.1" /end CHARACTERISTIC
/begin MEASUREMENT LV_ERR_ECT "ECT error detected" UBYTE _CNV_S_2_RANGE______21_R_CM 1 100. 0. 255. ECU_ADDRESS 0x3fcf96 /end MEASUREMENT
/begin MEASUREMENT T_PUC_INT_ECT_DIAG "Duration of PUC phases for ECT_MEC diagnosis" UWORD _CNV_A_R_LINEAR_____14_CM 1 100. 0. 6553.5 ECU_ADDRESS 0x3fe53c FORMAT "%5.1" /end MEASUREMENT
/begin CHARACTERISTIC C_T_PUC_TCO_EX_PLAUS_DIAG "Max. duration of PUC phase for diagnosis active" VALUE 0x43014 _REC_VAL_20_u2 6553.400000000001 _CNV_A_R_LINEAR_____14_CM 0.1 6553.5 FORMAT "%6.1" /end CHARACTERISTIC
/begin CHARACTERISTIC C_TCO_TCO_EX_PLAUS_DIAG "TCO/TCO_EX Plausiblization difference" VALUE 0x42a87 _REC_VAL_20_u1 190.5 _CNV_A_R_LINEAR_____1_CM 0. 190.5 FORMAT "%5.1" /end CHARACTERISTIC
/begin CHARACTERISTIC C_TCO_EX_TCO_EX_PLAUS_DIAG "Min TCO_EX difference between ST and diagnosis" VALUE 0x42a55 _REC_VAL_20_u1 190.5 _CNV_A_R_LINEAR_____1_CM 0. 190.5 FORMAT "%5.1" /end CHARACTERISTIC
/begin CHARACTERISTIC C_TAM_MIN_TCO_EX_PLAUS_DIAG "Threshold of ambient temperature for diagnosis" VALUE 0x42a39 _REC_VAL_20_u1 190.5 _CNV_A_R_LINEAR_____0_CM -48. 142.5 FORMAT "%5.1" /end CHARACTERISTIC
/begin CHARACTERISTIC C_TCO_TCO_EX_PLAUS_DIAG_MIN "Min. TCO for diagnosis result \"no error\"" VALUE 0x42a88 _REC_VAL_20_u1 190.5 _CNV_A_R_LINEAR_____0_CM -48. 142.5 FORMAT "%5.1" /end CHARACTERISTIC
/begin CHARACTERISTIC C_N_MIN_ECT_PLAUS_DIAG "Min. N_32 threshold for STEP2 of diagnosis" VALUE 0x42961 _REC_VAL_20_u1 8160. _CNV_A_R_LINEAR_____5_CM 0. 8160. FORMAT "%4.0" /end CHARACTERISTIC
/begin MEASUREMENT LV_ERR_ECT_MEC "ECT Mechanical error detected" UBYTE _CNV_S_2_RANGE______21_R_CM 1 100. 0. 255. ECU_ADDRESS 0x3fd4ff /end MEASUREMENT
/begin MEASUREMENT LV_ERR_ECT_EL "ECT Electrical error detected" UBYTE _CNV_S_2_RANGE______21_R_CM 1 100. 0. 255. ECU_ADDRESS 0x3fd4fb /end MEASUREMENT
/begin MEASUREMENT LV_ERR_RLY_EFP "???" UBYTE _CNV_S_2_RANGE______184_R_CM 1 100. 0. 255. ECU_ADDRESS 0x3fd3b7 /end MEASUREMENT
/begin CHARACTERISTIC C_SUM_CYC_CAM_DIAG_IVVT "" VALUE 0x429aa _REC_VAL_20_u1 255. _CNV_A_R_LINEAR_____227_CM 0. 255. FORMAT "%3.0" /end CHARACTERISTIC
/begin CHARACTERISTIC C_TOIL_MIN_IVVT "" VALUE 0x42aca _REC_VAL_20_u1 200. _CNV_A_R_LINEAR_____3_CM -40. 160. FORMAT "%3.0" /end CHARACTERISTIC
/begin CHARACTERISTIC C_VB_MAX_IVVT "" VALUE 0x42b08 _REC_VAL_20_u1 26. _CNV_A_R_LINEAR_____53_CM 0. 26. FORMAT "%4.1" /end CHARACTERISTIC
/begin CHARACTERISTIC C_VB_MIN_IVVT "" VALUE 0x42b10 _REC_VAL_20_u1 26. _CNV_A_R_LINEAR_____53_CM 0. 26. FORMAT "%4.1" /end CHARACTERISTIC
/begin CHARACTERISTIC ID_DLY_ST_IVVT "" CURVE 0x4cc5d _REC_CUR_20_u1_u1 25.4 _CNV_A_R_LINEAR_____14_CM 0.1 25.5 FORMAT "%4.1"
 /begin AXIS_DESCR COM_AXIS TOIL _CNV_A_R_LINEAR_____3_CM 6 -40. 160. FORMAT "%3.0" AXIS_PTS_REF ldpm_toil_2_ivvt /end AXIS_DESCR
/end CHARACTERISTIC
/begin MEASUREMENT STATE_IVVT_TRAN "" ULONG _CNV_S_21_STATE_IVVT_228_CM 1 100. 0. 20. ECU_ADDRESS 0x3fc6d4 /end MEASUREMENT
/begin MEASUREMENT LV_ENA_IVVT_PARK "configuration data for VANOS-parking function enabled (=1) / disabled (=0)" UBYTE _CNV_S_2_RANGE______11_CM 1 100. 0. 1. ECU_ADDRESS 0x3fc6d8 BIT_MASK 0x1 /end MEASUREMENT
/begin CHARACTERISTIC C_TOIL_HYS_IVVT "" VALUE 0x42ac3 _REC_VAL_20_u1 200. _CNV_A_R_LINEAR_____2_CM 0. 200. FORMAT "%3.0" /end CHARACTERISTIC
/begin CHARACTERISTIC C_TCO_MIN_IVVT_PARK "Minimum coolant temperature for activation of IVVT parking function" VALUE 0x42a6f _REC_VAL_20_u1 190.5 _CNV_A_R_LINEAR_____0_CM -48. 142.5 FORMAT "%5.1" /end CHARACTERISTIC
/begin CHARACTERISTIC C_TCO_MAX_IVVT_PARK "Maximum coolant temperature for activation of IVVT parking function" VALUE 0x42a5e _REC_VAL_20_u1 190.5 _CNV_A_R_LINEAR_____0_CM -48. 142.5 FORMAT "%5.1" /end CHARACTERISTIC
/begin CHARACTERISTIC LC_ENA_IVVT_PARK "switch for IVVT parking function (1 = enabled)" VALUE 0x42b7c _REC_VAL_20_u1 1. _CNV_A_R_LINEAR_____12_CM 0. 1. FORMAT "%2.0" /end CHARACTERISTIC
/begin MEASUREMENT STATE_IVVT "actual status IVVT-function" ULONG _CNV_S_7_STATE_IVVT_229_CM 1 100. 0. 6. ECU_ADDRESS 0x3fc6d0 /end MEASUREMENT
/begin CHARACTERISTIC IP_TOIL_MAX_IVVT "" CURVE 0x50cb1 _REC_CUR_20_u1_u1 200. _CNV_A_R_LINEAR_____3_CM -40. 160. FORMAT "%3.0"
 /begin AXIS_DESCR COM_AXIS N_32 _CNV_A_R_LINEAR_____5_CM 6 0. 8160. FORMAT "%4.0" AXIS_PTS_REF ldpm_n_32_3_ivvt /end AXIS_DESCR
/end CHARACTERISTIC
/begin MEASUREMENT LV_ERR_IVVT "Global error flag IVVT" UBYTE _CNV_S_2_RANGE______21_R_CM 1 100. 0. 255. ECU_ADDRESS 0x3fcb16 /end MEASUREMENT
/begin CHARACTERISTIC C_T_DLY_DIAG_REF_IVVT "Delelaytime before IVVT" VALUE 0x429d7 _REC_VAL_20_u1 25.5 _CNV_A_R_LINEAR_____14_CM 0. 25.5 FORMAT "%4.1" /end CHARACTERISTIC
/begin MEASUREMENT LV_ERR_MEC_IVVT_IN_1 "IVVT 1 Error flag" UBYTE _CNV_S_2_RANGE______21_R_CM 1 100. 0. 255. ECU_ADDRESS 0x3fd3bf /end MEASUREMENT
/begin MEASUREMENT LV_ERR_REF_IVVT_IN_1 "IVVT 1 Error flag" UBYTE _CNV_S_2_RANGE______21_R_CM 1 100. 0. 255. ECU_ADDRESS 0x3fd3cf /end MEASUREMENT
/begin MEASUREMENT LV_ERR_MEC_IVVT_IN_2 "IVVT 2 Error flag" UBYTE _CNV_S_2_RANGE______21_R_CM 1 100. 0. 255. ECU_ADDRESS 0x3fd3c3 /end MEASUREMENT
/begin MEASUREMENT LV_ERR_REF_IVVT_IN_2 "IVVT 2 Error flag" UBYTE _CNV_S_2_RANGE______21_R_CM 1 100. 0. 255. ECU_ADDRESS 0x3fd3d3 /end MEASUREMENT
/begin MEASUREMENT LV_ERR_REF_IVVT_EX_1 "IVVT 1 Error flag" UBYTE _CNV_S_2_RANGE______21_R_CM 1 100. 0. 255. ECU_ADDRESS 0x3fd3d7 /end MEASUREMENT
/begin MEASUREMENT LV_ERR_MEC_IVVT_EX_2 "IVVT 2 Error flag" UBYTE _CNV_S_2_RANGE______21_R_CM 1 100. 0. 255. ECU_ADDRESS 0x3fd3cb /end MEASUREMENT
/begin MEASUREMENT LV_ERR_REF_IVVT_EX_2 "IVVT 2 Error flag" UBYTE _CNV_S_2_RANGE______21_R_CM 1 100. 0. 255. ECU_ADDRESS 0x3fd3db /end MEASUREMENT
/begin MEASUREMENT LV_ERR_MEC_IVVT_EX_1 "IVVT 1 Error flag" UBYTE _CNV_S_2_RANGE______21_R_CM 1 100. 0. 255. ECU_ADDRESS 0x3fd3c7 /end MEASUREMENT
/begin MEASUREMENT CAM_SP_AV_IN_AFL "Camshaft setpoint for homogeneous lean combustion -intake cam" SWORD _CNV_A_R_LINEAR_____232_CM 1 100. -768. 767.9765625 ECU_ADDRESS 0x3fc8f0 FORMAT "%7.2" /end MEASUREMENT
/begin MEASUREMENT CAM_SP_AV_IN_S "Exhaust camshaft target spread for stratified combustion" SWORD _CNV_A_R_LINEAR_____232_CM 1 100. -768. 767.9765625 ECU_ADDRESS 0x3fc8ee FORMAT "%7.2" /end MEASUREMENT
/begin MEASUREMENT LV_INH_IVVT_IN_1 "" UBYTE _CNV_A_R_LINEAR_____10_CM 1 100. 0. 1. ECU_ADDRESS 0x3fc7dc FORMAT "%1.0" /end MEASUREMENT
/begin MEASUREMENT CAM_RAW_IN_1 "Raw value of current inlet CAM position (distance maximum valve lift GTDC)" UBYTE _CNV_A_R_LINEAR_____234_CM 1 100. 60. 155.625 ECU_ADDRESS 0x3fc6e8 FORMAT "%5.1" /end MEASUREMENT
/begin MEASUREMENT CAM_EDGE_NR_IN_1 "Number of CAM edge detected at current inlet CAM position" UBYTE _CNV_A_R_LINEAR_____10_CM 1 100. 0. 255. ECU_ADDRESS 0x3fc6e9 FORMAT "%3.0" /end MEASUREMENT
/begin MEASUREMENT CAM_PSN_CAP_SAVE_IVVT_IN_1 "captured system time at inlet CAM edge" ULONG _CNV_A_R_LINEAR_____248_CM 1 100. 0. 17179869180. ECU_ADDRESS 0x3fc6ec FORMAT "%11.0" /end MEASUREMENT
/begin MEASUREMENT LV_INH_IVVT_IN_2 "" UBYTE _CNV_A_R_LINEAR_____10_CM 1 100. 0. 1. ECU_ADDRESS 0x3fc8d4 FORMAT "%1.0" /end MEASUREMENT
/begin MEASUREMENT CAM_RAW_IN_2 "Raw value of current inlet CAM position (distance maximum valve lift GTDC)" UBYTE _CNV_A_R_LINEAR_____234_CM 1 100. 60. 155.625 ECU_ADDRESS 0x3fc7e0 FORMAT "%5.1" /end MEASUREMENT
/begin MEASUREMENT CAM_EDGE_NR_IN_2 "Number of CAM edge detected at current inlet CAM position" UBYTE _CNV_A_R_LINEAR_____10_CM 1 100. 0. 255. ECU_ADDRESS 0x3fc7e1 FORMAT "%3.0" /end MEASUREMENT
/begin MEASUREMENT CAM_PSN_CAP_SAVE_IVVT_IN_2 "captured system time at inlet CAM edge" ULONG _CNV_A_R_LINEAR_____248_CM 1 100. 0. 17179869180. ECU_ADDRESS 0x3fc7e4 FORMAT "%11.0" /end MEASUREMENT
/begin MEASUREMENT LV_INH_IVVT_EX_1 "" UBYTE _CNV_A_R_LINEAR_____10_CM 1 100. 0. 1. ECU_ADDRESS 0x3fc9ec FORMAT "%1.0" /end MEASUREMENT
/begin MEASUREMENT CAM_RAW_EX_1 "Raw value of current exhaust CAM position (distance maximum valve lift GTDC)" UBYTE _CNV_A_R_LINEAR_____231_CM 1 100. -40. -135.625 ECU_ADDRESS 0x3fc8f8 FORMAT "%5.1" /end MEASUREMENT
/begin MEASUREMENT CAM_EDGE_NR_EX_1 "Number of CAM edge detected at current exhaust CAM position" UBYTE _CNV_A_R_LINEAR_____10_CM 1 100. 0. 255. ECU_ADDRESS 0x3fc8f9 FORMAT "%3.0" /end MEASUREMENT
/begin MEASUREMENT CAM_PSN_CAP_SAVE_IVVT_EX_1 "captured system time at exhaust CAM edge" ULONG _CNV_A_R_LINEAR_____248_CM 1 100. 0. 17179869180. ECU_ADDRESS 0x3fc8fc FORMAT "%11.0" /end MEASUREMENT
/begin MEASUREMENT LV_INH_IVVT_EX_2 "" UBYTE _CNV_A_R_LINEAR_____10_CM 1 100. 0. 1. ECU_ADDRESS 0x3fcae4 FORMAT "%1.0" /end MEASUREMENT
/begin MEASUREMENT CAM_RAW_EX_2 "Raw value of current exhaust CAM position (distance maximum valve lift GTDC)" UBYTE _CNV_A_R_LINEAR_____231_CM 1 100. -40. -135.625 ECU_ADDRESS 0x3fc9f0 FORMAT "%5.1" /end MEASUREMENT
/begin MEASUREMENT CAM_EDGE_NR_EX_2 "Number of CAM edge detected at current exhaust CAM position" UBYTE _CNV_A_R_LINEAR_____10_CM 1 100. 0. 255. ECU_ADDRESS 0x3fc9f1 FORMAT "%3.0" /end MEASUREMENT
/begin MEASUREMENT CAM_PSN_CAP_SAVE_IVVT_EX_2 "captured system time at exhaust CAM edge" ULONG _CNV_A_R_LINEAR_____248_CM 1 100. 0. 17179869180. ECU_ADDRESS 0x3fc9f4 FORMAT "%11.0" /end MEASUREMENT
/begin MEASUREMENT CAM_SP_AV_EX_AFL "Camshaft setpoint for homogeneous lean combustion -intake cam" SWORD _CNV_A_R_LINEAR_____232_CM 1 100. -768. 767.9765625 ECU_ADDRESS 0x3fcb00 FORMAT "%7.2" /end MEASUREMENT
/begin MEASUREMENT CAM_SP_AV_EX_S "Exhaust camshaft target spread for stratified combustion" SWORD _CNV_A_R_LINEAR_____232_CM 1 100. -768. 767.9765625 ECU_ADDRESS 0x3fcafe FORMAT "%7.2" /end MEASUREMENT
/begin CHARACTERISTIC ID_CAM_0_SEG_OFS__CAM_EDGE_NR "" CURVE 0x456ca _REC_CUR_20_u2_u1 24575.625 _CNV_A_R_LINEAR_____250_CM -12288. 12287.625 FORMAT "%7.1"
 /begin AXIS_DESCR COM_AXIS ONLINE_DUMMY _CNV_A_R_LINEAR_____10_CM 4 0. 3. FORMAT "%2.0" AXIS_PTS_REF ldpm_cam_edge_nr /end AXIS_DESCR
/end CHARACTERISTIC
/begin CHARACTERISTIC ID_CAM_1_SEG_OFS__CAM_EDGE_NR "" CURVE 0x456d2 _REC_CUR_20_u2_u1 24575.625 _CNV_A_R_LINEAR_____250_CM -12288. 12287.625 FORMAT "%7.1"
 /begin AXIS_DESCR COM_AXIS ONLINE_DUMMY _CNV_A_R_LINEAR_____10_CM 4 0. 3. FORMAT "%2.0" AXIS_PTS_REF ldpm_cam_edge_nr /end AXIS_DESCR
/end CHARACTERISTIC
/begin CHARACTERISTIC C_N_MAX_IVVT_1 "" VALUE 0x42eb2 _REC_VAL_20_u2 8160. _CNV_A_R_LINEAR_____17_CM 0. 8160. FORMAT "%4.0" /end CHARACTERISTIC
/begin CHARACTERISTIC C_N_MAX_IVVT_2 "" VALUE 0x42eb4 _REC_VAL_20_u2 8160. _CNV_A_R_LINEAR_____17_CM 0. 8160. FORMAT "%4.0" /end CHARACTERISTIC
/begin AXIS_PTS ldpm_cam_edge_nr "" 0x43b60 CAM_EDGE_NR _REC_AXS_20_u1 3. _CNV_A_R_LINEAR_____10_CM 4 0. 3. FORMAT "%2.0" /end AXIS_PTS
/begin CHARACTERISTIC IP_CAM_SP_1_EX_AFL__N__MAF_IVVT "Target spread for thermal condition 1,hom, lean, exhaust camschaft" MAP 0x4d083 _REC_MAP_20_u1_u2_u2 -95.625 _CNV_A_R_LINEAR_____231_CM -40. -135.625 FORMAT "%5.1"
 /begin AXIS_DESCR COM_AXIS N _CNV_A_R_LINEAR_____17_CM 16 0. 8160. FORMAT "%4.0" AXIS_PTS_REF ldpm_n_5 /end AXIS_DESCR
 /begin AXIS_DESCR COM_AXIS MAF _CNV_A_R_LINEAR_____95_CM 12 0. 1389. FORMAT "%7.2" AXIS_PTS_REF ldpm_maf_ivvt_2 /end AXIS_DESCR
/end CHARACTERISTIC
/begin CHARACTERISTIC IP_CAM_SP_2_EX_AFL__N__MAF_IVVT "Target spread for thermal condition 2,hom, lean, exhaust camschaft" MAP 0x4d47b _REC_MAP_20_u1_u2_u2 -95.625 _CNV_A_R_LINEAR_____231_CM -40. -135.625 FORMAT "%5.1"
 /begin AXIS_DESCR COM_AXIS N _CNV_A_R_LINEAR_____17_CM 16 0. 8160. FORMAT "%4.0" AXIS_PTS_REF ldpm_n_5 /end AXIS_DESCR
 /begin AXIS_DESCR COM_AXIS MAF _CNV_A_R_LINEAR_____95_CM 12 0. 1389. FORMAT "%7.2" AXIS_PTS_REF ldpm_maf_ivvt_2 /end AXIS_DESCR
/end CHARACTERISTIC
/begin CHARACTERISTIC IP_CAM_SP_2_IN_AFL__N__MAF_IVVT "Target spread for thermal condition 2,hom, lean, intaket camschaft" MAP 0x4d677 _REC_MAP_20_u1_u2_u2 95.625 _CNV_A_R_LINEAR_____234_CM 60. 155.625 FORMAT "%5.1"
 /begin AXIS_DESCR COM_AXIS N _CNV_A_R_LINEAR_____17_CM 16 0. 8160. FORMAT "%4.0" AXIS_PTS_REF ldpm_n_5 /end AXIS_DESCR
 /begin AXIS_DESCR COM_AXIS MAF _CNV_A_R_LINEAR_____95_CM 12 0. 1389. FORMAT "%7.2" AXIS_PTS_REF ldpm_maf_ivvt_2 /end AXIS_DESCR
/end CHARACTERISTIC
/begin CHARACTERISTIC IP_CAM_SP_1_IN_AFL__N__MAF_IVVT "Target spread for thermal condition 1,hom, lean, intaket camschaft" MAP 0x4d27f _REC_MAP_20_u1_u2_u2 95.625 _CNV_A_R_LINEAR_____234_CM 60. 155.625 FORMAT "%5.1"
 /begin AXIS_DESCR COM_AXIS N _CNV_A_R_LINEAR_____17_CM 16 0. 8160. FORMAT "%4.0" AXIS_PTS_REF ldpm_n_5 /end AXIS_DESCR
 /begin AXIS_DESCR COM_AXIS MAF _CNV_A_R_LINEAR_____95_CM 12 0. 1389. FORMAT "%7.2" AXIS_PTS_REF ldpm_maf_ivvt_2 /end AXIS_DESCR
/end CHARACTERISTIC
/begin MEASUREMENT MFF_MMV "low pass filtered value for fuel mass flow" UWORD _CNV_A_R_LINEAR_____95_CM 1 100. 0. 1389. ECU_ADDRESS 0x3fcb0a FORMAT "%7.2" /end MEASUREMENT
/begin CHARACTERISTIC IP_CAM_SP_1_IN_IS_S__N__MFF_MMV "Stratified target overlap for TCO_1, idle, intake camschaft" MAP 0x4d373 _REC_MAP_20_u1_u2_u2 95.625 _CNV_A_R_LINEAR_____234_CM 60. 155.625 FORMAT "%5.1"
 /begin AXIS_DESCR COM_AXIS N _CNV_A_R_LINEAR_____17_CM 6 0. 8160. FORMAT "%4.0" AXIS_PTS_REF ldpm_n_13 /end AXIS_DESCR
 /begin AXIS_DESCR COM_AXIS MFF_MMV _CNV_A_R_LINEAR_____95_CM 6 0. 1389. FORMAT "%7.2" AXIS_PTS_REF ldpm_mff_mmv /end AXIS_DESCR
/end CHARACTERISTIC
/begin CHARACTERISTIC IP_CAM_SP_2_IN_IS_S__N__MFF_MMV "Stratified target overlap for TCO_2, idle, intake camschaft" MAP 0x4d76b _REC_MAP_20_u1_u2_u2 95.625 _CNV_A_R_LINEAR_____234_CM 60. 155.625 FORMAT "%5.1"
 /begin AXIS_DESCR COM_AXIS N _CNV_A_R_LINEAR_____17_CM 6 0. 8160. FORMAT "%4.0" AXIS_PTS_REF ldpm_n_13 /end AXIS_DESCR
 /begin AXIS_DESCR COM_AXIS MFF_MMV _CNV_A_R_LINEAR_____95_CM 6 0. 1389. FORMAT "%7.2" AXIS_PTS_REF ldpm_mff_mmv /end AXIS_DESCR
/end CHARACTERISTIC
/begin CHARACTERISTIC IP_CAM_SP_2_IN_PL_S__N__MFF_MMV "Stratified target overlap for TCO_2, PL, intake camschaft" MAP 0x4d84f _REC_MAP_20_u1_u2_u2 95.625 _CNV_A_R_LINEAR_____234_CM 60. 155.625 FORMAT "%5.1"
 /begin AXIS_DESCR COM_AXIS N _CNV_A_R_LINEAR_____17_CM 6 0. 8160. FORMAT "%4.0" AXIS_PTS_REF ldpm_n_13 /end AXIS_DESCR
 /begin AXIS_DESCR COM_AXIS MFF_MMV _CNV_A_R_LINEAR_____95_CM 6 0. 1389. FORMAT "%7.2" AXIS_PTS_REF ldpm_mff_mmv /end AXIS_DESCR
/end CHARACTERISTIC
/begin CHARACTERISTIC IP_CAM_SP_1_IN_PL_S__N__MFF_MMV "Stratified target overlap for TCO_1, PL, intake camschaft" MAP 0x4d457 _REC_MAP_20_u1_u2_u2 95.625 _CNV_A_R_LINEAR_____234_CM 60. 155.625 FORMAT "%5.1"
 /begin AXIS_DESCR COM_AXIS N _CNV_A_R_LINEAR_____17_CM 6 0. 8160. FORMAT "%4.0" AXIS_PTS_REF ldpm_n_13 /end AXIS_DESCR
 /begin AXIS_DESCR COM_AXIS MFF_MMV _CNV_A_R_LINEAR_____95_CM 6 0. 1389. FORMAT "%7.2" AXIS_PTS_REF ldpm_mff_mmv /end AXIS_DESCR
/end CHARACTERISTIC
/begin CHARACTERISTIC IP_CAM_SP_1_EX_IS_S__N__MFF_MMV "Stratified target overlap for TCO_1,IS , exhaust camschaft" MAP 0x4d177 _REC_MAP_20_u1_u2_u2 -95.625 _CNV_A_R_LINEAR_____231_CM -40. -135.625 FORMAT "%5.1"
 /begin AXIS_DESCR COM_AXIS N _CNV_A_R_LINEAR_____17_CM 6 0. 8160. FORMAT "%4.0" AXIS_PTS_REF ldpm_n_13 /end AXIS_DESCR
 /begin AXIS_DESCR COM_AXIS MFF_MMV _CNV_A_R_LINEAR_____95_CM 6 0. 1389. FORMAT "%7.2" AXIS_PTS_REF ldpm_mff_mmv /end AXIS_DESCR
/end CHARACTERISTIC
/begin CHARACTERISTIC IP_CAM_SP_2_EX_IS_S__N__MFF_MMV "Stratified target overlap for TCO_2,IS , exhaust camschaft" MAP 0x4d56f _REC_MAP_20_u1_u2_u2 -95.625 _CNV_A_R_LINEAR_____231_CM -40. -135.625 FORMAT "%5.1"
 /begin AXIS_DESCR COM_AXIS N _CNV_A_R_LINEAR_____17_CM 6 0. 8160. FORMAT "%4.0" AXIS_PTS_REF ldpm_n_13 /end AXIS_DESCR
 /begin AXIS_DESCR COM_AXIS MFF_MMV _CNV_A_R_LINEAR_____95_CM 6 0. 1389. FORMAT "%7.2" AXIS_PTS_REF ldpm_mff_mmv /end AXIS_DESCR
/end CHARACTERISTIC
/begin CHARACTERISTIC IP_CAM_SP_2_EX_PL_S__N__MFF_MMV "Stratified target overlap for TCO_2, PL , exhaust camschaft" MAP 0x4d653 _REC_MAP_20_u1_u2_u2 -95.625 _CNV_A_R_LINEAR_____231_CM -40. -135.625 FORMAT "%5.1"
 /begin AXIS_DESCR COM_AXIS N _CNV_A_R_LINEAR_____17_CM 6 0. 8160. FORMAT "%4.0" AXIS_PTS_REF ldpm_n_13 /end AXIS_DESCR
 /begin AXIS_DESCR COM_AXIS MFF_MMV _CNV_A_R_LINEAR_____95_CM 6 0. 1389. FORMAT "%7.2" AXIS_PTS_REF ldpm_mff_mmv /end AXIS_DESCR
/end CHARACTERISTIC
/begin CHARACTERISTIC IP_CAM_SP_1_EX_PL_S__N__MFF_MMV "Stratified target overlap for TCO_1, PL , exhaust camschaft" MAP 0x4d25b _REC_MAP_20_u1_u2_u2 -95.625 _CNV_A_R_LINEAR_____231_CM -40. -135.625 FORMAT "%5.1"
 /begin AXIS_DESCR COM_AXIS N _CNV_A_R_LINEAR_____17_CM 6 0. 8160. FORMAT "%4.0" AXIS_PTS_REF ldpm_n_13 /end AXIS_DESCR
 /begin AXIS_DESCR COM_AXIS MFF_MMV _CNV_A_R_LINEAR_____95_CM 6 0. 1389. FORMAT "%7.2" AXIS_PTS_REF ldpm_mff_mmv /end AXIS_DESCR
/end CHARACTERISTIC
/begin CHARACTERISTIC C_CRLC_MFF_SP_S "correlation constant for low pass filterd mass fuel flow stratified" VALUE 0x42c76 _REC_VAL_20_u2 0.99998474 _CNV_A_R_LINEAR_____31_CM 0. 0.99998474 FORMAT "%7.5" /end CHARACTERISTIC
/begin AXIS_PTS ldpm_mff_mmv "" 0x45176 MFF_MMV _REC_AXS_20_u2 1389. _CNV_A_R_LINEAR_____95_CM 6 0. 1389. FORMAT "%7.2" /end AXIS_PTS
/begin MEASUREMENT LV_ERR_KNKS_1 "Boolean for knock sensor 1 error currently active" UBYTE _CNV_S_2_RANGE______21_R_CM 1 100. 0. 255. ECU_ADDRESS 0x3fd41b /end MEASUREMENT
/begin MEASUREMENT LV_ERR_KNKS_2 "Boolean for knock sensor 2 error currently active" UBYTE _CNV_S_2_RANGE______21_R_CM 1 100. 0. 255. ECU_ADDRESS 0x3fd41f /end MEASUREMENT
/begin CHARACTERISTIC C_N_MIN_KNKS_DIAG "Lower engine speed treshold for knock sensor diagnosis" VALUE 0x42965 _REC_VAL_20_u1 8160. _CNV_A_R_LINEAR_____5_CM 0. 8160. FORMAT "%4.0" /end CHARACTERISTIC
/begin CHARACTERISTIC C_MAF_MIN_KNKS_DIAG "Lower engine load treshold for knock sensor diagnosis" VALUE 0x42e76 _REC_VAL_20_u2 1389. _CNV_A_R_LINEAR_____95_CM 0. 1389. FORMAT "%7.2" /end CHARACTERISTIC
/begin CHARACTERISTIC C_NL_MIN_DIAG "Minimum noise level treshold" VALUE 0x42974 _REC_VAL_20_u1 4.998 _CNV_A_R_LINEAR_____38_CM 0. 4.998 FORMAT "%6.4" /end CHARACTERISTIC
/begin CHARACTERISTIC C_NL_MAX_DIAG "Maximum noise level treshold" VALUE 0x42972 _REC_VAL_20_u1 4.998 _CNV_A_R_LINEAR_____38_CM 0. 4.998 FORMAT "%6.4" /end CHARACTERISTIC
/begin CHARACTERISTIC C_PWM_LSH_DOWN_MAX "Maximum O2-Sensor heater duty cycle to perform the electrical diagnosis" VALUE 0x42993 _REC_VAL_20_u1 99.609375 _CNV_A_R_LINEAR_____4_CM 0. 99.609375 FORMAT "%5.1" /end CHARACTERISTIC
/begin CHARACTERISTIC C_PWM_LSH_DOWN_MIN "Minimum O2-Sensor heater duty cycle to perform the electrical diagnosis" VALUE 0x42994 _REC_VAL_20_u1 99.609375 _CNV_A_R_LINEAR_____4_CM 0. 99.609375 FORMAT "%5.1" /end CHARACTERISTIC
/begin CHARACTERISTIC C_TEG_CAT_DOWN_MDL_MIN_LSH_DIAG "Minimum catalyst temperature threshold to permit SCB to set fault during LSH preheating state" VALUE 0x4305c _REC_VAL_20_u2 2047. _CNV_A_R_LINEAR_____211_CM 0. 2047. FORMAT "%7.2" /end CHARACTERISTIC
/begin CHARACTERISTIC C_TEG_DYN_MIN_LSH_DIAG "Minimum exhaust gas temperature threshold to permit SCB to set fault during LSH power rise state" VALUE 0x43068 _REC_VAL_20_u2 2047. _CNV_A_R_LINEAR_____211_CM 0. 2047. FORMAT "%7.2" /end CHARACTERISTIC
/begin CHARACTERISTIC C_PWM_LSH_UP_MIN "Minimum O2-Sensor heater duty cycle to perform the electrical diagnosis" VALUE 0x42996 _REC_VAL_20_u1 99.609375 _CNV_A_R_LINEAR_____4_CM 0. 99.609375 FORMAT "%5.1" /end CHARACTERISTIC
/begin CHARACTERISTIC C_PWM_LSH_UP_MAX "Maximum O2-Sensor heater duty cycle to perform the electrical diagnosis" VALUE 0x42995 _REC_VAL_20_u1 99.609375 _CNV_A_R_LINEAR_____4_CM 0. 99.609375 FORMAT "%5.1" /end CHARACTERISTIC
/begin MEASUREMENT LV_INH_DIAG_LSH_UP_2 "Inhibit flag for Upstream oxygen sensor heater OBDI diagnosis" UBYTE _CNV_S_2_RANGE______28_CM 1 100. 0. 1. ECU_ADDRESS 0x3fcbc0 BIT_MASK 0x1 /end MEASUREMENT
/begin MEASUREMENT LV_INH_DIAG_LSH_DOWN_1 "Inhibit flag for Downpstream oxygen sensor heater OBDI diagnosis" UBYTE _CNV_S_2_RANGE______28_CM 1 100. 0. 1. ECU_ADDRESS 0x3fcbbf BIT_MASK 0x1 /end MEASUREMENT
/begin MEASUREMENT LV_INH_DIAG_LSH_DOWN_2 "Inhibit flag for Downpstream oxygen sensor heater OBDI diagnosis" UBYTE _CNV_S_2_RANGE______28_CM 1 100. 0. 1. ECU_ADDRESS 0x3fcbc1 BIT_MASK 0x1 /end MEASUREMENT
/begin MEASUREMENT LV_INH_DIAG_LSH_UP_1 "Inhibit flag for Upstream oxygen sensor heater OBDI diagnosis" UBYTE _CNV_S_2_RANGE______28_CM 1 100. 0. 1. ECU_ADDRESS 0x3fcbbe BIT_MASK 0x1 /end MEASUREMENT
/begin CHARACTERISTIC ID_MAF_TAB "conversion table for MAF value" MAP 0x4596e _REC_MAP_20_u2_u1_u1 1023.984375 _CNV_A_R_LINEAR_____41_CM 0. 1023.984375 FORMAT "%7.2"
 /begin AXIS_DESCR COM_AXIS ONLINE_DUMMY _CNV_A_R_LINEAR_____10_CM 16 0. 255. FORMAT "%3.0" AXIS_PTS_REF ldp_id_maf_tab_1 /end AXIS_DESCR
 /begin AXIS_DESCR COM_AXIS ONLINE_DUMMY _CNV_A_R_LINEAR_____10_CM 16 0. 255. FORMAT "%3.0" AXIS_PTS_REF ldp_id_maf_tab_2 /end AXIS_DESCR
/end CHARACTERISTIC
/begin AXIS_PTS ldp_id_maf_tab_1 "" 0x433e9 INDEX_1 _REC_AXS_20_u1 255. _CNV_A_R_LINEAR_____10_CM 16 0. 255. FORMAT "%3.0" /end AXIS_PTS
/begin AXIS_PTS ldp_id_maf_tab_2 "" 0x433fa INDEX_2 _REC_AXS_20_u1 255. _CNV_A_R_LINEAR_____10_CM 16 0. 255. FORMAT "%3.0" /end AXIS_PTS
/begin CHARACTERISTIC C_N_MIN_MAF_DIAG "Engine speed condition" VALUE 0x42967 _REC_VAL_20_u1 2448. _CNV_A_R_LINEAR_____5_CM 0. 8160. FORMAT "%4.0" /end CHARACTERISTIC
/begin CHARACTERISTIC C_MAF_MIN_DIAG "max. mass air flow diagnostic threshold" VALUE 0x42e74 _REC_VAL_20_u2 614.390625 _CNV_A_R_LINEAR_____101_CM 0. 2047.96875 FORMAT "%7.2" /end CHARACTERISTIC
/begin CHARACTERISTIC C_ISAPWM_MAF_MIN_ISA_DIAG "ISAPWM_ISA-condition" VALUE 0x42daa _REC_VAL_20_u2 99.99847412 _CNV_A_R_LINEAR_____94_CM 0. 99.99847412 /end CHARACTERISTIC
/begin CHARACTERISTIC C_MAF_KGH_DIAG_INI "Set point for MAF_KGH_DIAG at transition out of start" VALUE 0x42e52 _REC_VAL_20_u2 2047.96875 _CNV_A_R_LINEAR_____101_CM 0. 2047.96875 FORMAT "%7.2" /end CHARACTERISTIC
/begin MEASUREMENT PQ_TURB_SYS "Substitute Mass air flow on ISA " UBYTE _CNV_A_R_LINEAR_____20_CM 1 100. 0. 0.99610001 ECU_ADDRESS 0x3fc616 FORMAT "%5.3" /end MEASUREMENT
/begin MEASUREMENT MAF_SUB_ISA "Substitute Mass air flow on ISA " UWORD _CNV_A_R_LINEAR_____95_CM 1 100. 0. 1389. ECU_ADDRESS 0x3fc610 FORMAT "%7.2" /end MEASUREMENT
/begin MEASUREMENT MAF_KGH_DIAG "Substitute Mass air flow on ISA " UWORD _CNV_A_R_LINEAR_____101_CM 1 100. 0. 2047.96875 ECU_ADDRESS 0x3fc614 FORMAT "%7.2" /end MEASUREMENT
/begin CHARACTERISTIC ID_CRLC_MAF_DIAG__N_32 "Mittelungskonstante zur Mittelung des Luftmassen-Diagnosewertes" CURVE 0x4cc43 _REC_CUR_20_u1_u1 0.99610001 _CNV_A_R_LINEAR_____20_CM 0. 0.99610001 FORMAT "%5.3"
 /begin AXIS_DESCR COM_AXIS N_32 _CNV_A_R_LINEAR_____5_CM 4 0. 8160. FORMAT "%4.0" AXIS_PTS_REF ldp_n_32__crlc_maf_diag /end AXIS_DESCR
/end CHARACTERISTIC
/begin CHARACTERISTIC IP_MAF_MAX_ISA__PQ_TURB_SYS "max. mass Air flow thru ISA" CURVE 0x4909a _REC_CUR_20_u2_u1 2047.96875 _CNV_A_R_LINEAR_____101_CM 0. 2047.96875 FORMAT "%7.2"
 /begin AXIS_DESCR COM_AXIS N_32 _CNV_A_R_LINEAR_____20_CM 6 0. 0.99610001 FORMAT "%5.3" AXIS_PTS_REF ldpm_pq_turb_sys /end AXIS_DESCR
/end CHARACTERISTIC
/begin CHARACTERISTIC IP_FAC_PQ_ISA__ISAPWM_ISA "Correction manifold/ turbulence pressure" CURVE 0x4e35f _REC_CUR_20_u1_u2 1.99220002 _CNV_A_R_LINEAR_____34_CM 0. 1.99220002 FORMAT "%5.3"
 /begin AXIS_DESCR COM_AXIS ISAPWM_ISA _CNV_A_R_LINEAR_____94_CM 4 0. 99.99847412 AXIS_PTS_REF ldp_isapwm_isa__fac_pq_isa /end AXIS_DESCR
/end CHARACTERISTIC
/begin CHARACTERISTIC C_MAF_MAX_DIAG "min. mass air flow diagnostic threshold" VALUE 0x42e6a _REC_VAL_20_u2 614.390625 _CNV_A_R_LINEAR_____101_CM 0. 2047.96875 FORMAT "%7.2" /end CHARACTERISTIC
/begin CHARACTERISTIC C_FAC_TQ_REQ_MIN_MAF_DIAG "" VALUE 0x42d52 _REC_VAL_20_u2 0.599990844 _CNV_A_R_LINEAR_____45_CM 0. 1.99996948 FORMAT "%7.5" /end CHARACTERISTIC
/begin MEASUREMENT LV_MAF_BLS_DIAG "MAF error anf break active" UBYTE _CNV_S_2_RANGE______28_CM 1 100. 0. 1. ECU_ADDRESS 0x3fc612 /end MEASUREMENT
/begin AXIS_PTS ldp_n_32__crlc_maf_diag "" 0x434ce N_32 _REC_AXS_20_u1 8160. _CNV_A_R_LINEAR_____5_CM 4 0. 8160. FORMAT "%4.0" /end AXIS_PTS
/begin AXIS_PTS ldpm_pq_turb_sys "" 0x43ef3 PQ_TURB_SYS _REC_AXS_20_u1 0.99610001 _CNV_A_R_LINEAR_____20_CM 6 0. 0.99610001 FORMAT "%5.3" /end AXIS_PTS
/begin AXIS_PTS ldp_isapwm_isa__fac_pq_isa "" 0x44418 ISAPWM_ISA _REC_AXS_20_u2 99.99847412 _CNV_A_R_LINEAR_____94_CM 4 0. 99.99847412 /end AXIS_PTS
/begin MEASUREMENT LV_ERR_MAF "MAF error detected" UBYTE _CNV_S_2_RANGE______21_R_CM 1 100. 0. 255. ECU_ADDRESS 0x3fd363 /end MEASUREMENT
/begin CHARACTERISTIC C_TOIL_MIN_DIAG "TOIL threshold for short to VB or line break - TOIL diagnosis" VALUE 0x42ac8 _REC_VAL_20_u1 200. _CNV_A_R_LINEAR_____3_CM -40. 160. FORMAT "%3.0" /end CHARACTERISTIC
/begin CHARACTERISTIC C_TCO_MAX_TOIL_DIAG "TCO threshold - TOIL diagnosis" VALUE 0x42a61 _REC_VAL_20_u1 190.5 _CNV_A_R_LINEAR_____0_CM -48. 142.5 FORMAT "%5.1" /end CHARACTERISTIC
/begin CHARACTERISTIC C_TOIL_SUB_DIAG "Substitude value for TOIL" VALUE 0x42ace _REC_VAL_20_u1 200. _CNV_A_R_LINEAR_____3_CM -40. 160. FORMAT "%3.0" /end CHARACTERISTIC
/begin CHARACTERISTIC C_TOIL_MAX_DIAG "TOIL threshold for short to ground - TOIL diagnosis" VALUE 0x42ac5 _REC_VAL_20_u1 200. _CNV_A_R_LINEAR_____3_CM -40. 160. FORMAT "%3.0" /end CHARACTERISTIC
/begin MEASUREMENT LV_POIL_SWI "logical variable oil pressure switch (1 = warning lamp on)" UBYTE _CNV_S_2_RANGE______28_CM 1 100. 0. 1. ECU_ADDRESS 0x3fcc9d BIT_MASK 0x1 /end MEASUREMENT
/begin MEASUREMENT LV_ERR_TOIL "???" UBYTE _CNV_S_2_RANGE______21_R_CM 1 100. 0. 255. ECU_ADDRESS 0x3fd353 /end MEASUREMENT
/begin CHARACTERISTIC C_ECTPWM_MIN_DIAG "Minimum PWM for ECT diagnosis" VALUE 0x4288d _REC_VAL_20_u1 99.609375 _CNV_A_R_LINEAR_____4_CM 0. 99.609375 FORMAT "%4.1" /end CHARACTERISTIC
/begin CHARACTERISTIC C_ECTPWM_MAX_DIAG "Maximum PWM for ECT diagnosis" VALUE 0x4288c _REC_VAL_20_u1 99.609375 _CNV_A_R_LINEAR_____4_CM 0. 99.609375 FORMAT "%4.1" /end CHARACTERISTIC
/begin MEASUREMENT LV_RLY_ST "Starter relay" UBYTE _CNV_S_2_RANGE______11_CM 1 100. 0. 1. ECU_ADDRESS 0x3fcfa2 /end MEASUREMENT
/begin MEASUREMENT LV_ERR_AMP "Error of the ambient pressure sensor" UBYTE _CNV_S_2_RANGE______21_R_CM 1 100. 0. 255. ECU_ADDRESS 0x3fd35f /end MEASUREMENT
/begin MEASUREMENT SAF_KGH "corrected value of SA mass flow" UWORD _CNV_A_R_LINEAR_____41_CM 1 100. 0. 1023.984375 ECU_ADDRESS 0x3fcc72 FORMAT "%7.2" /end MEASUREMENT
/begin MEASUREMENT SAF_MDL "Model value of secondary air mass flow (only if a SAFM is used)" UWORD _CNV_A_R_LINEAR_____41_CM 1 100. 0. 1023.984375 ECU_ADDRESS 0x3fcc74 FORMAT "%7.2" /end MEASUREMENT
/begin MEASUREMENT SAF_KGH_MES_BAS "Raw secondary air-mass flow measured (without correction, to be used for diagnosis only)" UWORD _CNV_A_R_LINEAR_____101_CM 1 100. 0. 2047.96875 ECU_ADDRESS 0x3fcc76 FORMAT "%7.2" /end MEASUREMENT
/begin CHARACTERISTIC C_SOFPWM_SOF_MAX_DIAG "max. pwm for SOF control" VALUE 0x4299f _REC_VAL_20_u1 99.609375 _CNV_A_R_LINEAR_____4_CM 0. 99.609375 FORMAT "%4.1" /end CHARACTERISTIC
/begin CHARACTERISTIC C_SOFPWM_SOF_MIN_DIAG "max. pwm for SOF control" VALUE 0x429a0 _REC_VAL_20_u1 99.609375 _CNV_A_R_LINEAR_____4_CM 0. 99.609375 FORMAT "%4.1" /end CHARACTERISTIC
/begin CHARACTERISTIC C_T_TIA_TCO_EX_DIAG "Time condition - TCO_EX diagnosis" VALUE 0x43044 _REC_VAL_20_u2 65534. _CNV_A_R_LINEAR_____47_CM 1. 65535. FORMAT "%5.0" /end CHARACTERISTIC
/begin MEASUREMENT LV_ERR_TCO_EX "TCO_EX error detected" UBYTE _CNV_S_2_RANGE______21_R_CM 1 100. 0. 255. ECU_ADDRESS 0x3fd357 /end MEASUREMENT
/begin MEASUREMENT LV_ERR_PREL_TEG_PCAT_DOWN_2 "Temp. after precatalyst antibounce flag" UBYTE _CNV_S_2_RANGE______21_R_CM 1 100. 0. 255. ECU_ADDRESS 0x3fcca5 /end MEASUREMENT
/begin MEASUREMENT LV_ERR_PREL_TEG_PCAT_DOWN_1 "Temp. after precatalyst antibounce flag" UBYTE _CNV_S_2_RANGE______21_R_CM 1 100. 0. 255. ECU_ADDRESS 0x3fcca4 /end MEASUREMENT
/begin CHARACTERISTIC C_V_TEG_PCAT_DOWN_DIAG_MIN "minimum voltage threshold for erroe detection" VALUE 0x4313e _REC_VAL_20_u2 4.99511719 _CNV_A_R_LINEAR_____33_CM 0. 4.99511719 FORMAT "%5.3" /end CHARACTERISTIC
/begin CHARACTERISTIC C_V_TEG_PCAT_DOWN_DIAG_MAX "maximum voltage threshold for erroe detection" VALUE 0x4313c _REC_VAL_20_u2 4.99511719 _CNV_A_R_LINEAR_____33_CM 0. 4.99511719 FORMAT "%5.3" /end CHARACTERISTIC
/begin CHARACTERISTIC C_V_TEG_MES_GRD_MAX "maximum voltage gradient threshold for error detection" VALUE 0x4313a _REC_VAL_20_u2 4.99511719 _CNV_A_R_LINEAR_____33_CM 0. 4.99511719 FORMAT "%5.3" /end CHARACTERISTIC
/begin MEASUREMENT LV_ERR_TEG_PCAT_DOWN_1 "Temp. after precatalyst error flag" UBYTE _CNV_S_2_RANGE______21_R_CM 1 100. 0. 255. ECU_ADDRESS 0x3fd34b /end MEASUREMENT
/begin MEASUREMENT LV_ERR_TEG_PCAT_DOWN_2 "Temp. after precatalyst error flag" UBYTE _CNV_S_2_RANGE______21_R_CM 1 100. 0. 255. ECU_ADDRESS 0x3fd34f /end MEASUREMENT
/begin CHARACTERISTIC C_TCO_DIAG "TCO threshold for calculation of substitutes" VALUE 0x42a48 _REC_VAL_20_u1 28.575 _CNV_A_R_LINEAR_____0_CM -48. 142.5 FORMAT "%5.1" /end CHARACTERISTIC
/begin CHARACTERISTIC C_TIA_MAX_DIAG "TIA threshold for short to ground - TIA diagnosis" VALUE 0x42ab1 _REC_VAL_20_u1 28.575 _CNV_A_R_LINEAR_____0_CM -48. 142.5 FORMAT "%5.1" /end CHARACTERISTIC
/begin CHARACTERISTIC C_TIA_MIN_DIAG "TIA threshold for short to VB or line break - TIA diagnosis" VALUE 0x42ab6 _REC_VAL_20_u1 28.575 _CNV_A_R_LINEAR_____0_CM -48. 142.5 FORMAT "%5.1" /end CHARACTERISTIC
/begin CHARACTERISTIC C_TIA_SUB_BOL "Intake air substitute temperature" VALUE 0x42aba _REC_VAL_20_u1 28.575 _CNV_A_R_LINEAR_____0_CM -48. 142.5 FORMAT "%5.1" /end CHARACTERISTIC
/begin CHARACTERISTIC C_TIA_SUB_TOL "Intake air substitute temperature" VALUE 0x42abb _REC_VAL_20_u1 28.575 _CNV_A_R_LINEAR_____0_CM -48. 142.5 FORMAT "%5.1" /end CHARACTERISTIC
/begin CHARACTERISTIC C_VIMPWM_2 "VIMPWM position 2" VALUE 0x43328 _REC_VAL_20_s2 199.99694824 _CNV_A_R_LINEAR_____173_CM -100. 99.99694824 FORMAT "%8.3" /end CHARACTERISTIC
/begin CHARACTERISTIC C_VIMPWM_3 "VIMPWM position 3" VALUE 0x4332a _REC_VAL_20_s2 199.99694824 _CNV_A_R_LINEAR_____173_CM -100. 99.99694824 FORMAT "%8.3" /end CHARACTERISTIC
/begin CHARACTERISTIC C_VIMPWM_1 "VIMPWM position 1" VALUE 0x43326 _REC_VAL_20_s2 199.99694824 _CNV_A_R_LINEAR_____173_CM -100. 99.99694824 FORMAT "%8.3" /end CHARACTERISTIC
/begin CHARACTERISTIC C_VIM_AV_2 "VIM_AV position 2" VALUE 0x4315c _REC_VAL_20_u2 199.9969 _CNV_A_R_LINEAR_____352_CM 0. 199.9969 FORMAT "%7.3" /end CHARACTERISTIC
/begin CHARACTERISTIC C_VIM_AV_3 "VIM_AV position 3" VALUE 0x4315e _REC_VAL_20_u2 199.9969 _CNV_A_R_LINEAR_____352_CM 0. 199.9969 FORMAT "%7.3" /end CHARACTERISTIC
/begin CHARACTERISTIC C_VIM_AV_1 "VIM_AV position 1" VALUE 0x4315a _REC_VAL_20_u2 199.9969 _CNV_A_R_LINEAR_____352_CM 0. 199.9969 FORMAT "%7.3" /end CHARACTERISTIC
/begin CHARACTERISTIC C_N_VIM_L "Lower engine speed threshold" VALUE 0x42ed6 _REC_VAL_20_u2 8160. _CNV_A_R_LINEAR_____17_CM 0. 8160. FORMAT "%4.0" /end CHARACTERISTIC
/begin CHARACTERISTIC C_N_VIM_HYS "engine speed threshold hysteresis" VALUE 0x42ed4 _REC_VAL_20_u2 8160. _CNV_A_R_LINEAR_____17_CM 0. 8160. FORMAT "%4.0" /end CHARACTERISTIC
/begin CHARACTERISTIC C_N_VIM_H "Higher engine speed threshold" VALUE 0x42ed2 _REC_VAL_20_u2 8160. _CNV_A_R_LINEAR_____17_CM 0. 8160. FORMAT "%4.0" /end CHARACTERISTIC
/begin CHARACTERISTIC C_FAC_MAF_MAX_VIM "load threshold" VALUE 0x42d1c _REC_VAL_20_u2 1.99996948 _CNV_A_R_LINEAR_____45_CM 0. 1.99996948 FORMAT "%7.5" /end CHARACTERISTIC
/begin CHARACTERISTIC C_FAC_MAF_MAX_VIM_HYS "load threshold hysteresis" VALUE 0x42d1e _REC_VAL_20_u2 1.99996948 _CNV_A_R_LINEAR_____45_CM 0. 1.99996948 FORMAT "%7.5" /end CHARACTERISTIC
/begin CHARACTERISTIC IP_FAC_N_VIM "TIA correction for VIM switch thresholds" CURVE 0x4e2a3 _REC_CUR_20_u1_u1 1.9921875 _CNV_A_R_LINEAR_____103_CM 0. 1.9921875 FORMAT "%5.3"
 /begin AXIS_DESCR COM_AXIS TIA _CNV_A_R_LINEAR_____0_CM 8 -48. 142.5 FORMAT "%5.1" AXIS_PTS_REF ldp_tia_fac_n_vim /end AXIS_DESCR
/end CHARACTERISTIC
/begin AXIS_PTS ldp_tia_fac_n_vim "" 0x439da TIA _REC_AXS_20_u1 190.5 _CNV_A_R_LINEAR_____0_CM 8 -48. 142.5 FORMAT "%5.1" /end AXIS_PTS
/begin MEASUREMENT VIMPWM "pulse width modulated signal for VIM-actuator" SWORD _CNV_A_R_LINEAR_____173_CM 1 100. -100. 99.99694824 ECU_ADDRESS 0x3fcfba FORMAT "%8.3" /end MEASUREMENT
/begin MEASUREMENT N_VIM "???" UWORD _CNV_A_R_LINEAR_____17_CM 1 100. 0. 8160. ECU_ADDRESS 0x3fcfb8 FORMAT "%4.0" /end MEASUREMENT
/begin MEASUREMENT VIM_AV "Actual position variable intake manifold" UWORD _CNV_A_R_LINEAR_____352_CM 1 100. 0. 199.9969 ECU_ADDRESS 0x3fcfb4 FORMAT "%7.3" /end MEASUREMENT
/begin MEASUREMENT LV_VIM "VIM power stage (2-stage-DISA); 0 passive, 1 active" UBYTE _CNV_S_2_RANGE______28_CM 1 100. 0. 1. ECU_ADDRESS 0x3fcfb6 /end MEASUREMENT
/begin CHARACTERISTIC C_MAF_VS_MIN_DIAG "MAF condition - vehicle speed diagnosis" VALUE 0x42906 _REC_VAL_20_u1 1389. _CNV_A_R_LINEAR_____18_CM 0. 1389. FORMAT "%4.0" /end CHARACTERISTIC
/begin CHARACTERISTIC C_N_VS_MIN_DIAG "Engine speed condition - vehicle speed diagnosis" VALUE 0x42ed8 _REC_VAL_20_u2 8160. _CNV_A_R_LINEAR_____17_CM 0. 8160. FORMAT "%4.0" /end CHARACTERISTIC
/begin CHARACTERISTIC C_T_VS_MIN_DIAG "Time condition - vehicle speed diagnosis" VALUE 0x4304c _REC_VAL_20_u2 65535. _CNV_A_R_LINEAR_____47_CM 0. 65535. FORMAT "%5.0" /end CHARACTERISTIC
/begin MEASUREMENT T_VS_DIAG "Time counter for error detection" UWORD _CNV_A_R_LINEAR_____47_CM 1 100. 0. 65535. ECU_ADDRESS 0x3fe2f6 FORMAT "%5.0" /end MEASUREMENT
/begin MEASUREMENT T_VS_END_DIAG "Time counter for end of diagnosis" UWORD _CNV_A_R_LINEAR_____47_CM 1 100. 0. 65535. ECU_ADDRESS 0x3fe2f8 FORMAT "%5.0" /end MEASUREMENT
/begin CHARACTERISTIC TOG_TK_MAX "" VALUE 0x5b7f4 _REC_VAL_20_u2 6553.5 _CNV_R_R_t_q0p1ms_505_CM 0. 6553.5 FORMAT "%8.3" /end CHARACTERISTIC
/begin CHARACTERISTIC TOG_TK_MIN "" VALUE 0x5b7f6 _REC_VAL_20_u2 6553.5 _CNV_R_R_t_q0p1ms_505_CM 0. 6553.5 FORMAT "%8.3" /end CHARACTERISTIC
/begin CHARACTERISTIC TOG_TR_MAX "" VALUE 0x5b7f8 _REC_VAL_20_u2 6553.5 _CNV_R_R_t_q0p1ms_505_CM 0. 6553.5 FORMAT "%8.3" /end CHARACTERISTIC
/begin CHARACTERISTIC TOG_TR_MIN "" VALUE 0x5b7fa _REC_VAL_20_u2 6553.5 _CNV_R_R_t_q0p1ms_505_CM 0. 6553.5 FORMAT "%8.3" /end CHARACTERISTIC
/begin CHARACTERISTIC TOG_TV_MAX "" VALUE 0x5b7fc _REC_VAL_20_u2 6553.5 _CNV_R_R_t_q0p1ms_505_CM 0. 6553.5 FORMAT "%8.3" /end CHARACTERISTIC
/begin CHARACTERISTIC TOG_TV_MIN "" VALUE 0x5b7fe _REC_VAL_20_u2 6553.5 _CNV_R_R_t_q0p1ms_505_CM 0. 6553.5 FORMAT "%8.3" /end CHARACTERISTIC
/begin CHARACTERISTIC TOG_VERS "" VALUE 0x5b801 _REC_VAL_20_u1 2. _CNV_A_R_LINEAR_____12_CM 0. 2. FORMAT "%5.3" /end CHARACTERISTIC
/begin CHARACTERISTIC OZKMVL "Toleranzwert für gefahrene Kilometer nach Ölverlustmeldung" VALUE 0x5a000 _REC_VAL_20_u2 65535. _CNV_R_R_igen_ub_q1_483_CM 0. 65535. FORMAT "%8.4" /end CHARACTERISTIC
/begin CHARACTERISTIC OZLANGLIM1 "Schwelle für langen Mittelwert Ölniveau (Vebrauchswarnung)" VALUE 0x5a002 _REC_VAL_20_u1 74.707031 _CNV_R_R_niv_ub_b75_550_CM 0. 74.707031 FORMAT "%8.4" /end CHARACTERISTIC
/begin CHARACTERISTIC OZLANGLIM2 "Schwelle für langen Mittelwert Ölniveau (Verlustwarnung)" VALUE 0x5a003 _REC_VAL_20_u1 74.707031 _CNV_R_R_niv_ub_b75_550_CM 0. 74.707031 FORMAT "%8.4" /end CHARACTERISTIC
/begin CHARACTERISTIC OZLIM1HEAL "Schwelle für Rücknahme der Ölniveauwarnung Verbrauch" VALUE 0x5a004 _REC_VAL_20_u1 74.707031 _CNV_R_R_niv_ub_b75_550_CM 0. 74.707031 FORMAT "%8.4" /end CHARACTERISTIC
/begin CHARACTERISTIC OZLIM2HEAL "Schwelle für Rücknahme der Ölniveauwarnung Verlust" VALUE 0x5a005 _REC_VAL_20_u1 74.707031 _CNV_R_R_niv_ub_b75_550_CM 0. 74.707031 FORMAT "%8.4" /end CHARACTERISTIC
/begin CHARACTERISTIC OZORLIM2 "Schwelle für Orientierungswert Ölniveau (Verlustwarnung)" VALUE 0x5a006 _REC_VAL_20_u1 74.707031 _CNV_R_R_niv_ub_b75_550_CM 0. 74.707031 FORMAT "%8.4" /end CHARACTERISTIC
/begin CHARACTERISTIC OZVORLIM1 "Schwelle für vorgezogenen Mittelwert Ölniveau (Vebrauchswarnung)" VALUE 0x5a007 _REC_VAL_20_u1 74.707031 _CNV_R_R_niv_ub_b75_550_CM 0. 74.707031 FORMAT "%8.4" /end CHARACTERISTIC
/begin CHARACTERISTIC OZVORLIM2 "Schwelle für vorgezogenen Mittelwert Ölniveau (Verlustwarnung)" VALUE 0x5a008 _REC_VAL_20_u1 74.707031 _CNV_R_R_niv_ub_b75_550_CM 0. 74.707031 FORMAT "%8.4" /end CHARACTERISTIC
/begin MEASUREMENT OZBGBITS1_1S "???" UBYTE _CNV_A_R_LINEAR_____10_CM 1 100. 0. 255. ECU_ADDRESS 0x3fb1f7 FORMAT "%3.0" /end MEASUREMENT
/begin MEASUREMENT B_MOL_VB "Bedingung Ölverbrauchswarnung" UBYTE _CNV_A_R_LINEAR_____10_CM 1 100. 0. 255. ECU_ADDRESS 0x3fb1f7 FORMAT "%3.0" BIT_MASK 0x40 /end MEASUREMENT
/begin MEASUREMENT B_BOSMSGC "Bedingung für Absetzen einer BOS-Meldung" UBYTE _CNV_A_R_LINEAR_____10_CM 1 100. 0. 255. ECU_ADDRESS 0x3fb1f7 FORMAT "%3.0" BIT_MASK 0x10 /end MEASUREMENT
/begin MEASUREMENT B_MOL_VL "Bedingung Ölverlustwarnung" UBYTE _CNV_A_R_LINEAR_____10_CM 1 100. 0. 255. ECU_ADDRESS 0x3fb1f7 FORMAT "%3.0" BIT_MASK 0x20 /end MEASUREMENT
/begin MEASUREMENT B_OELTEMP "Bedingung für CAN-Ausgabe der Öltemperatur" UBYTE _CNV_A_R_LINEAR_____10_CM 1 100. 0. 255. ECU_ADDRESS 0x3fb1f7 FORMAT "%3.0" BIT_MASK 0x8 /end MEASUREMENT
/begin MEASUREMENT B_MOL_SF "Bedingung Checkcontrol Sensorfehler" UBYTE _CNV_A_R_LINEAR_____10_CM 1 100. 0. 255. ECU_ADDRESS 0x3fb1f7 FORMAT "%3.0" BIT_MASK 0x80 /end MEASUREMENT
/begin MEASUREMENT OZBGBITS3_1S "???" UBYTE _CNV_A_R_LINEAR_____10_CM 1 100. 0. 255. ECU_ADDRESS 0x3fb31f FORMAT "%3.0" /end MEASUREMENT
/begin MEASUREMENT B_OZKL15 "Merker für Kl.15 EIN zum Senden der BOS-Meldung" UBYTE _CNV_A_R_LINEAR_____10_CM 1 100. 0. 255. ECU_ADDRESS 0x3fb31f FORMAT "%3.0" BIT_MASK 0x80 /end MEASUREMENT
/begin MEASUREMENT BOS01_W "Ausgabewert Restlaufstrecke Motoröl" SWORD _CNV_R_R_km_sw_q10_551_CM 1 100. -327680. 327670. ECU_ADDRESS 0x3fb318 FORMAT "%8.4" /end MEASUREMENT
/begin MEASUREMENT BOSSTATE "Einheit der BOS-Info (km)" UBYTE _CNV_R_R_igen_ub_q1_483_CM 1 100. 0. 255. ECU_ADDRESS 0x3fb1f4 FORMAT "%8.4" /end MEASUREMENT
/begin MEASUREMENT IDFBOSMG_W "Kennung für BOS-Meldung = Ölservice-Info" UWORD _CNV_R_R_igen_ub_q1_483_CM 1 100. 0. 65535. ECU_ADDRESS 0x3fb1ec FORMAT "%8.4" /end MEASUREMENT
/begin MEASUREMENT IDFBOSMGT "Kennung für BOS-Meldung vom Tester" UBYTE _CNV_R_R_igen_ub_q1_483_CM 1 100. 0. 255. ECU_ADDRESS 0x3fb1f6 FORMAT "%8.4" /end MEASUREMENT
/begin MEASUREMENT IDBOSMSG "Kennung für BOS-Meldung vom Kombi" UBYTE _CNV_R_R_igen_ub_q1_483_CM 1 100. 0. 255. ECU_ADDRESS 0x3fb1f5 FORMAT "%8.4" /end MEASUREMENT
/begin MEASUREMENT TOELOZ "Ausgabe Öltemperatur" UBYTE _CNV_R_R_temp_ub_q1_552_CM 1 100. -48. 207. ECU_ADDRESS 0x3fb1f9 FORMAT "%8.4" /end MEASUREMENT
/begin MEASUREMENT TOL "Ausgabewert Öltemperatur in Standardquantisierung" UBYTE _CNV_R_R_temp_uw_q0_481_CM 1 100. -48. 143.25 ECU_ADDRESS 0x3fb1fa FORMAT "%8.4" /end MEASUREMENT
/begin MEASUREMENT ZRBOSMLD "anzuzeigender Zähler für durchgeführten Ölservice" UBYTE _CNV_R_R_igen_ub_q1_483_CM 1 100. 0. 255. ECU_ADDRESS 0x3fb321 FORMAT "%8.4" /end MEASUREMENT
/begin MEASUREMENT OZKMSTVL "Kilometerstand wenn Ölverlust detektiert wurde und eine größere Wegstrecke als OZKMVL zurückgelegt wurde" UWORD _CNV_R_R_nmot_ub_q1_538_CM 1 100. 0. 655350. ECU_ADDRESS 0x3fb31a FORMAT "%8.4" /end MEASUREMENT
/begin MEASUREMENT OZVLDISTC "Zähler für Anzahl der Fälle, in denen mehr als OZKMVL nach detektiertem Ölverlust gefahren wurde" UBYTE _CNV_R_R_igen_ub_q1_483_CM 1 100. 0. 255. ECU_ADDRESS 0x3fb320 FORMAT "%8.4" /end MEASUREMENT
/begin MEASUREMENT OZVLDIST "gefahrene Wegstrecke seit Detektion Ölverlust" UWORD _CNV_R_R_nmot_ub_q1_538_CM 1 100. 0. 655350. ECU_ADDRESS 0x3fb31c FORMAT "%8.4" /end MEASUREMENT
/begin MEASUREMENT OZTEMPF "" UBYTE _CNV_R_R_temp_ub_q1_552_CM 1 100. -48. 207. ECU_ADDRESS 0x3fb294 FORMAT "%8.4" /end MEASUREMENT
/begin CHARACTERISTIC OZDELAY "Zeit für Einschaltverzögerung" VALUE 0x5a020 _REC_VAL_20_u2 65535. _CNV_R_R_igen_ub_q1_483_CM 0. 65535. FORMAT "%8.4" /end CHARACTERISTIC
/begin CHARACTERISTIC OZDIAGSPG "Spannung, unterhalb der die Diagnose ausgeblendet wird" VALUE 0x5a026 _REC_VAL_20_u1 24.021 _CNV_A_R_spg_ubatt_479_CM 0. 24.021 FORMAT "%8.4" /end CHARACTERISTIC
/begin CHARACTERISTIC OZERRD "Entprellzeit Sensor- und Kommunikationsfehler" VALUE 0x5a022 _REC_VAL_20_u2 65535. _CNV_R_R_igen_ub_q1_483_CM 0. 65535. FORMAT "%8.4" /end CHARACTERISTIC
/begin CHARACTERISTIC OZHEAL "Entprellzeit Fehler-Healing" VALUE 0x5a024 _REC_VAL_20_u2 65535. _CNV_R_R_igen_ub_q1_483_CM 0. 65535. FORMAT "%8.4" /end CHARACTERISTIC
/begin CHARACTERISTIC OZNIVKL "Skalierungskennlinie Niveau" CURVE 0x5a014 _REC_CUR_52_u1_u1 74.707031 _CNV_R_R_niv_ub_b75_550_CM 0. 74.707031 FORMAT "%8.4"
 /begin AXIS_DESCR STD_AXIS oznivt _CNV_R_R_igen_ub_q1_483_CM 2 0. 255. FORMAT "%8.4" /end AXIS_DESCR
/end CHARACTERISTIC
/begin CHARACTERISTIC OZPERMKL "Skalierungskennlinie Permittivität" CURVE 0x5a00a _REC_CUR_52_u2_u2 5.9999084 _CNV_R_R_perm_uw_b6_553_CM 0. 5.9999084 FORMAT "%8.4"
 /begin AXIS_DESCR STD_AXIS ozpermt _CNV_R_R_igen_ub_q1_483_CM 2 0. 1024. FORMAT "%8.4" /end AXIS_DESCR
/end CHARACTERISTIC
/begin CHARACTERISTIC OZTEMPKL "Skalierungskennlinie Temperatur" CURVE 0x5a019 _REC_CUR_52_u1_u1 255. _CNV_R_R_temp_ub_q1_552_CM -48. 207. FORMAT "%8.4"
 /begin AXIS_DESCR STD_AXIS oztempt _CNV_R_R_igen_ub_q1_483_CM 2 0. 255. FORMAT "%8.4" /end AXIS_DESCR
/end CHARACTERISTIC
/begin MEASUREMENT OZGGBITS2_1S "???" UBYTE _CNV_A_R_LINEAR_____10_CM 1 100. 0. 255. ECU_ADDRESS 0x3fb203 FORMAT "%3.0" /end MEASUREMENT
/begin MEASUREMENT B_NIVERRB "Niveaufehler in Fehlerspeicher eintragen" UBYTE _CNV_A_R_LINEAR_____10_CM 1 100. 0. 255. ECU_ADDRESS 0x3fb203 FORMAT "%3.0" BIT_MASK 0x40 /end MEASUREMENT
/begin MEASUREMENT B_OZSHEAL "Ausgabe Fehlerspeicher löschen" UBYTE _CNV_A_R_LINEAR_____10_CM 1 100. 0. 255. ECU_ADDRESS 0x3fb203 FORMAT "%3.0" BIT_MASK 0x20 /end MEASUREMENT
/begin MEASUREMENT B_PERMERRB "Permittivitätsfehler in Fehlerspeicher eintragen" UBYTE _CNV_A_R_LINEAR_____10_CM 1 100. 0. 255. ECU_ADDRESS 0x3fb203 FORMAT "%3.0" BIT_MASK 0x8 /end MEASUREMENT
/begin MEASUREMENT B_SIGB "BSD-Signalfehler in Fehlerspeicher eintragen" UBYTE _CNV_A_R_LINEAR_____10_CM 1 100. 0. 255. ECU_ADDRESS 0x3fb203 FORMAT "%3.0" BIT_MASK 0x4 /end MEASUREMENT
/begin MEASUREMENT B_TEMPERRB "Temperaturfehler in Fehlerspeicher eintragen" UBYTE _CNV_A_R_LINEAR_____10_CM 1 100. 0. 255. ECU_ADDRESS 0x3fb203 FORMAT "%3.0" BIT_MASK 0x1 /end MEASUREMENT
/begin MEASUREMENT OZGGBITS3_1S "???" UBYTE _CNV_A_R_LINEAR_____10_CM 1 100. 0. 255. ECU_ADDRESS 0x3fb204 FORMAT "%3.0" /end MEASUREMENT
/begin MEASUREMENT B_SVCNTCHG "Bedingung für über Tester geänderten Servicezähler" UBYTE _CNV_A_R_LINEAR_____10_CM 1 100. 0. 255. ECU_ADDRESS 0x3fb204 FORMAT "%3.0" BIT_MASK 0x80 /end MEASUREMENT
/begin MEASUREMENT B_OZWERTOK "Bedingung aller Werte vom Ölsensor in Ordnung" UBYTE _CNV_A_R_LINEAR_____10_CM 1 100. 0. 255. ECU_ADDRESS 0x3fb204 FORMAT "%3.0" BIT_MASK 0x40 /end MEASUREMENT
/begin MEASUREMENT B_OELWECH "Bedingung Ölwechsel erfolgt" UBYTE _CNV_A_R_LINEAR_____10_CM 1 100. 0. 255. ECU_ADDRESS 0x3fb204 FORMAT "%3.0" BIT_MASK 0x20 /end MEASUREMENT
/begin MEASUREMENT B_OZDELAY "Bedingung, dass Wartezeit nach Einschalten abgelaufen" UBYTE _CNV_A_R_LINEAR_____10_CM 1 100. 0. 255. ECU_ADDRESS 0x3fb204 FORMAT "%3.0" BIT_MASK 0x10 /end MEASUREMENT
/begin MEASUREMENT B_OZNIV "Bedingung Niveausignal in Ordnung" UBYTE _CNV_A_R_LINEAR_____10_CM 1 100. 0. 255. ECU_ADDRESS 0x3fb204 FORMAT "%3.0" BIT_MASK 0x8 /end MEASUREMENT
/begin MEASUREMENT B_OZPERM "Bedingung Permittivitätssignal in Ordnung" UBYTE _CNV_A_R_LINEAR_____10_CM 1 100. 0. 255. ECU_ADDRESS 0x3fb204 FORMAT "%3.0" BIT_MASK 0x4 /end MEASUREMENT
/begin MEASUREMENT B_OZTEMIC "Bedingung Ölzustandssensor von Temic ist verbaut" UBYTE _CNV_A_R_LINEAR_____10_CM 1 100. 0. 255. ECU_ADDRESS 0x3fb204 FORMAT "%3.0" BIT_MASK 0x2 /end MEASUREMENT
/begin MEASUREMENT B_OZTEMP "Bedingung Temperatursignal in Ordnung" UBYTE _CNV_A_R_LINEAR_____10_CM 1 100. 0. 255. ECU_ADDRESS 0x3fb204 FORMAT "%3.0" BIT_MASK 0x1 /end MEASUREMENT
/begin MEASUREMENT OZGGBITS4_1S "???" UBYTE _CNV_A_R_LINEAR_____10_CM 1 100. 0. 255. ECU_ADDRESS 0x3fb352 FORMAT "%3.0" /end MEASUREMENT
/begin MEASUREMENT B_DMEWECH "Bedingung für getauschte DME zur Aktualisierung der BOS-Werte" UBYTE _CNV_A_R_LINEAR_____10_CM 1 100. 0. 255. ECU_ADDRESS 0x3fb352 FORMAT "%3.0" BIT_MASK 0x80 /end MEASUREMENT
/begin MEASUREMENT B_DMEINI "Bedingung für neue noch nicht initialisierte DME" UBYTE _CNV_A_R_LINEAR_____10_CM 1 100. 0. 255. ECU_ADDRESS 0x3fb352 FORMAT "%3.0" BIT_MASK 0x40 /end MEASUREMENT
/begin MEASUREMENT BOSBTVFBK "Rest-Verfügbarkeit Motoröl in Prozent" UBYTE _CNV_R_R_igen_ub_q1_483_CM 1 100. 0. 255. ECU_ADDRESS 0x3fb31e FORMAT "%8.4" /end MEASUREMENT
/begin MEASUREMENT IDFBOSRTT "Kennung vom Tester für Ölservice" UBYTE _CNV_R_R_igen_ub_q1_483_CM 1 100. 0. 255. ECU_ADDRESS 0x3fb201 FORMAT "%8.4" /end MEASUREMENT
/begin MEASUREMENT OZNIV "" UBYTE _CNV_R_R_niv_ub_b75_550_CM 1 100. 0. 74.707031 ECU_ADDRESS 0x3fb205 FORMAT "%8.4" /end MEASUREMENT
/begin MEASUREMENT OZPERM_W "" UWORD _CNV_R_R_perm_uw_b6_553_CM 1 100. 0. 5.9999084 ECU_ADDRESS 0x3fb1fe FORMAT "%8.4" /end MEASUREMENT
/begin MEASUREMENT OZSVCNTCHG "geänderter Servicezähler" UBYTE _CNV_R_R_igen_ub_q1_483_CM 1 100. 0. 255. ECU_ADDRESS 0x3fb207 FORMAT "%8.4" /end MEASUREMENT
/begin MEASUREMENT OZTEMP "Öltemperatur ungefiltert" UBYTE _CNV_R_R_temp_ub_q1_552_CM 1 100. -48. 207. ECU_ADDRESS 0x3fb208 FORMAT "%8.4" /end MEASUREMENT
/begin MEASUREMENT ZRBOSRT "Servicezählerwert vom Tester" UBYTE _CNV_R_R_igen_ub_q1_483_CM 1 100. 0. 255. ECU_ADDRESS 0x3fb20a FORMAT "%8.4" /end MEASUREMENT
/begin MEASUREMENT OZVFBDMEW "" UBYTE _CNV_R_R_igen_ub_q1_483_CM 1 100. 0. 255. ECU_ADDRESS 0x3fb358 FORMAT "%8.4" /end MEASUREMENT
/begin MEASUREMENT OZLOWPERM0_0_ "Register für Er nach Ölwechsel" UWORD _CNV_R_R_perm_uw_b6_553_CM 1 100. 0. 5.9999084 ECU_ADDRESS 0x3fb33a FORMAT "%8.4" /end MEASUREMENT
/begin MEASUREMENT OZLOWPERM0_1_ "Register für Er nach Ölwechsel" UWORD _CNV_R_R_perm_uw_b6_553_CM 1 100. 0. 5.9999084 ECU_ADDRESS 0x3fb33c FORMAT "%8.4" /end MEASUREMENT
/begin MEASUREMENT OZLOWPERM0_2_ "Register für Er nach Ölwechsel" UWORD _CNV_R_R_perm_uw_b6_553_CM 1 100. 0. 5.9999084 ECU_ADDRESS 0x3fb33e FORMAT "%8.4" /end MEASUREMENT
/begin MEASUREMENT OZLOWPERM0_3_ "Register für Er nach Ölwechsel" UWORD _CNV_R_R_perm_uw_b6_553_CM 1 100. 0. 5.9999084 ECU_ADDRESS 0x3fb340 FORMAT "%8.4" /end MEASUREMENT
/begin MEASUREMENT OZLOWPERM0_4_ "Register für Er nach Ölwechsel" UWORD _CNV_R_R_perm_uw_b6_553_CM 1 100. 0. 5.9999084 ECU_ADDRESS 0x3fb342 FORMAT "%8.4" /end MEASUREMENT
/begin MEASUREMENT OZLOWPERM0_5_ "Register für Er nach Ölwechsel" UWORD _CNV_R_R_perm_uw_b6_553_CM 1 100. 0. 5.9999084 ECU_ADDRESS 0x3fb344 FORMAT "%8.4" /end MEASUREMENT
/begin MEASUREMENT OZLOWPEREX_0_ "Register für extrapoliertes Er beim Ölwechsel" UWORD _CNV_R_R_perm_uw_b6_553_CM 1 100. 0. 5.9999084 ECU_ADDRESS 0x3fb32e FORMAT "%8.4" /end MEASUREMENT
/begin MEASUREMENT OZLOWPEREX_1_ "Register für extrapoliertes Er beim Ölwechsel" UWORD _CNV_R_R_perm_uw_b6_553_CM 1 100. 0. 5.9999084 ECU_ADDRESS 0x3fb330 FORMAT "%8.4" /end MEASUREMENT
/begin MEASUREMENT OZLOWPEREX_2_ "Register für extrapoliertes Er beim Ölwechsel" UWORD _CNV_R_R_perm_uw_b6_553_CM 1 100. 0. 5.9999084 ECU_ADDRESS 0x3fb332 FORMAT "%8.4" /end MEASUREMENT
/begin MEASUREMENT OZLOWPEREX_3_ "Register für extrapoliertes Er beim Ölwechsel" UWORD _CNV_R_R_perm_uw_b6_553_CM 1 100. 0. 5.9999084 ECU_ADDRESS 0x3fb334 FORMAT "%8.4" /end MEASUREMENT
/begin MEASUREMENT OZLOWPEREX_4_ "Register für extrapoliertes Er beim Ölwechsel" UWORD _CNV_R_R_perm_uw_b6_553_CM 1 100. 0. 5.9999084 ECU_ADDRESS 0x3fb336 FORMAT "%8.4" /end MEASUREMENT
/begin MEASUREMENT OZLOWPEREX_5_ "Register für extrapoliertes Er beim Ölwechsel" UWORD _CNV_R_R_perm_uw_b6_553_CM 1 100. 0. 5.9999084 ECU_ADDRESS 0x3fb338 FORMAT "%8.4" /end MEASUREMENT
/begin MEASUREMENT OZLOWKM_0_ "Register für KM-Stand beim Ölwechsel" UWORD _CNV_R_R_km_sw_q10_551_CM 1 100. 0. 655350. ECU_ADDRESS 0x3fb322 FORMAT "%8.4" /end MEASUREMENT
/begin MEASUREMENT OZLOWKM_1_ "Register für KM-Stand beim Ölwechsel" UWORD _CNV_R_R_km_sw_q10_551_CM 1 100. 0. 655350. ECU_ADDRESS 0x3fb324 FORMAT "%8.4" /end MEASUREMENT
/begin MEASUREMENT OZLOWKM_2_ "Register für KM-Stand beim Ölwechsel" UWORD _CNV_R_R_km_sw_q10_551_CM 1 100. 0. 655350. ECU_ADDRESS 0x3fb326 FORMAT "%8.4" /end MEASUREMENT
/begin MEASUREMENT OZLOWKM_3_ "Register für KM-Stand beim Ölwechsel" UWORD _CNV_R_R_km_sw_q10_551_CM 1 100. 0. 655350. ECU_ADDRESS 0x3fb328 FORMAT "%8.4" /end MEASUREMENT
/begin MEASUREMENT OZLOWKM_4_ "Register für KM-Stand beim Ölwechsel" UWORD _CNV_R_R_km_sw_q10_551_CM 1 100. 0. 655350. ECU_ADDRESS 0x3fb32a FORMAT "%8.4" /end MEASUREMENT
/begin MEASUREMENT OZLOWKM_5_ "Register für KM-Stand beim Ölwechsel" UWORD _CNV_R_R_km_sw_q10_551_CM 1 100. 0. 655350. ECU_ADDRESS 0x3fb32c FORMAT "%8.4" /end MEASUREMENT
/begin MEASUREMENT OZLOWRWANZ_0_ "Register für Restweganzeige beim Ölwechsel" SWORD _CNV_R_R_km_sw_q10_551_CM 1 100. -327680. 327670. ECU_ADDRESS 0x3fb346 FORMAT "%8.4" /end MEASUREMENT
/begin MEASUREMENT OZLOWRWANZ_1_ "Register für Restweganzeige beim Ölwechsel" SWORD _CNV_R_R_km_sw_q10_551_CM 1 100. -327680. 327670. ECU_ADDRESS 0x3fb348 FORMAT "%8.4" /end MEASUREMENT
/begin MEASUREMENT OZLOWRWANZ_2_ "Register für Restweganzeige beim Ölwechsel" SWORD _CNV_R_R_km_sw_q10_551_CM 1 100. -327680. 327670. ECU_ADDRESS 0x3fb34a FORMAT "%8.4" /end MEASUREMENT
/begin MEASUREMENT OZLOWRWANZ_3_ "Register für Restweganzeige beim Ölwechsel" SWORD _CNV_R_R_km_sw_q10_551_CM 1 100. -327680. 327670. ECU_ADDRESS 0x3fb34c FORMAT "%8.4" /end MEASUREMENT
/begin MEASUREMENT OZLOWRWANZ_4_ "Register für Restweganzeige beim Ölwechsel" SWORD _CNV_R_R_km_sw_q10_551_CM 1 100. -327680. 327670. ECU_ADDRESS 0x3fb34e FORMAT "%8.4" /end MEASUREMENT
/begin MEASUREMENT OZLOWRWANZ_5_ "Register für Restweganzeige beim Ölwechsel" SWORD _CNV_R_R_km_sw_q10_551_CM 1 100. -327680. 327670. ECU_ADDRESS 0x3fb350 FORMAT "%8.4" /end MEASUREMENT
/begin MEASUREMENT OZLOWCNT "Zähler zur Sicherung der Ölwechselinformationen" UBYTE _CNV_R_R_igen_ub_q1_483_CM 1 100. 0. 255. ECU_ADDRESS 0x3fb353 FORMAT "%8.4" /end MEASUREMENT
/begin MEASUREMENT OZPERMERRC "Fehlerzähler Permittivität" UBYTE _CNV_R_R_igen_ub_q1_483_CM 1 100. 0. 255. ECU_ADDRESS 0x3fb355 FORMAT "%8.4" /end MEASUREMENT
/begin MEASUREMENT OZTEMPERRC "Fehlerzähler Temperatur" UBYTE _CNV_R_R_igen_ub_q1_483_CM 1 100. 0. 255. ECU_ADDRESS 0x3fb357 FORMAT "%8.4" /end MEASUREMENT
/begin MEASUREMENT OZNIVERRC "Fehlerzähler Niveau" UBYTE _CNV_R_R_igen_ub_q1_483_CM 1 100. 0. 255. ECU_ADDRESS 0x3fb354 FORMAT "%8.4" /end MEASUREMENT
/begin MEASUREMENT OZSIGERRC "Fehlerzähler Kommunikation" UBYTE _CNV_R_R_igen_ub_q1_483_CM 1 100. 0. 255. ECU_ADDRESS 0x3fb356 FORMAT "%8.4" /end MEASUREMENT
/begin CHARACTERISTIC OZMWK "Anzahl der Messwerte für Kurzzeit-Mittelwert Niveau" VALUE 0x5a048 _REC_VAL_20_u2 65534. _CNV_R_R_igen_ub_q1_483_CM 1. 65535. FORMAT "%8.4" /end CHARACTERISTIC
/begin CHARACTERISTIC OZMWL "Anzahl der Messwerte für Langzeit-Mittelwert Niveau" VALUE 0x5a049 _REC_VAL_20_u2 65534. _CNV_R_R_igen_ub_q1_483_CM 1. 65535. FORMAT "%8.4" /end CHARACTERISTIC
/begin CHARACTERISTIC OZMWOR "Anzahl der Messwerte für Orientierungsmessung" VALUE 0x5a04a _REC_VAL_20_u2 65534. _CNV_R_R_igen_ub_q1_483_CM 1. 65535. FORMAT "%8.4" /end CHARACTERISTIC
/begin CHARACTERISTIC OZMWV "Anzahl der Messwerte für vorgezogenen Mittelwert Niveau" VALUE 0x5a04b _REC_VAL_20_u2 65534. _CNV_R_R_igen_ub_q1_483_CM 1. 65535. FORMAT "%8.4" /end CHARACTERISTIC
/begin CHARACTERISTIC OZNFCNT "Anzahl Werte für Nachfüllerkennung" VALUE 0x5a04c _REC_VAL_20_S8 1. _CNV_A_R_LINEAR_____12_CM -1. 0. /end CHARACTERISTIC
/begin CHARACTERISTIC OZNFTMPMAX "obere Temperaturgrenze für Nachfüllerkennung" VALUE 0x5a04d _REC_VAL_20_u1 255. _CNV_R_R_temp_ub_q1_552_CM -48. 207. FORMAT "%8.4" /end CHARACTERISTIC
/begin CHARACTERISTIC OZNFTMPMIN "untere Temperaturgrenze für Nachfüllerkennung" VALUE 0x5a04e _REC_VAL_20_u1 255. _CNV_R_R_temp_ub_q1_552_CM -48. 207. FORMAT "%8.4" /end CHARACTERISTIC
/begin CHARACTERISTIC OZNIVMMLIT "Umrechnungsfaktor für Ölniveau von mm in Liter" VALUE 0x5a04f _REC_VAL_20_u1 2.55 _CNV_R_R_lf_ub_554_CM 0. 2.55 FORMAT "%8.4" /end CHARACTERISTIC
/begin CHARACTERISTIC OZNIVNFM05 "Niveauschwelle für Erkennung 0,5 Liter nachgefüllt" VALUE 0x5a050 _REC_VAL_20_u1 255. _CNV_R_R_igen_ub_q1_483_CM 0. 255. FORMAT "%8.4" /end CHARACTERISTIC
/begin CHARACTERISTIC OZNIVNFM10 "Niveauschwelle für Erkennung 1,0 Liter nachgefüllt" VALUE 0x5a051 _REC_VAL_20_u1 255. _CNV_R_R_igen_ub_q1_483_CM 0. 255. FORMAT "%8.4" /end CHARACTERISTIC
/begin CHARACTERISTIC OZNMOTMAX "obere Drehzahlgrenze für drehzahlkorrigierten Niveaumittelwert" VALUE 0x5a052 _REC_VAL_20_u1 10200. _CNV_A_R_nmot_ub_q4_537_CM 0. 10200. FORMAT "%8.4" /end CHARACTERISTIC
/begin CHARACTERISTIC OZNMOTMIN "untere Drehzahlgrenze für drehzahlkorrigierten Niveaumittelwert" VALUE 0x5a053 _REC_VAL_20_u1 10200. _CNV_A_R_nmot_ub_q4_537_CM 0. 10200. FORMAT "%8.4" /end CHARACTERISTIC
/begin CHARACTERISTIC OZTEMPBW "Temperaturschwelle Öltemperatur Motor betriebswarm" VALUE 0x5a054 _REC_VAL_20_u1 229.69922 _CNV_R_R_temp_ub_q1_555_CM -55.2 174.49922 FORMAT "%8.4" /end CHARACTERISTIC
/begin CHARACTERISTIC OZTEMPORR "Temperaturschwelle für Orientierungsmessung" VALUE 0x5a055 _REC_VAL_20_u1 229.69922 _CNV_R_R_temp_ub_q1_555_CM -55.2 174.49922 FORMAT "%8.4" /end CHARACTERISTIC
/begin CHARACTERISTIC OZNMNIVKL "Kennlinie für Drehzahlkorrektur des Niveaus" CURVE 0x5a027 _REC_CUR_52_UBYTE_s1_u1 74.707031 _CNV_R_R_niv_sb_b37_556_CM -37.5 37.207031 FORMAT "%8.4"
 /begin AXIS_DESCR STD_AXIS oznmotmw _CNV_A_R_nmot_ub_q4_537_CM 16 0. 10200. FORMAT "%8.4" /end AXIS_DESCR
/end CHARACTERISTIC
/begin MEASUREMENT OZNIVBITS3_1S "???" UBYTE _CNV_A_R_LINEAR_____10_CM 1 100. 0. 255. ECU_ADDRESS 0x3fb220 FORMAT "%3.0" /end MEASUREMENT
/begin MEASUREMENT B_OZOR "Bedingung Orientierungsmessung erfolgt" UBYTE _CNV_A_R_LINEAR_____10_CM 1 100. 0. 255. ECU_ADDRESS 0x3fb220 FORMAT "%3.0" BIT_MASK 0x80 /end MEASUREMENT
/begin MEASUREMENT B_OZVORMW "Bedingung vorgezogener Mittelwert berechnet" UBYTE _CNV_A_R_LINEAR_____10_CM 1 100. 0. 255. ECU_ADDRESS 0x3fb220 FORMAT "%3.0" BIT_MASK 0x40 /end MEASUREMENT
/begin MEASUREMENT OZNIVBITS2_1S "???" UBYTE _CNV_A_R_LINEAR_____10_CM 1 100. 0. 255. ECU_ADDRESS 0x3fb35a FORMAT "%3.0" /end MEASUREMENT
/begin MEASUREMENT B_OZLW1 "Bedingung mindestens ein gültiger Langzeitmittelwert war vorhanden" UBYTE _CNV_A_R_LINEAR_____10_CM 1 100. 0. 255. ECU_ADDRESS 0x3fb35a FORMAT "%3.0" BIT_MASK 0x80 /end MEASUREMENT
/begin MEASUREMENT OZNIVBITS4_1S "???" UBYTE _CNV_A_R_LINEAR_____10_CM 1 100. 0. 255. ECU_ADDRESS 0x3fb35b FORMAT "%3.0" /end MEASUREMENT
/begin MEASUREMENT B_OZLANGMW "Bedingung Langzeit-Mittelwert berechnet" UBYTE _CNV_A_R_LINEAR_____10_CM 1 100. 0. 255. ECU_ADDRESS 0x3fb35b FORMAT "%3.0" BIT_MASK 0x80 /end MEASUREMENT
/begin MEASUREMENT OZKRZOR "kurzzeitiger Mittelwert Orientierungsmessung Niveau" UBYTE _CNV_R_R_niv_ub_b75_550_CM 1 100. 0. 74.707031 ECU_ADDRESS 0x3fb21d FORMAT "%8.4" /end MEASUREMENT
/begin MEASUREMENT OZLANGMW "Langzeitmittelwert berechnet" UBYTE _CNV_R_R_niv_ub_b75_550_CM 1 100. 0. 74.707031 ECU_ADDRESS 0x3fb359 FORMAT "%8.4" /end MEASUREMENT
/begin MEASUREMENT OZNIVNFM "Nachfüllmenge" UBYTE _CNV_R_R_nivmmxl_ub_557_CM 1 100. 0. 7.96875 ECU_ADDRESS 0x3fb224 FORMAT "%8.4" /end MEASUREMENT
/begin MEASUREMENT OZVORMW "vorgezogener Mittelwert Niveau" UBYTE _CNV_R_R_niv_ub_b75_550_CM 1 100. 0. 74.707031 ECU_ADDRESS 0x3fb226 FORMAT "%8.4" /end MEASUREMENT
/begin CHARACTERISTIC OZOELKMPL "gefahrene Strecke nach Ölwechsel, ab wo Er-Auswertung erfolgt" VALUE 0x5a064 _REC_VAL_20_S8 6442450943. _CNV_A_R_LINEAR_____12_CM -2147483648. 4294967295. /end CHARACTERISTIC
/begin CHARACTERISTIC OZPERMCOK5 "minimale Anzahl der Messwerte für einen gültigen Permittivitätswert" VALUE 0x5a058 _REC_VAL_20_S8 1. _CNV_A_R_LINEAR_____12_CM -1. 0. /end CHARACTERISTIC
/begin CHARACTERISTIC OZPERMMIN "minimaler Permittivitätswert für gültige Auswertung" VALUE 0x5a05a _REC_VAL_20_S8 6442450943. _CNV_A_R_LINEAR_____12_CM -2147483648. 4294967295. /end CHARACTERISTIC
/begin CHARACTERISTIC OZPERMMNIV "Niveauschwelle für gültige Permittivitätsauswertung" VALUE 0x5a065 _REC_VAL_20_S8 6442450943. _CNV_A_R_LINEAR_____12_CM -2147483648. 4294967295. /end CHARACTERISTIC
/begin CHARACTERISTIC OZPERMNK3 "Drehzahlschwelle für Er-Ausblendung" VALUE 0x5a066 _REC_VAL_20_u1 10200. _CNV_A_R_nmot_ub_q4_537_CM 0. 10200. FORMAT "%8.4" /end CHARACTERISTIC
/begin CHARACTERISTIC OZPERMTIK6 "Mittelungszeitraum Permittivität" VALUE 0x5a05c _REC_VAL_20_S8 6442450943. _CNV_A_R_LINEAR_____12_CM -2147483648. 4294967295. /end CHARACTERISTIC
/begin CHARACTERISTIC OZPERMTIK8 "Ausheizzeit" VALUE 0x5a05e _REC_VAL_20_u2 65535. _CNV_R_R_igen_ub_q1_483_CM 0. 65535. FORMAT "%8.4" /end CHARACTERISTIC
/begin CHARACTERISTIC OZPERMTIK9 "maximale Zeit nach B_ozpermpl = true, Neustart und oztempf < OZPERMTI in der eine gültige Messung erfolgen kann (Kaltzeitschwelle)" VALUE 0x5a060 _REC_VAL_20_S8 6442450943. _CNV_A_R_LINEAR_____12_CM -2147483648. 4294967295. /end CHARACTERISTIC
/begin CHARACTERISTIC OZPERMTK12 "Untere Temperaturgrenze Messfenster Permittivität" VALUE 0x5a067 _REC_VAL_20_u1 255. _CNV_R_R_temp_ub_q1_552_CM -48. 207. FORMAT "%8.4" /end CHARACTERISTIC
/begin CHARACTERISTIC OZPERMTK13 "Obere Temperaturgrenze Messfenster Permittivität" VALUE 0x5a068 _REC_VAL_20_u1 255. _CNV_R_R_temp_ub_q1_552_CM -48. 207. FORMAT "%8.4" /end CHARACTERISTIC
/begin CHARACTERISTIC OZPERMTK4 "Abklingzeit Drehzahlschwelle" VALUE 0x5a062 _REC_VAL_20_u2 65535. _CNV_R_R_igen_ub_q1_483_CM 0. 65535. FORMAT "%8.4" /end CHARACTERISTIC
/begin CHARACTERISTIC OZPERMTK7 "Ausheiztemperatur" VALUE 0x5a069 _REC_VAL_20_u1 255. _CNV_R_R_temp_ub_q1_552_CM -48. 207. FORMAT "%8.4" /end CHARACTERISTIC
/begin MEASUREMENT OZKMLOW "Kilometerstand letzter Ölwechsel" UWORD _CNV_R_R_nmot_ub_q1_538_CM 1 100. 0. 655350. ECU_ADDRESS 0x3fb35c FORMAT "%8.4" /end MEASUREMENT
/begin MEASUREMENT OZOELKM "Ölkilometer" UWORD _CNV_R_R_nmot_ub_q1_538_CM 1 100. 0. 655350. ECU_ADDRESS 0x3fb37e FORMAT "%8.4" /end MEASUREMENT
/begin MEASUREMENT OZPERMEX "Permittivität für Bewertung aufbereitet (extrapoliert)" UWORD _CNV_R_R_perm_uw_b6_553_CM 1 100. 0. 5.9999084 ECU_ADDRESS 0x3fb380 FORMAT "%8.4" /end MEASUREMENT
/begin MEASUREMENT OZPERMLOW "aufbereitete Permittivität bei letztem Ölwechsel" UWORD _CNV_R_R_perm_uw_b6_553_CM 1 100. 0. 5.9999084 ECU_ADDRESS 0x3fb382 FORMAT "%8.4" /end MEASUREMENT
/begin MEASUREMENT OZNIVKM "letzter Kilometerstand bei dem ein neuer Langzeitmittelwert Niveau vorlag und kein Öl nachgefüllt wurde" UWORD _CNV_R_R_nmot_ub_q1_538_CM 1 100. 0. 655350. ECU_ADDRESS 0x3fb37c FORMAT "%8.4" /end MEASUREMENT
/begin MEASUREMENT OZPERMANZ "Anzahl der Messwerte im Schieberegister" SBYTE _CNV_R_R_igen_ub_q1_483_CM 1 100. -128. 127. ECU_ADDRESS 0x3fb3a6 FORMAT "%8.4" /end MEASUREMENT
/begin MEASUREMENT OZPERMOFF "Offset für Permittivitätskorrektur" SWORD _CNV_R_R_perm_sw_b6_558_CM 1 100. -6. 5.9999084 ECU_ADDRESS 0x3fb384 FORMAT "%8.4" /end MEASUREMENT
/begin MEASUREMENT OZPERMREG_0_ "Schieberegister Permittivität" UWORD _CNV_R_R_perm_uw_b6_553_CM 1 100. 0. 5.9999084 ECU_ADDRESS 0x3fb386 FORMAT "%8.4" /end MEASUREMENT
/begin MEASUREMENT OZPERMREG_1_ "Schieberegister Permittivität" UWORD _CNV_R_R_perm_uw_b6_553_CM 1 100. 0. 5.9999084 ECU_ADDRESS 0x3fb388 FORMAT "%8.4" /end MEASUREMENT
/begin MEASUREMENT OZPERMREG_2_ "Schieberegister Permittivität" UWORD _CNV_R_R_perm_uw_b6_553_CM 1 100. 0. 5.9999084 ECU_ADDRESS 0x3fb38a FORMAT "%8.4" /end MEASUREMENT
/begin MEASUREMENT OZPERMREG_3_ "Schieberegister Permittivität" UWORD _CNV_R_R_perm_uw_b6_553_CM 1 100. 0. 5.9999084 ECU_ADDRESS 0x3fb38c FORMAT "%8.4" /end MEASUREMENT
/begin MEASUREMENT OZPERMREG_4_ "Schieberegister Permittivität" UWORD _CNV_R_R_perm_uw_b6_553_CM 1 100. 0. 5.9999084 ECU_ADDRESS 0x3fb38e FORMAT "%8.4" /end MEASUREMENT
/begin MEASUREMENT OZPERMREG_5_ "Schieberegister Permittivität" UWORD _CNV_R_R_perm_uw_b6_553_CM 1 100. 0. 5.9999084 ECU_ADDRESS 0x3fb390 FORMAT "%8.4" /end MEASUREMENT
/begin MEASUREMENT OZPERMREG_6_ "Schieberegister Permittivität" UWORD _CNV_R_R_perm_uw_b6_553_CM 1 100. 0. 5.9999084 ECU_ADDRESS 0x3fb392 FORMAT "%8.4" /end MEASUREMENT
/begin MEASUREMENT OZPERMREG_7_ "Schieberegister Permittivität" UWORD _CNV_R_R_perm_uw_b6_553_CM 1 100. 0. 5.9999084 ECU_ADDRESS 0x3fb394 FORMAT "%8.4" /end MEASUREMENT
/begin MEASUREMENT OZPERMREG_8_ "Schieberegister Permittivität" UWORD _CNV_R_R_perm_uw_b6_553_CM 1 100. 0. 5.9999084 ECU_ADDRESS 0x3fb396 FORMAT "%8.4" /end MEASUREMENT
/begin MEASUREMENT OZPERMREG_9_ "Schieberegister Permittivität" UWORD _CNV_R_R_perm_uw_b6_553_CM 1 100. 0. 5.9999084 ECU_ADDRESS 0x3fb398 FORMAT "%8.4" /end MEASUREMENT
/begin MEASUREMENT OZPERMREG_10_ "Schieberegister Permittivität" UWORD _CNV_R_R_perm_uw_b6_553_CM 1 100. 0. 5.9999084 ECU_ADDRESS 0x3fb39a FORMAT "%8.4" /end MEASUREMENT
/begin MEASUREMENT OZPERMREG_11_ "Schieberegister Permittivität" UWORD _CNV_R_R_perm_uw_b6_553_CM 1 100. 0. 5.9999084 ECU_ADDRESS 0x3fb39c FORMAT "%8.4" /end MEASUREMENT
/begin MEASUREMENT OZPERMREG_12_ "Schieberegister Permittivität" UWORD _CNV_R_R_perm_uw_b6_553_CM 1 100. 0. 5.9999084 ECU_ADDRESS 0x3fb39e FORMAT "%8.4" /end MEASUREMENT
/begin MEASUREMENT OZPERMREG_13_ "Schieberegister Permittivität" UWORD _CNV_R_R_perm_uw_b6_553_CM 1 100. 0. 5.9999084 ECU_ADDRESS 0x3fb3a0 FORMAT "%8.4" /end MEASUREMENT
/begin MEASUREMENT OZPERMREG_14_ "Schieberegister Permittivität" UWORD _CNV_R_R_perm_uw_b6_553_CM 1 100. 0. 5.9999084 ECU_ADDRESS 0x3fb3a2 FORMAT "%8.4" /end MEASUREMENT
/begin MEASUREMENT OZKMREG_0_ "Schieberegister Kilometerstand" UWORD _CNV_R_R_nmot_ub_q1_538_CM 1 100. 0. 655350. ECU_ADDRESS 0x3fb35e FORMAT "%8.4" /end MEASUREMENT
/begin MEASUREMENT OZKMREG_1_ "Schieberegister Kilometerstand" UWORD _CNV_R_R_nmot_ub_q1_538_CM 1 100. 0. 655350. ECU_ADDRESS 0x3fb360 FORMAT "%8.4" /end MEASUREMENT
/begin MEASUREMENT OZKMREG_2_ "Schieberegister Kilometerstand" UWORD _CNV_R_R_nmot_ub_q1_538_CM 1 100. 0. 655350. ECU_ADDRESS 0x3fb362 FORMAT "%8.4" /end MEASUREMENT
/begin MEASUREMENT OZKMREG_3_ "Schieberegister Kilometerstand" UWORD _CNV_R_R_nmot_ub_q1_538_CM 1 100. 0. 655350. ECU_ADDRESS 0x3fb364 FORMAT "%8.4" /end MEASUREMENT
/begin MEASUREMENT OZKMREG_4_ "Schieberegister Kilometerstand" UWORD _CNV_R_R_nmot_ub_q1_538_CM 1 100. 0. 655350. ECU_ADDRESS 0x3fb366 FORMAT "%8.4" /end MEASUREMENT
/begin MEASUREMENT OZKMREG_5_ "Schieberegister Kilometerstand" UWORD _CNV_R_R_nmot_ub_q1_538_CM 1 100. 0. 655350. ECU_ADDRESS 0x3fb368 FORMAT "%8.4" /end MEASUREMENT
/begin MEASUREMENT OZKMREG_6_ "Schieberegister Kilometerstand" UWORD _CNV_R_R_nmot_ub_q1_538_CM 1 100. 0. 655350. ECU_ADDRESS 0x3fb36a FORMAT "%8.4" /end MEASUREMENT
/begin MEASUREMENT OZKMREG_7_ "Schieberegister Kilometerstand" UWORD _CNV_R_R_nmot_ub_q1_538_CM 1 100. 0. 655350. ECU_ADDRESS 0x3fb36c FORMAT "%8.4" /end MEASUREMENT
/begin MEASUREMENT OZKMREG_8_ "Schieberegister Kilometerstand" UWORD _CNV_R_R_nmot_ub_q1_538_CM 1 100. 0. 655350. ECU_ADDRESS 0x3fb36e FORMAT "%8.4" /end MEASUREMENT
/begin MEASUREMENT OZKMREG_9_ "Schieberegister Kilometerstand" UWORD _CNV_R_R_nmot_ub_q1_538_CM 1 100. 0. 655350. ECU_ADDRESS 0x3fb370 FORMAT "%8.4" /end MEASUREMENT
/begin MEASUREMENT OZKMREG_10_ "Schieberegister Kilometerstand" UWORD _CNV_R_R_nmot_ub_q1_538_CM 1 100. 0. 655350. ECU_ADDRESS 0x3fb372 FORMAT "%8.4" /end MEASUREMENT
/begin MEASUREMENT OZKMREG_11_ "Schieberegister Kilometerstand" UWORD _CNV_R_R_nmot_ub_q1_538_CM 1 100. 0. 655350. ECU_ADDRESS 0x3fb374 FORMAT "%8.4" /end MEASUREMENT
/begin MEASUREMENT OZKMREG_12_ "Schieberegister Kilometerstand" UWORD _CNV_R_R_nmot_ub_q1_538_CM 1 100. 0. 655350. ECU_ADDRESS 0x3fb376 FORMAT "%8.4" /end MEASUREMENT
/begin MEASUREMENT OZKMREG_13_ "Schieberegister Kilometerstand" UWORD _CNV_R_R_nmot_ub_q1_538_CM 1 100. 0. 655350. ECU_ADDRESS 0x3fb378 FORMAT "%8.4" /end MEASUREMENT
/begin MEASUREMENT OZKMREG_14_ "Schieberegister Kilometerstand" UWORD _CNV_R_R_nmot_ub_q1_538_CM 1 100. 0. 655350. ECU_ADDRESS 0x3fb37a FORMAT "%8.4" /end MEASUREMENT
/begin MEASUREMENT OZPRFSTRG "Zähler für Delta Er-Ermittlung" UBYTE _CNV_R_R_igen_ub_q1_483_CM 1 100. 0. 255. ECU_ADDRESS 0x3fb3a9 FORMAT "%8.4" /end MEASUREMENT
/begin CHARACTERISTIC OZANFANZ "BOS-Startanzeigewert Restlaufstrecke" VALUE 0x5a06a _REC_VAL_20_S8 6442450943. _CNV_A_R_LINEAR_____12_CM -2147483648. 4294967295. /end CHARACTERISTIC
/begin CHARACTERISTIC OZKMMAXK11 "Maximalintervall" VALUE 0x5a06e _REC_VAL_20_S8 6442450943. _CNV_A_R_LINEAR_____12_CM -2147483648. 4294967295. /end CHARACTERISTIC
/begin CHARACTERISTIC OZKVB96 "Typprüfkraftstoffverbrauch" VALUE 0x5a07e _REC_VAL_20_u2 8600. _CNV_R_R_fuel_uw_q1_559_CM 200. 8800. FORMAT "%8.4" /end CHARACTERISTIC
/begin CHARACTERISTIC OZKVBMXK18 "maximal zulässige Gesamtkraftstoffbonusmenge" VALUE 0x5a070 _REC_VAL_20_u2 65535. _CNV_R_R_fuel_uw_q1_559_CM 0. 65535. FORMAT "%8.4" /end CHARACTERISTIC
/begin CHARACTERISTIC OZKVBOK16 "Kraftstoffbonusmenge in [l] je 0,5l Ölnachfüllung" VALUE 0x5a072 _REC_VAL_20_u2 65535. _CNV_R_R_fuel_uw_q1_559_CM 0. 65535. FORMAT "%8.4" /end CHARACTERISTIC
/begin CHARACTERISTIC OZLF1 "Länderfaktor 1 Festwert" VALUE 0x5a07f _REC_VAL_20_S8 6442450943. _CNV_A_R_LINEAR_____12_CM -2147483648. 4294967295. /end CHARACTERISTIC
/begin CHARACTERISTIC OZLF2 "Länderfaktor 2 Festwert" VALUE 0x5a080 _REC_VAL_20_S8 6442450943. _CNV_A_R_LINEAR_____12_CM -2147483648. 4294967295. /end CHARACTERISTIC
/begin CHARACTERISTIC OZMNKMBO "Wegstrecke ab der eine Bonuszuteilung erfolgt" VALUE 0x5a074 _REC_VAL_20_S8 6442450943. _CNV_A_R_LINEAR_____12_CM -2147483648. 4294967295. /end CHARACTERISTIC
/begin CHARACTERISTIC OZMXOHK15 "maximale Öllaufzeit" VALUE 0x5a076 _REC_VAL_20_S8 1. _CNV_A_R_LINEAR_____12_CM -1. 0. /end CHARACTERISTIC
/begin CHARACTERISTIC OZPERBOK17 "Er-Bonusbetrag je 0,5l Ölnachfüllung" VALUE 0x5a078 _REC_VAL_20_S8 6442450943. _CNV_A_R_LINEAR_____12_CM -2147483648. 4294967295. /end CHARACTERISTIC
/begin CHARACTERISTIC OZPERBRK14 "Begrenzungsfaktor für Restweg aus der Permittivität" VALUE 0x5a081 _REC_VAL_20_S8 6442450943. _CNV_A_R_LINEAR_____12_CM -2147483648. 4294967295. /end CHARACTERISTIC
/begin CHARACTERISTIC OZPERXK10 "zulässige Permittivitätsänderung im Ölwechselintervall" VALUE 0x5a07a _REC_VAL_20_S8 6442450943. _CNV_A_R_LINEAR_____12_CM -2147483648. 4294967295. /end CHARACTERISTIC
/begin CHARACTERISTIC OZTAGCTERR "Fehlerkennung für Tagezähler" VALUE 0x5a07c _REC_VAL_20_S8 1. _CNV_A_R_LINEAR_____12_CM -1. 0. /end CHARACTERISTIC
/begin CHARACTERISTIC OZZEITFAKT "Faktor zum Ausblenden der Zeit zu Beginn der Auswertung" VALUE 0x5a082 _REC_VAL_20_S8 6442450943. _CNV_A_R_LINEAR_____12_CM -2147483648. 4294967295. /end CHARACTERISTIC
/begin MEASUREMENT OZLF1T "" UBYTE _CNV_R_R_lf_ub_554_CM 1 100. 0. 2.55 ECU_ADDRESS 0x3fb3bd FORMAT "%8.4" /end MEASUREMENT
/begin MEASUREMENT OZRWANZ "" SWORD _CNV_R_R_km_sw_q10_551_CM 1 100. -327680. 327670. ECU_ADDRESS 0x3fb3b4 FORMAT "%8.4" /end MEASUREMENT
/begin MEASUREMENT OZVFANZ "anzuzeigende Verfügbarkeit" UBYTE _CNV_R_R_lf_ub_554_CM 1 100. 0. 2.55 ECU_ADDRESS 0x3fb291 FORMAT "%8.4" /end MEASUREMENT
/begin MEASUREMENT OZCTTAGINI "Initialwert für Ölzeitzähler" UWORD _CNV_R_R_DEZ_560_CM 1 100. 0. 65535. ECU_ADDRESS 0x3fb3ac FORMAT "%8.4" /end MEASUREMENT
/begin MEASUREMENT OZKVBOG "zugeteilte Bonuskraftstoffmenge" UWORD _CNV_R_R_fuel_uw_q1_559_CM 1 100. 0. 65535. ECU_ADDRESS 0x3fb3b0 FORMAT "%8.4" /end MEASUREMENT
/begin MEASUREMENT OZKVBSM_UL "Kraftstoffverbrauch seit letztem Ölwechsel" ULONG _CNV_R_R_fuel_ul_q0_561_CM 1 100. 0. 10000. ECU_ADDRESS 0x3fb3b8 FORMAT "%8.4" /end MEASUREMENT
/begin MEASUREMENT OZLF2T "Länderfaktor 2" UBYTE _CNV_R_R_lf_ub_554_CM 1 100. 0. 2.55 ECU_ADDRESS 0x3fb3bf FORMAT "%8.4" /end MEASUREMENT
/begin MEASUREMENT OZLF2C "Länderfaktor 2 codiert" UBYTE _CNV_R_R_lf_ub_554_CM 1 100. 0. 2.55 ECU_ADDRESS 0x3fb3be FORMAT "%8.4" /end MEASUREMENT
/begin MEASUREMENT OZLF1C "Länderfaktor 1 codiert" UBYTE _CNV_R_R_lf_ub_554_CM 1 100. 0. 127. ECU_ADDRESS 0x3fb3bc FORMAT "%8.4" /end MEASUREMENT
/begin MEASUREMENT OZKMSTRW0 "Kilometerstand bei Restweg = Null" UWORD _CNV_R_R_km_uw_q10_562_CM 1 100. 0. 655350. ECU_ADDRESS 0x3fb3ae FORMAT "%8.4" /end MEASUREMENT
/begin MEASUREMENT OZPERMBOG "zugeteilter Permittivitätsbonus" UWORD _CNV_A_R_rasc_for_b_563_CM 1 100. 0. 21845. ECU_ADDRESS 0x3fb3b2 FORMAT "%8.4" /end MEASUREMENT
/begin CHARACTERISTIC OZTEMPZK "Zeitkonstante Filter Öltemperatur" VALUE 0x5a083 _REC_VAL_20_u1 254. _CNV_R_R_zk1sxs_ub__564_CM 1. 255. FORMAT "%8.4" /end CHARACTERISTIC
/begin CHARACTERISTIC C_SWI_VEPU_AS "control byte venturi pump" VALUE 0x429b6 _REC_VAL_20_u1 1. _CNV_S_2_RANGE______565_CM 0. 1. /end CHARACTERISTIC
/begin MEASUREMENT KMSTAND "" UWORD _CNV_R_R_nmot_ub_q1_538_CM 1 100. 0. 655350. ECU_ADDRESS 0x3fc59e FORMAT "%8.4" /end MEASUREMENT
/begin MEASUREMENT ZRBOSR "" UBYTE _CNV_R_R_igen_ub_q1_483_CM 1 100. 0. 255. ECU_ADDRESS 0x3fc435 FORMAT "%8.4" /end MEASUREMENT
/begin MEASUREMENT M_TOL "" UBYTE _CNV_R_R_temp_uw_q0_481_CM 1 100. -48. 143.25 ECU_ADDRESS 0x3fc5a5 FORMAT "%8.4" /end MEASUREMENT
/begin MEASUREMENT KVAVERBR "" UWORD _CNV_R_R_fuel_uw_b6_574_CM 1 100. 0. 65535. ECU_ADDRESS 0x3fc5a0 FORMAT "%8.4" /end MEASUREMENT
/begin MEASUREMENT ZTAGEABS_W "" UWORD _CNV_R_R_igen_ub_q1_483_CM 1 100. 0. 65535. ECU_ADDRESS 0x3fc5a2 FORMAT "%8.4" /end MEASUREMENT
/begin MEASUREMENT IDBOSRST "" UBYTE _CNV_R_R_igen_ub_q1_483_CM 1 100. 0. 255. ECU_ADDRESS 0x3fc433 FORMAT "%8.4" /end MEASUREMENT
/begin MEASUREMENT IDFBOSRT_W "" UWORD _CNV_R_R_igen_ub_q1_483_CM 1 100. 0. 65535. ECU_ADDRESS 0x3fc418 FORMAT "%8.4" /end MEASUREMENT
/begin MEASUREMENT VBOST "" UBYTE _CNV_R_R_igen_ub_q1_483_CM 1 100. 0. 255. ECU_ADDRESS 0x3fc434 FORMAT "%8.4" /end MEASUREMENT
/begin MEASUREMENT B_SA "" UBYTE _CNV_A_R_LINEAR_____12_CM 1 100. 0. 255. ECU_ADDRESS 0x3fc5a4 BIT_MASK 0x1 /end MEASUREMENT
/begin MEASUREMENT UB "" UBYTE _CNV_A_R_spg_ubatt_575_CM 1 100. 0. 24.021 ECU_ADDRESS 0x3fc563 FORMAT "%5.2" /end MEASUREMENT
/begin MEASUREMENT LV_ERR_TIA "TIA error detected" UBYTE _CNV_S_2_RANGE______21_R_CM 1 100. 0. 255. ECU_ADDRESS 0x3fd35b /end MEASUREMENT
/begin CHARACTERISTIC LC_SA_SWI_ACQ "logical constant for decision SAF_KGH through model value (=1) SAFM is used" VALUE 0x42bc1 _REC_VAL_20_u1 1. _CNV_A_R_LINEAR_____10_CM 0. 1. FORMAT "%2.0" /end CHARACTERISTIC
/begin CHARACTERISTIC CW_OZ "" VALUE 0x5a01e _REC_VAL_20_u2 65535. _CNV_R_R_igen_ub_q1_483_CM 0. 65535. FORMAT "%8.4" /end CHARACTERISTIC
/begin CHARACTERISTIC OZKMUPL "Ungültigkeitswert Kilometerstand" VALUE 0x5a056 _REC_VAL_20_u2 655350. _CNV_R_R_nmot_ub_q1_538_CM 0. 655350. FORMAT "%8.4" /end CHARACTERISTIC
/begin CHARACTERISTIC OZBZKMSTK1 "" VALUE 0x5a06c _REC_VAL_20_u2 655350. _CNV_R_R_nmot_ub_q1_538_CM 0. 655350. FORMAT "%8.4" /end CHARACTERISTIC
/begin CHARACTERISTIC TOGVERZOEG "" VALUE 0x5b800 _REC_VAL_20_u1 255. _CNV_A_R_LINEAR_____12_CM 0. 255. FORMAT "%5.1" /end CHARACTERISTIC
/begin AXIS_PTS ldpm_maf_cyl_ip_rel_flow_inc_cp "" 0x450bc MAF_CYL _REC_AXS_20_u2 2047.96875 _CNV_A_R_LINEAR_____101_CM 6 0. 2047.96875 FORMAT "%6.2" /end AXIS_PTS
/begin AXIS_PTS ldpm_n_32_ip_fuel_dly_cps "" 0x43e56 N_32 _REC_AXS_20_u1 8160. _CNV_A_R_LINEAR_____5_CM 6 0. 8160. FORMAT "%4.0" /end AXIS_PTS
/begin AXIS_PTS ldpm_n_32_3_ivvt "" 0x43d58 N_32 _REC_AXS_20_u1 8160. _CNV_A_R_LINEAR_____5_CM 6 0. 8160. FORMAT "%4.0" /end AXIS_PTS
/begin AXIS_PTS ldpm_n_13 "" 0x451f4 N _REC_AXS_20_u2 8160. _CNV_A_R_LINEAR_____17_CM 6 0. 8160. FORMAT "%4.0" /end AXIS_PTS
/begin AXIS_PTS ldpm_n_5 "" 0x45280 N _REC_AXS_20_u2 8160. _CNV_A_R_LINEAR_____17_CM 16 0. 8160. FORMAT "%4.0" /end AXIS_PTS
/begin AXIS_PTS ldpm_maf_ivvt_2 "" 0x45112 MAF _REC_AXS_20_u2 1389. _CNV_A_R_LINEAR_____95_CM 12 0. 1389. FORMAT "%7.2" /end AXIS_PTS
/begin AXIS_PTS ldpm_toil_2_ivvt "" 0x44071 TOIL _REC_AXS_20_u1 200. _CNV_A_R_LINEAR_____3_CM 6 -40. 160. FORMAT "%3.0" /end AXIS_PTS
/begin MEASUREMENT LV_IM_BLS "brake light switch" UBYTE _CNV_S_2_RANGE______28_CM 1 100. 0. 1. ECU_ADDRESS 0x3fccfa BIT_MASK 0x1 /end MEASUREMENT
/begin MEASUREMENT LV_KEY_OFF "Boolean for ignition key status (ON / OFF)" UBYTE _CNV_S_2_RANGE______28_CM 1 100. 0. 1. ECU_ADDRESS 0x3fbf6d BIT_MASK 0x1 /end MEASUREMENT
/begin MEASUREMENT LV_IM_ST "starter" UBYTE _CNV_S_2_RANGE______28_CM 1 100. 0. 1. ECU_ADDRESS 0x3fccf3 BIT_MASK 0x1 /end MEASUREMENT
/begin MEASUREMENT LV_IM_LOCK "????" UBYTE _CNV_S_2_RANGE______28_CM 1 100. 0. 1. ECU_ADDRESS 0x3fccf4 BIT_MASK 0x1 /end MEASUREMENT
/begin MEASUREMENT LV_IM_CRU_SET_AC "cruise control set / accelerate" UBYTE _CNV_S_2_RANGE______28_CM 1 100. 0. 1. ECU_ADDRESS 0x3fccf5 BIT_MASK 0x1 /end MEASUREMENT
/begin MEASUREMENT LV_IM_CRU_RESU_DECE "cruise control resume / decelerate" UBYTE _CNV_S_2_RANGE______28_CM 1 100. 0. 1. ECU_ADDRESS 0x3fccf6 BIT_MASK 0x1 /end MEASUREMENT
/begin MEASUREMENT LV_IM_CRU_MAIN_OFF "cruise control main switch / off" UBYTE _CNV_S_2_RANGE______28_CM 1 100. 0. 1. ECU_ADDRESS 0x3fccf7 BIT_MASK 0x1 /end MEASUREMENT
/begin MEASUREMENT LV_IM_BTS "brake test switch" UBYTE _CNV_S_2_RANGE______28_CM 1 100. 0. 1. ECU_ADDRESS 0x3fccf9 BIT_MASK 0x1 /end MEASUREMENT
/begin MEASUREMENT LV_IM_CS_PN "clutch switch" UBYTE _CNV_S_2_RANGE______28_CM 1 100. 0. 1. ECU_ADDRESS 0x3fccf8 BIT_MASK 0x1 /end MEASUREMENT
/begin MEASUREMENT V_DUR_IGC_0 "Burntime for  respective cylinder" UWORD _CNV_A_R_LINEAR_____208_CM 1 100. 0. 20. ECU_ADDRESS 0x3fbfb0 FORMAT "%8.3" /end MEASUREMENT
/begin MEASUREMENT V_DUR_IGC_1 "Burntime for  respective cylinder" UWORD _CNV_A_R_LINEAR_____208_CM 1 100. 0. 20. ECU_ADDRESS 0x3fbfb2 FORMAT "%8.3" /end MEASUREMENT
/begin MEASUREMENT V_DUR_IGC_2 "Burntime for  respective cylinder" UWORD _CNV_A_R_LINEAR_____208_CM 1 100. 0. 20. ECU_ADDRESS 0x3fbfb4 FORMAT "%8.3" /end MEASUREMENT
/begin MEASUREMENT V_DUR_IGC_3 "Burntime for  respective cylinder" UWORD _CNV_A_R_LINEAR_____208_CM 1 100. 0. 20. ECU_ADDRESS 0x3fbfb6 FORMAT "%8.3" /end MEASUREMENT
/begin MEASUREMENT V_DUR_IGC_4 "Burntime for  respective cylinder" UWORD _CNV_A_R_LINEAR_____208_CM 1 100. 0. 20. ECU_ADDRESS 0x3fbfb8 FORMAT "%8.3" /end MEASUREMENT
/begin MEASUREMENT V_DUR_IGC_5 "Burntime for  respective cylinder" UWORD _CNV_A_R_LINEAR_____208_CM 1 100. 0. 20. ECU_ADDRESS 0x3fbfba FORMAT "%8.3" /end MEASUREMENT
/begin MEASUREMENT LV_TD_IGC_CUT_0 "Diagnostic-bit of primary short circuit to battery" UBYTE _CNV_S_2_RANGE______28_CM 1 100. 0. 1. ECU_ADDRESS 0x3fbfbc BIT_MASK 0x1 /end MEASUREMENT
/begin MEASUREMENT LV_TD_IGC_CUT_1 "Diagnostic-bit of primary short circuit to battery" UBYTE _CNV_S_2_RANGE______28_CM 1 100. 0. 1. ECU_ADDRESS 0x3fbfbd BIT_MASK 0x1 /end MEASUREMENT
/begin MEASUREMENT LV_TD_IGC_CUT_2 "Diagnostic-bit of primary short circuit to battery" UBYTE _CNV_S_2_RANGE______28_CM 1 100. 0. 1. ECU_ADDRESS 0x3fbfbe BIT_MASK 0x1 /end MEASUREMENT
/begin MEASUREMENT LV_TD_IGC_CUT_3 "Diagnostic-bit of primary short circuit to battery" UBYTE _CNV_S_2_RANGE______28_CM 1 100. 0. 1. ECU_ADDRESS 0x3fbfbf BIT_MASK 0x1 /end MEASUREMENT
/begin MEASUREMENT LV_TD_IGC_CUT_4 "Diagnostic-bit of primary short circuit to battery" UBYTE _CNV_S_2_RANGE______28_CM 1 100. 0. 1. ECU_ADDRESS 0x3fbfc0 BIT_MASK 0x1 /end MEASUREMENT
/begin MEASUREMENT LV_TD_IGC_CUT_5 "Diagnostic-bit of primary short circuit to battery" UBYTE _CNV_S_2_RANGE______28_CM 1 100. 0. 1. ECU_ADDRESS 0x3fbfc1 BIT_MASK 0x1 /end MEASUREMENT
/begin MEASUREMENT BIOS_T_SEG_MIS "" UWORD _CNV_A_R_LINEAR_____490_CM 1 100. 0. 65535. ECU_ADDRESS 0x3fbfa8 FORMAT "%5.0" /end MEASUREMENT
/begin MEASUREMENT BIOS_CRU_DATA "status off MSW module" UBYTE _CNV_S_5_RANGE_BIOS_583_R_CM 1 100. 110. 255. ECU_ADDRESS 0x3fc066 /end MEASUREMENT
/begin MEASUREMENT VB_MES "Battery voltage value measured (10 bits)" UWORD _CNV_A_R_LINEAR_____210_CM 1 100. 0. 28.7055 ECU_ADDRESS 0x3fbf64 FORMAT "%5.2" /end MEASUREMENT
/begin MEASUREMENT V_IGK_MES "Computed ignition key voltage" UWORD _CNV_A_R_LINEAR_____210_CM 1 100. 0. 28.7055 ECU_ADDRESS 0x3fbf66 FORMAT "%5.2" /end MEASUREMENT
/begin CHARACTERISTIC C_N_THD_ES_BLOCK "engine speed threshold for blocked engine" VALUE 0x42ecc _REC_VAL_20_u2 8160. _CNV_A_R_LINEAR_____17_CM 0. 8160. FORMAT "%4.0" /end CHARACTERISTIC
/begin MEASUREMENT SAF_SUM "Accumulated secondary air mass flow measurements for segment number (2n-1), n = 1,2,3,..." ULONG _CNV_A_R_LINEAR_____39_CM 1 100. 0. 67108863.98 ECU_ADDRESS 0x3fbf3c FORMAT "%11.2" /end MEASUREMENT
/begin MEASUREMENT SAF_SUM_1 "Accumulated secondary air mass flow measurements for segment number (2n), n = 1,2,3,..." ULONG _CNV_A_R_LINEAR_____39_CM 1 100. 0. 67108863.98 ECU_ADDRESS 0x3fbf40 FORMAT "%11.2" /end MEASUREMENT
/begin MEASUREMENT SAF_CTR "Number of samples in buffer saf_sum" UWORD _CNV_A_R_LINEAR_____10_CM 1 100. 0. 65535. ECU_ADDRESS 0x3fbf54 FORMAT "%5.0" /end MEASUREMENT
/begin MEASUREMENT SAF_CTR_1 "Number of samples in buffer saf_sum_1" UWORD _CNV_A_R_LINEAR_____10_CM 1 100. 0. 65535. ECU_ADDRESS 0x3fbf56 FORMAT "%5.0" /end MEASUREMENT
/begin MEASUREMENT LV_SAF_SEG "indicates if segment number is even or odd" UBYTE _CNV_S_2_RANGE______28_CM 1 100. 0. 1. ECU_ADDRESS 0x3fbf6a /end MEASUREMENT
/begin MEASUREMENT OZKMSTVLT "Kilometerstand wenn Ölverlust detektiert wurde" UWORD _CNV_R_R_nmot_ub_q1_538_CM 1 100. 0. 655350. ECU_ADDRESS 0x3fb1ee FORMAT "%8.4" /end MEASUREMENT
/begin MEASUREMENT OZRWANZT "letzter Wert der Restweganzeige" SWORD _CNV_R_R_km_sw_q10_551_CM 1 100. -327680. 327670. ECU_ADDRESS 0x3fb1f0 FORMAT "%8.4" /end MEASUREMENT
/begin MEASUREMENT OZVFTMP "begrenzte Verfügbarkeit" UBYTE _CNV_R_R_lf_ub_554_CM 1 100. 0. 2.55 ECU_ADDRESS 0x3fb1f8 FORMAT "%8.4" /end MEASUREMENT
/begin MEASUREMENT KVAVERL "Kraftstoffverbrauch um einen Abtastwert verzögert" UWORD _CNV_R_R_fuel_uw_b6_574_CM 1 100. 0. 65535. ECU_ADDRESS 0x3fb24c FORMAT "%8.4" /end MEASUREMENT
/begin MEASUREMENT OZDKVB "Kraftstoffverbrauch innerhalb der letzten Sekunde" UWORD _CNV_R_R_fuel_uw_b6_574_CM 1 100. 0. 65535. ECU_ADDRESS 0x3fb24e FORMAT "%8.4" /end MEASUREMENT
/begin MEASUREMENT OZGWFNBO "Gewichtungsfaktor Nachfüllbonus" FLOAT64_IEEE _CNV_A_R_LINEAR_____12_CM 1 100. -2147483648. 4294967295. ECU_ADDRESS 0x3fb290 /end MEASUREMENT
/begin MEASUREMENT OZKVBBGW "gewichteter Bonus Kraftstoffverbrauch" UWORD _CNV_R_R_fuel_uw_q1_559_CM 1 100. 0. 65535. ECU_ADDRESS 0x3fb250 FORMAT "%8.4" /end MEASUREMENT
/begin MEASUREMENT OZKVBMX "Zwischengröße Restwegberechnung Kraftstoffverbrauch" UWORD _CNV_R_R_fuel_uw_q1_559_CM 1 100. 200. 10000. ECU_ADDRESS 0x3fb252 FORMAT "%8.4" /end MEASUREMENT
/begin MEASUREMENT OZKVBOGW "additiver Term Nachfüllbonus Kraftstoffverbrauch gewichtet" UWORD _CNV_R_R_fuel_uw_q1_559_CM 1 100. 0. 65535. ECU_ADDRESS 0x3fb254 FORMAT "%8.4" /end MEASUREMENT
/begin MEASUREMENT OZKVBTMP1 "" FLOAT64_IEEE _CNV_A_R_LINEAR_____12_CM 1 100. -2147483648. 4294967295. ECU_ADDRESS 0x3fb256 /end MEASUREMENT
/begin MEASUREMENT OZKVBTMP2 "" FLOAT64_IEEE _CNV_A_R_LINEAR_____12_CM 1 100. -2147483648. 4294967295. ECU_ADDRESS 0x3fb280 /end MEASUREMENT
/begin MEASUREMENT OZKVBTMP3 "" FLOAT64_IEEE _CNV_A_R_LINEAR_____12_CM 1 100. -2147483648. 4294967295. ECU_ADDRESS 0x3fb258 /end MEASUREMENT
/begin MEASUREMENT OZKVBTMP4 "" FLOAT64_IEEE _CNV_A_R_LINEAR_____12_CM 1 100. -2147483648. 4294967295. ECU_ADDRESS 0x3fb284 /end MEASUREMENT
/begin MEASUREMENT OZOELZEIT "Öllaufzeit" FLOAT64_IEEE _CNV_A_R_LINEAR_____12_CM 1 100. -2147483648. 4294967295. ECU_ADDRESS 0x3fb25a /end MEASUREMENT
/begin MEASUREMENT OZPERMBGW "gewichteter Bonus Permittivität" FLOAT64_IEEE _CNV_A_R_LINEAR_____12_CM 1 100. -2147483648. 4294967295. ECU_ADDRESS 0x3fb25c /end MEASUREMENT
/begin MEASUREMENT OZPERMBOGW "additiver Term Nachfüllbonus Permittivität gewichtet" FLOAT64_IEEE _CNV_A_R_LINEAR_____12_CM 1 100. -2147483648. 4294967295. ECU_ADDRESS 0x3fb25e /end MEASUREMENT
/begin MEASUREMENT OZPERMMA "maximal zulässiges Delta-Er im Ölwechselintervall mit Bonus berücksichtigt" FLOAT64_IEEE _CNV_A_R_LINEAR_____12_CM 1 100. -2147483648. 4294967295. ECU_ADDRESS 0x3fb260 /end MEASUREMENT
/begin MEASUREMENT OZPERMTMP1 "" FLOAT64_IEEE _CNV_A_R_LINEAR_____12_CM 1 100. -2147483648. 4294967295. ECU_ADDRESS 0x3fb262 /end MEASUREMENT
/begin MEASUREMENT OZPERMTMP2 "" FLOAT64_IEEE _CNV_A_R_LINEAR_____12_CM 1 100. -2147483648. 4294967295. ECU_ADDRESS 0x3fb288 /end MEASUREMENT
/begin MEASUREMENT OZPERMTMP3 "" FLOAT64_IEEE _CNV_A_R_LINEAR_____12_CM 1 100. -2147483648. 4294967295. ECU_ADDRESS 0x3fb264 /end MEASUREMENT
/begin MEASUREMENT OZRWKVB "Restweg aus Kraftstoffverbrauch abgeleitet" SWORD _CNV_R_R_km_sw_q10_551_CM 1 100. -32770. 32770. ECU_ADDRESS 0x3fb266 FORMAT "%8.4" /end MEASUREMENT
/begin MEASUREMENT OZRWKVBA "absoluter Restweg aus Kraftstoffverbrauch" FLOAT64_IEEE _CNV_A_R_LINEAR_____12_CM 1 100. -2147483648. 4294967295. ECU_ADDRESS 0x3fb268 /end MEASUREMENT
/begin MEASUREMENT OZRWKVBR "relativer Restweg aus Kraftstoffverbrauch" FLOAT64_IEEE _CNV_A_R_LINEAR_____12_CM 1 100. -2147483648. 4294967295. ECU_ADDRESS 0x3fb28c /end MEASUREMENT
/begin MEASUREMENT OZRWP "Zwischengröße Restwegberechnung" FLOAT64_IEEE _CNV_A_R_LINEAR_____12_CM 1 100. -2147483648. 4294967295. ECU_ADDRESS 0x3fb26a /end MEASUREMENT
/begin MEASUREMENT OZRWPERM "Restweg aus Permittivität abgeleitet" FLOAT64_IEEE _CNV_A_R_LINEAR_____12_CM 1 100. -2147483648. 4294967295. ECU_ADDRESS 0x3fb26c /end MEASUREMENT
/begin MEASUREMENT OZRWPERMA "absoluter Restweg aus Er" FLOAT64_IEEE _CNV_A_R_LINEAR_____12_CM 1 100. -2147483648. 4294967295. ECU_ADDRESS 0x3fb26e /end MEASUREMENT
/begin MEASUREMENT OZRWPERMR "relativer Restweg aus Er" FLOAT64_IEEE _CNV_A_R_LINEAR_____12_CM 1 100. -2147483648. 4294967295. ECU_ADDRESS 0x3fb270 /end MEASUREMENT
/begin MEASUREMENT OZRWZEIT "Restweg aus Zeit" FLOAT64_IEEE _CNV_A_R_LINEAR_____12_CM 1 100. -2147483648. 4294967295. ECU_ADDRESS 0x3fb272 /end MEASUREMENT
/begin MEASUREMENT OZRWZEITA "absoluter Restweg aus Zeit" FLOAT64_IEEE _CNV_A_R_LINEAR_____12_CM 1 100. -2147483648. 4294967295. ECU_ADDRESS 0x3fb274 /end MEASUREMENT
/begin MEASUREMENT OZRWZEITR "relativer Restweg aus Zeit" FLOAT64_IEEE _CNV_A_R_LINEAR_____12_CM 1 100. -2147483648. 4294967295. ECU_ADDRESS 0x3fb276 /end MEASUREMENT
/begin MEASUREMENT OZVFKVB "Verfügbarkeit aus Kraftstoffverbrauch" FLOAT64_IEEE _CNV_A_R_LINEAR_____12_CM 1 100. -2147483648. 4294967295. ECU_ADDRESS 0x3fb278 /end MEASUREMENT
/begin MEASUREMENT OZVFZEIT "Verfügbarkeit aus Zeit" FLOAT64_IEEE _CNV_A_R_LINEAR_____12_CM 1 100. -2147483648. 4294967295. ECU_ADDRESS 0x3fb292 /end MEASUREMENT
/begin MEASUREMENT OZZEITTMP1 "" FLOAT64_IEEE _CNV_A_R_LINEAR_____12_CM 1 100. -1. 0. ECU_ADDRESS 0x3fb27a /end MEASUREMENT
/begin MEASUREMENT OZZEITTMP2 "Zwischenvariable Zeitberechnung" FLOAT64_IEEE _CNV_A_R_LINEAR_____12_CM 1 100. -2147483648. 4294967295. ECU_ADDRESS 0x3fb293 /end MEASUREMENT
/begin MEASUREMENT OZZEITTMP3 "" FLOAT64_IEEE _CNV_A_R_LINEAR_____12_CM 1 100. -2147483648. 4294967295. ECU_ADDRESS 0x3fb27c /end MEASUREMENT
/begin MEASUREMENT B_OZFBSD "" UBYTE _CNV_A_R_LINEAR_____12_CM 1 100. 0. 255. ECU_ADDRESS 0x3fb20b BIT_MASK 0x1 /end MEASUREMENT
/begin MEASUREMENT BOSBTVFBKT "Verfügbarkeit vom Tester" UBYTE _CNV_R_R_igen_ub_q1_483_CM 1 100. 0. 255. ECU_ADDRESS 0x3fb200 FORMAT "%8.4" /end MEASUREMENT
/begin MEASUREMENT OZNIVR "" UBYTE _CNV_R_R_igen_ub_q1_483_CM 1 100. 0. 255. ECU_ADDRESS 0x3fb20c FORMAT "%8.4" /end MEASUREMENT
/begin MEASUREMENT OZNIVT "begrenzter Niveau-Rohwert" UBYTE _CNV_R_R_igen_ub_q1_483_CM 1 100. 0. 255. ECU_ADDRESS 0x3fb206 FORMAT "%8.4" /end MEASUREMENT
/begin MEASUREMENT OZPERMR_W "" UWORD _CNV_R_R_igen_ub_q1_483_CM 1 100. 0. 1024. ECU_ADDRESS 0x3fb20e FORMAT "%8.4" /end MEASUREMENT
/begin MEASUREMENT OZPERMT "begrenzter Permittivitäts-Rohwert" UWORD _CNV_R_R_igen_ub_q1_483_CM 1 100. 0. 1024. ECU_ADDRESS 0x3fb1fc FORMAT "%8.4" /end MEASUREMENT
/begin MEASUREMENT OZSTATUS "" UBYTE _CNV_R_R_igen_ub_q1_483_CM 1 100. 0. 255. ECU_ADDRESS 0x3fb210 FORMAT "%8.4" /end MEASUREMENT
/begin MEASUREMENT OZTEMPR "" UBYTE _CNV_R_R_igen_ub_q1_483_CM 1 100. 0. 255. ECU_ADDRESS 0x3fb212 FORMAT "%8.4" /end MEASUREMENT
/begin MEASUREMENT OZTEMPT "begrenzter Temperatur-Rohwert" UBYTE _CNV_R_R_igen_ub_q1_483_CM 1 100. 0. 255. ECU_ADDRESS 0x3fb209 FORMAT "%8.4" /end MEASUREMENT
/begin MEASUREMENT OZDINDEX "Zähler für Permittivitätaufbereitung (>= 6 -> Auswertung)" ULONG _CNV_R_R_igen_ub_q1_483_CM 1 100. -1. 0. ECU_ADDRESS 0x3fb242 FORMAT "%8.4" /end MEASUREMENT
/begin MEASUREMENT OZDPERM "Delta-Er" FLOAT64_IEEE _CNV_A_R_LINEAR_____12_CM 1 100. -2147483648. 4294967295. ECU_ADDRESS 0x3fb228 /end MEASUREMENT
/begin MEASUREMENT OZDPERMSI "Index des letzten Kilometerstandes bei dem noch sicher keine Nachfüllung vorlag" SLONG _CNV_R_R_igen_ub_q1_483_CM 1 100. 0. 2147483647. ECU_ADDRESS 0x3fb243 FORMAT "%8.4" /end MEASUREMENT
/begin MEASUREMENT OZERANZP1 "Anzahl Punkte P1" ULONG _CNV_R_R_igen_ub_q1_483_CM 1 100. -1. 0. ECU_ADDRESS 0x3fb244 FORMAT "%8.4" /end MEASUREMENT
/begin MEASUREMENT OZERANZP2 "Anzahl Punkte P2" SLONG _CNV_R_R_igen_ub_q1_483_CM 1 100. 0. 2147483647. ECU_ADDRESS 0x3fb245 FORMAT "%8.4" /end MEASUREMENT
/begin MEASUREMENT OZERANZPRF "Anzahl Punkte Pruefpunkt" SLONG _CNV_R_R_igen_ub_q1_483_CM 1 100. 0. 2147483647. ECU_ADDRESS 0x3fb246 FORMAT "%8.4" /end MEASUREMENT
/begin MEASUREMENT OZKMPERMGL "Kilometerstand bei gültigem Permittivitätsmittelwert" FLOAT64_IEEE _CNV_A_R_LINEAR_____12_CM 1 100. -2147483648. 4294967295. ECU_ADDRESS 0x3fb22a /end MEASUREMENT
/begin MEASUREMENT OZLAUFVAR "Schleifenzähler Punkteberechnung" SLONG _CNV_R_R_igen_ub_q1_483_CM 1 100. 0. 2147483647. ECU_ADDRESS 0x3fb247 FORMAT "%8.4" /end MEASUREMENT
/begin MEASUREMENT OZPERMERP1 "Permittivität Punkt P1" UWORD _CNV_R_R_perm_uw_b6_553_CM 1 100. 0. 5.9999084 ECU_ADDRESS 0x3fb22c FORMAT "%8.4" /end MEASUREMENT
/begin MEASUREMENT OZPERMERP2 "Permittivität Punkt P2" FLOAT64_IEEE _CNV_A_R_LINEAR_____12_CM 1 100. -2147483648. 4294967295. ECU_ADDRESS 0x3fb22e /end MEASUREMENT
/begin MEASUREMENT OZPERMERPR "Permittivität Pruefpunkt" FLOAT64_IEEE _CNV_A_R_LINEAR_____12_CM 1 100. -2147483648. 4294967295. ECU_ADDRESS 0x3fb230 /end MEASUREMENT
/begin MEASUREMENT OZPERMKMP1 "Kilometerstand Punkt P1" UWORD _CNV_R_R_nmot_ub_q1_538_CM 1 100. 0. 655350. ECU_ADDRESS 0x3fb232 FORMAT "%8.4" /end MEASUREMENT
/begin MEASUREMENT OZPERMKMP2 "Kilometerstand Punkt P2" FLOAT64_IEEE _CNV_A_R_LINEAR_____12_CM 1 100. -2147483648. 4294967295. ECU_ADDRESS 0x3fb234 /end MEASUREMENT
/begin MEASUREMENT OZPERMKMPR "Kilometerstand Pruefpunkt" FLOAT64_IEEE _CNV_A_R_LINEAR_____12_CM 1 100. -2147483648. 4294967295. ECU_ADDRESS 0x3fb236 /end MEASUREMENT
/begin MEASUREMENT OZPERMKO_W "korrigierter gültiger Permittivitätswert" FLOAT64_IEEE _CNV_A_R_LINEAR_____12_CM 1 100. -2147483648. 4294967295. ECU_ADDRESS 0x3fb238 /end MEASUREMENT
/begin MEASUREMENT OZPERMPL_W "gültiger Permittivitätsmittelwert" FLOAT64_IEEE _CNV_A_R_LINEAR_____12_CM 1 100. -2147483648. 4294967295. ECU_ADDRESS 0x3fb23a /end MEASUREMENT
/begin MEASUREMENT OZSHIFT "Schleifenzähler für Schieberegister" UBYTE _CNV_R_R_igen_ub_q1_483_CM 1 100. 0. 255. ECU_ADDRESS 0x3fb249 FORMAT "%8.4" /end MEASUREMENT
/begin MEASUREMENT OZTV1 "Zwischenvariable1 Permittivitätsaufbereitung" FLOAT64_IEEE _CNV_A_R_LINEAR_____12_CM 1 100. -2147483648. 4294967295. ECU_ADDRESS 0x3fb23c /end MEASUREMENT
/begin MEASUREMENT OZTV2 "Zwischenvariable2 Permittivitätsaufbereitung" FLOAT64_IEEE _CNV_A_R_LINEAR_____12_CM 1 100. -2147483648. 4294967295. ECU_ADDRESS 0x3fb23e /end MEASUREMENT
/begin MEASUREMENT OZTV3 "Zwischenvariable3 Permittivitätsaufbereitung" FLOAT64_IEEE _CNV_A_R_LINEAR_____12_CM 1 100. -2147483648. 4294967295. ECU_ADDRESS 0x3fb240 /end MEASUREMENT
/begin MEASUREMENT TODELTIME "Zähler Ausheizzeit (nichtflüchtig)" UWORD _CNV_R_R_igen_ub_q1_483_CM 1 100. 0. 65535. ECU_ADDRESS 0x3fb3a4 FORMAT "%8.4" /end MEASUREMENT
/begin MEASUREMENT OZKRZCNT "Counter für kurzzeitigen Mittelwert Niveau" FLOAT64_IEEE _CNV_A_R_LINEAR_____12_CM 1 100. -1. 0. ECU_ADDRESS 0x3fb21a /end MEASUREMENT
/begin MEASUREMENT OZKRZMW "kurzzeitiger Mittelwert Niveau" UBYTE _CNV_R_R_niv_ub_b75_550_CM 1 100. 0. 74.707031 ECU_ADDRESS 0x3fb21b FORMAT "%8.4" /end MEASUREMENT
/begin MEASUREMENT OZKRZMWKOR "kurzzeitiger drehzahlkorrigierter Mittelwert Niveau" UBYTE _CNV_R_R_niv_ub_b75_550_CM 1 100. 0. 74.707031 ECU_ADDRESS 0x3fb21c FORMAT "%8.4" /end MEASUREMENT
/begin MEASUREMENT OZLGMWCNT "" SLONG _CNV_R_R_igen_ub_q1_483_CM 1 100. 0. 2147483647. ECU_ADDRESS 0x3fb21e FORMAT "%8.4" /end MEASUREMENT
/begin MEASUREMENT OZNIVLGALT "Langzeitmittelwert Niveau beim Starten des Motors (B_kl15 steigende Flanke)" UBYTE _CNV_R_R_niv_ub_b75_550_CM 1 100. 0. 74.707031 ECU_ADDRESS 0x3fb221 FORMAT "%8.4" /end MEASUREMENT
/begin MEASUREMENT OZNIVLGNEU "aktuell gültiger Langzeitmittelwert Niveau" UBYTE _CNV_R_R_niv_ub_b75_550_CM 1 100. 0. 74.707031 ECU_ADDRESS 0x3fb222 FORMAT "%8.4" /end MEASUREMENT
/begin MEASUREMENT OZNIVNFLIT "Nachfüllmenge in Liter" FLOAT64_IEEE _CNV_A_R_LINEAR_____12_CM 1 100. -2147483648. 4294967295. ECU_ADDRESS 0x3fb223 /end MEASUREMENT
/begin MEASUREMENT OZNMOTMW "kurzzeitiger Mittelwert Drehzahl" UBYTE _CNV_A_R_nmot_ub_q4_537_CM 1 100. 0. 10200. ECU_ADDRESS 0x3fb225 FORMAT "%8.4" /end MEASUREMENT
/begin MEASUREMENT OZVORMWCNT "Counter für vorgezogenen Mittelwert Niveau" SLONG _CNV_R_R_igen_ub_q1_483_CM 1 100. 0. 2147483647. ECU_ADDRESS 0x3fb227 FORMAT "%8.4" /end MEASUREMENT
/begin MEASUREMENT IVVTPWM_1 "Pulsewidth modulated signal for cam-actuator 1" UWORD _CNV_A_R_LINEAR_____94_CM 1 100. 0. 99.99847412 ECU_ADDRESS 0x3fbff6 /end MEASUREMENT
/begin MEASUREMENT IVVTPWM_0 "Pulsewidth modulated signal for cam-actuator 0" UWORD _CNV_A_R_LINEAR_____94_CM 1 100. 0. 99.99847412 ECU_ADDRESS 0x3fbff4 /end MEASUREMENT
/begin MEASUREMENT LV_HLD_IVVTPWM_0 "Hold bit on PWM output CAM 0 (1 = hold dutycycle, 0 = energization time)" UBYTE _CNV_S_2_RANGE______28_CM 1 100. 0. 1. ECU_ADDRESS 0x3fbff8 BIT_MASK 0x1 /end MEASUREMENT
/begin MEASUREMENT LV_HLD_IVVTPWM_1 "Hold bit on PWM output CAM 0 (1 = hold dutycycle, 0 = energization time)" UBYTE _CNV_S_2_RANGE______28_CM 1 100. 0. 1. ECU_ADDRESS 0x3fbff9 BIT_MASK 0x1 /end MEASUREMENT
/begin MEASUREMENT T_STOP_CUR_IVVTPWM_0 "Captured system time at end of energization time" ULONG _CNV_A_R_LINEAR_____248_CM 1 100. 0. 17179869180. ECU_ADDRESS 0x3fbffc FORMAT "%11.0" /end MEASUREMENT
/begin MEASUREMENT T_STOP_CUR_IVVTPWM_1 "Captured system time at end of energization time" ULONG _CNV_A_R_LINEAR_____248_CM 1 100. 0. 17179869180. ECU_ADDRESS 0x3fc000 FORMAT "%11.0" /end MEASUREMENT
/begin MEASUREMENT B_TOEL "" UBYTE _CNV_S_2_B_TRUE_519_CM 1 100. 0. 1. ECU_ADDRESS 0x3fb1e9 /end MEASUREMENT
/begin MEASUREMENT B_TOG "" UBYTE _CNV_S_2_B_TRUE_519_CM 1 100. 0. 1. ECU_ADDRESS 0x3fb1ea /end MEASUREMENT
/begin MEASUREMENT TOG_CNT "" UBYTE _CNV_A_R_LINEAR_____12_CM 1 100. 0. 255. ECU_ADDRESS 0x3fa49a FORMAT "%5.1" /end MEASUREMENT
/begin MEASUREMENT TOG_ICNT "" UWORD _CNV_R_R_t10msxs_ub_489_CM 1 100. 0. 655.35 ECU_ADDRESS 0x3fa492 FORMAT "%8.4" /end MEASUREMENT
/begin MEASUREMENT TOG_PWMST "" UBYTE _CNV_A_R_LINEAR_____12_CM 1 100. 0. 255. ECU_ADDRESS 0x3fa49b FORMAT "%5.1" /end MEASUREMENT
/begin MEASUREMENT TOG_ST "" UBYTE _CNV_A_R_LINEAR_____12_CM 1 100. 0. 255. ECU_ADDRESS 0x3fa49c FORMAT "%5.1" /end MEASUREMENT
/begin MEASUREMENT TOG_STATE "" UBYTE _CNV_A_R_LINEAR_____12_CM 1 100. 0. 255. ECU_ADDRESS 0x3fa49d FORMAT "%5.1" /end MEASUREMENT
/begin MEASUREMENT TOG_TK "" UWORD _CNV_R_R_t_q0p1ms_505_CM 1 100. 0. 6553.5 ECU_ADDRESS 0x3fa494 FORMAT "%8.3" /end MEASUREMENT
/begin MEASUREMENT TOG_TR "" UWORD _CNV_R_R_t_q0p1ms_505_CM 1 100. 0. 6553.5 ECU_ADDRESS 0x3fa496 FORMAT "%8.3" /end MEASUREMENT
/begin MEASUREMENT TOG_TV "" UWORD _CNV_R_R_t_q0p1ms_505_CM 1 100. 0. 6553.5 ECU_ADDRESS 0x3fa498 FORMAT "%8.3" /end MEASUREMENT
/begin MEASUREMENT TOG_UPLCNT "" UBYTE _CNV_A_R_LINEAR_____12_CM 1 100. 0. 255. ECU_ADDRESS 0x3fa49e FORMAT "%5.1" /end MEASUREMENT
/begin AXIS_PTS ldp_id_saf_tab_1 "" 0x4340b INDEX_1 _REC_AXS_20_u1 255. _CNV_A_R_LINEAR_____10_CM 16 0. 255. FORMAT "%3.0" /end AXIS_PTS
/begin AXIS_PTS ldp_id_saf_tab_2 "" 0x4341c INDEX_2 _REC_AXS_20_u1 255. _CNV_A_R_LINEAR_____10_CM 16 0. 255. FORMAT "%3.0" /end AXIS_PTS
/begin AXIS_PTS ldpm_n_id_crk_acq "" 0x4532a N _REC_AXS_20_u2 8160. _CNV_A_R_LINEAR_____17_CM 6 0. 8160. FORMAT "%4.0" /end AXIS_PTS
/begin AXIS_PTS ldpm_n_id_cam_acq "" 0x45310 N _REC_AXS_20_u2 8160. _CNV_A_R_LINEAR_____17_CM 12 0. 8160. FORMAT "%4.0" /end AXIS_PTS
/begin COMPU_METHOD _CNV_A_R_LINEAR_____0_CM "" RAT_FUNC "%6.3" "°C" COEFFS 0 1.333333333333333 64. 0 0 1 /end COMPU_METHOD
/begin COMPU_METHOD _CNV_A_R_LINEAR_____1_CM "" RAT_FUNC "%6.3" "°C" COEFFS 0 1.333333333333333 0. 0 0 1 /end COMPU_METHOD
/begin COMPU_METHOD _CNV_A_R_LINEAR_____2_CM "" RAT_FUNC "%6.3" "°C" COEFFS 0 1. 0. 0 0 1 /end COMPU_METHOD
/begin COMPU_METHOD _CNV_A_R_LINEAR_____3_CM "" RAT_FUNC "%6.3" "°C" COEFFS 0 1. 40. 0 0 1 /end COMPU_METHOD
/begin COMPU_METHOD _CNV_A_R_LINEAR_____4_CM "" RAT_FUNC "%6.3" "%" COEFFS 0 2.56 0. 0 0 1 /end COMPU_METHOD
/begin COMPU_METHOD _CNV_A_R_LINEAR_____5_CM "" RAT_FUNC "%6.3" "rpm" COEFFS 0 3.125e-002 0. 0 0 1 /end COMPU_METHOD
/begin COMPU_METHOD _CNV_A_R_LINEAR_____10_CM "" RAT_FUNC "%6.3" "-" COEFFS 0 1. 0. 0 0 1 /end COMPU_METHOD
/begin COMPU_METHOD _CNV_S_2_RANGE______11_CM "" TAB_VERB "%6.3" "-" COMPU_TAB_REF _CNV_S_2_RANGE______11 /end COMPU_METHOD
/begin COMPU_VTAB _CNV_S_2_RANGE______11 "" TAB_VERB 2 0 "0" 1 "1" /end COMPU_VTAB
/begin COMPU_METHOD _CNV_A_R_LINEAR_____12_CM "" RAT_FUNC "%6.3" "[-]" COEFFS 0 1. 0. 0 0 1 /end COMPU_METHOD
/begin COMPU_METHOD _CNV_A_R_LINEAR_____13_CM "" RAT_FUNC "%6.3" "km/h" COEFFS 0 1. 0. 0 0 1 /end COMPU_METHOD
/begin COMPU_METHOD _CNV_A_R_LINEAR_____14_CM "" RAT_FUNC "%6.3" "s" COEFFS 0 10. 0. 0 0 1 /end COMPU_METHOD
/begin COMPU_METHOD _CNV_A_R_LINEAR_____17_CM "" RAT_FUNC "%6.3" "rpm" COEFFS 0 1. 0. 0 0 1 /end COMPU_METHOD
/begin COMPU_METHOD _CNV_A_R_LINEAR_____18_CM "" RAT_FUNC "%6.3" "mg/stk" COEFFS 0 0.183585313174946 0. 0 0 1 /end COMPU_METHOD
/begin COMPU_METHOD _CNV_A_R_LINEAR_____20_CM "" RAT_FUNC "%6.3" "-" COEFFS 0 255.9983911655618 0. 0 0 1 /end COMPU_METHOD
/begin COMPU_METHOD _CNV_S_2_RANGE______21_R_CM "" TAB_VERB "%6.3" "[-]" COMPU_TAB_REF _CNV_S_2_RANGE______21_R /end COMPU_METHOD
/begin COMPU_VTAB_RANGE _CNV_S_2_RANGE______21_R "" 2 0 0 "0" 1 255 "1" /end COMPU_VTAB_RANGE
/begin COMPU_METHOD _CNV_A_R_LINEAR_____26_CM "" RAT_FUNC "%6.3" "V" COEFFS 0 9.846168103048838 0. 0 0 1 /end COMPU_METHOD
/begin COMPU_METHOD _CNV_A_R_LINEAR_____27_CM "" RAT_FUNC "%6.3" "s" COEFFS 0 100. 0. 0 0 1 /end COMPU_METHOD
/begin COMPU_METHOD _CNV_S_2_RANGE______28_CM "" TAB_VERB "%6.3" "[-]" COMPU_TAB_REF _CNV_S_2_RANGE______28 /end COMPU_METHOD
/begin COMPU_VTAB _CNV_S_2_RANGE______28 "" TAB_VERB 2 0 "0" 1 "1" /end COMPU_VTAB
/begin COMPU_METHOD _CNV_A_R_LINEAR_____31_CM "" RAT_FUNC "%6.3" "-" COEFFS 0 65536.00007936121 0. 0 0 1 /end COMPU_METHOD
/begin COMPU_METHOD _CNV_A_R_LINEAR_____33_CM "" RAT_FUNC "%6.3" "V" COEFFS 0 204.7999998974999 0. 0 0 1 /end COMPU_METHOD
/begin COMPU_METHOD _CNV_A_R_LINEAR_____34_CM "" RAT_FUNC "%6.3" "-" COEFFS 0 127.9991955827809 0. 0 0 1 /end COMPU_METHOD
/begin COMPU_METHOD _CNV_A_R_LINEAR_____35_CM "" RAT_FUNC "%6.3" "min" COEFFS 0 1. 0. 0 0 1 /end COMPU_METHOD
/begin COMPU_METHOD _CNV_A_R_LINEAR_____36_CM "" RAT_FUNC "%6.3" "-" COEFFS 0 51.0204081632653 0. 0 0 1 /end COMPU_METHOD
/begin COMPU_METHOD _CNV_A_R_LINEAR_____37_CM "" RAT_FUNC "%6.3" "V" COEFFS 0 102.4003523452984 0. 0 0 1 /end COMPU_METHOD
/begin COMPU_METHOD _CNV_A_R_LINEAR_____38_CM "" RAT_FUNC "%6.3" "V" COEFFS 0 51.0204081632653 0. 0 0 1 /end COMPU_METHOD
/begin COMPU_METHOD _CNV_A_R_LINEAR_____39_CM "" RAT_FUNC "%6.3" "kg/h" COEFFS 0 64.00000000417234 0. 0 0 1 /end COMPU_METHOD
/begin COMPU_METHOD _CNV_A_R_LINEAR_____40_CM "" RAT_FUNC "%6.3" "-" COEFFS 0 16. 0. 0 0 1 /end COMPU_METHOD
/begin COMPU_METHOD _CNV_A_R_LINEAR_____41_CM "" RAT_FUNC "%6.3" "kg/h" COEFFS 0 64. 0. 0 0 1 /end COMPU_METHOD
/begin COMPU_METHOD _CNV_A_R_LINEAR_____42_CM "" RAT_FUNC "%6.3" "[-]" COEFFS 0 32. 0. 0 0 1 /end COMPU_METHOD
/begin COMPU_METHOD _CNV_A_R_LINEAR_____43_CM "" RAT_FUNC "%6.3" "hPa" COEFFS 0 12.06017666543982 0. 0 0 1 /end COMPU_METHOD
/begin COMPU_METHOD _CNV_A_R_LINEAR_____44_CM "" RAT_FUNC "%6.3" "[-]" COEFFS 0 255.9999357490357 0. 0 0 1 /end COMPU_METHOD
/begin COMPU_METHOD _CNV_A_R_LINEAR_____45_CM "" RAT_FUNC "%6.3" "-" COEFFS 0 32768.00003968061 0. 0 0 1 /end COMPU_METHOD
/begin COMPU_METHOD _CNV_A_R_LINEAR_____47_CM "" RAT_FUNC "%6.3" "s" COEFFS 0 1. 0. 0 0 1 /end COMPU_METHOD
/begin COMPU_METHOD _CNV_A_R_LINEAR_____53_CM "" RAT_FUNC "%6.3" "V" COEFFS 0 9.807692307692308 0. 0 0 1 /end COMPU_METHOD
/begin COMPU_METHOD _CNV_A_R_LINEAR_____78_CM "" RAT_FUNC "%6.3" "km/h" COEFFS 0 128.0000018750286 0. 0 0 1 /end COMPU_METHOD
/begin COMPU_METHOD _CNV_A_R_LINEAR_____81_CM "" RAT_FUNC "%6.3" "V" COEFFS 0 10. -50. 0 0 1 /end COMPU_METHOD
/begin COMPU_METHOD _CNV_A_R_LINEAR_____82_CM "" RAT_FUNC "%6.3" "A" COEFFS 0 10. 0. 0 0 1 /end COMPU_METHOD
/begin COMPU_METHOD _CNV_A_R_LINEAR_____83_CM "" RAT_FUNC "%6.3" "rpm" COEFFS 0 2.e-002 0. 0 0 1 /end COMPU_METHOD
/begin COMPU_METHOD _CNV_A_R_LINEAR_____94_CM "" RAT_FUNC "%6.3" "%" COEFFS 0 655.3600000071681 0. 0 0 1 /end COMPU_METHOD
/begin COMPU_METHOD _CNV_A_R_LINEAR_____95_CM "" RAT_FUNC "%6.3" "mg/stk" COEFFS 0 47.18142548596112 0. 0 0 1 /end COMPU_METHOD
/begin COMPU_METHOD _CNV_A_R_LINEAR_____99_CM "" RAT_FUNC "%6.3" "kg/h" COEFFS 0 8191.999999679995 0. 0 0 1 /end COMPU_METHOD
/begin COMPU_METHOD _CNV_A_R_LINEAR_____100_CM "" RAT_FUNC "%6.3" "g" COEFFS 0 2949840.175137362 0. 0 0 1 /end COMPU_METHOD
/begin COMPU_METHOD _CNV_A_R_LINEAR_____101_CM "" RAT_FUNC "%6.3" "kg/h" COEFFS 0 32. 0. 0 0 1 /end COMPU_METHOD
/begin COMPU_METHOD _CNV_A_R_LINEAR_____102_CM "" RAT_FUNC "%6.3" "hPa" COEFFS 0 12.06017666543982 32767.5 0 0 1 /end COMPU_METHOD
/begin COMPU_METHOD _CNV_A_R_LINEAR_____103_CM "" RAT_FUNC "%6.3" "-" COEFFS 0 128. 0. 0 0 1 /end COMPU_METHOD
/begin COMPU_METHOD _CNV_A_R_LINEAR_____104_CM "" RAT_FUNC "%6.3" "-" COEFFS 0 1023.999999959999 0. 0 0 1 /end COMPU_METHOD
/begin COMPU_METHOD _CNV_A_R_LINEAR_____115_CM "" RAT_FUNC "%6.3" "Hz" COEFFS 0 1. 0. 0 0 1 /end COMPU_METHOD
/begin COMPU_METHOD _CNV_A_R_LINEAR_____116_CM "" RAT_FUNC "%6.3" "%" COEFFS 0 1.28 0. 0 0 1 /end COMPU_METHOD
/begin COMPU_METHOD _CNV_A_R_LINEAR_____117_CM "" RAT_FUNC "%6.3" "%" COEFFS 0 2.56 128. 0 0 1 /end COMPU_METHOD
/begin COMPU_METHOD _CNV_S_7_RANGE_STAT_118_CM "" TAB_VERB "%6.3" "-" COMPU_TAB_REF _CNV_S_7_RANGE_STAT_118 /end COMPU_METHOD
/begin COMPU_VTAB _CNV_S_7_RANGE_STAT_118 "" TAB_VERB 7 0 "T_CP_NOT_ACT" 1 "T_CP_1_ACT" 2 "T_MFF_AD_1_ACT" 3 "T_MFF_AD_DEAC" 4 "T_MFF_AD_ACT" 5 "T_CP_2_ACT" 6 "T_CP_DEAC" /end COMPU_VTAB
/begin COMPU_METHOD _CNV_A_R_LINEAR_____163_CM "" RAT_FUNC "%6.3" "Grad C" COEFFS 0 1. 40. 0 0 1 /end COMPU_METHOD
/begin COMPU_METHOD _CNV_A_R_LINEAR_____173_CM "" RAT_FUNC "%6.3" "%" COEFFS 0 327.680000003584 3.584063961170614e-007 0 0 1 /end COMPU_METHOD
/begin COMPU_METHOD _CNV_S_2_RANGE______184_R_CM "" TAB_VERB "%6.3" "-" COMPU_TAB_REF _CNV_S_2_RANGE______184_R /end COMPU_METHOD
/begin COMPU_VTAB_RANGE _CNV_S_2_RANGE______184_R "" 2 0 0 "0" 1 255 "1" /end COMPU_VTAB_RANGE
/begin COMPU_METHOD _CNV_A_R_LINEAR_____208_CM "" RAT_FUNC "%6.3" "ms" COEFFS 0 250. 0. 0 0 1 /end COMPU_METHOD
/begin COMPU_METHOD _CNV_A_R_LINEAR_____210_CM "" RAT_FUNC "%6.3" "V" COEFFS 0 35.63776976537597 0. 0 0 1 /end COMPU_METHOD
/begin COMPU_METHOD _CNV_A_R_LINEAR_____211_CM "" RAT_FUNC "%6.3" "°C" COEFFS 0 16. 0. 0 0 1 /end COMPU_METHOD
/begin COMPU_METHOD _CNV_A_R_LINEAR_____227_CM "" RAT_FUNC "%6.3" "*360°CRK" COEFFS 0 1. 0. 0 0 1 /end COMPU_METHOD
/begin COMPU_METHOD _CNV_S_21_STATE_IVVT_228_CM "" TAB_VERB "%6.3" "-" COMPU_TAB_REF _CNV_S_21_STATE_IVVT_228 /end COMPU_METHOD
/begin COMPU_VTAB _CNV_S_21_STATE_IVVT_228 "" TAB_VERB 21 0 "Ini" 1 "Ad-Pas" 2 "Ad-Re" 3 "Ad-Ena" 4 "Ad-Lih" 5 "Ena-Ad" 6 "Ena-Lih" 7 "Ena-Pas" 8 "Ena-Re" 9 "Pas-Re" 10 "Pas-Lih" 11 "Re-Ena" 12 "Re-Ad" 13 "Re-Lih" 14 "Re-Pas" 15 "Ini-Pas" 16 "Ini-Par" 17 "Par-Pas" 18 "Par-Ena" 19 "Par-Lih" 20 "Ena-Par" /end COMPU_VTAB
/begin COMPU_METHOD _CNV_S_7_STATE_IVVT_229_CM "" TAB_VERB "%6.3" "-" COMPU_TAB_REF _CNV_S_7_STATE_IVVT_229 /end COMPU_METHOD
/begin COMPU_VTAB _CNV_S_7_STATE_IVVT_229 "" TAB_VERB 7 0 "Passive" 1 "Ready" 2 "Enable" 3 "Limp Home" 4 "Adaptation" 5 "Parking" 6 "Init" /end COMPU_VTAB
/begin COMPU_METHOD _CNV_A_R_LINEAR_____231_CM "" RAT_FUNC "%6.3" "°CRK" COEFFS 0 -2.666666666666667 -106.6666666666667 0 0 1 /end COMPU_METHOD
/begin COMPU_METHOD _CNV_A_R_LINEAR_____232_CM "" RAT_FUNC "%6.3" "°CRK" COEFFS 0 42.66666666666666 0. 0 0 1 /end COMPU_METHOD
/begin COMPU_METHOD _CNV_A_R_LINEAR_____234_CM "" RAT_FUNC "%6.3" "°CRK" COEFFS 0 2.666666666666667 -160. 0 0 1 /end COMPU_METHOD
/begin COMPU_METHOD _CNV_A_R_LINEAR_____248_CM "" RAT_FUNC "%6.3" "µs" COEFFS 0 0.25 0. 0 0 1 /end COMPU_METHOD
/begin COMPU_METHOD _CNV_A_R_LINEAR_____250_CM "" RAT_FUNC "%6.3" "°CRK" COEFFS 0 2.666666666666667 32768. 0 0 1 /end COMPU_METHOD
/begin COMPU_METHOD _CNV_A_R_LINEAR_____352_CM "" RAT_FUNC "%6.3" "%" COEFFS 0 327.6800790412251 0. 0 0 1 /end COMPU_METHOD
/begin COMPU_METHOD _CNV_A_R_spg_ubatt_479_CM "" RAT_FUNC "%6.3" "[-]" COEFFS 0 10.61571125265393 0. 0 0 1 /end COMPU_METHOD
/begin COMPU_METHOD _CNV_R_R_temp_uw_q0_481_CM "" RAT_FUNC "%6.3" "[-]" COEFFS 0. 1. 48. 0. 0. 0.75 /end COMPU_METHOD
/begin COMPU_METHOD _CNV_R_R_igen_ub_q1_483_CM "" RAT_FUNC "%6.3" "[-]" COEFFS 0. 1. 0. 0. 0. 1. /end COMPU_METHOD
/begin COMPU_METHOD _CNV_R_R_t10msxs_ub_489_CM "" RAT_FUNC "%6.3" "s" COEFFS 0. 1. 0. 0. 0. 1.e-002 /end COMPU_METHOD
/begin COMPU_METHOD _CNV_A_R_LINEAR_____490_CM "" RAT_FUNC "%6.3" "µs" COEFFS 0 1. 0. 0 0 1 /end COMPU_METHOD
/begin COMPU_METHOD _CNV_R_R_t_q0p1ms_505_CM "" RAT_FUNC "%6.3" "ms" COEFFS 0. 10. 0. 0. 0. 1. /end COMPU_METHOD
/begin COMPU_METHOD _CNV_S_2_B_TRUE_519_CM "" TAB_VERB "%6.3" "[-]" COMPU_TAB_REF _CNV_S_2_B_TRUE_519 /end COMPU_METHOD
/begin COMPU_VTAB _CNV_S_2_B_TRUE_519 "" TAB_VERB 2 0 "----" 1 "TRUE" /end COMPU_VTAB
/begin COMPU_METHOD _CNV_A_R_nmot_ub_q4_537_CM "" RAT_FUNC "%6.3" "[-]" COEFFS 0 2.5e-002 0. 0 0 1 /end COMPU_METHOD
/begin COMPU_METHOD _CNV_R_R_nmot_ub_q1_538_CM "" RAT_FUNC "%6.3" "[-]" COEFFS 0. 1. 0. 0. 0. 10. /end COMPU_METHOD
/begin COMPU_METHOD _CNV_R_R_niv_ub_b75_550_CM "" RAT_FUNC "%6.3" "mm" COEFFS 0. 256. 0. 0. 0. 75. /end COMPU_METHOD
/begin COMPU_METHOD _CNV_R_R_km_sw_q10_551_CM "" RAT_FUNC "%6.3" "[-]" COEFFS 0. 0.1 0. 0. 0. 1. /end COMPU_METHOD
/begin COMPU_METHOD _CNV_R_R_temp_ub_q1_552_CM "" RAT_FUNC "%6.3" "[-]" COEFFS 0. 1. 48. 0. 0. 1. /end COMPU_METHOD
/begin COMPU_METHOD _CNV_R_R_perm_uw_b6_553_CM "" RAT_FUNC "%6.3" "[-]" COEFFS 0. 65536. 0. 0. 0. 6. /end COMPU_METHOD
/begin COMPU_METHOD _CNV_R_R_lf_ub_554_CM "" RAT_FUNC "%6.3" "[-]" COEFFS 0. 100. 0. 0. 0. 1. /end COMPU_METHOD
/begin COMPU_METHOD _CNV_R_R_temp_ub_q1_555_CM "" RAT_FUNC "%6.3" "°C" COEFFS 0. 1. 55.2 0. 0. 0.90078125 /end COMPU_METHOD
/begin COMPU_METHOD _CNV_R_R_niv_sb_b37_556_CM "" RAT_FUNC "%6.3" "[-]" COEFFS 0. 256. 0. 0. 0. 75. /end COMPU_METHOD
/begin COMPU_METHOD _CNV_R_R_nivmmxl_ub_557_CM "" RAT_FUNC "%6.3" "[-]" COEFFS 0. 32. 0. 0. 0. 1. /end COMPU_METHOD
/begin COMPU_METHOD _CNV_R_R_perm_sw_b6_558_CM "" RAT_FUNC "%6.3" "[-]" COEFFS 0. 32768. 0. 0. 0. 6. /end COMPU_METHOD
/begin COMPU_METHOD _CNV_R_R_fuel_uw_q1_559_CM "" RAT_FUNC "%6.3" "L" COEFFS 0. 1. 0. 0. 0. 1. /end COMPU_METHOD
/begin COMPU_METHOD _CNV_R_R_DEZ_560_CM "" RAT_FUNC "%6.3" "-" COEFFS 0. 1. 0. 0. 0. 1. /end COMPU_METHOD
/begin COMPU_METHOD _CNV_R_R_fuel_ul_q0_561_CM "" RAT_FUNC "%6.3" "L" COEFFS 0. 8192. 0. 0. 0. 1. /end COMPU_METHOD
/begin COMPU_METHOD _CNV_R_R_km_uw_q10_562_CM "" RAT_FUNC "%6.3" "km" COEFFS 0. 1. 0. 0. 0. 10. /end COMPU_METHOD
/begin COMPU_METHOD _CNV_A_R_rasc_for_b_563_CM "" RAT_FUNC "%6.3" "[-]" COEFFS 0 10922.5 0. 0 0 1 /end COMPU_METHOD
/begin COMPU_METHOD _CNV_R_R_zk1sxs_ub__564_CM "" RAT_FUNC "%6.3" "sec." COEFFS 0. 1. 0. 0. 0. 1. /end COMPU_METHOD
/begin COMPU_METHOD _CNV_S_2_RANGE______565_CM "" TAB_VERB "%6.3" "[-]" COMPU_TAB_REF _CNV_S_2_RANGE______565 /end COMPU_METHOD
/begin COMPU_VTAB _CNV_S_2_RANGE______565 "" TAB_VERB 2 0 "OFF" 1 "ON" /end COMPU_VTAB
/begin COMPU_METHOD _CNV_R_R_fuel_uw_b6_574_CM "" RAT_FUNC "%6.3" "µL" COEFFS 0. 1. 0. 0. 0. 1. /end COMPU_METHOD
/begin COMPU_METHOD _CNV_A_R_spg_ubatt_575_CM "" RAT_FUNC "%6.3" "V" COEFFS 0 10.61571125265393 0. 0 0 1 /end COMPU_METHOD
/begin COMPU_METHOD _CNV_S_5_RANGE_BIOS_583_R_CM "" TAB_VERB "%6.3" "[-]" COMPU_TAB_REF _CNV_S_5_RANGE_BIOS_583_R /end COMPU_METHOD
/begin COMPU_VTAB_RANGE _CNV_S_5_RANGE_BIOS_583_R "" 5 110 111 "Resume" 182 183 "Set / Accelerate" 218 219 "OFF" 252 253 "Decelerate" 254 255 "None" /end COMPU_VTAB_RANGE
/begin RECORD_LAYOUT _REC_VAL_20_u1 FNC_VALUES 1 UBYTE COLUMN_DIR DIRECT /end RECORD_LAYOUT
/begin RECORD_LAYOUT _REC_AXS_20_u1 NO_AXIS_PTS_X 1 UBYTE AXIS_PTS_X 2 UBYTE INDEX_INCR DIRECT /end RECORD_LAYOUT
/begin RECORD_LAYOUT _REC_CUR_20_u1_u1 FNC_VALUES 1 UBYTE COLUMN_DIR DIRECT /end RECORD_LAYOUT
/begin RECORD_LAYOUT _REC_AXS_20_u2 NO_AXIS_PTS_X 1 UWORD AXIS_PTS_X 2 UWORD INDEX_INCR DIRECT /end RECORD_LAYOUT
/begin RECORD_LAYOUT _REC_CUR_20_u2_u2 FNC_VALUES 1 UWORD COLUMN_DIR DIRECT /end RECORD_LAYOUT
/begin RECORD_LAYOUT _REC_VAL_20_u2 FNC_VALUES 1 UWORD COLUMN_DIR DIRECT /end RECORD_LAYOUT
/begin RECORD_LAYOUT _REC_CUR_20_u2_u1 FNC_VALUES 1 UWORD COLUMN_DIR DIRECT /end RECORD_LAYOUT
/begin RECORD_LAYOUT _REC_MAP_20_u1_u1_u2 FNC_VALUES 1 UBYTE COLUMN_DIR DIRECT /end RECORD_LAYOUT
/begin RECORD_LAYOUT _REC_CUR_20_u1_u2 FNC_VALUES 1 UBYTE COLUMN_DIR DIRECT /end RECORD_LAYOUT
/begin RECORD_LAYOUT _REC_MAP_20_u2_u1_u1 FNC_VALUES 1 UWORD COLUMN_DIR DIRECT /end RECORD_LAYOUT
/begin RECORD_LAYOUT _REC_VAL_20_s2 FNC_VALUES 1 SWORD COLUMN_DIR DIRECT /end RECORD_LAYOUT
/begin RECORD_LAYOUT _REC_MAP_20_u1_u2_u2 FNC_VALUES 1 UBYTE COLUMN_DIR DIRECT /end RECORD_LAYOUT
/begin RECORD_LAYOUT _REC_VAL_20_s1 FNC_VALUES 1 SBYTE COLUMN_DIR DIRECT /end RECORD_LAYOUT
/begin RECORD_LAYOUT _REC_CUR_52_u2_u2 NO_AXIS_PTS_X 1 UWORD AXIS_PTS_X 2 UWORD INDEX_INCR DIRECT FNC_VALUES 3 UWORD COLUMN_DIR DIRECT /end RECORD_LAYOUT
/begin RECORD_LAYOUT _REC_CUR_52_UBYTE_s1_u1 NO_AXIS_PTS_X 1 UBYTE AXIS_PTS_X 2 UBYTE INDEX_INCR DIRECT FNC_VALUES 3 SBYTE COLUMN_DIR DIRECT /end RECORD_LAYOUT
/begin RECORD_LAYOUT _REC_CUR_52_u1_u1 NO_AXIS_PTS_X 1 UBYTE AXIS_PTS_X 2 UBYTE INDEX_INCR DIRECT FNC_VALUES 3 UBYTE COLUMN_DIR DIRECT /end RECORD_LAYOUT
/begin RECORD_LAYOUT _REC_VAL_20_S8 FNC_VALUES 1 FLOAT64_IEEE COLUMN_DIR DIRECT /end RECORD_LAYOUT
/begin FUNCTION AUX_Infinitely_variable_valve_ti "_Infinitely variable valve timing intake and exhaust"
 /begin DEF_CHARACTERISTIC C_SUM_CYC_CAM_DIAG_IVVT C_TOIL_MIN_IVVT C_VB_MAX_IVVT C_VB_MIN_IVVT ID_DLY_ST_IVVT C_TOIL_HYS_IVVT C_TCO_MIN_IVVT_PARK C_TCO_MAX_IVVT_PARK LC_ENA_IVVT_PARK IP_TOIL_MAX_IVVT /end DEF_CHARACTERISTIC
 /begin OUT_MEASUREMENT STATE_IVVT_TRAN LV_ENA_IVVT_PARK STATE_IVVT LV_INH_IVVT_IN_1 LV_INH_IVVT_IN_2 LV_INH_IVVT_EX_1 LV_INH_IVVT_EX_2 /end OUT_MEASUREMENT
/end FUNCTION
/begin FUNCTION AUX_Exhaust_flap_actuation "_Exhaust flap actuation"
 /begin DEF_CHARACTERISTIC ID_NR_IP_GEAR_EF_AT ID_NR_IP_GEAR_EF_MT IP_PV_MIN_AT_2_EF IP_PV_MIN_AT_3_EF IP_PV_MIN_AT_4_EF IP_PV_MIN_AT_5_EF IP_PV_MIN_MT_1_EF IP_PV_MIN_MT_2_EF IP_PV_MIN_MT_3_EF IP_PV_MIN_MT_4_EF C_PV_HYS_EF C_VS_MIN_EF_AT C_VS_MIN_EF_MT C_T_EF_AST C_STATE_VS_MIN_EF_AT C_STATE_VS_MIN_EF_MT IP_PV_MIN_MT_5_EF C_STATE_CH_EF IP_PV_MIN_AT_1_EF /end DEF_CHARACTERISTIC
 /begin OUT_MEASUREMENT LV_EF /end OUT_MEASUREMENT
/end FUNCTION
/begin FUNCTION AUX_IVVT_application_Incidences "_IVVT application Incidences"
 /begin DEF_CHARACTERISTIC ID_CAM_0_SEG_OFS__CAM_EDGE_NR ID_CAM_1_SEG_OFS__CAM_EDGE_NR C_N_MAX_IVVT_1 C_N_MAX_IVVT_2 /end DEF_CHARACTERISTIC
 /begin OUT_MEASUREMENT CAM_EDGE_NR_1 CAM_EDGE_NR_0 CAM_RAW_IN_1 CAM_EDGE_NR_IN_1 CAM_PSN_CAP_SAVE_IVVT_IN_1 CAM_RAW_IN_2 CAM_EDGE_NR_IN_2 CAM_PSN_CAP_SAVE_IVVT_IN_2 CAM_RAW_EX_1 CAM_EDGE_NR_EX_1 CAM_PSN_CAP_SAVE_IVVT_EX_1 CAM_RAW_EX_2 CAM_EDGE_NR_EX_2 CAM_PSN_CAP_SAVE_IVVT_EX_2 IVVTPWM_1 IVVTPWM_0 LV_HLD_IVVTPWM_0 LV_HLD_IVVTPWM_1 T_STOP_CUR_IVVTPWM_0 T_STOP_CUR_IVVTPWM_1 /end OUT_MEASUREMENT
/end FUNCTION
/begin FUNCTION AUX_Starter_Relay_Control "_Starter Relay Control" /begin DEF_CHARACTERISTIC C_N_THD_ES_BLOCK /end DEF_CHARACTERISTIC /begin OUT_MEASUREMENT LV_RLY_ST /end OUT_MEASUREMENT /end FUNCTION
/begin FUNCTION AUX_E_box_cooling_fan "_E-box cooling fan"
 /begin DEF_CHARACTERISTIC C_TECU_THD_EBOX_CFA C_TECU_HYS_EBOX_CFA C_TIA_THD_EBOX_CFA C_TIA_HYS_EBOX_CFA /end DEF_CHARACTERISTIC
 /begin OUT_MEASUREMENT LV_EBOX_CFA /end OUT_MEASUREMENT
/end FUNCTION
/begin FUNCTION AUX_Electrical_fuel_pump_Interfa "_Electrical fuel pump Interface" /end FUNCTION
/begin FUNCTION AUX_IVVT_setpoint_for_homogeneou "_IVVT setpoint for homogeneous-lean"
 /begin DEF_CHARACTERISTIC IP_CAM_SP_1_EX_AFL__N__MAF_IVVT IP_CAM_SP_2_EX_AFL__N__MAF_IVVT IP_CAM_SP_2_IN_AFL__N__MAF_IVVT IP_CAM_SP_1_IN_AFL__N__MAF_IVVT /end DEF_CHARACTERISTIC
 /begin OUT_MEASUREMENT CAM_SP_AV_IN_AFL CAM_SP_AV_EX_AFL /end OUT_MEASUREMENT
/end FUNCTION
/begin FUNCTION AUX_IVVT_setpoint_for_stratified "_IVVT setpoint for stratified mode"
 /begin DEF_CHARACTERISTIC IP_CAM_SP_1_IN_IS_S__N__MFF_MMV IP_CAM_SP_2_IN_IS_S__N__MFF_MMV IP_CAM_SP_2_IN_PL_S__N__MFF_MMV IP_CAM_SP_1_IN_PL_S__N__MFF_MMV IP_CAM_SP_1_EX_IS_S__N__MFF_MMV IP_CAM_SP_2_EX_IS_S__N__MFF_MMV IP_CAM_SP_2_EX_PL_S__N__MFF_MMV IP_CAM_SP_1_EX_PL_S__N__MFF_MMV C_CRLC_MFF_SP_S /end DEF_CHARACTERISTIC
 /begin OUT_MEASUREMENT CAM_SP_AV_IN_S CAM_SP_AV_EX_S MFF_MMV /end OUT_MEASUREMENT
/end FUNCTION
/begin FUNCTION AUX_Application_incidences_for_t "__Application incidences for the Evaporative emission control"
 /begin OUT_MEASUREMENT LV_OBD_CDN_CLOSE_MOD LV_OBD_CDN_MIN_MOD LV_ACT_EVAP FLOW_SP_CPS_EVAP /end OUT_MEASUREMENT
/end FUNCTION
/begin FUNCTION AUX_Sound_Flap_Control "_Sound Flap Control"
 /begin DEF_CHARACTERISTIC C_V_SOF_SWI_ON_BOL C_PV_AV_SOF_HYS C_N_SOF_HYS C_VS_SOF_MAX C_T_AST_SOF C_TIA_SOF_MIN C_SOFPWM_MIN C_T_SOF_ACT_MAX ID_SOF_REQ_GEAR_0 ID_SOF_REQ_GEAR_1 ID_SOF_REQ_GEAR_2 ID_SOF_REQ_GEAR_3 ID_SOF_REQ_GEAR_4 ID_SOF_REQ_GEAR_5 ID_SOF_REQ_GEAR_6 IP_FAC_SOFPWM_ON IP_FAC_SOFPWM_OFF IP_FAC_SOFPWM_VB IP_FAC_SOFPWM_TIA C_VS_SOF_MAX_HYS C_T_ES_SOF LC_SOF_ACT_KWP C_SOFPWM_MAX C_V_SOF_SWI_ON_TOL C_V_SOF_SWI_AMT_ON_TOL LC_VAR_SOF_SWI LC_VAR_SOF_SWI_AMT C_SOFPWM_SOF_MAX_DIAG C_SOFPWM_SOF_MIN_DIAG /end DEF_CHARACTERISTIC
 /begin OUT_MEASUREMENT SOFPWM LV_SOF_INH PV_AV_SOF_REQ N_SOF_REQ LV_SOF_ACT LV_SOF_REQ T_SOF_ACT SOFPWM_SOF SOFPWM_COR LV_SOF_SWI_REQ LV_SOF_SWI LV_SOF_SWI_AMT LV_SOF_SWI_AMT_REQ /end OUT_MEASUREMENT
/end FUNCTION
/begin FUNCTION AUX_Coordination_of_secondary_ai "_Coordination of secondary air mass flow determination" /begin DEF_CHARACTERISTIC LC_SA_SWI_ACQ /end DEF_CHARACTERISTIC /begin OUT_MEASUREMENT SAF_KGH SAF_MDL /end OUT_MEASUREMENT /end FUNCTION
/begin FUNCTION AUX_Electronically_controlled_ra "_Electronically controlled radiator shutter"
 /begin DEF_CHARACTERISTIC C_T_DLY_MAX_ECRAS_ON C_T_DLY_MAX_ECRAS_OFF C_N_32_ECRAS_ON C_VS_FIL_ECRAS_ON C_TCO_EX_ECRAS_ON C_TCO_EX_ECRAS_OFF C_N_ECF_ECRAS_ON C_N_ECF_ECRAS_OFF C_TIA_ECRAS_ON C_TIA_ECRAS_OFF C_TEMP_GB_ECRAS_ON C_TEMP_GB_ECRAS_OFF C_ECTPWM_ECRAS_ON C_ECTPWM_ECRAS_OFF LC_ECRAS_MAN_ACT LC_TEST_ECRAS LC_ECRAS_ERR_TCO LC_INH_ECRAS C_VS_FIL_ECRAS_OFF /end DEF_CHARACTERISTIC
 /begin OUT_MEASUREMENT LV_CDN_ECRAS_ON LV_CDN_ECRAS_OFF LV_ECRAS_OFF LV_ECRAS_ON LV_ECRAS CTR_T_DLY_ECRAS_ON CTR_T_DLY_ECRAS_OFF /end OUT_MEASUREMENT
/end FUNCTION
/begin FUNCTION AUX_Flow_Calculations___Evaporat "_Flow Calculations - Evaporative Emission Control"
 /begin DEF_CHARACTERISTIC C_FLOW_CPS_AS C_MAF_TOT_CP_DLY_CRLC C_FLOW_CPS_DLY_CRLC LC_FLOW_CPS_AS IP_CPPWM__FLOW_COR_CPS__PRS_CPS IP_FAC_AMP_CP__AMP IP_FAC_TIA_CP__TIA_THR IP_FLOW_CPS__PRS_CPS IP_FUEL_DLY_CPS__N_32 IP_FUEL_FAC_CPS__N_32 IP_FLOW_CPS_DEC__MAF_CYL IP_FLOW_CPS_INC__MAF_CYL IP_T_DLY_CP__MAF_CYL /end DEF_CHARACTERISTIC
 /begin OUT_MEASUREMENT REL_FLOW_CPS_AV MFF_ADD_CP FLOW_SP_CPS FLOW_COR_CPS FLOW_REQ_CPS FLOW_CPS CPPWM_SP FUEL_CPS FUEL_FLOW_ADD_BUF_0_ FUEL_FLOW_ADD_BUF_1_ FUEL_FLOW_ADD_BUF_2_ FUEL_FLOW_ADD_BUF_3_ FUEL_FLOW_ADD_BUF_4_ FUEL_FLOW_ADD_BUF_5_ FUEL_FLOW_ADD_BUF_6_ FUEL_FLOW_ADD_BUF_7_ FUEL_FLOW_ADD_BUF_8_ FUEL_FLOW_ADD_BUF_9_ FUEL_FLOW_ADD_BUF_10_ FUEL_FLOW_ADD_BUF_11_ FUEL_FLOW_ADD_BUF_12_ FUEL_FLOW_ADD_BUF_13_ FUEL_FLOW_ADD_BUF_14_ FUEL_FLOW_ADD_BUF_15_ FUEL_FLOW_ADD_BUF_16_ FUEL_FLOW_ADD_BUF_17_ FUEL_FLOW_ADD_BUF_18_ FUEL_FLOW_ADD_BUF_19_ FLOW_TOT_CPS FUEL_TOT_CPS MAF_CPS FAC_TIA_AMP_CP MAF_TOT_CP_DLY_OLD MAF_TOT_CP_OLD2 FLOW_CPS_DLY FLOW_CPS_DLY_OLD FLOW_CPS_OLD FLOW_CPS_OLD2 FLOW_CPS_DLY_MMV MAF_TOT_CP MAF_TOT_CP_DLY MAF_TOT_CP_DLY_MMV MAF_TOT_CP_OLD CPPWM /end OUT_MEASUREMENT
/end FUNCTION
/begin FUNCTION AUX_Time_Control_between_lambda_ "_Time Control between lambda adaption and canister purge"
 /begin DEF_CHARACTERISTIC C_T_1_CP C_T_2_CP C_T_DI_CP C_T_MFF_AD_MAX C_T_1_MFF_AD C_CL_MMV_T_BOL C_CL_MMV_T_TOL IP_T_MAX_CP__CL_MMV /end DEF_CHARACTERISTIC
 /begin OUT_MEASUREMENT STATE_T_SDL_CP T_CP T_MAX_CP LV_MFF_AD_ENA LV_CP_ENA T_AD T_MAX_AD /end OUT_MEASUREMENT
/end FUNCTION
/begin FUNCTION AUX_Canister_Purge_ON_OFF_Valve_ "_Canister Purge ON/OFF Valve Control"
 /begin DEF_CHARACTERISTIC C_N_FRQ_1_CPS C_N_FRQ_2_CPS C_N_FRQ_HYS_CPS C_CPPWM_FRQ_1_CPS C_CPPWM_FRQ_2_CPS C_CPPWM_FRQ_HYS_CPS C_CPPWM_FRQ_1 C_CPPWM_FRQ_2 C_CPPWM_MAX_CPS_DIAG_FRQ_1 C_CPPWM_MAX_CPS_DIAG_FRQ_2 C_CPPWM_MIN_CPS_DIAG_FRQ_1 C_CPPWM_MIN_CPS_DIAG_FRQ_2 C_CPPWM_AS LC_CPPWM_LIM_DIAG LC_CPPWM_AS IP_CPPWM_VB_ADD_1__VB IP_CPPWM_VB_ADD_2__VB IP_CPPWM_VB_FAC__VB IP_CPPWM_COR_FRQ__CPPWM_REF /end DEF_CHARACTERISTIC
 /begin OUT_MEASUREMENT CPPWM_CPS CPPWM_REF LV_FRQ_1_CPS FRQ_REQ_CP LV_CLOSE_ACT_CP /end OUT_MEASUREMENT
/end FUNCTION
/begin FUNCTION AUX_Variable_Intake_Manifold "_Variable Intake Manifold"
 /begin DEF_CHARACTERISTIC C_VIMPWM_2 C_VIMPWM_3 C_VIMPWM_1 C_VIM_AV_2 C_VIM_AV_3 C_VIM_AV_1 C_N_VIM_L C_N_VIM_HYS C_N_VIM_H C_FAC_MAF_MAX_VIM C_FAC_MAF_MAX_VIM_HYS IP_FAC_N_VIM /end DEF_CHARACTERISTIC
 /begin OUT_MEASUREMENT VIMPWM N_VIM VIM_AV LV_VIM /end OUT_MEASUREMENT
/end FUNCTION
/begin FUNCTION AUX_QLT_SENSOR "_QLT_SENSOR"
 /begin DEF_CHARACTERISTIC OZKMVL OZLANGLIM1 OZLANGLIM2 OZLIM1HEAL OZLIM2HEAL OZORLIM2 OZVORLIM1 OZVORLIM2 OZDELAY OZDIAGSPG OZERRD OZHEAL OZNIVKL OZPERMKL OZTEMPKL OZMWK OZMWL OZMWOR OZMWV OZNFCNT OZNFTMPMAX OZNFTMPMIN OZNIVMMLIT OZNIVNFM05 OZNIVNFM10 OZNMOTMAX OZNMOTMIN OZTEMPBW OZTEMPORR OZNMNIVKL OZOELKMPL OZPERMCOK5 OZPERMMIN OZPERMMNIV OZPERMNK3 OZPERMTIK6 OZPERMTIK8 OZPERMTIK9 OZPERMTK12 OZPERMTK13 OZPERMTK4 OZPERMTK7 OZANFANZ OZKMMAXK11 OZKVB96 OZKVBMXK18 OZKVBOK16 OZLF1 OZLF2 OZMNKMBO OZMXOHK15 OZPERBOK17 OZPERBRK14 OZPERXK10 OZTAGCTERR OZZEITFAKT OZTEMPZK CW_OZ OZKMUPL OZBZKMSTK1 /end DEF_CHARACTERISTIC
 /begin OUT_MEASUREMENT OZBGBITS1_1S B_MOL_VB B_BOSMSGC B_MOL_VL B_OELTEMP B_MOL_SF OZBGBITS3_1S B_OZKL15 BOS01_W BOSSTATE IDFBOSMG_W IDFBOSMGT IDBOSMSG TOELOZ TOL ZRBOSMLD OZKMSTVL OZVLDISTC OZVLDIST OZTEMPF OZGGBITS2_1S B_NIVERRB B_OZSHEAL B_PERMERRB B_SIGB B_TEMPERRB OZGGBITS3_1S B_SVCNTCHG B_OZWERTOK B_OELWECH B_OZDELAY B_OZNIV B_OZPERM B_OZTEMIC B_OZTEMP OZGGBITS4_1S B_DMEWECH B_DMEINI BOSBTVFBK IDFBOSRTT OZNIV OZPERM_W OZSVCNTCHG OZTEMP ZRBOSRT OZVFBDMEW OZLOWPERM0_0_ OZLOWPERM0_1_ OZLOWPERM0_2_ OZLOWPERM0_3_ OZLOWPERM0_4_ OZLOWPERM0_5_ OZLOWPEREX_0_ OZLOWPEREX_1_ OZLOWPEREX_2_ OZLOWPEREX_3_ OZLOWPEREX_4_ OZLOWPEREX_5_ OZLOWKM_0_ OZLOWKM_1_ OZLOWKM_2_ OZLOWKM_3_ OZLOWKM_4_ OZLOWKM_5_ OZLOWRWANZ_0_ OZLOWRWANZ_1_ OZLOWRWANZ_2_ OZLOWRWANZ_3_ OZLOWRWANZ_4_ OZLOWRWANZ_5_ OZLOWCNT OZPERMERRC OZTEMPERRC OZNIVERRC OZSIGERRC OZNIVBITS3_1S B_OZOR B_OZVORMW OZNIVBITS2_1S B_OZLW1 OZNIVBITS4_1S B_OZLANGMW OZKRZOR OZLANGMW OZNIVNFM OZVORMW OZKMLOW OZOELKM OZPERMEX OZPERMLOW OZNIVKM OZPERMANZ OZPERMOFF OZPERMREG_0_ OZPERMREG_1_ OZPERMREG_2_ OZPERMREG_3_ OZPERMREG_4_ OZPERMREG_5_ OZPERMREG_6_ OZPERMREG_7_ OZPERMREG_8_ OZPERMREG_9_ OZPERMREG_10_ OZPERMREG_11_ OZPERMREG_12_ OZPERMREG_13_ OZPERMREG_14_ OZKMREG_0_ OZKMREG_1_ OZKMREG_2_ OZKMREG_3_ OZKMREG_4_ OZKMREG_5_ OZKMREG_6_ OZKMREG_7_ OZKMREG_8_ OZKMREG_9_ OZKMREG_10_ OZKMREG_11_ OZKMREG_12_ OZKMREG_13_ OZKMREG_14_ OZPRFSTRG OZLF1T OZRWANZ OZVFANZ OZCTTAGINI OZKVBOG OZKVBSM_UL OZLF2T OZLF2C OZLF1C OZKMSTRW0 OZPERMBOG KMSTAND ZRBOSR M_TOL KVAVERBR ZTAGEABS_W IDBOSRST IDFBOSRT_W VBOST B_SA OZKMSTVLT OZRWANZT OZVFTMP KVAVERL OZDKVB OZGWFNBO OZKVBBGW OZKVBMX OZKVBOGW OZKVBTMP1 OZKVBTMP2 OZKVBTMP3 OZKVBTMP4 OZOELZEIT OZPERMBGW OZPERMBOGW OZPERMMA OZPERMTMP1 OZPERMTMP2 OZPERMTMP3 OZRWKVB OZRWKVBA OZRWKVBR OZRWP OZRWPERM OZRWPERMA OZRWPERMR OZRWZEIT OZRWZEITA OZRWZEITR OZVFKVB OZVFZEIT OZZEITTMP1 OZZEITTMP2 OZZEITTMP3 B_OZFBSD BOSBTVFBKT OZNIVR OZNIVT OZPERMR_W OZPERMT OZSTATUS OZTEMPR OZTEMPT OZDINDEX OZDPERM OZDPERMSI OZERANZP1 OZERANZP2 OZERANZPRF OZKMPERMGL OZLAUFVAR OZPERMERP1 OZPERMERP2 OZPERMERPR OZPERMKMP1 OZPERMKMP2 OZPERMKMPR OZPERMKO_W OZPERMPL_W OZSHIFT OZTV1 OZTV2 OZTV3 TODELTIME OZKRZCNT OZKRZMW OZKRZMWKOR OZLGMWCNT OZNIVLGALT OZNIVLGNEU OZNIVNFLIT OZNMOTMW OZVORMWCNT /end OUT_MEASUREMENT
/end FUNCTION
/begin FUNCTION AUX_Application_incidences_for_E "_Application incidences for Electrical fuel pump Interface"
 /begin OUT_MEASUREMENT LV_EFP_ON_EXT_ADJ_CAN LV_EFP_OFF_EXT_ADJ_CAN STATE_DIAG_EFP STATE_EFP_CAN V_ENG_EFP CUR_ENG_EFP VB_EFP N_EFP_AV /end OUT_MEASUREMENT
/end FUNCTION
/begin FUNCTION AUX_Mastershift "_Mastershift" /end FUNCTION
/begin FUNCTION BIO_Basic_SW_Inputs_and_Outputs "BIO"
 /begin SUB_FUNCTION BIO_Standard_analog_inputs BIO_Keyword_Protocol_2000 BIO_PWM_outputs BIO_Logic_inputs BIO_Acquisition_of_after_ignitio BIO_MSW_interface BIO_Acquisition_of_oil_pressure_ BIO_Acquisition_of_secondary_air BIO_Aquisition_Oil_temperature_a /end SUB_FUNCTION
/end FUNCTION
/begin FUNCTION BIO_Standard_analog_inputs "_Standard analog inputs"
 /begin DEF_CHARACTERISTIC C_CAM_SYNC_DLY C_N_MIN_CRK_TOOTH_VLD ID_CRK_GAP_RATIO ID_CAM_TOOTH_PER_SP_FAC__N ID_CRK_TOOTH_PER_SP_FAC ID_SAF_TAB ID_CAM_TOOTH_RATIO__N ID_CRK_TOOTH_RATIO ID_MAF_TAB /end DEF_CHARACTERISTIC
 /begin OUT_MEASUREMENT V_AMP V_TIA V_PVS_1 V_PVS_2 V_TCO V_TCO_EX V_TPS_1 V_TPS_2 V_LS_UP_1 V_LS_UP_2 V_LS_DOWN_2 V_LS_DOWN_1 VCC_PVS_1 VCC_PVS_2 V_VIM_FB V_EGR V_TEG_PCAT_DOWN_1 V_TEG_PCAT_DOWN_2 V_PORT V_TECU V_FPS V_SAF MAF_CTR_1 MAF_SUM_1 MAF_SUM V_MAF VB_BAS MAF_CTR LV_MAF_SEG V_IGK_BAS VCC_MAF V_TOIL V_PVS_2_MC V_PVS_2_MU /end OUT_MEASUREMENT
/end FUNCTION
/begin FUNCTION BIO_Keyword_Protocol_2000 "_Keyword Protocol 2000"
 /begin OUT_MEASUREMENT V_DUR_IGC_0 V_DUR_IGC_1 V_DUR_IGC_2 V_DUR_IGC_3 V_DUR_IGC_4 V_DUR_IGC_5 LV_TD_IGC_CUT_0 LV_TD_IGC_CUT_1 LV_TD_IGC_CUT_2 LV_TD_IGC_CUT_3 LV_TD_IGC_CUT_4 LV_TD_IGC_CUT_5 /end OUT_MEASUREMENT
/end FUNCTION
/begin FUNCTION BIO_PWM_outputs "_PWM outputs" /begin DEF_CHARACTERISTIC C_SWI_VEPU_AS /end DEF_CHARACTERISTIC /end FUNCTION
/begin FUNCTION BIO_Logic_inputs "_Logic inputs"
 /begin OUT_MEASUREMENT LV_IM_BLS LV_IM_ST LV_IM_LOCK LV_IM_CRU_SET_AC LV_IM_CRU_RESU_DECE LV_IM_CRU_MAIN_OFF LV_IM_BTS LV_IM_CS_PN /end OUT_MEASUREMENT
/end FUNCTION
/begin FUNCTION BIO_Acquisition_of_after_ignitio "_Acquisition of after ignition key battery voltage" /begin OUT_MEASUREMENT LV_KEY_OFF BIOS_T_SEG_MIS VB_MES V_IGK_MES /end OUT_MEASUREMENT /end FUNCTION
/begin FUNCTION BIO_MSW_interface "_MSW interface" /begin OUT_MEASUREMENT BIOS_CRU_DATA /end OUT_MEASUREMENT /end FUNCTION
/begin FUNCTION BIO_Acquisition_of_oil_pressure_ "_Acquisition of oil pressure switch" /begin OUT_MEASUREMENT LV_POIL_SWI /end OUT_MEASUREMENT /end FUNCTION
/begin FUNCTION BIO_Acquisition_of_secondary_air "_Acquisition of secondary air mass flow"
 /begin OUT_MEASUREMENT SAF_KGH_MES_BAS SAF_SUM SAF_SUM_1 SAF_CTR SAF_CTR_1 LV_SAF_SEG /end OUT_MEASUREMENT
/end FUNCTION
/begin FUNCTION BIO_Aquisition_Oil_temperature_a "_Aquisition Oil temperature and level sensor"
 /begin DEF_CHARACTERISTIC TOG_TK_MAX TOG_TK_MIN TOG_TR_MAX TOG_TR_MIN TOG_TV_MAX TOG_TV_MIN TOG_VERS TOGVERZOEG /end DEF_CHARACTERISTIC
 /begin OUT_MEASUREMENT UB B_TOEL B_TOG TOG_CNT TOG_ICNT TOG_PWMST TOG_ST TOG_STATE TOG_TK TOG_TR TOG_TV TOG_UPLCNT /end OUT_MEASUREMENT
/end FUNCTION
/begin FUNCTION DIA_Diagnosis_and_limp_home "DIA"
 /begin SUB_FUNCTION DIA_Mass_air_flow_meter DIA_Intake_air_temperature_senso DIA_Temperature_sensor___TCO_EX_ DIA_IVVT_diagnosis DIA_Fuel_pump_relay_RLY_EFP DIA_Ambient_pressure_sensor DIA_Upstream_oxygen_sensor_heate DIA_Downstream_oxygen_sensor_hea DIA_Oil_temperature_sensor_TOIL DIA_Electronically_controlled_th DIA_Temperature_exhaust_gas_sens DIA_Knock_sensor_diagnosis DIA_Vehicle_speed_signal_diagnos DIA_Ignition_system_diagnosis DIA_Throttle_position_sensor_dia DIA_Injection_valves_IV_1_to_6 DIA_Canister_purge_valve_diagnos DIA_ETC_driver_diagnosis DIA_Lambda_sensor_upstream_heate DIA_Lambda_sensor_downstream_hea DIA_Generator_diagnosis DIA_Crankshaft_Signal_Diagnosis_ DIA_Camshaft_Sensor_Diagnosis_an DIA_Secondary_Air_Valve_Diagnosi DIA_Electronical_Cooling_Fan_Dia DIA_Secondary_Air_Pump_Diagnosis DIA_Air_Condition_Compressor_Con DIA_Main_Relay_Diagnosis__RLY_MA DIA_Coolant_Temperature_Sensor_D DIA_TCO_Sensor_Plausibility_Diag DIA_Idle_Speed_Control_Diagnosis DIA_CAN_diagnosis DIA_Multifunctional_steering_whe DIA_Pedal_value_sensor_diagnosis DIA_Brake_light_switch_diagnosis DIA_Idle_Speed_Actuator_Diagnosi DIA_Engine_roughness_idle_diagno DIA_Variable_Intake_Manifold__VI DIA_Immobilizer_signal_diagnosis DIA_Exhaust_flap_diagnosis DIA_Anti_bounce_algorithm DIA_Torque_Request_for_Safety_Di DIA_E_box_cooling_fan_diagnosis DIA_ECU_temperature_sensor_diagn DIA_Upstream_oxygen_sensor_signa DIA_Application_incidences_for_u DIA_Application_incidences_for_d DIA_Downstream_oxygen_sensor_sig DIA_Tank_leakage_detection_diagn DIA_SOF_diagnosis DIA_Oil_pressure_switch_diagnosi DIA_Starter_Output_Diagnosis DIA_BSD_Diagnosis DIA_Diagnosis_Oil_temperature_an DIA_CAN_diagnosis_for_EFP_contro DIA_TPS___ETC_Limp_Home_Manager DIA_ETC_Actuator_diagnosis_and_A DIA_Electric_solenoid_valve_diag DIA_Distance_cruise_control_diag DIA_GS_intervention_plausibility DIA_AMT_intervention_plausibilit DIA_Electronically_controlled_ra DIA_DMTL_heater_diagnosis DIA_Application_incidences_NOx_S DIA_NOx_Sensor_Diagnosis___OBD_I DIA_CAN_diagnosis_for_NOX_contro /end SUB_FUNCTION
/end FUNCTION
/begin FUNCTION DIA_Mass_air_flow_meter "_Mass air flow meter"
 /begin DEF_CHARACTERISTIC C_N_MIN_MAF_DIAG C_MAF_MIN_DIAG C_ISAPWM_MAF_MIN_ISA_DIAG C_MAF_KGH_DIAG_INI ID_CRLC_MAF_DIAG__N_32 IP_MAF_MAX_ISA__PQ_TURB_SYS IP_FAC_PQ_ISA__ISAPWM_ISA C_MAF_MAX_DIAG C_FAC_TQ_REQ_MIN_MAF_DIAG /end DEF_CHARACTERISTIC
 /begin OUT_MEASUREMENT PQ_TURB_SYS MAF_SUB_ISA MAF_KGH_DIAG LV_MAF_BLS_DIAG LV_ERR_MAF /end OUT_MEASUREMENT
/end FUNCTION
/begin FUNCTION DIA_Intake_air_temperature_senso "_Intake air temperature sensor"
 /begin DEF_CHARACTERISTIC C_TCO_DIAG C_TIA_MAX_DIAG C_TIA_MIN_DIAG C_TIA_SUB_BOL C_TIA_SUB_TOL /end DEF_CHARACTERISTIC
 /begin OUT_MEASUREMENT LV_ERR_TIA /end OUT_MEASUREMENT
/end FUNCTION
/begin FUNCTION DIA_Temperature_sensor___TCO_EX_ "_Temperature sensor - TCO_EX Coolant" /begin DEF_CHARACTERISTIC C_T_TIA_TCO_EX_DIAG /end DEF_CHARACTERISTIC /begin OUT_MEASUREMENT LV_ERR_TCO_EX /end OUT_MEASUREMENT /end FUNCTION
/begin FUNCTION DIA_IVVT_diagnosis "_IVVT diagnosis" /begin DEF_CHARACTERISTIC C_T_DLY_DIAG_REF_IVVT /end DEF_CHARACTERISTIC
 /begin OUT_MEASUREMENT LV_ERR_IVVT LV_ERR_MEC_IVVT_IN_1 LV_ERR_REF_IVVT_IN_1 LV_ERR_MEC_IVVT_IN_2 LV_ERR_REF_IVVT_IN_2 LV_ERR_REF_IVVT_EX_1 LV_ERR_MEC_IVVT_EX_2 LV_ERR_REF_IVVT_EX_2 LV_ERR_MEC_IVVT_EX_1 /end OUT_MEASUREMENT
/end FUNCTION
/begin FUNCTION DIA_Fuel_pump_relay_RLY_EFP "_Fuel pump relay RLY_EFP" /begin OUT_MEASUREMENT LV_ERR_RLY_EFP /end OUT_MEASUREMENT /end FUNCTION
/begin FUNCTION DIA_Ambient_pressure_sensor "_Ambient pressure sensor" /begin DEF_CHARACTERISTIC C_AMP_REF C_V_AMP_MAX_DIAG C_V_AMP_MIN_DIAG /end DEF_CHARACTERISTIC /begin OUT_MEASUREMENT LV_ERR_AMP /end OUT_MEASUREMENT /end FUNCTION
/begin FUNCTION DIA_Upstream_oxygen_sensor_heate "_Upstream oxygen sensor heater diagnosis" /begin DEF_CHARACTERISTIC C_TEG_DYN_MIN_LSH_DIAG C_PWM_LSH_UP_MIN C_PWM_LSH_UP_MAX /end DEF_CHARACTERISTIC /begin OUT_MEASUREMENT LV_INH_DIAG_LSH_UP_2 LV_INH_DIAG_LSH_UP_1 /end OUT_MEASUREMENT /end FUNCTION
/begin FUNCTION DIA_Downstream_oxygen_sensor_hea "_Downstream oxygen sensor heater diagnosis"
 /begin DEF_CHARACTERISTIC C_PWM_LSH_DOWN_MAX C_PWM_LSH_DOWN_MIN C_TEG_CAT_DOWN_MDL_MIN_LSH_DIAG /end DEF_CHARACTERISTIC
 /begin OUT_MEASUREMENT LV_INH_DIAG_LSH_DOWN_1 LV_INH_DIAG_LSH_DOWN_2 /end OUT_MEASUREMENT
/end FUNCTION
/begin FUNCTION DIA_Oil_temperature_sensor_TOIL "_Oil temperature sensor TOIL"
 /begin DEF_CHARACTERISTIC C_TOIL_MIN_DIAG C_TCO_MAX_TOIL_DIAG C_TOIL_SUB_DIAG C_TOIL_MAX_DIAG /end DEF_CHARACTERISTIC
 /begin OUT_MEASUREMENT LV_ERR_TOIL /end OUT_MEASUREMENT
/end FUNCTION
/begin FUNCTION DIA_Electronically_controlled_th "_Electronically controlled thermostat diagnosis (ECT)"
 /begin DEF_CHARACTERISTIC C_TCO_ST_ECT_PLAUS_DIAG C_T_PUC_TCO_EX_PLAUS_DIAG C_TCO_TCO_EX_PLAUS_DIAG C_TCO_EX_TCO_EX_PLAUS_DIAG C_TAM_MIN_TCO_EX_PLAUS_DIAG C_TCO_TCO_EX_PLAUS_DIAG_MIN C_N_MIN_ECT_PLAUS_DIAG C_ECTPWM_MIN_DIAG C_ECTPWM_MAX_DIAG /end DEF_CHARACTERISTIC
 /begin OUT_MEASUREMENT LV_ERR_ECT T_PUC_INT_ECT_DIAG LV_ERR_ECT_MEC LV_ERR_ECT_EL /end OUT_MEASUREMENT
/end FUNCTION
/begin FUNCTION DIA_Temperature_exhaust_gas_sens "_Temperature exhaust gas sensor diagnosis (TEG)"
 /begin DEF_CHARACTERISTIC C_V_TEG_PCAT_DOWN_DIAG_MIN C_V_TEG_PCAT_DOWN_DIAG_MAX C_V_TEG_MES_GRD_MAX /end DEF_CHARACTERISTIC
 /begin OUT_MEASUREMENT LV_ERR_PREL_TEG_PCAT_DOWN_2 LV_ERR_PREL_TEG_PCAT_DOWN_1 LV_ERR_TEG_PCAT_DOWN_1 LV_ERR_TEG_PCAT_DOWN_2 /end OUT_MEASUREMENT
/end FUNCTION
/begin FUNCTION DIA_Knock_sensor_diagnosis "_Knock sensor diagnosis"
 /begin DEF_CHARACTERISTIC C_N_MIN_KNKS_DIAG C_MAF_MIN_KNKS_DIAG C_NL_MIN_DIAG C_NL_MAX_DIAG /end DEF_CHARACTERISTIC
 /begin OUT_MEASUREMENT LV_ERR_KNKS_1 LV_ERR_KNKS_2 /end OUT_MEASUREMENT
/end FUNCTION
/begin FUNCTION DIA_Vehicle_speed_signal_diagnos "_Vehicle speed signal diagnosis" /begin DEF_CHARACTERISTIC C_MAF_VS_MIN_DIAG C_N_VS_MIN_DIAG C_T_VS_MIN_DIAG /end DEF_CHARACTERISTIC /begin OUT_MEASUREMENT T_VS_DIAG T_VS_END_DIAG /end OUT_MEASUREMENT /end FUNCTION
/end MODULE
/end PROJECT
