ASAP2_VERSION 1 31
/begin PROJECT MS45 "BMW Motorsteuerung R6"
/begin HEADER "_default_HeaderComment" PROJECT_NO _52 /end HEADER
/begin MODULE _default_ModuleName "_default_ModuleLongIdentifier"
/begin MOD_COMMON "_default_ModCommonComment" DEPOSIT ABSOLUTE BYTE_ORDER MSB_FIRST ALIGNMENT_BYTE 1 ALIGNMENT_WORD 2 ALIGNMENT_LONG 4 ALIGNMENT_FLOAT32_IEEE 4 ALIGNMENT_FLOAT64_IEEE 8 /end MOD_COMMON
/begin MEASUREMENT ERR_INFO_STAT "" UBYTE _CNV_S_2_RANGE______21_R_CM 1 100. 0. 255. ECU_ADDRESS 0x3fd598 /end MEASUREMENT
/begin CHARACTERISTIC C_V_CONV_THD_DEAC_MON "Threshold for A/D-converter test deactivation" VALUE 0x4027c _REC_VAL_20_u1 4.998 _CNV_A_R_LINEAR_____38_CM 0. 4.998 FORMAT "%5.3" /end CHARACTERISTIC
/begin CHARACTERISTIC C_V_PVS_2_CONV_RATIO_HYS_MON "Maximum ratio between PVS channel 2 on main controller and on monitoring unit" VALUE 0x4027d _REC_VAL_20_u1 4.998 _CNV_A_R_LINEAR_____38_CM 0. 4.998 FORMAT "%5.3" /end CHARACTERISTIC
/begin CHARACTERISTIC C_CAN_VB_MIN_DIAG_MON "Threshold of battery voltage for CAN diagnosis" VALUE 0x4025c _REC_VAL_20_u1 26. _CNV_A_R_LINEAR_____53_CM 0. 26. FORMAT "%4.1" /end CHARACTERISTIC
/begin CHARACTERISTIC C_T_MSR_INH_MON "Delay time for disable of MSR torque demand in monitoring level" VALUE 0x4026e _REC_VAL_20_u1 10.2 _CNV_A_R_LINEAR_____87_CM 0. 10.2 FORMAT "%5.2" /end CHARACTERISTIC
/begin CHARACTERISTIC C_TQI_STND_MON "Maximum indicated engine torque (scalling factor for torque demands from CAN)" VALUE 0x4027b _REC_VAL_20_u1 510. _CNV_A_R_LINEAR_____88_CM 0. 510. FORMAT "%4.0" /end CHARACTERISTIC
/begin MEASUREMENT TQI_MSR_MON "Torque demand from drag control" UBYTE _CNV_A_R_LINEAR_____88_CM 1 100. 0. 510. ECU_ADDRESS 0x3feceb FORMAT "%4.0" /end MEASUREMENT
/begin MEASUREMENT T_MSR_INH_MON "Timer for inhibition of MSR torque demand in monitoring level" UBYTE _CNV_A_R_LINEAR_____87_CM 1 100. 0. 10.2 ECU_ADDRESS 0x3fecec FORMAT "%5.2" /end MEASUREMENT
/begin MEASUREMENT ABC_MSR_INH_MON "Anti bounce counter for fault in MSR present" UBYTE _CNV_A_R_LINEAR_____10_CM 1 100. 0. 255. ECU_ADDRESS 0x3fecf4 FORMAT "%3.0" /end MEASUREMENT
/begin MEASUREMENT TQ_MSR_MON "Torque demand from drag control BN 2000" SWORD _CNV_A_R_LINEAR_____48_CM 1 100. -1024. 1023.96875 ECU_ADDRESS 0x3fed54 FORMAT "%8.2" /end MEASUREMENT
/begin MEASUREMENT TQ_DCC_MON "DCC torque request for monitoring" SWORD _CNV_A_R_LINEAR_____48_CM 1 100. -1024. 1023.96875 ECU_ADDRESS 0x3fed56 FORMAT "%8.2" /end MEASUREMENT
/begin MEASUREMENT ABC_DCC_INH_MON "Anti bounce counter for fault in DCC present" UBYTE _CNV_A_R_LINEAR_____10_CM 1 100. 0. 255. ECU_ADDRESS 0x3fecf5 FORMAT "%3.0" /end MEASUREMENT
/begin MEASUREMENT LV_ERR_DCC_REV_MON "Reversible DCC error mon" UBYTE _CNV_S_2_RANGE______21_R_CM 1 100. 0. 255. ECU_ADDRESS 0x3fecc6 /end MEASUREMENT
/begin MEASUREMENT T_DCC_BRAKE_DET_MON "Irreversible DCC error mon" UBYTE _CNV_A_R_LINEAR_____87_CM 1 100. 0. 10.2 ECU_ADDRESS 0x3fecfb FORMAT "%5.2" /end MEASUREMENT
/begin MEASUREMENT LV_ERR_DCC_INH_MON "Logical variable for fault in DCC present" UBYTE _CNV_S_2_RANGE______21_R_CM 1 100. 0. 255. ECU_ADDRESS 0x3fecbb /end MEASUREMENT
/begin MEASUREMENT T_DCC_INH_MON "Timer for inhibition of DCC torque demand in monitoring level" UBYTE _CNV_A_R_LINEAR_____87_CM 1 100. 0. 10.2 ECU_ADDRESS 0x3feced FORMAT "%5.2" /end MEASUREMENT
/begin MEASUREMENT STATE_ERR_AMT_MON "State of AMT Error intervention" UBYTE _CNV_A_R_LINEAR_____10_CM 1 100. 0. 255. ECU_ADDRESS 0x3fecf0 FORMAT "%3.0" /end MEASUREMENT
/begin MEASUREMENT T_STATE_AMT_1_DIAG_MON "Intervention  in shift phase 1" UBYTE _CNV_A_R_LINEAR_____87_CM 1 100. 0. 10.2 ECU_ADDRESS 0x3fecfc FORMAT "%5.2" /end MEASUREMENT
/begin MEASUREMENT T_STATE_AMT_2_DIAG_MON "Intervention  in shift phase 2" UBYTE _CNV_A_R_LINEAR_____87_CM 1 100. 0. 10.2 ECU_ADDRESS 0x3fecfd FORMAT "%5.2" /end MEASUREMENT
/begin MEASUREMENT T_STATE_AMT_3_DIAG_MON "Intervention  in shift phase 3" UBYTE _CNV_A_R_LINEAR_____87_CM 1 100. 0. 10.2 ECU_ADDRESS 0x3fecfe FORMAT "%5.2" /end MEASUREMENT
/begin MEASUREMENT T_STATE_CLU_AMT_DIAG_MON "Timer clutch state 3" UBYTE _CNV_A_R_LINEAR_____87_CM 1 100. 0. 10.2 ECU_ADDRESS 0x3fecff FORMAT "%5.2" /end MEASUREMENT
/begin MEASUREMENT T_TQI_AMT_DIAG_MON "Intervention timer  1 or 3" UBYTE _CNV_A_R_LINEAR_____87_CM 1 100. 0. 10.2 ECU_ADDRESS 0x3fed01 FORMAT "%5.2" /end MEASUREMENT
/begin MEASUREMENT TQI_AMT_PLAUS_MON "Plausibility torque" UBYTE _CNV_A_R_LINEAR_____88_CM 1 100. 0. 510. ECU_ADDRESS 0x3fed02 FORMAT "%3.0" /end MEASUREMENT
/begin MEASUREMENT TQI_GS_MON "Torque demand from drag control  CAN 11H" UBYTE _CNV_A_R_LINEAR_____88_CM 1 100. 0. 510. ECU_ADDRESS 0x3fecf1 FORMAT "%3.0" /end MEASUREMENT
/begin MEASUREMENT LV_ERR_AMT_INH_MON "Logical variable for fault in MSR present" UBYTE _CNV_S_2_RANGE______21_R_CM 1 100. 0. 255. ECU_ADDRESS 0x3fecbe /end MEASUREMENT
/begin MEASUREMENT T_AMT_INH_MON "Timer for inhibition of AMT torque demand in monitoring level" UBYTE _CNV_A_R_LINEAR_____87_CM 1 100. 0. 10.2 ECU_ADDRESS 0x3fecef FORMAT "%5.2" /end MEASUREMENT
/begin MEASUREMENT T_GS_INH_MON "Timer for inhibition of GS torque demand in monitoring level" UBYTE _CNV_A_R_LINEAR_____87_CM 1 100. 0. 10.2 ECU_ADDRESS 0x3fecf2 FORMAT "%5.2" /end MEASUREMENT
/begin MEASUREMENT TQ_GS_MON "Engine torgue request of EGS  Checked torque value in monitoring level" SWORD _CNV_A_R_LINEAR_____48_CM 1 100. -1024. 1023.96875 ECU_ADDRESS 0x3fed5a FORMAT "%8.2" /end MEASUREMENT
/begin MEASUREMENT LV_ERR_GS_INH_MON "Logical variable for fault in GS present" UBYTE _CNV_S_2_RANGE______21_R_CM 1 100. 0. 255. ECU_ADDRESS 0x3fecbd /end MEASUREMENT
/begin MEASUREMENT LV_ERR_TQ_GS_INC_PLAUS_MON "GS torque increase not plausible" UBYTE _CNV_S_2_RANGE______21_R_CM 1 100. 0. 255. ECU_ADDRESS 0x3fecc1 /end MEASUREMENT
/begin MEASUREMENT STATE_GS_PLAUS_MON "State GS torque increase not plausible bit coded" UBYTE _CNV_A_R_LINEAR_____10_CM 1 100. 0. 63. ECU_ADDRESS 0x3fecf3 FORMAT "%2.0" /end MEASUREMENT
/begin MEASUREMENT LV_INT_MAX_TQ_GS_INC_MON "Gs requested torque value to high and not plausible" UBYTE _CNV_S_2_RANGE______28_CM 1 100. 0. 1. ECU_ADDRESS 0x3fecc0 /end MEASUREMENT
/begin MEASUREMENT INT_TQ_GS_INC_MON "Integrated Torque request EGS" UWORD _CNV_A_R_LINEAR_____89_CM 1 100. 0. 204.7 ECU_ADDRESS 0x3fed5c FORMAT "%7.3" /end MEASUREMENT
/begin MEASUREMENT LV_VS_MIN_TQ_GS_INC_MON "GS about VS torque increase not plausible" UBYTE _CNV_S_2_RANGE______28_CM 1 100. 0. 1. ECU_ADDRESS 0x3fecbf /end MEASUREMENT
/begin MEASUREMENT CTR_T_VS_TQ_GS_INC_MON "Vehicle speed threshold time delay" UBYTE _CNV_A_R_LINEAR_____87_CM 1 100. 0. 10.2 ECU_ADDRESS 0x3fed03 FORMAT "%5.2" /end MEASUREMENT
/begin MEASUREMENT CTR_T_AC_TQ_GS_INC_MON "AC counter time delay" UBYTE _CNV_A_R_LINEAR_____87_CM 1 100. 0. 10.2 ECU_ADDRESS 0x3fed04 FORMAT "%5.2" /end MEASUREMENT
/begin MEASUREMENT LV_AC_MAX_TQ_GS_INC_MON "GS about AC requested torque value to high and not plausible" UBYTE _CNV_S_2_RANGE______28_CM 1 100. 0. 1. ECU_ADDRESS 0x3fecc2 /end MEASUREMENT
/begin MEASUREMENT LV_T_MIN_TQ_GS_INC_DEAC_MON "Minimum time between two requests to low" UBYTE _CNV_S_2_RANGE______28_CM 1 100. 0. 1. ECU_ADDRESS 0x3fecc3 /end MEASUREMENT
/begin MEASUREMENT CTR_T_MAX_TQ_GS_INC_MON "Counter MAX time limit threshold time" UBYTE _CNV_A_R_LINEAR_____87_CM 1 100. 0. 10.2 ECU_ADDRESS 0x3fed06 FORMAT "%5.2" /end MEASUREMENT
/begin MEASUREMENT LV_T_MAX_TQ_GS_INC_MON "Requesting time to long" UBYTE _CNV_S_2_RANGE______28_CM 1 100. 0. 1. ECU_ADDRESS 0x3fecc4 /end MEASUREMENT
/begin MEASUREMENT LV_TQ_MAX_TQ_GS_INC_MON "Inegrated torque to high" UBYTE _CNV_S_2_RANGE______28_CM 1 100. 0. 1. ECU_ADDRESS 0x3fecc5 /end MEASUREMENT
/begin MEASUREMENT CTR_T_DIF_MIN_TQ_GS_INC_MON "Minimum time between two requests to low" UBYTE _CNV_A_R_LINEAR_____87_CM 1 100. 0. 10.2 ECU_ADDRESS 0x3fed05 FORMAT "%5.2" /end MEASUREMENT
/begin MEASUREMENT CTR_T_TQ_MAX_TQ_GS_INC_MON "Min time limit threshold time delay" UBYTE _CNV_A_R_LINEAR_____87_CM 1 100. 0. 10.2 ECU_ADDRESS 0x3fed07 FORMAT "%5.2" /end MEASUREMENT
/begin CHARACTERISTIC C_ABC_INC_DCC_INH_MON "Anti bounce counter increment" VALUE 0x426cd _REC_VAL_20_u1 255. _CNV_A_R_LINEAR_____10_CM 0. 255. FORMAT "%3.0" /end CHARACTERISTIC
/begin CHARACTERISTIC C_ABC_MAX_DCC_INH_MON "Maximum value of anti-bounce counter" VALUE 0x42754 _REC_VAL_20_u1 254. _CNV_A_R_LINEAR_____10_CM 1. 255. FORMAT "%3.0" /end CHARACTERISTIC
/begin CHARACTERISTIC C_ABC_INC_DCC_REV_MON "Increment counter" VALUE 0x426d1 _REC_VAL_20_u1 255. _CNV_A_R_LINEAR_____10_CM 0. 255. FORMAT "%3.0" /end CHARACTERISTIC
/begin CHARACTERISTIC C_ABC_MAX_DCC_REV_MON "Maximum counter" VALUE 0x42758 _REC_VAL_20_u1 254. _CNV_A_R_LINEAR_____10_CM 1. 255. FORMAT "%3.0" /end CHARACTERISTIC
/begin CHARACTERISTIC C_T_DCC_INH_MON "Delay time for disable of DCC torque demand in monitoring level" VALUE 0x429cc _REC_VAL_20_u1 10.2 _CNV_A_R_LINEAR_____87_CM 0. 10.2 FORMAT "%5.2" /end CHARACTERISTIC
/begin CHARACTERISTIC C_ABC_INC_DCC_IRREV_MON "Increment counter" VALUE 0x426cf _REC_VAL_20_u1 255. _CNV_A_R_LINEAR_____10_CM 0. 255. FORMAT "%3.0" /end CHARACTERISTIC
/begin CHARACTERISTIC C_ABC_MAX_DCC_IRREV_MON "Maximum counter" VALUE 0x42756 _REC_VAL_20_u1 254. _CNV_A_R_LINEAR_____10_CM 1. 255. FORMAT "%3.0" /end CHARACTERISTIC
/begin CHARACTERISTIC C_T_MAX_BRAKE_DET_DCC_MON "Maximum Brake delay timer" VALUE 0x42a08 _REC_VAL_20_u1 10.2 _CNV_A_R_LINEAR_____87_CM 0. 10.2 FORMAT "%5.2" /end CHARACTERISTIC
/begin CHARACTERISTIC C_VS_FIL_AMT_MON "Vehicle speed threshold  engine stop" VALUE 0x431ca _REC_VAL_20_u2 511.99218 _CNV_A_R_LINEAR_____78_CM 0. 511.99218 FORMAT "%7.3" /end CHARACTERISTIC
/begin CHARACTERISTIC C_T_MAX_STATE_AMT_1_DIAG_MON "Max Intervention  in shift phase 1" VALUE 0x42a0d _REC_VAL_20_u1 10.2 _CNV_A_R_LINEAR_____87_CM 0. 10.2 FORMAT "%5.2" /end CHARACTERISTIC
/begin CHARACTERISTIC C_T_MAX_STATE_AMT_2_DIAG_MON "Max Intervention  in shift phase 2" VALUE 0x42a0e _REC_VAL_20_u1 10.2 _CNV_A_R_LINEAR_____87_CM 0. 10.2 FORMAT "%5.2" /end CHARACTERISTIC
/begin CHARACTERISTIC C_TQI_AMT_DIAG_MON "Plausibility torque intervention hysteresis" VALUE 0x42ade _REC_VAL_20_u1 510. _CNV_A_R_LINEAR_____88_CM 0. 510. FORMAT "%3.0" /end CHARACTERISTIC
/begin CHARACTERISTIC C_T_MAX_STATE_AMT_3_DIAG_MON "Max Intervention  in shift phase 3" VALUE 0x42a0f _REC_VAL_20_u1 10.2 _CNV_A_R_LINEAR_____87_CM 0. 10.2 FORMAT "%5.2" /end CHARACTERISTIC
/begin CHARACTERISTIC C_T_MAX_TQI_AMT_DIAG_MON "Max. timer shift intervention phase 1or 3" VALUE 0x42a16 _REC_VAL_20_u1 10.2 _CNV_A_R_LINEAR_____87_CM 0. 10.2 FORMAT "%5.2" /end CHARACTERISTIC
/begin CHARACTERISTIC C_TQI_AMT_COND_DIAG_MON "Torque at shift phase 0" VALUE 0x42add _REC_VAL_20_u1 510. _CNV_A_R_LINEAR_____88_CM 0. 510. FORMAT "%3.0" /end CHARACTERISTIC
/begin CHARACTERISTIC C_TQI_AMT_CAN_ES_MON "Torque at engine stop" VALUE 0x42adc _REC_VAL_20_u1 510. _CNV_A_R_LINEAR_____88_CM 0. 510. FORMAT "%3.0" /end CHARACTERISTIC
/begin CHARACTERISTIC C_T_MAX_STATE_CLU_AMT_DIAG_MON "Max. time at clutch" VALUE 0x42a10 _REC_VAL_20_u1 10.2 _CNV_A_R_LINEAR_____87_CM 0. 10.2 FORMAT "%5.2" /end CHARACTERISTIC
/begin CHARACTERISTIC C_ABC_INC_AMT_INH_MON "Anti bounce counter increment" VALUE 0x426b2 _REC_VAL_20_u1 255. _CNV_A_R_LINEAR_____10_CM 0. 255. FORMAT "%3.0" /end CHARACTERISTIC
/begin CHARACTERISTIC C_ABC_MAX_AMT_INH_MON "Maximum value of anti-bounce counter" VALUE 0x42739 _REC_VAL_20_u1 254. _CNV_A_R_LINEAR_____10_CM 1. 255. FORMAT "%3.0" /end CHARACTERISTIC
/begin CHARACTERISTIC C_T_AMT_INH_MON "Delay time for disable of AMT torque demand in monitoring level" VALUE 0x429bb _REC_VAL_20_u1 10.2 _CNV_A_R_LINEAR_____87_CM 0. 10.2 FORMAT "%5.2" /end CHARACTERISTIC
/begin CHARACTERISTIC C_ABC_INC_GS_INH_MON "Anti bounce counter increment" VALUE 0x426e0 _REC_VAL_20_u1 255. _CNV_A_R_LINEAR_____10_CM 0. 255. FORMAT "%3.0" /end CHARACTERISTIC
/begin CHARACTERISTIC C_ABC_INC_TQ_GS_INC_PLAUS_MON "Debounce counter increment - TQ_GS_INC Diagnosis" VALUE 0x42724 _REC_VAL_20_u1 255. _CNV_A_R_LINEAR_____10_CM 0. 255. FORMAT "%3.0" /end CHARACTERISTIC
/begin CHARACTERISTIC C_ABC_MAX_GS_INH_MON "Maximum value of anti-bounce counter" VALUE 0x42765 _REC_VAL_20_u1 254. _CNV_A_R_LINEAR_____10_CM 1. 255. FORMAT "%3.0" /end CHARACTERISTIC
/begin CHARACTERISTIC C_ABC_MAX_TQ_GS_INC_PLAUS_MON "Debounce counter maximum - TQ_GS_INC Diagnosis" VALUE 0x427a6 _REC_VAL_20_u1 254. _CNV_A_R_LINEAR_____10_CM 1. 255. FORMAT "%3.0" /end CHARACTERISTIC
/begin CHARACTERISTIC C_T_GS_INH_MON "Delay time for disable of GS torque demand in monitoring level" VALUE 0x429fb _REC_VAL_20_u1 10.2 _CNV_A_R_LINEAR_____87_CM 0. 10.2 FORMAT "%5.2" /end CHARACTERISTIC
/begin CHARACTERISTIC C_VS_MIN_TQ_GS_INC_MON "Vehicle speed threshold" VALUE 0x431d8 _REC_VAL_20_u2 511.99218 _CNV_A_R_LINEAR_____78_CM 0. 511.99218 FORMAT "%7.3" /end CHARACTERISTIC
/begin CHARACTERISTIC C_T_DLY_MIN_VS_TQ_GS_INC_MON "Vehicle speed threshold time delay" VALUE 0x429ef _REC_VAL_20_u1 10.2 _CNV_A_R_LINEAR_____87_CM 0. 10.2 FORMAT "%5.2" /end CHARACTERISTIC
/begin CHARACTERISTIC C_CRLC_TQ_GS_INC_PLAUS_MON "Corelation of torque request " VALUE 0x4283e _REC_VAL_20_u1 0.9960940000000002 _CNV_A_R_LINEAR_____44_CM 0. 0.996094 FORMAT "%5.3" /end CHARACTERISTIC
/begin CHARACTERISTIC C_INT_MAX_TQ_GS_INC_MON "Max value integrated torque" VALUE 0x42d9e _REC_VAL_20_u2 204.7 _CNV_A_R_LINEAR_____89_CM 0. 204.7 FORMAT "%7.3" /end CHARACTERISTIC
/begin CHARACTERISTIC C_INT_MIN_TQ_GS_INC_MON "Min value integrated torque" VALUE 0x42da2 _REC_VAL_20_u2 204.7 _CNV_A_R_LINEAR_____89_CM 0. 204.7 FORMAT "%7.3" /end CHARACTERISTIC
/begin CHARACTERISTIC C_T_DLY_AC_MAX_TQ_GS_INC_MON "AC threshold time delay" VALUE 0x429d4 _REC_VAL_20_u1 10.2 _CNV_A_R_LINEAR_____87_CM 0. 10.2 FORMAT "%5.2" /end CHARACTERISTIC
/begin CHARACTERISTIC C_T_MAX_TQ_GS_INC_MON "Min time limit threshold time delay" VALUE 0x42a15 _REC_VAL_20_u1 10.2 _CNV_A_R_LINEAR_____87_CM 0. 10.2 FORMAT "%5.2" /end CHARACTERISTIC
/begin CHARACTERISTIC C_T_DLY_TQ_MAX_TQ_GS_INC_MON "Min time limit threshold time delay" VALUE 0x429f6 _REC_VAL_20_u1 10.2 _CNV_A_R_LINEAR_____87_CM 0. 10.2 FORMAT "%5.2" /end CHARACTERISTIC
/begin AXIS_PTS ldp_vs_fil__tq_gs_inc_mon "" 0x44e38 VS_FIL _REC_AXS_20_u2 511.99218 _CNV_A_R_LINEAR_____78_CM 6 0. 511.99218 FORMAT "%7.3" /end AXIS_PTS
/begin AXIS_PTS ldp_n_32__tq_gs_inc_mon "" 0x4363c N_32 _REC_AXS_20_u1 8160. _CNV_A_R_LINEAR_____5_CM 6 0. 8160. FORMAT "%4.0" /end AXIS_PTS
/begin CHARACTERISTIC IP_AC_MAX_TQ_GS_INC_MON "Acceleration threshold" CURVE 0x45f5c _REC_CUR_20_u2_u2 31.44 _CNV_A_R_LINEAR_____90_CM -15.72 15.72 FORMAT "%7.4"
 /begin AXIS_DESCR COM_AXIS VS_FIL _CNV_A_R_LINEAR_____78_CM 6 0. 511.99218 FORMAT "%7.3" AXIS_PTS_REF ldp_vs_fil__tq_gs_inc_mon /end AXIS_DESCR
/end CHARACTERISTIC
/begin CHARACTERISTIC IP_TQ_MAX_TQ_GS_INC_MON "Maximum requested torque EGS " CURVE 0x4c380 _REC_CUR_20_u2_u1 1023.96875 _CNV_A_R_LINEAR_____48_CM 0. 1023.96875 FORMAT "%7.2"
 /begin AXIS_DESCR COM_AXIS N_32 _CNV_A_R_LINEAR_____5_CM 6 0. 8160. FORMAT "%4.0" AXIS_PTS_REF ldp_n_32__tq_gs_inc_mon /end AXIS_DESCR
/end CHARACTERISTIC
/begin MEASUREMENT ABC_AMT_INH_MON "Anti bounce counter for fault in AMT present" UBYTE _CNV_A_R_LINEAR_____10_CM 1 100. 0. 255. ECU_ADDRESS 0x3fecf6 FORMAT "%3.0" /end MEASUREMENT
/begin MEASUREMENT STATE_AMT_OLD_MON "Previos shift phase3 " UBYTE _CNV_A_R_LINEAR_____10_CM 1 100. 0. 3. ECU_ADDRESS 0x3fed00 FORMAT "%2.0" /end MEASUREMENT
/begin MEASUREMENT LV_ERR_DCC_IRREV_MON "Irreversible DCC error mon" UBYTE _CNV_S_2_RANGE______21_R_CM 1 100. 0. 255. ECU_ADDRESS 0x3fecc7 /end MEASUREMENT
/begin MEASUREMENT LV_DCC_OFF_ECU_MON "Irreversible DCC error mon" UBYTE _CNV_S_2_RANGE______21_R_CM 1 100. 0. 255. ECU_ADDRESS 0x3fecbc /end MEASUREMENT
/begin MEASUREMENT TQ_AMT_MON "Engine torgue request of AMT  Checked torque value in monitoring level" SWORD _CNV_A_R_LINEAR_____48_CM 1 100. -1024. 1023.96875 ECU_ADDRESS 0x3fed58 FORMAT "%8.2" /end MEASUREMENT
/begin MEASUREMENT TQI_AMT_MON "Torque demand from AMT control CAN11H" UBYTE _CNV_A_R_LINEAR_____88_CM 1 100. 0. 510. ECU_ADDRESS 0x3fecee FORMAT "%3.0" /end MEASUREMENT
/begin MEASUREMENT ABC_GS_INH_MON "Anti bounce counter for fault in GS present" UBYTE _CNV_A_R_LINEAR_____10_CM 1 100. 0. 255. ECU_ADDRESS 0x3fecf7 FORMAT "%3.0" /end MEASUREMENT
/begin CHARACTERISTIC C_INT_TQ_GS_INC_REST_MON "Minimum integrated GS intervention torque" VALUE 0x42da6 _REC_VAL_20_u2 204.7 _CNV_A_R_LINEAR_____89_CM 0. 204.7 FORMAT "%7.3" /end CHARACTERISTIC
/begin CHARACTERISTIC C_T_DIF_MIN_TQ_GS_INC_MON "Min time limit threshold time delay" VALUE 0x429d3 _REC_VAL_20_u1 10.2 _CNV_A_R_LINEAR_____87_CM 0. 10.2 FORMAT "%5.2" /end CHARACTERISTIC
/begin CHARACTERISTIC C_VS_MIN_CRU_MON "Minimum threshold for vehicle speed control active" VALUE 0x40284 _REC_VAL_20_u1 510. _CNV_A_R_LINEAR_____140_CM 0. 510. FORMAT "%3.0" /end CHARACTERISTIC
/begin CHARACTERISTIC C_T_CRU_INH_MON "Delay time for disable of cruise control charge demand in monitoring level" VALUE 0x4026d _REC_VAL_20_u1 10.2 _CNV_A_R_LINEAR_____87_CM 0. 10.2 FORMAT "%5.2" /end CHARACTERISTIC
/begin MEASUREMENT LV_ERR_CONV_MON_1 "Error of the Monitoring" UBYTE _CNV_S_2_RANGE______21_R_CM 1 100. 0. 255. ECU_ADDRESS 0x3fd547 BIT_MASK 0x1 /end MEASUREMENT
/begin MEASUREMENT LV_ERR_N_32_MON_1 "" UBYTE _CNV_S_2_RANGE______11_CM 1 100. 0. 1. ECU_ADDRESS 0x3fd54b BIT_MASK 0x1 /end MEASUREMENT
/begin MEASUREMENT LV_ERR_PVS_MON_1 "" UBYTE _CNV_S_2_RANGE______11_CM 1 100. 0. 1. ECU_ADDRESS 0x3fd54f BIT_MASK 0x1 /end MEASUREMENT
/begin MEASUREMENT LV_ERR_TPS_MON_1 "" UBYTE _CNV_S_2_RANGE______11_CM 1 100. 0. 1. ECU_ADDRESS 0x3fd553 BIT_MASK 0x1 /end MEASUREMENT
/begin MEASUREMENT LV_ERR_TQ_LOSS_MON_1 "" UBYTE _CNV_S_2_RANGE______11_CM 1 100. 0. 1. ECU_ADDRESS 0x3fd557 BIT_MASK 0x1 /end MEASUREMENT
/begin MEASUREMENT LV_ERR_TQ_MIN_CLU_MON_1 "" UBYTE _CNV_S_2_RANGE______11_CM 1 100. 0. 1. ECU_ADDRESS 0x3fd55b BIT_MASK 0x1 /end MEASUREMENT
/begin MEASUREMENT LV_ERR_TQ_MAX_CLU_MON_1 "" UBYTE _CNV_S_2_RANGE______11_CM 1 100. 0. 1. ECU_ADDRESS 0x3fd55f BIT_MASK 0x1 /end MEASUREMENT
/begin MEASUREMENT LV_ERR_TQ_DIF_P_D_IS_MON_1 "" UBYTE _CNV_S_2_RANGE______11_CM 1 100. 0. 1. ECU_ADDRESS 0x3fd563 BIT_MASK 0x1 /end MEASUREMENT
/begin MEASUREMENT LV_ERR_TQ_DIF_I_IS_MON_1 "MON.MON_Errors" UBYTE _CNV_S_2_RANGE______11_CM 1 100. 0. 1. ECU_ADDRESS 0x3fd567 BIT_MASK 0x1 /end MEASUREMENT
/begin MEASUREMENT LV_ERR_TQI_AV_MON_1 "" UBYTE _CNV_S_2_RANGE______11_CM 1 100. 0. 1. ECU_ADDRESS 0x3fd56b BIT_MASK 0x1 /end MEASUREMENT
/begin MEASUREMENT LV_ERR_TQI_N_MAX_MON_1 "" UBYTE _CNV_S_2_RANGE______11_CM 1 100. 0. 1. ECU_ADDRESS 0x3fd56f BIT_MASK 0x1 /end MEASUREMENT
/begin MEASUREMENT LV_ERR_MSR_INH_MON_1 "" UBYTE _CNV_S_2_RANGE______11_CM 1 100. 0. 1. ECU_ADDRESS 0x3fd573 BIT_MASK 0x1 /end MEASUREMENT
/begin MEASUREMENT LV_ERR_CRU_INH_MON_1 "" UBYTE _CNV_S_2_RANGE______11_CM 1 100. 0. 1. ECU_ADDRESS 0x3fd577 BIT_MASK 0x1 /end MEASUREMENT
/begin MEASUREMENT LV_ERR_MAF_MON_1 "" UBYTE _CNV_S_2_RANGE______11_CM 1 100. 0. 1. ECU_ADDRESS 0x3fd57b BIT_MASK 0x1 /end MEASUREMENT
/begin CHARACTERISTIC C_MAF_SUB_MMV_CRLC_MON "Correlation constant for MAF_SUB_MON filter" VALUE 0x4028e _REC_VAL_20_u2 0.99998474 _CNV_A_R_LINEAR_____31_CM 0. 0.99998474 FORMAT "%7.5" /end CHARACTERISTIC
/begin CHARACTERISTIC C_N_TPS_MIN_DIAG_MON "Minimum engine speed for diagnosis of TPS ratio error" VALUE 0x4026b _REC_VAL_20_u1 816. _CNV_A_R_LINEAR_____5_CM 0. 8160. FORMAT "%4.0" /end CHARACTERISTIC
/begin CHARACTERISTIC C_TPS_SLOP_MON "nominal value of TPS slope" VALUE 0x40274 _REC_VAL_20_u1 3.199 _CNV_A_R_LINEAR_____355_CM 0. 31.99 FORMAT "%4.1" /end CHARACTERISTIC
/begin CHARACTERISTIC C_V_TPS_AD_EL_BOL_1_MON "Upper limit of V_TPS_AD_EL_BOL_1" VALUE 0x40280 _REC_VAL_20_u1 4.998 _CNV_A_R_LINEAR_____38_CM 0. 4.998 FORMAT "%5.3" /end CHARACTERISTIC
/begin CHARACTERISTIC C_V_TPS_AD_EL_BOL_2_MON "Lower limit of V_TPS_AD_EL_BOL_2" VALUE 0x40281 _REC_VAL_20_u1 4.998 _CNV_A_R_LINEAR_____38_CM 0. 4.998 FORMAT "%5.3" /end CHARACTERISTIC
/begin CHARACTERISTIC C_V_TPS_MAX_MON "Maximum nominal voltage of the TPS fully opened" VALUE 0x40282 _REC_VAL_20_u1 4.998 _CNV_A_R_LINEAR_____38_CM 0. 4.998 FORMAT "%6.4" /end CHARACTERISTIC
/begin CHARACTERISTIC C_V_TPS_RATIO_HYS_MON "Maximum TPS ratio error allowed" VALUE 0x40283 _REC_VAL_20_u1 4.998 _CNV_A_R_LINEAR_____38_CM 0. 4.998 FORMAT "%5.3" /end CHARACTERISTIC
/begin CHARACTERISTIC IP_FAC_TPS_ISA_MON "calculation factor TPS -> ISAPWM" CURVE 0x403ba _REC_CUR_20_u1_u1 106.24 _CNV_A_R_LINEAR_____356_CM 0. 106.24 FORMAT "%5.1"
 /begin AXIS_DESCR COM_AXIS TPS_AV_MON _CNV_A_R_LINEAR_____357_CM 6 0. 119.5 FORMAT "%5.1" AXIS_PTS_REF ldp_tps_av_mon__fac_tps_isa_mon /end AXIS_DESCR
/end CHARACTERISTIC
/begin CHARACTERISTIC IP_MAF_MAX_ISA_MON "max. MAF_KGH (ISA)" CURVE 0x40546 _REC_CUR_20_u2_u1 2047.96875 _CNV_A_R_LINEAR_____101_CM 0. 2047.96875 FORMAT "%7.2"
 /begin AXIS_DESCR COM_AXIS PQ_TURB_SYS_MON _CNV_A_R_LINEAR_____253_CM 6 0. 0.996094 FORMAT "%5.3" AXIS_PTS_REF ldp_pq_turb_sys_mon__fac_pq_isa /end AXIS_DESCR
/end CHARACTERISTIC
/begin CHARACTERISTIC IP_FAC_PQ_ISA_MON "correction factor intake manifold / turbulence pressure" CURVE 0x403b6 _REC_CUR_20_u1_u2 0.19921875 _CNV_A_R_LINEAR_____103_CM 0. 1.9921875 FORMAT "%5.3"
 /begin AXIS_DESCR COM_AXIS ISAPWM_ISA _CNV_A_R_LINEAR_____94_CM 4 0. 99.99847412 AXIS_PTS_REF ldp_isapwm_isa__fac_pq_isa_mon /end AXIS_DESCR
/end CHARACTERISTIC
/begin CHARACTERISTIC C_N_MIN_MAF_DIAG_MON "Minimum engine speed threshold for diagnosis of the MAF signal" VALUE 0x40268 _REC_VAL_20_u1 816. _CNV_A_R_LINEAR_____5_CM 0. 8160. FORMAT "%4.0" /end CHARACTERISTIC
/begin CHARACTERISTIC IP_PQ_MON "pressure ratio main collector" MAP 0x4048c _REC_MAP_20_u1_u1_u1 0.9960940000000002 _CNV_A_R_LINEAR_____253_CM 0. 0.996094 FORMAT "%5.3"
 /begin AXIS_DESCR COM_AXIS N_32_MON _CNV_A_R_LINEAR_____5_CM 8 0. 8160. FORMAT "%4.0" AXIS_PTS_REF ldp_n_32_mon__pq_mon /end AXIS_DESCR
 /begin AXIS_DESCR COM_AXIS TPS_SUM_AV_MON _CNV_A_R_LINEAR_____357_CM 8 0. 119.5 FORMAT "%5.1" AXIS_PTS_REF ldp_tps_sum_av_mon__pq_mon /end AXIS_DESCR
/end CHARACTERISTIC
/begin CHARACTERISTIC IP_FAC_MAF_SUB_COR_MON "Correction factor for MAF_SUB_COR_MON calculation" MAP 0x40392 _REC_MAP_20_u1_u1_u2 1.9921875 _CNV_A_R_LINEAR_____103_CM 0. 1.9921875 FORMAT "%5.3"
 /begin AXIS_DESCR COM_AXIS TIA _CNV_A_R_LINEAR_____0_CM 6 -48. 142.5 FORMAT "%5.1" AXIS_PTS_REF ldp_tia__fac_maf_sub_cor_mon /end AXIS_DESCR
 /begin AXIS_DESCR COM_AXIS AMP _CNV_A_R_LINEAR_____43_CM 6 0. 5434. FORMAT "%7.2" AXIS_PTS_REF ldp_amp__fac_maf_sub_cor_mon /end AXIS_DESCR
/end CHARACTERISTIC
/begin CHARACTERISTIC IP_MAF_SUB_MON "MAF substitute" MAP 0x40445 _REC_MAP_20_u1_u1_u1 138.9 _CNV_A_R_LINEAR_____18_CM 0. 1389. FORMAT "%4.0"
 /begin AXIS_DESCR COM_AXIS N_32_MON _CNV_A_R_LINEAR_____5_CM 8 0. 8160. FORMAT "%4.0" AXIS_PTS_REF ldp_n_32_mon__maf_sub_mon /end AXIS_DESCR
 /begin AXIS_DESCR COM_AXIS TPS_AV_MON _CNV_A_R_LINEAR_____357_CM 8 0. 119.5 FORMAT "%5.1" AXIS_PTS_REF ldp_tps_av_mon__maf_sub_mon /end AXIS_DESCR
/end CHARACTERISTIC
/begin CHARACTERISTIC IP_MAF_SUB_THD_MON "Threshold for MAF_MON error detection" CURVE 0x40485 _REC_CUR_20_u1_u1 138.9 _CNV_A_R_LINEAR_____18_CM 0. 1389. FORMAT "%4.0"
 /begin AXIS_DESCR COM_AXIS MAF_SUB_1 _CNV_A_R_LINEAR_____18_CM 2 0. 1389. FORMAT "%4.0" AXIS_PTS_REF ldp_maf_sub__maf_sub_thd_mon /end AXIS_DESCR
/end CHARACTERISTIC
/begin AXIS_PTS ldp_n_32_mon__maf_sub_mon "" 0x402ef N_32_MON _REC_AXS_20_u1 8160. _CNV_A_R_LINEAR_____5_CM 8 0. 8160. FORMAT "%4.0" /end AXIS_PTS
/begin AXIS_PTS ldp_pq_turb_sys_mon__fac_pq_isa "" 0x4032b PQ_TURB_SYS_MON _REC_AXS_20_u1 0.9960940000000002 _CNV_A_R_LINEAR_____253_CM 6 0. 0.996094 FORMAT "%5.3" /end AXIS_PTS
/begin AXIS_PTS ldp_tps_av_mon__fac_tps_isa_mon "" 0x40367 TPS_AV_MON _REC_AXS_20_u1 11.95 _CNV_A_R_LINEAR_____357_CM 6 0. 119.5 FORMAT "%5.1" /end AXIS_PTS
/begin AXIS_PTS ldp_tps_av_mon__maf_sub_mon "" 0x4036e TPS_AV_MON _REC_AXS_20_u1 11.95 _CNV_A_R_LINEAR_____357_CM 8 0. 119.5 FORMAT "%5.1" /end AXIS_PTS
/begin AXIS_PTS ldp_isapwm_isa__fac_pq_isa_mon "" 0x402b0 ISAPWM_ISA _REC_AXS_20_u2 14.999771118 _CNV_A_R_LINEAR_____94_CM 4 0. 99.99847412 /end AXIS_PTS
/begin AXIS_PTS ldp_amp__fac_maf_sub_cor_mon "" 0x402a2 AMP _REC_AXS_20_u2 5434. _CNV_A_R_LINEAR_____43_CM 6 0. 5434. FORMAT "%7.2" /end AXIS_PTS
/begin AXIS_PTS ldp_n_32_mon__pq_mon "" 0x402f8 N_32_MON _REC_AXS_20_u1 816. _CNV_A_R_LINEAR_____5_CM 8 0. 8160. FORMAT "%4.0" /end AXIS_PTS
/begin AXIS_PTS ldp_tps_sum_av_mon__pq_mon "" 0x40377 TPS_SUM_AV_MON _REC_AXS_20_u1 119.5 _CNV_A_R_LINEAR_____357_CM 8 0. 119.5 FORMAT "%5.1" /end AXIS_PTS
/begin AXIS_PTS ldp_tia__fac_maf_sub_cor_mon "Correction factor for MAF_SUB_COR_MON calculation" 0x40360 TIA _REC_AXS_20_u1 190.5 _CNV_A_R_LINEAR_____0_CM 6 -48. 142.5 FORMAT "%5.1" /end AXIS_PTS
/begin CHARACTERISTIC C_V_TPS_1_LIH_MON "Threshold for detection of throttle position 1 outside limp home position" VALUE 0x4029c _REC_VAL_20_u2 4.99511719 _CNV_A_R_LINEAR_____33_CM 0. 4.99511719 FORMAT "%5.3" /end CHARACTERISTIC
/begin CHARACTERISTIC C_V_TPS_2_LIH_MON "Threshold for detection of throttle position 2 outside limp home position" VALUE 0x4029e _REC_VAL_20_u2 4.99511719 _CNV_A_R_LINEAR_____33_CM 0. 4.99511719 FORMAT "%5.3" /end CHARACTERISTIC
/begin CHARACTERISTIC C_FAC_TQ_GS_MON "torque monitoring correction" VALUE 0x40261 _REC_VAL_20_u1 0.159375 _CNV_A_R_LINEAR_____195_CM 0. 3.984375 FORMAT "%4.2" /end CHARACTERISTIC
/begin CHARACTERISTIC C_FAC_TQ_AMT_MON "torque monitoring correction" VALUE 0x4025e _REC_VAL_20_u1 0.159375 _CNV_A_R_LINEAR_____195_CM 0. 3.984375 FORMAT "%4.2" /end CHARACTERISTIC
/begin CHARACTERISTIC C_FAC_TQ_GS_BN_MON "torque monitoring correction" VALUE 0x40260 _REC_VAL_20_u1 0.159375 _CNV_A_R_LINEAR_____195_CM 0. 3.984375 FORMAT "%4.2" /end CHARACTERISTIC
/begin CHARACTERISTIC C_FAC_TQ_AMT_BN_MON "torque monitoring correction" VALUE 0x4025d _REC_VAL_20_u1 0.159375 _CNV_A_R_LINEAR_____195_CM 0. 3.984375 FORMAT "%4.2" /end CHARACTERISTIC
/begin CHARACTERISTIC C_FAC_TQ_DCC_BN_MON "torque monitoring correction" VALUE 0x4025f _REC_VAL_20_u1 0.159375 _CNV_A_R_LINEAR_____195_CM 0. 3.984375 FORMAT "%4.2" /end CHARACTERISTIC
/begin CHARACTERISTIC C_N_MAX_MTC_LIH_THD_MON "Speed threshold for the detection of a fault in the engine speed limitation" VALUE 0x40267 _REC_VAL_20_u1 8160. _CNV_A_R_LINEAR_____5_CM 0. 8160. FORMAT "%4.0" /end CHARACTERISTIC
/begin MEASUREMENT LV_ERR_TQI_N_MAX_MON "Fault currently present in engine speed limitation" UBYTE _CNV_S_2_RANGE______11_CM 1 100. 0. 1. ECU_ADDRESS 0x3fecdb BIT_MASK 0x1 /end MEASUREMENT
/begin CHARACTERISTIC C_N_32_DIF_MAX_MON "Maximum difference between N_32 and N_32_SUB_MON" VALUE 0x40265 _REC_VAL_20_u1 8160. _CNV_A_R_LINEAR_____5_CM 0. 8160. FORMAT "%4.0" /end CHARACTERISTIC
/begin CHARACTERISTIC C_V_PVS_IS_THD_1_MON "Thershold for idle speed PVS channel 1" VALUE 0x40298 _REC_VAL_20_u2 4.99511719 _CNV_A_R_LINEAR_____33_CM 0. 4.99511719 FORMAT "%5.3" /end CHARACTERISTIC
/begin CHARACTERISTIC C_V_PVS_IS_THD_2_MON "Thershold for idle speed PVS channel 2" VALUE 0x4029a _REC_VAL_20_u2 4.99511719 _CNV_A_R_LINEAR_____33_CM 0. 4.99511719 FORMAT "%5.3" /end CHARACTERISTIC
/begin CHARACTERISTIC C_V_PVS_SLOP_1_MON "Slope of the PVS channel 1" VALUE 0x4027e _REC_VAL_20_u1 79.6875 _CNV_A_R_LINEAR_____389_CM 0. 79.6875 FORMAT "%4.1" /end CHARACTERISTIC
/begin CHARACTERISTIC C_V_PVS_SLOP_2_MON "Slope of the PVS channel 2" VALUE 0x4027f _REC_VAL_20_u1 159.375 _CNV_A_R_LINEAR_____394_CM 0. 159.375 FORMAT "%5.1" /end CHARACTERISTIC
/begin CHARACTERISTIC C_N_MIN_PVS_DIAG_MON "Minimum engine speed for PVS diagnosis" VALUE 0x40269 _REC_VAL_20_u1 816. _CNV_A_R_LINEAR_____5_CM 0. 8160. FORMAT "%4.0" /end CHARACTERISTIC
/begin CHARACTERISTIC IP_PV_RATIO_HYS_MON "Maximum PVS ratio error allowed" CURVE 0x404cc _REC_CUR_20_u1_u1 99.609375 _CNV_A_R_LINEAR_____4_CM 0. 99.609375 FORMAT "%4.1"
 /begin AXIS_DESCR COM_AXIS PV_AV_MON _CNV_A_R_LINEAR_____4_CM 6 0. 99.609375 FORMAT "%4.1" AXIS_PTS_REF ldp_pv_av_min_mon_ip_pv_mon /end AXIS_DESCR
/end CHARACTERISTIC
/begin CHARACTERISTIC C_PV_LIH_MAX_MON "Max. pedal position in case of an PVS error" VALUE 0x4026c _REC_VAL_20_u1 99.609375 _CNV_A_R_LINEAR_____4_CM 0. 99.609375 FORMAT "%5.2" /end CHARACTERISTIC
/begin AXIS_PTS ldp_pv_av_min_mon_ip_pv_mon "" 0x4033b PV_AV_MIN _REC_AXS_20_u1 99.609375 _CNV_A_R_LINEAR_____4_CM 6 0. 99.609375 FORMAT "%4.1" /end AXIS_PTS
/begin MEASUREMENT LV_ERR_PVS_RATIO_MON "Logical variable for ratio-error between PVS channel 1 and 2" UBYTE _CNV_S_2_RANGE______21_R_CM 1 100. 0. 255. ECU_ADDRESS 0x3fecdd BIT_MASK 0x1 /end MEASUREMENT
/begin MEASUREMENT LV_ERR_VCC_PVS_2_MON "Fault in power supply for PVS_2 present" UBYTE _CNV_S_2_RANGE______21_R_CM 1 100. 0. 255. ECU_ADDRESS 0x3fecd6 BIT_MASK 0x1 /end MEASUREMENT
/begin MEASUREMENT LV_ERR_VCC_PVS_1_MON "Fault in power supply for PVS_1 present" UBYTE _CNV_S_2_RANGE______21_R_CM 1 100. 0. 255. ECU_ADDRESS 0x3fecd5 BIT_MASK 0x1 /end MEASUREMENT
/begin MEASUREMENT LV_ERR_VCC_PVS_MON "Fault in power supply for PVS present" UBYTE _CNV_S_2_RANGE______21_R_CM 1 100. 0. 255. ECU_ADDRESS 0x3fecd7 BIT_MASK 0x1 /end MEASUREMENT
/begin CHARACTERISTIC C_T_TCO_GRD_MAX_MON "Minimum time before a new change of TCO_MON is allowed" VALUE 0x4026f _REC_VAL_20_u1 10.2 _CNV_A_R_LINEAR_____87_CM 0. 10.2 FORMAT "%5.2" /end CHARACTERISTIC
/begin CHARACTERISTIC C_TCO_GRD_MAX_MON "Maximum negative gradient for the coolant temperature" VALUE 0x40271 _REC_VAL_20_u1 190.5 _CNV_A_R_LINEAR_____1_CM 0. 190.5 FORMAT "%5.1" /end CHARACTERISTIC
/begin CHARACTERISTIC C_TCO_SUB_THD_MAX_MON "Threshold for the max. TCO_SUB temperature while TCO is lower than C_TCO_THD_MIN_MON" VALUE 0x40272 _REC_VAL_20_u1 190.5 _CNV_A_R_LINEAR_____0_CM -48. 142.5 FORMAT "%5.1" /end CHARACTERISTIC
/begin CHARACTERISTIC C_TCO_THD_MIN_MON "Threshold for the min. TCO temperature while TCO_SUB is higher than C_TCO_SUB_THD_MAX_MON" VALUE 0x40273 _REC_VAL_20_u1 190.5 _CNV_A_R_LINEAR_____0_CM -48. 142.5 FORMAT "%5.1" /end CHARACTERISTIC
/begin CHARACTERISTIC IP_EFF_IGA_MON "Basic ignition efficiency (process monitoring)" CURVE 0x4038a _REC_CUR_20_u1_u1 1.9921875 _CNV_A_R_LINEAR_____103_CM 0. 1.9921875 FORMAT "%5.3"
 /begin AXIS_DESCR COM_AXIS IGA_DIF_AV _CNV_A_R_LINEAR_____203_CM 8 0. -95.625 FORMAT "%6.2" AXIS_PTS_REF ldp_iga_dif_av_mon__eff_iga_mon /end AXIS_DESCR
/end CHARACTERISTIC
/begin CHARACTERISTIC IP_IGA_REF_MON "Reference ignition angle (process monitoring)" MAP 0x40405 _REC_MAP_20_u1_u1_u1 95.625 _CNV_A_R_LINEAR_____202_CM -35.625 60. FORMAT "%5.1"
 /begin AXIS_DESCR COM_AXIS N_32_MON _CNV_A_R_LINEAR_____5_CM 8 0. 8160. FORMAT "%4.0" AXIS_PTS_REF ldp_n_32_mon__iga_ref_mon /end AXIS_DESCR
 /begin AXIS_DESCR COM_AXIS MAF_MON _CNV_A_R_LINEAR_____18_CM 8 0. 1389. FORMAT "%4.0" AXIS_PTS_REF ldp_maf_mon__iga_ref_mon /end AXIS_DESCR
/end CHARACTERISTIC
/begin CHARACTERISTIC IP_TQI_REF_MON "Indicated engine torque at reference conditions (process monitoring)" MAP 0x40509 _REC_MAP_20_u1_u1_u1 510. _CNV_A_R_LINEAR_____88_CM 0. 510. FORMAT "%3.0"
 /begin AXIS_DESCR COM_AXIS N_32_MON _CNV_A_R_LINEAR_____5_CM 6 0. 8160. FORMAT "%4.0" AXIS_PTS_REF ldp_n_32_mon__tqi_ref_mon /end AXIS_DESCR
 /begin AXIS_DESCR COM_AXIS MAF_MON _CNV_A_R_LINEAR_____18_CM 8 0. 1389. FORMAT "%4.0" AXIS_PTS_REF ldp_maf_mon__tqi_ref_mon /end AXIS_DESCR
/end CHARACTERISTIC
/begin CHARACTERISTIC C_IGA_REF_EGR_COR_LIM_MON "maximum permitted ignition angle correction for EGR active" VALUE 0x402a0 _REC_VAL_20_s1 95.625 _CNV_A_R_LINEAR_____75_CM -48. 47.625 FORMAT "%5.1" /end CHARACTERISTIC
/begin AXIS_PTS ldp_n_32_mon__tqi_ref_mon "" 0x40313 N_32_MON _REC_AXS_20_u1 8160. _CNV_A_R_LINEAR_____5_CM 6 0. 8160. FORMAT "%4.0" /end AXIS_PTS
/begin AXIS_PTS ldp_maf_mon__tqi_ref_mon "" 0x402cc MAF_MON _REC_AXS_20_u1 1389. _CNV_A_R_LINEAR_____18_CM 8 0. 1389. FORMAT "%4.0" /end AXIS_PTS
/begin AXIS_PTS ldp_n_32_mon__iga_ref_mon "" 0x402e6 N_32_MON _REC_AXS_20_u1 8160. _CNV_A_R_LINEAR_____5_CM 8 0. 8160. FORMAT "%4.0" /end AXIS_PTS
/begin AXIS_PTS ldp_maf_mon__iga_ref_mon "" 0x402c3 MAF_MON _REC_AXS_20_u1 1389. _CNV_A_R_LINEAR_____18_CM 8 0. 1389. FORMAT "%4.0" /end AXIS_PTS
/begin AXIS_PTS ldp_iga_dif_av_mon__eff_iga_mon "" 0x402ba IGA_DIF_AV_MON _REC_AXS_20_u1 -95.625 _CNV_A_R_LINEAR_____203_CM 8 0. -95.625 FORMAT "%6.2" /end AXIS_PTS
/begin CHARACTERISTIC IP_TQI_DIF_MAX_MON "Threshold for diagnosis of engine torque overflow" MAP 0x404f9 _REC_MAP_20_u1_u1_u1 510. _CNV_A_R_LINEAR_____88_CM 0. 510. FORMAT "%3.0"
 /begin AXIS_DESCR COM_AXIS N_32_MON _CNV_A_R_LINEAR_____5_CM 4 0. 8160. FORMAT "%4.0" AXIS_PTS_REF ldp_n_32_mon__tqi_dif_max_mon /end AXIS_DESCR
 /begin AXIS_DESCR COM_AXIS TQI_SP_MON _CNV_A_R_LINEAR_____88_CM 4 0. 510. FORMAT "%3.0" AXIS_PTS_REF ldp_tqi_sp_mon__tqi_dif_max_mon /end AXIS_DESCR
/end CHARACTERISTIC
/begin AXIS_PTS ldp_tqi_sp_mon__tqi_dif_max_mon "" 0x40385 TQI_SP_MON _REC_AXS_20_u1 510. _CNV_A_R_LINEAR_____88_CM 4 0. 510. FORMAT "%3.0" /end AXIS_PTS
/begin AXIS_PTS ldp_n_32_mon__tqi_dif_max_mon "" 0x4030e N_32_MON _REC_AXS_20_u1 8160. _CNV_A_R_LINEAR_____5_CM 4 0. 8160. FORMAT "%4.0" /end AXIS_PTS
/begin CHARACTERISTIC IP_TQ_DIF_P_D_IS_MAX_MON "maximum PD-part depending on speed deviation to idle speed setpoint" CURVE 0x404d2 _REC_CUR_20_u1_u1 510. _CNV_A_R_LINEAR_____88_CM 0. 510. FORMAT "%3.0"
 /begin AXIS_DESCR COM_AXIS N_DIF_SP_IS_MON _CNV_A_R_LINEAR_____378_CM 4 -4096. 4064. FORMAT "%5.0" AXIS_PTS_REF ldp_n_dif_sp_is_mon_ip_tq_mon /end AXIS_DESCR
/end CHARACTERISTIC
/begin CHARACTERISTIC IP_FAC_TQ_DIF_P_D_IS_MON "maximum scaling factor due to separation of PD-part" CURVE 0x403c0 _REC_CUR_20_u1_u1 1.9921875 _CNV_A_R_LINEAR_____103_CM 0. 1.9921875 FORMAT "%5.3"
 /begin AXIS_DESCR COM_AXIS TCO_MON _CNV_A_R_LINEAR_____0_CM 5 -48. 142.5 FORMAT "%4.0" AXIS_PTS_REF ldp_tco_mon_ip_fac_tq_p_d_mon /end AXIS_DESCR
/end CHARACTERISTIC
/begin CHARACTERISTIC C_N_DIF_MIN_MON "minimum idle speed setpoint deviation for active I-part" VALUE 0x40266 _REC_VAL_20_u1 8160. _CNV_A_R_LINEAR_____378_CM -4096. 4064. FORMAT "%5.0" /end CHARACTERISTIC
/begin CHARACTERISTIC C_TQ_DIF_I_IS_MAX_MON "maximum I-part" VALUE 0x40276 _REC_VAL_20_u1 255. _CNV_A_R_LINEAR_____84_CM 0. 255. FORMAT "%3.0" /end CHARACTERISTIC
/begin CHARACTERISTIC C_TQ_PAS_I_IS_MON "target value for monitoring ramp operation due to ISC deactivation" VALUE 0x40279 _REC_VAL_20_u1 255. _CNV_A_R_LINEAR_____84_CM 0. 255. FORMAT "%3.0" /end CHARACTERISTIC
/begin CHARACTERISTIC C_FAC_RAMP_POS_I_IS_MON "Slope for monitoring positive ISC deactivation-ramp operation" VALUE 0x4028c _REC_VAL_20_u2 0.9999850000000001 _CNV_A_R_LINEAR_____462_CM 0. 0.999985 FORMAT "%6.4" /end CHARACTERISTIC
/begin CHARACTERISTIC C_FAC_RAMP_NEG_I_IS_MON "Slope for monitoring negative ISC deactivation-ramp operation" VALUE 0x40288 _REC_VAL_20_u2 3.1875e-002 _CNV_A_R_LINEAR_____463_CM 0. 3.1875e-002 FORMAT "%7.5" /end CHARACTERISTIC
/begin CHARACTERISTIC C_TQ_DIF_P_D_IS_ADD_MON "Additive constant for PD-part model value" VALUE 0x40277 _REC_VAL_20_u1 255. _CNV_A_R_LINEAR_____84_CM 0. 255. FORMAT "%3.0" /end CHARACTERISTIC
/begin CHARACTERISTIC C_TQ_DIF_I_IS_ADD_MON "additive constant for I-part model value" VALUE 0x40275 _REC_VAL_20_u1 255. _CNV_A_R_LINEAR_____84_CM 0. 255. FORMAT "%3.0" /end CHARACTERISTIC
/begin CHARACTERISTIC C_FAC_RAMP_NEG_P_D_IS_MON "Factor for monitoring negative ISC-deactivation-ramp operation of the PD-part" VALUE 0x4028a _REC_VAL_20_u2 3.1875e-002 _CNV_A_R_LINEAR_____463_CM 0. 3.1875e-002 FORMAT "%7.5" /end CHARACTERISTIC
/begin CHARACTERISTIC IP_N_SP_IS_MON_MAX_MON "maximum idle speed setpoint depending on coolant temperature" CURVE 0x40487 _REC_CUR_20_u1_u1 8160. _CNV_A_R_LINEAR_____5_CM 0. 8160. FORMAT "%4.0"
 /begin AXIS_DESCR COM_AXIS TCO_MON _CNV_A_R_LINEAR_____0_CM 5 -48. 142.5 FORMAT "%5.1" AXIS_PTS_REF ldp_tco_mon_ip_n_sp_is_mon /end AXIS_DESCR
/end CHARACTERISTIC
/begin AXIS_PTS ldp_n_dif_sp_is_mon_ip_tq_mon "maximum PD-part depending on speed deviation to idle speed setpoint" 0x40326 N_DIF_SP_IS_MON _REC_AXS_20_u1 8160. _CNV_A_R_LINEAR_____378_CM 4 -4096. 4064. FORMAT "%5.0" /end AXIS_PTS
/begin AXIS_PTS ldp_tco_mon_ip_fac_tq_p_d_mon "" 0x4034f TCO_MON _REC_AXS_20_u1 190.5 _CNV_A_R_LINEAR_____0_CM 5 -48. 142.5 FORMAT "%4.0" /end AXIS_PTS
/begin AXIS_PTS ldp_tco_mon_ip_n_sp_is_mon "" 0x40355 TCO_MON _REC_AXS_20_u1 190.5 _CNV_A_R_LINEAR_____0_CM 5 -48. 142.5 FORMAT "%5.1" /end AXIS_PTS
/begin MEASUREMENT LV_ERR_TQ_DIF_P_D_IS_MON "Fault currently present in torque generation, symptom 'idle speed controller - PD-part'" UBYTE _CNV_S_2_RANGE______11_CM 1 100. 0. 1. ECU_ADDRESS 0x3fece3 BIT_MASK 0x1 /end MEASUREMENT
/begin MEASUREMENT LV_ERR_TQ_DIF_I_IS_MON "Fault currently present in torque generation, symptom 'idle speed controller - I-part'" UBYTE _CNV_S_2_RANGE______11_CM 1 100. 0. 1. ECU_ADDRESS 0x3fece4 BIT_MASK 0x1 /end MEASUREMENT
/begin CHARACTERISTIC IP_TQ_LOSS_MIN_MON "modelled speed and TCO dependent torque losses" MAP 0x404d6 _REC_MAP_20_u1_u1_u1 -510. _CNV_A_R_LINEAR_____464_CM 0. -510. FORMAT "%4.0"
 /begin AXIS_DESCR COM_AXIS N_32_MON _CNV_A_R_LINEAR_____5_CM 5 0. 8160. FORMAT "%4.0" AXIS_PTS_REF ldp_n_32_mon__tq_loss_min_mon /end AXIS_DESCR
 /begin AXIS_DESCR COM_AXIS TCO_MON _CNV_A_R_LINEAR_____0_CM 5 -48. 142.5 FORMAT "%4.0" AXIS_PTS_REF ldp_tco_mon__tq_loss_min_mon /end AXIS_DESCR
/end CHARACTERISTIC
/begin CHARACTERISTIC C_TQ_LOSS_ADD_ACC_MIN_MON "minimum additional torque loss for ACC active" VALUE 0x40278 _REC_VAL_20_u1 -20.4 _CNV_A_R_LINEAR_____464_CM 0. -510. FORMAT "%4.0" /end CHARACTERISTIC
/begin CHARACTERISTIC C_FAC_TQ_LOSS_ALTER_MON "tq_loss correction" VALUE 0x40262 _REC_VAL_20_u1 0.159375 _CNV_A_R_LINEAR_____195_CM 0. 3.984375 FORMAT "%4.2" /end CHARACTERISTIC
/begin CHARACTERISTIC C_FAC_TQ_LOSS_PSTE_MON "tq_loss correction" VALUE 0x40264 _REC_VAL_20_u1 0.159375 _CNV_A_R_LINEAR_____195_CM 0. 3.984375 FORMAT "%4.2" /end CHARACTERISTIC
/begin CHARACTERISTIC C_FAC_TQ_LOSS_ARS_MON "tq_loss correction" VALUE 0x40263 _REC_VAL_20_u1 0.159375 _CNV_A_R_LINEAR_____195_CM 0. 3.984375 FORMAT "%4.2" /end CHARACTERISTIC
/begin AXIS_PTS ldp_n_32_mon__tq_loss_min_mon "" 0x40301 N_32_MON _REC_AXS_20_u1 8160. _CNV_A_R_LINEAR_____5_CM 5 0. 8160. FORMAT "%4.0" /end AXIS_PTS
/begin AXIS_PTS ldp_tco_mon__tq_loss_min_mon "" 0x40342 TCO_MON _REC_AXS_20_u1 190.5 _CNV_A_R_LINEAR_____0_CM 5 -48. 142.5 FORMAT "%4.0" /end AXIS_PTS
/begin MEASUREMENT LV_ERR_TQ_LOSS_MON "Fault currently present in torque generation, symptom 'torque losses'" UBYTE _CNV_S_2_RANGE______11_CM 1 100. 0. 1. ECU_ADDRESS 0x3fece7 BIT_MASK 0x1 /end MEASUREMENT
/begin CHARACTERISTIC IP_TQ_MAX_CLU_MAX_MON "maximum value for maximum torque at clutch" CURVE 0x404ef _REC_CUR_20_u1_u1 510. _CNV_A_R_LINEAR_____88_CM 0. 510. FORMAT "%3.0"
 /begin AXIS_DESCR COM_AXIS N_32_MON _CNV_A_R_LINEAR_____5_CM 6 0. 8160. FORMAT "%4.0" AXIS_PTS_REF ldp_n_32_mon__tq_max_clu_max_mon /end AXIS_DESCR
/end CHARACTERISTIC
/begin AXIS_PTS ldp_n_32_mon__tq_max_clu_max_mon "" 0x40307 N_32_MON _REC_AXS_20_u1 8160. _CNV_A_R_LINEAR_____5_CM 6 0. 8160. FORMAT "%4.0" /end AXIS_PTS
/begin MEASUREMENT LV_ERR_TQ_MAX_CLU_MON "Fault currently present in torque generation, symptom 'maximum torque at clutch'" UBYTE _CNV_S_2_RANGE______11_CM 1 100. 0. 1. ECU_ADDRESS 0x3fece8 BIT_MASK 0x1 /end MEASUREMENT
/begin CHARACTERISTIC C_N_ST_MAX_MON "maximum start end speed" VALUE 0x4026a _REC_VAL_20_u1 8160. _CNV_A_R_LINEAR_____5_CM 0. 8160. FORMAT "%4.0" /end CHARACTERISTIC
/begin MEASUREMENT LV_ERR_TQ_MIN_CLU_MON "Fault currently present in torque generation, symptom 'minimum torque at clutch'" UBYTE _CNV_S_2_RANGE______11_CM 1 100. 0. 1. ECU_ADDRESS 0x3fece9 BIT_MASK 0x1 /end MEASUREMENT
/begin MEASUREMENT TQ_MIN_CLU_MON "monitored minimum torque at clutch" SWORD _CNV_A_R_LINEAR_____48_CM 1 100. -1024. 1023.96875 ECU_ADDRESS 0x3fed78 FORMAT "%8.2" /end MEASUREMENT
/begin MEASUREMENT ABC_TQ_MIN_CLU_MON "Anti bounce counter for monitoring of minimum torque at clutch" UBYTE _CNV_A_R_LINEAR_____10_CM 1 100. 0. 255. ECU_ADDRESS 0x3fed38 FORMAT "%3.0" /end MEASUREMENT
/begin MEASUREMENT TQ_MIN_CLU_DIF_MON "difference of monitored and modelled minimum torque at clutch" SWORD _CNV_A_R_LINEAR_____48_CM 1 100. -1024. 1023.96875 ECU_ADDRESS 0x3fed7a FORMAT "%8.2" /end MEASUREMENT
/begin MEASUREMENT TQ_MIN_CLU_MDL_1_MON "Temporary variable for calculation of modelled minimum torque at clutch" SWORD _CNV_A_R_LINEAR_____48_CM 1 100. -1024. 1023.96875 ECU_ADDRESS 0x3fed7e FORMAT "%8.2" /end MEASUREMENT
/begin MEASUREMENT TQ_MIN_CLU_MDL_2_MON "Temporary variable for calculation of modelled minimum torque at clutch" SWORD _CNV_A_R_LINEAR_____48_CM 1 100. -1024. 1023.96875 ECU_ADDRESS 0x3fed80 FORMAT "%8.2" /end MEASUREMENT
/begin MEASUREMENT TQ_MIN_CLU_MDL_MON "modelled value of mimimum torque at clutch" SWORD _CNV_A_R_LINEAR_____48_CM 1 100. -1024. 1023.96875 ECU_ADDRESS 0x3fed82 FORMAT "%8.2" /end MEASUREMENT
/begin MEASUREMENT TQ_CONV_MAX_MON "modelled vaue of maximum converter torque" UBYTE _CNV_A_R_LINEAR_____88_CM 1 100. 0. 510. ECU_ADDRESS 0x3fed37 FORMAT "%3.0" /end MEASUREMENT
/begin MEASUREMENT TQ_ST_MON "modelled value of start torque" UWORD _CNV_A_R_LINEAR_____48_CM 1 100. 0. 1023.96875 ECU_ADDRESS 0x3fed7c FORMAT "%7.2" /end MEASUREMENT
/begin AXIS_PTS ldp_n_dif_mon_ip_tq_min_mon "" 0x40321 N_DIF_SP_IS_MON _REC_AXS_20_u1 8160. _CNV_A_R_LINEAR_____378_CM 4 -4096. 4064. FORMAT "%5.0" /end AXIS_PTS
/begin AXIS_PTS ldp_n_32_mon_ip_tqi_min_pu_mon "" 0x4031a N_32_MON _REC_AXS_20_u1 8160. _CNV_A_R_LINEAR_____5_CM 6 0. 8160. FORMAT "%4.0" /end AXIS_PTS
/begin AXIS_PTS ldp_tco_mon_ip_fac_conv_mon "" 0x40348 TCO_MON _REC_AXS_20_u1 190.5 _CNV_A_R_LINEAR_____0_CM 6 -48. 142.5 FORMAT "%5.1" /end AXIS_PTS
/begin AXIS_PTS ldp_tco_mon_ip_tqi_min_pu_mon "" 0x4035b TCO_MON _REC_AXS_20_u1 190.5 _CNV_A_R_LINEAR_____0_CM 4 -48. 142.5 FORMAT "%5.1" /end AXIS_PTS
/begin CHARACTERISTIC IP_TQ_MIN_CLU_MAX_MON "maximum value for minimum torque at clutch" CURVE 0x404f5 _REC_CUR_20_u1_u1 510. _CNV_A_R_LINEAR_____88_CM 0. 510. FORMAT "%3.0"
 /begin AXIS_DESCR COM_AXIS N_DIF_SP_IS_MON _CNV_A_R_LINEAR_____378_CM 4 -4096. 4064. FORMAT "%5.0" AXIS_PTS_REF ldp_n_dif_mon_ip_tq_min_mon /end AXIS_DESCR
/end CHARACTERISTIC
/begin CHARACTERISTIC IP_FAC_CONV_MON "Converter torque characteristics" CURVE 0x4053a _REC_CUR_20_u2_u1 4.88e-004 _CNV_A_R_LINEAR_____452_CM 0. 4.88e-004 FORMAT "%10.9"
 /begin AXIS_DESCR COM_AXIS TCO_MON _CNV_A_R_LINEAR_____0_CM 6 -48. 142.5 FORMAT "%5.1" AXIS_PTS_REF ldp_tco_mon_ip_fac_conv_mon /end AXIS_DESCR
/end CHARACTERISTIC
/begin CHARACTERISTIC IP_TQI_MIN_REQ_PU_MON "Minimum requested indicated torque in PU phase" MAP 0x40572 _REC_MAP_20_u2_u1_u1 1023.96875 _CNV_A_R_LINEAR_____48_CM 0. 1023.96875 FORMAT "%7.2"
 /begin AXIS_DESCR COM_AXIS N_32_MON _CNV_A_R_LINEAR_____5_CM 6 0. 8160. FORMAT "%4.0" AXIS_PTS_REF ldp_n_32_mon_ip_tqi_min_pu_mon /end AXIS_DESCR
 /begin AXIS_DESCR COM_AXIS TCO_MON _CNV_A_R_LINEAR_____0_CM 4 -48. 142.5 FORMAT "%5.1" AXIS_PTS_REF ldp_tco_mon_ip_tqi_min_pu_mon /end AXIS_DESCR
/end CHARACTERISTIC
/begin CHARACTERISTIC C_T_TQI_MON "Dead time for torque decrease" VALUE 0x40270 _REC_VAL_20_u1 10.2 _CNV_A_R_LINEAR_____87_CM 0. 10.2 FORMAT "%5.2" /end CHARACTERISTIC
/begin CHARACTERISTIC C_TQI_SP_DEC_MAX_MON "Maximum negative gradient of desired indicated engine torque" VALUE 0x4027a _REC_VAL_20_u1 31.875 _CNV_A_R_LINEAR_____467_CM 0. 31.875 FORMAT "%5.2" /end CHARACTERISTIC
/begin CHARACTERISTIC IP_FAC_TQ_REQ_DRIV_MON "Scaling factor for requested torque at clutch from driver" MAP 0x403c5 _REC_MAP_20_u1_u1_u1 1.9921875 _CNV_A_R_LINEAR_____103_CM 0. 1.9921875 FORMAT "%5.3"
 /begin AXIS_DESCR COM_AXIS N_32_MON _CNV_A_R_LINEAR_____5_CM 8 0. 8160. FORMAT "%4.0" AXIS_PTS_REF ldp_n_32__fac_tq_req_driv_mon /end AXIS_DESCR
 /begin AXIS_DESCR COM_AXIS PV_AV_MON _CNV_A_R_LINEAR_____4_CM 8 0. 99.609375 FORMAT "%5.2" AXIS_PTS_REF ldp_pv_av__fac_tq_req_driv_mon /end AXIS_DESCR
/end CHARACTERISTIC
/begin AXIS_PTS ldp_n_32__fac_tq_req_driv_mon "" 0x402d8 N_32_MON _REC_AXS_20_u1 8160. _CNV_A_R_LINEAR_____5_CM 8 0. 8160. FORMAT "%4.0" /end AXIS_PTS
/begin AXIS_PTS ldp_pv_av__fac_tq_req_driv_mon "" 0x40332 PV_AV_MON _REC_AXS_20_u1 99.609375 _CNV_A_R_LINEAR_____4_CM 8 0. 99.609375 FORMAT "%5.2" /end AXIS_PTS
/begin MEASUREMENT LV_DET_MIS "Single misfire detected (TDC occurence)" UBYTE _CNV_S_2_RANGE______11_CM 1 100. 0. 1. ECU_ADDRESS 0x3fcbe2 /end MEASUREMENT
/begin MEASUREMENT MIS_STATE_ER "Status carrier byte of actual detected misfire through engine roughness index - 1 bit / cylinder." UWORD _CNV_A_R_LINEAR_____10_CM 1 100. 0. 65535. ECU_ADDRESS 0x3fdd02 FORMAT "%5.0" /end MEASUREMENT
/begin CHARACTERISTIC C_FAC_SCA_ER_STND "Scaling factor used for normalized engine roughness calculation" VALUE 0x41618 _REC_VAL_20_u1 255. _CNV_A_R_LINEAR_____10_CM 0. 255. FORMAT "%3.0" /end CHARACTERISTIC
/begin CHARACTERISTIC C_N_MAX_ER_STND "Maximum engine speed for normalized ER index (ER_STND)" VALUE 0x4165e _REC_VAL_20_u2 8160. _CNV_A_R_LINEAR_____17_CM 0. 8160. FORMAT "%4.0" /end CHARACTERISTIC
/begin CHARACTERISTIC LC_ER_STND_CONF "Selection between classical ER index (=0) & normalized ER index (ER_STND) (=1) to execute misfire detection" VALUE 0x41633 _REC_VAL_20_u1 1. _CNV_S_2_RANGE______11_CM 0. 1. /end CHARACTERISTIC
/begin MEASUREMENT ER_STND "Normalized engine roughness (versus engine speed - including DRV2_MMV component)" SWORD _CNV_A_R_LINEAR_____541_CM 1 100. -32768. 32767. ECU_ADDRESS 0x3fcbe0 FORMAT "%6.0" /end MEASUREMENT
/begin MEASUREMENT ER_STND_0 "Cylinder normalized engine roughness values" SWORD _CNV_A_R_LINEAR_____541_CM 1 100. -32768. 32767. ECU_ADDRESS 0x3fdcf6 FORMAT "%6.0" /end MEASUREMENT
/begin MEASUREMENT ER_STND_1 "Cylinder normalized engine roughness values" SWORD _CNV_A_R_LINEAR_____541_CM 1 100. -32768. 32767. ECU_ADDRESS 0x3fdcf8 FORMAT "%6.0" /end MEASUREMENT
/begin MEASUREMENT ER_STND_2 "Cylinder normalized engine roughness values" SWORD _CNV_A_R_LINEAR_____541_CM 1 100. -32768. 32767. ECU_ADDRESS 0x3fdcfa FORMAT "%6.0" /end MEASUREMENT
/begin MEASUREMENT ER_STND_3 "Cylinder normalized engine roughness values" SWORD _CNV_A_R_LINEAR_____541_CM 1 100. -32768. 32767. ECU_ADDRESS 0x3fdcfc FORMAT "%6.0" /end MEASUREMENT
/begin MEASUREMENT ER_STND_4 "Cylinder normalized engine roughness values" SWORD _CNV_A_R_LINEAR_____541_CM 1 100. -32768. 32767. ECU_ADDRESS 0x3fdcfe FORMAT "%6.0" /end MEASUREMENT
/begin MEASUREMENT ER_STND_5 "Cylinder normalized engine roughness values" SWORD _CNV_A_R_LINEAR_____541_CM 1 100. -32768. 32767. ECU_ADDRESS 0x3fdd00 FORMAT "%6.0" /end MEASUREMENT
/begin MEASUREMENT N_MIS "Engine speed for misfire detection - delayed for intake phase analysis of actual diagnosed cylinder" UWORD _CNV_A_R_LINEAR_____17_CM 1 100. 0. 8160. ECU_ADDRESS 0x3fcbd0 FORMAT "%4.0" /end MEASUREMENT
/begin MEASUREMENT LOAD_MIS_1 "Normalised engine load for misfire detection - 1 misfire segment before" UWORD _CNV_A_R_LINEAR_____172_CM 1 100. 0. 99.99694824 ECU_ADDRESS 0x3fdc96 /end MEASUREMENT
/begin MEASUREMENT LOAD_MIS_2 "Normalised engine load for misfire detection - 2 misfire segment before" UWORD _CNV_A_R_LINEAR_____172_CM 1 100. 0. 99.99694824 ECU_ADDRESS 0x3fcbca /end MEASUREMENT
/begin MEASUREMENT LOAD_MIS_3 "Normalised engine load for misfire detection - 3 misfire segment before" UWORD _CNV_A_R_LINEAR_____172_CM 1 100. 0. 99.99694824 ECU_ADDRESS 0x3fdc98 /end MEASUREMENT
/begin MEASUREMENT LOAD_GRD_MIS "Normalised engine load gradient for misfire detection " UWORD _CNV_A_R_LINEAR_____172_CM 1 100. 0. 99.99694824 ECU_ADDRESS 0x3fcbcc /end MEASUREMENT
/begin MEASUREMENT LOAD_MIN_MIS "Normalised engine \"zero\" load for misfire detection" UWORD _CNV_A_R_LINEAR_____172_CM 1 100. 0. 99.99694824 ECU_ADDRESS 0x3fcbce /end MEASUREMENT
/begin MEASUREMENT LOAD_MIS "Normalised engine load for misfire detection - sampled at current misfire segment" UWORD _CNV_A_R_LINEAR_____172_CM 1 100. 0. 99.99694824 ECU_ADDRESS 0x3fcbc8 /end MEASUREMENT
/begin CHARACTERISTIC IP_LOAD_MIN_AFS_MT_MIS "Zero load curve vs engine speed in AFS combustion mode, MT vehicle" CURVE 0x41a5a _REC_CUR_20_u2_u2 99.99694824000001 _CNV_A_R_LINEAR_____172_CM 0. 99.99694824
 /begin AXIS_DESCR COM_AXIS N _CNV_A_R_LINEAR_____17_CM 12 0. 8160. FORMAT "%4.0" AXIS_PTS_REF ldp_n__load_min_afs_mt_mis /end AXIS_DESCR
/end CHARACTERISTIC
/begin CHARACTERISTIC IP_LOAD_MIN_AFS_AT_MIS "Zero load curve vs engine speed in AFS combustion mode, AT vehicle" CURVE 0x41a42 _REC_CUR_20_u2_u2 99.99694824000001 _CNV_A_R_LINEAR_____172_CM 0. 99.99694824
 /begin AXIS_DESCR COM_AXIS N _CNV_A_R_LINEAR_____17_CM 12 0. 8160. FORMAT "%4.0" AXIS_PTS_REF ldp_n__load_min_afs_at_mis /end AXIS_DESCR
/end CHARACTERISTIC
/begin CHARACTERISTIC IP_LOAD_MIN_AFL_MT_MIS "Zero load curve vs engine speed in AFL combustion mode, MT vehicle" CURVE 0x41a2a _REC_CUR_20_u2_u2 99.99694824000001 _CNV_A_R_LINEAR_____172_CM 0. 99.99694824
 /begin AXIS_DESCR COM_AXIS N _CNV_A_R_LINEAR_____17_CM 12 0. 8160. FORMAT "%4.0" AXIS_PTS_REF ldp_n__load_min_afl_mt_mis /end AXIS_DESCR
/end CHARACTERISTIC
/begin CHARACTERISTIC IP_LOAD_MIN_AFL_AT_MIS "Zero load curve vs engine speed in AFL combustion mode, AT vehicle" CURVE 0x41a12 _REC_CUR_20_u2_u2 99.99694824000001 _CNV_A_R_LINEAR_____172_CM 0. 99.99694824
 /begin AXIS_DESCR COM_AXIS N _CNV_A_R_LINEAR_____17_CM 12 0. 8160. FORMAT "%4.0" AXIS_PTS_REF ldp_n__load_min_afl_at_mis /end AXIS_DESCR
/end CHARACTERISTIC
/begin CHARACTERISTIC IP_LOAD_MIN_S_MT_MIS "Zero load curve vs engine speed in S combustion mode, MT vehicle" CURVE 0x41a8a _REC_CUR_20_u2_u2 99.99694824000001 _CNV_A_R_LINEAR_____172_CM 0. 99.99694824
 /begin AXIS_DESCR COM_AXIS N _CNV_A_R_LINEAR_____17_CM 12 0. 8160. FORMAT "%4.0" AXIS_PTS_REF ldp_n__load_min_s_mt_mis /end AXIS_DESCR
/end CHARACTERISTIC
/begin CHARACTERISTIC IP_LOAD_MIN_S_AT_MIS "Zero load curve vs engine speed in S combustion mode, AT vehicle" CURVE 0x41a72 _REC_CUR_20_u2_u2 99.99694824000001 _CNV_A_R_LINEAR_____172_CM 0. 99.99694824
 /begin AXIS_DESCR COM_AXIS N _CNV_A_R_LINEAR_____17_CM 12 0. 8160. FORMAT "%4.0" AXIS_PTS_REF ldp_n__load_min_s_at_mis /end AXIS_DESCR
/end CHARACTERISTIC
/begin CHARACTERISTIC IP_AMP_OFS_LOAD_AFS_MIS "Extra load from zero load curve vs AMP in AFS combustion mode" CURVE 0x41996 _REC_CUR_20_u2_u2 99.94 _CNV_A_R_LINEAR_____542_CM -50. 49.94 FORMAT "%7.3"
 /begin AXIS_DESCR COM_AXIS AMP _CNV_A_R_LINEAR_____43_CM 9 0. 5434. FORMAT "%7.2" AXIS_PTS_REF ldpm_amp__amp_ofs_load_mis /end AXIS_DESCR
/end CHARACTERISTIC
/begin CHARACTERISTIC IP_AMP_OFS_LOAD_S_MIS "Extra load from zero load curve vs AMP in S combustion mode" CURVE 0x419a8 _REC_CUR_20_u2_u2 99.94 _CNV_A_R_LINEAR_____542_CM -50. 49.94 FORMAT "%7.3"
 /begin AXIS_DESCR COM_AXIS AMP _CNV_A_R_LINEAR_____43_CM 9 0. 5434. FORMAT "%7.2" AXIS_PTS_REF ldpm_amp__amp_ofs_load_mis /end AXIS_DESCR
/end CHARACTERISTIC
/begin CHARACTERISTIC IP_AMP_OFS_LOAD_AFL_MIS "Extra load from zero load curve vs AMP in AFL combustion mode" CURVE 0x41984 _REC_CUR_20_u2_u2 99.94 _CNV_A_R_LINEAR_____542_CM -50. 49.94 FORMAT "%7.3"
 /begin AXIS_DESCR COM_AXIS AMP _CNV_A_R_LINEAR_____43_CM 9 0. 5434. FORMAT "%7.2" AXIS_PTS_REF ldpm_amp__amp_ofs_load_mis /end AXIS_DESCR
/end CHARACTERISTIC
/begin CHARACTERISTIC IP_TCO_OFS_LOAD_AFL_MIS "Extra load from zero load curve vs coolant temperature  in AFL combustion mode" CURVE 0x41aba _REC_CUR_20_u2_u1 99.94 _CNV_A_R_LINEAR_____542_CM -50. 49.94 FORMAT "%7.3"
 /begin AXIS_DESCR COM_AXIS TCO _CNV_A_R_LINEAR_____0_CM 9 -48. 142.5 FORMAT "%5.1" AXIS_PTS_REF ldpm_tco__tco_ofs_load_mis /end AXIS_DESCR
/end CHARACTERISTIC
/begin CHARACTERISTIC IP_TCO_OFS_LOAD_S_MIS "Extra load from zero load curve vs coolant temperature in S combustion mode" CURVE 0x41ade _REC_CUR_20_u2_u1 99.94 _CNV_A_R_LINEAR_____542_CM -50. 49.94 FORMAT "%7.3"
 /begin AXIS_DESCR COM_AXIS TCO _CNV_A_R_LINEAR_____0_CM 9 -48. 142.5 FORMAT "%5.1" AXIS_PTS_REF ldpm_tco__tco_ofs_load_mis /end AXIS_DESCR
/end CHARACTERISTIC
/begin CHARACTERISTIC IP_TCO_OFS_LOAD_AFS_MIS "Extra load from zero load curve vs coolant temperature  in AFS combustion mode" CURVE 0x41acc _REC_CUR_20_u2_u1 99.94 _CNV_A_R_LINEAR_____542_CM -50. 49.94 FORMAT "%7.3"
 /begin AXIS_DESCR COM_AXIS TCO _CNV_A_R_LINEAR_____0_CM 9 -48. 142.5 FORMAT "%5.1" AXIS_PTS_REF ldpm_tco__tco_ofs_load_mis /end AXIS_DESCR
/end CHARACTERISTIC
/begin AXIS_PTS ldp_n_32__fac_thd_iv_s_er "" 0x4191c LDP_N_32__FAC_THD_IV_S_ER _REC_AXS_20_u1 8160. _CNV_A_R_LINEAR_____5_CM 6 0. 8160. FORMAT "%4.0" /end AXIS_PTS
/begin AXIS_PTS ldp_n_32__fac_thd_iv_er "" 0x41915 LDP_N_32__FAC_THD_IV_ER _REC_AXS_20_u1 8160. _CNV_A_R_LINEAR_____5_CM 6 0. 8160. FORMAT "%4.0" /end AXIS_PTS
/begin AXIS_PTS ldp_load_mis__thd_afl_er_is "" 0x4171e LDP_LOAD_MIS__THD_AFL_ER_IS _REC_AXS_20_u2 99.99694824000001 _CNV_A_R_LINEAR_____172_CM 6 0. 99.99694824 /end AXIS_PTS
/begin AXIS_PTS ldp_load_mis__thd_afs_er_is "" 0x4172c LDP_LOAD_MIS__THD_AFS_ER_IS _REC_AXS_20_u2 99.99694824000001 _CNV_A_R_LINEAR_____172_CM 6 0. 99.99694824 /end AXIS_PTS
/begin AXIS_PTS ldp_load_mis__thd_s_er_is "" 0x4178e LDP_LOAD_MIS__THD_S_ER_IS _REC_AXS_20_u2 99.99694824000001 _CNV_A_R_LINEAR_____172_CM 6 0. 99.99694824 /end AXIS_PTS
/begin AXIS_PTS ldp_n__thd_afs_er_is "" 0x41898 LDP_N__THD_AFS_ER_IS _REC_AXS_20_u2 8159. _CNV_A_R_LINEAR_____17_CM 4 1. 8160. FORMAT "%4.0" /end AXIS_PTS
/begin AXIS_PTS ldp_n__thd_afl_er_is "" 0x4188e LDP_N__THD_AFL_ER_IS _REC_AXS_20_u2 8159. _CNV_A_R_LINEAR_____17_CM 4 1. 8160. FORMAT "%4.0" /end AXIS_PTS
/begin AXIS_PTS ldp_n__thd_s_er_is "" 0x418a2 LDP_N__THD_S_ER_IS _REC_AXS_20_u2 8159. _CNV_A_R_LINEAR_____17_CM 4 1. 8160. FORMAT "%4.0" /end AXIS_PTS
/begin AXIS_PTS ldp_tco__fac_thd_er "" 0x41971 LDP_TCO__FAC_THD_ER _REC_AXS_20_u1 190.5 _CNV_A_R_LINEAR_____0_CM 8 -48. 142.5 FORMAT "%5.1" /end AXIS_PTS
/begin AXIS_PTS ldp_iga_ch_bas__fac_thd_er_ch "" 0x418e4 LDP_IGA_CH_BAS__FAC_THD_ER_CH _REC_AXS_20_u1 95.625 _CNV_A_R_LINEAR_____202_CM 4 -35.625 60. FORMAT "%5.1" /end AXIS_PTS
/begin CHARACTERISTIC IP_THD_AT_AFL_ER "ER threshold for misfire detection in air fuel lean combustion mode, AT vehicle" MAP 0x41b50 _REC_MAP_20_u2_u2_u1 65535. _CNV_A_R_LINEAR_____499_CM -32768. 32767. FORMAT "%6.0"
 /begin AXIS_DESCR COM_AXIS LOAD_MIS _CNV_A_R_LINEAR_____172_CM 6 0. 99.99694824 AXIS_PTS_REF ldp_load_mis__thd_at_afl_er /end AXIS_DESCR
 /begin AXIS_DESCR COM_AXIS N_32 _CNV_A_R_LINEAR_____5_CM 12 0. 8160. FORMAT "%4.0" AXIS_PTS_REF ldp_n_32__thd_at_afl_er /end AXIS_DESCR
/end CHARACTERISTIC
/begin CHARACTERISTIC IP_THD_AFL_ER_IS "ER threshold for misfire detection in air fuel lean combustion mode in idle speed" MAP 0x41af0 _REC_MAP_20_u2_u2_u2 65535. _CNV_A_R_LINEAR_____499_CM -32768. 32767. FORMAT "%6.0"
 /begin AXIS_DESCR COM_AXIS LOAD_MIS _CNV_A_R_LINEAR_____172_CM 6 0. 99.99694824 AXIS_PTS_REF ldp_load_mis__thd_afl_er_is /end AXIS_DESCR
 /begin AXIS_DESCR COM_AXIS N _CNV_A_R_LINEAR_____17_CM 4 1. 8160. FORMAT "%4.0" AXIS_PTS_REF ldp_n__thd_afl_er_is /end AXIS_DESCR
/end CHARACTERISTIC
/begin CHARACTERISTIC IP_THD_MT_AFS_ER "ER threshold for misfire detection in air stoichiometric combustion mode, MT vehicle" MAP 0x41d90 _REC_MAP_20_u2_u2_u1 65535. _CNV_A_R_LINEAR_____499_CM -32768. 32767. FORMAT "%6.0"
 /begin AXIS_DESCR COM_AXIS LOAD_MIS _CNV_A_R_LINEAR_____172_CM 6 0. 99.99694824 AXIS_PTS_REF ldp_load_mis__thd_mt_afs_er /end AXIS_DESCR
 /begin AXIS_DESCR COM_AXIS N_32 _CNV_A_R_LINEAR_____5_CM 12 0. 8160. FORMAT "%4.0" AXIS_PTS_REF ldp_n_32__thd_mt_afs_er /end AXIS_DESCR
/end CHARACTERISTIC
/begin CHARACTERISTIC IP_THD_MT_AFL_ER "ER threshold for misfire detection in air fuel lean combustion mode, MT vehicle" MAP 0x41d00 _REC_MAP_20_u2_u2_u1 65535. _CNV_A_R_LINEAR_____499_CM -32768. 32767. FORMAT "%6.0"
 /begin AXIS_DESCR COM_AXIS LOAD_MIS _CNV_A_R_LINEAR_____172_CM 6 0. 99.99694824 AXIS_PTS_REF ldp_load_mis__thd_mt_afl_er /end AXIS_DESCR
 /begin AXIS_DESCR COM_AXIS N_32 _CNV_A_R_LINEAR_____5_CM 12 0. 8160. FORMAT "%4.0" AXIS_PTS_REF ldp_n_32__thd_mt_afl_er /end AXIS_DESCR
/end CHARACTERISTIC
/begin CHARACTERISTIC IP_THD_AFS_ER_IS "ER threshold for misfire detection in air fuel lean combustion mode in idle speed" MAP 0x41b20 _REC_MAP_20_u2_u2_u2 65535. _CNV_A_R_LINEAR_____499_CM -32768. 32767. FORMAT "%6.0"
 /begin AXIS_DESCR COM_AXIS LOAD_MIS _CNV_A_R_LINEAR_____172_CM 6 0. 99.99694824 AXIS_PTS_REF ldp_load_mis__thd_afs_er_is /end AXIS_DESCR
 /begin AXIS_DESCR COM_AXIS N _CNV_A_R_LINEAR_____17_CM 4 1. 8160. FORMAT "%4.0" AXIS_PTS_REF ldp_n__thd_afs_er_is /end AXIS_DESCR
/end CHARACTERISTIC
/begin CHARACTERISTIC IP_THD_AT_AFS_ER "ER threshold for misfire detection in air stochiometric combustion mode, AT vehicle" MAP 0x41be0 _REC_MAP_20_u2_u2_u1 65535. _CNV_A_R_LINEAR_____499_CM -32768. 32767. FORMAT "%6.0"
 /begin AXIS_DESCR COM_AXIS LOAD_MIS _CNV_A_R_LINEAR_____172_CM 6 0. 99.99694824 AXIS_PTS_REF ldp_load_mis__thd_at_afs_er /end AXIS_DESCR
 /begin AXIS_DESCR COM_AXIS N_32 _CNV_A_R_LINEAR_____5_CM 12 0. 8160. FORMAT "%4.0" AXIS_PTS_REF ldp_n_32__thd_at_afs_er /end AXIS_DESCR
/end CHARACTERISTIC
/begin CHARACTERISTIC IP_THD_AT_S_ER "ER threshold for misfire detection in stratified combustion mode, AT vehicle" MAP 0x41c70 _REC_MAP_20_u2_u2_u1 65535. _CNV_A_R_LINEAR_____499_CM -32768. 32767. FORMAT "%6.0"
 /begin AXIS_DESCR COM_AXIS LOAD_MIS _CNV_A_R_LINEAR_____172_CM 6 0. 99.99694824 AXIS_PTS_REF ldp_load_mis__thd_at_s_er /end AXIS_DESCR
 /begin AXIS_DESCR COM_AXIS N_32 _CNV_A_R_LINEAR_____5_CM 12 0. 8160. FORMAT "%4.0" AXIS_PTS_REF ldp_n_32__thd_at_s_er /end AXIS_DESCR
/end CHARACTERISTIC
/begin CHARACTERISTIC IP_THD_MT_S_ER "ER threshold for misfire detection in stratified combustion mode, MT vehicle" MAP 0x41e20 _REC_MAP_20_u2_u2_u1 65535. _CNV_A_R_LINEAR_____499_CM -32768. 32767. FORMAT "%6.0"
 /begin AXIS_DESCR COM_AXIS LOAD_MIS _CNV_A_R_LINEAR_____172_CM 6 0. 99.99694824 AXIS_PTS_REF ldp_load_mis__thd_mt_s_er /end AXIS_DESCR
 /begin AXIS_DESCR COM_AXIS N_32 _CNV_A_R_LINEAR_____5_CM 12 0. 8160. FORMAT "%4.0" AXIS_PTS_REF ldp_n_32__thd_mt_s_er /end AXIS_DESCR
/end CHARACTERISTIC
/begin CHARACTERISTIC IP_THD_S_ER_IS "ER threshold for misfire detection in stratified combustion mode in idle speed" MAP 0x41eb0 _REC_MAP_20_u2_u2_u2 65535. _CNV_A_R_LINEAR_____499_CM -32768. 32767. FORMAT "%6.0"
 /begin AXIS_DESCR COM_AXIS LOAD_MIS _CNV_A_R_LINEAR_____172_CM 6 0. 99.99694824 AXIS_PTS_REF ldp_load_mis__thd_s_er_is /end AXIS_DESCR
 /begin AXIS_DESCR COM_AXIS N _CNV_A_R_LINEAR_____17_CM 4 1. 8160. FORMAT "%4.0" AXIS_PTS_REF ldp_n__thd_s_er_is /end AXIS_DESCR
/end CHARACTERISTIC
/begin CHARACTERISTIC IP_FAC_THD_IV_ER "Factor for adaptation of the threshold in case of active cylinder cut-off" CURVE 0x419ca _REC_CUR_20_u2_u1 1. _CNV_A_R_LINEAR_____182_CM 0. 1. FORMAT "%7.5"
 /begin AXIS_DESCR COM_AXIS N_32 _CNV_A_R_LINEAR_____5_CM 6 0. 8160. FORMAT "%4.0" AXIS_PTS_REF ldp_n_32__fac_thd_iv_er /end AXIS_DESCR
/end CHARACTERISTIC
/begin CHARACTERISTIC IP_FAC_THD_ER "Temperature dependent threshold reduction" CURVE 0x419ba _REC_CUR_20_u2_u1 1.9929 _CNV_A_R_LINEAR_____543_CM 0. 1.9929 FORMAT "%6.4"
 /begin AXIS_DESCR COM_AXIS TCO _CNV_A_R_LINEAR_____0_CM 8 -48. 142.5 FORMAT "%5.1" AXIS_PTS_REF ldp_tco__fac_thd_er /end AXIS_DESCR
/end CHARACTERISTIC
/begin CHARACTERISTIC IP_FAC_THD_ER_CH "Threshold correction depending on IGA for catalyst heating" CURVE 0x41fd4 _REC_CUR_20_u1_u1 1.9921875 _CNV_A_R_LINEAR_____103_CM 0. 1.9921875 FORMAT "%5.3"
 /begin AXIS_DESCR COM_AXIS IGA_CH_BAS _CNV_A_R_LINEAR_____202_CM 4 -35.625 60. FORMAT "%5.1" AXIS_PTS_REF ldp_iga_ch_bas__fac_thd_er_ch /end AXIS_DESCR
/end CHARACTERISTIC
/begin MEASUREMENT MIS_DET_CDN_APP_INH_NR "Misfiring APP INC detection fade out requests number  (after masking)" UBYTE _CNV_A_R_LINEAR_____10_CM 1 100. 0. 255. ECU_ADDRESS 0x3fdce0 FORMAT "%3.0" /end MEASUREMENT
/begin MEASUREMENT MIS_DET_CDN_APP_INH "Misfiring APP INC detection fade out requests carrier word (before masking)" UWORD _CNV_A_R_LINEAR_____10_CM 1 100. 0. 65535. ECU_ADDRESS 0x3fdcb6 FORMAT "%5.0" /end MEASUREMENT
/begin MEASUREMENT LV_INH_MAP_DIF_DET_MIS "Misfire detection fade out request flag due to MAP_DIF condition" UWORD _CNV_A_R_LINEAR_____10_CM 1 100. 0. 65535. ECU_ADDRESS 0x3fdcb6 FORMAT "%5.0" BIT_MASK 0x1 /end MEASUREMENT
/begin MEASUREMENT LV_INH_TPS_GRD_DET_MIS "Misfire detection fade out request flag due to TPS gradient condition" UWORD _CNV_A_R_LINEAR_____10_CM 1 100. 0. 65535. ECU_ADDRESS 0x3fdcb6 FORMAT "%5.0" BIT_MASK 0x2 /end MEASUREMENT
/begin MEASUREMENT LV_INH_LOAD_GRD_DET_MIS "Misfire detection fade out request flag due to LOAD_GRD_MIS condition" UWORD _CNV_A_R_LINEAR_____10_CM 1 100. 0. 65535. ECU_ADDRESS 0x3fdcb6 FORMAT "%5.0" BIT_MASK 0x4 /end MEASUREMENT
/begin MEASUREMENT LV_INH_IGA_DIF_DET_MIS "Misfire detection fade out request flag due to IGA_DIF condition" UWORD _CNV_A_R_LINEAR_____10_CM 1 100. 0. 65535. ECU_ADDRESS 0x3fdcb6 FORMAT "%5.0" BIT_MASK 0x8 /end MEASUREMENT
/begin MEASUREMENT LV_INH_CMB_TRA_MIS "Misfire detection fade out request flag due to combustion mode transients" UWORD _CNV_A_R_LINEAR_____10_CM 1 100. 0. 65535. ECU_ADDRESS 0x3fdcb6 FORMAT "%5.0" BIT_MASK 0x10 /end MEASUREMENT
/begin MEASUREMENT LV_INH_ACC_DET_MIS "Misfire detection fade out request flag due to Air conditionner transient condition" UWORD _CNV_A_R_LINEAR_____10_CM 1 100. 0. 65535. ECU_ADDRESS 0x3fdcb6 FORMAT "%5.0" BIT_MASK 0x20 /end MEASUREMENT
/begin MEASUREMENT LV_CDN_INH_MIS "Misfire detection fade out request flag due to OBD1 faults" UWORD _CNV_A_R_LINEAR_____10_CM 1 100. 0. 65535. ECU_ADDRESS 0x3fdcb6 FORMAT "%5.0" BIT_MASK 0x100 /end MEASUREMENT
/begin MEASUREMENT LV_INH_INDX_MIS "Misfire detection fade out request flag due to misfire detection index trouble" UWORD _CNV_A_R_LINEAR_____10_CM 1 100. 0. 65535. ECU_ADDRESS 0x3fdcb6 FORMAT "%5.0" BIT_MASK 0x200 /end MEASUREMENT
/begin MEASUREMENT IGA_MIS_1 "Ignition angle 1 misfire segment before" SBYTE _CNV_A_R_LINEAR_____75_CM 1 100. -48. 47.625 ECU_ADDRESS 0x3fdce3 FORMAT "%5.1" /end MEASUREMENT
/begin MEASUREMENT IGA_MIS_2 "Ignition angle 2 misfire segment before" SBYTE _CNV_A_R_LINEAR_____75_CM 1 100. -48. 47.625 ECU_ADDRESS 0x3fdce2 FORMAT "%5.1" /end MEASUREMENT
/begin MEASUREMENT IGA_MIS "Ignition angle at current misfire segment" SBYTE _CNV_A_R_LINEAR_____75_CM 1 100. -48. 47.625 ECU_ADDRESS 0x3fdce4 FORMAT "%5.1" /end MEASUREMENT
/begin MEASUREMENT LV_REQ_APP_INH_MIS "Misfire detection APP INC fade out request flag" UBYTE _CNV_S_2_RANGE______11_CM 1 100. 0. 1. ECU_ADDRESS 0x3fcbd6 /end MEASUREMENT
/begin MEASUREMENT CTR_TOT_MIS "Overall misfire detection counter" ULONG _CNV_A_R_LINEAR_____12_CM 1 100. 0. 4294967295. ECU_ADDRESS 0x3fcbc4 FORMAT "%11.0" /end MEASUREMENT
/begin CHARACTERISTIC C_MASK_APP_INH_DET_ZDLY_MIS "MIS_DET_CDN_APP_INH carrier structure fade out configuration mask (misfire detection zero delay phase)" VALUE 0x4164a _REC_VAL_20_u2 65535. _CNV_A_R_LINEAR_____10_CM 0. 65535. FORMAT "%5.0" /end CHARACTERISTIC
/begin CHARACTERISTIC C_MASK_APP_INH_DET_MIS "MIS_DET_CDN_APP_INH carrier structure fade out configuration mask (misfire detection nominal phase)" VALUE 0x41648 _REC_VAL_20_u2 65535. _CNV_A_R_LINEAR_____10_CM 0. 65535. FORMAT "%5.0" /end CHARACTERISTIC
/begin CHARACTERISTIC C_MAP_DIF_DLY_ER "Fade out duration when manifold air pressure gradient has been detected" VALUE 0x41646 _REC_VAL_20_u2 655.35 _CNV_A_R_LINEAR_____27_CM 0. 655.35 FORMAT "%5.2" /end CHARACTERISTIC
/begin CHARACTERISTIC C_TPS_GRD_DLY_ZDLY_ER "Fade out duration when maximum throttle gradient has been detected during zero delay starting phase" VALUE 0x41676 _REC_VAL_20_u2 655.35 _CNV_A_R_LINEAR_____27_CM 0. 655.35 FORMAT "%5.2" /end CHARACTERISTIC
/begin CHARACTERISTIC C_NR_TDC_IGA_DIF_ER "Fade out duration when IGA difference per TDC has been detected" VALUE 0x41627 _REC_VAL_20_u1 255. _CNV_A_R_LINEAR_____10_CM 0. 255. FORMAT "%3.0" /end CHARACTERISTIC
/begin CHARACTERISTIC C_TPS_GRD_DLY_ER "Fade out duration when maximum throttle gradient has been detected" VALUE 0x41674 _REC_VAL_20_u2 655.35 _CNV_A_R_LINEAR_____27_CM 0. 655.35 FORMAT "%5.2" /end CHARACTERISTIC
/begin CHARACTERISTIC C_LOAD_GRD_HOM_DLY_MIS "Fade out duration when maximum LOAD_GRD_MIS has been detected in homogeneous combustion  modes" VALUE 0x4163e _REC_VAL_20_u2 655.35 _CNV_A_R_LINEAR_____27_CM 0. 655.35 FORMAT "%5.2" /end CHARACTERISTIC
/begin CHARACTERISTIC C_LOAD_GRD_S_DLY_MIS "Fade out duration when maximum LOAD_GRD_MIS has been detected in stratified combustion  mode" VALUE 0x41640 _REC_VAL_20_u2 655.35 _CNV_A_R_LINEAR_____27_CM 0. 655.35 FORMAT "%5.2" /end CHARACTERISTIC
/begin CHARACTERISTIC C_NR_TDC_CMB_TRA_S_MIS "Fade out TDC's duration when engine combustion manager enter or leave stratified combustion mode" VALUE 0x41626 _REC_VAL_20_u1 255. _CNV_A_R_LINEAR_____544_CM 0. 255. FORMAT "%3.0" /end CHARACTERISTIC
/begin CHARACTERISTIC C_NR_TDC_CMB_TRA_AFL_MIS "Fade out TDC's duration when engine combustion manager enter or leave air/fuel lean combustion mode" VALUE 0x41625 _REC_VAL_20_u1 255. _CNV_A_R_LINEAR_____544_CM 0. 255. FORMAT "%3.0" /end CHARACTERISTIC
/begin CHARACTERISTIC C_ACCOUT_DLY_ER "Fade out duration when air-conditioning compressor has been switched on" VALUE 0x41638 _REC_VAL_20_u2 655.34 _CNV_A_R_LINEAR_____27_CM 1.e-002 655.35 FORMAT "%5.2" /end CHARACTERISTIC
/begin CHARACTERISTIC IP_TPS_GRD_MAX_ER "Maximum throttle gradient threshold for fade out condition" CURVE 0x42044 _REC_CUR_20_u1_u2 2987.5 _CNV_A_R_LINEAR_____264_CM 0. 2987.5 FORMAT "%6.1"
 /begin AXIS_DESCR COM_AXIS TPS_AV _CNV_A_R_LINEAR_____226_CM 10 0. 119.5 FORMAT "%7.3" AXIS_PTS_REF ldp_tps_av__tps_grd_max_er /end AXIS_DESCR
/end CHARACTERISTIC
/begin CHARACTERISTIC IP_TPS_GRD_MAX_ZDLY_ER "Maximum throttle gradient threshold for fade out condition during zero delay misfire monitoring activation" CURVE 0x4204e _REC_CUR_20_u1_u2 2987.5 _CNV_A_R_LINEAR_____264_CM 0. 2987.5 FORMAT "%6.1"
 /begin AXIS_DESCR COM_AXIS TPS_AV _CNV_A_R_LINEAR_____226_CM 6 0. 119.5 FORMAT "%7.3" AXIS_PTS_REF ldp_tps_av__tps_grd_max_zdly_er /end AXIS_DESCR
/end CHARACTERISTIC
/begin CHARACTERISTIC IP_LOAD_GRD_HOM_MAX_MIS "Maximum LOAD_MIS gradient for fade out condition in homogeneous combustion modes" CURVE 0x419e2 _REC_CUR_20_u2_u2 99.99694824000001 _CNV_A_R_LINEAR_____172_CM 0. 99.99694824
 /begin AXIS_DESCR COM_AXIS LOAD_MIS _CNV_A_R_LINEAR_____172_CM 12 0. 99.99694824 AXIS_PTS_REF ldp_load_mis__load_grd_hom_max /end AXIS_DESCR
/end CHARACTERISTIC
/begin CHARACTERISTIC IP_LOAD_GRD_S_MAX_MIS "Maximum LOAD_MIS gradient for fade out condition in stratified combustion mode" CURVE 0x419fa _REC_CUR_20_u2_u2 99.99694824000001 _CNV_A_R_LINEAR_____172_CM 0. 99.99694824
 /begin AXIS_DESCR COM_AXIS LOAD_MIS _CNV_A_R_LINEAR_____172_CM 12 0. 99.99694824 AXIS_PTS_REF ldp_load_mis__load_grd_s_max /end AXIS_DESCR
/end CHARACTERISTIC
/begin AXIS_PTS ldp_map__map_dif_max_er "" 0x417ae LDP_MAP__MAP_DIF_MAX_ER _REC_AXS_20_u2 5434. _CNV_A_R_LINEAR_____43_CM 12 0. 5434. FORMAT "%7.2" /end AXIS_PTS
/begin CHARACTERISTIC IP_MAP_DIF_MAX_ER "Maximum MAP gradient (per segment °CRK) for fade out condition" CURVE 0x41aa2 _REC_CUR_20_u2_u2 5434. _CNV_A_R_LINEAR_____43_CM 0. 5434. FORMAT "%7.2"
 /begin AXIS_DESCR COM_AXIS MAP _CNV_A_R_LINEAR_____43_CM 12 0. 5434. FORMAT "%7.2" AXIS_PTS_REF ldp_map__map_dif_max_er /end AXIS_DESCR
/end CHARACTERISTIC
/begin AXIS_PTS ldp_n_32__delta_iga_mis "" 0x418e9 LDP_N_32__DELTA_IGA_MIS _REC_AXS_20_u1 8160. _CNV_A_R_LINEAR_____5_CM 8 0. 8160. FORMAT "%4.0" /end AXIS_PTS
/begin AXIS_PTS ldp_maf__delta_iga_mis "" 0x4179c LDP_MAF__DELTA_IGA_MIS _REC_AXS_20_u2 1389. _CNV_A_R_LINEAR_____95_CM 8 0. 1389. FORMAT "%7.2" /end AXIS_PTS
/begin CHARACTERISTIC IP_DELTA_IGA_MIS "Spark advance angle difference at part load for misfire inhibition" MAP 0x41ee0 _REC_MAP_20_u1_u1_u2 47.625 _CNV_A_R_LINEAR_____75_CM 0. 47.625
 /begin AXIS_DESCR COM_AXIS N_32 _CNV_A_R_LINEAR_____5_CM 8 0. 8160. FORMAT "%4.0" AXIS_PTS_REF ldp_n_32__delta_iga_mis /end AXIS_DESCR
 /begin AXIS_DESCR COM_AXIS MAF _CNV_A_R_LINEAR_____95_CM 8 0. 1389. FORMAT "%7.2" AXIS_PTS_REF ldp_maf__delta_iga_mis /end AXIS_DESCR
/end CHARACTERISTIC
/begin CHARACTERISTIC IP_FAC_THD_IV_S_ER "Factor for adaptation of the threshold in case of active cylinder cut-off in stratified combustion mode" CURVE 0x419d6 _REC_CUR_20_u2_u1 1. _CNV_A_R_LINEAR_____182_CM 0. 1. FORMAT "%7.5"
 /begin AXIS_DESCR COM_AXIS N_32 _CNV_A_R_LINEAR_____5_CM 6 0. 8160. FORMAT "%4.0" AXIS_PTS_REF ldp_n_32__fac_thd_iv_s_er /end AXIS_DESCR
/end CHARACTERISTIC
/begin AXIS_PTS ldpm_amp__amp_ofs_load_mis "" 0x418d0 LDPM_AMP__AMP_OFS_LOAD_MIS _REC_AXS_20_u2 5434. _CNV_A_R_LINEAR_____43_CM 9 0. 5434. FORMAT "%7.2" /end AXIS_PTS
/begin AXIS_PTS ldpm_tco__tco_ofs_load_mis "" 0x4197a LDPM_TCO__TCO_OFS_LOAD_MIS _REC_AXS_20_u1 190.5 _CNV_A_R_LINEAR_____0_CM 9 -48. 142.5 FORMAT "%5.1" /end AXIS_PTS
/begin CHARACTERISTIC LC_CONF_LOAD_MIS "LOAD_MIS switch configuration versus engine combustion mode : (=0) LOAD_MIS always relative to TQI_AV (=1) LOAD_MIS relative to MAF in homogeneous combustion modes & relative to TQI_AV in stratified mode" VALUE 0x4162c _REC_VAL_20_u1 1. _CNV_S_2_RANGE______11_CM 0. 1. /end CHARACTERISTIC
/begin CHARACTERISTIC C_TQI_AV_MAX_MIS "Maximum torque value to determine engine load ratio scale" VALUE 0x41678 _REC_VAL_20_u2 1023.984375 _CNV_A_R_LINEAR_____545_CM 0. 1023.984375 FORMAT "%7.2" /end CHARACTERISTIC
/begin CHARACTERISTIC C_MAF_MAX_MIS "Maximum air mass value to determine engine load ratio scale" VALUE 0x41644 _REC_VAL_20_u2 1389. _CNV_A_R_LINEAR_____95_CM 0. 1389. FORMAT "%7.2" /end CHARACTERISTIC
/begin AXIS_PTS ldp_tps_av__tps_grd_max_er "" 0x418ac LDP_TPS_AV__TPS_GRD_MAX_ER _REC_AXS_20_u2 119.5 _CNV_A_R_LINEAR_____226_CM 10 0. 119.5 FORMAT "%7.3" /end AXIS_PTS
/begin AXIS_PTS ldp_tps_av__tps_grd_max_zdly_er "" 0x418c2 LDP_TPS_AV__TPS_GRD_MAX_ZDLY_ER _REC_AXS_20_u2 11.95 _CNV_A_R_LINEAR_____226_CM 6 0. 119.5 FORMAT "%7.3" /end AXIS_PTS
/begin AXIS_PTS ldp_load_mis__load_grd_hom_max "" 0x416ea LDP_LOAD_MIS__LOAD_GRD_HOM_MAX _REC_AXS_20_u2 99.99694824000001 _CNV_A_R_LINEAR_____172_CM 12 0. 99.99694824 /end AXIS_PTS
/begin AXIS_PTS ldp_load_mis__load_grd_s_max "" 0x41704 LDP_LOAD_MIS__LOAD_GRD_S_MAX _REC_AXS_20_u2 99.99694824000001 _CNV_A_R_LINEAR_____172_CM 12 0. 99.99694824 /end AXIS_PTS
/begin MEASUREMENT THD_ER_BUF_0 "Misfire detection threshold stack for ER evaluation" SWORD _CNV_A_R_LINEAR_____490_CM 1 100. -32768. 32767. ECU_ADDRESS 0x3fdc9a FORMAT "%6.0" /end MEASUREMENT
/begin MEASUREMENT THD_ER_BUF_1 "Misfire detection threshold stack for ER evaluation" SWORD _CNV_A_R_LINEAR_____490_CM 1 100. -32768. 32767. ECU_ADDRESS 0x3fdc9c FORMAT "%6.0" /end MEASUREMENT
/begin MEASUREMENT THD_ER_BUF_2 "Misfire detection threshold stack for ER evaluation" SWORD _CNV_A_R_LINEAR_____490_CM 1 100. -32768. 32767. ECU_ADDRESS 0x3fdc9e FORMAT "%6.0" /end MEASUREMENT
/begin MEASUREMENT THD_ER_BUF_3 "Misfire detection threshold stack for ER evaluation" SWORD _CNV_A_R_LINEAR_____490_CM 1 100. -32768. 32767. ECU_ADDRESS 0x3fdca0 FORMAT "%6.0" /end MEASUREMENT
/begin MEASUREMENT THD_ER_BUF_4 "Misfire detection threshold stack for ER evaluation" SWORD _CNV_A_R_LINEAR_____490_CM 1 100. -32768. 32767. ECU_ADDRESS 0x3fdca2 FORMAT "%6.0" /end MEASUREMENT
/begin MEASUREMENT THD_ER_BUF_5 "Misfire detection threshold stack for ER evaluation" SWORD _CNV_A_R_LINEAR_____490_CM 1 100. -32768. 32767. ECU_ADDRESS 0x3fdca4 FORMAT "%6.0" /end MEASUREMENT
/begin MEASUREMENT THD_ER_STND_BUF_0 "Misfire detection threshold stack for ER_STND evaluation" SWORD _CNV_A_R_LINEAR_____10_CM 1 100. -32768. 32767. ECU_ADDRESS 0x3fdca8 FORMAT "%6.0" /end MEASUREMENT
/begin MEASUREMENT THD_ER_STND_BUF_1 "Misfire detection threshold stack for ER_STND evaluation" SWORD _CNV_A_R_LINEAR_____10_CM 1 100. -32768. 32767. ECU_ADDRESS 0x3fdcaa FORMAT "%6.0" /end MEASUREMENT
/begin MEASUREMENT THD_ER_STND_BUF_2 "Misfire detection threshold stack for ER_STND evaluation" SWORD _CNV_A_R_LINEAR_____10_CM 1 100. -32768. 32767. ECU_ADDRESS 0x3fdcac FORMAT "%6.0" /end MEASUREMENT
/begin MEASUREMENT THD_ER_STND_BUF_3 "Misfire detection threshold stack for ER_STND evaluation" SWORD _CNV_A_R_LINEAR_____10_CM 1 100. -32768. 32767. ECU_ADDRESS 0x3fdcae FORMAT "%6.0" /end MEASUREMENT
/begin MEASUREMENT THD_ER_STND_BUF_4 "Misfire detection threshold stack for ER_STND evaluation" SWORD _CNV_A_R_LINEAR_____10_CM 1 100. -32768. 32767. ECU_ADDRESS 0x3fdcb0 FORMAT "%6.0" /end MEASUREMENT
/begin MEASUREMENT THD_ER_STND_BUF_5 "Misfire detection threshold stack for ER_STND evaluation" SWORD _CNV_A_R_LINEAR_____10_CM 1 100. -32768. 32767. ECU_ADDRESS 0x3fdcb2 FORMAT "%6.0" /end MEASUREMENT
/begin MEASUREMENT IGA_DIF_MIS "Ignition angle difference between 2 misfire segment tasks" SBYTE _CNV_A_R_LINEAR_____75_CM 1 100. -48. 47.625 ECU_ADDRESS 0x3fdce1 FORMAT "%5.1" /end MEASUREMENT
/begin MEASUREMENT MAP_DIF_MIS "Manifold air pressure difference between 2 misfire segment tasks" UWORD _CNV_A_R_LINEAR_____43_CM 1 100. 0. 5434. ECU_ADDRESS 0x3fdcb8 FORMAT "%7.2" /end MEASUREMENT
/begin MEASUREMENT THD_ER_STND "Misfire detection threshold for current ER_STND value" SWORD _CNV_A_R_LINEAR_____10_CM 1 100. -32768. 32767. ECU_ADDRESS 0x3fcbd4 FORMAT "%6.0" /end MEASUREMENT
/begin MEASUREMENT THD_ER_STND_0 "Misfire detection thresholds for cylinder ER_STND values" SWORD _CNV_A_R_LINEAR_____10_CM 1 100. -32768. 32767. ECU_ADDRESS 0x3fdcd4 FORMAT "%6.0" /end MEASUREMENT
/begin MEASUREMENT THD_ER_STND_1 "Misfire detection thresholds for cylinder ER_STND values" SWORD _CNV_A_R_LINEAR_____10_CM 1 100. -32768. 32767. ECU_ADDRESS 0x3fdcd6 FORMAT "%6.0" /end MEASUREMENT
/begin MEASUREMENT THD_ER_STND_2 "Misfire detection thresholds for cylinder ER_STND values" SWORD _CNV_A_R_LINEAR_____10_CM 1 100. -32768. 32767. ECU_ADDRESS 0x3fdcd8 FORMAT "%6.0" /end MEASUREMENT
/begin MEASUREMENT THD_ER_STND_3 "Misfire detection thresholds for cylinder ER_STND values" SWORD _CNV_A_R_LINEAR_____10_CM 1 100. -32768. 32767. ECU_ADDRESS 0x3fdcda FORMAT "%6.0" /end MEASUREMENT
/begin MEASUREMENT THD_ER_STND_4 "Misfire detection thresholds for cylinder ER_STND values" SWORD _CNV_A_R_LINEAR_____10_CM 1 100. -32768. 32767. ECU_ADDRESS 0x3fdcdc FORMAT "%6.0" /end MEASUREMENT
/begin MEASUREMENT THD_ER_STND_5 "Misfire detection thresholds for cylinder ER_STND values" SWORD _CNV_A_R_LINEAR_____10_CM 1 100. -32768. 32767. ECU_ADDRESS 0x3fdcde FORMAT "%6.0" /end MEASUREMENT
/begin MEASUREMENT THD_ER "Misfire detection threshold for current ER value" SWORD _CNV_A_R_LINEAR_____490_CM 1 100. -32768. 32767. ECU_ADDRESS 0x3fcbd2 FORMAT "%6.0" /end MEASUREMENT
/begin MEASUREMENT THD_ER_0 "Misfire detection thresholds for cylinder ER values" SWORD _CNV_A_R_LINEAR_____490_CM 1 100. -32768. 32767. ECU_ADDRESS 0x3fdcc8 FORMAT "%6.0" /end MEASUREMENT
/begin MEASUREMENT THD_ER_1 "Misfire detection thresholds for cylinder ER values" SWORD _CNV_A_R_LINEAR_____490_CM 1 100. -32768. 32767. ECU_ADDRESS 0x3fdcca FORMAT "%6.0" /end MEASUREMENT
/begin MEASUREMENT THD_ER_2 "Misfire detection thresholds for cylinder ER values" SWORD _CNV_A_R_LINEAR_____490_CM 1 100. -32768. 32767. ECU_ADDRESS 0x3fdccc FORMAT "%6.0" /end MEASUREMENT
/begin MEASUREMENT THD_ER_3 "Misfire detection thresholds for cylinder ER values" SWORD _CNV_A_R_LINEAR_____490_CM 1 100. -32768. 32767. ECU_ADDRESS 0x3fdcce FORMAT "%6.0" /end MEASUREMENT
/begin MEASUREMENT THD_ER_4 "Misfire detection thresholds for cylinder ER values" SWORD _CNV_A_R_LINEAR_____490_CM 1 100. -32768. 32767. ECU_ADDRESS 0x3fdcd0 FORMAT "%6.0" /end MEASUREMENT
/begin MEASUREMENT THD_ER_5 "Misfire detection thresholds for cylinder ER values" SWORD _CNV_A_R_LINEAR_____490_CM 1 100. -32768. 32767. ECU_ADDRESS 0x3fdcd2 FORMAT "%6.0" /end MEASUREMENT
/begin AXIS_PTS ldp_n__load_min_s_mt_mis "" 0x4184a LDP_N__LOAD_MIN_S_MT_MIS _REC_AXS_20_u2 8160. _CNV_A_R_LINEAR_____17_CM 12 0. 8160. FORMAT "%4.0" /end AXIS_PTS
/begin AXIS_PTS ldp_n__load_min_s_at_mis "" 0x41830 LDP_N__LOAD_MIN_S_AT_MIS _REC_AXS_20_u2 8160. _CNV_A_R_LINEAR_____17_CM 12 0. 8160. FORMAT "%4.0" /end AXIS_PTS
/begin AXIS_PTS ldp_n__load_min_afs_mt_mis "" 0x41816 LDP_N__LOAD_MIN_AFS_MT_MIS _REC_AXS_20_u2 8160. _CNV_A_R_LINEAR_____17_CM 12 0. 8160. FORMAT "%4.0" /end AXIS_PTS
/begin AXIS_PTS ldp_n__load_min_afs_at_mis "" 0x417fc LDP_N__LOAD_MIN_AFS_AT_MIS _REC_AXS_20_u2 8160. _CNV_A_R_LINEAR_____17_CM 12 0. 8160. FORMAT "%4.0" /end AXIS_PTS
/begin AXIS_PTS ldp_n__load_min_afl_mt_mis "" 0x417e2 LDP_N__LOAD_MIN_AFL_MT_MIS _REC_AXS_20_u2 8160. _CNV_A_R_LINEAR_____17_CM 12 0. 8160. FORMAT "%4.0" /end AXIS_PTS
/begin AXIS_PTS ldp_n__load_min_afl_at_mis "" 0x417c8 LDP_N__LOAD_MIN_AFL_AT_MIS _REC_AXS_20_u2 8160. _CNV_A_R_LINEAR_____17_CM 12 0. 8160. FORMAT "%4.0" /end AXIS_PTS
/begin AXIS_PTS ldp_load_mis__thd_mt_afl_er "" 0x41764 LDP_LOAD_MIS__THD_MT_AFL_ER _REC_AXS_20_u2 99.99694824000001 _CNV_A_R_LINEAR_____172_CM 6 0. 99.99694824 /end AXIS_PTS
/begin AXIS_PTS ldp_load_mis__thd_at_afl_er "" 0x4173a LDP_LOAD_MIS__THD_AT_AFL_ER _REC_AXS_20_u2 99.99694824000001 _CNV_A_R_LINEAR_____172_CM 6 0. 99.99694824 /end AXIS_PTS
/begin AXIS_PTS ldp_n_32__thd_mt_afl_er "" 0x4194a LDP_N_32__THD_MT_AFL_ER _REC_AXS_20_u1 8160. _CNV_A_R_LINEAR_____5_CM 12 0. 8160. FORMAT "%4.0" /end AXIS_PTS
/begin AXIS_PTS ldp_n_32__thd_at_afl_er "" 0x41923 LDP_N_32__THD_AT_AFL_ER _REC_AXS_20_u1 8160. _CNV_A_R_LINEAR_____5_CM 12 0. 8160. FORMAT "%4.0" /end AXIS_PTS
/begin AXIS_PTS ldp_load_mis__thd_mt_afs_er "" 0x41772 LDP_LOAD_MIS__THD_MT_AFS_ER _REC_AXS_20_u2 99.99694824000001 _CNV_A_R_LINEAR_____172_CM 6 0. 99.99694824 /end AXIS_PTS
/begin AXIS_PTS ldp_load_mis__thd_at_afs_er "" 0x41748 LDP_LOAD_MIS__THD_AT_AFS_ER _REC_AXS_20_u2 99.99694824000001 _CNV_A_R_LINEAR_____172_CM 6 0. 99.99694824 /end AXIS_PTS
/begin AXIS_PTS ldp_load_mis__thd_mt_s_er "" 0x41780 LDP_LOAD_MIS__THD_MT_S_ER _REC_AXS_20_u2 99.99694824000001 _CNV_A_R_LINEAR_____172_CM 6 0. 99.99694824 /end AXIS_PTS
/begin AXIS_PTS ldp_load_mis__thd_at_s_er "" 0x41756 LDP_LOAD_MIS__THD_AT_S_ER _REC_AXS_20_u2 99.99694824000001 _CNV_A_R_LINEAR_____172_CM 6 0. 99.99694824 /end AXIS_PTS
/begin AXIS_PTS ldp_n_32__thd_mt_s_er "" 0x41964 LDP_N_32__THD_MT_S_ER _REC_AXS_20_u1 8160. _CNV_A_R_LINEAR_____5_CM 12 0. 8160. FORMAT "%4.0" /end AXIS_PTS
/begin AXIS_PTS ldp_n_32__thd_at_s_er "" 0x4193d LDP_N_32__THD_AT_S_ER _REC_AXS_20_u1 8160. _CNV_A_R_LINEAR_____5_CM 12 0. 8160. FORMAT "%4.0" /end AXIS_PTS
/begin AXIS_PTS ldp_n_32__thd_mt_afs_er "" 0x41957 LDP_N_32__THD_MT_AFS_ER _REC_AXS_20_u1 8160. _CNV_A_R_LINEAR_____5_CM 12 0. 8160. FORMAT "%4.0" /end AXIS_PTS
/begin AXIS_PTS ldp_n_32__thd_at_afs_er "" 0x41930 LDP_N_32__THD_AT_AFS_ER _REC_AXS_20_u1 8160. _CNV_A_R_LINEAR_____5_CM 12 0. 8160. FORMAT "%4.0" /end AXIS_PTS
/begin MEASUREMENT STATE_DIAG_MIS "Misfire detection phase state machine" UBYTE _CNV_S_5_RANGE_STAT_546_CM 1 100. 0. 4. ECU_ADDRESS 0x3fdd10 /end MEASUREMENT
/begin MEASUREMENT MIS_DET_CYL_INH "Cylinder misfiring detection inhibition carrier byte when a fade out condition occurred (after masking & delay)" UWORD _CNV_A_R_LINEAR_____10_CM 1 100. 0. 65535. ECU_ADDRESS 0x3fdd0e FORMAT "%5.0" /end MEASUREMENT
/begin MEASUREMENT MIS_DET_CDN_INH_NR "Misfiring detection fade out requests number (after masking)" UBYTE _CNV_A_R_LINEAR_____10_CM 1 100. 0. 255. ECU_ADDRESS 0x3fdd12 FORMAT "%3.0" /end MEASUREMENT
/begin MEASUREMENT CTR_TDC_ZDLY_MIS "TDC decounter for disabled diagnostic" UWORD _CNV_A_R_LINEAR_____544_CM 1 100. 0. 65535. ECU_ADDRESS 0x3fdd0c FORMAT "%5.0" /end MEASUREMENT
/begin MEASUREMENT CTR_T_ZDLY_MIS "10 ms decounter for diagnostic fade out (general purpose)" UWORD _CNV_A_R_LINEAR_____27_CM 1 100. 0. 655.35 ECU_ADDRESS 0x3fcbe4 FORMAT "%5.2" /end MEASUREMENT
/begin MEASUREMENT LV_DIAG_MIS "Nominal Misfire Monitoring Phase" UBYTE _CNV_S_2_RANGE______11_CM 1 100. 0. 1. ECU_ADDRESS 0x3fdd14 /end MEASUREMENT
/begin CHARACTERISTIC C_MASK_INH_DET_ZDLY_MIS "MIS_DET_CDN_INH carrier structure fade out configuration mask (misfire detection zero delay phase)" VALUE 0x4161a _REC_VAL_20_u1 255. _CNV_A_R_LINEAR_____10_CM 0. 255. FORMAT "%3.0" /end CHARACTERISTIC
/begin CHARACTERISTIC C_N_MIN_ZDLY_MIS "Minimum engine speed for zero delay misfire monitoring activation" VALUE 0x41666 _REC_VAL_20_u2 8160. _CNV_A_R_LINEAR_____17_CM 0. 8160. FORMAT "%4.0" /end CHARACTERISTIC
/begin CHARACTERISTIC C_T_ZDLY_MIS "Duration for engine start specific misfire monitoring (5s according CARB)" VALUE 0x41670 _REC_VAL_20_u2 655.35 _CNV_A_R_LINEAR_____27_CM 0. 655.35 FORMAT "%5.2" /end CHARACTERISTIC
/begin CHARACTERISTIC C_NR_TDC_ZDLY_MIS "Standard TDC count disablement tdc number before monitoring (engine start phase)" VALUE 0x41629 _REC_VAL_20_u1 255. _CNV_A_R_LINEAR_____544_CM 0. 255. FORMAT "%3.0" /end CHARACTERISTIC
/begin CHARACTERISTIC C_N_MIN_MIS "Minimum engine speed for misfire detection" VALUE 0x41664 _REC_VAL_20_u2 8160. _CNV_A_R_LINEAR_____17_CM 0. 8160. FORMAT "%4.0" /end CHARACTERISTIC
/begin CHARACTERISTIC C_N_MAX_MIS_AT "Maximum engine speed for misfire detection / automatic transmission" VALUE 0x41660 _REC_VAL_20_u2 8160. _CNV_A_R_LINEAR_____17_CM 0. 8160. FORMAT "%4.0" /end CHARACTERISTIC
/begin CHARACTERISTIC C_N_MAX_MIS_MT "Maximum engine speed for misfire detection / manual transmission" VALUE 0x41662 _REC_VAL_20_u2 8160. _CNV_A_R_LINEAR_____17_CM 0. 8160. FORMAT "%4.0" /end CHARACTERISTIC
/begin MEASUREMENT MIS_DET_CDN_INH "Misfiring detection fade out requests carrier byte (before masking)" UBYTE _CNV_A_R_LINEAR_____10_CM 1 100. 0. 255. ECU_ADDRESS 0x3fdd11 FORMAT "%3.0" /end MEASUREMENT
/begin MEASUREMENT LV_INH_N_DET_MIS "Misfire detection fade out request flag due to engine speed condition" UBYTE _CNV_A_R_LINEAR_____10_CM 1 100. 0. 255. ECU_ADDRESS 0x3fdd11 FORMAT "%3.0" BIT_MASK 0x1 /end MEASUREMENT
/begin MEASUREMENT LV_INH_LOAD_MIN_DET_MIS "Misfire detection fade out request flag due to zero load line condition" UBYTE _CNV_A_R_LINEAR_____10_CM 1 100. 0. 255. ECU_ADDRESS 0x3fdd11 FORMAT "%3.0" BIT_MASK 0x2 /end MEASUREMENT
/begin MEASUREMENT LV_INH_TCO_MIN_DET_MIS "Misfire detection fade out request flag due to minimum temperature condition" UBYTE _CNV_A_R_LINEAR_____10_CM 1 100. 0. 255. ECU_ADDRESS 0x3fdd11 FORMAT "%3.0" BIT_MASK 0x4 /end MEASUREMENT
/begin MEASUREMENT LV_INH_AMP_MIN_DET_MIS "Misfire detection fade out request flag due to minimum atmospheric pressure condition" UBYTE _CNV_A_R_LINEAR_____10_CM 1 100. 0. 255. ECU_ADDRESS 0x3fdd11 FORMAT "%3.0" BIT_MASK 0x8 /end MEASUREMENT
/begin MEASUREMENT LV_INH_ST_DET_MIS "Misfire detection fade out request flag due to engine start condition" UBYTE _CNV_A_R_LINEAR_____10_CM 1 100. 0. 255. ECU_ADDRESS 0x3fdd11 FORMAT "%3.0" BIT_MASK 0x10 /end MEASUREMENT
/begin MEASUREMENT LV_INH_IV_OFF_DET_MIS "Misfire detection fade out request flag due to cylinder shut-off condition" UBYTE _CNV_A_R_LINEAR_____10_CM 1 100. 0. 255. ECU_ADDRESS 0x3fdd11 FORMAT "%3.0" BIT_MASK 0x20 /end MEASUREMENT
/begin MEASUREMENT LV_REQ_INH_MIS "Misfire detection fade out request flag" UBYTE _CNV_S_2_RANGE______11_CM 1 100. 0. 1. ECU_ADDRESS 0x3fcbe6 /end MEASUREMENT
/begin CHARACTERISTIC C_MASK_INH_DET_MIS "MIS_DET_CDN_INH carrier structure fade out configuration mask (misfire detection nominal phase)" VALUE 0x41619 _REC_VAL_20_u1 255. _CNV_A_R_LINEAR_____10_CM 0. 255. FORMAT "%3.0" /end CHARACTERISTIC
/begin CHARACTERISTIC C_NR_TDC_INH_MIS "Fade out duration in TDC when engine speed rise up to C_N_MIN_ZDLY_MIS" VALUE 0x41628 _REC_VAL_20_u1 255. _CNV_A_R_LINEAR_____544_CM 0. 255. FORMAT "%3.0" /end CHARACTERISTIC
/begin CHARACTERISTIC LC_REQ_ZDLY_MIS "Activation of CARB required 0 delay monitoring" VALUE 0x41637 _REC_VAL_20_u1 1. _CNV_S_2_RANGE______11_CM 0. 1. /end CHARACTERISTIC
/begin CHARACTERISTIC C_AMP_MIN_MIS "Minimum amp for misfire detection" VALUE 0x4163a _REC_VAL_20_u2 5434. _CNV_A_R_LINEAR_____43_CM 0. 5434. FORMAT "%7.2" /end CHARACTERISTIC
/begin CHARACTERISTIC C_TCO_MIN_MIS "Minimum coolant temperature for misfire detection" VALUE 0x4162a _REC_VAL_20_u1 28.575 _CNV_A_R_LINEAR_____0_CM -48. 142.5 FORMAT "%5.1" /end CHARACTERISTIC
/begin CHARACTERISTIC C_T_DLY_ST_MIS "Fade out duration when engine operating state start LV_ST has been exited" VALUE 0x4166c _REC_VAL_20_u2 655.35 _CNV_A_R_LINEAR_____27_CM 0. 655.35 FORMAT "%5.2" /end CHARACTERISTIC
/begin CHARACTERISTIC C_T_DLY_IV_OFF_MIS "Fade out duration after injection is back on" VALUE 0x4166a _REC_VAL_20_u2 655.35 _CNV_A_R_LINEAR_____27_CM 0. 655.35 FORMAT "%5.2" /end CHARACTERISTIC
/begin MEASUREMENT LV_ZDLY_DIAG_MIS "Zero delay misfire monitoring phase" UBYTE _CNV_S_2_RANGE______11_CM 1 100. 0. 1. ECU_ADDRESS 0x3fdd15 /end MEASUREMENT
/begin MEASUREMENT LV_PUC_DET_MIS "Fuel Cut-Off dedicated to misfire detection, including a delay time for fuel reactivation" UBYTE _CNV_S_2_RANGE______11_CM 1 100. 0. 1. ECU_ADDRESS 0x3fdd16 /end MEASUREMENT
/begin CHARACTERISTIC C_LOAD_MIS_FTP "FTP cycle engine load threshold" VALUE 0x41642 _REC_VAL_20_u2 99.99694824000001 _CNV_A_R_LINEAR_____172_CM 0. 99.99694824 /end CHARACTERISTIC
/begin CHARACTERISTIC C_N_MIS_FTP "FTP cycle engine speed threshold" VALUE 0x41668 _REC_VAL_20_u2 8160. _CNV_A_R_LINEAR_____17_CM 0. 8160. FORMAT "%4.0" /end CHARACTERISTIC
/begin CHARACTERISTIC C_MIS_A_IND_THD "Cylinder individual threshold used for cylinder shut-off during CARB A criteria window" VALUE 0x4164c _REC_VAL_20_u2 65535. _CNV_A_R_LINEAR_____10_CM 0. 65535. FORMAT "%5.0" /end CHARACTERISTIC
/begin CHARACTERISTIC C_CTR_FTP_CDN_MIS_A "TDC counter threshold for FTP cycle definition" VALUE 0x4163c _REC_VAL_20_u2 65535. _CNV_A_R_LINEAR_____10_CM 0. 65535. FORMAT "%5.0" /end CHARACTERISTIC
/begin CHARACTERISTIC C_MIS_A_MIN_NR "Cylinder identification ratio for CARB A criteria detection" VALUE 0x4161b _REC_VAL_20_u1 99.609375 _CNV_A_R_LINEAR_____4_CM 0. 99.609375 FORMAT "%4.1" /end CHARACTERISTIC
/begin CHARACTERISTIC C_MIS_SUM_A_THD "Cylinder global threshold for misfire status CARB A detection" VALUE 0x41650 _REC_VAL_20_u2 65535. _CNV_A_R_LINEAR_____10_CM 0. 65535. FORMAT "%5.0" /end CHARACTERISTIC
/begin CHARACTERISTIC C_MIS_SUM_A_CBK_THD "Cylinder bank threshold for misfire status CARB A detection" VALUE 0x4164e _REC_VAL_20_u2 65535. _CNV_A_R_LINEAR_____10_CM 0. 65535. FORMAT "%5.0" /end CHARACTERISTIC
/begin CHARACTERISTIC C_MIS_MAX_NR_OFF_IV "Maximum number of allowed cylinder to be shut-off after detection of the misfire status CARB A." VALUE 0x4161e _REC_VAL_20_u1 4. _CNV_A_R_LINEAR_____547_CM 0. 4. FORMAT "%2.0" /end CHARACTERISTIC
/begin CHARACTERISTIC C_MIS_MIN_NR_PUC "Minimum number of trailing throttle fuel cut-off phases LV_PUC before cancelling cylinder(s) shut-off. " VALUE 0x4161f _REC_VAL_20_u1 254. _CNV_A_R_LINEAR_____10_CM 1. 255. FORMAT "%3.0" /end CHARACTERISTIC
/begin CHARACTERISTIC C_T_MIS_MIN_PUC "Minimum duration of trailing throttle fuel cut-off phase to be validated like this." VALUE 0x4166e _REC_VAL_20_u2 99.90000000000001 _CNV_A_R_LINEAR_____14_CM 0.1 100. FORMAT "%5.1" /end CHARACTERISTIC
/begin CHARACTERISTIC C_NR_ERR_DET_MAX_MIS_B4 "Maximum value of CTR_ERR_DET_MIS_B4 for misfire CARB B4 status detection (typical: 4)" VALUE 0x41624 _REC_VAL_20_u1 255. _CNV_A_R_LINEAR_____10_CM 0. 255. FORMAT "%3.0" /end CHARACTERISTIC
/begin CHARACTERISTIC C_MIS_SUM_B1_THD_MT "Global threshold for CARB B1 misfire criteria detection, LV_AT = 0" VALUE 0x41656 _REC_VAL_20_u2 65535. _CNV_A_R_LINEAR_____10_CM 0. 65535. FORMAT "%5.0" /end CHARACTERISTIC
/begin CHARACTERISTIC C_MIS_SUM_B1_THD_AT "Global threshold for  CARB B1 misfire criteria detection, LV_AT = 1" VALUE 0x41654 _REC_VAL_20_u2 65535. _CNV_A_R_LINEAR_____10_CM 0. 65535. FORMAT "%5.0" /end CHARACTERISTIC
/begin CHARACTERISTIC C_MIS_SUM_B4_THD_MT "Global threshold for CARB B4 misfire criteria detection, LV_AT = 0" VALUE 0x4165c _REC_VAL_20_u2 65535. _CNV_A_R_LINEAR_____10_CM 0. 65535. FORMAT "%5.0" /end CHARACTERISTIC
/begin CHARACTERISTIC C_MIS_SUM_B4_THD_AT "Global hreshold for CARB B4 misfire criteria detection, LV_AT = 1" VALUE 0x4165a _REC_VAL_20_u2 65535. _CNV_A_R_LINEAR_____10_CM 0. 65535. FORMAT "%5.0" /end CHARACTERISTIC
/begin CHARACTERISTIC C_MIS_B1_MIN_NR "Cylinder indentification ratio for CARB B1 criteria detection" VALUE 0x4161c _REC_VAL_20_u1 99.609375 _CNV_A_R_LINEAR_____4_CM 0. 99.609375 FORMAT "%4.1" /end CHARACTERISTIC
/begin CHARACTERISTIC C_MIS_B4_MIN_NR "Cylinder indentification ratio for CARB B4 criteria detection" VALUE 0x4161d _REC_VAL_20_u1 99.609375 _CNV_A_R_LINEAR_____4_CM 0. 99.609375 FORMAT "%4.1" /end CHARACTERISTIC
/begin CHARACTERISTIC C_MIS_SUM_B1_CBK_THD "Cylinder bank threshold for CARB B1 misfire criteria detection" VALUE 0x41652 _REC_VAL_20_u2 65535. _CNV_A_R_LINEAR_____10_CM 0. 65535. FORMAT "%5.0" /end CHARACTERISTIC
/begin CHARACTERISTIC C_MIS_SUM_B4_CBK_THD "Cylinder bank threshold for CARB B4 misfire criteria detection" VALUE 0x41658 _REC_VAL_20_u2 65535. _CNV_A_R_LINEAR_____10_CM 0. 65535. FORMAT "%5.0" /end CHARACTERISTIC
/begin MEASUREMENT LV_ERR_DET_MIS_A "CARB A misfire criteria detected in actual 200 rev. window (not debounced)" UBYTE _CNV_S_2_RANGE______11_CM 1 100. 0. 1. ECU_ADDRESS 0x3fcc13 /end MEASUREMENT
/begin MEASUREMENT LV_FTP_MIS_A "Boolean for FTP emission cycle condition status CARB A" UBYTE _CNV_S_2_RANGE______11_CM 1 100. 0. 1. ECU_ADDRESS 0x3fdd28 /end MEASUREMENT
/begin MEASUREMENT LV_END_DIAG_WIN_MIS_A "CARB A misfire criteria diagnosis end for similar condition window" UBYTE _CNV_S_2_RANGE______11_CM 1 100. 0. 1. ECU_ADDRESS 0x3fcc15 /end MEASUREMENT
/begin MEASUREMENT LV_ERR_DET_MIS_B4 "CARB B4 misfire criteria detected in actual 1000 rev. window, (not debounced)" UBYTE _CNV_S_2_RANGE______11_CM 1 100. 0. 1. ECU_ADDRESS 0x3fcc14 /end MEASUREMENT
/begin MEASUREMENT LV_END_DIAG_WIN_MIS_B1 "CARB B1 misfire criteria diagnosis end for similar condition window" UBYTE _CNV_S_2_RANGE______11_CM 1 100. 0. 1. ECU_ADDRESS 0x3fcc16 /end MEASUREMENT
/begin MEASUREMENT LV_END_DIAG_WIN_MIS_B4 "CARB B4 misfire criteria diagnosis end for similar condition window" UBYTE _CNV_S_2_RANGE______11_CM 1 100. 0. 1. ECU_ADDRESS 0x3fcc17 /end MEASUREMENT
/begin MEASUREMENT INH_IV_MIS "Idendification of cylinders shut off by misfire Carb A" UWORD _CNV_A_R_LINEAR_____10_CM 1 100. 0. 4095. ECU_ADDRESS 0x3fcc00 FORMAT "%5.0" /end MEASUREMENT
/begin MEASUREMENT MIS_NR_TDC_A "TDC counter CARB A window (200 crankshaft revolutions)." UWORD _CNV_A_R_LINEAR_____10_CM 1 100. 0. 65535. ECU_ADDRESS 0x3fdd18 FORMAT "%5.0" /end MEASUREMENT
/begin MEASUREMENT MIS_SUM_A "CARB A misfire sum (global)" UWORD _CNV_A_R_LINEAR_____10_CM 1 100. 0. 65535. ECU_ADDRESS 0x3fdd1c FORMAT "%5.0" /end MEASUREMENT
/begin MEASUREMENT MIS_SUM_A_CBK_1 "CARB A misfire sum (dedicated to cylinder bank)" UWORD _CNV_A_R_LINEAR_____10_CM 1 100. 0. 65535. ECU_ADDRESS 0x3fcc02 FORMAT "%5.0" /end MEASUREMENT
/begin MEASUREMENT MIS_SUM_A_CBK_2 "CARB A misfire sum (dedicated to cylinder bank)" UWORD _CNV_A_R_LINEAR_____10_CM 1 100. 0. 65535. ECU_ADDRESS 0x3fcc04 FORMAT "%5.0" /end MEASUREMENT
/begin MEASUREMENT CTR_CHK_MIS_A "CARB A diagnosis occurence counter" UBYTE _CNV_A_R_LINEAR_____10_CM 1 100. 0. 255. ECU_ADDRESS 0x3fdd24 FORMAT "%3.0" /end MEASUREMENT
/begin MEASUREMENT CTR_FTP_CDN_MIS_A "TDC counter for FTP condition detection" UWORD _CNV_A_R_LINEAR_____10_CM 1 100. 0. 65535. ECU_ADDRESS 0x3fdd20 FORMAT "%5.0" /end MEASUREMENT
/begin MEASUREMENT CTR_ERR_DET_MIS_A "CARB A misfire criteria detected counter" UBYTE _CNV_A_R_LINEAR_____10_CM 1 100. 0. 255. ECU_ADDRESS 0x3fcc10 FORMAT "%3.0" /end MEASUREMENT
/begin MEASUREMENT MIS_CTR_A_0 "Misfire sums (cylinder individual) after combination and weighting in CARB A window." UWORD _CNV_A_R_LINEAR_____10_CM 1 100. 0. 65535. ECU_ADDRESS 0x3fcbe8 FORMAT "%5.0" /end MEASUREMENT
/begin MEASUREMENT MIS_CTR_A_1 "Misfire sums (cylinder individual) after combination and weighting in CARB A window." UWORD _CNV_A_R_LINEAR_____10_CM 1 100. 0. 65535. ECU_ADDRESS 0x3fcbea FORMAT "%5.0" /end MEASUREMENT
/begin MEASUREMENT MIS_CTR_A_2 "Misfire sums (cylinder individual) after combination and weighting in CARB A window." UWORD _CNV_A_R_LINEAR_____10_CM 1 100. 0. 65535. ECU_ADDRESS 0x3fcbec FORMAT "%5.0" /end MEASUREMENT
/begin MEASUREMENT MIS_CTR_A_3 "Misfire sums (cylinder individual) after combination and weighting in CARB A window." UWORD _CNV_A_R_LINEAR_____10_CM 1 100. 0. 65535. ECU_ADDRESS 0x3fcbee FORMAT "%5.0" /end MEASUREMENT
/begin MEASUREMENT MIS_CTR_A_4 "Misfire sums (cylinder individual) after combination and weighting in CARB A window." UWORD _CNV_A_R_LINEAR_____10_CM 1 100. 0. 65535. ECU_ADDRESS 0x3fcbf0 FORMAT "%5.0" /end MEASUREMENT
/begin MEASUREMENT MIS_CTR_A_5 "Misfire sums (cylinder individual) after combination and weighting in CARB A window." UWORD _CNV_A_R_LINEAR_____10_CM 1 100. 0. 65535. ECU_ADDRESS 0x3fcbf2 FORMAT "%5.0" /end MEASUREMENT
/begin MEASUREMENT MIS_CTR_B_0 "Misfire sums (cylinder individual) after combination and weighting in CARB B window." UWORD _CNV_A_R_LINEAR_____10_CM 1 100. 0. 65535. ECU_ADDRESS 0x3fcbf4 FORMAT "%5.0" /end MEASUREMENT
/begin MEASUREMENT MIS_CTR_B_1 "Misfire sums (cylinder individual) after combination and weighting in CARB B window." UWORD _CNV_A_R_LINEAR_____10_CM 1 100. 0. 65535. ECU_ADDRESS 0x3fcbf6 FORMAT "%5.0" /end MEASUREMENT
/begin MEASUREMENT MIS_CTR_B_2 "Misfire sums (cylinder individual) after combination and weighting in CARB B window." UWORD _CNV_A_R_LINEAR_____10_CM 1 100. 0. 65535. ECU_ADDRESS 0x3fcbf8 FORMAT "%5.0" /end MEASUREMENT
/begin MEASUREMENT MIS_CTR_B_3 "Misfire sums (cylinder individual) after combination and weighting in CARB B window." UWORD _CNV_A_R_LINEAR_____10_CM 1 100. 0. 65535. ECU_ADDRESS 0x3fcbfa FORMAT "%5.0" /end MEASUREMENT
/begin MEASUREMENT MIS_CTR_B_4 "Misfire sums (cylinder individual) after combination and weighting in CARB B window." UWORD _CNV_A_R_LINEAR_____10_CM 1 100. 0. 65535. ECU_ADDRESS 0x3fcbfc FORMAT "%5.0" /end MEASUREMENT
/begin MEASUREMENT MIS_CTR_B_5 "Misfire sums (cylinder individual) after combination and weighting in CARB B window." UWORD _CNV_A_R_LINEAR_____10_CM 1 100. 0. 65535. ECU_ADDRESS 0x3fcbfe FORMAT "%5.0" /end MEASUREMENT
/begin MEASUREMENT MIS_NR_TDC_B "TDC counter CARB B window (1000 crankshaft revolutions)." UWORD _CNV_A_R_LINEAR_____10_CM 1 100. 0. 65535. ECU_ADDRESS 0x3fdd1a FORMAT "%5.0" /end MEASUREMENT
/begin MEASUREMENT MIS_SUM_B "CARB B misfire sum (global)" UWORD _CNV_A_R_LINEAR_____10_CM 1 100. 0. 65535. ECU_ADDRESS 0x3fdd1e FORMAT "%5.0" /end MEASUREMENT
/begin MEASUREMENT MIS_SUM_B_CBK_1 "CARB B misfire sum (cylinder bank dedicated)" UWORD _CNV_A_R_LINEAR_____10_CM 1 100. 0. 65535. ECU_ADDRESS 0x3fcc06 FORMAT "%5.0" /end MEASUREMENT
/begin MEASUREMENT MIS_SUM_B_CBK_2 "CARB B misfire sum (cylinder bank dedicated)" UWORD _CNV_A_R_LINEAR_____10_CM 1 100. 0. 65535. ECU_ADDRESS 0x3fcc08 FORMAT "%5.0" /end MEASUREMENT
/begin MEASUREMENT CTR_CHK_MIS_B4 "CARB B4 diagnosis occurence counter" UBYTE _CNV_A_R_LINEAR_____10_CM 1 100. 0. 255. ECU_ADDRESS 0x3fdd25 FORMAT "%3.0" /end MEASUREMENT
/begin MEASUREMENT CTR_ERR_DET_MIS_B4 "CARB B4 misfire criteria detected counter" UBYTE _CNV_A_R_LINEAR_____10_CM 1 100. 0. 255. ECU_ADDRESS 0x3fcc11 FORMAT "%3.0" /end MEASUREMENT
/begin MEASUREMENT SYM_CYL_MIS_A "CARB A misfire criteria symptoms" UWORD _CNV_A_R_LINEAR_____10_CM 1 100. 0. 65535. ECU_ADDRESS 0x3fcc0a FORMAT "%5.0" /end MEASUREMENT
/begin MEASUREMENT SYM_CYL_MIS_B1 "CARB B1 misfire criteria symptoms" UWORD _CNV_A_R_LINEAR_____10_CM 1 100. 0. 65535. ECU_ADDRESS 0x3fcc0c FORMAT "%5.0" /end MEASUREMENT
/begin MEASUREMENT SYM_CYL_MIS_B4 "CARB B4 misfire criteria symptoms" UWORD _CNV_A_R_LINEAR_____10_CM 1 100. 0. 65535. ECU_ADDRESS 0x3fcc0e FORMAT "%5.0" /end MEASUREMENT
/begin CHARACTERISTIC LC_MIS_INH "Global switch to disable all misfire monitoring related modules" VALUE 0x41636 _REC_VAL_20_u1 1. _CNV_S_2_RANGE______11_CM 0. 1. /end CHARACTERISTIC
/begin CHARACTERISTIC LC_CONF_RND_DET_MIS_B "Configuration for random cylinder detection when no specific cylinder counter  > C_MIS_B1_MIN_NR * MIS_SUM_B or > C_MIS_B4_MIN_NR * MIS_SUM_B" VALUE 0x41631 _REC_VAL_20_u1 1. _CNV_S_2_RANGE______11_CM 0. 1. /end CHARACTERISTIC
/begin CHARACTERISTIC LC_CONF_INH_IV_MIS "Cylinder switch back on configuration mode : switch back on at the end of driving cycle  (=0) or after a defined number of fuel cut-off phases (=1)" VALUE 0x4162b _REC_VAL_20_u1 1. _CNV_S_2_RANGE______11_CM 0. 1. /end CHARACTERISTIC
/begin MEASUREMENT CTR_ABC_MIS_A "" UBYTE _CNV_A_R_LINEAR_____10_CM 1 100. 0. 255. ECU_ADDRESS 0x3fd532 FORMAT "%3.0" /end MEASUREMENT
/begin MEASUREMENT LV_CDN_DIAG_MIS_A "" UBYTE _CNV_S_2_RANGE______21_R_CM 1 100. 0. 255. ECU_ADDRESS 0x3fd530 BIT_MASK 0x10 /end MEASUREMENT
/begin MEASUREMENT LV_END_DIAG_MIS_A "" UBYTE _CNV_S_2_RANGE______21_R_CM 1 100. 0. 255. ECU_ADDRESS 0x3fd530 BIT_MASK 0x20 /end MEASUREMENT
/begin MEASUREMENT LV_READY_MIS_A "" UBYTE _CNV_S_2_RANGE______21_R_CM 1 100. 0. 255. ECU_ADDRESS 0x3fd530 BIT_MASK 0x40 /end MEASUREMENT
/begin MEASUREMENT LV_ERR_MEM_MIS_A "" UBYTE _CNV_S_2_RANGE______21_R_CM 1 100. 0. 255. ECU_ADDRESS 0x3fd530 BIT_MASK 0x80 /end MEASUREMENT
/begin MEASUREMENT CTR_ABC_END_DIAG_MIS_A "" UBYTE _CNV_A_R_LINEAR_____12_CM 1 100. 0. 255. ECU_ADDRESS 0x3fd531 FORMAT "%3.0" /end MEASUREMENT
/begin MEASUREMENT CTR_ABC_MIS_B1 "" UBYTE _CNV_A_R_LINEAR_____10_CM 1 100. 0. 255. ECU_ADDRESS 0x3fd536 FORMAT "%3.0" /end MEASUREMENT
/begin MEASUREMENT LV_CDN_DIAG_MIS_B1 "" UBYTE _CNV_S_2_RANGE______21_R_CM 1 100. 0. 255. ECU_ADDRESS 0x3fd534 BIT_MASK 0x10 /end MEASUREMENT
/begin MEASUREMENT LV_END_DIAG_MIS_B1 "" UBYTE _CNV_S_2_RANGE______21_R_CM 1 100. 0. 255. ECU_ADDRESS 0x3fd534 BIT_MASK 0x20 /end MEASUREMENT
/begin MEASUREMENT LV_READY_MIS_B1 "" UBYTE _CNV_S_2_RANGE______21_R_CM 1 100. 0. 255. ECU_ADDRESS 0x3fd534 BIT_MASK 0x40 /end MEASUREMENT
/begin MEASUREMENT LV_ERR_MEM_MIS_B1 "" UBYTE _CNV_S_2_RANGE______21_R_CM 1 100. 0. 255. ECU_ADDRESS 0x3fd534 BIT_MASK 0x80 /end MEASUREMENT
/begin MEASUREMENT CTR_ABC_END_DIAG_MIS_B1 "" UBYTE _CNV_A_R_LINEAR_____12_CM 1 100. 0. 255. ECU_ADDRESS 0x3fd535 FORMAT "%3.0" /end MEASUREMENT
/begin MEASUREMENT CTR_ABC_MIS_B4 "" UBYTE _CNV_A_R_LINEAR_____10_CM 1 100. 0. 255. ECU_ADDRESS 0x3fd53a FORMAT "%3.0" /end MEASUREMENT
/begin MEASUREMENT LV_CDN_DIAG_MIS_B4 "" UBYTE _CNV_S_2_RANGE______21_R_CM 1 100. 0. 255. ECU_ADDRESS 0x3fd538 BIT_MASK 0x10 /end MEASUREMENT
/begin MEASUREMENT LV_END_DIAG_MIS_B4 "" UBYTE _CNV_S_2_RANGE______21_R_CM 1 100. 0. 255. ECU_ADDRESS 0x3fd538 BIT_MASK 0x20 /end MEASUREMENT
/begin MEASUREMENT LV_READY_MIS_B4 "" UBYTE _CNV_S_2_RANGE______21_R_CM 1 100. 0. 255. ECU_ADDRESS 0x3fd538 BIT_MASK 0x40 /end MEASUREMENT
/begin MEASUREMENT LV_ERR_MEM_MIS_B4 "" UBYTE _CNV_S_2_RANGE______21_R_CM 1 100. 0. 255. ECU_ADDRESS 0x3fd538 BIT_MASK 0x80 /end MEASUREMENT
/begin MEASUREMENT CTR_ABC_END_DIAG_MIS_B4 "" UBYTE _CNV_A_R_LINEAR_____12_CM 1 100. 0. 255. ECU_ADDRESS 0x3fd539 FORMAT "%3.0" /end MEASUREMENT
/begin MEASUREMENT LV_ERR_MIS_A "CARB A misfire criteria confirmed (debounced)" UBYTE _CNV_S_2_RANGE______11_CM 1 100. 0. 1. ECU_ADDRESS 0x3fd533 /end MEASUREMENT
/begin MEASUREMENT LV_ERR_MIS_B1 "CARB B1 misfire criteria confirmed" UBYTE _CNV_S_2_RANGE______11_CM 1 100. 0. 1. ECU_ADDRESS 0x3fd537 /end MEASUREMENT
/begin MEASUREMENT LV_ERR_MIS_B4 "CARB B4 misfire criteria confirmed (debounced)" UBYTE _CNV_S_2_RANGE______11_CM 1 100. 0. 1. ECU_ADDRESS 0x3fd53b /end MEASUREMENT
/begin CHARACTERISTIC C_NR_ERR_DET_MAX_MIS_A "Maximum value of CTR_ERR_DET_MIS_A for misfire CARB A status detection (typical: 3)" VALUE 0x41623 _REC_VAL_20_u1 255. _CNV_A_R_LINEAR_____10_CM 0. 255. FORMAT "%3.0" /end CHARACTERISTIC
/begin CHARACTERISTIC LC_CONF_RND_DET_MIS_A "Configuration for random cylinder detection when no specific cylinder counter  > C_MIS_A_MIN_NR * MIS_SUM_A : cylinder with the highest MIS_CTR_A value is updated in SYM_CYL_MIS_A (=0) or RND bit is set to 1 in SYM_CYL_MIS_A (=1)" VALUE 0x41630 _REC_VAL_20_u1 1. _CNV_S_2_RANGE______11_CM 0. 1. /end CHARACTERISTIC
/begin CHARACTERISTIC LC_CONF_MIS_A_LIH "Configuration to select MIL mode in case of cylinder shut-off(=0, LV_ERR_MIS_A=0, MIL is not set by cylinder shut-off function), (=1, LV_ERR_MIS_A=1, MIL is ON until end of cylinder shut-off, see mode chosen with LC_CONF_INH_IV_MIS)" VALUE 0x4162d _REC_VAL_20_u1 1. _CNV_S_2_RANGE______11_CM 0. 1. /end CHARACTERISTIC
/begin CHARACTERISTIC C_NR_CYL_MPL_MIS_A "Number of cylinder in MIS_A to set the multiple misfire CARB A status (typical: 2)" VALUE 0x41621 _REC_VAL_20_u1 255. _CNV_A_R_LINEAR_____10_CM 0. 255. FORMAT "%3.0" /end CHARACTERISTIC
/begin CHARACTERISTIC C_NR_CYL_MPL_MIS_B "Number of cylinder in MIS_Bx to set the multiple misfire CARB Bx status (typical: 2)" VALUE 0x41622 _REC_VAL_20_u1 255. _CNV_A_R_LINEAR_____10_CM 0. 255. FORMAT "%3.0" /end CHARACTERISTIC
/begin CHARACTERISTIC LC_CONF_MPL_DET_MIS_A "Configuration for multiple cylinder status set in SYM_CYL_MIS_A (multiple misfire pattern Pcode saved) (=1)" VALUE 0x4162e _REC_VAL_20_u1 1. _CNV_S_2_RANGE______11_CM 0. 1. /end CHARACTERISTIC
/begin CHARACTERISTIC LC_CONF_MPL_DET_MIS_B "Configuration for multiple cylinder status set in SYM_CYL_MIS_Bx (multiple misfire pattern Pcode saved) (=1)" VALUE 0x4162f _REC_VAL_20_u1 1. _CNV_S_2_RANGE______11_CM 0. 1. /end CHARACTERISTIC
/begin MEASUREMENT SUM_FAC_DIAG_MIS "Sum of the weighting factor from diagnosis combinations for final misfire decision" UWORD _CNV_A_R_LINEAR_____548_CM 1 100. 0. 6. ECU_ADDRESS 0x3fdcea FORMAT "%6.4" /end MEASUREMENT
/begin MEASUREMENT FAC_IGC_DIAG_MIS "Reliability weighting factor for ignition diagnosis (ignition failure detected)" UBYTE _CNV_A_R_LINEAR_____549_CM 1 100. 0. 2. ECU_ADDRESS 0x3fdcf4 FORMAT "%6.4" /end MEASUREMENT
/begin MEASUREMENT FAC_ER_DIAG_MIS "Reliability weighting factor for detection based on misfire detection index (ER)" UBYTE _CNV_A_R_LINEAR_____549_CM 1 100. 0. 2. ECU_ADDRESS 0x3fdcf3 FORMAT "%6.4" /end MEASUREMENT
/begin MEASUREMENT FAC_IV_DIAG_MIS "Reliability weighting factor for injection valve (injection valve failure detected)" UBYTE _CNV_A_R_LINEAR_____549_CM 1 100. 0. 2. ECU_ADDRESS 0x3fdcf5 FORMAT "%6.4" /end MEASUREMENT
/begin MEASUREMENT LV_ERR_DET_MIS "Flag for individual misfire detection after crossed diagnosis" UBYTE _CNV_S_2_RANGE______11_CM 1 100. 0. 1. ECU_ADDRESS 0x3fcbd9 /end MEASUREMENT
/begin MEASUREMENT LV_MIS_STATE_B "Project specific name for misfire carb B detected, debounced" UBYTE _CNV_S_2_RANGE______11_CM 1 100. 0. 1. ECU_ADDRESS 0x3fcbdb /end MEASUREMENT
/begin MEASUREMENT LV_FTL_L_DIAG_MIS "Specific request to allow FTL_L symptom storing (misfire detection with low fuel tank level)" UBYTE _CNV_S_2_RANGE______11_CM 1 100. 0. 1. ECU_ADDRESS 0x3fcbdc /end MEASUREMENT
/begin MEASUREMENT LV_ERR_RR_MIS "Specific request to allow ERR_RR symptom storing (misfire detection with rough road detection in failure)" UBYTE _CNV_S_2_RANGE______11_CM 1 100. 0. 1. ECU_ADDRESS 0x3fcbdd /end MEASUREMENT
/begin MEASUREMENT LV_MIS_STATE_A "Project specific name for misfire carb A detected, debounced" UBYTE _CNV_S_2_RANGE______11_CM 1 100. 0. 1. ECU_ADDRESS 0x3fcbda /end MEASUREMENT
/begin MEASUREMENT LV_REQ_APP_CTR_MIS_A "Specific request to allow out of FTP counting mode even if we are within FTP area" UBYTE _CNV_S_2_RANGE______11_CM 1 100. 0. 1. ECU_ADDRESS 0x3fcbde /end MEASUREMENT
/begin AXIS_PTS ldp_n_32__fac_er_afl_diag_mis "" 0x418f2 LDP_N_32__FAC_ER_AFL_DIAG_MIS _REC_AXS_20_u1 8160. _CNV_A_R_LINEAR_____5_CM 6 0. 8160. FORMAT "%4.0" /end AXIS_PTS
/begin AXIS_PTS ldp_n_32__fac_er_s_diag_mis "" 0x41900 LDP_N_32__FAC_ER_S_DIAG_MIS _REC_AXS_20_u1 8160. _CNV_A_R_LINEAR_____5_CM 6 0. 8160. FORMAT "%4.0" /end AXIS_PTS
/begin AXIS_PTS ldp_n_32__fac_igc_diag_mis "" 0x41907 LDP_N_32__FAC_IGC_DIAG_MIS _REC_AXS_20_u1 8160. _CNV_A_R_LINEAR_____5_CM 6 0. 8160. FORMAT "%4.0" /end AXIS_PTS
/begin AXIS_PTS ldp_n_32__fac_er_afs_diag_mis "" 0x418f9 LDP_N_32__FAC_ER_AFS_DIAG_MIS _REC_AXS_20_u1 8160. _CNV_A_R_LINEAR_____5_CM 6 0. 8160. FORMAT "%4.0" /end AXIS_PTS
/begin AXIS_PTS ldp_n_32__fac_iv_diag_mis "" 0x4190e LDP_N_32__FAC_IV_DIAG_MIS _REC_AXS_20_u1 8160. _CNV_A_R_LINEAR_____5_CM 6 0. 8160. FORMAT "%4.0" /end AXIS_PTS
/begin AXIS_PTS ldp_load_mis__fac_er_s_diag_mis "" 0x416c0 LDP_LOAD_MIS__FAC_ER_S_DIAG_MIS _REC_AXS_20_u2 99.99694824000001 _CNV_A_R_LINEAR_____172_CM 6 0. 99.99694824 /end AXIS_PTS
/begin AXIS_PTS ldp_load_mis__fac_igc_diag_mis "" 0x416ce LDP_LOAD_MIS__FAC_IGC_DIAG_MIS _REC_AXS_20_u2 99.99694824000001 _CNV_A_R_LINEAR_____172_CM 6 0. 99.99694824 /end AXIS_PTS
/begin CHARACTERISTIC IP_FAC_ER_AFL_DIAG_MIS "Weighting factor for irregular engine operation (engine speed analysis)" MAP 0x41f20 _REC_MAP_20_u1_u1_u2 2. _CNV_A_R_LINEAR_____549_CM 0. 2. FORMAT "%6.4"
 /begin AXIS_DESCR COM_AXIS N_32 _CNV_A_R_LINEAR_____5_CM 6 0. 8160. FORMAT "%4.0" AXIS_PTS_REF ldp_n_32__fac_er_afl_diag_mis /end AXIS_DESCR
 /begin AXIS_DESCR COM_AXIS LOAD_MIS _CNV_A_R_LINEAR_____172_CM 6 0. 99.99694824 AXIS_PTS_REF ldp_load_mis__fac_er_afl_diag /end AXIS_DESCR
/end CHARACTERISTIC
/begin CHARACTERISTIC IP_FAC_ER_S_DIAG_MIS "Weighting factor for irregular engine operation (engine speed analysis)" MAP 0x41f68 _REC_MAP_20_u1_u1_u2 2. _CNV_A_R_LINEAR_____549_CM 0. 2. FORMAT "%6.4"
 /begin AXIS_DESCR COM_AXIS N_32 _CNV_A_R_LINEAR_____5_CM 6 0. 8160. FORMAT "%4.0" AXIS_PTS_REF ldp_n_32__fac_er_s_diag_mis /end AXIS_DESCR
 /begin AXIS_DESCR COM_AXIS LOAD_MIS _CNV_A_R_LINEAR_____172_CM 6 0. 99.99694824 AXIS_PTS_REF ldp_load_mis__fac_er_s_diag_mis /end AXIS_DESCR
/end CHARACTERISTIC
/begin CHARACTERISTIC IP_FAC_ER_AFS_DIAG_MIS "Weighting factor for irregular engine operation (engine speed analysis)" MAP 0x41f44 _REC_MAP_20_u1_u1_u2 2. _CNV_A_R_LINEAR_____549_CM 0. 2. FORMAT "%6.4"
 /begin AXIS_DESCR COM_AXIS N_32 _CNV_A_R_LINEAR_____5_CM 6 0. 8160. FORMAT "%4.0" AXIS_PTS_REF ldp_n_32__fac_er_afs_diag_mis /end AXIS_DESCR
 /begin AXIS_DESCR COM_AXIS LOAD_MIS _CNV_A_R_LINEAR_____172_CM 6 0. 99.99694824 AXIS_PTS_REF ldp_load_mis__fac_er_afs_diag /end AXIS_DESCR
/end CHARACTERISTIC
/begin CHARACTERISTIC IP_FAC_IGC_DIAG_MIS "Weighting factor for ignition diagnosis (ignition failure detected)" MAP 0x41f8c _REC_MAP_20_u1_u1_u2 2. _CNV_A_R_LINEAR_____549_CM 0. 2. FORMAT "%6.4"
 /begin AXIS_DESCR COM_AXIS N_32 _CNV_A_R_LINEAR_____5_CM 6 0. 8160. FORMAT "%4.0" AXIS_PTS_REF ldp_n_32__fac_igc_diag_mis /end AXIS_DESCR
 /begin AXIS_DESCR COM_AXIS LOAD_MIS _CNV_A_R_LINEAR_____172_CM 6 0. 99.99694824 AXIS_PTS_REF ldp_load_mis__fac_igc_diag_mis /end AXIS_DESCR
/end CHARACTERISTIC
/begin CHARACTERISTIC IP_FAC_IV_DIAG_MIS "Weighting factor for injection valve diagnosis (injection valve failure detected)" MAP 0x41fb0 _REC_MAP_20_u1_u1_u2 2. _CNV_A_R_LINEAR_____549_CM 0. 2. FORMAT "%6.4"
 /begin AXIS_DESCR COM_AXIS N_32 _CNV_A_R_LINEAR_____5_CM 6 0. 8160. FORMAT "%4.0" AXIS_PTS_REF ldp_n_32__fac_iv_diag_mis /end AXIS_DESCR
 /begin AXIS_DESCR COM_AXIS LOAD_MIS _CNV_A_R_LINEAR_____172_CM 6 0. 99.99694824 AXIS_PTS_REF ldp_load_mis__fac_iv_diag_mis /end AXIS_DESCR
/end CHARACTERISTIC
/begin AXIS_PTS ldp_load_mis__fac_iv_diag_mis "" 0x416dc LDP_LOAD_MIS__FAC_IV_DIAG_MIS _REC_AXS_20_u2 99.99694824000001 _CNV_A_R_LINEAR_____172_CM 6 0. 99.99694824 /end AXIS_PTS
/begin AXIS_PTS ldp_load_mis_2__mis_a_fac_afl "" 0x4167a LDP_LOAD_MIS_2__MIS_A_FAC_AFL _REC_AXS_20_u2 99.99694824000001 _CNV_A_R_LINEAR_____172_CM 6 0. 99.99694824 /end AXIS_PTS
/begin AXIS_PTS ldp_load_mis_2__mis_a_fac_afs "" 0x41688 LDP_LOAD_MIS_2__MIS_A_FAC_AFS _REC_AXS_20_u2 99.99694824000001 _CNV_A_R_LINEAR_____172_CM 6 0. 99.99694824 /end AXIS_PTS
/begin AXIS_PTS ldp_load_mis_2__mis_a_fac_s "" 0x41696 LDP_LOAD_MIS_2__MIS_A_FAC_S _REC_AXS_20_u2 99.99694824000001 _CNV_A_R_LINEAR_____172_CM 6 0. 99.99694824 /end AXIS_PTS
/begin CHARACTERISTIC C_MIS_NR_OFF_IV_IGCFB "Threshold for number of cylinders shut off due to misfire" VALUE 0x41620 _REC_VAL_20_u1 6. _CNV_A_R_LINEAR_____10_CM 0. 6. FORMAT "%1.0" /end CHARACTERISTIC
/begin CHARACTERISTIC C_TEG_CAT_UP_MIS_A_MAX "TEG Threshold for misfire A counter management" VALUE 0x41672 _REC_VAL_20_u2 2047. _CNV_A_R_LINEAR_____211_CM 0. 2047. FORMAT "%7.2" /end CHARACTERISTIC
/begin CHARACTERISTIC LC_FTL_L_DIAG_MIS "Calibration to enable Low Fuel tank level symptom storing in misfire diagnosis symptom carriers" VALUE 0x41635 _REC_VAL_20_u1 1. _CNV_S_2_RANGE______11_CM 0. 1. /end CHARACTERISTIC
/begin CHARACTERISTIC LC_CTR_CONF_DIAG_MIS "Diagnosis TDC counting mode : counting all TDCs (=0) or only diagnosed TDC's (=1)" VALUE 0x41632 _REC_VAL_20_u1 1. _CNV_S_2_RANGE______11_CM 0. 1. /end CHARACTERISTIC
/begin CHARACTERISTIC LC_ERR_RR_MIS "Calibration to enable rough road detection failure symptom storing in misfire diagnosis symptom carriers" VALUE 0x41634 _REC_VAL_20_u1 1. _CNV_S_2_RANGE______11_CM 0. 1. /end CHARACTERISTIC
/begin CHARACTERISTIC IP_MIS_A_FAC_AFL "Catalyst damage weighting factor used for MIS_A counters increment (AFL combustion mode)" MAP 0x41fd8 _REC_MAP_20_u1_u2_u2 100. _CNV_A_R_LINEAR_____10_CM 0. 100. FORMAT "%3.0"
 /begin AXIS_DESCR COM_AXIS N _CNV_A_R_LINEAR_____17_CM 6 0. 8160. FORMAT "%4.0" AXIS_PTS_REF ldp_n__mis_a_fac_afl /end AXIS_DESCR
 /begin AXIS_DESCR COM_AXIS LOAD_MIS_2 _CNV_A_R_LINEAR_____172_CM 6 0. 99.99694824 AXIS_PTS_REF ldp_load_mis_2__mis_a_fac_afl /end AXIS_DESCR
/end CHARACTERISTIC
/begin CHARACTERISTIC IP_MIS_A_FAC_AFS "Catalyst damage weighting factor used for MIS_A counters increment (AFS combustion mode)" MAP 0x41ffc _REC_MAP_20_u1_u2_u2 100. _CNV_A_R_LINEAR_____10_CM 0. 100. FORMAT "%3.0"
 /begin AXIS_DESCR COM_AXIS N _CNV_A_R_LINEAR_____17_CM 6 0. 8160. FORMAT "%4.0" AXIS_PTS_REF ldp_n__mis_a_fac_afs /end AXIS_DESCR
 /begin AXIS_DESCR COM_AXIS LOAD_MIS_2 _CNV_A_R_LINEAR_____172_CM 6 0. 99.99694824 AXIS_PTS_REF ldp_load_mis_2__mis_a_fac_afs /end AXIS_DESCR
/end CHARACTERISTIC
/begin CHARACTERISTIC IP_MIS_A_FAC_S "Catalyst damage weighting factor used for MIS_A counters increment (Stratified combustion mode)" MAP 0x42020 _REC_MAP_20_u1_u2_u2 100. _CNV_A_R_LINEAR_____10_CM 0. 100. FORMAT "%3.0"
 /begin AXIS_DESCR COM_AXIS N _CNV_A_R_LINEAR_____17_CM 6 0. 8160. FORMAT "%4.0" AXIS_PTS_REF ldp_n__mis_a_fac_s /end AXIS_DESCR
 /begin AXIS_DESCR COM_AXIS LOAD_MIS_2 _CNV_A_R_LINEAR_____172_CM 6 0. 99.99694824 AXIS_PTS_REF ldp_load_mis_2__mis_a_fac_s /end AXIS_DESCR
/end CHARACTERISTIC
/begin AXIS_PTS ldp_n__mis_a_fac_afl "" 0x41864 LDP_N__MIS_A_FAC_AFL _REC_AXS_20_u2 8160. _CNV_A_R_LINEAR_____17_CM 6 0. 8160. FORMAT "%4.0" /end AXIS_PTS
/begin AXIS_PTS ldp_n__mis_a_fac_afs "" 0x41872 LDP_N__MIS_A_FAC_AFS _REC_AXS_20_u2 8160. _CNV_A_R_LINEAR_____17_CM 6 0. 8160. FORMAT "%4.0" /end AXIS_PTS
/begin AXIS_PTS ldp_n__mis_a_fac_s "" 0x41880 LDP_N__MIS_A_FAC_S _REC_AXS_20_u2 8160. _CNV_A_R_LINEAR_____17_CM 6 0. 8160. FORMAT "%4.0" /end AXIS_PTS
/begin AXIS_PTS ldp_load_mis__fac_er_afs_diag "" 0x416b2 LDP_LOAD_MIS__FAC_ER_AFS_DIAG _REC_AXS_20_u2 99.99694824000001 _CNV_A_R_LINEAR_____172_CM 6 0. 99.99694824 /end AXIS_PTS
/begin AXIS_PTS ldp_load_mis__fac_er_afl_diag "" 0x416a4 LDP_LOAD_MIS__FAC_ER_AFL_DIAG _REC_AXS_20_u2 99.99694824000001 _CNV_A_R_LINEAR_____172_CM 6 0. 99.99694824 /end AXIS_PTS
/begin MEASUREMENT MIS_A_FAC "Catalyst damage weighting factor to increment cylinder specific counters when misfire is detected" UBYTE _CNV_A_R_LINEAR_____10_CM 1 100. 0. 100. ECU_ADDRESS 0x3fcbd7 FORMAT "%3.0" /end MEASUREMENT
/begin MEASUREMENT MIS_A_FAC_BUF_0 "Catalyst damage weighting factor buffer" UBYTE _CNV_A_R_LINEAR_____10_CM 1 100. 0. 100. ECU_ADDRESS 0x3fdcec FORMAT "%3.0" /end MEASUREMENT
/begin MEASUREMENT MIS_A_FAC_BUF_1 "Catalyst damage weighting factor buffer" UBYTE _CNV_A_R_LINEAR_____10_CM 1 100. 0. 100. ECU_ADDRESS 0x3fdced FORMAT "%3.0" /end MEASUREMENT
/begin MEASUREMENT MIS_A_FAC_BUF_2 "Catalyst damage weighting factor buffer" UBYTE _CNV_A_R_LINEAR_____10_CM 1 100. 0. 100. ECU_ADDRESS 0x3fdcee FORMAT "%3.0" /end MEASUREMENT
/begin MEASUREMENT MIS_A_FAC_BUF_3 "Catalyst damage weighting factor buffer" UBYTE _CNV_A_R_LINEAR_____10_CM 1 100. 0. 100. ECU_ADDRESS 0x3fdcef FORMAT "%3.0" /end MEASUREMENT
/begin MEASUREMENT MIS_A_FAC_BUF_4 "Catalyst damage weighting factor buffer" UBYTE _CNV_A_R_LINEAR_____10_CM 1 100. 0. 100. ECU_ADDRESS 0x3fdcf0 FORMAT "%3.0" /end MEASUREMENT
/begin MEASUREMENT MIS_A_FAC_BUF_5 "Catalyst damage weighting factor buffer" UBYTE _CNV_A_R_LINEAR_____10_CM 1 100. 0. 100. ECU_ADDRESS 0x3fdcf1 FORMAT "%3.0" /end MEASUREMENT
/begin MEASUREMENT LV_TQI_MON_ACT_MON2 "" ULONG _CNV_S_2_RANGE______28_CM 1 100. 0. 1. ECU_ADDRESS 0x3fed8c BIT_MASK 0x10000 /end MEASUREMENT
/begin MEASUREMENT LV_N_LIM_ETC_MON2 "" ULONG _CNV_S_2_RANGE______28_CM 1 100. 0. 1. ECU_ADDRESS 0x3fed8c BIT_MASK 0x20000 /end MEASUREMENT
/begin MEASUREMENT LV_ERR_CONV_MON2 "" ULONG _CNV_S_2_RANGE______28_CM 1 100. 0. 1. ECU_ADDRESS 0x3fed8c BIT_MASK 0x40000 /end MEASUREMENT
/begin MEASUREMENT LV_ERR_N_32_MON2 "" ULONG _CNV_S_2_RANGE______28_CM 1 100. 0. 1. ECU_ADDRESS 0x3fed8c BIT_MASK 0x80000 /end MEASUREMENT
/begin MEASUREMENT LV_ERR_TQ_DIF_P_D_IS_MON2 "" ULONG _CNV_S_2_RANGE______28_CM 1 100. 0. 1. ECU_ADDRESS 0x3fed8c BIT_MASK 0x100000 /end MEASUREMENT
/begin MEASUREMENT LV_ERR_TQ_DIF_I_IS_MON2 "" ULONG _CNV_S_2_RANGE______28_CM 1 100. 0. 1. ECU_ADDRESS 0x3fed8c BIT_MASK 0x200000 /end MEASUREMENT
/begin MEASUREMENT LV_ERR_TQ_LOSS_MON2 "" ULONG _CNV_S_2_RANGE______28_CM 1 100. 0. 1. ECU_ADDRESS 0x3fed8c BIT_MASK 0x400000 /end MEASUREMENT
/begin MEASUREMENT LV_ERR_TQ_MIN_CLU_MON2 "" ULONG _CNV_S_2_RANGE______28_CM 1 100. 0. 1. ECU_ADDRESS 0x3fed8c BIT_MASK 0x800000 /end MEASUREMENT
/begin MEASUREMENT LV_ERR_TQ_MAX_CLU_MON2 "" ULONG _CNV_S_2_RANGE______28_CM 1 100. 0. 1. ECU_ADDRESS 0x3fed8c BIT_MASK 0x1000000 /end MEASUREMENT
/begin MEASUREMENT LV_ERR_PVS_MON2 "" ULONG _CNV_S_2_RANGE______28_CM 1 100. 0. 1. ECU_ADDRESS 0x3fed8c BIT_MASK 0x2000000 /end MEASUREMENT
/begin MEASUREMENT LV_ERR_TPS_MON2 "" ULONG _CNV_S_2_RANGE______28_CM 1 100. 0. 1. ECU_ADDRESS 0x3fed8c BIT_MASK 0x4000000 /end MEASUREMENT
/begin MEASUREMENT LV_ERR_MAF_MON2 "" ULONG _CNV_S_2_RANGE______28_CM 1 100. 0. 1. ECU_ADDRESS 0x3fed8c BIT_MASK 0x8000000 /end MEASUREMENT
/begin MEASUREMENT SF_1_MON2 "" UWORD _CNV_A_R_LINEAR_____10_CM 1 100. 0. 65535. ECU_ADDRESS 0x3fed8c FORMAT "%5.0" /end MEASUREMENT
/begin MEASUREMENT LV_ERR_TMP_MU_MON2 "" ULONG _CNV_S_2_RANGE______28_CM 1 100. 0. 1. ECU_ADDRESS 0x3fed90 BIT_MASK 0x400000 /end MEASUREMENT
/begin MEASUREMENT LV_ERR_TRAN_ENA_MON2 "" ULONG _CNV_S_2_RANGE______28_CM 1 100. 0. 1. ECU_ADDRESS 0x3fed90 BIT_MASK 0x800000 /end MEASUREMENT
/begin MEASUREMENT LV_N_LIM_REQ_MON2 "" ULONG _CNV_S_2_RANGE______28_CM 1 100. 0. 1. ECU_ADDRESS 0x3fed90 BIT_MASK 0x4000000 /end MEASUREMENT
/begin MEASUREMENT LV_OFF_MTC_IV_MU_MON2 "" ULONG _CNV_S_2_RANGE______28_CM 1 100. 0. 1. ECU_ADDRESS 0x3fed90 BIT_MASK 0x8000000 /end MEASUREMENT
/begin MEASUREMENT LV_OFF_IV_MON2 "" ULONG _CNV_S_2_RANGE______28_CM 1 100. 0. 1. ECU_ADDRESS 0x3fed90 BIT_MASK 0x10000000 /end MEASUREMENT
/begin MEASUREMENT LV_OFF_MTC_MON2 "" ULONG _CNV_S_2_RANGE______28_CM 1 100. 0. 1. ECU_ADDRESS 0x3fed90 BIT_MASK 0x20000000 /end MEASUREMENT
/begin MEASUREMENT LV_ERR_TQI_AV_MON2 "" ULONG _CNV_S_2_RANGE______28_CM 1 100. 0. 1. ECU_ADDRESS 0x3fed90 BIT_MASK 0x40000000 /end MEASUREMENT
/begin MEASUREMENT LV_ERR_TQI_N_MAX_MON2 "" ULONG _CNV_S_2_RANGE______28_CM 1 100. 0. 1. ECU_ADDRESS 0x3fed90 BIT_MASK 0x80000000 /end MEASUREMENT
/begin MEASUREMENT SF_2_MON2 "" UWORD _CNV_A_R_LINEAR_____10_CM 1 100. 0. 65535. ECU_ADDRESS 0x3fed90 FORMAT "%5.0" /end MEASUREMENT
/begin MEASUREMENT LV_PREV_STATE_IV0_MON2 "" ULONG _CNV_S_2_RANGE______28_CM 1 100. 0. 1. ECU_ADDRESS 0x3fed94 BIT_MASK 0x10000 /end MEASUREMENT
/begin MEASUREMENT LV_PREV_STATE_IV1_MON2 "" ULONG _CNV_S_2_RANGE______28_CM 1 100. 0. 1. ECU_ADDRESS 0x3fed94 BIT_MASK 0x20000 /end MEASUREMENT
/begin MEASUREMENT LV_PREV_STATE_IV2_MON2 "" ULONG _CNV_S_2_RANGE______28_CM 1 100. 0. 1. ECU_ADDRESS 0x3fed94 BIT_MASK 0x40000 /end MEASUREMENT
/begin MEASUREMENT LV_PREV_STATE_IV3_MON2 "" ULONG _CNV_S_2_RANGE______28_CM 1 100. 0. 1. ECU_ADDRESS 0x3fed94 BIT_MASK 0x80000 /end MEASUREMENT
/begin MEASUREMENT LV_PREV_STATE_IV4_MON2 "" ULONG _CNV_S_2_RANGE______28_CM 1 100. 0. 1. ECU_ADDRESS 0x3fed94 BIT_MASK 0x100000 /end MEASUREMENT
/begin MEASUREMENT LV_PREV_STATE_IV5_MON2 "" ULONG _CNV_S_2_RANGE______28_CM 1 100. 0. 1. ECU_ADDRESS 0x3fed94 BIT_MASK 0x200000 /end MEASUREMENT
/begin MEASUREMENT STATE_IV_MON2 "" UWORD _CNV_A_R_LINEAR_____10_CM 1 100. 0. 65535. ECU_ADDRESS 0x3fed94 FORMAT "%5.0" /end MEASUREMENT
/begin CHARACTERISTIC C_N_MAX_MTC_LIH_THD_MON2 "" VALUE 0x42958 _REC_VAL_20_u1 8160. _CNV_A_R_LINEAR_____5_CM 0. 8160. FORMAT "%4.0" /end CHARACTERISTIC
/begin CHARACTERISTIC C_TQI_SP_DEC_MAX_MON2 "" VALUE 0x42adf _REC_VAL_20_u1 31.875 _CNV_A_R_LINEAR_____467_CM 0. 31.875 FORMAT "%5.2" /end CHARACTERISTIC
/begin CHARACTERISTIC C_T_TQI_MON2 "" VALUE 0x42a30 _REC_VAL_20_u1 10.2 _CNV_A_R_LINEAR_____87_CM 0. 10.2 FORMAT "%5.2" /end CHARACTERISTIC
/begin CHARACTERISTIC C_IGA_REF_EGR_COR_LIM_MON2 "maximum permitted ignition angle correction for EGR active" VALUE 0x4334d _REC_VAL_20_s1 95.625 _CNV_A_R_LINEAR_____75_CM -48. 47.625 FORMAT "%5.1" /end CHARACTERISTIC
/begin CHARACTERISTIC LC_VAL_MO2_ANS "" VALUE 0x42bf3 _REC_VAL_20_u1 1. _CNV_A_R_LINEAR_____10_CM 0. 1. FORMAT "%2.0" /end CHARACTERISTIC
/begin CHARACTERISTIC ID_N_32_MON2__IDX "Motordrehzahl" CURVE 0x4cdac _REC_CUR_20_u1_u1 8160. _CNV_A_R_LINEAR_____5_CM 0. 8160. FORMAT "%4.0"
 /begin AXIS_DESCR COM_AXIS VAL_MO3_TST_REC_IDX_MO2 _CNV_A_R_LINEAR_____10_CM 12 0. 9. FORMAT "%2.0" AXIS_PTS_REF ldpm_tst_rec_idx_mon2 /end AXIS_DESCR
/end CHARACTERISTIC
/begin CHARACTERISTIC ID_SF_2_MON2__IDX "Logische Startwerte Tabelle 2" CURVE 0x45e44 _REC_CUR_20_u2_u1 65535. _CNV_A_R_LINEAR_____10_CM 0. 65535. FORMAT "%5.0"
 /begin AXIS_DESCR COM_AXIS VAL_MO3_TST_REC_IDX_MO2 _CNV_A_R_LINEAR_____10_CM 12 0. 9. FORMAT "%2.0" AXIS_PTS_REF ldpm_tst_rec_idx_mon2 /end AXIS_DESCR
/end CHARACTERISTIC
/begin CHARACTERISTIC IP_TQI_DIF_MAX_MON2 "Diagnoseschwelle Drehmomentenüberlauf (Prozesskontrolle 2)" MAP 0x50cbf _REC_MAP_20_u1_u1_u1 510. _CNV_A_R_LINEAR_____88_CM 0. 510. FORMAT "%3.0"
 /begin AXIS_DESCR COM_AXIS N_32_MON2 _CNV_A_R_LINEAR_____5_CM 4 0. 8160. FORMAT "%4.0" AXIS_PTS_REF ldp_n_32__tqi_dif_max_mon2 /end AXIS_DESCR
 /begin AXIS_DESCR COM_AXIS TQI_SP_MON2 _CNV_A_R_LINEAR_____88_CM 4 0. 510. FORMAT "%3.0" AXIS_PTS_REF ldp_tqi_sp__tqi_dif_max_mon2 /end AXIS_DESCR
/end CHARACTERISTIC
/begin CHARACTERISTIC ID_TQ_MAX_CLU_MON2__IDX "Monitored maximum torque at clutch" CURVE 0x50e38 _REC_CUR_20_s2_u1 2047.96875 _CNV_A_R_LINEAR_____48_CM -1024. 1023.96875 FORMAT "%8.2"
 /begin AXIS_DESCR COM_AXIS VAL_MO3_TST_REC_IDX_MO2 _CNV_A_R_LINEAR_____10_CM 12 0. 9. FORMAT "%2.0" AXIS_PTS_REF ldpm_tst_rec_idx_mon2 /end AXIS_DESCR
/end CHARACTERISTIC
/begin CHARACTERISTIC ID_STATE_IV_MON2__IDX "Status der Einspritzventile im letzten Zyklus" CURVE 0x45e5c _REC_CUR_20_u2_u1 65535. _CNV_A_R_LINEAR_____10_CM 0. 65535. FORMAT "%5.0"
 /begin AXIS_DESCR COM_AXIS VAL_MO3_TST_REC_IDX_MO2 _CNV_A_R_LINEAR_____10_CM 12 0. 9. FORMAT "%2.0" AXIS_PTS_REF ldpm_tst_rec_idx_mon2 /end AXIS_DESCR
/end CHARACTERISTIC
/begin CHARACTERISTIC ID_IGA_REF_EGR_COR_MON2__IDX "Ignition angle correction for EGR" CURVE 0x50e68 _REC_CUR_20_s1_u1 95.625 _CNV_A_R_LINEAR_____75_CM -48. 47.625 FORMAT "%5.1"
 /begin AXIS_DESCR COM_AXIS VAL_MO3_TST_REC_IDX_MO2 _CNV_A_R_LINEAR_____10_CM 12 0. 9. FORMAT "%2.0" AXIS_PTS_REF ldpm_tst_rec_idx_mon2 /end AXIS_DESCR
/end CHARACTERISTIC
/begin CHARACTERISTIC ID_T_TQI_MON2__IDX "Totzeit für Verzögerung des Sollmoments" CURVE 0x4cfa1 _REC_CUR_20_u1_u1 10.2 _CNV_A_R_LINEAR_____87_CM 0. 10.2 FORMAT "%5.2"
 /begin AXIS_DESCR COM_AXIS VAL_MO3_TST_REC_IDX_MO2 _CNV_A_R_LINEAR_____10_CM 12 0. 9. FORMAT "%2.0" AXIS_PTS_REF ldpm_tst_rec_idx_mon2 /end AXIS_DESCR
/end CHARACTERISTIC
/begin CHARACTERISTIC ID_TQI_SP_MON2__IDX "Sollmoment" CURVE 0x4d077 _REC_CUR_20_u1_u1 510. _CNV_A_R_LINEAR_____88_CM 0. 510. FORMAT "%3.0"
 /begin AXIS_DESCR COM_AXIS VAL_MO3_TST_REC_IDX_MO2 _CNV_A_R_LINEAR_____10_CM 12 0. 9. FORMAT "%2.0" AXIS_PTS_REF ldpm_tst_rec_idx_mon2 /end AXIS_DESCR
/end CHARACTERISTIC
/begin CHARACTERISTIC ID_ABC_TQI_AV_MON2__IDX "Entprellzähler für Überwachung des aktuell indizierten Motormoments" CURVE 0x4cba8 _REC_CUR_20_u1_u1 255. _CNV_A_R_LINEAR_____10_CM 0. 255. FORMAT "%3.0"
 /begin AXIS_DESCR COM_AXIS VAL_MO3_TST_REC_IDX_MO2 _CNV_A_R_LINEAR_____10_CM 12 0. 9. FORMAT "%2.0" AXIS_PTS_REF ldpm_tst_rec_idx_mon2 /end AXIS_DESCR
/end CHARACTERISTIC
/begin CHARACTERISTIC IP_FAC_TQ_REQ_DRIV_MON2 "Momentenanforderung für Pedalwert und Drehzahl" MAP 0x4e783 _REC_MAP_20_u1_u1_u1 1.9921875 _CNV_A_R_LINEAR_____103_CM 0. 1.9921875 FORMAT "%5.3"
 /begin AXIS_DESCR COM_AXIS N_32_MON2 _CNV_A_R_LINEAR_____5_CM 8 0. 8160. FORMAT "%4.0" AXIS_PTS_REF ldp_n_32__fac_tq_req_driv_mon2 /end AXIS_DESCR
 /begin AXIS_DESCR COM_AXIS PV_AV_MON2 _CNV_A_R_LINEAR_____4_CM 8 0. 99.609375 FORMAT "%5.2" AXIS_PTS_REF ldp_pv_av__fac_tq_req_driv_mon2 /end AXIS_DESCR
/end CHARACTERISTIC
/begin CHARACTERISTIC IP_TQI_REF_MON2 "" MAP 0x50ccf _REC_MAP_20_u1_u1_u1 510. _CNV_A_R_LINEAR_____88_CM 0. 510. FORMAT "%3.0"
 /begin AXIS_DESCR COM_AXIS N_32_MON2 _CNV_A_R_LINEAR_____5_CM 6 0. 8160. FORMAT "%4.0" AXIS_PTS_REF ldp_n_32__tqi_ref_mon2 /end AXIS_DESCR
 /begin AXIS_DESCR COM_AXIS MAF_MON2 _CNV_A_R_LINEAR_____18_CM 4 0. 1389. FORMAT "%4.0" AXIS_PTS_REF ldp_maf__tqi_ref_mon2 /end AXIS_DESCR
/end CHARACTERISTIC
/begin CHARACTERISTIC ID_ABC_TQI_N_MAX_MON2__IDX "Entprellzähler für Überwachung der Drehzahlbegrenzung" CURVE 0x4cbb4 _REC_CUR_20_u1_u1 255. _CNV_A_R_LINEAR_____10_CM 0. 255. FORMAT "%3.0"
 /begin AXIS_DESCR COM_AXIS VAL_MO3_TST_REC_IDX_MO2 _CNV_A_R_LINEAR_____10_CM 12 0. 9. FORMAT "%2.0" AXIS_PTS_REF ldpm_tst_rec_idx_mon2 /end AXIS_DESCR
/end CHARACTERISTIC
/begin CHARACTERISTIC IP_EFF_IGA_MON2 "" CURVE 0x4db9f _REC_CUR_20_u1_u1 1.9921875 _CNV_A_R_LINEAR_____103_CM 0. 1.9921875 FORMAT "%5.3"
 /begin AXIS_DESCR COM_AXIS IGA_DIF_AV _CNV_A_R_LINEAR_____203_CM 8 0. -95.625 FORMAT "%6.2" AXIS_PTS_REF ldp_iga_dif_av__eff_iga_mon2 /end AXIS_DESCR
/end CHARACTERISTIC
/begin CHARACTERISTIC ID_ANS_MON2__IDX "Übergabeindex für Rückgabewert der Prozesskontrollnachbildung (Prozesskontrolle)" CURVE 0x456b2 _REC_CUR_20_u2_u1 6553.5 _CNV_A_R_LINEAR_____10_CM 0. 65535. FORMAT "%5.0"
 /begin AXIS_DESCR COM_AXIS VAL_MO3_TST_REC_IDX_MO2 _CNV_A_R_LINEAR_____10_CM 12 0. 9. FORMAT "%2.0" AXIS_PTS_REF ldpm_tst_rec_idx_mon2 /end AXIS_DESCR
/end CHARACTERISTIC
/begin CHARACTERISTIC ID_TQ_DIF_P_D_IS_MON2__IDX "P- and D- controller output for idle speed control" CURVE 0x50dd8 _REC_CUR_20_s2_u1 2047.96875 _CNV_A_R_LINEAR_____48_CM -1024. 1023.96875 FORMAT "%8.2"
 /begin AXIS_DESCR COM_AXIS VAL_MO3_TST_REC_IDX_MO2 _CNV_A_R_LINEAR_____10_CM 12 0. 9. FORMAT "%2.0" AXIS_PTS_REF ldpm_tst_rec_idx_mon2 /end AXIS_DESCR
/end CHARACTERISTIC
/begin CHARACTERISTIC ID_TQ_EGS_MON2__IDX "Torque demand from EGS" CURVE 0x50df0 _REC_CUR_20_s2_u1 2047.96875 _CNV_A_R_LINEAR_____48_CM -1024. 1023.96875 FORMAT "%8.2"
 /begin AXIS_DESCR COM_AXIS VAL_MO3_TST_REC_IDX_MO2 _CNV_A_R_LINEAR_____10_CM 12 0. 9. FORMAT "%2.0" AXIS_PTS_REF ldpm_tst_rec_idx_mon2 /end AXIS_DESCR
/end CHARACTERISTIC
/begin CHARACTERISTIC ID_IGA_IGC_MON2__IDX "Zündwinkel" CURVE 0x4cd58 _REC_CUR_20_u1_u1 95.625 _CNV_A_R_LINEAR_____202_CM -35.625 60. FORMAT "%5.1"
 /begin AXIS_DESCR COM_AXIS VAL_MO3_TST_REC_IDX_MO2 _CNV_A_R_LINEAR_____10_CM 12 0. 9. FORMAT "%2.0" AXIS_PTS_REF ldpm_tst_rec_idx_mon2 /end AXIS_DESCR
/end CHARACTERISTIC
/begin CHARACTERISTIC ID_TQ_ESP_MON2__IDX "Torque demand from EPS" CURVE 0x50e08 _REC_CUR_20_s2_u1 2047.96875 _CNV_A_R_LINEAR_____48_CM -1024. 1023.96875 FORMAT "%8.2"
 /begin AXIS_DESCR COM_AXIS VAL_MO3_TST_REC_IDX_MO2 _CNV_A_R_LINEAR_____10_CM 12 0. 9. FORMAT "%2.0" AXIS_PTS_REF ldpm_tst_rec_idx_mon2 /end AXIS_DESCR
/end CHARACTERISTIC
/begin CHARACTERISTIC ID_MAF_MON2__IDX "Luftmasse" CURVE 0x4cda0 _REC_CUR_20_u1_u1 1389. _CNV_A_R_LINEAR_____18_CM 0. 1389. FORMAT "%4.0"
 /begin AXIS_DESCR COM_AXIS VAL_MO3_TST_REC_IDX_MO2 _CNV_A_R_LINEAR_____10_CM 12 0. 9. FORMAT "%2.0" AXIS_PTS_REF ldpm_tst_rec_idx_mon2 /end AXIS_DESCR
/end CHARACTERISTIC
/begin CHARACTERISTIC ID_PV_AV_MON2__IDX "Pedalwert" CURVE 0x4ce45 _REC_CUR_20_u1_u1 99.609375 _CNV_A_R_LINEAR_____4_CM 0. 99.609375 FORMAT "%4.1"
 /begin AXIS_DESCR COM_AXIS VAL_MO3_TST_REC_IDX_MO2 _CNV_A_R_LINEAR_____10_CM 12 0. 9. FORMAT "%2.0" AXIS_PTS_REF ldpm_tst_rec_idx_mon2 /end AXIS_DESCR
/end CHARACTERISTIC
/begin CHARACTERISTIC ID_TQ_LOSS_MON2__IDX "Torque losses" CURVE 0x50e20 _REC_CUR_20_s2_u1 2047.96875 _CNV_A_R_LINEAR_____48_CM -1024. 1023.96875 FORMAT "%8.2"
 /begin AXIS_DESCR COM_AXIS VAL_MO3_TST_REC_IDX_MO2 _CNV_A_R_LINEAR_____10_CM 12 0. 9. FORMAT "%2.0" AXIS_PTS_REF ldpm_tst_rec_idx_mon2 /end AXIS_DESCR
/end CHARACTERISTIC
/begin CHARACTERISTIC IP_IGA_REF_MON2 "Referenz-Zündwinkel (Prozesskontrolle 2)" MAP 0x4f49a _REC_MAP_20_u1_u1_u1 95.625 _CNV_A_R_LINEAR_____202_CM -35.625 60. FORMAT "%5.1"
 /begin AXIS_DESCR COM_AXIS N_32_MON2 _CNV_A_R_LINEAR_____5_CM 8 0. 8160. FORMAT "%4.0" AXIS_PTS_REF ldp_n_32__iga_ref_mon2 /end AXIS_DESCR
 /begin AXIS_DESCR COM_AXIS MAF_MON2 _CNV_A_R_LINEAR_____18_CM 8 0. 1389. FORMAT "%4.0" AXIS_PTS_REF ldp_maf__iga_ref_mon2 /end AXIS_DESCR
/end CHARACTERISTIC
/begin CHARACTERISTIC ID_SF_1_MON2__IDX "Logische Startwerte Tabelle 1" CURVE 0x45e2c _REC_CUR_20_u2_u1 65535. _CNV_A_R_LINEAR_____10_CM 0. 65535. FORMAT "%5.0"
 /begin AXIS_DESCR COM_AXIS VAL_MO3_TST_REC_IDX_MO2 _CNV_A_R_LINEAR_____10_CM 12 0. 9. FORMAT "%2.0" AXIS_PTS_REF ldpm_tst_rec_idx_mon2 /end AXIS_DESCR
/end CHARACTERISTIC
/begin CHARACTERISTIC ID_TQ_MIN_CLU_MON2__IDX "Monitored minimum torque at clutch" CURVE 0x50e50 _REC_CUR_20_s2_u1 2047.96875 _CNV_A_R_LINEAR_____48_CM -1024. 1023.96875 FORMAT "%8.2"
 /begin AXIS_DESCR COM_AXIS VAL_MO3_TST_REC_IDX_MO2 _CNV_A_R_LINEAR_____10_CM 12 0. 9. FORMAT "%2.0" AXIS_PTS_REF ldpm_tst_rec_idx_mon2 /end AXIS_DESCR
/end CHARACTERISTIC
/begin CHARACTERISTIC ID_FAC_TQ_REQ_CRU_MON2__IDX "Torque demand from cruise control" CURVE 0x4ccf1 _REC_CUR_20_u1_u1 1.99220002 _CNV_A_R_LINEAR_____34_CM 0. 1.99220002 FORMAT "%5.3"
 /begin AXIS_DESCR COM_AXIS VAL_MO3_TST_REC_IDX_MO2 _CNV_A_R_LINEAR_____10_CM 12 0. 9. FORMAT "%2.0" AXIS_PTS_REF ldpm_tst_rec_idx_mon2 /end AXIS_DESCR
/end CHARACTERISTIC
/begin CHARACTERISTIC ID_INH_SWI_IV_MON2__IDX "shut off request for cylinder x" CURVE 0x45796 _REC_CUR_20_u2_u1 65534. _CNV_A_R_LINEAR_____10_CM 1. 65535. FORMAT "%5.0"
 /begin AXIS_DESCR COM_AXIS VAL_MO3_TST_REC_IDX_MO2 _CNV_A_R_LINEAR_____10_CM 12 0. 9. FORMAT "%2.0" AXIS_PTS_REF ldpm_tst_rec_idx_mon2 /end AXIS_DESCR
/end CHARACTERISTIC
/begin AXIS_PTS ldp_iga_dif_av__eff_iga_mon2 "" 0x4342d IGA_DIF_AV_MON2 _REC_AXS_20_u1 -95.625 _CNV_A_R_LINEAR_____203_CM 8 0. -95.625 FORMAT "%6.2" /end AXIS_PTS
/begin AXIS_PTS ldp_maf__iga_ref_mon2 "" 0x43447 MAF_MON2 _REC_AXS_20_u1 1389. _CNV_A_R_LINEAR_____18_CM 8 0. 1389. FORMAT "%4.0" /end AXIS_PTS
/begin AXIS_PTS ldp_maf__tqi_ref_mon2 "" 0x43469 MAF_MON2 _REC_AXS_20_u1 1389. _CNV_A_R_LINEAR_____18_CM 4 0. 1389. FORMAT "%4.0" /end AXIS_PTS
/begin AXIS_PTS ldp_n_32__iga_ref_mon2 "" 0x43534 N_32_MON2 _REC_AXS_20_u1 8160. _CNV_A_R_LINEAR_____5_CM 8 0. 8160. FORMAT "%4.0" /end AXIS_PTS
/begin AXIS_PTS ldp_n_32__tqi_dif_max_mon2 "" 0x4364a N_32_MON2 _REC_AXS_20_u1 8160. _CNV_A_R_LINEAR_____5_CM 4 0. 8160. FORMAT "%4.0" /end AXIS_PTS
/begin AXIS_PTS ldp_n_32__tqi_ref_mon2 "" 0x4364f N_32_MON2 _REC_AXS_20_u1 8160. _CNV_A_R_LINEAR_____5_CM 6 0. 8160. FORMAT "%4.0" /end AXIS_PTS
/begin AXIS_PTS ldp_tqi_sp__tqi_dif_max_mon2 "" 0x43a79 TQI_SP_MON2 _REC_AXS_20_u1 510. _CNV_A_R_LINEAR_____88_CM 4 0. 510. FORMAT "%3.0" /end AXIS_PTS
/begin AXIS_PTS ldp_n_32__fac_tq_req_driv_mon2 "" 0x434ff N_32_MON2 _REC_AXS_20_u1 8160. _CNV_A_R_LINEAR_____5_CM 8 0. 8160. FORMAT "%4.0" /end AXIS_PTS
/begin AXIS_PTS ldp_pv_av__fac_tq_req_driv_mon2 "" 0x4379b PV_AV_MON2 _REC_AXS_20_u1 99.609375 _CNV_A_R_LINEAR_____4_CM 8 0. 99.609375 FORMAT "%5.2" /end AXIS_PTS
/begin MEASUREMENT VAL_MO2_ANS_TST "" UWORD _CNV_A_R_LINEAR_____10_CM 1 100. 0. 65535. ECU_ADDRESS 0x3fed98 FORMAT "%5.0" /end MEASUREMENT
/begin AXIS_PTS ldpm_tst_rec_idx_mon2 "" 0x4408f VAL_MO3_TST_REC_IDX_MO2 _REC_AXS_20_u1 9. _CNV_A_R_LINEAR_____10_CM 12 0. 9. FORMAT "%2.0" /end AXIS_PTS
/begin MEASUREMENT VAL_MO3_AV_CAL_CKS_HIGH "" ULONG _CNV_A_R_LINEAR_____10_CM 1 100. 0. 4294967295. ECU_ADDRESS 0x3fbf14 FORMAT "%11.0" /end MEASUREMENT
/begin MEASUREMENT VAL_MO3_AV_CAL_CKS_LOW "" ULONG _CNV_A_R_LINEAR_____10_CM 1 100. 0. 4294967295. ECU_ADDRESS 0x3fbf10 FORMAT "%11.0" /end MEASUREMENT
/begin CHARACTERISTIC VAL_MO3_CAL_CKS_HIGH "setpoint of CAL data (high) ROM test process monitoring" VALUE 0x43374 _REC_VAL_20_u4 4294967295. _CNV_A_R_LINEAR_____12_CM 0. 4294967295. FORMAT "%11.0" /end CHARACTERISTIC
/begin CHARACTERISTIC VAL_MO3_CAL_CKS_LOW "setpoint of CAL data (low) ROM test process monitoring" VALUE 0x43378 _REC_VAL_20_u4 4294967295. _CNV_A_R_LINEAR_____12_CM 0. 4294967295. FORMAT "%11.0" /end CHARACTERISTIC
/begin CHARACTERISTIC VAL_MO3_SWI_CAL_CKS "switch to set the fault of the CAL data ROM test inactive (A5h means inactive)" VALUE 0x42bfa _REC_VAL_20_u1 255. _CNV_A_R_LINEAR_____10_CM 0. 255. FORMAT "%3.0" /end CHARACTERISTIC
/begin CHARACTERISTIC VAL_MO3_ANS_CPM_TAB "assignment table for answer of copy of process monitoring" CURVE 0x4cb90 _REC_CUR_20_u2_u1 65535. _CNV_A_R_LINEAR_____10_CM 0. 65535. FORMAT "%5.0"
 /begin AXIS_DESCR COM_AXIS VAL_MO3_TST_REC_IDX_MO2 _CNV_A_R_LINEAR_____10_CM 12 0. 12. FORMAT "%3.0" AXIS_PTS_REF ldpm_tst_rec /end AXIS_DESCR
/end CHARACTERISTIC
/begin MEASUREMENT VAL_MO2_ANS "" UWORD _CNV_A_R_LINEAR_____10_CM 1 100. 0. 65535. ECU_ADDRESS 0x3fbef4 FORMAT "%5.0" /end MEASUREMENT
/begin MEASUREMENT VAL_MO3_ERR_CODE_MC "error code of an error dtected by the MC" UBYTE _CNV_A_R_LINEAR_____10_CM 1 100. 0. 255. ECU_ADDRESS 0x3fa0ae FORMAT "%3.0" /end MEASUREMENT
/begin MEASUREMENT VAL_MO3_ERR_CODE_MU "error code of an error dtected by the MU" UBYTE _CNV_A_R_LINEAR_____10_CM 1 100. 0. 255. ECU_ADDRESS 0x3fbefd FORMAT "%3.0" /end MEASUREMENT
/begin MEASUREMENT VAL_MO3_PREDRIVE_ACT "active flag of PREDRIVE CHECK" UBYTE _CNV_S_2_RANGE______28_CM 1 100. 0. 1. ECU_ADDRESS 0x3fbef8 /end MEASUREMENT
/begin MEASUREMENT VAL_MO3_PWR_STAG_DIS_MC "" UBYTE _CNV_S_2_RANGE______11_CM 1 100. 0. 1. ECU_ADDRESS 0x3fbef6 BIT_MASK 0x1 /end MEASUREMENT
/begin MEASUREMENT VAL_MO3_PWR_STAG_DIS_MU "" UBYTE _CNV_S_2_RANGE______11_CM 1 100. 0. 1. ECU_ADDRESS 0x3fbef7 BIT_MASK 0x1 /end MEASUREMENT
/begin MEASUREMENT VAL_MO3_RST_CTR_MC "reset counter on MC" UBYTE _CNV_A_R_LINEAR_____10_CM 1 100. 0. 255. ECU_ADDRESS 0x3fa0af FORMAT "%3.0" /end MEASUREMENT
/begin MEASUREMENT VAL_MO3_RST_CTR_MU "reset counter on MU" UBYTE _CNV_A_R_LINEAR_____10_CM 1 100. 0. 255. ECU_ADDRESS 0x3fbefe FORMAT "%3.0" /end MEASUREMENT
/begin MEASUREMENT VAL_MO3_TST_REC_IDX_MO2 "index for the test records of copy of Process Monitoring" UBYTE _CNV_A_R_LINEAR_____10_CM 1 100. 0. 255. ECU_ADDRESS 0x3fbef2 FORMAT "%3.0" /end MEASUREMENT
/begin AXIS_PTS ldpm_tst_rec "" 0x44082 VAL_MO3_TST_REC_IDX_MO2 _REC_AXS_20_u1 12. _CNV_A_R_LINEAR_____10_CM 12 0. 12. FORMAT "%3.0" /end AXIS_PTS
/begin MEASUREMENT LV_ERR_CONV_MON "Logical variable for ADC error" UBYTE _CNV_S_2_RANGE______11_CM 1 100. 0. 1. ECU_ADDRESS 0x3fecb9 BIT_MASK 0x1 /end MEASUREMENT
/begin MEASUREMENT LV_ERR_N_32_MON "Logical variable for ratio error between N_32_MON and N_32_SUB_MON" UBYTE _CNV_S_2_RANGE______11_CM 1 100. 0. 1. ECU_ADDRESS 0x3fecdc BIT_MASK 0x1 /end MEASUREMENT
/begin MEASUREMENT LV_ERR_PVS_MON "Logical variable for different PVS diagnosis between L1 and L2" UBYTE _CNV_S_2_RANGE______11_CM 1 100. 0. 1. ECU_ADDRESS 0x3fecde BIT_MASK 0x1 /end MEASUREMENT
/begin MEASUREMENT LV_ERR_TPS_MON "Logical variable for different TPS diagnosis between L1 and L2" UBYTE _CNV_S_2_RANGE______11_CM 1 100. 0. 1. ECU_ADDRESS 0x3feccf BIT_MASK 0x1 /end MEASUREMENT
/begin MEASUREMENT LV_ERR_TQI_AV_MON "Fault currently present in torque generation" UBYTE _CNV_S_2_RANGE______11_CM 1 100. 0. 1. ECU_ADDRESS 0x3fece2 BIT_MASK 0x1 /end MEASUREMENT
/begin MEASUREMENT LV_ERR_MSR_INH_MON "Logical variable for fault in MSR present" UBYTE _CNV_S_2_RANGE______11_CM 1 100. 0. 1. ECU_ADDRESS 0x3fecba BIT_MASK 0x1 /end MEASUREMENT
/begin MEASUREMENT LV_ERR_CRU_INH_MON "Logival variable for inhibition of cruise control" UBYTE _CNV_S_2_RANGE______11_CM 1 100. 0. 1. ECU_ADDRESS 0x3fecc9 BIT_MASK 0x1 /end MEASUREMENT
/begin MEASUREMENT LV_ERR_MAF_MON "Logical variable for error in mass air flow signal" UBYTE _CNV_S_2_RANGE______11_CM 1 100. 0. 1. ECU_ADDRESS 0x3fecd0 BIT_MASK 0x1 /end MEASUREMENT
/begin MEASUREMENT LV_ERR_TQI_N_MAX_NVMY_MON "Error location for \"monitoring of engine speed limitation\" stored in non volatile memory" UBYTE _CNV_S_2_RANGE______21_R_CM 1 100. 0. 255. ECU_ADDRESS 0x3fd583 BIT_MASK 0x1 /end MEASUREMENT
/begin MEASUREMENT VAL_MON_ERR_RAM "Logical variable for fault of RAM in process monitoring present" UBYTE _CNV_S_2_RANGE______11_CM 1 100. 0. 1. ECU_ADDRESS 0x3fece1 BIT_MASK 0x1 /end MEASUREMENT
/begin AXIS_PTS ldp_maf_sub__maf_sub_thd_mon "" 0x402d5 MAF_SUB _REC_AXS_20_u1 1389. _CNV_A_R_LINEAR_____18_CM 2 0. 1389. FORMAT "%4.0" /end AXIS_PTS
/begin MEASUREMENT ABC_CONV_MON "Anti bounce counter ADC error" UBYTE _CNV_A_R_LINEAR_____10_CM 1 100. 0. 255. ECU_ADDRESS 0x3fecea FORMAT "%3.0" /end MEASUREMENT
/begin MEASUREMENT ABC_MAF_MON "Anti bounce counter MAF signal" UBYTE _CNV_A_R_LINEAR_____10_CM 1 100. 0. 255. ECU_ADDRESS 0x3fed14 FORMAT "%3.0" /end MEASUREMENT
/begin MEASUREMENT ABC_TPS_RATIO_MON "Anti bounce counter TPS ratio error" UBYTE _CNV_A_R_LINEAR_____10_CM 1 100. 0. 255. ECU_ADDRESS 0x3fed13 FORMAT "%3.0" /end MEASUREMENT
/begin MEASUREMENT ABC_TQI_N_MAX_MON "Anti-bounce-counter for fault in engine speed limitation" UBYTE _CNV_A_R_LINEAR_____10_CM 1 100. 0. 255. ECU_ADDRESS 0x3fed16 FORMAT "%3.0" /end MEASUREMENT
/begin MEASUREMENT LV_OFF_IV_MON "Request for disable of MTC power stage by main controller" UBYTE _CNV_S_2_RANGE______11_CM 1 100. 0. 1. ECU_ADDRESS 0x3feccc BIT_MASK 0x1 /end MEASUREMENT
/begin MEASUREMENT LV_OFF_MTC_IV_MU_MON "Request for wrong answers of the instruction set test to the monitoring unit in order to disable MTC and IV" UBYTE _CNV_S_2_RANGE______11_CM 1 100. 0. 1. ECU_ADDRESS 0x3feccd BIT_MASK 0x1 /end MEASUREMENT
/begin MEASUREMENT MAF_MON "Mass air flow signal used monitoring level" UBYTE _CNV_A_R_LINEAR_____18_CM 1 100. 0. 1389. ECU_ADDRESS 0x3fed0a FORMAT "%4.0" /end MEASUREMENT
/begin MEASUREMENT MAF_SUB_MON "MAF substitute" UBYTE _CNV_A_R_LINEAR_____18_CM 1 100. 0. 1389. ECU_ADDRESS 0x3fed0f FORMAT "%4.0" /end MEASUREMENT
/begin MEASUREMENT N_32_MON "Engine speed (monitoring level)" UBYTE _CNV_A_R_LINEAR_____5_CM 1 100. 0. 8160. ECU_ADDRESS 0x3fed17 FORMAT "%4.0" /end MEASUREMENT
/begin MEASUREMENT N_32_SUB_MON "Engine speed substitute monitoring level" UBYTE _CNV_A_R_LINEAR_____5_CM 1 100. 0. 8160. ECU_ADDRESS 0x3fed18 FORMAT "%4.0" /end MEASUREMENT
/begin MEASUREMENT PQ_TURB_SYS_MON "ISA pressure quotient" UBYTE _CNV_A_R_LINEAR_____253_CM 1 100. 0. 0.996094 ECU_ADDRESS 0x3fed12 FORMAT "%5.3" /end MEASUREMENT
/begin MEASUREMENT PV_AV_MON "" UBYTE _CNV_A_R_LINEAR_____4_CM 1 100. 0. 99.609375 ECU_ADDRESS 0x3fed1a FORMAT "%4.1" /end MEASUREMENT
/begin MEASUREMENT T_CRU_INH_MON "Timer for inhibition of cruise control charge demand in monitoring level" UBYTE _CNV_A_R_LINEAR_____87_CM 1 100. 0. 10.2 ECU_ADDRESS 0x3fed08 FORMAT "%5.2" /end MEASUREMENT
/begin MEASUREMENT T_TCO_GRD_MON "Timer for negative TCO gradient limitation" UBYTE _CNV_A_R_LINEAR_____87_CM 1 100. 0. 10.2 ECU_ADDRESS 0x3fed21 FORMAT "%5.2" /end MEASUREMENT
/begin MEASUREMENT TCO_MON "Coolant temperature (monitoring level)" UBYTE _CNV_A_R_LINEAR_____0_CM 1 100. -48. 142.5 ECU_ADDRESS 0x3fed20 FORMAT "%5.1" /end MEASUREMENT
/begin MEASUREMENT TPS_AV_MON "TPS actual value" UBYTE _CNV_A_R_LINEAR_____357_CM 1 100. 0. 119.5 ECU_ADDRESS 0x3fed0c FORMAT "%5.1" /end MEASUREMENT
/begin MEASUREMENT TPS_SUM_AV_MON "total throttle angel actual value" UBYTE _CNV_A_R_LINEAR_____357_CM 1 100. 0. 119.5 ECU_ADDRESS 0x3fed60 FORMAT "%5.1" /end MEASUREMENT
/begin MEASUREMENT TQI_AV_MON "Actual indicated engine torque (process monitoring)" UBYTE _CNV_A_R_LINEAR_____88_CM 1 100. 0. 510. ECU_ADDRESS 0x3fed22 FORMAT "%3.0" /end MEASUREMENT
/begin MEASUREMENT TQI_DIF_MAX_MON "Permitted deviation between actual and desired indicated engine torque" UBYTE _CNV_A_R_LINEAR_____88_CM 1 100. 0. 510. ECU_ADDRESS 0x3fed2b FORMAT "%3.0" /end MEASUREMENT
/begin MEASUREMENT TQI_DIF_MON "Deviation between actual and desired indicated engine torque" UBYTE _CNV_A_R_LINEAR_____88_CM 1 100. 0. 510. ECU_ADDRESS 0x3fed2a FORMAT "%3.0" /end MEASUREMENT
/begin MEASUREMENT TQI_REQ_TOT_MON "Desired non-delayed indicated engine torque" UBYTE _CNV_A_R_LINEAR_____88_CM 1 100. 0. 510. ECU_ADDRESS 0x3fed3b FORMAT "%3.0" /end MEASUREMENT
/begin MEASUREMENT TQI_SP_MON "Desired indicated engine torque" UBYTE _CNV_A_R_LINEAR_____88_CM 1 100. 0. 510. ECU_ADDRESS 0x3fed39 FORMAT "%7.3" /end MEASUREMENT
/begin MEASUREMENT V_TPS_1_MON "Adapted TPS signal channel 1" UBYTE _CNV_A_R_LINEAR_____38_CM 1 100. 0. 4.998 ECU_ADDRESS 0x3fed0d FORMAT "%5.3" /end MEASUREMENT
/begin MEASUREMENT V_TPS_2_MON "Adapted TPS signal channel 2" UBYTE _CNV_A_R_LINEAR_____38_CM 1 100. 0. 4.998 ECU_ADDRESS 0x3fed0e FORMAT "%5.3" /end MEASUREMENT
/begin MEASUREMENT LV_OFF_MTC_MON "Request for disable of MTC power stage by main controller" UBYTE _CNV_S_2_RANGE______11_CM 1 100. 0. 1. ECU_ADDRESS 0x3fecca BIT_MASK 0x1 /end MEASUREMENT
/begin MEASUREMENT LV_N_LIM_REQ_MON "Request for engine speed limitation" UBYTE _CNV_S_2_RANGE______11_CM 1 100. 0. 1. ECU_ADDRESS 0x3feccb BIT_MASK 0x1 /end MEASUREMENT
/begin MEASUREMENT PV_AV_1_MON "degree of activation of the accelerator pedal from PVS-channel 1" UBYTE _CNV_A_R_LINEAR_____4_CM 1 100. 0. 99.609375 ECU_ADDRESS 0x3fed1b FORMAT "%3.1" /end MEASUREMENT
/begin MEASUREMENT PV_AV_2_MON "degree of activation of the accelerator pedal from PVS-channel 2" UBYTE _CNV_A_R_LINEAR_____4_CM 1 100. 0. 99.609375 ECU_ADDRESS 0x3fed1c FORMAT "%3.1" /end MEASUREMENT
/begin MEASUREMENT ABC_N_32_MON "Anti bounce counter N_32_RATIO error" UBYTE _CNV_A_R_LINEAR_____10_CM 1 100. 0. 255. ECU_ADDRESS 0x3fed19 FORMAT "%3.0" /end MEASUREMENT
/begin MEASUREMENT ABC_PVS_RATIO_MON "Anti bounce counter PVS ratio error" UBYTE _CNV_A_R_LINEAR_____10_CM 1 100. 0. 255. ECU_ADDRESS 0x3fed1e FORMAT "%3.0" /end MEASUREMENT
/begin MEASUREMENT N_DIF_SP_IS_MON "monitored deviation from actual engine speed to idle speed setpoint" UBYTE _CNV_A_R_LINEAR_____378_CM 1 100. -4096. 4064. ECU_ADDRESS 0x3fed2c FORMAT "%5.0" /end MEASUREMENT
/begin MEASUREMENT ABC_TQI_AV_MON "Anti-bounce-counter for fault in torque generation" UBYTE _CNV_A_R_LINEAR_____10_CM 1 100. 0. 255. ECU_ADDRESS 0x3fed28 FORMAT "%3.0" /end MEASUREMENT
/begin MEASUREMENT TQ_DIF_I_IS_MON "monitored I-part of the idle speed controller" SWORD _CNV_A_R_LINEAR_____48_CM 1 100. -1024. 1023.96875 ECU_ADDRESS 0x3fed6a FORMAT "%8.2" /end MEASUREMENT
/begin MEASUREMENT TQ_DIF_I_IS_RAMP_MON "modelled I-part dring ramp function" SWORD _CNV_A_R_LINEAR_____585_CM 1 100. -256. 255.9921875 ECU_ADDRESS 0x3fed72 FORMAT "%7.1" /end MEASUREMENT
/begin MEASUREMENT TQ_DIF_P_D_IS_DIF_MON "difference between monitored and modelled PD-part" SBYTE _CNV_A_R_LINEAR_____88_CM 1 100. -256. 254. ECU_ADDRESS 0x3fed31 FORMAT "%3.0" /end MEASUREMENT
/begin MEASUREMENT TQ_DIF_I_IS_DIF_MON "difference between monitored and modelled I-part" SBYTE _CNV_A_R_LINEAR_____88_CM 1 100. -256. 254. ECU_ADDRESS 0x3fed32 FORMAT "%3.0" /end MEASUREMENT
/begin MEASUREMENT ABC_TQ_DIF_P_D_IS_MON "Anti bounce counter for monitoring of idle speed controller - PD-part" UBYTE _CNV_A_R_LINEAR_____10_CM 1 100. 0. 255. ECU_ADDRESS 0x3fed2f FORMAT "%3.0" /end MEASUREMENT
/begin MEASUREMENT TQ_LOSS_MON "Torque losses" SWORD _CNV_A_R_LINEAR_____48_CM 1 100. -1024. 1023.96875 ECU_ADDRESS 0x3fed74 FORMAT "%8.2" /end MEASUREMENT
/begin MEASUREMENT TQ_LOSS_DIF_MON "difference of monitored and modelled torque losses" SBYTE _CNV_A_R_LINEAR_____88_CM 1 100. -256. 254. ECU_ADDRESS 0x3fed33 FORMAT "%3.0" /end MEASUREMENT
/begin MEASUREMENT ABC_TQ_LOSS_MON "Anti bounce counter for monitoring of torque losses" UBYTE _CNV_A_R_LINEAR_____10_CM 1 100. 0. 255. ECU_ADDRESS 0x3fed34 FORMAT "%3.0" /end MEASUREMENT
/begin MEASUREMENT ABC_TQ_DIF_I_IS_MON "Anti bounce counter for monitoring of idle speed controller" UBYTE _CNV_A_R_LINEAR_____10_CM 1 100. 0. 255. ECU_ADDRESS 0x3fed30 FORMAT "%3.0" /end MEASUREMENT
/begin MEASUREMENT TQ_MAX_CLU_MON "monitored maximum torque at clutch" SWORD _CNV_A_R_LINEAR_____48_CM 1 100. -1024. 1023.96875 ECU_ADDRESS 0x3fed76 FORMAT "%8.2" /end MEASUREMENT
/begin MEASUREMENT TQ_MAX_CLU_DIF_MON "difference of monitored and modelled maximum torque at clutch" SBYTE _CNV_A_R_LINEAR_____88_CM 1 100. -256. 254. ECU_ADDRESS 0x3fed35 FORMAT "%3.0" /end MEASUREMENT
/begin MEASUREMENT ABC_TQ_MAX_CLU_MON "Anti bounce counter for monitoring of maximum torque at clutch" UBYTE _CNV_A_R_LINEAR_____10_CM 1 100. 0. 255. ECU_ADDRESS 0x3fed36 FORMAT "%3.0" /end MEASUREMENT
/begin MEASUREMENT FAC_TQ_REQ_CRU_MON "Charge demand from cruise control" UWORD _CNV_A_R_LINEAR_____45_CM 1 100. 0. 1.99996948 ECU_ADDRESS 0x3fed5e FORMAT "%7.5" /end MEASUREMENT
/begin MEASUREMENT ABC_CRU_INH_MON "Anti bounce counter for fault in cruise conditions present" UBYTE _CNV_A_R_LINEAR_____10_CM 1 100. 0. 255. ECU_ADDRESS 0x3fed09 FORMAT "%3.0" /end MEASUREMENT
/begin MEASUREMENT LV_N_LIM_ETC_MON "Logical variable for activation of engine speed limitation monitoring" UBYTE _CNV_S_2_RANGE______11_CM 1 100. 0. 1. ECU_ADDRESS 0x3fecd1 BIT_MASK 0x1 /end MEASUREMENT
/begin MEASUREMENT LV_TQI_MON_ACT_MON "Logical variable for torque monitoring active" UBYTE _CNV_S_2_RANGE______11_CM 1 100. 0. 1. ECU_ADDRESS 0x3fecd2 BIT_MASK 0x1 /end MEASUREMENT
/begin MEASUREMENT TQ_ESP_MON "Engine torgue request of ESP  Checked torque value in monitoring level" SWORD _CNV_A_R_LINEAR_____48_CM 1 100. -1024. 1023.96875 ECU_ADDRESS 0x3fed64 FORMAT "%8.2" /end MEASUREMENT
/begin MEASUREMENT MAF_SUB_COR_MMV_MON "Low pass filtered MAF_SUB_COR_MON" UBYTE _CNV_A_R_LINEAR_____18_CM 1 100. 0. 1389. ECU_ADDRESS 0x3fed0b FORMAT "%4.0" /end MEASUREMENT
/begin MEASUREMENT MAF_SUB_TPS_MON "MAF substitute (TPS)" UBYTE _CNV_A_R_LINEAR_____18_CM 1 100. 0. 1389. ECU_ADDRESS 0x3fed11 FORMAT "%4.0" /end MEASUREMENT
/begin MEASUREMENT MAF_SUB_ISA_MON "MAF substitute (ISA)" UBYTE _CNV_A_R_LINEAR_____18_CM 1 100. 0. 1389. ECU_ADDRESS 0x3fed10 FORMAT "%4.0" /end MEASUREMENT
/begin MEASUREMENT LV_BRAKE_MON "Brake active or brake fault present" UBYTE _CNV_S_2_RANGE______11_CM 1 100. 0. 1. ECU_ADDRESS 0x3fecd4 BIT_MASK 0x1 /end MEASUREMENT
/begin MEASUREMENT LV_IM_BTS_MON "" UBYTE _CNV_S_2_RANGE______11_CM 1 100. 0. 1. ECU_ADDRESS 0x3fecd9 BIT_MASK 0x1 /end MEASUREMENT
/begin MEASUREMENT LV_IM_BLS_MON "" UBYTE _CNV_S_2_RANGE______11_CM 1 100. 0. 1. ECU_ADDRESS 0x3fecda BIT_MASK 0x1 /end MEASUREMENT
/begin MEASUREMENT STATE_N_MAX_MON "Error indication" UWORD _CNV_A_R_LINEAR_____10_CM 1 100. 0. 65535. ECU_ADDRESS 0x3fa6fc FORMAT "%5.0" /end MEASUREMENT
/begin MEASUREMENT FAC_TQ_REQ_MON "Scaling factor for requested torque at clutch from driver" UBYTE _CNV_A_R_LINEAR_____34_CM 1 100. 0. 1.99220002 ECU_ADDRESS 0x3fed3a FORMAT "%5.3" /end MEASUREMENT
/begin MEASUREMENT EFF_IGA_AV_MON "actual ignition efficiency for torque monitoring" UBYTE _CNV_A_R_LINEAR_____103_CM 1 100. 0. 1.9921875 ECU_ADDRESS 0x3fed23 FORMAT "%5.3" /end MEASUREMENT
/begin MEASUREMENT IGA_REF_COR_MON "reference ignition angle for torque monitoring (corrected by EGR influence)" UBYTE _CNV_A_R_LINEAR_____202_CM 1 100. -35.625 60. ECU_ADDRESS 0x3fed27 FORMAT "%5.1" /end MEASUREMENT
/begin MEASUREMENT EFF_SCC_AV_1_MON "actual ignition efficiency for torque monitoring" UBYTE _CNV_A_R_LINEAR_____103_CM 1 100. 0. 1.9921875 ECU_ADDRESS 0x3fed24 FORMAT "%5.3" /end MEASUREMENT
/begin MEASUREMENT EFF_SCC_AV_2_MON "actual ignition efficiency for torque monitoring" UBYTE _CNV_A_R_LINEAR_____103_CM 1 100. 0. 1.9921875 ECU_ADDRESS 0x3fed25 FORMAT "%5.3" /end MEASUREMENT
/begin MEASUREMENT EFF_SCC_AV_MON "actual ignition efficiency for torque monitoring" UBYTE _CNV_A_R_LINEAR_____103_CM 1 100. 0. 1.9921875 ECU_ADDRESS 0x3fed26 FORMAT "%5.3" /end MEASUREMENT
/begin MEASUREMENT TQ_DIF_P_D_IS_MON "monitored PD-part of the idle speed controller" SWORD _CNV_A_R_LINEAR_____48_CM 1 100. -1024. 1023.96875 ECU_ADDRESS 0x3fed68 FORMAT "%8.2" /end MEASUREMENT
/begin MEASUREMENT TQ_DIF_P_D_IS_RAMP_MON "modelled PD-part during ramp function" SWORD _CNV_A_R_LINEAR_____48_CM 1 100. -1024. 1023.96875 ECU_ADDRESS 0x3fed70 FORMAT "%8.2" /end MEASUREMENT
/begin MEASUREMENT TQ_ADD_P_D_IS_MON "decrement for modelled PD-part during ramp function" SWORD _CNV_A_R_LINEAR_____585_CM 1 100. -256. 255.9921875 ECU_ADDRESS 0x3fed6c FORMAT "%7.1" /end MEASUREMENT
/begin MEASUREMENT TQ_ADD_I_IS_MON "Decrement for modelled I-part during ramp function" SWORD _CNV_A_R_LINEAR_____585_CM 1 100. -256. 255.9921875 ECU_ADDRESS 0x3fed6e FORMAT "%7.1" /end MEASUREMENT
/begin MEASUREMENT STATE_ERR_TQ_DIF_P_D_IS_MON "State variable for fault detection in torque generation, symptom 'idle speed controller - PD-part'" UBYTE _CNV_S_3_STATE_ERR__586_CM 1 100. 0. 2. ECU_ADDRESS 0x3fed2d /end MEASUREMENT
/begin MEASUREMENT STATE_ERR_TQ_DIF_I_IS_MON "State variable for fault detection in torque generation, symptom 'idle speed controller -   I-part'" UBYTE _CNV_S_3_STATE_ERR__586_CM 1 100. 0. 2. ECU_ADDRESS 0x3fed2e /end MEASUREMENT
/begin MEASUREMENT LV_IGK_MON "Logical variable for ignition key on" UBYTE _CNV_S_2_RANGE______11_CM 1 100. 0. 1. ECU_ADDRESS 0x3fecd3 BIT_MASK 0x1 /end MEASUREMENT
/begin MEASUREMENT N_SP_IS_MON "Idle speed setpoint used in level 2" UWORD _CNV_A_R_LINEAR_____17_CM 1 100. 0. 8160. ECU_ADDRESS 0x3fed62 FORMAT "%4.0" /end MEASUREMENT
/begin MEASUREMENT TQ_EGS_MON "Engine torgue request of EGS  Checked torque value in monitoring level" SWORD _CNV_A_R_LINEAR_____48_CM 1 100. -1024. 1023.96875 ECU_ADDRESS 0x3fed66 FORMAT "%8.2" /end MEASUREMENT
/begin MEASUREMENT TQ_ESP_MON2 "Torque demand from ESP" SWORD _CNV_A_R_LINEAR_____48_CM 1 100. -1024. 1023.96875 ECU_ADDRESS 0x3fed9c FORMAT "%8.2" /end MEASUREMENT
/begin MEASUREMENT TQ_LOSS_MON2 "Torque losses" SWORD _CNV_A_R_LINEAR_____48_CM 1 100. -1024. 1023.96875 ECU_ADDRESS 0x3fed9e FORMAT "%8.2" /end MEASUREMENT
/begin MEASUREMENT TQI_AV_MON2 "" UBYTE _CNV_A_R_LINEAR_____88_CM 1 100. 0. 510. ECU_ADDRESS 0x3fed4b FORMAT "%3.0" /end MEASUREMENT
/begin MEASUREMENT PV_AV_MON2 "Pedal value" UBYTE _CNV_A_R_LINEAR_____4_CM 1 100. 0. 99.609375 ECU_ADDRESS 0x3fed3d FORMAT "%4.1" /end MEASUREMENT
/begin MEASUREMENT FAC_TQ_REQ_CRU_MON2 "Torque demand from cruise control" UBYTE _CNV_A_R_LINEAR_____34_CM 1 100. 0. 1.99220002 ECU_ADDRESS 0x3fed3e FORMAT "%5.3" /end MEASUREMENT
/begin MEASUREMENT TQ_DIF_P_D_IS_MON2 "P- and D- controller output for idle speed control" SWORD _CNV_A_R_LINEAR_____48_CM 1 100. -1024. 1023.96875 ECU_ADDRESS 0x3feda4 FORMAT "%8.2" /end MEASUREMENT
/begin MEASUREMENT TQ_MIN_CLU_MON2 "Monitored minimum torque at clutch" SWORD _CNV_A_R_LINEAR_____48_CM 1 100. -1024. 1023.96875 ECU_ADDRESS 0x3feda0 FORMAT "%8.2" /end MEASUREMENT
/begin MEASUREMENT FAC_TQ_REQ_MON2 "Scaling factor for requested torque at clutch from driver" UBYTE _CNV_A_R_LINEAR_____34_CM 1 100. 0. 1.99220002 ECU_ADDRESS 0x3fed4a FORMAT "%5.3" /end MEASUREMENT
/begin MEASUREMENT MAF_MON2 "" UBYTE _CNV_A_R_LINEAR_____18_CM 1 100. 0. 1389. ECU_ADDRESS 0x3fed41 FORMAT "%4.0" /end MEASUREMENT
/begin MEASUREMENT ABC_TQI_AV_MON2 "" UBYTE _CNV_A_R_LINEAR_____10_CM 1 100. 0. 255. ECU_ADDRESS 0x3fed47 FORMAT "%3.0" /end MEASUREMENT
/begin MEASUREMENT N_32_MON2 "" UBYTE _CNV_A_R_LINEAR_____5_CM 1 100. 0. 8160. ECU_ADDRESS 0x3fed3f FORMAT "%4.0" /end MEASUREMENT
/begin MEASUREMENT TQ_MAX_CLU_MON2 "Monitored maximum torque at clutch" SWORD _CNV_A_R_LINEAR_____48_CM 1 100. -1024. 1023.96875 ECU_ADDRESS 0x3feda2 FORMAT "%8.2" /end MEASUREMENT
/begin MEASUREMENT TQI_DIF_MAX_MON2 "" UBYTE _CNV_A_R_LINEAR_____88_CM 1 100. 0. 510. ECU_ADDRESS 0x3fed4f FORMAT "%3.0" /end MEASUREMENT
/begin MEASUREMENT IGA_REF_EGR_COR_MON2 "Ingition angle correction for EGR" SBYTE _CNV_A_R_LINEAR_____75_CM 1 100. -48. 47.625 ECU_ADDRESS 0x3fed43 FORMAT "%5.1" /end MEASUREMENT
/begin MEASUREMENT IGA_REF_COR_MON2 "reference ignition angle for torque monitoring (corrected by EGR influence)" UBYTE _CNV_A_R_LINEAR_____202_CM 1 100. -35.625 60. ECU_ADDRESS 0x3fed4d FORMAT "%5.1" /end MEASUREMENT
/begin MEASUREMENT TQI_DIF_MON2 "" UBYTE _CNV_A_R_LINEAR_____88_CM 1 100. 0. 510. ECU_ADDRESS 0x3fed4e FORMAT "%3.0" /end MEASUREMENT
/begin MEASUREMENT ABC_TQI_N_MAX_MON2 "" UBYTE _CNV_A_R_LINEAR_____10_CM 1 100. 0. 255. ECU_ADDRESS 0x3fed48 FORMAT "%3.0" /end MEASUREMENT
/begin MEASUREMENT TQI_REQ_TOT_MON2 "" UBYTE _CNV_A_R_LINEAR_____88_CM 1 100. 0. 510. ECU_ADDRESS 0x3fed49 FORMAT "%3.0" /end MEASUREMENT
/begin MEASUREMENT IGA_IGC_MON2 "" UBYTE _CNV_A_R_LINEAR_____202_CM 1 100. -35.625 60. ECU_ADDRESS 0x3fed42 FORMAT "%5.1" /end MEASUREMENT
/begin MEASUREMENT TQI_SP_MON2 "" UBYTE _CNV_A_R_LINEAR_____88_CM 1 100. 0. 510. ECU_ADDRESS 0x3feda6 FORMAT "%3.0" /end MEASUREMENT
/begin MEASUREMENT TQ_EGS_MON2 "Torque demand from EGS" SWORD _CNV_A_R_LINEAR_____48_CM 1 100. -1024. 1023.96875 ECU_ADDRESS 0x3fed9a FORMAT "%8.2" /end MEASUREMENT
/begin MEASUREMENT EFF_IGA_AV_MON2 "actual ignition efficiency for torque monitoring" UBYTE _CNV_A_R_LINEAR_____103_CM 1 100. 0. 1.9921875 ECU_ADDRESS 0x3fed4c FORMAT "%5.3" /end MEASUREMENT
/begin MEASUREMENT EFF_SCC_AV_2_MON2 "actual ignition efficiency for torque monitoring" UBYTE _CNV_A_R_LINEAR_____103_CM 1 100. 0. 1.9921875 ECU_ADDRESS 0x3fed45 FORMAT "%5.3" /end MEASUREMENT
/begin MEASUREMENT EFF_SCC_AV_MON2 "actual ignition efficiency for torque monitoring" UBYTE _CNV_A_R_LINEAR_____103_CM 1 100. 0. 1.9921875 ECU_ADDRESS 0x3fed46 FORMAT "%5.3" /end MEASUREMENT
/begin MEASUREMENT EFF_SCC_AV_1_MON2 "actual ignition efficiency for torque monitoring" UBYTE _CNV_A_R_LINEAR_____103_CM 1 100. 0. 1.9921875 ECU_ADDRESS 0x3fed44 FORMAT "%5.3" /end MEASUREMENT
/begin MEASUREMENT T_TQI_MON2 "" UBYTE _CNV_A_R_LINEAR_____87_CM 1 100. 0. 10.2 ECU_ADDRESS 0x3fed40 FORMAT "%5.2" /end MEASUREMENT
/begin MEASUREMENT INH_SWI_IV_MON2 "shut of request for cylinder x" UWORD _CNV_A_R_LINEAR_____10_CM 1 100. 1. 65535. ECU_ADDRESS 0x3feda8 FORMAT "%5.0" /end MEASUREMENT
/begin MEASUREMENT BIOS_TEST_ECU_RAM "actual value of RAM test" UBYTE _CNV_A_R_LINEAR_____10_CM 1 100. 0. 255. ECU_ADDRESS 0x3fed51 FORMAT "%3.0" /end MEASUREMENT
/begin MEASUREMENT BIOS_TEST_ECU_RAM_CPL "actual complement value of RAM test" UBYTE _CNV_A_R_LINEAR_____10_CM 1 100. 0. 255. ECU_ADDRESS 0x3fc364 FORMAT "%3.0" /end MEASUREMENT
/begin COMPU_METHOD _CNV_A_R_LINEAR_____0_CM "" RAT_FUNC "%6.3" "°C" COEFFS 0 1.333333333333333 64. 0 0 1 /end COMPU_METHOD
/begin COMPU_METHOD _CNV_A_R_LINEAR_____1_CM "" RAT_FUNC "%6.3" "°C" COEFFS 0 1.333333333333333 0. 0 0 1 /end COMPU_METHOD
/begin COMPU_METHOD _CNV_A_R_LINEAR_____4_CM "" RAT_FUNC "%6.3" "%" COEFFS 0 2.56 0. 0 0 1 /end COMPU_METHOD
/begin COMPU_METHOD _CNV_A_R_LINEAR_____5_CM "" RAT_FUNC "%6.3" "rpm" COEFFS 0 3.125e-002 0. 0 0 1 /end COMPU_METHOD
/begin COMPU_METHOD _CNV_A_R_LINEAR_____10_CM "" RAT_FUNC "%6.3" "-" COEFFS 0 1. 0. 0 0 1 /end COMPU_METHOD
/begin COMPU_METHOD _CNV_S_2_RANGE______11_CM "" TAB_VERB "%6.3" "-" COMPU_TAB_REF _CNV_S_2_RANGE______11 /end COMPU_METHOD
/begin COMPU_VTAB _CNV_S_2_RANGE______11 "" TAB_VERB 2 0 "0" 1 "1" /end COMPU_VTAB
/begin COMPU_METHOD _CNV_A_R_LINEAR_____12_CM "" RAT_FUNC "%6.3" "[-]" COEFFS 0 1. 0. 0 0 1 /end COMPU_METHOD
/begin COMPU_METHOD _CNV_A_R_LINEAR_____14_CM "" RAT_FUNC "%6.3" "s" COEFFS 0 10. 0. 0 0 1 /end COMPU_METHOD
/begin COMPU_METHOD _CNV_A_R_LINEAR_____17_CM "" RAT_FUNC "%6.3" "rpm" COEFFS 0 1. 0. 0 0 1 /end COMPU_METHOD
/begin COMPU_METHOD _CNV_A_R_LINEAR_____18_CM "" RAT_FUNC "%6.3" "mg/stk" COEFFS 0 0.183585313174946 0. 0 0 1 /end COMPU_METHOD
/begin COMPU_METHOD _CNV_S_2_RANGE______21_R_CM "" TAB_VERB "%6.3" "[-]" COMPU_TAB_REF _CNV_S_2_RANGE______21_R /end COMPU_METHOD
/begin COMPU_VTAB_RANGE _CNV_S_2_RANGE______21_R "" 2 0 0 "0" 1 255 "1" /end COMPU_VTAB_RANGE
/begin COMPU_METHOD _CNV_A_R_LINEAR_____27_CM "" RAT_FUNC "%6.3" "s" COEFFS 0 100. 0. 0 0 1 /end COMPU_METHOD
/begin COMPU_METHOD _CNV_S_2_RANGE______28_CM "" TAB_VERB "%6.3" "[-]" COMPU_TAB_REF _CNV_S_2_RANGE______28 /end COMPU_METHOD
/begin COMPU_VTAB _CNV_S_2_RANGE______28 "" TAB_VERB 2 0 "0" 1 "1" /end COMPU_VTAB
/begin COMPU_METHOD _CNV_A_R_LINEAR_____31_CM "" RAT_FUNC "%6.3" "-" COEFFS 0 65536.00007936121 0. 0 0 1 /end COMPU_METHOD
/begin COMPU_METHOD _CNV_A_R_LINEAR_____33_CM "" RAT_FUNC "%6.3" "V" COEFFS 0 204.7999998974999 0. 0 0 1 /end COMPU_METHOD
/begin COMPU_METHOD _CNV_A_R_LINEAR_____34_CM "" RAT_FUNC "%6.3" "-" COEFFS 0 127.9991955827809 0. 0 0 1 /end COMPU_METHOD
/begin COMPU_METHOD _CNV_A_R_LINEAR_____38_CM "" RAT_FUNC "%6.3" "V" COEFFS 0 51.0204081632653 0. 0 0 1 /end COMPU_METHOD
/begin COMPU_METHOD _CNV_A_R_LINEAR_____43_CM "" RAT_FUNC "%6.3" "hPa" COEFFS 0 12.06017666543982 0. 0 0 1 /end COMPU_METHOD
/begin COMPU_METHOD _CNV_A_R_LINEAR_____44_CM "" RAT_FUNC "%6.3" "[-]" COEFFS 0 255.9999357490357 0. 0 0 1 /end COMPU_METHOD
/begin COMPU_METHOD _CNV_A_R_LINEAR_____45_CM "" RAT_FUNC "%6.3" "-" COEFFS 0 32768.00003968061 0. 0 0 1 /end COMPU_METHOD
/begin COMPU_METHOD _CNV_A_R_LINEAR_____48_CM "" RAT_FUNC "%6.3" "Nm" COEFFS 0 32. 0. 0 0 1 /end COMPU_METHOD
/begin COMPU_METHOD _CNV_A_R_LINEAR_____53_CM "" RAT_FUNC "%6.3" "V" COEFFS 0 9.807692307692308 0. 0 0 1 /end COMPU_METHOD
/begin COMPU_METHOD _CNV_A_R_LINEAR_____75_CM "" RAT_FUNC "%6.3" "°CRK" COEFFS 0 2.666666666666667 0. 0 0 1 /end COMPU_METHOD
/begin COMPU_METHOD _CNV_A_R_LINEAR_____78_CM "" RAT_FUNC "%6.3" "km/h" COEFFS 0 128.0000018750286 0. 0 0 1 /end COMPU_METHOD
/begin COMPU_METHOD _CNV_A_R_LINEAR_____84_CM "" RAT_FUNC "%6.3" "Nm" COEFFS 0 1. 0. 0 0 1 /end COMPU_METHOD
/begin COMPU_METHOD _CNV_A_R_LINEAR_____87_CM "" RAT_FUNC "%6.3" "s" COEFFS 0 25. 0. 0 0 1 /end COMPU_METHOD
/begin COMPU_METHOD _CNV_A_R_LINEAR_____88_CM "" RAT_FUNC "%6.3" "Nm" COEFFS 0 0.5 0. 0 0 1 /end COMPU_METHOD
/begin COMPU_METHOD _CNV_A_R_LINEAR_____89_CM "" RAT_FUNC "%6.3" "Nms" COEFFS 0 320.1514411333659 0. 0 0 1 /end COMPU_METHOD
/begin COMPU_METHOD _CNV_A_R_LINEAR_____90_CM "" RAT_FUNC "%6.3" "m/s²" COEFFS 0 2084.446564885496 32767.5 0 0 1 /end COMPU_METHOD
/begin COMPU_METHOD _CNV_A_R_LINEAR_____94_CM "" RAT_FUNC "%6.3" "%" COEFFS 0 655.3600000071681 0. 0 0 1 /end COMPU_METHOD
/begin COMPU_METHOD _CNV_A_R_LINEAR_____95_CM "" RAT_FUNC "%6.3" "mg/stk" COEFFS 0 47.18142548596112 0. 0 0 1 /end COMPU_METHOD
/begin COMPU_METHOD _CNV_A_R_LINEAR_____101_CM "" RAT_FUNC "%6.3" "kg/h" COEFFS 0 32. 0. 0 0 1 /end COMPU_METHOD
/begin COMPU_METHOD _CNV_A_R_LINEAR_____103_CM "" RAT_FUNC "%6.3" "-" COEFFS 0 128. 0. 0 0 1 /end COMPU_METHOD
/begin COMPU_METHOD _CNV_A_R_LINEAR_____140_CM "" RAT_FUNC "%6.3" "km/h" COEFFS 0 0.5 0. 0 0 1 /end COMPU_METHOD
/begin COMPU_METHOD _CNV_A_R_LINEAR_____172_CM "" RAT_FUNC "%6.3" "%" COEFFS 0 327.6800000071683 0. 0 0 1 /end COMPU_METHOD
/begin COMPU_METHOD _CNV_A_R_LINEAR_____182_CM "" RAT_FUNC "%6.3" "-" COEFFS 0 65535. 0. 0 0 1 /end COMPU_METHOD
/begin COMPU_METHOD _CNV_A_R_LINEAR_____195_CM "" RAT_FUNC "%6.3" "[-]" COEFFS 0 64. 0. 0 0 1 /end COMPU_METHOD
/begin COMPU_METHOD _CNV_A_R_LINEAR_____202_CM "" RAT_FUNC "%6.3" "°CRK" COEFFS 0 2.666666666666667 95. 0 0 1 /end COMPU_METHOD
/begin COMPU_METHOD _CNV_A_R_LINEAR_____203_CM "" RAT_FUNC "%6.3" "°CRK" COEFFS 0 -2.666666666666667 0. 0 0 1 /end COMPU_METHOD
/begin COMPU_METHOD _CNV_A_R_LINEAR_____211_CM "" RAT_FUNC "%6.3" "°C" COEFFS 0 16. 0. 0 0 1 /end COMPU_METHOD
/begin COMPU_METHOD _CNV_A_R_LINEAR_____226_CM "" RAT_FUNC "%6.3" "°TPS" COEFFS 0 137.0962343096234 0. 0 0 1 /end COMPU_METHOD
/begin COMPU_METHOD _CNV_A_R_LINEAR_____253_CM "" RAT_FUNC "%6.3" "-" COEFFS 0 255.9999357490357 0. 0 0 1 /end COMPU_METHOD
/begin COMPU_METHOD _CNV_A_R_LINEAR_____264_CM "" RAT_FUNC "%6.3" "°TPS/s" COEFFS 0 8.535564853556485e-002 0. 0 0 1 /end COMPU_METHOD
/begin COMPU_METHOD _CNV_A_R_LINEAR_____355_CM "" RAT_FUNC "%6.3" "°TPS/V" COEFFS 0 7.971241012816505 0. 0 0 1 /end COMPU_METHOD
/begin COMPU_METHOD _CNV_A_R_LINEAR_____356_CM "" RAT_FUNC "%6.3" "%/°TPS" COEFFS 0 2.400225903614458 0. 0 0 1 /end COMPU_METHOD
/begin COMPU_METHOD _CNV_A_R_LINEAR_____357_CM "" RAT_FUNC "%6.3" "°TPS" COEFFS 0 2.133891213389121 0. 0 0 1 /end COMPU_METHOD
/begin COMPU_METHOD _CNV_A_R_LINEAR_____378_CM "" RAT_FUNC "%6.3" "rpm" COEFFS 0 3.125e-002 128. 0 0 1 /end COMPU_METHOD
/begin COMPU_METHOD _CNV_A_R_LINEAR_____389_CM "" RAT_FUNC "%6.3" "%/V" COEFFS 0 3.2 0. 0 0 1 /end COMPU_METHOD
/begin COMPU_METHOD _CNV_A_R_LINEAR_____394_CM "" RAT_FUNC "%6.3" "%/V" COEFFS 0 1.6 0. 0 0 1 /end COMPU_METHOD
/begin COMPU_METHOD _CNV_A_R_LINEAR_____452_CM "" RAT_FUNC "%6.3" "Nm/rpm*rpm" COEFFS 0 134293032.7868853 0. 0 0 1 /end COMPU_METHOD
/begin COMPU_METHOD _CNV_A_R_LINEAR_____462_CM "" RAT_FUNC "%6.3" "-" COEFFS 0 8000.120001800027 0. 0 0 1 /end COMPU_METHOD
/begin COMPU_METHOD _CNV_A_R_LINEAR_____463_CM "" RAT_FUNC "%6.3" "-" COEFFS 0 8000. 0. 0 0 1 /end COMPU_METHOD
/begin COMPU_METHOD _CNV_A_R_LINEAR_____464_CM "" RAT_FUNC "%6.3" "Nm" COEFFS 0 -0.5 0. 0 0 1 /end COMPU_METHOD
/begin COMPU_METHOD _CNV_A_R_LINEAR_____467_CM "" RAT_FUNC "%6.3" "Nm" COEFFS 0 8. 0. 0 0 1 /end COMPU_METHOD
/begin COMPU_METHOD _CNV_A_R_LINEAR_____490_CM "" RAT_FUNC "%6.3" "µs" COEFFS 0 1. 0. 0 0 1 /end COMPU_METHOD
/begin COMPU_METHOD _CNV_A_R_LINEAR_____499_CM "" RAT_FUNC "%6.3" "µs" COEFFS 0 1. 32768. 0 0 1 /end COMPU_METHOD
/begin COMPU_METHOD _CNV_A_R_LINEAR_____541_CM "" RAT_FUNC "%6.3" "1/s^2" COEFFS 0 1. 0. 0 0 1 /end COMPU_METHOD
/begin COMPU_METHOD _CNV_A_R_LINEAR_____542_CM "" RAT_FUNC "%6.3" "%" COEFFS 0 327.8667200320192 16393.33600160096 0 0 1 /end COMPU_METHOD
/begin COMPU_METHOD _CNV_A_R_LINEAR_____543_CM "" RAT_FUNC "%6.3" "-" COEFFS 0 256.4102564102564 0. 0 0 1 /end COMPU_METHOD
/begin COMPU_METHOD _CNV_A_R_LINEAR_____544_CM "" RAT_FUNC "%6.3" "tdc" COEFFS 0 1. 0. 0 0 1 /end COMPU_METHOD
/begin COMPU_METHOD _CNV_A_R_LINEAR_____545_CM "" RAT_FUNC "%6.3" "Nm" COEFFS 0 64. 0. 0 0 1 /end COMPU_METHOD
/begin COMPU_METHOD _CNV_S_5_RANGE_STAT_546_CM "" TAB_VERB "%6.3" "-" COMPU_TAB_REF _CNV_S_5_RANGE_STAT_546 /end COMPU_METHOD
/begin COMPU_VTAB _CNV_S_5_RANGE_STAT_546 "" TAB_VERB 5 0 "Init Phase" 1 "Prepa. 0 delay" 2 "0 delay monit." 3 "Prepa nominal" 4 "Nominal monit." /end COMPU_VTAB
/begin COMPU_METHOD _CNV_A_R_LINEAR_____547_CM "" RAT_FUNC "%6.3" "cyl" COEFFS 0 1. 0. 0 0 1 /end COMPU_METHOD
/begin COMPU_METHOD _CNV_A_R_LINEAR_____548_CM "" RAT_FUNC "%6.3" "-" COEFFS 0 256.3333333333333 0. 0 0 1 /end COMPU_METHOD
/begin COMPU_METHOD _CNV_A_R_LINEAR_____549_CM "" RAT_FUNC "%6.3" "-" COEFFS 0 127.5 0. 0 0 1 /end COMPU_METHOD
/begin COMPU_METHOD _CNV_A_R_LINEAR_____585_CM "" RAT_FUNC "%6.3" "Nm" COEFFS 0 128. 0. 0 0 1 /end COMPU_METHOD
/begin COMPU_METHOD _CNV_S_3_STATE_ERR__586_CM "" TAB_VERB "%6.3" "[-]" COMPU_TAB_REF _CNV_S_3_STATE_ERR__586 /end COMPU_METHOD
/begin COMPU_VTAB _CNV_S_3_STATE_ERR__586 "" TAB_VERB 3 0 "NO_ERROR" 1 "ERROR_PATH_1" 2 "ERROR_PATH_2" /end COMPU_VTAB
/begin RECORD_LAYOUT _REC_VAL_20_u1 FNC_VALUES 1 UBYTE COLUMN_DIR DIRECT /end RECORD_LAYOUT
/begin RECORD_LAYOUT _REC_MAP_20_u1_u1_u1 FNC_VALUES 1 UBYTE COLUMN_DIR DIRECT /end RECORD_LAYOUT
/begin RECORD_LAYOUT _REC_AXS_20_u1 NO_AXIS_PTS_X 1 UBYTE AXIS_PTS_X 2 UBYTE INDEX_INCR DIRECT /end RECORD_LAYOUT
/begin RECORD_LAYOUT _REC_CUR_20_u1_u1 FNC_VALUES 1 UBYTE COLUMN_DIR DIRECT /end RECORD_LAYOUT
/begin RECORD_LAYOUT _REC_MAP_20_u2_u2_u1 FNC_VALUES 1 UWORD COLUMN_DIR DIRECT /end RECORD_LAYOUT
/begin RECORD_LAYOUT _REC_AXS_20_u2 NO_AXIS_PTS_X 1 UWORD AXIS_PTS_X 2 UWORD INDEX_INCR DIRECT /end RECORD_LAYOUT
/begin RECORD_LAYOUT _REC_CUR_20_u2_u2 FNC_VALUES 1 UWORD COLUMN_DIR DIRECT /end RECORD_LAYOUT
/begin RECORD_LAYOUT _REC_VAL_20_u2 FNC_VALUES 1 UWORD COLUMN_DIR DIRECT /end RECORD_LAYOUT
/begin RECORD_LAYOUT _REC_CUR_20_u2_u1 FNC_VALUES 1 UWORD COLUMN_DIR DIRECT /end RECORD_LAYOUT
/begin RECORD_LAYOUT _REC_MAP_20_u1_u1_u2 FNC_VALUES 1 UBYTE COLUMN_DIR DIRECT /end RECORD_LAYOUT
/begin RECORD_LAYOUT _REC_CUR_20_u1_u2 FNC_VALUES 1 UBYTE COLUMN_DIR DIRECT /end RECORD_LAYOUT
/begin RECORD_LAYOUT _REC_MAP_20_u2_u1_u1 FNC_VALUES 1 UWORD COLUMN_DIR DIRECT /end RECORD_LAYOUT
/begin RECORD_LAYOUT _REC_VAL_20_u4 FNC_VALUES 1 ULONG COLUMN_DIR DIRECT /end RECORD_LAYOUT
/begin RECORD_LAYOUT _REC_MAP_20_u1_u2_u2 FNC_VALUES 1 UBYTE COLUMN_DIR DIRECT /end RECORD_LAYOUT
/begin RECORD_LAYOUT _REC_VAL_20_s1 FNC_VALUES 1 SBYTE COLUMN_DIR DIRECT /end RECORD_LAYOUT
/begin RECORD_LAYOUT _REC_MAP_20_u2_u2_u2 FNC_VALUES 1 UWORD COLUMN_DIR DIRECT /end RECORD_LAYOUT
/begin RECORD_LAYOUT _REC_CUR_20_s2_u1 FNC_VALUES 1 SWORD COLUMN_DIR DIRECT /end RECORD_LAYOUT
/begin RECORD_LAYOUT _REC_CUR_20_s1_u1 FNC_VALUES 1 SBYTE COLUMN_DIR DIRECT /end RECORD_LAYOUT
/begin FUNCTION MISF ""
 /begin SUB_FUNCTION MISF_Det_ENRD_Based MISF_Legal_Misf_Det_Fade_Out_Cnd MISF_Rate_Err_Mngt MISF_Det_ENRD_Based_Appli_Inci MISF_Rate_Err_Mngt_Appli_Inci /end SUB_FUNCTION
/end FUNCTION
/begin FUNCTION MISF_Det_ENRD_Based "" /begin DEF_CHARACTERISTIC C_FAC_SCA_ER_STND C_N_MAX_ER_STND LC_ER_STND_CONF /end DEF_CHARACTERISTIC
 /begin OUT_MEASUREMENT LV_DET_MIS MIS_STATE_ER ER_STND ER_STND_0 ER_STND_1 ER_STND_2 ER_STND_3 ER_STND_4 ER_STND_5 /end OUT_MEASUREMENT
/end FUNCTION
/begin FUNCTION MISF_Legal_Misf_Det_Fade_Out_Cnd ""
 /begin DEF_CHARACTERISTIC C_MASK_INH_DET_ZDLY_MIS C_N_MIN_ZDLY_MIS C_T_ZDLY_MIS C_NR_TDC_ZDLY_MIS C_N_MIN_MIS C_N_MAX_MIS_AT C_N_MAX_MIS_MT C_MASK_INH_DET_MIS C_NR_TDC_INH_MIS LC_REQ_ZDLY_MIS C_AMP_MIN_MIS C_TCO_MIN_MIS C_T_DLY_ST_MIS C_T_DLY_IV_OFF_MIS /end DEF_CHARACTERISTIC
 /begin OUT_MEASUREMENT STATE_DIAG_MIS MIS_DET_CYL_INH MIS_DET_CDN_INH_NR CTR_TDC_ZDLY_MIS CTR_T_ZDLY_MIS LV_DIAG_MIS MIS_DET_CDN_INH LV_INH_N_DET_MIS LV_INH_LOAD_MIN_DET_MIS LV_INH_TCO_MIN_DET_MIS LV_INH_AMP_MIN_DET_MIS LV_INH_ST_DET_MIS LV_INH_IV_OFF_DET_MIS LV_REQ_INH_MIS LV_ZDLY_DIAG_MIS LV_PUC_DET_MIS /end OUT_MEASUREMENT
/end FUNCTION
/begin FUNCTION MISF_Rate_Err_Mngt ""
 /begin DEF_CHARACTERISTIC C_LOAD_MIS_FTP C_N_MIS_FTP C_MIS_A_IND_THD C_CTR_FTP_CDN_MIS_A C_MIS_A_MIN_NR C_MIS_SUM_A_THD C_MIS_SUM_A_CBK_THD C_MIS_MAX_NR_OFF_IV C_MIS_MIN_NR_PUC C_T_MIS_MIN_PUC C_NR_ERR_DET_MAX_MIS_B4 C_MIS_SUM_B1_THD_MT C_MIS_SUM_B1_THD_AT C_MIS_SUM_B4_THD_MT C_MIS_SUM_B4_THD_AT C_MIS_B1_MIN_NR C_MIS_B4_MIN_NR C_MIS_SUM_B1_CBK_THD C_MIS_SUM_B4_CBK_THD LC_MIS_INH LC_CONF_RND_DET_MIS_B LC_CONF_INH_IV_MIS C_NR_ERR_DET_MAX_MIS_A LC_CONF_RND_DET_MIS_A LC_CONF_MIS_A_LIH C_NR_CYL_MPL_MIS_A C_NR_CYL_MPL_MIS_B LC_CONF_MPL_DET_MIS_A LC_CONF_MPL_DET_MIS_B /end DEF_CHARACTERISTIC
 /begin OUT_MEASUREMENT LV_ERR_DET_MIS_A LV_FTP_MIS_A LV_END_DIAG_WIN_MIS_A LV_ERR_DET_MIS_B4 LV_END_DIAG_WIN_MIS_B1 LV_END_DIAG_WIN_MIS_B4 INH_IV_MIS MIS_NR_TDC_A MIS_SUM_A MIS_SUM_A_CBK_1 MIS_SUM_A_CBK_2 CTR_CHK_MIS_A CTR_FTP_CDN_MIS_A CTR_ERR_DET_MIS_A MIS_CTR_A_0 MIS_CTR_A_1 MIS_CTR_A_2 MIS_CTR_A_3 MIS_CTR_A_4 MIS_CTR_A_5 MIS_CTR_B_0 MIS_CTR_B_1 MIS_CTR_B_2 MIS_CTR_B_3 MIS_CTR_B_4 MIS_CTR_B_5 MIS_NR_TDC_B MIS_SUM_B MIS_SUM_B_CBK_1 MIS_SUM_B_CBK_2 CTR_CHK_MIS_B4 CTR_ERR_DET_MIS_B4 SYM_CYL_MIS_A SYM_CYL_MIS_B1 SYM_CYL_MIS_B4 CTR_ABC_MIS_A ERR_INFO_STAT LV_CDN_DIAG_MIS_A LV_END_DIAG_MIS_A LV_READY_MIS_A LV_ERR_MEM_MIS_A CTR_ABC_END_DIAG_MIS_A CTR_ABC_MIS_B1 ERR_INFO_STAT LV_CDN_DIAG_MIS_B1 LV_END_DIAG_MIS_B1 LV_READY_MIS_B1 LV_ERR_MEM_MIS_B1 CTR_ABC_END_DIAG_MIS_B1 CTR_ABC_MIS_B4 ERR_INFO_STAT LV_CDN_DIAG_MIS_B4 LV_END_DIAG_MIS_B4 LV_READY_MIS_B4 LV_ERR_MEM_MIS_B4 CTR_ABC_END_DIAG_MIS_B4 LV_ERR_MIS_A LV_ERR_MIS_B1 LV_ERR_MIS_B4 /end OUT_MEASUREMENT
/end FUNCTION
/begin FUNCTION MISF_Det_ENRD_Based_Appli_Inci ""
 /begin DEF_CHARACTERISTIC IP_LOAD_MIN_AFS_MT_MIS IP_LOAD_MIN_AFS_AT_MIS IP_LOAD_MIN_AFL_MT_MIS IP_LOAD_MIN_AFL_AT_MIS IP_LOAD_MIN_S_MT_MIS IP_LOAD_MIN_S_AT_MIS IP_AMP_OFS_LOAD_AFS_MIS IP_AMP_OFS_LOAD_S_MIS IP_AMP_OFS_LOAD_AFL_MIS IP_TCO_OFS_LOAD_AFL_MIS IP_TCO_OFS_LOAD_S_MIS IP_TCO_OFS_LOAD_AFS_MIS ldp_n_32__fac_thd_iv_s_er ldp_n_32__fac_thd_iv_er ldp_load_mis__thd_afl_er_is ldp_load_mis__thd_afs_er_is ldp_load_mis__thd_s_er_is ldp_n__thd_afs_er_is ldp_n__thd_afl_er_is ldp_n__thd_s_er_is ldp_tco__fac_thd_er ldp_iga_ch_bas__fac_thd_er_ch IP_THD_AT_AFL_ER IP_THD_AFL_ER_IS IP_THD_MT_AFS_ER IP_THD_MT_AFL_ER IP_THD_AFS_ER_IS IP_THD_AT_AFS_ER IP_THD_AT_S_ER IP_THD_MT_S_ER IP_THD_S_ER_IS IP_FAC_THD_IV_ER IP_FAC_THD_ER IP_FAC_THD_ER_CH C_MASK_APP_INH_DET_ZDLY_MIS C_MASK_APP_INH_DET_MIS C_MAP_DIF_DLY_ER C_TPS_GRD_DLY_ZDLY_ER C_NR_TDC_IGA_DIF_ER C_TPS_GRD_DLY_ER C_LOAD_GRD_HOM_DLY_MIS C_LOAD_GRD_S_DLY_MIS C_NR_TDC_CMB_TRA_S_MIS C_NR_TDC_CMB_TRA_AFL_MIS C_ACCOUT_DLY_ER IP_TPS_GRD_MAX_ER IP_TPS_GRD_MAX_ZDLY_ER IP_LOAD_GRD_HOM_MAX_MIS IP_LOAD_GRD_S_MAX_MIS ldp_map__map_dif_max_er IP_MAP_DIF_MAX_ER ldp_n_32__delta_iga_mis ldp_maf__delta_iga_mis IP_DELTA_IGA_MIS IP_FAC_THD_IV_S_ER ldpm_amp__amp_ofs_load_mis ldpm_tco__tco_ofs_load_mis LC_CONF_LOAD_MIS C_TQI_AV_MAX_MIS C_MAF_MAX_MIS ldp_tps_av__tps_grd_max_er ldp_tps_av__tps_grd_max_zdly_er ldp_load_mis__load_grd_hom_max ldp_load_mis__load_grd_s_max ldp_n__load_min_s_mt_mis ldp_n__load_min_s_at_mis ldp_n__load_min_afs_mt_mis ldp_n__load_min_afs_at_mis ldp_n__load_min_afl_mt_mis ldp_n__load_min_afl_at_mis ldp_load_mis__thd_mt_afl_er ldp_load_mis__thd_at_afl_er ldp_n_32__thd_mt_afl_er ldp_n_32__thd_at_afl_er ldp_load_mis__thd_mt_afs_er ldp_load_mis__thd_at_afs_er ldp_load_mis__thd_mt_s_er ldp_load_mis__thd_at_s_er ldp_n_32__thd_mt_s_er ldp_n_32__thd_at_s_er ldp_n_32__thd_mt_afs_er ldp_n_32__thd_at_afs_er /end DEF_CHARACTERISTIC
 /begin OUT_MEASUREMENT N_MIS LOAD_MIS_1 LOAD_MIS_2 LOAD_MIS_3 LOAD_GRD_MIS LOAD_MIN_MIS LOAD_MIS MIS_DET_CDN_APP_INH_NR MIS_DET_CDN_APP_INH LV_INH_MAP_DIF_DET_MIS LV_INH_TPS_GRD_DET_MIS LV_INH_LOAD_GRD_DET_MIS LV_INH_IGA_DIF_DET_MIS LV_INH_CMB_TRA_MIS LV_INH_ACC_DET_MIS LV_CDN_INH_MIS LV_INH_INDX_MIS IGA_MIS_1 IGA_MIS_2 IGA_MIS LV_REQ_APP_INH_MIS CTR_TOT_MIS THD_ER_BUF_0 THD_ER_BUF_1 THD_ER_BUF_2 THD_ER_BUF_3 THD_ER_BUF_4 THD_ER_BUF_5 THD_ER_STND_BUF_0 THD_ER_STND_BUF_1 THD_ER_STND_BUF_2 THD_ER_STND_BUF_3 THD_ER_STND_BUF_4 THD_ER_STND_BUF_5 IGA_DIF_MIS MAP_DIF_MIS THD_ER_STND THD_ER_STND_0 THD_ER_STND_1 THD_ER_STND_2 THD_ER_STND_3 THD_ER_STND_4 THD_ER_STND_5 THD_ER THD_ER_0 THD_ER_1 THD_ER_2 THD_ER_3 THD_ER_4 THD_ER_5 /end OUT_MEASUREMENT
/end FUNCTION
/begin FUNCTION MISF_Rate_Err_Mngt_Appli_Inci ""
 /begin DEF_CHARACTERISTIC ldp_n_32__fac_er_afl_diag_mis ldp_n_32__fac_er_s_diag_mis ldp_n_32__fac_igc_diag_mis ldp_n_32__fac_er_afs_diag_mis ldp_n_32__fac_iv_diag_mis ldp_load_mis__fac_er_s_diag_mis ldp_load_mis__fac_igc_diag_mis IP_FAC_ER_AFL_DIAG_MIS IP_FAC_ER_S_DIAG_MIS IP_FAC_ER_AFS_DIAG_MIS IP_FAC_IGC_DIAG_MIS IP_FAC_IV_DIAG_MIS ldp_load_mis__fac_iv_diag_mis ldp_load_mis_2__mis_a_fac_afl ldp_load_mis_2__mis_a_fac_afs ldp_load_mis_2__mis_a_fac_s C_MIS_NR_OFF_IV_IGCFB C_TEG_CAT_UP_MIS_A_MAX LC_FTL_L_DIAG_MIS LC_CTR_CONF_DIAG_MIS LC_ERR_RR_MIS IP_MIS_A_FAC_AFL IP_MIS_A_FAC_AFS IP_MIS_A_FAC_S ldp_n__mis_a_fac_afl ldp_n__mis_a_fac_afs ldp_n__mis_a_fac_s ldp_load_mis__fac_er_afs_diag ldp_load_mis__fac_er_afl_diag /end DEF_CHARACTERISTIC
 /begin OUT_MEASUREMENT SUM_FAC_DIAG_MIS FAC_IGC_DIAG_MIS FAC_ER_DIAG_MIS FAC_IV_DIAG_MIS LV_ERR_DET_MIS LV_MIS_STATE_B LV_FTL_L_DIAG_MIS LV_ERR_RR_MIS LV_MIS_STATE_A LV_REQ_APP_CTR_MIS_A MIS_A_FAC MIS_A_FAC_BUF_0 MIS_A_FAC_BUF_1 MIS_A_FAC_BUF_2 MIS_A_FAC_BUF_3 MIS_A_FAC_BUF_4 MIS_A_FAC_BUF_5 /end OUT_MEASUREMENT
/end FUNCTION
/begin FUNCTION MON_Monitoring "MON"
 /begin SUB_FUNCTION MON_Monitoring_of_pedal_value_si MON_Application_Incidence_and_Co MON_RAM_Test_of_process_monitori MON_Monitoring_of_analog_digital MON_TCO_Monitoring MON_Monitoring_of_torque_demand_ MON_Monitoring_of_torque_losses MON_Monitoring_of_minimum_torque MON_Monitoring_of_maximum_torque MON_Monitoring_of_engine_speed MON_Desired_indicated_engine_tor MON_Actual_indicated_engine_torq MON_Monitoring_of_actual_indicat MON_Monitoring_of_engine_speed_l MON_Fault_reaction_of_process_mo MON_Can_signals MON_Monitoring_of_cruse_control_ MON_Monitoring_of_mass_air_flow_ MON_Errors MON_Processor_Monitoring_by_copy MON_Processor_Monitoring MON_Fault_Reaction_of_Processor_ /end SUB_FUNCTION
/end FUNCTION
/begin FUNCTION MON_Monitoring_of_pedal_value_si "_Monitoring of pedal value signal"
 /begin DEF_CHARACTERISTIC C_V_PVS_IS_THD_1_MON C_V_PVS_IS_THD_2_MON C_V_PVS_SLOP_1_MON C_V_PVS_SLOP_2_MON C_N_MIN_PVS_DIAG_MON IP_PV_RATIO_HYS_MON C_PV_LIH_MAX_MON /end DEF_CHARACTERISTIC
 /begin OUT_MEASUREMENT LV_ERR_PVS_RATIO_MON LV_ERR_PVS_MON PV_AV_MON PV_AV_1_MON PV_AV_2_MON ABC_PVS_RATIO_MON /end OUT_MEASUREMENT
/end FUNCTION
/begin FUNCTION MON_Application_Incidence_and_Co "_Application Incidence and Configuration of Process Monitoring"
 /begin DEF_CHARACTERISTIC C_V_TPS_1_LIH_MON C_V_TPS_2_LIH_MON C_FAC_TQ_GS_MON C_FAC_TQ_AMT_MON C_FAC_TQ_GS_BN_MON C_FAC_TQ_AMT_BN_MON C_FAC_TQ_DCC_BN_MON /end DEF_CHARACTERISTIC
 /begin OUT_MEASUREMENT LV_ERR_VCC_PVS_2_MON LV_ERR_VCC_PVS_1_MON LV_ERR_VCC_PVS_MON LV_ERR_TQI_N_MAX_NVMY_MON LV_N_LIM_ETC_MON LV_TQI_MON_ACT_MON TQ_ESP_MON LV_BRAKE_MON LV_IM_BTS_MON LV_IM_BLS_MON STATE_N_MAX_MON LV_IGK_MON N_SP_IS_MON TQ_EGS_MON /end OUT_MEASUREMENT
/end FUNCTION
/begin FUNCTION MON_RAM_Test_of_process_monitori "_RAM Test of process monitoring" /begin OUT_MEASUREMENT VAL_MON_ERR_RAM /end OUT_MEASUREMENT /end FUNCTION
/begin FUNCTION MON_Monitoring_of_analog_digital "_Monitoring of analog-digital-conversoin" /begin DEF_CHARACTERISTIC C_V_CONV_THD_DEAC_MON C_V_PVS_2_CONV_RATIO_HYS_MON /end DEF_CHARACTERISTIC /begin OUT_MEASUREMENT LV_ERR_CONV_MON ABC_CONV_MON /end OUT_MEASUREMENT /end FUNCTION
/begin FUNCTION MON_TCO_Monitoring "_TCO Monitoring"
 /begin DEF_CHARACTERISTIC C_T_TCO_GRD_MAX_MON C_TCO_GRD_MAX_MON C_TCO_SUB_THD_MAX_MON C_TCO_THD_MIN_MON /end DEF_CHARACTERISTIC
 /begin OUT_MEASUREMENT T_TCO_GRD_MON TCO_MON /end OUT_MEASUREMENT
/end FUNCTION
/begin FUNCTION MON_Monitoring_of_torque_demand_ "_Monitoring of torque demand from idle speed controller"
 /begin DEF_CHARACTERISTIC IP_TQ_DIF_P_D_IS_MAX_MON IP_FAC_TQ_DIF_P_D_IS_MON C_N_DIF_MIN_MON C_TQ_DIF_I_IS_MAX_MON C_TQ_PAS_I_IS_MON C_FAC_RAMP_POS_I_IS_MON C_FAC_RAMP_NEG_I_IS_MON C_TQ_DIF_P_D_IS_ADD_MON C_TQ_DIF_I_IS_ADD_MON C_FAC_RAMP_NEG_P_D_IS_MON IP_N_SP_IS_MON_MAX_MON /end DEF_CHARACTERISTIC
 /begin OUT_MEASUREMENT LV_ERR_TQ_DIF_P_D_IS_MON LV_ERR_TQ_DIF_I_IS_MON N_DIF_SP_IS_MON TQ_DIF_I_IS_MON TQ_DIF_I_IS_RAMP_MON TQ_DIF_P_D_IS_DIF_MON TQ_DIF_I_IS_DIF_MON ABC_TQ_DIF_P_D_IS_MON ABC_TQ_DIF_I_IS_MON TQ_DIF_P_D_IS_MON TQ_DIF_P_D_IS_RAMP_MON TQ_ADD_P_D_IS_MON TQ_ADD_I_IS_MON STATE_ERR_TQ_DIF_P_D_IS_MON STATE_ERR_TQ_DIF_I_IS_MON /end OUT_MEASUREMENT
/end FUNCTION
/begin FUNCTION MON_Monitoring_of_torque_losses "_Monitoring of torque losses"
 /begin DEF_CHARACTERISTIC IP_TQ_LOSS_MIN_MON C_TQ_LOSS_ADD_ACC_MIN_MON C_FAC_TQ_LOSS_ALTER_MON C_FAC_TQ_LOSS_PSTE_MON C_FAC_TQ_LOSS_ARS_MON /end DEF_CHARACTERISTIC
 /begin OUT_MEASUREMENT LV_ERR_TQ_LOSS_MON TQ_LOSS_MON TQ_LOSS_DIF_MON ABC_TQ_LOSS_MON /end OUT_MEASUREMENT
/end FUNCTION
/begin FUNCTION MON_Monitoring_of_minimum_torque "_Monitoring of minimum torque at clutch"
 /begin DEF_CHARACTERISTIC C_N_ST_MAX_MON IP_TQ_MIN_CLU_MAX_MON IP_FAC_CONV_MON IP_TQI_MIN_REQ_PU_MON /end DEF_CHARACTERISTIC
 /begin OUT_MEASUREMENT LV_ERR_TQ_MIN_CLU_MON TQ_MIN_CLU_MON ABC_TQ_MIN_CLU_MON TQ_MIN_CLU_DIF_MON TQ_MIN_CLU_MDL_1_MON TQ_MIN_CLU_MDL_2_MON TQ_MIN_CLU_MDL_MON TQ_CONV_MAX_MON TQ_ST_MON /end OUT_MEASUREMENT
/end FUNCTION
/begin FUNCTION MON_Monitoring_of_maximum_torque "_Monitoring of maximum torque at clutch" /begin DEF_CHARACTERISTIC IP_TQ_MAX_CLU_MAX_MON /end DEF_CHARACTERISTIC
 /begin OUT_MEASUREMENT LV_ERR_TQ_MAX_CLU_MON TQ_MAX_CLU_MON TQ_MAX_CLU_DIF_MON ABC_TQ_MAX_CLU_MON /end OUT_MEASUREMENT
/end FUNCTION
/begin FUNCTION MON_Monitoring_of_engine_speed "_Monitoring of engine speed" /begin DEF_CHARACTERISTIC C_N_32_DIF_MAX_MON /end DEF_CHARACTERISTIC /begin OUT_MEASUREMENT LV_ERR_N_32_MON N_32_MON N_32_SUB_MON ABC_N_32_MON /end OUT_MEASUREMENT /end FUNCTION
/begin FUNCTION MON_Desired_indicated_engine_tor "_Desired indicated engine torque" /begin DEF_CHARACTERISTIC C_T_TQI_MON C_TQI_SP_DEC_MAX_MON IP_FAC_TQ_REQ_DRIV_MON /end DEF_CHARACTERISTIC /begin OUT_MEASUREMENT TQI_REQ_TOT_MON TQI_SP_MON FAC_TQ_REQ_MON /end OUT_MEASUREMENT /end FUNCTION
/begin FUNCTION MON_Actual_indicated_engine_torq "_Actual indicated engine torque"
 /begin DEF_CHARACTERISTIC IP_EFF_IGA_MON IP_IGA_REF_MON IP_TQI_REF_MON C_IGA_REF_EGR_COR_LIM_MON /end DEF_CHARACTERISTIC
 /begin OUT_MEASUREMENT TQI_AV_MON EFF_IGA_AV_MON IGA_REF_COR_MON EFF_SCC_AV_1_MON EFF_SCC_AV_2_MON EFF_SCC_AV_MON /end OUT_MEASUREMENT
/end FUNCTION
/begin FUNCTION MON_Monitoring_of_actual_indicat "_Monitoring of actual indicated engine torque" /begin DEF_CHARACTERISTIC IP_TQI_DIF_MAX_MON /end DEF_CHARACTERISTIC
 /begin OUT_MEASUREMENT LV_ERR_TQI_AV_MON TQI_DIF_MAX_MON TQI_DIF_MON ABC_TQI_AV_MON /end OUT_MEASUREMENT
/end FUNCTION
/begin FUNCTION MON_Monitoring_of_engine_speed_l "_Monitoring of engine speed limitation" /begin DEF_CHARACTERISTIC C_N_MAX_MTC_LIH_THD_MON /end DEF_CHARACTERISTIC /begin OUT_MEASUREMENT LV_ERR_TQI_N_MAX_MON ABC_TQI_N_MAX_MON /end OUT_MEASUREMENT /end FUNCTION
/begin FUNCTION MON_Fault_reaction_of_process_mo "_Fault reaction of process monitoring"
 /begin OUT_MEASUREMENT LV_OFF_IV_MON LV_OFF_MTC_IV_MU_MON LV_OFF_MTC_MON LV_N_LIM_REQ_MON /end OUT_MEASUREMENT
/end FUNCTION
/begin FUNCTION MON_Can_signals "_Can-signals"
 /begin DEF_CHARACTERISTIC C_CAN_VB_MIN_DIAG_MON C_T_MSR_INH_MON C_TQI_STND_MON C_ABC_INC_DCC_INH_MON C_ABC_MAX_DCC_INH_MON C_ABC_INC_DCC_REV_MON C_ABC_MAX_DCC_REV_MON C_T_DCC_INH_MON C_ABC_INC_DCC_IRREV_MON C_ABC_MAX_DCC_IRREV_MON C_T_MAX_BRAKE_DET_DCC_MON C_VS_FIL_AMT_MON C_T_MAX_STATE_AMT_1_DIAG_MON C_T_MAX_STATE_AMT_2_DIAG_MON C_TQI_AMT_DIAG_MON C_T_MAX_STATE_AMT_3_DIAG_MON C_T_MAX_TQI_AMT_DIAG_MON C_TQI_AMT_COND_DIAG_MON C_TQI_AMT_CAN_ES_MON C_T_MAX_STATE_CLU_AMT_DIAG_MON C_ABC_INC_AMT_INH_MON C_ABC_MAX_AMT_INH_MON C_T_AMT_INH_MON C_ABC_INC_GS_INH_MON C_ABC_INC_TQ_GS_INC_PLAUS_MON C_ABC_MAX_GS_INH_MON C_ABC_MAX_TQ_GS_INC_PLAUS_MON C_T_GS_INH_MON C_VS_MIN_TQ_GS_INC_MON C_T_DLY_MIN_VS_TQ_GS_INC_MON C_CRLC_TQ_GS_INC_PLAUS_MON C_INT_MAX_TQ_GS_INC_MON C_INT_MIN_TQ_GS_INC_MON C_T_DLY_AC_MAX_TQ_GS_INC_MON C_T_MAX_TQ_GS_INC_MON C_T_DLY_TQ_MAX_TQ_GS_INC_MON IP_AC_MAX_TQ_GS_INC_MON IP_TQ_MAX_TQ_GS_INC_MON C_INT_TQ_GS_INC_REST_MON C_T_DIF_MIN_TQ_GS_INC_MON /end DEF_CHARACTERISTIC
 /begin OUT_MEASUREMENT TQI_MSR_MON T_MSR_INH_MON ABC_MSR_INH_MON TQ_MSR_MON TQ_DCC_MON ABC_DCC_INH_MON LV_ERR_DCC_REV_MON T_DCC_BRAKE_DET_MON LV_ERR_DCC_INH_MON T_DCC_INH_MON STATE_ERR_AMT_MON T_STATE_AMT_1_DIAG_MON T_STATE_AMT_2_DIAG_MON T_STATE_AMT_3_DIAG_MON T_STATE_CLU_AMT_DIAG_MON T_TQI_AMT_DIAG_MON TQI_AMT_PLAUS_MON TQI_GS_MON LV_ERR_AMT_INH_MON T_AMT_INH_MON T_GS_INH_MON TQ_GS_MON LV_ERR_GS_INH_MON LV_ERR_TQ_GS_INC_PLAUS_MON STATE_GS_PLAUS_MON LV_INT_MAX_TQ_GS_INC_MON INT_TQ_GS_INC_MON LV_VS_MIN_TQ_GS_INC_MON CTR_T_VS_TQ_GS_INC_MON CTR_T_AC_TQ_GS_INC_MON LV_AC_MAX_TQ_GS_INC_MON LV_T_MIN_TQ_GS_INC_DEAC_MON CTR_T_MAX_TQ_GS_INC_MON LV_T_MAX_TQ_GS_INC_MON LV_TQ_MAX_TQ_GS_INC_MON CTR_T_DIF_MIN_TQ_GS_INC_MON CTR_T_TQ_MAX_TQ_GS_INC_MON ABC_AMT_INH_MON STATE_AMT_OLD_MON LV_ERR_DCC_IRREV_MON LV_DCC_OFF_ECU_MON TQ_AMT_MON TQI_AMT_MON ABC_GS_INH_MON LV_ERR_MSR_INH_MON /end OUT_MEASUREMENT
/end FUNCTION
/begin FUNCTION MON_Monitoring_of_cruse_control_ "_Monitoring of cruse control conditions" /begin DEF_CHARACTERISTIC C_VS_MIN_CRU_MON C_T_CRU_INH_MON /end DEF_CHARACTERISTIC
 /begin OUT_MEASUREMENT LV_ERR_CRU_INH_MON T_CRU_INH_MON FAC_TQ_REQ_CRU_MON ABC_CRU_INH_MON /end OUT_MEASUREMENT
/end FUNCTION
/begin FUNCTION MON_Monitoring_of_mass_air_flow_ "_Monitoring of mass air flow signal (MAF)"
 /begin DEF_CHARACTERISTIC C_MAF_SUB_MMV_CRLC_MON C_N_TPS_MIN_DIAG_MON C_TPS_SLOP_MON C_V_TPS_AD_EL_BOL_1_MON C_V_TPS_AD_EL_BOL_2_MON C_V_TPS_MAX_MON C_V_TPS_RATIO_HYS_MON IP_FAC_TPS_ISA_MON IP_MAF_MAX_ISA_MON IP_FAC_PQ_ISA_MON C_N_MIN_MAF_DIAG_MON IP_PQ_MON IP_FAC_MAF_SUB_COR_MON IP_MAF_SUB_MON IP_MAF_SUB_THD_MON /end DEF_CHARACTERISTIC
 /begin OUT_MEASUREMENT LV_ERR_TPS_MON LV_ERR_MAF_MON ABC_MAF_MON ABC_TPS_RATIO_MON MAF_MON MAF_SUB_MON PQ_TURB_SYS_MON TPS_AV_MON TPS_SUM_AV_MON V_TPS_1_MON V_TPS_2_MON MAF_SUB_COR_MMV_MON MAF_SUB_TPS_MON MAF_SUB_ISA_MON /end OUT_MEASUREMENT
/end FUNCTION
/begin FUNCTION MON_Errors "_Errors"
 /begin OUT_MEASUREMENT LV_ERR_CONV_MON_1 LV_ERR_N_32_MON_1 LV_ERR_PVS_MON_1 LV_ERR_TPS_MON_1 LV_ERR_TQ_LOSS_MON_1 LV_ERR_TQ_MIN_CLU_MON_1 LV_ERR_TQ_MAX_CLU_MON_1 LV_ERR_TQ_DIF_P_D_IS_MON_1 LV_ERR_TQ_DIF_I_IS_MON_1 LV_ERR_TQI_AV_MON_1 LV_ERR_TQI_N_MAX_MON_1 LV_ERR_MSR_INH_MON_1 LV_ERR_CRU_INH_MON_1 LV_ERR_MAF_MON_1 /end OUT_MEASUREMENT
/end FUNCTION
/begin FUNCTION MON_Processor_Monitoring_by_copy "_Processor Monitoring by copy of Process Monitoring"
 /begin DEF_CHARACTERISTIC C_N_MAX_MTC_LIH_THD_MON2 C_TQI_SP_DEC_MAX_MON2 C_T_TQI_MON2 C_IGA_REF_EGR_COR_LIM_MON2 LC_VAL_MO2_ANS ID_N_32_MON2__IDX ID_SF_2_MON2__IDX IP_TQI_DIF_MAX_MON2 ID_TQ_MAX_CLU_MON2__IDX ID_STATE_IV_MON2__IDX ID_IGA_REF_EGR_COR_MON2__IDX ID_T_TQI_MON2__IDX ID_TQI_SP_MON2__IDX ID_ABC_TQI_AV_MON2__IDX IP_FAC_TQ_REQ_DRIV_MON2 IP_TQI_REF_MON2 ID_ABC_TQI_N_MAX_MON2__IDX IP_EFF_IGA_MON2 ID_ANS_MON2__IDX ID_TQ_DIF_P_D_IS_MON2__IDX ID_TQ_EGS_MON2__IDX ID_IGA_IGC_MON2__IDX ID_TQ_ESP_MON2__IDX ID_MAF_MON2__IDX ID_PV_AV_MON2__IDX ID_TQ_LOSS_MON2__IDX IP_IGA_REF_MON2 ID_SF_1_MON2__IDX ID_TQ_MIN_CLU_MON2__IDX ID_FAC_TQ_REQ_CRU_MON2__IDX ID_INH_SWI_IV_MON2__IDX VAL_MO3_SWI_CAL_CKS /end DEF_CHARACTERISTIC
 /begin OUT_MEASUREMENT LV_TQI_MON_ACT_MON2 LV_N_LIM_ETC_MON2 LV_ERR_CONV_MON2 LV_ERR_N_32_MON2 LV_ERR_TQ_DIF_P_D_IS_MON2 LV_ERR_TQ_DIF_I_IS_MON2 LV_ERR_TQ_LOSS_MON2 LV_ERR_TQ_MIN_CLU_MON2 LV_ERR_TQ_MAX_CLU_MON2 LV_ERR_PVS_MON2 LV_ERR_TPS_MON2 LV_ERR_MAF_MON2 SF_1_MON2 LV_ERR_TMP_MU_MON2 LV_ERR_TRAN_ENA_MON2 LV_N_LIM_REQ_MON2 LV_OFF_MTC_IV_MU_MON2 LV_OFF_IV_MON2 LV_OFF_MTC_MON2 LV_ERR_TQI_AV_MON2 LV_ERR_TQI_N_MAX_MON2 SF_2_MON2 LV_PREV_STATE_IV0_MON2 LV_PREV_STATE_IV1_MON2 LV_PREV_STATE_IV2_MON2 LV_PREV_STATE_IV3_MON2 LV_PREV_STATE_IV4_MON2 LV_PREV_STATE_IV5_MON2 STATE_IV_MON2 VAL_MO2_ANS_TST VAL_MO3_AV_CAL_CKS_HIGH VAL_MO3_AV_CAL_CKS_LOW VAL_MO2_ANS TQ_ESP_MON2 TQ_LOSS_MON2 TQI_AV_MON2 PV_AV_MON2 FAC_TQ_REQ_CRU_MON2 TQ_DIF_P_D_IS_MON2 TQ_MIN_CLU_MON2 FAC_TQ_REQ_MON2 MAF_MON2 ABC_TQI_AV_MON2 N_32_MON2 TQ_MAX_CLU_MON2 TQI_DIF_MAX_MON2 IGA_REF_EGR_COR_MON2 IGA_REF_COR_MON2 TQI_DIF_MON2 ABC_TQI_N_MAX_MON2 TQI_REQ_TOT_MON2 IGA_IGC_MON2 TQI_SP_MON2 TQ_EGS_MON2 EFF_IGA_AV_MON2 EFF_SCC_AV_2_MON2 EFF_SCC_AV_MON2 EFF_SCC_AV_1_MON2 T_TQI_MON2 INH_SWI_IV_MON2 /end OUT_MEASUREMENT
/end FUNCTION
/begin FUNCTION MON_Processor_Monitoring "_Processor Monitoring"
 /begin DEF_CHARACTERISTIC VAL_MO3_CAL_CKS_HIGH VAL_MO3_CAL_CKS_LOW VAL_MO3_ANS_CPM_TAB /end DEF_CHARACTERISTIC
 /begin OUT_MEASUREMENT VAL_MO3_PREDRIVE_ACT VAL_MO3_TST_REC_IDX_MO2 BIOS_TEST_ECU_RAM BIOS_TEST_ECU_RAM_CPL /end OUT_MEASUREMENT
/end FUNCTION
/begin FUNCTION MON_Fault_Reaction_of_Processor_ "_Fault Reaction of Processor Monitoring"
 /begin OUT_MEASUREMENT VAL_MO3_ERR_CODE_MC VAL_MO3_ERR_CODE_MU VAL_MO3_PWR_STAG_DIS_MC VAL_MO3_PWR_STAG_DIS_MU VAL_MO3_RST_CTR_MC VAL_MO3_RST_CTR_MU /end OUT_MEASUREMENT
/end FUNCTION
/end MODULE
/end PROJECT
