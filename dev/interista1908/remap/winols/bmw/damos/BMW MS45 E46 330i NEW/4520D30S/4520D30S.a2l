ASAP2_VERSION 1 31
/begin PROJECT MS45 "BMW Motorsteuerung R6"
/begin HEADER "_default_HeaderComment" PROJECT_NO _52 /end HEADER
/begin MODULE _default_ModuleName "_default_ModuleLongIdentifier"
/begin MOD_COMMON "_default_ModCommonComment" DEPOSIT ABSOLUTE BYTE_ORDER MSB_FIRST ALIGNMENT_BYTE 1 ALIGNMENT_WORD 2 ALIGNMENT_LONG 4 ALIGNMENT_FLOAT32_IEEE 4 ALIGNMENT_FLOAT64_IEEE 8 /end MOD_COMMON
/begin CHARACTERISTIC C_ABC_INC_IMOB_2 "" VALUE 0x426e4 _REC_VAL_20_u1 254. _CNV_A_R_LINEAR_____10_CM 1. 255. FORMAT "%3.0" /end CHARACTERISTIC
/begin CHARACTERISTIC C_ABC_INC_IMOB_1 "" VALUE 0x426e3 _REC_VAL_20_u1 254. _CNV_A_R_LINEAR_____10_CM 1. 255. FORMAT "%3.0" /end CHARACTERISTIC
/begin CHARACTERISTIC C_ABC_MAX_IMOB_2 "" VALUE 0x42769 _REC_VAL_20_u1 254. _CNV_A_R_LINEAR_____10_CM 1. 255. FORMAT "%3.0" /end CHARACTERISTIC
/begin CHARACTERISTIC C_ABC_MAX_IMOB_1 "" VALUE 0x42768 _REC_VAL_20_u1 254. _CNV_A_R_LINEAR_____10_CM 1. 255. FORMAT "%3.0" /end CHARACTERISTIC
/begin MEASUREMENT ERR_INFO_STAT "" UBYTE _CNV_S_2_RANGE______21_R_CM 1 100. 0. 255. ECU_ADDRESS 0x3fd598 /end MEASUREMENT
/begin CHARACTERISTIC C_ABC_INC_AMP "Anti - bounce counter increment" VALUE 0x426b1 _REC_VAL_20_u1 255. _CNV_A_R_LINEAR_____10_CM 0. 255. FORMAT "%3.0" /end CHARACTERISTIC
/begin CHARACTERISTIC C_ABC_MAX_AMP "Maximum value of the anti - bounce counter" VALUE 0x42738 _REC_VAL_20_u1 254. _CNV_A_R_LINEAR_____10_CM 1. 255. FORMAT "%3.0" /end CHARACTERISTIC
/begin CHARACTERISTIC C_ABC_INC_IM_BTS_PLAUS "BTS debounce counter increment  " VALUE 0x426e2 _REC_VAL_20_u1 255. _CNV_A_R_LINEAR_____10_CM 0. 255. FORMAT "%3.0" /end CHARACTERISTIC
/begin CHARACTERISTIC C_ABC_INC_IM_BLS_PLAUS "BLS debounce counter increment  " VALUE 0x426e1 _REC_VAL_20_u1 255. _CNV_A_R_LINEAR_____10_CM 0. 255. FORMAT "%3.0" /end CHARACTERISTIC
/begin CHARACTERISTIC C_ABC_MAX_IM_BTS_PLAUS "BTS debounce counter maximum value, error debounce" VALUE 0x42767 _REC_VAL_20_u1 254. _CNV_A_R_LINEAR_____10_CM 1. 255. FORMAT "%3.0" /end CHARACTERISTIC
/begin CHARACTERISTIC C_ABC_MAX_IM_BLS_PLAUS "BLS debounce counter maximum value" VALUE 0x42766 _REC_VAL_20_u1 254. _CNV_A_R_LINEAR_____10_CM 1. 255. FORMAT "%3.0" /end CHARACTERISTIC
/begin CHARACTERISTIC C_ABC_INC_BN_TQ_DCC "Anti - bounce counter increment BN2000 Diagnosis" VALUE 0x426c0 _REC_VAL_20_u1 255. _CNV_A_R_LINEAR_____10_CM 0. 255. FORMAT "%3.0" /end CHARACTERISTIC
/begin CHARACTERISTIC C_ABC_INC_BN_TQ_TCS "Anti - bounce counter increment BN2000 Diagnosis" VALUE 0x426c2 _REC_VAL_20_u1 255. _CNV_A_R_LINEAR_____10_CM 0. 255. FORMAT "%3.0" /end CHARACTERISTIC
/begin CHARACTERISTIC C_ABC_INC_BN_VS_TCS "Anti - bounce counter increment BN2000 Diagnosis" VALUE 0x426c4 _REC_VAL_20_u1 255. _CNV_A_R_LINEAR_____10_CM 0. 255. FORMAT "%3.0" /end CHARACTERISTIC
/begin CHARACTERISTIC C_ABC_INC_BN_TCS "Anti - bounce counter increment BN2000 Diagnosis" VALUE 0x426be _REC_VAL_20_u1 255. _CNV_A_R_LINEAR_____10_CM 0. 255. FORMAT "%3.0" /end CHARACTERISTIC
/begin CHARACTERISTIC C_ABC_INC_BN_TQ_ETCU "Anti - bounce counter increment BN2000 Diagnosis" VALUE 0x426c1 _REC_VAL_20_u1 255. _CNV_A_R_LINEAR_____10_CM 0. 255. FORMAT "%3.0" /end CHARACTERISTIC
/begin CHARACTERISTIC C_ABC_INC_BN_CAS "Anti - bounce counter increment BN2000 Diagnosis" VALUE 0x426b6 _REC_VAL_20_u1 255. _CNV_A_R_LINEAR_____10_CM 0. 255. FORMAT "%3.0" /end CHARACTERISTIC
/begin CHARACTERISTIC C_ABC_INC_BN_ETCU "Anti - bounce counter increment BN2000 Diagnosis" VALUE 0x426b7 _REC_VAL_20_u1 255. _CNV_A_R_LINEAR_____10_CM 0. 255. FORMAT "%3.0" /end CHARACTERISTIC
/begin CHARACTERISTIC C_ABC_INC_BN_TQ_AMT "Anti - bounce counter increment BN2000 Diagnosis" VALUE 0x426bf _REC_VAL_20_u1 255. _CNV_A_R_LINEAR_____10_CM 0. 255. FORMAT "%3.0" /end CHARACTERISTIC
/begin CHARACTERISTIC C_ABC_INC_BN_ACC "Anti - bounce counter increment BN2000 Diagnosis" VALUE 0x426b3 _REC_VAL_20_u1 255. _CNV_A_R_LINEAR_____10_CM 0. 255. FORMAT "%3.0" /end CHARACTERISTIC
/begin CHARACTERISTIC C_ABC_INC_BN_ICL "Anti - bounce counter increment BN2000 Diagnosis" VALUE 0x426b8 _REC_VAL_20_u1 255. _CNV_A_R_LINEAR_____10_CM 0. 255. FORMAT "%3.0" /end CHARACTERISTIC
/begin CHARACTERISTIC C_ABC_INC_BN_KM_ICL "Anti - bounce counter increment BN2000 Diagnosis" VALUE 0x426b9 _REC_VAL_20_u1 255. _CNV_A_R_LINEAR_____10_CM 0. 255. FORMAT "%3.0" /end CHARACTERISTIC
/begin CHARACTERISTIC C_ABC_INC_BN_VEH_MOD "Anti - bounce counter increment BN2000 Diagnosis" VALUE 0x426c3 _REC_VAL_20_u1 255. _CNV_A_R_LINEAR_____10_CM 0. 255. FORMAT "%3.0" /end CHARACTERISTIC
/begin CHARACTERISTIC C_ABC_INC_BN_T_ICL "Anti - bounce counter increment BN2000 Diagnosis" VALUE 0x426bd _REC_VAL_20_u1 255. _CNV_A_R_LINEAR_____10_CM 0. 255. FORMAT "%3.0" /end CHARACTERISTIC
/begin CHARACTERISTIC C_ABC_INC_BN_POW_VB "Anti - bounce counter increment BN2000 Diagnosis" VALUE 0x426bc _REC_VAL_20_u1 255. _CNV_A_R_LINEAR_____10_CM 0. 255. FORMAT "%3.0" /end CHARACTERISTIC
/begin CHARACTERISTIC C_ABC_INC_BN_POW_GEN "Anti - bounce counter increment BN2000 Diagnosis" VALUE 0x426bb _REC_VAL_20_u1 255. _CNV_A_R_LINEAR_____10_CM 0. 255. FORMAT "%3.0" /end CHARACTERISTIC
/begin CHARACTERISTIC C_ABC_INC_BN_MSW "Anti - bounce counter increment BN2000 Diagnosis" VALUE 0x426ba _REC_VAL_20_u1 255. _CNV_A_R_LINEAR_____10_CM 0. 255. FORMAT "%3.0" /end CHARACTERISTIC
/begin CHARACTERISTIC C_ABC_INC_BN_ANG_PSTE "Anti - bounce counter increment BN2000 Diagnosis" VALUE 0x426b4 _REC_VAL_20_u1 255. _CNV_A_R_LINEAR_____10_CM 0. 255. FORMAT "%3.0" /end CHARACTERISTIC
/begin CHARACTERISTIC C_ABC_MAX_BN_CAS "Maximum value of the anti - bounce counter BN2000 diagnosis" VALUE 0x4273d _REC_VAL_20_u1 254. _CNV_A_R_LINEAR_____10_CM 1. 255. FORMAT "%3.0" /end CHARACTERISTIC
/begin CHARACTERISTIC C_ABC_MAX_BN_TQ_TCS "Maximum value of the anti - bounce counter BN2000 diagnosis" VALUE 0x42749 _REC_VAL_20_u1 254. _CNV_A_R_LINEAR_____10_CM 1. 255. FORMAT "%3.0" /end CHARACTERISTIC
/begin CHARACTERISTIC C_ABC_MAX_BN_VS_TCS "Maximum value of the anti - bounce counter BN2000 diagnosis" VALUE 0x4274b _REC_VAL_20_u1 254. _CNV_A_R_LINEAR_____10_CM 1. 255. FORMAT "%3.0" /end CHARACTERISTIC
/begin CHARACTERISTIC C_ABC_MAX_BN_TCS "Maximum value of the anti - bounce counter BN2000 diagnosis" VALUE 0x42745 _REC_VAL_20_u1 254. _CNV_A_R_LINEAR_____10_CM 1. 255. FORMAT "%3.0" /end CHARACTERISTIC
/begin CHARACTERISTIC C_ABC_MAX_BN_TQ_ETCU "Maximum value of the anti - bounce counter BN2000 diagnosis" VALUE 0x42748 _REC_VAL_20_u1 254. _CNV_A_R_LINEAR_____10_CM 1. 255. FORMAT "%3.0" /end CHARACTERISTIC
/begin CHARACTERISTIC C_ABC_MAX_BN_ETCU "Maximum value of the anti - bounce counter BN2000 diagnosis" VALUE 0x4273e _REC_VAL_20_u1 254. _CNV_A_R_LINEAR_____10_CM 1. 255. FORMAT "%3.0" /end CHARACTERISTIC
/begin CHARACTERISTIC C_ABC_MAX_BN_TQ_AMT "Maximum value of the anti - bounce counter BN2000 diagnosis" VALUE 0x42746 _REC_VAL_20_u1 254. _CNV_A_R_LINEAR_____10_CM 1. 255. FORMAT "%3.0" /end CHARACTERISTIC
/begin CHARACTERISTIC C_ABC_MAX_BN_ACC "Maximum value of the anti - bounce counter BN2000 diagnosis" VALUE 0x4273a _REC_VAL_20_u1 254. _CNV_A_R_LINEAR_____10_CM 1. 255. FORMAT "%3.0" /end CHARACTERISTIC
/begin CHARACTERISTIC C_ABC_MAX_BN_T_ICL "Maximum value of the anti - bounce counter BN2000 diagnosis" VALUE 0x42744 _REC_VAL_20_u1 254. _CNV_A_R_LINEAR_____10_CM 1. 255. FORMAT "%3.0" /end CHARACTERISTIC
/begin CHARACTERISTIC C_ABC_MAX_BN_KM_ICL "Maximum value of the anti - bounce counter BN2000 diagnosis" VALUE 0x42740 _REC_VAL_20_u1 254. _CNV_A_R_LINEAR_____10_CM 1. 255. FORMAT "%3.0" /end CHARACTERISTIC
/begin CHARACTERISTIC C_ABC_MAX_BN_VEH_MOD "Maximum value of the anti - bounce counter BN2000 diagnosis" VALUE 0x4274a _REC_VAL_20_u1 254. _CNV_A_R_LINEAR_____10_CM 1. 255. FORMAT "%3.0" /end CHARACTERISTIC
/begin CHARACTERISTIC C_ABC_MAX_BN_ICL "Maximum value of the anti - bounce counter BN2000 diagnosis" VALUE 0x4273f _REC_VAL_20_u1 254. _CNV_A_R_LINEAR_____10_CM 1. 255. FORMAT "%3.0" /end CHARACTERISTIC
/begin CHARACTERISTIC C_ABC_MAX_BN_POW_VB "Maximum value of the anti - bounce counter BN2000 diagnosis" VALUE 0x42743 _REC_VAL_20_u1 254. _CNV_A_R_LINEAR_____10_CM 1. 255. FORMAT "%3.0" /end CHARACTERISTIC
/begin CHARACTERISTIC C_ABC_MAX_BN_POW_GEN "Maximum value of the anti - bounce counter BN2000 diagnosis" VALUE 0x42742 _REC_VAL_20_u1 254. _CNV_A_R_LINEAR_____10_CM 1. 255. FORMAT "%3.0" /end CHARACTERISTIC
/begin CHARACTERISTIC C_ABC_MAX_BN_MSW "Maximum value of the anti - bounce counter BN2000 diagnosis" VALUE 0x42741 _REC_VAL_20_u1 254. _CNV_A_R_LINEAR_____10_CM 1. 255. FORMAT "%3.0" /end CHARACTERISTIC
/begin CHARACTERISTIC C_ABC_MAX_BN_TQ_DCC "Maximum value of the anti - bounce counter BN2000 diagnosis" VALUE 0x42747 _REC_VAL_20_u1 254. _CNV_A_R_LINEAR_____10_CM 1. 255. FORMAT "%3.0" /end CHARACTERISTIC
/begin CHARACTERISTIC C_ABC_MAX_BN_ANG_PSTE "Maximum value of the anti - bounce counter BN2000 diagnosis" VALUE 0x4273b _REC_VAL_20_u1 254. _CNV_A_R_LINEAR_____10_CM 1. 255. FORMAT "%3.0" /end CHARACTERISTIC
/begin CHARACTERISTIC C_CTR_DIAG_TCC_CAN_MAX_ARS "Maximum number of wrong ATCC_CAN count events before error detection of BN2000 message" VALUE 0x42850 _REC_VAL_20_u1 255. _CNV_A_R_LINEAR_____10_CM 0. 255. FORMAT "%3.0" /end CHARACTERISTIC
/begin CHARACTERISTIC C_CTR_DIAG_TCC_CAN_MAX_CAS "Maximum number of wrong ATCC_CAN count events before error detection of BN2000 message" VALUE 0x42851 _REC_VAL_20_u1 255. _CNV_A_R_LINEAR_____10_CM 0. 255. FORMAT "%3.0" /end CHARACTERISTIC
/begin CHARACTERISTIC C_CTR_DIAG_TCC_CAN_MAX_TQ_TCS "Maximum number of wrong ATCC_CAN count events before error detection of BN2000 message" VALUE 0x42857 _REC_VAL_20_u1 255. _CNV_A_R_LINEAR_____10_CM 0. 255. FORMAT "%3.0" /end CHARACTERISTIC
/begin CHARACTERISTIC C_CTR_DIAG_TCC_CAN_MAX_TQ_ETCU "Maximum number of wrong ATCC_CAN count events before error detection of BN2000 message" VALUE 0x42856 _REC_VAL_20_u1 255. _CNV_A_R_LINEAR_____10_CM 0. 255. FORMAT "%3.0" /end CHARACTERISTIC
/begin CHARACTERISTIC C_CTR_DIAG_TCC_CAN_MAX_TQ_AMT "Maximum number of wrong ATCC_CAN count events before error detection of BN2000 message" VALUE 0x42854 _REC_VAL_20_u1 255. _CNV_A_R_LINEAR_____10_CM 0. 255. FORMAT "%3.0" /end CHARACTERISTIC
/begin CHARACTERISTIC C_CTR_DIAG_TCC_CAN_MAX_VEH_MOD "Maximum number of wrong ATCC_CAN count events before error detection of BN2000 message" VALUE 0x42858 _REC_VAL_20_u1 255. _CNV_A_R_LINEAR_____10_CM 0. 255. FORMAT "%3.0" /end CHARACTERISTIC
/begin CHARACTERISTIC C_CTR_DIAG_TCC_CAN_MAX_ICL "Maximum number of wrong ATCC_CAN count events before error detection of BN2000 message" VALUE 0x42852 _REC_VAL_20_u1 255. _CNV_A_R_LINEAR_____10_CM 0. 255. FORMAT "%3.0" /end CHARACTERISTIC
/begin CHARACTERISTIC C_CTR_DIAG_TCC_CAN_MAX_MSW "Maximum number of wrong ATCC_CAN count events before error detection of BN2000 message" VALUE 0x42853 _REC_VAL_20_u1 255. _CNV_A_R_LINEAR_____10_CM 0. 255. FORMAT "%3.0" /end CHARACTERISTIC
/begin CHARACTERISTIC C_CTR_DIAG_TCC_CAN_MAX_TQ_DCC "Maximum number of wrong ATCC_CAN count events before error detection of BN2000 message" VALUE 0x42855 _REC_VAL_20_u1 255. _CNV_A_R_LINEAR_____10_CM 0. 255. FORMAT "%3.0" /end CHARACTERISTIC
/begin CHARACTERISTIC C_CTR_DIAG_CKS_MAX_CAS "Maximum number of wrong checksum calculation events before error detection of BN2000 message" VALUE 0x42847 _REC_VAL_20_u1 255. _CNV_A_R_LINEAR_____10_CM 0. 255. FORMAT "%3.0" /end CHARACTERISTIC
/begin CHARACTERISTIC C_CTR_DIAG_CKS_MAX_TQ_TCS "Maximum number of wrong checksum calculation events before error detection of BN2000 message" VALUE 0x4284c _REC_VAL_20_u1 255. _CNV_A_R_LINEAR_____10_CM 0. 255. FORMAT "%3.0" /end CHARACTERISTIC
/begin CHARACTERISTIC C_CTR_DIAG_CKS_MAX_TQ_ETCU "Maximum number of wrong checksum calculation events before error detection of BN2000 message" VALUE 0x4284b _REC_VAL_20_u1 255. _CNV_A_R_LINEAR_____10_CM 0. 255. FORMAT "%3.0" /end CHARACTERISTIC
/begin CHARACTERISTIC C_CTR_DIAG_CKS_MAX_TQ_AMT "Maximum number of wrong checksum calculation events before error detection of BN2000 message" VALUE 0x42849 _REC_VAL_20_u1 255. _CNV_A_R_LINEAR_____10_CM 0. 255. FORMAT "%3.0" /end CHARACTERISTIC
/begin CHARACTERISTIC C_CTR_DIAG_CKS_MAX_VEH_MOD "Maximum number of wrong checksum calculation events before error detection of BN2000 message" VALUE 0x4284d _REC_VAL_20_u1 255. _CNV_A_R_LINEAR_____10_CM 0. 255. FORMAT "%3.0" /end CHARACTERISTIC
/begin CHARACTERISTIC C_CTR_DIAG_CKS_MAX_MSW "Maximum number of wrong checksum calculation events before error detection of BN2000 message" VALUE 0x42848 _REC_VAL_20_u1 255. _CNV_A_R_LINEAR_____10_CM 0. 255. FORMAT "%3.0" /end CHARACTERISTIC
/begin CHARACTERISTIC C_CTR_DIAG_CKS_MAX_TQ_DCC "Maximum number of wrong checksum calculation events before error detection of BN2000 message" VALUE 0x4284a _REC_VAL_20_u1 255. _CNV_A_R_LINEAR_____10_CM 0. 255. FORMAT "%3.0" /end CHARACTERISTIC
/begin CHARACTERISTIC C_CTR_DIAG_TOUT_MAX_ARS "Maximum number of missing message events before error detection of BN2000 message" VALUE 0x4285b _REC_VAL_20_u1 255. _CNV_A_R_LINEAR_____10_CM 0. 255. FORMAT "%3.0" /end CHARACTERISTIC
/begin CHARACTERISTIC C_CTR_DIAG_TOUT_MAX_CAS "Maximum number of missing message events before error detection of BN2000 message" VALUE 0x4285c _REC_VAL_20_u1 255. _CNV_A_R_LINEAR_____10_CM 0. 255. FORMAT "%3.0" /end CHARACTERISTIC
/begin CHARACTERISTIC C_CTR_DIAG_TOUT_MAX_TQ_TCS "Maximum number of missing message events before error detection of BN2000 message" VALUE 0x42868 _REC_VAL_20_u1 255. _CNV_A_R_LINEAR_____10_CM 0. 255. FORMAT "%3.0" /end CHARACTERISTIC
/begin CHARACTERISTIC C_CTR_DIAG_TOUT_MAX_VS_TCS "Maximum number of missing message events before error detection of BN2000 message" VALUE 0x4286a _REC_VAL_20_u1 255. _CNV_A_R_LINEAR_____10_CM 0. 255. FORMAT "%3.0" /end CHARACTERISTIC
/begin CHARACTERISTIC C_CTR_DIAG_TOUT_MAX_TCS "Maximum number of missing message events before error detection of BN2000 message" VALUE 0x42864 _REC_VAL_20_u1 255. _CNV_A_R_LINEAR_____10_CM 0. 255. FORMAT "%3.0" /end CHARACTERISTIC
/begin CHARACTERISTIC C_CTR_DIAG_TOUT_MAX_TQ_ETCU "Maximum number of missing message events before error detection of BN2000 message" VALUE 0x42867 _REC_VAL_20_u1 255. _CNV_A_R_LINEAR_____10_CM 0. 255. FORMAT "%3.0" /end CHARACTERISTIC
/begin CHARACTERISTIC C_CTR_DIAG_TOUT_MAX_TQ_DCC "Maximum number of missing message events before error detection of BN2000 message" VALUE 0x42866 _REC_VAL_20_u1 255. _CNV_A_R_LINEAR_____10_CM 0. 255. FORMAT "%3.0" /end CHARACTERISTIC
/begin CHARACTERISTIC C_CTR_DIAG_TOUT_MAX_TQ_AMT "Maximum number of missing message events before error detection of BN2000 message" VALUE 0x42865 _REC_VAL_20_u1 255. _CNV_A_R_LINEAR_____10_CM 0. 255. FORMAT "%3.0" /end CHARACTERISTIC
/begin CHARACTERISTIC C_CTR_DIAG_TOUT_MAX_ACC "Maximum number of missing message events before error detection of BN2000 message" VALUE 0x42859 _REC_VAL_20_u1 255. _CNV_A_R_LINEAR_____10_CM 0. 255. FORMAT "%3.0" /end CHARACTERISTIC
/begin CHARACTERISTIC C_CTR_DIAG_TOUT_MAX_T_ICL "Maximum number of missing message events before error detection of BN2000 message" VALUE 0x42863 _REC_VAL_20_u1 255. _CNV_A_R_LINEAR_____10_CM 0. 255. FORMAT "%3.0" /end CHARACTERISTIC
/begin CHARACTERISTIC C_CTR_DIAG_TOUT_MAX_VEH_MOD "Maximum number of missing message events before error detection of BN2000 message" VALUE 0x42869 _REC_VAL_20_u1 255. _CNV_A_R_LINEAR_____10_CM 0. 255. FORMAT "%3.0" /end CHARACTERISTIC
/begin CHARACTERISTIC C_CTR_DIAG_TOUT_MAX_KM_ICL "Maximum number of missing message events before error detection of BN2000 message" VALUE 0x4285f _REC_VAL_20_u1 255. _CNV_A_R_LINEAR_____10_CM 0. 255. FORMAT "%3.0" /end CHARACTERISTIC
/begin CHARACTERISTIC C_CTR_DIAG_TOUT_MAX_ICL "Maximum number of missing message events before error detection of BN2000 message" VALUE 0x4285e _REC_VAL_20_u1 255. _CNV_A_R_LINEAR_____10_CM 0. 255. FORMAT "%3.0" /end CHARACTERISTIC
/begin CHARACTERISTIC C_CTR_DIAG_TOUT_MAX_POW_VB "Maximum number of missing message events before error detection of BN2000 message" VALUE 0x42862 _REC_VAL_20_u1 255. _CNV_A_R_LINEAR_____10_CM 0. 255. FORMAT "%3.0" /end CHARACTERISTIC
/begin CHARACTERISTIC C_CTR_DIAG_TOUT_MAX_POW_GEN "Maximum number of missing message events before error detection of BN2000 message" VALUE 0x42861 _REC_VAL_20_u1 255. _CNV_A_R_LINEAR_____10_CM 0. 255. FORMAT "%3.0" /end CHARACTERISTIC
/begin CHARACTERISTIC C_CTR_DIAG_TOUT_MAX_MSW "Maximum number of missing message events before error detection of BN2000 message" VALUE 0x42860 _REC_VAL_20_u1 255. _CNV_A_R_LINEAR_____10_CM 0. 255. FORMAT "%3.0" /end CHARACTERISTIC
/begin CHARACTERISTIC C_CTR_DIAG_TOUT_MAX_ETCU "Maximum number of missing message events before error detection of BN2000 message" VALUE 0x4285d _REC_VAL_20_u1 255. _CNV_A_R_LINEAR_____10_CM 0. 255. FORMAT "%3.0" /end CHARACTERISTIC
/begin CHARACTERISTIC C_CTR_DIAG_TOUT_MAX_ANG_PSTE "Maximum number of missing message events before error detection of BN2000 message" VALUE 0x4285a _REC_VAL_20_u1 255. _CNV_A_R_LINEAR_____10_CM 0. 255. FORMAT "%3.0" /end CHARACTERISTIC
/begin CHARACTERISTIC C_ABC_MAX_BN_ARS "Maximum value of the anti - bounce counter BN2000 diagnosis" VALUE 0x4273c _REC_VAL_20_u1 254. _CNV_A_R_LINEAR_____10_CM 1. 255. FORMAT "%3.0" /end CHARACTERISTIC
/begin CHARACTERISTIC C_ABC_INC_BN_ARS "Anti - bounce counter increment BN2000 Diagnosis" VALUE 0x426b5 _REC_VAL_20_u1 255. _CNV_A_R_LINEAR_____10_CM 0. 255. FORMAT "%3.0" /end CHARACTERISTIC
/begin CHARACTERISTIC C_ABC_DEC_BN_TQ_DCC "Anti - bounce counter increment BN2000 Diagnosis" VALUE 0x426ab _REC_VAL_20_u1 255. _CNV_A_R_LINEAR_____10_CM 0. 255. FORMAT "%3.0" /end CHARACTERISTIC
/begin CHARACTERISTIC C_ABC_DEC_BN_ARS "Anti - bounce counter increment BN2000 Diagnosis" VALUE 0x426a0 _REC_VAL_20_u1 255. _CNV_A_R_LINEAR_____10_CM 0. 255. FORMAT "%3.0" /end CHARACTERISTIC
/begin CHARACTERISTIC C_ABC_DEC_BN_CAS "Anti - bounce counter increment BN2000 Diagnosis" VALUE 0x426a1 _REC_VAL_20_u1 255. _CNV_A_R_LINEAR_____10_CM 0. 255. FORMAT "%3.0" /end CHARACTERISTIC
/begin CHARACTERISTIC C_ABC_DEC_BN_TQ_TCS "Anti - bounce counter increment BN2000 Diagnosis" VALUE 0x426ad _REC_VAL_20_u1 255. _CNV_A_R_LINEAR_____10_CM 0. 255. FORMAT "%3.0" /end CHARACTERISTIC
/begin CHARACTERISTIC C_ABC_DEC_BN_VS_TCS "Anti - bounce counter increment BN2000 Diagnosis" VALUE 0x426af _REC_VAL_20_u1 255. _CNV_A_R_LINEAR_____10_CM 0. 255. FORMAT "%3.0" /end CHARACTERISTIC
/begin CHARACTERISTIC C_ABC_DEC_BN_TCS "Anti - bounce counter increment BN2000 Diagnosis" VALUE 0x426a9 _REC_VAL_20_u1 255. _CNV_A_R_LINEAR_____10_CM 0. 255. FORMAT "%3.0" /end CHARACTERISTIC
/begin CHARACTERISTIC C_ABC_DEC_BN_TQ_ETCU "Anti - bounce counter increment BN2000 Diagnosis" VALUE 0x426ac _REC_VAL_20_u1 255. _CNV_A_R_LINEAR_____10_CM 0. 255. FORMAT "%3.0" /end CHARACTERISTIC
/begin CHARACTERISTIC C_ABC_DEC_BN_ETCU "Anti - bounce counter increment BN2000 Diagnosis" VALUE 0x426a2 _REC_VAL_20_u1 255. _CNV_A_R_LINEAR_____10_CM 0. 255. FORMAT "%3.0" /end CHARACTERISTIC
/begin CHARACTERISTIC C_ABC_DEC_BN_TQ_AMT "Anti - bounce counter increment BN2000 Diagnosis" VALUE 0x426aa _REC_VAL_20_u1 255. _CNV_A_R_LINEAR_____10_CM 0. 255. FORMAT "%3.0" /end CHARACTERISTIC
/begin CHARACTERISTIC C_ABC_DEC_BN_ACC "Anti - bounce counter increment BN2000 Diagnosis" VALUE 0x4269e _REC_VAL_20_u1 255. _CNV_A_R_LINEAR_____10_CM 0. 255. FORMAT "%3.0" /end CHARACTERISTIC
/begin CHARACTERISTIC C_ABC_DEC_BN_ICL "Anti - bounce counter increment BN2000 Diagnosis" VALUE 0x426a3 _REC_VAL_20_u1 255. _CNV_A_R_LINEAR_____10_CM 0. 255. FORMAT "%3.0" /end CHARACTERISTIC
/begin CHARACTERISTIC C_ABC_DEC_BN_KM_ICL "Anti - bounce counter increment BN2000 Diagnosis" VALUE 0x426a4 _REC_VAL_20_u1 255. _CNV_A_R_LINEAR_____10_CM 0. 255. FORMAT "%3.0" /end CHARACTERISTIC
/begin CHARACTERISTIC C_ABC_DEC_BN_T_ICL "Anti - bounce counter increment BN2000 Diagnosis" VALUE 0x426a8 _REC_VAL_20_u1 255. _CNV_A_R_LINEAR_____10_CM 0. 255. FORMAT "%3.0" /end CHARACTERISTIC
/begin CHARACTERISTIC C_ABC_DEC_BN_POW_VB "Anti - bounce counter increment BN2000 Diagnosis" VALUE 0x426a7 _REC_VAL_20_u1 255. _CNV_A_R_LINEAR_____10_CM 0. 255. FORMAT "%3.0" /end CHARACTERISTIC
/begin CHARACTERISTIC C_ABC_DEC_BN_POW_GEN "Anti - bounce counter increment BN2000 Diagnosis" VALUE 0x426a6 _REC_VAL_20_u1 255. _CNV_A_R_LINEAR_____10_CM 0. 255. FORMAT "%3.0" /end CHARACTERISTIC
/begin CHARACTERISTIC C_ABC_DEC_BN_MSW "Anti - bounce counter increment BN2000 Diagnosis" VALUE 0x426a5 _REC_VAL_20_u1 255. _CNV_A_R_LINEAR_____10_CM 0. 255. FORMAT "%3.0" /end CHARACTERISTIC
/begin CHARACTERISTIC C_ABC_DEC_BN_ANG_PSTE "Anti - bounce counter increment BN2000 Diagnosis" VALUE 0x4269f _REC_VAL_20_u1 255. _CNV_A_R_LINEAR_____10_CM 0. 255. FORMAT "%3.0" /end CHARACTERISTIC
/begin CHARACTERISTIC C_ABC_DEC_BN_VEH_MOD "Anti - bounce counter increment BN2000 Diagnosis" VALUE 0x426ae _REC_VAL_20_u1 255. _CNV_A_R_LINEAR_____10_CM 0. 255. FORMAT "%3.0" /end CHARACTERISTIC
/begin CHARACTERISTIC C_ABC_INC_BSD "Anti - bounce counter increment" VALUE 0x426c5 _REC_VAL_20_u1 255. _CNV_A_R_LINEAR_____10_CM 0. 255. FORMAT "%3.0" /end CHARACTERISTIC
/begin CHARACTERISTIC C_ABC_MAX_BSD "Debounce counter maximum value" VALUE 0x4274c _REC_VAL_20_u1 254. _CNV_A_R_LINEAR_____10_CM 1. 255. FORMAT "%3.0" /end CHARACTERISTIC
/begin CHARACTERISTIC C_ABC_INC_CAM_PER_0 "anti-bounce counter increment for CAM_0 camshaft period error diagnosis" VALUE 0x426c6 _REC_VAL_20_u1 255. _CNV_A_R_LINEAR_____10_CM 0. 255. FORMAT "%3.0" /end CHARACTERISTIC
/begin CHARACTERISTIC C_ABC_INC_CAM_PER_1 "anti-bounce counter increment for CAM_1 camshaft period error diagnosis" VALUE 0x426c7 _REC_VAL_20_u1 255. _CNV_A_R_LINEAR_____10_CM 0. 255. FORMAT "%3.0" /end CHARACTERISTIC
/begin CHARACTERISTIC C_ABC_MAX_CAM_PER_1 "maximum value of the anti-bounce counter for CAM_1 camshaft period error diagnosis" VALUE 0x4274e _REC_VAL_20_u1 254. _CNV_A_R_LINEAR_____10_CM 1. 255. FORMAT "%3.0" /end CHARACTERISTIC
/begin CHARACTERISTIC C_ABC_MAX_CAM_PER_0 "maximum value of the anti-bounce counter for CAM_0 camshaft period error diagnosis" VALUE 0x4274d _REC_VAL_20_u1 254. _CNV_A_R_LINEAR_____10_CM 1. 255. FORMAT "%3.0" /end CHARACTERISTIC
/begin CHARACTERISTIC C_ABC_INC_CAM_PSN_1 "anti-bounce counter increment for CAM_1 camshaft position diagnosis" VALUE 0x426c9 _REC_VAL_20_u1 255. _CNV_A_R_LINEAR_____10_CM 0. 255. FORMAT "%3.0" /end CHARACTERISTIC
/begin CHARACTERISTIC C_ABC_MAX_CAM_PSN_0 "maximum value of the anti-bounce counter for CAM_0 camshaft position diagnosis" VALUE 0x4274f _REC_VAL_20_u1 254. _CNV_A_R_LINEAR_____10_CM 1. 255. FORMAT "%3.0" /end CHARACTERISTIC
/begin CHARACTERISTIC C_ABC_MAX_CAM_PSN_1 "maximum value of the anti-bounce counter for CAM_1 camshaft position diagnosis" VALUE 0x42750 _REC_VAL_20_u1 254. _CNV_A_R_LINEAR_____10_CM 1. 255. FORMAT "%3.0" /end CHARACTERISTIC
/begin CHARACTERISTIC C_ABC_INC_CAM_PSN_0 "anti-bounce counter increment for CAM_0 camshaft position diagnosis" VALUE 0x426c8 _REC_VAL_20_u1 255. _CNV_A_R_LINEAR_____10_CM 0. 255. FORMAT "%3.0" /end CHARACTERISTIC
/begin CHARACTERISTIC C_ABC_INC_TOUT_ASR_3 "anti bounce counter increment  - diagnosis of timeout CAN message ASC3" VALUE 0x42714 _REC_VAL_20_u1 255. _CNV_A_R_LINEAR_____10_CM 0. 255. FORMAT "%3.0" /end CHARACTERISTIC
/begin CHARACTERISTIC C_ABC_MAX_TOUT_ASR_3 "anti bounce counter maximum value  - diagnosis of timeout CAN message ASC3 " VALUE 0x42798 _REC_VAL_20_u1 254. _CNV_A_R_LINEAR_____10_CM 1. 255. FORMAT "%3.0" /end CHARACTERISTIC
/begin CHARACTERISTIC C_ABC_INC_CAN_BOFF "anti bounce counter increment  - diagnosis of CAN bus on / off" VALUE 0x426ca _REC_VAL_20_u1 255. _CNV_A_R_LINEAR_____10_CM 0. 255. FORMAT "%3.0" /end CHARACTERISTIC
/begin CHARACTERISTIC C_ABC_MAX_CAN_BOFF "anti bounce counter maximum value  - diagnosis of CAN bus on / off" VALUE 0x42751 _REC_VAL_20_u1 254. _CNV_A_R_LINEAR_____10_CM 1. 255. FORMAT "%3.0" /end CHARACTERISTIC
/begin CHARACTERISTIC C_ABC_INC_TOUT_ASR_1 "anti bounce counter increment  - diagnosis of timeout CAN message ASC1" VALUE 0x42713 _REC_VAL_20_u1 255. _CNV_A_R_LINEAR_____10_CM 0. 255. FORMAT "%3.0" /end CHARACTERISTIC
/begin CHARACTERISTIC C_ABC_MAX_TOUT_ASR_1 "anti bounce counter maximum value  - diagnosis of timeout CAN message ASC1 " VALUE 0x42797 _REC_VAL_20_u1 254. _CNV_A_R_LINEAR_____10_CM 1. 255. FORMAT "%3.0" /end CHARACTERISTIC
/begin CHARACTERISTIC C_ABC_INC_TOUT_EFP "anti bounce counter increment  - diagnosis of timeout CAN message EFP" VALUE 0x42715 _REC_VAL_20_u1 255. _CNV_A_R_LINEAR_____10_CM 0. 255. FORMAT "%3.0" /end CHARACTERISTIC
/begin CHARACTERISTIC C_ABC_MAX_TOUT_EFP "anti bounce counter maximum value  - diagnosis of timeout CAN message EFP" VALUE 0x42799 _REC_VAL_20_u1 254. _CNV_A_R_LINEAR_____10_CM 1. 255. FORMAT "%3.0" /end CHARACTERISTIC
/begin CHARACTERISTIC C_ABC_INC_LOCAN_BOFF "Debounce counter increment - diagnosis of LOCAN bus on / off" VALUE 0x426ed _REC_VAL_20_u1 255. _CNV_A_R_LINEAR_____10_CM 0. 255. FORMAT "%3.0" /end CHARACTERISTIC
/begin CHARACTERISTIC C_ABC_MAX_LOCAN_BOFF "debounce counter maximum value - diagnosis of LOCAN bus on / off" VALUE 0x42772 _REC_VAL_20_u1 254. _CNV_A_R_LINEAR_____10_CM 1. 255. FORMAT "%3.0" /end CHARACTERISTIC
/begin CHARACTERISTIC C_ABC_INC_TOUT_ETCU_1 "anti bounce counter increment  - diagnosis of timeout CAN message EGS1" VALUE 0x42716 _REC_VAL_20_u1 255. _CNV_A_R_LINEAR_____10_CM 0. 255. FORMAT "%3.0" /end CHARACTERISTIC
/begin CHARACTERISTIC C_ABC_INC_TOUT_ETCU_2 "anti bounce counter increment  - diagnosis of timeout CAN message EGS2" VALUE 0x42717 _REC_VAL_20_u1 255. _CNV_A_R_LINEAR_____10_CM 0. 255. FORMAT "%3.0" /end CHARACTERISTIC
/begin CHARACTERISTIC C_ABC_MAX_TOUT_ETCU_1 "anti bounce counter maximum value  - diagnosis of timeout CAN message EGS1 " VALUE 0x4279a _REC_VAL_20_u1 254. _CNV_A_R_LINEAR_____10_CM 1. 255. FORMAT "%3.0" /end CHARACTERISTIC
/begin CHARACTERISTIC C_ABC_MAX_TOUT_ETCU_2 "anti bounce counter maximum value  - diagnosis of timeout CAN message EGS2" VALUE 0x4279b _REC_VAL_20_u1 254. _CNV_A_R_LINEAR_____10_CM 1. 255. FORMAT "%3.0" /end CHARACTERISTIC
/begin CHARACTERISTIC C_ABC_INC_TOUT_ICL_2_ "anti bounce counter increment  - diagnosis of timeout CAN message INSTR2" VALUE 0x42718 _REC_VAL_20_u1 255. _CNV_A_R_LINEAR_____10_CM 0. 255. FORMAT "%3.0" /end CHARACTERISTIC
/begin CHARACTERISTIC C_ABC_MAX_TOUT_ICL_2 "anti bounce counter maximum value  - diagnosis of timeout CAN message INSTR2" VALUE 0x4279c _REC_VAL_20_u1 254. _CNV_A_R_LINEAR_____10_CM 1. 255. FORMAT "%3.0" /end CHARACTERISTIC
/begin CHARACTERISTIC C_ABC_INC_TOUT_ICL_3_ "anti bounce counter increment  - diagnosis of timeout CAN message INSTR3" VALUE 0x42719 _REC_VAL_20_u1 255. _CNV_A_R_LINEAR_____10_CM 0. 255. FORMAT "%3.0" /end CHARACTERISTIC
/begin CHARACTERISTIC C_ABC_MAX_TOUT_ICL_3 "anti bounce counter maximum value  - diagnosis of timeout CAN message INSTR3" VALUE 0x4279d _REC_VAL_20_u1 254. _CNV_A_R_LINEAR_____10_CM 1. 255. FORMAT "%3.0" /end CHARACTERISTIC
/begin CHARACTERISTIC C_ABC_INC_TOUT_PSTE_1 "anti bounce counter increment  - diagnosis of timeout CAN message EGS2" VALUE 0x4271b _REC_VAL_20_u1 255. _CNV_A_R_LINEAR_____10_CM 0. 255. FORMAT "%3.0" /end CHARACTERISTIC
/begin CHARACTERISTIC C_ABC_MAX_TOUT_PSTE_1 "anti bounce counter maximum value  - diagnosis of timeout CAN message LWS1" VALUE 0x4279f _REC_VAL_20_u1 254. _CNV_A_R_LINEAR_____10_CM 1. 255. FORMAT "%3.0" /end CHARACTERISTIC
/begin CHARACTERISTIC C_ABC_INC_TOUT_AMT_1 "anti bounce counter increment  - diagnosis of timeout CAN message SSG1" VALUE 0x42712 _REC_VAL_20_u1 255. _CNV_A_R_LINEAR_____10_CM 0. 255. FORMAT "%3.0" /end CHARACTERISTIC
/begin CHARACTERISTIC C_ABC_MAX_TOUT_AMT_1 "anti bounce counter maximum value  - diagnosis of timeout CAN message SSG1 " VALUE 0x42796 _REC_VAL_20_u1 254. _CNV_A_R_LINEAR_____10_CM 1. 255. FORMAT "%3.0" /end CHARACTERISTIC
/begin CHARACTERISTIC C_ABC_INC_TOUT_TXU_1 "anti bounce counter increment  - diagnosis of timeout CAN message TXU1" VALUE 0x4271c _REC_VAL_20_u1 255. _CNV_A_R_LINEAR_____10_CM 0. 255. FORMAT "%3.0" /end CHARACTERISTIC
/begin CHARACTERISTIC C_ABC_MAX_TOUT_TXU_1 "anti bounce counter maximum value  - diagnosis of timeout CAN message TXU1" VALUE 0x427a0 _REC_VAL_20_u1 254. _CNV_A_R_LINEAR_____10_CM 1. 255. FORMAT "%3.0" /end CHARACTERISTIC
/begin CHARACTERISTIC C_ABC_INC_ENG_PSN_PREV_SYN "anti-bounce counter increment engine position error previous engine synchronization" VALUE 0x426dd _REC_VAL_20_u1 255. _CNV_A_R_LINEAR_____10_CM 0. 255. FORMAT "%3.0" /end CHARACTERISTIC
/begin CHARACTERISTIC C_ABC_INC_ENG_PSN_DUR_ST "anti-bounce counter increment engine position error during start" VALUE 0x426dc _REC_VAL_20_u1 255. _CNV_A_R_LINEAR_____10_CM 0. 255. FORMAT "%3.0" /end CHARACTERISTIC
/begin CHARACTERISTIC C_ABC_MAX_ENG_PSN "maximum value of the anti-bounce counter for engine position error" VALUE 0x42762 _REC_VAL_20_u1 254. _CNV_A_R_LINEAR_____10_CM 1. 255. FORMAT "%3.0" /end CHARACTERISTIC
/begin CHARACTERISTIC C_ABC_INC_ENG_PSN_AST "anti-bounce counter increment engine position error after start" VALUE 0x426db _REC_VAL_20_u1 255. _CNV_A_R_LINEAR_____10_CM 0. 255. FORMAT "%3.0" /end CHARACTERISTIC
/begin CHARACTERISTIC C_ABC_INC_TOOTH_PER_PREV_SYN "anti-bounce counter increment tooth period error previous engine synchronization" VALUE 0x42711 _REC_VAL_20_u1 255. _CNV_A_R_LINEAR_____10_CM 0. 255. FORMAT "%3.0" /end CHARACTERISTIC
/begin CHARACTERISTIC C_ABC_INC_TOOTH_PER_AST "anti-bounce counter increment tooth period error after start" VALUE 0x4270f _REC_VAL_20_u1 255. _CNV_A_R_LINEAR_____10_CM 0. 255. FORMAT "%3.0" /end CHARACTERISTIC
/begin CHARACTERISTIC C_ABC_MAX_TOOTH_PER "maximum value of the anti-bounce counter for tooth period error" VALUE 0x42795 _REC_VAL_20_u1 254. _CNV_A_R_LINEAR_____10_CM 1. 255. FORMAT "%3.0" /end CHARACTERISTIC
/begin CHARACTERISTIC C_ABC_INC_TOOTH_PER_DUR_ST "anti-bounce counter increment tooth period error during start" VALUE 0x42710 _REC_VAL_20_u1 255. _CNV_A_R_LINEAR_____10_CM 0. 255. FORMAT "%3.0" /end CHARACTERISTIC
/begin CHARACTERISTIC C_ABC_INC_TPU_SYN_PREV_SYN "anti-bounce counter increment TPU synchronization error previous engine synchronization" VALUE 0x42722 _REC_VAL_20_u1 255. _CNV_A_R_LINEAR_____10_CM 0. 255. FORMAT "%3.0" /end CHARACTERISTIC
/begin CHARACTERISTIC C_ABC_INC_TPU_SYN_DUR_ST "anti-bounce counter increment TPU synchronization error during start" VALUE 0x42721 _REC_VAL_20_u1 255. _CNV_A_R_LINEAR_____10_CM 0. 255. FORMAT "%3.0" /end CHARACTERISTIC
/begin CHARACTERISTIC C_ABC_MAX_TPU_SYN "maximum value of the anti-bounce counter for TPU synchronization error" VALUE 0x427a4 _REC_VAL_20_u1 254. _CNV_A_R_LINEAR_____10_CM 1. 255. FORMAT "%3.0" /end CHARACTERISTIC
/begin CHARACTERISTIC C_ABC_INC_TPU_SYN_AST "anti-bounce counter increment TPU synchronization error after start" VALUE 0x42720 _REC_VAL_20_u1 255. _CNV_A_R_LINEAR_____10_CM 0. 255. FORMAT "%3.0" /end CHARACTERISTIC
/begin CHARACTERISTIC C_ABC_INC_CRK_NOT_PLAUS "Anti bounce counter increment crankshaft sensor signal not plausible" VALUE 0x426cc _REC_VAL_20_u1 255. _CNV_A_R_LINEAR_____10_CM 0. 255. FORMAT "%3.0" /end CHARACTERISTIC
/begin CHARACTERISTIC C_ABC_MAX_CRK_NOT_PLAUS "Maximum of anti bounce counter sensor signal not plausible" VALUE 0x42753 _REC_VAL_20_u1 254. _CNV_A_R_LINEAR_____10_CM 1. 255. FORMAT "%3.0" /end CHARACTERISTIC
/begin CHARACTERISTIC C_ABC_INC_DCC_REV "Increment counter" VALUE 0x426d0 _REC_VAL_20_u1 255. _CNV_A_R_LINEAR_____10_CM 0. 255. FORMAT "%3.0" /end CHARACTERISTIC
/begin CHARACTERISTIC C_ABC_MAX_DCC_IRREV "Maximum counter" VALUE 0x42755 _REC_VAL_20_u1 254. _CNV_A_R_LINEAR_____10_CM 1. 255. FORMAT "%3.0" /end CHARACTERISTIC
/begin CHARACTERISTIC C_ABC_INC_DCC_IRREV "Increment counter" VALUE 0x426ce _REC_VAL_20_u1 255. _CNV_A_R_LINEAR_____10_CM 0. 255. FORMAT "%3.0" /end CHARACTERISTIC
/begin CHARACTERISTIC C_ABC_MAX_DCC_REV "Maximum counter" VALUE 0x42757 _REC_VAL_20_u1 254. _CNV_A_R_LINEAR_____10_CM 1. 255. FORMAT "%3.0" /end CHARACTERISTIC
/begin CHARACTERISTIC C_ABC_INC_DMTL_PUMP "Anti - bounce counter increment" VALUE 0x426d2 _REC_VAL_20_u1 255. _CNV_A_R_LINEAR_____10_CM 0. 255. FORMAT "%3.0" /end CHARACTERISTIC
/begin CHARACTERISTIC C_ABC_INC_ECT_MEC "Debounce counter increment - Thermostat heating diagnosis" VALUE 0x426d9 _REC_VAL_20_u1 255. _CNV_A_R_LINEAR_____10_CM 0. 255. FORMAT "%3.0" /end CHARACTERISTIC
/begin CHARACTERISTIC C_ABC_MAX_ECT_MEC "Debounce counter maximum value - Thermostat heating diagnosis" VALUE 0x42760 _REC_VAL_20_u1 254. _CNV_A_R_LINEAR_____10_CM 1. 255. FORMAT "%3.0" /end CHARACTERISTIC
/begin CHARACTERISTIC LC_ABC_BENCH "logical constant to manage the anti-bounce bench mode" VALUE 0x42b42 _REC_VAL_20_u1 1. _CNV_A_R_LINEAR_____10_CM 0. 1. FORMAT "%2.0" /end CHARACTERISTIC
/begin MEASUREMENT LV_ERR_MEM_TPS_1 "" UBYTE _CNV_S_2_RANGE______21_R_CM 1 100. 0. 255. ECU_ADDRESS 0x3fd450 BIT_MASK 0x80 /end MEASUREMENT
/begin MEASUREMENT CTR_ABC_END_DIAG_TPS_1 "" UBYTE _CNV_A_R_LINEAR_____12_CM 1 100. 0. 255. ECU_ADDRESS 0x3fd451 FORMAT "%3.0" /end MEASUREMENT
/begin MEASUREMENT CTR_ABC_TPS_2 "" UBYTE _CNV_A_R_LINEAR_____10_CM 1 100. 0. 255. ECU_ADDRESS 0x3fd456 FORMAT "%3.0" /end MEASUREMENT
/begin MEASUREMENT LV_CDN_DIAG_TPS_2 "" UBYTE _CNV_S_2_RANGE______21_R_CM 1 100. 0. 255. ECU_ADDRESS 0x3fd454 BIT_MASK 0x10 /end MEASUREMENT
/begin MEASUREMENT LV_END_DIAG_TPS_2 "" UBYTE _CNV_S_2_RANGE______21_R_CM 1 100. 0. 255. ECU_ADDRESS 0x3fd454 BIT_MASK 0x20 /end MEASUREMENT
/begin MEASUREMENT LV_READY_TPS_2 "" UBYTE _CNV_S_2_RANGE______21_R_CM 1 100. 0. 255. ECU_ADDRESS 0x3fd454 BIT_MASK 0x40 /end MEASUREMENT
/begin MEASUREMENT ERR_SYM_TPS_2 "" UBYTE _CNV_S_6_RANGE_ERR__22_CM 1 100. 0. 15. ECU_ADDRESS 0x3fd454 BIT_MASK 0xF /end MEASUREMENT
/begin MEASUREMENT LV_ERR_MEM_TPS_2 "" UBYTE _CNV_S_2_RANGE______21_R_CM 1 100. 0. 255. ECU_ADDRESS 0x3fd454 BIT_MASK 0x80 /end MEASUREMENT
/begin MEASUREMENT CTR_ABC_END_DIAG_TPS_2 "" UBYTE _CNV_A_R_LINEAR_____12_CM 1 100. 0. 255. ECU_ADDRESS 0x3fd455 FORMAT "%3.0" /end MEASUREMENT
/begin MEASUREMENT CTR_ABC_VLS_UP_PUC_1 "" UBYTE _CNV_A_R_LINEAR_____10_CM 1 100. 0. 255. ECU_ADDRESS 0x3fd6c6 FORMAT "%3.0" /end MEASUREMENT
/begin MEASUREMENT LV_CDN_DIAG_VLS_UP_PUC_1 "" UBYTE _CNV_S_2_RANGE______21_R_CM 1 100. 0. 255. ECU_ADDRESS 0x3fd6c4 BIT_MASK 0x10 /end MEASUREMENT
/begin MEASUREMENT LV_END_DIAG_VLS_UP_PUC_1 "" UBYTE _CNV_S_2_RANGE______21_R_CM 1 100. 0. 255. ECU_ADDRESS 0x3fd6c4 BIT_MASK 0x20 /end MEASUREMENT
/begin MEASUREMENT LV_READY_VLS_UP_PUC_1 "" UBYTE _CNV_S_2_RANGE______21_R_CM 1 100. 0. 255. ECU_ADDRESS 0x3fd6c4 BIT_MASK 0x40 /end MEASUREMENT
/begin MEASUREMENT ERR_SYM_VLS_UP_PUC_1 "" UBYTE _CNV_S_6_RANGE_ERR__22_CM 1 100. 0. 15. ECU_ADDRESS 0x3fd6c4 BIT_MASK 0xF /end MEASUREMENT
/begin MEASUREMENT LV_ERR_MEM_VLS_UP_PUC_1 "" UBYTE _CNV_S_2_RANGE______21_R_CM 1 100. 0. 255. ECU_ADDRESS 0x3fd6c4 BIT_MASK 0x80 /end MEASUREMENT
/begin MEASUREMENT CTR_ABC_END_DIAG_VLS_UP_PUC_1 "" UBYTE _CNV_A_R_LINEAR_____12_CM 1 100. 0. 255. ECU_ADDRESS 0x3fd6c5 FORMAT "%3.0" /end MEASUREMENT
/begin MEASUREMENT CTR_ABC_VLS_UP_PUC_2 "" UBYTE _CNV_A_R_LINEAR_____10_CM 1 100. 0. 255. ECU_ADDRESS 0x3fd6ca FORMAT "%3.0" /end MEASUREMENT
/begin MEASUREMENT LV_CDN_DIAG_VLS_UP_PUC_2 "" UBYTE _CNV_S_2_RANGE______21_R_CM 1 100. 0. 255. ECU_ADDRESS 0x3fd6c8 BIT_MASK 0x10 /end MEASUREMENT
/begin MEASUREMENT LV_END_DIAG_VLS_UP_PUC_2 "" UBYTE _CNV_S_2_RANGE______21_R_CM 1 100. 0. 255. ECU_ADDRESS 0x3fd6c8 BIT_MASK 0x20 /end MEASUREMENT
/begin MEASUREMENT LV_READY_VLS_UP_PUC_2 "" UBYTE _CNV_S_2_RANGE______21_R_CM 1 100. 0. 255. ECU_ADDRESS 0x3fd6c8 BIT_MASK 0x40 /end MEASUREMENT
/begin MEASUREMENT ERR_SYM_VLS_UP_PUC_2 "" UBYTE _CNV_S_6_RANGE_ERR__22_CM 1 100. 0. 15. ECU_ADDRESS 0x3fd6c8 BIT_MASK 0xF /end MEASUREMENT
/begin MEASUREMENT LV_ERR_MEM_VLS_UP_PUC_2 "" UBYTE _CNV_S_2_RANGE______21_R_CM 1 100. 0. 255. ECU_ADDRESS 0x3fd6c8 BIT_MASK 0x80 /end MEASUREMENT
/begin MEASUREMENT CTR_ABC_END_DIAG_VLS_UP_PUC_2 "" UBYTE _CNV_A_R_LINEAR_____12_CM 1 100. 0. 255. ECU_ADDRESS 0x3fd6c9 FORMAT "%3.0" /end MEASUREMENT
/begin MEASUREMENT CTR_ABC_ECU_RAM "" UBYTE _CNV_A_R_LINEAR_____10_CM 1 100. 0. 255. ECU_ADDRESS 0x3fd5ca FORMAT "%3.0" /end MEASUREMENT
/begin MEASUREMENT LV_CDN_DIAG_ECU_RAM "" UBYTE _CNV_S_2_RANGE______21_R_CM 1 100. 0. 255. ECU_ADDRESS 0x3fd5c8 BIT_MASK 0x10 /end MEASUREMENT
/begin MEASUREMENT LV_END_DIAG_ECU_RAM "" UBYTE _CNV_S_2_RANGE______21_R_CM 1 100. 0. 255. ECU_ADDRESS 0x3fd5c8 BIT_MASK 0x20 /end MEASUREMENT
/begin MEASUREMENT LV_READY_ECU_RAM "" UBYTE _CNV_S_2_RANGE______21_R_CM 1 100. 0. 255. ECU_ADDRESS 0x3fd5c8 BIT_MASK 0x40 /end MEASUREMENT
/begin MEASUREMENT ERR_SYM_ECU_RAM "" UBYTE _CNV_S_6_RANGE_ERR__22_CM 1 100. 0. 15. ECU_ADDRESS 0x3fd5c8 BIT_MASK 0xF /end MEASUREMENT
/begin MEASUREMENT LV_ERR_MEM_ECU_RAM "" UBYTE _CNV_S_2_RANGE______21_R_CM 1 100. 0. 255. ECU_ADDRESS 0x3fd5c8 BIT_MASK 0x80 /end MEASUREMENT
/begin MEASUREMENT CTR_ABC_END_DIAG_ECU_RAM "" UBYTE _CNV_A_R_LINEAR_____12_CM 1 100. 0. 255. ECU_ADDRESS 0x3fd5c9 FORMAT "%3.0" /end MEASUREMENT
/begin MEASUREMENT CTR_ABC_TIA "" UBYTE _CNV_A_R_LINEAR_____10_CM 1 100. 0. 255. ECU_ADDRESS 0x3fd35a FORMAT "%3.0" /end MEASUREMENT
/begin MEASUREMENT LV_CDN_DIAG_TIA "" UBYTE _CNV_S_2_RANGE______21_R_CM 1 100. 0. 255. ECU_ADDRESS 0x3fd358 BIT_MASK 0x10 /end MEASUREMENT
/begin MEASUREMENT LV_END_DIAG_TIA "" UBYTE _CNV_S_2_RANGE______21_R_CM 1 100. 0. 255. ECU_ADDRESS 0x3fd358 BIT_MASK 0x20 /end MEASUREMENT
/begin MEASUREMENT LV_READY_TIA "" UBYTE _CNV_S_2_RANGE______21_R_CM 1 100. 0. 255. ECU_ADDRESS 0x3fd358 BIT_MASK 0x40 /end MEASUREMENT
/begin MEASUREMENT ERR_SYM_TIA "" UBYTE _CNV_S_6_RANGE_ERR__22_CM 1 100. 0. 15. ECU_ADDRESS 0x3fd358 BIT_MASK 0xF /end MEASUREMENT
/begin MEASUREMENT LV_ERR_MEM_TIA "" UBYTE _CNV_S_2_RANGE______21_R_CM 1 100. 0. 255. ECU_ADDRESS 0x3fd358 BIT_MASK 0x80 /end MEASUREMENT
/begin MEASUREMENT CTR_ABC_END_DIAG_TIA "" UBYTE _CNV_A_R_LINEAR_____12_CM 1 100. 0. 255. ECU_ADDRESS 0x3fd359 FORMAT "%3.0" /end MEASUREMENT
/begin MEASUREMENT CTR_ABC_TPU_SYN "" UBYTE _CNV_A_R_LINEAR_____10_CM 1 100. 0. 255. ECU_ADDRESS 0x3fd4c6 FORMAT "%3.0" /end MEASUREMENT
/begin MEASUREMENT LV_CDN_DIAG_TPU_SYN "" UBYTE _CNV_S_2_RANGE______21_R_CM 1 100. 0. 255. ECU_ADDRESS 0x3fd4c4 BIT_MASK 0x10 /end MEASUREMENT
/begin MEASUREMENT LV_END_DIAG_TPU_SYN "" UBYTE _CNV_S_2_RANGE______21_R_CM 1 100. 0. 255. ECU_ADDRESS 0x3fd4c4 BIT_MASK 0x20 /end MEASUREMENT
/begin MEASUREMENT LV_READY_TPU_SYN "" UBYTE _CNV_S_2_RANGE______21_R_CM 1 100. 0. 255. ECU_ADDRESS 0x3fd4c4 BIT_MASK 0x40 /end MEASUREMENT
/begin MEASUREMENT ERR_SYM_TPU_SYN "" UBYTE _CNV_S_6_RANGE_ERR__22_CM 1 100. 0. 15. ECU_ADDRESS 0x3fd4c4 BIT_MASK 0xF /end MEASUREMENT
/begin MEASUREMENT LV_ERR_MEM_TPU_SYN "" UBYTE _CNV_S_2_RANGE______21_R_CM 1 100. 0. 255. ECU_ADDRESS 0x3fd4c4 BIT_MASK 0x80 /end MEASUREMENT
/begin MEASUREMENT CTR_ABC_END_DIAG_TPU_SYN "" UBYTE _CNV_A_R_LINEAR_____12_CM 1 100. 0. 255. ECU_ADDRESS 0x3fd4c5 FORMAT "%3.0" /end MEASUREMENT
/begin MEASUREMENT CTR_ABC_BN_TQ_TCS "" UBYTE _CNV_A_R_LINEAR_____10_CM 1 100. 0. 255. ECU_ADDRESS 0x3fd632 FORMAT "%3.0" /end MEASUREMENT
/begin MEASUREMENT LV_CDN_DIAG_BN_TQ_TCS "" UBYTE _CNV_S_2_RANGE______21_R_CM 1 100. 0. 255. ECU_ADDRESS 0x3fd630 BIT_MASK 0x10 /end MEASUREMENT
/begin MEASUREMENT LV_END_DIAG_BN_TQ_TCS "" UBYTE _CNV_S_2_RANGE______21_R_CM 1 100. 0. 255. ECU_ADDRESS 0x3fd630 BIT_MASK 0x20 /end MEASUREMENT
/begin MEASUREMENT LV_READY_BN_TQ_TCS "" UBYTE _CNV_S_2_RANGE______21_R_CM 1 100. 0. 255. ECU_ADDRESS 0x3fd630 BIT_MASK 0x40 /end MEASUREMENT
/begin MEASUREMENT ERR_SYM_BN_TQ_TCS "" UBYTE _CNV_S_6_RANGE_ERR__22_CM 1 100. 0. 15. ECU_ADDRESS 0x3fd630 BIT_MASK 0xF /end MEASUREMENT
/begin MEASUREMENT LV_ERR_MEM_BN_TQ_TCS "" UBYTE _CNV_S_2_RANGE______21_R_CM 1 100. 0. 255. ECU_ADDRESS 0x3fd630 BIT_MASK 0x80 /end MEASUREMENT
/begin MEASUREMENT CTR_ABC_END_DIAG_BN_TQ_TCS "" UBYTE _CNV_A_R_LINEAR_____12_CM 1 100. 0. 255. ECU_ADDRESS 0x3fd631 FORMAT "%3.0" /end MEASUREMENT
/begin MEASUREMENT CTR_ABC_N_EFP_LOW "" UBYTE _CNV_A_R_LINEAR_____10_CM 1 100. 0. 255. ECU_ADDRESS 0x3fd67e FORMAT "%3.0" /end MEASUREMENT
/begin MEASUREMENT LV_CDN_DIAG_N_EFP_LOW "" UBYTE _CNV_S_2_RANGE______21_R_CM 1 100. 0. 255. ECU_ADDRESS 0x3fd67c BIT_MASK 0x10 /end MEASUREMENT
/begin MEASUREMENT LV_END_DIAG_N_EFP_LOW "" UBYTE _CNV_S_2_RANGE______21_R_CM 1 100. 0. 255. ECU_ADDRESS 0x3fd67c BIT_MASK 0x20 /end MEASUREMENT
/begin MEASUREMENT LV_READY_N_EFP_LOW "" UBYTE _CNV_S_2_RANGE______21_R_CM 1 100. 0. 255. ECU_ADDRESS 0x3fd67c BIT_MASK 0x40 /end MEASUREMENT
/begin MEASUREMENT ERR_SYM_N_EFP_LOW "" UBYTE _CNV_S_6_RANGE_ERR__22_CM 1 100. 0. 15. ECU_ADDRESS 0x3fd67c BIT_MASK 0xF /end MEASUREMENT
/begin MEASUREMENT LV_ERR_MEM_N_EFP_LOW "" UBYTE _CNV_S_2_RANGE______21_R_CM 1 100. 0. 255. ECU_ADDRESS 0x3fd67c BIT_MASK 0x80 /end MEASUREMENT
/begin MEASUREMENT CTR_ABC_END_DIAG_N_EFP_LOW "" UBYTE _CNV_A_R_LINEAR_____12_CM 1 100. 0. 255. ECU_ADDRESS 0x3fd67d FORMAT "%3.0" /end MEASUREMENT
/begin MEASUREMENT CTR_ABC_OBD2_LSH_DOWN_1 "" UBYTE _CNV_A_R_LINEAR_____10_CM 1 100. 0. 255. ECU_ADDRESS 0x3fd5de FORMAT "%3.0" /end MEASUREMENT
/begin MEASUREMENT LV_CDN_DIAG_OBD2_LSH_DOWN_1 "" UBYTE _CNV_S_2_RANGE______21_R_CM 1 100. 0. 255. ECU_ADDRESS 0x3fd5dc BIT_MASK 0x10 /end MEASUREMENT
/begin MEASUREMENT LV_END_DIAG_OBD2_LSH_DOWN_1 "" UBYTE _CNV_S_2_RANGE______21_R_CM 1 100. 0. 255. ECU_ADDRESS 0x3fd5dc BIT_MASK 0x20 /end MEASUREMENT
/begin MEASUREMENT LV_READY_OBD2_LSH_DOWN_1 "" UBYTE _CNV_S_2_RANGE______21_R_CM 1 100. 0. 255. ECU_ADDRESS 0x3fd5dc BIT_MASK 0x40 /end MEASUREMENT
/begin MEASUREMENT ERR_SYM_OBD2_LSH_DOWN_1 "" UBYTE _CNV_S_6_RANGE_ERR__22_CM 1 100. 0. 15. ECU_ADDRESS 0x3fd5dc BIT_MASK 0xF /end MEASUREMENT
/begin MEASUREMENT LV_ERR_MEM_OBD2_LSH_DOWN_1 "" UBYTE _CNV_S_2_RANGE______21_R_CM 1 100. 0. 255. ECU_ADDRESS 0x3fd5dc BIT_MASK 0x80 /end MEASUREMENT
/begin MEASUREMENT CTR_ABC_END_DIAG_OBD2_LSH_DOWN_1 "" UBYTE _CNV_A_R_LINEAR_____12_CM 1 100. 0. 255. ECU_ADDRESS 0x3fd5dd FORMAT "%3.0" /end MEASUREMENT
/begin MEASUREMENT CTR_ABC_OBD2_LSH_DOWN_2 "" UBYTE _CNV_A_R_LINEAR_____10_CM 1 100. 0. 255. ECU_ADDRESS 0x3fd5e2 FORMAT "%3.0" /end MEASUREMENT
/begin MEASUREMENT LV_CDN_DIAG_OBD2_LSH_DOWN_2 "" UBYTE _CNV_S_2_RANGE______21_R_CM 1 100. 0. 255. ECU_ADDRESS 0x3fd5e0 BIT_MASK 0x10 /end MEASUREMENT
/begin MEASUREMENT LV_END_DIAG_OBD2_LSH_DOWN_2 "" UBYTE _CNV_S_2_RANGE______21_R_CM 1 100. 0. 255. ECU_ADDRESS 0x3fd5e0 BIT_MASK 0x20 /end MEASUREMENT
/begin MEASUREMENT LV_READY_OBD2_LSH_DOWN_2 "" UBYTE _CNV_S_2_RANGE______21_R_CM 1 100. 0. 255. ECU_ADDRESS 0x3fd5e0 BIT_MASK 0x40 /end MEASUREMENT
/begin MEASUREMENT ERR_SYM_OBD2_LSH_DOWN_2 "" UBYTE _CNV_S_6_RANGE_ERR__22_CM 1 100. 0. 15. ECU_ADDRESS 0x3fd5e0 BIT_MASK 0xF /end MEASUREMENT
/begin MEASUREMENT LV_ERR_MEM_OBD2_LSH_DOWN_2 "" UBYTE _CNV_S_2_RANGE______21_R_CM 1 100. 0. 255. ECU_ADDRESS 0x3fd5e0 BIT_MASK 0x80 /end MEASUREMENT
/begin MEASUREMENT CTR_ABC_END_DIAG_OBD2_LSH_DOWN_2 "" UBYTE _CNV_A_R_LINEAR_____12_CM 1 100. 0. 255. ECU_ADDRESS 0x3fd5e1 FORMAT "%3.0" /end MEASUREMENT
/begin MEASUREMENT CTR_ABC_TOUT_ICL_2 "" UBYTE _CNV_A_R_LINEAR_____10_CM 1 100. 0. 255. ECU_ADDRESS 0x3fd3fe FORMAT "%3.0" /end MEASUREMENT
/begin MEASUREMENT LV_CDN_DIAG_TOUT_ICL_2 "" UBYTE _CNV_S_2_RANGE______21_R_CM 1 100. 0. 255. ECU_ADDRESS 0x3fd3fc BIT_MASK 0x10 /end MEASUREMENT
/begin MEASUREMENT LV_END_DIAG_TOUT_ICL_2 "" UBYTE _CNV_S_2_RANGE______21_R_CM 1 100. 0. 255. ECU_ADDRESS 0x3fd3fc BIT_MASK 0x20 /end MEASUREMENT
/begin MEASUREMENT LV_READY_TOUT_ICL_2 "" UBYTE _CNV_S_2_RANGE______21_R_CM 1 100. 0. 255. ECU_ADDRESS 0x3fd3fc BIT_MASK 0x40 /end MEASUREMENT
/begin MEASUREMENT ERR_SYM_TOUT_ICL_2 "" UBYTE _CNV_S_6_RANGE_ERR__22_CM 1 100. 0. 15. ECU_ADDRESS 0x3fd3fc BIT_MASK 0xF /end MEASUREMENT
/begin MEASUREMENT LV_ERR_MEM_TOUT_ICL_2 "" UBYTE _CNV_S_2_RANGE______21_R_CM 1 100. 0. 255. ECU_ADDRESS 0x3fd3fc BIT_MASK 0x80 /end MEASUREMENT
/begin MEASUREMENT CTR_ABC_END_DIAG_TOUT_ICL_2 "" UBYTE _CNV_A_R_LINEAR_____12_CM 1 100. 0. 255. ECU_ADDRESS 0x3fd3fd FORMAT "%3.0" /end MEASUREMENT
/begin MEASUREMENT CTR_ABC_TOUT_ICL_3 "" UBYTE _CNV_A_R_LINEAR_____10_CM 1 100. 0. 255. ECU_ADDRESS 0x3fd402 FORMAT "%3.0" /end MEASUREMENT
/begin MEASUREMENT LV_CDN_DIAG_TOUT_ICL_3 "" UBYTE _CNV_S_2_RANGE______21_R_CM 1 100. 0. 255. ECU_ADDRESS 0x3fd400 BIT_MASK 0x10 /end MEASUREMENT
/begin MEASUREMENT LV_END_DIAG_TOUT_ICL_3 "" UBYTE _CNV_S_2_RANGE______21_R_CM 1 100. 0. 255. ECU_ADDRESS 0x3fd400 BIT_MASK 0x20 /end MEASUREMENT
/begin MEASUREMENT LV_READY_TOUT_ICL_3 "" UBYTE _CNV_S_2_RANGE______21_R_CM 1 100. 0. 255. ECU_ADDRESS 0x3fd400 BIT_MASK 0x40 /end MEASUREMENT
/begin MEASUREMENT ERR_SYM_TOUT_ICL_3 "" UBYTE _CNV_S_6_RANGE_ERR__22_CM 1 100. 0. 15. ECU_ADDRESS 0x3fd400 BIT_MASK 0xF /end MEASUREMENT
/begin MEASUREMENT LV_ERR_MEM_TOUT_ICL_3 "" UBYTE _CNV_S_2_RANGE______21_R_CM 1 100. 0. 255. ECU_ADDRESS 0x3fd400 BIT_MASK 0x80 /end MEASUREMENT
/begin MEASUREMENT CTR_ABC_END_DIAG_TOUT_ICL_3 "" UBYTE _CNV_A_R_LINEAR_____12_CM 1 100. 0. 255. ECU_ADDRESS 0x3fd401 FORMAT "%3.0" /end MEASUREMENT
/begin MEASUREMENT CTR_ABC_TPS_MAF_1 "" UBYTE _CNV_A_R_LINEAR_____10_CM 1 100. 0. 255. ECU_ADDRESS 0x3fd45a FORMAT "%3.0" /end MEASUREMENT
/begin MEASUREMENT LV_CDN_DIAG_TPS_MAF_1 "" UBYTE _CNV_S_2_RANGE______21_R_CM 1 100. 0. 255. ECU_ADDRESS 0x3fd458 BIT_MASK 0x10 /end MEASUREMENT
/begin MEASUREMENT LV_END_DIAG_TPS_MAF_1 "" UBYTE _CNV_S_2_RANGE______21_R_CM 1 100. 0. 255. ECU_ADDRESS 0x3fd458 BIT_MASK 0x20 /end MEASUREMENT
/begin MEASUREMENT LV_READY_TPS_MAF_1 "" UBYTE _CNV_S_2_RANGE______21_R_CM 1 100. 0. 255. ECU_ADDRESS 0x3fd458 BIT_MASK 0x40 /end MEASUREMENT
/begin MEASUREMENT ERR_SYM_TPS_MAF_1 "" UBYTE _CNV_S_6_RANGE_ERR__22_CM 1 100. 0. 15. ECU_ADDRESS 0x3fd458 BIT_MASK 0xF /end MEASUREMENT
/begin MEASUREMENT LV_ERR_MEM_TPS_MAF_1 "" UBYTE _CNV_S_2_RANGE______21_R_CM 1 100. 0. 255. ECU_ADDRESS 0x3fd458 BIT_MASK 0x80 /end MEASUREMENT
/begin MEASUREMENT CTR_ABC_END_DIAG_TPS_MAF_1 "" UBYTE _CNV_A_R_LINEAR_____12_CM 1 100. 0. 255. ECU_ADDRESS 0x3fd459 FORMAT "%3.0" /end MEASUREMENT
/begin MEASUREMENT CTR_ABC_TPS_MAF_2 "" UBYTE _CNV_A_R_LINEAR_____10_CM 1 100. 0. 255. ECU_ADDRESS 0x3fd45e FORMAT "%3.0" /end MEASUREMENT
/begin MEASUREMENT LV_CDN_DIAG_TPS_MAF_2 "" UBYTE _CNV_S_2_RANGE______21_R_CM 1 100. 0. 255. ECU_ADDRESS 0x3fd45c BIT_MASK 0x10 /end MEASUREMENT
/begin MEASUREMENT LV_END_DIAG_TPS_MAF_2 "" UBYTE _CNV_S_2_RANGE______21_R_CM 1 100. 0. 255. ECU_ADDRESS 0x3fd45c BIT_MASK 0x20 /end MEASUREMENT
/begin MEASUREMENT LV_READY_TPS_MAF_2 "" UBYTE _CNV_S_2_RANGE______21_R_CM 1 100. 0. 255. ECU_ADDRESS 0x3fd45c BIT_MASK 0x40 /end MEASUREMENT
/begin MEASUREMENT ERR_SYM_TPS_MAF_2 "" UBYTE _CNV_S_6_RANGE_ERR__22_CM 1 100. 0. 15. ECU_ADDRESS 0x3fd45c BIT_MASK 0xF /end MEASUREMENT
/begin MEASUREMENT LV_ERR_MEM_TPS_MAF_2 "" UBYTE _CNV_S_2_RANGE______21_R_CM 1 100. 0. 255. ECU_ADDRESS 0x3fd45c BIT_MASK 0x80 /end MEASUREMENT
/begin MEASUREMENT CTR_ABC_END_DIAG_TPS_MAF_2 "" UBYTE _CNV_A_R_LINEAR_____12_CM 1 100. 0. 255. ECU_ADDRESS 0x3fd45d FORMAT "%3.0" /end MEASUREMENT
/begin MEASUREMENT CTR_ABC_MTC_CTL_1 "" UBYTE _CNV_A_R_LINEAR_____10_CM 1 100. 0. 255. ECU_ADDRESS 0x3fd47e FORMAT "%3.0" /end MEASUREMENT
/begin MEASUREMENT LV_CDN_DIAG_MTC_CTL_1 "" UBYTE _CNV_S_2_RANGE______21_R_CM 1 100. 0. 255. ECU_ADDRESS 0x3fd47c BIT_MASK 0x10 /end MEASUREMENT
/begin MEASUREMENT LV_END_DIAG_MTC_CTL_1 "" UBYTE _CNV_S_2_RANGE______21_R_CM 1 100. 0. 255. ECU_ADDRESS 0x3fd47c BIT_MASK 0x20 /end MEASUREMENT
/begin MEASUREMENT LV_READY_MTC_CTL_1 "" UBYTE _CNV_S_2_RANGE______21_R_CM 1 100. 0. 255. ECU_ADDRESS 0x3fd47c BIT_MASK 0x40 /end MEASUREMENT
/begin MEASUREMENT ERR_SYM_MTC_CTL_1 "" UBYTE _CNV_S_6_RANGE_ERR__22_CM 1 100. 0. 15. ECU_ADDRESS 0x3fd47c BIT_MASK 0xF /end MEASUREMENT
/begin MEASUREMENT LV_ERR_MEM_MTC_CTL_1 "" UBYTE _CNV_S_2_RANGE______21_R_CM 1 100. 0. 255. ECU_ADDRESS 0x3fd47c BIT_MASK 0x80 /end MEASUREMENT
/begin MEASUREMENT CTR_ABC_END_DIAG_MTC_CTL_1 "" UBYTE _CNV_A_R_LINEAR_____12_CM 1 100. 0. 255. ECU_ADDRESS 0x3fd47d FORMAT "%3.0" /end MEASUREMENT
/begin MEASUREMENT CTR_ABC_GEN_IF "" UBYTE _CNV_A_R_LINEAR_____10_CM 1 100. 0. 255. ECU_ADDRESS 0x3fd49e FORMAT "%3.0" /end MEASUREMENT
/begin MEASUREMENT LV_CDN_DIAG_GEN_IF "" UBYTE _CNV_S_2_RANGE______21_R_CM 1 100. 0. 255. ECU_ADDRESS 0x3fd49c BIT_MASK 0x10 /end MEASUREMENT
/begin MEASUREMENT LV_END_DIAG_GEN_IF "" UBYTE _CNV_S_2_RANGE______21_R_CM 1 100. 0. 255. ECU_ADDRESS 0x3fd49c BIT_MASK 0x20 /end MEASUREMENT
/begin MEASUREMENT LV_READY_GEN_IF "" UBYTE _CNV_S_2_RANGE______21_R_CM 1 100. 0. 255. ECU_ADDRESS 0x3fd49c BIT_MASK 0x40 /end MEASUREMENT
/begin MEASUREMENT ERR_SYM_GEN_IF "" UBYTE _CNV_S_6_RANGE_ERR__22_CM 1 100. 0. 15. ECU_ADDRESS 0x3fd49c BIT_MASK 0xF /end MEASUREMENT
/begin MEASUREMENT LV_ERR_MEM_GEN_IF "" UBYTE _CNV_S_2_RANGE______21_R_CM 1 100. 0. 255. ECU_ADDRESS 0x3fd49c BIT_MASK 0x80 /end MEASUREMENT
/begin MEASUREMENT CTR_ABC_END_DIAG_GEN_IF "" UBYTE _CNV_A_R_LINEAR_____12_CM 1 100. 0. 255. ECU_ADDRESS 0x3fd49d FORMAT "%3.0" /end MEASUREMENT
/begin MEASUREMENT CTR_ABC_MTC_CTL_2 "" UBYTE _CNV_A_R_LINEAR_____10_CM 1 100. 0. 255. ECU_ADDRESS 0x3fd482 FORMAT "%3.0" /end MEASUREMENT
/begin MEASUREMENT LV_CDN_DIAG_MTC_CTL_2 "" UBYTE _CNV_S_2_RANGE______21_R_CM 1 100. 0. 255. ECU_ADDRESS 0x3fd480 BIT_MASK 0x10 /end MEASUREMENT
/begin MEASUREMENT LV_END_DIAG_MTC_CTL_2 "" UBYTE _CNV_S_2_RANGE______21_R_CM 1 100. 0. 255. ECU_ADDRESS 0x3fd480 BIT_MASK 0x20 /end MEASUREMENT
/begin MEASUREMENT LV_READY_MTC_CTL_2 "" UBYTE _CNV_S_2_RANGE______21_R_CM 1 100. 0. 255. ECU_ADDRESS 0x3fd480 BIT_MASK 0x40 /end MEASUREMENT
/begin MEASUREMENT ERR_SYM_MTC_CTL_2 "" UBYTE _CNV_S_6_RANGE_ERR__22_CM 1 100. 0. 15. ECU_ADDRESS 0x3fd480 BIT_MASK 0xF /end MEASUREMENT
/begin MEASUREMENT LV_ERR_MEM_MTC_CTL_2 "" UBYTE _CNV_S_2_RANGE______21_R_CM 1 100. 0. 255. ECU_ADDRESS 0x3fd480 BIT_MASK 0x80 /end MEASUREMENT
/begin MEASUREMENT CTR_ABC_END_DIAG_MTC_CTL_2 "" UBYTE _CNV_A_R_LINEAR_____12_CM 1 100. 0. 255. ECU_ADDRESS 0x3fd481 FORMAT "%3.0" /end MEASUREMENT
/begin MEASUREMENT CTR_ABC_MTC_CTL_3 "" UBYTE _CNV_A_R_LINEAR_____10_CM 1 100. 0. 255. ECU_ADDRESS 0x3fd486 FORMAT "%3.0" /end MEASUREMENT
/begin MEASUREMENT LV_CDN_DIAG_MTC_CTL_3 "" UBYTE _CNV_S_2_RANGE______21_R_CM 1 100. 0. 255. ECU_ADDRESS 0x3fd484 BIT_MASK 0x10 /end MEASUREMENT
/begin MEASUREMENT LV_END_DIAG_MTC_CTL_3 "" UBYTE _CNV_S_2_RANGE______21_R_CM 1 100. 0. 255. ECU_ADDRESS 0x3fd484 BIT_MASK 0x20 /end MEASUREMENT
/begin MEASUREMENT LV_READY_MTC_CTL_3 "" UBYTE _CNV_S_2_RANGE______21_R_CM 1 100. 0. 255. ECU_ADDRESS 0x3fd484 BIT_MASK 0x40 /end MEASUREMENT
/begin MEASUREMENT ERR_SYM_MTC_CTL_3 "" UBYTE _CNV_S_6_RANGE_ERR__22_CM 1 100. 0. 15. ECU_ADDRESS 0x3fd484 BIT_MASK 0xF /end MEASUREMENT
/begin MEASUREMENT LV_ERR_MEM_MTC_CTL_3 "" UBYTE _CNV_S_2_RANGE______21_R_CM 1 100. 0. 255. ECU_ADDRESS 0x3fd484 BIT_MASK 0x80 /end MEASUREMENT
/begin MEASUREMENT CTR_ABC_END_DIAG_MTC_CTL_3 "" UBYTE _CNV_A_R_LINEAR_____12_CM 1 100. 0. 255. ECU_ADDRESS 0x3fd485 FORMAT "%3.0" /end MEASUREMENT
/begin MEASUREMENT CTR_ABC_MAF "" UBYTE _CNV_A_R_LINEAR_____10_CM 1 100. 0. 255. ECU_ADDRESS 0x3fd362 FORMAT "%3.0" /end MEASUREMENT
/begin MEASUREMENT LV_CDN_DIAG_MAF "" UBYTE _CNV_S_2_RANGE______21_R_CM 1 100. 0. 255. ECU_ADDRESS 0x3fd360 BIT_MASK 0x10 /end MEASUREMENT
/begin MEASUREMENT LV_END_DIAG_MAF "" UBYTE _CNV_S_2_RANGE______21_R_CM 1 100. 0. 255. ECU_ADDRESS 0x3fd360 BIT_MASK 0x20 /end MEASUREMENT
/begin MEASUREMENT LV_READY_MAF "" UBYTE _CNV_S_2_RANGE______21_R_CM 1 100. 0. 255. ECU_ADDRESS 0x3fd360 BIT_MASK 0x40 /end MEASUREMENT
/begin MEASUREMENT ERR_SYM_MAF "" UBYTE _CNV_S_6_RANGE_ERR__22_CM 1 100. 0. 15. ECU_ADDRESS 0x3fd360 BIT_MASK 0xF /end MEASUREMENT
/begin MEASUREMENT LV_ERR_MEM_MAF "" UBYTE _CNV_S_2_RANGE______21_R_CM 1 100. 0. 255. ECU_ADDRESS 0x3fd360 BIT_MASK 0x80 /end MEASUREMENT
/begin MEASUREMENT CTR_ABC_END_DIAG_MAF "" UBYTE _CNV_A_R_LINEAR_____12_CM 1 100. 0. 255. ECU_ADDRESS 0x3fd361 FORMAT "%3.0" /end MEASUREMENT
/begin MEASUREMENT CTR_ABC_RLY_EFP "" UBYTE _CNV_A_R_LINEAR_____10_CM 1 100. 0. 255. ECU_ADDRESS 0x3fd3b6 FORMAT "%3.0" /end MEASUREMENT
/begin MEASUREMENT LV_CDN_DIAG_RLY_EFP "" UBYTE _CNV_S_2_RANGE______21_R_CM 1 100. 0. 255. ECU_ADDRESS 0x3fd3b4 BIT_MASK 0x10 /end MEASUREMENT
/begin MEASUREMENT LV_END_DIAG_RLY_EFP "" UBYTE _CNV_S_2_RANGE______21_R_CM 1 100. 0. 255. ECU_ADDRESS 0x3fd3b4 BIT_MASK 0x20 /end MEASUREMENT
/begin MEASUREMENT LV_READY_RLY_EFP "" UBYTE _CNV_S_2_RANGE______21_R_CM 1 100. 0. 255. ECU_ADDRESS 0x3fd3b4 BIT_MASK 0x40 /end MEASUREMENT
/begin MEASUREMENT ERR_SYM_RLY_EFP "" UBYTE _CNV_S_6_RANGE_ERR__22_CM 1 100. 0. 15. ECU_ADDRESS 0x3fd3b4 BIT_MASK 0xF /end MEASUREMENT
/begin MEASUREMENT LV_ERR_MEM_RLY_EFP "" UBYTE _CNV_S_2_RANGE______21_R_CM 1 100. 0. 255. ECU_ADDRESS 0x3fd3b4 BIT_MASK 0x80 /end MEASUREMENT
/begin MEASUREMENT CTR_ABC_END_DIAG_RLY_EFP "" UBYTE _CNV_A_R_LINEAR_____12_CM 1 100. 0. 255. ECU_ADDRESS 0x3fd3b5 FORMAT "%3.0" /end MEASUREMENT
/begin MEASUREMENT CTR_ABC_TECU "" UBYTE _CNV_A_R_LINEAR_____10_CM 1 100. 0. 255. ECU_ADDRESS 0x3fd5c2 FORMAT "%3.0" /end MEASUREMENT
/begin MEASUREMENT LV_CDN_DIAG_TECU "" UBYTE _CNV_S_2_RANGE______21_R_CM 1 100. 0. 255. ECU_ADDRESS 0x3fd5c0 BIT_MASK 0x10 /end MEASUREMENT
/begin MEASUREMENT LV_END_DIAG_TECU "" UBYTE _CNV_S_2_RANGE______21_R_CM 1 100. 0. 255. ECU_ADDRESS 0x3fd5c0 BIT_MASK 0x20 /end MEASUREMENT
/begin MEASUREMENT LV_READY_TECU "" UBYTE _CNV_S_2_RANGE______21_R_CM 1 100. 0. 255. ECU_ADDRESS 0x3fd5c0 BIT_MASK 0x40 /end MEASUREMENT
/begin MEASUREMENT ERR_SYM_TECU "" UBYTE _CNV_S_6_RANGE_ERR__22_CM 1 100. 0. 15. ECU_ADDRESS 0x3fd5c0 BIT_MASK 0xF /end MEASUREMENT
/begin MEASUREMENT LV_ERR_MEM_TECU "" UBYTE _CNV_S_2_RANGE______21_R_CM 1 100. 0. 255. ECU_ADDRESS 0x3fd5c0 BIT_MASK 0x80 /end MEASUREMENT
/begin MEASUREMENT CTR_ABC_END_DIAG_TECU "" UBYTE _CNV_A_R_LINEAR_____12_CM 1 100. 0. 255. ECU_ADDRESS 0x3fd5c1 FORMAT "%3.0" /end MEASUREMENT
/begin MEASUREMENT CTR_ABC_REF_IVVT_IN_1 "" UBYTE _CNV_A_R_LINEAR_____10_CM 1 100. 0. 255. ECU_ADDRESS 0x3fd3ce FORMAT "%3.0" /end MEASUREMENT
/begin MEASUREMENT LV_CDN_DIAG_REF_IVVT_IN_1 "" UBYTE _CNV_S_2_RANGE______21_R_CM 1 100. 0. 255. ECU_ADDRESS 0x3fd3cc BIT_MASK 0x10 /end MEASUREMENT
/begin MEASUREMENT LV_END_DIAG_REF_IVVT_IN_1 "" UBYTE _CNV_S_2_RANGE______21_R_CM 1 100. 0. 255. ECU_ADDRESS 0x3fd3cc BIT_MASK 0x20 /end MEASUREMENT
/begin MEASUREMENT LV_READY_REF_IVVT_IN_1 "" UBYTE _CNV_S_2_RANGE______21_R_CM 1 100. 0. 255. ECU_ADDRESS 0x3fd3cc BIT_MASK 0x40 /end MEASUREMENT
/begin MEASUREMENT ERR_SYM_REF_IVVT_IN_1 "" UBYTE _CNV_S_6_RANGE_ERR__22_CM 1 100. 0. 15. ECU_ADDRESS 0x3fd3cc BIT_MASK 0xF /end MEASUREMENT
/begin MEASUREMENT LV_ERR_MEM_REF_IVVT_IN_1 "" UBYTE _CNV_S_2_RANGE______21_R_CM 1 100. 0. 255. ECU_ADDRESS 0x3fd3cc BIT_MASK 0x80 /end MEASUREMENT
/begin MEASUREMENT CTR_ABC_END_DIAG_REF_IVVT_IN_1 "" UBYTE _CNV_A_R_LINEAR_____12_CM 1 100. 0. 255. ECU_ADDRESS 0x3fd3cd FORMAT "%3.0" /end MEASUREMENT
/begin MEASUREMENT CTR_ABC_REF_IVVT_IN_2 "" UBYTE _CNV_A_R_LINEAR_____10_CM 1 100. 0. 255. ECU_ADDRESS 0x3fd3d2 FORMAT "%3.0" /end MEASUREMENT
/begin MEASUREMENT LV_CDN_DIAG_REF_IVVT_IN_2 "" UBYTE _CNV_S_2_RANGE______21_R_CM 1 100. 0. 255. ECU_ADDRESS 0x3fd3d0 BIT_MASK 0x10 /end MEASUREMENT
/begin MEASUREMENT LV_END_DIAG_REF_IVVT_IN_2 "" UBYTE _CNV_S_2_RANGE______21_R_CM 1 100. 0. 255. ECU_ADDRESS 0x3fd3d0 BIT_MASK 0x20 /end MEASUREMENT
/begin MEASUREMENT LV_READY_REF_IVVT_IN_2 "" UBYTE _CNV_S_2_RANGE______21_R_CM 1 100. 0. 255. ECU_ADDRESS 0x3fd3d0 BIT_MASK 0x40 /end MEASUREMENT
/begin MEASUREMENT ERR_SYM_REF_IVVT_IN_2 "" UBYTE _CNV_S_6_RANGE_ERR__22_CM 1 100. 0. 15. ECU_ADDRESS 0x3fd3d0 BIT_MASK 0xF /end MEASUREMENT
/begin MEASUREMENT LV_ERR_MEM_REF_IVVT_IN_2 "" UBYTE _CNV_S_2_RANGE______21_R_CM 1 100. 0. 255. ECU_ADDRESS 0x3fd3d0 BIT_MASK 0x80 /end MEASUREMENT
/begin MEASUREMENT CTR_ABC_END_DIAG_REF_IVVT_IN_2 "" UBYTE _CNV_A_R_LINEAR_____12_CM 1 100. 0. 255. ECU_ADDRESS 0x3fd3d1 FORMAT "%3.0" /end MEASUREMENT
/begin MEASUREMENT CTR_ABC_TCO_STUCK "" UBYTE _CNV_A_R_LINEAR_____10_CM 1 100. 0. 255. ECU_ADDRESS 0x3fd4f2 FORMAT "%3.0" /end MEASUREMENT
/begin MEASUREMENT LV_CDN_DIAG_TCO_STUCK "" UBYTE _CNV_S_2_RANGE______21_R_CM 1 100. 0. 255. ECU_ADDRESS 0x3fd4f0 BIT_MASK 0x10 /end MEASUREMENT
/begin MEASUREMENT LV_END_DIAG_TCO_STUCK "" UBYTE _CNV_S_2_RANGE______21_R_CM 1 100. 0. 255. ECU_ADDRESS 0x3fd4f0 BIT_MASK 0x20 /end MEASUREMENT
/begin MEASUREMENT LV_READY_TCO_STUCK "" UBYTE _CNV_S_2_RANGE______21_R_CM 1 100. 0. 255. ECU_ADDRESS 0x3fd4f0 BIT_MASK 0x40 /end MEASUREMENT
/begin MEASUREMENT ERR_SYM_TCO_STUCK "" UBYTE _CNV_S_6_RANGE_ERR__22_CM 1 100. 0. 15. ECU_ADDRESS 0x3fd4f0 BIT_MASK 0xF /end MEASUREMENT
/begin MEASUREMENT LV_ERR_MEM_TCO_STUCK "" UBYTE _CNV_S_2_RANGE______21_R_CM 1 100. 0. 255. ECU_ADDRESS 0x3fd4f0 BIT_MASK 0x80 /end MEASUREMENT
/begin MEASUREMENT CTR_ABC_END_DIAG_TCO_STUCK "" UBYTE _CNV_A_R_LINEAR_____12_CM 1 100. 0. 255. ECU_ADDRESS 0x3fd4f1 FORMAT "%3.0" /end MEASUREMENT
/begin MEASUREMENT CTR_ABC_SOF "" UBYTE _CNV_A_R_LINEAR_____10_CM 1 100. 0. 255. ECU_ADDRESS 0x3fd5f6 FORMAT "%3.0" /end MEASUREMENT
/begin MEASUREMENT LV_CDN_DIAG_SOF "" UBYTE _CNV_S_2_RANGE______21_R_CM 1 100. 0. 255. ECU_ADDRESS 0x3fd5f4 BIT_MASK 0x10 /end MEASUREMENT
/begin MEASUREMENT LV_END_DIAG_SOF "" UBYTE _CNV_S_2_RANGE______21_R_CM 1 100. 0. 255. ECU_ADDRESS 0x3fd5f4 BIT_MASK 0x20 /end MEASUREMENT
/begin MEASUREMENT LV_READY_SOF "" UBYTE _CNV_S_2_RANGE______21_R_CM 1 100. 0. 255. ECU_ADDRESS 0x3fd5f4 BIT_MASK 0x40 /end MEASUREMENT
/begin MEASUREMENT ERR_SYM_SOF "" UBYTE _CNV_S_6_RANGE_ERR__22_CM 1 100. 0. 15. ECU_ADDRESS 0x3fd5f4 BIT_MASK 0xF /end MEASUREMENT
/begin MEASUREMENT LV_ERR_MEM_SOF "" UBYTE _CNV_S_2_RANGE______21_R_CM 1 100. 0. 255. ECU_ADDRESS 0x3fd5f4 BIT_MASK 0x80 /end MEASUREMENT
/begin MEASUREMENT CTR_ABC_END_DIAG_SOF "" UBYTE _CNV_A_R_LINEAR_____12_CM 1 100. 0. 255. ECU_ADDRESS 0x3fd5f5 FORMAT "%3.0" /end MEASUREMENT
/begin MEASUREMENT CTR_ABC_LOAD_PLAUS "" UBYTE _CNV_A_R_LINEAR_____10_CM 1 100. 0. 255. ECU_ADDRESS 0x3fd676 FORMAT "%3.0" /end MEASUREMENT
/begin MEASUREMENT LV_CDN_DIAG_LOAD_PLAUS "" UBYTE _CNV_S_2_RANGE______21_R_CM 1 100. 0. 255. ECU_ADDRESS 0x3fd674 BIT_MASK 0x10 /end MEASUREMENT
/begin MEASUREMENT LV_END_DIAG_LOAD_PLAUS "" UBYTE _CNV_S_2_RANGE______21_R_CM 1 100. 0. 255. ECU_ADDRESS 0x3fd674 BIT_MASK 0x20 /end MEASUREMENT
/begin MEASUREMENT LV_READY_LOAD_PLAUS "" UBYTE _CNV_S_2_RANGE______21_R_CM 1 100. 0. 255. ECU_ADDRESS 0x3fd674 BIT_MASK 0x40 /end MEASUREMENT
/begin MEASUREMENT ERR_SYM_LOAD_PLAUS "" UBYTE _CNV_S_6_RANGE_ERR__22_CM 1 100. 0. 15. ECU_ADDRESS 0x3fd674 BIT_MASK 0xF /end MEASUREMENT
/begin MEASUREMENT LV_ERR_MEM_LOAD_PLAUS "" UBYTE _CNV_S_2_RANGE______21_R_CM 1 100. 0. 255. ECU_ADDRESS 0x3fd674 BIT_MASK 0x80 /end MEASUREMENT
/begin MEASUREMENT CTR_ABC_END_DIAG_LOAD_PLAUS "" UBYTE _CNV_A_R_LINEAR_____12_CM 1 100. 0. 255. ECU_ADDRESS 0x3fd675 FORMAT "%3.0" /end MEASUREMENT
/begin MEASUREMENT CTR_ABC_N_32_MON_1 "" UBYTE _CNV_A_R_LINEAR_____10_CM 1 100. 0. 255. ECU_ADDRESS 0x3fd54a FORMAT "%3.0" /end MEASUREMENT
/begin MEASUREMENT LV_CDN_DIAG_N_32_MON_1 "" UBYTE _CNV_S_2_RANGE______21_R_CM 1 100. 0. 255. ECU_ADDRESS 0x3fd548 BIT_MASK 0x10 /end MEASUREMENT
/begin MEASUREMENT LV_END_DIAG_N_32_MON_1 "" UBYTE _CNV_S_2_RANGE______21_R_CM 1 100. 0. 255. ECU_ADDRESS 0x3fd548 BIT_MASK 0x20 /end MEASUREMENT
/begin MEASUREMENT LV_READY_N_32_MON_1 "" UBYTE _CNV_S_2_RANGE______21_R_CM 1 100. 0. 255. ECU_ADDRESS 0x3fd548 BIT_MASK 0x40 /end MEASUREMENT
/begin MEASUREMENT ERR_SYM_N_32_MON_1 "" UBYTE _CNV_S_6_RANGE_ERR__22_CM 1 100. 0. 15. ECU_ADDRESS 0x3fd548 BIT_MASK 0xF /end MEASUREMENT
/begin MEASUREMENT LV_ERR_MEM_N_32_MON_1 "" UBYTE _CNV_S_2_RANGE______21_R_CM 1 100. 0. 255. ECU_ADDRESS 0x3fd548 BIT_MASK 0x80 /end MEASUREMENT
/begin MEASUREMENT CTR_ABC_END_DIAG_N_32_MON_1 "" UBYTE _CNV_A_R_LINEAR_____12_CM 1 100. 0. 255. ECU_ADDRESS 0x3fd549 FORMAT "%3.0" /end MEASUREMENT
/begin MEASUREMENT CTR_ABC_CAM_0_NOT_PLAUS "" UBYTE _CNV_A_R_LINEAR_____10_CM 1 100. 0. 255. ECU_ADDRESS 0x3fd4b6 FORMAT "%3.0" /end MEASUREMENT
/begin MEASUREMENT LV_CDN_DIAG_CAM_0_NOT_PLAUS "" UBYTE _CNV_S_2_RANGE______21_R_CM 1 100. 0. 255. ECU_ADDRESS 0x3fd4b4 BIT_MASK 0x10 /end MEASUREMENT
/begin MEASUREMENT LV_END_DIAG_CAM_0_NOT_PLAUS "" UBYTE _CNV_S_2_RANGE______21_R_CM 1 100. 0. 255. ECU_ADDRESS 0x3fd4b4 BIT_MASK 0x20 /end MEASUREMENT
/begin MEASUREMENT LV_READY_CAM_0_NOT_PLAUS "" UBYTE _CNV_S_2_RANGE______21_R_CM 1 100. 0. 255. ECU_ADDRESS 0x3fd4b4 BIT_MASK 0x40 /end MEASUREMENT
/begin MEASUREMENT ERR_SYM_CAM_0_NOT_PLAUS "" UBYTE _CNV_S_6_RANGE_ERR__22_CM 1 100. 0. 15. ECU_ADDRESS 0x3fd4b4 BIT_MASK 0xF /end MEASUREMENT
/begin MEASUREMENT LV_ERR_MEM_CAM_0_NOT_PLAUS "" UBYTE _CNV_S_2_RANGE______21_R_CM 1 100. 0. 255. ECU_ADDRESS 0x3fd4b4 BIT_MASK 0x80 /end MEASUREMENT
/begin MEASUREMENT CTR_ABC_END_DIAG_CAM_0_NOT_PLAUS "" UBYTE _CNV_A_R_LINEAR_____12_CM 1 100. 0. 255. ECU_ADDRESS 0x3fd4b5 FORMAT "%3.0" /end MEASUREMENT
/begin MEASUREMENT CTR_ABC_PVS_RATIO "" UBYTE _CNV_A_R_LINEAR_____10_CM 1 100. 0. 255. ECU_ADDRESS 0x3fd472 FORMAT "%3.0" /end MEASUREMENT
/begin MEASUREMENT LV_CDN_DIAG_PVS_RATIO "" UBYTE _CNV_S_2_RANGE______21_R_CM 1 100. 0. 255. ECU_ADDRESS 0x3fd470 BIT_MASK 0x10 /end MEASUREMENT
/begin MEASUREMENT LV_END_DIAG_PVS_RATIO "" UBYTE _CNV_S_2_RANGE______21_R_CM 1 100. 0. 255. ECU_ADDRESS 0x3fd470 BIT_MASK 0x20 /end MEASUREMENT
/begin MEASUREMENT LV_READY_PVS_RATIO "" UBYTE _CNV_S_2_RANGE______21_R_CM 1 100. 0. 255. ECU_ADDRESS 0x3fd470 BIT_MASK 0x40 /end MEASUREMENT
/begin MEASUREMENT ERR_SYM_PVS_RATIO "" UBYTE _CNV_S_6_RANGE_ERR__22_CM 1 100. 0. 15. ECU_ADDRESS 0x3fd470 BIT_MASK 0xF /end MEASUREMENT
/begin MEASUREMENT LV_ERR_MEM_PVS_RATIO "" UBYTE _CNV_S_2_RANGE______21_R_CM 1 100. 0. 255. ECU_ADDRESS 0x3fd470 BIT_MASK 0x80 /end MEASUREMENT
/begin MEASUREMENT CTR_ABC_END_DIAG_PVS_RATIO "" UBYTE _CNV_A_R_LINEAR_____12_CM 1 100. 0. 255. ECU_ADDRESS 0x3fd471 FORMAT "%3.0" /end MEASUREMENT
/begin MEASUREMENT CTR_ABC_LSH_DOWN_1 "" UBYTE _CNV_A_R_LINEAR_____10_CM 1 100. 0. 255. ECU_ADDRESS 0x3fd3ae FORMAT "%3.0" /end MEASUREMENT
/begin MEASUREMENT LV_CDN_DIAG_LSH_DOWN_1 "" UBYTE _CNV_S_2_RANGE______21_R_CM 1 100. 0. 255. ECU_ADDRESS 0x3fd3ac BIT_MASK 0x10 /end MEASUREMENT
/begin MEASUREMENT LV_END_DIAG_LSH_DOWN_1 "" UBYTE _CNV_S_2_RANGE______21_R_CM 1 100. 0. 255. ECU_ADDRESS 0x3fd3ac BIT_MASK 0x20 /end MEASUREMENT
/begin MEASUREMENT LV_READY_LSH_DOWN_1 "" UBYTE _CNV_S_2_RANGE______21_R_CM 1 100. 0. 255. ECU_ADDRESS 0x3fd3ac BIT_MASK 0x40 /end MEASUREMENT
/begin MEASUREMENT ERR_SYM_LSH_DOWN_1 "" UBYTE _CNV_S_6_RANGE_ERR__22_CM 1 100. 0. 15. ECU_ADDRESS 0x3fd3ac BIT_MASK 0xF /end MEASUREMENT
/begin MEASUREMENT LV_ERR_MEM_LSH_DOWN_1 "" UBYTE _CNV_S_2_RANGE______21_R_CM 1 100. 0. 255. ECU_ADDRESS 0x3fd3ac BIT_MASK 0x80 /end MEASUREMENT
/begin MEASUREMENT CTR_ABC_END_DIAG_LSH_DOWN_1 "" UBYTE _CNV_A_R_LINEAR_____12_CM 1 100. 0. 255. ECU_ADDRESS 0x3fd3ad FORMAT "%3.0" /end MEASUREMENT
/begin MEASUREMENT CTR_ABC_TOUT_ASR_1 "" UBYTE _CNV_A_R_LINEAR_____10_CM 1 100. 0. 255. ECU_ADDRESS 0x3fd406 FORMAT "%3.0" /end MEASUREMENT
/begin MEASUREMENT LV_CDN_DIAG_TOUT_ASR_1 "" UBYTE _CNV_S_2_RANGE______21_R_CM 1 100. 0. 255. ECU_ADDRESS 0x3fd404 BIT_MASK 0x10 /end MEASUREMENT
/begin MEASUREMENT LV_END_DIAG_TOUT_ASR_1 "" UBYTE _CNV_S_2_RANGE______21_R_CM 1 100. 0. 255. ECU_ADDRESS 0x3fd404 BIT_MASK 0x20 /end MEASUREMENT
/begin MEASUREMENT LV_READY_TOUT_ASR_1 "" UBYTE _CNV_S_2_RANGE______21_R_CM 1 100. 0. 255. ECU_ADDRESS 0x3fd404 BIT_MASK 0x40 /end MEASUREMENT
/begin MEASUREMENT ERR_SYM_TOUT_ASR_1 "" UBYTE _CNV_S_6_RANGE_ERR__22_CM 1 100. 0. 15. ECU_ADDRESS 0x3fd404 BIT_MASK 0xF /end MEASUREMENT
/begin MEASUREMENT LV_ERR_MEM_TOUT_ASR_1 "" UBYTE _CNV_S_2_RANGE______21_R_CM 1 100. 0. 255. ECU_ADDRESS 0x3fd404 BIT_MASK 0x80 /end MEASUREMENT
/begin MEASUREMENT CTR_ABC_END_DIAG_TOUT_ASR_1 "" UBYTE _CNV_A_R_LINEAR_____12_CM 1 100. 0. 255. ECU_ADDRESS 0x3fd405 FORMAT "%3.0" /end MEASUREMENT
/begin MEASUREMENT CTR_ABC_LSH_DOWN_2 "" UBYTE _CNV_A_R_LINEAR_____10_CM 1 100. 0. 255. ECU_ADDRESS 0x3fd3b2 FORMAT "%3.0" /end MEASUREMENT
/begin MEASUREMENT LV_CDN_DIAG_LSH_DOWN_2 "" UBYTE _CNV_S_2_RANGE______21_R_CM 1 100. 0. 255. ECU_ADDRESS 0x3fd3b0 BIT_MASK 0x10 /end MEASUREMENT
/begin MEASUREMENT LV_END_DIAG_LSH_DOWN_2 "" UBYTE _CNV_S_2_RANGE______21_R_CM 1 100. 0. 255. ECU_ADDRESS 0x3fd3b0 BIT_MASK 0x20 /end MEASUREMENT
/begin MEASUREMENT LV_READY_LSH_DOWN_2 "" UBYTE _CNV_S_2_RANGE______21_R_CM 1 100. 0. 255. ECU_ADDRESS 0x3fd3b0 BIT_MASK 0x40 /end MEASUREMENT
/begin MEASUREMENT ERR_SYM_LSH_DOWN_2 "" UBYTE _CNV_S_6_RANGE_ERR__22_CM 1 100. 0. 15. ECU_ADDRESS 0x3fd3b0 BIT_MASK 0xF /end MEASUREMENT
/begin MEASUREMENT LV_ERR_MEM_LSH_DOWN_2 "" UBYTE _CNV_S_2_RANGE______21_R_CM 1 100. 0. 255. ECU_ADDRESS 0x3fd3b0 BIT_MASK 0x80 /end MEASUREMENT
/begin MEASUREMENT CTR_ABC_END_DIAG_LSH_DOWN_2 "" UBYTE _CNV_A_R_LINEAR_____12_CM 1 100. 0. 255. ECU_ADDRESS 0x3fd3b1 FORMAT "%3.0" /end MEASUREMENT
/begin MEASUREMENT CTR_ABC_TOUT_ASR_3 "" UBYTE _CNV_A_R_LINEAR_____10_CM 1 100. 0. 255. ECU_ADDRESS 0x3fd40a FORMAT "%3.0" /end MEASUREMENT
/begin MEASUREMENT LV_CDN_DIAG_TOUT_ASR_3 "" UBYTE _CNV_S_2_RANGE______21_R_CM 1 100. 0. 255. ECU_ADDRESS 0x3fd408 BIT_MASK 0x10 /end MEASUREMENT
/begin MEASUREMENT LV_END_DIAG_TOUT_ASR_3 "" UBYTE _CNV_S_2_RANGE______21_R_CM 1 100. 0. 255. ECU_ADDRESS 0x3fd408 BIT_MASK 0x20 /end MEASUREMENT
/begin MEASUREMENT LV_READY_TOUT_ASR_3 "" UBYTE _CNV_S_2_RANGE______21_R_CM 1 100. 0. 255. ECU_ADDRESS 0x3fd408 BIT_MASK 0x40 /end MEASUREMENT
/begin MEASUREMENT ERR_SYM_TOUT_ASR_3 "" UBYTE _CNV_S_6_RANGE_ERR__22_CM 1 100. 0. 15. ECU_ADDRESS 0x3fd408 BIT_MASK 0xF /end MEASUREMENT
/begin MEASUREMENT LV_ERR_MEM_TOUT_ASR_3 "" UBYTE _CNV_S_2_RANGE______21_R_CM 1 100. 0. 255. ECU_ADDRESS 0x3fd408 BIT_MASK 0x80 /end MEASUREMENT
/begin MEASUREMENT CTR_ABC_END_DIAG_TOUT_ASR_3 "" UBYTE _CNV_A_R_LINEAR_____12_CM 1 100. 0. 255. ECU_ADDRESS 0x3fd409 FORMAT "%3.0" /end MEASUREMENT
/begin MEASUREMENT CTR_ABC_LSH_UP_1 "" UBYTE _CNV_A_R_LINEAR_____10_CM 1 100. 0. 255. ECU_ADDRESS 0x3fd3a6 FORMAT "%3.0" /end MEASUREMENT
/begin MEASUREMENT LV_CDN_DIAG_LSH_UP_1 "" UBYTE _CNV_S_2_RANGE______21_R_CM 1 100. 0. 255. ECU_ADDRESS 0x3fd3a4 BIT_MASK 0x10 /end MEASUREMENT
/begin MEASUREMENT LV_END_DIAG_LSH_UP_1 "" UBYTE _CNV_S_2_RANGE______21_R_CM 1 100. 0. 255. ECU_ADDRESS 0x3fd3a4 BIT_MASK 0x20 /end MEASUREMENT
/begin MEASUREMENT LV_READY_LSH_UP_1 "" UBYTE _CNV_S_2_RANGE______21_R_CM 1 100. 0. 255. ECU_ADDRESS 0x3fd3a4 BIT_MASK 0x40 /end MEASUREMENT
/begin MEASUREMENT ERR_SYM_LSH_UP_1 "" UBYTE _CNV_S_6_RANGE_ERR__22_CM 1 100. 0. 15. ECU_ADDRESS 0x3fd3a4 BIT_MASK 0xF /end MEASUREMENT
/begin MEASUREMENT LV_ERR_MEM_LSH_UP_1 "" UBYTE _CNV_S_2_RANGE______21_R_CM 1 100. 0. 255. ECU_ADDRESS 0x3fd3a4 BIT_MASK 0x80 /end MEASUREMENT
/begin MEASUREMENT CTR_ABC_END_DIAG_LSH_UP_1 "" UBYTE _CNV_A_R_LINEAR_____12_CM 1 100. 0. 255. ECU_ADDRESS 0x3fd3a5 FORMAT "%3.0" /end MEASUREMENT
/begin MEASUREMENT CTR_ABC_LSH_UP_2 "" UBYTE _CNV_A_R_LINEAR_____10_CM 1 100. 0. 255. ECU_ADDRESS 0x3fd3aa FORMAT "%3.0" /end MEASUREMENT
/begin MEASUREMENT LV_CDN_DIAG_LSH_UP_2 "" UBYTE _CNV_S_2_RANGE______21_R_CM 1 100. 0. 255. ECU_ADDRESS 0x3fd3a8 BIT_MASK 0x10 /end MEASUREMENT
/begin MEASUREMENT LV_END_DIAG_LSH_UP_2 "" UBYTE _CNV_S_2_RANGE______21_R_CM 1 100. 0. 255. ECU_ADDRESS 0x3fd3a8 BIT_MASK 0x20 /end MEASUREMENT
/begin MEASUREMENT LV_READY_LSH_UP_2 "" UBYTE _CNV_S_2_RANGE______21_R_CM 1 100. 0. 255. ECU_ADDRESS 0x3fd3a8 BIT_MASK 0x40 /end MEASUREMENT
/begin MEASUREMENT ERR_SYM_LSH_UP_2 "" UBYTE _CNV_S_6_RANGE_ERR__22_CM 1 100. 0. 15. ECU_ADDRESS 0x3fd3a8 BIT_MASK 0xF /end MEASUREMENT
/begin MEASUREMENT LV_ERR_MEM_LSH_UP_2 "" UBYTE _CNV_S_2_RANGE______21_R_CM 1 100. 0. 255. ECU_ADDRESS 0x3fd3a8 BIT_MASK 0x80 /end MEASUREMENT
/begin MEASUREMENT CTR_ABC_END_DIAG_LSH_UP_2 "" UBYTE _CNV_A_R_LINEAR_____12_CM 1 100. 0. 255. ECU_ADDRESS 0x3fd3a9 FORMAT "%3.0" /end MEASUREMENT
/begin MEASUREMENT CTR_ABC_ENG_PSN "" UBYTE _CNV_A_R_LINEAR_____10_CM 1 100. 0. 255. ECU_ADDRESS 0x3fd4be FORMAT "%3.0" /end MEASUREMENT
/begin MEASUREMENT LV_CDN_DIAG_ENG_PSN "" UBYTE _CNV_S_2_RANGE______21_R_CM 1 100. 0. 255. ECU_ADDRESS 0x3fd4bc BIT_MASK 0x10 /end MEASUREMENT
/begin MEASUREMENT LV_END_DIAG_ENG_PSN "" UBYTE _CNV_S_2_RANGE______21_R_CM 1 100. 0. 255. ECU_ADDRESS 0x3fd4bc BIT_MASK 0x20 /end MEASUREMENT
/begin MEASUREMENT LV_READY_ENG_PSN "" UBYTE _CNV_S_2_RANGE______21_R_CM 1 100. 0. 255. ECU_ADDRESS 0x3fd4bc BIT_MASK 0x40 /end MEASUREMENT
/begin MEASUREMENT ERR_SYM_ENG_PSN "" UBYTE _CNV_S_6_RANGE_ERR__22_CM 1 100. 0. 15. ECU_ADDRESS 0x3fd4bc BIT_MASK 0xF /end MEASUREMENT
/begin MEASUREMENT LV_ERR_MEM_ENG_PSN "" UBYTE _CNV_S_2_RANGE______21_R_CM 1 100. 0. 255. ECU_ADDRESS 0x3fd4bc BIT_MASK 0x80 /end MEASUREMENT
/begin MEASUREMENT CTR_ABC_END_DIAG_ENG_PSN "" UBYTE _CNV_A_R_LINEAR_____12_CM 1 100. 0. 255. ECU_ADDRESS 0x3fd4bd FORMAT "%3.0" /end MEASUREMENT
/begin MEASUREMENT CTR_ABC_TOUT_AMT_1 "" UBYTE _CNV_A_R_LINEAR_____10_CM 1 100. 0. 255. ECU_ADDRESS 0x3fd412 FORMAT "%3.0" /end MEASUREMENT
/begin MEASUREMENT LV_CDN_DIAG_TOUT_AMT_1 "" UBYTE _CNV_S_2_RANGE______21_R_CM 1 100. 0. 255. ECU_ADDRESS 0x3fd410 BIT_MASK 0x10 /end MEASUREMENT
/begin MEASUREMENT LV_END_DIAG_TOUT_AMT_1 "" UBYTE _CNV_S_2_RANGE______21_R_CM 1 100. 0. 255. ECU_ADDRESS 0x3fd410 BIT_MASK 0x20 /end MEASUREMENT
/begin MEASUREMENT LV_READY_TOUT_AMT_1 "" UBYTE _CNV_S_2_RANGE______21_R_CM 1 100. 0. 255. ECU_ADDRESS 0x3fd410 BIT_MASK 0x40 /end MEASUREMENT
/begin MEASUREMENT ERR_SYM_TOUT_AMT_1 "" UBYTE _CNV_S_6_RANGE_ERR__22_CM 1 100. 0. 15. ECU_ADDRESS 0x3fd410 BIT_MASK 0xF /end MEASUREMENT
/begin MEASUREMENT LV_ERR_MEM_TOUT_AMT_1 "" UBYTE _CNV_S_2_RANGE______21_R_CM 1 100. 0. 255. ECU_ADDRESS 0x3fd410 BIT_MASK 0x80 /end MEASUREMENT
/begin MEASUREMENT CTR_ABC_END_DIAG_TOUT_AMT_1 "" UBYTE _CNV_A_R_LINEAR_____12_CM 1 100. 0. 255. ECU_ADDRESS 0x3fd411 FORMAT "%3.0" /end MEASUREMENT
/begin MEASUREMENT CTR_ABC_MSW_TOG "" UBYTE _CNV_A_R_LINEAR_____10_CM 1 100. 0. 255. ECU_ADDRESS 0x3fd512 FORMAT "%3.0" /end MEASUREMENT
/begin MEASUREMENT LV_CDN_DIAG_MSW_TOG "" UBYTE _CNV_S_2_RANGE______21_R_CM 1 100. 0. 255. ECU_ADDRESS 0x3fd510 BIT_MASK 0x10 /end MEASUREMENT
/begin MEASUREMENT LV_END_DIAG_MSW_TOG "" UBYTE _CNV_S_2_RANGE______21_R_CM 1 100. 0. 255. ECU_ADDRESS 0x3fd510 BIT_MASK 0x20 /end MEASUREMENT
/begin MEASUREMENT LV_READY_MSW_TOG "" UBYTE _CNV_S_2_RANGE______21_R_CM 1 100. 0. 255. ECU_ADDRESS 0x3fd510 BIT_MASK 0x40 /end MEASUREMENT
/begin MEASUREMENT ERR_SYM_MSW_TOG "" UBYTE _CNV_S_6_RANGE_ERR__22_CM 1 100. 0. 15. ECU_ADDRESS 0x3fd510 BIT_MASK 0xF /end MEASUREMENT
/begin MEASUREMENT LV_ERR_MEM_MSW_TOG "" UBYTE _CNV_S_2_RANGE______21_R_CM 1 100. 0. 255. ECU_ADDRESS 0x3fd510 BIT_MASK 0x80 /end MEASUREMENT
/begin MEASUREMENT CTR_ABC_END_DIAG_MSW_TOG "" UBYTE _CNV_A_R_LINEAR_____12_CM 1 100. 0. 255. ECU_ADDRESS 0x3fd511 FORMAT "%3.0" /end MEASUREMENT
/begin MEASUREMENT CTR_ABC_BN_ARS "" UBYTE _CNV_A_R_LINEAR_____10_CM 1 100. 0. 255. ECU_ADDRESS 0x3fd62a FORMAT "%3.0" /end MEASUREMENT
/begin MEASUREMENT LV_CDN_DIAG_BN_ARS "" UBYTE _CNV_S_2_RANGE______21_R_CM 1 100. 0. 255. ECU_ADDRESS 0x3fd628 BIT_MASK 0x10 /end MEASUREMENT
/begin MEASUREMENT LV_END_DIAG_BN_ARS "" UBYTE _CNV_S_2_RANGE______21_R_CM 1 100. 0. 255. ECU_ADDRESS 0x3fd628 BIT_MASK 0x20 /end MEASUREMENT
/begin MEASUREMENT LV_READY_BN_ARS "" UBYTE _CNV_S_2_RANGE______21_R_CM 1 100. 0. 255. ECU_ADDRESS 0x3fd628 BIT_MASK 0x40 /end MEASUREMENT
/begin MEASUREMENT ERR_SYM_BN_ARS "" UBYTE _CNV_S_6_RANGE_ERR__22_CM 1 100. 0. 15. ECU_ADDRESS 0x3fd628 BIT_MASK 0xF /end MEASUREMENT
/begin MEASUREMENT LV_ERR_MEM_BN_ARS "" UBYTE _CNV_S_2_RANGE______21_R_CM 1 100. 0. 255. ECU_ADDRESS 0x3fd628 BIT_MASK 0x80 /end MEASUREMENT
/begin MEASUREMENT CTR_ABC_END_DIAG_BN_ARS "" UBYTE _CNV_A_R_LINEAR_____12_CM 1 100. 0. 255. ECU_ADDRESS 0x3fd629 FORMAT "%3.0" /end MEASUREMENT
/begin MEASUREMENT CTR_ABC_VLS_DOWN_PUE_1 "" UBYTE _CNV_A_R_LINEAR_____10_CM 1 100. 0. 255. ECU_ADDRESS 0x3fd5b6 FORMAT "%3.0" /end MEASUREMENT
/begin MEASUREMENT LV_CDN_DIAG_VLS_DOWN_PUE_1 "" UBYTE _CNV_S_2_RANGE______21_R_CM 1 100. 0. 255. ECU_ADDRESS 0x3fd5b4 BIT_MASK 0x10 /end MEASUREMENT
/begin MEASUREMENT LV_END_DIAG_VLS_DOWN_PUE_1 "" UBYTE _CNV_S_2_RANGE______21_R_CM 1 100. 0. 255. ECU_ADDRESS 0x3fd5b4 BIT_MASK 0x20 /end MEASUREMENT
/begin MEASUREMENT LV_READY_VLS_DOWN_PUE_1 "" UBYTE _CNV_S_2_RANGE______21_R_CM 1 100. 0. 255. ECU_ADDRESS 0x3fd5b4 BIT_MASK 0x40 /end MEASUREMENT
/begin MEASUREMENT ERR_SYM_VLS_DOWN_PUE_1 "" UBYTE _CNV_S_6_RANGE_ERR__22_CM 1 100. 0. 15. ECU_ADDRESS 0x3fd5b4 BIT_MASK 0xF /end MEASUREMENT
/begin MEASUREMENT LV_ERR_MEM_VLS_DOWN_PUE_1 "" UBYTE _CNV_S_2_RANGE______21_R_CM 1 100. 0. 255. ECU_ADDRESS 0x3fd5b4 BIT_MASK 0x80 /end MEASUREMENT
/begin MEASUREMENT CTR_ABC_END_DIAG_VLS_DOWN_PUE_1 "" UBYTE _CNV_A_R_LINEAR_____12_CM 1 100. 0. 255. ECU_ADDRESS 0x3fd5b5 FORMAT "%3.0" /end MEASUREMENT
/begin MEASUREMENT CTR_ABC_VLS_DOWN_PUE_2 "" UBYTE _CNV_A_R_LINEAR_____10_CM 1 100. 0. 255. ECU_ADDRESS 0x3fd5ba FORMAT "%3.0" /end MEASUREMENT
/begin MEASUREMENT LV_CDN_DIAG_VLS_DOWN_PUE_2 "" UBYTE _CNV_S_2_RANGE______21_R_CM 1 100. 0. 255. ECU_ADDRESS 0x3fd5b8 BIT_MASK 0x10 /end MEASUREMENT
/begin MEASUREMENT LV_END_DIAG_VLS_DOWN_PUE_2 "" UBYTE _CNV_S_2_RANGE______21_R_CM 1 100. 0. 255. ECU_ADDRESS 0x3fd5b8 BIT_MASK 0x20 /end MEASUREMENT
/begin MEASUREMENT LV_READY_VLS_DOWN_PUE_2 "" UBYTE _CNV_S_2_RANGE______21_R_CM 1 100. 0. 255. ECU_ADDRESS 0x3fd5b8 BIT_MASK 0x40 /end MEASUREMENT
/begin MEASUREMENT ERR_SYM_VLS_DOWN_PUE_2 "" UBYTE _CNV_S_6_RANGE_ERR__22_CM 1 100. 0. 15. ECU_ADDRESS 0x3fd5b8 BIT_MASK 0xF /end MEASUREMENT
/begin MEASUREMENT LV_ERR_MEM_VLS_DOWN_PUE_2 "" UBYTE _CNV_S_2_RANGE______21_R_CM 1 100. 0. 255. ECU_ADDRESS 0x3fd5b8 BIT_MASK 0x80 /end MEASUREMENT
/begin MEASUREMENT CTR_ABC_END_DIAG_VLS_DOWN_PUE_2 "" UBYTE _CNV_A_R_LINEAR_____12_CM 1 100. 0. 255. ECU_ADDRESS 0x3fd5b9 FORMAT "%3.0" /end MEASUREMENT
/begin MEASUREMENT CTR_ABC_LS_UP_SWT_1 "" UBYTE _CNV_A_R_LINEAR_____10_CM 1 100. 0. 255. ECU_ADDRESS 0x3fd6de FORMAT "%3.0" /end MEASUREMENT
/begin MEASUREMENT LV_CDN_DIAG_LS_UP_SWT_1 "" UBYTE _CNV_S_2_RANGE______21_R_CM 1 100. 0. 255. ECU_ADDRESS 0x3fd6dc BIT_MASK 0x10 /end MEASUREMENT
/begin MEASUREMENT LV_END_DIAG_LS_UP_SWT_1 "" UBYTE _CNV_S_2_RANGE______21_R_CM 1 100. 0. 255. ECU_ADDRESS 0x3fd6dc BIT_MASK 0x20 /end MEASUREMENT
/begin MEASUREMENT LV_READY_LS_UP_SWT_1 "" UBYTE _CNV_S_2_RANGE______21_R_CM 1 100. 0. 255. ECU_ADDRESS 0x3fd6dc BIT_MASK 0x40 /end MEASUREMENT
/begin MEASUREMENT ERR_SYM_LS_UP_SWT_1 "" UBYTE _CNV_S_6_RANGE_ERR__22_CM 1 100. 0. 15. ECU_ADDRESS 0x3fd6dc BIT_MASK 0xF /end MEASUREMENT
/begin MEASUREMENT LV_ERR_MEM_LS_UP_SWT_1 "" UBYTE _CNV_S_2_RANGE______21_R_CM 1 100. 0. 255. ECU_ADDRESS 0x3fd6dc BIT_MASK 0x80 /end MEASUREMENT
/begin MEASUREMENT CTR_ABC_END_DIAG_LS_UP_SWT_1 "" UBYTE _CNV_A_R_LINEAR_____12_CM 1 100. 0. 255. ECU_ADDRESS 0x3fd6dd FORMAT "%3.0" /end MEASUREMENT
/begin MEASUREMENT CTR_ABC_LS_UP_SWT_2 "" UBYTE _CNV_A_R_LINEAR_____10_CM 1 100. 0. 255. ECU_ADDRESS 0x3fd6e2 FORMAT "%3.0" /end MEASUREMENT
/begin MEASUREMENT LV_CDN_DIAG_LS_UP_SWT_2 "" UBYTE _CNV_S_2_RANGE______21_R_CM 1 100. 0. 255. ECU_ADDRESS 0x3fd6e0 BIT_MASK 0x10 /end MEASUREMENT
/begin MEASUREMENT LV_END_DIAG_LS_UP_SWT_2 "" UBYTE _CNV_S_2_RANGE______21_R_CM 1 100. 0. 255. ECU_ADDRESS 0x3fd6e0 BIT_MASK 0x20 /end MEASUREMENT
/begin MEASUREMENT LV_READY_LS_UP_SWT_2 "" UBYTE _CNV_S_2_RANGE______21_R_CM 1 100. 0. 255. ECU_ADDRESS 0x3fd6e0 BIT_MASK 0x40 /end MEASUREMENT
/begin MEASUREMENT ERR_SYM_LS_UP_SWT_2 "" UBYTE _CNV_S_6_RANGE_ERR__22_CM 1 100. 0. 15. ECU_ADDRESS 0x3fd6e0 BIT_MASK 0xF /end MEASUREMENT
/begin MEASUREMENT LV_ERR_MEM_LS_UP_SWT_2 "" UBYTE _CNV_S_2_RANGE______21_R_CM 1 100. 0. 255. ECU_ADDRESS 0x3fd6e0 BIT_MASK 0x80 /end MEASUREMENT
/begin MEASUREMENT CTR_ABC_END_DIAG_LS_UP_SWT_2 "" UBYTE _CNV_A_R_LINEAR_____12_CM 1 100. 0. 255. ECU_ADDRESS 0x3fd6e1 FORMAT "%3.0" /end MEASUREMENT
/begin MEASUREMENT CTR_ABC_TOUT_PSTE_1 "" UBYTE _CNV_A_R_LINEAR_____10_CM 1 100. 0. 255. ECU_ADDRESS 0x3fd40e FORMAT "%3.0" /end MEASUREMENT
/begin MEASUREMENT LV_CDN_DIAG_TOUT_PSTE_1 "" UBYTE _CNV_S_2_RANGE______21_R_CM 1 100. 0. 255. ECU_ADDRESS 0x3fd40c BIT_MASK 0x10 /end MEASUREMENT
/begin MEASUREMENT LV_END_DIAG_TOUT_PSTE_1 "" UBYTE _CNV_S_2_RANGE______21_R_CM 1 100. 0. 255. ECU_ADDRESS 0x3fd40c BIT_MASK 0x20 /end MEASUREMENT
/begin MEASUREMENT LV_READY_TOUT_PSTE_1 "" UBYTE _CNV_S_2_RANGE______21_R_CM 1 100. 0. 255. ECU_ADDRESS 0x3fd40c BIT_MASK 0x40 /end MEASUREMENT
/begin MEASUREMENT ERR_SYM_TOUT_PSTE_1 "" UBYTE _CNV_S_6_RANGE_ERR__22_CM 1 100. 0. 15. ECU_ADDRESS 0x3fd40c BIT_MASK 0xF /end MEASUREMENT
/begin MEASUREMENT LV_ERR_MEM_TOUT_PSTE_1 "" UBYTE _CNV_S_2_RANGE______21_R_CM 1 100. 0. 255. ECU_ADDRESS 0x3fd40c BIT_MASK 0x80 /end MEASUREMENT
/begin MEASUREMENT CTR_ABC_END_DIAG_TOUT_PSTE_1 "" UBYTE _CNV_A_R_LINEAR_____12_CM 1 100. 0. 255. ECU_ADDRESS 0x3fd40d FORMAT "%3.0" /end MEASUREMENT
/begin MEASUREMENT CTR_ABC_VIM "" UBYTE _CNV_A_R_LINEAR_____10_CM 1 100. 0. 255. ECU_ADDRESS 0x3fd4a2 FORMAT "%3.0" /end MEASUREMENT
/begin MEASUREMENT LV_CDN_DIAG_VIM "" UBYTE _CNV_S_2_RANGE______21_R_CM 1 100. 0. 255. ECU_ADDRESS 0x3fd4a0 BIT_MASK 0x10 /end MEASUREMENT
/begin MEASUREMENT LV_END_DIAG_VIM "" UBYTE _CNV_S_2_RANGE______21_R_CM 1 100. 0. 255. ECU_ADDRESS 0x3fd4a0 BIT_MASK 0x20 /end MEASUREMENT
/begin MEASUREMENT LV_READY_VIM "" UBYTE _CNV_S_2_RANGE______21_R_CM 1 100. 0. 255. ECU_ADDRESS 0x3fd4a0 BIT_MASK 0x40 /end MEASUREMENT
/begin MEASUREMENT ERR_SYM_VIM "" UBYTE _CNV_S_6_RANGE_ERR__22_CM 1 100. 0. 15. ECU_ADDRESS 0x3fd4a0 BIT_MASK 0xF /end MEASUREMENT
/begin MEASUREMENT LV_ERR_MEM_VIM "" UBYTE _CNV_S_2_RANGE______21_R_CM 1 100. 0. 255. ECU_ADDRESS 0x3fd4a0 BIT_MASK 0x80 /end MEASUREMENT
/begin MEASUREMENT CTR_ABC_END_DIAG_VIM "" UBYTE _CNV_A_R_LINEAR_____12_CM 1 100. 0. 255. ECU_ADDRESS 0x3fd4a1 FORMAT "%3.0" /end MEASUREMENT
/begin MEASUREMENT CTR_ABC_TQ_GS_INC_PLAUS "" UBYTE _CNV_A_R_LINEAR_____10_CM 1 100. 0. 255. ECU_ADDRESS 0x3fd612 FORMAT "%3.0" /end MEASUREMENT
/begin MEASUREMENT LV_CDN_DIAG_TQ_GS_INC_PLAUS "" UBYTE _CNV_S_2_RANGE______21_R_CM 1 100. 0. 255. ECU_ADDRESS 0x3fd610 BIT_MASK 0x10 /end MEASUREMENT
/begin MEASUREMENT LV_END_DIAG_TQ_GS_INC_PLAUS "" UBYTE _CNV_S_2_RANGE______21_R_CM 1 100. 0. 255. ECU_ADDRESS 0x3fd610 BIT_MASK 0x20 /end MEASUREMENT
/begin MEASUREMENT LV_READY_TQ_GS_INC_PLAUS "" UBYTE _CNV_S_2_RANGE______21_R_CM 1 100. 0. 255. ECU_ADDRESS 0x3fd610 BIT_MASK 0x40 /end MEASUREMENT
/begin MEASUREMENT ERR_SYM_TQ_GS_INC_PLAUS "" UBYTE _CNV_S_6_RANGE_ERR__22_CM 1 100. 0. 15. ECU_ADDRESS 0x3fd610 BIT_MASK 0xF /end MEASUREMENT
/begin MEASUREMENT LV_ERR_MEM_TQ_GS_INC_PLAUS "" UBYTE _CNV_S_2_RANGE______21_R_CM 1 100. 0. 255. ECU_ADDRESS 0x3fd610 BIT_MASK 0x80 /end MEASUREMENT
/begin MEASUREMENT CTR_ABC_END_DIAG_TQ_GS_INC_PLAUS "" UBYTE _CNV_A_R_LINEAR_____12_CM 1 100. 0. 255. ECU_ADDRESS 0x3fd611 FORMAT "%3.0" /end MEASUREMENT
/begin MEASUREMENT CTR_ABC_DCC_IRREV "" UBYTE _CNV_A_R_LINEAR_____10_CM 1 100. 0. 255. ECU_ADDRESS 0x3fd61a FORMAT "%3.0" /end MEASUREMENT
/begin MEASUREMENT LV_CDN_DIAG_DCC_IRREV "" UBYTE _CNV_S_2_RANGE______21_R_CM 1 100. 0. 255. ECU_ADDRESS 0x3fd618 BIT_MASK 0x10 /end MEASUREMENT
/begin MEASUREMENT LV_END_DIAG_DCC_IRREV "" UBYTE _CNV_S_2_RANGE______21_R_CM 1 100. 0. 255. ECU_ADDRESS 0x3fd618 BIT_MASK 0x20 /end MEASUREMENT
/begin MEASUREMENT LV_READY_DCC_IRREV "" UBYTE _CNV_S_2_RANGE______21_R_CM 1 100. 0. 255. ECU_ADDRESS 0x3fd618 BIT_MASK 0x40 /end MEASUREMENT
/begin MEASUREMENT ERR_SYM_DCC_IRREV "" UBYTE _CNV_S_6_RANGE_ERR__22_CM 1 100. 0. 15. ECU_ADDRESS 0x3fd618 BIT_MASK 0xF /end MEASUREMENT
/begin MEASUREMENT LV_ERR_MEM_DCC_IRREV "" UBYTE _CNV_S_2_RANGE______21_R_CM 1 100. 0. 255. ECU_ADDRESS 0x3fd618 BIT_MASK 0x80 /end MEASUREMENT
/begin MEASUREMENT CTR_ABC_END_DIAG_DCC_IRREV "" UBYTE _CNV_A_R_LINEAR_____12_CM 1 100. 0. 255. ECU_ADDRESS 0x3fd619 FORMAT "%3.0" /end MEASUREMENT
/begin MEASUREMENT CTR_ABC_DUR_IGC_0 "" UBYTE _CNV_A_R_LINEAR_____10_CM 1 100. 0. 255. ECU_ADDRESS 0x3fd43a FORMAT "%3.0" /end MEASUREMENT
/begin MEASUREMENT LV_CDN_DIAG_DUR_IGC_0 "" UBYTE _CNV_S_2_RANGE______21_R_CM 1 100. 0. 255. ECU_ADDRESS 0x3fd438 BIT_MASK 0x10 /end MEASUREMENT
/begin MEASUREMENT LV_END_DIAG_DUR_IGC_0 "" UBYTE _CNV_S_2_RANGE______21_R_CM 1 100. 0. 255. ECU_ADDRESS 0x3fd438 BIT_MASK 0x20 /end MEASUREMENT
/begin MEASUREMENT LV_READY_DUR_IGC_0 "" UBYTE _CNV_S_2_RANGE______21_R_CM 1 100. 0. 255. ECU_ADDRESS 0x3fd438 BIT_MASK 0x40 /end MEASUREMENT
/begin MEASUREMENT ERR_SYM_DUR_IGC_0 "" UBYTE _CNV_S_6_RANGE_ERR__22_CM 1 100. 0. 15. ECU_ADDRESS 0x3fd438 BIT_MASK 0xF /end MEASUREMENT
/begin MEASUREMENT LV_ERR_MEM_DUR_IGC_0 "" UBYTE _CNV_S_2_RANGE______21_R_CM 1 100. 0. 255. ECU_ADDRESS 0x3fd438 BIT_MASK 0x80 /end MEASUREMENT
/begin MEASUREMENT CTR_ABC_END_DIAG_DUR_IGC_0 "" UBYTE _CNV_A_R_LINEAR_____12_CM 1 100. 0. 255. ECU_ADDRESS 0x3fd439 FORMAT "%3.0" /end MEASUREMENT
/begin MEASUREMENT CTR_ABC_DUR_IGC_1 "" UBYTE _CNV_A_R_LINEAR_____10_CM 1 100. 0. 255. ECU_ADDRESS 0x3fd43e FORMAT "%3.0" /end MEASUREMENT
/begin MEASUREMENT LV_CDN_DIAG_DUR_IGC_1 "" UBYTE _CNV_S_2_RANGE______21_R_CM 1 100. 0. 255. ECU_ADDRESS 0x3fd43c BIT_MASK 0x10 /end MEASUREMENT
/begin MEASUREMENT LV_END_DIAG_DUR_IGC_1 "" UBYTE _CNV_S_2_RANGE______21_R_CM 1 100. 0. 255. ECU_ADDRESS 0x3fd43c BIT_MASK 0x20 /end MEASUREMENT
/begin MEASUREMENT LV_READY_DUR_IGC_1 "" UBYTE _CNV_S_2_RANGE______21_R_CM 1 100. 0. 255. ECU_ADDRESS 0x3fd43c BIT_MASK 0x40 /end MEASUREMENT
/begin MEASUREMENT ERR_SYM_DUR_IGC_1 "" UBYTE _CNV_S_6_RANGE_ERR__22_CM 1 100. 0. 15. ECU_ADDRESS 0x3fd43c BIT_MASK 0xF /end MEASUREMENT
/begin MEASUREMENT LV_ERR_MEM_DUR_IGC_1 "" UBYTE _CNV_S_2_RANGE______21_R_CM 1 100. 0. 255. ECU_ADDRESS 0x3fd43c BIT_MASK 0x80 /end MEASUREMENT
/begin MEASUREMENT CTR_ABC_END_DIAG_DUR_IGC_1 "" UBYTE _CNV_A_R_LINEAR_____12_CM 1 100. 0. 255. ECU_ADDRESS 0x3fd43d FORMAT "%3.0" /end MEASUREMENT
/begin MEASUREMENT CTR_ABC_DUR_IGC_2 "" UBYTE _CNV_A_R_LINEAR_____10_CM 1 100. 0. 255. ECU_ADDRESS 0x3fd442 FORMAT "%3.0" /end MEASUREMENT
/begin MEASUREMENT LV_CDN_DIAG_DUR_IGC_2 "" UBYTE _CNV_S_2_RANGE______21_R_CM 1 100. 0. 255. ECU_ADDRESS 0x3fd440 BIT_MASK 0x10 /end MEASUREMENT
/begin MEASUREMENT LV_END_DIAG_DUR_IGC_2 "" UBYTE _CNV_S_2_RANGE______21_R_CM 1 100. 0. 255. ECU_ADDRESS 0x3fd440 BIT_MASK 0x20 /end MEASUREMENT
/begin MEASUREMENT LV_READY_DUR_IGC_2 "" UBYTE _CNV_S_2_RANGE______21_R_CM 1 100. 0. 255. ECU_ADDRESS 0x3fd440 BIT_MASK 0x40 /end MEASUREMENT
/begin MEASUREMENT ERR_SYM_DUR_IGC_2 "" UBYTE _CNV_S_6_RANGE_ERR__22_CM 1 100. 0. 15. ECU_ADDRESS 0x3fd440 BIT_MASK 0xF /end MEASUREMENT
/begin MEASUREMENT LV_ERR_MEM_DUR_IGC_2 "" UBYTE _CNV_S_2_RANGE______21_R_CM 1 100. 0. 255. ECU_ADDRESS 0x3fd440 BIT_MASK 0x80 /end MEASUREMENT
/begin MEASUREMENT CTR_ABC_END_DIAG_DUR_IGC_2 "" UBYTE _CNV_A_R_LINEAR_____12_CM 1 100. 0. 255. ECU_ADDRESS 0x3fd441 FORMAT "%3.0" /end MEASUREMENT
/begin MEASUREMENT CTR_ABC_DUR_IGC_3 "" UBYTE _CNV_A_R_LINEAR_____10_CM 1 100. 0. 255. ECU_ADDRESS 0x3fd446 FORMAT "%3.0" /end MEASUREMENT
/begin MEASUREMENT LV_CDN_DIAG_DUR_IGC_3 "" UBYTE _CNV_S_2_RANGE______21_R_CM 1 100. 0. 255. ECU_ADDRESS 0x3fd444 BIT_MASK 0x10 /end MEASUREMENT
/begin MEASUREMENT LV_END_DIAG_DUR_IGC_3 "" UBYTE _CNV_S_2_RANGE______21_R_CM 1 100. 0. 255. ECU_ADDRESS 0x3fd444 BIT_MASK 0x20 /end MEASUREMENT
/begin MEASUREMENT LV_READY_DUR_IGC_3 "" UBYTE _CNV_S_2_RANGE______21_R_CM 1 100. 0. 255. ECU_ADDRESS 0x3fd444 BIT_MASK 0x40 /end MEASUREMENT
/begin MEASUREMENT ERR_SYM_DUR_IGC_3 "" UBYTE _CNV_S_6_RANGE_ERR__22_CM 1 100. 0. 15. ECU_ADDRESS 0x3fd444 BIT_MASK 0xF /end MEASUREMENT
/begin MEASUREMENT LV_ERR_MEM_DUR_IGC_3 "" UBYTE _CNV_S_2_RANGE______21_R_CM 1 100. 0. 255. ECU_ADDRESS 0x3fd444 BIT_MASK 0x80 /end MEASUREMENT
/begin MEASUREMENT CTR_ABC_END_DIAG_DUR_IGC_3 "" UBYTE _CNV_A_R_LINEAR_____12_CM 1 100. 0. 255. ECU_ADDRESS 0x3fd445 FORMAT "%3.0" /end MEASUREMENT
/begin MEASUREMENT CTR_ABC_DUR_IGC_4 "" UBYTE _CNV_A_R_LINEAR_____10_CM 1 100. 0. 255. ECU_ADDRESS 0x3fd44a FORMAT "%3.0" /end MEASUREMENT
/begin MEASUREMENT LV_CDN_DIAG_DUR_IGC_4 "" UBYTE _CNV_S_2_RANGE______21_R_CM 1 100. 0. 255. ECU_ADDRESS 0x3fd448 BIT_MASK 0x10 /end MEASUREMENT
/begin MEASUREMENT LV_END_DIAG_DUR_IGC_4 "" UBYTE _CNV_S_2_RANGE______21_R_CM 1 100. 0. 255. ECU_ADDRESS 0x3fd448 BIT_MASK 0x20 /end MEASUREMENT
/begin MEASUREMENT LV_READY_DUR_IGC_4 "" UBYTE _CNV_S_2_RANGE______21_R_CM 1 100. 0. 255. ECU_ADDRESS 0x3fd448 BIT_MASK 0x40 /end MEASUREMENT
/begin MEASUREMENT ERR_SYM_DUR_IGC_4 "" UBYTE _CNV_S_6_RANGE_ERR__22_CM 1 100. 0. 15. ECU_ADDRESS 0x3fd448 BIT_MASK 0xF /end MEASUREMENT
/begin MEASUREMENT LV_ERR_MEM_DUR_IGC_4 "" UBYTE _CNV_S_2_RANGE______21_R_CM 1 100. 0. 255. ECU_ADDRESS 0x3fd448 BIT_MASK 0x80 /end MEASUREMENT
/begin MEASUREMENT CTR_ABC_END_DIAG_DUR_IGC_4 "" UBYTE _CNV_A_R_LINEAR_____12_CM 1 100. 0. 255. ECU_ADDRESS 0x3fd449 FORMAT "%3.0" /end MEASUREMENT
/begin MEASUREMENT CTR_ABC_DUR_IGC_5 "" UBYTE _CNV_A_R_LINEAR_____10_CM 1 100. 0. 255. ECU_ADDRESS 0x3fd44e FORMAT "%3.0" /end MEASUREMENT
/begin MEASUREMENT LV_CDN_DIAG_DUR_IGC_5 "" UBYTE _CNV_S_2_RANGE______21_R_CM 1 100. 0. 255. ECU_ADDRESS 0x3fd44c BIT_MASK 0x10 /end MEASUREMENT
/begin MEASUREMENT LV_END_DIAG_DUR_IGC_5 "" UBYTE _CNV_S_2_RANGE______21_R_CM 1 100. 0. 255. ECU_ADDRESS 0x3fd44c BIT_MASK 0x20 /end MEASUREMENT
/begin MEASUREMENT LV_READY_DUR_IGC_5 "" UBYTE _CNV_S_2_RANGE______21_R_CM 1 100. 0. 255. ECU_ADDRESS 0x3fd44c BIT_MASK 0x40 /end MEASUREMENT
/begin MEASUREMENT ERR_SYM_DUR_IGC_5 "" UBYTE _CNV_S_6_RANGE_ERR__22_CM 1 100. 0. 15. ECU_ADDRESS 0x3fd44c BIT_MASK 0xF /end MEASUREMENT
/begin MEASUREMENT LV_ERR_MEM_DUR_IGC_5 "" UBYTE _CNV_S_2_RANGE______21_R_CM 1 100. 0. 255. ECU_ADDRESS 0x3fd44c BIT_MASK 0x80 /end MEASUREMENT
/begin MEASUREMENT CTR_ABC_END_DIAG_DUR_IGC_5 "" UBYTE _CNV_A_R_LINEAR_____12_CM 1 100. 0. 255. ECU_ADDRESS 0x3fd44d FORMAT "%3.0" /end MEASUREMENT
/begin MEASUREMENT CTR_ABC_VLS_UP_MAX_1 "" UBYTE _CNV_A_R_LINEAR_____10_CM 1 100. 0. 255. ECU_ADDRESS 0x3fd6b6 FORMAT "%3.0" /end MEASUREMENT
/begin MEASUREMENT LV_CDN_DIAG_VLS_UP_MAX_1 "" UBYTE _CNV_S_2_RANGE______21_R_CM 1 100. 0. 255. ECU_ADDRESS 0x3fd6b4 BIT_MASK 0x10 /end MEASUREMENT
/begin MEASUREMENT LV_END_DIAG_VLS_UP_MAX_1 "" UBYTE _CNV_S_2_RANGE______21_R_CM 1 100. 0. 255. ECU_ADDRESS 0x3fd6b4 BIT_MASK 0x20 /end MEASUREMENT
/begin MEASUREMENT LV_READY_VLS_UP_MAX_1 "" UBYTE _CNV_S_2_RANGE______21_R_CM 1 100. 0. 255. ECU_ADDRESS 0x3fd6b4 BIT_MASK 0x40 /end MEASUREMENT
/begin MEASUREMENT ERR_SYM_VLS_UP_MAX_1 "" UBYTE _CNV_S_6_RANGE_ERR__22_CM 1 100. 0. 15. ECU_ADDRESS 0x3fd6b4 BIT_MASK 0xF /end MEASUREMENT
/begin MEASUREMENT LV_ERR_MEM_VLS_UP_MAX_1 "" UBYTE _CNV_S_2_RANGE______21_R_CM 1 100. 0. 255. ECU_ADDRESS 0x3fd6b4 BIT_MASK 0x80 /end MEASUREMENT
/begin MEASUREMENT CTR_ABC_END_DIAG_VLS_UP_MAX_1 "" UBYTE _CNV_A_R_LINEAR_____12_CM 1 100. 0. 255. ECU_ADDRESS 0x3fd6b5 FORMAT "%3.0" /end MEASUREMENT
/begin MEASUREMENT CTR_ABC_VLS_UP_MAX_2 "" UBYTE _CNV_A_R_LINEAR_____10_CM 1 100. 0. 255. ECU_ADDRESS 0x3fd6ba FORMAT "%3.0" /end MEASUREMENT
/begin MEASUREMENT LV_CDN_DIAG_VLS_UP_MAX_2 "" UBYTE _CNV_S_2_RANGE______21_R_CM 1 100. 0. 255. ECU_ADDRESS 0x3fd6b8 BIT_MASK 0x10 /end MEASUREMENT
/begin MEASUREMENT LV_END_DIAG_VLS_UP_MAX_2 "" UBYTE _CNV_S_2_RANGE______21_R_CM 1 100. 0. 255. ECU_ADDRESS 0x3fd6b8 BIT_MASK 0x20 /end MEASUREMENT
/begin MEASUREMENT LV_READY_VLS_UP_MAX_2 "" UBYTE _CNV_S_2_RANGE______21_R_CM 1 100. 0. 255. ECU_ADDRESS 0x3fd6b8 BIT_MASK 0x40 /end MEASUREMENT
/begin MEASUREMENT ERR_SYM_VLS_UP_MAX_2 "" UBYTE _CNV_S_6_RANGE_ERR__22_CM 1 100. 0. 15. ECU_ADDRESS 0x3fd6b8 BIT_MASK 0xF /end MEASUREMENT
/begin MEASUREMENT LV_ERR_MEM_VLS_UP_MAX_2 "" UBYTE _CNV_S_2_RANGE______21_R_CM 1 100. 0. 255. ECU_ADDRESS 0x3fd6b8 BIT_MASK 0x80 /end MEASUREMENT
/begin MEASUREMENT CTR_ABC_END_DIAG_VLS_UP_MAX_2 "" UBYTE _CNV_A_R_LINEAR_____12_CM 1 100. 0. 255. ECU_ADDRESS 0x3fd6b9 FORMAT "%3.0" /end MEASUREMENT
/begin MEASUREMENT CTR_ABC_TOIL "" UBYTE _CNV_A_R_LINEAR_____10_CM 1 100. 0. 255. ECU_ADDRESS 0x3fd352 FORMAT "%3.0" /end MEASUREMENT
/begin MEASUREMENT LV_CDN_DIAG_TOIL "" UBYTE _CNV_S_2_RANGE______21_R_CM 1 100. 0. 255. ECU_ADDRESS 0x3fd350 BIT_MASK 0x10 /end MEASUREMENT
/begin MEASUREMENT LV_END_DIAG_TOIL "" UBYTE _CNV_S_2_RANGE______21_R_CM 1 100. 0. 255. ECU_ADDRESS 0x3fd350 BIT_MASK 0x20 /end MEASUREMENT
/begin MEASUREMENT LV_READY_TOIL "" UBYTE _CNV_S_2_RANGE______21_R_CM 1 100. 0. 255. ECU_ADDRESS 0x3fd350 BIT_MASK 0x40 /end MEASUREMENT
/begin MEASUREMENT ERR_SYM_TOIL "" UBYTE _CNV_S_6_RANGE_ERR__22_CM 1 100. 0. 15. ECU_ADDRESS 0x3fd350 BIT_MASK 0xF /end MEASUREMENT
/begin MEASUREMENT LV_ERR_MEM_TOIL "" UBYTE _CNV_S_2_RANGE______21_R_CM 1 100. 0. 255. ECU_ADDRESS 0x3fd350 BIT_MASK 0x80 /end MEASUREMENT
/begin MEASUREMENT CTR_ABC_END_DIAG_TOIL "" UBYTE _CNV_A_R_LINEAR_____12_CM 1 100. 0. 255. ECU_ADDRESS 0x3fd351 FORMAT "%3.0" /end MEASUREMENT
/begin MEASUREMENT CTR_ABC_MEC_ISA "" UBYTE _CNV_A_R_LINEAR_____10_CM 1 100. 0. 255. ECU_ADDRESS 0x3fd526 FORMAT "%3.0" /end MEASUREMENT
/begin MEASUREMENT LV_CDN_DIAG_MEC_ISA "" UBYTE _CNV_S_2_RANGE______21_R_CM 1 100. 0. 255. ECU_ADDRESS 0x3fd524 BIT_MASK 0x10 /end MEASUREMENT
/begin MEASUREMENT LV_END_DIAG_MEC_ISA "" UBYTE _CNV_S_2_RANGE______21_R_CM 1 100. 0. 255. ECU_ADDRESS 0x3fd524 BIT_MASK 0x20 /end MEASUREMENT
/begin MEASUREMENT LV_READY_MEC_ISA "" UBYTE _CNV_S_2_RANGE______21_R_CM 1 100. 0. 255. ECU_ADDRESS 0x3fd524 BIT_MASK 0x40 /end MEASUREMENT
/begin MEASUREMENT ERR_SYM_MEC_ISA "" UBYTE _CNV_S_6_RANGE_ERR__22_CM 1 100. 0. 15. ECU_ADDRESS 0x3fd524 BIT_MASK 0xF /end MEASUREMENT
/begin MEASUREMENT LV_ERR_MEM_MEC_ISA "" UBYTE _CNV_S_2_RANGE______21_R_CM 1 100. 0. 255. ECU_ADDRESS 0x3fd524 BIT_MASK 0x80 /end MEASUREMENT
/begin MEASUREMENT CTR_ABC_END_DIAG_MEC_ISA "" UBYTE _CNV_A_R_LINEAR_____12_CM 1 100. 0. 255. ECU_ADDRESS 0x3fd525 FORMAT "%3.0" /end MEASUREMENT
/begin MEASUREMENT CTR_ABC_PVS_MON_1 "" UBYTE _CNV_A_R_LINEAR_____10_CM 1 100. 0. 255. ECU_ADDRESS 0x3fd54e FORMAT "%3.0" /end MEASUREMENT
/begin MEASUREMENT LV_CDN_DIAG_PVS_MON_1 "" UBYTE _CNV_S_2_RANGE______21_R_CM 1 100. 0. 255. ECU_ADDRESS 0x3fd54c BIT_MASK 0x10 /end MEASUREMENT
/begin MEASUREMENT LV_END_DIAG_PVS_MON_1 "" UBYTE _CNV_S_2_RANGE______21_R_CM 1 100. 0. 255. ECU_ADDRESS 0x3fd54c BIT_MASK 0x20 /end MEASUREMENT
/begin MEASUREMENT LV_READY_PVS_MON_1 "" UBYTE _CNV_S_2_RANGE______21_R_CM 1 100. 0. 255. ECU_ADDRESS 0x3fd54c BIT_MASK 0x40 /end MEASUREMENT
/begin MEASUREMENT ERR_SYM_PVS_MON_1 "" UBYTE _CNV_S_6_RANGE_ERR__22_CM 1 100. 0. 15. ECU_ADDRESS 0x3fd54c BIT_MASK 0xF /end MEASUREMENT
/begin MEASUREMENT LV_ERR_MEM_PVS_MON_1 "" UBYTE _CNV_S_2_RANGE______21_R_CM 1 100. 0. 255. ECU_ADDRESS 0x3fd54c BIT_MASK 0x80 /end MEASUREMENT
/begin MEASUREMENT CTR_ABC_END_DIAG_PVS_MON_1 "" UBYTE _CNV_A_R_LINEAR_____12_CM 1 100. 0. 255. ECU_ADDRESS 0x3fd54d FORMAT "%3.0" /end MEASUREMENT
/begin MEASUREMENT CTR_ABC_VLS_DOWN_MAX_1 "" UBYTE _CNV_A_R_LINEAR_____10_CM 1 100. 0. 255. ECU_ADDRESS 0x3fd366 FORMAT "%3.0" /end MEASUREMENT
/begin MEASUREMENT LV_CDN_DIAG_VLS_DOWN_MAX_1 "" UBYTE _CNV_S_2_RANGE______21_R_CM 1 100. 0. 255. ECU_ADDRESS 0x3fd364 BIT_MASK 0x10 /end MEASUREMENT
/begin MEASUREMENT LV_END_DIAG_VLS_DOWN_MAX_1 "" UBYTE _CNV_S_2_RANGE______21_R_CM 1 100. 0. 255. ECU_ADDRESS 0x3fd364 BIT_MASK 0x20 /end MEASUREMENT
/begin MEASUREMENT LV_READY_VLS_DOWN_MAX_1 "" UBYTE _CNV_S_2_RANGE______21_R_CM 1 100. 0. 255. ECU_ADDRESS 0x3fd364 BIT_MASK 0x40 /end MEASUREMENT
/begin MEASUREMENT ERR_SYM_VLS_DOWN_MAX_1 "" UBYTE _CNV_S_6_RANGE_ERR__22_CM 1 100. 0. 15. ECU_ADDRESS 0x3fd364 BIT_MASK 0xF /end MEASUREMENT
/begin MEASUREMENT LV_ERR_MEM_VLS_DOWN_MAX_1 "" UBYTE _CNV_S_2_RANGE______21_R_CM 1 100. 0. 255. ECU_ADDRESS 0x3fd364 BIT_MASK 0x80 /end MEASUREMENT
/begin MEASUREMENT CTR_ABC_END_DIAG_VLS_DOWN_MAX_1 "" UBYTE _CNV_A_R_LINEAR_____12_CM 1 100. 0. 255. ECU_ADDRESS 0x3fd365 FORMAT "%3.0" /end MEASUREMENT
/begin MEASUREMENT CTR_ABC_VLS_DOWN_MAX_2 "" UBYTE _CNV_A_R_LINEAR_____10_CM 1 100. 0. 255. ECU_ADDRESS 0x3fd36a FORMAT "%3.0" /end MEASUREMENT
/begin MEASUREMENT LV_CDN_DIAG_VLS_DOWN_MAX_2 "" UBYTE _CNV_S_2_RANGE______21_R_CM 1 100. 0. 255. ECU_ADDRESS 0x3fd368 BIT_MASK 0x10 /end MEASUREMENT
/begin MEASUREMENT LV_END_DIAG_VLS_DOWN_MAX_2 "" UBYTE _CNV_S_2_RANGE______21_R_CM 1 100. 0. 255. ECU_ADDRESS 0x3fd368 BIT_MASK 0x20 /end MEASUREMENT
/begin MEASUREMENT LV_READY_VLS_DOWN_MAX_2 "" UBYTE _CNV_S_2_RANGE______21_R_CM 1 100. 0. 255. ECU_ADDRESS 0x3fd368 BIT_MASK 0x40 /end MEASUREMENT
/begin MEASUREMENT ERR_SYM_VLS_DOWN_MAX_2 "" UBYTE _CNV_S_6_RANGE_ERR__22_CM 1 100. 0. 15. ECU_ADDRESS 0x3fd368 BIT_MASK 0xF /end MEASUREMENT
/begin MEASUREMENT LV_ERR_MEM_VLS_DOWN_MAX_2 "" UBYTE _CNV_S_2_RANGE______21_R_CM 1 100. 0. 255. ECU_ADDRESS 0x3fd368 BIT_MASK 0x80 /end MEASUREMENT
/begin MEASUREMENT CTR_ABC_END_DIAG_VLS_DOWN_MAX_2 "" UBYTE _CNV_A_R_LINEAR_____12_CM 1 100. 0. 255. ECU_ADDRESS 0x3fd369 FORMAT "%3.0" /end MEASUREMENT
/begin MEASUREMENT CTR_ABC_V_REF_1 "" UBYTE _CNV_A_R_LINEAR_____10_CM 1 100. 0. 255. ECU_ADDRESS 0x3fd462 FORMAT "%3.0" /end MEASUREMENT
/begin MEASUREMENT LV_CDN_DIAG_V_REF_1 "" UBYTE _CNV_S_2_RANGE______21_R_CM 1 100. 0. 255. ECU_ADDRESS 0x3fd460 BIT_MASK 0x10 /end MEASUREMENT
/begin MEASUREMENT LV_END_DIAG_V_REF_1 "" UBYTE _CNV_S_2_RANGE______21_R_CM 1 100. 0. 255. ECU_ADDRESS 0x3fd460 BIT_MASK 0x20 /end MEASUREMENT
/begin MEASUREMENT LV_READY_V_REF_1 "" UBYTE _CNV_S_2_RANGE______21_R_CM 1 100. 0. 255. ECU_ADDRESS 0x3fd460 BIT_MASK 0x40 /end MEASUREMENT
/begin MEASUREMENT ERR_SYM_V_REF_1 "" UBYTE _CNV_S_6_RANGE_ERR__22_CM 1 100. 0. 15. ECU_ADDRESS 0x3fd460 BIT_MASK 0xF /end MEASUREMENT
/begin MEASUREMENT LV_ERR_MEM_V_REF_1 "" UBYTE _CNV_S_2_RANGE______21_R_CM 1 100. 0. 255. ECU_ADDRESS 0x3fd460 BIT_MASK 0x80 /end MEASUREMENT
/begin MEASUREMENT CTR_ABC_END_DIAG_V_REF_1 "" UBYTE _CNV_A_R_LINEAR_____12_CM 1 100. 0. 255. ECU_ADDRESS 0x3fd461 FORMAT "%3.0" /end MEASUREMENT
/begin MEASUREMENT CTR_ABC_TCO_PLAUS "" UBYTE _CNV_A_R_LINEAR_____10_CM 1 100. 0. 255. ECU_ADDRESS 0x3fd502 FORMAT "%3.0" /end MEASUREMENT
/begin MEASUREMENT LV_CDN_DIAG_TCO_PLAUS "" UBYTE _CNV_S_2_RANGE______21_R_CM 1 100. 0. 255. ECU_ADDRESS 0x3fd500 BIT_MASK 0x10 /end MEASUREMENT
/begin MEASUREMENT LV_END_DIAG_TCO_PLAUS "" UBYTE _CNV_S_2_RANGE______21_R_CM 1 100. 0. 255. ECU_ADDRESS 0x3fd500 BIT_MASK 0x20 /end MEASUREMENT
/begin MEASUREMENT LV_READY_TCO_PLAUS "" UBYTE _CNV_S_2_RANGE______21_R_CM 1 100. 0. 255. ECU_ADDRESS 0x3fd500 BIT_MASK 0x40 /end MEASUREMENT
/begin MEASUREMENT ERR_SYM_TCO_PLAUS "" UBYTE _CNV_S_6_RANGE_ERR__22_CM 1 100. 0. 15. ECU_ADDRESS 0x3fd500 BIT_MASK 0xF /end MEASUREMENT
/begin MEASUREMENT LV_ERR_MEM_TCO_PLAUS "" UBYTE _CNV_S_2_RANGE______21_R_CM 1 100. 0. 255. ECU_ADDRESS 0x3fd500 BIT_MASK 0x80 /end MEASUREMENT
/begin MEASUREMENT CTR_ABC_END_DIAG_TCO_PLAUS "" UBYTE _CNV_A_R_LINEAR_____12_CM 1 100. 0. 255. ECU_ADDRESS 0x3fd501 FORMAT "%3.0" /end MEASUREMENT
/begin MEASUREMENT CTR_ABC_V_REF_2 "" UBYTE _CNV_A_R_LINEAR_____10_CM 1 100. 0. 255. ECU_ADDRESS 0x3fd466 FORMAT "%3.0" /end MEASUREMENT
/begin MEASUREMENT LV_CDN_DIAG_V_REF_2 "" UBYTE _CNV_S_2_RANGE______21_R_CM 1 100. 0. 255. ECU_ADDRESS 0x3fd464 BIT_MASK 0x10 /end MEASUREMENT
/begin MEASUREMENT LV_END_DIAG_V_REF_2 "" UBYTE _CNV_S_2_RANGE______21_R_CM 1 100. 0. 255. ECU_ADDRESS 0x3fd464 BIT_MASK 0x20 /end MEASUREMENT
/begin MEASUREMENT LV_READY_V_REF_2 "" UBYTE _CNV_S_2_RANGE______21_R_CM 1 100. 0. 255. ECU_ADDRESS 0x3fd464 BIT_MASK 0x40 /end MEASUREMENT
/begin MEASUREMENT ERR_SYM_V_REF_2 "" UBYTE _CNV_S_6_RANGE_ERR__22_CM 1 100. 0. 15. ECU_ADDRESS 0x3fd464 BIT_MASK 0xF /end MEASUREMENT
/begin MEASUREMENT LV_ERR_MEM_V_REF_2 "" UBYTE _CNV_S_2_RANGE______21_R_CM 1 100. 0. 255. ECU_ADDRESS 0x3fd464 BIT_MASK 0x80 /end MEASUREMENT
/begin MEASUREMENT CTR_ABC_END_DIAG_V_REF_2 "" UBYTE _CNV_A_R_LINEAR_____12_CM 1 100. 0. 255. ECU_ADDRESS 0x3fd465 FORMAT "%3.0" /end MEASUREMENT
/begin MEASUREMENT CTR_ABC_REF_IVVT_EX_1 "" UBYTE _CNV_A_R_LINEAR_____10_CM 1 100. 0. 255. ECU_ADDRESS 0x3fd3d6 FORMAT "%3.0" /end MEASUREMENT
/begin MEASUREMENT LV_CDN_DIAG_REF_IVVT_EX_1 "" UBYTE _CNV_S_2_RANGE______21_R_CM 1 100. 0. 255. ECU_ADDRESS 0x3fd3d4 BIT_MASK 0x10 /end MEASUREMENT
/begin MEASUREMENT LV_END_DIAG_REF_IVVT_EX_1 "" UBYTE _CNV_S_2_RANGE______21_R_CM 1 100. 0. 255. ECU_ADDRESS 0x3fd3d4 BIT_MASK 0x20 /end MEASUREMENT
/begin MEASUREMENT LV_READY_REF_IVVT_EX_1 "" UBYTE _CNV_S_2_RANGE______21_R_CM 1 100. 0. 255. ECU_ADDRESS 0x3fd3d4 BIT_MASK 0x40 /end MEASUREMENT
/begin MEASUREMENT ERR_SYM_REF_IVVT_EX_1 "" UBYTE _CNV_S_6_RANGE_ERR__22_CM 1 100. 0. 15. ECU_ADDRESS 0x3fd3d4 BIT_MASK 0xF /end MEASUREMENT
/begin MEASUREMENT LV_ERR_MEM_REF_IVVT_EX_1 "" UBYTE _CNV_S_2_RANGE______21_R_CM 1 100. 0. 255. ECU_ADDRESS 0x3fd3d4 BIT_MASK 0x80 /end MEASUREMENT
/begin MEASUREMENT CTR_ABC_END_DIAG_REF_IVVT_EX_1 "" UBYTE _CNV_A_R_LINEAR_____12_CM 1 100. 0. 255. ECU_ADDRESS 0x3fd3d5 FORMAT "%3.0" /end MEASUREMENT
/begin MEASUREMENT CTR_ABC_REF_IVVT_EX_2 "" UBYTE _CNV_A_R_LINEAR_____10_CM 1 100. 0. 255. ECU_ADDRESS 0x3fd3da FORMAT "%3.0" /end MEASUREMENT
/begin MEASUREMENT LV_CDN_DIAG_REF_IVVT_EX_2 "" UBYTE _CNV_S_2_RANGE______21_R_CM 1 100. 0. 255. ECU_ADDRESS 0x3fd3d8 BIT_MASK 0x10 /end MEASUREMENT
/begin MEASUREMENT LV_END_DIAG_REF_IVVT_EX_2 "" UBYTE _CNV_S_2_RANGE______21_R_CM 1 100. 0. 255. ECU_ADDRESS 0x3fd3d8 BIT_MASK 0x20 /end MEASUREMENT
/begin MEASUREMENT LV_READY_REF_IVVT_EX_2 "" UBYTE _CNV_S_2_RANGE______21_R_CM 1 100. 0. 255. ECU_ADDRESS 0x3fd3d8 BIT_MASK 0x40 /end MEASUREMENT
/begin MEASUREMENT ERR_SYM_REF_IVVT_EX_2 "" UBYTE _CNV_S_6_RANGE_ERR__22_CM 1 100. 0. 15. ECU_ADDRESS 0x3fd3d8 BIT_MASK 0xF /end MEASUREMENT
/begin MEASUREMENT LV_ERR_MEM_REF_IVVT_EX_2 "" UBYTE _CNV_S_2_RANGE______21_R_CM 1 100. 0. 255. ECU_ADDRESS 0x3fd3d8 BIT_MASK 0x80 /end MEASUREMENT
/begin MEASUREMENT CTR_ABC_END_DIAG_REF_IVVT_EX_2 "" UBYTE _CNV_A_R_LINEAR_____12_CM 1 100. 0. 255. ECU_ADDRESS 0x3fd3d9 FORMAT "%3.0" /end MEASUREMENT
/begin MEASUREMENT CTR_ABC_SA_SAP "" UBYTE _CNV_A_R_LINEAR_____10_CM 1 100. 0. 255. ECU_ADDRESS 0x3fd58a FORMAT "%3.0" /end MEASUREMENT
/begin MEASUREMENT LV_CDN_DIAG_SA_SAP "" UBYTE _CNV_S_2_RANGE______21_R_CM 1 100. 0. 255. ECU_ADDRESS 0x3fd588 BIT_MASK 0x10 /end MEASUREMENT
/begin MEASUREMENT LV_END_DIAG_SA_SAP "" UBYTE _CNV_S_2_RANGE______21_R_CM 1 100. 0. 255. ECU_ADDRESS 0x3fd588 BIT_MASK 0x20 /end MEASUREMENT
/begin MEASUREMENT LV_READY_SA_SAP "" UBYTE _CNV_S_2_RANGE______21_R_CM 1 100. 0. 255. ECU_ADDRESS 0x3fd588 BIT_MASK 0x40 /end MEASUREMENT
/begin MEASUREMENT ERR_SYM_SA_SAP "" UBYTE _CNV_S_6_RANGE_ERR__22_CM 1 100. 0. 15. ECU_ADDRESS 0x3fd588 BIT_MASK 0xF /end MEASUREMENT
/begin MEASUREMENT LV_ERR_MEM_SA_SAP "" UBYTE _CNV_S_2_RANGE______21_R_CM 1 100. 0. 255. ECU_ADDRESS 0x3fd588 BIT_MASK 0x80 /end MEASUREMENT
/begin MEASUREMENT CTR_ABC_END_DIAG_SA_SAP "" UBYTE _CNV_A_R_LINEAR_____12_CM 1 100. 0. 255. ECU_ADDRESS 0x3fd589 FORMAT "%3.0" /end MEASUREMENT
/begin MEASUREMENT CTR_ABC_RLY_MAIN "" UBYTE _CNV_A_R_LINEAR_____10_CM 1 100. 0. 255. ECU_ADDRESS 0x3fd4d6 FORMAT "%3.0" /end MEASUREMENT
/begin MEASUREMENT LV_CDN_DIAG_RLY_MAIN "" UBYTE _CNV_S_2_RANGE______21_R_CM 1 100. 0. 255. ECU_ADDRESS 0x3fd4d4 BIT_MASK 0x10 /end MEASUREMENT
/begin MEASUREMENT LV_END_DIAG_RLY_MAIN "" UBYTE _CNV_S_2_RANGE______21_R_CM 1 100. 0. 255. ECU_ADDRESS 0x3fd4d4 BIT_MASK 0x20 /end MEASUREMENT
/begin MEASUREMENT LV_READY_RLY_MAIN "" UBYTE _CNV_S_2_RANGE______21_R_CM 1 100. 0. 255. ECU_ADDRESS 0x3fd4d4 BIT_MASK 0x40 /end MEASUREMENT
/begin MEASUREMENT ERR_SYM_RLY_MAIN "" UBYTE _CNV_S_6_RANGE_ERR__22_CM 1 100. 0. 15. ECU_ADDRESS 0x3fd4d4 BIT_MASK 0xF /end MEASUREMENT
/begin MEASUREMENT LV_ERR_MEM_RLY_MAIN "" UBYTE _CNV_S_2_RANGE______21_R_CM 1 100. 0. 255. ECU_ADDRESS 0x3fd4d4 BIT_MASK 0x80 /end MEASUREMENT
/begin MEASUREMENT CTR_ABC_END_DIAG_RLY_MAIN "" UBYTE _CNV_A_R_LINEAR_____12_CM 1 100. 0. 255. ECU_ADDRESS 0x3fd4d5 FORMAT "%3.0" /end MEASUREMENT
/begin MEASUREMENT CTR_ABC_SA_SAV "" UBYTE _CNV_A_R_LINEAR_____10_CM 1 100. 0. 255. ECU_ADDRESS 0x3fd58e FORMAT "%3.0" /end MEASUREMENT
/begin MEASUREMENT LV_CDN_DIAG_SA_SAV "" UBYTE _CNV_S_2_RANGE______21_R_CM 1 100. 0. 255. ECU_ADDRESS 0x3fd58c BIT_MASK 0x10 /end MEASUREMENT
/begin MEASUREMENT LV_END_DIAG_SA_SAV "" UBYTE _CNV_S_2_RANGE______21_R_CM 1 100. 0. 255. ECU_ADDRESS 0x3fd58c BIT_MASK 0x20 /end MEASUREMENT
/begin MEASUREMENT LV_READY_SA_SAV "" UBYTE _CNV_S_2_RANGE______21_R_CM 1 100. 0. 255. ECU_ADDRESS 0x3fd58c BIT_MASK 0x40 /end MEASUREMENT
/begin MEASUREMENT ERR_SYM_SA_SAV "" UBYTE _CNV_S_6_RANGE_ERR__22_CM 1 100. 0. 15. ECU_ADDRESS 0x3fd58c BIT_MASK 0xF /end MEASUREMENT
/begin MEASUREMENT LV_ERR_MEM_SA_SAV "" UBYTE _CNV_S_2_RANGE______21_R_CM 1 100. 0. 255. ECU_ADDRESS 0x3fd58c BIT_MASK 0x80 /end MEASUREMENT
/begin MEASUREMENT CTR_ABC_END_DIAG_SA_SAV "" UBYTE _CNV_A_R_LINEAR_____12_CM 1 100. 0. 255. ECU_ADDRESS 0x3fd58d FORMAT "%3.0" /end MEASUREMENT
/begin MEASUREMENT CTR_ABC_CRASH_EFP "" UBYTE _CNV_A_R_LINEAR_____10_CM 1 100. 0. 255. ECU_ADDRESS 0x3fd67a FORMAT "%3.0" /end MEASUREMENT
/begin MEASUREMENT LV_CDN_DIAG_CRASH_EFP "" UBYTE _CNV_S_2_RANGE______21_R_CM 1 100. 0. 255. ECU_ADDRESS 0x3fd678 BIT_MASK 0x10 /end MEASUREMENT
/begin MEASUREMENT LV_END_DIAG_CRASH_EFP "" UBYTE _CNV_S_2_RANGE______21_R_CM 1 100. 0. 255. ECU_ADDRESS 0x3fd678 BIT_MASK 0x20 /end MEASUREMENT
/begin MEASUREMENT LV_READY_CRASH_EFP "" UBYTE _CNV_S_2_RANGE______21_R_CM 1 100. 0. 255. ECU_ADDRESS 0x3fd678 BIT_MASK 0x40 /end MEASUREMENT
/begin MEASUREMENT ERR_SYM_CRASH_EFP "" UBYTE _CNV_S_6_RANGE_ERR__22_CM 1 100. 0. 15. ECU_ADDRESS 0x3fd678 BIT_MASK 0xF /end MEASUREMENT
/begin MEASUREMENT LV_ERR_MEM_CRASH_EFP "" UBYTE _CNV_S_2_RANGE______21_R_CM 1 100. 0. 255. ECU_ADDRESS 0x3fd678 BIT_MASK 0x80 /end MEASUREMENT
/begin MEASUREMENT CTR_ABC_END_DIAG_CRASH_EFP "" UBYTE _CNV_A_R_LINEAR_____12_CM 1 100. 0. 255. ECU_ADDRESS 0x3fd679 FORMAT "%3.0" /end MEASUREMENT
/begin MEASUREMENT CTR_ABC_ECT_MEC "" UBYTE _CNV_A_R_LINEAR_____10_CM 1 100. 0. 255. ECU_ADDRESS 0x3fd4fe FORMAT "%3.0" /end MEASUREMENT
/begin MEASUREMENT LV_CDN_DIAG_ECT_MEC "" UBYTE _CNV_S_2_RANGE______21_R_CM 1 100. 0. 255. ECU_ADDRESS 0x3fd4fc BIT_MASK 0x10 /end MEASUREMENT
/begin MEASUREMENT LV_END_DIAG_ECT_MEC "" UBYTE _CNV_S_2_RANGE______21_R_CM 1 100. 0. 255. ECU_ADDRESS 0x3fd4fc BIT_MASK 0x20 /end MEASUREMENT
/begin MEASUREMENT LV_READY_ECT_MEC "" UBYTE _CNV_S_2_RANGE______21_R_CM 1 100. 0. 255. ECU_ADDRESS 0x3fd4fc BIT_MASK 0x40 /end MEASUREMENT
/begin MEASUREMENT ERR_SYM_ECT_MEC "" UBYTE _CNV_S_6_RANGE_ERR__22_CM 1 100. 0. 15. ECU_ADDRESS 0x3fd4fc BIT_MASK 0xF /end MEASUREMENT
/begin MEASUREMENT LV_ERR_MEM_ECT_MEC "" UBYTE _CNV_S_2_RANGE______21_R_CM 1 100. 0. 255. ECU_ADDRESS 0x3fd4fc BIT_MASK 0x80 /end MEASUREMENT
/begin MEASUREMENT CTR_ABC_END_DIAG_ECT_MEC "" UBYTE _CNV_A_R_LINEAR_____12_CM 1 100. 0. 255. ECU_ADDRESS 0x3fd4fd FORMAT "%3.0" /end MEASUREMENT
/begin MEASUREMENT CTR_ABC_VLS_DOWN_MIN_COLD_1 "" UBYTE _CNV_A_R_LINEAR_____10_CM 1 100. 0. 255. ECU_ADDRESS 0x3fd36e FORMAT "%3.0" /end MEASUREMENT
/begin MEASUREMENT LV_CDN_DIAG_VLS_DOWN_MIN_COLD_1 "" UBYTE _CNV_S_2_RANGE______21_R_CM 1 100. 0. 255. ECU_ADDRESS 0x3fd36c BIT_MASK 0x10 /end MEASUREMENT
/begin MEASUREMENT LV_END_DIAG_VLS_DOWN_MIN_COLD_1 "" UBYTE _CNV_S_2_RANGE______21_R_CM 1 100. 0. 255. ECU_ADDRESS 0x3fd36c BIT_MASK 0x20 /end MEASUREMENT
/begin MEASUREMENT LV_READY_VLS_DOWN_MIN_COLD_1 "" UBYTE _CNV_S_2_RANGE______21_R_CM 1 100. 0. 255. ECU_ADDRESS 0x3fd36c BIT_MASK 0x40 /end MEASUREMENT
/begin MEASUREMENT ERR_SYM_VLS_DOWN_MIN_COLD_1 "" UBYTE _CNV_S_6_RANGE_ERR__22_CM 1 100. 0. 15. ECU_ADDRESS 0x3fd36c BIT_MASK 0xF /end MEASUREMENT
/begin MEASUREMENT LV_ERR_MEM_VLS_DOWN_MIN_COLD_1 "" UBYTE _CNV_S_2_RANGE______21_R_CM 1 100. 0. 255. ECU_ADDRESS 0x3fd36c BIT_MASK 0x80 /end MEASUREMENT
/begin MEASUREMENT CTR_ABC_END_DIAG_VLS_DOWN_MIN_CO "" UBYTE _CNV_A_R_LINEAR_____12_CM 1 100. 0. 255. ECU_ADDRESS 0x3fd36d FORMAT "%3.0" /end MEASUREMENT
/begin MEASUREMENT CTR_ABC_ISA_1 "" UBYTE _CNV_A_R_LINEAR_____10_CM 1 100. 0. 255. ECU_ADDRESS 0x3fd51e FORMAT "%3.0" /end MEASUREMENT
/begin MEASUREMENT LV_CDN_DIAG_ISA_1 "" UBYTE _CNV_S_2_RANGE______21_R_CM 1 100. 0. 255. ECU_ADDRESS 0x3fd51c BIT_MASK 0x10 /end MEASUREMENT
/begin MEASUREMENT LV_END_DIAG_ISA_1 "" UBYTE _CNV_S_2_RANGE______21_R_CM 1 100. 0. 255. ECU_ADDRESS 0x3fd51c BIT_MASK 0x20 /end MEASUREMENT
/begin MEASUREMENT LV_READY_ISA_1 "" UBYTE _CNV_S_2_RANGE______21_R_CM 1 100. 0. 255. ECU_ADDRESS 0x3fd51c BIT_MASK 0x40 /end MEASUREMENT
/begin MEASUREMENT ERR_SYM_ISA_1 "" UBYTE _CNV_S_6_RANGE_ERR__22_CM 1 100. 0. 15. ECU_ADDRESS 0x3fd51c BIT_MASK 0xF /end MEASUREMENT
/begin MEASUREMENT LV_ERR_MEM_ISA_1 "" UBYTE _CNV_S_2_RANGE______21_R_CM 1 100. 0. 255. ECU_ADDRESS 0x3fd51c BIT_MASK 0x80 /end MEASUREMENT
/begin MEASUREMENT CTR_ABC_END_DIAG_ISA_1 "" UBYTE _CNV_A_R_LINEAR_____12_CM 1 100. 0. 255. ECU_ADDRESS 0x3fd51d FORMAT "%3.0" /end MEASUREMENT
/begin MEASUREMENT CTR_ABC_VLS_DOWN_MIN_COLD_2 "" UBYTE _CNV_A_R_LINEAR_____10_CM 1 100. 0. 255. ECU_ADDRESS 0x3fd372 FORMAT "%3.0" /end MEASUREMENT
/begin MEASUREMENT LV_CDN_DIAG_VLS_DOWN_MIN_COLD_2 "" UBYTE _CNV_S_2_RANGE______21_R_CM 1 100. 0. 255. ECU_ADDRESS 0x3fd370 BIT_MASK 0x10 /end MEASUREMENT
/begin MEASUREMENT LV_END_DIAG_VLS_DOWN_MIN_COLD_2 "" UBYTE _CNV_S_2_RANGE______21_R_CM 1 100. 0. 255. ECU_ADDRESS 0x3fd370 BIT_MASK 0x20 /end MEASUREMENT
/begin MEASUREMENT LV_READY_VLS_DOWN_MIN_COLD_2 "" UBYTE _CNV_S_2_RANGE______21_R_CM 1 100. 0. 255. ECU_ADDRESS 0x3fd370 BIT_MASK 0x40 /end MEASUREMENT
/begin MEASUREMENT ERR_SYM_VLS_DOWN_MIN_COLD_2 "" UBYTE _CNV_S_6_RANGE_ERR__22_CM 1 100. 0. 15. ECU_ADDRESS 0x3fd370 BIT_MASK 0xF /end MEASUREMENT
/begin MEASUREMENT LV_ERR_MEM_VLS_DOWN_MIN_COLD_2 "" UBYTE _CNV_S_2_RANGE______21_R_CM 1 100. 0. 255. ECU_ADDRESS 0x3fd370 BIT_MASK 0x80 /end MEASUREMENT
/begin MEASUREMENT CTR_ABC_ISA_2 "" UBYTE _CNV_A_R_LINEAR_____10_CM 1 100. 0. 255. ECU_ADDRESS 0x3fd522 FORMAT "%3.0" /end MEASUREMENT
/begin MEASUREMENT LV_CDN_DIAG_ISA_2 "" UBYTE _CNV_S_2_RANGE______21_R_CM 1 100. 0. 255. ECU_ADDRESS 0x3fd520 BIT_MASK 0x10 /end MEASUREMENT
/begin MEASUREMENT LV_END_DIAG_ISA_2 "" UBYTE _CNV_S_2_RANGE______21_R_CM 1 100. 0. 255. ECU_ADDRESS 0x3fd520 BIT_MASK 0x20 /end MEASUREMENT
/begin MEASUREMENT LV_READY_ISA_2 "" UBYTE _CNV_S_2_RANGE______21_R_CM 1 100. 0. 255. ECU_ADDRESS 0x3fd520 BIT_MASK 0x40 /end MEASUREMENT
/begin MEASUREMENT ERR_SYM_ISA_2 "" UBYTE _CNV_S_6_RANGE_ERR__22_CM 1 100. 0. 15. ECU_ADDRESS 0x3fd520 BIT_MASK 0xF /end MEASUREMENT
/begin MEASUREMENT LV_ERR_MEM_ISA_2 "" UBYTE _CNV_S_2_RANGE______21_R_CM 1 100. 0. 255. ECU_ADDRESS 0x3fd520 BIT_MASK 0x80 /end MEASUREMENT
/begin MEASUREMENT CTR_ABC_END_DIAG_ISA_2 "" UBYTE _CNV_A_R_LINEAR_____12_CM 1 100. 0. 255. ECU_ADDRESS 0x3fd521 FORMAT "%3.0" /end MEASUREMENT
/begin MEASUREMENT CTR_ABC_SOF_REQ "" UBYTE _CNV_A_R_LINEAR_____10_CM 1 100. 0. 255. ECU_ADDRESS 0x3fd5fa FORMAT "%3.0" /end MEASUREMENT
/begin MEASUREMENT LV_CDN_DIAG_SOF_REQ "" UBYTE _CNV_S_2_RANGE______21_R_CM 1 100. 0. 255. ECU_ADDRESS 0x3fd5f8 BIT_MASK 0x10 /end MEASUREMENT
/begin MEASUREMENT LV_END_DIAG_SOF_REQ "" UBYTE _CNV_S_2_RANGE______21_R_CM 1 100. 0. 255. ECU_ADDRESS 0x3fd5f8 BIT_MASK 0x20 /end MEASUREMENT
/begin MEASUREMENT LV_READY_SOF_REQ "" UBYTE _CNV_S_2_RANGE______21_R_CM 1 100. 0. 255. ECU_ADDRESS 0x3fd5f8 BIT_MASK 0x40 /end MEASUREMENT
/begin MEASUREMENT ERR_SYM_SOF_REQ "" UBYTE _CNV_S_6_RANGE_ERR__22_CM 1 100. 0. 15. ECU_ADDRESS 0x3fd5f8 BIT_MASK 0xF /end MEASUREMENT
/begin MEASUREMENT LV_ERR_MEM_SOF_REQ "" UBYTE _CNV_S_2_RANGE______21_R_CM 1 100. 0. 255. ECU_ADDRESS 0x3fd5f8 BIT_MASK 0x80 /end MEASUREMENT
/begin MEASUREMENT CTR_ABC_END_DIAG_SOF_REQ "" UBYTE _CNV_A_R_LINEAR_____12_CM 1 100. 0. 255. ECU_ADDRESS 0x3fd5f9 FORMAT "%3.0" /end MEASUREMENT
/begin MEASUREMENT CTR_ABC_ECF "" UBYTE _CNV_A_R_LINEAR_____10_CM 1 100. 0. 255. ECU_ADDRESS 0x3fd4ea FORMAT "%3.0" /end MEASUREMENT
/begin MEASUREMENT LV_CDN_DIAG_ECF "" UBYTE _CNV_S_2_RANGE______21_R_CM 1 100. 0. 255. ECU_ADDRESS 0x3fd4e8 BIT_MASK 0x10 /end MEASUREMENT
/begin MEASUREMENT LV_END_DIAG_ECF "" UBYTE _CNV_S_2_RANGE______21_R_CM 1 100. 0. 255. ECU_ADDRESS 0x3fd4e8 BIT_MASK 0x20 /end MEASUREMENT
/begin MEASUREMENT LV_READY_ECF "" UBYTE _CNV_S_2_RANGE______21_R_CM 1 100. 0. 255. ECU_ADDRESS 0x3fd4e8 BIT_MASK 0x40 /end MEASUREMENT
/begin MEASUREMENT ERR_SYM_ECF "" UBYTE _CNV_S_6_RANGE_ERR__22_CM 1 100. 0. 15. ECU_ADDRESS 0x3fd4e8 BIT_MASK 0xF /end MEASUREMENT
/begin MEASUREMENT LV_ERR_MEM_ECF "" UBYTE _CNV_S_2_RANGE______21_R_CM 1 100. 0. 255. ECU_ADDRESS 0x3fd4e8 BIT_MASK 0x80 /end MEASUREMENT
/begin MEASUREMENT CTR_ABC_END_DIAG_ECF "" UBYTE _CNV_A_R_LINEAR_____12_CM 1 100. 0. 255. ECU_ADDRESS 0x3fd4e9 FORMAT "%3.0" /end MEASUREMENT
/begin MEASUREMENT CTR_ABC_BN_MSW "" UBYTE _CNV_A_R_LINEAR_____10_CM 1 100. 0. 255. ECU_ADDRESS 0x3fd666 FORMAT "%3.0" /end MEASUREMENT
/begin MEASUREMENT LV_CDN_DIAG_BN_MSW "" UBYTE _CNV_S_2_RANGE______21_R_CM 1 100. 0. 255. ECU_ADDRESS 0x3fd664 BIT_MASK 0x10 /end MEASUREMENT
/begin MEASUREMENT LV_END_DIAG_BN_MSW "" UBYTE _CNV_S_2_RANGE______21_R_CM 1 100. 0. 255. ECU_ADDRESS 0x3fd664 BIT_MASK 0x20 /end MEASUREMENT
/begin MEASUREMENT LV_READY_BN_MSW "" UBYTE _CNV_S_2_RANGE______21_R_CM 1 100. 0. 255. ECU_ADDRESS 0x3fd664 BIT_MASK 0x40 /end MEASUREMENT
/begin MEASUREMENT ERR_SYM_BN_MSW "" UBYTE _CNV_S_6_RANGE_ERR__22_CM 1 100. 0. 15. ECU_ADDRESS 0x3fd664 BIT_MASK 0xF /end MEASUREMENT
/begin MEASUREMENT LV_ERR_MEM_BN_MSW "" UBYTE _CNV_S_2_RANGE______21_R_CM 1 100. 0. 255. ECU_ADDRESS 0x3fd664 BIT_MASK 0x80 /end MEASUREMENT
/begin MEASUREMENT CTR_ABC_END_DIAG_BN_MSW "" UBYTE _CNV_A_R_LINEAR_____12_CM 1 100. 0. 255. ECU_ADDRESS 0x3fd665 FORMAT "%3.0" /end MEASUREMENT
/begin MEASUREMENT CTR_ABC_BN_POW_GEN "" UBYTE _CNV_A_R_LINEAR_____10_CM 1 100. 0. 255. ECU_ADDRESS 0x3fd662 FORMAT "%3.0" /end MEASUREMENT
/begin MEASUREMENT LV_CDN_DIAG_BN_POW_GEN "" UBYTE _CNV_S_2_RANGE______21_R_CM 1 100. 0. 255. ECU_ADDRESS 0x3fd660 BIT_MASK 0x10 /end MEASUREMENT
/begin MEASUREMENT LV_END_DIAG_BN_POW_GEN "" UBYTE _CNV_S_2_RANGE______21_R_CM 1 100. 0. 255. ECU_ADDRESS 0x3fd660 BIT_MASK 0x20 /end MEASUREMENT
/begin MEASUREMENT LV_READY_BN_POW_GEN "" UBYTE _CNV_S_2_RANGE______21_R_CM 1 100. 0. 255. ECU_ADDRESS 0x3fd660 BIT_MASK 0x40 /end MEASUREMENT
/begin MEASUREMENT ERR_SYM_BN_POW_GEN "" UBYTE _CNV_S_6_RANGE_ERR__22_CM 1 100. 0. 15. ECU_ADDRESS 0x3fd660 BIT_MASK 0xF /end MEASUREMENT
/begin MEASUREMENT LV_ERR_MEM_BN_POW_GEN "" UBYTE _CNV_S_2_RANGE______21_R_CM 1 100. 0. 255. ECU_ADDRESS 0x3fd660 BIT_MASK 0x80 /end MEASUREMENT
/begin MEASUREMENT CTR_ABC_END_DIAG_BN_POW_GEN "" UBYTE _CNV_A_R_LINEAR_____12_CM 1 100. 0. 255. ECU_ADDRESS 0x3fd661 FORMAT "%3.0" /end MEASUREMENT
/begin MEASUREMENT CTR_ABC_BN_KM_ICL "" UBYTE _CNV_A_R_LINEAR_____10_CM 1 100. 0. 255. ECU_ADDRESS 0x3fd656 FORMAT "%3.0" /end MEASUREMENT
/begin MEASUREMENT LV_CDN_DIAG_BN_KM_ICL "" UBYTE _CNV_S_2_RANGE______21_R_CM 1 100. 0. 255. ECU_ADDRESS 0x3fd654 BIT_MASK 0x10 /end MEASUREMENT
/begin MEASUREMENT LV_END_DIAG_BN_KM_ICL "" UBYTE _CNV_S_2_RANGE______21_R_CM 1 100. 0. 255. ECU_ADDRESS 0x3fd654 BIT_MASK 0x20 /end MEASUREMENT
/begin MEASUREMENT LV_READY_BN_KM_ICL "" UBYTE _CNV_S_2_RANGE______21_R_CM 1 100. 0. 255. ECU_ADDRESS 0x3fd654 BIT_MASK 0x40 /end MEASUREMENT
/begin MEASUREMENT ERR_SYM_BN_KM_ICL "" UBYTE _CNV_S_6_RANGE_ERR__22_CM 1 100. 0. 15. ECU_ADDRESS 0x3fd654 BIT_MASK 0xF /end MEASUREMENT
/begin MEASUREMENT LV_ERR_MEM_BN_KM_ICL "" UBYTE _CNV_S_2_RANGE______21_R_CM 1 100. 0. 255. ECU_ADDRESS 0x3fd654 BIT_MASK 0x80 /end MEASUREMENT
/begin MEASUREMENT CTR_ABC_END_DIAG_BN_KM_ICL "" UBYTE _CNV_A_R_LINEAR_____12_CM 1 100. 0. 255. ECU_ADDRESS 0x3fd655 FORMAT "%3.0" /end MEASUREMENT
/begin MEASUREMENT CTR_ABC_TQI_N_MAX_NVMY_MON "" UBYTE _CNV_A_R_LINEAR_____10_CM 1 100. 0. 255. ECU_ADDRESS 0x3fd582 FORMAT "%3.0" /end MEASUREMENT
/begin MEASUREMENT LV_CDN_DIAG_TQI_N_MAX_NVMY_MON "" UBYTE _CNV_S_2_RANGE______21_R_CM 1 100. 0. 255. ECU_ADDRESS 0x3fd580 BIT_MASK 0x10 /end MEASUREMENT
/begin MEASUREMENT LV_END_DIAG_TQI_N_MAX_NVMY_MON "" UBYTE _CNV_S_2_RANGE______21_R_CM 1 100. 0. 255. ECU_ADDRESS 0x3fd580 BIT_MASK 0x20 /end MEASUREMENT
/begin MEASUREMENT LV_READY_TQI_N_MAX_NVMY_MON "" UBYTE _CNV_S_2_RANGE______21_R_CM 1 100. 0. 255. ECU_ADDRESS 0x3fd580 BIT_MASK 0x40 /end MEASUREMENT
/begin MEASUREMENT ERR_SYM_TQI_N_MAX_NVMY_MON "" UBYTE _CNV_S_6_RANGE_ERR__22_CM 1 100. 0. 15. ECU_ADDRESS 0x3fd580 BIT_MASK 0xF /end MEASUREMENT
/begin MEASUREMENT LV_ERR_MEM_TQI_N_MAX_NVMY_MON "" UBYTE _CNV_S_2_RANGE______21_R_CM 1 100. 0. 255. ECU_ADDRESS 0x3fd580 BIT_MASK 0x80 /end MEASUREMENT
/begin MEASUREMENT CTR_ABC_END_DIAG_TQI_N_MAX_NVMY_ "" UBYTE _CNV_A_R_LINEAR_____12_CM 1 100. 0. 255. ECU_ADDRESS 0x3fd581 FORMAT "%3.0" /end MEASUREMENT
/begin MEASUREMENT CTR_ABC_TPS_PLAUS "" UBYTE _CNV_A_R_LINEAR_____10_CM 1 100. 0. 255. ECU_ADDRESS 0x3fd672 FORMAT "%3.0" /end MEASUREMENT
/begin MEASUREMENT LV_CDN_DIAG_TPS_PLAUS "" UBYTE _CNV_S_2_RANGE______21_R_CM 1 100. 0. 255. ECU_ADDRESS 0x3fd670 BIT_MASK 0x10 /end MEASUREMENT
/begin MEASUREMENT LV_END_DIAG_TPS_PLAUS "" UBYTE _CNV_S_2_RANGE______21_R_CM 1 100. 0. 255. ECU_ADDRESS 0x3fd670 BIT_MASK 0x20 /end MEASUREMENT
/begin MEASUREMENT LV_READY_TPS_PLAUS "" UBYTE _CNV_S_2_RANGE______21_R_CM 1 100. 0. 255. ECU_ADDRESS 0x3fd670 BIT_MASK 0x40 /end MEASUREMENT
/begin MEASUREMENT ERR_SYM_TPS_PLAUS "" UBYTE _CNV_S_6_RANGE_ERR__22_CM 1 100. 0. 15. ECU_ADDRESS 0x3fd670 BIT_MASK 0xF /end MEASUREMENT
/begin MEASUREMENT LV_ERR_MEM_TPS_PLAUS "" UBYTE _CNV_S_2_RANGE______21_R_CM 1 100. 0. 255. ECU_ADDRESS 0x3fd670 BIT_MASK 0x80 /end MEASUREMENT
/begin MEASUREMENT CTR_ABC_END_DIAG_TPS_PLAUS "" UBYTE _CNV_A_R_LINEAR_____12_CM 1 100. 0. 255. ECU_ADDRESS 0x3fd671 FORMAT "%3.0" /end MEASUREMENT
/begin MEASUREMENT CTR_ABC_TOUT_TXU_1 "" UBYTE _CNV_A_R_LINEAR_____10_CM 1 100. 0. 255. ECU_ADDRESS 0x3fd4ce FORMAT "%3.0" /end MEASUREMENT
/begin MEASUREMENT LV_CDN_DIAG_TOUT_TXU_1 "" UBYTE _CNV_S_2_RANGE______21_R_CM 1 100. 0. 255. ECU_ADDRESS 0x3fd4cc BIT_MASK 0x10 /end MEASUREMENT
/begin MEASUREMENT LV_END_DIAG_TOUT_TXU_1 "" UBYTE _CNV_S_2_RANGE______21_R_CM 1 100. 0. 255. ECU_ADDRESS 0x3fd4cc BIT_MASK 0x20 /end MEASUREMENT
/begin MEASUREMENT LV_READY_TOUT_TXU_1 "" UBYTE _CNV_S_2_RANGE______21_R_CM 1 100. 0. 255. ECU_ADDRESS 0x3fd4cc BIT_MASK 0x40 /end MEASUREMENT
/begin MEASUREMENT ERR_SYM_TOUT_TXU_1 "" UBYTE _CNV_S_6_RANGE_ERR__22_CM 1 100. 0. 15. ECU_ADDRESS 0x3fd4cc BIT_MASK 0xF /end MEASUREMENT
/begin MEASUREMENT LV_ERR_MEM_TOUT_TXU_1 "" UBYTE _CNV_S_2_RANGE______21_R_CM 1 100. 0. 255. ECU_ADDRESS 0x3fd4cc BIT_MASK 0x80 /end MEASUREMENT
/begin MEASUREMENT CTR_ABC_END_DIAG_TOUT_TXU_1 "" UBYTE _CNV_A_R_LINEAR_____12_CM 1 100. 0. 255. ECU_ADDRESS 0x3fd4cd FORMAT "%3.0" /end MEASUREMENT
/begin MEASUREMENT CTR_ABC_MTC_DR "" UBYTE _CNV_A_R_LINEAR_____10_CM 1 100. 0. 255. ECU_ADDRESS 0x3fd47a FORMAT "%3.0" /end MEASUREMENT
/begin MEASUREMENT LV_CDN_DIAG_MTC_DR "" UBYTE _CNV_S_2_RANGE______21_R_CM 1 100. 0. 255. ECU_ADDRESS 0x3fd478 BIT_MASK 0x10 /end MEASUREMENT
/begin MEASUREMENT LV_END_DIAG_MTC_DR "" UBYTE _CNV_S_2_RANGE______21_R_CM 1 100. 0. 255. ECU_ADDRESS 0x3fd478 BIT_MASK 0x20 /end MEASUREMENT
/begin MEASUREMENT LV_READY_MTC_DR "" UBYTE _CNV_S_2_RANGE______21_R_CM 1 100. 0. 255. ECU_ADDRESS 0x3fd478 BIT_MASK 0x40 /end MEASUREMENT
/begin MEASUREMENT ERR_SYM_MTC_DR "" UBYTE _CNV_S_6_RANGE_ERR__22_CM 1 100. 0. 15. ECU_ADDRESS 0x3fd478 BIT_MASK 0xF /end MEASUREMENT
/begin MEASUREMENT LV_ERR_MEM_MTC_DR "" UBYTE _CNV_S_2_RANGE______21_R_CM 1 100. 0. 255. ECU_ADDRESS 0x3fd478 BIT_MASK 0x80 /end MEASUREMENT
/begin MEASUREMENT CTR_ABC_END_DIAG_MTC_DR "" UBYTE _CNV_A_R_LINEAR_____12_CM 1 100. 0. 255. ECU_ADDRESS 0x3fd479 FORMAT "%3.0" /end MEASUREMENT
/begin MEASUREMENT CTR_ABC_TPS_AD "" UBYTE _CNV_A_R_LINEAR_____10_CM 1 100. 0. 255. ECU_ADDRESS 0x3fd48a FORMAT "%3.0" /end MEASUREMENT
/begin MEASUREMENT LV_CDN_DIAG_TPS_AD "" UBYTE _CNV_S_2_RANGE______21_R_CM 1 100. 0. 255. ECU_ADDRESS 0x3fd488 BIT_MASK 0x10 /end MEASUREMENT
/begin MEASUREMENT LV_END_DIAG_TPS_AD "" UBYTE _CNV_S_2_RANGE______21_R_CM 1 100. 0. 255. ECU_ADDRESS 0x3fd488 BIT_MASK 0x20 /end MEASUREMENT
/begin MEASUREMENT LV_READY_TPS_AD "" UBYTE _CNV_S_2_RANGE______21_R_CM 1 100. 0. 255. ECU_ADDRESS 0x3fd488 BIT_MASK 0x40 /end MEASUREMENT
/begin MEASUREMENT ERR_SYM_TPS_AD "" UBYTE _CNV_S_6_RANGE_ERR__22_CM 1 100. 0. 15. ECU_ADDRESS 0x3fd488 BIT_MASK 0xF /end MEASUREMENT
/begin MEASUREMENT LV_ERR_MEM_TPS_AD "" UBYTE _CNV_S_2_RANGE______21_R_CM 1 100. 0. 255. ECU_ADDRESS 0x3fd488 BIT_MASK 0x80 /end MEASUREMENT
/begin MEASUREMENT CTR_ABC_END_DIAG_TPS_AD "" UBYTE _CNV_A_R_LINEAR_____12_CM 1 100. 0. 255. ECU_ADDRESS 0x3fd489 FORMAT "%3.0" /end MEASUREMENT
/begin MEASUREMENT CTR_ABC_DIAGCPS "" UBYTE _CNV_A_R_LINEAR_____10_CM 1 100. 0. 255. ECU_ADDRESS 0x3fd60e FORMAT "%3.0" /end MEASUREMENT
/begin MEASUREMENT LV_CDN_DIAG_DIAGCPS "" UBYTE _CNV_S_2_RANGE______21_R_CM 1 100. 0. 255. ECU_ADDRESS 0x3fd60c BIT_MASK 0x10 /end MEASUREMENT
/begin MEASUREMENT LV_END_DIAG_DIAGCPS "" UBYTE _CNV_S_2_RANGE______21_R_CM 1 100. 0. 255. ECU_ADDRESS 0x3fd60c BIT_MASK 0x20 /end MEASUREMENT
/begin MEASUREMENT LV_READY_DIAGCPS "" UBYTE _CNV_S_2_RANGE______21_R_CM 1 100. 0. 255. ECU_ADDRESS 0x3fd60c BIT_MASK 0x40 /end MEASUREMENT
/begin MEASUREMENT ERR_SYM_DIAGCPS "" UBYTE _CNV_S_6_RANGE_ERR__22_CM 1 100. 0. 15. ECU_ADDRESS 0x3fd60c BIT_MASK 0xF /end MEASUREMENT
/begin MEASUREMENT LV_ERR_DIAGCPS "" UBYTE _CNV_S_2_RANGE______21_R_CM 1 100. 0. 255. ECU_ADDRESS 0x3fd60c BIT_MASK 0x80 /end MEASUREMENT
/begin MEASUREMENT CTR_ABC_END_DIAG_DIAGCPS "" UBYTE _CNV_A_R_LINEAR_____12_CM 1 100. 0. 255. ECU_ADDRESS 0x3fd60d FORMAT "%3.0" /end MEASUREMENT
/begin MEASUREMENT CTR_ABC_CAM_PER_0 "" UBYTE _CNV_A_R_LINEAR_____10_CM 1 100. 0. 255. ECU_ADDRESS 0x3fd4a6 FORMAT "%3.0" /end MEASUREMENT
/begin MEASUREMENT LV_CDN_DIAG_CAM_PER_0 "" UBYTE _CNV_S_2_RANGE______21_R_CM 1 100. 0. 255. ECU_ADDRESS 0x3fd4a4 BIT_MASK 0x10 /end MEASUREMENT
/begin MEASUREMENT LV_END_DIAG_CAM_PER_0 "" UBYTE _CNV_S_2_RANGE______21_R_CM 1 100. 0. 255. ECU_ADDRESS 0x3fd4a4 BIT_MASK 0x20 /end MEASUREMENT
/begin MEASUREMENT LV_READY_CAM_PER_0 "" UBYTE _CNV_S_2_RANGE______21_R_CM 1 100. 0. 255. ECU_ADDRESS 0x3fd4a4 BIT_MASK 0x40 /end MEASUREMENT
/begin MEASUREMENT ERR_SYM_CAM_PER_0 "" UBYTE _CNV_S_6_RANGE_ERR__22_CM 1 100. 0. 15. ECU_ADDRESS 0x3fd4a4 BIT_MASK 0xF /end MEASUREMENT
/begin MEASUREMENT LV_ERR_MEM_CAM_PER_0 "" UBYTE _CNV_S_2_RANGE______21_R_CM 1 100. 0. 255. ECU_ADDRESS 0x3fd4a4 BIT_MASK 0x80 /end MEASUREMENT
/begin MEASUREMENT CTR_ABC_END_DIAG_CAM_PER_0 "" UBYTE _CNV_A_R_LINEAR_____12_CM 1 100. 0. 255. ECU_ADDRESS 0x3fd4a5 FORMAT "%3.0" /end MEASUREMENT
/begin MEASUREMENT CTR_ABC_CAM_PER_1 "" UBYTE _CNV_A_R_LINEAR_____10_CM 1 100. 0. 255. ECU_ADDRESS 0x3fd4aa FORMAT "%3.0" /end MEASUREMENT
/begin MEASUREMENT LV_CDN_DIAG_CAM_PER_1 "" UBYTE _CNV_S_2_RANGE______21_R_CM 1 100. 0. 255. ECU_ADDRESS 0x3fd4a8 BIT_MASK 0x10 /end MEASUREMENT
/begin MEASUREMENT LV_END_DIAG_CAM_PER_1 "" UBYTE _CNV_S_2_RANGE______21_R_CM 1 100. 0. 255. ECU_ADDRESS 0x3fd4a8 BIT_MASK 0x20 /end MEASUREMENT
/begin MEASUREMENT LV_READY_CAM_PER_1 "" UBYTE _CNV_S_2_RANGE______21_R_CM 1 100. 0. 255. ECU_ADDRESS 0x3fd4a8 BIT_MASK 0x40 /end MEASUREMENT
/begin MEASUREMENT ERR_SYM_CAM_PER_1 "" UBYTE _CNV_S_6_RANGE_ERR__22_CM 1 100. 0. 15. ECU_ADDRESS 0x3fd4a8 BIT_MASK 0xF /end MEASUREMENT
/begin MEASUREMENT LV_ERR_MEM_CAM_PER_1 "" UBYTE _CNV_S_2_RANGE______21_R_CM 1 100. 0. 255. ECU_ADDRESS 0x3fd4a8 BIT_MASK 0x80 /end MEASUREMENT
/begin MEASUREMENT CTR_ABC_END_DIAG_CAM_PER_1 "" UBYTE _CNV_A_R_LINEAR_____12_CM 1 100. 0. 255. ECU_ADDRESS 0x3fd4a9 FORMAT "%3.0" /end MEASUREMENT
/begin MEASUREMENT CTR_ABC_TQ_MAX_CLU_MON_1 "" UBYTE _CNV_A_R_LINEAR_____10_CM 1 100. 0. 255. ECU_ADDRESS 0x3fd55e FORMAT "%3.0" /end MEASUREMENT
/begin MEASUREMENT LV_CDN_DIAG_TQ_MAX_CLU_MON_1 "" UBYTE _CNV_S_2_RANGE______21_R_CM 1 100. 0. 255. ECU_ADDRESS 0x3fd55c BIT_MASK 0x10 /end MEASUREMENT
/begin MEASUREMENT LV_END_DIAG_TQ_MAX_CLU_MON_1 "" UBYTE _CNV_S_2_RANGE______21_R_CM 1 100. 0. 255. ECU_ADDRESS 0x3fd55c BIT_MASK 0x20 /end MEASUREMENT
/begin MEASUREMENT LV_READY_TQ_MAX_CLU_MON_1 "" UBYTE _CNV_S_2_RANGE______21_R_CM 1 100. 0. 255. ECU_ADDRESS 0x3fd55c BIT_MASK 0x40 /end MEASUREMENT
/begin MEASUREMENT ERR_SYM_TQ_MAX_CLU_MON_1 "" UBYTE _CNV_S_6_RANGE_ERR__22_CM 1 100. 0. 15. ECU_ADDRESS 0x3fd55c BIT_MASK 0xF /end MEASUREMENT
/begin MEASUREMENT LV_ERR_MEM_TQ_MAX_CLU_MON_1 "" UBYTE _CNV_S_2_RANGE______21_R_CM 1 100. 0. 255. ECU_ADDRESS 0x3fd55c BIT_MASK 0x80 /end MEASUREMENT
/begin MEASUREMENT CTR_ABC_END_DIAG_TQ_MAX_CLU_MON_ "" UBYTE _CNV_A_R_LINEAR_____12_CM 1 100. 0. 255. ECU_ADDRESS 0x3fd55d FORMAT "%3.0" /end MEASUREMENT
/begin MEASUREMENT CTR_ABC_LS_DOWN_SWT_1 "" UBYTE _CNV_A_R_LINEAR_____10_CM 1 100. 0. 255. ECU_ADDRESS 0x3fd5ae FORMAT "%3.0" /end MEASUREMENT
/begin MEASUREMENT LV_CDN_DIAG_LS_DOWN_SWT_1 "" UBYTE _CNV_S_2_RANGE______21_R_CM 1 100. 0. 255. ECU_ADDRESS 0x3fd5ac BIT_MASK 0x10 /end MEASUREMENT
/begin MEASUREMENT LV_END_DIAG_LS_DOWN_SWT_1 "" UBYTE _CNV_S_2_RANGE______21_R_CM 1 100. 0. 255. ECU_ADDRESS 0x3fd5ac BIT_MASK 0x20 /end MEASUREMENT
/begin MEASUREMENT LV_READY_LS_DOWN_SWT_1 "" UBYTE _CNV_S_2_RANGE______21_R_CM 1 100. 0. 255. ECU_ADDRESS 0x3fd5ac BIT_MASK 0x40 /end MEASUREMENT
/begin MEASUREMENT ERR_SYM_LS_DOWN_SWT_1 "" UBYTE _CNV_S_6_RANGE_ERR__22_CM 1 100. 0. 15. ECU_ADDRESS 0x3fd5ac BIT_MASK 0xF /end MEASUREMENT
/begin MEASUREMENT LV_ERR_MEM_LS_DOWN_SWT_1 "" UBYTE _CNV_S_2_RANGE______21_R_CM 1 100. 0. 255. ECU_ADDRESS 0x3fd5ac BIT_MASK 0x80 /end MEASUREMENT
/begin MEASUREMENT CTR_ABC_END_DIAG_LS_DOWN_SWT_1 "" UBYTE _CNV_A_R_LINEAR_____12_CM 1 100. 0. 255. ECU_ADDRESS 0x3fd5ad FORMAT "%3.0" /end MEASUREMENT
/begin MEASUREMENT CTR_ABC_LS_DOWN_SWT_2 "" UBYTE _CNV_A_R_LINEAR_____10_CM 1 100. 0. 255. ECU_ADDRESS 0x3fd5b2 FORMAT "%3.0" /end MEASUREMENT
/begin MEASUREMENT LV_CDN_DIAG_LS_DOWN_SWT_2 "" UBYTE _CNV_S_2_RANGE______21_R_CM 1 100. 0. 255. ECU_ADDRESS 0x3fd5b0 BIT_MASK 0x10 /end MEASUREMENT
/begin MEASUREMENT LV_END_DIAG_LS_DOWN_SWT_2 "" UBYTE _CNV_S_2_RANGE______21_R_CM 1 100. 0. 255. ECU_ADDRESS 0x3fd5b0 BIT_MASK 0x20 /end MEASUREMENT
/begin MEASUREMENT LV_READY_LS_DOWN_SWT_2 "" UBYTE _CNV_S_2_RANGE______21_R_CM 1 100. 0. 255. ECU_ADDRESS 0x3fd5b0 BIT_MASK 0x40 /end MEASUREMENT
/begin MEASUREMENT ERR_SYM_LS_DOWN_SWT_2 "" UBYTE _CNV_S_6_RANGE_ERR__22_CM 1 100. 0. 15. ECU_ADDRESS 0x3fd5b0 BIT_MASK 0xF /end MEASUREMENT
/begin MEASUREMENT LV_ERR_MEM_LS_DOWN_SWT_2 "" UBYTE _CNV_S_2_RANGE______21_R_CM 1 100. 0. 255. ECU_ADDRESS 0x3fd5b0 BIT_MASK 0x80 /end MEASUREMENT
/begin MEASUREMENT CTR_ABC_END_DIAG_LS_DOWN_SWT_2 "" UBYTE _CNV_A_R_LINEAR_____12_CM 1 100. 0. 255. ECU_ADDRESS 0x3fd5b1 FORMAT "%3.0" /end MEASUREMENT
/begin MEASUREMENT CTR_ABC_IV_0 "" UBYTE _CNV_A_R_LINEAR_____10_CM 1 100. 0. 255. ECU_ADDRESS 0x3fd38e FORMAT "%3.0" /end MEASUREMENT
/begin MEASUREMENT LV_CDN_DIAG_IV_0 "" UBYTE _CNV_S_2_RANGE______21_R_CM 1 100. 0. 255. ECU_ADDRESS 0x3fd38c BIT_MASK 0x10 /end MEASUREMENT
/begin MEASUREMENT LV_END_DIAG_IV_0 "" UBYTE _CNV_S_2_RANGE______21_R_CM 1 100. 0. 255. ECU_ADDRESS 0x3fd38c BIT_MASK 0x20 /end MEASUREMENT
/begin MEASUREMENT LV_READY_IV_0 "" UBYTE _CNV_S_2_RANGE______21_R_CM 1 100. 0. 255. ECU_ADDRESS 0x3fd38c BIT_MASK 0x40 /end MEASUREMENT
/begin MEASUREMENT ERR_SYM_IV_0 "" UBYTE _CNV_S_6_RANGE_ERR__22_CM 1 100. 0. 15. ECU_ADDRESS 0x3fd38c BIT_MASK 0xF /end MEASUREMENT
/begin MEASUREMENT LV_ERR_MEM_IV_0 "" UBYTE _CNV_S_2_RANGE______21_R_CM 1 100. 0. 255. ECU_ADDRESS 0x3fd38c BIT_MASK 0x80 /end MEASUREMENT
/begin MEASUREMENT CTR_ABC_END_DIAG_IV_0 "" UBYTE _CNV_A_R_LINEAR_____12_CM 1 100. 0. 255. ECU_ADDRESS 0x3fd38d FORMAT "%3.0" /end MEASUREMENT
/begin MEASUREMENT CTR_ABC_IV_1 "" UBYTE _CNV_A_R_LINEAR_____10_CM 1 100. 0. 255. ECU_ADDRESS 0x3fd392 FORMAT "%3.0" /end MEASUREMENT
/begin MEASUREMENT LV_CDN_DIAG_IV_1 "" UBYTE _CNV_S_2_RANGE______21_R_CM 1 100. 0. 255. ECU_ADDRESS 0x3fd390 BIT_MASK 0x10 /end MEASUREMENT
/begin MEASUREMENT LV_END_DIAG_IV_1 "" UBYTE _CNV_S_2_RANGE______21_R_CM 1 100. 0. 255. ECU_ADDRESS 0x3fd390 BIT_MASK 0x20 /end MEASUREMENT
/begin MEASUREMENT LV_READY_IV_1 "" UBYTE _CNV_S_2_RANGE______21_R_CM 1 100. 0. 255. ECU_ADDRESS 0x3fd390 BIT_MASK 0x40 /end MEASUREMENT
/begin MEASUREMENT ERR_SYM_IV_1 "" UBYTE _CNV_S_6_RANGE_ERR__22_CM 1 100. 0. 15. ECU_ADDRESS 0x3fd390 BIT_MASK 0xF /end MEASUREMENT
/begin MEASUREMENT LV_ERR_MEM_IV_1 "" UBYTE _CNV_S_2_RANGE______21_R_CM 1 100. 0. 255. ECU_ADDRESS 0x3fd390 BIT_MASK 0x80 /end MEASUREMENT
/begin MEASUREMENT CTR_ABC_END_DIAG_IV_1 "" UBYTE _CNV_A_R_LINEAR_____12_CM 1 100. 0. 255. ECU_ADDRESS 0x3fd391 FORMAT "%3.0" /end MEASUREMENT
/begin MEASUREMENT CTR_ABC_IV_2 "" UBYTE _CNV_A_R_LINEAR_____10_CM 1 100. 0. 255. ECU_ADDRESS 0x3fd396 FORMAT "%3.0" /end MEASUREMENT
/begin MEASUREMENT LV_CDN_DIAG_IV_2 "" UBYTE _CNV_S_2_RANGE______21_R_CM 1 100. 0. 255. ECU_ADDRESS 0x3fd394 BIT_MASK 0x10 /end MEASUREMENT
/begin MEASUREMENT LV_END_DIAG_IV_2 "" UBYTE _CNV_S_2_RANGE______21_R_CM 1 100. 0. 255. ECU_ADDRESS 0x3fd394 BIT_MASK 0x20 /end MEASUREMENT
/begin MEASUREMENT LV_READY_IV_2 "" UBYTE _CNV_S_2_RANGE______21_R_CM 1 100. 0. 255. ECU_ADDRESS 0x3fd394 BIT_MASK 0x40 /end MEASUREMENT
/begin MEASUREMENT ERR_SYM_IV_2 "" UBYTE _CNV_S_6_RANGE_ERR__22_CM 1 100. 0. 15. ECU_ADDRESS 0x3fd394 BIT_MASK 0xF /end MEASUREMENT
/begin MEASUREMENT LV_ERR_MEM_IV_2 "" UBYTE _CNV_S_2_RANGE______21_R_CM 1 100. 0. 255. ECU_ADDRESS 0x3fd394 BIT_MASK 0x80 /end MEASUREMENT
/begin MEASUREMENT CTR_ABC_END_DIAG_IV_2 "" UBYTE _CNV_A_R_LINEAR_____12_CM 1 100. 0. 255. ECU_ADDRESS 0x3fd395 FORMAT "%3.0" /end MEASUREMENT
/begin MEASUREMENT CTR_ABC_IV_3 "" UBYTE _CNV_A_R_LINEAR_____10_CM 1 100. 0. 255. ECU_ADDRESS 0x3fd39a FORMAT "%3.0" /end MEASUREMENT
/begin MEASUREMENT LV_CDN_DIAG_IV_3 "" UBYTE _CNV_S_2_RANGE______21_R_CM 1 100. 0. 255. ECU_ADDRESS 0x3fd398 BIT_MASK 0x10 /end MEASUREMENT
/begin MEASUREMENT LV_END_DIAG_IV_3 "" UBYTE _CNV_S_2_RANGE______21_R_CM 1 100. 0. 255. ECU_ADDRESS 0x3fd398 BIT_MASK 0x20 /end MEASUREMENT
/begin MEASUREMENT LV_READY_IV_3 "" UBYTE _CNV_S_2_RANGE______21_R_CM 1 100. 0. 255. ECU_ADDRESS 0x3fd398 BIT_MASK 0x40 /end MEASUREMENT
/begin MEASUREMENT ERR_SYM_IV_3 "" UBYTE _CNV_S_6_RANGE_ERR__22_CM 1 100. 0. 15. ECU_ADDRESS 0x3fd398 BIT_MASK 0xF /end MEASUREMENT
/begin MEASUREMENT LV_ERR_MEM_IV_3 "" UBYTE _CNV_S_2_RANGE______21_R_CM 1 100. 0. 255. ECU_ADDRESS 0x3fd398 BIT_MASK 0x80 /end MEASUREMENT
/begin MEASUREMENT CTR_ABC_END_DIAG_IV_3 "" UBYTE _CNV_A_R_LINEAR_____12_CM 1 100. 0. 255. ECU_ADDRESS 0x3fd399 FORMAT "%3.0" /end MEASUREMENT
/begin MEASUREMENT CTR_ABC_IV_4 "" UBYTE _CNV_A_R_LINEAR_____10_CM 1 100. 0. 255. ECU_ADDRESS 0x3fd39e FORMAT "%3.0" /end MEASUREMENT
/begin MEASUREMENT LV_CDN_DIAG_IV_4 "" UBYTE _CNV_S_2_RANGE______21_R_CM 1 100. 0. 255. ECU_ADDRESS 0x3fd39c BIT_MASK 0x10 /end MEASUREMENT
/begin MEASUREMENT LV_END_DIAG_IV_4 "" UBYTE _CNV_S_2_RANGE______21_R_CM 1 100. 0. 255. ECU_ADDRESS 0x3fd39c BIT_MASK 0x20 /end MEASUREMENT
/begin MEASUREMENT LV_READY_IV_4 "" UBYTE _CNV_S_2_RANGE______21_R_CM 1 100. 0. 255. ECU_ADDRESS 0x3fd39c BIT_MASK 0x40 /end MEASUREMENT
/begin MEASUREMENT ERR_SYM_IV_4 "" UBYTE _CNV_S_6_RANGE_ERR__22_CM 1 100. 0. 15. ECU_ADDRESS 0x3fd39c BIT_MASK 0xF /end MEASUREMENT
/begin MEASUREMENT LV_ERR_MEM_IV_4 "" UBYTE _CNV_S_2_RANGE______21_R_CM 1 100. 0. 255. ECU_ADDRESS 0x3fd39c BIT_MASK 0x80 /end MEASUREMENT
/begin MEASUREMENT CTR_ABC_END_DIAG_IV_4 "" UBYTE _CNV_A_R_LINEAR_____12_CM 1 100. 0. 255. ECU_ADDRESS 0x3fd39d FORMAT "%3.0" /end MEASUREMENT
/begin MEASUREMENT CTR_ABC_IV_5 "" UBYTE _CNV_A_R_LINEAR_____10_CM 1 100. 0. 255. ECU_ADDRESS 0x3fd3a2 FORMAT "%3.0" /end MEASUREMENT
/begin MEASUREMENT LV_CDN_DIAG_IV_5 "" UBYTE _CNV_S_2_RANGE______21_R_CM 1 100. 0. 255. ECU_ADDRESS 0x3fd3a0 BIT_MASK 0x10 /end MEASUREMENT
/begin MEASUREMENT LV_END_DIAG_IV_5 "" UBYTE _CNV_S_2_RANGE______21_R_CM 1 100. 0. 255. ECU_ADDRESS 0x3fd3a0 BIT_MASK 0x20 /end MEASUREMENT
/begin MEASUREMENT LV_READY_IV_5 "" UBYTE _CNV_S_2_RANGE______21_R_CM 1 100. 0. 255. ECU_ADDRESS 0x3fd3a0 BIT_MASK 0x40 /end MEASUREMENT
/begin MEASUREMENT ERR_SYM_IV_5 "" UBYTE _CNV_S_6_RANGE_ERR__22_CM 1 100. 0. 15. ECU_ADDRESS 0x3fd3a0 BIT_MASK 0xF /end MEASUREMENT
/begin MEASUREMENT LV_ERR_MEM_IV_5 "" UBYTE _CNV_S_2_RANGE______21_R_CM 1 100. 0. 255. ECU_ADDRESS 0x3fd3a0 BIT_MASK 0x80 /end MEASUREMENT
/begin MEASUREMENT CTR_ABC_END_DIAG_IV_5 "" UBYTE _CNV_A_R_LINEAR_____12_CM 1 100. 0. 255. ECU_ADDRESS 0x3fd3a1 FORMAT "%3.0" /end MEASUREMENT
/begin MEASUREMENT CTR_ABC_TOUT_EFP "" UBYTE _CNV_A_R_LINEAR_____10_CM 1 100. 0. 255. ECU_ADDRESS 0x3fd60a FORMAT "%3.0" /end MEASUREMENT
/begin MEASUREMENT LV_CDN_DIAG_TOUT_EFP "" UBYTE _CNV_S_2_RANGE______21_R_CM 1 100. 0. 255. ECU_ADDRESS 0x3fd608 BIT_MASK 0x10 /end MEASUREMENT
/begin MEASUREMENT LV_END_DIAG_TOUT_EFP "" UBYTE _CNV_S_2_RANGE______21_R_CM 1 100. 0. 255. ECU_ADDRESS 0x3fd608 BIT_MASK 0x20 /end MEASUREMENT
/begin MEASUREMENT LV_READY_TOUT_EFP "" UBYTE _CNV_S_2_RANGE______21_R_CM 1 100. 0. 255. ECU_ADDRESS 0x3fd608 BIT_MASK 0x40 /end MEASUREMENT
/begin MEASUREMENT ERR_SYM_TOUT_EFP "" UBYTE _CNV_S_6_RANGE_ERR__22_CM 1 100. 0. 15. ECU_ADDRESS 0x3fd608 BIT_MASK 0xF /end MEASUREMENT
/begin MEASUREMENT LV_ERR_MEM_TOUT_EFP "" UBYTE _CNV_S_2_RANGE______21_R_CM 1 100. 0. 255. ECU_ADDRESS 0x3fd608 BIT_MASK 0x80 /end MEASUREMENT
/begin MEASUREMENT CTR_ABC_END_DIAG_TOUT_EFP "" UBYTE _CNV_A_R_LINEAR_____12_CM 1 100. 0. 255. ECU_ADDRESS 0x3fd609 FORMAT "%3.0" /end MEASUREMENT
/begin MEASUREMENT CTR_ABC_EFP_TEMP "" UBYTE _CNV_A_R_LINEAR_____10_CM 1 100. 0. 255. ECU_ADDRESS 0x3fd686 FORMAT "%3.0" /end MEASUREMENT
/begin MEASUREMENT LV_CDN_DIAG_EFP_TEMP "" UBYTE _CNV_S_2_RANGE______21_R_CM 1 100. 0. 255. ECU_ADDRESS 0x3fd684 BIT_MASK 0x10 /end MEASUREMENT
/begin MEASUREMENT LV_END_DIAG_EFP_TEMP "" UBYTE _CNV_S_2_RANGE______21_R_CM 1 100. 0. 255. ECU_ADDRESS 0x3fd684 BIT_MASK 0x20 /end MEASUREMENT
/begin MEASUREMENT LV_READY_EFP_TEMP "" UBYTE _CNV_S_2_RANGE______21_R_CM 1 100. 0. 255. ECU_ADDRESS 0x3fd684 BIT_MASK 0x40 /end MEASUREMENT
/begin MEASUREMENT ERR_SYM_EFP_TEMP "" UBYTE _CNV_S_6_RANGE_ERR__22_CM 1 100. 0. 15. ECU_ADDRESS 0x3fd684 BIT_MASK 0xF /end MEASUREMENT
/begin MEASUREMENT LV_ERR_MEM_EFP_TEMP "" UBYTE _CNV_S_2_RANGE______21_R_CM 1 100. 0. 255. ECU_ADDRESS 0x3fd684 BIT_MASK 0x80 /end MEASUREMENT
/begin MEASUREMENT CTR_ABC_END_DIAG_EFP_TEMP "" UBYTE _CNV_A_R_LINEAR_____12_CM 1 100. 0. 255. ECU_ADDRESS 0x3fd685 FORMAT "%3.0" /end MEASUREMENT
/begin MEASUREMENT CTR_ABC_BN_TQ_DCC "" UBYTE _CNV_A_R_LINEAR_____10_CM 1 100. 0. 255. ECU_ADDRESS 0x3fd626 FORMAT "%3.0" /end MEASUREMENT
/begin MEASUREMENT LV_CDN_DIAG_BN_TQ_DCC "" UBYTE _CNV_S_2_RANGE______21_R_CM 1 100. 0. 255. ECU_ADDRESS 0x3fd624 BIT_MASK 0x10 /end MEASUREMENT
/begin MEASUREMENT LV_END_DIAG_BN_TQ_DCC "" UBYTE _CNV_S_2_RANGE______21_R_CM 1 100. 0. 255. ECU_ADDRESS 0x3fd624 BIT_MASK 0x20 /end MEASUREMENT
/begin MEASUREMENT LV_READY_BN_TQ_DCC "" UBYTE _CNV_S_2_RANGE______21_R_CM 1 100. 0. 255. ECU_ADDRESS 0x3fd624 BIT_MASK 0x40 /end MEASUREMENT
/begin MEASUREMENT ERR_SYM_BN_TQ_DCC "" UBYTE _CNV_S_6_RANGE_ERR__22_CM 1 100. 0. 15. ECU_ADDRESS 0x3fd624 BIT_MASK 0xF /end MEASUREMENT
/begin MEASUREMENT LV_ERR_MEM_BN_TQ_DCC "" UBYTE _CNV_S_2_RANGE______21_R_CM 1 100. 0. 255. ECU_ADDRESS 0x3fd624 BIT_MASK 0x80 /end MEASUREMENT
/begin MEASUREMENT CTR_ABC_END_DIAG_BN_TQ_DCC "" UBYTE _CNV_A_R_LINEAR_____12_CM 1 100. 0. 255. ECU_ADDRESS 0x3fd625 FORMAT "%3.0" /end MEASUREMENT
/begin MEASUREMENT CTR_ABC_BN_ICL "" UBYTE _CNV_A_R_LINEAR_____10_CM 1 100. 0. 255. ECU_ADDRESS 0x3fd65a FORMAT "%3.0" /end MEASUREMENT
/begin MEASUREMENT LV_CDN_DIAG_BN_ICL "" UBYTE _CNV_S_2_RANGE______21_R_CM 1 100. 0. 255. ECU_ADDRESS 0x3fd658 BIT_MASK 0x10 /end MEASUREMENT
/begin MEASUREMENT LV_END_DIAG_BN_ICL "" UBYTE _CNV_S_2_RANGE______21_R_CM 1 100. 0. 255. ECU_ADDRESS 0x3fd658 BIT_MASK 0x20 /end MEASUREMENT
/begin MEASUREMENT LV_READY_BN_ICL "" UBYTE _CNV_S_2_RANGE______21_R_CM 1 100. 0. 255. ECU_ADDRESS 0x3fd658 BIT_MASK 0x40 /end MEASUREMENT
/begin MEASUREMENT ERR_SYM_BN_ICL "" UBYTE _CNV_S_6_RANGE_ERR__22_CM 1 100. 0. 15. ECU_ADDRESS 0x3fd658 BIT_MASK 0xF /end MEASUREMENT
/begin MEASUREMENT LV_ERR_MEM_BN_ICL "" UBYTE _CNV_S_2_RANGE______21_R_CM 1 100. 0. 255. ECU_ADDRESS 0x3fd658 BIT_MASK 0x80 /end MEASUREMENT
/begin MEASUREMENT CTR_ABC_END_DIAG_BN_ICL "" UBYTE _CNV_A_R_LINEAR_____12_CM 1 100. 0. 255. ECU_ADDRESS 0x3fd659 FORMAT "%3.0" /end MEASUREMENT
/begin MEASUREMENT CTR_ABC_TQI_LIM "" UBYTE _CNV_A_R_LINEAR_____10_CM 1 100. 0. 255. ECU_ADDRESS 0x3fd5ce FORMAT "%3.0" /end MEASUREMENT
/begin MEASUREMENT LV_CDN_DIAG_TQI_LIM "" UBYTE _CNV_S_2_RANGE______21_R_CM 1 100. 0. 255. ECU_ADDRESS 0x3fd5cc BIT_MASK 0x10 /end MEASUREMENT
/begin MEASUREMENT LV_END_DIAG_TQI_LIM "" UBYTE _CNV_S_2_RANGE______21_R_CM 1 100. 0. 255. ECU_ADDRESS 0x3fd5cc BIT_MASK 0x20 /end MEASUREMENT
/begin MEASUREMENT LV_READY_TQI_LIM "" UBYTE _CNV_S_2_RANGE______21_R_CM 1 100. 0. 255. ECU_ADDRESS 0x3fd5cc BIT_MASK 0x40 /end MEASUREMENT
/begin MEASUREMENT ERR_SYM_TQI_LIM "" UBYTE _CNV_S_6_RANGE_ERR__22_CM 1 100. 0. 15. ECU_ADDRESS 0x3fd5cc BIT_MASK 0xF /end MEASUREMENT
/begin MEASUREMENT LV_ERR_MEM_TQI_LIM "" UBYTE _CNV_S_2_RANGE______21_R_CM 1 100. 0. 255. ECU_ADDRESS 0x3fd5cc BIT_MASK 0x80 /end MEASUREMENT
/begin MEASUREMENT CTR_ABC_END_DIAG_TQI_LIM "" UBYTE _CNV_A_R_LINEAR_____12_CM 1 100. 0. 255. ECU_ADDRESS 0x3fd5cd FORMAT "%3.0" /end MEASUREMENT
/begin MEASUREMENT CTR_ABC_DMTL_PUMP "" UBYTE _CNV_A_R_LINEAR_____10_CM 1 100. 0. 255. ECU_ADDRESS 0x3fd5ea FORMAT "%3.0" /end MEASUREMENT
/begin MEASUREMENT LV_CDN_DIAG_DMTL_PUMP "" UBYTE _CNV_S_2_RANGE______21_R_CM 1 100. 0. 255. ECU_ADDRESS 0x3fd5e8 BIT_MASK 0x10 /end MEASUREMENT
/begin MEASUREMENT LV_END_DIAG_DMTL_PUMP "" UBYTE _CNV_S_2_RANGE______21_R_CM 1 100. 0. 255. ECU_ADDRESS 0x3fd5e8 BIT_MASK 0x20 /end MEASUREMENT
/begin MEASUREMENT LV_READY_DMTL_PUMP "" UBYTE _CNV_S_2_RANGE______21_R_CM 1 100. 0. 255. ECU_ADDRESS 0x3fd5e8 BIT_MASK 0x40 /end MEASUREMENT
/begin MEASUREMENT ERR_SYM_DMTL_PUMP "" UBYTE _CNV_S_6_RANGE_ERR__22_CM 1 100. 0. 15. ECU_ADDRESS 0x3fd5e8 BIT_MASK 0xF /end MEASUREMENT
/begin MEASUREMENT LV_ERR_MEM_DMTL_PUMP "" UBYTE _CNV_S_2_RANGE______21_R_CM 1 100. 0. 255. ECU_ADDRESS 0x3fd5e8 BIT_MASK 0x80 /end MEASUREMENT
/begin MEASUREMENT CTR_ABC_END_DIAG_DMTL_PUMP "" UBYTE _CNV_A_R_LINEAR_____12_CM 1 100. 0. 255. ECU_ADDRESS 0x3fd5e9 FORMAT "%3.0" /end MEASUREMENT
/begin MEASUREMENT CTR_ABC_TPS_MON_1 "" UBYTE _CNV_A_R_LINEAR_____10_CM 1 100. 0. 255. ECU_ADDRESS 0x3fd552 FORMAT "%3.0" /end MEASUREMENT
/begin MEASUREMENT LV_CDN_DIAG_TPS_MON_1 "" UBYTE _CNV_S_2_RANGE______21_R_CM 1 100. 0. 255. ECU_ADDRESS 0x3fd550 BIT_MASK 0x10 /end MEASUREMENT
/begin MEASUREMENT LV_END_DIAG_TPS_MON_1 "" UBYTE _CNV_S_2_RANGE______21_R_CM 1 100. 0. 255. ECU_ADDRESS 0x3fd550 BIT_MASK 0x20 /end MEASUREMENT
/begin MEASUREMENT LV_READY_TPS_MON_1 "" UBYTE _CNV_S_2_RANGE______21_R_CM 1 100. 0. 255. ECU_ADDRESS 0x3fd550 BIT_MASK 0x40 /end MEASUREMENT
/begin MEASUREMENT ERR_SYM_TPS_MON_1 "" UBYTE _CNV_S_6_RANGE_ERR__22_CM 1 100. 0. 15. ECU_ADDRESS 0x3fd550 BIT_MASK 0xF /end MEASUREMENT
/begin MEASUREMENT LV_ERR_MEM_TPS_MON_1 "" UBYTE _CNV_S_2_RANGE______21_R_CM 1 100. 0. 255. ECU_ADDRESS 0x3fd550 BIT_MASK 0x80 /end MEASUREMENT
/begin MEASUREMENT CTR_ABC_END_DIAG_TPS_MON_1 "" UBYTE _CNV_A_R_LINEAR_____12_CM 1 100. 0. 255. ECU_ADDRESS 0x3fd551 FORMAT "%3.0" /end MEASUREMENT
/begin MEASUREMENT CTR_ABC_ECT_EL "" UBYTE _CNV_A_R_LINEAR_____10_CM 1 100. 0. 255. ECU_ADDRESS 0x3fd4fa FORMAT "%3.0" /end MEASUREMENT
/begin MEASUREMENT LV_CDN_DIAG_ECT_EL "" UBYTE _CNV_S_2_RANGE______21_R_CM 1 100. 0. 255. ECU_ADDRESS 0x3fd4f8 BIT_MASK 0x10 /end MEASUREMENT
/begin MEASUREMENT LV_END_DIAG_ECT_EL "" UBYTE _CNV_S_2_RANGE______21_R_CM 1 100. 0. 255. ECU_ADDRESS 0x3fd4f8 BIT_MASK 0x20 /end MEASUREMENT
/begin MEASUREMENT LV_READY_ECT_EL "" UBYTE _CNV_S_2_RANGE______21_R_CM 1 100. 0. 255. ECU_ADDRESS 0x3fd4f8 BIT_MASK 0x40 /end MEASUREMENT
/begin MEASUREMENT ERR_SYM_ECT_EL "" UBYTE _CNV_S_6_RANGE_ERR__22_CM 1 100. 0. 15. ECU_ADDRESS 0x3fd4f8 BIT_MASK 0xF /end MEASUREMENT
/begin MEASUREMENT LV_ERR_MEM_ECT_EL "" UBYTE _CNV_S_2_RANGE______21_R_CM 1 100. 0. 255. ECU_ADDRESS 0x3fd4f8 BIT_MASK 0x80 /end MEASUREMENT
/begin MEASUREMENT CTR_ABC_END_DIAG_ECT_EL "" UBYTE _CNV_A_R_LINEAR_____12_CM 1 100. 0. 255. ECU_ADDRESS 0x3fd4f9 FORMAT "%3.0" /end MEASUREMENT
/begin MEASUREMENT CTR_ABC_BN_TQ_AMT "" UBYTE _CNV_A_R_LINEAR_____10_CM 1 100. 0. 255. ECU_ADDRESS 0x3fd646 FORMAT "%3.0" /end MEASUREMENT
/begin MEASUREMENT LV_CDN_DIAG_BN_TQ_AMT "" UBYTE _CNV_S_2_RANGE______21_R_CM 1 100. 0. 255. ECU_ADDRESS 0x3fd644 BIT_MASK 0x10 /end MEASUREMENT
/begin MEASUREMENT LV_END_DIAG_BN_TQ_AMT "" UBYTE _CNV_S_2_RANGE______21_R_CM 1 100. 0. 255. ECU_ADDRESS 0x3fd644 BIT_MASK 0x20 /end MEASUREMENT
/begin MEASUREMENT LV_READY_BN_TQ_AMT "" UBYTE _CNV_S_2_RANGE______21_R_CM 1 100. 0. 255. ECU_ADDRESS 0x3fd644 BIT_MASK 0x40 /end MEASUREMENT
/begin MEASUREMENT ERR_SYM_BN_TQ_AMT "" UBYTE _CNV_S_6_RANGE_ERR__22_CM 1 100. 0. 15. ECU_ADDRESS 0x3fd644 BIT_MASK 0xF /end MEASUREMENT
/begin MEASUREMENT LV_ERR_MEM_BN_TQ_AMT "" UBYTE _CNV_S_2_RANGE______21_R_CM 1 100. 0. 255. ECU_ADDRESS 0x3fd644 BIT_MASK 0x80 /end MEASUREMENT
/begin MEASUREMENT CTR_ABC_END_DIAG_BN_TQ_AMT "" UBYTE _CNV_A_R_LINEAR_____12_CM 1 100. 0. 255. ECU_ADDRESS 0x3fd645 FORMAT "%3.0" /end MEASUREMENT
/begin MEASUREMENT CTR_ABC_EFP_LIH "" UBYTE _CNV_A_R_LINEAR_____10_CM 1 100. 0. 255. ECU_ADDRESS 0x3fd68a FORMAT "%3.0" /end MEASUREMENT
/begin MEASUREMENT LV_CDN_DIAG_EFP_LIH "" UBYTE _CNV_S_2_RANGE______21_R_CM 1 100. 0. 255. ECU_ADDRESS 0x3fd688 BIT_MASK 0x10 /end MEASUREMENT
/begin MEASUREMENT LV_END_DIAG_EFP_LIH "" UBYTE _CNV_S_2_RANGE______21_R_CM 1 100. 0. 255. ECU_ADDRESS 0x3fd688 BIT_MASK 0x20 /end MEASUREMENT
/begin MEASUREMENT LV_READY_EFP_LIH "" UBYTE _CNV_S_2_RANGE______21_R_CM 1 100. 0. 255. ECU_ADDRESS 0x3fd688 BIT_MASK 0x40 /end MEASUREMENT
/begin MEASUREMENT ERR_SYM_EFP_LIH "" UBYTE _CNV_S_6_RANGE_ERR__22_CM 1 100. 0. 15. ECU_ADDRESS 0x3fd688 BIT_MASK 0xF /end MEASUREMENT
/begin MEASUREMENT LV_ERR_MEM_EFP_LIH "" UBYTE _CNV_S_2_RANGE______21_R_CM 1 100. 0. 255. ECU_ADDRESS 0x3fd688 BIT_MASK 0x80 /end MEASUREMENT
/begin MEASUREMENT CTR_ABC_END_DIAG_EFP_LIH "" UBYTE _CNV_A_R_LINEAR_____12_CM 1 100. 0. 255. ECU_ADDRESS 0x3fd689 FORMAT "%3.0" /end MEASUREMENT
/begin MEASUREMENT CTR_ABC_BN_TCS "" UBYTE _CNV_A_R_LINEAR_____10_CM 1 100. 0. 255. ECU_ADDRESS 0x3fd63a FORMAT "%3.0" /end MEASUREMENT
/begin MEASUREMENT LV_CDN_DIAG_BN_TCS "" UBYTE _CNV_S_2_RANGE______21_R_CM 1 100. 0. 255. ECU_ADDRESS 0x3fd638 BIT_MASK 0x10 /end MEASUREMENT
/begin MEASUREMENT LV_END_DIAG_BN_TCS "" UBYTE _CNV_S_2_RANGE______21_R_CM 1 100. 0. 255. ECU_ADDRESS 0x3fd638 BIT_MASK 0x20 /end MEASUREMENT
/begin MEASUREMENT LV_READY_BN_TCS "" UBYTE _CNV_S_2_RANGE______21_R_CM 1 100. 0. 255. ECU_ADDRESS 0x3fd638 BIT_MASK 0x40 /end MEASUREMENT
/begin MEASUREMENT ERR_SYM_BN_TCS "" UBYTE _CNV_S_6_RANGE_ERR__22_CM 1 100. 0. 15. ECU_ADDRESS 0x3fd638 BIT_MASK 0xF /end MEASUREMENT
/begin MEASUREMENT LV_ERR_MEM_BN_TCS "" UBYTE _CNV_S_2_RANGE______21_R_CM 1 100. 0. 255. ECU_ADDRESS 0x3fd638 BIT_MASK 0x80 /end MEASUREMENT
/begin MEASUREMENT CTR_ABC_END_DIAG_BN_TCS "" UBYTE _CNV_A_R_LINEAR_____12_CM 1 100. 0. 255. ECU_ADDRESS 0x3fd639 FORMAT "%3.0" /end MEASUREMENT
/begin MEASUREMENT CTR_ABC_CRU_INH_MON_1 "" UBYTE _CNV_A_R_LINEAR_____10_CM 1 100. 0. 255. ECU_ADDRESS 0x3fd576 FORMAT "%3.0" /end MEASUREMENT
/begin MEASUREMENT LV_CDN_DIAG_CRU_INH_MON_1 "" UBYTE _CNV_S_2_RANGE______21_R_CM 1 100. 0. 255. ECU_ADDRESS 0x3fd574 BIT_MASK 0x10 /end MEASUREMENT
/begin MEASUREMENT LV_END_DIAG_CRU_INH_MON_1 "" UBYTE _CNV_S_2_RANGE______21_R_CM 1 100. 0. 255. ECU_ADDRESS 0x3fd574 BIT_MASK 0x20 /end MEASUREMENT
/begin MEASUREMENT LV_READY_CRU_INH_MON_1 "" UBYTE _CNV_S_2_RANGE______21_R_CM 1 100. 0. 255. ECU_ADDRESS 0x3fd574 BIT_MASK 0x40 /end MEASUREMENT
/begin MEASUREMENT ERR_SYM_CRU_INH_MON_1 "" UBYTE _CNV_S_6_RANGE_ERR__22_CM 1 100. 0. 15. ECU_ADDRESS 0x3fd574 BIT_MASK 0xF /end MEASUREMENT
/begin MEASUREMENT LV_ERR_MEM_CRU_INH_MON_1 "" UBYTE _CNV_S_2_RANGE______21_R_CM 1 100. 0. 255. ECU_ADDRESS 0x3fd574 BIT_MASK 0x80 /end MEASUREMENT
/begin MEASUREMENT CTR_ABC_END_DIAG_CRU_INH_MON_1 "" UBYTE _CNV_A_R_LINEAR_____12_CM 1 100. 0. 255. ECU_ADDRESS 0x3fd575 FORMAT "%3.0" /end MEASUREMENT
/begin MEASUREMENT CTR_ABC_VLS_UP_STK_1 "" UBYTE _CNV_A_R_LINEAR_____10_CM 1 100. 0. 255. ECU_ADDRESS 0x3fd6ce FORMAT "%3.0" /end MEASUREMENT
/begin MEASUREMENT LV_CDN_DIAG_VLS_UP_STK_1 "" UBYTE _CNV_S_2_RANGE______21_R_CM 1 100. 0. 255. ECU_ADDRESS 0x3fd6cc BIT_MASK 0x10 /end MEASUREMENT
/begin MEASUREMENT LV_END_DIAG_VLS_UP_STK_1 "" UBYTE _CNV_S_2_RANGE______21_R_CM 1 100. 0. 255. ECU_ADDRESS 0x3fd6cc BIT_MASK 0x20 /end MEASUREMENT
/begin MEASUREMENT LV_READY_VLS_UP_STK_1 "" UBYTE _CNV_S_2_RANGE______21_R_CM 1 100. 0. 255. ECU_ADDRESS 0x3fd6cc BIT_MASK 0x40 /end MEASUREMENT
/begin MEASUREMENT ERR_SYM_VLS_UP_STK_1 "" UBYTE _CNV_S_6_RANGE_ERR__22_CM 1 100. 0. 15. ECU_ADDRESS 0x3fd6cc BIT_MASK 0xF /end MEASUREMENT
/begin MEASUREMENT LV_ERR_MEM_VLS_UP_STK_1 "" UBYTE _CNV_S_2_RANGE______21_R_CM 1 100. 0. 255. ECU_ADDRESS 0x3fd6cc BIT_MASK 0x80 /end MEASUREMENT
/begin MEASUREMENT CTR_ABC_END_DIAG_VLS_UP_STK_1 "" UBYTE _CNV_A_R_LINEAR_____12_CM 1 100. 0. 255. ECU_ADDRESS 0x3fd6cd FORMAT "%3.0" /end MEASUREMENT
/begin MEASUREMENT CTR_ABC_VLS_UP_STK_2 "" UBYTE _CNV_A_R_LINEAR_____10_CM 1 100. 0. 255. ECU_ADDRESS 0x3fd6d2 FORMAT "%3.0" /end MEASUREMENT
/begin MEASUREMENT LV_CDN_DIAG_VLS_UP_STK_2 "" UBYTE _CNV_S_2_RANGE______21_R_CM 1 100. 0. 255. ECU_ADDRESS 0x3fd6d0 BIT_MASK 0x10 /end MEASUREMENT
/begin MEASUREMENT LV_END_DIAG_VLS_UP_STK_2 "" UBYTE _CNV_S_2_RANGE______21_R_CM 1 100. 0. 255. ECU_ADDRESS 0x3fd6d0 BIT_MASK 0x20 /end MEASUREMENT
/begin MEASUREMENT LV_READY_VLS_UP_STK_2 "" UBYTE _CNV_S_2_RANGE______21_R_CM 1 100. 0. 255. ECU_ADDRESS 0x3fd6d0 BIT_MASK 0x40 /end MEASUREMENT
/begin MEASUREMENT ERR_SYM_VLS_UP_STK_2 "" UBYTE _CNV_S_6_RANGE_ERR__22_CM 1 100. 0. 15. ECU_ADDRESS 0x3fd6d0 BIT_MASK 0xF /end MEASUREMENT
/begin MEASUREMENT LV_ERR_MEM_VLS_UP_STK_2 "" UBYTE _CNV_S_2_RANGE______21_R_CM 1 100. 0. 255. ECU_ADDRESS 0x3fd6d0 BIT_MASK 0x80 /end MEASUREMENT
/begin MEASUREMENT CTR_ABC_END_DIAG_VLS_UP_STK_2 "" UBYTE _CNV_A_R_LINEAR_____12_CM 1 100. 0. 255. ECU_ADDRESS 0x3fd6d1 FORMAT "%3.0" /end MEASUREMENT
/begin MEASUREMENT CTR_ABC_TCO_GRD "" UBYTE _CNV_A_R_LINEAR_____10_CM 1 100. 0. 255. ECU_ADDRESS 0x3fd4f6 FORMAT "%3.0" /end MEASUREMENT
/begin MEASUREMENT LV_CDN_DIAG_TCO_GRD "" UBYTE _CNV_S_2_RANGE______21_R_CM 1 100. 0. 255. ECU_ADDRESS 0x3fd4f4 BIT_MASK 0x10 /end MEASUREMENT
/begin MEASUREMENT LV_END_DIAG_TCO_GRD "" UBYTE _CNV_S_2_RANGE______21_R_CM 1 100. 0. 255. ECU_ADDRESS 0x3fd4f4 BIT_MASK 0x20 /end MEASUREMENT
/begin MEASUREMENT LV_READY_TCO_GRD "" UBYTE _CNV_S_2_RANGE______21_R_CM 1 100. 0. 255. ECU_ADDRESS 0x3fd4f4 BIT_MASK 0x40 /end MEASUREMENT
/begin MEASUREMENT ERR_SYM_TCO_GRD "" UBYTE _CNV_S_6_RANGE_ERR__22_CM 1 100. 0. 15. ECU_ADDRESS 0x3fd4f4 BIT_MASK 0xF /end MEASUREMENT
/begin MEASUREMENT LV_ERR_MEM_TCO_GRD "" UBYTE _CNV_S_2_RANGE______21_R_CM 1 100. 0. 255. ECU_ADDRESS 0x3fd4f4 BIT_MASK 0x80 /end MEASUREMENT
/begin MEASUREMENT CTR_ABC_END_DIAG_TCO_GRD "" UBYTE _CNV_A_R_LINEAR_____12_CM 1 100. 0. 255. ECU_ADDRESS 0x3fd4f5 FORMAT "%3.0" /end MEASUREMENT
/begin MEASUREMENT CTR_ABC_RLY_ACCOUT "" UBYTE _CNV_A_R_LINEAR_____10_CM 1 100. 0. 255. ECU_ADDRESS 0x3fd4de FORMAT "%3.0" /end MEASUREMENT
/begin MEASUREMENT LV_CDN_DIAG_RLY_ACCOUT "" UBYTE _CNV_S_2_RANGE______21_R_CM 1 100. 0. 255. ECU_ADDRESS 0x3fd4dc BIT_MASK 0x10 /end MEASUREMENT
/begin MEASUREMENT LV_END_DIAG_RLY_ACCOUT "" UBYTE _CNV_S_2_RANGE______21_R_CM 1 100. 0. 255. ECU_ADDRESS 0x3fd4dc BIT_MASK 0x20 /end MEASUREMENT
/begin MEASUREMENT LV_READY_RLY_ACCOUT "" UBYTE _CNV_S_2_RANGE______21_R_CM 1 100. 0. 255. ECU_ADDRESS 0x3fd4dc BIT_MASK 0x40 /end MEASUREMENT
/begin MEASUREMENT ERR_SYM_RLY_ACCOUT "" UBYTE _CNV_S_6_RANGE_ERR__22_CM 1 100. 0. 15. ECU_ADDRESS 0x3fd4dc BIT_MASK 0xF /end MEASUREMENT
/begin MEASUREMENT LV_ERR_MEM_RLY_ACCOUT "" UBYTE _CNV_S_2_RANGE______21_R_CM 1 100. 0. 255. ECU_ADDRESS 0x3fd4dc BIT_MASK 0x80 /end MEASUREMENT
/begin MEASUREMENT CTR_ABC_END_DIAG_RLY_ACCOUT "" UBYTE _CNV_A_R_LINEAR_____12_CM 1 100. 0. 255. ECU_ADDRESS 0x3fd4dd FORMAT "%3.0" /end MEASUREMENT
/begin MEASUREMENT CTR_ABC_LOCAN_BOFF "" UBYTE _CNV_A_R_LINEAR_____10_CM 1 100. 0. 255. ECU_ADDRESS 0x3fd68e FORMAT "%3.0" /end MEASUREMENT
/begin MEASUREMENT LV_CDN_DIAG_LOCAN_BOFF "" UBYTE _CNV_S_2_RANGE______21_R_CM 1 100. 0. 255. ECU_ADDRESS 0x3fd68c BIT_MASK 0x10 /end MEASUREMENT
/begin MEASUREMENT LV_END_DIAG_LOCAN_BOFF "" UBYTE _CNV_S_2_RANGE______21_R_CM 1 100. 0. 255. ECU_ADDRESS 0x3fd68c BIT_MASK 0x20 /end MEASUREMENT
/begin MEASUREMENT LV_READY_LOCAN_BOFF "" UBYTE _CNV_S_2_RANGE______21_R_CM 1 100. 0. 255. ECU_ADDRESS 0x3fd68c BIT_MASK 0x40 /end MEASUREMENT
/begin MEASUREMENT ERR_SYM_LOCAN_BOFF "" UBYTE _CNV_S_6_RANGE_ERR__22_CM 1 100. 0. 15. ECU_ADDRESS 0x3fd68c BIT_MASK 0xF /end MEASUREMENT
/begin MEASUREMENT LV_ERR_MEM_LOCAN_BOFF "" UBYTE _CNV_S_2_RANGE______21_R_CM 1 100. 0. 255. ECU_ADDRESS 0x3fd68c BIT_MASK 0x80 /end MEASUREMENT
/begin MEASUREMENT CTR_ABC_END_DIAG_LOCAN_BOFF "" UBYTE _CNV_A_R_LINEAR_____12_CM 1 100. 0. 255. ECU_ADDRESS 0x3fd68d FORMAT "%3.0" /end MEASUREMENT
/begin MEASUREMENT CTR_ABC_TQI_N_MAX_MON_1 "" UBYTE _CNV_A_R_LINEAR_____10_CM 1 100. 0. 255. ECU_ADDRESS 0x3fd56e FORMAT "%3.0" /end MEASUREMENT
/begin MEASUREMENT LV_CDN_DIAG_TQI_N_MAX_MON_1 "" UBYTE _CNV_S_2_RANGE______21_R_CM 1 100. 0. 255. ECU_ADDRESS 0x3fd56c BIT_MASK 0x10 /end MEASUREMENT
/begin MEASUREMENT LV_END_DIAG_TQI_N_MAX_MON_1 "" UBYTE _CNV_S_2_RANGE______21_R_CM 1 100. 0. 255. ECU_ADDRESS 0x3fd56c BIT_MASK 0x20 /end MEASUREMENT
/begin MEASUREMENT LV_READY_TQI_N_MAX_MON_1 "" UBYTE _CNV_S_2_RANGE______21_R_CM 1 100. 0. 255. ECU_ADDRESS 0x3fd56c BIT_MASK 0x40 /end MEASUREMENT
/begin MEASUREMENT ERR_SYM_TQI_N_MAX_MON_1 "" UBYTE _CNV_S_6_RANGE_ERR__22_CM 1 100. 0. 15. ECU_ADDRESS 0x3fd56c BIT_MASK 0xF /end MEASUREMENT
/begin MEASUREMENT LV_ERR_MEM_TQI_N_MAX_MON_1 "" UBYTE _CNV_S_2_RANGE______21_R_CM 1 100. 0. 255. ECU_ADDRESS 0x3fd56c BIT_MASK 0x80 /end MEASUREMENT
/begin MEASUREMENT CTR_ABC_END_DIAG_TQI_N_MAX_MON_1 "" UBYTE _CNV_A_R_LINEAR_____12_CM 1 100. 0. 255. ECU_ADDRESS 0x3fd56d FORMAT "%3.0" /end MEASUREMENT
/begin MEASUREMENT CTR_ABC_BN_VEH_MOD "" UBYTE _CNV_A_R_LINEAR_____10_CM 1 100. 0. 255. ECU_ADDRESS 0x3fd652 FORMAT "%3.0" /end MEASUREMENT
/begin MEASUREMENT LV_CDN_DIAG_BN_VEH_MOD "" UBYTE _CNV_S_2_RANGE______21_R_CM 1 100. 0. 255. ECU_ADDRESS 0x3fd650 BIT_MASK 0x10 /end MEASUREMENT
/begin MEASUREMENT LV_END_DIAG_BN_VEH_MOD "" UBYTE _CNV_S_2_RANGE______21_R_CM 1 100. 0. 255. ECU_ADDRESS 0x3fd650 BIT_MASK 0x20 /end MEASUREMENT
/begin MEASUREMENT LV_READY_BN_VEH_MOD "" UBYTE _CNV_S_2_RANGE______21_R_CM 1 100. 0. 255. ECU_ADDRESS 0x3fd650 BIT_MASK 0x40 /end MEASUREMENT
/begin MEASUREMENT ERR_SYM_BN_VEH_MOD "" UBYTE _CNV_S_6_RANGE_ERR__22_CM 1 100. 0. 15. ECU_ADDRESS 0x3fd650 BIT_MASK 0xF /end MEASUREMENT
/begin MEASUREMENT LV_ERR_MEM_BN_VEH_MOD "" UBYTE _CNV_S_2_RANGE______21_R_CM 1 100. 0. 255. ECU_ADDRESS 0x3fd650 BIT_MASK 0x80 /end MEASUREMENT
/begin MEASUREMENT CTR_ABC_END_DIAG_BN_VEH_MOD "" UBYTE _CNV_A_R_LINEAR_____12_CM 1 100. 0. 255. ECU_ADDRESS 0x3fd651 FORMAT "%3.0" /end MEASUREMENT
/begin MEASUREMENT CTR_ABC_QOIL_SENS "" UBYTE _CNV_A_R_LINEAR_____10_CM 1 100. 0. 255. ECU_ADDRESS 0x3fd69a FORMAT "%3.0" /end MEASUREMENT
/begin MEASUREMENT LV_CDN_DIAG_QOIL_SENS "" UBYTE _CNV_S_2_RANGE______21_R_CM 1 100. 0. 255. ECU_ADDRESS 0x3fd698 BIT_MASK 0x10 /end MEASUREMENT
/begin MEASUREMENT LV_END_DIAG_QOIL_SENS "" UBYTE _CNV_S_2_RANGE______21_R_CM 1 100. 0. 255. ECU_ADDRESS 0x3fd698 BIT_MASK 0x20 /end MEASUREMENT
/begin MEASUREMENT LV_READY_QOIL_SENS "" UBYTE _CNV_S_2_RANGE______21_R_CM 1 100. 0. 255. ECU_ADDRESS 0x3fd698 BIT_MASK 0x40 /end MEASUREMENT
/begin MEASUREMENT ERR_SYM_QOIL_SENS "" UBYTE _CNV_S_6_RANGE_ERR__22_CM 1 100. 0. 15. ECU_ADDRESS 0x3fd698 BIT_MASK 0xF /end MEASUREMENT
/begin MEASUREMENT LV_ERR_MEM_QOIL_SENS "" UBYTE _CNV_S_2_RANGE______21_R_CM 1 100. 0. 255. ECU_ADDRESS 0x3fd698 BIT_MASK 0x80 /end MEASUREMENT
/begin MEASUREMENT CTR_ABC_END_DIAG_QOIL_SENS "" UBYTE _CNV_A_R_LINEAR_____12_CM 1 100. 0. 255. ECU_ADDRESS 0x3fd699 FORMAT "%3.0" /end MEASUREMENT
/begin MEASUREMENT CTR_ABC_EF "" UBYTE _CNV_A_R_LINEAR_____10_CM 1 100. 0. 255. ECU_ADDRESS 0x3fd5be FORMAT "%3.0" /end MEASUREMENT
/begin MEASUREMENT LV_CDN_DIAG_EF "" UBYTE _CNV_S_2_RANGE______21_R_CM 1 100. 0. 255. ECU_ADDRESS 0x3fd5bc BIT_MASK 0x10 /end MEASUREMENT
/begin MEASUREMENT LV_END_DIAG_EF "" UBYTE _CNV_S_2_RANGE______21_R_CM 1 100. 0. 255. ECU_ADDRESS 0x3fd5bc BIT_MASK 0x20 /end MEASUREMENT
/begin MEASUREMENT LV_READY_EF "" UBYTE _CNV_S_2_RANGE______21_R_CM 1 100. 0. 255. ECU_ADDRESS 0x3fd5bc BIT_MASK 0x40 /end MEASUREMENT
/begin MEASUREMENT ERR_SYM_EF "" UBYTE _CNV_S_6_RANGE_ERR__22_CM 1 100. 0. 15. ECU_ADDRESS 0x3fd5bc BIT_MASK 0xF /end MEASUREMENT
/begin MEASUREMENT LV_ERR_MEM_EF "" UBYTE _CNV_S_2_RANGE______21_R_CM 1 100. 0. 255. ECU_ADDRESS 0x3fd5bc BIT_MASK 0x80 /end MEASUREMENT
/begin MEASUREMENT CTR_ABC_END_DIAG_EF "" UBYTE _CNV_A_R_LINEAR_____12_CM 1 100. 0. 255. ECU_ADDRESS 0x3fd5bd FORMAT "%3.0" /end MEASUREMENT
/begin MEASUREMENT CTR_ABC_TOIL_LEVEL "" UBYTE _CNV_A_R_LINEAR_____10_CM 1 100. 0. 255. ECU_ADDRESS 0x3fd3f2 FORMAT "%3.0" /end MEASUREMENT
/begin MEASUREMENT LV_CDN_DIAG_TOIL_LEVEL "" UBYTE _CNV_S_2_RANGE______21_R_CM 1 100. 0. 255. ECU_ADDRESS 0x3fd3f0 BIT_MASK 0x10 /end MEASUREMENT
/begin MEASUREMENT LV_END_DIAG_TOIL_LEVEL "" UBYTE _CNV_S_2_RANGE______21_R_CM 1 100. 0. 255. ECU_ADDRESS 0x3fd3f0 BIT_MASK 0x20 /end MEASUREMENT
/begin MEASUREMENT LV_READY_TOIL_LEVEL "" UBYTE _CNV_S_2_RANGE______21_R_CM 1 100. 0. 255. ECU_ADDRESS 0x3fd3f0 BIT_MASK 0x40 /end MEASUREMENT
/begin MEASUREMENT ERR_SYM_TOIL_LEVEL "" UBYTE _CNV_S_6_RANGE_ERR__22_CM 1 100. 0. 15. ECU_ADDRESS 0x3fd3f0 BIT_MASK 0xF /end MEASUREMENT
/begin MEASUREMENT LV_ERR_MEM_TOIL_LEVEL "" UBYTE _CNV_S_2_RANGE______21_R_CM 1 100. 0. 255. ECU_ADDRESS 0x3fd3f0 BIT_MASK 0x80 /end MEASUREMENT
/begin MEASUREMENT CTR_ABC_END_DIAG_TOIL_LEVEL "" UBYTE _CNV_A_R_LINEAR_____12_CM 1 100. 0. 255. ECU_ADDRESS 0x3fd3f1 FORMAT "%3.0" /end MEASUREMENT
/begin MEASUREMENT CTR_ABC_AMP "" UBYTE _CNV_A_R_LINEAR_____10_CM 1 100. 0. 255. ECU_ADDRESS 0x3fd35e FORMAT "%3.0" /end MEASUREMENT
/begin MEASUREMENT LV_CDN_DIAG_AMP "" UBYTE _CNV_S_2_RANGE______21_R_CM 1 100. 0. 255. ECU_ADDRESS 0x3fd35c BIT_MASK 0x10 /end MEASUREMENT
/begin MEASUREMENT LV_END_DIAG_AMP "" UBYTE _CNV_S_2_RANGE______21_R_CM 1 100. 0. 255. ECU_ADDRESS 0x3fd35c BIT_MASK 0x20 /end MEASUREMENT
/begin MEASUREMENT LV_READY_AMP "" UBYTE _CNV_S_2_RANGE______21_R_CM 1 100. 0. 255. ECU_ADDRESS 0x3fd35c BIT_MASK 0x40 /end MEASUREMENT
/begin MEASUREMENT ERR_SYM_AMP "" UBYTE _CNV_S_6_RANGE_ERR__22_CM 1 100. 0. 15. ECU_ADDRESS 0x3fd35c BIT_MASK 0xF /end MEASUREMENT
/begin MEASUREMENT LV_ERR_MEM_AMP "" UBYTE _CNV_S_2_RANGE______21_R_CM 1 100. 0. 255. ECU_ADDRESS 0x3fd35c BIT_MASK 0x80 /end MEASUREMENT
/begin MEASUREMENT CTR_ABC_END_DIAG_AMP "" UBYTE _CNV_A_R_LINEAR_____12_CM 1 100. 0. 255. ECU_ADDRESS 0x3fd35d FORMAT "%3.0" /end MEASUREMENT
/begin MEASUREMENT CTR_ABC_RLY_MAIN_DLY "" UBYTE _CNV_A_R_LINEAR_____10_CM 1 100. 0. 255. ECU_ADDRESS 0x3fd4da FORMAT "%3.0" /end MEASUREMENT
/begin MEASUREMENT LV_CDN_DIAG_RLY_MAIN_DLY "" UBYTE _CNV_S_2_RANGE______21_R_CM 1 100. 0. 255. ECU_ADDRESS 0x3fd4d8 BIT_MASK 0x10 /end MEASUREMENT
/begin MEASUREMENT LV_END_DIAG_RLY_MAIN_DLY "" UBYTE _CNV_S_2_RANGE______21_R_CM 1 100. 0. 255. ECU_ADDRESS 0x3fd4d8 BIT_MASK 0x20 /end MEASUREMENT
/begin MEASUREMENT LV_READY_RLY_MAIN_DLY "" UBYTE _CNV_S_2_RANGE______21_R_CM 1 100. 0. 255. ECU_ADDRESS 0x3fd4d8 BIT_MASK 0x40 /end MEASUREMENT
/begin MEASUREMENT ERR_SYM_RLY_MAIN_DLY "" UBYTE _CNV_S_6_RANGE_ERR__22_CM 1 100. 0. 15. ECU_ADDRESS 0x3fd4d8 BIT_MASK 0xF /end MEASUREMENT
/begin MEASUREMENT LV_ERR_MEM_RLY_MAIN_DLY "" UBYTE _CNV_S_2_RANGE______21_R_CM 1 100. 0. 255. ECU_ADDRESS 0x3fd4d8 BIT_MASK 0x80 /end MEASUREMENT
/begin MEASUREMENT CTR_ABC_END_DIAG_RLY_MAIN_DLY "" UBYTE _CNV_A_R_LINEAR_____12_CM 1 100. 0. 255. ECU_ADDRESS 0x3fd4d9 FORMAT "%3.0" /end MEASUREMENT
/begin CHARACTERISTIC C_ABC_MAX_TD_IGC_CUT "Maximum value of anti-bounce counter for the ignition system diagnosis to switch off the coil" VALUE 0x4278f _REC_VAL_20_u1 254. _CNV_A_R_LINEAR_____10_CM 1. 255. FORMAT "%3.0" /end CHARACTERISTIC
/begin CHARACTERISTIC C_ABC_INC_V_DUR_IGC "Debounce counter increment" VALUE 0x42728 _REC_VAL_20_u1 255. _CNV_A_R_LINEAR_____10_CM 0. 255. FORMAT "%3.0" /end CHARACTERISTIC
/begin CHARACTERISTIC C_ABC_MAX_V_DUR_IGC "Debounce counter maximum" VALUE 0x427aa _REC_VAL_20_u1 254. _CNV_A_R_LINEAR_____10_CM 1. 255. FORMAT "%3.0" /end CHARACTERISTIC
/begin CHARACTERISTIC C_ABC_INC_TD_IGC_CUT "Anti-bounce counter increment for the ignition system diagnosis 1/720°CRK" VALUE 0x42709 _REC_VAL_20_u1 255. _CNV_A_R_LINEAR_____10_CM 0. 255. FORMAT "%3.0" /end CHARACTERISTIC
/begin CHARACTERISTIC C_ABC_MAX_ISC "Maximum value of the anti - bounce counter for idle speed plausibility check" VALUE 0x4276d _REC_VAL_20_u1 254. _CNV_A_R_LINEAR_____10_CM 1. 255. FORMAT "%3.0" /end CHARACTERISTIC
/begin CHARACTERISTIC C_ABC_INC_ISC "Anti - bounce counter increment for idle speed plausibility check" VALUE 0x426e8 _REC_VAL_20_u1 255. _CNV_A_R_LINEAR_____10_CM 0. 255. FORMAT "%3.0" /end CHARACTERISTIC
/begin CHARACTERISTIC C_ABC_DEC_ISC "Anti - bounce counter increment for idle speed plausibility check" VALUE 0x426b0 _REC_VAL_20_u1 255. _CNV_A_R_LINEAR_____10_CM 0. 255. FORMAT "%3.0" /end CHARACTERISTIC
/begin MEASUREMENT CTR_ABC_ISC "" UBYTE _CNV_A_R_LINEAR_____10_CM 1 100. 0. 255. ECU_ADDRESS 0x3fd506 FORMAT "%3.0" /end MEASUREMENT
/begin MEASUREMENT LV_CDN_DIAG_ISC "" UBYTE _CNV_S_2_RANGE______21_R_CM 1 100. 0. 255. ECU_ADDRESS 0x3fd504 BIT_MASK 0x10 /end MEASUREMENT
/begin MEASUREMENT LV_END_DIAG_ISC "" UBYTE _CNV_S_2_RANGE______21_R_CM 1 100. 0. 255. ECU_ADDRESS 0x3fd504 BIT_MASK 0x20 /end MEASUREMENT
/begin MEASUREMENT LV_READY_ISC "" UBYTE _CNV_S_2_RANGE______21_R_CM 1 100. 0. 255. ECU_ADDRESS 0x3fd504 BIT_MASK 0x40 /end MEASUREMENT
/begin MEASUREMENT ERR_SYM_ISC "" UBYTE _CNV_S_6_RANGE_ERR__22_CM 1 100. 0. 15. ECU_ADDRESS 0x3fd504 BIT_MASK 0xF /end MEASUREMENT
/begin MEASUREMENT LV_ERR_MEM_ISC "" UBYTE _CNV_S_2_RANGE______21_R_CM 1 100. 0. 255. ECU_ADDRESS 0x3fd504 BIT_MASK 0x80 /end MEASUREMENT
/begin MEASUREMENT CTR_ABC_END_DIAG_ISC "" UBYTE _CNV_A_R_LINEAR_____12_CM 1 100. 0. 255. ECU_ADDRESS 0x3fd505 FORMAT "%3.0" /end MEASUREMENT
/begin CHARACTERISTIC C_ABC_INC_ISA_MEC "debounce counter increment - diagnosis of mechanical fault ISA" VALUE 0x426e7 _REC_VAL_20_u1 255. _CNV_A_R_LINEAR_____10_CM 0. 255. FORMAT "%3.0" /end CHARACTERISTIC
/begin CHARACTERISTIC C_ABC_MAX_ISA_MEC "debounce counter maximum value - diagnosis of mechanical fault ISA" VALUE 0x4276c _REC_VAL_20_u1 254. _CNV_A_R_LINEAR_____10_CM 1. 255. FORMAT "%3.0" /end CHARACTERISTIC
/begin CHARACTERISTIC C_ABC_MAX_REF_IVVT "Debounce counter maximum value - VANOS diagnosis magnetic valves" VALUE 0x42782 _REC_VAL_20_u1 254. _CNV_A_R_LINEAR_____10_CM 1. 255. FORMAT "%3.0" /end CHARACTERISTIC
/begin CHARACTERISTIC C_ABC_INC_REF_IVVT "Debounce counter increment - VANOS diagnosis magnetic valve CAM_IN" VALUE 0x426fc _REC_VAL_20_u1 255. _CNV_A_R_LINEAR_____10_CM 0. 255. FORMAT "%3.0" /end CHARACTERISTIC
/begin CHARACTERISTIC C_ABC_INC_SLV_IVVT "Debounce counter increment - VANOS diagnosis magnetic valve CAM_IN" VALUE 0x42703 _REC_VAL_20_u1 255. _CNV_A_R_LINEAR_____10_CM 0. 255. FORMAT "%3.0" /end CHARACTERISTIC
/begin CHARACTERISTIC C_ABC_MAX_SLV_IVVT "Debounce counter maximum value - VANOS diagnosis magnetic valves" VALUE 0x42789 _REC_VAL_20_u1 254. _CNV_A_R_LINEAR_____10_CM 1. 255. FORMAT "%3.0" /end CHARACTERISTIC
/begin CHARACTERISTIC C_ABC_INC_KNKS_DIAG "Debounce counter increment - knock sensor diagnosis" VALUE 0x426ea _REC_VAL_20_u1 255. _CNV_A_R_LINEAR_____10_CM 0. 255. FORMAT "%3.0" /end CHARACTERISTIC
/begin CHARACTERISTIC C_ABC_MAX_KNKS_DIAG "Debounce counter maximum value - knock sensor diagnosis" VALUE 0x4276f _REC_VAL_20_u1 254. _CNV_A_R_LINEAR_____10_CM 1. 255. FORMAT "%3.0" /end CHARACTERISTIC
/begin CHARACTERISTIC C_ABC_MAX_VLS_DOWN_MAX "Debounce counter maximum for short to plus electrical check" VALUE 0x427af _REC_VAL_20_u1 254. _CNV_A_R_LINEAR_____10_CM 1. 255. FORMAT "%3.0" /end CHARACTERISTIC
/begin CHARACTERISTIC C_ABC_MAX_VLS_DOWN_OC "Debounce counter maximum for open line electrical check" VALUE 0x427b2 _REC_VAL_20_u1 254. _CNV_A_R_LINEAR_____10_CM 1. 255. FORMAT "%3.0" /end CHARACTERISTIC
/begin CHARACTERISTIC C_ABC_INC_VLS_DOWN_MAX "Debounce counter increment for short to plus electrical check" VALUE 0x4272d _REC_VAL_20_u1 255. _CNV_A_R_LINEAR_____10_CM 0. 255. FORMAT "%3.0" /end CHARACTERISTIC
/begin CHARACTERISTIC C_ABC_INC_VLS_DOWN_OC "Debounce counter increment for open line electrical check" VALUE 0x42730 _REC_VAL_20_u1 255. _CNV_A_R_LINEAR_____10_CM 0. 255. FORMAT "%3.0" /end CHARACTERISTIC
/begin CHARACTERISTIC C_ABC_INC_VLS_DOWN_MIN "Debounce counter increment for short to ground electrical check" VALUE 0x4272e _REC_VAL_20_u1 255. _CNV_A_R_LINEAR_____10_CM 0. 255. FORMAT "%3.0" /end CHARACTERISTIC
/begin CHARACTERISTIC C_ABC_INC_VLS_DOWN_MIN_COLD "Debounce counter increment for short to ground electrical check" VALUE 0x4272f _REC_VAL_20_u1 255. _CNV_A_R_LINEAR_____10_CM 0. 255. FORMAT "%3.0" /end CHARACTERISTIC
/begin CHARACTERISTIC C_ABC_MAX_VLS_DOWN_MIN "Debounce counter maximum for short to ground electrical check" VALUE 0x427b0 _REC_VAL_20_u1 254. _CNV_A_R_LINEAR_____10_CM 1. 255. FORMAT "%3.0" /end CHARACTERISTIC
/begin CHARACTERISTIC C_ABC_MAX_VLS_DOWN_MIN_COLD "Debounce counter maximum for short to ground electrical check" VALUE 0x427b1 _REC_VAL_20_u1 254. _CNV_A_R_LINEAR_____10_CM 1. 255. FORMAT "%3.0" /end CHARACTERISTIC
/begin CHARACTERISTIC C_ABC_MAX_VLS_UP_MAX "Debounce counter maximum for electrical check short to plus" VALUE 0x427b4 _REC_VAL_20_u1 254. _CNV_A_R_LINEAR_____10_CM 1. 255. FORMAT "%3.0" /end CHARACTERISTIC
/begin CHARACTERISTIC C_ABC_MAX_VLS_UP_PUC "Debounce counter maximum for PUC plausibility" VALUE 0x427b8 _REC_VAL_20_u1 254. _CNV_A_R_LINEAR_____10_CM 1. 255. FORMAT "%3.0" /end CHARACTERISTIC
/begin CHARACTERISTIC C_ABC_MAX_VLS_UP_OC "Debounce counter maximum for electrical check open line" VALUE 0x427b7 _REC_VAL_20_u1 254. _CNV_A_R_LINEAR_____10_CM 1. 255. FORMAT "%3.0" /end CHARACTERISTIC
/begin CHARACTERISTIC C_ABC_INC_VLS_UP_OC "Debounce counter increment for electrical check open line" VALUE 0x42735 _REC_VAL_20_u1 255. _CNV_A_R_LINEAR_____10_CM 0. 255. FORMAT "%3.0" /end CHARACTERISTIC
/begin CHARACTERISTIC C_ABC_INC_VLS_UP_MAX "Debounce counter increment for electrical check short to plus" VALUE 0x42732 _REC_VAL_20_u1 255. _CNV_A_R_LINEAR_____10_CM 0. 255. FORMAT "%3.0" /end CHARACTERISTIC
/begin CHARACTERISTIC C_ABC_INC_VLS_UP_PUC "Debounce counter increment for PUC plausibility" VALUE 0x42736 _REC_VAL_20_u1 255. _CNV_A_R_LINEAR_____10_CM 0. 255. FORMAT "%3.0" /end CHARACTERISTIC
/begin MEASUREMENT CTR_ABC_CHG_LS_DOWN "" UBYTE _CNV_A_R_LINEAR_____10_CM 1 100. 0. 255. ECU_ADDRESS 0x3fd696 FORMAT "%3.0" /end MEASUREMENT
/begin MEASUREMENT LV_CDN_DIAG_CHG_LS_DOWN "" UBYTE _CNV_S_2_RANGE______21_R_CM 1 100. 0. 255. ECU_ADDRESS 0x3fd694 BIT_MASK 0x10 /end MEASUREMENT
/begin MEASUREMENT LV_END_DIAG_CHG_LS_DOWN "" UBYTE _CNV_S_2_RANGE______21_R_CM 1 100. 0. 255. ECU_ADDRESS 0x3fd694 BIT_MASK 0x20 /end MEASUREMENT
/begin MEASUREMENT LV_READY_CHG_LS_DOWN "" UBYTE _CNV_S_2_RANGE______21_R_CM 1 100. 0. 255. ECU_ADDRESS 0x3fd694 BIT_MASK 0x40 /end MEASUREMENT
/begin MEASUREMENT ERR_SYM_CHG_LS_DOWN "" UBYTE _CNV_S_6_RANGE_ERR__22_CM 1 100. 0. 15. ECU_ADDRESS 0x3fd694 BIT_MASK 0xF /end MEASUREMENT
/begin MEASUREMENT LV_ERR_MEM_CHG_LS_DOWN "" UBYTE _CNV_S_2_RANGE______21_R_CM 1 100. 0. 255. ECU_ADDRESS 0x3fd694 BIT_MASK 0x80 /end MEASUREMENT
/begin MEASUREMENT CTR_ABC_END_DIAG_CHG_LS_DOWN "" UBYTE _CNV_A_R_LINEAR_____12_CM 1 100. 0. 255. ECU_ADDRESS 0x3fd695 FORMAT "%3.0" /end MEASUREMENT
/begin MEASUREMENT CTR_ABC_CHG_LS_UP "" UBYTE _CNV_A_R_LINEAR_____10_CM 1 100. 0. 255. ECU_ADDRESS 0x3fd692 FORMAT "%3.0" /end MEASUREMENT
/begin MEASUREMENT LV_CDN_DIAG_CHG_LS_UP "" UBYTE _CNV_S_2_RANGE______21_R_CM 1 100. 0. 255. ECU_ADDRESS 0x3fd690 BIT_MASK 0x10 /end MEASUREMENT
/begin MEASUREMENT LV_END_DIAG_CHG_LS_UP "" UBYTE _CNV_S_2_RANGE______21_R_CM 1 100. 0. 255. ECU_ADDRESS 0x3fd690 BIT_MASK 0x20 /end MEASUREMENT
/begin MEASUREMENT LV_READY_CHG_LS_UP "" UBYTE _CNV_S_2_RANGE______21_R_CM 1 100. 0. 255. ECU_ADDRESS 0x3fd690 BIT_MASK 0x40 /end MEASUREMENT
/begin MEASUREMENT ERR_SYM_CHG_LS_UP "" UBYTE _CNV_S_6_RANGE_ERR__22_CM 1 100. 0. 15. ECU_ADDRESS 0x3fd690 BIT_MASK 0xF /end MEASUREMENT
/begin MEASUREMENT LV_ERR_MEM_CHG_LS_UP "" UBYTE _CNV_S_2_RANGE______21_R_CM 1 100. 0. 255. ECU_ADDRESS 0x3fd690 BIT_MASK 0x80 /end MEASUREMENT
/begin MEASUREMENT CTR_ABC_END_DIAG_CHG_LS_UP "" UBYTE _CNV_A_R_LINEAR_____12_CM 1 100. 0. 255. ECU_ADDRESS 0x3fd691 FORMAT "%3.0" /end MEASUREMENT
/begin MEASUREMENT CTR_ABC_LAM_DLY_1 "" UBYTE _CNV_A_R_LINEAR_____10_CM 1 100. 0. 255. ECU_ADDRESS 0x3fd6d6 FORMAT "%3.0" /end MEASUREMENT
/begin MEASUREMENT LV_CDN_DIAG_LAM_DLY_1 "" UBYTE _CNV_S_2_RANGE______21_R_CM 1 100. 0. 255. ECU_ADDRESS 0x3fd6d4 BIT_MASK 0x10 /end MEASUREMENT
/begin MEASUREMENT LV_END_DIAG_LAM_DLY_1 "" UBYTE _CNV_S_2_RANGE______21_R_CM 1 100. 0. 255. ECU_ADDRESS 0x3fd6d4 BIT_MASK 0x20 /end MEASUREMENT
/begin MEASUREMENT LV_READY_LAM_DLY_1 "" UBYTE _CNV_S_2_RANGE______21_R_CM 1 100. 0. 255. ECU_ADDRESS 0x3fd6d4 BIT_MASK 0x40 /end MEASUREMENT
/begin MEASUREMENT ERR_SYM_LAM_DLY_1 "" UBYTE _CNV_S_6_RANGE_ERR__22_CM 1 100. 0. 15. ECU_ADDRESS 0x3fd6d4 BIT_MASK 0xF /end MEASUREMENT
/begin MEASUREMENT LV_ERR_MEM_LAM_DLY_1 "" UBYTE _CNV_S_2_RANGE______21_R_CM 1 100. 0. 255. ECU_ADDRESS 0x3fd6d4 BIT_MASK 0x80 /end MEASUREMENT
/begin MEASUREMENT CTR_ABC_END_DIAG_LAM_DLY_1 "" UBYTE _CNV_A_R_LINEAR_____12_CM 1 100. 0. 255. ECU_ADDRESS 0x3fd6d5 FORMAT "%3.0" /end MEASUREMENT
/begin MEASUREMENT CTR_ABC_LAM_DLY_2 "" UBYTE _CNV_A_R_LINEAR_____10_CM 1 100. 0. 255. ECU_ADDRESS 0x3fd6da FORMAT "%3.0" /end MEASUREMENT
/begin MEASUREMENT LV_CDN_DIAG_LAM_DLY_2 "" UBYTE _CNV_S_2_RANGE______21_R_CM 1 100. 0. 255. ECU_ADDRESS 0x3fd6d8 BIT_MASK 0x10 /end MEASUREMENT
/begin MEASUREMENT LV_END_DIAG_LAM_DLY_2 "" UBYTE _CNV_S_2_RANGE______21_R_CM 1 100. 0. 255. ECU_ADDRESS 0x3fd6d8 BIT_MASK 0x20 /end MEASUREMENT
/begin MEASUREMENT LV_READY_LAM_DLY_2 "" UBYTE _CNV_S_2_RANGE______21_R_CM 1 100. 0. 255. ECU_ADDRESS 0x3fd6d8 BIT_MASK 0x40 /end MEASUREMENT
/begin MEASUREMENT ERR_SYM_LAM_DLY_2 "" UBYTE _CNV_S_6_RANGE_ERR__22_CM 1 100. 0. 15. ECU_ADDRESS 0x3fd6d8 BIT_MASK 0xF /end MEASUREMENT
/begin MEASUREMENT LV_ERR_MEM_LAM_DLY_2 "" UBYTE _CNV_S_2_RANGE______21_R_CM 1 100. 0. 255. ECU_ADDRESS 0x3fd6d8 BIT_MASK 0x80 /end MEASUREMENT
/begin MEASUREMENT CTR_ABC_END_DIAG_LAM_DLY_2 "" UBYTE _CNV_A_R_LINEAR_____12_CM 1 100. 0. 255. ECU_ADDRESS 0x3fd6d9 FORMAT "%3.0" /end MEASUREMENT
/begin COMPU_METHOD _CNV_A_R_LINEAR_____10_CM "" RAT_FUNC "%6.3" "-" COEFFS 0 1. 0. 0 0 1 /end COMPU_METHOD
/begin COMPU_METHOD _CNV_A_R_LINEAR_____12_CM "" RAT_FUNC "%6.3" "[-]" COEFFS 0 1. 0. 0 0 1 /end COMPU_METHOD
/begin COMPU_METHOD _CNV_S_2_RANGE______21_R_CM "" TAB_VERB "%6.3" "[-]" COMPU_TAB_REF _CNV_S_2_RANGE______21_R /end COMPU_METHOD
/begin COMPU_VTAB_RANGE _CNV_S_2_RANGE______21_R "" 2 0 0 "0" 1 255 "1" /end COMPU_VTAB_RANGE
/begin COMPU_METHOD _CNV_S_6_RANGE_ERR__22_CM "" TAB_VERB "%6.3" "[-]" COMPU_TAB_REF _CNV_S_6_RANGE_ERR__22 /end COMPU_METHOD
/begin COMPU_VTAB _CNV_S_6_RANGE_ERR__22 "" TAB_VERB 6 0 "NO_SYM" 1 "SYM_0" 2 "SYM_1" 4 "SYM_2" 8 "SYM_3" 15 "BENCH_MODE" /end COMPU_VTAB
/begin RECORD_LAYOUT _REC_VAL_20_u1 FNC_VALUES 1 UBYTE COLUMN_DIR DIRECT /end RECORD_LAYOUT
/begin FUNCTION DIA_Anti_bounce_algorithm "_Anti-bounce-algorithm"
 /begin DEF_CHARACTERISTIC C_ABC_INC_IMOB_2 C_ABC_INC_IMOB_1 C_ABC_MAX_IMOB_2 C_ABC_MAX_IMOB_1 C_ABC_INC_AMP C_ABC_MAX_AMP C_ABC_INC_IM_BTS_PLAUS C_ABC_INC_IM_BLS_PLAUS C_ABC_MAX_IM_BTS_PLAUS C_ABC_MAX_IM_BLS_PLAUS C_ABC_INC_BN_TQ_DCC C_ABC_INC_BN_TQ_TCS C_ABC_INC_BN_VS_TCS C_ABC_INC_BN_TCS C_ABC_INC_BN_TQ_ETCU C_ABC_INC_BN_CAS C_ABC_INC_BN_ETCU C_ABC_INC_BN_TQ_AMT C_ABC_INC_BN_ACC C_ABC_INC_BN_ICL C_ABC_INC_BN_KM_ICL C_ABC_INC_BN_VEH_MOD C_ABC_INC_BN_T_ICL C_ABC_INC_BN_POW_VB C_ABC_INC_BN_POW_GEN C_ABC_INC_BN_MSW C_ABC_INC_BN_ANG_PSTE C_ABC_MAX_BN_CAS C_ABC_MAX_BN_TQ_TCS C_ABC_MAX_BN_VS_TCS C_ABC_MAX_BN_TCS C_ABC_MAX_BN_TQ_ETCU C_ABC_MAX_BN_ETCU C_ABC_MAX_BN_TQ_AMT C_ABC_MAX_BN_ACC C_ABC_MAX_BN_T_ICL C_ABC_MAX_BN_KM_ICL C_ABC_MAX_BN_VEH_MOD C_ABC_MAX_BN_ICL C_ABC_MAX_BN_POW_VB C_ABC_MAX_BN_POW_GEN C_ABC_MAX_BN_MSW C_ABC_MAX_BN_TQ_DCC C_ABC_MAX_BN_ANG_PSTE C_CTR_DIAG_TCC_CAN_MAX_ARS C_CTR_DIAG_TCC_CAN_MAX_CAS C_CTR_DIAG_TCC_CAN_MAX_TQ_TCS C_CTR_DIAG_TCC_CAN_MAX_TQ_ETCU C_CTR_DIAG_TCC_CAN_MAX_TQ_AMT C_CTR_DIAG_TCC_CAN_MAX_VEH_MOD C_CTR_DIAG_TCC_CAN_MAX_ICL C_CTR_DIAG_TCC_CAN_MAX_MSW C_CTR_DIAG_TCC_CAN_MAX_TQ_DCC C_CTR_DIAG_CKS_MAX_CAS C_CTR_DIAG_CKS_MAX_TQ_TCS C_CTR_DIAG_CKS_MAX_TQ_ETCU C_CTR_DIAG_CKS_MAX_TQ_AMT C_CTR_DIAG_CKS_MAX_VEH_MOD C_CTR_DIAG_CKS_MAX_MSW C_CTR_DIAG_CKS_MAX_TQ_DCC C_CTR_DIAG_TOUT_MAX_ARS C_CTR_DIAG_TOUT_MAX_CAS C_CTR_DIAG_TOUT_MAX_TQ_TCS C_CTR_DIAG_TOUT_MAX_VS_TCS C_CTR_DIAG_TOUT_MAX_TCS C_CTR_DIAG_TOUT_MAX_TQ_ETCU C_CTR_DIAG_TOUT_MAX_TQ_DCC C_CTR_DIAG_TOUT_MAX_TQ_AMT C_CTR_DIAG_TOUT_MAX_ACC C_CTR_DIAG_TOUT_MAX_T_ICL C_CTR_DIAG_TOUT_MAX_VEH_MOD C_CTR_DIAG_TOUT_MAX_KM_ICL C_CTR_DIAG_TOUT_MAX_ICL C_CTR_DIAG_TOUT_MAX_POW_VB C_CTR_DIAG_TOUT_MAX_POW_GEN C_CTR_DIAG_TOUT_MAX_MSW C_CTR_DIAG_TOUT_MAX_ETCU C_CTR_DIAG_TOUT_MAX_ANG_PSTE C_ABC_MAX_BN_ARS C_ABC_INC_BN_ARS C_ABC_DEC_BN_TQ_DCC C_ABC_DEC_BN_ARS C_ABC_DEC_BN_CAS C_ABC_DEC_BN_TQ_TCS C_ABC_DEC_BN_VS_TCS C_ABC_DEC_BN_TCS C_ABC_DEC_BN_TQ_ETCU C_ABC_DEC_BN_ETCU C_ABC_DEC_BN_TQ_AMT C_ABC_DEC_BN_ACC C_ABC_DEC_BN_ICL C_ABC_DEC_BN_KM_ICL C_ABC_DEC_BN_T_ICL C_ABC_DEC_BN_POW_VB C_ABC_DEC_BN_POW_GEN C_ABC_DEC_BN_MSW C_ABC_DEC_BN_ANG_PSTE C_ABC_DEC_BN_VEH_MOD C_ABC_INC_BSD C_ABC_MAX_BSD C_ABC_INC_CAM_PER_0 C_ABC_INC_CAM_PER_1 C_ABC_MAX_CAM_PER_1 C_ABC_MAX_CAM_PER_0 C_ABC_INC_CAM_PSN_1 C_ABC_MAX_CAM_PSN_0 C_ABC_MAX_CAM_PSN_1 C_ABC_INC_CAM_PSN_0 C_ABC_INC_TOUT_ASR_3 C_ABC_MAX_TOUT_ASR_3 C_ABC_INC_CAN_BOFF C_ABC_MAX_CAN_BOFF C_ABC_INC_TOUT_ASR_1 C_ABC_MAX_TOUT_ASR_1 C_ABC_INC_TOUT_EFP C_ABC_MAX_TOUT_EFP C_ABC_INC_LOCAN_BOFF C_ABC_MAX_LOCAN_BOFF C_ABC_INC_TOUT_ETCU_1 C_ABC_INC_TOUT_ETCU_2 C_ABC_MAX_TOUT_ETCU_1 C_ABC_MAX_TOUT_ETCU_2 C_ABC_INC_TOUT_ICL_2_ C_ABC_MAX_TOUT_ICL_2 C_ABC_INC_TOUT_ICL_3_ C_ABC_MAX_TOUT_ICL_3 C_ABC_INC_TOUT_PSTE_1 C_ABC_MAX_TOUT_PSTE_1 C_ABC_INC_TOUT_AMT_1 C_ABC_MAX_TOUT_AMT_1 C_ABC_INC_TOUT_TXU_1 C_ABC_MAX_TOUT_TXU_1 C_ABC_INC_ENG_PSN_PREV_SYN C_ABC_INC_ENG_PSN_DUR_ST C_ABC_MAX_ENG_PSN C_ABC_INC_ENG_PSN_AST C_ABC_INC_TOOTH_PER_PREV_SYN C_ABC_INC_TOOTH_PER_AST C_ABC_MAX_TOOTH_PER C_ABC_INC_TOOTH_PER_DUR_ST C_ABC_INC_TPU_SYN_PREV_SYN C_ABC_INC_TPU_SYN_DUR_ST C_ABC_MAX_TPU_SYN C_ABC_INC_TPU_SYN_AST C_ABC_INC_CRK_NOT_PLAUS C_ABC_MAX_CRK_NOT_PLAUS C_ABC_INC_DCC_REV C_ABC_MAX_DCC_IRREV C_ABC_INC_DCC_IRREV C_ABC_MAX_DCC_REV C_ABC_INC_DMTL_PUMP C_ABC_INC_ECT_MEC C_ABC_MAX_ECT_MEC LC_ABC_BENCH C_ABC_MAX_TD_IGC_CUT C_ABC_INC_V_DUR_IGC C_ABC_MAX_V_DUR_IGC C_ABC_INC_TD_IGC_CUT C_ABC_MAX_ISC C_ABC_INC_ISC C_ABC_DEC_ISC C_ABC_INC_ISA_MEC C_ABC_MAX_ISA_MEC C_ABC_MAX_REF_IVVT C_ABC_INC_REF_IVVT C_ABC_INC_SLV_IVVT C_ABC_MAX_SLV_IVVT C_ABC_INC_KNKS_DIAG C_ABC_MAX_KNKS_DIAG C_ABC_MAX_VLS_DOWN_MAX C_ABC_MAX_VLS_DOWN_OC C_ABC_INC_VLS_DOWN_MAX C_ABC_INC_VLS_DOWN_OC C_ABC_INC_VLS_DOWN_MIN C_ABC_INC_VLS_DOWN_MIN_COLD C_ABC_MAX_VLS_DOWN_MIN C_ABC_MAX_VLS_DOWN_MIN_COLD C_ABC_MAX_VLS_UP_MAX C_ABC_MAX_VLS_UP_PUC C_ABC_MAX_VLS_UP_OC C_ABC_INC_VLS_UP_OC C_ABC_INC_VLS_UP_MAX C_ABC_INC_VLS_UP_PUC /end DEF_CHARACTERISTIC
 /begin OUT_MEASUREMENT LV_ERR_MEM_TPS_1 CTR_ABC_END_DIAG_TPS_1 CTR_ABC_TPS_2 ERR_INFO_STAT LV_CDN_DIAG_TPS_2 LV_END_DIAG_TPS_2 LV_READY_TPS_2 ERR_SYM_TPS_2 LV_ERR_MEM_TPS_2 CTR_ABC_END_DIAG_TPS_2 CTR_ABC_VLS_UP_PUC_1 ERR_INFO_STAT LV_CDN_DIAG_VLS_UP_PUC_1 LV_END_DIAG_VLS_UP_PUC_1 LV_READY_VLS_UP_PUC_1 ERR_SYM_VLS_UP_PUC_1 LV_ERR_MEM_VLS_UP_PUC_1 CTR_ABC_END_DIAG_VLS_UP_PUC_1 CTR_ABC_VLS_UP_PUC_2 ERR_INFO_STAT LV_CDN_DIAG_VLS_UP_PUC_2 LV_END_DIAG_VLS_UP_PUC_2 LV_READY_VLS_UP_PUC_2 ERR_SYM_VLS_UP_PUC_2 LV_ERR_MEM_VLS_UP_PUC_2 CTR_ABC_END_DIAG_VLS_UP_PUC_2 CTR_ABC_ECU_RAM ERR_INFO_STAT LV_CDN_DIAG_ECU_RAM LV_END_DIAG_ECU_RAM LV_READY_ECU_RAM ERR_SYM_ECU_RAM LV_ERR_MEM_ECU_RAM CTR_ABC_END_DIAG_ECU_RAM CTR_ABC_TIA ERR_INFO_STAT LV_CDN_DIAG_TIA LV_END_DIAG_TIA LV_READY_TIA ERR_SYM_TIA LV_ERR_MEM_TIA CTR_ABC_END_DIAG_TIA CTR_ABC_TPU_SYN ERR_INFO_STAT LV_CDN_DIAG_TPU_SYN LV_END_DIAG_TPU_SYN LV_READY_TPU_SYN ERR_SYM_TPU_SYN LV_ERR_MEM_TPU_SYN CTR_ABC_END_DIAG_TPU_SYN CTR_ABC_BN_TQ_TCS ERR_INFO_STAT LV_CDN_DIAG_BN_TQ_TCS LV_END_DIAG_BN_TQ_TCS LV_READY_BN_TQ_TCS ERR_SYM_BN_TQ_TCS LV_ERR_MEM_BN_TQ_TCS CTR_ABC_END_DIAG_BN_TQ_TCS CTR_ABC_N_EFP_LOW ERR_INFO_STAT LV_CDN_DIAG_N_EFP_LOW LV_END_DIAG_N_EFP_LOW LV_READY_N_EFP_LOW ERR_SYM_N_EFP_LOW LV_ERR_MEM_N_EFP_LOW CTR_ABC_END_DIAG_N_EFP_LOW CTR_ABC_OBD2_LSH_DOWN_1 ERR_INFO_STAT LV_CDN_DIAG_OBD2_LSH_DOWN_1 LV_END_DIAG_OBD2_LSH_DOWN_1 LV_READY_OBD2_LSH_DOWN_1 ERR_SYM_OBD2_LSH_DOWN_1 LV_ERR_MEM_OBD2_LSH_DOWN_1 CTR_ABC_END_DIAG_OBD2_LSH_DOWN_1 CTR_ABC_OBD2_LSH_DOWN_2 ERR_INFO_STAT LV_CDN_DIAG_OBD2_LSH_DOWN_2 LV_END_DIAG_OBD2_LSH_DOWN_2 LV_READY_OBD2_LSH_DOWN_2 ERR_SYM_OBD2_LSH_DOWN_2 LV_ERR_MEM_OBD2_LSH_DOWN_2 CTR_ABC_END_DIAG_OBD2_LSH_DOWN_2 CTR_ABC_TOUT_ICL_2 ERR_INFO_STAT LV_CDN_DIAG_TOUT_ICL_2 LV_END_DIAG_TOUT_ICL_2 LV_READY_TOUT_ICL_2 ERR_SYM_TOUT_ICL_2 LV_ERR_MEM_TOUT_ICL_2 CTR_ABC_END_DIAG_TOUT_ICL_2 CTR_ABC_TOUT_ICL_3 ERR_INFO_STAT LV_CDN_DIAG_TOUT_ICL_3 LV_END_DIAG_TOUT_ICL_3 LV_READY_TOUT_ICL_3 ERR_SYM_TOUT_ICL_3 LV_ERR_MEM_TOUT_ICL_3 CTR_ABC_END_DIAG_TOUT_ICL_3 CTR_ABC_TPS_MAF_1 ERR_INFO_STAT LV_CDN_DIAG_TPS_MAF_1 LV_END_DIAG_TPS_MAF_1 LV_READY_TPS_MAF_1 ERR_SYM_TPS_MAF_1 LV_ERR_MEM_TPS_MAF_1 CTR_ABC_END_DIAG_TPS_MAF_1 CTR_ABC_TPS_MAF_2 ERR_INFO_STAT LV_CDN_DIAG_TPS_MAF_2 LV_END_DIAG_TPS_MAF_2 LV_READY_TPS_MAF_2 ERR_SYM_TPS_MAF_2 LV_ERR_MEM_TPS_MAF_2 CTR_ABC_END_DIAG_TPS_MAF_2 CTR_ABC_MTC_CTL_1 ERR_INFO_STAT LV_CDN_DIAG_MTC_CTL_1 LV_END_DIAG_MTC_CTL_1 LV_READY_MTC_CTL_1 ERR_SYM_MTC_CTL_1 LV_ERR_MEM_MTC_CTL_1 CTR_ABC_END_DIAG_MTC_CTL_1 CTR_ABC_GEN_IF ERR_INFO_STAT LV_CDN_DIAG_GEN_IF LV_END_DIAG_GEN_IF LV_READY_GEN_IF ERR_SYM_GEN_IF LV_ERR_MEM_GEN_IF CTR_ABC_END_DIAG_GEN_IF CTR_ABC_MTC_CTL_2 ERR_INFO_STAT LV_CDN_DIAG_MTC_CTL_2 LV_END_DIAG_MTC_CTL_2 LV_READY_MTC_CTL_2 ERR_SYM_MTC_CTL_2 LV_ERR_MEM_MTC_CTL_2 CTR_ABC_END_DIAG_MTC_CTL_2 CTR_ABC_MTC_CTL_3 ERR_INFO_STAT LV_CDN_DIAG_MTC_CTL_3 LV_END_DIAG_MTC_CTL_3 LV_READY_MTC_CTL_3 ERR_SYM_MTC_CTL_3 LV_ERR_MEM_MTC_CTL_3 CTR_ABC_END_DIAG_MTC_CTL_3 CTR_ABC_MAF ERR_INFO_STAT LV_CDN_DIAG_MAF LV_END_DIAG_MAF LV_READY_MAF ERR_SYM_MAF LV_ERR_MEM_MAF CTR_ABC_END_DIAG_MAF CTR_ABC_RLY_EFP ERR_INFO_STAT LV_CDN_DIAG_RLY_EFP LV_END_DIAG_RLY_EFP LV_READY_RLY_EFP ERR_SYM_RLY_EFP LV_ERR_MEM_RLY_EFP CTR_ABC_END_DIAG_RLY_EFP CTR_ABC_TECU ERR_INFO_STAT LV_CDN_DIAG_TECU LV_END_DIAG_TECU LV_READY_TECU ERR_SYM_TECU LV_ERR_MEM_TECU CTR_ABC_END_DIAG_TECU CTR_ABC_REF_IVVT_IN_1 ERR_INFO_STAT LV_CDN_DIAG_REF_IVVT_IN_1 LV_END_DIAG_REF_IVVT_IN_1 LV_READY_REF_IVVT_IN_1 ERR_SYM_REF_IVVT_IN_1 LV_ERR_MEM_REF_IVVT_IN_1 CTR_ABC_END_DIAG_REF_IVVT_IN_1 CTR_ABC_REF_IVVT_IN_2 ERR_INFO_STAT LV_CDN_DIAG_REF_IVVT_IN_2 LV_END_DIAG_REF_IVVT_IN_2 LV_READY_REF_IVVT_IN_2 ERR_SYM_REF_IVVT_IN_2 LV_ERR_MEM_REF_IVVT_IN_2 CTR_ABC_END_DIAG_REF_IVVT_IN_2 CTR_ABC_TCO_STUCK ERR_INFO_STAT LV_CDN_DIAG_TCO_STUCK LV_END_DIAG_TCO_STUCK LV_READY_TCO_STUCK ERR_SYM_TCO_STUCK LV_ERR_MEM_TCO_STUCK CTR_ABC_END_DIAG_TCO_STUCK CTR_ABC_SOF ERR_INFO_STAT LV_CDN_DIAG_SOF LV_END_DIAG_SOF LV_READY_SOF ERR_SYM_SOF LV_ERR_MEM_SOF CTR_ABC_END_DIAG_SOF CTR_ABC_LOAD_PLAUS ERR_INFO_STAT LV_CDN_DIAG_LOAD_PLAUS LV_END_DIAG_LOAD_PLAUS LV_READY_LOAD_PLAUS ERR_SYM_LOAD_PLAUS LV_ERR_MEM_LOAD_PLAUS CTR_ABC_END_DIAG_LOAD_PLAUS CTR_ABC_N_32_MON_1 ERR_INFO_STAT LV_CDN_DIAG_N_32_MON_1 LV_END_DIAG_N_32_MON_1 LV_READY_N_32_MON_1 ERR_SYM_N_32_MON_1 LV_ERR_MEM_N_32_MON_1 CTR_ABC_END_DIAG_N_32_MON_1 CTR_ABC_CAM_0_NOT_PLAUS ERR_INFO_STAT LV_CDN_DIAG_CAM_0_NOT_PLAUS LV_END_DIAG_CAM_0_NOT_PLAUS LV_READY_CAM_0_NOT_PLAUS ERR_SYM_CAM_0_NOT_PLAUS LV_ERR_MEM_CAM_0_NOT_PLAUS CTR_ABC_END_DIAG_CAM_0_NOT_PLAUS CTR_ABC_PVS_RATIO ERR_INFO_STAT LV_CDN_DIAG_PVS_RATIO LV_END_DIAG_PVS_RATIO LV_READY_PVS_RATIO ERR_SYM_PVS_RATIO LV_ERR_MEM_PVS_RATIO CTR_ABC_END_DIAG_PVS_RATIO CTR_ABC_LSH_DOWN_1 ERR_INFO_STAT LV_CDN_DIAG_LSH_DOWN_1 LV_END_DIAG_LSH_DOWN_1 LV_READY_LSH_DOWN_1 ERR_SYM_LSH_DOWN_1 LV_ERR_MEM_LSH_DOWN_1 CTR_ABC_END_DIAG_LSH_DOWN_1 CTR_ABC_TOUT_ASR_1 ERR_INFO_STAT LV_CDN_DIAG_TOUT_ASR_1 LV_END_DIAG_TOUT_ASR_1 LV_READY_TOUT_ASR_1 ERR_SYM_TOUT_ASR_1 LV_ERR_MEM_TOUT_ASR_1 CTR_ABC_END_DIAG_TOUT_ASR_1 CTR_ABC_LSH_DOWN_2 ERR_INFO_STAT LV_CDN_DIAG_LSH_DOWN_2 LV_END_DIAG_LSH_DOWN_2 LV_READY_LSH_DOWN_2 ERR_SYM_LSH_DOWN_2 LV_ERR_MEM_LSH_DOWN_2 CTR_ABC_END_DIAG_LSH_DOWN_2 CTR_ABC_TOUT_ASR_3 ERR_INFO_STAT LV_CDN_DIAG_TOUT_ASR_3 LV_END_DIAG_TOUT_ASR_3 LV_READY_TOUT_ASR_3 ERR_SYM_TOUT_ASR_3 LV_ERR_MEM_TOUT_ASR_3 CTR_ABC_END_DIAG_TOUT_ASR_3 CTR_ABC_LSH_UP_1 ERR_INFO_STAT LV_CDN_DIAG_LSH_UP_1 LV_END_DIAG_LSH_UP_1 LV_READY_LSH_UP_1 ERR_SYM_LSH_UP_1 LV_ERR_MEM_LSH_UP_1 CTR_ABC_END_DIAG_LSH_UP_1 CTR_ABC_LSH_UP_2 ERR_INFO_STAT LV_CDN_DIAG_LSH_UP_2 LV_END_DIAG_LSH_UP_2 LV_READY_LSH_UP_2 ERR_SYM_LSH_UP_2 LV_ERR_MEM_LSH_UP_2 CTR_ABC_END_DIAG_LSH_UP_2 CTR_ABC_ENG_PSN ERR_INFO_STAT LV_CDN_DIAG_ENG_PSN LV_END_DIAG_ENG_PSN LV_READY_ENG_PSN ERR_SYM_ENG_PSN LV_ERR_MEM_ENG_PSN CTR_ABC_END_DIAG_ENG_PSN CTR_ABC_TOUT_AMT_1 ERR_INFO_STAT LV_CDN_DIAG_TOUT_AMT_1 LV_END_DIAG_TOUT_AMT_1 LV_READY_TOUT_AMT_1 ERR_SYM_TOUT_AMT_1 LV_ERR_MEM_TOUT_AMT_1 CTR_ABC_END_DIAG_TOUT_AMT_1 CTR_ABC_MSW_TOG ERR_INFO_STAT LV_CDN_DIAG_MSW_TOG LV_END_DIAG_MSW_TOG LV_READY_MSW_TOG ERR_SYM_MSW_TOG LV_ERR_MEM_MSW_TOG CTR_ABC_END_DIAG_MSW_TOG CTR_ABC_BN_ARS ERR_INFO_STAT LV_CDN_DIAG_BN_ARS LV_END_DIAG_BN_ARS LV_READY_BN_ARS ERR_SYM_BN_ARS LV_ERR_MEM_BN_ARS CTR_ABC_END_DIAG_BN_ARS CTR_ABC_VLS_DOWN_PUE_1 ERR_INFO_STAT LV_CDN_DIAG_VLS_DOWN_PUE_1 LV_END_DIAG_VLS_DOWN_PUE_1 LV_READY_VLS_DOWN_PUE_1 ERR_SYM_VLS_DOWN_PUE_1 LV_ERR_MEM_VLS_DOWN_PUE_1 CTR_ABC_END_DIAG_VLS_DOWN_PUE_1 CTR_ABC_VLS_DOWN_PUE_2 ERR_INFO_STAT LV_CDN_DIAG_VLS_DOWN_PUE_2 LV_END_DIAG_VLS_DOWN_PUE_2 LV_READY_VLS_DOWN_PUE_2 ERR_SYM_VLS_DOWN_PUE_2 LV_ERR_MEM_VLS_DOWN_PUE_2 CTR_ABC_END_DIAG_VLS_DOWN_PUE_2 CTR_ABC_LS_UP_SWT_1 ERR_INFO_STAT LV_CDN_DIAG_LS_UP_SWT_1 LV_END_DIAG_LS_UP_SWT_1 LV_READY_LS_UP_SWT_1 ERR_SYM_LS_UP_SWT_1 LV_ERR_MEM_LS_UP_SWT_1 CTR_ABC_END_DIAG_LS_UP_SWT_1 CTR_ABC_LS_UP_SWT_2 ERR_INFO_STAT LV_CDN_DIAG_LS_UP_SWT_2 LV_END_DIAG_LS_UP_SWT_2 LV_READY_LS_UP_SWT_2 ERR_SYM_LS_UP_SWT_2 LV_ERR_MEM_LS_UP_SWT_2 CTR_ABC_END_DIAG_LS_UP_SWT_2 CTR_ABC_TOUT_PSTE_1 ERR_INFO_STAT LV_CDN_DIAG_TOUT_PSTE_1 LV_END_DIAG_TOUT_PSTE_1 LV_READY_TOUT_PSTE_1 ERR_SYM_TOUT_PSTE_1 LV_ERR_MEM_TOUT_PSTE_1 CTR_ABC_END_DIAG_TOUT_PSTE_1 CTR_ABC_VIM ERR_INFO_STAT LV_CDN_DIAG_VIM LV_END_DIAG_VIM LV_READY_VIM ERR_SYM_VIM LV_ERR_MEM_VIM CTR_ABC_END_DIAG_VIM CTR_ABC_TQ_GS_INC_PLAUS ERR_INFO_STAT LV_CDN_DIAG_TQ_GS_INC_PLAUS LV_END_DIAG_TQ_GS_INC_PLAUS LV_READY_TQ_GS_INC_PLAUS ERR_SYM_TQ_GS_INC_PLAUS LV_ERR_MEM_TQ_GS_INC_PLAUS CTR_ABC_END_DIAG_TQ_GS_INC_PLAUS CTR_ABC_DCC_IRREV ERR_INFO_STAT LV_CDN_DIAG_DCC_IRREV LV_END_DIAG_DCC_IRREV LV_READY_DCC_IRREV ERR_SYM_DCC_IRREV LV_ERR_MEM_DCC_IRREV CTR_ABC_END_DIAG_DCC_IRREV CTR_ABC_DUR_IGC_0 ERR_INFO_STAT LV_CDN_DIAG_DUR_IGC_0 LV_END_DIAG_DUR_IGC_0 LV_READY_DUR_IGC_0 ERR_SYM_DUR_IGC_0 LV_ERR_MEM_DUR_IGC_0 CTR_ABC_END_DIAG_DUR_IGC_0 CTR_ABC_DUR_IGC_1 ERR_INFO_STAT LV_CDN_DIAG_DUR_IGC_1 LV_END_DIAG_DUR_IGC_1 LV_READY_DUR_IGC_1 ERR_SYM_DUR_IGC_1 LV_ERR_MEM_DUR_IGC_1 CTR_ABC_END_DIAG_DUR_IGC_1 CTR_ABC_DUR_IGC_2 ERR_INFO_STAT LV_CDN_DIAG_DUR_IGC_2 LV_END_DIAG_DUR_IGC_2 LV_READY_DUR_IGC_2 ERR_SYM_DUR_IGC_2 LV_ERR_MEM_DUR_IGC_2 CTR_ABC_END_DIAG_DUR_IGC_2 CTR_ABC_DUR_IGC_3 ERR_INFO_STAT LV_CDN_DIAG_DUR_IGC_3 LV_END_DIAG_DUR_IGC_3 LV_READY_DUR_IGC_3 ERR_SYM_DUR_IGC_3 LV_ERR_MEM_DUR_IGC_3 CTR_ABC_END_DIAG_DUR_IGC_3 CTR_ABC_DUR_IGC_4 ERR_INFO_STAT LV_CDN_DIAG_DUR_IGC_4 LV_END_DIAG_DUR_IGC_4 LV_READY_DUR_IGC_4 ERR_SYM_DUR_IGC_4 LV_ERR_MEM_DUR_IGC_4 CTR_ABC_END_DIAG_DUR_IGC_4 CTR_ABC_DUR_IGC_5 ERR_INFO_STAT LV_CDN_DIAG_DUR_IGC_5 LV_END_DIAG_DUR_IGC_5 LV_READY_DUR_IGC_5 ERR_SYM_DUR_IGC_5 LV_ERR_MEM_DUR_IGC_5 CTR_ABC_END_DIAG_DUR_IGC_5 CTR_ABC_VLS_UP_MAX_1 ERR_INFO_STAT LV_CDN_DIAG_VLS_UP_MAX_1 LV_END_DIAG_VLS_UP_MAX_1 LV_READY_VLS_UP_MAX_1 ERR_SYM_VLS_UP_MAX_1 LV_ERR_MEM_VLS_UP_MAX_1 CTR_ABC_END_DIAG_VLS_UP_MAX_1 CTR_ABC_VLS_UP_MAX_2 ERR_INFO_STAT LV_CDN_DIAG_VLS_UP_MAX_2 LV_END_DIAG_VLS_UP_MAX_2 LV_READY_VLS_UP_MAX_2 ERR_SYM_VLS_UP_MAX_2 LV_ERR_MEM_VLS_UP_MAX_2 CTR_ABC_END_DIAG_VLS_UP_MAX_2 CTR_ABC_TOIL ERR_INFO_STAT LV_CDN_DIAG_TOIL LV_END_DIAG_TOIL LV_READY_TOIL ERR_SYM_TOIL LV_ERR_MEM_TOIL CTR_ABC_END_DIAG_TOIL CTR_ABC_MEC_ISA ERR_INFO_STAT LV_CDN_DIAG_MEC_ISA LV_END_DIAG_MEC_ISA LV_READY_MEC_ISA ERR_SYM_MEC_ISA LV_ERR_MEM_MEC_ISA CTR_ABC_END_DIAG_MEC_ISA CTR_ABC_PVS_MON_1 ERR_INFO_STAT LV_CDN_DIAG_PVS_MON_1 LV_END_DIAG_PVS_MON_1 LV_READY_PVS_MON_1 ERR_SYM_PVS_MON_1 LV_ERR_MEM_PVS_MON_1 CTR_ABC_END_DIAG_PVS_MON_1 CTR_ABC_VLS_DOWN_MAX_1 ERR_INFO_STAT LV_CDN_DIAG_VLS_DOWN_MAX_1 LV_END_DIAG_VLS_DOWN_MAX_1 LV_READY_VLS_DOWN_MAX_1 ERR_SYM_VLS_DOWN_MAX_1 LV_ERR_MEM_VLS_DOWN_MAX_1 CTR_ABC_END_DIAG_VLS_DOWN_MAX_1 CTR_ABC_VLS_DOWN_MAX_2 ERR_INFO_STAT LV_CDN_DIAG_VLS_DOWN_MAX_2 LV_END_DIAG_VLS_DOWN_MAX_2 LV_READY_VLS_DOWN_MAX_2 ERR_SYM_VLS_DOWN_MAX_2 LV_ERR_MEM_VLS_DOWN_MAX_2 CTR_ABC_END_DIAG_VLS_DOWN_MAX_2 CTR_ABC_V_REF_1 ERR_INFO_STAT LV_CDN_DIAG_V_REF_1 LV_END_DIAG_V_REF_1 LV_READY_V_REF_1 ERR_SYM_V_REF_1 LV_ERR_MEM_V_REF_1 CTR_ABC_END_DIAG_V_REF_1 CTR_ABC_TCO_PLAUS ERR_INFO_STAT LV_CDN_DIAG_TCO_PLAUS LV_END_DIAG_TCO_PLAUS LV_READY_TCO_PLAUS ERR_SYM_TCO_PLAUS LV_ERR_MEM_TCO_PLAUS CTR_ABC_END_DIAG_TCO_PLAUS CTR_ABC_V_REF_2 ERR_INFO_STAT LV_CDN_DIAG_V_REF_2 LV_END_DIAG_V_REF_2 LV_READY_V_REF_2 ERR_SYM_V_REF_2 LV_ERR_MEM_V_REF_2 CTR_ABC_END_DIAG_V_REF_2 CTR_ABC_REF_IVVT_EX_1 ERR_INFO_STAT LV_CDN_DIAG_REF_IVVT_EX_1 LV_END_DIAG_REF_IVVT_EX_1 LV_READY_REF_IVVT_EX_1 ERR_SYM_REF_IVVT_EX_1 LV_ERR_MEM_REF_IVVT_EX_1 CTR_ABC_END_DIAG_REF_IVVT_EX_1 CTR_ABC_REF_IVVT_EX_2 ERR_INFO_STAT LV_CDN_DIAG_REF_IVVT_EX_2 LV_END_DIAG_REF_IVVT_EX_2 LV_READY_REF_IVVT_EX_2 ERR_SYM_REF_IVVT_EX_2 LV_ERR_MEM_REF_IVVT_EX_2 CTR_ABC_END_DIAG_REF_IVVT_EX_2 CTR_ABC_SA_SAP ERR_INFO_STAT LV_CDN_DIAG_SA_SAP LV_END_DIAG_SA_SAP LV_READY_SA_SAP ERR_SYM_SA_SAP LV_ERR_MEM_SA_SAP CTR_ABC_END_DIAG_SA_SAP CTR_ABC_RLY_MAIN ERR_INFO_STAT LV_CDN_DIAG_RLY_MAIN LV_END_DIAG_RLY_MAIN LV_READY_RLY_MAIN ERR_SYM_RLY_MAIN LV_ERR_MEM_RLY_MAIN CTR_ABC_END_DIAG_RLY_MAIN CTR_ABC_SA_SAV ERR_INFO_STAT LV_CDN_DIAG_SA_SAV LV_END_DIAG_SA_SAV LV_READY_SA_SAV ERR_SYM_SA_SAV LV_ERR_MEM_SA_SAV CTR_ABC_END_DIAG_SA_SAV CTR_ABC_CRASH_EFP ERR_INFO_STAT LV_CDN_DIAG_CRASH_EFP LV_END_DIAG_CRASH_EFP LV_READY_CRASH_EFP ERR_SYM_CRASH_EFP LV_ERR_MEM_CRASH_EFP CTR_ABC_END_DIAG_CRASH_EFP CTR_ABC_ECT_MEC ERR_INFO_STAT LV_CDN_DIAG_ECT_MEC LV_END_DIAG_ECT_MEC LV_READY_ECT_MEC ERR_SYM_ECT_MEC LV_ERR_MEM_ECT_MEC CTR_ABC_END_DIAG_ECT_MEC CTR_ABC_VLS_DOWN_MIN_COLD_1 ERR_INFO_STAT LV_CDN_DIAG_VLS_DOWN_MIN_COLD_1 LV_END_DIAG_VLS_DOWN_MIN_COLD_1 LV_READY_VLS_DOWN_MIN_COLD_1 ERR_SYM_VLS_DOWN_MIN_COLD_1 LV_ERR_MEM_VLS_DOWN_MIN_COLD_1 CTR_ABC_END_DIAG_VLS_DOWN_MIN_CO CTR_ABC_ISA_1 ERR_INFO_STAT LV_CDN_DIAG_ISA_1 LV_END_DIAG_ISA_1 LV_READY_ISA_1 ERR_SYM_ISA_1 LV_ERR_MEM_ISA_1 CTR_ABC_END_DIAG_ISA_1 CTR_ABC_VLS_DOWN_MIN_COLD_2 ERR_INFO_STAT LV_CDN_DIAG_VLS_DOWN_MIN_COLD_2 LV_END_DIAG_VLS_DOWN_MIN_COLD_2 LV_READY_VLS_DOWN_MIN_COLD_2 ERR_SYM_VLS_DOWN_MIN_COLD_2 LV_ERR_MEM_VLS_DOWN_MIN_COLD_2 CTR_ABC_END_DIAG_VLS_DOWN_MIN_CO CTR_ABC_ISA_2 ERR_INFO_STAT LV_CDN_DIAG_ISA_2 LV_END_DIAG_ISA_2 LV_READY_ISA_2 ERR_SYM_ISA_2 LV_ERR_MEM_ISA_2 CTR_ABC_END_DIAG_ISA_2 CTR_ABC_SOF_REQ ERR_INFO_STAT LV_CDN_DIAG_SOF_REQ LV_END_DIAG_SOF_REQ LV_READY_SOF_REQ ERR_SYM_SOF_REQ LV_ERR_MEM_SOF_REQ CTR_ABC_END_DIAG_SOF_REQ CTR_ABC_ECF ERR_INFO_STAT LV_CDN_DIAG_ECF LV_END_DIAG_ECF LV_READY_ECF ERR_SYM_ECF LV_ERR_MEM_ECF CTR_ABC_END_DIAG_ECF CTR_ABC_BN_MSW ERR_INFO_STAT LV_CDN_DIAG_BN_MSW LV_END_DIAG_BN_MSW LV_READY_BN_MSW ERR_SYM_BN_MSW LV_ERR_MEM_BN_MSW CTR_ABC_END_DIAG_BN_MSW CTR_ABC_BN_POW_GEN ERR_INFO_STAT LV_CDN_DIAG_BN_POW_GEN LV_END_DIAG_BN_POW_GEN LV_READY_BN_POW_GEN ERR_SYM_BN_POW_GEN LV_ERR_MEM_BN_POW_GEN CTR_ABC_END_DIAG_BN_POW_GEN CTR_ABC_BN_KM_ICL ERR_INFO_STAT LV_CDN_DIAG_BN_KM_ICL LV_END_DIAG_BN_KM_ICL LV_READY_BN_KM_ICL ERR_SYM_BN_KM_ICL LV_ERR_MEM_BN_KM_ICL CTR_ABC_END_DIAG_BN_KM_ICL CTR_ABC_TQI_N_MAX_NVMY_MON ERR_INFO_STAT LV_CDN_DIAG_TQI_N_MAX_NVMY_MON LV_END_DIAG_TQI_N_MAX_NVMY_MON LV_READY_TQI_N_MAX_NVMY_MON ERR_SYM_TQI_N_MAX_NVMY_MON LV_ERR_MEM_TQI_N_MAX_NVMY_MON CTR_ABC_END_DIAG_TQI_N_MAX_NVMY_ CTR_ABC_TPS_PLAUS ERR_INFO_STAT LV_CDN_DIAG_TPS_PLAUS LV_END_DIAG_TPS_PLAUS LV_READY_TPS_PLAUS ERR_SYM_TPS_PLAUS LV_ERR_MEM_TPS_PLAUS CTR_ABC_END_DIAG_TPS_PLAUS CTR_ABC_TOUT_TXU_1 ERR_INFO_STAT LV_CDN_DIAG_TOUT_TXU_1 LV_END_DIAG_TOUT_TXU_1 LV_READY_TOUT_TXU_1 ERR_SYM_TOUT_TXU_1 LV_ERR_MEM_TOUT_TXU_1 CTR_ABC_END_DIAG_TOUT_TXU_1 CTR_ABC_MTC_DR ERR_INFO_STAT LV_CDN_DIAG_MTC_DR LV_END_DIAG_MTC_DR LV_READY_MTC_DR ERR_SYM_MTC_DR LV_ERR_MEM_MTC_DR CTR_ABC_END_DIAG_MTC_DR CTR_ABC_TPS_AD ERR_INFO_STAT LV_CDN_DIAG_TPS_AD LV_END_DIAG_TPS_AD LV_READY_TPS_AD ERR_SYM_TPS_AD LV_ERR_MEM_TPS_AD CTR_ABC_END_DIAG_TPS_AD CTR_ABC_DIAGCPS ERR_INFO_STAT LV_CDN_DIAG_DIAGCPS LV_END_DIAG_DIAGCPS LV_READY_DIAGCPS ERR_SYM_DIAGCPS LV_ERR_DIAGCPS CTR_ABC_END_DIAG_DIAGCPS CTR_ABC_CAM_PER_0 ERR_INFO_STAT LV_CDN_DIAG_CAM_PER_0 LV_END_DIAG_CAM_PER_0 LV_READY_CAM_PER_0 ERR_SYM_CAM_PER_0 LV_ERR_MEM_CAM_PER_0 CTR_ABC_END_DIAG_CAM_PER_0 CTR_ABC_CAM_PER_1 ERR_INFO_STAT LV_CDN_DIAG_CAM_PER_1 LV_END_DIAG_CAM_PER_1 LV_READY_CAM_PER_1 ERR_SYM_CAM_PER_1 LV_ERR_MEM_CAM_PER_1 CTR_ABC_END_DIAG_CAM_PER_1 CTR_ABC_TQ_MAX_CLU_MON_1 ERR_INFO_STAT LV_CDN_DIAG_TQ_MAX_CLU_MON_1 LV_END_DIAG_TQ_MAX_CLU_MON_1 LV_READY_TQ_MAX_CLU_MON_1 ERR_SYM_TQ_MAX_CLU_MON_1 LV_ERR_MEM_TQ_MAX_CLU_MON_1 CTR_ABC_END_DIAG_TQ_MAX_CLU_MON_ CTR_ABC_LS_DOWN_SWT_1 ERR_INFO_STAT LV_CDN_DIAG_LS_DOWN_SWT_1 LV_END_DIAG_LS_DOWN_SWT_1 LV_READY_LS_DOWN_SWT_1 ERR_SYM_LS_DOWN_SWT_1 LV_ERR_MEM_LS_DOWN_SWT_1 CTR_ABC_END_DIAG_LS_DOWN_SWT_1 CTR_ABC_LS_DOWN_SWT_2 ERR_INFO_STAT LV_CDN_DIAG_LS_DOWN_SWT_2 LV_END_DIAG_LS_DOWN_SWT_2 LV_READY_LS_DOWN_SWT_2 ERR_SYM_LS_DOWN_SWT_2 LV_ERR_MEM_LS_DOWN_SWT_2 CTR_ABC_END_DIAG_LS_DOWN_SWT_2 CTR_ABC_IV_0 ERR_INFO_STAT LV_CDN_DIAG_IV_0 LV_END_DIAG_IV_0 LV_READY_IV_0 ERR_SYM_IV_0 LV_ERR_MEM_IV_0 CTR_ABC_END_DIAG_IV_0 CTR_ABC_IV_1 ERR_INFO_STAT LV_CDN_DIAG_IV_1 LV_END_DIAG_IV_1 LV_READY_IV_1 ERR_SYM_IV_1 LV_ERR_MEM_IV_1 CTR_ABC_END_DIAG_IV_1 CTR_ABC_IV_2 ERR_INFO_STAT LV_CDN_DIAG_IV_2 LV_END_DIAG_IV_2 LV_READY_IV_2 ERR_SYM_IV_2 LV_ERR_MEM_IV_2 CTR_ABC_END_DIAG_IV_2 CTR_ABC_IV_3 ERR_INFO_STAT LV_CDN_DIAG_IV_3 LV_END_DIAG_IV_3 LV_READY_IV_3 ERR_SYM_IV_3 LV_ERR_MEM_IV_3 CTR_ABC_END_DIAG_IV_3 CTR_ABC_IV_4 ERR_INFO_STAT LV_CDN_DIAG_IV_4 LV_END_DIAG_IV_4 LV_READY_IV_4 ERR_SYM_IV_4 LV_ERR_MEM_IV_4 CTR_ABC_END_DIAG_IV_4 CTR_ABC_IV_5 ERR_INFO_STAT LV_CDN_DIAG_IV_5 LV_END_DIAG_IV_5 LV_READY_IV_5 ERR_SYM_IV_5 LV_ERR_MEM_IV_5 CTR_ABC_END_DIAG_IV_5 CTR_ABC_TOUT_EFP ERR_INFO_STAT LV_CDN_DIAG_TOUT_EFP LV_END_DIAG_TOUT_EFP LV_READY_TOUT_EFP ERR_SYM_TOUT_EFP LV_ERR_MEM_TOUT_EFP CTR_ABC_END_DIAG_TOUT_EFP CTR_ABC_EFP_TEMP ERR_INFO_STAT LV_CDN_DIAG_EFP_TEMP LV_END_DIAG_EFP_TEMP LV_READY_EFP_TEMP ERR_SYM_EFP_TEMP LV_ERR_MEM_EFP_TEMP CTR_ABC_END_DIAG_EFP_TEMP CTR_ABC_BN_TQ_DCC ERR_INFO_STAT LV_CDN_DIAG_BN_TQ_DCC LV_END_DIAG_BN_TQ_DCC LV_READY_BN_TQ_DCC ERR_SYM_BN_TQ_DCC LV_ERR_MEM_BN_TQ_DCC CTR_ABC_END_DIAG_BN_TQ_DCC CTR_ABC_BN_ICL ERR_INFO_STAT LV_CDN_DIAG_BN_ICL LV_END_DIAG_BN_ICL LV_READY_BN_ICL ERR_SYM_BN_ICL LV_ERR_MEM_BN_ICL CTR_ABC_END_DIAG_BN_ICL CTR_ABC_TQI_LIM ERR_INFO_STAT LV_CDN_DIAG_TQI_LIM LV_END_DIAG_TQI_LIM LV_READY_TQI_LIM ERR_SYM_TQI_LIM LV_ERR_MEM_TQI_LIM CTR_ABC_END_DIAG_TQI_LIM CTR_ABC_DMTL_PUMP ERR_INFO_STAT LV_CDN_DIAG_DMTL_PUMP LV_END_DIAG_DMTL_PUMP LV_READY_DMTL_PUMP ERR_SYM_DMTL_PUMP LV_ERR_MEM_DMTL_PUMP CTR_ABC_END_DIAG_DMTL_PUMP CTR_ABC_TPS_MON_1 ERR_INFO_STAT LV_CDN_DIAG_TPS_MON_1 LV_END_DIAG_TPS_MON_1 LV_READY_TPS_MON_1 ERR_SYM_TPS_MON_1 LV_ERR_MEM_TPS_MON_1 CTR_ABC_END_DIAG_TPS_MON_1 CTR_ABC_ECT_EL ERR_INFO_STAT LV_CDN_DIAG_ECT_EL LV_END_DIAG_ECT_EL LV_READY_ECT_EL ERR_SYM_ECT_EL LV_ERR_MEM_ECT_EL CTR_ABC_END_DIAG_ECT_EL CTR_ABC_BN_TQ_AMT ERR_INFO_STAT LV_CDN_DIAG_BN_TQ_AMT LV_END_DIAG_BN_TQ_AMT LV_READY_BN_TQ_AMT ERR_SYM_BN_TQ_AMT LV_ERR_MEM_BN_TQ_AMT CTR_ABC_END_DIAG_BN_TQ_AMT CTR_ABC_EFP_LIH ERR_INFO_STAT LV_CDN_DIAG_EFP_LIH LV_END_DIAG_EFP_LIH LV_READY_EFP_LIH ERR_SYM_EFP_LIH LV_ERR_MEM_EFP_LIH CTR_ABC_END_DIAG_EFP_LIH CTR_ABC_BN_TCS ERR_INFO_STAT LV_CDN_DIAG_BN_TCS LV_END_DIAG_BN_TCS LV_READY_BN_TCS ERR_SYM_BN_TCS LV_ERR_MEM_BN_TCS CTR_ABC_END_DIAG_BN_TCS CTR_ABC_CRU_INH_MON_1 ERR_INFO_STAT LV_CDN_DIAG_CRU_INH_MON_1 LV_END_DIAG_CRU_INH_MON_1 LV_READY_CRU_INH_MON_1 ERR_SYM_CRU_INH_MON_1 LV_ERR_MEM_CRU_INH_MON_1 CTR_ABC_END_DIAG_CRU_INH_MON_1 CTR_ABC_VLS_UP_STK_1 ERR_INFO_STAT LV_CDN_DIAG_VLS_UP_STK_1 LV_END_DIAG_VLS_UP_STK_1 LV_READY_VLS_UP_STK_1 ERR_SYM_VLS_UP_STK_1 LV_ERR_MEM_VLS_UP_STK_1 CTR_ABC_END_DIAG_VLS_UP_STK_1 CTR_ABC_VLS_UP_STK_2 ERR_INFO_STAT LV_CDN_DIAG_VLS_UP_STK_2 LV_END_DIAG_VLS_UP_STK_2 LV_READY_VLS_UP_STK_2 ERR_SYM_VLS_UP_STK_2 LV_ERR_MEM_VLS_UP_STK_2 CTR_ABC_END_DIAG_VLS_UP_STK_2 CTR_ABC_TCO_GRD ERR_INFO_STAT LV_CDN_DIAG_TCO_GRD LV_END_DIAG_TCO_GRD LV_READY_TCO_GRD ERR_SYM_TCO_GRD LV_ERR_MEM_TCO_GRD CTR_ABC_END_DIAG_TCO_GRD CTR_ABC_RLY_ACCOUT ERR_INFO_STAT LV_CDN_DIAG_RLY_ACCOUT LV_END_DIAG_RLY_ACCOUT LV_READY_RLY_ACCOUT ERR_SYM_RLY_ACCOUT LV_ERR_MEM_RLY_ACCOUT CTR_ABC_END_DIAG_RLY_ACCOUT CTR_ABC_LOCAN_BOFF ERR_INFO_STAT LV_CDN_DIAG_LOCAN_BOFF LV_END_DIAG_LOCAN_BOFF LV_READY_LOCAN_BOFF ERR_SYM_LOCAN_BOFF LV_ERR_MEM_LOCAN_BOFF CTR_ABC_END_DIAG_LOCAN_BOFF CTR_ABC_TQI_N_MAX_MON_1 ERR_INFO_STAT LV_CDN_DIAG_TQI_N_MAX_MON_1 LV_END_DIAG_TQI_N_MAX_MON_1 LV_READY_TQI_N_MAX_MON_1 ERR_SYM_TQI_N_MAX_MON_1 LV_ERR_MEM_TQI_N_MAX_MON_1 CTR_ABC_END_DIAG_TQI_N_MAX_MON_1 CTR_ABC_BN_VEH_MOD ERR_INFO_STAT LV_CDN_DIAG_BN_VEH_MOD LV_END_DIAG_BN_VEH_MOD LV_READY_BN_VEH_MOD ERR_SYM_BN_VEH_MOD LV_ERR_MEM_BN_VEH_MOD CTR_ABC_END_DIAG_BN_VEH_MOD CTR_ABC_QOIL_SENS ERR_INFO_STAT LV_CDN_DIAG_QOIL_SENS LV_END_DIAG_QOIL_SENS LV_READY_QOIL_SENS ERR_SYM_QOIL_SENS LV_ERR_MEM_QOIL_SENS CTR_ABC_END_DIAG_QOIL_SENS CTR_ABC_EF ERR_INFO_STAT LV_CDN_DIAG_EF LV_END_DIAG_EF LV_READY_EF ERR_SYM_EF LV_ERR_MEM_EF CTR_ABC_END_DIAG_EF CTR_ABC_TOIL_LEVEL ERR_INFO_STAT LV_CDN_DIAG_TOIL_LEVEL LV_END_DIAG_TOIL_LEVEL LV_READY_TOIL_LEVEL ERR_SYM_TOIL_LEVEL LV_ERR_MEM_TOIL_LEVEL CTR_ABC_END_DIAG_TOIL_LEVEL CTR_ABC_AMP ERR_INFO_STAT LV_CDN_DIAG_AMP LV_END_DIAG_AMP LV_READY_AMP ERR_SYM_AMP LV_ERR_MEM_AMP CTR_ABC_END_DIAG_AMP CTR_ABC_RLY_MAIN_DLY ERR_INFO_STAT LV_CDN_DIAG_RLY_MAIN_DLY LV_END_DIAG_RLY_MAIN_DLY LV_READY_RLY_MAIN_DLY ERR_SYM_RLY_MAIN_DLY LV_ERR_MEM_RLY_MAIN_DLY CTR_ABC_END_DIAG_RLY_MAIN_DLY CTR_ABC_ISC ERR_INFO_STAT LV_CDN_DIAG_ISC LV_END_DIAG_ISC LV_READY_ISC ERR_SYM_ISC LV_ERR_MEM_ISC CTR_ABC_END_DIAG_ISC CTR_ABC_CHG_LS_DOWN ERR_INFO_STAT LV_CDN_DIAG_CHG_LS_DOWN LV_END_DIAG_CHG_LS_DOWN LV_READY_CHG_LS_DOWN ERR_SYM_CHG_LS_DOWN LV_ERR_MEM_CHG_LS_DOWN CTR_ABC_END_DIAG_CHG_LS_DOWN CTR_ABC_CHG_LS_UP ERR_INFO_STAT LV_CDN_DIAG_CHG_LS_UP LV_END_DIAG_CHG_LS_UP LV_READY_CHG_LS_UP ERR_SYM_CHG_LS_UP LV_ERR_MEM_CHG_LS_UP CTR_ABC_END_DIAG_CHG_LS_UP CTR_ABC_LAM_DLY_1 ERR_INFO_STAT LV_CDN_DIAG_LAM_DLY_1 LV_END_DIAG_LAM_DLY_1 LV_READY_LAM_DLY_1 ERR_SYM_LAM_DLY_1 LV_ERR_MEM_LAM_DLY_1 CTR_ABC_END_DIAG_LAM_DLY_1 CTR_ABC_LAM_DLY_2 ERR_INFO_STAT LV_CDN_DIAG_LAM_DLY_2 LV_END_DIAG_LAM_DLY_2 LV_READY_LAM_DLY_2 ERR_SYM_LAM_DLY_2 LV_ERR_MEM_LAM_DLY_2 CTR_ABC_END_DIAG_LAM_DLY_2 /end OUT_MEASUREMENT
/end FUNCTION
/end MODULE
/end PROJECT
