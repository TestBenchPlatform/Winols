ASAP2_VERSION 1 31
/begin PROJECT MS45 "BMW Motorsteuerung R6"
/begin HEADER "_default_HeaderComment" PROJECT_NO _52 /end HEADER
/begin MODULE _default_ModuleName "_default_ModuleLongIdentifier"
/begin MOD_COMMON "_default_ModCommonComment" DEPOSIT ABSOLUTE BYTE_ORDER MSB_FIRST ALIGNMENT_BYTE 1 ALIGNMENT_WORD 2 ALIGNMENT_LONG 4 ALIGNMENT_FLOAT32_IEEE 4 ALIGNMENT_FLOAT64_IEEE 8 /end MOD_COMMON
/begin CHARACTERISTIC C_CAM_GRD_AD_MAX_IVVT "" VALUE 0x427fb _REC_VAL_20_u1 95.625 _CNV_A_R_LINEAR_____236_CM 0. 95.625 /end CHARACTERISTIC
/begin CHARACTERISTIC C_CAM_GRD_AD_MAX_ST_IVVT "" VALUE 0x427fc _REC_VAL_20_u1 95.625 _CNV_A_R_LINEAR_____236_CM 0. 95.625 /end CHARACTERISTIC
/begin CHARACTERISTIC C_CRLC_REF_IVVT "" VALUE 0x42837 _REC_VAL_20_u1 0.9960940000000002 _CNV_A_R_LINEAR_____44_CM 0. 0.996094 FORMAT "%5.3" /end CHARACTERISTIC
/begin CHARACTERISTIC ID_SUM_CAM_AD_IVVT "" CURVE 0x4cf81 _REC_CUR_20_u1_u1 255. _CNV_A_R_LINEAR_____10_CM 0. 255. FORMAT "%3.0"
 /begin AXIS_DESCR COM_AXIS TOIL _CNV_A_R_LINEAR_____3_CM 6 -40. 160. FORMAT "%3.0" AXIS_PTS_REF ldpm_toil_2_ivvt /end AXIS_DESCR
/end CHARACTERISTIC
/begin CHARACTERISTIC C_CAM_RAW_DYW_IVVT_IN "" VALUE 0x42806 _REC_VAL_20_u1 95.625 _CNV_A_R_LINEAR_____75_CM 0. 95.625 /end CHARACTERISTIC
/begin CHARACTERISTIC C_CRLC_CAM_AD_IVVT "" VALUE 0x4282e _REC_VAL_20_u1 0.9960940000000002 _CNV_A_R_LINEAR_____44_CM 0. 0.996094 FORMAT "%5.3" /end CHARACTERISTIC
/begin CHARACTERISTIC C_CRLC_CAM_AD_ST_IVVT "" VALUE 0x4282f _REC_VAL_20_u1 0.9960940000000002 _CNV_A_R_LINEAR_____44_CM 0. 0.996094 FORMAT "%5.3" /end CHARACTERISTIC
/begin CHARACTERISTIC C_T_MIN_REF_REQ_IVVT "" VALUE 0x42a1d _REC_VAL_20_u1 25.5 _CNV_A_R_LINEAR_____14_CM 0. 25.5 FORMAT "%4.1" /end CHARACTERISTIC
/begin CHARACTERISTIC C_TCO_ADD_CAM_REF_IVVT "" VALUE 0x42a44 _REC_VAL_20_u1 190.5 _CNV_A_R_LINEAR_____1_CM 0. 190.5 FORMAT "%6.2" /end CHARACTERISTIC
/begin MEASUREMENT LV_CAM_AD_REQ_IVVT "" UBYTE _CNV_A_R_LINEAR_____10_CM 1 100. 0. 1. ECU_ADDRESS 0x3fc6da FORMAT "%1.0" BIT_MASK 0x1 /end MEASUREMENT
/begin MEASUREMENT LV_CAM_AD_DI_IVVT "Adaptation disabled" UBYTE _CNV_A_R_LINEAR_____10_CM 1 100. 0. 1. ECU_ADDRESS 0x3fc6db FORMAT "%1.0" BIT_MASK 0x1 /end MEASUREMENT
/begin MEASUREMENT LV_CAM_AD_AVL_IVVT "" UBYTE _CNV_A_R_LINEAR_____10_CM 1 100. 0. 1. ECU_ADDRESS 0x3fc6d9 FORMAT "%1.0" BIT_MASK 0x1 /end MEASUREMENT
/begin MEASUREMENT LV_CAM_AD_NVMY_VLD "Valid Adaptation values in non-volatile memory available" UBYTE _CNV_A_R_LINEAR_____10_CM 1 100. 0. 1. ECU_ADDRESS 0x3fc6dc FORMAT "%1.0" BIT_MASK 0x1 /end MEASUREMENT
/begin CHARACTERISTIC C_CAM_RAW_DYW_IVVT_EX "" VALUE 0x42805 _REC_VAL_20_u1 95.625 _CNV_A_R_LINEAR_____75_CM 0. 95.625 /end CHARACTERISTIC
/begin CHARACTERISTIC C_CAM_DIF_MAX_IVVT_PARK "Maximum deviation for activation of IVVT parking function" VALUE 0x427f9 _REC_VAL_20_u1 95.625 _CNV_A_R_LINEAR_____75_CM 0. 95.625 FORMAT "%5.2" /end CHARACTERISTIC
/begin MEASUREMENT LV_DIS_IVVT_PARK "IVVT parking function disabled  (=1)" UBYTE _CNV_A_R_LINEAR_____10_CM 1 100. 0. 1. ECU_ADDRESS 0x3fc6dd FORMAT "%1.0" BIT_MASK 0x1 /end MEASUREMENT
/begin MEASUREMENT CTR_CAM_AD_IVVT "Counter for camshaft Adaptations after engine start" UBYTE _CNV_A_R_LINEAR_____10_CM 1 100. 0. 255. ECU_ADDRESS 0x3fdbde FORMAT "%3.0" /end MEASUREMENT
/begin CHARACTERISTIC C_CTR_THD_IVVT_PARK "Maximum treshold for activation of IVVT parking function despite too high setpoint deviation or drift " VALUE 0x42c9c _REC_VAL_20_u2 65535. _CNV_A_R_LINEAR_____10_CM 0. 65535. FORMAT "%5.0" /end CHARACTERISTIC
/begin CHARACTERISTIC C_CYC_CAM_POS_DLY_PARK "Number of segments for CAM-position filtering" VALUE 0x42873 _REC_VAL_20_u1 255. _CNV_A_R_LINEAR_____10_CM 0. 255. FORMAT "%3.0" /end CHARACTERISTIC
/begin CHARACTERISTIC C_N_CAM_AD_BOL "Lower engine speed level of forbidden zone for CAM-Adaptation" VALUE 0x42932 _REC_VAL_20_u1 8160. _CNV_A_R_LINEAR_____5_CM 0. 8160. FORMAT "%4.0" /end CHARACTERISTIC
/begin CHARACTERISTIC C_N_CAM_AD_TOL "Upper engine speed level of forbidden zone for CAM-Adaptation" VALUE 0x42933 _REC_VAL_20_u1 8160. _CNV_A_R_LINEAR_____5_CM 0. 8160. FORMAT "%4.0" /end CHARACTERISTIC
/begin CHARACTERISTIC C_CTR_CAM_AD_IVVT_MAX "Maximum number of IVVT end position Adaptations after engine start" VALUE 0x42846 _REC_VAL_20_u1 255. _CNV_A_R_LINEAR_____10_CM 0. 255. FORMAT "%3.0" /end CHARACTERISTIC
/begin CHARACTERISTIC C_T_DLY_CAM_AD_IVVT "Delay time after transition \"enable\" to \"Adaptation\" before Adaptation calculation starts" VALUE 0x429d5 _REC_VAL_20_u1 2.55 _CNV_A_R_LINEAR_____27_CM 0. 2.55 FORMAT "%4.2" /end CHARACTERISTIC
/begin CHARACTERISTIC C_FAC_HLD_DLY "Count of delay times before transition from HLD_DLY to HLD_ADAP" VALUE 0x428ab _REC_VAL_20_u1 1.55 _CNV_A_R_LINEAR_____237_CM 1. 2.55 FORMAT "%4.2" /end CHARACTERISTIC
/begin CHARACTERISTIC IP_T_FAC_ADC_IVVT_EX "" MAP 0x4a6f0 _REC_MAP_20_u2_u1_u1 639.9902344 _CNV_A_R_LINEAR_____238_CM 0. 639.9902344 FORMAT "%7.3"
 /begin AXIS_DESCR COM_AXIS N_32 _CNV_A_R_LINEAR_____5_CM 8 0. 8160. FORMAT "%4.0" AXIS_PTS_REF ldpm_n_32_2_ivvt /end AXIS_DESCR
 /begin AXIS_DESCR COM_AXIS TOIL _CNV_A_R_LINEAR_____3_CM 8 -40. 160. FORMAT "%3.0" AXIS_PTS_REF ldpm_toil_1_ivvt /end AXIS_DESCR
/end CHARACTERISTIC
/begin CHARACTERISTIC IP_T_FAC_ADC_IVVT_IN "" MAP 0x4a770 _REC_MAP_20_u2_u1_u1 639.9902344 _CNV_A_R_LINEAR_____238_CM 0. 639.9902344 FORMAT "%7.3"
 /begin AXIS_DESCR COM_AXIS N_32 _CNV_A_R_LINEAR_____5_CM 8 0. 8160. FORMAT "%4.0" AXIS_PTS_REF ldpm_n_32_2_ivvt /end AXIS_DESCR
 /begin AXIS_DESCR COM_AXIS TOIL _CNV_A_R_LINEAR_____3_CM 8 -40. 160. FORMAT "%3.0" AXIS_PTS_REF ldpm_toil_1_ivvt /end AXIS_DESCR
/end CHARACTERISTIC
/begin CHARACTERISTIC IP_T_FAC_RTD_IVVT_EX "" MAP 0x4a7f0 _REC_MAP_20_u2_u1_u1 639.9902344 _CNV_A_R_LINEAR_____238_CM 0. 639.9902344 FORMAT "%7.3"
 /begin AXIS_DESCR COM_AXIS N_32 _CNV_A_R_LINEAR_____5_CM 8 0. 8160. FORMAT "%4.0" AXIS_PTS_REF ldpm_n_32_2_ivvt /end AXIS_DESCR
 /begin AXIS_DESCR COM_AXIS TOIL _CNV_A_R_LINEAR_____3_CM 8 -40. 160. FORMAT "%3.0" AXIS_PTS_REF ldpm_toil_1_ivvt /end AXIS_DESCR
/end CHARACTERISTIC
/begin CHARACTERISTIC IP_FAC_CTL_IVVT_IN "" CURVE 0x4df40 _REC_CUR_20_u1_u1 3.984375 _CNV_A_R_LINEAR_____195_CM 0. 3.984375 FORMAT "%7.5"
 /begin AXIS_DESCR COM_AXIS N_32 _CNV_A_R_LINEAR_____5_CM 6 0. 8160. FORMAT "%4.0" AXIS_PTS_REF ldpm_n_32_3_ivvt /end AXIS_DESCR
/end CHARACTERISTIC
/begin CHARACTERISTIC C_CAM_MDL_DIF_MIN_ADH "Minimum cam-position error for activation of adhesion detection" VALUE 0x43226 _REC_VAL_20_s2 120. _CNV_A_R_LINEAR_____75_CM -60. 60. FORMAT "%7.3" /end CHARACTERISTIC
/begin CHARACTERISTIC C_FAC_T_SUM_MIN_IVVT_ADH "Factor on minimum energization time for adhesion detection" VALUE 0x428bb _REC_VAL_20_u1 15.9375 _CNV_A_R_LINEAR_____40_CM 0. 15.9375 FORMAT "%5.2" /end CHARACTERISTIC
/begin CHARACTERISTIC C_FAC_DLY_IVVT_ADH "Factor on minimum energization time for adhesion detection" VALUE 0x428a0 _REC_VAL_20_u1 15.9375 _CNV_A_R_LINEAR_____40_CM 0. 15.9375 FORMAT "%5.2" /end CHARACTERISTIC
/begin CHARACTERISTIC C_CAM_ADJ_DIF_ADH_IN "Treshold for minimum movement in target direction for adhesion detection inlet cam" VALUE 0x43224 _REC_VAL_20_s2 120. _CNV_A_R_LINEAR_____75_CM -60. 60. FORMAT "%7.3" /end CHARACTERISTIC
/begin CHARACTERISTIC C_CAM_ADJ_DIF_ADH_EX "Treshold for minimum movement in target direction for adhesion detection exhaust cam" VALUE 0x43222 _REC_VAL_20_s2 120. _CNV_A_R_LINEAR_____75_CM -60. 60. FORMAT "%7.3" /end CHARACTERISTIC
/begin CHARACTERISTIC C_CAM_ADH_HYS "Hysteresis for movement detection in adhesion detection " VALUE 0x427f4 _REC_VAL_20_u1 95.625 _CNV_A_R_LINEAR_____75_CM 0. 95.625 FORMAT "%5.2" /end CHARACTERISTIC
/begin CHARACTERISTIC IP_TOIL_MIN_IVVT_DIAG "Minimum oil temperature for adhesion detection and mechanical IVVT-diagnosis" CURVE 0x50cbb _REC_CUR_20_u1_u1 200. _CNV_A_R_LINEAR_____3_CM -40. 160. FORMAT "%3.0"
 /begin AXIS_DESCR COM_AXIS N_32 _CNV_A_R_LINEAR_____5_CM 4 0. 8160. FORMAT "%4.0" AXIS_PTS_REF ldpm_n_32_4_ivvt /end AXIS_DESCR
/end CHARACTERISTIC
/begin CHARACTERISTIC IP_TOIL_MAX_IVVT_DIAG "Maximum oil temperature for adhesion detection and mechanical IVVT-diagnosis" CURVE 0x50cb7 _REC_CUR_20_u1_u1 200. _CNV_A_R_LINEAR_____3_CM -40. 160. FORMAT "%3.0"
 /begin AXIS_DESCR COM_AXIS N_32 _CNV_A_R_LINEAR_____5_CM 4 0. 8160. FORMAT "%4.0" AXIS_PTS_REF ldpm_n_32_4_ivvt /end AXIS_DESCR
/end CHARACTERISTIC
/begin CHARACTERISTIC IP_T_FAC_RTD_IVVT_IN "" MAP 0x4a870 _REC_MAP_20_u2_u1_u1 639.9902344 _CNV_A_R_LINEAR_____238_CM 0. 639.9902344 FORMAT "%7.3"
 /begin AXIS_DESCR COM_AXIS N_32 _CNV_A_R_LINEAR_____5_CM 8 0. 8160. FORMAT "%4.0" AXIS_PTS_REF ldpm_n_32_2_ivvt /end AXIS_DESCR
 /begin AXIS_DESCR COM_AXIS TOIL _CNV_A_R_LINEAR_____3_CM 8 -40. 160. FORMAT "%3.0" AXIS_PTS_REF ldpm_toil_1_ivvt /end AXIS_DESCR
/end CHARACTERISTIC
/begin CHARACTERISTIC IP_T_DLY_ADD_ADC_IVVT_IN "" CURVE 0x50302 _REC_CUR_20_u1_u1 159.375 _CNV_A_R_LINEAR_____239_CM 0. 159.375 FORMAT "%6.1"
 /begin AXIS_DESCR COM_AXIS TOIL _CNV_A_R_LINEAR_____3_CM 8 -40. 160. FORMAT "%3.0" AXIS_PTS_REF ldpm_toil_1_ivvt /end AXIS_DESCR
/end CHARACTERISTIC
/begin CHARACTERISTIC IP_T_DLY_ADD_ADC_IVVT_EX "" CURVE 0x502fa _REC_CUR_20_u1_u1 159.375 _CNV_A_R_LINEAR_____239_CM 0. 159.375 FORMAT "%6.1"
 /begin AXIS_DESCR COM_AXIS TOIL _CNV_A_R_LINEAR_____3_CM 8 -40. 160. FORMAT "%3.0" AXIS_PTS_REF ldpm_toil_1_ivvt /end AXIS_DESCR
/end CHARACTERISTIC
/begin CHARACTERISTIC IP_T_DLY_ADD_RTD_IVVT_EX "" CURVE 0x5030a _REC_CUR_20_u1_u1 159.375 _CNV_A_R_LINEAR_____239_CM 0. 159.375 FORMAT "%6.1"
 /begin AXIS_DESCR COM_AXIS TOIL _CNV_A_R_LINEAR_____3_CM 8 -40. 160. FORMAT "%3.0" AXIS_PTS_REF ldpm_toil_1_ivvt /end AXIS_DESCR
/end CHARACTERISTIC
/begin CHARACTERISTIC IP_T_DLY_ADD_RTD_IVVT_IN "" CURVE 0x50312 _REC_CUR_20_u1_u1 159.375 _CNV_A_R_LINEAR_____239_CM 0. 159.375 FORMAT "%6.1"
 /begin AXIS_DESCR COM_AXIS TOIL _CNV_A_R_LINEAR_____3_CM 8 -40. 160. FORMAT "%3.0" AXIS_PTS_REF ldpm_toil_1_ivvt /end AXIS_DESCR
/end CHARACTERISTIC
/begin CHARACTERISTIC IP_FAC_CTL_IVVT_EX "" CURVE 0x4df3a _REC_CUR_20_u1_u1 3.984375 _CNV_A_R_LINEAR_____195_CM 0. 3.984375 FORMAT "%7.5"
 /begin AXIS_DESCR COM_AXIS N_32 _CNV_A_R_LINEAR_____5_CM 6 0. 8160. FORMAT "%4.0" AXIS_PTS_REF ldpm_n_32_3_ivvt /end AXIS_DESCR
/end CHARACTERISTIC
/begin CHARACTERISTIC IP_T_CTL_ADC_IVVT_EX "" MAP 0x4fe7a _REC_MAP_20_u1_u1_u1 159.375 _CNV_A_R_LINEAR_____239_CM 0. 159.375 FORMAT "%6.1"
 /begin AXIS_DESCR COM_AXIS IVVT_IN_1.STRUCT_CTL_IVVT.CAM_MDL_DIF_IVVT _CNV_A_R_LINEAR_____75_CM 8 0. 60. AXIS_PTS_REF ldpm_cam_mdl_dif_ivvt /end AXIS_DESCR
 /begin AXIS_DESCR COM_AXIS IVVT_IN_1.STRUCT_CTL_IVVT.DLY_IVVT _CNV_A_R_LINEAR_____23_CM 6 0. 2550. FORMAT "%4.0" AXIS_PTS_REF ldpm_dly_ivvt_1_ivvt /end AXIS_DESCR
/end CHARACTERISTIC
/begin CHARACTERISTIC IP_T_CTL_ADC_IVVT_IN "" MAP 0x4feaa _REC_MAP_20_u1_u1_u1 159.375 _CNV_A_R_LINEAR_____239_CM 0. 159.375 FORMAT "%6.1"
 /begin AXIS_DESCR COM_AXIS IVVT_IN_1.STRUCT_CTL_IVVT.CAM_MDL_DIF_IVVT _CNV_A_R_LINEAR_____75_CM 8 0. 60. AXIS_PTS_REF ldpm_cam_mdl_dif_ivvt /end AXIS_DESCR
 /begin AXIS_DESCR COM_AXIS IVVT_IN_1.STRUCT_CTL_IVVT.DLY_IVVT _CNV_A_R_LINEAR_____23_CM 6 0. 2550. FORMAT "%4.0" AXIS_PTS_REF ldpm_dly_ivvt_1_ivvt /end AXIS_DESCR
/end CHARACTERISTIC
/begin CHARACTERISTIC IP_T_CTL_RTD_IVVT_IN "" MAP 0x4ff0a _REC_MAP_20_u1_u1_u1 159.375 _CNV_A_R_LINEAR_____239_CM 0. 159.375 FORMAT "%6.1"
 /begin AXIS_DESCR COM_AXIS IVVT_IN_1.STRUCT_CTL_IVVT.CAM_MDL_DIF_IVVT _CNV_A_R_LINEAR_____75_CM 8 0. 60. AXIS_PTS_REF ldpm_cam_mdl_dif_ivvt /end AXIS_DESCR
 /begin AXIS_DESCR COM_AXIS IVVT_IN_1.STRUCT_CTL_IVVT.DLY_IVVT _CNV_A_R_LINEAR_____23_CM 6 0. 2550. FORMAT "%4.0" AXIS_PTS_REF ldpm_dly_ivvt_1_ivvt /end AXIS_DESCR
/end CHARACTERISTIC
/begin CHARACTERISTIC IP_T_CTL_RTD_IVVT_EX "" MAP 0x4feda _REC_MAP_20_u1_u1_u1 159.375 _CNV_A_R_LINEAR_____239_CM 0. 159.375 FORMAT "%6.1"
 /begin AXIS_DESCR COM_AXIS IVVT_IN_1.STRUCT_CTL_IVVT.CAM_MDL_DIF_IVVT _CNV_A_R_LINEAR_____75_CM 8 0. 60. AXIS_PTS_REF ldpm_cam_mdl_dif_ivvt /end AXIS_DESCR
 /begin AXIS_DESCR COM_AXIS IVVT_IN_1.STRUCT_CTL_IVVT.DLY_IVVT _CNV_A_R_LINEAR_____23_CM 6 0. 2550. FORMAT "%4.0" AXIS_PTS_REF ldpm_dly_ivvt_1_ivvt /end AXIS_DESCR
/end CHARACTERISTIC
/begin CHARACTERISTIC IP_T_SUM_MIN_ADC_IVVT_EX "" MAP 0x5070e _REC_MAP_20_u1_u1_u1 158.75 _CNV_A_R_LINEAR_____239_CM 0.625 159.375 FORMAT "%7.3"
 /begin AXIS_DESCR COM_AXIS N_32 _CNV_A_R_LINEAR_____5_CM 4 0. 8160. FORMAT "%4.0" AXIS_PTS_REF ldpm_n_32_1_ivvt /end AXIS_DESCR
 /begin AXIS_DESCR COM_AXIS TOIL _CNV_A_R_LINEAR_____3_CM 8 -40. 160. FORMAT "%3.0" AXIS_PTS_REF ldpm_toil_1_ivvt /end AXIS_DESCR
/end CHARACTERISTIC
/begin CHARACTERISTIC IP_T_SUM_MIN_ADC_IVVT_IN "" MAP 0x5072e _REC_MAP_20_u1_u1_u1 158.75 _CNV_A_R_LINEAR_____239_CM 0.625 159.375 FORMAT "%7.3"
 /begin AXIS_DESCR COM_AXIS N_32 _CNV_A_R_LINEAR_____5_CM 4 0. 8160. FORMAT "%4.0" AXIS_PTS_REF ldpm_n_32_1_ivvt /end AXIS_DESCR
 /begin AXIS_DESCR COM_AXIS TOIL _CNV_A_R_LINEAR_____3_CM 8 -40. 160. FORMAT "%3.0" AXIS_PTS_REF ldpm_toil_1_ivvt /end AXIS_DESCR
/end CHARACTERISTIC
/begin CHARACTERISTIC IP_T_SUM_MIN_RTD_IVVT_IN "" MAP 0x5076e _REC_MAP_20_u1_u1_u1 158.75 _CNV_A_R_LINEAR_____239_CM 0.625 159.375 FORMAT "%7.3"
 /begin AXIS_DESCR COM_AXIS N_32 _CNV_A_R_LINEAR_____5_CM 4 0. 8160. FORMAT "%4.0" AXIS_PTS_REF ldpm_n_32_1_ivvt /end AXIS_DESCR
 /begin AXIS_DESCR COM_AXIS TOIL _CNV_A_R_LINEAR_____3_CM 8 -40. 160. FORMAT "%3.0" AXIS_PTS_REF ldpm_toil_1_ivvt /end AXIS_DESCR
/end CHARACTERISTIC
/begin CHARACTERISTIC IP_T_SUM_MIN_RTD_IVVT_EX "" MAP 0x5074e _REC_MAP_20_u1_u1_u1 158.75 _CNV_A_R_LINEAR_____239_CM 0.625 159.375 FORMAT "%7.3"
 /begin AXIS_DESCR COM_AXIS N_32 _CNV_A_R_LINEAR_____5_CM 4 0. 8160. FORMAT "%4.0" AXIS_PTS_REF ldpm_n_32_1_ivvt /end AXIS_DESCR
 /begin AXIS_DESCR COM_AXIS TOIL _CNV_A_R_LINEAR_____3_CM 8 -40. 160. FORMAT "%3.0" AXIS_PTS_REF ldpm_toil_1_ivvt /end AXIS_DESCR
/end CHARACTERISTIC
/begin CHARACTERISTIC C_T_ADD_MIN_IVVT_ADH_IN "Increment of energization time in case adhesion detected on inlet cam" VALUE 0x429b9 _REC_VAL_20_u1 159.375 _CNV_A_R_LINEAR_____239_CM 0. 159.375 FORMAT "%6.1" /end CHARACTERISTIC
/begin CHARACTERISTIC C_T_ADD_MIN_IVVT_ADH_EX "Increment of energization time in case adhesion detected on exhaust cam" VALUE 0x429b8 _REC_VAL_20_u1 159.375 _CNV_A_R_LINEAR_____239_CM 0. 159.375 FORMAT "%6.1" /end CHARACTERISTIC
/begin CHARACTERISTIC C_T_ADD_MIN_IVVT_ADH_MAX "Increment of energization time in case adhesion detected on exhaust cam" VALUE 0x429ba _REC_VAL_20_u1 159.375 _CNV_A_R_LINEAR_____239_CM 0. 159.375 FORMAT "%6.1" /end CHARACTERISTIC
/begin AXIS_PTS ldpm_cam_mdl_dif_ivvt "" 0x43b6f CAM_MDL_DIF_IVVT _REC_AXS_20_u1 60. _CNV_A_R_LINEAR_____75_CM 8 0. 60. /end AXIS_PTS
/begin AXIS_PTS ldpm_dly_ivvt_1_ivvt "" 0x43b97 DLY_IVVT_IN _REC_AXS_20_u1 2550. _CNV_A_R_LINEAR_____23_CM 6 0. 2550. FORMAT "%4.0" /end AXIS_PTS
/begin AXIS_PTS ldpm_n_32_4_ivvt "" 0x43d5f N_32 _REC_AXS_20_u1 8160. _CNV_A_R_LINEAR_____5_CM 4 0. 8160. FORMAT "%4.0" /end AXIS_PTS
/begin CHARACTERISTIC C_CAM_DIF_MIN_DLY_IVVT "" VALUE 0x427fa _REC_VAL_20_u1 47.625 _CNV_A_R_LINEAR_____75_CM 0. 47.625 /end CHARACTERISTIC
/begin CHARACTERISTIC IP_DLY_ADC_IVVT_EX "" MAP 0x4da8f _REC_MAP_20_u1_u1_u1 2550. _CNV_A_R_LINEAR_____23_CM 0. 2550. FORMAT "%4.0"
 /begin AXIS_DESCR COM_AXIS N_32 _CNV_A_R_LINEAR_____5_CM 8 0. 8160. FORMAT "%4.0" AXIS_PTS_REF ldpm_n_32_2_ivvt /end AXIS_DESCR
 /begin AXIS_DESCR COM_AXIS TOIL _CNV_A_R_LINEAR_____3_CM 8 -40. 160. FORMAT "%3.0" AXIS_PTS_REF ldpm_toil_1_ivvt /end AXIS_DESCR
/end CHARACTERISTIC
/begin CHARACTERISTIC IP_DLY_ADC_IVVT_IN "" MAP 0x4dacf _REC_MAP_20_u1_u1_u1 2550. _CNV_A_R_LINEAR_____23_CM 0. 2550. FORMAT "%4.0"
 /begin AXIS_DESCR COM_AXIS N_32 _CNV_A_R_LINEAR_____5_CM 8 0. 8160. FORMAT "%4.0" AXIS_PTS_REF ldpm_n_32_2_ivvt /end AXIS_DESCR
 /begin AXIS_DESCR COM_AXIS TOIL _CNV_A_R_LINEAR_____3_CM 8 -40. 160. FORMAT "%3.0" AXIS_PTS_REF ldpm_toil_1_ivvt /end AXIS_DESCR
/end CHARACTERISTIC
/begin CHARACTERISTIC IP_DLY_RTD_IVVT_EX "" MAP 0x4db0f _REC_MAP_20_u1_u1_u1 2550. _CNV_A_R_LINEAR_____23_CM 0. 2550. FORMAT "%4.0"
 /begin AXIS_DESCR COM_AXIS N_32 _CNV_A_R_LINEAR_____5_CM 8 0. 8160. FORMAT "%4.0" AXIS_PTS_REF ldpm_n_32_2_ivvt /end AXIS_DESCR
 /begin AXIS_DESCR COM_AXIS TOIL _CNV_A_R_LINEAR_____3_CM 8 -40. 160. FORMAT "%3.0" AXIS_PTS_REF ldpm_toil_1_ivvt /end AXIS_DESCR
/end CHARACTERISTIC
/begin CHARACTERISTIC IP_DLY_RTD_IVVT_IN "" MAP 0x4db4f _REC_MAP_20_u1_u1_u1 2550. _CNV_A_R_LINEAR_____23_CM 0. 2550. FORMAT "%4.0"
 /begin AXIS_DESCR COM_AXIS N_32 _CNV_A_R_LINEAR_____5_CM 8 0. 8160. FORMAT "%4.0" AXIS_PTS_REF ldpm_n_32_2_ivvt /end AXIS_DESCR
 /begin AXIS_DESCR COM_AXIS TOIL _CNV_A_R_LINEAR_____3_CM 8 -40. 160. FORMAT "%3.0" AXIS_PTS_REF ldpm_toil_1_ivvt /end AXIS_DESCR
/end CHARACTERISTIC
/begin MEASUREMENT DLY_ADC_IVVT_IN "" UBYTE _CNV_A_R_LINEAR_____23_CM 1 100. 0. 2550. ECU_ADDRESS 0x3fc8f4 FORMAT "%4.0" /end MEASUREMENT
/begin MEASUREMENT DLY_RTD_IVVT_IN "" UBYTE _CNV_A_R_LINEAR_____23_CM 1 100. 0. 2550. ECU_ADDRESS 0x3fc8f5 FORMAT "%4.0" /end MEASUREMENT
/begin MEASUREMENT CAM_SP_DYW_IVVT_IN "" UBYTE _CNV_A_R_LINEAR_____234_CM 1 100. 60. 155.625 ECU_ADDRESS 0x3fc8f2 FORMAT "%7.3" /end MEASUREMENT
/begin MEASUREMENT LV_CAM_SP_DYW_IVVT_IN "" UBYTE _CNV_A_R_LINEAR_____10_CM 1 100. 0. 1. ECU_ADDRESS 0x3fc8f3 FORMAT "%1.0" /end MEASUREMENT
/begin MEASUREMENT CAM_MDL_DIF_IVVT_IN_1 "" SWORD _CNV_A_R_LINEAR_____75_CM 1 100. -60. 60. ECU_ADDRESS 0x3fc72a FORMAT "%7.3" /end MEASUREMENT
/begin MEASUREMENT DLY_IVVT_IN_1 "" UBYTE _CNV_A_R_LINEAR_____23_CM 1 100. 0. 2550. ECU_ADDRESS 0x3fc76c FORMAT "%4.0" /end MEASUREMENT
/begin MEASUREMENT CAM_MDL_IVVT_IN_1 "" UWORD _CNV_A_R_LINEAR_____241_CM 1 100. 60. 155.9985 ECU_ADDRESS 0x3fc792 FORMAT "%7.3" /end MEASUREMENT
/begin MEASUREMENT CAM_MDL_DLY_NOT_IVVT_IN_1 "" UWORD _CNV_A_R_LINEAR_____241_CM 1 100. 60. 155.9985 ECU_ADDRESS 0x3fc790 FORMAT "%7.3" /end MEASUREMENT
/begin MEASUREMENT CAM_SP_DIF_IVVT_IN_1 "" SWORD _CNV_A_R_LINEAR_____75_CM 1 100. -60. 60. ECU_ADDRESS 0x3fc710 FORMAT "%7.3" /end MEASUREMENT
/begin MEASUREMENT T_CTL_I_IVVT_IN_1 "" SWORD _CNV_A_R_LINEAR_____239_CM 1 100. -20480. 20479.375 ECU_ADDRESS 0x3fc72e FORMAT "%8.1" /end MEASUREMENT
/begin MEASUREMENT T_CTL_IVVT_IN_1 "" SWORD _CNV_A_R_LINEAR_____239_CM 1 100. -20480. 20479.375 ECU_ADDRESS 0x3fc72c FORMAT "%8.1" /end MEASUREMENT
/begin MEASUREMENT T_IVVT_IN_1 "" SWORD _CNV_A_R_LINEAR_____239_CM 1 100. -20480. 20479.375 ECU_ADDRESS 0x3fc722 FORMAT "%8.1" /end MEASUREMENT
/begin MEASUREMENT T_SUM_IVVT_IN_1 "" SWORD _CNV_A_R_LINEAR_____239_CM 1 100. -20480. 20479.375 ECU_ADDRESS 0x3fc720 FORMAT "%8.1" /end MEASUREMENT
/begin MEASUREMENT T_SLV_IVVT_IN_1 "" SWORD _CNV_A_R_LINEAR_____239_CM 1 100. -20480. 20479.375 ECU_ADDRESS 0x3fc76a FORMAT "%8.1" /end MEASUREMENT
/begin MEASUREMENT T_STOP_ADJ_IVVT_IN_1 "" ULONG _CNV_A_R_LINEAR_____242_CM 1 100. 0. 17179869180. ECU_ADDRESS 0x3fc784 FORMAT "%11.0" /end MEASUREMENT
/begin MEASUREMENT T_ACT_IVVT_IN_1 "" ULONG _CNV_A_R_LINEAR_____242_CM 1 100. 0. 17179869180. ECU_ADDRESS 0x3fc78c FORMAT "%11.0" /end MEASUREMENT
/begin MEASUREMENT T_CTL_I_LIM_IVVT_IN_1 "" SWORD _CNV_A_R_LINEAR_____239_CM 1 100. -20480. 20479.375 ECU_ADDRESS 0x3fc730 FORMAT "%8.1" /end MEASUREMENT
/begin MEASUREMENT T_ST_ADJ_IVVT_IN_1 "" ULONG _CNV_A_R_LINEAR_____242_CM 1 100. 0. 17179869180. ECU_ADDRESS 0x3fc788 FORMAT "%11.0" /end MEASUREMENT
/begin MEASUREMENT T_ADJ_OLD_IVVT_IN_1 "" UWORD _CNV_A_R_LINEAR_____239_CM 1 100. 0. 40959.375 ECU_ADDRESS 0x3fc77e FORMAT "%7.1" /end MEASUREMENT
/begin MEASUREMENT T_LIM_IVVT_IN_1 "" SWORD _CNV_A_R_LINEAR_____239_CM 1 100. -20480. 20479.375 ECU_ADDRESS 0x3fc76e FORMAT "%8.1" /end MEASUREMENT
/begin MEASUREMENT T_CTL_I_LIM_1_IVVT_IN_1 "" SWORD _CNV_A_R_LINEAR_____239_CM 1 100. -20480. 20479.375 ECU_ADDRESS 0x3fc732 FORMAT "%8.1" /end MEASUREMENT
/begin MEASUREMENT T_SUM_TMP_IVVT_IN_1 "" SWORD _CNV_A_R_LINEAR_____239_CM 1 100. -20480. 20479.375 ECU_ADDRESS 0x3fc77a FORMAT "%8.1" /end MEASUREMENT
/begin MEASUREMENT T_SUM_SUBT_IVVT_IN_1 "" UWORD _CNV_A_R_LINEAR_____239_CM 1 100. 0. 40959.375 ECU_ADDRESS 0x3fc770 FORMAT "%7.1" /end MEASUREMENT
/begin MEASUREMENT T_ADJ_NEW_IVVT_IN_1 "" UWORD _CNV_A_R_LINEAR_____239_CM 1 100. 0. 40959.375 ECU_ADDRESS 0x3fc77c FORMAT "%7.1" /end MEASUREMENT
/begin MEASUREMENT T_SUM_IF_IVVT_IN_1 "" UWORD _CNV_A_R_LINEAR_____242_CM 1 100. 0. 262140. ECU_ADDRESS 0x3fc726 FORMAT "%6.0" /end MEASUREMENT
/begin MEASUREMENT CAM_DIF_IVVT_IN_1 "" SWORD _CNV_A_R_LINEAR_____75_CM 1 100. -60. 60. ECU_ADDRESS 0x3fc712 FORMAT "%7.3" /end MEASUREMENT
/begin MEASUREMENT CAM_CLC_DELTA_IN_1 "" UWORD _CNV_A_R_LINEAR_____243_CM 1 100. 0. 95.99850000000001 ECU_ADDRESS 0x3fc794 /end MEASUREMENT
/begin MEASUREMENT LV_ADJ_POS_IVVT_IN_1 "" UBYTE _CNV_A_R_LINEAR_____10_CM 1 100. 0. 1. ECU_ADDRESS 0x3fc715 FORMAT "%1.0" /end MEASUREMENT
/begin MEASUREMENT LV_ADJ_CHG_DIR_IVVT_IN_1 "" UBYTE _CNV_A_R_LINEAR_____10_CM 1 100. 0. 1. ECU_ADDRESS 0x3fc714 FORMAT "%1.0" /end MEASUREMENT
/begin MEASUREMENT LV_HLD_REQ_IVVT_IN_1 "" UBYTE _CNV_A_R_LINEAR_____10_CM 1 100. 0. 1. ECU_ADDRESS 0x3fc724 FORMAT "%1.0" /end MEASUREMENT
/begin MEASUREMENT LV_MDL_ADC_IVVT_IN_1 "" UBYTE _CNV_A_R_LINEAR_____10_CM 1 100. 0. 1. ECU_ADDRESS 0x3fc767 FORMAT "%1.0" /end MEASUREMENT
/begin MEASUREMENT STATE_IVVT_PWM_IN_1 "" ULONG _CNV_S_3_STATE_IVVT_244_CM 1 100. 0. 2. ECU_ADDRESS 0x3fc71c /end MEASUREMENT
/begin MEASUREMENT STATE_IVVT_ACT_IN_1 "" ULONG _CNV_S_5_STATE_IVVT_245_CM 1 100. 0. 4. ECU_ADDRESS 0x3fc718 /end MEASUREMENT
/begin MEASUREMENT CAM_IN_1 "" UBYTE _CNV_A_R_LINEAR_____234_CM 1 100. 60. 155.625 ECU_ADDRESS 0x3fc6f0 FORMAT "%7.3" /end MEASUREMENT
/begin MEASUREMENT CAM_REF_IVVT_IN_1 "" UWORD _CNV_A_R_LINEAR_____241_CM 1 100. 60. 155.9985 ECU_ADDRESS 0x3fc6f4 FORMAT "%7.3" /end MEASUREMENT
/begin MEASUREMENT CAM_AD_IVVT_IN_1_0 "" SWORD _CNV_A_R_LINEAR_____246_CM 1 100. -48. 47.9985 ECU_ADDRESS 0x3fc6f6 FORMAT "%7.3" /end MEASUREMENT
/begin MEASUREMENT CAM_REF_DIF_IVVT_IN_1 "" SWORD _CNV_A_R_LINEAR_____75_CM 1 100. -95.625 95.625 ECU_ADDRESS 0x3fc6fc FORMAT "%7.3" /end MEASUREMENT
/begin MEASUREMENT CAM_RAW_DYW_IVVT_IN_1 "" UBYTE _CNV_A_R_LINEAR_____234_CM 1 100. 60. 155.625 ECU_ADDRESS 0x3fc701 FORMAT "%7.3" /end MEASUREMENT
/begin MEASUREMENT LV_CAM_RAW_DYW_IVVT_IN_1 "" UBYTE _CNV_A_R_LINEAR_____10_CM 1 100. 0. 1. ECU_ADDRESS 0x3fc6fe FORMAT "%1.0" /end MEASUREMENT
/begin MEASUREMENT CAM_REF_RAW_IN_1 "" UBYTE _CNV_A_R_LINEAR_____234_CM 1 100. 60. 155.625 ECU_ADDRESS 0x3fc702 FORMAT "%7.3" /end MEASUREMENT
/begin MEASUREMENT CAM_AD_IVVT_IN_1_1 "" SWORD _CNV_A_R_LINEAR_____246_CM 1 100. -48. 47.9985 ECU_ADDRESS 0x3fc6f8 FORMAT "%7.3" /end MEASUREMENT
/begin MEASUREMENT CAM_AD_IVVT_IN_1_2 "" SWORD _CNV_A_R_LINEAR_____246_CM 1 100. -48. 47.9985 ECU_ADDRESS 0x3fc6fa FORMAT "%7.3" /end MEASUREMENT
/begin MEASUREMENT CAM_IN_PARK_1 "last valid inlet cam position befor engine stop" UBYTE _CNV_A_R_LINEAR_____234_CM 1 100. 60. 155.625 ECU_ADDRESS 0x3fc703 FORMAT "%5.1" /end MEASUREMENT
/begin MEASUREMENT CTR_CAM_DIF_IVVT_PARK_IN_1 " Counter for too high deviation from setpoint in IVVT parking function" UWORD _CNV_A_R_LINEAR_____10_CM 1 100. 0. 65535. ECU_ADDRESS 0x3fc704 FORMAT "%5.0" /end MEASUREMENT
/begin MEASUREMENT CTR_CAM_DRIFT_IVVT_PARK_IN_1 "Counter for too high camshaft drift in IVVT parking function" UWORD _CNV_A_R_LINEAR_____10_CM 1 100. 0. 65535. ECU_ADDRESS 0x3fc706 FORMAT "%5.0" /end MEASUREMENT
/begin MEASUREMENT DLY_MES_ADC_IVVT_IN_1 "" UBYTE _CNV_A_R_LINEAR_____23_CM 1 100. 0. 2550. ECU_ADDRESS 0x3fc7ac FORMAT "%4.0" /end MEASUREMENT
/begin MEASUREMENT DLY_MES_RTD_IVVT_IN_1 "" UBYTE _CNV_A_R_LINEAR_____23_CM 1 100. 0. 2550. ECU_ADDRESS 0x3fc7ad FORMAT "%4.0" /end MEASUREMENT
/begin MEASUREMENT IVVTPWM_IN_1 "" UBYTE _CNV_A_R_LINEAR_____4_CM 1 100. 0. 99.609375 ECU_ADDRESS 0x3fc7ca /end MEASUREMENT
/begin MEASUREMENT SUM_CYC_ADH_IVVT_IN_1 "" UWORD _CNV_A_R_LINEAR_____10_CM 1 100. 0. 6000. ECU_ADDRESS 0x3fc7bc FORMAT "%4.0" /end MEASUREMENT
/begin MEASUREMENT IVVTHPWM_ADH_IN_1 "" SBYTE _CNV_A_R_LINEAR_____4_CM 1 100. -50. 49.609375 ECU_ADDRESS 0x3fc7cb FORMAT "%6.2" /end MEASUREMENT
/begin MEASUREMENT IVVTHPWM_ADH_SAVE_IN_1 "" SBYTE _CNV_A_R_LINEAR_____4_CM 1 100. -50. 49.609375 ECU_ADDRESS 0x3fc7cc FORMAT "%6.2" /end MEASUREMENT
/begin MEASUREMENT LV_ADH_ACT_IVVT_IN_1 "" UBYTE _CNV_A_R_LINEAR_____10_CM 1 100. 0. 1. ECU_ADDRESS 0x3fc7cd FORMAT "%1.0" /end MEASUREMENT
/begin MEASUREMENT LV_ADH_END_IVVT_IN_1 "" UBYTE _CNV_A_R_LINEAR_____10_CM 1 100. 0. 1. ECU_ADDRESS 0x3fc7ce FORMAT "%1.0" /end MEASUREMENT
/begin MEASUREMENT SUM_STATE_ACT_ADJ_IVVT_IN_1 "" UBYTE _CNV_A_R_LINEAR_____10_CM 1 100. 0. 255. ECU_ADDRESS 0x3fc7cf FORMAT "%3.0" /end MEASUREMENT
/begin MEASUREMENT VEL_DRIFT_IVVTHPWM_IN_1 "" SWORD _CNV_A_R_LINEAR_____247_CM 1 100. -95.625 95.625 ECU_ADDRESS 0x3fc7be FORMAT "%7.3" /end MEASUREMENT
/begin MEASUREMENT IVVTHPWM_AD_IN_1 "" UBYTE _CNV_A_R_LINEAR_____117_CM 1 100. -50. 49.609375 ECU_ADDRESS 0x3fc7d4 FORMAT "%6.2" /end MEASUREMENT
/begin MEASUREMENT CAM_IN_2 "" UBYTE _CNV_A_R_LINEAR_____234_CM 1 100. 60. 155.625 ECU_ADDRESS 0x3fc7e8 FORMAT "%7.3" /end MEASUREMENT
/begin MEASUREMENT CAM_REF_IVVT_IN_2 "" UWORD _CNV_A_R_LINEAR_____241_CM 1 100. 60. 155.9985 ECU_ADDRESS 0x3fc7ec FORMAT "%7.3" /end MEASUREMENT
/begin MEASUREMENT CAM_AD_IVVT_IN_2_0 "" SWORD _CNV_A_R_LINEAR_____246_CM 1 100. -48. 47.9985 ECU_ADDRESS 0x3fc7ee FORMAT "%7.3" /end MEASUREMENT
/begin MEASUREMENT CAM_REF_DIF_IVVT_IN_2 "" SWORD _CNV_A_R_LINEAR_____75_CM 1 100. -95.625 95.625 ECU_ADDRESS 0x3fc7f4 FORMAT "%7.3" /end MEASUREMENT
/begin MEASUREMENT LV_CAM_RAW_DYW_IVVT_IN_2 "" UBYTE _CNV_A_R_LINEAR_____10_CM 1 100. 0. 1. ECU_ADDRESS 0x3fc7f6 FORMAT "%1.0" /end MEASUREMENT
/begin MEASUREMENT CAM_RAW_DYW_IVVT_IN_2 "" UBYTE _CNV_A_R_LINEAR_____234_CM 1 100. 60. 155.625 ECU_ADDRESS 0x3fc7f9 FORMAT "%7.3" /end MEASUREMENT
/begin MEASUREMENT CAM_REF_RAW_IN_2 "" UBYTE _CNV_A_R_LINEAR_____234_CM 1 100. 60. 155.625 ECU_ADDRESS 0x3fc7fa FORMAT "%7.3" /end MEASUREMENT
/begin MEASUREMENT CAM_AD_IVVT_IN_2_1 "" SWORD _CNV_A_R_LINEAR_____246_CM 1 100. -48. 47.9985 ECU_ADDRESS 0x3fc7f0 FORMAT "%7.3" /end MEASUREMENT
/begin MEASUREMENT CAM_AD_IVVT_IN_2_2 "" SWORD _CNV_A_R_LINEAR_____246_CM 1 100. -48. 47.9985 ECU_ADDRESS 0x3fc7f2 FORMAT "%7.3" /end MEASUREMENT
/begin MEASUREMENT CAM_IN_PARK_2 "last valid inlet cam position befor engine stop" UBYTE _CNV_A_R_LINEAR_____234_CM 1 100. 60. 155.625 ECU_ADDRESS 0x3fc7fb FORMAT "%5.1" /end MEASUREMENT
/begin MEASUREMENT CTR_CAM_DIF_IVVT_PARK_IN_2 " Counter for too high deviation from setpoint in IVVT parking function" UWORD _CNV_A_R_LINEAR_____10_CM 1 100. 0. 65535. ECU_ADDRESS 0x3fc7fc FORMAT "%5.0" /end MEASUREMENT
/begin MEASUREMENT CTR_CAM_DRIFT_IVVT_PARK_IN_2 "Counter for too high camshaft drift in IVVT parking function" UWORD _CNV_A_R_LINEAR_____10_CM 1 100. 0. 65535. ECU_ADDRESS 0x3fc7fe FORMAT "%5.0" /end MEASUREMENT
/begin MEASUREMENT DLY_MES_ADC_IVVT_IN_2 "" UBYTE _CNV_A_R_LINEAR_____23_CM 1 100. 0. 2550. ECU_ADDRESS 0x3fc8a4 FORMAT "%4.0" /end MEASUREMENT
/begin MEASUREMENT DLY_MES_RTD_IVVT_IN_2 "" UBYTE _CNV_A_R_LINEAR_____23_CM 1 100. 0. 2550. ECU_ADDRESS 0x3fc8a5 FORMAT "%4.0" /end MEASUREMENT
/begin MEASUREMENT IVVTPWM_IN_2 "" UBYTE _CNV_A_R_LINEAR_____4_CM 1 100. 0. 99.609375 ECU_ADDRESS 0x3fc8c2 /end MEASUREMENT
/begin MEASUREMENT SUM_CYC_ADH_IVVT_IN_2 "" UWORD _CNV_A_R_LINEAR_____10_CM 1 100. 0. 6000. ECU_ADDRESS 0x3fc8b4 FORMAT "%4.0" /end MEASUREMENT
/begin MEASUREMENT IVVTHPWM_ADH_IN_2 "" SBYTE _CNV_A_R_LINEAR_____4_CM 1 100. -50. 49.609375 ECU_ADDRESS 0x3fc8c3 FORMAT "%6.2" /end MEASUREMENT
/begin MEASUREMENT IVVTHPWM_ADH_SAVE_IN_2 "" SBYTE _CNV_A_R_LINEAR_____4_CM 1 100. -50. 49.609375 ECU_ADDRESS 0x3fc8c4 FORMAT "%6.2" /end MEASUREMENT
/begin MEASUREMENT LV_ADH_ACT_IVVT_IN_2 "" UBYTE _CNV_A_R_LINEAR_____10_CM 1 100. 0. 1. ECU_ADDRESS 0x3fc8c5 FORMAT "%1.0" /end MEASUREMENT
/begin MEASUREMENT LV_ADH_END_IVVT_IN_2 "" UBYTE _CNV_A_R_LINEAR_____10_CM 1 100. 0. 1. ECU_ADDRESS 0x3fc8c6 FORMAT "%1.0" /end MEASUREMENT
/begin MEASUREMENT SUM_STATE_ACT_ADJ_IVVT_IN_2 "" UBYTE _CNV_A_R_LINEAR_____10_CM 1 100. 0. 255. ECU_ADDRESS 0x3fc8c7 FORMAT "%3.0" /end MEASUREMENT
/begin MEASUREMENT VEL_DRIFT_IVVTHPWM_IN_2 "" SWORD _CNV_A_R_LINEAR_____247_CM 1 100. -95.625 95.625 ECU_ADDRESS 0x3fc8b6 FORMAT "%7.3" /end MEASUREMENT
/begin MEASUREMENT IVVTHPWM_AD_IN_2 "" UBYTE _CNV_A_R_LINEAR_____117_CM 1 100. -50. 49.609375 ECU_ADDRESS 0x3fc8cc FORMAT "%6.2" /end MEASUREMENT
/begin MEASUREMENT CAM_SP_DIF_IVVT_IN_2 "" SWORD _CNV_A_R_LINEAR_____75_CM 1 100. -60. 60. ECU_ADDRESS 0x3fc808 FORMAT "%7.3" /end MEASUREMENT
/begin MEASUREMENT CAM_MDL_DLY_NOT_IVVT_IN_2 "" UWORD _CNV_A_R_LINEAR_____241_CM 1 100. 60. 155.9985 ECU_ADDRESS 0x3fc888 FORMAT "%7.3" /end MEASUREMENT
/begin MEASUREMENT CAM_MDL_IVVT_IN_2 "" UWORD _CNV_A_R_LINEAR_____241_CM 1 100. 60. 155.9985 ECU_ADDRESS 0x3fc88a FORMAT "%7.3" /end MEASUREMENT
/begin MEASUREMENT CAM_MDL_DIF_IVVT_IN_2 "" SWORD _CNV_A_R_LINEAR_____75_CM 1 100. -60. 60. ECU_ADDRESS 0x3fc822 FORMAT "%7.3" /end MEASUREMENT
/begin MEASUREMENT DLY_IVVT_IN_2 "" UBYTE _CNV_A_R_LINEAR_____23_CM 1 100. 0. 2550. ECU_ADDRESS 0x3fc864 FORMAT "%4.0" /end MEASUREMENT
/begin MEASUREMENT T_IVVT_IN_2 "" SWORD _CNV_A_R_LINEAR_____239_CM 1 100. -20480. 20479.375 ECU_ADDRESS 0x3fc81a FORMAT "%8.1" /end MEASUREMENT
/begin MEASUREMENT T_SUM_IVVT_IN_2 "" SWORD _CNV_A_R_LINEAR_____239_CM 1 100. -20480. 20479.375 ECU_ADDRESS 0x3fc818 FORMAT "%8.1" /end MEASUREMENT
/begin MEASUREMENT T_CTL_IVVT_IN_2 "" SWORD _CNV_A_R_LINEAR_____239_CM 1 100. -20480. 20479.375 ECU_ADDRESS 0x3fc824 FORMAT "%8.1" /end MEASUREMENT
/begin MEASUREMENT T_CTL_I_IVVT_IN_2 "" SWORD _CNV_A_R_LINEAR_____239_CM 1 100. -20480. 20479.375 ECU_ADDRESS 0x3fc826 FORMAT "%8.1" /end MEASUREMENT
/begin MEASUREMENT T_SLV_IVVT_IN_2 "" SWORD _CNV_A_R_LINEAR_____239_CM 1 100. -20480. 20479.375 ECU_ADDRESS 0x3fc862 FORMAT "%8.1" /end MEASUREMENT
/begin MEASUREMENT T_STOP_ADJ_IVVT_IN_2 "" ULONG _CNV_A_R_LINEAR_____242_CM 1 100. 0. 17179869180. ECU_ADDRESS 0x3fc87c FORMAT "%11.0" /end MEASUREMENT
/begin MEASUREMENT T_ACT_IVVT_IN_2 "" ULONG _CNV_A_R_LINEAR_____242_CM 1 100. 0. 17179869180. ECU_ADDRESS 0x3fc884 FORMAT "%11.0" /end MEASUREMENT
/begin MEASUREMENT T_CTL_I_LIM_IVVT_IN_2 "" SWORD _CNV_A_R_LINEAR_____239_CM 1 100. -20480. 20479.375 ECU_ADDRESS 0x3fc828 FORMAT "%8.1" /end MEASUREMENT
/begin MEASUREMENT T_ST_ADJ_IVVT_IN_2 "" ULONG _CNV_A_R_LINEAR_____242_CM 1 100. 0. 17179869180. ECU_ADDRESS 0x3fc880 FORMAT "%11.0" /end MEASUREMENT
/begin MEASUREMENT T_ADJ_OLD_IVVT_IN_2 "" UWORD _CNV_A_R_LINEAR_____239_CM 1 100. 0. 40959.375 ECU_ADDRESS 0x3fc876 FORMAT "%7.1" /end MEASUREMENT
/begin MEASUREMENT T_LIM_IVVT_IN_2 "" SWORD _CNV_A_R_LINEAR_____239_CM 1 100. -20480. 20479.375 ECU_ADDRESS 0x3fc866 FORMAT "%8.1" /end MEASUREMENT
/begin MEASUREMENT T_CTL_I_LIM_1_IVVT_IN_2 "" SWORD _CNV_A_R_LINEAR_____239_CM 1 100. -20480. 20479.375 ECU_ADDRESS 0x3fc82a FORMAT "%8.1" /end MEASUREMENT
/begin MEASUREMENT T_SUM_TMP_IVVT_IN_2 "" SWORD _CNV_A_R_LINEAR_____239_CM 1 100. -20480. 20479.375 ECU_ADDRESS 0x3fc872 FORMAT "%8.1" /end MEASUREMENT
/begin MEASUREMENT T_SUM_SUBT_IVVT_IN_2 "" UWORD _CNV_A_R_LINEAR_____239_CM 1 100. 0. 40959.375 ECU_ADDRESS 0x3fc868 FORMAT "%7.1" /end MEASUREMENT
/begin MEASUREMENT T_ADJ_NEW_IVVT_IN_2 "" UWORD _CNV_A_R_LINEAR_____239_CM 1 100. 0. 40959.375 ECU_ADDRESS 0x3fc874 FORMAT "%7.1" /end MEASUREMENT
/begin MEASUREMENT T_SUM_IF_IVVT_IN_2 "" UWORD _CNV_A_R_LINEAR_____242_CM 1 100. 0. 262140. ECU_ADDRESS 0x3fc81e FORMAT "%6.0" /end MEASUREMENT
/begin MEASUREMENT CAM_DIF_IVVT_IN_2 "" SWORD _CNV_A_R_LINEAR_____75_CM 1 100. -60. 60. ECU_ADDRESS 0x3fc80a FORMAT "%7.3" /end MEASUREMENT
/begin MEASUREMENT CAM_CLC_DELTA_IN_2 "" UWORD _CNV_A_R_LINEAR_____243_CM 1 100. 0. 95.99850000000001 ECU_ADDRESS 0x3fc88c /end MEASUREMENT
/begin MEASUREMENT LV_ADJ_POS_IVVT_IN_2 "" UBYTE _CNV_A_R_LINEAR_____10_CM 1 100. 0. 1. ECU_ADDRESS 0x3fc80d FORMAT "%1.0" /end MEASUREMENT
/begin MEASUREMENT LV_ADJ_CHG_DIR_IVVT_IN_2 "" UBYTE _CNV_A_R_LINEAR_____10_CM 1 100. 0. 1. ECU_ADDRESS 0x3fc80c FORMAT "%1.0" /end MEASUREMENT
/begin MEASUREMENT LV_HLD_REQ_IVVT_IN_2 "" UBYTE _CNV_A_R_LINEAR_____10_CM 1 100. 0. 1. ECU_ADDRESS 0x3fc81c FORMAT "%1.0" /end MEASUREMENT
/begin MEASUREMENT LV_MDL_ADC_IVVT_IN_2 "" UBYTE _CNV_A_R_LINEAR_____10_CM 1 100. 0. 1. ECU_ADDRESS 0x3fc85f FORMAT "%1.0" /end MEASUREMENT
/begin MEASUREMENT STATE_IVVT_ACT_IN_2 "" ULONG _CNV_S_5_STATE_IVVT_245_CM 1 100. 0. 4. ECU_ADDRESS 0x3fc810 /end MEASUREMENT
/begin MEASUREMENT STATE_IVVT_PWM_IN_2 "" ULONG _CNV_S_3_STATE_IVVT_244_CM 1 100. 0. 2. ECU_ADDRESS 0x3fc814 /end MEASUREMENT
/begin MEASUREMENT CAM_MDL_DIF_IVVT_EX_1 "" SWORD _CNV_A_R_LINEAR_____75_CM 1 100. -60. 60. ECU_ADDRESS 0x3fc93a FORMAT "%7.3" /end MEASUREMENT
/begin MEASUREMENT DLY_IVVT_EX_1 "" UBYTE _CNV_A_R_LINEAR_____23_CM 1 100. 0. 2550. ECU_ADDRESS 0x3fc97c FORMAT "%4.0" /end MEASUREMENT
/begin MEASUREMENT CAM_MDL_IVVT_EX_1 "" UWORD _CNV_A_R_LINEAR_____249_CM 1 100. -40. -135.9985 ECU_ADDRESS 0x3fc9a2 FORMAT "%8.3" /end MEASUREMENT
/begin MEASUREMENT CAM_MDL_DLY_NOT_IVVT_EX_1 "" UWORD _CNV_A_R_LINEAR_____249_CM 1 100. -40. -135.9985 ECU_ADDRESS 0x3fc9a0 FORMAT "%8.3" /end MEASUREMENT
/begin MEASUREMENT CAM_SP_DIF_IVVT_EX_1 "" SWORD _CNV_A_R_LINEAR_____75_CM 1 100. -60. 60. ECU_ADDRESS 0x3fc920 FORMAT "%7.3" /end MEASUREMENT
/begin MEASUREMENT T_CTL_IVVT_EX_1 "" SWORD _CNV_A_R_LINEAR_____239_CM 1 100. -20480. 20479.375 ECU_ADDRESS 0x3fc93c FORMAT "%8.1" /end MEASUREMENT
/begin MEASUREMENT T_CTL_I_IVVT_EX_1 "" SWORD _CNV_A_R_LINEAR_____239_CM 1 100. -20480. 20479.375 ECU_ADDRESS 0x3fc93e FORMAT "%8.1" /end MEASUREMENT
/begin MEASUREMENT T_IVVT_EX_1 "" SWORD _CNV_A_R_LINEAR_____239_CM 1 100. -20480. 20479.375 ECU_ADDRESS 0x3fc932 FORMAT "%8.1" /end MEASUREMENT
/begin MEASUREMENT T_SUM_IVVT_EX_1 "" SWORD _CNV_A_R_LINEAR_____239_CM 1 100. -20480. 20479.375 ECU_ADDRESS 0x3fc930 FORMAT "%8.1" /end MEASUREMENT
/begin MEASUREMENT T_SLV_IVVT_EX_1 "" SWORD _CNV_A_R_LINEAR_____239_CM 1 100. -20480. 20479.375 ECU_ADDRESS 0x3fc97a FORMAT "%8.1" /end MEASUREMENT
/begin MEASUREMENT T_STOP_ADJ_IVVT_EX_1 "" ULONG _CNV_A_R_LINEAR_____242_CM 1 100. 0. 17179869180. ECU_ADDRESS 0x3fc994 FORMAT "%11.0" /end MEASUREMENT
/begin MEASUREMENT T_ACT_IVVT_EX_1 "" ULONG _CNV_A_R_LINEAR_____242_CM 1 100. 0. 17179869180. ECU_ADDRESS 0x3fc99c FORMAT "%11.0" /end MEASUREMENT
/begin MEASUREMENT T_CTL_I_LIM_IVVT_EX_1 "" SWORD _CNV_A_R_LINEAR_____239_CM 1 100. -20480. 20479.375 ECU_ADDRESS 0x3fc940 FORMAT "%8.1" /end MEASUREMENT
/begin MEASUREMENT T_ST_ADJ_IVVT_EX_1 "" ULONG _CNV_A_R_LINEAR_____242_CM 1 100. 0. 17179869180. ECU_ADDRESS 0x3fc998 FORMAT "%11.0" /end MEASUREMENT
/begin MEASUREMENT T_ADJ_OLD_IVVT_EX_1 "" UWORD _CNV_A_R_LINEAR_____239_CM 1 100. 0. 40959.375 ECU_ADDRESS 0x3fc98e FORMAT "%7.1" /end MEASUREMENT
/begin MEASUREMENT T_LIM_IVVT_EX_1 "" SWORD _CNV_A_R_LINEAR_____239_CM 1 100. -20480. 20479.375 ECU_ADDRESS 0x3fc97e FORMAT "%8.1" /end MEASUREMENT
/begin MEASUREMENT T_CTL_I_LIM_1_IVVT_EX_1 "" SWORD _CNV_A_R_LINEAR_____239_CM 1 100. -20480. 20479.375 ECU_ADDRESS 0x3fc942 FORMAT "%8.1" /end MEASUREMENT
/begin MEASUREMENT T_SUM_TMP_IVVT_EX_1 "" SWORD _CNV_A_R_LINEAR_____239_CM 1 100. -20480. 20479.375 ECU_ADDRESS 0x3fc98a FORMAT "%8.1" /end MEASUREMENT
/begin MEASUREMENT T_SUM_SUBT_IVVT_EX_1 "" UWORD _CNV_A_R_LINEAR_____239_CM 1 100. 0. 40959.375 ECU_ADDRESS 0x3fc980 FORMAT "%7.1" /end MEASUREMENT
/begin MEASUREMENT T_ADJ_NEW_IVVT_EX_1 "" UWORD _CNV_A_R_LINEAR_____239_CM 1 100. 0. 40959.375 ECU_ADDRESS 0x3fc98c FORMAT "%7.1" /end MEASUREMENT
/begin MEASUREMENT T_SUM_IF_IVVT_EX_1 "" UWORD _CNV_A_R_LINEAR_____242_CM 1 100. 0. 262140. ECU_ADDRESS 0x3fc936 FORMAT "%6.0" /end MEASUREMENT
/begin MEASUREMENT CAM_DIF_IVVT_EX_1 "" SWORD _CNV_A_R_LINEAR_____75_CM 1 100. -60. 60. ECU_ADDRESS 0x3fc922 FORMAT "%7.3" /end MEASUREMENT
/begin MEASUREMENT CAM_CLC_DELTA_EX_1 "" UWORD _CNV_A_R_LINEAR_____243_CM 1 100. 0. 95.99850000000001 ECU_ADDRESS 0x3fc9a4 /end MEASUREMENT
/begin MEASUREMENT LV_ADJ_POS_IVVT_EX_1 "" UBYTE _CNV_A_R_LINEAR_____10_CM 1 100. 0. 1. ECU_ADDRESS 0x3fc925 FORMAT "%1.0" /end MEASUREMENT
/begin MEASUREMENT LV_ADJ_CHG_DIR_IVVT_EX_1 "" UBYTE _CNV_A_R_LINEAR_____10_CM 1 100. 0. 1. ECU_ADDRESS 0x3fc924 FORMAT "%1.0" /end MEASUREMENT
/begin MEASUREMENT LV_HLD_REQ_IVVT_EX_1 "" UBYTE _CNV_A_R_LINEAR_____10_CM 1 100. 0. 1. ECU_ADDRESS 0x3fc934 FORMAT "%1.0" /end MEASUREMENT
/begin MEASUREMENT LV_MDL_ADC_IVVT_EX_1 "" UBYTE _CNV_A_R_LINEAR_____10_CM 1 100. 0. 1. ECU_ADDRESS 0x3fc977 FORMAT "%1.0" /end MEASUREMENT
/begin MEASUREMENT STATE_IVVT_ACT_EX_1 "" ULONG _CNV_S_5_STATE_IVVT_245_CM 1 100. 0. 4. ECU_ADDRESS 0x3fc928 /end MEASUREMENT
/begin MEASUREMENT STATE_IVVT_PWM_EX_1 "" ULONG _CNV_S_3_STATE_IVVT_244_CM 1 100. 0. 2. ECU_ADDRESS 0x3fc92c /end MEASUREMENT
/begin MEASUREMENT CAM_EX_1 "" UBYTE _CNV_A_R_LINEAR_____231_CM 1 100. -40. -135.625 ECU_ADDRESS 0x3fc900 FORMAT "%8.3" /end MEASUREMENT
/begin MEASUREMENT CAM_REF_IVVT_EX_1 "" UWORD _CNV_A_R_LINEAR_____249_CM 1 100. -40. -135.9985 ECU_ADDRESS 0x3fc904 FORMAT "%8.3" /end MEASUREMENT
/begin MEASUREMENT CAM_AD_IVVT_EX_1_0 "" SWORD _CNV_A_R_LINEAR_____246_CM 1 100. -48. 47.9985 ECU_ADDRESS 0x3fc906 FORMAT "%7.3" /end MEASUREMENT
/begin MEASUREMENT CAM_REF_DIF_IVVT_EX_1 "" SWORD _CNV_A_R_LINEAR_____75_CM 1 100. -95.625 95.625 ECU_ADDRESS 0x3fc90c FORMAT "%7.3" /end MEASUREMENT
/begin MEASUREMENT CAM_RAW_DYW_IVVT_EX_1 "" UBYTE _CNV_A_R_LINEAR_____231_CM 1 100. -40. -135.625 ECU_ADDRESS 0x3fc911 FORMAT "%8.3" /end MEASUREMENT
/begin MEASUREMENT LV_CAM_RAW_DYW_IVVT_EX_1 "" UBYTE _CNV_A_R_LINEAR_____10_CM 1 100. 0. 1. ECU_ADDRESS 0x3fc90e FORMAT "%1.0" /end MEASUREMENT
/begin MEASUREMENT CAM_REF_RAW_EX_1 "" UBYTE _CNV_A_R_LINEAR_____231_CM 1 100. -40. -135.625 ECU_ADDRESS 0x3fc912 FORMAT "%8.3" /end MEASUREMENT
/begin MEASUREMENT CAM_AD_IVVT_EX_1_1 "" SWORD _CNV_A_R_LINEAR_____246_CM 1 100. -48. 47.9985 ECU_ADDRESS 0x3fc908 FORMAT "%7.3" /end MEASUREMENT
/begin MEASUREMENT CAM_AD_IVVT_EX_1_2 "" SWORD _CNV_A_R_LINEAR_____246_CM 1 100. -48. 47.9985 ECU_ADDRESS 0x3fc90a FORMAT "%7.3" /end MEASUREMENT
/begin MEASUREMENT CAM_EX_PARK_1 "last valid exhaust cam position befor engine stop" UBYTE _CNV_A_R_LINEAR_____231_CM 1 100. -40. -135.625 ECU_ADDRESS 0x3fc913 FORMAT "%8.3" /end MEASUREMENT
/begin MEASUREMENT CTR_CAM_DIF_IVVT_PARK_EX_1 " Counter for too high deviation from setpoint in IVVT parking function" UWORD _CNV_A_R_LINEAR_____10_CM 1 100. 0. 65535. ECU_ADDRESS 0x3fc914 FORMAT "%5.0" /end MEASUREMENT
/begin MEASUREMENT CTR_CAM_DRIFT_IVVT_PARK_EX_1 "Counter for too high camshaft drift in IVVT parking function" UWORD _CNV_A_R_LINEAR_____10_CM 1 100. 0. 65535. ECU_ADDRESS 0x3fc916 FORMAT "%5.0" /end MEASUREMENT
/begin MEASUREMENT DLY_MES_ADC_IVVT_EX_1 "" UBYTE _CNV_A_R_LINEAR_____23_CM 1 100. 0. 2550. ECU_ADDRESS 0x3fc9bc FORMAT "%4.0" /end MEASUREMENT
/begin MEASUREMENT DLY_MES_RTD_IVVT_EX_1 "" UBYTE _CNV_A_R_LINEAR_____23_CM 1 100. 0. 2550. ECU_ADDRESS 0x3fc9bd FORMAT "%4.0" /end MEASUREMENT
/begin MEASUREMENT IVVTPWM_EX_1 "" UBYTE _CNV_A_R_LINEAR_____4_CM 1 100. 0. 99.609375 ECU_ADDRESS 0x3fc9da /end MEASUREMENT
/begin MEASUREMENT SUM_CYC_ADH_IVVT_EX_1 "" UWORD _CNV_A_R_LINEAR_____10_CM 1 100. 0. 6000. ECU_ADDRESS 0x3fc9cc FORMAT "%4.0" /end MEASUREMENT
/begin MEASUREMENT IVVTHPWM_ADH_EX_1 "" SBYTE _CNV_A_R_LINEAR_____4_CM 1 100. -50. 49.609375 ECU_ADDRESS 0x3fc9db FORMAT "%6.2" /end MEASUREMENT
/begin MEASUREMENT IVVTHPWM_ADH_SAVE_EX_1 "" SBYTE _CNV_A_R_LINEAR_____4_CM 1 100. -50. 49.609375 ECU_ADDRESS 0x3fc9dc FORMAT "%6.2" /end MEASUREMENT
/begin MEASUREMENT LV_ADH_ACT_IVVT_EX_1 "" UBYTE _CNV_A_R_LINEAR_____10_CM 1 100. 0. 1. ECU_ADDRESS 0x3fc9dd FORMAT "%1.0" /end MEASUREMENT
/begin MEASUREMENT LV_ADH_END_IVVT_EX_1 "" UBYTE _CNV_A_R_LINEAR_____10_CM 1 100. 0. 1. ECU_ADDRESS 0x3fc9de FORMAT "%1.0" /end MEASUREMENT
/begin MEASUREMENT SUM_STATE_ACT_ADJ_IVVT_EX_1 "" UBYTE _CNV_A_R_LINEAR_____10_CM 1 100. 0. 255. ECU_ADDRESS 0x3fc9df FORMAT "%3.0" /end MEASUREMENT
/begin MEASUREMENT VEL_DRIFT_IVVTHPWM_EX_1 "" SWORD _CNV_A_R_LINEAR_____247_CM 1 100. -95.625 95.625 ECU_ADDRESS 0x3fc9ce FORMAT "%7.3" /end MEASUREMENT
/begin MEASUREMENT IVVTHPWM_AD_EX_1 "" UBYTE _CNV_A_R_LINEAR_____117_CM 1 100. -50. 49.609375 ECU_ADDRESS 0x3fc9e4 FORMAT "%6.2" /end MEASUREMENT
/begin MEASUREMENT CAM_EX_2 "" UBYTE _CNV_A_R_LINEAR_____231_CM 1 100. -40. -135.625 ECU_ADDRESS 0x3fc9f8 FORMAT "%8.3" /end MEASUREMENT
/begin MEASUREMENT CAM_REF_IVVT_EX_2 "" UWORD _CNV_A_R_LINEAR_____249_CM 1 100. -40. -135.9985 ECU_ADDRESS 0x3fc9fc FORMAT "%8.3" /end MEASUREMENT
/begin MEASUREMENT CAM_AD_IVVT_EX_2_0 "" SWORD _CNV_A_R_LINEAR_____246_CM 1 100. -48. 47.9985 ECU_ADDRESS 0x3fc9fe FORMAT "%7.3" /end MEASUREMENT
/begin MEASUREMENT CAM_REF_DIF_IVVT_EX_2 "" SWORD _CNV_A_R_LINEAR_____75_CM 1 100. -95.625 95.625 ECU_ADDRESS 0x3fca04 FORMAT "%7.3" /end MEASUREMENT
/begin MEASUREMENT LV_CAM_RAW_DYW_IVVT_EX_2 "" UBYTE _CNV_A_R_LINEAR_____10_CM 1 100. 0. 1. ECU_ADDRESS 0x3fca06 FORMAT "%1.0" /end MEASUREMENT
/begin MEASUREMENT CAM_RAW_DYW_IVVT_EX_2 "" UBYTE _CNV_A_R_LINEAR_____231_CM 1 100. -40. -135.625 ECU_ADDRESS 0x3fca09 FORMAT "%8.3" /end MEASUREMENT
/begin MEASUREMENT CAM_REF_RAW_EX_2 "" UBYTE _CNV_A_R_LINEAR_____231_CM 1 100. -40. -135.625 ECU_ADDRESS 0x3fca0a FORMAT "%8.3" /end MEASUREMENT
/begin MEASUREMENT CAM_AD_IVVT_EX_2_1 "" SWORD _CNV_A_R_LINEAR_____246_CM 1 100. -48. 47.9985 ECU_ADDRESS 0x3fca00 FORMAT "%7.3" /end MEASUREMENT
/begin MEASUREMENT CAM_AD_IVVT_EX_2_2 "" SWORD _CNV_A_R_LINEAR_____246_CM 1 100. -48. 47.9985 ECU_ADDRESS 0x3fca02 FORMAT "%7.3" /end MEASUREMENT
/begin MEASUREMENT CAM_EX_PARK_2 "last valid exhaust cam position befor engine stop" UBYTE _CNV_A_R_LINEAR_____231_CM 1 100. -40. -135.625 ECU_ADDRESS 0x3fca0b FORMAT "%8.3" /end MEASUREMENT
/begin MEASUREMENT CTR_CAM_DIF_IVVT_PARK_EX_2 " Counter for too high deviation from setpoint in IVVT parking function" UWORD _CNV_A_R_LINEAR_____10_CM 1 100. 0. 65535. ECU_ADDRESS 0x3fca0c FORMAT "%5.0" /end MEASUREMENT
/begin MEASUREMENT CTR_CAM_DRIFT_IVVT_PARK_EX_2 "Counter for too high camshaft drift in IVVT parking function" UWORD _CNV_A_R_LINEAR_____10_CM 1 100. 0. 65535. ECU_ADDRESS 0x3fca0e FORMAT "%5.0" /end MEASUREMENT
/begin MEASUREMENT DLY_MES_ADC_IVVT_EX_2 "" UBYTE _CNV_A_R_LINEAR_____23_CM 1 100. 0. 2550. ECU_ADDRESS 0x3fcab4 FORMAT "%4.0" /end MEASUREMENT
/begin MEASUREMENT DLY_MES_RTD_IVVT_EX_2 "" UBYTE _CNV_A_R_LINEAR_____23_CM 1 100. 0. 2550. ECU_ADDRESS 0x3fcab5 FORMAT "%4.0" /end MEASUREMENT
/begin MEASUREMENT IVVTPWM_EX_2 "" UBYTE _CNV_A_R_LINEAR_____4_CM 1 100. 0. 99.609375 ECU_ADDRESS 0x3fcad2 /end MEASUREMENT
/begin MEASUREMENT SUM_CYC_ADH_IVVT_EX_2 "" UWORD _CNV_A_R_LINEAR_____10_CM 1 100. 0. 6000. ECU_ADDRESS 0x3fcac4 FORMAT "%4.0" /end MEASUREMENT
/begin MEASUREMENT IVVTHPWM_ADH_EX_2 "" SBYTE _CNV_A_R_LINEAR_____4_CM 1 100. -50. 49.609375 ECU_ADDRESS 0x3fcad3 FORMAT "%6.2" /end MEASUREMENT
/begin MEASUREMENT IVVTHPWM_ADH_SAVE_EX_2 "" SBYTE _CNV_A_R_LINEAR_____4_CM 1 100. -50. 49.609375 ECU_ADDRESS 0x3fcad4 FORMAT "%6.2" /end MEASUREMENT
/begin MEASUREMENT LV_ADH_ACT_IVVT_EX_2 "" UBYTE _CNV_A_R_LINEAR_____10_CM 1 100. 0. 1. ECU_ADDRESS 0x3fcad5 FORMAT "%1.0" /end MEASUREMENT
/begin MEASUREMENT LV_ADH_END_IVVT_EX_2 "" UBYTE _CNV_A_R_LINEAR_____10_CM 1 100. 0. 1. ECU_ADDRESS 0x3fcad6 FORMAT "%1.0" /end MEASUREMENT
/begin MEASUREMENT SUM_STATE_ACT_ADJ_IVVT_EX_2 "" UBYTE _CNV_A_R_LINEAR_____10_CM 1 100. 0. 255. ECU_ADDRESS 0x3fcad7 FORMAT "%3.0" /end MEASUREMENT
/begin MEASUREMENT VEL_DRIFT_IVVTHPWM_EX_2 "" SWORD _CNV_A_R_LINEAR_____247_CM 1 100. -95.625 95.625 ECU_ADDRESS 0x3fcac6 FORMAT "%7.3" /end MEASUREMENT
/begin MEASUREMENT IVVTHPWM_AD_EX_2 "" UBYTE _CNV_A_R_LINEAR_____117_CM 1 100. -50. 49.609375 ECU_ADDRESS 0x3fcadc FORMAT "%6.2" /end MEASUREMENT
/begin MEASUREMENT CAM_SP_DIF_IVVT_EX_2 "" SWORD _CNV_A_R_LINEAR_____75_CM 1 100. -60. 60. ECU_ADDRESS 0x3fca18 FORMAT "%7.3" /end MEASUREMENT
/begin MEASUREMENT CAM_MDL_DLY_NOT_IVVT_EX_2 "" UWORD _CNV_A_R_LINEAR_____249_CM 1 100. -40. -135.9985 ECU_ADDRESS 0x3fca98 FORMAT "%8.3" /end MEASUREMENT
/begin MEASUREMENT CAM_MDL_IVVT_EX_2 "" UWORD _CNV_A_R_LINEAR_____249_CM 1 100. -40. -135.9985 ECU_ADDRESS 0x3fca9a FORMAT "%8.3" /end MEASUREMENT
/begin MEASUREMENT CAM_MDL_DIF_IVVT_EX_2 "" SWORD _CNV_A_R_LINEAR_____75_CM 1 100. -60. 60. ECU_ADDRESS 0x3fca32 FORMAT "%7.3" /end MEASUREMENT
/begin MEASUREMENT DLY_IVVT_EX_2 "" UBYTE _CNV_A_R_LINEAR_____23_CM 1 100. 0. 2550. ECU_ADDRESS 0x3fca74 FORMAT "%4.0" /end MEASUREMENT
/begin MEASUREMENT T_IVVT_EX_2 "" SWORD _CNV_A_R_LINEAR_____239_CM 1 100. -20480. 20479.375 ECU_ADDRESS 0x3fca2a FORMAT "%8.1" /end MEASUREMENT
/begin MEASUREMENT T_SUM_IVVT_EX_2 "" SWORD _CNV_A_R_LINEAR_____239_CM 1 100. -20480. 20479.375 ECU_ADDRESS 0x3fca28 FORMAT "%8.1" /end MEASUREMENT
/begin MEASUREMENT T_CTL_IVVT_EX_2 "" SWORD _CNV_A_R_LINEAR_____239_CM 1 100. -20480. 20479.375 ECU_ADDRESS 0x3fca34 FORMAT "%8.1" /end MEASUREMENT
/begin MEASUREMENT T_CTL_I_IVVT_EX_2 "" SWORD _CNV_A_R_LINEAR_____239_CM 1 100. -20480. 20479.375 ECU_ADDRESS 0x3fca36 FORMAT "%8.1" /end MEASUREMENT
/begin MEASUREMENT T_SLV_IVVT_EX_2 "" SWORD _CNV_A_R_LINEAR_____239_CM 1 100. -20480. 20479.375 ECU_ADDRESS 0x3fca72 FORMAT "%8.1" /end MEASUREMENT
/begin MEASUREMENT T_STOP_ADJ_IVVT_EX_2 "" ULONG _CNV_A_R_LINEAR_____242_CM 1 100. 0. 17179869180. ECU_ADDRESS 0x3fca8c FORMAT "%11.0" /end MEASUREMENT
/begin MEASUREMENT T_ACT_IVVT_EX_2 "" ULONG _CNV_A_R_LINEAR_____242_CM 1 100. 0. 17179869180. ECU_ADDRESS 0x3fca94 FORMAT "%11.0" /end MEASUREMENT
/begin MEASUREMENT T_CTL_I_LIM_IVVT_EX_2 "" SWORD _CNV_A_R_LINEAR_____239_CM 1 100. -20480. 20479.375 ECU_ADDRESS 0x3fca38 FORMAT "%8.1" /end MEASUREMENT
/begin MEASUREMENT T_ST_ADJ_IVVT_EX_2 "" ULONG _CNV_A_R_LINEAR_____242_CM 1 100. 0. 17179869180. ECU_ADDRESS 0x3fca90 FORMAT "%11.0" /end MEASUREMENT
/begin MEASUREMENT T_ADJ_OLD_IVVT_EX_2 "" UWORD _CNV_A_R_LINEAR_____239_CM 1 100. 0. 40959.375 ECU_ADDRESS 0x3fca86 FORMAT "%7.1" /end MEASUREMENT
/begin MEASUREMENT T_LIM_IVVT_EX_2 "" SWORD _CNV_A_R_LINEAR_____239_CM 1 100. -20480. 20479.375 ECU_ADDRESS 0x3fca76 FORMAT "%8.1" /end MEASUREMENT
/begin MEASUREMENT T_CTL_I_LIM_1_IVVT_EX_2 "" SWORD _CNV_A_R_LINEAR_____239_CM 1 100. -20480. 20479.375 ECU_ADDRESS 0x3fca3a FORMAT "%8.1" /end MEASUREMENT
/begin MEASUREMENT T_SUM_TMP_IVVT_EX_2 "" SWORD _CNV_A_R_LINEAR_____239_CM 1 100. -20480. 20479.375 ECU_ADDRESS 0x3fca82 FORMAT "%8.1" /end MEASUREMENT
/begin MEASUREMENT T_SUM_SUBT_IVVT_EX_2 "" UWORD _CNV_A_R_LINEAR_____239_CM 1 100. 0. 40959.375 ECU_ADDRESS 0x3fca78 FORMAT "%7.1" /end MEASUREMENT
/begin MEASUREMENT T_ADJ_NEW_IVVT_EX_2 "" UWORD _CNV_A_R_LINEAR_____239_CM 1 100. 0. 40959.375 ECU_ADDRESS 0x3fca84 FORMAT "%7.1" /end MEASUREMENT
/begin MEASUREMENT T_SUM_IF_IVVT_EX_2 "" UWORD _CNV_A_R_LINEAR_____242_CM 1 100. 0. 262140. ECU_ADDRESS 0x3fca2e FORMAT "%6.0" /end MEASUREMENT
/begin MEASUREMENT CAM_DIF_IVVT_EX_2 "" SWORD _CNV_A_R_LINEAR_____75_CM 1 100. -60. 60. ECU_ADDRESS 0x3fca1a FORMAT "%7.3" /end MEASUREMENT
/begin MEASUREMENT CAM_CLC_DELTA_EX_2 "" UWORD _CNV_A_R_LINEAR_____243_CM 1 100. 0. 95.99850000000001 ECU_ADDRESS 0x3fca9c /end MEASUREMENT
/begin MEASUREMENT LV_ADJ_POS_IVVT_EX_2 "" UBYTE _CNV_A_R_LINEAR_____10_CM 1 100. 0. 1. ECU_ADDRESS 0x3fca1d FORMAT "%1.0" /end MEASUREMENT
/begin MEASUREMENT LV_ADJ_CHG_DIR_IVVT_EX_2 "" UBYTE _CNV_A_R_LINEAR_____10_CM 1 100. 0. 1. ECU_ADDRESS 0x3fca1c FORMAT "%1.0" /end MEASUREMENT
/begin MEASUREMENT LV_HLD_REQ_IVVT_EX_2 "" UBYTE _CNV_A_R_LINEAR_____10_CM 1 100. 0. 1. ECU_ADDRESS 0x3fca2c FORMAT "%1.0" /end MEASUREMENT
/begin MEASUREMENT LV_MDL_ADC_IVVT_EX_2 "" UBYTE _CNV_A_R_LINEAR_____10_CM 1 100. 0. 1. ECU_ADDRESS 0x3fca6f FORMAT "%1.0" /end MEASUREMENT
/begin MEASUREMENT STATE_IVVT_ACT_EX_2 "" ULONG _CNV_S_5_STATE_IVVT_245_CM 1 100. 0. 4. ECU_ADDRESS 0x3fca20 /end MEASUREMENT
/begin MEASUREMENT STATE_IVVT_PWM_EX_2 "" ULONG _CNV_S_3_STATE_IVVT_244_CM 1 100. 0. 2. ECU_ADDRESS 0x3fca24 /end MEASUREMENT
/begin MEASUREMENT DLY_ADC_IVVT_EX "" UBYTE _CNV_A_R_LINEAR_____23_CM 1 100. 0. 2550. ECU_ADDRESS 0x3fcb04 FORMAT "%4.0" /end MEASUREMENT
/begin MEASUREMENT DLY_RTD_IVVT_EX "" UBYTE _CNV_A_R_LINEAR_____23_CM 1 100. 0. 2550. ECU_ADDRESS 0x3fcb05 FORMAT "%4.0" /end MEASUREMENT
/begin MEASUREMENT CAM_SP_DYW_IVVT_EX "" UBYTE _CNV_A_R_LINEAR_____231_CM 1 100. -40. -135.625 ECU_ADDRESS 0x3fcb02 FORMAT "%8.3" /end MEASUREMENT
/begin MEASUREMENT LV_CAM_SP_DYW_IVVT_EX "" UBYTE _CNV_A_R_LINEAR_____10_CM 1 100. 0. 1. ECU_ADDRESS 0x3fcb03 FORMAT "%1.0" /end MEASUREMENT
/begin CHARACTERISTIC IP_FAC_IVVTPWM "" CURVE 0x4e1d2 _REC_CUR_20_u1_u1 1.9921875 _CNV_A_R_LINEAR_____103_CM 0. 1.9921875 FORMAT "%5.3"
 /begin AXIS_DESCR COM_AXIS VB _CNV_A_R_LINEAR_____53_CM 3 0. 26. FORMAT "%4.1" AXIS_PTS_REF ldp_vb__fac_ivvtpwm /end AXIS_DESCR
/end CHARACTERISTIC
/begin CHARACTERISTIC IP_IVVTHPWM "" MAP 0x4f824 _REC_MAP_20_u1_u1_u1 99.609375 _CNV_A_R_LINEAR_____4_CM 0. 99.609375
 /begin AXIS_DESCR COM_AXIS TMAG_IVVT _CNV_A_R_LINEAR_____3_CM 12 -40. 160. FORMAT "%3.0" AXIS_PTS_REF ldpm_tmag_ivvt_1_ivvt /end AXIS_DESCR
 /begin AXIS_DESCR COM_AXIS VB _CNV_A_R_LINEAR_____53_CM 4 0. 26. FORMAT "%4.1" AXIS_PTS_REF ldp_vb_ip_ivvthpwm /end AXIS_DESCR
/end CHARACTERISTIC
/begin CHARACTERISTIC C_IVVTPWM_AD_OFS_EX "" VALUE 0x4334e _REC_VAL_20_s1 99.609375 _CNV_A_R_LINEAR_____4_CM -50. 49.609375 FORMAT "%6.2" /end CHARACTERISTIC
/begin CHARACTERISTIC C_IVVTPWM_ADC_EX "" VALUE 0x428ef _REC_VAL_20_u1 99.609375 _CNV_A_R_LINEAR_____4_CM 0. 99.609375 /end CHARACTERISTIC
/begin CHARACTERISTIC C_IVVTPWM_ADC_IN "" VALUE 0x428f0 _REC_VAL_20_u1 99.609375 _CNV_A_R_LINEAR_____4_CM 0. 99.609375 /end CHARACTERISTIC
/begin CHARACTERISTIC C_IVVTPWM_RTD_EX "" VALUE 0x428f1 _REC_VAL_20_u1 99.609375 _CNV_A_R_LINEAR_____4_CM 0. 99.609375 /end CHARACTERISTIC
/begin CHARACTERISTIC C_IVVTPWM_RTD_IN "" VALUE 0x428f2 _REC_VAL_20_u1 99.609375 _CNV_A_R_LINEAR_____4_CM 0. 99.609375 /end CHARACTERISTIC
/begin CHARACTERISTIC C_CAM_HYS_ADH_IVVT "" VALUE 0x427fe _REC_VAL_20_u1 60. _CNV_A_R_LINEAR_____75_CM 0. 60. /end CHARACTERISTIC
/begin CHARACTERISTIC C_CAM_HYS_RST_ADH_IVVT "" VALUE 0x42800 _REC_VAL_20_u1 60. _CNV_A_R_LINEAR_____75_CM 0. 60. /end CHARACTERISTIC
/begin CHARACTERISTIC C_CAM_SP_DIF_ADH_IVVT "" VALUE 0x42807 _REC_VAL_20_u1 60. _CNV_A_R_LINEAR_____75_CM 0. 60. /end CHARACTERISTIC
/begin CHARACTERISTIC C_CYC_MAX_ADH_IVVT "" VALUE 0x42874 _REC_VAL_20_u1 255. _CNV_A_R_LINEAR_____10_CM 0. 255. FORMAT "%3.0" /end CHARACTERISTIC
/begin CHARACTERISTIC C_SUM_SEG_DLY_IVVTHPWM "" VALUE 0x429b2 _REC_VAL_20_u1 254. _CNV_A_R_LINEAR_____10_CM 1. 255. FORMAT "%3.0" /end CHARACTERISTIC
/begin MEASUREMENT T_DLY_MES_IVVT "" UWORD _CNV_A_R_LINEAR_____23_CM 1 100. 0. 655350. ECU_ADDRESS 0x3fcb08 FORMAT "%6.0" /end MEASUREMENT
/begin CHARACTERISTIC C_IVVTHPWM_AD_MIN "" VALUE 0x428ee _REC_VAL_20_u1 99.609375 _CNV_A_R_LINEAR_____117_CM -50. 49.609375 FORMAT "%6.2" /end CHARACTERISTIC
/begin CHARACTERISTIC C_IVVTHPWM_AD_MAX "" VALUE 0x428ed _REC_VAL_20_u1 99.609375 _CNV_A_R_LINEAR_____117_CM -50. 49.609375 FORMAT "%6.2" /end CHARACTERISTIC
/begin CHARACTERISTIC IP_CYC_MIN_ADH_IVVT "" CURVE 0x46428 _REC_CUR_20_u2_u1 6000. _CNV_A_R_LINEAR_____10_CM 0. 6000. FORMAT "%4.0"
 /begin AXIS_DESCR COM_AXIS N_32 _CNV_A_R_LINEAR_____5_CM 4 0. 8160. FORMAT "%4.0" AXIS_PTS_REF ldpm_n_32_1_ivvt /end AXIS_DESCR
/end CHARACTERISTIC
/begin CHARACTERISTIC IP_IVVTHPWM_ADH "" CURVE 0x4f854 _REC_CUR_20_u1_u2 49.609375 _CNV_A_R_LINEAR_____4_CM 0. 49.609375
 /begin AXIS_DESCR COM_AXIS ONLINE_DUMMY _CNV_A_R_LINEAR_____251_CM 5 -60. 60. FORMAT "%7.3" AXIS_PTS_REF ldpm_cam_dif_ivvt /end AXIS_DESCR
/end CHARACTERISTIC
/begin CHARACTERISTIC IP_IVVTHPWM_ADH_CYC_IN "" CURVE 0x4f85e _REC_CUR_20_u1_u2 255. _CNV_A_R_LINEAR_____10_CM 0. 255. FORMAT "%3.0"
 /begin AXIS_DESCR COM_AXIS ONLINE_DUMMY _CNV_A_R_LINEAR_____251_CM 5 -60. 60. FORMAT "%7.3" AXIS_PTS_REF ldpm_cam_dif_ivvt /end AXIS_DESCR
/end CHARACTERISTIC
/begin CHARACTERISTIC IP_IVVTHPWM_ADH_CYC_EX "" CURVE 0x4f859 _REC_CUR_20_u1_u2 255. _CNV_A_R_LINEAR_____10_CM 0. 255. FORMAT "%3.0"
 /begin AXIS_DESCR COM_AXIS ONLINE_DUMMY _CNV_A_R_LINEAR_____251_CM 5 -60. 60. FORMAT "%7.3" AXIS_PTS_REF ldpm_cam_dif_ivvt /end AXIS_DESCR
/end CHARACTERISTIC
/begin CHARACTERISTIC ID_IVVTHPWM_COR_AD "" MAP 0x4cd64 _REC_MAP_20_u1_u1_u2 49.609375 _CNV_A_R_LINEAR_____4_CM 0. 49.609375
 /begin AXIS_DESCR COM_AXIS ONLINE_DUMMY _CNV_A_R_LINEAR_____247_CM 6 0. 95.625 FORMAT "%5.2" AXIS_PTS_REF ldp_vel_drift_ip_ivvthpwm_cor /end AXIS_DESCR
 /begin AXIS_DESCR COM_AXIS ONLINE_DUMMY _CNV_A_R_LINEAR_____252_CM 6 0. 65535. FORMAT "%5.0" AXIS_PTS_REF ldp_t_drift_ivvthpwm /end AXIS_DESCR
/end CHARACTERISTIC
/begin AXIS_PTS ldp_vb__fac_ivvtpwm "" 0x43ab0 VB _REC_AXS_20_u1 26. _CNV_A_R_LINEAR_____53_CM 3 0. 26. FORMAT "%4.1" /end AXIS_PTS
/begin AXIS_PTS ldp_vb_ip_ivvthpwm "" 0x43aef VB _REC_AXS_20_u1 26. _CNV_A_R_LINEAR_____53_CM 4 0. 26. FORMAT "%4.1" /end AXIS_PTS
/begin AXIS_PTS ldpm_cam_dif_ivvt "" 0x44e9c CAM_DIF_IVVT _REC_AXS_20_u2 120. _CNV_A_R_LINEAR_____251_CM 5 -60. 60. FORMAT "%7.3" /end AXIS_PTS
/begin AXIS_PTS ldp_vel_drift_ip_ivvthpwm_cor "" 0x43afd VEL_DRIFT _REC_AXS_20_u1 95.625 _CNV_A_R_LINEAR_____247_CM 6 0. 95.625 FORMAT "%5.2" /end AXIS_PTS
/begin AXIS_PTS ldp_t_drift_ivvthpwm "" 0x44a88 T_DRIFT _REC_AXS_20_u2 65535. _CNV_A_R_LINEAR_____252_CM 6 0. 65535. FORMAT "%5.0" /end AXIS_PTS
/begin CHARACTERISTIC IP_TMAG_IVVT "" MAP 0x50c3d _REC_MAP_20_u1_u1_u1 200. _CNV_A_R_LINEAR_____3_CM -40. 160. FORMAT "%3.0"
 /begin AXIS_DESCR COM_AXIS TOIL _CNV_A_R_LINEAR_____3_CM 10 -40. 160. FORMAT "%3.0" AXIS_PTS_REF ldp_toil_ip_tmag_ivvt /end AXIS_DESCR
 /begin AXIS_DESCR COM_AXIS TCO _CNV_A_R_LINEAR_____0_CM 10 -48. 142.5 FORMAT "%6.2" AXIS_PTS_REF ldp_tco_ip_tmag_ivvt /end AXIS_DESCR
/end CHARACTERISTIC
/begin MEASUREMENT TMAG_IVVT "" UBYTE _CNV_A_R_LINEAR_____3_CM 1 100. -40. 160. ECU_ADDRESS 0x3fcb17 FORMAT "%3.0" /end MEASUREMENT
/begin AXIS_PTS ldp_tco_ip_tmag_ivvt "" 0x43927 TCO _REC_AXS_20_u1 190.5 _CNV_A_R_LINEAR_____0_CM 10 -48. 142.5 FORMAT "%6.2" /end AXIS_PTS
/begin AXIS_PTS ldp_toil_ip_tmag_ivvt "" 0x43a2e TOIL _REC_AXS_20_u1 200. _CNV_A_R_LINEAR_____3_CM 10 -40. 160. FORMAT "%3.0" /end AXIS_PTS
/begin CHARACTERISTIC CRENGOF "Offset für Strombedarf Motor" VALUE 0x5a150 _REC_VAL_20_u1 127. _CNV_R_R_i_vvt_ub_q_476_CM -63.5 63.5 FORMAT "%8.4" /end CHARACTERISTIC
/begin CHARACTERISTIC CRVVTOF "Stromoffset VVT" VALUE 0x5a152 _REC_VAL_20_u1 64. _CNV_R_R_i_vvt_ub_q_476_CM 0. 64. FORMAT "%8.4" /end CHARACTERISTIC
/begin CHARACTERISTIC KFELUPWM "Strom E-Lüfter über pwm und ub" MAP 0x5a094 _REC_MAP_52_u2_u2_u2 64. _CNV_R_R_i_eluft_q0_477_CM 0. 64. FORMAT "%8.4"
 /begin AXIS_DESCR STD_AXIS taml_tmp _CNV_R_R_rel_ub_b10_478_CM 7 0. 100. FORMAT "%8.4" /end AXIS_DESCR
 /begin AXIS_DESCR STD_AXIS ub_tmp _CNV_A_R_spg_ubatt_479_CM 7 0. 24.021 FORMAT "%8.4" /end AXIS_DESCR
/end CHARACTERISTIC
/begin CHARACTERISTIC KLELTEMP "Temperaturfaktor Elüfter" CURVE 0x5a116 _REC_CUR_52_u2_u2 1.9921875 _CNV_A_R_fak_ub_b2_480_CM 0. 1.9921875 FORMAT "%8.4"
 /begin AXIS_DESCR STD_AXIS tans_tmp _CNV_R_R_temp_uw_q0_481_CM 6 -48. 143.25 FORMAT "%8.4" /end AXIS_DESCR
/end CHARACTERISTIC
/begin CHARACTERISTIC CRVVTNOT "Wert vvt_iges bei vvt_es Fehlersignal" VALUE 0x5a151 _REC_VAL_20_u1 127.5 _CNV_R_R_i_vvt_ub_q_476_CM -63.5 64. FORMAT "%8.4" /end CHARACTERISTIC
/begin CHARACTERISTIC KLELSLP "Kennlinie E-Lüfter Strom" CURVE 0x5a146 _REC_CUR_52_UBYTE_u2_u1 255. _CNV_R_R_i_eluft_q0_477_CM 0. 255. FORMAT "%8.4"
 /begin AXIS_DESCR STD_AXIS ub_tmp _CNV_A_R_spg_ubatt_479_CM 3 0. 24.021 FORMAT "%8.4" /end AXIS_DESCR
/end CHARACTERISTIC
/begin MEASUREMENT FAKTUBEL "Faktor Lüfterstrom aus Geschwindigkeit" UWORD _CNV_A_R_fak_ub_b2_480_CM 1 100. 0. 1.9921875 ECU_ADDRESS 0x3fb132 FORMAT "%8.4" /end MEASUREMENT
/begin MEASUREMENT I_ELUVFZG "Lüfterstrom ohne Geschwindigkeitseinfluss" UWORD _CNV_R_R_i_eluft_q0_477_CM 1 100. 0. 128. ECU_ADDRESS 0x3fb138 FORMAT "%8.4" /end MEASUREMENT
/begin MEASUREMENT VFZG_TMP "temp. Fahrzeuggeschwindigkeit" UWORD _CNV_R_R_vfzg_ub_q1_482_CM 1 100. 0. 318.75 ECU_ADDRESS 0x3fb144 FORMAT "%8.4" /end MEASUREMENT
/begin CHARACTERISTIC KLELUB "Kennlinie für Batteriespannungskorrektur E-lüfter" CURVE 0x5a130 _REC_CUR_52_u2_u2 1.9921875 _CNV_A_R_fak_ub_b2_480_CM 0. 1.9921875 FORMAT "%8.4"
 /begin AXIS_DESCR STD_AXIS ub_tmp _CNV_A_R_spg_ubatt_479_CM 5 0. 24.021 FORMAT "%8.4" /end AXIS_DESCR
/end CHARACTERISTIC
/begin CHARACTERISTIC DFRUTYP "DF-Rückschaltungstyp für LLR-Anhebung" VALUE 0x5a3e3 _REC_VAL_20_u1 255. _CNV_A_R_LINEAR_____12_CM 0. 255. FORMAT "%8.4" /end CHARACTERISTIC
/begin CHARACTERISTIC IGENLLRANH "Generatorstromabstand für LL-Anhebung" VALUE 0x5a3e4 _REC_VAL_20_u1 254. _CNV_R_R_igen_ub_q1_483_CM 0. 254. FORMAT "%8.4" /end CHARACTERISTIC
/begin CHARACTERISTIC LLRABS_DF "DF-Schwelle für LL-Absenkung" VALUE 0x5a3e5 _REC_VAL_20_u1 99.609375 _CNV_A_R_PCENT_484_CM 0. 99.609375 FORMAT "%8.4" /end CHARACTERISTIC
/begin CHARACTERISTIC LLRANH_DF "DF-Schwelle für LL-Anhebung" VALUE 0x5a3e6 _REC_VAL_20_u1 99.609375 _CNV_A_R_PCENT_484_CM 0. 99.609375 FORMAT "%8.4" /end CHARACTERISTIC
/begin CHARACTERISTIC NTWBGLLGEN "Notlaufwert Leerlaufanhebung bei Generatorfehler" VALUE 0x5a3e7 _REC_VAL_20_u1 1. _CNV_A_R_LINEAR_____12_CM 0. 1. FORMAT "%8.4" /end CHARACTERISTIC
/begin CHARACTERISTIC PRELLDFAH "Prellzeit für LLR-Anhebung" VALUE 0x5a3e8 _REC_VAL_20_u1 25.5 _CNV_R_R_t100msxs_u_485_CM 0. 25.5 FORMAT "%8.4" /end CHARACTERISTIC
/begin CHARACTERISTIC PRELLDFRF "Prellzeit für LLR-Absenkung" VALUE 0x5a3e9 _REC_VAL_20_u1 25.5 _CNV_R_R_t100msxs_u_485_CM 0. 25.5 FORMAT "%8.4" /end CHARACTERISTIC
/begin CHARACTERISTIC KFDFIGEN0 "inv. Generator-DF-Ausgang" MAP 0x5a153 _REC_MAP_52_u1_u1_u1 99.609375 _CNV_A_R_PCENT_484_CM 0. 99.609375 FORMAT "%8.4"
 /begin AXIS_DESCR STD_AXIS NO_INPUT_QUANTITY _CNV_R_R_igen_ub_q1_483_CM 8 0. 255. FORMAT "%8.4" /end AXIS_DESCR
 /begin AXIS_DESCR STD_AXIS NO_INPUT_QUANTITY _CNV_R_R_igen_ub_q1_483_CM 8 0. 255. FORMAT "%8.4" /end AXIS_DESCR
/end CHARACTERISTIC
/begin CHARACTERISTIC KFDFIGEN1 "inv. Generator-DF-Ausgang" MAP 0x5a1a5 _REC_MAP_52_u1_u1_u1 99.609375 _CNV_A_R_PCENT_484_CM 0. 99.609375 FORMAT "%8.4"
 /begin AXIS_DESCR STD_AXIS NO_INPUT_QUANTITY _CNV_R_R_igen_ub_q1_483_CM 8 0. 255. FORMAT "%8.4" /end AXIS_DESCR
 /begin AXIS_DESCR STD_AXIS NO_INPUT_QUANTITY _CNV_R_R_igen_ub_q1_483_CM 8 0. 255. FORMAT "%8.4" /end AXIS_DESCR
/end CHARACTERISTIC
/begin CHARACTERISTIC KFDFIGEN2 "inv. Generator-DF-Ausgang" MAP 0x5a1f7 _REC_MAP_52_u1_u1_u1 99.609375 _CNV_A_R_PCENT_484_CM 0. 99.609375 FORMAT "%8.4"
 /begin AXIS_DESCR STD_AXIS NO_INPUT_QUANTITY _CNV_R_R_igen_ub_q1_483_CM 8 0. 255. FORMAT "%8.4" /end AXIS_DESCR
 /begin AXIS_DESCR STD_AXIS NO_INPUT_QUANTITY _CNV_R_R_igen_ub_q1_483_CM 8 0. 255. FORMAT "%8.4" /end AXIS_DESCR
/end CHARACTERISTIC
/begin CHARACTERISTIC KFDFIGEN3 "inv. Generator-DF-Ausgang" MAP 0x5a249 _REC_MAP_52_u1_u1_u1 99.609375 _CNV_A_R_PCENT_484_CM 0. 99.609375 FORMAT "%8.4"
 /begin AXIS_DESCR STD_AXIS NO_INPUT_QUANTITY _CNV_R_R_igen_ub_q1_483_CM 8 0. 255. FORMAT "%8.4" /end AXIS_DESCR
 /begin AXIS_DESCR STD_AXIS NO_INPUT_QUANTITY _CNV_R_R_igen_ub_q1_483_CM 8 0. 255. FORMAT "%8.4" /end AXIS_DESCR
/end CHARACTERISTIC
/begin CHARACTERISTIC KFDFIGEN4 "inv. Generator-DF-Ausgang" MAP 0x5a29b _REC_MAP_52_u1_u1_u1 99.609375 _CNV_A_R_PCENT_484_CM 0. 99.609375 FORMAT "%8.4"
 /begin AXIS_DESCR STD_AXIS NO_INPUT_QUANTITY _CNV_R_R_igen_ub_q1_483_CM 8 0. 255. FORMAT "%8.4" /end AXIS_DESCR
 /begin AXIS_DESCR STD_AXIS NO_INPUT_QUANTITY _CNV_R_R_igen_ub_q1_483_CM 8 0. 255. FORMAT "%8.4" /end AXIS_DESCR
/end CHARACTERISTIC
/begin CHARACTERISTIC KFDFIGEN5 "inv. Generator-DF-Ausgang" MAP 0x5a2ed _REC_MAP_52_u1_u1_u1 99.609375 _CNV_A_R_PCENT_484_CM 0. 99.609375 FORMAT "%8.4"
 /begin AXIS_DESCR STD_AXIS NO_INPUT_QUANTITY _CNV_R_R_igen_ub_q1_483_CM 8 0. 255. FORMAT "%8.4" /end AXIS_DESCR
 /begin AXIS_DESCR STD_AXIS NO_INPUT_QUANTITY _CNV_R_R_igen_ub_q1_483_CM 8 0. 255. FORMAT "%8.4" /end AXIS_DESCR
/end CHARACTERISTIC
/begin CHARACTERISTIC KFDFIGEN6 "inv. Generator-DF-Ausgang" MAP 0x5a33f _REC_MAP_52_u1_u1_u1 99.609375 _CNV_A_R_PCENT_484_CM 0. 99.609375 FORMAT "%8.4"
 /begin AXIS_DESCR STD_AXIS NO_INPUT_QUANTITY _CNV_R_R_igen_ub_q1_483_CM 8 0. 255. FORMAT "%8.4" /end AXIS_DESCR
 /begin AXIS_DESCR STD_AXIS NO_INPUT_QUANTITY _CNV_R_R_igen_ub_q1_483_CM 8 0. 255. FORMAT "%8.4" /end AXIS_DESCR
/end CHARACTERISTIC
/begin CHARACTERISTIC KFDFIGEN7 "inv. Generator-DF-Ausgang" MAP 0x5a391 _REC_MAP_52_u1_u1_u1 99.609375 _CNV_A_R_PCENT_484_CM 0. 99.609375 FORMAT "%8.4"
 /begin AXIS_DESCR STD_AXIS NO_INPUT_QUANTITY _CNV_R_R_igen_ub_q1_483_CM 8 0. 255. FORMAT "%8.4" /end AXIS_DESCR
 /begin AXIS_DESCR STD_AXIS NO_INPUT_QUANTITY _CNV_R_R_igen_ub_q1_483_CM 8 0. 255. FORMAT "%8.4" /end AXIS_DESCR
/end CHARACTERISTIC
/begin CHARACTERISTIC GEN_DNMIN "" VALUE 0x5a3ea _REC_VAL_20_u2 16383.75 _CNV_A_R_LINEAR_____486_CM 0. 16383.75 FORMAT "%8.2" /end CHARACTERISTIC
/begin CHARACTERISTIC GENPDTIME "" VALUE 0x5a3ee _REC_VAL_20_u1 25500. _CNV_A_R_LINEAR_____487_CM 0. 25500. FORMAT "%5.0" /end CHARACTERISTIC
/begin CHARACTERISTIC GFBSUTERR "Entprellzeit Fehlereintrag Kommunikation unplausibel" VALUE 0x5a3ef _REC_VAL_20_u1 25.5 _CNV_R_R_t100msxs_u_485_CM 0. 25.5 FORMAT "%8.4" /end CHARACTERISTIC
/begin CHARACTERISTIC GFBSUTHEAL "Entprellzeit Fehlerheilung Kommunikation unplausibel" VALUE 0x5a3f0 _REC_VAL_20_u1 25.5 _CNV_R_R_t100msxs_u_485_CM 0. 25.5 FORMAT "%8.4" /end CHARACTERISTIC
/begin CHARACTERISTIC GFELTERR "Entprellzeit Fehlereintrag elekt. Fehler" VALUE 0x5a3f1 _REC_VAL_20_u1 25.5 _CNV_R_R_t100msxs_u_485_CM 0. 25.5 FORMAT "%8.4" /end CHARACTERISTIC
/begin CHARACTERISTIC GFELTHEAL "Entprellzeit Fehlerheilung elekt. Fehler" VALUE 0x5a3f2 _REC_VAL_20_u1 25.5 _CNV_R_R_t100msxs_u_485_CM 0. 25.5 FORMAT "%8.4" /end CHARACTERISTIC
/begin CHARACTERISTIC GFHTTERR "Entprellzeit Fehlereintrag Ueberhitzung" VALUE 0x5a3f3 _REC_VAL_20_u1 25.5 _CNV_R_R_t100msxs_u_485_CM 0. 25.5 FORMAT "%8.4" /end CHARACTERISTIC
/begin CHARACTERISTIC GFHTTHEAL "Entprellzeit Fehlerheilung Ueberhitzung" VALUE 0x5a3f4 _REC_VAL_20_u1 25.5 _CNV_R_R_t100msxs_u_485_CM 0. 25.5 FORMAT "%8.4" /end CHARACTERISTIC
/begin CHARACTERISTIC GFMETERR "Entprellzeit Fehlereintrag mechanischer Fehler" VALUE 0x5a3f5 _REC_VAL_20_u1 25.5 _CNV_R_R_t100msxs_u_485_CM 0. 25.5 FORMAT "%8.4" /end CHARACTERISTIC
/begin CHARACTERISTIC GFMETHEAL "Entprellzeit Fehlerheilung mechanischer Fehler" VALUE 0x5a3f6 _REC_VAL_20_u1 25.5 _CNV_R_R_t100msxs_u_485_CM 0. 25.5 FORMAT "%8.4" /end CHARACTERISTIC
/begin CHARACTERISTIC GFNOBTERR "Entprellzeit Fehlereintrag f. keine Kommunikation" VALUE 0x5a3f7 _REC_VAL_20_u1 25.5 _CNV_R_R_t100msxs_u_485_CM 0. 25.5 FORMAT "%8.4" /end CHARACTERISTIC
/begin CHARACTERISTIC GFNOBTHEAL "Entprellzeit Fehlerheilung f. keine Kommunikation" VALUE 0x5a3f8 _REC_VAL_20_u1 25.5 _CNV_R_R_t100msxs_u_485_CM 0. 25.5 FORMAT "%8.4" /end CHARACTERISTIC
/begin CHARACTERISTIC MSKGENDFP "Bitmaske Generator Fehler-> DFP" VALUE 0x5a3f9 _REC_VAL_20_u1 255. _CNV_A_R_LINEAR_____12_CM 0. 255. FORMAT "%8.4" /end CHARACTERISTIC
/begin CHARACTERISTIC MSKGENKL61 "Bitmaske fuer Generatorfehler -> Ladekontrolle" VALUE 0x5a3fa _REC_VAL_20_u1 255. _CNV_A_R_LINEAR_____12_CM 0. 255. FORMAT "%8.4" /end CHARACTERISTIC
/begin CHARACTERISTIC SNMBSDKL61 "Generatornotmotordrehzalschwelle KL61-Unterdrueckung" VALUE 0x5a3ec _REC_VAL_20_u2 16383.75 _CNV_R_R_nmot_uw_q0_488_CM 0. 16383.75 FORMAT "%8.4" /end CHARACTERISTIC
/begin CHARACTERISTIC EN_MDGEN "Enable Generatormomenteinrechung" VALUE 0x5b4c3 _REC_VAL_20_u1 0. _CNV_R_R_igen_ub_q1_483_CM 0. 255. FORMAT "%8.4" /end CHARACTERISTIC
/begin CHARACTERISTIC GEN_IG_OF "Offsetwert Generatorstrom" VALUE 0x5b456 _REC_VAL_20_u2 0. _CNV_R_R_igen_uw_q0_508_CM 0. 254. FORMAT "%8.4" /end CHARACTERISTIC
/begin CHARACTERISTIC GENITYP "Generatorstrotyp 0=gerechnet / 1=gemessen" VALUE 0x5b4cc _REC_VAL_20_u1 0. _CNV_A_R_LINEAR_____12_CM 0. 1. FORMAT "%8.4" /end CHARACTERISTIC
/begin CHARACTERISTIC GENTEMPAPP "Geneeratortemperatur mauelle Vorgabe" VALUE 0x5b454 _REC_VAL_20_u2 0. _CNV_R_R_temp_uw_q0_481_CM -48. 336. FORMAT "%8.4" /end CHARACTERISTIC
/begin CHARACTERISTIC GENTEMPMAN "Manuelle Generatorvorgabe" VALUE 0x5b4d5 _REC_VAL_20_u1 0. _CNV_A_R_LINEAR_____12_CM 0. 255. FORMAT "%8.4" /end CHARACTERISTIC
/begin CHARACTERISTIC GENTYP "Generatortyp" VALUE 0x5b4df _REC_VAL_20_u1 0. _CNV_A_R_LINEAR_____12_CM 0. 255. FORMAT "%8.4" /end CHARACTERISTIC
/begin CHARACTERISTIC GENUMGTYP "Generatorluftumgebung" VALUE 0x5b4e8 _REC_VAL_20_u1 0. _CNV_A_R_LINEAR_____12_CM 0. 255. FORMAT "%8.4" /end CHARACTERISTIC
/begin CHARACTERISTIC TSTCNTEN "Enable TestCounter" VALUE 0x5b4f1 _REC_VAL_20_u1 0. _CNV_R_R_igen_ub_q1_483_CM 0. 1. FORMAT "%8.4" /end CHARACTERISTIC
/begin CHARACTERISTIC TSTFIL_IN "Testfilter Eingang" VALUE 0x5b458 _REC_VAL_20_u2 0. _CNV_R_R_gendt_q0p0_509_CM 0. 768. FORMAT "%8.4" /end CHARACTERISTIC
/begin CHARACTERISTIC TSTFIL_INI "Initialisierung Testfilter" VALUE 0x5b4f2 _REC_VAL_20_u1 0. _CNV_A_R_LINEAR_____12_CM 0. 255. FORMAT "%8.4" /end CHARACTERISTIC
/begin CHARACTERISTIC ZMGENIG "Zeitkonstante Generatorstrom" VALUE 0x5b45a _REC_VAL_20_u2 0. _CNV_R_R_genzmig_uw_510_CM 0. 1.9999695 FORMAT "%8.4" /end CHARACTERISTIC
/begin CHARACTERISTIC ZMTESTFIL "Zeitkonstante Testfilter" VALUE 0x5b4c0 _REC_VAL_20_u2 0. _CNV_R_R_genzmst_uw_511_CM 0. 0.99998474 FORMAT "%8.4" /end CHARACTERISTIC
/begin CHARACTERISTIC ENGENTANS "Schwelle Motortemperatur fuer Freigabe Generaturansaugluft " VALUE 0x5b4c2 _REC_VAL_20_u1 0. _CNV_R_R_temp_uw_q0_481_CM -48. 143.25 FORMAT "%8.4" /end CHARACTERISTIC
/begin CHARACTERISTIC GENTMOTDT "Offset Generatorwassertemperatur" VALUE 0x5b4d6 _REC_VAL_20_u1 0. _CNV_R_R_temp_uw_q0_481_CM -48. 143.25 FORMAT "%8.4" /end CHARACTERISTIC
/begin CHARACTERISTIC GENVFZGSW "geschwindigkeitsabhängige Generatoransaugluftschwelle" VALUE 0x5b4e9 _REC_VAL_20_u1 0. _CNV_R_R_vfzg_ub_q1_482_CM 0. 318.75 FORMAT "%8.4" /end CHARACTERISTIC
/begin CHARACTERISTIC KLIGENMESS "Transferfunktion I_Generator" CURVE 0x5b128 _REC_CUR_32_u2_u2 0. _CNV_R_R_fak_uw_b51_512_CM 0. 511.99219 FORMAT "%8.4"
 /begin AXIS_DESCR STD_AXIS igenmess _CNV_R_R_igen_ub_q1_483_CM 4 0. 1024. FORMAT "%8.4" /end AXIS_DESCR
/end CHARACTERISTIC
/begin CHARACTERISTIC KLRTHFAK0 "RTHfaktor ueber Generatorstrom" CURVE 0x5b2c2 _REC_CUR_32_u1_u1 0. _CNV_R_R_fak_ub_b4_513_CM 0. 3.984375 FORMAT "%8.4"
 /begin AXIS_DESCR STD_AXIS geni_end _CNV_R_R_igen_ub_q1_483_CM 11 0. 254. FORMAT "%8.4" /end AXIS_DESCR
/end CHARACTERISTIC
/begin CHARACTERISTIC PRELLGTMOT "Prellzeit für Tmot-Schwelle" VALUE 0x5b4ee _REC_VAL_20_u1 0. _CNV_R_R_igen_ub_q1_483_CM 0. 255. FORMAT "%8.4" /end CHARACTERISTIC
/begin CHARACTERISTIC ZMGENSTHZ0 "Zeitkonstante Generatorstator0 Aufheizung" VALUE 0x5b47c _REC_VAL_20_u2 0. _CNV_R_R_genzmst_uw_511_CM 0. 0.99998474 FORMAT "%8.4" /end CHARACTERISTIC
/begin CHARACTERISTIC ZMGENSTKL0 "Zeitkonstante Abkühlung Generator0" VALUE 0x5b48c _REC_VAL_20_u2 0. _CNV_R_R_genzmst_uw_511_CM 0. 0.99998474 FORMAT "%8.4" /end CHARACTERISTIC
/begin CHARACTERISTIC ZMGENTWA "Zeitkonstante Generatorstatorwasser" VALUE 0x5b49c _REC_VAL_20_u2 0. _CNV_R_R_genzmst_uw_511_CM 0. 0.99998474 FORMAT "%8.4" /end CHARACTERISTIC
/begin CHARACTERISTIC GENDIFAK0 "Stromfaktor Diode0" VALUE 0x5b4c4 _REC_VAL_20_u1 0. _CNV_R_R_fak_q0p003_514_CM 0. 0.99609375 FORMAT "%8.4" /end CHARACTERISTIC
/begin CHARACTERISTIC GENDIFAK1 "Stromfaktor Diode1" VALUE 0x5b4c5 _REC_VAL_20_u1 0. _CNV_R_R_fak_q0p003_514_CM 0. 0.99609375 FORMAT "%8.4" /end CHARACTERISTIC
/begin CHARACTERISTIC GENDIFAK2 "Stromfaktor Diode2" VALUE 0x5b4c6 _REC_VAL_20_u1 0. _CNV_R_R_fak_q0p003_514_CM 0. 0.99609375 FORMAT "%8.4" /end CHARACTERISTIC
/begin CHARACTERISTIC GENDIFAK3 "Stromfaktor Diode3" VALUE 0x5b4c7 _REC_VAL_20_u1 0. _CNV_R_R_fak_q0p003_514_CM 0. 0.99609375 FORMAT "%8.4" /end CHARACTERISTIC
/begin CHARACTERISTIC GENDIFAK4 "Stromfaktor Diode4" VALUE 0x5b4c8 _REC_VAL_20_u1 0. _CNV_R_R_fak_q0p003_514_CM 0. 0.99609375 FORMAT "%8.4" /end CHARACTERISTIC
/begin CHARACTERISTIC GENDIFAK5 "Stromfaktor Diode" VALUE 0x5b4c9 _REC_VAL_20_u1 0. _CNV_R_R_fak_q0p003_514_CM 0. 0.99609375 FORMAT "%8.4" /end CHARACTERISTIC
/begin CHARACTERISTIC GENDIFAK6 "Stromfaktor Diode6" VALUE 0x5b4ca _REC_VAL_20_u1 0. _CNV_R_R_fak_q0p003_514_CM 0. 0.99609375 FORMAT "%8.4" /end CHARACTERISTIC
/begin CHARACTERISTIC GENDIFAK7 "Stromfaktor Diode7" VALUE 0x5b4cb _REC_VAL_20_u1 0. _CNV_R_R_fak_q0p003_514_CM 0. 0.99609375 FORMAT "%8.4" /end CHARACTERISTIC
/begin CHARACTERISTIC GENRS0_0 "Generatorstatorwiderstand0 bei 25°" VALUE 0x5b444 _REC_VAL_20_u2 0. _CNV_R_R_genrstator_515_CM 0. 0.99998474 FORMAT "%8.4" /end CHARACTERISTIC
/begin CHARACTERISTIC GENRS0_1 "Generatorstatorwiderstand1 bei 25°" VALUE 0x5b446 _REC_VAL_20_u2 0. _CNV_R_R_genrstator_515_CM 0. 0.99998474 FORMAT "%8.4" /end CHARACTERISTIC
/begin CHARACTERISTIC GENRS0_2 "Generatorstatorwiderstand2 bei 25°" VALUE 0x5b448 _REC_VAL_20_u2 0. _CNV_R_R_genrstator_515_CM 0. 0.99998474 FORMAT "%8.4" /end CHARACTERISTIC
/begin CHARACTERISTIC GENRS0_3 "Generatorstatorwiderstand3 bei 25°" VALUE 0x5b44a _REC_VAL_20_u2 0. _CNV_R_R_genrstator_515_CM 0. 0.99998474 FORMAT "%8.4" /end CHARACTERISTIC
/begin CHARACTERISTIC GENRS0_4 "Generatorstatorwiderstand4 bei 25°" VALUE 0x5b44c _REC_VAL_20_u2 0. _CNV_R_R_genrstator_515_CM 0. 0.99998474 FORMAT "%8.4" /end CHARACTERISTIC
/begin CHARACTERISTIC GENRS0_5 "Generatorstatorwiderstand5 bei 25°" VALUE 0x5b44e _REC_VAL_20_u2 0. _CNV_R_R_genrstator_515_CM 0. 0.99998474 FORMAT "%8.4" /end CHARACTERISTIC
/begin CHARACTERISTIC GENRS0_6 "Generatorstatorwiderstand6 bei 25°" VALUE 0x5b450 _REC_VAL_20_u2 0. _CNV_R_R_genrstator_515_CM 0. 0.99998474 FORMAT "%8.4" /end CHARACTERISTIC
/begin CHARACTERISTIC GENRS0_7 "Generatorstatorwiderstand7 bei 25°" VALUE 0x5b452 _REC_VAL_20_u2 0. _CNV_R_R_genrstator_515_CM 0. 0.99998474 FORMAT "%8.4" /end CHARACTERISTIC
/begin CHARACTERISTIC GENSTFAK0 "Stromfaktor Statorspule0" VALUE 0x5b4cd _REC_VAL_20_u1 0. _CNV_R_R_fak_q0p003_514_CM 0. 0.99609375 FORMAT "%8.4" /end CHARACTERISTIC
/begin CHARACTERISTIC GENSTFAK1 "Stromfaktor Statorspule" VALUE 0x5b4ce _REC_VAL_20_u1 0. _CNV_R_R_fak_q0p003_514_CM 0. 0.99609375 FORMAT "%8.4" /end CHARACTERISTIC
/begin CHARACTERISTIC GENSTFAK2 "Stromfaktor Statorspule2" VALUE 0x5b4cf _REC_VAL_20_u1 0. _CNV_R_R_fak_q0p003_514_CM 0. 0.99609375 FORMAT "%8.4" /end CHARACTERISTIC
/begin CHARACTERISTIC GENSTFAK3 "Stromfaktor Statorspule3" VALUE 0x5b4d0 _REC_VAL_20_u1 0. _CNV_R_R_fak_q0p003_514_CM 0. 0.99609375 FORMAT "%8.4" /end CHARACTERISTIC
/begin CHARACTERISTIC GENSTFAK4 "Stromfaktor Statorspule4" VALUE 0x5b4d1 _REC_VAL_20_u1 0. _CNV_R_R_fak_q0p003_514_CM 0. 0.99609375 FORMAT "%8.4" /end CHARACTERISTIC
/begin CHARACTERISTIC GENSTFAK5 "Stromfaktor Statorspule5" VALUE 0x5b4d2 _REC_VAL_20_u1 0. _CNV_R_R_fak_q0p003_514_CM 0. 0.99609375 FORMAT "%8.4" /end CHARACTERISTIC
/begin CHARACTERISTIC GENSTFAK6 "Stromfaktor Statorspule6" VALUE 0x5b4d3 _REC_VAL_20_u1 0. _CNV_R_R_fak_q0p003_514_CM 0. 0.99609375 FORMAT "%8.4" /end CHARACTERISTIC
/begin CHARACTERISTIC GENSTFAK7 "Stromfaktor Statorspule7" VALUE 0x5b4d4 _REC_VAL_20_u1 0. _CNV_R_R_fak_q0p003_514_CM 0. 0.99609375 FORMAT "%8.4" /end CHARACTERISTIC
/begin CHARACTERISTIC GENTMOTOF0 "Offset Generatoransaugluft" VALUE 0x5b4d7 _REC_VAL_20_u1 0. _CNV_R_R_temp_uw_q0_481_CM -48. 143.25 FORMAT "%8.4" /end CHARACTERISTIC
/begin CHARACTERISTIC GENTMOTOF1 "Offset Generatoransaugluft" VALUE 0x5b4d8 _REC_VAL_20_u1 0. _CNV_R_R_temp_uw_q0_481_CM -48. 143.25 FORMAT "%8.4" /end CHARACTERISTIC
/begin CHARACTERISTIC GENTMOTOF2 "Offset Generatoransaugluft" VALUE 0x5b4d9 _REC_VAL_20_u1 0. _CNV_R_R_temp_uw_q0_481_CM -48. 143.25 FORMAT "%8.4" /end CHARACTERISTIC
/begin CHARACTERISTIC GENTMOTOF3 "Offset Generatoransaugluft" VALUE 0x5b4da _REC_VAL_20_u1 0. _CNV_R_R_temp_uw_q0_481_CM -48. 143.25 FORMAT "%8.4" /end CHARACTERISTIC
/begin CHARACTERISTIC GENTMOTOF4 "Offset Generatoransaugluft" VALUE 0x5b4db _REC_VAL_20_u1 0. _CNV_R_R_temp_uw_q0_481_CM -48. 143.25 FORMAT "%8.4" /end CHARACTERISTIC
/begin CHARACTERISTIC GENTMOTOF5 "Offset Generatoransaugluft" VALUE 0x5b4dc _REC_VAL_20_u1 0. _CNV_R_R_temp_uw_q0_481_CM -48. 143.25 FORMAT "%8.4" /end CHARACTERISTIC
/begin CHARACTERISTIC GENTMOTOF6 "Offset Generatoransaugluft" VALUE 0x5b4dd _REC_VAL_20_u1 0. _CNV_R_R_temp_uw_q0_481_CM -48. 143.25 FORMAT "%8.4" /end CHARACTERISTIC
/begin CHARACTERISTIC GENTMOTOF7 "Offset Generatoransaugluft" VALUE 0x5b4de _REC_VAL_20_u1 0. _CNV_R_R_temp_uw_q0_481_CM -48. 143.25 FORMAT "%8.4" /end CHARACTERISTIC
/begin CHARACTERISTIC GENTYPFELD "Generatorkennfeldzuordnung" VAL_BLK 0x5b422 _REC_VAL_2_u1 0. _CNV_R_R_igen_ub_q1_483_CM 0. 255. FORMAT "%8.4" NUMBER 32 /end CHARACTERISTIC
/begin CHARACTERISTIC IGBASIS "Generatorgrundstrombedarf FZG " VALUE 0x5b4ea _REC_VAL_20_u1 0. _CNV_R_R_igen_ub_q1_483_CM 0. 255. FORMAT "%8.4" /end CHARACTERISTIC
/begin CHARACTERISTIC IGBASISOFF "Generatorgrundstrombedarf FZG bei Genred" VALUE 0x5b4eb _REC_VAL_20_u1 0. _CNV_R_R_igen_ub_q1_483_CM 0. 255. FORMAT "%8.4" /end CHARACTERISTIC
/begin CHARACTERISTIC KFGENWETA0 "Wirkungsgrad0 Generator mit 2*PI" MAP 0x5a460 _REC_MAP_32_u1_u1_u2 0. _CNV_R_R_geneta_q0p_516_CM 0. 7.96875 FORMAT "%8.4"
 /begin AXIS_DESCR STD_AXIS igm _CNV_R_R_igen_ub_q1_483_CM 8 0. 255. FORMAT "%8.4" /end AXIS_DESCR
 /begin AXIS_DESCR STD_AXIS ngen_w _CNV_R_R_ngen_uw_q0_517_CM 8 0. 32767.5 FORMAT "%8.4" /end AXIS_DESCR
/end CHARACTERISTIC
/begin CHARACTERISTIC KFGENWETA1 "Wirkungsgrad1 Generator mit 2*PI" MAP 0x5a4ba _REC_MAP_32_u1_u1_u2 0. _CNV_R_R_geneta_q0p_516_CM 0. 7.96875 FORMAT "%8.4"
 /begin AXIS_DESCR STD_AXIS igm _CNV_R_R_igen_ub_q1_483_CM 8 0. 255. FORMAT "%8.4" /end AXIS_DESCR
 /begin AXIS_DESCR STD_AXIS ngen_w _CNV_R_R_ngen_uw_q0_517_CM 8 0. 32767.5 FORMAT "%8.4" /end AXIS_DESCR
/end CHARACTERISTIC
/begin CHARACTERISTIC KFGENWETA2 "Wirkungsgrad2 Generator mit 2*PI" MAP 0x5a514 _REC_MAP_32_u1_u1_u2 0. _CNV_R_R_geneta_q0p_516_CM 0. 7.96875 FORMAT "%8.4"
 /begin AXIS_DESCR STD_AXIS igm _CNV_R_R_igen_ub_q1_483_CM 8 0. 255. FORMAT "%8.4" /end AXIS_DESCR
 /begin AXIS_DESCR STD_AXIS ngen_w _CNV_R_R_ngen_uw_q0_517_CM 8 0. 32767.5 FORMAT "%8.4" /end AXIS_DESCR
/end CHARACTERISTIC
/begin CHARACTERISTIC KFGENWETA3 "Wirkungsgrad3 Generator mit 2*PI" MAP 0x5a56e _REC_MAP_32_u1_u1_u2 0. _CNV_R_R_geneta_q0p_516_CM 0. 7.96875 FORMAT "%8.4"
 /begin AXIS_DESCR STD_AXIS igm _CNV_R_R_igen_ub_q1_483_CM 8 0. 255. FORMAT "%8.4" /end AXIS_DESCR
 /begin AXIS_DESCR STD_AXIS ngen_w _CNV_R_R_ngen_uw_q0_517_CM 8 0. 32767.5 FORMAT "%8.4" /end AXIS_DESCR
/end CHARACTERISTIC
/begin CHARACTERISTIC KFGENWETA4 "Wirkungsgrad4 Generator mit 2*PI" MAP 0x5a5c8 _REC_MAP_32_u1_u1_u2 0. _CNV_R_R_geneta_q0p_516_CM 0. 7.96875 FORMAT "%8.4"
 /begin AXIS_DESCR STD_AXIS igm _CNV_R_R_igen_ub_q1_483_CM 8 0. 255. FORMAT "%8.4" /end AXIS_DESCR
 /begin AXIS_DESCR STD_AXIS ngen_w _CNV_R_R_ngen_uw_q0_517_CM 8 0. 32767.5 FORMAT "%8.4" /end AXIS_DESCR
/end CHARACTERISTIC
/begin CHARACTERISTIC KFGENWETA5 "Wirkungsgrad5 Generator mit 2*PI" MAP 0x5a622 _REC_MAP_32_u1_u1_u2 0. _CNV_R_R_geneta_q0p_516_CM 0. 7.96875 FORMAT "%8.4"
 /begin AXIS_DESCR STD_AXIS igm _CNV_R_R_igen_ub_q1_483_CM 8 0. 255. FORMAT "%8.4" /end AXIS_DESCR
 /begin AXIS_DESCR STD_AXIS ngen_w _CNV_R_R_ngen_uw_q0_517_CM 8 0. 32767.5 FORMAT "%8.4" /end AXIS_DESCR
/end CHARACTERISTIC
/begin CHARACTERISTIC KFGENWETA6 "Wirkungsgrad6 Generator mit 2*PI" MAP 0x5a67c _REC_MAP_32_u1_u1_u2 0. _CNV_R_R_geneta_q0p_516_CM 0. 7.96875 FORMAT "%8.4"
 /begin AXIS_DESCR STD_AXIS igm _CNV_R_R_igen_ub_q1_483_CM 8 0. 255. FORMAT "%8.4" /end AXIS_DESCR
 /begin AXIS_DESCR STD_AXIS ngen_w _CNV_R_R_ngen_uw_q0_517_CM 8 0. 32767.5 FORMAT "%8.4" /end AXIS_DESCR
/end CHARACTERISTIC
/begin CHARACTERISTIC KFGENWETA7 "Wirkungsgrad7 Generator mit 2*PI" MAP 0x5a6d6 _REC_MAP_32_u1_u1_u2 0. _CNV_R_R_geneta_q0p_516_CM 0. 7.96875 FORMAT "%8.4"
 /begin AXIS_DESCR STD_AXIS igm _CNV_R_R_igen_ub_q1_483_CM 8 0. 255. FORMAT "%8.4" /end AXIS_DESCR
 /begin AXIS_DESCR STD_AXIS ngen_w _CNV_R_R_ngen_uw_q0_517_CM 8 0. 32767.5 FORMAT "%8.4" /end AXIS_DESCR
/end CHARACTERISTIC
/begin CHARACTERISTIC KFIGENDF0 "Generatorstrom0 DF-Kennfeld" MAP 0x5ac10 _REC_MAP_32_u1_u1_u1 0. _CNV_R_R_igen_ub_q1_483_CM 0. 255. FORMAT "%8.4"
 /begin AXIS_DESCR STD_AXIS dffgen _CNV_A_R_PCENT_484_CM 7 0. 99.609375 FORMAT "%8.4" /end AXIS_DESCR
 /begin AXIS_DESCR STD_AXIS genitemp _CNV_R_R_igen_ub_q1_483_CM 8 0. 255. FORMAT "%8.4" /end AXIS_DESCR
/end CHARACTERISTIC
/begin CHARACTERISTIC KFIGENDF1 "Generatorstrom1 DF-Kennfeld" MAP 0x5ac59 _REC_MAP_32_u1_u1_u1 0. _CNV_R_R_igen_ub_q1_483_CM 0. 255. FORMAT "%8.4"
 /begin AXIS_DESCR STD_AXIS dffgen _CNV_A_R_PCENT_484_CM 7 0. 99.609375 FORMAT "%8.4" /end AXIS_DESCR
 /begin AXIS_DESCR STD_AXIS genitemp _CNV_R_R_igen_ub_q1_483_CM 8 0. 255. FORMAT "%8.4" /end AXIS_DESCR
/end CHARACTERISTIC
/begin CHARACTERISTIC KFIGENDF2 "Generatorstrom2 DF-Kennfeld" MAP 0x5aca2 _REC_MAP_32_u1_u1_u1 0. _CNV_R_R_igen_ub_q1_483_CM 0. 255. FORMAT "%8.4"
 /begin AXIS_DESCR STD_AXIS dffgen _CNV_A_R_PCENT_484_CM 7 0. 99.609375 FORMAT "%8.4" /end AXIS_DESCR
 /begin AXIS_DESCR STD_AXIS genitemp _CNV_R_R_igen_ub_q1_483_CM 8 0. 255. FORMAT "%8.4" /end AXIS_DESCR
/end CHARACTERISTIC
/begin CHARACTERISTIC KFIGENDF3 "Generatorstrom3 DF-Kennfeld" MAP 0x5aceb _REC_MAP_32_u1_u1_u1 0. _CNV_R_R_igen_ub_q1_483_CM 0. 255. FORMAT "%8.4"
 /begin AXIS_DESCR STD_AXIS dffgen _CNV_A_R_PCENT_484_CM 7 0. 99.609375 FORMAT "%8.4" /end AXIS_DESCR
 /begin AXIS_DESCR STD_AXIS genitemp _CNV_R_R_igen_ub_q1_483_CM 8 0. 255. FORMAT "%8.4" /end AXIS_DESCR
/end CHARACTERISTIC
/begin CHARACTERISTIC KFIGENDF4 "Generatorstrom4 DF-Kennfeld" MAP 0x5ad34 _REC_MAP_32_u1_u1_u1 0. _CNV_R_R_igen_ub_q1_483_CM 0. 255. FORMAT "%8.4"
 /begin AXIS_DESCR STD_AXIS dffgen _CNV_A_R_PCENT_484_CM 7 0. 99.609375 FORMAT "%8.4" /end AXIS_DESCR
 /begin AXIS_DESCR STD_AXIS genitemp _CNV_R_R_igen_ub_q1_483_CM 8 0. 255. FORMAT "%8.4" /end AXIS_DESCR
/end CHARACTERISTIC
/begin CHARACTERISTIC KFIGENDF5 "Generatorstrom5 DF-Kennfeld" MAP 0x5ad7d _REC_MAP_32_u1_u1_u1 0. _CNV_R_R_igen_ub_q1_483_CM 0. 255. FORMAT "%8.4"
 /begin AXIS_DESCR STD_AXIS dffgen _CNV_A_R_PCENT_484_CM 7 0. 99.609375 FORMAT "%8.4" /end AXIS_DESCR
 /begin AXIS_DESCR STD_AXIS genitemp _CNV_R_R_igen_ub_q1_483_CM 8 0. 255. FORMAT "%8.4" /end AXIS_DESCR
/end CHARACTERISTIC
/begin CHARACTERISTIC KFIGENDF6 "Generatorstrom6 DF-Kennfeld" MAP 0x5adc6 _REC_MAP_32_u1_u1_u1 0. _CNV_R_R_igen_ub_q1_483_CM 0. 255. FORMAT "%8.4"
 /begin AXIS_DESCR STD_AXIS dffgen _CNV_A_R_PCENT_484_CM 7 0. 99.609375 FORMAT "%8.4" /end AXIS_DESCR
 /begin AXIS_DESCR STD_AXIS genitemp _CNV_R_R_igen_ub_q1_483_CM 8 0. 255. FORMAT "%8.4" /end AXIS_DESCR
/end CHARACTERISTIC
/begin CHARACTERISTIC KFIGENDF7 "Generatorstrom7 DF-Kennfeld" MAP 0x5ae0f _REC_MAP_32_u1_u1_u1 0. _CNV_R_R_igen_ub_q1_483_CM 0. 255. FORMAT "%8.4"
 /begin AXIS_DESCR STD_AXIS dffgen _CNV_A_R_PCENT_484_CM 7 0. 99.609375 FORMAT "%8.4" /end AXIS_DESCR
 /begin AXIS_DESCR STD_AXIS genitemp _CNV_R_R_igen_ub_q1_483_CM 8 0. 255. FORMAT "%8.4" /end AXIS_DESCR
/end CHARACTERISTIC
/begin CHARACTERISTIC KLFPDIODE0 "Verlustleistungsfaktor eines Diodenpaars0" CURVE 0x5ae58 _REC_CUR_32_u2_u2 0. _CNV_A_R_fak_ub_b2_480_CM 0. 1.9921875 FORMAT "%8.4"
 /begin AXIS_DESCR STD_AXIS gentemp _CNV_R_R_temp_uw_q0_481_CM 5 -48. 336. FORMAT "%8.4" /end AXIS_DESCR
/end CHARACTERISTIC
/begin CHARACTERISTIC KLFPDIODE1 "Verlustleistungsfaktor eines Diodenpaars1" CURVE 0x5ae6e _REC_CUR_32_u2_u2 0. _CNV_A_R_fak_ub_b2_480_CM 0. 1.9921875 FORMAT "%8.4"
 /begin AXIS_DESCR STD_AXIS gentemp _CNV_R_R_temp_uw_q0_481_CM 5 -48. 336. FORMAT "%8.4" /end AXIS_DESCR
/end CHARACTERISTIC
/begin CHARACTERISTIC KLFPDIODE2 "Verlustleistungsfaktor eines Diodenpaars2" CURVE 0x5ae84 _REC_CUR_32_u2_u2 0. _CNV_A_R_fak_ub_b2_480_CM 0. 1.9921875 FORMAT "%8.4"
 /begin AXIS_DESCR STD_AXIS gentemp _CNV_R_R_temp_uw_q0_481_CM 5 -48. 336. FORMAT "%8.4" /end AXIS_DESCR
/end CHARACTERISTIC
/begin CHARACTERISTIC KLFPDIODE3 "Verlustleistungsfaktor eines Diodenpaars" CURVE 0x5ae9a _REC_CUR_32_u2_u2 0. _CNV_A_R_fak_ub_b2_480_CM 0. 1.9921875 FORMAT "%8.4"
 /begin AXIS_DESCR STD_AXIS gentemp _CNV_R_R_temp_uw_q0_481_CM 5 -48. 336. FORMAT "%8.4" /end AXIS_DESCR
/end CHARACTERISTIC
/begin CHARACTERISTIC KLFPDIODE4 "Verlustleistungsfaktor eines Diodenpaars4" CURVE 0x5aeb0 _REC_CUR_32_u2_u2 0. _CNV_A_R_fak_ub_b2_480_CM 0. 1.9921875 FORMAT "%8.4"
 /begin AXIS_DESCR STD_AXIS gentemp _CNV_R_R_temp_uw_q0_481_CM 5 -48. 336. FORMAT "%8.4" /end AXIS_DESCR
/end CHARACTERISTIC
/begin CHARACTERISTIC KLFPDIODE5 "Verlustleistungsfaktor eines Diodenpaars5" CURVE 0x5aec6 _REC_CUR_32_u2_u2 0. _CNV_A_R_fak_ub_b2_480_CM 0. 1.9921875 FORMAT "%8.4"
 /begin AXIS_DESCR STD_AXIS gentemp _CNV_R_R_temp_uw_q0_481_CM 5 -48. 336. FORMAT "%8.4" /end AXIS_DESCR
/end CHARACTERISTIC
/begin CHARACTERISTIC KLFPDIODE6 "Verlustleistungsfaktor eines Diodenpaars6" CURVE 0x5aedc _REC_CUR_32_u2_u2 0. _CNV_A_R_fak_ub_b2_480_CM 0. 1.9921875 FORMAT "%8.4"
 /begin AXIS_DESCR STD_AXIS gentemp _CNV_R_R_temp_uw_q0_481_CM 5 -48. 336. FORMAT "%8.4" /end AXIS_DESCR
/end CHARACTERISTIC
/begin CHARACTERISTIC KLFPDIODE7 "Verlustleistungsfaktor eines Diodenpaars7" CURVE 0x5aef2 _REC_CUR_32_u2_u2 0. _CNV_A_R_fak_ub_b2_480_CM 0. 1.9921875 FORMAT "%8.4"
 /begin AXIS_DESCR STD_AXIS gentemp _CNV_R_R_temp_uw_q0_481_CM 5 -48. 336. FORMAT "%8.4" /end AXIS_DESCR
/end CHARACTERISTIC
/begin CHARACTERISTIC KLGENEXP0 "Abkühlkurve Generator0" CURVE 0x5af08 _REC_CUR_32_u2_u2 0. _CNV_R_R_fak_q0p003_514_CM 0. 1. FORMAT "%8.4"
 /begin AXIS_DESCR STD_AXIS tabst_w _CNV_R_R_igen_ub_q1_483_CM 13 0. 65535. FORMAT "%8.4" /end AXIS_DESCR
/end CHARACTERISTIC
/begin CHARACTERISTIC KLGENEXP1 "Abkühlkurve Generator1" CURVE 0x5af3e _REC_CUR_32_u2_u2 0. _CNV_R_R_fak_q0p003_514_CM 0. 1. FORMAT "%8.4"
 /begin AXIS_DESCR STD_AXIS tabst_w _CNV_R_R_igen_ub_q1_483_CM 13 0. 65535. FORMAT "%8.4" /end AXIS_DESCR
/end CHARACTERISTIC
/begin CHARACTERISTIC KLGENEXP2 "Abkühlkurve Generator2" CURVE 0x5af74 _REC_CUR_32_u2_u2 0. _CNV_R_R_fak_q0p003_514_CM 0. 1. FORMAT "%8.4"
 /begin AXIS_DESCR STD_AXIS tabst_w _CNV_R_R_igen_ub_q1_483_CM 13 0. 65535. FORMAT "%8.4" /end AXIS_DESCR
/end CHARACTERISTIC
/begin CHARACTERISTIC KLGENEXP3 "Abkühlkurve Generator3" CURVE 0x5afaa _REC_CUR_32_u2_u2 0. _CNV_R_R_fak_q0p003_514_CM 0. 1. FORMAT "%8.4"
 /begin AXIS_DESCR STD_AXIS tabst_w _CNV_R_R_igen_ub_q1_483_CM 13 0. 65535. FORMAT "%8.4" /end AXIS_DESCR
/end CHARACTERISTIC
/begin CHARACTERISTIC KLGENEXP4 "Abkühlkurve Generator4" CURVE 0x5afe0 _REC_CUR_32_u2_u2 0. _CNV_R_R_fak_q0p003_514_CM 0. 1. FORMAT "%8.4"
 /begin AXIS_DESCR STD_AXIS tabst_w _CNV_R_R_igen_ub_q1_483_CM 13 0. 65535. FORMAT "%8.4" /end AXIS_DESCR
/end CHARACTERISTIC
/begin CHARACTERISTIC KLGENEXP5 "Abkühlkurve Generator5" CURVE 0x5b016 _REC_CUR_32_u2_u2 0. _CNV_R_R_fak_q0p003_514_CM 0. 1. FORMAT "%8.4"
 /begin AXIS_DESCR STD_AXIS tabst_w _CNV_R_R_igen_ub_q1_483_CM 13 0. 65535. FORMAT "%8.4" /end AXIS_DESCR
/end CHARACTERISTIC
/begin CHARACTERISTIC KLGENEXP6 "Abkühlkurve Generator6" CURVE 0x5b04c _REC_CUR_32_u2_u2 0. _CNV_R_R_fak_q0p003_514_CM 0. 1. FORMAT "%8.4"
 /begin AXIS_DESCR STD_AXIS tabst_w _CNV_R_R_igen_ub_q1_483_CM 13 0. 65535. FORMAT "%8.4" /end AXIS_DESCR
/end CHARACTERISTIC
/begin CHARACTERISTIC KLGENEXP7 "Abkühlkurve Generator7" CURVE 0x5b082 _REC_CUR_32_u2_u2 0. _CNV_R_R_fak_q0p003_514_CM 0. 1. FORMAT "%8.4"
 /begin AXIS_DESCR STD_AXIS tabst_w _CNV_R_R_igen_ub_q1_483_CM 13 0. 65535. FORMAT "%8.4" /end AXIS_DESCR
/end CHARACTERISTIC
/begin CHARACTERISTIC KLGENTETA0 "Temperatur_eta_faktor Generator0" CURVE 0x5b0b8 _REC_CUR_32_u2_u2 0. _CNV_R_R_fak_q0p003_514_CM 0. 2. FORMAT "%8.4"
 /begin AXIS_DESCR STD_AXIS gentemp _CNV_R_R_temp_uw_q0_481_CM 3 -48. 336. FORMAT "%8.4" /end AXIS_DESCR
/end CHARACTERISTIC
/begin CHARACTERISTIC KLGENTETA1 "Temperatur_eta_faktor Generator1" CURVE 0x5b0c6 _REC_CUR_32_u2_u2 0. _CNV_R_R_fak_q0p003_514_CM 0. 2. FORMAT "%8.4"
 /begin AXIS_DESCR STD_AXIS gentemp _CNV_R_R_temp_uw_q0_481_CM 3 -48. 336. FORMAT "%8.4" /end AXIS_DESCR
/end CHARACTERISTIC
/begin CHARACTERISTIC KLGENTETA2 "Temperatur_eta_faktor Generator2" CURVE 0x5b0d4 _REC_CUR_32_u2_u2 0. _CNV_R_R_fak_q0p003_514_CM 0. 2. FORMAT "%8.4"
 /begin AXIS_DESCR STD_AXIS gentemp _CNV_R_R_temp_uw_q0_481_CM 3 -48. 336. FORMAT "%8.4" /end AXIS_DESCR
/end CHARACTERISTIC
/begin CHARACTERISTIC KLGENTETA3 "Temperatur_eta_faktor Generator3" CURVE 0x5b0e2 _REC_CUR_32_u2_u2 0. _CNV_R_R_fak_q0p003_514_CM 0. 2. FORMAT "%8.4"
 /begin AXIS_DESCR STD_AXIS gentemp _CNV_R_R_temp_uw_q0_481_CM 3 -48. 336. FORMAT "%8.4" /end AXIS_DESCR
/end CHARACTERISTIC
/begin CHARACTERISTIC KLGENTETA4 "Temperatur_eta_faktor Generator4" CURVE 0x5b0f0 _REC_CUR_32_u2_u2 0. _CNV_R_R_fak_q0p003_514_CM 0. 2. FORMAT "%8.4"
 /begin AXIS_DESCR STD_AXIS gentemp _CNV_R_R_temp_uw_q0_481_CM 3 -48. 336. FORMAT "%8.4" /end AXIS_DESCR
/end CHARACTERISTIC
/begin CHARACTERISTIC KLGENTETA5 "Temperatur_eta_faktor Generator5" CURVE 0x5b0fe _REC_CUR_32_u2_u2 0. _CNV_R_R_fak_q0p003_514_CM 0. 2. FORMAT "%8.4"
 /begin AXIS_DESCR STD_AXIS gentemp _CNV_R_R_temp_uw_q0_481_CM 3 -48. 336. FORMAT "%8.4" /end AXIS_DESCR
/end CHARACTERISTIC
/begin CHARACTERISTIC KLGENTETA6 "Temperatur_eta_faktor Generator6" CURVE 0x5b10c _REC_CUR_32_u2_u2 0. _CNV_R_R_fak_q0p003_514_CM 0. 2. FORMAT "%8.4"
 /begin AXIS_DESCR STD_AXIS gentemp _CNV_R_R_temp_uw_q0_481_CM 3 -48. 336. FORMAT "%8.4" /end AXIS_DESCR
/end CHARACTERISTIC
/begin CHARACTERISTIC KLGENTETA7 "Temperatur_eta_faktor Generator7" CURVE 0x5b11a _REC_CUR_32_u2_u2 0. _CNV_R_R_fak_q0p003_514_CM 0. 2. FORMAT "%8.4"
 /begin AXIS_DESCR STD_AXIS gentemp _CNV_R_R_temp_uw_q0_481_CM 3 -48. 336. FORMAT "%8.4" /end AXIS_DESCR
/end CHARACTERISTIC
/begin CHARACTERISTIC KLRTH0FAK0 "RTHfaktor0 ueber Generatorstrom" CURVE 0x5b20a _REC_CUR_32_u1_u1 0. _CNV_R_R_fak_ub_b4_513_CM 0. 3.984375 FORMAT "%8.4"
 /begin AXIS_DESCR STD_AXIS geni_end _CNV_R_R_igen_ub_q1_483_CM 11 0. 254. FORMAT "%8.4" /end AXIS_DESCR
/end CHARACTERISTIC
/begin CHARACTERISTIC KLRTH0FAK1 "RTHfaktor1 ueber Generatorstrom" CURVE 0x5b221 _REC_CUR_32_u1_u1 0. _CNV_R_R_fak_ub_b4_513_CM 0. 3.984375 FORMAT "%8.4"
 /begin AXIS_DESCR STD_AXIS geni_end _CNV_R_R_igen_ub_q1_483_CM 11 0. 254. FORMAT "%8.4" /end AXIS_DESCR
/end CHARACTERISTIC
/begin CHARACTERISTIC KLRTH0FAK2 "RTHfaktor 2 ueber Generatorstrom" CURVE 0x5b238 _REC_CUR_32_u1_u1 0. _CNV_R_R_fak_ub_b4_513_CM 0. 3.96875 FORMAT "%8.4"
 /begin AXIS_DESCR STD_AXIS geni_end _CNV_R_R_igen_ub_q1_483_CM 11 0. 254. FORMAT "%8.4" /end AXIS_DESCR
/end CHARACTERISTIC
/begin CHARACTERISTIC KLRTH0FAK3 "RTHfaktor3 ueber Generatorstrom" CURVE 0x5b24f _REC_CUR_32_u1_u1 0. _CNV_R_R_fak_ub_b4_513_CM 0. 3.984375 FORMAT "%8.4"
 /begin AXIS_DESCR STD_AXIS geni_end _CNV_R_R_igen_ub_q1_483_CM 11 0. 254. FORMAT "%8.4" /end AXIS_DESCR
/end CHARACTERISTIC
/begin CHARACTERISTIC KLRTH0FAK4 "RTHfaktor4 ueber Generatorstrom" CURVE 0x5b266 _REC_CUR_32_u1_u1 0. _CNV_R_R_fak_ub_b4_513_CM 0. 3.984375 FORMAT "%8.4"
 /begin AXIS_DESCR STD_AXIS geni_end _CNV_R_R_igen_ub_q1_483_CM 11 0. 254. FORMAT "%8.4" /end AXIS_DESCR
/end CHARACTERISTIC
/begin CHARACTERISTIC KLRTH0FAK5 "RTHfaktor5 ueber Generatorstrom" CURVE 0x5b27d _REC_CUR_32_u1_u1 0. _CNV_R_R_fak_ub_b4_513_CM 0. 3.984375 FORMAT "%8.4"
 /begin AXIS_DESCR STD_AXIS geni_end _CNV_R_R_igen_ub_q1_483_CM 11 0. 254. FORMAT "%8.4" /end AXIS_DESCR
/end CHARACTERISTIC
/begin CHARACTERISTIC KLRTH0FAK6 "RTHfaktor6 ueber Generatorstrom" CURVE 0x5b294 _REC_CUR_32_u1_u1 0. _CNV_R_R_fak_ub_b4_513_CM 0. 3.984375 FORMAT "%8.4"
 /begin AXIS_DESCR STD_AXIS geni_end _CNV_R_R_igen_ub_q1_483_CM 11 0. 254. FORMAT "%8.4" /end AXIS_DESCR
/end CHARACTERISTIC
/begin CHARACTERISTIC KLRTH0FAK7 "RTHfaktor7 ueber Generatorstrom" CURVE 0x5b2ab _REC_CUR_32_u1_u1 0. _CNV_R_R_fak_ub_b4_513_CM 0. 3.984375 FORMAT "%8.4"
 /begin AXIS_DESCR STD_AXIS geni_end _CNV_R_R_igen_ub_q1_483_CM 11 0. 254. FORMAT "%8.4" /end AXIS_DESCR
/end CHARACTERISTIC
/begin CHARACTERISTIC KLRTHFAK1 "RTHfaktor1 ueber Generatorstrom Fahrt" CURVE 0x5b2d9 _REC_CUR_32_u1_u1 0. _CNV_R_R_fak_ub_b4_513_CM 0. 3.984375 FORMAT "%8.4"
 /begin AXIS_DESCR STD_AXIS geni_end _CNV_R_R_igen_ub_q1_483_CM 11 0. 254. FORMAT "%8.4" /end AXIS_DESCR
/end CHARACTERISTIC
/begin CHARACTERISTIC KLRTHFAK2 "RTHfaktor2 ueber Generatorstrom Fahrt" CURVE 0x5b2f0 _REC_CUR_32_u1_u1 0. _CNV_R_R_fak_ub_b4_513_CM 0. 3.984375 FORMAT "%8.4"
 /begin AXIS_DESCR STD_AXIS geni_end _CNV_R_R_igen_ub_q1_483_CM 11 0. 254. FORMAT "%8.4" /end AXIS_DESCR
/end CHARACTERISTIC
/begin CHARACTERISTIC KLRTHFAK3 "RTHfaktor3 ueber Generatorstrom Fahrt" CURVE 0x5b307 _REC_CUR_32_u1_u1 0. _CNV_R_R_fak_ub_b4_513_CM 0. 3.984375 FORMAT "%8.4"
 /begin AXIS_DESCR STD_AXIS geni_end _CNV_R_R_igen_ub_q1_483_CM 11 0. 254. FORMAT "%8.4" /end AXIS_DESCR
/end CHARACTERISTIC
/begin CHARACTERISTIC KLRTHFAK4 "RTHfaktor4 ueber Generatorstrom Fahrt" CURVE 0x5b31e _REC_CUR_32_u1_u1 0. _CNV_R_R_fak_ub_b4_513_CM 0. 3.984375 FORMAT "%8.4"
 /begin AXIS_DESCR STD_AXIS geni_end _CNV_R_R_igen_ub_q1_483_CM 11 0. 254. FORMAT "%8.4" /end AXIS_DESCR
/end CHARACTERISTIC
/begin CHARACTERISTIC KLRTHFAK5 "RTHfaktor5 ueber Generatorstrom Fahrt" CURVE 0x5b335 _REC_CUR_32_u1_u1 0. _CNV_R_R_fak_ub_b4_513_CM 0. 3.984375 FORMAT "%8.4"
 /begin AXIS_DESCR STD_AXIS geni_end _CNV_R_R_igen_ub_q1_483_CM 11 0. 254. FORMAT "%8.4" /end AXIS_DESCR
/end CHARACTERISTIC
/begin CHARACTERISTIC KLRTHFAK6 "RTHfaktor6 ueber Generatorstrom Fahrt" CURVE 0x5b34c _REC_CUR_32_u1_u1 0. _CNV_R_R_fak_ub_b4_513_CM 0. 3.984375 FORMAT "%8.4"
 /begin AXIS_DESCR STD_AXIS geni_end _CNV_R_R_igen_ub_q1_483_CM 11 0. 254. FORMAT "%8.4" /end AXIS_DESCR
/end CHARACTERISTIC
/begin CHARACTERISTIC KLRTHFAK7 "RTHfaktor7 ueber Generatorstrom Fahrt" CURVE 0x5b363 _REC_CUR_32_u1_u1 0. _CNV_R_R_fak_ub_b4_513_CM 0. 3.984375 FORMAT "%8.4"
 /begin AXIS_DESCR STD_AXIS geni_end _CNV_R_R_igen_ub_q1_483_CM 11 0. 254. FORMAT "%8.4" /end AXIS_DESCR
/end CHARACTERISTIC
/begin CHARACTERISTIC KLRTHGEN0 "RTH-Kennfeld Generator0" CURVE 0x5b13a _REC_CUR_32_u2_u2 0. _CNV_R_R_fak_uw_b64_518_CM 0. 1. FORMAT "%8.4"
 /begin AXIS_DESCR STD_AXIS ngen_w _CNV_R_R_ngen_uw_q0_517_CM 6 0. 32767.5 FORMAT "%8.4" /end AXIS_DESCR
/end CHARACTERISTIC
/begin CHARACTERISTIC KLRTHGEN1 "RTH-Kennfeld Generator1" CURVE 0x5b154 _REC_CUR_32_u2_u2 0. _CNV_R_R_fak_uw_b64_518_CM 0. 1. FORMAT "%8.4"
 /begin AXIS_DESCR STD_AXIS ngen_w _CNV_R_R_ngen_uw_q0_517_CM 6 0. 32767.5 FORMAT "%8.4" /end AXIS_DESCR
/end CHARACTERISTIC
/begin CHARACTERISTIC KLRTHGEN2 "RTH-Kennfeld Generator2" CURVE 0x5b16e _REC_CUR_32_u2_u2 0. _CNV_R_R_fak_uw_b64_518_CM 0. 1. FORMAT "%8.4"
 /begin AXIS_DESCR STD_AXIS ngen_w _CNV_R_R_ngen_uw_q0_517_CM 6 0. 32767.5 FORMAT "%8.4" /end AXIS_DESCR
/end CHARACTERISTIC
/begin CHARACTERISTIC KLRTHGEN3 "RTH-Kennfeld Generator3" CURVE 0x5b188 _REC_CUR_32_u2_u2 0. _CNV_R_R_fak_uw_b64_518_CM 0. 1. FORMAT "%8.4"
 /begin AXIS_DESCR STD_AXIS ngen_w _CNV_R_R_ngen_uw_q0_517_CM 6 0. 32767.5 FORMAT "%8.4" /end AXIS_DESCR
/end CHARACTERISTIC
/begin CHARACTERISTIC KLRTHGEN4 "RTH-Kennfeld Generator4" CURVE 0x5b1a2 _REC_CUR_32_u2_u2 0. _CNV_R_R_fak_uw_b64_518_CM 0. 1. FORMAT "%8.4"
 /begin AXIS_DESCR STD_AXIS ngen_w _CNV_R_R_ngen_uw_q0_517_CM 6 0. 32767.5 FORMAT "%8.4" /end AXIS_DESCR
/end CHARACTERISTIC
/begin CHARACTERISTIC KLRTHGEN5 "RTH-Kennfeld Generator5" CURVE 0x5b1bc _REC_CUR_32_u2_u2 0. _CNV_R_R_fak_uw_b64_518_CM 0. 1. FORMAT "%8.4"
 /begin AXIS_DESCR STD_AXIS ngen_w _CNV_R_R_ngen_uw_q0_517_CM 6 0. 32767.5 FORMAT "%8.4" /end AXIS_DESCR
/end CHARACTERISTIC
/begin CHARACTERISTIC KLRTHGEN6 "RTH-Kennfeld Generator6" CURVE 0x5b1d6 _REC_CUR_32_u2_u2 0. _CNV_R_R_fak_uw_b64_518_CM 0. 1. FORMAT "%8.4"
 /begin AXIS_DESCR STD_AXIS ngen_w _CNV_R_R_ngen_uw_q0_517_CM 6 0. 32767.5 FORMAT "%8.4" /end AXIS_DESCR
/end CHARACTERISTIC
/begin CHARACTERISTIC KLRTHGEN7 "RTH-Kennfeld Generator7" CURVE 0x5b1f0 _REC_CUR_32_u2_u2 0. _CNV_R_R_fak_uw_b64_518_CM 0. 1. FORMAT "%8.4"
 /begin AXIS_DESCR STD_AXIS ngen_w _CNV_R_R_ngen_uw_q0_517_CM 6 0. 32767.5 FORMAT "%8.4" /end AXIS_DESCR
/end CHARACTERISTIC
/begin CHARACTERISTIC KLTANSGEN0 "Kennlinie Generatoransaugluft0" CURVE 0x5b37a _REC_CUR_32_u1_u1 0. _CNV_R_R_temp_uw_q0_481_CM -48. 143.25 FORMAT "%8.4"
 /begin AXIS_DESCR STD_AXIS vfzg _CNV_R_R_vfzg_ub_q1_482_CM 10 0. 318.75 FORMAT "%8.4" /end AXIS_DESCR
/end CHARACTERISTIC
/begin CHARACTERISTIC KLTANSGEN1 "Kennlinie Generatoransaugluft1" CURVE 0x5b38f _REC_CUR_32_u1_u1 0. _CNV_R_R_temp_uw_q0_481_CM -48. 143.25 FORMAT "%8.4"
 /begin AXIS_DESCR STD_AXIS vfzg _CNV_R_R_vfzg_ub_q1_482_CM 10 0. 318.75 FORMAT "%8.4" /end AXIS_DESCR
/end CHARACTERISTIC
/begin CHARACTERISTIC KLTANSGEN2 "Kennlinie Generatoransaugluft2" CURVE 0x5b3a4 _REC_CUR_32_u1_u1 0. _CNV_R_R_temp_uw_q0_481_CM -48. 143.25 FORMAT "%8.4"
 /begin AXIS_DESCR STD_AXIS vfzg _CNV_R_R_vfzg_ub_q1_482_CM 10 0. 318.75 FORMAT "%8.4" /end AXIS_DESCR
/end CHARACTERISTIC
/begin CHARACTERISTIC KLTANSGEN3 "Kennlinie Generatoransaugluft3" CURVE 0x5b3b9 _REC_CUR_32_u1_u1 0. _CNV_R_R_temp_uw_q0_481_CM -48. 143.25 FORMAT "%8.4"
 /begin AXIS_DESCR STD_AXIS vfzg _CNV_R_R_vfzg_ub_q1_482_CM 10 0. 318.75 FORMAT "%8.4" /end AXIS_DESCR
/end CHARACTERISTIC
/begin CHARACTERISTIC KLTANSGEN4 "Kennlinie Generatoransaugluft4" CURVE 0x5b3ce _REC_CUR_32_u1_u1 0. _CNV_R_R_temp_uw_q0_481_CM -48. 143.25 FORMAT "%8.4"
 /begin AXIS_DESCR STD_AXIS vfzg _CNV_R_R_vfzg_ub_q1_482_CM 10 0. 318.75 FORMAT "%8.4" /end AXIS_DESCR
/end CHARACTERISTIC
/begin CHARACTERISTIC KLTANSGEN5 "Kennlinie Generatoransaugluft5" CURVE 0x5b3e3 _REC_CUR_32_u1_u1 0. _CNV_R_R_temp_uw_q0_481_CM -48. 143.25 FORMAT "%8.4"
 /begin AXIS_DESCR STD_AXIS vfzg _CNV_R_R_vfzg_ub_q1_482_CM 10 0. 318.75 FORMAT "%8.4" /end AXIS_DESCR
/end CHARACTERISTIC
/begin CHARACTERISTIC KLTANSGEN6 "Kennlinie Generatoransaugluft6" CURVE 0x5b3f8 _REC_CUR_32_u1_u1 0. _CNV_R_R_temp_uw_q0_481_CM -48. 143.25 FORMAT "%8.4"
 /begin AXIS_DESCR STD_AXIS vfzg _CNV_R_R_vfzg_ub_q1_482_CM 10 0. 318.75 FORMAT "%8.4" /end AXIS_DESCR
/end CHARACTERISTIC
/begin CHARACTERISTIC KLTANSGEN7 "Kennlinie Generatoransaugluft7" CURVE 0x5b40d _REC_CUR_32_u1_u1 0. _CNV_R_R_temp_uw_q0_481_CM -48. 143.25 FORMAT "%8.4"
 /begin AXIS_DESCR STD_AXIS vfzg _CNV_R_R_vfzg_ub_q1_482_CM 10 0. 318.75 FORMAT "%8.4" /end AXIS_DESCR
/end CHARACTERISTIC
/begin CHARACTERISTIC MANAWNUMM "manuelle Kennfeldauswahlnummeroffset" VALUE 0x5b4ed _REC_VAL_20_u1 0. _CNV_R_R_igen_ub_q1_483_CM 0. 255. FORMAT "%8.4" /end CHARACTERISTIC
/begin CHARACTERISTIC S_IGMISCH "Schalter IG-Mischung" VALUE 0x5b4ef _REC_VAL_20_u1 0. _CNV_S_2_B_TRUE_519_CM 0. 1. BIT_MASK 0x1 /end CHARACTERISTIC
/begin CHARACTERISTIC TIGMISCH "Verzögerungzeit IGMISCH" VALUE 0x5b4f0 _REC_VAL_20_u1 0. _CNV_R_R_t10msxs_ub_520_CM 0. 2.55 FORMAT "%8.4" /end CHARACTERISTIC
/begin CHARACTERISTIC UDIODERMS0 "RMS-Schwellspannung Generatordiode0" VALUE 0x5b4f3 _REC_VAL_20_u1 0. _CNV_A_R_fak_ub_b2_480_CM 0. 1.9921875 FORMAT "%8.4" /end CHARACTERISTIC
/begin CHARACTERISTIC UDIODERMS1 "RMS-Schwellspannung Generatordiode1" VALUE 0x5b4f4 _REC_VAL_20_u1 0. _CNV_A_R_fak_ub_b2_480_CM 0. 1.9921875 FORMAT "%8.4" /end CHARACTERISTIC
/begin CHARACTERISTIC UDIODERMS2 "RMS-Schwellspannung Generatordiode2" VALUE 0x5b4f5 _REC_VAL_20_u1 0. _CNV_A_R_fak_ub_b2_480_CM 0. 1.9921875 FORMAT "%8.4" /end CHARACTERISTIC
/begin CHARACTERISTIC UDIODERMS3 "RMS-Schwellspannung Generatordiode3" VALUE 0x5b4f6 _REC_VAL_20_u1 0. _CNV_A_R_fak_ub_b2_480_CM 0. 1.9921875 FORMAT "%8.4" /end CHARACTERISTIC
/begin CHARACTERISTIC UDIODERMS4 "RMS-Schwellspannung Generatordiode4" VALUE 0x5b4f7 _REC_VAL_20_u1 0. _CNV_A_R_fak_ub_b2_480_CM 0. 1.9921875 FORMAT "%8.4" /end CHARACTERISTIC
/begin CHARACTERISTIC UDIODERMS5 "RMS-Schwellspannung Generatordiode5" VALUE 0x5b4f8 _REC_VAL_20_u1 0. _CNV_A_R_fak_ub_b2_480_CM 0. 1.9921875 FORMAT "%8.4" /end CHARACTERISTIC
/begin CHARACTERISTIC UDIODERMS6 "RMS-Schwellspannung Generatordiode6" VALUE 0x5b4f9 _REC_VAL_20_u1 0. _CNV_A_R_fak_ub_b2_480_CM 0. 1.9921875 FORMAT "%8.4" /end CHARACTERISTIC
/begin CHARACTERISTIC UDIODERMS7 "RMS-Schwellspannung Generatordiode7" VALUE 0x5b4fa _REC_VAL_20_u1 0. _CNV_A_R_fak_ub_b2_480_CM 0. 1.9921875 FORMAT "%8.4" /end CHARACTERISTIC
/begin CHARACTERISTIC ZMGENS0HZ0 "Zeitkonstante Generatorstator0 Aufheizung im Stand" VALUE 0x5b45c _REC_VAL_20_u2 0. _CNV_R_R_genzmst_uw_511_CM 0. 0.99998474 FORMAT "%8.4" /end CHARACTERISTIC
/begin CHARACTERISTIC ZMGENS0HZ1 "Zeitkonstante Generatorstator1 Aufheizung im Stand" VALUE 0x5b45e _REC_VAL_20_u2 0. _CNV_R_R_genzmst_uw_511_CM 0. 0.99998474 FORMAT "%8.4" /end CHARACTERISTIC
/begin CHARACTERISTIC ZMGENS0HZ2 "Zeitkonstante Generatorstator2 Aufheizung im Stand" VALUE 0x5b460 _REC_VAL_20_u2 0. _CNV_R_R_genzmst_uw_511_CM 0. 0.99998474 FORMAT "%8.4" /end CHARACTERISTIC
/begin CHARACTERISTIC ZMGENS0HZ3 "Zeitkonstante Generatorstator3 Aufheizung im Stand" VALUE 0x5b462 _REC_VAL_20_u2 0. _CNV_R_R_genzmst_uw_511_CM 0. 0.99998474 FORMAT "%8.4" /end CHARACTERISTIC
/begin CHARACTERISTIC ZMGENS0HZ4 "Zeitkonstante Generatorstator4 Aufheizung im Stand" VALUE 0x5b464 _REC_VAL_20_u2 0. _CNV_R_R_genzmst_uw_511_CM 0. 0.99998474 FORMAT "%8.4" /end CHARACTERISTIC
/begin CHARACTERISTIC ZMGENS0HZ5 "Zeitkonstante Generatorstator5 Aufheizung im Stand" VALUE 0x5b466 _REC_VAL_20_u2 0. _CNV_R_R_genzmst_uw_511_CM 0. 0.99998474 FORMAT "%8.4" /end CHARACTERISTIC
/begin CHARACTERISTIC ZMGENS0HZ6 "Zeitkonstante Generatorstator6 Aufheizung im Stand" VALUE 0x5b468 _REC_VAL_20_u2 0. _CNV_R_R_genzmst_uw_511_CM 0. 0.99998474 FORMAT "%8.4" /end CHARACTERISTIC
/begin CHARACTERISTIC ZMGENS0HZ7 "Zeitkonstante Generatorstator7 Aufheizung im Stand" VALUE 0x5b46a _REC_VAL_20_u2 0. _CNV_R_R_genzmst_uw_511_CM 0. 0.99998474 FORMAT "%8.4" /end CHARACTERISTIC
/begin CHARACTERISTIC ZMGENS0KL0 "Zeitkonstante Abkühlung Generator im Stand0" VALUE 0x5b46c _REC_VAL_20_u2 0. _CNV_R_R_genzmst_uw_511_CM 0. 0.99998474 FORMAT "%8.4" /end CHARACTERISTIC
/begin CHARACTERISTIC ZMGENS0KL1 "Zeitkonstante Abkühlung Generator im Stand1" VALUE 0x5b46e _REC_VAL_20_u2 0. _CNV_R_R_genzmst_uw_511_CM 0. 0.99998474 FORMAT "%8.4" /end CHARACTERISTIC
/begin CHARACTERISTIC ZMGENS0KL2 "Zeitkonstante Abkühlung Generator im Stand2" VALUE 0x5b470 _REC_VAL_20_u2 0. _CNV_R_R_genzmst_uw_511_CM 0. 0.99998474 FORMAT "%8.4" /end CHARACTERISTIC
/begin CHARACTERISTIC ZMGENS0KL3 "Zeitkonstante Abkühlung Generator im Stand3" VALUE 0x5b472 _REC_VAL_20_u2 0. _CNV_R_R_genzmst_uw_511_CM 0. 0.99998474 FORMAT "%8.4" /end CHARACTERISTIC
/begin CHARACTERISTIC ZMGENS0KL4 "Zeitkonstante Abkühlung Generator im Stand4" VALUE 0x5b474 _REC_VAL_20_u2 0. _CNV_R_R_genzmst_uw_511_CM 0. 0.99998474 FORMAT "%8.4" /end CHARACTERISTIC
/begin CHARACTERISTIC ZMGENS0KL5 "Zeitkonstante Abkühlung Generator im Stand5" VALUE 0x5b476 _REC_VAL_20_u2 0. _CNV_R_R_genzmst_uw_511_CM 0. 0.99998474 FORMAT "%8.4" /end CHARACTERISTIC
/begin CHARACTERISTIC ZMGENS0KL6 "Zeitkonstante Abkühlung Generator im Stand6" VALUE 0x5b478 _REC_VAL_20_u2 0. _CNV_R_R_genzmst_uw_511_CM 0. 0.99998474 FORMAT "%8.4" /end CHARACTERISTIC
/begin CHARACTERISTIC ZMGENS0KL7 "Zeitkonstante Abkühlung Generator im Stand7" VALUE 0x5b47a _REC_VAL_20_u2 0. _CNV_R_R_genzmst_uw_511_CM 0. 0.99998474 FORMAT "%8.4" /end CHARACTERISTIC
/begin CHARACTERISTIC ZMGENSTHZ1 "Zeitkonstante Generatorstator1 Aufheizung" VALUE 0x5b47e _REC_VAL_20_u2 0. _CNV_R_R_genzmst_uw_511_CM 0. 0.99998474 FORMAT "%8.4" /end CHARACTERISTIC
/begin CHARACTERISTIC ZMGENSTHZ2 "Zeitkonstante Generatorstator2 Aufheizung" VALUE 0x5b480 _REC_VAL_20_u2 0. _CNV_R_R_genzmst_uw_511_CM 0. 0.99998474 FORMAT "%8.4" /end CHARACTERISTIC
/begin CHARACTERISTIC ZMGENSTHZ3 "Zeitkonstante Generatorstator3 Aufheizung" VALUE 0x5b482 _REC_VAL_20_u2 0. _CNV_R_R_genzmst_uw_511_CM 0. 0.99998474 FORMAT "%8.4" /end CHARACTERISTIC
/begin CHARACTERISTIC ZMGENSTHZ4 "Zeitkonstante Generatorstator4 Aufheizung" VALUE 0x5b484 _REC_VAL_20_u2 0. _CNV_R_R_genzmst_uw_511_CM 0. 0.99998474 FORMAT "%8.4" /end CHARACTERISTIC
/begin CHARACTERISTIC ZMGENSTHZ5 "Zeitkonstante Generatorstator5 Aufheizung" VALUE 0x5b486 _REC_VAL_20_u2 0. _CNV_R_R_genzmst_uw_511_CM 0. 0.99998474 FORMAT "%8.4" /end CHARACTERISTIC
/begin CHARACTERISTIC ZMGENSTHZ6 "Zeitkonstante Generatorstator6 Aufheizung" VALUE 0x5b488 _REC_VAL_20_u2 0. _CNV_R_R_genzmst_uw_511_CM 0. 0.99998474 FORMAT "%8.4" /end CHARACTERISTIC
/begin CHARACTERISTIC ZMGENSTHZ7 "Zeitkonstante Generatorstator7 Aufheizung" VALUE 0x5b48a _REC_VAL_20_u2 0. _CNV_R_R_genzmst_uw_511_CM 0. 0.99998474 FORMAT "%8.4" /end CHARACTERISTIC
/begin CHARACTERISTIC ZMGENSTKL1 "Zeitkonstante Abkühlung Generator1" VALUE 0x5b48e _REC_VAL_20_u2 0. _CNV_R_R_genzmst_uw_511_CM 0. 0.99998474 FORMAT "%8.4" /end CHARACTERISTIC
/begin CHARACTERISTIC ZMGENSTKL2 "Zeitkonstante Abkühlung Generator2" VALUE 0x5b490 _REC_VAL_20_u2 0. _CNV_R_R_genzmst_uw_511_CM 0. 0.99998474 FORMAT "%8.4" /end CHARACTERISTIC
/begin CHARACTERISTIC ZMGENSTKL3 "Zeitkonstante Abkühlung Generator3" VALUE 0x5b492 _REC_VAL_20_u2 0. _CNV_R_R_genzmst_uw_511_CM 0. 0.99998474 FORMAT "%8.4" /end CHARACTERISTIC
/begin CHARACTERISTIC ZMGENSTKL4 "Zeitkonstante Abkühlung Generator4" VALUE 0x5b494 _REC_VAL_20_u2 0. _CNV_R_R_genzmst_uw_511_CM 0. 0.99998474 FORMAT "%8.4" /end CHARACTERISTIC
/begin CHARACTERISTIC ZMGENSTKL5 "Zeitkonstante Abkühlung Generator5" VALUE 0x5b496 _REC_VAL_20_u2 0. _CNV_R_R_genzmst_uw_511_CM 0. 0.99998474 FORMAT "%8.4" /end CHARACTERISTIC
/begin CHARACTERISTIC ZMGENSTKL6 "Zeitkonstante Abkühlung Generator6" VALUE 0x5b498 _REC_VAL_20_u2 0. _CNV_R_R_genzmst_uw_511_CM 0. 0.99998474 FORMAT "%8.4" /end CHARACTERISTIC
/begin CHARACTERISTIC ZMGENSTKL7 "Zeitkonstante Abkühlung Generator7" VALUE 0x5b49a _REC_VAL_20_u2 0. _CNV_R_R_genzmst_uw_511_CM 0. 0.99998474 FORMAT "%8.4" /end CHARACTERISTIC
/begin CHARACTERISTIC ZMGN0TANS0 "Zeitkonstante Generatoransaugluft0 bei vfzg = 0" VALUE 0x5b49e _REC_VAL_20_u2 0. _CNV_R_R_genzmst_uw_511_CM 0. 0.99998474 FORMAT "%8.4" /end CHARACTERISTIC
/begin CHARACTERISTIC ZMGN0TANS1 "Zeitkonstante Generatoransaugluft1 bei vfzg = 0" VALUE 0x5b4a0 _REC_VAL_20_u2 0. _CNV_R_R_genzmst_uw_511_CM 0. 0.99998474 FORMAT "%8.4" /end CHARACTERISTIC
/begin CHARACTERISTIC ZMGN0TANS2 "Zeitkonstante Generatoransaugluft2 bei vfzg = 0" VALUE 0x5b4a2 _REC_VAL_20_u2 0. _CNV_R_R_genzmst_uw_511_CM 0. 0.99998474 FORMAT "%8.4" /end CHARACTERISTIC
/begin CHARACTERISTIC ZMGN0TANS3 "Zeitkonstante Generatoransaugluft3 bei vfzg = 0" VALUE 0x5b4a4 _REC_VAL_20_u2 0. _CNV_R_R_genzmst_uw_511_CM 0. 0.99998474 FORMAT "%8.4" /end CHARACTERISTIC
/begin CHARACTERISTIC ZMGN0TANS4 "Zeitkonstante Generatoransaugluft4 bei vfzg = 0" VALUE 0x5b4a6 _REC_VAL_20_u2 0. _CNV_R_R_genzmst_uw_511_CM 0. 0.99998474 FORMAT "%8.4" /end CHARACTERISTIC
/begin CHARACTERISTIC ZMGN0TANS5 "Zeitkonstante Generatoransaugluft5 bei vfzg = 0" VALUE 0x5b4a8 _REC_VAL_20_u2 0. _CNV_R_R_genzmst_uw_511_CM 0. 0.99998474 FORMAT "%8.4" /end CHARACTERISTIC
/begin CHARACTERISTIC ZMGN0TANS6 "Zeitkonstante Generatoransaugluft6 bei vfzg = 0" VALUE 0x5b4aa _REC_VAL_20_u2 0. _CNV_R_R_genzmst_uw_511_CM 0. 0.99998474 FORMAT "%8.4" /end CHARACTERISTIC
/begin CHARACTERISTIC ZMGN0TANS7 "Zeitkonstante Generatoransaugluft7 bei vfzg = 0" VALUE 0x5b4ac _REC_VAL_20_u2 0. _CNV_R_R_genzmst_uw_511_CM 0. 0.99998474 FORMAT "%8.4" /end CHARACTERISTIC
/begin CHARACTERISTIC ZMGNTANS0 "Zeitkonstante Generatoransaugluft0" VALUE 0x5b4ae _REC_VAL_20_u2 0. _CNV_R_R_genzmst_uw_511_CM 0. 0.99998474 FORMAT "%8.4" /end CHARACTERISTIC
/begin CHARACTERISTIC ZMGNTANS1 "Zeitkonstante Generatoransaugluft1" VALUE 0x5b4b0 _REC_VAL_20_u2 0. _CNV_R_R_genzmst_uw_511_CM 0. 0.99998474 FORMAT "%8.4" /end CHARACTERISTIC
/begin CHARACTERISTIC ZMGNTANS2 "Zeitkonstante Generatoransaugluft2" VALUE 0x5b4b2 _REC_VAL_20_u2 0. _CNV_R_R_genzmst_uw_511_CM 0. 0.99998474 FORMAT "%8.4" /end CHARACTERISTIC
/begin CHARACTERISTIC ZMGNTANS3 "Zeitkonstante Generatoransaugluft3" VALUE 0x5b4b4 _REC_VAL_20_u2 0. _CNV_R_R_genzmst_uw_511_CM 0. 0.99998474 FORMAT "%8.4" /end CHARACTERISTIC
/begin CHARACTERISTIC ZMGNTANS4 "Zeitkonstante Generatoransaugluft4" VALUE 0x5b4b6 _REC_VAL_20_u2 0. _CNV_R_R_genzmst_uw_511_CM 0. 0.99998474 FORMAT "%8.4" /end CHARACTERISTIC
/begin CHARACTERISTIC ZMGNTANS5 "Zeitkonstante Generatoransaugluft5" VALUE 0x5b4b8 _REC_VAL_20_u2 0. _CNV_R_R_genzmst_uw_511_CM 0. 0.99998474 FORMAT "%8.4" /end CHARACTERISTIC
/begin CHARACTERISTIC ZMGNTANS6 "Zeitkonstante Generatoransaugluft6" VALUE 0x5b4ba _REC_VAL_20_u2 0. _CNV_R_R_genzmst_uw_511_CM 0. 0.99998474 FORMAT "%8.4" /end CHARACTERISTIC
/begin CHARACTERISTIC ZMGNTANS7 "Zeitkonstante Generatoransaugluft7" VALUE 0x5b4bc _REC_VAL_20_u2 0. _CNV_R_R_genzmst_uw_511_CM 0. 0.99998474 FORMAT "%8.4" /end CHARACTERISTIC
/begin CHARACTERISTIC ZMIGMISCH "Zeitkonstante IG Mischung" VALUE 0x5b4be _REC_VAL_20_u2 0. _CNV_R_R_genzmst_uw_511_CM 0. 0.99998474 FORMAT "%8.4" /end CHARACTERISTIC
/begin MEASUREMENT UGEN "Generatorsollspannung" UBYTE _CNV_R_R_spg_ugen_521_CM 1 100. 10.6 36.1 ECU_ADDRESS 0x3fc5a7 FORMAT "%8.4" /end MEASUREMENT
/begin MEASUREMENT DFFGEN "DF-Signal Generator" UBYTE _CNV_A_R_PCENT_484_CM 1 100. 0. 99.609375 ECU_ADDRESS 0x3fc5a8 FORMAT "%8.4" /end MEASUREMENT
/begin MEASUREMENT NMOT_W "Motordrehzahl" UWORD _CNV_R_R_nmot_uw_q0_488_CM 1 100. 0. 16383.75 ECU_ADDRESS 0x3fc554 FORMAT "%8.4" /end MEASUREMENT
/begin MEASUREMENT B_GENFKUPL "Generatortyp unplausibel" UBYTE _CNV_S_2_B_TRUE_519_CM 1 100. 0. 1. ECU_ADDRESS 0x3fc587 BIT_MASK 0x1 /end MEASUREMENT
/begin MEASUREMENT B_GFBSUPAK "Bedingung Generatortyp unplausibel" UBYTE _CNV_S_2_B_TRUE_519_CM 1 100. 0. 1. ECU_ADDRESS 0x3fc57c BIT_MASK 0x1 /end MEASUREMENT
/begin MEASUREMENT B_GFELAK "Generatorfehler elektrisch vorhanden" UBYTE _CNV_S_2_B_TRUE_519_CM 1 100. 0. 1. ECU_ADDRESS 0x3fc57d BIT_MASK 0x1 /end MEASUREMENT
/begin MEASUREMENT B_GFMEAK "Generatorfehler elektrisch vorhanden" UBYTE _CNV_S_2_B_TRUE_519_CM 1 100. 0. 1. ECU_ADDRESS 0x3fc57e BIT_MASK 0x1 /end MEASUREMENT
/begin MEASUREMENT B_GFNOBSAK "Kommunikationsfehler Generator" UBYTE _CNV_S_2_B_TRUE_519_CM 1 100. 0. 1. ECU_ADDRESS 0x3fc580 BIT_MASK 0x1 /end MEASUREMENT
/begin MEASUREMENT TANS "Ansauglufttemperatur" UBYTE _CNV_R_R_temp_uw_q0_481_CM 1 100. -48. 143.25 ECU_ADDRESS 0x3fc56b FORMAT "%8.4" /end MEASUREMENT
/begin MEASUREMENT VFZG "Fahrzeuggeschwindigkeit" UBYTE _CNV_R_R_vfzg_ub_q1_482_CM 1 100. 0. 318.75 ECU_ADDRESS 0x3fc56d FORMAT "%8.4" /end MEASUREMENT
/begin MEASUREMENT B_STEND "Bedingung Startende" UBYTE _CNV_S_2_B_TRUE_519_CM 1 100. 0. 1. ECU_ADDRESS 0x3fc567 BIT_MASK 0x1 /end MEASUREMENT
/begin MEASUREMENT IGENMESS "gemessener Generatorstrom" UWORD _CNV_A_R_LINEAR_____12_CM 1 100. 0. 1024. ECU_ADDRESS 0x3fc558 FORMAT "%8.4" /end MEASUREMENT
/begin MEASUREMENT TABST_W "Abstellzeit Motor" UWORD _CNV_R_R_igen_ub_q1_483_CM 1 100. 0. 65535. ECU_ADDRESS 0x3fc556 FORMAT "%8.4" /end MEASUREMENT
/begin MEASUREMENT B_PWF "Bedingung Powerfail" UBYTE _CNV_S_2_B_TRUE_519_CM 1 100. 0. 1. ECU_ADDRESS 0x3fc561 BIT_MASK 0x1 /end MEASUREMENT
/begin MEASUREMENT TMOT "Motortemperatur" UBYTE _CNV_R_R_temp_uw_q0_481_CM 1 100. -48. 143.25 ECU_ADDRESS 0x3fc565 FORMAT "%8.4" /end MEASUREMENT
/begin MEASUREMENT GENMANUFAK "Generatorhersteller" UBYTE _CNV_R_R_igen_ub_q1_483_CM 1 100. 0. 255. ECU_ADDRESS 0x3fc598 FORMAT "%8.4" /end MEASUREMENT
/begin MEASUREMENT GENTYPKENN "Generatortyp" UBYTE _CNV_R_R_igen_ub_q1_483_CM 1 100. 0. 255. ECU_ADDRESS 0x3fc599 FORMAT "%8.4" /end MEASUREMENT
/begin MEASUREMENT TUMG "Umgebungstemperatur" UBYTE _CNV_R_R_temp_uw_q0_481_CM 1 100. -48. 143.25 ECU_ADDRESS 0x3fc59a FORMAT "%8.4" /end MEASUREMENT
/begin CHARACTERISTIC S_RDGENTYP "Abfrage Generatortyp und Hersteller" VALUE 0x42bf9 _REC_VAL_20_u1 0. _CNV_R_R_igen_ub_q1_483_CM 0. 255. FORMAT "%8.4" /end CHARACTERISTIC
/begin CHARACTERISTIC GENUEBSETZ0 "Generatoruebersetzung0" VALUE 0x5b4e0 _REC_VAL_20_u1 0. _CNV_R_R_fak_ub_b4_513_CM 0. 3.984375 FORMAT "%8.4" /end CHARACTERISTIC
/begin CHARACTERISTIC GENUEBSETZ1 "Generatoruebersetzung1" VALUE 0x5b4e1 _REC_VAL_20_u1 0. _CNV_R_R_fak_ub_b4_513_CM 0. 3.984375 FORMAT "%8.4" /end CHARACTERISTIC
/begin CHARACTERISTIC GENUEBSETZ2 "Generatoruebersetzung2" VALUE 0x5b4e2 _REC_VAL_20_u1 0. _CNV_R_R_fak_ub_b4_513_CM 0. 3.984375 FORMAT "%8.4" /end CHARACTERISTIC
/begin CHARACTERISTIC GENUEBSETZ3 "Generatoruebersetzung3" VALUE 0x5b4e3 _REC_VAL_20_u1 0. _CNV_R_R_fak_ub_b4_513_CM 0. 3.984375 FORMAT "%8.4" /end CHARACTERISTIC
/begin CHARACTERISTIC GENUEBSETZ4 "Generatoruebersetzung4" VALUE 0x5b4e4 _REC_VAL_20_u1 0. _CNV_R_R_fak_ub_b4_513_CM 0. 3.984375 FORMAT "%8.4" /end CHARACTERISTIC
/begin CHARACTERISTIC GENUEBSETZ5 "Generatoruebersetzung5" VALUE 0x5b4e5 _REC_VAL_20_u1 0. _CNV_R_R_fak_ub_b4_513_CM 0. 3.984375 FORMAT "%8.4" /end CHARACTERISTIC
/begin CHARACTERISTIC GENUEBSETZ6 "Generatoruebersetzung6" VALUE 0x5b4e6 _REC_VAL_20_u1 0. _CNV_R_R_fak_ub_b4_513_CM 0. 3.984375 FORMAT "%8.4" /end CHARACTERISTIC
/begin CHARACTERISTIC GENUEBSETZ7 "Generatoruebersetzung7" VALUE 0x5b4e7 _REC_VAL_20_u1 0. _CNV_R_R_fak_ub_b4_513_CM 0. 3.984375 FORMAT "%8.4" /end CHARACTERISTIC
/begin CHARACTERISTIC KFIGENKA0 "Kaltkennfeld 0 Generator" MAP 0x5a730 _REC_MAP_32_u1_u1_u2 0. _CNV_R_R_igen_ub_q1_483_CM 0. 255. FORMAT "%8.4"
 /begin AXIS_DESCR STD_AXIS ugen _CNV_R_R_spg_ugen_521_CM 7 10.6 36.1 FORMAT "%8.4" /end AXIS_DESCR
 /begin AXIS_DESCR STD_AXIS ngen_w _CNV_R_R_ngen_uw_q0_517_CM 9 0. 32767.5 FORMAT "%8.4" /end AXIS_DESCR
/end CHARACTERISTIC
/begin CHARACTERISTIC KFIGENKA1 "Kaltkennfeld 1 Generator" MAP 0x5a78c _REC_MAP_32_u1_u1_u2 0. _CNV_R_R_igen_ub_q1_483_CM 0. 255. FORMAT "%8.4"
 /begin AXIS_DESCR STD_AXIS ugen _CNV_R_R_spg_ugen_521_CM 7 10.6 36.1 FORMAT "%8.4" /end AXIS_DESCR
 /begin AXIS_DESCR STD_AXIS ngen_w _CNV_R_R_ngen_uw_q0_517_CM 9 0. 32767.5 FORMAT "%8.4" /end AXIS_DESCR
/end CHARACTERISTIC
/begin CHARACTERISTIC KFIGENKA2 "Kaltkennfeld 2 Generator" MAP 0x5a7e8 _REC_MAP_32_u1_u1_u2 0. _CNV_R_R_igen_ub_q1_483_CM 0. 255. FORMAT "%8.4"
 /begin AXIS_DESCR STD_AXIS ugen _CNV_R_R_spg_ugen_521_CM 7 10.6 36.1 FORMAT "%8.4" /end AXIS_DESCR
 /begin AXIS_DESCR STD_AXIS ngen_w _CNV_R_R_ngen_uw_q0_517_CM 9 0. 32767.5 FORMAT "%8.4" /end AXIS_DESCR
/end CHARACTERISTIC
/begin CHARACTERISTIC KFIGENKA3 "Kaltkennfeld 3 Generator" MAP 0x5a844 _REC_MAP_32_u1_u1_u2 0. _CNV_R_R_igen_ub_q1_483_CM 0. 255. FORMAT "%8.4"
 /begin AXIS_DESCR STD_AXIS ugen _CNV_R_R_spg_ugen_521_CM 7 10.6 36.1 FORMAT "%8.4" /end AXIS_DESCR
 /begin AXIS_DESCR STD_AXIS ngen_w _CNV_R_R_ngen_uw_q0_517_CM 9 0. 32767.5 FORMAT "%8.4" /end AXIS_DESCR
/end CHARACTERISTIC
/begin CHARACTERISTIC KFIGENKA4 "Kaltkennfeld 4 Generator" MAP 0x5a8a0 _REC_MAP_32_u1_u1_u2 0. _CNV_R_R_igen_ub_q1_483_CM 0. 255. FORMAT "%8.4"
 /begin AXIS_DESCR STD_AXIS ugen _CNV_R_R_spg_ugen_521_CM 7 10.6 36.1 FORMAT "%8.4" /end AXIS_DESCR
 /begin AXIS_DESCR STD_AXIS ngen_w _CNV_R_R_ngen_uw_q0_517_CM 9 0. 32767.5 FORMAT "%8.4" /end AXIS_DESCR
/end CHARACTERISTIC
/begin CHARACTERISTIC KFIGENKA5 "Kaltkennfeld 5 Generator" MAP 0x5a8fc _REC_MAP_32_u1_u1_u2 0. _CNV_R_R_igen_ub_q1_483_CM 0. 255. FORMAT "%8.4"
 /begin AXIS_DESCR STD_AXIS ugen _CNV_R_R_spg_ugen_521_CM 7 10.6 36.1 FORMAT "%8.4" /end AXIS_DESCR
 /begin AXIS_DESCR STD_AXIS ngen_w _CNV_R_R_ngen_uw_q0_517_CM 9 0. 32767.5 FORMAT "%8.4" /end AXIS_DESCR
/end CHARACTERISTIC
/begin CHARACTERISTIC KFIGENKA6 "Kaltkennfeld 6 Generator" MAP 0x5a958 _REC_MAP_32_u1_u1_u2 0. _CNV_R_R_igen_ub_q1_483_CM 0. 255. FORMAT "%8.4"
 /begin AXIS_DESCR STD_AXIS ugen _CNV_R_R_spg_ugen_521_CM 7 10.6 36.1 FORMAT "%8.4" /end AXIS_DESCR
 /begin AXIS_DESCR STD_AXIS ngen_w _CNV_R_R_ngen_uw_q0_517_CM 9 0. 32767.5 FORMAT "%8.4" /end AXIS_DESCR
/end CHARACTERISTIC
/begin CHARACTERISTIC KFIGENKA7 "Kaltkennfeld 7 Generator" MAP 0x5a9b4 _REC_MAP_32_u1_u1_u2 0. _CNV_R_R_igen_ub_q1_483_CM 0. 255. FORMAT "%8.4"
 /begin AXIS_DESCR STD_AXIS ugen _CNV_R_R_spg_ugen_521_CM 7 10.6 36.1 FORMAT "%8.4" /end AXIS_DESCR
 /begin AXIS_DESCR STD_AXIS ngen_w _CNV_R_R_ngen_uw_q0_517_CM 9 0. 32767.5 FORMAT "%8.4" /end AXIS_DESCR
/end CHARACTERISTIC
/begin CHARACTERISTIC KFIGENWA0 "Warmkennfeld 0 Generator" MAP 0x5aa10 _REC_MAP_32_u1_u1_u2 0. _CNV_R_R_igen_ub_q1_483_CM 0. 255. FORMAT "%8.4"
 /begin AXIS_DESCR STD_AXIS genikaltun _CNV_R_R_igen_ub_q1_483_CM 6 0. 255. FORMAT "%8.4" /end AXIS_DESCR
 /begin AXIS_DESCR STD_AXIS gentempend _CNV_R_R_temp_uw_q0_481_CM 7 -48. 336. FORMAT "%8.4" /end AXIS_DESCR
/end CHARACTERISTIC
/begin CHARACTERISTIC KFIGENWA1 "Warmkennfeld 1 Generator" MAP 0x5aa50 _REC_MAP_32_u1_u1_u2 0. _CNV_R_R_igen_ub_q1_483_CM 0. 255. FORMAT "%8.4"
 /begin AXIS_DESCR STD_AXIS genikaltun _CNV_R_R_igen_ub_q1_483_CM 6 0. 255. FORMAT "%8.4" /end AXIS_DESCR
 /begin AXIS_DESCR STD_AXIS gentempend _CNV_R_R_temp_uw_q0_481_CM 7 -48. 336. FORMAT "%8.4" /end AXIS_DESCR
/end CHARACTERISTIC
/begin CHARACTERISTIC KFIGENWA2 "Warmkennfeld 2 Generator" MAP 0x5aa90 _REC_MAP_32_u1_u1_u2 0. _CNV_R_R_igen_ub_q1_483_CM 0. 255. FORMAT "%8.4"
 /begin AXIS_DESCR STD_AXIS genikaltun _CNV_R_R_igen_ub_q1_483_CM 6 0. 255. FORMAT "%8.4" /end AXIS_DESCR
 /begin AXIS_DESCR STD_AXIS gentempend _CNV_R_R_temp_uw_q0_481_CM 7 -48. 336. FORMAT "%8.4" /end AXIS_DESCR
/end CHARACTERISTIC
/begin CHARACTERISTIC KFIGENWA3 "Warmkennfeld  3 Generator" MAP 0x5aad0 _REC_MAP_32_u1_u1_u2 0. _CNV_R_R_igen_ub_q1_483_CM 0. 255. FORMAT "%8.4"
 /begin AXIS_DESCR STD_AXIS genikaltun _CNV_R_R_igen_ub_q1_483_CM 6 0. 255. FORMAT "%8.4" /end AXIS_DESCR
 /begin AXIS_DESCR STD_AXIS gentempend _CNV_R_R_temp_uw_q0_481_CM 7 -48. 336. FORMAT "%8.4" /end AXIS_DESCR
/end CHARACTERISTIC
/begin CHARACTERISTIC KFIGENWA4 "Warmkennfeld 4 Generator" MAP 0x5ab10 _REC_MAP_32_u1_u1_u2 0. _CNV_R_R_igen_ub_q1_483_CM 0. 255. FORMAT "%8.4"
 /begin AXIS_DESCR STD_AXIS genikaltun _CNV_R_R_igen_ub_q1_483_CM 6 0. 255. FORMAT "%8.4" /end AXIS_DESCR
 /begin AXIS_DESCR STD_AXIS gentempend _CNV_R_R_temp_uw_q0_481_CM 7 -48. 336. FORMAT "%8.4" /end AXIS_DESCR
/end CHARACTERISTIC
/begin CHARACTERISTIC KFIGENWA5 "Warmkennfeld 5 Generator" MAP 0x5ab50 _REC_MAP_32_u1_u1_u2 0. _CNV_R_R_igen_ub_q1_483_CM 0. 255. FORMAT "%8.4"
 /begin AXIS_DESCR STD_AXIS genikaltun _CNV_R_R_igen_ub_q1_483_CM 6 0. 255. FORMAT "%8.4" /end AXIS_DESCR
 /begin AXIS_DESCR STD_AXIS gentempend _CNV_R_R_temp_uw_q0_481_CM 7 -48. 336. FORMAT "%8.4" /end AXIS_DESCR
/end CHARACTERISTIC
/begin CHARACTERISTIC KFIGENWA6 "Warmkennfeld 6 Generator" MAP 0x5ab90 _REC_MAP_32_u1_u1_u2 0. _CNV_R_R_igen_ub_q1_483_CM 0. 255. FORMAT "%8.4"
 /begin AXIS_DESCR STD_AXIS genikaltun _CNV_R_R_igen_ub_q1_483_CM 6 0. 255. FORMAT "%8.4" /end AXIS_DESCR
 /begin AXIS_DESCR STD_AXIS gentempend _CNV_R_R_temp_uw_q0_481_CM 7 -48. 336. FORMAT "%8.4" /end AXIS_DESCR
/end CHARACTERISTIC
/begin CHARACTERISTIC KFIGENWA7 "Warmkennfeld 7 Generator " MAP 0x5abd0 _REC_MAP_32_u1_u1_u2 0. _CNV_R_R_igen_ub_q1_483_CM 0. 255. FORMAT "%8.4"
 /begin AXIS_DESCR STD_AXIS genikaltun _CNV_R_R_igen_ub_q1_483_CM 6 0. 255. FORMAT "%8.4" /end AXIS_DESCR
 /begin AXIS_DESCR STD_AXIS gentempend _CNV_R_R_temp_uw_q0_481_CM 7 -48. 336. FORMAT "%8.4" /end AXIS_DESCR
/end CHARACTERISTIC
/begin MEASUREMENT ST_CRAWENG "Strombedarf Motor" UBYTE _CNV_R_R_igen_ub_q1_483_CM 1 100. 0. 254. ECU_ADDRESS 0x3fb14a FORMAT "%8.4" /end MEASUREMENT
/begin MEASUREMENT B_FIRSTEMP "Bedingung Generatorstarttemperatur-Berechnung" UBYTE _CNV_S_2_B_TRUE_519_CM 1 100. 0. 1. ECU_ADDRESS 0x3fa3c8 BIT_MASK 0x1 /end MEASUREMENT
/begin MEASUREMENT B_GENE "Generatormoment enable/disable" UBYTE _CNV_S_2_B_TRUE_519_CM 1 100. 0. 1. ECU_ADDRESS 0x3fa3c9 BIT_MASK 0x1 /end MEASUREMENT
/begin MEASUREMENT B_GENOFF "Bedingung Generator AUS" SBYTE _CNV_S_2_B_TRUE_519_CM 1 100. 0. 1. ECU_ADDRESS 0x3fa47a BIT_MASK 0x1 /end MEASUREMENT
/begin MEASUREMENT B_HEIZEN "Bedingung Generator in Heizphase" UBYTE _CNV_S_2_B_TRUE_519_CM 1 100. 0. 1. ECU_ADDRESS 0x3fa3cb BIT_MASK 0x1 /end MEASUREMENT
/begin MEASUREMENT GEN_TETA "Wirkungsgrad Generator W*PI temperaturkompensiert" UWORD _CNV_R_R_geneta_q0p_516_CM 1 100. 0. 32. ECU_ADDRESS 0x3fb194 FORMAT "%8.4" /end MEASUREMENT
/begin MEASUREMENT GEN_WETA "Wirkungsgrad Generator mit Omega*PI" UBYTE _CNV_R_R_geneta_q0p_516_CM 1 100. 0. 7.96875 ECU_ADDRESS 0x3fb1c1 FORMAT "%8.4" /end MEASUREMENT
/begin MEASUREMENT GENALFAK2 "Winderstands-Alpha-Faktor" UWORD _CNV_R_R_genalfak_u_522_CM 1 100. 0. 2.999939 ECU_ADDRESS 0x3fb170 FORMAT "%8.4" /end MEASUREMENT
/begin MEASUREMENT GENDTS "Temperaturerhoehung im Generatorstator" UWORD _CNV_R_R_gendt_q0p0_509_CM 1 100. 0. 768. ECU_ADDRESS 0x3fb172 FORMAT "%8.4" /end MEASUREMENT
/begin MEASUREMENT GENDTS_S1 "Temperaturerhöhung einer Statorspule und Diodenpaar" UWORD _CNV_R_R_gendt_q0p0_509_CM 1 100. 0. 192. ECU_ADDRESS 0x3fb176 FORMAT "%8.4" /end MEASUREMENT
/begin MEASUREMENT GENDTSVOR "Temp-Variable" UWORD _CNV_R_R_gendt_q0p0_509_CM 1 100. 0. 768. ECU_ADDRESS 0x3fb174 FORMAT "%8.4" /end MEASUREMENT
/begin MEASUREMENT GENFETA "Generatorwirkungsgrad Berechnnugsterm" ULONG _CNV_R_R_geneta_q0p_516_CM 1 100. 3.125e-002 8191.875 ECU_ADDRESS 0x3fb1ac FORMAT "%8.4" /end MEASUREMENT
/begin MEASUREMENT GENI_DIFK "mittlerer Diodenstrom" UWORD _CNV_R_R_igen_uw_q0_508_CM 1 100. 0. 255. ECU_ADDRESS 0x3fb17e FORMAT "%8.4" /end MEASUREMENT
/begin MEASUREMENT GENI_END "Generatorstrom gemessen / gerechnet" UBYTE _CNV_R_R_igen_ub_q1_483_CM 1 100. 0. 254. ECU_ADDRESS 0x3fb1bf FORMAT "%8.4" /end MEASUREMENT
/begin MEASUREMENT GENI_STFK "mittlerer Statorstrom" UWORD _CNV_R_R_igen_uw_q0_508_CM 1 100. 0. 255. ECU_ADDRESS 0x3fb180 FORMAT "%8.4" /end MEASUREMENT
/begin MEASUREMENT GENI2_ST "mittlerer quadratischer Statorstrom" UWORD _CNV_A_R_LINEAR_____12_CM 1 100. 0. 65535. ECU_ADDRESS 0x3fb178 FORMAT "%8.4" /end MEASUREMENT
/begin MEASUREMENT GENIG "Generatorstrom gesamt" UBYTE _CNV_R_R_igen_ub_q1_483_CM 1 100. 0. 255. ECU_ADDRESS 0x3fb1bc FORMAT "%8.4" /end MEASUREMENT
/begin MEASUREMENT GENIKALTUN "DF korrektiert ueber Generatordrehzahl" UBYTE _CNV_R_R_igen_ub_q1_483_CM 1 100. 0. 255. ECU_ADDRESS 0x3fb1bd FORMAT "%8.4" /end MEASUREMENT
/begin MEASUREMENT GENINAFIL "Generatorstrom nach Filter" UWORD _CNV_R_R_igen_uw_q0_508_CM 1 100. 0. 256. ECU_ADDRESS 0x3fb17a FORMAT "%8.4" /end MEASUREMENT
/begin MEASUREMENT GENITEMP "korrigiertes DF Signal ueber Temperatur, Generatordrehzahl, Generatorspannung" UBYTE _CNV_R_R_igen_ub_q1_483_CM 1 100. 0. 255. ECU_ADDRESS 0x3fb1be FORMAT "%8.4" /end MEASUREMENT
/begin MEASUREMENT GENIVORFIL "Generatorstrom vor Filter" UWORD _CNV_R_R_igen_uw_q0_508_CM 1 100. 0. 256. ECU_ADDRESS 0x3fb17c FORMAT "%8.4" /end MEASUREMENT
/begin MEASUREMENT GENRS "Statorwiderstand" UWORD _CNV_R_R_genrstator_515_CM 1 100. 0. 0.99998474 ECU_ADDRESS 0x3fb182 FORMAT "%8.4" /end MEASUREMENT
/begin MEASUREMENT GENSPV "Generatorstatorverlustleistung" UWORD _CNV_R_R_genpv_uw_q_523_CM 1 100. 0. 2047.9688 ECU_ADDRESS 0x3fb184 FORMAT "%8.4" /end MEASUREMENT
/begin MEASUREMENT GENSPV_1 "Verlustleistung einer Statorspule" ULONG _CNV_R_R_genpv_ul_524_CM 1 100. 0. 262144. ECU_ADDRESS 0x3fb1b0 FORMAT "%8.4" /end MEASUREMENT
/begin MEASUREMENT GENSPV_2 "Verlustleistung eines Diodenpaars" ULONG _CNV_R_R_genpv_ul_524_CM 1 100. 0. 262144. ECU_ADDRESS 0x3fb1b4 FORMAT "%8.4" /end MEASUREMENT
/begin MEASUREMENT GENSTTEMP "Generatorstarttemperatur" UWORD _CNV_R_R_temp_uw_q0_481_CM 1 100. -48. 336. ECU_ADDRESS 0x3fb186 FORMAT "%8.4" /end MEASUREMENT
/begin MEASUREMENT GENTEMP "Generatortemperatur" UWORD _CNV_R_R_temp_uw_q0_481_CM 1 100. -48. 336. ECU_ADDRESS 0x3fb18c FORMAT "%8.4" /end MEASUREMENT
/begin MEASUREMENT GENTEMPAB "Abstelltemperatur Generator" UWORD _CNV_R_R_temp_uw_q0_481_CM 1 100. -48. 336. ECU_ADDRESS 0x3fb2fe FORMAT "%8.4" /end MEASUREMENT
/begin MEASUREMENT GENTEMPDT "Temperaturdifferenz zwischen Abstelltemperatur und Umgebungstemperatur" SWORD _CNV_R_R_temp_sw_q0_525_CM 1 100. -48. 384. ECU_ADDRESS 0x3fb18e FORMAT "%8.4" /end MEASUREMENT
/begin MEASUREMENT GENTEMPEND "Generatortemperatur endgültig" UWORD _CNV_R_R_temp_uw_q0_481_CM 1 100. -48. 336. ECU_ADDRESS 0x3fb190 FORMAT "%8.4" /end MEASUREMENT
/begin MEASUREMENT GENTEMPEXP "Delta Abkühltemperatur" SWORD _CNV_R_R_temp_sw_q0_525_CM 1 100. -48. 384. ECU_ADDRESS 0x3fb192 FORMAT "%8.4" /end MEASUREMENT
/begin MEASUREMENT GENTEMPFIL "gefilterte Generatortemperatur" UWORD _CNV_R_R_gendt_q0p0_509_CM 1 100. 0. 768. ECU_ADDRESS 0x3fa3c4 FORMAT "%8.4" /end MEASUREMENT
/begin MEASUREMENT IGEN400A "gemmessener Generatorstrom 400A-Bereich" UWORD _CNV_R_R_fak_uw_b51_512_CM 1 100. 0. 511.99219 ECU_ADDRESS 0x3fb196 FORMAT "%8.4" /end MEASUREMENT
/begin MEASUREMENT MD_GENNM "gefiltertes Generatormoment absolut Ausgang" UWORD _CNV_R_R_md_ub_q0p0_526_CM 1 100. 0. 128. ECU_ADDRESS 0x3fb1a0 FORMAT "%8.4" /end MEASUREMENT
/begin MEASUREMENT MDNORMTMP "temporäre MDNORM" UBYTE _CNV_R_R_md_ub_q16_527_CM 1 100. 16. 1008. ECU_ADDRESS 0x3fa3cc FORMAT "%8.4" /end MEASUREMENT
/begin MEASUREMENT NGEN_W "Generatordrehzahl" UWORD _CNV_R_R_ngen_uw_q0_517_CM 1 100. 0. 32767.5 ECU_ADDRESS 0x3fa3c6 FORMAT "%8.4" /end MEASUREMENT
/begin MEASUREMENT NMOTS "Motordrehzahl U/s" UBYTE _CNV_R_R_igen_ub_q1_483_CM 1 100. 0. 255. ECU_ADDRESS 0x3fb1c5 FORMAT "%8.4" /end MEASUREMENT
/begin MEASUREMENT PGENAB "elektrische Generatorleistung" ULONG _CNV_R_R_genpv_uw_q_523_CM 1 100. 0. 4096. ECU_ADDRESS 0x3fb1b8 FORMAT "%8.4" /end MEASUREMENT
/begin MEASUREMENT ST_I_GEN "Generatorstrom" UBYTE _CNV_R_R_igen_ub_q1_483_CM 1 100. 0. 255. ECU_ADDRESS 0x3fb1c6 FORMAT "%8.4" /end MEASUREMENT
/begin MEASUREMENT TSTCOUNTV "Testcounter-Wert" UWORD _CNV_R_R_igen_ub_q1_483_CM 1 100. 0. 65535. ECU_ADDRESS 0x3fb1a2 FORMAT "%8.4" /end MEASUREMENT
/begin MEASUREMENT TSTFIL_OUT "Testfilter Ausgang" UWORD _CNV_R_R_gendt_q0p0_509_CM 1 100. 0. 768. ECU_ADDRESS 0x3fb1a4 FORMAT "%8.4" /end MEASUREMENT
/begin MEASUREMENT TSTLOCINI "Temp-Variable" UBYTE _CNV_S_2_B_TRUE_519_CM 1 100. 0. 1. ECU_ADDRESS 0x3fa3cd BIT_MASK 0x1 /end MEASUREMENT
/begin MEASUREMENT GENTANS "Generatoransauglufttemperatur" UWORD _CNV_R_R_temp_uw_q0_481_CM 1 100. -48. 336. ECU_ADDRESS 0x3fb188 FORMAT "%8.4" /end MEASUREMENT
/begin MEASUREMENT GENTANSEND "Generatoransaugluftendwert" UWORD _CNV_R_R_temp_uw_q0_481_CM 1 100. -48. 143.25 ECU_ADDRESS 0x3fb18a FORMAT "%8.4" /end MEASUREMENT
/begin MEASUREMENT B_GENERKEN "Anfoderung der Generatorerkennung" UBYTE _CNV_S_2_B_TRUE_519_CM 1 100. 0. 1. ECU_ADDRESS 0x3fa3ca BIT_MASK 0x1 /end MEASUREMENT
/begin MEASUREMENT DIB_IG "Delta Ibasis zu genig" SWORD _CNV_R_R_igen_ub_q1_483_CM 1 100. -255. 255. ECU_ADDRESS 0x3fb16c FORMAT "%8.4" /end MEASUREMENT
/begin MEASUREMENT FDIB_IG "Faktor bewerte Delta I" SWORD _CNV_R_R_igen_ub_q1_483_CM 1 100. -255. 255. ECU_ADDRESS 0x3fb16e FORMAT "%8.4" /end MEASUREMENT
/begin MEASUREMENT GENAWNUMM "Generatorkennfeldnummer" UBYTE _CNV_R_R_igen_ub_q1_483_CM 1 100. 0. 255. ECU_ADDRESS 0x3fb2fc FORMAT "%8.4" /end MEASUREMENT
/begin MEASUREMENT GENDI_SPV "mittlerer quadratischer Diodenstrom" ULONG _CNV_R_R_genpv_ul_524_CM 1 100. 0. 510. ECU_ADDRESS 0x3fb1a8 FORMAT "%8.4" /end MEASUREMENT
/begin MEASUREMENT GENNUMMER "erkannte Generatornummer" UBYTE _CNV_R_R_igen_ub_q1_483_CM 1 100. 0. 255. ECU_ADDRESS 0x3fb1c0 FORMAT "%8.4" /end MEASUREMENT
/begin MEASUREMENT IBASIS "Basis Strombedarf FZG mit SLP" UBYTE _CNV_R_R_igen_ub_q1_483_CM 1 100. 0. 255. ECU_ADDRESS 0x3fb1c2 FORMAT "%8.4" /end MEASUREMENT
/begin MEASUREMENT IGM "Generatormischstrom" UBYTE _CNV_R_R_igen_ub_q1_483_CM 1 100. 0. 255. ECU_ADDRESS 0x3fb1c3 FORMAT "%8.4" /end MEASUREMENT
/begin MEASUREMENT IGVOR "Stromwert nach Überblendung" UBYTE _CNV_R_R_igen_ub_q1_483_CM 1 100. 0. 255. ECU_ADDRESS 0x3fb1c4 FORMAT "%8.4" /end MEASUREMENT
/begin MEASUREMENT MDGENREL_W "relatives Generatormoment Ausgang" UWORD _CNV_R_R_rel_uw_b10_528_CM 1 100. 0. 99.998474 ECU_ADDRESS 0x3fb19c FORMAT "%8.4" /end MEASUREMENT
/begin MEASUREMENT MDGENVF_W "relatives Generatordrehmoment" UWORD _CNV_R_R_rel_uw_b10_528_CM 1 100. 0. 99.998474 ECU_ADDRESS 0x3fb19e FORMAT "%8.4" /end MEASUREMENT
/begin MEASUREMENT UGEN_TMP "Sollspannung vom Generator" UWORD _CNV_R_R_spg_ugen_521_CM 1 100. 10.6 16. ECU_ADDRESS 0x3fb1a6 FORMAT "%8.4" /end MEASUREMENT
/begin MEASUREMENT B_GENACTIV "Bedingung Generatorinterface aktiv" SBYTE _CNV_S_2_B_TRUE_519_CM 1 100. 0. 1. ECU_ADDRESS 0x3fda72 BIT_MASK 0x1 /end MEASUREMENT
/begin MEASUREMENT MDGENFIL_W "gefiltertes Generatormoment absolut" UWORD _CNV_R_R_md_ub_q0p0_526_CM 1 100. 0. 128. ECU_ADDRESS 0x3fb198 FORMAT "%8.4" /end MEASUREMENT
/begin MEASUREMENT MDGENNMUFI "Generatormoment absolut" UWORD _CNV_R_R_md_ub_q0p0_526_CM 1 100. 0. 128. ECU_ADDRESS 0x3fb19a FORMAT "%8.4" /end MEASUREMENT
/begin CHARACTERISTIC GENMDNMOF "Offset des Generatormoments" VALUE 0x5b442 _REC_VAL_20_u2 0. _CNV_R_R_md_ub_q0p0_526_CM 0. 128. FORMAT "%8.4" /end CHARACTERISTIC
/begin CHARACTERISTIC IGNOTWERT "Generatornotlaufwert bei BSD-Ausfall" VALUE 0x5b4ec _REC_VAL_20_u1 0. _CNV_R_R_igen_ub_q1_483_CM 0. 255. FORMAT "%8.4" /end CHARACTERISTIC
/begin CHARACTERISTIC KFMDGENFIL "Kennfeld Zeitkonstante Generatormomentfilterung" MAP 0x5a3fc _REC_MAP_32_u2_u2_u2 0. _CNV_R_R_genzmst_uw_511_CM 0. 0.99998474 FORMAT "%8.4"
 /begin AXIS_DESCR STD_AXIS mdgenrel_w _CNV_R_R_md_ub_q0p0_526_CM 6 0. 128. FORMAT "%8.4" /end AXIS_DESCR
 /begin AXIS_DESCR STD_AXIS nmot_w _CNV_R_R_nmot_uw_q0_488_CM 6 0. 16383.75 FORMAT "%8.4" /end AXIS_DESCR
/end CHARACTERISTIC
/begin MEASUREMENT TLRFGEN "received load response time from alternator" UBYTE _CNV_A_R_LINEAR_____14_CM 1 100. 0. 25.5 ECU_ADDRESS 0x3fc5a9 FORMAT "%4.1" /end MEASUREMENT
/begin MEASUREMENT UFGEN "received alternator voltage" UBYTE _CNV_A_R_LINEAR_____70_CM 1 100. 10.6 16.9 ECU_ADDRESS 0x3fc5aa FORMAT "%4.1" /end MEASUREMENT
/begin MEASUREMENT B_GENFEL "alternator failure: electrical" UBYTE _CNV_S_2_RANGE______28_CM 1 100. 0. 1. ECU_ADDRESS 0x3fc5ab /end MEASUREMENT
/begin MEASUREMENT B_GENFHT "alternator failure: high temperature" UBYTE _CNV_S_2_RANGE______28_CM 1 100. 0. 1. ECU_ADDRESS 0x3fc5ac /end MEASUREMENT
/begin MEASUREMENT B_GENFME "alternator failure: mechanical" UBYTE _CNV_S_2_RANGE______28_CM 1 100. 0. 1. ECU_ADDRESS 0x3fc5ad /end MEASUREMENT
/begin MEASUREMENT B_GENFBSD "alternator failure: BSD interface" UBYTE _CNV_S_2_RANGE______28_CM 1 100. 0. 1. ECU_ADDRESS 0x3fc5ae /end MEASUREMENT
/begin CHARACTERISTIC C_VB_MIN_BSD_DIAG "Battery voltage threshold of power management diagnosis" VALUE 0x42b0d _REC_VAL_20_u1 26. _CNV_A_R_LINEAR_____53_CM 0. 26. FORMAT "%4.1" /end CHARACTERISTIC
/begin CHARACTERISTIC APPTBATINI "Enable Applikation Initwert Batterietemperatur" VALUE 0x5b67c _REC_VAL_20_u1 0. _CNV_A_R_LINEAR_____10_CM 0. 255. FORMAT "%3.0" /end CHARACTERISTIC
/begin CHARACTERISTIC BATT_ALFAH "Alphatau-Wert Batterie hinten" VALUE 0x5b698 _REC_VAL_20_S4 0.9999900000000002 _CNV_A_R_LINEAR_____12_CM 1.e-005 1. /end CHARACTERISTIC
/begin CHARACTERISTIC BATT_ALFAV "Alphatau-Wert Batterie vorne" VALUE 0x5b69c _REC_VAL_20_S4 0.9999900000000002 _CNV_A_R_LINEAR_____12_CM 1.e-005 1. /end CHARACTERISTIC
/begin CHARACTERISTIC BATT_BETAV "Beta-Wert Batterie vorne" VALUE 0x5b6a0 _REC_VAL_20_S4 0.9999900000000002 _CNV_A_R_LINEAR_____12_CM 1.e-005 1. /end CHARACTERISTIC
/begin CHARACTERISTIC BATTHTAUVK "Zeitkonstante Batterie hinten bei VFZG<" VALUE 0x5b68c _REC_VAL_20_S4 1. _CNV_A_R_LINEAR_____12_CM 0. 1. /end CHARACTERISTIC
/begin CHARACTERISTIC BATTVTAUVG "Zeitkonstante Batterie vorne bei VFZG>" VALUE 0x5b690 _REC_VAL_20_S4 1. _CNV_A_R_LINEAR_____12_CM 0. 1. /end CHARACTERISTIC
/begin CHARACTERISTIC BATTVTAUVK "Zeitkonstante Batterie bei VFZG<Zeitkonstante Batterie bei VFZG>" VALUE 0x5b694 _REC_VAL_20_S4 1. _CNV_A_R_LINEAR_____12_CM 0. 1. /end CHARACTERISTIC
/begin CHARACTERISTIC KLBATTLSTR "Geschwindigkeitsfaktor Batterieumgebungstemperatur" CURVE 0x5b4fc _REC_CUR_34_S4_S4 65534.9 _CNV_A_R_LINEAR_____12_CM 0.1 65535. /begin AXIS_DESCR STD_AXIS vfzg _CNV_A_R_LINEAR_____12_CM 6 0. 65535. /end AXIS_DESCR /end CHARACTERISTIC
/begin CHARACTERISTIC KLEXPALH "Funktion EXP(-ALPHA*tabst_w) hinten" CURVE 0x5b530 _REC_CUR_34_S4_S4 1. _CNV_A_R_LINEAR_____12_CM 0. 1. /begin AXIS_DESCR STD_AXIS tabst_fl _CNV_A_R_LINEAR_____12_CM 11 0. 65535. /end AXIS_DESCR /end CHARACTERISTIC
/begin CHARACTERISTIC KLEXPALV "Funktion EXP(-ALPHA*tabst_w) hinten" CURVE 0x5b58c _REC_CUR_34_S4_S4 1. _CNV_A_R_LINEAR_____12_CM 0. 1. /begin AXIS_DESCR STD_AXIS tabst_fl _CNV_A_R_LINEAR_____12_CM 11 0. 65535. /end AXIS_DESCR /end CHARACTERISTIC
/begin CHARACTERISTIC KLEXPBETAV "Funktion EXP (-BETA*tabst_w)" CURVE 0x5b5e8 _REC_CUR_34_S4_S4 1. _CNV_A_R_LINEAR_____12_CM 0. 1. /begin AXIS_DESCR STD_AXIS tabst_fl _CNV_A_R_LINEAR_____12_CM 11 0. 65535. /end AXIS_DESCR /end CHARACTERISTIC
/begin CHARACTERISTIC LADEKENNL "Batterieladespannungskennlinie" CURVE 0x5b644 _REC_CUR_34_S4_S4 16. _CNV_A_R_LINEAR_____12_CM 0. 16.
 /begin AXIS_DESCR STD_AXIS t_battabst _CNV_A_R_LINEAR_____12_CM 6 -2147483648. 4294967295. /end AXIS_DESCR
/end CHARACTERISTIC
/begin CHARACTERISTIC PLBATTUMG "Plausibilisierung-Schwelle Batterieumgebungstemperatur" VALUE 0x5b6b0 _REC_VAL_20_S4 6442450943. _CNV_A_R_LINEAR_____12_CM -2147483648. 4294967295. /end CHARACTERISTIC
/begin CHARACTERISTIC TBATINIMAN "Applikation INITWERT Batterietemperatur" VALUE 0x5b685 _REC_VAL_20_u1 191.25 _CNV_R_R_temp_uw_q0_481_CM -48. 143.25 FORMAT "%8.4" /end CHARACTERISTIC
/begin CHARACTERISTIC TBATTFTAUV "Zeitkonstante 5*Tau Batterievorne" VALUE 0x5b678 _REC_VAL_20_u2 65535. _CNV_R_R_igen_ub_q1_483_CM 0. 65535. FORMAT "%8.4" /end CHARACTERISTIC
/begin CHARACTERISTIC TBATTTAUFH "Zeitkonstante Batterie 5*Tau hinten" VALUE 0x5b6b4 _REC_VAL_20_S4 65535. _CNV_A_R_LINEAR_____12_CM 0. 65535. /end CHARACTERISTIC
/begin CHARACTERISTIC ULADE_TAU "Batterieladespannungs Zeitkonstante" VALUE 0x5b6bc _REC_VAL_20_S4 1. _CNV_A_R_LINEAR_____12_CM 0. 1. /end CHARACTERISTIC
/begin CHARACTERISTIC BATTORT0 "Batterieeinbauort No1" VALUE 0x5b67d _REC_VAL_20_u1 255. _CNV_A_R_LINEAR_____12_CM 0. 255. FORMAT "%8.4" /end CHARACTERISTIC
/begin CHARACTERISTIC BATTORT2 "Batterieeinbauort No2" VALUE 0x5b67e _REC_VAL_20_u1 255. _CNV_A_R_LINEAR_____12_CM 0. 255. FORMAT "%8.4" /end CHARACTERISTIC
/begin CHARACTERISTIC DTANSKOR "Ansaugluftmodelloffset Aussentemperatur" VALUE 0x5b680 _REC_VAL_20_s1 255. _CNV_R_R_temp_q1_535_CM -128. 127. FORMAT "%8.4" /end CHARACTERISTIC
/begin CHARACTERISTIC ILMINUMG "integrierte Lufmassenschwelle Aussentemperaturmodell" VALUE 0x5b681 _REC_VAL_20_u1 23.210667 _CNV_R_R_m_ub_b23p3_536_CM 0. 23.210667 FORMAT "%8.4" /end CHARACTERISTIC
/begin CHARACTERISTIC LBATTMAX "maximale Batterieladespannung Licht aus" VALUE 0x5b6a4 _REC_VAL_20_S4 16. _CNV_A_R_LINEAR_____12_CM 0. 16. /end CHARACTERISTIC
/begin CHARACTERISTIC LBATTMIN "minmale Batterieladespannung Licht an" VALUE 0x5b6a8 _REC_VAL_20_S4 16. _CNV_A_R_LINEAR_____12_CM 0. 16. /end CHARACTERISTIC
/begin CHARACTERISTIC MCOBATTORT "Codierung Hand Batterieeinbauort" VALUE 0x5b682 _REC_VAL_20_u1 2. _CNV_A_R_LINEAR_____12_CM 0. 2. FORMAT "%8.4" /end CHARACTERISTIC
/begin CHARACTERISTIC NMINUMG "Drehzahlschwelle Aussentemperaturmodell" VALUE 0x5b683 _REC_VAL_20_u1 10200. _CNV_A_R_nmot_ub_q4_537_CM 0. 10200. FORMAT "%8.4" /end CHARACTERISTIC
/begin CHARACTERISTIC OFTUMGCAN "Offset Umgebungstemperatur CAN" VALUE 0x5b684 _REC_VAL_20_s1 255. _CNV_R_R_temp_q1_535_CM -128. 127. FORMAT "%8.4" /end CHARACTERISTIC
/begin CHARACTERISTIC TUMGINI "Initialisierungswert Aussentemperaturmodell" VALUE 0x5b686 _REC_VAL_20_s1 255. _CNV_R_R_temp_q1_535_CM -128. 127. FORMAT "%8.4" /end CHARACTERISTIC
/begin CHARACTERISTIC TUMGTAU "Zeitkonstante 5*Tau Aussentemperatur" VALUE 0x5b67a _REC_VAL_20_u2 65535. _CNV_R_R_igen_ub_q1_483_CM 0. 65535. FORMAT "%8.4" /end CHARACTERISTIC
/begin CHARACTERISTIC UBATTNORM "Batterienormspannung" VALUE 0x5b6b8 _REC_VAL_20_S4 6442450943. _CNV_A_R_LINEAR_____12_CM -2147483648. 4294967295. /end CHARACTERISTIC
/begin CHARACTERISTIC VMINUMG "Fahrzeuggeschwindigkeitsschwelle Aussentemperaturmodell" VALUE 0x5b687 _REC_VAL_20_u1 318.75 _CNV_R_R_vfzg_ub_q1_482_CM 0. 318.75 FORMAT "%8.4" /end CHARACTERISTIC
/begin CHARACTERISTIC BATVFZGTAU "VFZG-Umschaltschwelle TAU Batterie" VALUE 0x5b67f _REC_VAL_20_u1 318.75 _CNV_R_R_vfzg_ub_q1_482_CM 0. 318.75 FORMAT "%8.4" /end CHARACTERISTIC
/begin CHARACTERISTIC BATTHTAUVG "Zeitkonstante Batterie hinten bei VFZG>" VALUE 0x5b688 _REC_VAL_20_S4 1. _CNV_A_R_LINEAR_____12_CM 0. 1. /end CHARACTERISTIC
/begin CHARACTERISTIC GENLDDFMAX "Schwell Anzeige maximaler Auslastungsgrad Generator" VALUE 0x5b6e0 _REC_VAL_20_u1 99.609375 _CNV_A_R_PCENT_484_CM 0. 99.609375 FORMAT "%8.4" /end CHARACTERISTIC
/begin CHARACTERISTIC KLGENLDST "Auslastungsgrad Generator" CURVE 0x5b6c0 _REC_CUR_52_u2_u2 100. _CNV_A_R_PCENT_484_CM 0. 100. FORMAT "%8.4"
 /begin AXIS_DESCR STD_AXIS gentemp _CNV_R_R_temp_uw_q0_481_CM 6 -48. 336. FORMAT "%8.4" /end AXIS_DESCR
/end CHARACTERISTIC
/begin CHARACTERISTIC DFMODE "DF-Mode-Schalter themermisch/elektrisch" VALUE 0x5b6dc _REC_VAL_20_u1 255. _CNV_A_R_LINEAR_____12_CM 0. 255. FORMAT "%8.4" /end CHARACTERISTIC
/begin CHARACTERISTIC DFS_MAX "DF-Auslastung Maximalschwelle" VALUE 0x5b6dd _REC_VAL_20_u1 99.609375 _CNV_A_R_PCENT_484_CM 0. 99.609375 FORMAT "%8.4" /end CHARACTERISTIC
/begin CHARACTERISTIC DFS_MIN "DF-Auslastung Minimalschwelle" VALUE 0x5b6de _REC_VAL_20_u1 99.609375 _CNV_A_R_PCENT_484_CM 0. 99.609375 FORMAT "%8.4" /end CHARACTERISTIC
/begin CHARACTERISTIC DFS_MITT "DF-Auslastung Mittelschwelle" VALUE 0x5b6df _REC_VAL_20_u1 99.609375 _CNV_A_R_PCENT_484_CM 0. 99.609375 FORMAT "%8.4" /end CHARACTERISTIC
/begin CHARACTERISTIC TNNSTART "Zeittriggerschwelle nach Motorstart" VALUE 0x5b6da _REC_VAL_20_u2 655.35 _CNV_R_R_t10msxs_ub_520_CM 0. 655.35 FORMAT "%8.4" /end CHARACTERISTIC
/begin CHARACTERISTIC B_APP_LLAH "Manuelle Umschaltung auf LL-Anhebung HAND" VALUE 0x5b6e1 _REC_VAL_20_u1 255. _CNV_A_R_LINEAR_____12_CM 0. 255. FORMAT "%8.4" /end CHARACTERISTIC
/begin CHARACTERISTIC GENLLAHAPP "Manuelle Leerlaufdrehzahlanhebung" VALUE 0x5b6e2 _REC_VAL_20_u1 255. _CNV_A_R_LINEAR_____12_CM 0. 255. FORMAT "%8.4" /end CHARACTERISTIC
/begin CHARACTERISTIC NSUBO "nsoll bei Batterieladebilanz zu niedrig" VALUE 0x5b6e3 _REC_VAL_20_u1 2550. _CNV_R_R_nmot_ub_q1_538_CM 0. 2550. FORMAT "%8.4" /end CHARACTERISTIC
/begin CHARACTERISTIC NSUBU "nsoll bei Batterieladebilanz io" VALUE 0x5b6e4 _REC_VAL_20_u1 2550. _CNV_R_R_nmot_ub_q1_538_CM 0. 2550. FORMAT "%8.4" /end CHARACTERISTIC
/begin CHARACTERISTIC ENAPPLGOFF "Enable Generatorauschaltsteuerung" VALUE 0x5b73e _REC_VAL_20_u1 255. _CNV_A_R_LINEAR_____12_CM 0. 255. FORMAT "%8.4" /end CHARACTERISTIC
/begin CHARACTERISTIC ENAPPLRESP "Enable Handsteuerung Loadresponse" VALUE 0x5b73f _REC_VAL_20_u1 255. _CNV_A_R_LINEAR_____12_CM 0. 255. FORMAT "%8.4" /end CHARACTERISTIC
/begin CHARACTERISTIC KFLORESP "Kennfeld Loadresponse ueber Motordrehzahl und rel. Luftmasse" MAP 0x5b6e5 _REC_MAP_52_u1_u1_u1 25.5 _CNV_R_R_t100msxs_u_485_CM 0. 25.5 FORMAT "%8.4"
 /begin AXIS_DESCR STD_AXIS nmot _CNV_A_R_nmot_ub_q4_537_CM 6 0. 10200. FORMAT "%8.4" /end AXIS_DESCR
 /begin AXIS_DESCR STD_AXIS rl _CNV_A_R_rel_ub_q0p_539_CM 6 0. 191.25 FORMAT "%8.4" /end AXIS_DESCR
/end CHARACTERISTIC
/begin CHARACTERISTIC KLLORESPM "Motorabhängiger Loadresponse-Faktor" CURVE 0x5b717 _REC_CUR_52_u1_u1 3.984375 _CNV_R_R_fak_ub_b4_513_CM 0. 3.984375 FORMAT "%8.4"
 /begin AXIS_DESCR STD_AXIS tmot _CNV_R_R_temp_uw_q0_481_CM 6 -48. 143.25 FORMAT "%8.4" /end AXIS_DESCR
/end CHARACTERISTIC
/begin CHARACTERISTIC KLZLRESOF "Kennlinie Generatorausschaltzeit bei Stillstand" CURVE 0x5b724 _REC_CUR_52_u1_u1 255. _CNV_R_R_igen_ub_q1_483_CM 0. 255. FORMAT "%8.4"
 /begin AXIS_DESCR STD_AXIS tmst _CNV_R_R_temp_uw_q0_481_CM 6 -48. 143.25 FORMAT "%8.4" /end AXIS_DESCR
/end CHARACTERISTIC
/begin CHARACTERISTIC KLZLRESOFV "Kennlinie Generatorausschaltzeit bei Fahrt" CURVE 0x5b731 _REC_CUR_52_u1_u1 255. _CNV_R_R_igen_ub_q1_483_CM 0. 255. FORMAT "%8.4"
 /begin AXIS_DESCR STD_AXIS tmst _CNV_R_R_temp_uw_q0_481_CM 6 -48. 143.25 FORMAT "%8.4" /end AXIS_DESCR
/end CHARACTERISTIC
/begin CHARACTERISTIC LRESPAPP "Load-Response Applikation" VALUE 0x5b740 _REC_VAL_20_u1 25.5 _CNV_R_R_t100msxs_u_485_CM 0. 25.5 FORMAT "%8.4" /end CHARACTERISTIC
/begin CHARACTERISTIC RLMXGENOF "relative Luftfüllungschwelle für Generatorzuschaltung" VALUE 0x5b742 _REC_VAL_20_u1 191.25 _CNV_A_R_rel_ub_q0p_539_CM 0. 191.25 FORMAT "%8.4" /end CHARACTERISTIC
/begin CHARACTERISTIC TGENOFVL "Generatorsabschaltzeit bei Vollastbeschleunigung" VALUE 0x5b745 _REC_VAL_20_u1 255. _CNV_R_R_igen_ub_q1_483_CM 0. 255. FORMAT "%8.4" /end CHARACTERISTIC
/begin CHARACTERISTIC TLORESPST "Startloadresponse" VALUE 0x5b746 _REC_VAL_20_u1 25.5 _CNV_R_R_t100msxs_u_485_CM 0. 25.5 FORMAT "%8.4" /end CHARACTERISTIC
/begin CHARACTERISTIC TVLOFHYST "Hysterese Generatorvollastabschaltung" VALUE 0x5b747 _REC_VAL_20_u1 255. _CNV_R_R_igen_ub_q1_483_CM 0. 255. FORMAT "%8.4" /end CHARACTERISTIC
/begin CHARACTERISTIC VGENOFMN "Geschwindigkeitgeneratorabschaltschwelle bei Vollastbeschleunigung" VALUE 0x5b748 _REC_VAL_20_u1 318.75 _CNV_R_R_vfzg_ub_q1_482_CM 0. 318.75 FORMAT "%8.4" /end CHARACTERISTIC
/begin CHARACTERISTIC VGENOGMX "Geschwindigkeitgeneratorzuschaltschwelle bei Vollastbeschleunigung" VALUE 0x5b749 _REC_VAL_20_u1 318.75 _CNV_R_R_vfzg_ub_q1_482_CM 0. 318.75 FORMAT "%8.4" /end CHARACTERISTIC
/begin CHARACTERISTIC NMXGENOF "Motordrehzahlschwelle für Generatorzuschaltung" VALUE 0x5b741 _REC_VAL_20_u1 10200. _CNV_A_R_nmot_ub_q4_537_CM 0. 10200. FORMAT "%8.4" /end CHARACTERISTIC
/begin CHARACTERISTIC S_LORESLL "Schalter Kennlinienausschaltzeit " VALUE 0x5b743 _REC_VAL_20_u1 255. _CNV_A_R_LINEAR_____12_CM 0. 255. /end CHARACTERISTIC
/begin CHARACTERISTIC TATMGENOF "Motordrehzahlschwelle  Katalysatortemperatur" VALUE 0x5b744 _REC_VAL_20_u1 1275. _CNV_R_R_temp_ub_q5_540_CM -50. 1225. FORMAT "%8.4" /end CHARACTERISTIC
/begin CHARACTERISTIC VZLORESOFV "Geschwindigkeitsschwelle für Generatorzuschaltung" VALUE 0x5b74a _REC_VAL_20_u1 318.75 _CNV_R_R_vfzg_ub_q1_482_CM 0. 318.75 FORMAT "%8.4" /end CHARACTERISTIC
/begin MEASUREMENT B_KL15 "Bedingung Kl15" UBYTE _CNV_A_R_LINEAR_____12_CM 1 100. 0. 255. ECU_ADDRESS 0x3fc56c BIT_MASK 0x1 /end MEASUREMENT
/begin MEASUREMENT B_TNS "Bedingung Tag/Nachtlicht" UBYTE _CNV_A_R_LINEAR_____12_CM 1 100. 0. 255. ECU_ADDRESS 0x3fc576 BIT_MASK 0x1 /end MEASUREMENT
/begin MEASUREMENT B_FS "Bedingung Fahrstufe" UBYTE _CNV_A_R_LINEAR_____12_CM 1 100. 0. 255. ECU_ADDRESS 0x3fc568 BIT_MASK 0x1 /end MEASUREMENT
/begin MEASUREMENT B_LL "Bedingung Leerlauf" UBYTE _CNV_A_R_LINEAR_____12_CM 1 100. 0. 255. ECU_ADDRESS 0x3fc569 BIT_MASK 0x1 /end MEASUREMENT
/begin MEASUREMENT B_LLREIN "Bedingung LLR ist aktiv" UBYTE _CNV_A_R_LINEAR_____12_CM 1 100. 0. 255. ECU_ADDRESS 0x3fc573 BIT_MASK 0x1 /end MEASUREMENT
/begin MEASUREMENT B_VL "Bedingung Vollast" UBYTE _CNV_A_R_LINEAR_____12_CM 1 100. 0. 255. ECU_ADDRESS 0x3fc572 BIT_MASK 0x1 /end MEASUREMENT
/begin MEASUREMENT B_NMOT "" UBYTE _CNV_A_R_LINEAR_____12_CM 1 100. 0. 255. ECU_ADDRESS 0x3fc560 BIT_MASK 0x1 /end MEASUREMENT
/begin MEASUREMENT B_ETUM "Bedingung Fehler in Umgebungstemperatur" UBYTE _CNV_A_R_LINEAR_____12_CM 1 100. 0. 255. ECU_ADDRESS 0x3fc589 BIT_MASK 0x1 /end MEASUREMENT
/begin CHARACTERISTIC APPNIDLIBS "" VALUE 0x4269c _REC_VAL_20_u1 255. _CNV_A_R_LINEAR_____10_CM 0. 255. FORMAT "%3.0" /end CHARACTERISTIC
/begin CHARACTERISTIC APPUIBS "" VALUE 0x4269d _REC_VAL_20_u1 6.375000000000003 _CNV_R_R_spg_gencan_573_CM 10.6 16.975 FORMAT "%8.4" /end CHARACTERISTIC
/begin CHARACTERISTIC B_APP_UGEN "Umschaltung auf manuelle Generatorspannungsvorgabe" VALUE 0x5b778 _REC_VAL_20_u1 255. _CNV_A_R_LINEAR_____12_CM 0. 255. FORMAT "%8.4" /end CHARACTERISTIC
/begin CHARACTERISTIC GENOFFTIME "maximale Generatorauszeit" VALUE 0x5b768 _REC_VAL_20_u2 6553.5 _CNV_R_R_t100msxs_u_485_CM 0. 6553.5 FORMAT "%8.4" /end CHARACTERISTIC
/begin CHARACTERISTIC GENUMAX "maximale Generatorspannung" VALUE 0x5b76a _REC_VAL_20_u2 20. _CNV_R_R_spg_sw_q0p_576_CM 0. 20. FORMAT "%8.4" /end CHARACTERISTIC
/begin CHARACTERISTIC GENURAMP "Spannungsinkrement fuer Rampe" VALUE 0x5b76c _REC_VAL_20_u2 20. _CNV_R_R_spg_sw_q0p_576_CM 0. 20. FORMAT "%8.4" /end CHARACTERISTIC
/begin CHARACTERISTIC GENURAMPOF "Spannungsinkrement fuer Rampe, Generator ausschalten" VALUE 0x5b76e _REC_VAL_20_u2 20. _CNV_R_R_spg_sw_q0p_576_CM 0. 20. FORMAT "%8.4" /end CHARACTERISTIC
/begin CHARACTERISTIC S_GOFFRAMP "Schalter Sprung auf 10,6V unverzoegert" VALUE 0x5b77a _REC_VAL_20_u1 255. _CNV_A_R_LINEAR_____12_CM 0. 255. FORMAT "%8.4" /end CHARACTERISTIC
/begin CHARACTERISTIC UGENOFF "Generatorauschaltspannung bei vfzg = 0" VALUE 0x5b772 _REC_VAL_20_u2 20. _CNV_R_R_spg_sw_q0p_576_CM 0. 20. FORMAT "%8.4" /end CHARACTERISTIC
/begin CHARACTERISTIC UGENOFFV0 "Generatorauschaltspannung bei vfzg != 0" VALUE 0x5b774 _REC_VAL_20_u2 20. _CNV_R_R_spg_sw_q0p_576_CM 0. 20. FORMAT "%8.4" /end CHARACTERISTIC
/begin CHARACTERISTIC KLFGENSLP "" CURVE 0x5b75a _REC_CUR_52_u1_u1 0.99609375 _CNV_R_R_fak_q0p003_514_CM 0. 0.99609375 FORMAT "%8.4"
 /begin AXIS_DESCR STD_AXIS imlpr _CNV_R_R_fak_q0p003_514_CM 6 0. 0.99609375 FORMAT "%8.4" /end AXIS_DESCR
/end CHARACTERISTIC
/begin CHARACTERISTIC KLUBATTMAX "" CURVE 0x5b74c _REC_CUR_52_UBYTE_u2_u1 16. _CNV_R_R_spg_sw_q0p_576_CM 0. 16. FORMAT "%8.4"
 /begin AXIS_DESCR STD_AXIS tbatt _CNV_R_R_temp_uw_q0_481_CM 4 -48. 143.25 FORMAT "%8.4" /end AXIS_DESCR
/end CHARACTERISTIC
/begin CHARACTERISTIC S_ENGENSLP "Schalter Enable Sollspannung SLP" VALUE 0x5b779 _REC_VAL_20_u1 0. _CNV_R_R_igen_ub_q1_483_CM 0. 255. FORMAT "%8.4" /end CHARACTERISTIC
/begin CHARACTERISTIC U_GENSLP "Sollspannung Generator von SLP" VALUE 0x5b776 _REC_VAL_20_u2 0. _CNV_R_R_spg_sw_q0p_576_CM 0. 16. FORMAT "%8.4" /end CHARACTERISTIC
/begin CHARACTERISTIC LC_POW_CORD_INH "Configuration of alternator powermanagement" VALUE 0x42bbc _REC_VAL_20_u1 1. _CNV_A_R_LINEAR_____12_CM 0. 1. FORMAT "%1.0" /end CHARACTERISTIC
/begin CHARACTERISTIC GEN_APP_UG "Manuelle Generatorspannungsvorgabe" VALUE 0x5b770 _REC_VAL_20_u2 20. _CNV_R_R_spg_sw_q0p_576_CM 0. 20. FORMAT "%8.4" /end CHARACTERISTIC
/begin CHARACTERISTIC C_CAM_HYS_AD_IVVT "" VALUE 0x427fd _REC_VAL_20_u1 47.625 _CNV_A_R_LINEAR_____75_CM 0. 47.625 /end CHARACTERISTIC
/begin CHARACTERISTIC C_CAM_HYS_REF_IVVT "" VALUE 0x427ff _REC_VAL_20_u1 95.625 _CNV_A_R_LINEAR_____75_CM 0. 95.625 /end CHARACTERISTIC
/begin CHARACTERISTIC C_CAM_INI_IN "valve spread angle inlet camshafts with IVVT passive" VALUE 0x42802 _REC_VAL_20_u1 95.625 _CNV_A_R_LINEAR_____234_CM 60. 155.625 FORMAT "%5.1" /end CHARACTERISTIC
/begin CHARACTERISTIC C_CAM_INI_EX "valve spread angle exhaust camshaft  with IVVT passive" VALUE 0x42801 _REC_VAL_20_u1 -95.625 _CNV_A_R_LINEAR_____231_CM -40. -135.625 FORMAT "%5.1" /end CHARACTERISTIC
/begin AXIS_PTS ldpm_n_32_3_ivvt "" 0x43d58 N_32 _REC_AXS_20_u1 8160. _CNV_A_R_LINEAR_____5_CM 6 0. 8160. FORMAT "%4.0" /end AXIS_PTS
/begin AXIS_PTS ldpm_n_32_2_ivvt "" 0x43d38 N_32 _REC_AXS_20_u1 8160. _CNV_A_R_LINEAR_____5_CM 8 0. 8160. FORMAT "%4.0" /end AXIS_PTS
/begin AXIS_PTS ldpm_tmag_ivvt_1_ivvt "" 0x4405b TMAG _REC_AXS_20_u1 200. _CNV_A_R_LINEAR_____3_CM 12 -40. 160. FORMAT "%3.0" /end AXIS_PTS
/begin AXIS_PTS ldpm_toil_2_ivvt "" 0x44071 TOIL _REC_AXS_20_u1 200. _CNV_A_R_LINEAR_____3_CM 6 -40. 160. FORMAT "%3.0" /end AXIS_PTS
/begin AXIS_PTS ldpm_n_32_1_ivvt "" 0x43cf4 N_32 _REC_AXS_20_u1 8160. _CNV_A_R_LINEAR_____5_CM 4 0. 8160. FORMAT "%4.0" /end AXIS_PTS
/begin AXIS_PTS ldpm_toil_1_ivvt "" 0x44068 TOIL _REC_AXS_20_u1 200. _CNV_A_R_LINEAR_____3_CM 8 -40. 160. FORMAT "%3.0" /end AXIS_PTS
/begin MEASUREMENT GENSTATROH "Status Generator" UBYTE _CNV_A_R_LINEAR_____10_CM 1 100. 0. 255. ECU_ADDRESS 0x3fa3c1 FORMAT "%3.0" /end MEASUREMENT
/begin MEASUREMENT ST_GEN "Generatorstatus" UBYTE _CNV_A_R_LINEAR_____10_CM 1 100. 0. 3. ECU_ADDRESS 0x3fa3c2 FORMAT "%2.0" /end MEASUREMENT
/begin MEASUREMENT B_KL61 "Bedingung KL61" UBYTE _CNV_S_2_RANGE______28_CM 1 100. 0. 1. ECU_ADDRESS 0x3fa3c0 /end MEASUREMENT
/begin MEASUREMENT FAKTTANSEL "Ansaugluftfaktor E-Lüfterstrom" UWORD _CNV_A_R_fak_ub_b2_480_CM 1 100. 0. 1.9921875 ECU_ADDRESS 0x3fb130 FORMAT "%8.4" /end MEASUREMENT
/begin MEASUREMENT I_ELU_VVT "Strom E-Lüfter und VVT-System" UWORD _CNV_R_R_i_eluft_q0_477_CM 1 100. 0. 4095.9375 ECU_ADDRESS 0x3fb13a FORMAT "%8.4" /end MEASUREMENT
/begin MEASUREMENT I_ELUEFTER "E-Lüfter Stromaufnahme" UWORD _CNV_R_R_i_eluft_q0_477_CM 1 100. 0. 128. ECU_ADDRESS 0x3fb134 FORMAT "%8.4" /end MEASUREMENT
/begin MEASUREMENT I_ELUPWM "E-Lüfterstrom ohne Temperaturabhängigkeit" UWORD _CNV_R_R_i_eluft_q0_477_CM 1 100. 0. 64. ECU_ADDRESS 0x3fb136 FORMAT "%8.4" /end MEASUREMENT
/begin MEASUREMENT TAML_TMP "temporäres Tastverhältnis E-Lüfter" UWORD _CNV_R_R_rel_ub_b10_478_CM 1 100. 0. 100. ECU_ADDRESS 0x3fb13e FORMAT "%8.4" /end MEASUREMENT
/begin MEASUREMENT TANS_TMP "temporäre Ansaugluft" UWORD _CNV_R_R_temp_ub_q0_587_CM 1 100. -48. 143.25 ECU_ADDRESS 0x3fb140 FORMAT "%8.4" /end MEASUREMENT
/begin MEASUREMENT UB_TMP "temporäre Batteriespannung" UWORD _CNV_A_R_spg_ubatt_479_CM 1 100. 0. 24.021 ECU_ADDRESS 0x3fb142 FORMAT "%8.4" /end MEASUREMENT
/begin MEASUREMENT VVT_IB1_2 "Gesamtstrom VVT Bank1 bzw 4Zyl. und Bank2" UWORD _CNV_R_R_i_vvt_ub_q_476_CM 1 100. 0. 128. ECU_ADDRESS 0x3fb146 FORMAT "%8.4" /end MEASUREMENT
/begin MEASUREMENT VVT_IGES "Strombedarf des gesamten VVT-Systems" UWORD _CNV_R_R_i_eluft_q0_477_CM 1 100. 0. 192. ECU_ADDRESS 0x3fb148 FORMAT "%8.4" /end MEASUREMENT
/begin MEASUREMENT B_INIBUMG "Hilfsbedingung Batterietemperaturumgebungsberechung" UBYTE _CNV_A_R_LINEAR_____12_CM 1 100. 0. 255. ECU_ADDRESS 0x3fb1c7 BIT_MASK 0x1 /end MEASUREMENT
/begin MEASUREMENT BATT_A1 "Temp-Variable" FLOAT32_IEEE _CNV_A_R_LINEAR_____12_CM 1 100. -2147483648. 4294967295. ECU_ADDRESS 0x3fa3fc /end MEASUREMENT
/begin MEASUREMENT BATT_A2 "Temp-Variable" FLOAT32_IEEE _CNV_A_R_LINEAR_____12_CM 1 100. -2147483648. 4294967295. ECU_ADDRESS 0x3fa400 /end MEASUREMENT
/begin MEASUREMENT BATT_C10 "Temp-Variable" FLOAT32_IEEE _CNV_A_R_LINEAR_____12_CM 1 100. -2147483648. 4294967295. ECU_ADDRESS 0x3fa404 /end MEASUREMENT
/begin MEASUREMENT BATT_C11 "Temp-Variable" FLOAT32_IEEE _CNV_A_R_LINEAR_____12_CM 1 100. -2147483648. 4294967295. ECU_ADDRESS 0x3fa408 /end MEASUREMENT
/begin MEASUREMENT BATT_C12 "Temp-Variable" FLOAT32_IEEE _CNV_A_R_LINEAR_____12_CM 1 100. -2147483648. 4294967295. ECU_ADDRESS 0x3fa40c /end MEASUREMENT
/begin MEASUREMENT BATT_C13 "Temp-Variable" FLOAT32_IEEE _CNV_A_R_LINEAR_____12_CM 1 100. -2147483648. 4294967295. ECU_ADDRESS 0x3fa410 /end MEASUREMENT
/begin MEASUREMENT BATT_C14 "Temp-Variable" FLOAT32_IEEE _CNV_A_R_LINEAR_____12_CM 1 100. -2147483648. 4294967295. ECU_ADDRESS 0x3fa414 /end MEASUREMENT
/begin MEASUREMENT BATT_C8 "Temp-Variable" FLOAT32_IEEE _CNV_A_R_LINEAR_____12_CM 1 100. -2147483648. 4294967295. ECU_ADDRESS 0x3fa418 /end MEASUREMENT
/begin MEASUREMENT BATT_C9 "Temp-Variable" FLOAT32_IEEE _CNV_A_R_LINEAR_____12_CM 1 100. -2147483648. 4294967295. ECU_ADDRESS 0x3fa41c /end MEASUREMENT
/begin MEASUREMENT BATT_D1 "Temp-Variable" FLOAT32_IEEE _CNV_A_R_LINEAR_____12_CM 1 100. -2147483648. 4294967295. ECU_ADDRESS 0x3fa420 /end MEASUREMENT
/begin MEASUREMENT BATT_E1 "Temp-Variable" FLOAT32_IEEE _CNV_A_R_LINEAR_____12_CM 1 100. -2147483648. 4294967295. ECU_ADDRESS 0x3fa424 /end MEASUREMENT
/begin MEASUREMENT BATT_E2 "Temp-Variable" FLOAT32_IEEE _CNV_A_R_LINEAR_____12_CM 1 100. -2147483648. 4294967295. ECU_ADDRESS 0x3fa428 /end MEASUREMENT
/begin MEASUREMENT BATT_E3 "Temp-Variable" FLOAT32_IEEE _CNV_A_R_LINEAR_____12_CM 1 100. -2147483648. 4294967295. ECU_ADDRESS 0x3fa42c /end MEASUREMENT
/begin MEASUREMENT BATT_E4 "Temp-Variable" FLOAT32_IEEE _CNV_A_R_LINEAR_____12_CM 1 100. -2147483648. 4294967295. ECU_ADDRESS 0x3fa430 /end MEASUREMENT
/begin MEASUREMENT BATT_E5 "Temp-Variable" FLOAT32_IEEE _CNV_A_R_LINEAR_____12_CM 1 100. -2147483648. 4294967295. ECU_ADDRESS 0x3fa434 /end MEASUREMENT
/begin MEASUREMENT BATT_E6 "Temp-Variable" FLOAT32_IEEE _CNV_A_R_LINEAR_____12_CM 1 100. -2147483648. 4294967295. ECU_ADDRESS 0x3fa438 /end MEASUREMENT
/begin MEASUREMENT BATT_TFIL "Zeitkonstante Batterie" FLOAT32_IEEE _CNV_A_R_LINEAR_____12_CM 1 100. -2147483648. 4294967295. ECU_ADDRESS 0x3fa43c /end MEASUREMENT
/begin MEASUREMENT BATT_W0 "Temp-Variable" FLOAT32_IEEE _CNV_A_R_LINEAR_____12_CM 1 100. -2147483648. 4294967295. ECU_ADDRESS 0x3fa440 /end MEASUREMENT
/begin MEASUREMENT BATTO_A "Temp-Variable" FLOAT32_IEEE _CNV_A_R_LINEAR_____12_CM 1 100. -2147483648. 4294967295. ECU_ADDRESS 0x3fa3d4 /end MEASUREMENT
/begin MEASUREMENT BATTO_A1 "Temp-Variable" FLOAT32_IEEE _CNV_A_R_LINEAR_____12_CM 1 100. -2147483648. 4294967295. ECU_ADDRESS 0x3fa3d8 /end MEASUREMENT
/begin MEASUREMENT BATTO_B "Temp-Variable" FLOAT32_IEEE _CNV_A_R_LINEAR_____12_CM 1 100. -2147483648. 4294967295. ECU_ADDRESS 0x3fa3dc /end MEASUREMENT
/begin MEASUREMENT BATTO_C "Temp-Variable" FLOAT32_IEEE _CNV_A_R_LINEAR_____12_CM 1 100. -2147483648. 4294967295. ECU_ADDRESS 0x3fa3e0 /end MEASUREMENT
/begin MEASUREMENT BATTO_C1 "Temp-Variable" FLOAT32_IEEE _CNV_A_R_LINEAR_____12_CM 1 100. -2147483648. 4294967295. ECU_ADDRESS 0x3fa3e4 /end MEASUREMENT
/begin MEASUREMENT BATTO_C2 "Temp-Variable" FLOAT32_IEEE _CNV_A_R_LINEAR_____12_CM 1 100. -2147483648. 4294967295. ECU_ADDRESS 0x3fa3e8 /end MEASUREMENT
/begin MEASUREMENT BATTO_C3 "Temp-Variable" FLOAT32_IEEE _CNV_A_R_LINEAR_____12_CM 1 100. -2147483648. 4294967295. ECU_ADDRESS 0x3fa3ec /end MEASUREMENT
/begin MEASUREMENT BATTO_C4 "Temp-Variable" FLOAT32_IEEE _CNV_A_R_LINEAR_____12_CM 1 100. -2147483648. 4294967295. ECU_ADDRESS 0x3fa3f0 /end MEASUREMENT
/begin MEASUREMENT BATTO_C6 "Temp-Variable" FLOAT32_IEEE _CNV_A_R_LINEAR_____12_CM 1 100. -2147483648. 4294967295. ECU_ADDRESS 0x3fa3f4 /end MEASUREMENT
/begin MEASUREMENT BATTO_C7 "Temp-Variable" FLOAT32_IEEE _CNV_A_R_LINEAR_____12_CM 1 100. -2147483648. 4294967295. ECU_ADDRESS 0x3fa3f8 /end MEASUREMENT
/begin MEASUREMENT CTRGENUTAR "" UBYTE _CNV_R_R_spg_gencan_69_CM 1 100. 10.6 16.975 ECU_ADDRESS 0x3fa3d0 FORMAT "%8.4" /end MEASUREMENT
/begin MEASUREMENT DBET_ALF "Batterieaplphawert" FLOAT32_IEEE _CNV_A_R_LINEAR_____12_CM 1 100. -2147483648. 4294967295. ECU_ADDRESS 0x3fa448 /end MEASUREMENT
/begin MEASUREMENT DBETALF_T "Temp-Variable" FLOAT32_IEEE _CNV_A_R_LINEAR_____12_CM 1 100. -2147483648. 4294967295. ECU_ADDRESS 0x3fa444 /end MEASUREMENT
/begin MEASUREMENT DT_TUMG "delta T-Umgebung" FLOAT32_IEEE _CNV_A_R_LINEAR_____12_CM 1 100. -2147483648. 4294967295. ECU_ADDRESS 0x3fa44c /end MEASUREMENT
/begin MEASUREMENT T_BATT_INI "Startwert Batterietemperatur" FLOAT32_IEEE _CNV_A_R_LINEAR_____12_CM 1 100. -2147483648. 4294967295. ECU_ADDRESS 0x3fa468 /end MEASUREMENT
/begin MEASUREMENT T_BATTABST "Batterieabstelltemperatur" FLOAT32_IEEE _CNV_A_R_LINEAR_____12_CM 1 100. -2147483648. 4294967295. ECU_ADDRESS 0x3fb308 /end MEASUREMENT
/begin MEASUREMENT T_UMGABST "Abstell-Aussentemperatur" SBYTE _CNV_R_R_temp_q1_535_CM 1 100. -128. 127. ECU_ADDRESS 0x3fb300 FORMAT "%8.4" /end MEASUREMENT
/begin MEASUREMENT T_UMGABSTF "letzte Aussentemperatur" FLOAT32_IEEE _CNV_A_R_LINEAR_____12_CM 1 100. -2147483648. 4294967295. ECU_ADDRESS 0x3fa46c /end MEASUREMENT
/begin MEASUREMENT TABST_FL "Abstellzeit in float" FLOAT32_IEEE _CNV_A_R_LINEAR_____12_CM 1 100. -2147483648. 4294967295. ECU_ADDRESS 0x3fa450 /end MEASUREMENT
/begin MEASUREMENT TANSF "Ansaugluft in float" FLOAT32_IEEE _CNV_A_R_LINEAR_____12_CM 1 100. -2147483648. 4294967295. ECU_ADDRESS 0x3fa454 /end MEASUREMENT
/begin MEASUREMENT TBATINMANF "Initwert Batterietmperatur Hand temp." FLOAT32_IEEE _CNV_A_R_LINEAR_____12_CM 1 100. -2147483648. 4294967295. ECU_ADDRESS 0x3fa458 /end MEASUREMENT
/begin MEASUREMENT TBATSTINIV "Starttemperatur Batterie vorne" FLOAT32_IEEE _CNV_A_R_LINEAR_____12_CM 1 100. -2147483648. 4294967295. ECU_ADDRESS 0x3fa45c /end MEASUREMENT
/begin MEASUREMENT TUMGBATOLD "vorherige Batterieumgebungstemperatur" FLOAT32_IEEE _CNV_A_R_LINEAR_____12_CM 1 100. -2147483648. 4294967295. ECU_ADDRESS 0x3fa460 /end MEASUREMENT
/begin MEASUREMENT TUMGBATTAB "Abstell-Umgebungstemperatur Batterie" FLOAT32_IEEE _CNV_A_R_LINEAR_____12_CM 1 100. -2147483648. 4294967295. ECU_ADDRESS 0x3fb304 /end MEASUREMENT
/begin MEASUREMENT TUMGCANF "aktuelle Aussentemperatur float" FLOAT32_IEEE _CNV_A_R_LINEAR_____12_CM 1 100. -2147483648. 4294967295. ECU_ADDRESS 0x3fa464 /end MEASUREMENT
/begin MEASUREMENT ST_LDSTGEN "Lastzustand Generator elektrisch/thermisch" UBYTE _CNV_A_R_LINEAR_____12_CM 1 100. 0. 255. ECU_ADDRESS 0x3fa472 FORMAT "%8.4" /end MEASUREMENT
/begin MEASUREMENT B_NSUB "Bedingung für Solldrehzahlanhebung bei niedriger Batterieladebilanz" UBYTE _CNV_A_R_LINEAR_____12_CM 1 100. 0. 255. ECU_ADDRESS 0x3fa474 BIT_MASK 0x1 /end MEASUREMENT
/begin MEASUREMENT N_IDLGSPEC "" UBYTE _CNV_A_R_LINEAR_____12_CM 1 100. 0. 255. ECU_ADDRESS 0x3fb153 FORMAT "%8.4" /end MEASUREMENT
/begin MEASUREMENT NSLB "Lerrlaufdrehzahl von Ladebilanz Batterie" UBYTE _CNV_R_R_nmot_ub_q1_538_CM 1 100. 0. 2550. ECU_ADDRESS 0x3fa475 FORMAT "%8.4" /end MEASUREMENT
/begin MEASUREMENT B_GENOFFMD "Bedingung Generatus-off-Anforderung" UBYTE _CNV_A_R_LINEAR_____12_CM 1 100. 0. 255. ECU_ADDRESS 0x3fa47b BIT_MASK 0x1 /end MEASUREMENT
/begin MEASUREMENT LOADRESP "gerechnete Loadresponse" UBYTE _CNV_R_R_t100msxs_u_485_CM 1 100. 0. 25.5 ECU_ADDRESS 0x3fa478 FORMAT "%8.4" /end MEASUREMENT
/begin MEASUREMENT B_GENOFFOK "Bedingung Generatorabschaltfreigabe Sicherheitstimer" UBYTE _CNV_A_R_LINEAR_____12_CM 1 100. 0. 255. ECU_ADDRESS 0x3fa47c BIT_MASK 0x1 /end MEASUREMENT
/begin MEASUREMENT I_SLP "berechnete Groesse Strombedarf Sekundärluftpumpe" UWORD _CNV_R_R_i_eluft_q0_477_CM 1 100. 0. 255. ECU_ADDRESS 0x3fb13c FORMAT "%8.4" /end MEASUREMENT
/begin MEASUREMENT B_HYSLLRAH "Bedingung LL-Anhebunghysterese" UBYTE _CNV_A_R_LINEAR_____12_CM 1 100. 0. 255. ECU_ADDRESS 0x3fb14e BIT_MASK 0x1 /end MEASUREMENT
/begin MEASUREMENT GENDFVORHS "DF-Signal Vorhersage" UBYTE _CNV_A_R_PCENT_484_CM 1 100. 0. 99.609375 ECU_ADDRESS 0x3fb14f FORMAT "%8.4" /end MEASUREMENT
/begin MEASUREMENT GENIKALTMP "temporärer Kaltstrom" UWORD _CNV_R_R_igen_uw_q0_508_CM 1 100. 0. 2047.9688 ECU_ADDRESS 0x3fb150 FORMAT "%8.4" /end MEASUREMENT
/begin MEASUREMENT GENITEMP2 "temporärer Warmstrom" UWORD _CNV_R_R_igen_uw_q0_508_CM 1 100. 0. 2047.9688 ECU_ADDRESS 0x3fb151 FORMAT "%8.4" /end MEASUREMENT
/begin MEASUREMENT IGENRLLRAH "Generatorstrom mit Vorlaufreserve" UBYTE _CNV_R_R_igen_ub_q1_483_CM 1 100. 0. 254. ECU_ADDRESS 0x3fb152 FORMAT "%8.4" /end MEASUREMENT
/begin MEASUREMENT NGSLLM "Generatorleerlaufdrehzahl" UWORD _CNV_R_R_ngen_uw_q0_517_CM 1 100. 0. 32767.5 ECU_ADDRESS 0x3fb14c FORMAT "%8.4" /end MEASUREMENT
/begin MEASUREMENT UFGENTMP2 "temporärer Generatorspannungsollwert" UBYTE _CNV_R_R_spg_ugen_521_CM 1 100. 10.6 36.1 ECU_ADDRESS 0x3fb154 FORMAT "%8.4" /end MEASUREMENT
/begin MEASUREMENT B_1STBSDER "Hilfsbit für Generatornotlaufdrehzahlfunktion" UBYTE _CNV_A_R_LINEAR_____12_CM 1 100. 0. 255. ECU_ADDRESS 0x3fb155 BIT_MASK 0x1 /end MEASUREMENT
/begin MEASUREMENT B_AUXERR "Bedingung AUX (wird momentan nicht benutzt)" UBYTE _CNV_A_R_LINEAR_____12_CM 1 100. 0. 255. ECU_ADDRESS 0x3fb156 BIT_MASK 0x1 /end MEASUREMENT
/begin MEASUREMENT B_GFBSUPEP "Bedingung Generatortyp unplausibel, entprellt" UBYTE _CNV_A_R_LINEAR_____12_CM 1 100. 0. 255. ECU_ADDRESS 0x3fb157 BIT_MASK 0x1 /end MEASUREMENT
/begin MEASUREMENT B_GFELEP "Bedingung elektrischer Fehler, entprellt" UBYTE _CNV_A_R_LINEAR_____12_CM 1 100. 0. 255. ECU_ADDRESS 0x3fb158 BIT_MASK 0x1 /end MEASUREMENT
/begin MEASUREMENT B_GFHTEP "Bedingung Generator Ueberhitzung, entprellt" UBYTE _CNV_A_R_LINEAR_____12_CM 1 100. 0. 255. ECU_ADDRESS 0x3fb159 BIT_MASK 0x1 /end MEASUREMENT
/begin MEASUREMENT B_GFMEEP "Bedingung mechanischer Fehler, entprellt" UBYTE _CNV_A_R_LINEAR_____12_CM 1 100. 0. 255. ECU_ADDRESS 0x3fb15a BIT_MASK 0x1 /end MEASUREMENT
/begin MEASUREMENT B_GFNOBSEP "Bedingung BSD Kommunikationsverlust, entprellt" UBYTE _CNV_A_R_LINEAR_____12_CM 1 100. 0. 255. ECU_ADDRESS 0x3fb15b BIT_MASK 0x1 /end MEASUREMENT
/begin MEASUREMENT EN_GENDIAG "Disgnose Freigabe Gen.Fehler" UBYTE _CNV_A_R_LINEAR_____12_CM 1 100. 0. 255. ECU_ADDRESS 0x3fb15c BIT_MASK 0x1 /end MEASUREMENT
/begin MEASUREMENT GENFBSAK "BSD Uebertragungsfehler kodiert fuer FSPVDGEN" UBYTE _CNV_R_R_igen_ub_q1_483_CM 1 100. 0. 255. ECU_ADDRESS 0x3fb163 FORMAT "%8.4" /end MEASUREMENT
/begin MEASUREMENT GFBSUCTR "Entprellzaehler fuer Generatortyp unplausibel" UBYTE _CNV_R_R_t100msxs_u_485_CM 1 100. 0. 25.5 ECU_ADDRESS 0x3fb164 FORMAT "%8.4" /end MEASUREMENT
/begin MEASUREMENT GFEHLIN1 "lokale Kopie Fehlerinput" UBYTE _CNV_A_R_LINEAR_____12_CM 1 100. 0. 255. ECU_ADDRESS 0x3fb15d BIT_MASK 0x1 /end MEASUREMENT
/begin MEASUREMENT GFEHLIN2 "lokale Kopie Fehlerinput" UBYTE _CNV_A_R_LINEAR_____12_CM 1 100. 0. 255. ECU_ADDRESS 0x3fb15e BIT_MASK 0x1 /end MEASUREMENT
/begin MEASUREMENT GFEHLIN3 "lokale Kopie Fehlerinput" UBYTE _CNV_A_R_LINEAR_____12_CM 1 100. 0. 255. ECU_ADDRESS 0x3fb15f BIT_MASK 0x1 /end MEASUREMENT
/begin MEASUREMENT GFEHLIN4 "lokale Kopie Fehlerinput" UBYTE _CNV_A_R_LINEAR_____12_CM 1 100. 0. 255. ECU_ADDRESS 0x3fb160 BIT_MASK 0x1 /end MEASUREMENT
/begin MEASUREMENT GFEHLIN5 "lokale Kopie Fehlerinput" UBYTE _CNV_A_R_LINEAR_____12_CM 1 100. 0. 255. ECU_ADDRESS 0x3fb161 BIT_MASK 0x1 /end MEASUREMENT
/begin MEASUREMENT GFELCTR "Entprellzaehler fuer elektrischen Fehler" UBYTE _CNV_R_R_t100msxs_u_485_CM 1 100. 0. 25.5 ECU_ADDRESS 0x3fb165 FORMAT "%8.4" /end MEASUREMENT
/begin MEASUREMENT GFHTCTR "Entprellzaehler fuer Generator Ueberhitzung" UBYTE _CNV_R_R_t100msxs_u_485_CM 1 100. 0. 25.5 ECU_ADDRESS 0x3fb166 FORMAT "%8.4" /end MEASUREMENT
/begin MEASUREMENT GFMECTR "Entprellzaehler fuer mechanischen Fehler" UBYTE _CNV_R_R_t100msxs_u_485_CM 1 100. 0. 25.5 ECU_ADDRESS 0x3fb167 FORMAT "%8.4" /end MEASUREMENT
/begin MEASUREMENT GFNOBCTR "Entprellzaehler fuer BSD Kommunikation unterbrochen" UBYTE _CNV_R_R_t100msxs_u_485_CM 1 100. 0. 25.5 ECU_ADDRESS 0x3fb168 FORMAT "%8.4" /end MEASUREMENT
/begin MEASUREMENT KL61LOC "Kl61 lokal" UBYTE _CNV_A_R_LINEAR_____12_CM 1 100. 0. 255. ECU_ADDRESS 0x3fb162 BIT_MASK 0x1 /end MEASUREMENT
/begin MEASUREMENT BATTORT "Batterieeinbauort" UBYTE _CNV_A_R_LINEAR_____12_CM 1 100. 0. 255. ECU_ADDRESS 0x3fb1c9 FORMAT "%8.4" /end MEASUREMENT
/begin MEASUREMENT COBATTORT "Codierzelle Batterieeinbauort" UBYTE _CNV_A_R_LINEAR_____12_CM 1 100. 0. 255. ECU_ADDRESS 0x3fb1ca FORMAT "%8.4" /end MEASUREMENT
/begin MEASUREMENT END_INIT "Temp-Variable Initialisierungsende" UBYTE _CNV_A_R_LINEAR_____12_CM 1 100. 0. 255. ECU_ADDRESS 0x3fb1c8 BIT_MASK 0x1 /end MEASUREMENT
/begin MEASUREMENT TUMG_ERS "Aussentemperatur oder Ersatzwert" SBYTE _CNV_R_R_temp_q1_535_CM 1 100. -128. 127. ECU_ADDRESS 0x3fb1cd FORMAT "%8.4" /end MEASUREMENT
/begin MEASUREMENT TUMGTEMP "Umgebungstemperatur Ersatz" SBYTE _CNV_R_R_temp_q1_535_CM 1 100. -128. 127. ECU_ADDRESS 0x3fb1cc FORMAT "%8.4" /end MEASUREMENT
/begin MEASUREMENT DFFGENFLO "DF-Signal temp" FLOAT32_IEEE _CNV_A_R_LINEAR_____12_CM 1 100. 0. 4294967295. ECU_ADDRESS 0x3fb1d0 /end MEASUREMENT
/begin MEASUREMENT DFMONITOR "DF-Monitor für FASTA" UBYTE _CNV_A_R_PCENT_484_CM 1 100. 0. 99.609375 ECU_ADDRESS 0x3fb30c FORMAT "%8.4" /end MEASUREMENT
/begin MEASUREMENT DFSUMME "DFMonitor Summe FASTA" FLOAT32_IEEE _CNV_A_R_LINEAR_____12_CM 1 100. 0. 4294967295. ECU_ADDRESS 0x3fb310 /end MEASUREMENT
/begin MEASUREMENT DFWANZAHL "DF-Wertezähler" FLOAT32_IEEE _CNV_A_R_LINEAR_____12_CM 1 100. 1. 4294967295. ECU_ADDRESS 0x3fb314 /end MEASUREMENT
/begin MEASUREMENT NNSTART "Motordrehzahl nach Motorstart" UWORD _CNV_R_R_nmot_uw_q0_488_CM 1 100. 0. 16383.75 ECU_ADDRESS 0x3fa470 FORMAT "%8.4" /end MEASUREMENT
/begin MEASUREMENT B_GENOFFST "Bedingung Generatorabschaltung im Start" UBYTE _CNV_A_R_LINEAR_____12_CM 1 100. 0. 255. ECU_ADDRESS 0x3fa476 BIT_MASK 0x1 /end MEASUREMENT
/begin MEASUREMENT B_GENOFFVL "Bedingung Generatorabschaltung bei Vollast" UBYTE _CNV_A_R_LINEAR_____12_CM 1 100. 0. 255. ECU_ADDRESS 0x3fa477 BIT_MASK 0x1 /end MEASUREMENT
/begin MEASUREMENT B_1STUGEN "Bedingung ctrgenutar noch nicht gueltig" UBYTE _CNV_A_R_LINEAR_____12_CM 1 100. 0. 255. ECU_ADDRESS 0x3fb1d4 BIT_MASK 0x1 /end MEASUREMENT
/begin MEASUREMENT UGLOC "lokale Generatorspannung" SWORD _CNV_R_R_spg_sw_q0p_576_CM 1 100. 0. 30. ECU_ADDRESS 0x3fb1d8 FORMAT "%8.4" /end MEASUREMENT
/begin MEASUREMENT URAMP "" SWORD _CNV_R_R_spg_sw_q0p_576_CM 1 100. 0. 30. ECU_ADDRESS 0x3fb1da FORMAT "%8.4" /end MEASUREMENT
/begin COMPU_METHOD _CNV_A_R_LINEAR_____0_CM "" RAT_FUNC "%6.3" "°C" COEFFS 0 1.333333333333333 64. 0 0 1 /end COMPU_METHOD
/begin COMPU_METHOD _CNV_A_R_LINEAR_____1_CM "" RAT_FUNC "%6.3" "°C" COEFFS 0 1.333333333333333 0. 0 0 1 /end COMPU_METHOD
/begin COMPU_METHOD _CNV_A_R_LINEAR_____3_CM "" RAT_FUNC "%6.3" "°C" COEFFS 0 1. 40. 0 0 1 /end COMPU_METHOD
/begin COMPU_METHOD _CNV_A_R_LINEAR_____4_CM "" RAT_FUNC "%6.3" "%" COEFFS 0 2.56 0. 0 0 1 /end COMPU_METHOD
/begin COMPU_METHOD _CNV_A_R_LINEAR_____5_CM "" RAT_FUNC "%6.3" "rpm" COEFFS 0 3.125e-002 0. 0 0 1 /end COMPU_METHOD
/begin COMPU_METHOD _CNV_A_R_LINEAR_____10_CM "" RAT_FUNC "%6.3" "-" COEFFS 0 1. 0. 0 0 1 /end COMPU_METHOD
/begin COMPU_METHOD _CNV_A_R_LINEAR_____12_CM "" RAT_FUNC "%6.3" "[-]" COEFFS 0 1. 0. 0 0 1 /end COMPU_METHOD
/begin COMPU_METHOD _CNV_A_R_LINEAR_____14_CM "" RAT_FUNC "%6.3" "s" COEFFS 0 10. 0. 0 0 1 /end COMPU_METHOD
/begin COMPU_METHOD _CNV_A_R_LINEAR_____23_CM "" RAT_FUNC "%6.3" "ms" COEFFS 0 0.1 0. 0 0 1 /end COMPU_METHOD
/begin COMPU_METHOD _CNV_A_R_LINEAR_____27_CM "" RAT_FUNC "%6.3" "s" COEFFS 0 100. 0. 0 0 1 /end COMPU_METHOD
/begin COMPU_METHOD _CNV_S_2_RANGE______28_CM "" TAB_VERB "%6.3" "[-]" COMPU_TAB_REF _CNV_S_2_RANGE______28 /end COMPU_METHOD
/begin COMPU_VTAB _CNV_S_2_RANGE______28 "" TAB_VERB 2 0 "0" 1 "1" /end COMPU_VTAB
/begin COMPU_METHOD _CNV_A_R_LINEAR_____40_CM "" RAT_FUNC "%6.3" "-" COEFFS 0 16. 0. 0 0 1 /end COMPU_METHOD
/begin COMPU_METHOD _CNV_A_R_LINEAR_____44_CM "" RAT_FUNC "%6.3" "[-]" COEFFS 0 255.9999357490357 0. 0 0 1 /end COMPU_METHOD
/begin COMPU_METHOD _CNV_A_R_LINEAR_____53_CM "" RAT_FUNC "%6.3" "V" COEFFS 0 9.807692307692308 0. 0 0 1 /end COMPU_METHOD
/begin COMPU_METHOD _CNV_R_R_spg_gencan_69_CM "" RAT_FUNC "%6.3" "V" COEFFS 0. 40. -424. 0. 0. 1. /end COMPU_METHOD
/begin COMPU_METHOD _CNV_A_R_LINEAR_____70_CM "" RAT_FUNC "%6.3" "V" COEFFS 0 10. -106. 0 0 1 /end COMPU_METHOD
/begin COMPU_METHOD _CNV_A_R_LINEAR_____75_CM "" RAT_FUNC "%6.3" "°CRK" COEFFS 0 2.666666666666667 0. 0 0 1 /end COMPU_METHOD
/begin COMPU_METHOD _CNV_A_R_LINEAR_____103_CM "" RAT_FUNC "%6.3" "-" COEFFS 0 128. 0. 0 0 1 /end COMPU_METHOD
/begin COMPU_METHOD _CNV_A_R_LINEAR_____117_CM "" RAT_FUNC "%6.3" "%" COEFFS 0 2.56 128. 0 0 1 /end COMPU_METHOD
/begin COMPU_METHOD _CNV_A_R_LINEAR_____195_CM "" RAT_FUNC "%6.3" "[-]" COEFFS 0 64. 0. 0 0 1 /end COMPU_METHOD
/begin COMPU_METHOD _CNV_A_R_LINEAR_____231_CM "" RAT_FUNC "%6.3" "°CRK" COEFFS 0 -2.666666666666667 -106.6666666666667 0 0 1 /end COMPU_METHOD
/begin COMPU_METHOD _CNV_A_R_LINEAR_____234_CM "" RAT_FUNC "%6.3" "°CRK" COEFFS 0 2.666666666666667 -160. 0 0 1 /end COMPU_METHOD
/begin COMPU_METHOD _CNV_A_R_LINEAR_____236_CM "" RAT_FUNC "%6.3" "°CRK/rev" COEFFS 0 2.666666666666667 0. 0 0 1 /end COMPU_METHOD
/begin COMPU_METHOD _CNV_A_R_LINEAR_____237_CM "" RAT_FUNC "%6.3" "-" COEFFS 0 100. -1.4210854715202e-014 0 0 1 /end COMPU_METHOD
/begin COMPU_METHOD _CNV_A_R_LINEAR_____238_CM "" RAT_FUNC "%6.3" "ms/0.375°CRK" COEFFS 0 102.399999996 0. 0 0 1 /end COMPU_METHOD
/begin COMPU_METHOD _CNV_A_R_LINEAR_____239_CM "" RAT_FUNC "%6.3" "ms" COEFFS 0 1.6 0. 0 0 1 /end COMPU_METHOD
/begin COMPU_METHOD _CNV_A_R_LINEAR_____241_CM "" RAT_FUNC "%6.3" "°CRK" COEFFS 0 682.666916670573 -40960.01500023438 0 0 1 /end COMPU_METHOD
/begin COMPU_METHOD _CNV_A_R_LINEAR_____242_CM "" RAT_FUNC "%6.3" "us" COEFFS 0 0.25 0. 0 0 1 /end COMPU_METHOD
/begin COMPU_METHOD _CNV_A_R_LINEAR_____243_CM "" RAT_FUNC "%6.3" "°CRK" COEFFS 0 682.666916670573 0. 0 0 1 /end COMPU_METHOD
/begin COMPU_METHOD _CNV_S_3_STATE_IVVT_244_CM "" TAB_VERB "%6.3" "-" COMPU_TAB_REF _CNV_S_3_STATE_IVVT_244 /end COMPU_METHOD
/begin COMPU_VTAB _CNV_S_3_STATE_IVVT_244 "" TAB_VERB 3 0 "HLD" 1 "RTD" 2 "ADC" /end COMPU_VTAB
/begin COMPU_METHOD _CNV_S_5_STATE_IVVT_245_CM "" TAB_VERB "%6.3" "-" COMPU_TAB_REF _CNV_S_5_STATE_IVVT_245 /end COMPU_METHOD
/begin COMPU_VTAB _CNV_S_5_STATE_IVVT_245 "" TAB_VERB 5 0 "INIT" 1 "HLD_DLY" 2 "HLD_ADAP" 3 "ADJ" 4 "END_POS" /end COMPU_VTAB
/begin COMPU_METHOD _CNV_A_R_LINEAR_____246_CM "" RAT_FUNC "%6.3" "°CRK" COEFFS 0 682.666916670573 1.200018750387244e-002 0 0 1 /end COMPU_METHOD
/begin COMPU_METHOD _CNV_A_R_LINEAR_____247_CM "" RAT_FUNC "%6.3" "°CRK/s" COEFFS 0 2.666666666666667 0. 0 0 1 /end COMPU_METHOD
/begin COMPU_METHOD _CNV_A_R_LINEAR_____249_CM "" RAT_FUNC "%6.3" "°CRK" COEFFS 0 -682.666916670573 -27306.67666682292 0 0 1 /end COMPU_METHOD
/begin COMPU_METHOD _CNV_A_R_LINEAR_____251_CM "" RAT_FUNC "%6.3" "°CRK" COEFFS 0 2.666666666666667 160. 0 0 1 /end COMPU_METHOD
/begin COMPU_METHOD _CNV_A_R_LINEAR_____252_CM "" RAT_FUNC "%6.3" "ms" COEFFS 0 1. 0. 0 0 1 /end COMPU_METHOD
/begin COMPU_METHOD _CNV_R_R_i_vvt_ub_q_476_CM "" RAT_FUNC "%6.3" "A" COEFFS 0. 1. 63.5 0. 0. 0.5 /end COMPU_METHOD
/begin COMPU_METHOD _CNV_R_R_i_eluft_q0_477_CM "" RAT_FUNC "%6.3" "A" COEFFS 0. 65536. 0. 0. 0. 4096. /end COMPU_METHOD
/begin COMPU_METHOD _CNV_R_R_rel_ub_b10_478_CM "" RAT_FUNC "%6.3" "[-]" COEFFS 0. 255. 0. 0. 0. 100. /end COMPU_METHOD
/begin COMPU_METHOD _CNV_A_R_spg_ubatt_479_CM "" RAT_FUNC "%6.3" "[-]" COEFFS 0 10.61571125265393 0. 0 0 1 /end COMPU_METHOD
/begin COMPU_METHOD _CNV_A_R_fak_ub_b2_480_CM "" RAT_FUNC "%6.3" "[-]" COEFFS 0 128. 0. 0 0 1 /end COMPU_METHOD
/begin COMPU_METHOD _CNV_R_R_temp_uw_q0_481_CM "" RAT_FUNC "%6.3" "[-]" COEFFS 0. 1. 48. 0. 0. 0.75 /end COMPU_METHOD
/begin COMPU_METHOD _CNV_R_R_vfzg_ub_q1_482_CM "" RAT_FUNC "%6.3" "[-]" COEFFS 0. 1. 0. 0. 0. 1.25 /end COMPU_METHOD
/begin COMPU_METHOD _CNV_R_R_igen_ub_q1_483_CM "" RAT_FUNC "%6.3" "[-]" COEFFS 0. 1. 0. 0. 0. 1. /end COMPU_METHOD
/begin COMPU_METHOD _CNV_A_R_PCENT_484_CM "" RAT_FUNC "%6.3" "[-]" COEFFS 0 2.56 0. 0 0 1 /end COMPU_METHOD
/begin COMPU_METHOD _CNV_R_R_t100msxs_u_485_CM "" RAT_FUNC "%6.3" "[-]" COEFFS 0. 1. 0. 0. 0. 0.1 /end COMPU_METHOD
/begin COMPU_METHOD _CNV_A_R_LINEAR_____486_CM "" RAT_FUNC "%6.3" "rpm" COEFFS 0 4. 0. 0 0 1 /end COMPU_METHOD
/begin COMPU_METHOD _CNV_A_R_LINEAR_____487_CM "" RAT_FUNC "%6.3" "ms" COEFFS 0 1.e-002 0. 0 0 1 /end COMPU_METHOD
/begin COMPU_METHOD _CNV_R_R_nmot_uw_q0_488_CM "" RAT_FUNC "%6.3" "[-]" COEFFS 0. 1. 0. 0. 0. 0.25 /end COMPU_METHOD
/begin COMPU_METHOD _CNV_R_R_igen_uw_q0_508_CM "" RAT_FUNC "%6.3" "A" COEFFS 0. 65536. 0. 0. 0. 2048. /end COMPU_METHOD
/begin COMPU_METHOD _CNV_R_R_gendt_q0p0_509_CM "" RAT_FUNC "%6.3" "°K" COEFFS 0. 1. 0. 0. 0. 0.75 /end COMPU_METHOD
/begin COMPU_METHOD _CNV_R_R_genzmig_uw_510_CM "" RAT_FUNC "%6.3" "[-]" COEFFS 0. 65536. 0. 0. 0. 2. /end COMPU_METHOD
/begin COMPU_METHOD _CNV_R_R_genzmst_uw_511_CM "" RAT_FUNC "%6.3" "[-]" COEFFS 0. 65536. 0. 0. 0. 1. /end COMPU_METHOD
/begin COMPU_METHOD _CNV_R_R_fak_uw_b51_512_CM "" RAT_FUNC "%6.3" "[-]" COEFFS 0. 65536. 0. 0. 0. 512. /end COMPU_METHOD
/begin COMPU_METHOD _CNV_R_R_fak_ub_b4_513_CM "" RAT_FUNC "%6.3" "[-]" COEFFS 0. 256. 0. 0. 0. 4. /end COMPU_METHOD
/begin COMPU_METHOD _CNV_R_R_fak_q0p003_514_CM "" RAT_FUNC "%6.3" "[-]" COEFFS 0. 256. 0. 0. 0. 1. /end COMPU_METHOD
/begin COMPU_METHOD _CNV_R_R_genrstator_515_CM "" RAT_FUNC "%6.3" "Ohm" COEFFS 0. 65536. 0. 0. 0. 1. /end COMPU_METHOD
/begin COMPU_METHOD _CNV_R_R_geneta_q0p_516_CM "" RAT_FUNC "%6.3" "-" COEFFS 0. 256. 0. 0. 0. 8. /end COMPU_METHOD
/begin COMPU_METHOD _CNV_R_R_ngen_uw_q0_517_CM "" RAT_FUNC "%6.3" "U/min" COEFFS 0. 1. 0. 0. 0. 0.5 /end COMPU_METHOD
/begin COMPU_METHOD _CNV_R_R_fak_uw_b64_518_CM "" RAT_FUNC "%6.3" "[-]" COEFFS 0. 65536. 0. 0. 0. 64. /end COMPU_METHOD
/begin COMPU_METHOD _CNV_S_2_B_TRUE_519_CM "" TAB_VERB "%6.3" "[-]" COMPU_TAB_REF _CNV_S_2_B_TRUE_519 /end COMPU_METHOD
/begin COMPU_VTAB _CNV_S_2_B_TRUE_519 "" TAB_VERB 2 0 "----" 1 "TRUE" /end COMPU_VTAB
/begin COMPU_METHOD _CNV_R_R_t10msxs_ub_520_CM "" RAT_FUNC "%6.3" "[-]" COEFFS 0. 1. 0. 0. 0. 1.e-002 /end COMPU_METHOD
/begin COMPU_METHOD _CNV_R_R_spg_ugen_521_CM "" RAT_FUNC "%6.3" "[-]" COEFFS 0. 10. -106. 0. 0. 1. /end COMPU_METHOD
/begin COMPU_METHOD _CNV_R_R_genalfak_u_522_CM "" RAT_FUNC "%6.3" "[-]" COEFFS 0. 65536. 0. 0. 0. 4. /end COMPU_METHOD
/begin COMPU_METHOD _CNV_R_R_genpv_uw_q_523_CM "" RAT_FUNC "%6.3" "W" COEFFS 0. 65536. 0. 0. 0. 2048. /end COMPU_METHOD
/begin COMPU_METHOD _CNV_R_R_genpv_ul_524_CM "" RAT_FUNC "%6.3" "W" COEFFS 0. 1. 0. 0. 0. 262144. /end COMPU_METHOD
/begin COMPU_METHOD _CNV_R_R_temp_sw_q0_525_CM "" RAT_FUNC "%6.3" "[-]" COEFFS 0. 4. 0. 0. 0. 3. /end COMPU_METHOD
/begin COMPU_METHOD _CNV_R_R_md_ub_q0p0_526_CM "" RAT_FUNC "%6.3" "Nm" COEFFS 0. 1024. 0. 0. 0. 256. /end COMPU_METHOD
/begin COMPU_METHOD _CNV_R_R_md_ub_q16_527_CM "" RAT_FUNC "%6.3" "[-]" COEFFS 0. 1. 0. 0. 0. 16. /end COMPU_METHOD
/begin COMPU_METHOD _CNV_R_R_rel_uw_b10_528_CM "" RAT_FUNC "%6.3" "[-]" COEFFS 0. 65536. 0. 0. 0. 100. /end COMPU_METHOD
/begin COMPU_METHOD _CNV_R_R_temp_q1_535_CM "" RAT_FUNC "%6.3" "°C" COEFFS 0. 1. 0. 0. 0. 1. /end COMPU_METHOD
/begin COMPU_METHOD _CNV_R_R_m_ub_b23p3_536_CM "" RAT_FUNC "%6.3" "[-]" COEFFS 0. 2812.5 0. 0. 0. 256. /end COMPU_METHOD
/begin COMPU_METHOD _CNV_A_R_nmot_ub_q4_537_CM "" RAT_FUNC "%6.3" "[-]" COEFFS 0 2.5e-002 0. 0 0 1 /end COMPU_METHOD
/begin COMPU_METHOD _CNV_R_R_nmot_ub_q1_538_CM "" RAT_FUNC "%6.3" "[-]" COEFFS 0. 1. 0. 0. 0. 10. /end COMPU_METHOD
/begin COMPU_METHOD _CNV_A_R_rel_ub_q0p_539_CM "" RAT_FUNC "%6.3" "[-]" COEFFS 0 1.333333333333333 0. 0 0 1 /end COMPU_METHOD
/begin COMPU_METHOD _CNV_R_R_temp_ub_q5_540_CM "" RAT_FUNC "%6.3" "[-]" COEFFS 0. 1. 50. 0. 0. 5. /end COMPU_METHOD
/begin COMPU_METHOD _CNV_R_R_spg_gencan_573_CM "" RAT_FUNC "%6.3" "[-]" COEFFS 0. 40. -424. 0. 0. 1. /end COMPU_METHOD
/begin COMPU_METHOD _CNV_R_R_spg_sw_q0p_576_CM "" RAT_FUNC "%6.3" "V" COEFFS 0. 1000. 0. 0. 0. 1. /end COMPU_METHOD
/begin COMPU_METHOD _CNV_R_R_temp_ub_q0_587_CM "" RAT_FUNC "%6.3" "°C" COEFFS 0. 1. 48. 0. 0. 0.75 /end COMPU_METHOD
/begin RECORD_LAYOUT _REC_VAL_20_u1 FNC_VALUES 1 UBYTE COLUMN_DIR DIRECT /end RECORD_LAYOUT
/begin RECORD_LAYOUT _REC_MAP_20_u1_u1_u1 FNC_VALUES 1 UBYTE COLUMN_DIR DIRECT /end RECORD_LAYOUT
/begin RECORD_LAYOUT _REC_AXS_20_u1 NO_AXIS_PTS_X 1 UBYTE AXIS_PTS_X 2 UBYTE INDEX_INCR DIRECT /end RECORD_LAYOUT
/begin RECORD_LAYOUT _REC_CUR_20_u1_u1 FNC_VALUES 1 UBYTE COLUMN_DIR DIRECT /end RECORD_LAYOUT
/begin RECORD_LAYOUT _REC_AXS_20_u2 NO_AXIS_PTS_X 1 UWORD AXIS_PTS_X 2 UWORD INDEX_INCR DIRECT /end RECORD_LAYOUT
/begin RECORD_LAYOUT _REC_VAL_20_u2 FNC_VALUES 1 UWORD COLUMN_DIR DIRECT /end RECORD_LAYOUT
/begin RECORD_LAYOUT _REC_CUR_20_u2_u1 FNC_VALUES 1 UWORD COLUMN_DIR DIRECT /end RECORD_LAYOUT
/begin RECORD_LAYOUT _REC_MAP_20_u1_u1_u2 FNC_VALUES 1 UBYTE COLUMN_DIR DIRECT /end RECORD_LAYOUT
/begin RECORD_LAYOUT _REC_CUR_20_u1_u2 FNC_VALUES 1 UBYTE COLUMN_DIR DIRECT /end RECORD_LAYOUT
/begin RECORD_LAYOUT _REC_MAP_20_u2_u1_u1 FNC_VALUES 1 UWORD COLUMN_DIR DIRECT /end RECORD_LAYOUT
/begin RECORD_LAYOUT _REC_VAL_20_s2 FNC_VALUES 1 SWORD COLUMN_DIR DIRECT /end RECORD_LAYOUT
/begin RECORD_LAYOUT _REC_VAL_20_s1 FNC_VALUES 1 SBYTE COLUMN_DIR DIRECT /end RECORD_LAYOUT
/begin RECORD_LAYOUT _REC_MAP_52_u2_u2_u2 NO_AXIS_PTS_X 1 UWORD NO_AXIS_PTS_Y 2 UWORD AXIS_PTS_X 3 UWORD INDEX_INCR DIRECT AXIS_PTS_Y 4 UWORD INDEX_INCR DIRECT FNC_VALUES 5 UWORD COLUMN_DIR DIRECT /end RECORD_LAYOUT
/begin RECORD_LAYOUT _REC_CUR_52_u2_u2 NO_AXIS_PTS_X 1 UWORD AXIS_PTS_X 2 UWORD INDEX_INCR DIRECT FNC_VALUES 3 UWORD COLUMN_DIR DIRECT /end RECORD_LAYOUT
/begin RECORD_LAYOUT _REC_CUR_52_UBYTE_u2_u1 NO_AXIS_PTS_X 1 UBYTE AXIS_PTS_X 2 UBYTE INDEX_INCR DIRECT FNC_VALUES 3 UWORD COLUMN_DIR DIRECT /end RECORD_LAYOUT
/begin RECORD_LAYOUT _REC_MAP_52_u1_u1_u1 NO_AXIS_PTS_X 1 UBYTE NO_AXIS_PTS_Y 2 UBYTE AXIS_PTS_X 3 UBYTE INDEX_INCR DIRECT AXIS_PTS_Y 4 UBYTE INDEX_INCR DIRECT FNC_VALUES 5 UBYTE COLUMN_DIR DIRECT /end RECORD_LAYOUT
/begin RECORD_LAYOUT _REC_CUR_32_u2_u2 NO_AXIS_PTS_X 1 UWORD AXIS_PTS_X 2 UWORD INDEX_INCR DIRECT FNC_VALUES 3 UWORD COLUMN_DIR DIRECT /end RECORD_LAYOUT
/begin RECORD_LAYOUT _REC_CUR_32_u1_u1 NO_AXIS_PTS_X 1 UBYTE AXIS_PTS_X 2 UBYTE INDEX_INCR DIRECT FNC_VALUES 3 UBYTE COLUMN_DIR DIRECT /end RECORD_LAYOUT
/begin RECORD_LAYOUT _REC_VAL_2_u1 FNC_VALUES 1 UBYTE COLUMN_DIR DIRECT /end RECORD_LAYOUT
/begin RECORD_LAYOUT _REC_MAP_32_u1_u1_u2 NO_AXIS_PTS_X 1 UBYTE NO_AXIS_PTS_Y 2 UBYTE AXIS_PTS_X 3 UBYTE INDEX_INCR DIRECT AXIS_PTS_Y 4 UWORD INDEX_INCR DIRECT FNC_VALUES 5 UBYTE COLUMN_DIR DIRECT /end RECORD_LAYOUT
/begin RECORD_LAYOUT _REC_MAP_32_u1_u1_u1 NO_AXIS_PTS_X 1 UBYTE NO_AXIS_PTS_Y 2 UBYTE AXIS_PTS_X 3 UBYTE INDEX_INCR DIRECT AXIS_PTS_Y 4 UBYTE INDEX_INCR DIRECT FNC_VALUES 5 UBYTE COLUMN_DIR DIRECT /end RECORD_LAYOUT
/begin RECORD_LAYOUT _REC_MAP_32_u2_u2_u2 NO_AXIS_PTS_X 1 UWORD NO_AXIS_PTS_Y 2 UWORD AXIS_PTS_X 3 UWORD INDEX_INCR DIRECT AXIS_PTS_Y 4 UWORD INDEX_INCR DIRECT FNC_VALUES 5 UWORD COLUMN_DIR DIRECT /end RECORD_LAYOUT
/begin RECORD_LAYOUT _REC_VAL_20_S4 FNC_VALUES 1 FLOAT32_IEEE COLUMN_DIR DIRECT /end RECORD_LAYOUT
/begin RECORD_LAYOUT _REC_CUR_34_S4_S4 NO_AXIS_PTS_X 1 ULONG AXIS_PTS_X 2 FLOAT32_IEEE INDEX_INCR DIRECT FNC_VALUES 3 FLOAT32_IEEE COLUMN_DIR DIRECT /end RECORD_LAYOUT
/begin RECORD_LAYOUT _REC_CUR_52_u1_u1 NO_AXIS_PTS_X 1 UBYTE AXIS_PTS_X 2 UBYTE INDEX_INCR DIRECT FNC_VALUES 3 UBYTE COLUMN_DIR DIRECT /end RECORD_LAYOUT
/begin FUNCTION AUX_Power_Management "_Power Management"
 /begin DEF_CHARACTERISTIC CRENGOF CRVVTOF KFELUPWM KLELTEMP CRVVTNOT KLELSLP KLELUB DFRUTYP IGENLLRANH LLRABS_DF LLRANH_DF NTWBGLLGEN PRELLDFAH PRELLDFRF KFDFIGEN0 KFDFIGEN1 KFDFIGEN2 KFDFIGEN3 KFDFIGEN4 KFDFIGEN5 KFDFIGEN6 KFDFIGEN7 GEN_DNMIN GENPDTIME GFBSUTERR GFBSUTHEAL GFELTERR GFELTHEAL GFHTTERR GFHTTHEAL GFMETERR GFMETHEAL GFNOBTERR GFNOBTHEAL MSKGENDFP MSKGENKL61 SNMBSDKL61 EN_MDGEN GEN_IG_OF GENITYP GENTEMPAPP GENTEMPMAN GENTYP GENUMGTYP TSTCNTEN TSTFIL_IN TSTFIL_INI ZMGENIG ZMTESTFIL ENGENTANS GENTMOTDT GENVFZGSW KLIGENMESS KLRTHFAK0 PRELLGTMOT ZMGENSTHZ0 ZMGENSTKL0 ZMGENTWA GENDIFAK0 GENDIFAK1 GENDIFAK2 GENDIFAK3 GENDIFAK4 GENDIFAK5 GENDIFAK6 GENDIFAK7 GENRS0_0 GENRS0_1 GENRS0_2 GENRS0_3 GENRS0_4 GENRS0_5 GENRS0_6 GENRS0_7 GENSTFAK0 GENSTFAK1 GENSTFAK2 GENSTFAK3 GENSTFAK4 GENSTFAK5 GENSTFAK6 GENSTFAK7 GENTMOTOF0 GENTMOTOF1 GENTMOTOF2 GENTMOTOF3 GENTMOTOF4 GENTMOTOF5 GENTMOTOF6 GENTMOTOF7 GENTYPFELD IGBASIS IGBASISOFF KFGENWETA0 KFGENWETA1 KFGENWETA2 KFGENWETA3 KFGENWETA4 KFGENWETA5 KFGENWETA6 KFGENWETA7 KFIGENDF0 KFIGENDF1 KFIGENDF2 KFIGENDF3 KFIGENDF4 KFIGENDF5 KFIGENDF6 KFIGENDF7 KLFPDIODE0 KLFPDIODE1 KLFPDIODE2 KLFPDIODE3 KLFPDIODE4 KLFPDIODE5 KLFPDIODE6 KLFPDIODE7 KLGENEXP0 KLGENEXP1 KLGENEXP2 KLGENEXP3 KLGENEXP4 KLGENEXP5 KLGENEXP6 KLGENEXP7 KLGENTETA0 KLGENTETA1 KLGENTETA2 KLGENTETA3 KLGENTETA4 KLGENTETA5 KLGENTETA6 KLGENTETA7 KLRTH0FAK0 KLRTH0FAK1 KLRTH0FAK2 KLRTH0FAK3 KLRTH0FAK4 KLRTH0FAK5 KLRTH0FAK6 KLRTH0FAK7 KLRTHFAK1 KLRTHFAK2 KLRTHFAK3 KLRTHFAK4 KLRTHFAK5 KLRTHFAK6 KLRTHFAK7 KLRTHGEN0 KLRTHGEN1 KLRTHGEN2 KLRTHGEN3 KLRTHGEN4 KLRTHGEN5 KLRTHGEN6 KLRTHGEN7 KLTANSGEN0 KLTANSGEN1 KLTANSGEN2 KLTANSGEN3 KLTANSGEN4 KLTANSGEN5 KLTANSGEN6 KLTANSGEN7 MANAWNUMM S_IGMISCH TIGMISCH UDIODERMS0 UDIODERMS1 UDIODERMS2 UDIODERMS3 UDIODERMS4 UDIODERMS5 UDIODERMS6 UDIODERMS7 ZMGENS0HZ0 ZMGENS0HZ1 ZMGENS0HZ2 ZMGENS0HZ3 ZMGENS0HZ4 ZMGENS0HZ5 ZMGENS0HZ6 ZMGENS0HZ7 ZMGENS0KL0 ZMGENS0KL1 ZMGENS0KL2 ZMGENS0KL3 ZMGENS0KL4 ZMGENS0KL5 ZMGENS0KL6 ZMGENS0KL7 ZMGENSTHZ1 ZMGENSTHZ2 ZMGENSTHZ3 ZMGENSTHZ4 ZMGENSTHZ5 ZMGENSTHZ6 ZMGENSTHZ7 ZMGENSTKL1 ZMGENSTKL2 ZMGENSTKL3 ZMGENSTKL4 ZMGENSTKL5 ZMGENSTKL6 ZMGENSTKL7 ZMGN0TANS0 ZMGN0TANS1 ZMGN0TANS2 ZMGN0TANS3 ZMGN0TANS4 ZMGN0TANS5 ZMGN0TANS6 ZMGN0TANS7 ZMGNTANS0 ZMGNTANS1 ZMGNTANS2 ZMGNTANS3 ZMGNTANS4 ZMGNTANS5 ZMGNTANS6 ZMGNTANS7 ZMIGMISCH S_RDGENTYP GENUEBSETZ0 GENUEBSETZ1 GENUEBSETZ2 GENUEBSETZ3 GENUEBSETZ4 GENUEBSETZ5 GENUEBSETZ6 GENUEBSETZ7 KFIGENKA0 KFIGENKA1 KFIGENKA2 KFIGENKA3 KFIGENKA4 KFIGENKA5 KFIGENKA6 KFIGENKA7 KFIGENWA0 KFIGENWA1 KFIGENWA2 KFIGENWA3 KFIGENWA4 KFIGENWA5 KFIGENWA6 KFIGENWA7 GENMDNMOF IGNOTWERT KFMDGENFIL C_VB_MIN_BSD_DIAG APPTBATINI BATT_ALFAH BATT_ALFAV BATT_BETAV BATTHTAUVK BATTVTAUVG BATTVTAUVK KLBATTLSTR KLEXPALH KLEXPALV KLEXPBETAV LADEKENNL PLBATTUMG TBATINIMAN TBATTFTAUV TBATTTAUFH ULADE_TAU BATTORT0 BATTORT2 DTANSKOR ILMINUMG LBATTMAX LBATTMIN MCOBATTORT NMINUMG OFTUMGCAN TUMGINI TUMGTAU UBATTNORM VMINUMG BATVFZGTAU BATTHTAUVG GENLDDFMAX KLGENLDST DFMODE DFS_MAX DFS_MIN DFS_MITT TNNSTART B_APP_LLAH GENLLAHAPP NSUBO NSUBU ENAPPLGOFF ENAPPLRESP KFLORESP KLLORESPM KLZLRESOF KLZLRESOFV LRESPAPP RLMXGENOF TGENOFVL TLORESPST TVLOFHYST VGENOFMN VGENOGMX NMXGENOF S_LORESLL TATMGENOF VZLORESOFV APPNIDLIBS APPUIBS B_APP_UGEN GENOFFTIME GENUMAX GENURAMP GENURAMPOF S_GOFFRAMP UGENOFF UGENOFFV0 KLFGENSLP KLUBATTMAX S_ENGENSLP U_GENSLP LC_POW_CORD_INH GEN_APP_UG /end DEF_CHARACTERISTIC
 /begin OUT_MEASUREMENT FAKTUBEL I_ELUVFZG VFZG_TMP UGEN DFFGEN NMOT_W B_GENFKUPL B_GFBSUPAK B_GFELAK B_GFMEAK B_GFNOBSAK TANS VFZG B_STEND IGENMESS TABST_W B_PWF TMOT GENMANUFAK GENTYPKENN TUMG ST_CRAWENG B_FIRSTEMP B_GENE B_GENOFF B_HEIZEN GEN_TETA GEN_WETA GENALFAK2 GENDTS GENDTS_S1 GENDTSVOR GENFETA GENI_DIFK GENI_END GENI_STFK GENI2_ST GENIG GENIKALTUN GENINAFIL GENITEMP GENIVORFIL GENRS GENSPV GENSPV_1 GENSPV_2 GENSTTEMP GENTEMP GENTEMPAB GENTEMPDT GENTEMPEND GENTEMPEXP GENTEMPFIL IGEN400A MD_GENNM MDNORMTMP NGEN_W NMOTS PGENAB ST_I_GEN TSTCOUNTV TSTFIL_OUT TSTLOCINI GENTANS GENTANSEND B_GENERKEN DIB_IG FDIB_IG GENAWNUMM GENDI_SPV GENNUMMER IBASIS IGM IGVOR MDGENREL_W MDGENVF_W UGEN_TMP B_GENACTIV MDGENFIL_W MDGENNMUFI TLRFGEN UFGEN B_GENFEL B_GENFHT B_GENFME B_GENFBSD B_KL15 B_TNS B_FS B_LL B_LLREIN B_VL B_NMOT B_ETUM GENSTATROH ST_GEN B_KL61 FAKTTANSEL I_ELU_VVT I_ELUEFTER I_ELUPWM TAML_TMP TANS_TMP UB_TMP VVT_IB1_2 VVT_IGES B_INIBUMG BATT_A1 BATT_A2 BATT_C10 BATT_C11 BATT_C12 BATT_C13 BATT_C14 BATT_C8 BATT_C9 BATT_D1 BATT_E1 BATT_E2 BATT_E3 BATT_E4 BATT_E5 BATT_E6 BATT_TFIL BATT_W0 BATTO_A BATTO_A1 BATTO_B BATTO_C BATTO_C1 BATTO_C2 BATTO_C3 BATTO_C4 BATTO_C6 BATTO_C7 CTRGENUTAR DBET_ALF DBETALF_T DT_TUMG T_BATT_INI T_BATTABST T_UMGABST T_UMGABSTF TABST_FL TANSF TBATINMANF TBATSTINIV TUMGBATOLD TUMGBATTAB TUMGCANF ST_LDSTGEN B_NSUB N_IDLGSPEC NSLB B_GENOFFMD LOADRESP B_GENOFFOK I_SLP B_HYSLLRAH GENDFVORHS GENIKALTMP GENITEMP2 IGENRLLRAH NGSLLM UFGENTMP2 B_1STBSDER B_AUXERR B_GFBSUPEP B_GFELEP B_GFHTEP B_GFMEEP B_GFNOBSEP EN_GENDIAG GENFBSAK GFBSUCTR GFEHLIN1 GFEHLIN2 GFEHLIN3 GFEHLIN4 GFEHLIN5 GFELCTR GFHTCTR GFMECTR GFNOBCTR KL61LOC BATTORT COBATTORT END_INIT TUMG_ERS TUMGTEMP DFFGENFLO DFMONITOR DFSUMME DFWANZAHL NNSTART B_GENOFFST B_GENOFFVL B_1STUGEN UGLOC URAMP /end OUT_MEASUREMENT
/end FUNCTION
/begin FUNCTION AUX_Calculating_the_pulse_width_ "_Calculating the pulse width modulation"
 /begin DEF_CHARACTERISTIC IP_FAC_IVVTPWM IP_IVVTHPWM C_IVVTPWM_AD_OFS_EX C_IVVTPWM_ADC_EX C_IVVTPWM_ADC_IN C_IVVTPWM_RTD_EX C_IVVTPWM_RTD_IN C_CAM_HYS_ADH_IVVT C_CAM_HYS_RST_ADH_IVVT C_CAM_SP_DIF_ADH_IVVT C_CYC_MAX_ADH_IVVT C_SUM_SEG_DLY_IVVTHPWM C_IVVTHPWM_AD_MIN C_IVVTHPWM_AD_MAX IP_CYC_MIN_ADH_IVVT IP_IVVTHPWM_ADH IP_IVVTHPWM_ADH_CYC_IN IP_IVVTHPWM_ADH_CYC_EX ID_IVVTHPWM_COR_AD IVVTHPWM_AD_IN_2 IVVTHPWM_AD_IN_1 IVVTHPWM_AD_EX_2 IVVTHPWM_AD_EX_1 /end DEF_CHARACTERISTIC
 /begin OUT_MEASUREMENT CAM_SP_DYW_IVVT_IN LV_CAM_SP_DYW_IVVT_IN IVVTPWM_IN_1 SUM_CYC_ADH_IVVT_IN_1 IVVTHPWM_ADH_IN_1 IVVTHPWM_ADH_SAVE_IN_1 LV_ADH_ACT_IVVT_IN_1 LV_ADH_END_IVVT_IN_1 SUM_STATE_ACT_ADJ_IVVT_IN_1 VEL_DRIFT_IVVTHPWM_IN_1 IVVTHPWM_AD_IN_1 IVVTPWM_IN_2 SUM_CYC_ADH_IVVT_IN_2 IVVTHPWM_ADH_IN_2 IVVTHPWM_ADH_SAVE_IN_2 LV_ADH_ACT_IVVT_IN_2 LV_ADH_END_IVVT_IN_2 SUM_STATE_ACT_ADJ_IVVT_IN_2 VEL_DRIFT_IVVTHPWM_IN_2 IVVTHPWM_AD_IN_2 IVVTPWM_EX_1 SUM_CYC_ADH_IVVT_EX_1 IVVTHPWM_ADH_EX_1 IVVTHPWM_ADH_SAVE_EX_1 LV_ADH_ACT_IVVT_EX_1 LV_ADH_END_IVVT_EX_1 SUM_STATE_ACT_ADJ_IVVT_EX_1 VEL_DRIFT_IVVTHPWM_EX_1 IVVTHPWM_AD_EX_1 IVVTPWM_EX_2 SUM_CYC_ADH_IVVT_EX_2 IVVTHPWM_ADH_EX_2 IVVTHPWM_ADH_SAVE_EX_2 LV_ADH_ACT_IVVT_EX_2 LV_ADH_END_IVVT_EX_2 SUM_STATE_ACT_ADJ_IVVT_EX_2 VEL_DRIFT_IVVTHPWM_EX_2 IVVTHPWM_AD_EX_2 CAM_SP_DYW_IVVT_EX LV_CAM_SP_DYW_IVVT_EX T_DLY_MES_IVVT /end OUT_MEASUREMENT
/end FUNCTION
/begin FUNCTION AUX_Coil_substitute_temperature "_Coil substitute temperature" /begin DEF_CHARACTERISTIC IP_TMAG_IVVT /end DEF_CHARACTERISTIC /begin OUT_MEASUREMENT TMAG_IVVT /end OUT_MEASUREMENT /end FUNCTION
/begin FUNCTION AUX_Calculation_of_delay "_Calculation of delay"
 /begin DEF_CHARACTERISTIC C_CAM_DIF_MIN_DLY_IVVT IP_DLY_ADC_IVVT_EX IP_DLY_ADC_IVVT_IN IP_DLY_RTD_IVVT_EX IP_DLY_RTD_IVVT_IN /end DEF_CHARACTERISTIC
 /begin OUT_MEASUREMENT DLY_ADC_IVVT_IN DLY_RTD_IVVT_IN DLY_MES_ADC_IVVT_IN_1 DLY_MES_RTD_IVVT_IN_1 DLY_MES_ADC_IVVT_IN_2 DLY_MES_RTD_IVVT_IN_2 DLY_MES_ADC_IVVT_EX_1 DLY_MES_RTD_IVVT_EX_1 DLY_MES_ADC_IVVT_EX_2 DLY_MES_RTD_IVVT_EX_2 DLY_ADC_IVVT_EX DLY_RTD_IVVT_EX /end OUT_MEASUREMENT
/end FUNCTION
/begin FUNCTION AUX_IVVT_Controller "_IVVT-Controller"
 /begin DEF_CHARACTERISTIC C_FAC_HLD_DLY IP_T_FAC_ADC_IVVT_EX IP_T_FAC_ADC_IVVT_IN IP_T_FAC_RTD_IVVT_EX IP_FAC_CTL_IVVT_IN C_CAM_MDL_DIF_MIN_ADH C_FAC_T_SUM_MIN_IVVT_ADH C_FAC_DLY_IVVT_ADH C_CAM_ADJ_DIF_ADH_IN C_CAM_ADJ_DIF_ADH_EX C_CAM_ADH_HYS IP_TOIL_MIN_IVVT_DIAG IP_TOIL_MAX_IVVT_DIAG IP_T_FAC_RTD_IVVT_IN IP_T_DLY_ADD_ADC_IVVT_IN IP_T_DLY_ADD_ADC_IVVT_EX IP_T_DLY_ADD_RTD_IVVT_EX IP_T_DLY_ADD_RTD_IVVT_IN IP_FAC_CTL_IVVT_EX IP_T_CTL_ADC_IVVT_EX IP_T_CTL_ADC_IVVT_IN IP_T_CTL_RTD_IVVT_IN IP_T_CTL_RTD_IVVT_EX IP_T_SUM_MIN_ADC_IVVT_EX IP_T_SUM_MIN_ADC_IVVT_IN IP_T_SUM_MIN_RTD_IVVT_IN IP_T_SUM_MIN_RTD_IVVT_EX C_T_ADD_MIN_IVVT_ADH_IN C_T_ADD_MIN_IVVT_ADH_EX C_T_ADD_MIN_IVVT_ADH_MAX /end DEF_CHARACTERISTIC
 /begin OUT_MEASUREMENT CAM_MDL_DIF_IVVT_IN_1 DLY_IVVT_IN_1 CAM_MDL_IVVT_IN_1 CAM_MDL_DLY_NOT_IVVT_IN_1 CAM_SP_DIF_IVVT_IN_1 T_CTL_I_IVVT_IN_1 T_CTL_IVVT_IN_1 T_IVVT_IN_1 T_SUM_IVVT_IN_1 T_SLV_IVVT_IN_1 T_STOP_ADJ_IVVT_IN_1 T_ACT_IVVT_IN_1 T_CTL_I_LIM_IVVT_IN_1 T_ST_ADJ_IVVT_IN_1 T_ADJ_OLD_IVVT_IN_1 T_LIM_IVVT_IN_1 T_CTL_I_LIM_1_IVVT_IN_1 T_SUM_TMP_IVVT_IN_1 T_SUM_SUBT_IVVT_IN_1 T_ADJ_NEW_IVVT_IN_1 T_SUM_IF_IVVT_IN_1 CAM_DIF_IVVT_IN_1 CAM_CLC_DELTA_IN_1 LV_ADJ_POS_IVVT_IN_1 LV_ADJ_CHG_DIR_IVVT_IN_1 LV_HLD_REQ_IVVT_IN_1 LV_MDL_ADC_IVVT_IN_1 STATE_IVVT_PWM_IN_1 STATE_IVVT_ACT_IN_1 CAM_SP_DIF_IVVT_IN_2 CAM_MDL_DLY_NOT_IVVT_IN_2 CAM_MDL_IVVT_IN_2 CAM_MDL_DIF_IVVT_IN_2 DLY_IVVT_IN_2 T_IVVT_IN_2 T_SUM_IVVT_IN_2 T_CTL_IVVT_IN_2 T_CTL_I_IVVT_IN_2 T_SLV_IVVT_IN_2 T_STOP_ADJ_IVVT_IN_2 T_ACT_IVVT_IN_2 T_CTL_I_LIM_IVVT_IN_2 T_ST_ADJ_IVVT_IN_2 T_ADJ_OLD_IVVT_IN_2 T_LIM_IVVT_IN_2 T_CTL_I_LIM_1_IVVT_IN_2 T_SUM_TMP_IVVT_IN_2 T_SUM_SUBT_IVVT_IN_2 T_ADJ_NEW_IVVT_IN_2 T_SUM_IF_IVVT_IN_2 CAM_DIF_IVVT_IN_2 CAM_CLC_DELTA_IN_2 LV_ADJ_POS_IVVT_IN_2 LV_ADJ_CHG_DIR_IVVT_IN_2 LV_HLD_REQ_IVVT_IN_2 LV_MDL_ADC_IVVT_IN_2 STATE_IVVT_ACT_IN_2 STATE_IVVT_PWM_IN_2 CAM_MDL_DIF_IVVT_EX_1 DLY_IVVT_EX_1 CAM_MDL_IVVT_EX_1 CAM_MDL_DLY_NOT_IVVT_EX_1 CAM_SP_DIF_IVVT_EX_1 T_CTL_IVVT_EX_1 T_CTL_I_IVVT_EX_1 T_IVVT_EX_1 T_SUM_IVVT_EX_1 T_SLV_IVVT_EX_1 T_STOP_ADJ_IVVT_EX_1 T_ACT_IVVT_EX_1 T_CTL_I_LIM_IVVT_EX_1 T_ST_ADJ_IVVT_EX_1 T_ADJ_OLD_IVVT_EX_1 T_LIM_IVVT_EX_1 T_CTL_I_LIM_1_IVVT_EX_1 T_SUM_TMP_IVVT_EX_1 T_SUM_SUBT_IVVT_EX_1 T_ADJ_NEW_IVVT_EX_1 T_SUM_IF_IVVT_EX_1 CAM_DIF_IVVT_EX_1 CAM_CLC_DELTA_EX_1 LV_ADJ_POS_IVVT_EX_1 LV_ADJ_CHG_DIR_IVVT_EX_1 LV_HLD_REQ_IVVT_EX_1 LV_MDL_ADC_IVVT_EX_1 STATE_IVVT_ACT_EX_1 STATE_IVVT_PWM_EX_1 CAM_SP_DIF_IVVT_EX_2 CAM_MDL_DLY_NOT_IVVT_EX_2 CAM_MDL_IVVT_EX_2 CAM_MDL_DIF_IVVT_EX_2 DLY_IVVT_EX_2 T_IVVT_EX_2 T_SUM_IVVT_EX_2 T_CTL_IVVT_EX_2 T_CTL_I_IVVT_EX_2 T_SLV_IVVT_EX_2 T_STOP_ADJ_IVVT_EX_2 T_ACT_IVVT_EX_2 T_CTL_I_LIM_IVVT_EX_2 T_ST_ADJ_IVVT_EX_2 T_ADJ_OLD_IVVT_EX_2 T_LIM_IVVT_EX_2 T_CTL_I_LIM_1_IVVT_EX_2 T_SUM_TMP_IVVT_EX_2 T_SUM_SUBT_IVVT_EX_2 T_ADJ_NEW_IVVT_EX_2 T_SUM_IF_IVVT_EX_2 CAM_DIF_IVVT_EX_2 CAM_CLC_DELTA_EX_2 LV_ADJ_POS_IVVT_EX_2 LV_ADJ_CHG_DIR_IVVT_EX_2 LV_HLD_REQ_IVVT_EX_2 LV_MDL_ADC_IVVT_EX_2 STATE_IVVT_ACT_EX_2 STATE_IVVT_PWM_EX_2 /end OUT_MEASUREMENT
/end FUNCTION
/begin FUNCTION AUX_Adaptation_of_reference_and_ "_Adaptation of reference and non-reference edges"
 /begin DEF_CHARACTERISTIC C_CAM_GRD_AD_MAX_IVVT C_CAM_GRD_AD_MAX_ST_IVVT C_CRLC_REF_IVVT ID_SUM_CAM_AD_IVVT C_CAM_RAW_DYW_IVVT_IN C_CRLC_CAM_AD_IVVT C_CRLC_CAM_AD_ST_IVVT C_T_MIN_REF_REQ_IVVT C_TCO_ADD_CAM_REF_IVVT C_CAM_RAW_DYW_IVVT_EX C_CAM_DIF_MAX_IVVT_PARK C_CTR_THD_IVVT_PARK C_CYC_CAM_POS_DLY_PARK C_N_CAM_AD_BOL C_N_CAM_AD_TOL C_CTR_CAM_AD_IVVT_MAX C_T_DLY_CAM_AD_IVVT C_CAM_HYS_AD_IVVT C_CAM_HYS_REF_IVVT C_CAM_INI_IN C_CAM_INI_EX /end DEF_CHARACTERISTIC
 /begin OUT_MEASUREMENT LV_CAM_AD_REQ_IVVT LV_CAM_AD_DI_IVVT LV_CAM_AD_AVL_IVVT LV_CAM_AD_NVMY_VLD LV_DIS_IVVT_PARK CTR_CAM_AD_IVVT CAM_IN_1 CAM_REF_IVVT_IN_1 CAM_AD_IVVT_IN_1_0 CAM_REF_DIF_IVVT_IN_1 CAM_RAW_DYW_IVVT_IN_1 LV_CAM_RAW_DYW_IVVT_IN_1 CAM_REF_RAW_IN_1 CAM_AD_IVVT_IN_1_1 CAM_AD_IVVT_IN_1_2 CAM_IN_PARK_1 CTR_CAM_DIF_IVVT_PARK_IN_1 CTR_CAM_DRIFT_IVVT_PARK_IN_1 CAM_IN_2 CAM_REF_IVVT_IN_2 CAM_AD_IVVT_IN_2_0 CAM_REF_DIF_IVVT_IN_2 LV_CAM_RAW_DYW_IVVT_IN_2 CAM_RAW_DYW_IVVT_IN_2 CAM_REF_RAW_IN_2 CAM_AD_IVVT_IN_2_1 CAM_AD_IVVT_IN_2_2 CAM_IN_PARK_2 CTR_CAM_DIF_IVVT_PARK_IN_2 CTR_CAM_DRIFT_IVVT_PARK_IN_2 CAM_EX_1 CAM_REF_IVVT_EX_1 CAM_AD_IVVT_EX_1_0 CAM_REF_DIF_IVVT_EX_1 CAM_RAW_DYW_IVVT_EX_1 LV_CAM_RAW_DYW_IVVT_EX_1 CAM_REF_RAW_EX_1 CAM_AD_IVVT_EX_1_1 CAM_AD_IVVT_EX_1_2 CAM_EX_PARK_1 CTR_CAM_DIF_IVVT_PARK_EX_1 CTR_CAM_DRIFT_IVVT_PARK_EX_1 CAM_EX_2 CAM_REF_IVVT_EX_2 CAM_AD_IVVT_EX_2_0 CAM_REF_DIF_IVVT_EX_2 LV_CAM_RAW_DYW_IVVT_EX_2 CAM_RAW_DYW_IVVT_EX_2 CAM_REF_RAW_EX_2 CAM_AD_IVVT_EX_2_1 CAM_AD_IVVT_EX_2_2 CAM_EX_PARK_2 CTR_CAM_DIF_IVVT_PARK_EX_2 CTR_CAM_DRIFT_IVVT_PARK_EX_2 /end OUT_MEASUREMENT
/end FUNCTION
/end MODULE
/end PROJECT
