ASAP2_VERSION 1 31
/begin PROJECT MS45 "BMW Motorsteuerung R6"
/begin HEADER "_default_HeaderComment" PROJECT_NO _52 /end HEADER
/begin MODULE _default_ModuleName "_default_ModuleLongIdentifier"
/begin MOD_COMMON "_default_ModCommonComment" DEPOSIT ABSOLUTE BYTE_ORDER MSB_FIRST ALIGNMENT_BYTE 1 ALIGNMENT_WORD 2 ALIGNMENT_LONG 4 ALIGNMENT_FLOAT32_IEEE 4 ALIGNMENT_FLOAT64_IEEE 8 /end MOD_COMMON
/begin MEASUREMENT ER_MMV_IS_DIAG_0 "Filtered engine roughness value cylinder individual" SWORD _CNV_A_R_LINEAR_____15_CM 1 100. -8. 7.99975586 ECU_ADDRESS 0x3fcdc0 FORMAT "%7.4" /end MEASUREMENT
/begin MEASUREMENT ER_MMV_IS_DIAG_1 "Filtered engine roughness value cylinder individual" SWORD _CNV_A_R_LINEAR_____15_CM 1 100. -8. 7.99975586 ECU_ADDRESS 0x3fcdc2 FORMAT "%7.4" /end MEASUREMENT
/begin MEASUREMENT ER_MMV_IS_DIAG_2 "Filtered engine roughness value cylinder individual" SWORD _CNV_A_R_LINEAR_____15_CM 1 100. -8. 7.99975586 ECU_ADDRESS 0x3fcdc4 FORMAT "%7.4" /end MEASUREMENT
/begin MEASUREMENT ER_MMV_IS_DIAG_3 "Filtered engine roughness value cylinder individual" SWORD _CNV_A_R_LINEAR_____15_CM 1 100. -8. 7.99975586 ECU_ADDRESS 0x3fcdc6 FORMAT "%7.4" /end MEASUREMENT
/begin MEASUREMENT ER_MMV_IS_DIAG_4 "Filtered engine roughness value cylinder individual" SWORD _CNV_A_R_LINEAR_____15_CM 1 100. -8. 7.99975586 ECU_ADDRESS 0x3fcdc8 FORMAT "%7.4" /end MEASUREMENT
/begin MEASUREMENT ER_MMV_IS_DIAG_5 "Filtered engine roughness value cylinder individual" SWORD _CNV_A_R_LINEAR_____15_CM 1 100. -8. 7.99975586 ECU_ADDRESS 0x3fcdca FORMAT "%7.4" /end MEASUREMENT
/begin CHARACTERISTIC IP_THD_IS_ER_DIAG__N__MAF "ER reference value for ER diagnosis" MAP 0x4b9e8 _REC_MAP_20_u2_u2_u1 -32766. _CNV_A_R_LINEAR_____16_CM -1. -32767. FORMAT "%7.0"
 /begin AXIS_DESCR COM_AXIS N _CNV_A_R_LINEAR_____17_CM 4 0. 8160. FORMAT "%4.0" AXIS_PTS_REF ldp_n__thd_is_er_diag /end AXIS_DESCR
 /begin AXIS_DESCR COM_AXIS MAF _CNV_A_R_LINEAR_____18_CM 4 0. 1389. FORMAT "%4.0" AXIS_PTS_REF ldp_maf__thd_is_er_diag /end AXIS_DESCR
/end CHARACTERISTIC
/begin CHARACTERISTIC IP_FAC_THD_IS_ER_DIAG__TCO "TCO-dependent reference value correction" CURVE 0x4e539 _REC_CUR_20_u1_u1 0.9922 _CNV_A_R_LINEAR_____19_CM 1. 1.9922 FORMAT "%5.3"
 /begin AXIS_DESCR COM_AXIS TCO _CNV_A_R_LINEAR_____0_CM 8 -48. 142.5 FORMAT "%5.1" AXIS_PTS_REF ldp_tco__fac_thd_is_er_diag /end AXIS_DESCR
/end CHARACTERISTIC
/begin CHARACTERISTIC C_CRLC_IS_ER_DIAG "Correlation constant for calculating the ER diagnostic values" VALUE 0x42832 _REC_VAL_20_u1 0.99610001 _CNV_A_R_LINEAR_____20_CM 0. 0.99610001 FORMAT "%5.3" /end CHARACTERISTIC
/begin AXIS_PTS ldp_maf__thd_is_er_diag "" 0x43464 MAF _REC_AXS_20_u1 1389. _CNV_A_R_LINEAR_____18_CM 4 0. 1389. FORMAT "%4.0" /end AXIS_PTS
/begin AXIS_PTS ldp_n__thd_is_er_diag "" 0x4481a N _REC_AXS_20_u2 816. _CNV_A_R_LINEAR_____17_CM 4 0. 8160. FORMAT "%4.0" /end AXIS_PTS
/begin AXIS_PTS ldp_tco__fac_thd_is_er_diag "" 0x4385d TCO _REC_AXS_20_u1 190.5 _CNV_A_R_LINEAR_____0_CM 8 -48. 142.5 FORMAT "%5.1" /end AXIS_PTS
/begin CHARACTERISTIC C_TOUT_IMOB "" VALUE 0x42ad3 _REC_VAL_20_u1 25.4 _CNV_A_R_LINEAR_____14_CM 0.1 25.5 FORMAT "%4.1" /end CHARACTERISTIC
/begin MEASUREMENT LV_ERR_IMOB_2 "" UBYTE _CNV_S_2_RANGE______21_R_CM 1 100. 0. 255. ECU_ADDRESS 0x3fd597 BIT_MASK 0x1 /end MEASUREMENT
/begin MEASUREMENT LV_ERR_IMOB_1 "" UBYTE _CNV_S_2_RANGE______21_R_CM 1 100. 0. 255. ECU_ADDRESS 0x3fd593 BIT_MASK 0x1 /end MEASUREMENT
/begin MEASUREMENT LV_ERR_IMOB_3 "" UBYTE _CNV_S_2_RANGE______21_R_CM 1 100. 0. 255. ECU_ADDRESS 0x3fd59b BIT_MASK 0x1 /end MEASUREMENT
/begin MEASUREMENT CTR_ABC_IMOB_3 "" UBYTE _CNV_A_R_LINEAR_____10_CM 1 100. 0. 255. ECU_ADDRESS 0x3fd59a FORMAT "%3.0" /end MEASUREMENT
/begin MEASUREMENT ERR_INFO_STAT "" UBYTE _CNV_S_2_RANGE______21_R_CM 1 100. 0. 255. ECU_ADDRESS 0x3fd598 /end MEASUREMENT
/begin MEASUREMENT LV_CDN_DIAG_IMOB_3 "" UBYTE _CNV_S_2_RANGE______21_R_CM 1 100. 0. 255. ECU_ADDRESS 0x3fd598 BIT_MASK 0x10 /end MEASUREMENT
/begin MEASUREMENT LV_END_DIAG_IMOB_3 "" UBYTE _CNV_S_2_RANGE______21_R_CM 1 100. 0. 255. ECU_ADDRESS 0x3fd598 BIT_MASK 0x20 /end MEASUREMENT
/begin MEASUREMENT LV_READY_IMOB_3 "" UBYTE _CNV_S_2_RANGE______21_R_CM 1 100. 0. 255. ECU_ADDRESS 0x3fd598 BIT_MASK 0x40 /end MEASUREMENT
/begin MEASUREMENT ERR_SYM_IMOB_3 "" UBYTE _CNV_S_6_RANGE_ERR__22_CM 1 100. 0. 15. ECU_ADDRESS 0x3fd598 BIT_MASK 0xF /end MEASUREMENT
/begin MEASUREMENT LV_ERR_MEM_IMOB_3 "" UBYTE _CNV_S_2_RANGE______21_R_CM 1 100. 0. 255. ECU_ADDRESS 0x3fd598 BIT_MASK 0x80 /end MEASUREMENT
/begin MEASUREMENT CTR_ABC_END_DIAG_IMOB_3 "" UBYTE _CNV_A_R_LINEAR_____12_CM 1 100. 0. 255. ECU_ADDRESS 0x3fd599 FORMAT "%3.0" /end MEASUREMENT
/begin MEASUREMENT CTR_ABC_IMOB_2 "" UBYTE _CNV_A_R_LINEAR_____10_CM 1 100. 0. 255. ECU_ADDRESS 0x3fd596 FORMAT "%3.0" /end MEASUREMENT
/begin MEASUREMENT LV_CDN_DIAG_IMOB_2 "" UBYTE _CNV_S_2_RANGE______21_R_CM 1 100. 0. 255. ECU_ADDRESS 0x3fd594 BIT_MASK 0x10 /end MEASUREMENT
/begin MEASUREMENT LV_END_DIAG_IMOB_2 "" UBYTE _CNV_S_2_RANGE______21_R_CM 1 100. 0. 255. ECU_ADDRESS 0x3fd594 BIT_MASK 0x20 /end MEASUREMENT
/begin MEASUREMENT LV_READY_IMOB_2 "" UBYTE _CNV_S_2_RANGE______21_R_CM 1 100. 0. 255. ECU_ADDRESS 0x3fd594 BIT_MASK 0x40 /end MEASUREMENT
/begin MEASUREMENT ERR_SYM_IMOB_2 "" UBYTE _CNV_S_6_RANGE_ERR__22_CM 1 100. 0. 15. ECU_ADDRESS 0x3fd594 BIT_MASK 0xF /end MEASUREMENT
/begin MEASUREMENT LV_ERR_MEM_IMOB_2 "" UBYTE _CNV_S_2_RANGE______21_R_CM 1 100. 0. 255. ECU_ADDRESS 0x3fd594 BIT_MASK 0x80 /end MEASUREMENT
/begin MEASUREMENT CTR_ABC_END_DIAG_IMOB_2 "" UBYTE _CNV_A_R_LINEAR_____12_CM 1 100. 0. 255. ECU_ADDRESS 0x3fd595 FORMAT "%3.0" /end MEASUREMENT
/begin MEASUREMENT CTR_ABC_IMOB_1 "" UBYTE _CNV_A_R_LINEAR_____10_CM 1 100. 0. 255. ECU_ADDRESS 0x3fd592 FORMAT "%3.0" /end MEASUREMENT
/begin MEASUREMENT LV_CDN_DIAG_IMOB_1 "" UBYTE _CNV_S_2_RANGE______21_R_CM 1 100. 0. 255. ECU_ADDRESS 0x3fd590 BIT_MASK 0x10 /end MEASUREMENT
/begin MEASUREMENT LV_END_DIAG_IMOB_1 "" UBYTE _CNV_S_2_RANGE______21_R_CM 1 100. 0. 255. ECU_ADDRESS 0x3fd590 BIT_MASK 0x20 /end MEASUREMENT
/begin MEASUREMENT LV_READY_IMOB_1 "" UBYTE _CNV_S_2_RANGE______21_R_CM 1 100. 0. 255. ECU_ADDRESS 0x3fd590 BIT_MASK 0x40 /end MEASUREMENT
/begin MEASUREMENT ERR_SYM_IMOB_1 "" UBYTE _CNV_S_6_RANGE_ERR__22_CM 1 100. 0. 15. ECU_ADDRESS 0x3fd590 BIT_MASK 0xF /end MEASUREMENT
/begin MEASUREMENT LV_ERR_MEM_IMOB_1 "" UBYTE _CNV_S_2_RANGE______21_R_CM 1 100. 0. 255. ECU_ADDRESS 0x3fd590 BIT_MASK 0x80 /end MEASUREMENT
/begin MEASUREMENT CTR_ABC_END_DIAG_IMOB_1 "" UBYTE _CNV_A_R_LINEAR_____12_CM 1 100. 0. 255. ECU_ADDRESS 0x3fd591 FORMAT "%3.0" /end MEASUREMENT
/begin MEASUREMENT LV_LOCK_IMOB "Locking of ign and inj by imob" UBYTE _CNV_S_2_RANGE______11_CM 1 100. 0. 1. ECU_ADDRESS 0x3fc3db BIT_MASK 0x1 /end MEASUREMENT
/begin MEASUREMENT INH_IV_IMOB "Locking request for inj by imob" UBYTE _CNV_A_R_LINEAR_____10_CM 1 100. 0. 255. ECU_ADDRESS 0x3fdbb5 FORMAT "%3.0" BIT_MASK 0x1 /end MEASUREMENT
/begin MEASUREMENT CTR_ERR_IMOB_2 "Error counter of diagnosis imob_2 diagnosis" UBYTE _CNV_A_R_LINEAR_____10_CM 1 100. 0. 255. ECU_ADDRESS 0x3fdbd2 FORMAT "%3.0" /end MEASUREMENT
/begin MEASUREMENT CTR_ERR_IMOB_1 "Error counter of diagnosis imob_1 diagnosis" UBYTE _CNV_A_R_LINEAR_____10_CM 1 100. 0. 255. ECU_ADDRESS 0x3fdbd1 FORMAT "%3.0" /end MEASUREMENT
/begin CHARACTERISTIC C_VB_MIN_MSW_DIAG "Min. battery voltage for MSW diagnosis" VALUE 0x42b12 _REC_VAL_20_u1 25.8984 _CNV_A_R_LINEAR_____26_CM 0. 25.8984 FORMAT "%3.1" /end CHARACTERISTIC
/begin MEASUREMENT LV_BRAKE_DET "LV_IM_BLS or _BTS detected" UBYTE _CNV_S_2_RANGE______28_CM 1 100. 0. 1. ECU_ADDRESS 0x3fcc6c /end MEASUREMENT
/begin CHARACTERISTIC C_T_BTS_PLAUS_MAX "Maximum value of the time counter for debounce  " VALUE 0x429bc _REC_VAL_20_u1 25.5 _CNV_A_R_LINEAR_____14_CM 0. 25.5 FORMAT "%4.1" /end CHARACTERISTIC
/begin MEASUREMENT LV_ERR_BLS_PLAUS "BLS plausibility error flag" UBYTE _CNV_S_2_RANGE______21_R_CM 1 100. 0. 255. ECU_ADDRESS 0x3fcc6b /end MEASUREMENT
/begin MEASUREMENT LV_ERR_CAM_0 "logical variable camshaft signal error CAM_0 (error debounced = 1) " UBYTE _CNV_S_2_RANGE______21_R_CM 1 100. 0. 255. ECU_ADDRESS 0x3fcfc8 /end MEASUREMENT
/begin CHARACTERISTIC ID_WIN_BOL_CHK_CAM_0 "camshaft and edge specific start angle of check window CAM_0" CURVE 0x45f30 _REC_CUR_20_u2_u1 720. _CNV_A_R_LINEAR_____75_CM 0. 720. FORMAT "%6.2"
 /begin AXIS_DESCR COM_AXIS CAM_EDGE_NR_0 _CNV_A_R_LINEAR_____10_CM 4 0. 3. FORMAT "%2.0" AXIS_PTS_REF ldpm_cam_edge_nr_0__win_chk /end AXIS_DESCR
/end CHARACTERISTIC
/begin CHARACTERISTIC ID_WIN_BOL_CHK_CAM_1 "camshaft and edge specific start angle of check window CAM_1" CURVE 0x45f38 _REC_CUR_20_u2_u1 720. _CNV_A_R_LINEAR_____75_CM 0. 720. FORMAT "%6.2"
 /begin AXIS_DESCR COM_AXIS CAM_EDGE_NR_1 _CNV_A_R_LINEAR_____10_CM 4 0. 3. FORMAT "%2.0" AXIS_PTS_REF ldpm_cam_edge_nr_1__win_chk /end AXIS_DESCR
/end CHARACTERISTIC
/begin CHARACTERISTIC ID_WIN_TOL_CHK_CAM_1 "camshaft and edge specific end angle of check window CAM_1" CURVE 0x45f48 _REC_CUR_20_u2_u1 720. _CNV_A_R_LINEAR_____75_CM 0. 720. FORMAT "%6.2"
 /begin AXIS_DESCR COM_AXIS CAM_EDGE_NR_1 _CNV_A_R_LINEAR_____10_CM 4 0. 3. FORMAT "%2.0" AXIS_PTS_REF ldpm_cam_edge_nr_1__win_chk /end AXIS_DESCR
/end CHARACTERISTIC
/begin CHARACTERISTIC ID_WIN_TOL_CHK_CAM_0 "camshaft and edge specific end angle of check window CAM_0" CURVE 0x45f40 _REC_CUR_20_u2_u1 720. _CNV_A_R_LINEAR_____75_CM 0. 720. FORMAT "%6.2"
 /begin AXIS_DESCR COM_AXIS CAM_EDGE_NR_0 _CNV_A_R_LINEAR_____10_CM 4 0. 3. FORMAT "%2.0" AXIS_PTS_REF ldpm_cam_edge_nr_0__win_chk /end AXIS_DESCR
/end CHARACTERISTIC
/begin MEASUREMENT CAM_EDGE_CTR_0 "Free counting camshaft edge counter CAM_0" UWORD _CNV_A_R_LINEAR_____10_CM 1 100. 0. 65535. ECU_ADDRESS 0x3fe564 FORMAT "%5.0" /end MEASUREMENT
/begin MEASUREMENT CAM_EDGE_1 "Camshaft edge specific angle CAM_1" UWORD _CNV_A_R_LINEAR_____75_CM 1 100. 0. 720. ECU_ADDRESS 0x3fcfbe FORMAT "%6.2" /end MEASUREMENT
/begin MEASUREMENT STATE_CAM_EDGE_CTR_0 "State of camshaft signal position at actual recurrence for CAM_0" UBYTE _CNV_S_4_RANGE_STAT_76_CM 1 100. 0. 4. ECU_ADDRESS 0x3fe568 /end MEASUREMENT
/begin MEASUREMENT STATE_CAM_EDGE_CTR_1 "State of camshaft signal position at actual recurrence for CAM_1" UBYTE _CNV_S_4_RANGE_STAT_76_CM 1 100. 0. 4. ECU_ADDRESS 0x3fe569 /end MEASUREMENT
/begin MEASUREMENT LV_ERR_CAM "logical variable camshaft signal error (debounced error = 1)" UBYTE _CNV_S_2_RANGE______21_R_CM 1 100. 0. 255. ECU_ADDRESS 0x3fcfc7 /end MEASUREMENT
/begin MEASUREMENT LV_ERR_CAM_1 "logical variable camshaft signal error CAM_1 (error debounced = 1) " UBYTE _CNV_S_2_RANGE______21_R_CM 1 100. 0. 255. ECU_ADDRESS 0x3fcfc9 /end MEASUREMENT
/begin MEASUREMENT LV_CAM_SYN_DET_0 "logical variable camshaft error CAM_0 debounce counters are 0 (indicates synchronisation)" UBYTE _CNV_S_2_RANGE______28_CM 1 100. 0. 1. ECU_ADDRESS 0x3fcfca /end MEASUREMENT
/begin MEASUREMENT LV_CAM_SYN_DET_1 "logical variable camshaft error CAM_1 debounce counters are 0 (indicates synchronisation)" UBYTE _CNV_S_2_RANGE______28_CM 1 100. 0. 1. ECU_ADDRESS 0x3fcfcb /end MEASUREMENT
/begin MEASUREMENT CAM_EDGE_CTR_1 "Free counting camshaft edge counter CAM_1" UWORD _CNV_A_R_LINEAR_____10_CM 1 100. 0. 65535. ECU_ADDRESS 0x3fe566 FORMAT "%5.0" /end MEASUREMENT
/begin MEASUREMENT CAM_EDGE_CTR_DIAG_1 "Free counting camshaft edge counter CAM_1 (started at first electrical cam edge!!)" UWORD _CNV_A_R_LINEAR_____10_CM 1 100. 0. 65535. ECU_ADDRESS 0x3fcfc2 FORMAT "%5.0" /end MEASUREMENT
/begin MEASUREMENT T_CAM_DIAG "time counter for detection of crank-but no camsignal" UWORD _CNV_A_R_LINEAR_____23_CM 1 100. 0. 655350. ECU_ADDRESS 0x3fe56c FORMAT "%6.0" /end MEASUREMENT
/begin MEASUREMENT CAM_EDGE_0 "Camshaft edge specific angle CAM_0" UWORD _CNV_A_R_LINEAR_____75_CM 1 100. 0. 720. ECU_ADDRESS 0x3fcfbc FORMAT "%6.2" /end MEASUREMENT
/begin MEASUREMENT STATE_CAM_SYN "Camshaft synchronisation state" UBYTE _CNV_S_7_RANGE_STAT_77_CM 1 100. 0. 9. ECU_ADDRESS 0x3fcfc6 /end MEASUREMENT
/begin CHARACTERISTIC C_T_CAM_DIAG_MAX "max value of time counter for detection of crank-but no camsignal" VALUE 0x42f62 _REC_VAL_20_u2 655350. _CNV_A_R_LINEAR_____23_CM 0. 655350. FORMAT "%6.0" /end CHARACTERISTIC
/begin CHARACTERISTIC C_CAM_EDGE_DIF_MAX "difference between edge counters" VALUE 0x42c40 _REC_VAL_20_u2 65535. _CNV_A_R_LINEAR_____10_CM 0. 65535. FORMAT "%5.0" /end CHARACTERISTIC
/begin CHARACTERISTIC C_T_MAX_CAM_TOOTH_PER "Maximum tooth period CAM_i" VALUE 0x42a09 _REC_VAL_20_u1 2550. _CNV_A_R_LINEAR_____23_CM 0. 2550. FORMAT "%4.0" /end CHARACTERISTIC
/begin MEASUREMENT CAM_EDGE_CTR_DIAG_0 "Free counting camshaft edge counter CAM_0 (started at first electrical cam edge!!)" UWORD _CNV_A_R_LINEAR_____10_CM 1 100. 0. 65535. ECU_ADDRESS 0x3fcfc0 FORMAT "%5.0" /end MEASUREMENT
/begin MEASUREMENT T_MAX_CAM_TOOTH_PER_0 "Time counter for detection of maximum tooth period CAM 0 time elapsed" UBYTE _CNV_A_R_LINEAR_____23_CM 1 100. 0. 2550. ECU_ADDRESS 0x3fe56a FORMAT "%4.0" /end MEASUREMENT
/begin MEASUREMENT T_MAX_CAM_TOOTH_PER_1 "Time counter for detection of maximum tooth period CAM 1 time elapsed" UBYTE _CNV_A_R_LINEAR_____23_CM 1 100. 0. 2550. ECU_ADDRESS 0x3fe56b FORMAT "%4.0" /end MEASUREMENT
/begin AXIS_PTS ldpm_cam_edge_nr_0__win_chk "" 0x43b65 CAM_EDGE_NR_0 _REC_AXS_20_u1 3. _CNV_A_R_LINEAR_____10_CM 4 0. 3. FORMAT "%2.0" /end AXIS_PTS
/begin AXIS_PTS ldpm_cam_edge_nr_1__win_chk "" 0x43b6a CAM_EDGE_NR_1 _REC_AXS_20_u1 3. _CNV_A_R_LINEAR_____10_CM 4 0. 3. FORMAT "%2.0" /end AXIS_PTS
/begin MEASUREMENT CYC_CTR_ASR_3_DIAG "counter of not received ASC3 messages" UBYTE _CNV_A_R_LINEAR_____10_CM 1 100. 0. 255. ECU_ADDRESS 0x3fd896 FORMAT "%3.0" /end MEASUREMENT
/begin CHARACTERISTIC C_ASR_3_CYCNR_MAX "maximum number of missing ASC3 messages for error debounce counter increment" VALUE 0x427c0 _REC_VAL_20_u1 254. _CNV_A_R_LINEAR_____10_CM 1. 255. FORMAT "%3.0" /end CHARACTERISTIC
/begin CHARACTERISTIC C_ASR_1_CYCNR_MAX "maximum number of missing ASC1 messages for error debounce counter increment" VALUE 0x427bf _REC_VAL_20_u1 254. _CNV_A_R_LINEAR_____10_CM 1. 255. FORMAT "%3.0" /end CHARACTERISTIC
/begin MEASUREMENT CYC_CTR_ASR_1_DIAG "counter of not received ASC1 messages" UBYTE _CNV_A_R_LINEAR_____10_CM 1 100. 0. 255. ECU_ADDRESS 0x3fd895 FORMAT "%3.0" /end MEASUREMENT
/begin CHARACTERISTIC C_ETCU_1_CYCNR_MAX "maximum number of missing EGS1 messages for error debounce counter increment" VALUE 0x42898 _REC_VAL_20_u1 254. _CNV_A_R_LINEAR_____10_CM 1. 255. FORMAT "%3.0" /end CHARACTERISTIC
/begin CHARACTERISTIC C_ETCU_2_CYCNR_MAX "maximum number of missing EGS2 messages for error debounce counter increment" VALUE 0x42899 _REC_VAL_20_u1 254. _CNV_A_R_LINEAR_____10_CM 1. 255. FORMAT "%3.0" /end CHARACTERISTIC
/begin MEASUREMENT CYC_CTR_ETCU_1_DIAG "counter of not received EGS1 messages" UBYTE _CNV_A_R_LINEAR_____10_CM 1 100. 0. 255. ECU_ADDRESS 0x3fd8f1 FORMAT "%3.0" /end MEASUREMENT
/begin MEASUREMENT CYC_CTR_ETCU_2_DIAG "counter of not received EGS2 messages" UBYTE _CNV_A_R_LINEAR_____10_CM 1 100. 0. 255. ECU_ADDRESS 0x3fd8f2 FORMAT "%3.0" /end MEASUREMENT
/begin MEASUREMENT CYC_CTR_ICL_2_DIAG "counter of not received INSTR2 messages" UBYTE _CNV_A_R_LINEAR_____10_CM 1 100. 0. 255. ECU_ADDRESS 0x3fd924 FORMAT "%3.0" /end MEASUREMENT
/begin CHARACTERISTIC C_ICL_2_CYCNR_MAX "maximum number of missing INSTR2 messages for error debounce counter increment" VALUE 0x428d1 _REC_VAL_20_u1 254. _CNV_A_R_LINEAR_____10_CM 1. 255. FORMAT "%3.0" /end CHARACTERISTIC
/begin MEASUREMENT CYC_CTR_ICL_3_DIAG "counter of not received INSTR3 messages" UBYTE _CNV_A_R_LINEAR_____10_CM 1 100. 0. 255. ECU_ADDRESS 0x3fd925 FORMAT "%3.0" /end MEASUREMENT
/begin CHARACTERISTIC C_ICL_3_CYCNR_MAX "maximum number of missing INSTR3 messages for error debounce counter increment" VALUE 0x428d2 _REC_VAL_20_u1 254. _CNV_A_R_LINEAR_____10_CM 1. 255. FORMAT "%3.0" /end CHARACTERISTIC
/begin MEASUREMENT CYC_CTR_PSTE_1_DIAG "counter of not received LWS1 messages" UBYTE _CNV_A_R_LINEAR_____10_CM 1 100. 0. 255. ECU_ADDRESS 0x3fd934 FORMAT "%3.0" /end MEASUREMENT
/begin CHARACTERISTIC C_PSTE_1_CYCNR_MAX "maximum number of missing LWS1 messages for error debounce counter increment" VALUE 0x42980 _REC_VAL_20_u1 254. _CNV_A_R_LINEAR_____10_CM 1. 255. FORMAT "%3.0" /end CHARACTERISTIC
/begin CHARACTERISTIC C_CTR_DIAG_TCC_CAN_MAX_AMT_1 "maximum number of wrong alive counter events for error debounce counter increment" VALUE 0x4284f _REC_VAL_20_u1 255. _CNV_A_R_LINEAR_____10_CM 0. 255. FORMAT "%3.0" /end CHARACTERISTIC
/begin CHARACTERISTIC C_CTR_DIAG_CPL_CAN_MAX_AMT_1 "maximum number of wrong complement messages for error debounce counter increment" VALUE 0x4284e _REC_VAL_20_u1 255. _CNV_A_R_LINEAR_____10_CM 0. 255. FORMAT "%3.0" /end CHARACTERISTIC
/begin MEASUREMENT CYC_CTR_AMT_1_DIAG "counter of not received SSG1 messages" UBYTE _CNV_A_R_LINEAR_____10_CM 1 100. 0. 255. ECU_ADDRESS 0x3fd943 FORMAT "%3.0" /end MEASUREMENT
/begin CHARACTERISTIC C_AMT_1_CYCNR_MAX "maximum number of missing SSG1 messages for error debounce counter increment" VALUE 0x427bd _REC_VAL_20_u1 254. _CNV_A_R_LINEAR_____10_CM 1. 255. FORMAT "%3.0" /end CHARACTERISTIC
/begin MEASUREMENT CYC_CTR_TXU_1_DIAG "counter of not received TXU1messages" UBYTE _CNV_A_R_LINEAR_____10_CM 1 100. 0. 255. ECU_ADDRESS 0x3fd959 FORMAT "%3.0" /end MEASUREMENT
/begin CHARACTERISTIC C_TXU_1_CYCNR_MAX "maximum number of missing TXU1 messages for error debounce counter increment" VALUE 0x42ae0 _REC_VAL_20_u1 254. _CNV_A_R_LINEAR_____10_CM 1. 255. FORMAT "%3.0" /end CHARACTERISTIC
/begin MEASUREMENT STATE_CRK_DIAG "Crankshaft diagnosis state" UBYTE _CNV_S_5_RANGE_STAT_119_CM 1 100. 0. 8. ECU_ADDRESS 0x3fcfcc /end MEASUREMENT
/begin MEASUREMENT STATE_CRK_SYN "Crankshaft synchronization state" UBYTE _CNV_S_10_RANGE_CRK__120_CM 1 100. 0. 9. ECU_ADDRESS 0x3fcfcd /end MEASUREMENT
/begin MEASUREMENT STATE_SYN_REQ "State of synchronizationrequest" UBYTE _CNV_S_5_RANGE_STAT_121_CM 1 100. 0. 4. ECU_ADDRESS 0x3fcfce /end MEASUREMENT
/begin CHARACTERISTIC LC_INH_DET_REV_ENG "LC to switch of the detection (=1)" VALUE 0x42b89 _REC_VAL_20_u1 1. _CNV_A_R_LINEAR_____10_CM 0. 1. FORMAT "%2.0" /end CHARACTERISTIC
/begin CHARACTERISTIC C_CAM_EDGE_SUM_MAX "number of cam edges for detection of not plausible crankshaft sensor signal" VALUE 0x42c42 _REC_VAL_20_u2 65535. _CNV_A_R_LINEAR_____10_CM 0. 65535. FORMAT "%5.0" /end CHARACTERISTIC
/begin CHARACTERISTIC C_CAM_DET_REV_ENG_MAX "CAM setpoint threshold for engine forward detection" VALUE 0x427f7 _REC_VAL_20_u1 95.625 _CNV_A_R_LINEAR_____122_CM 0. 95.625 FORMAT "%4.1" /end CHARACTERISTIC
/begin CHARACTERISTIC C_CAM_DET_REV_ENG_MIN "CAM setpoint threshold for engine reverse detection" VALUE 0x427f8 _REC_VAL_20_u1 95.625 _CNV_A_R_LINEAR_____122_CM 0. 95.625 FORMAT "%4.1" /end CHARACTERISTIC
/begin MEASUREMENT LV_ERR_CRK "logical variable global crankshaft signal error (debounced error = 1)" UBYTE _CNV_S_2_RANGE______21_R_CM 1 100. 0. 255. ECU_ADDRESS 0x3fcfcf /end MEASUREMENT
/begin MEASUREMENT LV_DET_REV_ENG "Flag for detection of reverse running engine" UBYTE _CNV_S_2_RANGE______21_R_CM 1 100. 0. 255. ECU_ADDRESS 0x3fcfd0 /end MEASUREMENT
/begin MEASUREMENT CTR_ABC_TD_IGC_CUT_0 "" UBYTE _CNV_A_R_LINEAR_____10_CM 1 100. 0. 255. ECU_ADDRESS 0x3fd422 FORMAT "%3.0" /end MEASUREMENT
/begin MEASUREMENT LV_CDN_DIAG_TD_IGC_CUT_0 "" UBYTE _CNV_S_2_RANGE______21_R_CM 1 100. 0. 255. ECU_ADDRESS 0x3fd420 BIT_MASK 0x10 /end MEASUREMENT
/begin MEASUREMENT LV_END_DIAG_TD_IGC_CUT_0 "" UBYTE _CNV_S_2_RANGE______21_R_CM 1 100. 0. 255. ECU_ADDRESS 0x3fd420 BIT_MASK 0x20 /end MEASUREMENT
/begin MEASUREMENT LV_READY_TD_IGC_CUT_0 "" UBYTE _CNV_S_2_RANGE______21_R_CM 1 100. 0. 255. ECU_ADDRESS 0x3fd420 BIT_MASK 0x40 /end MEASUREMENT
/begin MEASUREMENT ERR_SYM_TD_IGC_CUT_0 "" UBYTE _CNV_S_6_RANGE_ERR__22_CM 1 100. 0. 15. ECU_ADDRESS 0x3fd420 BIT_MASK 0xF /end MEASUREMENT
/begin MEASUREMENT LV_ERR_MEM_TD_IGC_CUT_0 "" UBYTE _CNV_S_2_RANGE______21_R_CM 1 100. 0. 255. ECU_ADDRESS 0x3fd420 BIT_MASK 0x80 /end MEASUREMENT
/begin MEASUREMENT CTR_ABC_END_DIAG_TD_IGC_CUT_0 "" UBYTE _CNV_A_R_LINEAR_____12_CM 1 100. 0. 255. ECU_ADDRESS 0x3fd421 FORMAT "%3.0" /end MEASUREMENT
/begin MEASUREMENT CTR_ABC_TD_IGC_CUT_1 "" UBYTE _CNV_A_R_LINEAR_____10_CM 1 100. 0. 255. ECU_ADDRESS 0x3fd426 FORMAT "%3.0" /end MEASUREMENT
/begin MEASUREMENT LV_CDN_DIAG_TD_IGC_CUT_1 "" UBYTE _CNV_S_2_RANGE______21_R_CM 1 100. 0. 255. ECU_ADDRESS 0x3fd424 BIT_MASK 0x10 /end MEASUREMENT
/begin MEASUREMENT LV_END_DIAG_TD_IGC_CUT_1 "" UBYTE _CNV_S_2_RANGE______21_R_CM 1 100. 0. 255. ECU_ADDRESS 0x3fd424 BIT_MASK 0x20 /end MEASUREMENT
/begin MEASUREMENT LV_READY_TD_IGC_CUT_1 "" UBYTE _CNV_S_2_RANGE______21_R_CM 1 100. 0. 255. ECU_ADDRESS 0x3fd424 BIT_MASK 0x40 /end MEASUREMENT
/begin MEASUREMENT ERR_SYM_TD_IGC_CUT_1 "" UBYTE _CNV_S_6_RANGE_ERR__22_CM 1 100. 0. 15. ECU_ADDRESS 0x3fd424 BIT_MASK 0xF /end MEASUREMENT
/begin MEASUREMENT LV_ERR_MEM_TD_IGC_CUT_1 "" UBYTE _CNV_S_2_RANGE______21_R_CM 1 100. 0. 255. ECU_ADDRESS 0x3fd424 BIT_MASK 0x80 /end MEASUREMENT
/begin MEASUREMENT CTR_ABC_END_DIAG_TD_IGC_CUT_1 "" UBYTE _CNV_A_R_LINEAR_____12_CM 1 100. 0. 255. ECU_ADDRESS 0x3fd425 FORMAT "%3.0" /end MEASUREMENT
/begin MEASUREMENT CTR_ABC_TD_IGC_CUT_2 "" UBYTE _CNV_A_R_LINEAR_____10_CM 1 100. 0. 255. ECU_ADDRESS 0x3fd42a FORMAT "%3.0" /end MEASUREMENT
/begin MEASUREMENT LV_CDN_DIAG_TD_IGC_CUT_2 "" UBYTE _CNV_S_2_RANGE______21_R_CM 1 100. 0. 255. ECU_ADDRESS 0x3fd428 BIT_MASK 0x10 /end MEASUREMENT
/begin MEASUREMENT LV_END_DIAG_TD_IGC_CUT_2 "" UBYTE _CNV_S_2_RANGE______21_R_CM 1 100. 0. 255. ECU_ADDRESS 0x3fd428 BIT_MASK 0x20 /end MEASUREMENT
/begin MEASUREMENT LV_READY_TD_IGC_CUT_2 "" UBYTE _CNV_S_2_RANGE______21_R_CM 1 100. 0. 255. ECU_ADDRESS 0x3fd428 BIT_MASK 0x40 /end MEASUREMENT
/begin MEASUREMENT ERR_SYM_TD_IGC_CUT_2 "" UBYTE _CNV_S_6_RANGE_ERR__22_CM 1 100. 0. 15. ECU_ADDRESS 0x3fd428 BIT_MASK 0xF /end MEASUREMENT
/begin MEASUREMENT LV_ERR_MEM_TD_IGC_CUT_2 "" UBYTE _CNV_S_2_RANGE______21_R_CM 1 100. 0. 255. ECU_ADDRESS 0x3fd428 BIT_MASK 0x80 /end MEASUREMENT
/begin MEASUREMENT CTR_ABC_END_DIAG_TD_IGC_CUT_2 "" UBYTE _CNV_A_R_LINEAR_____12_CM 1 100. 0. 255. ECU_ADDRESS 0x3fd429 FORMAT "%3.0" /end MEASUREMENT
/begin MEASUREMENT CTR_ABC_TD_IGC_CUT_3 "" UBYTE _CNV_A_R_LINEAR_____10_CM 1 100. 0. 255. ECU_ADDRESS 0x3fd42e FORMAT "%3.0" /end MEASUREMENT
/begin MEASUREMENT LV_CDN_DIAG_TD_IGC_CUT_3 "" UBYTE _CNV_S_2_RANGE______21_R_CM 1 100. 0. 255. ECU_ADDRESS 0x3fd42c BIT_MASK 0x10 /end MEASUREMENT
/begin MEASUREMENT LV_END_DIAG_TD_IGC_CUT_3 "" UBYTE _CNV_S_2_RANGE______21_R_CM 1 100. 0. 255. ECU_ADDRESS 0x3fd42c BIT_MASK 0x20 /end MEASUREMENT
/begin MEASUREMENT LV_READY_TD_IGC_CUT_3 "" UBYTE _CNV_S_2_RANGE______21_R_CM 1 100. 0. 255. ECU_ADDRESS 0x3fd42c BIT_MASK 0x40 /end MEASUREMENT
/begin MEASUREMENT ERR_SYM_TD_IGC_CUT_3 "" UBYTE _CNV_S_6_RANGE_ERR__22_CM 1 100. 0. 15. ECU_ADDRESS 0x3fd42c BIT_MASK 0xF /end MEASUREMENT
/begin MEASUREMENT LV_ERR_MEM_TD_IGC_CUT_3 "" UBYTE _CNV_S_2_RANGE______21_R_CM 1 100. 0. 255. ECU_ADDRESS 0x3fd42c BIT_MASK 0x80 /end MEASUREMENT
/begin MEASUREMENT CTR_ABC_END_DIAG_TD_IGC_CUT_3 "" UBYTE _CNV_A_R_LINEAR_____12_CM 1 100. 0. 255. ECU_ADDRESS 0x3fd42d FORMAT "%3.0" /end MEASUREMENT
/begin MEASUREMENT CTR_ABC_TD_IGC_CUT_4 "" UBYTE _CNV_A_R_LINEAR_____10_CM 1 100. 0. 255. ECU_ADDRESS 0x3fd432 FORMAT "%3.0" /end MEASUREMENT
/begin MEASUREMENT LV_CDN_DIAG_TD_IGC_CUT_4 "" UBYTE _CNV_S_2_RANGE______21_R_CM 1 100. 0. 255. ECU_ADDRESS 0x3fd430 BIT_MASK 0x10 /end MEASUREMENT
/begin MEASUREMENT LV_END_DIAG_TD_IGC_CUT_4 "" UBYTE _CNV_S_2_RANGE______21_R_CM 1 100. 0. 255. ECU_ADDRESS 0x3fd430 BIT_MASK 0x20 /end MEASUREMENT
/begin MEASUREMENT LV_READY_TD_IGC_CUT_4 "" UBYTE _CNV_S_2_RANGE______21_R_CM 1 100. 0. 255. ECU_ADDRESS 0x3fd430 BIT_MASK 0x40 /end MEASUREMENT
/begin MEASUREMENT ERR_SYM_TD_IGC_CUT_4 "" UBYTE _CNV_S_6_RANGE_ERR__22_CM 1 100. 0. 15. ECU_ADDRESS 0x3fd430 BIT_MASK 0xF /end MEASUREMENT
/begin MEASUREMENT LV_ERR_MEM_TD_IGC_CUT_4 "" UBYTE _CNV_S_2_RANGE______21_R_CM 1 100. 0. 255. ECU_ADDRESS 0x3fd430 BIT_MASK 0x80 /end MEASUREMENT
/begin MEASUREMENT CTR_ABC_END_DIAG_TD_IGC_CUT_4 "" UBYTE _CNV_A_R_LINEAR_____12_CM 1 100. 0. 255. ECU_ADDRESS 0x3fd431 FORMAT "%3.0" /end MEASUREMENT
/begin MEASUREMENT CTR_ABC_TD_IGC_CUT_5 "" UBYTE _CNV_A_R_LINEAR_____10_CM 1 100. 0. 255. ECU_ADDRESS 0x3fd436 FORMAT "%3.0" /end MEASUREMENT
/begin MEASUREMENT LV_CDN_DIAG_TD_IGC_CUT_5 "" UBYTE _CNV_S_2_RANGE______21_R_CM 1 100. 0. 255. ECU_ADDRESS 0x3fd434 BIT_MASK 0x10 /end MEASUREMENT
/begin MEASUREMENT LV_END_DIAG_TD_IGC_CUT_5 "" UBYTE _CNV_S_2_RANGE______21_R_CM 1 100. 0. 255. ECU_ADDRESS 0x3fd434 BIT_MASK 0x20 /end MEASUREMENT
/begin MEASUREMENT LV_READY_TD_IGC_CUT_5 "" UBYTE _CNV_S_2_RANGE______21_R_CM 1 100. 0. 255. ECU_ADDRESS 0x3fd434 BIT_MASK 0x40 /end MEASUREMENT
/begin MEASUREMENT ERR_SYM_TD_IGC_CUT_5 "" UBYTE _CNV_S_6_RANGE_ERR__22_CM 1 100. 0. 15. ECU_ADDRESS 0x3fd434 BIT_MASK 0xF /end MEASUREMENT
/begin MEASUREMENT LV_ERR_MEM_TD_IGC_CUT_5 "" UBYTE _CNV_S_2_RANGE______21_R_CM 1 100. 0. 255. ECU_ADDRESS 0x3fd434 BIT_MASK 0x80 /end MEASUREMENT
/begin MEASUREMENT CTR_ABC_END_DIAG_TD_IGC_CUT_5 "" UBYTE _CNV_A_R_LINEAR_____12_CM 1 100. 0. 255. ECU_ADDRESS 0x3fd435 FORMAT "%3.0" /end MEASUREMENT
/begin MEASUREMENT CTR_ABC_VLS_UP_MIN_COLD_1 "" UBYTE _CNV_A_R_LINEAR_____10_CM 1 100. 0. 255. ECU_ADDRESS 0x3fd6a6 FORMAT "%3.0" /end MEASUREMENT
/begin MEASUREMENT LV_CDN_DIAG_VLS_UP_MIN_COLD_1 "" UBYTE _CNV_S_2_RANGE______21_R_CM 1 100. 0. 255. ECU_ADDRESS 0x3fd6a4 BIT_MASK 0x10 /end MEASUREMENT
/begin MEASUREMENT LV_END_DIAG_VLS_UP_MIN_COLD_1 "" UBYTE _CNV_S_2_RANGE______21_R_CM 1 100. 0. 255. ECU_ADDRESS 0x3fd6a4 BIT_MASK 0x20 /end MEASUREMENT
/begin MEASUREMENT LV_READY_VLS_UP_MIN_COLD_1 "" UBYTE _CNV_S_2_RANGE______21_R_CM 1 100. 0. 255. ECU_ADDRESS 0x3fd6a4 BIT_MASK 0x40 /end MEASUREMENT
/begin MEASUREMENT ERR_SYM_VLS_UP_MIN_COLD_1 "" UBYTE _CNV_S_6_RANGE_ERR__22_CM 1 100. 0. 15. ECU_ADDRESS 0x3fd6a4 BIT_MASK 0xF /end MEASUREMENT
/begin MEASUREMENT LV_ERR_MEM_VLS_UP_MIN_COLD_1 "" UBYTE _CNV_S_2_RANGE______21_R_CM 1 100. 0. 255. ECU_ADDRESS 0x3fd6a4 BIT_MASK 0x80 /end MEASUREMENT
/begin MEASUREMENT CTR_ABC_END_DIAG_VLS_UP_MIN_COLD "" UBYTE _CNV_A_R_LINEAR_____12_CM 1 100. 0. 255. ECU_ADDRESS 0x3fd6a5 FORMAT "%3.0" /end MEASUREMENT
/begin MEASUREMENT CTR_ABC_VLS_UP_MIN_COLD_2 "" UBYTE _CNV_A_R_LINEAR_____10_CM 1 100. 0. 255. ECU_ADDRESS 0x3fd6aa FORMAT "%3.0" /end MEASUREMENT
/begin MEASUREMENT LV_CDN_DIAG_VLS_UP_MIN_COLD_2 "" UBYTE _CNV_S_2_RANGE______21_R_CM 1 100. 0. 255. ECU_ADDRESS 0x3fd6a8 BIT_MASK 0x10 /end MEASUREMENT
/begin MEASUREMENT LV_END_DIAG_VLS_UP_MIN_COLD_2 "" UBYTE _CNV_S_2_RANGE______21_R_CM 1 100. 0. 255. ECU_ADDRESS 0x3fd6a8 BIT_MASK 0x20 /end MEASUREMENT
/begin MEASUREMENT LV_READY_VLS_UP_MIN_COLD_2 "" UBYTE _CNV_S_2_RANGE______21_R_CM 1 100. 0. 255. ECU_ADDRESS 0x3fd6a8 BIT_MASK 0x40 /end MEASUREMENT
/begin MEASUREMENT ERR_SYM_VLS_UP_MIN_COLD_2 "" UBYTE _CNV_S_6_RANGE_ERR__22_CM 1 100. 0. 15. ECU_ADDRESS 0x3fd6a8 BIT_MASK 0xF /end MEASUREMENT
/begin MEASUREMENT LV_ERR_MEM_VLS_UP_MIN_COLD_2 "" UBYTE _CNV_S_2_RANGE______21_R_CM 1 100. 0. 255. ECU_ADDRESS 0x3fd6a8 BIT_MASK 0x80 /end MEASUREMENT
/begin MEASUREMENT CTR_ABC_POIL_SWI "" UBYTE _CNV_A_R_LINEAR_____10_CM 1 100. 0. 255. ECU_ADDRESS 0x3fd606 FORMAT "%3.0" /end MEASUREMENT
/begin MEASUREMENT LV_CDN_DIAG_POIL_SWI "" UBYTE _CNV_S_2_RANGE______21_R_CM 1 100. 0. 255. ECU_ADDRESS 0x3fd604 BIT_MASK 0x10 /end MEASUREMENT
/begin MEASUREMENT LV_END_DIAG_POIL_SWI "" UBYTE _CNV_S_2_RANGE______21_R_CM 1 100. 0. 255. ECU_ADDRESS 0x3fd604 BIT_MASK 0x20 /end MEASUREMENT
/begin MEASUREMENT LV_READY_POIL_SWI "" UBYTE _CNV_S_2_RANGE______21_R_CM 1 100. 0. 255. ECU_ADDRESS 0x3fd604 BIT_MASK 0x40 /end MEASUREMENT
/begin MEASUREMENT ERR_SYM_POIL_SWI "" UBYTE _CNV_S_6_RANGE_ERR__22_CM 1 100. 0. 15. ECU_ADDRESS 0x3fd604 BIT_MASK 0xF /end MEASUREMENT
/begin MEASUREMENT LV_ERR_MEM_POIL_SWI "" UBYTE _CNV_S_2_RANGE______21_R_CM 1 100. 0. 255. ECU_ADDRESS 0x3fd604 BIT_MASK 0x80 /end MEASUREMENT
/begin MEASUREMENT CTR_ABC_END_DIAG_POIL_SWI "" UBYTE _CNV_A_R_LINEAR_____12_CM 1 100. 0. 255. ECU_ADDRESS 0x3fd605 FORMAT "%3.0" /end MEASUREMENT
/begin MEASUREMENT CTR_ABC_BN_VS_TCS "" UBYTE _CNV_A_R_LINEAR_____10_CM 1 100. 0. 255. ECU_ADDRESS 0x3fd636 FORMAT "%3.0" /end MEASUREMENT
/begin MEASUREMENT LV_CDN_DIAG_BN_VS_TCS "" UBYTE _CNV_S_2_RANGE______21_R_CM 1 100. 0. 255. ECU_ADDRESS 0x3fd634 BIT_MASK 0x10 /end MEASUREMENT
/begin MEASUREMENT LV_END_DIAG_BN_VS_TCS "" UBYTE _CNV_S_2_RANGE______21_R_CM 1 100. 0. 255. ECU_ADDRESS 0x3fd634 BIT_MASK 0x20 /end MEASUREMENT
/begin MEASUREMENT LV_READY_BN_VS_TCS "" UBYTE _CNV_S_2_RANGE______21_R_CM 1 100. 0. 255. ECU_ADDRESS 0x3fd634 BIT_MASK 0x40 /end MEASUREMENT
/begin MEASUREMENT ERR_SYM_BN_VS_TCS "" UBYTE _CNV_S_6_RANGE_ERR__22_CM 1 100. 0. 15. ECU_ADDRESS 0x3fd634 BIT_MASK 0xF /end MEASUREMENT
/begin MEASUREMENT LV_ERR_MEM_BN_VS_TCS "" UBYTE _CNV_S_2_RANGE______21_R_CM 1 100. 0. 255. ECU_ADDRESS 0x3fd634 BIT_MASK 0x80 /end MEASUREMENT
/begin MEASUREMENT CTR_ABC_END_DIAG_BN_VS_TCS "" UBYTE _CNV_A_R_LINEAR_____12_CM 1 100. 0. 255. ECU_ADDRESS 0x3fd635 FORMAT "%3.0" /end MEASUREMENT
/begin MEASUREMENT CTR_ABC_TOUT_ETCU_1 "" UBYTE _CNV_A_R_LINEAR_____10_CM 1 100. 0. 255. ECU_ADDRESS 0x3fd3f6 FORMAT "%3.0" /end MEASUREMENT
/begin MEASUREMENT LV_CDN_DIAG_TOUT_ETCU_1 "" UBYTE _CNV_S_2_RANGE______21_R_CM 1 100. 0. 255. ECU_ADDRESS 0x3fd3f4 BIT_MASK 0x10 /end MEASUREMENT
/begin MEASUREMENT LV_END_DIAG_TOUT_ETCU_1 "" UBYTE _CNV_S_2_RANGE______21_R_CM 1 100. 0. 255. ECU_ADDRESS 0x3fd3f4 BIT_MASK 0x20 /end MEASUREMENT
/begin MEASUREMENT LV_READY_TOUT_ETCU_1 "" UBYTE _CNV_S_2_RANGE______21_R_CM 1 100. 0. 255. ECU_ADDRESS 0x3fd3f4 BIT_MASK 0x40 /end MEASUREMENT
/begin MEASUREMENT ERR_SYM_TOUT_ETCU_1 "" UBYTE _CNV_S_6_RANGE_ERR__22_CM 1 100. 0. 15. ECU_ADDRESS 0x3fd3f4 BIT_MASK 0xF /end MEASUREMENT
/begin MEASUREMENT LV_ERR_MEM_TOUT_ETCU_1 "" UBYTE _CNV_S_2_RANGE______21_R_CM 1 100. 0. 255. ECU_ADDRESS 0x3fd3f4 BIT_MASK 0x80 /end MEASUREMENT
/begin MEASUREMENT CTR_ABC_END_DIAG_TOUT_ETCU_1 "" UBYTE _CNV_A_R_LINEAR_____12_CM 1 100. 0. 255. ECU_ADDRESS 0x3fd3f5 FORMAT "%3.0" /end MEASUREMENT
/begin MEASUREMENT CTR_ABC_TOUT_ETCU_2 "" UBYTE _CNV_A_R_LINEAR_____10_CM 1 100. 0. 255. ECU_ADDRESS 0x3fd3fa FORMAT "%3.0" /end MEASUREMENT
/begin MEASUREMENT LV_CDN_DIAG_TOUT_ETCU_2 "" UBYTE _CNV_S_2_RANGE______21_R_CM 1 100. 0. 255. ECU_ADDRESS 0x3fd3f8 BIT_MASK 0x10 /end MEASUREMENT
/begin MEASUREMENT LV_END_DIAG_TOUT_ETCU_2 "" UBYTE _CNV_S_2_RANGE______21_R_CM 1 100. 0. 255. ECU_ADDRESS 0x3fd3f8 BIT_MASK 0x20 /end MEASUREMENT
/begin MEASUREMENT LV_READY_TOUT_ETCU_2 "" UBYTE _CNV_S_2_RANGE______21_R_CM 1 100. 0. 255. ECU_ADDRESS 0x3fd3f8 BIT_MASK 0x40 /end MEASUREMENT
/begin MEASUREMENT ERR_SYM_TOUT_ETCU_2 "" UBYTE _CNV_S_6_RANGE_ERR__22_CM 1 100. 0. 15. ECU_ADDRESS 0x3fd3f8 BIT_MASK 0xF /end MEASUREMENT
/begin MEASUREMENT LV_ERR_MEM_TOUT_ETCU_2 "" UBYTE _CNV_S_2_RANGE______21_R_CM 1 100. 0. 255. ECU_ADDRESS 0x3fd3f8 BIT_MASK 0x80 /end MEASUREMENT
/begin MEASUREMENT CTR_ABC_END_DIAG_TOUT_ETCU_2 "" UBYTE _CNV_A_R_LINEAR_____12_CM 1 100. 0. 255. ECU_ADDRESS 0x3fd3f9 FORMAT "%3.0" /end MEASUREMENT
/begin MEASUREMENT CTR_ABC_BSD "" UBYTE _CNV_A_R_LINEAR_____10_CM 1 100. 0. 255. ECU_ADDRESS 0x3fd602 FORMAT "%3.0" /end MEASUREMENT
/begin MEASUREMENT LV_CDN_DIAG_BSD "" UBYTE _CNV_S_2_RANGE______21_R_CM 1 100. 0. 255. ECU_ADDRESS 0x3fd600 BIT_MASK 0x10 /end MEASUREMENT
/begin MEASUREMENT LV_END_DIAG_BSD "" UBYTE _CNV_S_2_RANGE______21_R_CM 1 100. 0. 255. ECU_ADDRESS 0x3fd600 BIT_MASK 0x20 /end MEASUREMENT
/begin MEASUREMENT LV_READY_BSD "" UBYTE _CNV_S_2_RANGE______21_R_CM 1 100. 0. 255. ECU_ADDRESS 0x3fd600 BIT_MASK 0x40 /end MEASUREMENT
/begin MEASUREMENT ERR_SYM_BSD "" UBYTE _CNV_S_6_RANGE_ERR__22_CM 1 100. 0. 15. ECU_ADDRESS 0x3fd600 BIT_MASK 0xF /end MEASUREMENT
/begin MEASUREMENT LV_ERR_MEM_BSD "" UBYTE _CNV_S_2_RANGE______21_R_CM 1 100. 0. 255. ECU_ADDRESS 0x3fd600 BIT_MASK 0x80 /end MEASUREMENT
/begin MEASUREMENT CTR_ABC_END_DIAG_BSD "" UBYTE _CNV_A_R_LINEAR_____12_CM 1 100. 0. 255. ECU_ADDRESS 0x3fd601 FORMAT "%3.0" /end MEASUREMENT
/begin MEASUREMENT CTR_ABC_TEG_PCAT_DOWN_1 "" UBYTE _CNV_A_R_LINEAR_____10_CM 1 100. 0. 255. ECU_ADDRESS 0x3fd34a FORMAT "%3.0" /end MEASUREMENT
/begin MEASUREMENT LV_CDN_DIAG_TEG_PCAT_DOWN_1 "" UBYTE _CNV_S_2_RANGE______21_R_CM 1 100. 0. 255. ECU_ADDRESS 0x3fd348 BIT_MASK 0x10 /end MEASUREMENT
/begin MEASUREMENT LV_END_DIAG_TEG_PCAT_DOWN_1 "" UBYTE _CNV_S_2_RANGE______21_R_CM 1 100. 0. 255. ECU_ADDRESS 0x3fd348 BIT_MASK 0x20 /end MEASUREMENT
/begin MEASUREMENT LV_READY_TEG_PCAT_DOWN_1 "" UBYTE _CNV_S_2_RANGE______21_R_CM 1 100. 0. 255. ECU_ADDRESS 0x3fd348 BIT_MASK 0x40 /end MEASUREMENT
/begin MEASUREMENT ERR_SYM_TEG_PCAT_DOWN_1 "" UBYTE _CNV_S_6_RANGE_ERR__22_CM 1 100. 0. 15. ECU_ADDRESS 0x3fd348 BIT_MASK 0xF /end MEASUREMENT
/begin MEASUREMENT LV_ERR_MEM_TEG_PCAT_DOWN_1 "" UBYTE _CNV_S_2_RANGE______21_R_CM 1 100. 0. 255. ECU_ADDRESS 0x3fd348 BIT_MASK 0x80 /end MEASUREMENT
/begin MEASUREMENT CTR_ABC_END_DIAG_TEG_PCAT_DOWN_1 "" UBYTE _CNV_A_R_LINEAR_____12_CM 1 100. 0. 255. ECU_ADDRESS 0x3fd349 FORMAT "%3.0" /end MEASUREMENT
/begin MEASUREMENT CTR_ABC_TEG_PCAT_DOWN_2 "" UBYTE _CNV_A_R_LINEAR_____10_CM 1 100. 0. 255. ECU_ADDRESS 0x3fd34e FORMAT "%3.0" /end MEASUREMENT
/begin MEASUREMENT LV_CDN_DIAG_TEG_PCAT_DOWN_2 "" UBYTE _CNV_S_2_RANGE______21_R_CM 1 100. 0. 255. ECU_ADDRESS 0x3fd34c BIT_MASK 0x10 /end MEASUREMENT
/begin MEASUREMENT LV_END_DIAG_TEG_PCAT_DOWN_2 "" UBYTE _CNV_S_2_RANGE______21_R_CM 1 100. 0. 255. ECU_ADDRESS 0x3fd34c BIT_MASK 0x20 /end MEASUREMENT
/begin MEASUREMENT LV_READY_TEG_PCAT_DOWN_2 "" UBYTE _CNV_S_2_RANGE______21_R_CM 1 100. 0. 255. ECU_ADDRESS 0x3fd34c BIT_MASK 0x40 /end MEASUREMENT
/begin MEASUREMENT ERR_SYM_TEG_PCAT_DOWN_2 "" UBYTE _CNV_S_6_RANGE_ERR__22_CM 1 100. 0. 15. ECU_ADDRESS 0x3fd34c BIT_MASK 0xF /end MEASUREMENT
/begin MEASUREMENT LV_ERR_MEM_TEG_PCAT_DOWN_2 "" UBYTE _CNV_S_2_RANGE______21_R_CM 1 100. 0. 255. ECU_ADDRESS 0x3fd34c BIT_MASK 0x80 /end MEASUREMENT
/begin MEASUREMENT CTR_ABC_END_DIAG_TEG_PCAT_DOWN_2 "" UBYTE _CNV_A_R_LINEAR_____12_CM 1 100. 0. 255. ECU_ADDRESS 0x3fd34d FORMAT "%3.0" /end MEASUREMENT
/begin MEASUREMENT CTR_ABC_CHK_LS_DOWN_1 "" UBYTE _CNV_A_R_LINEAR_____10_CM 1 100. 0. 255. ECU_ADDRESS 0x3fd69e FORMAT "%3.0" /end MEASUREMENT
/begin MEASUREMENT LV_CDN_DIAG_CHK_LS_DOWN_1 "" UBYTE _CNV_S_2_RANGE______21_R_CM 1 100. 0. 255. ECU_ADDRESS 0x3fd69c BIT_MASK 0x10 /end MEASUREMENT
/begin MEASUREMENT LV_END_DIAG_CHK_LS_DOWN_1 "" UBYTE _CNV_S_2_RANGE______21_R_CM 1 100. 0. 255. ECU_ADDRESS 0x3fd69c BIT_MASK 0x20 /end MEASUREMENT
/begin MEASUREMENT LV_READY_CHK_LS_DOWN_1 "" UBYTE _CNV_S_2_RANGE______21_R_CM 1 100. 0. 255. ECU_ADDRESS 0x3fd69c BIT_MASK 0x40 /end MEASUREMENT
/begin MEASUREMENT ERR_SYM_CHK_LS_DOWN_1 "" UBYTE _CNV_S_6_RANGE_ERR__22_CM 1 100. 0. 15. ECU_ADDRESS 0x3fd69c BIT_MASK 0xF /end MEASUREMENT
/begin MEASUREMENT LV_ERR_MEM_CHK_LS_DOWN_1 "" UBYTE _CNV_S_2_RANGE______21_R_CM 1 100. 0. 255. ECU_ADDRESS 0x3fd69c BIT_MASK 0x80 /end MEASUREMENT
/begin MEASUREMENT CTR_ABC_END_DIAG_CHK_LS_DOWN_1 "" UBYTE _CNV_A_R_LINEAR_____12_CM 1 100. 0. 255. ECU_ADDRESS 0x3fd69d FORMAT "%3.0" /end MEASUREMENT
/begin MEASUREMENT CTR_ABC_CHK_LS_DOWN_2 "" UBYTE _CNV_A_R_LINEAR_____10_CM 1 100. 0. 255. ECU_ADDRESS 0x3fd6a2 FORMAT "%3.0" /end MEASUREMENT
/begin MEASUREMENT LV_CDN_DIAG_CHK_LS_DOWN_2 "" UBYTE _CNV_S_2_RANGE______21_R_CM 1 100. 0. 255. ECU_ADDRESS 0x3fd6a0 BIT_MASK 0x10 /end MEASUREMENT
/begin MEASUREMENT LV_END_DIAG_CHK_LS_DOWN_2 "" UBYTE _CNV_S_2_RANGE______21_R_CM 1 100. 0. 255. ECU_ADDRESS 0x3fd6a0 BIT_MASK 0x20 /end MEASUREMENT
/begin MEASUREMENT LV_READY_CHK_LS_DOWN_2 "" UBYTE _CNV_S_2_RANGE______21_R_CM 1 100. 0. 255. ECU_ADDRESS 0x3fd6a0 BIT_MASK 0x40 /end MEASUREMENT
/begin MEASUREMENT ERR_SYM_CHK_LS_DOWN_2 "" UBYTE _CNV_S_6_RANGE_ERR__22_CM 1 100. 0. 15. ECU_ADDRESS 0x3fd6a0 BIT_MASK 0xF /end MEASUREMENT
/begin MEASUREMENT LV_ERR_MEM_CHK_LS_DOWN_2 "" UBYTE _CNV_S_2_RANGE______21_R_CM 1 100. 0. 255. ECU_ADDRESS 0x3fd6a0 BIT_MASK 0x80 /end MEASUREMENT
/begin MEASUREMENT CTR_ABC_END_DIAG_CHK_LS_DOWN_2 "" UBYTE _CNV_A_R_LINEAR_____12_CM 1 100. 0. 255. ECU_ADDRESS 0x3fd6a1 FORMAT "%3.0" /end MEASUREMENT
/begin MEASUREMENT CTR_ABC_BN_ANG_PSTE "" UBYTE _CNV_A_R_LINEAR_____10_CM 1 100. 0. 255. ECU_ADDRESS 0x3fd66a FORMAT "%3.0" /end MEASUREMENT
/begin MEASUREMENT LV_CDN_DIAG_BN_ANG_PSTE "" UBYTE _CNV_S_2_RANGE______21_R_CM 1 100. 0. 255. ECU_ADDRESS 0x3fd668 BIT_MASK 0x10 /end MEASUREMENT
/begin MEASUREMENT LV_END_DIAG_BN_ANG_PSTE "" UBYTE _CNV_S_2_RANGE______21_R_CM 1 100. 0. 255. ECU_ADDRESS 0x3fd668 BIT_MASK 0x20 /end MEASUREMENT
/begin MEASUREMENT LV_READY_BN_ANG_PSTE "" UBYTE _CNV_S_2_RANGE______21_R_CM 1 100. 0. 255. ECU_ADDRESS 0x3fd668 BIT_MASK 0x40 /end MEASUREMENT
/begin MEASUREMENT ERR_SYM_BN_ANG_PSTE "" UBYTE _CNV_S_6_RANGE_ERR__22_CM 1 100. 0. 15. ECU_ADDRESS 0x3fd668 BIT_MASK 0xF /end MEASUREMENT
/begin MEASUREMENT LV_ERR_MEM_BN_ANG_PSTE "" UBYTE _CNV_S_2_RANGE______21_R_CM 1 100. 0. 255. ECU_ADDRESS 0x3fd668 BIT_MASK 0x80 /end MEASUREMENT
/begin MEASUREMENT CTR_ABC_END_DIAG_BN_ANG_PSTE "" UBYTE _CNV_A_R_LINEAR_____12_CM 1 100. 0. 255. ECU_ADDRESS 0x3fd669 FORMAT "%3.0" /end MEASUREMENT
/begin MEASUREMENT CTR_ABC_CPS "" UBYTE _CNV_A_R_LINEAR_____10_CM 1 100. 0. 255. ECU_ADDRESS 0x3fd3ba FORMAT "%3.0" /end MEASUREMENT
/begin MEASUREMENT LV_CDN_DIAG_CPS "" UBYTE _CNV_S_2_RANGE______21_R_CM 1 100. 0. 255. ECU_ADDRESS 0x3fd3b8 BIT_MASK 0x10 /end MEASUREMENT
/begin MEASUREMENT LV_END_DIAG_CPS "" UBYTE _CNV_S_2_RANGE______21_R_CM 1 100. 0. 255. ECU_ADDRESS 0x3fd3b8 BIT_MASK 0x20 /end MEASUREMENT
/begin MEASUREMENT LV_READY_CPS "" UBYTE _CNV_S_2_RANGE______21_R_CM 1 100. 0. 255. ECU_ADDRESS 0x3fd3b8 BIT_MASK 0x40 /end MEASUREMENT
/begin MEASUREMENT ERR_SYM_CPS "" UBYTE _CNV_S_6_RANGE_ERR__22_CM 1 100. 0. 15. ECU_ADDRESS 0x3fd3b8 BIT_MASK 0xF /end MEASUREMENT
/begin MEASUREMENT LV_ERR_MEM_CPS "" UBYTE _CNV_S_2_RANGE______21_R_CM 1 100. 0. 255. ECU_ADDRESS 0x3fd3b8 BIT_MASK 0x80 /end MEASUREMENT
/begin MEASUREMENT CTR_ABC_END_DIAG_CPS "" UBYTE _CNV_A_R_LINEAR_____12_CM 1 100. 0. 255. ECU_ADDRESS 0x3fd3b9 FORMAT "%3.0" /end MEASUREMENT
/begin MEASUREMENT CTR_ABC_TQI_AV_MON_1 "" UBYTE _CNV_A_R_LINEAR_____10_CM 1 100. 0. 255. ECU_ADDRESS 0x3fd56a FORMAT "%3.0" /end MEASUREMENT
/begin MEASUREMENT LV_CDN_DIAG_TQI_AV_MON_1 "" UBYTE _CNV_S_2_RANGE______21_R_CM 1 100. 0. 255. ECU_ADDRESS 0x3fd568 BIT_MASK 0x10 /end MEASUREMENT
/begin MEASUREMENT LV_END_DIAG_TQI_AV_MON_1 "" UBYTE _CNV_S_2_RANGE______21_R_CM 1 100. 0. 255. ECU_ADDRESS 0x3fd568 BIT_MASK 0x20 /end MEASUREMENT
/begin MEASUREMENT LV_READY_TQI_AV_MON_1 "" UBYTE _CNV_S_2_RANGE______21_R_CM 1 100. 0. 255. ECU_ADDRESS 0x3fd568 BIT_MASK 0x40 /end MEASUREMENT
/begin MEASUREMENT ERR_SYM_TQI_AV_MON_1 "" UBYTE _CNV_S_6_RANGE_ERR__22_CM 1 100. 0. 15. ECU_ADDRESS 0x3fd568 BIT_MASK 0xF /end MEASUREMENT
/begin MEASUREMENT LV_ERR_MEM_TQI_AV_MON_1 "" UBYTE _CNV_S_2_RANGE______21_R_CM 1 100. 0. 255. ECU_ADDRESS 0x3fd568 BIT_MASK 0x80 /end MEASUREMENT
/begin MEASUREMENT CTR_ABC_END_DIAG_TQI_AV_MON_1 "" UBYTE _CNV_A_R_LINEAR_____12_CM 1 100. 0. 255. ECU_ADDRESS 0x3fd569 FORMAT "%3.0" /end MEASUREMENT
/begin MEASUREMENT CTR_ABC_GEN "" UBYTE _CNV_A_R_LINEAR_____10_CM 1 100. 0. 255. ECU_ADDRESS 0x3fd49a FORMAT "%3.0" /end MEASUREMENT
/begin MEASUREMENT LV_CDN_DIAG_GEN "" UBYTE _CNV_S_2_RANGE______21_R_CM 1 100. 0. 255. ECU_ADDRESS 0x3fd498 BIT_MASK 0x10 /end MEASUREMENT
/begin MEASUREMENT LV_END_DIAG_GEN "" UBYTE _CNV_S_2_RANGE______21_R_CM 1 100. 0. 255. ECU_ADDRESS 0x3fd498 BIT_MASK 0x20 /end MEASUREMENT
/begin MEASUREMENT LV_READY_GEN "" UBYTE _CNV_S_2_RANGE______21_R_CM 1 100. 0. 255. ECU_ADDRESS 0x3fd498 BIT_MASK 0x40 /end MEASUREMENT
/begin MEASUREMENT ERR_SYM_GEN "" UBYTE _CNV_S_6_RANGE_ERR__22_CM 1 100. 0. 15. ECU_ADDRESS 0x3fd498 BIT_MASK 0xF /end MEASUREMENT
/begin MEASUREMENT LV_ERR_MEM_GEN "" UBYTE _CNV_S_2_RANGE______21_R_CM 1 100. 0. 255. ECU_ADDRESS 0x3fd498 BIT_MASK 0x80 /end MEASUREMENT
/begin MEASUREMENT CTR_ABC_END_DIAG_GEN "" UBYTE _CNV_A_R_LINEAR_____12_CM 1 100. 0. 255. ECU_ADDRESS 0x3fd499 FORMAT "%3.0" /end MEASUREMENT
/begin MEASUREMENT CTR_ABC_MEC_IVVT_IN_1 "" UBYTE _CNV_A_R_LINEAR_____10_CM 1 100. 0. 255. ECU_ADDRESS 0x3fd3be FORMAT "%3.0" /end MEASUREMENT
/begin MEASUREMENT LV_CDN_DIAG_MEC_IVVT_IN_1 "" UBYTE _CNV_S_2_RANGE______21_R_CM 1 100. 0. 255. ECU_ADDRESS 0x3fd3bc BIT_MASK 0x10 /end MEASUREMENT
/begin MEASUREMENT LV_END_DIAG_MEC_IVVT_IN_1 "" UBYTE _CNV_S_2_RANGE______21_R_CM 1 100. 0. 255. ECU_ADDRESS 0x3fd3bc BIT_MASK 0x20 /end MEASUREMENT
/begin MEASUREMENT LV_READY_MEC_IVVT_IN_1 "" UBYTE _CNV_S_2_RANGE______21_R_CM 1 100. 0. 255. ECU_ADDRESS 0x3fd3bc BIT_MASK 0x40 /end MEASUREMENT
/begin MEASUREMENT ERR_SYM_MEC_IVVT_IN_1 "" UBYTE _CNV_S_6_RANGE_ERR__22_CM 1 100. 0. 15. ECU_ADDRESS 0x3fd3bc BIT_MASK 0xF /end MEASUREMENT
/begin MEASUREMENT LV_ERR_MEM_MEC_IVVT_IN_1 "" UBYTE _CNV_S_2_RANGE______21_R_CM 1 100. 0. 255. ECU_ADDRESS 0x3fd3bc BIT_MASK 0x80 /end MEASUREMENT
/begin MEASUREMENT CTR_ABC_END_DIAG_MEC_IVVT_IN_1 "" UBYTE _CNV_A_R_LINEAR_____12_CM 1 100. 0. 255. ECU_ADDRESS 0x3fd3bd FORMAT "%3.0" /end MEASUREMENT
/begin MEASUREMENT CTR_ABC_MEC_IVVT_IN_2 "" UBYTE _CNV_A_R_LINEAR_____10_CM 1 100. 0. 255. ECU_ADDRESS 0x3fd3c2 FORMAT "%3.0" /end MEASUREMENT
/begin MEASUREMENT LV_CDN_DIAG_MEC_IVVT_IN_2 "" UBYTE _CNV_S_2_RANGE______21_R_CM 1 100. 0. 255. ECU_ADDRESS 0x3fd3c0 BIT_MASK 0x10 /end MEASUREMENT
/begin MEASUREMENT LV_END_DIAG_MEC_IVVT_IN_2 "" UBYTE _CNV_S_2_RANGE______21_R_CM 1 100. 0. 255. ECU_ADDRESS 0x3fd3c0 BIT_MASK 0x20 /end MEASUREMENT
/begin MEASUREMENT LV_READY_MEC_IVVT_IN_2 "" UBYTE _CNV_S_2_RANGE______21_R_CM 1 100. 0. 255. ECU_ADDRESS 0x3fd3c0 BIT_MASK 0x40 /end MEASUREMENT
/begin MEASUREMENT ERR_SYM_MEC_IVVT_IN_2 "" UBYTE _CNV_S_6_RANGE_ERR__22_CM 1 100. 0. 15. ECU_ADDRESS 0x3fd3c0 BIT_MASK 0xF /end MEASUREMENT
/begin MEASUREMENT LV_ERR_MEM_MEC_IVVT_IN_2 "" UBYTE _CNV_S_2_RANGE______21_R_CM 1 100. 0. 255. ECU_ADDRESS 0x3fd3c0 BIT_MASK 0x80 /end MEASUREMENT
/begin MEASUREMENT CTR_ABC_END_DIAG_MEC_IVVT_IN_2 "" UBYTE _CNV_A_R_LINEAR_____12_CM 1 100. 0. 255. ECU_ADDRESS 0x3fd3c1 FORMAT "%3.0" /end MEASUREMENT
/begin MEASUREMENT CTR_ABC_MIS_LOW_FUEL "" UBYTE _CNV_A_R_LINEAR_____10_CM 1 100. 0. 255. ECU_ADDRESS 0x3fd53e FORMAT "%3.0" /end MEASUREMENT
/begin MEASUREMENT LV_CDN_DIAG_MIS_LOW_FUEL "" UBYTE _CNV_S_2_RANGE______21_R_CM 1 100. 0. 255. ECU_ADDRESS 0x3fd53c BIT_MASK 0x10 /end MEASUREMENT
/begin MEASUREMENT LV_END_DIAG_MIS_LOW_FUEL "" UBYTE _CNV_S_2_RANGE______21_R_CM 1 100. 0. 255. ECU_ADDRESS 0x3fd53c BIT_MASK 0x20 /end MEASUREMENT
/begin MEASUREMENT LV_READY_MIS_LOW_FUEL "" UBYTE _CNV_S_2_RANGE______21_R_CM 1 100. 0. 255. ECU_ADDRESS 0x3fd53c BIT_MASK 0x40 /end MEASUREMENT
/begin MEASUREMENT ERR_SYM_MIS_LOW_FUEL "" UBYTE _CNV_S_6_RANGE_ERR__22_CM 1 100. 0. 15. ECU_ADDRESS 0x3fd53c BIT_MASK 0xF /end MEASUREMENT
/begin MEASUREMENT LV_ERR_MEM_MIS_LOW_FUEL "" UBYTE _CNV_S_2_RANGE______21_R_CM 1 100. 0. 255. ECU_ADDRESS 0x3fd53c BIT_MASK 0x80 /end MEASUREMENT
/begin MEASUREMENT CTR_ABC_END_DIAG_MIS_LOW_FUEL "" UBYTE _CNV_A_R_LINEAR_____12_CM 1 100. 0. 255. ECU_ADDRESS 0x3fd53d FORMAT "%3.0" /end MEASUREMENT
/begin MEASUREMENT CTR_ABC_BN_POW_VB "" UBYTE _CNV_A_R_LINEAR_____10_CM 1 100. 0. 255. ECU_ADDRESS 0x3fd65e FORMAT "%3.0" /end MEASUREMENT
/begin MEASUREMENT LV_CDN_DIAG_BN_POW_VB "" UBYTE _CNV_S_2_RANGE______21_R_CM 1 100. 0. 255. ECU_ADDRESS 0x3fd65c BIT_MASK 0x10 /end MEASUREMENT
/begin MEASUREMENT LV_END_DIAG_BN_POW_VB "" UBYTE _CNV_S_2_RANGE______21_R_CM 1 100. 0. 255. ECU_ADDRESS 0x3fd65c BIT_MASK 0x20 /end MEASUREMENT
/begin MEASUREMENT LV_READY_BN_POW_VB "" UBYTE _CNV_S_2_RANGE______21_R_CM 1 100. 0. 255. ECU_ADDRESS 0x3fd65c BIT_MASK 0x40 /end MEASUREMENT
/begin MEASUREMENT ERR_SYM_BN_POW_VB "" UBYTE _CNV_S_6_RANGE_ERR__22_CM 1 100. 0. 15. ECU_ADDRESS 0x3fd65c BIT_MASK 0xF /end MEASUREMENT
/begin MEASUREMENT LV_ERR_MEM_BN_POW_VB "" UBYTE _CNV_S_2_RANGE______21_R_CM 1 100. 0. 255. ECU_ADDRESS 0x3fd65c BIT_MASK 0x80 /end MEASUREMENT
/begin MEASUREMENT CTR_ABC_END_DIAG_BN_POW_VB "" UBYTE _CNV_A_R_LINEAR_____12_CM 1 100. 0. 255. ECU_ADDRESS 0x3fd65d FORMAT "%3.0" /end MEASUREMENT
/begin MEASUREMENT CTR_ABC_CRK_NOT_PLAUS "" UBYTE _CNV_A_R_LINEAR_____10_CM 1 100. 0. 255. ECU_ADDRESS 0x3fd4ca FORMAT "%3.0" /end MEASUREMENT
/begin MEASUREMENT LV_CDN_DIAG_CRK_NOT_PLAUS "" UBYTE _CNV_S_2_RANGE______21_R_CM 1 100. 0. 255. ECU_ADDRESS 0x3fd4c8 BIT_MASK 0x10 /end MEASUREMENT
/begin MEASUREMENT LV_END_DIAG_CRK_NOT_PLAUS "" UBYTE _CNV_S_2_RANGE______21_R_CM 1 100. 0. 255. ECU_ADDRESS 0x3fd4c8 BIT_MASK 0x20 /end MEASUREMENT
/begin MEASUREMENT LV_READY_CRK_NOT_PLAUS "" UBYTE _CNV_S_2_RANGE______21_R_CM 1 100. 0. 255. ECU_ADDRESS 0x3fd4c8 BIT_MASK 0x40 /end MEASUREMENT
/begin MEASUREMENT ERR_SYM_CRK_NOT_PLAUS "" UBYTE _CNV_S_6_RANGE_ERR__22_CM 1 100. 0. 15. ECU_ADDRESS 0x3fd4c8 BIT_MASK 0xF /end MEASUREMENT
/begin MEASUREMENT LV_ERR_MEM_CRK_NOT_PLAUS "" UBYTE _CNV_S_2_RANGE______21_R_CM 1 100. 0. 255. ECU_ADDRESS 0x3fd4c8 BIT_MASK 0x80 /end MEASUREMENT
/begin MEASUREMENT CTR_ABC_END_DIAG_CRK_NOT_PLAUS "" UBYTE _CNV_A_R_LINEAR_____12_CM 1 100. 0. 255. ECU_ADDRESS 0x3fd4c9 FORMAT "%3.0" /end MEASUREMENT
/begin MEASUREMENT CTR_ABC_SAP "" UBYTE _CNV_A_R_LINEAR_____10_CM 1 100. 0. 255. ECU_ADDRESS 0x3fd4e2 FORMAT "%3.0" /end MEASUREMENT
/begin MEASUREMENT LV_CDN_DIAG_SAP "" UBYTE _CNV_S_2_RANGE______21_R_CM 1 100. 0. 255. ECU_ADDRESS 0x3fd4e0 BIT_MASK 0x10 /end MEASUREMENT
/begin MEASUREMENT LV_END_DIAG_SAP "" UBYTE _CNV_S_2_RANGE______21_R_CM 1 100. 0. 255. ECU_ADDRESS 0x3fd4e0 BIT_MASK 0x20 /end MEASUREMENT
/begin MEASUREMENT LV_READY_SAP "" UBYTE _CNV_S_2_RANGE______21_R_CM 1 100. 0. 255. ECU_ADDRESS 0x3fd4e0 BIT_MASK 0x40 /end MEASUREMENT
/begin MEASUREMENT ERR_SYM_SAP "" UBYTE _CNV_S_6_RANGE_ERR__22_CM 1 100. 0. 15. ECU_ADDRESS 0x3fd4e0 BIT_MASK 0xF /end MEASUREMENT
/begin MEASUREMENT LV_ERR_MEM_SAP "" UBYTE _CNV_S_2_RANGE______21_R_CM 1 100. 0. 255. ECU_ADDRESS 0x3fd4e0 BIT_MASK 0x80 /end MEASUREMENT
/begin MEASUREMENT CTR_ABC_END_DIAG_SAP "" UBYTE _CNV_A_R_LINEAR_____12_CM 1 100. 0. 255. ECU_ADDRESS 0x3fd4e1 FORMAT "%3.0" /end MEASUREMENT
/begin MEASUREMENT CTR_ABC_BN_ETCU "" UBYTE _CNV_A_R_LINEAR_____10_CM 1 100. 0. 255. ECU_ADDRESS 0x3fd642 FORMAT "%3.0" /end MEASUREMENT
/begin MEASUREMENT LV_CDN_DIAG_BN_ETCU "" UBYTE _CNV_S_2_RANGE______21_R_CM 1 100. 0. 255. ECU_ADDRESS 0x3fd640 BIT_MASK 0x10 /end MEASUREMENT
/begin MEASUREMENT LV_END_DIAG_BN_ETCU "" UBYTE _CNV_S_2_RANGE______21_R_CM 1 100. 0. 255. ECU_ADDRESS 0x3fd640 BIT_MASK 0x20 /end MEASUREMENT
/begin MEASUREMENT LV_READY_BN_ETCU "" UBYTE _CNV_S_2_RANGE______21_R_CM 1 100. 0. 255. ECU_ADDRESS 0x3fd640 BIT_MASK 0x40 /end MEASUREMENT
/begin MEASUREMENT ERR_SYM_BN_ETCU "" UBYTE _CNV_S_6_RANGE_ERR__22_CM 1 100. 0. 15. ECU_ADDRESS 0x3fd640 BIT_MASK 0xF /end MEASUREMENT
/begin MEASUREMENT LV_ERR_MEM_BN_ETCU "" UBYTE _CNV_S_2_RANGE______21_R_CM 1 100. 0. 255. ECU_ADDRESS 0x3fd640 BIT_MASK 0x80 /end MEASUREMENT
/begin MEASUREMENT CTR_ABC_END_DIAG_BN_ETCU "" UBYTE _CNV_A_R_LINEAR_____12_CM 1 100. 0. 255. ECU_ADDRESS 0x3fd641 FORMAT "%3.0" /end MEASUREMENT
/begin MEASUREMENT CTR_ABC_TCO_EL "" UBYTE _CNV_A_R_LINEAR_____10_CM 1 100. 0. 255. ECU_ADDRESS 0x3fd4ee FORMAT "%3.0" /end MEASUREMENT
/begin MEASUREMENT LV_CDN_DIAG_TCO_EL "" UBYTE _CNV_S_2_RANGE______21_R_CM 1 100. 0. 255. ECU_ADDRESS 0x3fd4ec BIT_MASK 0x10 /end MEASUREMENT
/begin MEASUREMENT LV_END_DIAG_TCO_EL "" UBYTE _CNV_S_2_RANGE______21_R_CM 1 100. 0. 255. ECU_ADDRESS 0x3fd4ec BIT_MASK 0x20 /end MEASUREMENT
/begin MEASUREMENT LV_READY_TCO_EL "" UBYTE _CNV_S_2_RANGE______21_R_CM 1 100. 0. 255. ECU_ADDRESS 0x3fd4ec BIT_MASK 0x40 /end MEASUREMENT
/begin MEASUREMENT ERR_SYM_TCO_EL "" UBYTE _CNV_S_6_RANGE_ERR__22_CM 1 100. 0. 15. ECU_ADDRESS 0x3fd4ec BIT_MASK 0xF /end MEASUREMENT
/begin MEASUREMENT LV_ERR_MEM_TCO_EL "" UBYTE _CNV_S_2_RANGE______21_R_CM 1 100. 0. 255. ECU_ADDRESS 0x3fd4ec BIT_MASK 0x80 /end MEASUREMENT
/begin MEASUREMENT CTR_ABC_END_DIAG_TCO_EL "" UBYTE _CNV_A_R_LINEAR_____12_CM 1 100. 0. 255. ECU_ADDRESS 0x3fd4ed FORMAT "%3.0" /end MEASUREMENT
/begin MEASUREMENT CTR_ABC_SAV "" UBYTE _CNV_A_R_LINEAR_____10_CM 1 100. 0. 255. ECU_ADDRESS 0x3fd4e6 FORMAT "%3.0" /end MEASUREMENT
/begin MEASUREMENT LV_CDN_DIAG_SAV "" UBYTE _CNV_S_2_RANGE______21_R_CM 1 100. 0. 255. ECU_ADDRESS 0x3fd4e4 BIT_MASK 0x10 /end MEASUREMENT
/begin MEASUREMENT LV_END_DIAG_SAV "" UBYTE _CNV_S_2_RANGE______21_R_CM 1 100. 0. 255. ECU_ADDRESS 0x3fd4e4 BIT_MASK 0x20 /end MEASUREMENT
/begin MEASUREMENT LV_READY_SAV "" UBYTE _CNV_S_2_RANGE______21_R_CM 1 100. 0. 255. ECU_ADDRESS 0x3fd4e4 BIT_MASK 0x40 /end MEASUREMENT
/begin MEASUREMENT ERR_SYM_SAV "" UBYTE _CNV_S_6_RANGE_ERR__22_CM 1 100. 0. 15. ECU_ADDRESS 0x3fd4e4 BIT_MASK 0xF /end MEASUREMENT
/begin MEASUREMENT LV_ERR_MEM_SAV "" UBYTE _CNV_S_2_RANGE______21_R_CM 1 100. 0. 255. ECU_ADDRESS 0x3fd4e4 BIT_MASK 0x80 /end MEASUREMENT
/begin MEASUREMENT CTR_ABC_END_DIAG_SAV "" UBYTE _CNV_A_R_LINEAR_____12_CM 1 100. 0. 255. ECU_ADDRESS 0x3fd4e5 FORMAT "%3.0" /end MEASUREMENT
/begin MEASUREMENT CTR_ABC_BN_ACC "" UBYTE _CNV_A_R_LINEAR_____10_CM 1 100. 0. 255. ECU_ADDRESS 0x3fd64a FORMAT "%3.0" /end MEASUREMENT
/begin MEASUREMENT LV_CDN_DIAG_BN_ACC "" UBYTE _CNV_S_2_RANGE______21_R_CM 1 100. 0. 255. ECU_ADDRESS 0x3fd648 BIT_MASK 0x10 /end MEASUREMENT
/begin MEASUREMENT LV_END_DIAG_BN_ACC "" UBYTE _CNV_S_2_RANGE______21_R_CM 1 100. 0. 255. ECU_ADDRESS 0x3fd648 BIT_MASK 0x20 /end MEASUREMENT
/begin MEASUREMENT LV_READY_BN_ACC "" UBYTE _CNV_S_2_RANGE______21_R_CM 1 100. 0. 255. ECU_ADDRESS 0x3fd648 BIT_MASK 0x40 /end MEASUREMENT
/begin MEASUREMENT ERR_SYM_BN_ACC "" UBYTE _CNV_S_6_RANGE_ERR__22_CM 1 100. 0. 15. ECU_ADDRESS 0x3fd648 BIT_MASK 0xF /end MEASUREMENT
/begin MEASUREMENT LV_ERR_MEM_BN_ACC "" UBYTE _CNV_S_2_RANGE______21_R_CM 1 100. 0. 255. ECU_ADDRESS 0x3fd648 BIT_MASK 0x80 /end MEASUREMENT
/begin MEASUREMENT CTR_ABC_END_DIAG_BN_ACC "" UBYTE _CNV_A_R_LINEAR_____12_CM 1 100. 0. 255. ECU_ADDRESS 0x3fd649 FORMAT "%3.0" /end MEASUREMENT
/begin MEASUREMENT CTR_ABC_FSD_1 "" UBYTE _CNV_A_R_LINEAR_____10_CM 1 100. 0. 255. ECU_ADDRESS 0x3fd59e FORMAT "%3.0" /end MEASUREMENT
/begin MEASUREMENT LV_CDN_DIAG_FSD_1 "" UBYTE _CNV_S_2_RANGE______21_R_CM 1 100. 0. 255. ECU_ADDRESS 0x3fd59c BIT_MASK 0x10 /end MEASUREMENT
/begin MEASUREMENT LV_END_DIAG_FSD_1 "" UBYTE _CNV_S_2_RANGE______21_R_CM 1 100. 0. 255. ECU_ADDRESS 0x3fd59c BIT_MASK 0x20 /end MEASUREMENT
/begin MEASUREMENT LV_READY_FSD_1 "" UBYTE _CNV_S_2_RANGE______21_R_CM 1 100. 0. 255. ECU_ADDRESS 0x3fd59c BIT_MASK 0x40 /end MEASUREMENT
/begin MEASUREMENT ERR_SYM_FSD_1 "" UBYTE _CNV_S_6_RANGE_ERR__22_CM 1 100. 0. 15. ECU_ADDRESS 0x3fd59c BIT_MASK 0xF /end MEASUREMENT
/begin MEASUREMENT LV_ERR_MEM_FSD_1 "" UBYTE _CNV_S_2_RANGE______21_R_CM 1 100. 0. 255. ECU_ADDRESS 0x3fd59c BIT_MASK 0x80 /end MEASUREMENT
/begin MEASUREMENT CTR_ABC_END_DIAG_FSD_1 "" UBYTE _CNV_A_R_LINEAR_____12_CM 1 100. 0. 255. ECU_ADDRESS 0x3fd59d FORMAT "%3.0" /end MEASUREMENT
/begin MEASUREMENT CTR_ABC_FSD_2 "" UBYTE _CNV_A_R_LINEAR_____10_CM 1 100. 0. 255. ECU_ADDRESS 0x3fd5a2 FORMAT "%3.0" /end MEASUREMENT
/begin MEASUREMENT LV_CDN_DIAG_FSD_2 "" UBYTE _CNV_S_2_RANGE______21_R_CM 1 100. 0. 255. ECU_ADDRESS 0x3fd5a0 BIT_MASK 0x10 /end MEASUREMENT
/begin MEASUREMENT LV_END_DIAG_FSD_2 "" UBYTE _CNV_S_2_RANGE______21_R_CM 1 100. 0. 255. ECU_ADDRESS 0x3fd5a0 BIT_MASK 0x20 /end MEASUREMENT
/begin MEASUREMENT LV_READY_FSD_2 "" UBYTE _CNV_S_2_RANGE______21_R_CM 1 100. 0. 255. ECU_ADDRESS 0x3fd5a0 BIT_MASK 0x40 /end MEASUREMENT
/begin MEASUREMENT ERR_SYM_FSD_2 "" UBYTE _CNV_S_6_RANGE_ERR__22_CM 1 100. 0. 15. ECU_ADDRESS 0x3fd5a0 BIT_MASK 0xF /end MEASUREMENT
/begin MEASUREMENT LV_ERR_MEM_FSD_2 "" UBYTE _CNV_S_2_RANGE______21_R_CM 1 100. 0. 255. ECU_ADDRESS 0x3fd5a0 BIT_MASK 0x80 /end MEASUREMENT
/begin MEASUREMENT CTR_ABC_END_DIAG_FSD_2 "" UBYTE _CNV_A_R_LINEAR_____12_CM 1 100. 0. 255. ECU_ADDRESS 0x3fd5a1 FORMAT "%3.0" /end MEASUREMENT
/begin MEASUREMENT CTR_ABC_TCO_EX "" UBYTE _CNV_A_R_LINEAR_____10_CM 1 100. 0. 255. ECU_ADDRESS 0x3fd356 FORMAT "%3.0" /end MEASUREMENT
/begin MEASUREMENT LV_CDN_DIAG_TCO_EX "" UBYTE _CNV_S_2_RANGE______21_R_CM 1 100. 0. 255. ECU_ADDRESS 0x3fd354 BIT_MASK 0x10 /end MEASUREMENT
/begin MEASUREMENT LV_END_DIAG_TCO_EX "" UBYTE _CNV_S_2_RANGE______21_R_CM 1 100. 0. 255. ECU_ADDRESS 0x3fd354 BIT_MASK 0x20 /end MEASUREMENT
/begin MEASUREMENT LV_READY_TCO_EX "" UBYTE _CNV_S_2_RANGE______21_R_CM 1 100. 0. 255. ECU_ADDRESS 0x3fd354 BIT_MASK 0x40 /end MEASUREMENT
/begin MEASUREMENT ERR_SYM_TCO_EX "" UBYTE _CNV_S_6_RANGE_ERR__22_CM 1 100. 0. 15. ECU_ADDRESS 0x3fd354 BIT_MASK 0xF /end MEASUREMENT
/begin MEASUREMENT LV_ERR_MEM_TCO_EX "" UBYTE _CNV_S_2_RANGE______21_R_CM 1 100. 0. 255. ECU_ADDRESS 0x3fd354 BIT_MASK 0x80 /end MEASUREMENT
/begin MEASUREMENT CTR_ABC_END_DIAG_TCO_EX "" UBYTE _CNV_A_R_LINEAR_____12_CM 1 100. 0. 255. ECU_ADDRESS 0x3fd355 FORMAT "%3.0" /end MEASUREMENT
/begin MEASUREMENT CTR_ABC_CAN_BOFF "" UBYTE _CNV_A_R_LINEAR_____10_CM 1 100. 0. 255. ECU_ADDRESS 0x3fd4d2 FORMAT "%3.0" /end MEASUREMENT
/begin MEASUREMENT LV_CDN_DIAG_CAN_BOFF "" UBYTE _CNV_S_2_RANGE______21_R_CM 1 100. 0. 255. ECU_ADDRESS 0x3fd4d0 BIT_MASK 0x10 /end MEASUREMENT
/begin MEASUREMENT LV_END_DIAG_CAN_BOFF "" UBYTE _CNV_S_2_RANGE______21_R_CM 1 100. 0. 255. ECU_ADDRESS 0x3fd4d0 BIT_MASK 0x20 /end MEASUREMENT
/begin MEASUREMENT LV_READY_CAN_BOFF "" UBYTE _CNV_S_2_RANGE______21_R_CM 1 100. 0. 255. ECU_ADDRESS 0x3fd4d0 BIT_MASK 0x40 /end MEASUREMENT
/begin MEASUREMENT ERR_SYM_CAN_BOFF "" UBYTE _CNV_S_6_RANGE_ERR__22_CM 1 100. 0. 15. ECU_ADDRESS 0x3fd4d0 BIT_MASK 0xF /end MEASUREMENT
/begin MEASUREMENT LV_ERR_MEM_CAN_BOFF "" UBYTE _CNV_S_2_RANGE______21_R_CM 1 100. 0. 255. ECU_ADDRESS 0x3fd4d0 BIT_MASK 0x80 /end MEASUREMENT
/begin MEASUREMENT CTR_ABC_END_DIAG_CAN_BOFF "" UBYTE _CNV_A_R_LINEAR_____12_CM 1 100. 0. 255. ECU_ADDRESS 0x3fd4d1 FORMAT "%3.0" /end MEASUREMENT
/begin MEASUREMENT CTR_ABC_MAF_MON_1 "" UBYTE _CNV_A_R_LINEAR_____10_CM 1 100. 0. 255. ECU_ADDRESS 0x3fd57a FORMAT "%3.0" /end MEASUREMENT
/begin MEASUREMENT LV_CDN_DIAG_MAF_MON_1 "" UBYTE _CNV_S_2_RANGE______21_R_CM 1 100. 0. 255. ECU_ADDRESS 0x3fd578 BIT_MASK 0x10 /end MEASUREMENT
/begin MEASUREMENT LV_END_DIAG_MAF_MON_1 "" UBYTE _CNV_S_2_RANGE______21_R_CM 1 100. 0. 255. ECU_ADDRESS 0x3fd578 BIT_MASK 0x20 /end MEASUREMENT
/begin MEASUREMENT LV_READY_MAF_MON_1 "" UBYTE _CNV_S_2_RANGE______21_R_CM 1 100. 0. 255. ECU_ADDRESS 0x3fd578 BIT_MASK 0x40 /end MEASUREMENT
/begin MEASUREMENT ERR_SYM_MAF_MON_1 "" UBYTE _CNV_S_6_RANGE_ERR__22_CM 1 100. 0. 15. ECU_ADDRESS 0x3fd578 BIT_MASK 0xF /end MEASUREMENT
/begin MEASUREMENT LV_ERR_MEM_MAF_MON_1 "" UBYTE _CNV_S_2_RANGE______21_R_CM 1 100. 0. 255. ECU_ADDRESS 0x3fd578 BIT_MASK 0x80 /end MEASUREMENT
/begin MEASUREMENT CTR_ABC_END_DIAG_MAF_MON_1 "" UBYTE _CNV_A_R_LINEAR_____12_CM 1 100. 0. 255. ECU_ADDRESS 0x3fd579 FORMAT "%3.0" /end MEASUREMENT
/begin MEASUREMENT CTR_ABC_TPS_AD_BOL "" UBYTE _CNV_A_R_LINEAR_____10_CM 1 100. 0. 255. ECU_ADDRESS 0x3fd48e FORMAT "%3.0" /end MEASUREMENT
/begin MEASUREMENT LV_CDN_DIAG_TPS_AD_BOL "" UBYTE _CNV_S_2_RANGE______21_R_CM 1 100. 0. 255. ECU_ADDRESS 0x3fd48c BIT_MASK 0x10 /end MEASUREMENT
/begin MEASUREMENT LV_END_DIAG_TPS_AD_BOL "" UBYTE _CNV_S_2_RANGE______21_R_CM 1 100. 0. 255. ECU_ADDRESS 0x3fd48c BIT_MASK 0x20 /end MEASUREMENT
/begin MEASUREMENT LV_READY_TPS_AD_BOL "" UBYTE _CNV_S_2_RANGE______21_R_CM 1 100. 0. 255. ECU_ADDRESS 0x3fd48c BIT_MASK 0x40 /end MEASUREMENT
/begin MEASUREMENT ERR_SYM_TPS_AD_BOL "" UBYTE _CNV_S_6_RANGE_ERR__22_CM 1 100. 0. 15. ECU_ADDRESS 0x3fd48c BIT_MASK 0xF /end MEASUREMENT
/begin MEASUREMENT LV_ERR_MEM_TPS_AD_BOL "" UBYTE _CNV_S_2_RANGE______21_R_CM 1 100. 0. 255. ECU_ADDRESS 0x3fd48c BIT_MASK 0x80 /end MEASUREMENT
/begin MEASUREMENT CTR_ABC_END_DIAG_TPS_AD_BOL "" UBYTE _CNV_A_R_LINEAR_____12_CM 1 100. 0. 255. ECU_ADDRESS 0x3fd48d FORMAT "%3.0" /end MEASUREMENT
/begin MEASUREMENT CTR_ABC_LOAD_TPS_PLAUS "" UBYTE _CNV_A_R_LINEAR_____10_CM 1 100. 0. 255. ECU_ADDRESS 0x3fd66e FORMAT "%3.0" /end MEASUREMENT
/begin MEASUREMENT LV_CDN_DIAG_LOAD_TPS_PLAUS "" UBYTE _CNV_S_2_RANGE______21_R_CM 1 100. 0. 255. ECU_ADDRESS 0x3fd66c BIT_MASK 0x10 /end MEASUREMENT
/begin MEASUREMENT LV_END_DIAG_LOAD_TPS_PLAUS "" UBYTE _CNV_S_2_RANGE______21_R_CM 1 100. 0. 255. ECU_ADDRESS 0x3fd66c BIT_MASK 0x20 /end MEASUREMENT
/begin MEASUREMENT LV_READY_LOAD_TPS_PLAUS "" UBYTE _CNV_S_2_RANGE______21_R_CM 1 100. 0. 255. ECU_ADDRESS 0x3fd66c BIT_MASK 0x40 /end MEASUREMENT
/begin MEASUREMENT ERR_SYM_LOAD_TPS_PLAUS "" UBYTE _CNV_S_6_RANGE_ERR__22_CM 1 100. 0. 15. ECU_ADDRESS 0x3fd66c BIT_MASK 0xF /end MEASUREMENT
/begin MEASUREMENT LV_ERR_MEM_LOAD_TPS_PLAUS "" UBYTE _CNV_S_2_RANGE______21_R_CM 1 100. 0. 255. ECU_ADDRESS 0x3fd66c BIT_MASK 0x80 /end MEASUREMENT
/begin MEASUREMENT CTR_ABC_END_DIAG_LOAD_TPS_PLAUS "" UBYTE _CNV_A_R_LINEAR_____12_CM 1 100. 0. 255. ECU_ADDRESS 0x3fd66d FORMAT "%3.0" /end MEASUREMENT
/begin MEASUREMENT CTR_ABC_SA_SAFM "" UBYTE _CNV_A_R_LINEAR_____10_CM 1 100. 0. 255. ECU_ADDRESS 0x3fd586 FORMAT "%3.0" /end MEASUREMENT
/begin MEASUREMENT LV_CDN_DIAG_SA_SAFM "" UBYTE _CNV_S_2_RANGE______21_R_CM 1 100. 0. 255. ECU_ADDRESS 0x3fd584 BIT_MASK 0x10 /end MEASUREMENT
/begin MEASUREMENT LV_END_DIAG_SA_SAFM "" UBYTE _CNV_S_2_RANGE______21_R_CM 1 100. 0. 255. ECU_ADDRESS 0x3fd584 BIT_MASK 0x20 /end MEASUREMENT
/begin MEASUREMENT LV_READY_SA_SAFM "" UBYTE _CNV_S_2_RANGE______21_R_CM 1 100. 0. 255. ECU_ADDRESS 0x3fd584 BIT_MASK 0x40 /end MEASUREMENT
/begin MEASUREMENT ERR_SYM_SA_SAFM "" UBYTE _CNV_S_6_RANGE_ERR__22_CM 1 100. 0. 15. ECU_ADDRESS 0x3fd584 BIT_MASK 0xF /end MEASUREMENT
/begin MEASUREMENT LV_ERR_MEM_SA_SAFM "" UBYTE _CNV_S_2_RANGE______21_R_CM 1 100. 0. 255. ECU_ADDRESS 0x3fd584 BIT_MASK 0x80 /end MEASUREMENT
/begin MEASUREMENT CTR_ABC_END_DIAG_SA_SAFM "" UBYTE _CNV_A_R_LINEAR_____12_CM 1 100. 0. 255. ECU_ADDRESS 0x3fd585 FORMAT "%3.0" /end MEASUREMENT
/begin MEASUREMENT CTR_ABC_VLS_UP_OC_1 "" UBYTE _CNV_A_R_LINEAR_____10_CM 1 100. 0. 255. ECU_ADDRESS 0x3fd6be FORMAT "%3.0" /end MEASUREMENT
/begin MEASUREMENT LV_CDN_DIAG_VLS_UP_OC_1 "" UBYTE _CNV_S_2_RANGE______21_R_CM 1 100. 0. 255. ECU_ADDRESS 0x3fd6bc BIT_MASK 0x10 /end MEASUREMENT
/begin MEASUREMENT LV_END_DIAG_VLS_UP_OC_1 "" UBYTE _CNV_S_2_RANGE______21_R_CM 1 100. 0. 255. ECU_ADDRESS 0x3fd6bc BIT_MASK 0x20 /end MEASUREMENT
/begin MEASUREMENT LV_READY_VLS_UP_OC_1 "" UBYTE _CNV_S_2_RANGE______21_R_CM 1 100. 0. 255. ECU_ADDRESS 0x3fd6bc BIT_MASK 0x40 /end MEASUREMENT
/begin MEASUREMENT ERR_SYM_VLS_UP_OC_1 "" UBYTE _CNV_S_6_RANGE_ERR__22_CM 1 100. 0. 15. ECU_ADDRESS 0x3fd6bc BIT_MASK 0xF /end MEASUREMENT
/begin MEASUREMENT LV_ERR_MEM_VLS_UP_OC_1 "" UBYTE _CNV_S_2_RANGE______21_R_CM 1 100. 0. 255. ECU_ADDRESS 0x3fd6bc BIT_MASK 0x80 /end MEASUREMENT
/begin MEASUREMENT CTR_ABC_END_DIAG_VLS_UP_OC_1 "" UBYTE _CNV_A_R_LINEAR_____12_CM 1 100. 0. 255. ECU_ADDRESS 0x3fd6bd FORMAT "%3.0" /end MEASUREMENT
/begin MEASUREMENT CTR_ABC_VLS_UP_OC_2 "" UBYTE _CNV_A_R_LINEAR_____10_CM 1 100. 0. 255. ECU_ADDRESS 0x3fd6c2 FORMAT "%3.0" /end MEASUREMENT
/begin MEASUREMENT LV_CDN_DIAG_VLS_UP_OC_2 "" UBYTE _CNV_S_2_RANGE______21_R_CM 1 100. 0. 255. ECU_ADDRESS 0x3fd6c0 BIT_MASK 0x10 /end MEASUREMENT
/begin MEASUREMENT LV_END_DIAG_VLS_UP_OC_2 "" UBYTE _CNV_S_2_RANGE______21_R_CM 1 100. 0. 255. ECU_ADDRESS 0x3fd6c0 BIT_MASK 0x20 /end MEASUREMENT
/begin MEASUREMENT LV_READY_VLS_UP_OC_2 "" UBYTE _CNV_S_2_RANGE______21_R_CM 1 100. 0. 255. ECU_ADDRESS 0x3fd6c0 BIT_MASK 0x40 /end MEASUREMENT
/begin MEASUREMENT ERR_SYM_VLS_UP_OC_2 "" UBYTE _CNV_S_6_RANGE_ERR__22_CM 1 100. 0. 15. ECU_ADDRESS 0x3fd6c0 BIT_MASK 0xF /end MEASUREMENT
/begin MEASUREMENT LV_ERR_MEM_VLS_UP_OC_2 "" UBYTE _CNV_S_2_RANGE______21_R_CM 1 100. 0. 255. ECU_ADDRESS 0x3fd6c0 BIT_MASK 0x80 /end MEASUREMENT
/begin MEASUREMENT CTR_ABC_END_DIAG_VLS_UP_OC_2 "" UBYTE _CNV_A_R_LINEAR_____12_CM 1 100. 0. 255. ECU_ADDRESS 0x3fd6c1 FORMAT "%3.0" /end MEASUREMENT
/begin MEASUREMENT CTR_ABC_CAM_PSN_0 "" UBYTE _CNV_A_R_LINEAR_____10_CM 1 100. 0. 255. ECU_ADDRESS 0x3fd4ae FORMAT "%3.0" /end MEASUREMENT
/begin MEASUREMENT LV_CDN_DIAG_CAM_PSN_0 "" UBYTE _CNV_S_2_RANGE______21_R_CM 1 100. 0. 255. ECU_ADDRESS 0x3fd4ac BIT_MASK 0x10 /end MEASUREMENT
/begin MEASUREMENT LV_END_DIAG_CAM_PSN_0 "" UBYTE _CNV_S_2_RANGE______21_R_CM 1 100. 0. 255. ECU_ADDRESS 0x3fd4ac BIT_MASK 0x20 /end MEASUREMENT
/begin MEASUREMENT LV_READY_CAM_PSN_0 "" UBYTE _CNV_S_2_RANGE______21_R_CM 1 100. 0. 255. ECU_ADDRESS 0x3fd4ac BIT_MASK 0x40 /end MEASUREMENT
/begin MEASUREMENT ERR_SYM_CAM_PSN_0 "" UBYTE _CNV_S_6_RANGE_ERR__22_CM 1 100. 0. 15. ECU_ADDRESS 0x3fd4ac BIT_MASK 0xF /end MEASUREMENT
/begin MEASUREMENT LV_ERR_MEM_CAM_PSN_0 "" UBYTE _CNV_S_2_RANGE______21_R_CM 1 100. 0. 255. ECU_ADDRESS 0x3fd4ac BIT_MASK 0x80 /end MEASUREMENT
/begin MEASUREMENT CTR_ABC_END_DIAG_CAM_PSN_0 "" UBYTE _CNV_A_R_LINEAR_____12_CM 1 100. 0. 255. ECU_ADDRESS 0x3fd4ad FORMAT "%3.0" /end MEASUREMENT
/begin MEASUREMENT CTR_ABC_CAM_PSN_1 "" UBYTE _CNV_A_R_LINEAR_____10_CM 1 100. 0. 255. ECU_ADDRESS 0x3fd4b2 FORMAT "%3.0" /end MEASUREMENT
/begin MEASUREMENT LV_CDN_DIAG_CAM_PSN_1 "" UBYTE _CNV_S_2_RANGE______21_R_CM 1 100. 0. 255. ECU_ADDRESS 0x3fd4b0 BIT_MASK 0x10 /end MEASUREMENT
/begin MEASUREMENT LV_END_DIAG_CAM_PSN_1 "" UBYTE _CNV_S_2_RANGE______21_R_CM 1 100. 0. 255. ECU_ADDRESS 0x3fd4b0 BIT_MASK 0x20 /end MEASUREMENT
/begin MEASUREMENT LV_READY_CAM_PSN_1 "" UBYTE _CNV_S_2_RANGE______21_R_CM 1 100. 0. 255. ECU_ADDRESS 0x3fd4b0 BIT_MASK 0x40 /end MEASUREMENT
/begin MEASUREMENT ERR_SYM_CAM_PSN_1 "" UBYTE _CNV_S_6_RANGE_ERR__22_CM 1 100. 0. 15. ECU_ADDRESS 0x3fd4b0 BIT_MASK 0xF /end MEASUREMENT
/begin MEASUREMENT LV_ERR_MEM_CAM_PSN_1 "" UBYTE _CNV_S_2_RANGE______21_R_CM 1 100. 0. 255. ECU_ADDRESS 0x3fd4b0 BIT_MASK 0x80 /end MEASUREMENT
/begin MEASUREMENT CTR_ABC_END_DIAG_CAM_PSN_1 "" UBYTE _CNV_A_R_LINEAR_____12_CM 1 100. 0. 255. ECU_ADDRESS 0x3fd4b1 FORMAT "%3.0" /end MEASUREMENT
/begin MEASUREMENT CTR_ABC_BN_TQ_ETCU "" UBYTE _CNV_A_R_LINEAR_____10_CM 1 100. 0. 255. ECU_ADDRESS 0x3fd63e FORMAT "%3.0" /end MEASUREMENT
/begin MEASUREMENT LV_CDN_DIAG_BN_TQ_ETCU "" UBYTE _CNV_S_2_RANGE______21_R_CM 1 100. 0. 255. ECU_ADDRESS 0x3fd63c BIT_MASK 0x10 /end MEASUREMENT
/begin MEASUREMENT LV_END_DIAG_BN_TQ_ETCU "" UBYTE _CNV_S_2_RANGE______21_R_CM 1 100. 0. 255. ECU_ADDRESS 0x3fd63c BIT_MASK 0x20 /end MEASUREMENT
/begin MEASUREMENT LV_READY_BN_TQ_ETCU "" UBYTE _CNV_S_2_RANGE______21_R_CM 1 100. 0. 255. ECU_ADDRESS 0x3fd63c BIT_MASK 0x40 /end MEASUREMENT
/begin MEASUREMENT ERR_SYM_BN_TQ_ETCU "" UBYTE _CNV_S_6_RANGE_ERR__22_CM 1 100. 0. 15. ECU_ADDRESS 0x3fd63c BIT_MASK 0xF /end MEASUREMENT
/begin MEASUREMENT LV_ERR_MEM_BN_TQ_ETCU "" UBYTE _CNV_S_2_RANGE______21_R_CM 1 100. 0. 255. ECU_ADDRESS 0x3fd63c BIT_MASK 0x80 /end MEASUREMENT
/begin MEASUREMENT CTR_ABC_END_DIAG_BN_TQ_ETCU "" UBYTE _CNV_A_R_LINEAR_____12_CM 1 100. 0. 255. ECU_ADDRESS 0x3fd63d FORMAT "%3.0" /end MEASUREMENT
/begin MEASUREMENT CTR_ABC_BN_T_ICL "" UBYTE _CNV_A_R_LINEAR_____10_CM 1 100. 0. 255. ECU_ADDRESS 0x3fd64e FORMAT "%3.0" /end MEASUREMENT
/begin MEASUREMENT LV_CDN_DIAG_BN_T_ICL "" UBYTE _CNV_S_2_RANGE______21_R_CM 1 100. 0. 255. ECU_ADDRESS 0x3fd64c BIT_MASK 0x10 /end MEASUREMENT
/begin MEASUREMENT LV_END_DIAG_BN_T_ICL "" UBYTE _CNV_S_2_RANGE______21_R_CM 1 100. 0. 255. ECU_ADDRESS 0x3fd64c BIT_MASK 0x20 /end MEASUREMENT
/begin MEASUREMENT LV_READY_BN_T_ICL "" UBYTE _CNV_S_2_RANGE______21_R_CM 1 100. 0. 255. ECU_ADDRESS 0x3fd64c BIT_MASK 0x40 /end MEASUREMENT
/begin MEASUREMENT ERR_SYM_BN_T_ICL "" UBYTE _CNV_S_6_RANGE_ERR__22_CM 1 100. 0. 15. ECU_ADDRESS 0x3fd64c BIT_MASK 0xF /end MEASUREMENT
/begin MEASUREMENT LV_ERR_MEM_BN_T_ICL "" UBYTE _CNV_S_2_RANGE______21_R_CM 1 100. 0. 255. ECU_ADDRESS 0x3fd64c BIT_MASK 0x80 /end MEASUREMENT
/begin MEASUREMENT CTR_ABC_END_DIAG_BN_T_ICL "" UBYTE _CNV_A_R_LINEAR_____12_CM 1 100. 0. 255. ECU_ADDRESS 0x3fd64d FORMAT "%3.0" /end MEASUREMENT
/begin MEASUREMENT CTR_ABC_TQ_MIN_CLU_MON_1 "" UBYTE _CNV_A_R_LINEAR_____10_CM 1 100. 0. 255. ECU_ADDRESS 0x3fd55a FORMAT "%3.0" /end MEASUREMENT
/begin MEASUREMENT LV_CDN_DIAG_TQ_MIN_CLU_MON_1 "" UBYTE _CNV_S_2_RANGE______21_R_CM 1 100. 0. 255. ECU_ADDRESS 0x3fd558 BIT_MASK 0x10 /end MEASUREMENT
/begin MEASUREMENT LV_END_DIAG_TQ_MIN_CLU_MON_1 "" UBYTE _CNV_S_2_RANGE______21_R_CM 1 100. 0. 255. ECU_ADDRESS 0x3fd558 BIT_MASK 0x20 /end MEASUREMENT
/begin MEASUREMENT LV_READY_TQ_MIN_CLU_MON_1 "" UBYTE _CNV_S_2_RANGE______21_R_CM 1 100. 0. 255. ECU_ADDRESS 0x3fd558 BIT_MASK 0x40 /end MEASUREMENT
/begin MEASUREMENT ERR_SYM_TQ_MIN_CLU_MON_1 "" UBYTE _CNV_S_6_RANGE_ERR__22_CM 1 100. 0. 15. ECU_ADDRESS 0x3fd558 BIT_MASK 0xF /end MEASUREMENT
/begin MEASUREMENT LV_ERR_MEM_TQ_MIN_CLU_MON_1 "" UBYTE _CNV_S_2_RANGE______21_R_CM 1 100. 0. 255. ECU_ADDRESS 0x3fd558 BIT_MASK 0x80 /end MEASUREMENT
/begin MEASUREMENT CTR_ABC_END_DIAG_TQ_MIN_CLU_MON_ "" UBYTE _CNV_A_R_LINEAR_____12_CM 1 100. 0. 255. ECU_ADDRESS 0x3fd559 FORMAT "%3.0" /end MEASUREMENT
/begin MEASUREMENT CTR_ABC_MSW_2 "" UBYTE _CNV_A_R_LINEAR_____10_CM 1 100. 0. 255. ECU_ADDRESS 0x3fd516 FORMAT "%3.0" /end MEASUREMENT
/begin MEASUREMENT LV_CDN_DIAG_MSW_2 "" UBYTE _CNV_S_2_RANGE______21_R_CM 1 100. 0. 255. ECU_ADDRESS 0x3fd514 BIT_MASK 0x10 /end MEASUREMENT
/begin MEASUREMENT LV_END_DIAG_MSW_2 "" UBYTE _CNV_S_2_RANGE______21_R_CM 1 100. 0. 255. ECU_ADDRESS 0x3fd514 BIT_MASK 0x20 /end MEASUREMENT
/begin MEASUREMENT LV_READY_MSW_2 "" UBYTE _CNV_S_2_RANGE______21_R_CM 1 100. 0. 255. ECU_ADDRESS 0x3fd514 BIT_MASK 0x40 /end MEASUREMENT
/begin MEASUREMENT ERR_SYM_MSW_2 "" UBYTE _CNV_S_6_RANGE_ERR__22_CM 1 100. 0. 15. ECU_ADDRESS 0x3fd514 BIT_MASK 0xF /end MEASUREMENT
/begin MEASUREMENT LV_ERR_MEM_MSW_2 "" UBYTE _CNV_S_2_RANGE______21_R_CM 1 100. 0. 255. ECU_ADDRESS 0x3fd514 BIT_MASK 0x80 /end MEASUREMENT
/begin MEASUREMENT CTR_ABC_END_DIAG_MSW_2 "" UBYTE _CNV_A_R_LINEAR_____12_CM 1 100. 0. 255. ECU_ADDRESS 0x3fd515 FORMAT "%3.0" /end MEASUREMENT
/begin MEASUREMENT CTR_ABC_MSW_3 "" UBYTE _CNV_A_R_LINEAR_____10_CM 1 100. 0. 255. ECU_ADDRESS 0x3fd51a FORMAT "%3.0" /end MEASUREMENT
/begin MEASUREMENT LV_CDN_DIAG_MSW_3 "" UBYTE _CNV_S_2_RANGE______21_R_CM 1 100. 0. 255. ECU_ADDRESS 0x3fd518 BIT_MASK 0x10 /end MEASUREMENT
/begin MEASUREMENT LV_END_DIAG_MSW_3 "" UBYTE _CNV_S_2_RANGE______21_R_CM 1 100. 0. 255. ECU_ADDRESS 0x3fd518 BIT_MASK 0x20 /end MEASUREMENT
/begin MEASUREMENT LV_READY_MSW_3 "" UBYTE _CNV_S_2_RANGE______21_R_CM 1 100. 0. 255. ECU_ADDRESS 0x3fd518 BIT_MASK 0x40 /end MEASUREMENT
/begin MEASUREMENT ERR_SYM_MSW_3 "" UBYTE _CNV_S_6_RANGE_ERR__22_CM 1 100. 0. 15. ECU_ADDRESS 0x3fd518 BIT_MASK 0xF /end MEASUREMENT
/begin MEASUREMENT LV_ERR_MEM_MSW_3 "" UBYTE _CNV_S_2_RANGE______21_R_CM 1 100. 0. 255. ECU_ADDRESS 0x3fd518 BIT_MASK 0x80 /end MEASUREMENT
/begin MEASUREMENT CTR_ABC_END_DIAG_MSW_3 "" UBYTE _CNV_A_R_LINEAR_____12_CM 1 100. 0. 255. ECU_ADDRESS 0x3fd519 FORMAT "%3.0" /end MEASUREMENT
/begin MEASUREMENT CTR_ABC_TOOTH_PER "" UBYTE _CNV_A_R_LINEAR_____10_CM 1 100. 0. 255. ECU_ADDRESS 0x3fd4c2 FORMAT "%3.0" /end MEASUREMENT
/begin MEASUREMENT LV_CDN_DIAG_TOOTH_PER "" UBYTE _CNV_S_2_RANGE______21_R_CM 1 100. 0. 255. ECU_ADDRESS 0x3fd4c0 BIT_MASK 0x10 /end MEASUREMENT
/begin MEASUREMENT LV_END_DIAG_TOOTH_PER "" UBYTE _CNV_S_2_RANGE______21_R_CM 1 100. 0. 255. ECU_ADDRESS 0x3fd4c0 BIT_MASK 0x20 /end MEASUREMENT
/begin MEASUREMENT LV_READY_TOOTH_PER "" UBYTE _CNV_S_2_RANGE______21_R_CM 1 100. 0. 255. ECU_ADDRESS 0x3fd4c0 BIT_MASK 0x40 /end MEASUREMENT
/begin MEASUREMENT ERR_SYM_TOOTH_PER "" UBYTE _CNV_S_6_RANGE_ERR__22_CM 1 100. 0. 15. ECU_ADDRESS 0x3fd4c0 BIT_MASK 0xF /end MEASUREMENT
/begin MEASUREMENT LV_ERR_MEM_TOOTH_PER "" UBYTE _CNV_S_2_RANGE______21_R_CM 1 100. 0. 255. ECU_ADDRESS 0x3fd4c0 BIT_MASK 0x80 /end MEASUREMENT
/begin MEASUREMENT CTR_ABC_END_DIAG_TOOTH_PER "" UBYTE _CNV_A_R_LINEAR_____12_CM 1 100. 0. 255. ECU_ADDRESS 0x3fd4c1 FORMAT "%3.0" /end MEASUREMENT
/begin MEASUREMENT CTR_ABC_SLV_IVVT_IN_1 "" UBYTE _CNV_A_R_LINEAR_____10_CM 1 100. 0. 255. ECU_ADDRESS 0x3fd3de FORMAT "%3.0" /end MEASUREMENT
/begin MEASUREMENT LV_CDN_DIAG_SLV_IVVT_IN_1 "" UBYTE _CNV_S_2_RANGE______21_R_CM 1 100. 0. 255. ECU_ADDRESS 0x3fd3dc BIT_MASK 0x10 /end MEASUREMENT
/begin MEASUREMENT LV_END_DIAG_SLV_IVVT_IN_1 "" UBYTE _CNV_S_2_RANGE______21_R_CM 1 100. 0. 255. ECU_ADDRESS 0x3fd3dc BIT_MASK 0x20 /end MEASUREMENT
/begin MEASUREMENT LV_READY_SLV_IVVT_IN_1 "" UBYTE _CNV_S_2_RANGE______21_R_CM 1 100. 0. 255. ECU_ADDRESS 0x3fd3dc BIT_MASK 0x40 /end MEASUREMENT
/begin MEASUREMENT ERR_SYM_SLV_IVVT_IN_1 "" UBYTE _CNV_S_6_RANGE_ERR__22_CM 1 100. 0. 15. ECU_ADDRESS 0x3fd3dc BIT_MASK 0xF /end MEASUREMENT
/begin MEASUREMENT LV_ERR_MEM_SLV_IVVT_IN_1 "" UBYTE _CNV_S_2_RANGE______21_R_CM 1 100. 0. 255. ECU_ADDRESS 0x3fd3dc BIT_MASK 0x80 /end MEASUREMENT
/begin MEASUREMENT CTR_ABC_END_DIAG_SLV_IVVT_IN_1 "" UBYTE _CNV_A_R_LINEAR_____12_CM 1 100. 0. 255. ECU_ADDRESS 0x3fd3dd FORMAT "%3.0" /end MEASUREMENT
/begin MEASUREMENT CTR_ABC_SLV_IVVT_IN_2 "" UBYTE _CNV_A_R_LINEAR_____10_CM 1 100. 0. 255. ECU_ADDRESS 0x3fd3e2 FORMAT "%3.0" /end MEASUREMENT
/begin MEASUREMENT LV_CDN_DIAG_SLV_IVVT_IN_2 "" UBYTE _CNV_S_2_RANGE______21_R_CM 1 100. 0. 255. ECU_ADDRESS 0x3fd3e0 BIT_MASK 0x10 /end MEASUREMENT
/begin MEASUREMENT LV_END_DIAG_SLV_IVVT_IN_2 "" UBYTE _CNV_S_2_RANGE______21_R_CM 1 100. 0. 255. ECU_ADDRESS 0x3fd3e0 BIT_MASK 0x20 /end MEASUREMENT
/begin MEASUREMENT LV_READY_SLV_IVVT_IN_2 "" UBYTE _CNV_S_2_RANGE______21_R_CM 1 100. 0. 255. ECU_ADDRESS 0x3fd3e0 BIT_MASK 0x40 /end MEASUREMENT
/begin MEASUREMENT ERR_SYM_SLV_IVVT_IN_2 "" UBYTE _CNV_S_6_RANGE_ERR__22_CM 1 100. 0. 15. ECU_ADDRESS 0x3fd3e0 BIT_MASK 0xF /end MEASUREMENT
/begin MEASUREMENT LV_ERR_MEM_SLV_IVVT_IN_2 "" UBYTE _CNV_S_2_RANGE______21_R_CM 1 100. 0. 255. ECU_ADDRESS 0x3fd3e0 BIT_MASK 0x80 /end MEASUREMENT
/begin MEASUREMENT CTR_ABC_END_DIAG_SLV_IVVT_IN_2 "" UBYTE _CNV_A_R_LINEAR_____12_CM 1 100. 0. 255. ECU_ADDRESS 0x3fd3e1 FORMAT "%3.0" /end MEASUREMENT
/begin MEASUREMENT CTR_ABC_DCC_REV "" UBYTE _CNV_A_R_LINEAR_____10_CM 1 100. 0. 255. ECU_ADDRESS 0x3fd616 FORMAT "%3.0" /end MEASUREMENT
/begin MEASUREMENT LV_CDN_DIAG_DCC_REV "" UBYTE _CNV_S_2_RANGE______21_R_CM 1 100. 0. 255. ECU_ADDRESS 0x3fd614 BIT_MASK 0x10 /end MEASUREMENT
/begin MEASUREMENT LV_END_DIAG_DCC_REV "" UBYTE _CNV_S_2_RANGE______21_R_CM 1 100. 0. 255. ECU_ADDRESS 0x3fd614 BIT_MASK 0x20 /end MEASUREMENT
/begin MEASUREMENT LV_READY_DCC_REV "" UBYTE _CNV_S_2_RANGE______21_R_CM 1 100. 0. 255. ECU_ADDRESS 0x3fd614 BIT_MASK 0x40 /end MEASUREMENT
/begin MEASUREMENT ERR_SYM_DCC_REV "" UBYTE _CNV_S_6_RANGE_ERR__22_CM 1 100. 0. 15. ECU_ADDRESS 0x3fd614 BIT_MASK 0xF /end MEASUREMENT
/begin MEASUREMENT LV_ERR_MEM_DCC_REV "" UBYTE _CNV_S_2_RANGE______21_R_CM 1 100. 0. 255. ECU_ADDRESS 0x3fd614 BIT_MASK 0x80 /end MEASUREMENT
/begin MEASUREMENT CTR_ABC_END_DIAG_DCC_REV "" UBYTE _CNV_A_R_LINEAR_____12_CM 1 100. 0. 255. ECU_ADDRESS 0x3fd615 FORMAT "%3.0" /end MEASUREMENT
/begin MEASUREMENT CTR_ABC_IM_BLS_PLAUS "" UBYTE _CNV_A_R_LINEAR_____10_CM 1 100. 0. 255. ECU_ADDRESS 0x3fd50a FORMAT "%3.0" /end MEASUREMENT
/begin MEASUREMENT LV_CDN_DIAG_IM_BLS_PLAUS "" UBYTE _CNV_S_2_RANGE______21_R_CM 1 100. 0. 255. ECU_ADDRESS 0x3fd508 BIT_MASK 0x10 /end MEASUREMENT
/begin MEASUREMENT LV_END_DIAG_IM_BLS_PLAUS "" UBYTE _CNV_S_2_RANGE______21_R_CM 1 100. 0. 255. ECU_ADDRESS 0x3fd508 BIT_MASK 0x20 /end MEASUREMENT
/begin MEASUREMENT LV_READY_IM_BLS_PLAUS "" UBYTE _CNV_S_2_RANGE______21_R_CM 1 100. 0. 255. ECU_ADDRESS 0x3fd508 BIT_MASK 0x40 /end MEASUREMENT
/begin MEASUREMENT ERR_SYM_IM_BLS_PLAUS "" UBYTE _CNV_S_6_RANGE_ERR__22_CM 1 100. 0. 15. ECU_ADDRESS 0x3fd508 BIT_MASK 0xF /end MEASUREMENT
/begin MEASUREMENT LV_ERR_MEM_IM_BLS_PLAUS "" UBYTE _CNV_S_2_RANGE______21_R_CM 1 100. 0. 255. ECU_ADDRESS 0x3fd508 BIT_MASK 0x80 /end MEASUREMENT
/begin MEASUREMENT CTR_ABC_END_DIAG_IM_BLS_PLAUS "" UBYTE _CNV_A_R_LINEAR_____12_CM 1 100. 0. 255. ECU_ADDRESS 0x3fd509 FORMAT "%3.0" /end MEASUREMENT
/begin MEASUREMENT CTR_ABC_DMTL_LEAK "" UBYTE _CNV_A_R_LINEAR_____10_CM 1 100. 0. 255. ECU_ADDRESS 0x3fd5f2 FORMAT "%3.0" /end MEASUREMENT
/begin MEASUREMENT LV_CDN_DIAG_DMTL_LEAK "" UBYTE _CNV_S_2_RANGE______21_R_CM 1 100. 0. 255. ECU_ADDRESS 0x3fd5f0 BIT_MASK 0x10 /end MEASUREMENT
/begin MEASUREMENT LV_END_DIAG_DMTL_LEAK "" UBYTE _CNV_S_2_RANGE______21_R_CM 1 100. 0. 255. ECU_ADDRESS 0x3fd5f0 BIT_MASK 0x20 /end MEASUREMENT
/begin MEASUREMENT LV_READY_DMTL_LEAK "" UBYTE _CNV_S_2_RANGE______21_R_CM 1 100. 0. 255. ECU_ADDRESS 0x3fd5f0 BIT_MASK 0x40 /end MEASUREMENT
/begin MEASUREMENT ERR_SYM_DMTL_LEAK "" UBYTE _CNV_S_6_RANGE_ERR__22_CM 1 100. 0. 15. ECU_ADDRESS 0x3fd5f0 BIT_MASK 0xF /end MEASUREMENT
/begin MEASUREMENT LV_ERR_MEM_DMTL_LEAK "" UBYTE _CNV_S_2_RANGE______21_R_CM 1 100. 0. 255. ECU_ADDRESS 0x3fd5f0 BIT_MASK 0x80 /end MEASUREMENT
/begin MEASUREMENT CTR_ABC_END_DIAG_DMTL_LEAK "" UBYTE _CNV_A_R_LINEAR_____12_CM 1 100. 0. 255. ECU_ADDRESS 0x3fd5f1 FORMAT "%3.0" /end MEASUREMENT
/begin MEASUREMENT CTR_ABC_ECRAS "" UBYTE _CNV_A_R_LINEAR_____10_CM 1 100. 0. 255. ECU_ADDRESS 0x3fd61e FORMAT "%3.0" /end MEASUREMENT
/begin MEASUREMENT LV_CDN_DIAG_ECRAS "" UBYTE _CNV_S_2_RANGE______21_R_CM 1 100. 0. 255. ECU_ADDRESS 0x3fd61c BIT_MASK 0x10 /end MEASUREMENT
/begin MEASUREMENT LV_END_DIAG_ECRAS "" UBYTE _CNV_S_2_RANGE______21_R_CM 1 100. 0. 255. ECU_ADDRESS 0x3fd61c BIT_MASK 0x20 /end MEASUREMENT
/begin MEASUREMENT LV_READY_ECRAS "" UBYTE _CNV_S_2_RANGE______21_R_CM 1 100. 0. 255. ECU_ADDRESS 0x3fd61c BIT_MASK 0x40 /end MEASUREMENT
/begin MEASUREMENT ERR_SYM_ECRAS "" UBYTE _CNV_S_6_RANGE_ERR__22_CM 1 100. 0. 15. ECU_ADDRESS 0x3fd61c BIT_MASK 0xF /end MEASUREMENT
/begin MEASUREMENT LV_ERR_MEM_ECRAS "" UBYTE _CNV_S_2_RANGE______21_R_CM 1 100. 0. 255. ECU_ADDRESS 0x3fd61c BIT_MASK 0x80 /end MEASUREMENT
/begin MEASUREMENT CTR_ABC_END_DIAG_ECRAS "" UBYTE _CNV_A_R_LINEAR_____12_CM 1 100. 0. 255. ECU_ADDRESS 0x3fd61d FORMAT "%3.0" /end MEASUREMENT
/begin MEASUREMENT CTR_ABC_EBOX_CFA "" UBYTE _CNV_A_R_LINEAR_____10_CM 1 100. 0. 255. ECU_ADDRESS 0x3fd5c6 FORMAT "%3.0" /end MEASUREMENT
/begin MEASUREMENT LV_CDN_DIAG_EBOX_CFA "" UBYTE _CNV_S_2_RANGE______21_R_CM 1 100. 0. 255. ECU_ADDRESS 0x3fd5c4 BIT_MASK 0x10 /end MEASUREMENT
/begin MEASUREMENT LV_END_DIAG_EBOX_CFA "" UBYTE _CNV_S_2_RANGE______21_R_CM 1 100. 0. 255. ECU_ADDRESS 0x3fd5c4 BIT_MASK 0x20 /end MEASUREMENT
/begin MEASUREMENT LV_READY_EBOX_CFA "" UBYTE _CNV_S_2_RANGE______21_R_CM 1 100. 0. 255. ECU_ADDRESS 0x3fd5c4 BIT_MASK 0x40 /end MEASUREMENT
/begin MEASUREMENT ERR_SYM_EBOX_CFA "" UBYTE _CNV_S_6_RANGE_ERR__22_CM 1 100. 0. 15. ECU_ADDRESS 0x3fd5c4 BIT_MASK 0xF /end MEASUREMENT
/begin MEASUREMENT LV_ERR_MEM_EBOX_CFA "" UBYTE _CNV_S_2_RANGE______21_R_CM 1 100. 0. 255. ECU_ADDRESS 0x3fd5c4 BIT_MASK 0x80 /end MEASUREMENT
/begin MEASUREMENT CTR_ABC_END_DIAG_EBOX_CFA "" UBYTE _CNV_A_R_LINEAR_____12_CM 1 100. 0. 255. ECU_ADDRESS 0x3fd5c5 FORMAT "%3.0" /end MEASUREMENT
/begin MEASUREMENT CTR_ABC_CAT_DIAG_1 "" UBYTE _CNV_A_R_LINEAR_____10_CM 1 100. 0. 255. ECU_ADDRESS 0x3fd5a6 FORMAT "%3.0" /end MEASUREMENT
/begin MEASUREMENT LV_CDN_DIAG_CAT_DIAG_1 "" UBYTE _CNV_S_2_RANGE______21_R_CM 1 100. 0. 255. ECU_ADDRESS 0x3fd5a4 BIT_MASK 0x10 /end MEASUREMENT
/begin MEASUREMENT LV_END_DIAG_CAT_DIAG_1 "" UBYTE _CNV_S_2_RANGE______21_R_CM 1 100. 0. 255. ECU_ADDRESS 0x3fd5a4 BIT_MASK 0x20 /end MEASUREMENT
/begin MEASUREMENT LV_READY_CAT_DIAG_1 "" UBYTE _CNV_S_2_RANGE______21_R_CM 1 100. 0. 255. ECU_ADDRESS 0x3fd5a4 BIT_MASK 0x40 /end MEASUREMENT
/begin MEASUREMENT ERR_SYM_CAT_DIAG_1 "" UBYTE _CNV_S_6_RANGE_ERR__22_CM 1 100. 0. 15. ECU_ADDRESS 0x3fd5a4 BIT_MASK 0xF /end MEASUREMENT
/begin MEASUREMENT LV_ERR_MEM_CAT_DIAG_1 "" UBYTE _CNV_S_2_RANGE______21_R_CM 1 100. 0. 255. ECU_ADDRESS 0x3fd5a4 BIT_MASK 0x80 /end MEASUREMENT
/begin MEASUREMENT CTR_ABC_END_DIAG_CAT_DIAG_1 "" UBYTE _CNV_A_R_LINEAR_____12_CM 1 100. 0. 255. ECU_ADDRESS 0x3fd5a5 FORMAT "%3.0" /end MEASUREMENT
/begin MEASUREMENT CTR_ABC_CAT_DIAG_2 "" UBYTE _CNV_A_R_LINEAR_____10_CM 1 100. 0. 255. ECU_ADDRESS 0x3fd5aa FORMAT "%3.0" /end MEASUREMENT
/begin MEASUREMENT LV_CDN_DIAG_CAT_DIAG_2 "" UBYTE _CNV_S_2_RANGE______21_R_CM 1 100. 0. 255. ECU_ADDRESS 0x3fd5a8 BIT_MASK 0x10 /end MEASUREMENT
/begin MEASUREMENT LV_END_DIAG_CAT_DIAG_2 "" UBYTE _CNV_S_2_RANGE______21_R_CM 1 100. 0. 255. ECU_ADDRESS 0x3fd5a8 BIT_MASK 0x20 /end MEASUREMENT
/begin MEASUREMENT LV_READY_CAT_DIAG_2 "" UBYTE _CNV_S_2_RANGE______21_R_CM 1 100. 0. 255. ECU_ADDRESS 0x3fd5a8 BIT_MASK 0x40 /end MEASUREMENT
/begin MEASUREMENT ERR_SYM_CAT_DIAG_2 "" UBYTE _CNV_S_6_RANGE_ERR__22_CM 1 100. 0. 15. ECU_ADDRESS 0x3fd5a8 BIT_MASK 0xF /end MEASUREMENT
/begin MEASUREMENT LV_ERR_MEM_CAT_DIAG_2 "" UBYTE _CNV_S_2_RANGE______21_R_CM 1 100. 0. 255. ECU_ADDRESS 0x3fd5a8 BIT_MASK 0x80 /end MEASUREMENT
/begin MEASUREMENT CTR_ABC_END_DIAG_CAT_DIAG_2 "" UBYTE _CNV_A_R_LINEAR_____12_CM 1 100. 0. 255. ECU_ADDRESS 0x3fd5a9 FORMAT "%3.0" /end MEASUREMENT
/begin MEASUREMENT CTR_ABC_KNKS_1 "" UBYTE _CNV_A_R_LINEAR_____10_CM 1 100. 0. 255. ECU_ADDRESS 0x3fd41a FORMAT "%3.0" /end MEASUREMENT
/begin MEASUREMENT LV_CDN_DIAG_KNKS_1 "" UBYTE _CNV_S_2_RANGE______21_R_CM 1 100. 0. 255. ECU_ADDRESS 0x3fd418 BIT_MASK 0x10 /end MEASUREMENT
/begin MEASUREMENT LV_END_DIAG_KNKS_1 "" UBYTE _CNV_S_2_RANGE______21_R_CM 1 100. 0. 255. ECU_ADDRESS 0x3fd418 BIT_MASK 0x20 /end MEASUREMENT
/begin MEASUREMENT LV_READY_KNKS_1 "" UBYTE _CNV_S_2_RANGE______21_R_CM 1 100. 0. 255. ECU_ADDRESS 0x3fd418 BIT_MASK 0x40 /end MEASUREMENT
/begin MEASUREMENT ERR_SYM_KNKS_1 "" UBYTE _CNV_S_6_RANGE_ERR__22_CM 1 100. 0. 15. ECU_ADDRESS 0x3fd418 BIT_MASK 0xF /end MEASUREMENT
/begin MEASUREMENT LV_ERR_MEM_KNKS_1 "" UBYTE _CNV_S_2_RANGE______21_R_CM 1 100. 0. 255. ECU_ADDRESS 0x3fd418 BIT_MASK 0x80 /end MEASUREMENT
/begin MEASUREMENT CTR_ABC_END_DIAG_KNKS_1 "" UBYTE _CNV_A_R_LINEAR_____12_CM 1 100. 0. 255. ECU_ADDRESS 0x3fd419 FORMAT "%3.0" /end MEASUREMENT
/begin MEASUREMENT CTR_ABC_KNKS_2 "" UBYTE _CNV_A_R_LINEAR_____10_CM 1 100. 0. 255. ECU_ADDRESS 0x3fd41e FORMAT "%3.0" /end MEASUREMENT
/begin MEASUREMENT LV_CDN_DIAG_KNKS_2 "" UBYTE _CNV_S_2_RANGE______21_R_CM 1 100. 0. 255. ECU_ADDRESS 0x3fd41c BIT_MASK 0x10 /end MEASUREMENT
/begin MEASUREMENT LV_END_DIAG_KNKS_2 "" UBYTE _CNV_S_2_RANGE______21_R_CM 1 100. 0. 255. ECU_ADDRESS 0x3fd41c BIT_MASK 0x20 /end MEASUREMENT
/begin MEASUREMENT LV_READY_KNKS_2 "" UBYTE _CNV_S_2_RANGE______21_R_CM 1 100. 0. 255. ECU_ADDRESS 0x3fd41c BIT_MASK 0x40 /end MEASUREMENT
/begin MEASUREMENT ERR_SYM_KNKS_2 "" UBYTE _CNV_S_6_RANGE_ERR__22_CM 1 100. 0. 15. ECU_ADDRESS 0x3fd41c BIT_MASK 0xF /end MEASUREMENT
/begin MEASUREMENT LV_ERR_MEM_KNKS_2 "" UBYTE _CNV_S_2_RANGE______21_R_CM 1 100. 0. 255. ECU_ADDRESS 0x3fd41c BIT_MASK 0x80 /end MEASUREMENT
/begin MEASUREMENT CTR_ABC_END_DIAG_KNKS_2 "" UBYTE _CNV_A_R_LINEAR_____12_CM 1 100. 0. 255. ECU_ADDRESS 0x3fd41d FORMAT "%3.0" /end MEASUREMENT
/begin MEASUREMENT CTR_ABC_VLS_UP_MIN_1 "" UBYTE _CNV_A_R_LINEAR_____10_CM 1 100. 0. 255. ECU_ADDRESS 0x3fd6ae FORMAT "%3.0" /end MEASUREMENT
/begin MEASUREMENT LV_CDN_DIAG_VLS_UP_MIN_1 "" UBYTE _CNV_S_2_RANGE______21_R_CM 1 100. 0. 255. ECU_ADDRESS 0x3fd6ac BIT_MASK 0x10 /end MEASUREMENT
/begin MEASUREMENT LV_END_DIAG_VLS_UP_MIN_1 "" UBYTE _CNV_S_2_RANGE______21_R_CM 1 100. 0. 255. ECU_ADDRESS 0x3fd6ac BIT_MASK 0x20 /end MEASUREMENT
/begin MEASUREMENT LV_READY_VLS_UP_MIN_1 "" UBYTE _CNV_S_2_RANGE______21_R_CM 1 100. 0. 255. ECU_ADDRESS 0x3fd6ac BIT_MASK 0x40 /end MEASUREMENT
/begin MEASUREMENT ERR_SYM_VLS_UP_MIN_1 "" UBYTE _CNV_S_6_RANGE_ERR__22_CM 1 100. 0. 15. ECU_ADDRESS 0x3fd6ac BIT_MASK 0xF /end MEASUREMENT
/begin MEASUREMENT LV_ERR_MEM_VLS_UP_MIN_1 "" UBYTE _CNV_S_2_RANGE______21_R_CM 1 100. 0. 255. ECU_ADDRESS 0x3fd6ac BIT_MASK 0x80 /end MEASUREMENT
/begin MEASUREMENT CTR_ABC_END_DIAG_VLS_UP_MIN_1 "" UBYTE _CNV_A_R_LINEAR_____12_CM 1 100. 0. 255. ECU_ADDRESS 0x3fd6ad FORMAT "%3.0" /end MEASUREMENT
/begin MEASUREMENT CTR_ABC_VLS_UP_MIN_2 "" UBYTE _CNV_A_R_LINEAR_____10_CM 1 100. 0. 255. ECU_ADDRESS 0x3fd6b2 FORMAT "%3.0" /end MEASUREMENT
/begin MEASUREMENT LV_CDN_DIAG_VLS_UP_MIN_2 "" UBYTE _CNV_S_2_RANGE______21_R_CM 1 100. 0. 255. ECU_ADDRESS 0x3fd6b0 BIT_MASK 0x10 /end MEASUREMENT
/begin MEASUREMENT LV_END_DIAG_VLS_UP_MIN_2 "" UBYTE _CNV_S_2_RANGE______21_R_CM 1 100. 0. 255. ECU_ADDRESS 0x3fd6b0 BIT_MASK 0x20 /end MEASUREMENT
/begin MEASUREMENT LV_READY_VLS_UP_MIN_2 "" UBYTE _CNV_S_2_RANGE______21_R_CM 1 100. 0. 255. ECU_ADDRESS 0x3fd6b0 BIT_MASK 0x40 /end MEASUREMENT
/begin MEASUREMENT ERR_SYM_VLS_UP_MIN_2 "" UBYTE _CNV_S_6_RANGE_ERR__22_CM 1 100. 0. 15. ECU_ADDRESS 0x3fd6b0 BIT_MASK 0xF /end MEASUREMENT
/begin MEASUREMENT LV_ERR_MEM_VLS_UP_MIN_2 "" UBYTE _CNV_S_2_RANGE______21_R_CM 1 100. 0. 255. ECU_ADDRESS 0x3fd6b0 BIT_MASK 0x80 /end MEASUREMENT
/begin MEASUREMENT CTR_ABC_END_DIAG_VLS_UP_MIN_2 "" UBYTE _CNV_A_R_LINEAR_____12_CM 1 100. 0. 255. ECU_ADDRESS 0x3fd6b1 FORMAT "%3.0" /end MEASUREMENT
/begin MEASUREMENT CTR_ABC_TPS_ST_CHK_1 "" UBYTE _CNV_A_R_LINEAR_____10_CM 1 100. 0. 255. ECU_ADDRESS 0x3fd492 FORMAT "%3.0" /end MEASUREMENT
/begin MEASUREMENT LV_CDN_DIAG_TPS_ST_CHK_1 "" UBYTE _CNV_S_2_RANGE______21_R_CM 1 100. 0. 255. ECU_ADDRESS 0x3fd490 BIT_MASK 0x10 /end MEASUREMENT
/begin MEASUREMENT LV_END_DIAG_TPS_ST_CHK_1 "" UBYTE _CNV_S_2_RANGE______21_R_CM 1 100. 0. 255. ECU_ADDRESS 0x3fd490 BIT_MASK 0x20 /end MEASUREMENT
/begin MEASUREMENT LV_READY_TPS_ST_CHK_1 "" UBYTE _CNV_S_2_RANGE______21_R_CM 1 100. 0. 255. ECU_ADDRESS 0x3fd490 BIT_MASK 0x40 /end MEASUREMENT
/begin MEASUREMENT ERR_SYM_TPS_ST_CHK_1 "" UBYTE _CNV_S_6_RANGE_ERR__22_CM 1 100. 0. 15. ECU_ADDRESS 0x3fd490 BIT_MASK 0xF /end MEASUREMENT
/begin MEASUREMENT LV_ERR_MEM_TPS_ST_CHK_1 "" UBYTE _CNV_S_2_RANGE______21_R_CM 1 100. 0. 255. ECU_ADDRESS 0x3fd490 BIT_MASK 0x80 /end MEASUREMENT
/begin MEASUREMENT CTR_ABC_END_DIAG_TPS_ST_CHK_1 "" UBYTE _CNV_A_R_LINEAR_____12_CM 1 100. 0. 255. ECU_ADDRESS 0x3fd491 FORMAT "%3.0" /end MEASUREMENT
/begin MEASUREMENT CTR_ABC_TPS_ST_CHK_2 "" UBYTE _CNV_A_R_LINEAR_____10_CM 1 100. 0. 255. ECU_ADDRESS 0x3fd496 FORMAT "%3.0" /end MEASUREMENT
/begin MEASUREMENT LV_CDN_DIAG_TPS_ST_CHK_2 "" UBYTE _CNV_S_2_RANGE______21_R_CM 1 100. 0. 255. ECU_ADDRESS 0x3fd494 BIT_MASK 0x10 /end MEASUREMENT
/begin MEASUREMENT LV_END_DIAG_TPS_ST_CHK_2 "" UBYTE _CNV_S_2_RANGE______21_R_CM 1 100. 0. 255. ECU_ADDRESS 0x3fd494 BIT_MASK 0x20 /end MEASUREMENT
/begin MEASUREMENT LV_READY_TPS_ST_CHK_2 "" UBYTE _CNV_S_2_RANGE______21_R_CM 1 100. 0. 255. ECU_ADDRESS 0x3fd494 BIT_MASK 0x40 /end MEASUREMENT
/begin MEASUREMENT ERR_SYM_TPS_ST_CHK_2 "" UBYTE _CNV_S_6_RANGE_ERR__22_CM 1 100. 0. 15. ECU_ADDRESS 0x3fd494 BIT_MASK 0xF /end MEASUREMENT
/begin MEASUREMENT LV_ERR_MEM_TPS_ST_CHK_2 "" UBYTE _CNV_S_2_RANGE______21_R_CM 1 100. 0. 255. ECU_ADDRESS 0x3fd494 BIT_MASK 0x80 /end MEASUREMENT
/begin MEASUREMENT CTR_ABC_END_DIAG_TPS_ST_CHK_2 "" UBYTE _CNV_A_R_LINEAR_____12_CM 1 100. 0. 255. ECU_ADDRESS 0x3fd495 FORMAT "%3.0" /end MEASUREMENT
/begin MEASUREMENT CTR_ABC_BN_CAS "" UBYTE _CNV_A_R_LINEAR_____10_CM 1 100. 0. 255. ECU_ADDRESS 0x3fd62e FORMAT "%3.0" /end MEASUREMENT
/begin MEASUREMENT LV_CDN_DIAG_BN_CAS "" UBYTE _CNV_S_2_RANGE______21_R_CM 1 100. 0. 255. ECU_ADDRESS 0x3fd62c BIT_MASK 0x10 /end MEASUREMENT
/begin MEASUREMENT LV_END_DIAG_BN_CAS "" UBYTE _CNV_S_2_RANGE______21_R_CM 1 100. 0. 255. ECU_ADDRESS 0x3fd62c BIT_MASK 0x20 /end MEASUREMENT
/begin MEASUREMENT LV_READY_BN_CAS "" UBYTE _CNV_S_2_RANGE______21_R_CM 1 100. 0. 255. ECU_ADDRESS 0x3fd62c BIT_MASK 0x40 /end MEASUREMENT
/begin MEASUREMENT ERR_SYM_BN_CAS "" UBYTE _CNV_S_6_RANGE_ERR__22_CM 1 100. 0. 15. ECU_ADDRESS 0x3fd62c BIT_MASK 0xF /end MEASUREMENT
/begin MEASUREMENT LV_ERR_MEM_BN_CAS "" UBYTE _CNV_S_2_RANGE______21_R_CM 1 100. 0. 255. ECU_ADDRESS 0x3fd62c BIT_MASK 0x80 /end MEASUREMENT
/begin MEASUREMENT CTR_ABC_END_DIAG_BN_CAS "" UBYTE _CNV_A_R_LINEAR_____12_CM 1 100. 0. 255. ECU_ADDRESS 0x3fd62d FORMAT "%3.0" /end MEASUREMENT
/begin MEASUREMENT CTR_ABC_VLS_DOWN_MIN_1 "" UBYTE _CNV_A_R_LINEAR_____10_CM 1 100. 0. 255. ECU_ADDRESS 0x3fd376 FORMAT "%3.0" /end MEASUREMENT
/begin MEASUREMENT LV_CDN_DIAG_VLS_DOWN_MIN_1 "" UBYTE _CNV_S_2_RANGE______21_R_CM 1 100. 0. 255. ECU_ADDRESS 0x3fd374 BIT_MASK 0x10 /end MEASUREMENT
/begin MEASUREMENT LV_END_DIAG_VLS_DOWN_MIN_1 "" UBYTE _CNV_S_2_RANGE______21_R_CM 1 100. 0. 255. ECU_ADDRESS 0x3fd374 BIT_MASK 0x20 /end MEASUREMENT
/begin MEASUREMENT LV_READY_VLS_DOWN_MIN_1 "" UBYTE _CNV_S_2_RANGE______21_R_CM 1 100. 0. 255. ECU_ADDRESS 0x3fd374 BIT_MASK 0x40 /end MEASUREMENT
/begin MEASUREMENT ERR_SYM_VLS_DOWN_MIN_1 "" UBYTE _CNV_S_6_RANGE_ERR__22_CM 1 100. 0. 15. ECU_ADDRESS 0x3fd374 BIT_MASK 0xF /end MEASUREMENT
/begin MEASUREMENT LV_ERR_MEM_VLS_DOWN_MIN_1 "" UBYTE _CNV_S_2_RANGE______21_R_CM 1 100. 0. 255. ECU_ADDRESS 0x3fd374 BIT_MASK 0x80 /end MEASUREMENT
/begin MEASUREMENT CTR_ABC_END_DIAG_VLS_DOWN_MIN_1 "" UBYTE _CNV_A_R_LINEAR_____12_CM 1 100. 0. 255. ECU_ADDRESS 0x3fd375 FORMAT "%3.0" /end MEASUREMENT
/begin MEASUREMENT CTR_ABC_VLS_DOWN_MIN_2 "" UBYTE _CNV_A_R_LINEAR_____10_CM 1 100. 0. 255. ECU_ADDRESS 0x3fd37a FORMAT "%3.0" /end MEASUREMENT
/begin MEASUREMENT LV_CDN_DIAG_VLS_DOWN_MIN_2 "" UBYTE _CNV_S_2_RANGE______21_R_CM 1 100. 0. 255. ECU_ADDRESS 0x3fd378 BIT_MASK 0x10 /end MEASUREMENT
/begin MEASUREMENT LV_END_DIAG_VLS_DOWN_MIN_2 "" UBYTE _CNV_S_2_RANGE______21_R_CM 1 100. 0. 255. ECU_ADDRESS 0x3fd378 BIT_MASK 0x20 /end MEASUREMENT
/begin MEASUREMENT LV_READY_VLS_DOWN_MIN_2 "" UBYTE _CNV_S_2_RANGE______21_R_CM 1 100. 0. 255. ECU_ADDRESS 0x3fd378 BIT_MASK 0x40 /end MEASUREMENT
/begin MEASUREMENT ERR_SYM_VLS_DOWN_MIN_2 "" UBYTE _CNV_S_6_RANGE_ERR__22_CM 1 100. 0. 15. ECU_ADDRESS 0x3fd378 BIT_MASK 0xF /end MEASUREMENT
/begin MEASUREMENT LV_ERR_MEM_VLS_DOWN_MIN_2 "" UBYTE _CNV_S_2_RANGE______21_R_CM 1 100. 0. 255. ECU_ADDRESS 0x3fd378 BIT_MASK 0x80 /end MEASUREMENT
/begin MEASUREMENT CTR_ABC_END_DIAG_VLS_DOWN_MIN_2 "" UBYTE _CNV_A_R_LINEAR_____12_CM 1 100. 0. 255. ECU_ADDRESS 0x3fd379 FORMAT "%3.0" /end MEASUREMENT
/begin MEASUREMENT CTR_ABC_IM_BTS_PLAUS "" UBYTE _CNV_A_R_LINEAR_____10_CM 1 100. 0. 255. ECU_ADDRESS 0x3fd50e FORMAT "%3.0" /end MEASUREMENT
/begin MEASUREMENT LV_CDN_DIAG_IM_BTS_PLAUS "" UBYTE _CNV_S_2_RANGE______21_R_CM 1 100. 0. 255. ECU_ADDRESS 0x3fd50c BIT_MASK 0x10 /end MEASUREMENT
/begin MEASUREMENT LV_END_DIAG_IM_BTS_PLAUS "" UBYTE _CNV_S_2_RANGE______21_R_CM 1 100. 0. 255. ECU_ADDRESS 0x3fd50c BIT_MASK 0x20 /end MEASUREMENT
/begin MEASUREMENT LV_READY_IM_BTS_PLAUS "" UBYTE _CNV_S_2_RANGE______21_R_CM 1 100. 0. 255. ECU_ADDRESS 0x3fd50c BIT_MASK 0x40 /end MEASUREMENT
/begin MEASUREMENT ERR_SYM_IM_BTS_PLAUS "" UBYTE _CNV_S_6_RANGE_ERR__22_CM 1 100. 0. 15. ECU_ADDRESS 0x3fd50c BIT_MASK 0xF /end MEASUREMENT
/begin MEASUREMENT LV_ERR_MEM_IM_BTS_PLAUS "" UBYTE _CNV_S_2_RANGE______21_R_CM 1 100. 0. 255. ECU_ADDRESS 0x3fd50c BIT_MASK 0x80 /end MEASUREMENT
/begin MEASUREMENT CTR_ABC_END_DIAG_IM_BTS_PLAUS "" UBYTE _CNV_A_R_LINEAR_____12_CM 1 100. 0. 255. ECU_ADDRESS 0x3fd50d FORMAT "%3.0" /end MEASUREMENT
/begin MEASUREMENT CTR_ABC_LS_UP_FRQ_1 "" UBYTE _CNV_A_R_LINEAR_____10_CM 1 100. 0. 255. ECU_ADDRESS 0x3fd6e6 FORMAT "%3.0" /end MEASUREMENT
/begin MEASUREMENT LV_CDN_DIAG_LS_UP_FRQ_1 "" UBYTE _CNV_S_2_RANGE______21_R_CM 1 100. 0. 255. ECU_ADDRESS 0x3fd6e4 BIT_MASK 0x10 /end MEASUREMENT
/begin MEASUREMENT LV_END_DIAG_LS_UP_FRQ_1 "" UBYTE _CNV_S_2_RANGE______21_R_CM 1 100. 0. 255. ECU_ADDRESS 0x3fd6e4 BIT_MASK 0x20 /end MEASUREMENT
/begin MEASUREMENT LV_READY_LS_UP_FRQ_1 "" UBYTE _CNV_S_2_RANGE______21_R_CM 1 100. 0. 255. ECU_ADDRESS 0x3fd6e4 BIT_MASK 0x40 /end MEASUREMENT
/begin MEASUREMENT ERR_SYM_LS_UP_FRQ_1 "" UBYTE _CNV_S_6_RANGE_ERR__22_CM 1 100. 0. 15. ECU_ADDRESS 0x3fd6e4 BIT_MASK 0xF /end MEASUREMENT
/begin MEASUREMENT LV_ERR_MEM_LS_UP_FRQ_1 "" UBYTE _CNV_S_2_RANGE______21_R_CM 1 100. 0. 255. ECU_ADDRESS 0x3fd6e4 BIT_MASK 0x80 /end MEASUREMENT
/begin MEASUREMENT CTR_ABC_END_DIAG_LS_UP_FRQ_1 "" UBYTE _CNV_A_R_LINEAR_____12_CM 1 100. 0. 255. ECU_ADDRESS 0x3fd6e5 FORMAT "%3.0" /end MEASUREMENT
/begin MEASUREMENT CTR_ABC_LS_UP_FRQ_2 "" UBYTE _CNV_A_R_LINEAR_____10_CM 1 100. 0. 255. ECU_ADDRESS 0x3fd6ea FORMAT "%3.0" /end MEASUREMENT
/begin MEASUREMENT LV_CDN_DIAG_LS_UP_FRQ_2 "" UBYTE _CNV_S_2_RANGE______21_R_CM 1 100. 0. 255. ECU_ADDRESS 0x3fd6e8 BIT_MASK 0x10 /end MEASUREMENT
/begin MEASUREMENT LV_END_DIAG_LS_UP_FRQ_2 "" UBYTE _CNV_S_2_RANGE______21_R_CM 1 100. 0. 255. ECU_ADDRESS 0x3fd6e8 BIT_MASK 0x20 /end MEASUREMENT
/begin MEASUREMENT LV_READY_LS_UP_FRQ_2 "" UBYTE _CNV_S_2_RANGE______21_R_CM 1 100. 0. 255. ECU_ADDRESS 0x3fd6e8 BIT_MASK 0x40 /end MEASUREMENT
/begin MEASUREMENT ERR_SYM_LS_UP_FRQ_2 "" UBYTE _CNV_S_6_RANGE_ERR__22_CM 1 100. 0. 15. ECU_ADDRESS 0x3fd6e8 BIT_MASK 0xF /end MEASUREMENT
/begin MEASUREMENT LV_ERR_MEM_LS_UP_FRQ_2 "" UBYTE _CNV_S_2_RANGE______21_R_CM 1 100. 0. 255. ECU_ADDRESS 0x3fd6e8 BIT_MASK 0x80 /end MEASUREMENT
/begin MEASUREMENT CTR_ABC_END_DIAG_LS_UP_FRQ_2 "" UBYTE _CNV_A_R_LINEAR_____12_CM 1 100. 0. 255. ECU_ADDRESS 0x3fd6e9 FORMAT "%3.0" /end MEASUREMENT
/begin MEASUREMENT CTR_ABC_MEC_IVVT_EX_1 "" UBYTE _CNV_A_R_LINEAR_____10_CM 1 100. 0. 255. ECU_ADDRESS 0x3fd3c6 FORMAT "%3.0" /end MEASUREMENT
/begin MEASUREMENT LV_CDN_DIAG_MEC_IVVT_EX_1 "" UBYTE _CNV_S_2_RANGE______21_R_CM 1 100. 0. 255. ECU_ADDRESS 0x3fd3c4 BIT_MASK 0x10 /end MEASUREMENT
/begin MEASUREMENT LV_END_DIAG_MEC_IVVT_EX_1 "" UBYTE _CNV_S_2_RANGE______21_R_CM 1 100. 0. 255. ECU_ADDRESS 0x3fd3c4 BIT_MASK 0x20 /end MEASUREMENT
/begin MEASUREMENT LV_READY_MEC_IVVT_EX_1 "" UBYTE _CNV_S_2_RANGE______21_R_CM 1 100. 0. 255. ECU_ADDRESS 0x3fd3c4 BIT_MASK 0x40 /end MEASUREMENT
/begin MEASUREMENT ERR_SYM_MEC_IVVT_EX_1 "" UBYTE _CNV_S_6_RANGE_ERR__22_CM 1 100. 0. 15. ECU_ADDRESS 0x3fd3c4 BIT_MASK 0xF /end MEASUREMENT
/begin MEASUREMENT LV_ERR_MEM_MEC_IVVT_EX_1 "" UBYTE _CNV_S_2_RANGE______21_R_CM 1 100. 0. 255. ECU_ADDRESS 0x3fd3c4 BIT_MASK 0x80 /end MEASUREMENT
/begin MEASUREMENT CTR_ABC_END_DIAG_MEC_IVVT_EX_1 "" UBYTE _CNV_A_R_LINEAR_____12_CM 1 100. 0. 255. ECU_ADDRESS 0x3fd3c5 FORMAT "%3.0" /end MEASUREMENT
/begin MEASUREMENT CTR_ABC_MEC_IVVT_EX_2 "" UBYTE _CNV_A_R_LINEAR_____10_CM 1 100. 0. 255. ECU_ADDRESS 0x3fd3ca FORMAT "%3.0" /end MEASUREMENT
/begin MEASUREMENT LV_CDN_DIAG_MEC_IVVT_EX_2 "" UBYTE _CNV_S_2_RANGE______21_R_CM 1 100. 0. 255. ECU_ADDRESS 0x3fd3c8 BIT_MASK 0x10 /end MEASUREMENT
/begin MEASUREMENT LV_END_DIAG_MEC_IVVT_EX_2 "" UBYTE _CNV_S_2_RANGE______21_R_CM 1 100. 0. 255. ECU_ADDRESS 0x3fd3c8 BIT_MASK 0x20 /end MEASUREMENT
/begin MEASUREMENT LV_READY_MEC_IVVT_EX_2 "" UBYTE _CNV_S_2_RANGE______21_R_CM 1 100. 0. 255. ECU_ADDRESS 0x3fd3c8 BIT_MASK 0x40 /end MEASUREMENT
/begin MEASUREMENT ERR_SYM_MEC_IVVT_EX_2 "" UBYTE _CNV_S_6_RANGE_ERR__22_CM 1 100. 0. 15. ECU_ADDRESS 0x3fd3c8 BIT_MASK 0xF /end MEASUREMENT
/begin MEASUREMENT LV_ERR_MEM_MEC_IVVT_EX_2 "" UBYTE _CNV_S_2_RANGE______21_R_CM 1 100. 0. 255. ECU_ADDRESS 0x3fd3c8 BIT_MASK 0x80 /end MEASUREMENT
/begin MEASUREMENT CTR_ABC_END_DIAG_MEC_IVVT_EX_2 "" UBYTE _CNV_A_R_LINEAR_____12_CM 1 100. 0. 255. ECU_ADDRESS 0x3fd3c9 FORMAT "%3.0" /end MEASUREMENT
/begin MEASUREMENT CTR_ABC_CAM_1_NOT_PLAUS "" UBYTE _CNV_A_R_LINEAR_____10_CM 1 100. 0. 255. ECU_ADDRESS 0x3fd4ba FORMAT "%3.0" /end MEASUREMENT
/begin MEASUREMENT LV_CDN_DIAG_CAM_1_NOT_PLAUS "" UBYTE _CNV_S_2_RANGE______21_R_CM 1 100. 0. 255. ECU_ADDRESS 0x3fd4b8 BIT_MASK 0x10 /end MEASUREMENT
/begin MEASUREMENT LV_END_DIAG_CAM_1_NOT_PLAUS "" UBYTE _CNV_S_2_RANGE______21_R_CM 1 100. 0. 255. ECU_ADDRESS 0x3fd4b8 BIT_MASK 0x20 /end MEASUREMENT
/begin MEASUREMENT LV_READY_CAM_1_NOT_PLAUS "" UBYTE _CNV_S_2_RANGE______21_R_CM 1 100. 0. 255. ECU_ADDRESS 0x3fd4b8 BIT_MASK 0x40 /end MEASUREMENT
/begin MEASUREMENT ERR_SYM_CAM_1_NOT_PLAUS "" UBYTE _CNV_S_6_RANGE_ERR__22_CM 1 100. 0. 15. ECU_ADDRESS 0x3fd4b8 BIT_MASK 0xF /end MEASUREMENT
/begin MEASUREMENT LV_ERR_MEM_CAM_1_NOT_PLAUS "" UBYTE _CNV_S_2_RANGE______21_R_CM 1 100. 0. 255. ECU_ADDRESS 0x3fd4b8 BIT_MASK 0x80 /end MEASUREMENT
/begin MEASUREMENT CTR_ABC_END_DIAG_CAM_1_NOT_PLAUS "" UBYTE _CNV_A_R_LINEAR_____12_CM 1 100. 0. 255. ECU_ADDRESS 0x3fd4b9 FORMAT "%3.0" /end MEASUREMENT
/begin MEASUREMENT CTR_ABC_PVS_DOUBLE "" UBYTE _CNV_A_R_LINEAR_____10_CM 1 100. 0. 255. ECU_ADDRESS 0x3fd476 FORMAT "%3.0" /end MEASUREMENT
/begin MEASUREMENT LV_CDN_DIAG_PVS_DOUBLE "" UBYTE _CNV_S_2_RANGE______21_R_CM 1 100. 0. 255. ECU_ADDRESS 0x3fd474 BIT_MASK 0x10 /end MEASUREMENT
/begin MEASUREMENT LV_END_DIAG_PVS_DOUBLE "" UBYTE _CNV_S_2_RANGE______21_R_CM 1 100. 0. 255. ECU_ADDRESS 0x3fd474 BIT_MASK 0x20 /end MEASUREMENT
/begin MEASUREMENT LV_READY_PVS_DOUBLE "" UBYTE _CNV_S_2_RANGE______21_R_CM 1 100. 0. 255. ECU_ADDRESS 0x3fd474 BIT_MASK 0x40 /end MEASUREMENT
/begin MEASUREMENT ERR_SYM_PVS_DOUBLE "" UBYTE _CNV_S_6_RANGE_ERR__22_CM 1 100. 0. 15. ECU_ADDRESS 0x3fd474 BIT_MASK 0xF /end MEASUREMENT
/begin MEASUREMENT LV_ERR_MEM_PVS_DOUBLE "" UBYTE _CNV_S_2_RANGE______21_R_CM 1 100. 0. 255. ECU_ADDRESS 0x3fd474 BIT_MASK 0x80 /end MEASUREMENT
/begin MEASUREMENT CTR_ABC_END_DIAG_PVS_DOUBLE "" UBYTE _CNV_A_R_LINEAR_____12_CM 1 100. 0. 255. ECU_ADDRESS 0x3fd475 FORMAT "%3.0" /end MEASUREMENT
/begin MEASUREMENT CTR_ABC_CONV_MON_1 "" UBYTE _CNV_A_R_LINEAR_____10_CM 1 100. 0. 255. ECU_ADDRESS 0x3fd546 FORMAT "%3.0" /end MEASUREMENT
/begin MEASUREMENT LV_CDN_DIAG_CONV_MON_1 "" UBYTE _CNV_S_2_RANGE______21_R_CM 1 100. 0. 255. ECU_ADDRESS 0x3fd544 BIT_MASK 0x10 /end MEASUREMENT
/begin MEASUREMENT LV_END_DIAG_CONV_MON_1 "" UBYTE _CNV_S_2_RANGE______21_R_CM 1 100. 0. 255. ECU_ADDRESS 0x3fd544 BIT_MASK 0x20 /end MEASUREMENT
/begin MEASUREMENT LV_READY_CONV_MON_1 "" UBYTE _CNV_S_2_RANGE______21_R_CM 1 100. 0. 255. ECU_ADDRESS 0x3fd544 BIT_MASK 0x40 /end MEASUREMENT
/begin MEASUREMENT ERR_SYM_CONV_MON_1 "" UBYTE _CNV_S_6_RANGE_ERR__22_CM 1 100. 0. 15. ECU_ADDRESS 0x3fd544 BIT_MASK 0xF /end MEASUREMENT
/begin MEASUREMENT LV_ERR_MEM_CONV_MON_1 "" UBYTE _CNV_S_2_RANGE______21_R_CM 1 100. 0. 255. ECU_ADDRESS 0x3fd544 BIT_MASK 0x80 /end MEASUREMENT
/begin MEASUREMENT CTR_ABC_END_DIAG_CONV_MON_1 "" UBYTE _CNV_A_R_LINEAR_____12_CM 1 100. 0. 255. ECU_ADDRESS 0x3fd545 FORMAT "%3.0" /end MEASUREMENT
/begin MEASUREMENT CTR_ABC_N_EFP_HIGH "" UBYTE _CNV_A_R_LINEAR_____10_CM 1 100. 0. 255. ECU_ADDRESS 0x3fd682 FORMAT "%3.0" /end MEASUREMENT
/begin MEASUREMENT LV_CDN_DIAG_N_EFP_HIGH "" UBYTE _CNV_S_2_RANGE______21_R_CM 1 100. 0. 255. ECU_ADDRESS 0x3fd680 BIT_MASK 0x10 /end MEASUREMENT
/begin MEASUREMENT LV_END_DIAG_N_EFP_HIGH "" UBYTE _CNV_S_2_RANGE______21_R_CM 1 100. 0. 255. ECU_ADDRESS 0x3fd680 BIT_MASK 0x20 /end MEASUREMENT
/begin MEASUREMENT LV_READY_N_EFP_HIGH "" UBYTE _CNV_S_2_RANGE______21_R_CM 1 100. 0. 255. ECU_ADDRESS 0x3fd680 BIT_MASK 0x40 /end MEASUREMENT
/begin MEASUREMENT ERR_SYM_N_EFP_HIGH "" UBYTE _CNV_S_6_RANGE_ERR__22_CM 1 100. 0. 15. ECU_ADDRESS 0x3fd680 BIT_MASK 0xF /end MEASUREMENT
/begin MEASUREMENT LV_ERR_MEM_N_EFP_HIGH "" UBYTE _CNV_S_2_RANGE______21_R_CM 1 100. 0. 255. ECU_ADDRESS 0x3fd680 BIT_MASK 0x80 /end MEASUREMENT
/begin MEASUREMENT CTR_ABC_END_DIAG_N_EFP_HIGH "" UBYTE _CNV_A_R_LINEAR_____12_CM 1 100. 0. 255. ECU_ADDRESS 0x3fd681 FORMAT "%3.0" /end MEASUREMENT
/begin MEASUREMENT CTR_ABC_PVS_1 "" UBYTE _CNV_A_R_LINEAR_____10_CM 1 100. 0. 255. ECU_ADDRESS 0x3fd46a FORMAT "%3.0" /end MEASUREMENT
/begin MEASUREMENT LV_CDN_DIAG_PVS_1 "" UBYTE _CNV_S_2_RANGE______21_R_CM 1 100. 0. 255. ECU_ADDRESS 0x3fd468 BIT_MASK 0x10 /end MEASUREMENT
/begin MEASUREMENT LV_END_DIAG_PVS_1 "" UBYTE _CNV_S_2_RANGE______21_R_CM 1 100. 0. 255. ECU_ADDRESS 0x3fd468 BIT_MASK 0x20 /end MEASUREMENT
/begin MEASUREMENT LV_READY_PVS_1 "" UBYTE _CNV_S_2_RANGE______21_R_CM 1 100. 0. 255. ECU_ADDRESS 0x3fd468 BIT_MASK 0x40 /end MEASUREMENT
/begin MEASUREMENT ERR_SYM_PVS_1 "" UBYTE _CNV_S_6_RANGE_ERR__22_CM 1 100. 0. 15. ECU_ADDRESS 0x3fd468 BIT_MASK 0xF /end MEASUREMENT
/begin MEASUREMENT LV_ERR_MEM_PVS_1 "" UBYTE _CNV_S_2_RANGE______21_R_CM 1 100. 0. 255. ECU_ADDRESS 0x3fd468 BIT_MASK 0x80 /end MEASUREMENT
/begin MEASUREMENT CTR_ABC_END_DIAG_PVS_1 "" UBYTE _CNV_A_R_LINEAR_____12_CM 1 100. 0. 255. ECU_ADDRESS 0x3fd469 FORMAT "%3.0" /end MEASUREMENT
/begin MEASUREMENT CTR_ABC_PVS_2 "" UBYTE _CNV_A_R_LINEAR_____10_CM 1 100. 0. 255. ECU_ADDRESS 0x3fd46e FORMAT "%3.0" /end MEASUREMENT
/begin MEASUREMENT LV_CDN_DIAG_PVS_2 "" UBYTE _CNV_S_2_RANGE______21_R_CM 1 100. 0. 255. ECU_ADDRESS 0x3fd46c BIT_MASK 0x10 /end MEASUREMENT
/begin MEASUREMENT LV_END_DIAG_PVS_2 "" UBYTE _CNV_S_2_RANGE______21_R_CM 1 100. 0. 255. ECU_ADDRESS 0x3fd46c BIT_MASK 0x20 /end MEASUREMENT
/begin MEASUREMENT LV_READY_PVS_2 "" UBYTE _CNV_S_2_RANGE______21_R_CM 1 100. 0. 255. ECU_ADDRESS 0x3fd46c BIT_MASK 0x40 /end MEASUREMENT
/begin MEASUREMENT ERR_SYM_PVS_2 "" UBYTE _CNV_S_6_RANGE_ERR__22_CM 1 100. 0. 15. ECU_ADDRESS 0x3fd46c BIT_MASK 0xF /end MEASUREMENT
/begin MEASUREMENT LV_ERR_MEM_PVS_2 "" UBYTE _CNV_S_2_RANGE______21_R_CM 1 100. 0. 255. ECU_ADDRESS 0x3fd46c BIT_MASK 0x80 /end MEASUREMENT
/begin MEASUREMENT CTR_ABC_END_DIAG_PVS_2 "" UBYTE _CNV_A_R_LINEAR_____12_CM 1 100. 0. 255. ECU_ADDRESS 0x3fd46d FORMAT "%3.0" /end MEASUREMENT
/begin MEASUREMENT CTR_ABC_ECU_CKS "" UBYTE _CNV_A_R_LINEAR_____10_CM 1 100. 0. 255. ECU_ADDRESS 0x3fd3ee FORMAT "%3.0" /end MEASUREMENT
/begin MEASUREMENT LV_CDN_DIAG_ECU_CKS "" UBYTE _CNV_S_2_RANGE______21_R_CM 1 100. 0. 255. ECU_ADDRESS 0x3fd3ec BIT_MASK 0x10 /end MEASUREMENT
/begin MEASUREMENT LV_END_DIAG_ECU_CKS "" UBYTE _CNV_S_2_RANGE______21_R_CM 1 100. 0. 255. ECU_ADDRESS 0x3fd3ec BIT_MASK 0x20 /end MEASUREMENT
/begin MEASUREMENT LV_READY_ECU_CKS "" UBYTE _CNV_S_2_RANGE______21_R_CM 1 100. 0. 255. ECU_ADDRESS 0x3fd3ec BIT_MASK 0x40 /end MEASUREMENT
/begin MEASUREMENT ERR_SYM_ECU_CKS "" UBYTE _CNV_S_6_RANGE_ERR__22_CM 1 100. 0. 15. ECU_ADDRESS 0x3fd3ec BIT_MASK 0xF /end MEASUREMENT
/begin MEASUREMENT LV_ERR_MEM_ECU_CKS "" UBYTE _CNV_S_2_RANGE______21_R_CM 1 100. 0. 255. ECU_ADDRESS 0x3fd3ec BIT_MASK 0x80 /end MEASUREMENT
/begin MEASUREMENT CTR_ABC_END_DIAG_ECU_CKS "" UBYTE _CNV_A_R_LINEAR_____12_CM 1 100. 0. 255. ECU_ADDRESS 0x3fd3ed FORMAT "%3.0" /end MEASUREMENT
/begin MEASUREMENT CTR_ABC_MSR_INH_MON_1 "" UBYTE _CNV_A_R_LINEAR_____10_CM 1 100. 0. 255. ECU_ADDRESS 0x3fd572 FORMAT "%3.0" /end MEASUREMENT
/begin MEASUREMENT LV_CDN_DIAG_MSR_INH_MON_1 "" UBYTE _CNV_S_2_RANGE______21_R_CM 1 100. 0. 255. ECU_ADDRESS 0x3fd570 BIT_MASK 0x10 /end MEASUREMENT
/begin MEASUREMENT LV_END_DIAG_MSR_INH_MON_1 "" UBYTE _CNV_S_2_RANGE______21_R_CM 1 100. 0. 255. ECU_ADDRESS 0x3fd570 BIT_MASK 0x20 /end MEASUREMENT
/begin MEASUREMENT LV_READY_MSR_INH_MON_1 "" UBYTE _CNV_S_2_RANGE______21_R_CM 1 100. 0. 255. ECU_ADDRESS 0x3fd570 BIT_MASK 0x40 /end MEASUREMENT
/begin MEASUREMENT ERR_SYM_MSR_INH_MON_1 "" UBYTE _CNV_S_6_RANGE_ERR__22_CM 1 100. 0. 15. ECU_ADDRESS 0x3fd570 BIT_MASK 0xF /end MEASUREMENT
/begin MEASUREMENT LV_ERR_MEM_MSR_INH_MON_1 "" UBYTE _CNV_S_2_RANGE______21_R_CM 1 100. 0. 255. ECU_ADDRESS 0x3fd570 BIT_MASK 0x80 /end MEASUREMENT
/begin MEASUREMENT CTR_ABC_END_DIAG_MSR_INH_MON_1 "" UBYTE _CNV_A_R_LINEAR_____12_CM 1 100. 0. 255. ECU_ADDRESS 0x3fd571 FORMAT "%3.0" /end MEASUREMENT
/begin MEASUREMENT CTR_ABC_DMTLH "" UBYTE _CNV_A_R_LINEAR_____10_CM 1 100. 0. 255. ECU_ADDRESS 0x3fd622 FORMAT "%3.0" /end MEASUREMENT
/begin MEASUREMENT LV_CDN_DIAG_DMTLH "" UBYTE _CNV_S_2_RANGE______21_R_CM 1 100. 0. 255. ECU_ADDRESS 0x3fd620 BIT_MASK 0x10 /end MEASUREMENT
/begin MEASUREMENT LV_END_DIAG_DMTLH "" UBYTE _CNV_S_2_RANGE______21_R_CM 1 100. 0. 255. ECU_ADDRESS 0x3fd620 BIT_MASK 0x20 /end MEASUREMENT
/begin MEASUREMENT LV_READY_DMTLH "" UBYTE _CNV_S_2_RANGE______21_R_CM 1 100. 0. 255. ECU_ADDRESS 0x3fd620 BIT_MASK 0x40 /end MEASUREMENT
/begin MEASUREMENT ERR_SYM_DMTLH "" UBYTE _CNV_S_6_RANGE_ERR__22_CM 1 100. 0. 15. ECU_ADDRESS 0x3fd620 BIT_MASK 0xF /end MEASUREMENT
/begin MEASUREMENT LV_ERR_MEM_DMTLH "" UBYTE _CNV_S_2_RANGE______21_R_CM 1 100. 0. 255. ECU_ADDRESS 0x3fd620 BIT_MASK 0x80 /end MEASUREMENT
/begin MEASUREMENT CTR_ABC_END_DIAG_DMTLH "" UBYTE _CNV_A_R_LINEAR_____12_CM 1 100. 0. 255. ECU_ADDRESS 0x3fd621 FORMAT "%3.0" /end MEASUREMENT
/begin MEASUREMENT CTR_ABC_VS "" UBYTE _CNV_A_R_LINEAR_____10_CM 1 100. 0. 255. ECU_ADDRESS 0x3fd416 FORMAT "%3.0" /end MEASUREMENT
/begin MEASUREMENT LV_CDN_DIAG_VS "" UBYTE _CNV_S_2_RANGE______21_R_CM 1 100. 0. 255. ECU_ADDRESS 0x3fd414 BIT_MASK 0x10 /end MEASUREMENT
/begin MEASUREMENT LV_END_DIAG_VS "" UBYTE _CNV_S_2_RANGE______21_R_CM 1 100. 0. 255. ECU_ADDRESS 0x3fd414 BIT_MASK 0x20 /end MEASUREMENT
/begin MEASUREMENT LV_READY_VS "" UBYTE _CNV_S_2_RANGE______21_R_CM 1 100. 0. 255. ECU_ADDRESS 0x3fd414 BIT_MASK 0x40 /end MEASUREMENT
/begin MEASUREMENT ERR_SYM_VS "" UBYTE _CNV_S_6_RANGE_ERR__22_CM 1 100. 0. 15. ECU_ADDRESS 0x3fd414 BIT_MASK 0xF /end MEASUREMENT
/begin MEASUREMENT LV_ERR_MEM_VS "" UBYTE _CNV_S_2_RANGE______21_R_CM 1 100. 0. 255. ECU_ADDRESS 0x3fd414 BIT_MASK 0x80 /end MEASUREMENT
/begin MEASUREMENT CTR_ABC_END_DIAG_VS "" UBYTE _CNV_A_R_LINEAR_____12_CM 1 100. 0. 255. ECU_ADDRESS 0x3fd415 FORMAT "%3.0" /end MEASUREMENT
/begin MEASUREMENT CTR_ABC_DMTLM "" UBYTE _CNV_A_R_LINEAR_____10_CM 1 100. 0. 255. ECU_ADDRESS 0x3fd5ee FORMAT "%3.0" /end MEASUREMENT
/begin MEASUREMENT LV_CDN_DIAG_DMTLM "" UBYTE _CNV_S_2_RANGE______21_R_CM 1 100. 0. 255. ECU_ADDRESS 0x3fd5ec BIT_MASK 0x10 /end MEASUREMENT
/begin MEASUREMENT LV_END_DIAG_DMTLM "" UBYTE _CNV_S_2_RANGE______21_R_CM 1 100. 0. 255. ECU_ADDRESS 0x3fd5ec BIT_MASK 0x20 /end MEASUREMENT
/begin MEASUREMENT LV_READY_DMTLM "" UBYTE _CNV_S_2_RANGE______21_R_CM 1 100. 0. 255. ECU_ADDRESS 0x3fd5ec BIT_MASK 0x40 /end MEASUREMENT
/begin MEASUREMENT ERR_SYM_DMTLM "" UBYTE _CNV_S_6_RANGE_ERR__22_CM 1 100. 0. 15. ECU_ADDRESS 0x3fd5ec BIT_MASK 0xF /end MEASUREMENT
/begin MEASUREMENT LV_ERR_MEM_DMTLM "" UBYTE _CNV_S_2_RANGE______21_R_CM 1 100. 0. 255. ECU_ADDRESS 0x3fd5ec BIT_MASK 0x80 /end MEASUREMENT
/begin MEASUREMENT CTR_ABC_END_DIAG_DMTLM "" UBYTE _CNV_A_R_LINEAR_____12_CM 1 100. 0. 255. ECU_ADDRESS 0x3fd5ed FORMAT "%3.0" /end MEASUREMENT
/begin MEASUREMENT CTR_ABC_DMTLS "" UBYTE _CNV_A_R_LINEAR_____10_CM 1 100. 0. 255. ECU_ADDRESS 0x3fd5e6 FORMAT "%3.0" /end MEASUREMENT
/begin MEASUREMENT LV_CDN_DIAG_DMTLS "" UBYTE _CNV_S_2_RANGE______21_R_CM 1 100. 0. 255. ECU_ADDRESS 0x3fd5e4 BIT_MASK 0x10 /end MEASUREMENT
/begin MEASUREMENT LV_END_DIAG_DMTLS "" UBYTE _CNV_S_2_RANGE______21_R_CM 1 100. 0. 255. ECU_ADDRESS 0x3fd5e4 BIT_MASK 0x20 /end MEASUREMENT
/begin MEASUREMENT LV_READY_DMTLS "" UBYTE _CNV_S_2_RANGE______21_R_CM 1 100. 0. 255. ECU_ADDRESS 0x3fd5e4 BIT_MASK 0x40 /end MEASUREMENT
/begin MEASUREMENT ERR_SYM_DMTLS "" UBYTE _CNV_S_6_RANGE_ERR__22_CM 1 100. 0. 15. ECU_ADDRESS 0x3fd5e4 BIT_MASK 0xF /end MEASUREMENT
/begin MEASUREMENT LV_ERR_MEM_DMTLS "" UBYTE _CNV_S_2_RANGE______21_R_CM 1 100. 0. 255. ECU_ADDRESS 0x3fd5e4 BIT_MASK 0x80 /end MEASUREMENT
/begin MEASUREMENT CTR_ABC_END_DIAG_DMTLS "" UBYTE _CNV_A_R_LINEAR_____12_CM 1 100. 0. 255. ECU_ADDRESS 0x3fd5e5 FORMAT "%3.0" /end MEASUREMENT
/begin MEASUREMENT CTR_ABC_SLV_IVVT_EX_1 "" UBYTE _CNV_A_R_LINEAR_____10_CM 1 100. 0. 255. ECU_ADDRESS 0x3fd3e6 FORMAT "%3.0" /end MEASUREMENT
/begin MEASUREMENT LV_CDN_DIAG_SLV_IVVT_EX_1 "" UBYTE _CNV_S_2_RANGE______21_R_CM 1 100. 0. 255. ECU_ADDRESS 0x3fd3e4 BIT_MASK 0x10 /end MEASUREMENT
/begin MEASUREMENT LV_END_DIAG_SLV_IVVT_EX_1 "" UBYTE _CNV_S_2_RANGE______21_R_CM 1 100. 0. 255. ECU_ADDRESS 0x3fd3e4 BIT_MASK 0x20 /end MEASUREMENT
/begin MEASUREMENT LV_READY_SLV_IVVT_EX_1 "" UBYTE _CNV_S_2_RANGE______21_R_CM 1 100. 0. 255. ECU_ADDRESS 0x3fd3e4 BIT_MASK 0x40 /end MEASUREMENT
/begin MEASUREMENT ERR_SYM_SLV_IVVT_EX_1 "" UBYTE _CNV_S_6_RANGE_ERR__22_CM 1 100. 0. 15. ECU_ADDRESS 0x3fd3e4 BIT_MASK 0xF /end MEASUREMENT
/begin MEASUREMENT LV_ERR_MEM_SLV_IVVT_EX_1 "" UBYTE _CNV_S_2_RANGE______21_R_CM 1 100. 0. 255. ECU_ADDRESS 0x3fd3e4 BIT_MASK 0x80 /end MEASUREMENT
/begin MEASUREMENT CTR_ABC_END_DIAG_SLV_IVVT_EX_1 "" UBYTE _CNV_A_R_LINEAR_____12_CM 1 100. 0. 255. ECU_ADDRESS 0x3fd3e5 FORMAT "%3.0" /end MEASUREMENT
/begin MEASUREMENT CTR_ABC_SLV_IVVT_EX_2 "" UBYTE _CNV_A_R_LINEAR_____10_CM 1 100. 0. 255. ECU_ADDRESS 0x3fd3ea FORMAT "%3.0" /end MEASUREMENT
/begin MEASUREMENT LV_CDN_DIAG_SLV_IVVT_EX_2 "" UBYTE _CNV_S_2_RANGE______21_R_CM 1 100. 0. 255. ECU_ADDRESS 0x3fd3e8 BIT_MASK 0x10 /end MEASUREMENT
/begin MEASUREMENT LV_END_DIAG_SLV_IVVT_EX_2 "" UBYTE _CNV_S_2_RANGE______21_R_CM 1 100. 0. 255. ECU_ADDRESS 0x3fd3e8 BIT_MASK 0x20 /end MEASUREMENT
/begin MEASUREMENT LV_READY_SLV_IVVT_EX_2 "" UBYTE _CNV_S_2_RANGE______21_R_CM 1 100. 0. 255. ECU_ADDRESS 0x3fd3e8 BIT_MASK 0x40 /end MEASUREMENT
/begin MEASUREMENT ERR_SYM_SLV_IVVT_EX_2 "" UBYTE _CNV_S_6_RANGE_ERR__22_CM 1 100. 0. 15. ECU_ADDRESS 0x3fd3e8 BIT_MASK 0xF /end MEASUREMENT
/begin MEASUREMENT LV_ERR_MEM_SLV_IVVT_EX_2 "" UBYTE _CNV_S_2_RANGE______21_R_CM 1 100. 0. 255. ECU_ADDRESS 0x3fd3e8 BIT_MASK 0x80 /end MEASUREMENT
/begin MEASUREMENT CTR_ABC_END_DIAG_SLV_IVVT_EX_2 "" UBYTE _CNV_A_R_LINEAR_____12_CM 1 100. 0. 255. ECU_ADDRESS 0x3fd3e9 FORMAT "%3.0" /end MEASUREMENT
/begin MEASUREMENT CTR_ABC_TQ_DIF_I_IS_MON_1 "" UBYTE _CNV_A_R_LINEAR_____10_CM 1 100. 0. 255. ECU_ADDRESS 0x3fd566 FORMAT "%3.0" /end MEASUREMENT
/begin MEASUREMENT LV_CDN_DIAG_TQ_DIF_I_IS_MON_1 "" UBYTE _CNV_S_2_RANGE______21_R_CM 1 100. 0. 255. ECU_ADDRESS 0x3fd564 BIT_MASK 0x10 /end MEASUREMENT
/begin MEASUREMENT LV_END_DIAG_TQ_DIF_I_IS_MON_1 "" UBYTE _CNV_S_2_RANGE______21_R_CM 1 100. 0. 255. ECU_ADDRESS 0x3fd564 BIT_MASK 0x20 /end MEASUREMENT
/begin MEASUREMENT LV_READY_TQ_DIF_I_IS_MON_1 "" UBYTE _CNV_S_2_RANGE______21_R_CM 1 100. 0. 255. ECU_ADDRESS 0x3fd564 BIT_MASK 0x40 /end MEASUREMENT
/begin MEASUREMENT ERR_SYM_TQ_DIF_I_IS_MON_1 "" UBYTE _CNV_S_6_RANGE_ERR__22_CM 1 100. 0. 15. ECU_ADDRESS 0x3fd564 BIT_MASK 0xF /end MEASUREMENT
/begin MEASUREMENT LV_ERR_MEM_TQ_DIF_I_IS_MON_1 "" UBYTE _CNV_S_2_RANGE______21_R_CM 1 100. 0. 255. ECU_ADDRESS 0x3fd564 BIT_MASK 0x80 /end MEASUREMENT
/begin MEASUREMENT CTR_ABC_END_DIAG_TQ_DIF_I_IS_MON "" UBYTE _CNV_A_R_LINEAR_____12_CM 1 100. 0. 255. ECU_ADDRESS 0x3fd565 FORMAT "%3.0" /end MEASUREMENT
/begin MEASUREMENT CTR_ABC_PVS_BLS_NOT_PLAUS "" UBYTE _CNV_A_R_LINEAR_____10_CM 1 100. 0. 255. ECU_ADDRESS 0x3fd5d2 FORMAT "%3.0" /end MEASUREMENT
/begin MEASUREMENT LV_CDN_DIAG_PVS_BLS_NOT_PLAUS "" UBYTE _CNV_S_2_RANGE______21_R_CM 1 100. 0. 255. ECU_ADDRESS 0x3fd5d0 BIT_MASK 0x10 /end MEASUREMENT
/begin MEASUREMENT LV_END_DIAG_PVS_BLS_NOT_PLAUS "" UBYTE _CNV_S_2_RANGE______21_R_CM 1 100. 0. 255. ECU_ADDRESS 0x3fd5d0 BIT_MASK 0x20 /end MEASUREMENT
/begin MEASUREMENT LV_READY_PVS_BLS_NOT_PLAUS "" UBYTE _CNV_S_2_RANGE______21_R_CM 1 100. 0. 255. ECU_ADDRESS 0x3fd5d0 BIT_MASK 0x40 /end MEASUREMENT
/begin MEASUREMENT ERR_SYM_PVS_BLS_NOT_PLAUS "" UBYTE _CNV_S_6_RANGE_ERR__22_CM 1 100. 0. 15. ECU_ADDRESS 0x3fd5d0 BIT_MASK 0xF /end MEASUREMENT
/begin MEASUREMENT LV_ERR_MEM_PVS_BLS_NOT_PLAUS "" UBYTE _CNV_S_2_RANGE______21_R_CM 1 100. 0. 255. ECU_ADDRESS 0x3fd5d0 BIT_MASK 0x80 /end MEASUREMENT
/begin MEASUREMENT CTR_ABC_END_DIAG_PVS_BLS_NOT_PLA "" UBYTE _CNV_A_R_LINEAR_____12_CM 1 100. 0. 255. ECU_ADDRESS 0x3fd5d1 FORMAT "%3.0" /end MEASUREMENT
/begin MEASUREMENT CTR_ABC_VLS_DOWN_OC_1 "" UBYTE _CNV_A_R_LINEAR_____10_CM 1 100. 0. 255. ECU_ADDRESS 0x3fd37e FORMAT "%3.0" /end MEASUREMENT
/begin MEASUREMENT LV_CDN_DIAG_VLS_DOWN_OC_1 "" UBYTE _CNV_S_2_RANGE______21_R_CM 1 100. 0. 255. ECU_ADDRESS 0x3fd37c BIT_MASK 0x10 /end MEASUREMENT
/begin MEASUREMENT LV_END_DIAG_VLS_DOWN_OC_1 "" UBYTE _CNV_S_2_RANGE______21_R_CM 1 100. 0. 255. ECU_ADDRESS 0x3fd37c BIT_MASK 0x20 /end MEASUREMENT
/begin MEASUREMENT LV_READY_VLS_DOWN_OC_1 "" UBYTE _CNV_S_2_RANGE______21_R_CM 1 100. 0. 255. ECU_ADDRESS 0x3fd37c BIT_MASK 0x40 /end MEASUREMENT
/begin MEASUREMENT ERR_SYM_VLS_DOWN_OC_1 "" UBYTE _CNV_S_6_RANGE_ERR__22_CM 1 100. 0. 15. ECU_ADDRESS 0x3fd37c BIT_MASK 0xF /end MEASUREMENT
/begin MEASUREMENT LV_ERR_MEM_VLS_DOWN_OC_1 "" UBYTE _CNV_S_2_RANGE______21_R_CM 1 100. 0. 255. ECU_ADDRESS 0x3fd37c BIT_MASK 0x80 /end MEASUREMENT
/begin MEASUREMENT CTR_ABC_END_DIAG_VLS_DOWN_OC_1 "" UBYTE _CNV_A_R_LINEAR_____12_CM 1 100. 0. 255. ECU_ADDRESS 0x3fd37d FORMAT "%3.0" /end MEASUREMENT
/begin MEASUREMENT CTR_ABC_VLS_DOWN_OC_2 "" UBYTE _CNV_A_R_LINEAR_____10_CM 1 100. 0. 255. ECU_ADDRESS 0x3fd382 FORMAT "%3.0" /end MEASUREMENT
/begin MEASUREMENT LV_CDN_DIAG_VLS_DOWN_OC_2 "" UBYTE _CNV_S_2_RANGE______21_R_CM 1 100. 0. 255. ECU_ADDRESS 0x3fd380 BIT_MASK 0x10 /end MEASUREMENT
/begin MEASUREMENT LV_END_DIAG_VLS_DOWN_OC_2 "" UBYTE _CNV_S_2_RANGE______21_R_CM 1 100. 0. 255. ECU_ADDRESS 0x3fd380 BIT_MASK 0x20 /end MEASUREMENT
/begin MEASUREMENT LV_READY_VLS_DOWN_OC_2 "" UBYTE _CNV_S_2_RANGE______21_R_CM 1 100. 0. 255. ECU_ADDRESS 0x3fd380 BIT_MASK 0x40 /end MEASUREMENT
/begin MEASUREMENT ERR_SYM_VLS_DOWN_OC_2 "" UBYTE _CNV_S_6_RANGE_ERR__22_CM 1 100. 0. 15. ECU_ADDRESS 0x3fd380 BIT_MASK 0xF /end MEASUREMENT
/begin MEASUREMENT LV_ERR_MEM_VLS_DOWN_OC_2 "" UBYTE _CNV_S_2_RANGE______21_R_CM 1 100. 0. 255. ECU_ADDRESS 0x3fd380 BIT_MASK 0x80 /end MEASUREMENT
/begin MEASUREMENT CTR_ABC_END_DIAG_VLS_DOWN_OC_2 "" UBYTE _CNV_A_R_LINEAR_____12_CM 1 100. 0. 255. ECU_ADDRESS 0x3fd381 FORMAT "%3.0" /end MEASUREMENT
/begin MEASUREMENT CTR_ABC_RLY_ST "" UBYTE _CNV_A_R_LINEAR_____10_CM 1 100. 0. 255. ECU_ADDRESS 0x3fd5fe FORMAT "%3.0" /end MEASUREMENT
/begin MEASUREMENT LV_CDN_DIAG_RLY_ST "" UBYTE _CNV_S_2_RANGE______21_R_CM 1 100. 0. 255. ECU_ADDRESS 0x3fd5fc BIT_MASK 0x10 /end MEASUREMENT
/begin MEASUREMENT LV_END_DIAG_RLY_ST "" UBYTE _CNV_S_2_RANGE______21_R_CM 1 100. 0. 255. ECU_ADDRESS 0x3fd5fc BIT_MASK 0x20 /end MEASUREMENT
/begin MEASUREMENT LV_READY_RLY_ST "" UBYTE _CNV_S_2_RANGE______21_R_CM 1 100. 0. 255. ECU_ADDRESS 0x3fd5fc BIT_MASK 0x40 /end MEASUREMENT
/begin MEASUREMENT ERR_SYM_RLY_ST "" UBYTE _CNV_S_6_RANGE_ERR__22_CM 1 100. 0. 15. ECU_ADDRESS 0x3fd5fc BIT_MASK 0xF /end MEASUREMENT
/begin MEASUREMENT LV_ERR_MEM_RLY_ST "" UBYTE _CNV_S_2_RANGE______21_R_CM 1 100. 0. 255. ECU_ADDRESS 0x3fd5fc BIT_MASK 0x80 /end MEASUREMENT
/begin MEASUREMENT CTR_ABC_END_DIAG_RLY_ST "" UBYTE _CNV_A_R_LINEAR_____12_CM 1 100. 0. 255. ECU_ADDRESS 0x3fd5fd FORMAT "%3.0" /end MEASUREMENT
/begin MEASUREMENT CTR_ABC_TQ_LOSS_MON_1 "" UBYTE _CNV_A_R_LINEAR_____10_CM 1 100. 0. 255. ECU_ADDRESS 0x3fd556 FORMAT "%3.0" /end MEASUREMENT
/begin MEASUREMENT LV_CDN_DIAG_TQ_LOSS_MON_1 "" UBYTE _CNV_S_2_RANGE______21_R_CM 1 100. 0. 255. ECU_ADDRESS 0x3fd554 BIT_MASK 0x10 /end MEASUREMENT
/begin MEASUREMENT LV_END_DIAG_TQ_LOSS_MON_1 "" UBYTE _CNV_S_2_RANGE______21_R_CM 1 100. 0. 255. ECU_ADDRESS 0x3fd554 BIT_MASK 0x20 /end MEASUREMENT
/begin MEASUREMENT LV_READY_TQ_LOSS_MON_1 "" UBYTE _CNV_S_2_RANGE______21_R_CM 1 100. 0. 255. ECU_ADDRESS 0x3fd554 BIT_MASK 0x40 /end MEASUREMENT
/begin MEASUREMENT ERR_SYM_TQ_LOSS_MON_1 "" UBYTE _CNV_S_6_RANGE_ERR__22_CM 1 100. 0. 15. ECU_ADDRESS 0x3fd554 BIT_MASK 0xF /end MEASUREMENT
/begin MEASUREMENT LV_ERR_MEM_TQ_LOSS_MON_1 "" UBYTE _CNV_S_2_RANGE______21_R_CM 1 100. 0. 255. ECU_ADDRESS 0x3fd554 BIT_MASK 0x80 /end MEASUREMENT
/begin MEASUREMENT CTR_ABC_END_DIAG_TQ_LOSS_MON_1 "" UBYTE _CNV_A_R_LINEAR_____12_CM 1 100. 0. 255. ECU_ADDRESS 0x3fd555 FORMAT "%3.0" /end MEASUREMENT
/begin MEASUREMENT CTR_ABC_TQ_DIF_P_D_IS_MON_1 "" UBYTE _CNV_A_R_LINEAR_____10_CM 1 100. 0. 255. ECU_ADDRESS 0x3fd562 FORMAT "%3.0" /end MEASUREMENT
/begin MEASUREMENT LV_CDN_DIAG_TQ_DIF_P_D_IS_MON_1 "" UBYTE _CNV_S_2_RANGE______21_R_CM 1 100. 0. 255. ECU_ADDRESS 0x3fd560 BIT_MASK 0x10 /end MEASUREMENT
/begin MEASUREMENT LV_END_DIAG_TQ_DIF_P_D_IS_MON_1 "" UBYTE _CNV_S_2_RANGE______21_R_CM 1 100. 0. 255. ECU_ADDRESS 0x3fd560 BIT_MASK 0x20 /end MEASUREMENT
/begin MEASUREMENT LV_READY_TQ_DIF_P_D_IS_MON_1 "" UBYTE _CNV_S_2_RANGE______21_R_CM 1 100. 0. 255. ECU_ADDRESS 0x3fd560 BIT_MASK 0x40 /end MEASUREMENT
/begin MEASUREMENT ERR_SYM_TQ_DIF_P_D_IS_MON_1 "" UBYTE _CNV_S_6_RANGE_ERR__22_CM 1 100. 0. 15. ECU_ADDRESS 0x3fd560 BIT_MASK 0xF /end MEASUREMENT
/begin MEASUREMENT LV_ERR_MEM_TQ_DIF_P_D_IS_MON_1 "" UBYTE _CNV_S_2_RANGE______21_R_CM 1 100. 0. 255. ECU_ADDRESS 0x3fd560 BIT_MASK 0x80 /end MEASUREMENT
/begin MEASUREMENT CTR_ABC_END_DIAG_TQ_DIF_P_D_IS_M "" UBYTE _CNV_A_R_LINEAR_____12_CM 1 100. 0. 255. ECU_ADDRESS 0x3fd561 FORMAT "%3.0" /end MEASUREMENT
/begin MEASUREMENT CTR_ABC_OBD2_LSH_UP_1 "" UBYTE _CNV_A_R_LINEAR_____10_CM 1 100. 0. 255. ECU_ADDRESS 0x3fd5d6 FORMAT "%3.0" /end MEASUREMENT
/begin MEASUREMENT LV_CDN_DIAG_OBD2_LSH_UP_1 "" UBYTE _CNV_S_2_RANGE______21_R_CM 1 100. 0. 255. ECU_ADDRESS 0x3fd5d4 BIT_MASK 0x10 /end MEASUREMENT
/begin MEASUREMENT LV_END_DIAG_OBD2_LSH_UP_1 "" UBYTE _CNV_S_2_RANGE______21_R_CM 1 100. 0. 255. ECU_ADDRESS 0x3fd5d4 BIT_MASK 0x20 /end MEASUREMENT
/begin MEASUREMENT LV_READY_OBD2_LSH_UP_1 "" UBYTE _CNV_S_2_RANGE______21_R_CM 1 100. 0. 255. ECU_ADDRESS 0x3fd5d4 BIT_MASK 0x40 /end MEASUREMENT
/begin MEASUREMENT ERR_SYM_OBD2_LSH_UP_1 "" UBYTE _CNV_S_6_RANGE_ERR__22_CM 1 100. 0. 15. ECU_ADDRESS 0x3fd5d4 BIT_MASK 0xF /end MEASUREMENT
/begin MEASUREMENT LV_ERR_MEM_OBD2_LSH_UP_1 "" UBYTE _CNV_S_2_RANGE______21_R_CM 1 100. 0. 255. ECU_ADDRESS 0x3fd5d4 BIT_MASK 0x80 /end MEASUREMENT
/begin MEASUREMENT CTR_ABC_END_DIAG_OBD2_LSH_UP_1 "" UBYTE _CNV_A_R_LINEAR_____12_CM 1 100. 0. 255. ECU_ADDRESS 0x3fd5d5 FORMAT "%3.0" /end MEASUREMENT
/begin MEASUREMENT CTR_ABC_OBD2_LSH_UP_2 "" UBYTE _CNV_A_R_LINEAR_____10_CM 1 100. 0. 255. ECU_ADDRESS 0x3fd5da FORMAT "%3.0" /end MEASUREMENT
/begin MEASUREMENT LV_CDN_DIAG_OBD2_LSH_UP_2 "" UBYTE _CNV_S_2_RANGE______21_R_CM 1 100. 0. 255. ECU_ADDRESS 0x3fd5d8 BIT_MASK 0x10 /end MEASUREMENT
/begin MEASUREMENT LV_END_DIAG_OBD2_LSH_UP_2 "" UBYTE _CNV_S_2_RANGE______21_R_CM 1 100. 0. 255. ECU_ADDRESS 0x3fd5d8 BIT_MASK 0x20 /end MEASUREMENT
/begin MEASUREMENT LV_READY_OBD2_LSH_UP_2 "" UBYTE _CNV_S_2_RANGE______21_R_CM 1 100. 0. 255. ECU_ADDRESS 0x3fd5d8 BIT_MASK 0x40 /end MEASUREMENT
/begin MEASUREMENT ERR_SYM_OBD2_LSH_UP_2 "" UBYTE _CNV_S_6_RANGE_ERR__22_CM 1 100. 0. 15. ECU_ADDRESS 0x3fd5d8 BIT_MASK 0xF /end MEASUREMENT
/begin MEASUREMENT LV_ERR_MEM_OBD2_LSH_UP_2 "" UBYTE _CNV_S_2_RANGE______21_R_CM 1 100. 0. 255. ECU_ADDRESS 0x3fd5d8 BIT_MASK 0x80 /end MEASUREMENT
/begin MEASUREMENT CTR_ABC_END_DIAG_OBD2_LSH_UP_2 "" UBYTE _CNV_A_R_LINEAR_____12_CM 1 100. 0. 255. ECU_ADDRESS 0x3fd5d9 FORMAT "%3.0" /end MEASUREMENT
/begin MEASUREMENT CTR_ABC_TPS_1 "" UBYTE _CNV_A_R_LINEAR_____10_CM 1 100. 0. 255. ECU_ADDRESS 0x3fd452 FORMAT "%3.0" /end MEASUREMENT
/begin MEASUREMENT LV_CDN_DIAG_TPS_1 "" UBYTE _CNV_S_2_RANGE______21_R_CM 1 100. 0. 255. ECU_ADDRESS 0x3fd450 BIT_MASK 0x10 /end MEASUREMENT
/begin MEASUREMENT LV_END_DIAG_TPS_1 "" UBYTE _CNV_S_2_RANGE______21_R_CM 1 100. 0. 255. ECU_ADDRESS 0x3fd450 BIT_MASK 0x20 /end MEASUREMENT
/begin MEASUREMENT LV_READY_TPS_1 "" UBYTE _CNV_S_2_RANGE______21_R_CM 1 100. 0. 255. ECU_ADDRESS 0x3fd450 BIT_MASK 0x40 /end MEASUREMENT
/begin MEASUREMENT ERR_SYM_TPS_1 "" UBYTE _CNV_S_6_RANGE_ERR__22_CM 1 100. 0. 15. ECU_ADDRESS 0x3fd450 BIT_MASK 0xF /end MEASUREMENT
/begin MEASUREMENT LV_ERR_ENG_PSN "logical variable engine position error (debounced error = 1)" UBYTE _CNV_S_2_RANGE______21_R_CM 1 100. 0. 255. ECU_ADDRESS 0x3fd4bf /end MEASUREMENT
/begin MEASUREMENT LV_ERR_TOOTH_PER "logical variable tooth period error (debounced error = 1)" UBYTE _CNV_S_2_RANGE______21_R_CM 1 100. 0. 255. ECU_ADDRESS 0x3fd4c3 /end MEASUREMENT
/begin MEASUREMENT LV_ERR_TPU_SYN "logical variable TPU synchronization error (debounced error = 1)" UBYTE _CNV_S_2_RANGE______21_R_CM 1 100. 0. 255. ECU_ADDRESS 0x3fd4c7 /end MEASUREMENT
/begin MEASUREMENT LV_ERR_CAM_PER_0 "logical variable camshaft signal period error CAM_0 (debounced error = 1)" UBYTE _CNV_S_2_RANGE______21_R_CM 1 100. 0. 255. ECU_ADDRESS 0x3fd4a7 /end MEASUREMENT
/begin MEASUREMENT LV_ERR_CAM_PER_1 "logical variable camshaft signal period error CAM_1 (debounced error = 1)" UBYTE _CNV_S_2_RANGE______21_R_CM 1 100. 0. 255. ECU_ADDRESS 0x3fd4ab /end MEASUREMENT
/begin MEASUREMENT LV_ERR_CAM_PSN_0 "logical variable camshaft position error CAM_0 (debounced error = 1)" UBYTE _CNV_S_2_RANGE______21_R_CM 1 100. 0. 255. ECU_ADDRESS 0x3fd4af /end MEASUREMENT
/begin MEASUREMENT LV_ERR_RLY_ACCOUT "Status air condition compressor relay diagnosis" UBYTE _CNV_S_2_RANGE______21_R_CM 1 100. 0. 255. ECU_ADDRESS 0x3fd4df /end MEASUREMENT
/begin MEASUREMENT LV_ERR_RLY_MAIN "Boolean for error detected at the main relay" UBYTE _CNV_S_2_RANGE______21_R_CM 1 100. 0. 255. ECU_ADDRESS 0x3fd4d7 /end MEASUREMENT
/begin MEASUREMENT LV_ERR_TOUT_TXU_1 "logical variable timeout error CAN message TXU1" UBYTE _CNV_S_2_RANGE______21_R_CM 1 100. 0. 255. ECU_ADDRESS 0x3fd4cf /end MEASUREMENT
/begin MEASUREMENT LV_ERR_IM_BTS_PLAUS "BTS plausibility error flag" UBYTE _CNV_S_2_RANGE______21_R_CM 1 100. 0. 255. ECU_ADDRESS 0x3fd50f /end MEASUREMENT
/begin MEASUREMENT LV_ERR_IM_BLS_PLAUS "BLS plausibility error flag" UBYTE _CNV_S_2_RANGE______21_R_CM 1 100. 0. 255. ECU_ADDRESS 0x3fd50b /end MEASUREMENT
/begin MEASUREMENT LV_ERR_ECF "Boolean for errorcurrently present on ECF signal" UBYTE _CNV_S_2_RANGE______21_R_CM 1 100. 0. 255. ECU_ADDRESS 0x3fd4eb /end MEASUREMENT
/begin MEASUREMENT LV_ERR_EF "Logical value for exhaust flap power stage error" UBYTE _CNV_S_2_RANGE______21_R_CM 1 100. 0. 255. ECU_ADDRESS 0x3fd5bf BIT_MASK 0x1 /end MEASUREMENT
/begin MEASUREMENT LV_ERR_CAM_PSN_1 "logical variable camshaft position error CAM_1 (debounced error = 1)" UBYTE _CNV_S_2_RANGE______21_R_CM 1 100. 0. 255. ECU_ADDRESS 0x3fd4b3 /end MEASUREMENT
/begin MEASUREMENT LV_ERR_CAM_0_NOT_PLAUS "logical variable implausible camshaft sensor signal CAM_0 detected" UBYTE _CNV_S_2_RANGE______21_R_CM 1 100. 0. 255. ECU_ADDRESS 0x3fd4b7 /end MEASUREMENT
/begin MEASUREMENT LV_ERR_CAM_1_NOT_PLAUS "logical variable implausible camshaft sensor signal CAM_1 detected" UBYTE _CNV_S_2_RANGE______21_R_CM 1 100. 0. 255. ECU_ADDRESS 0x3fd4bb /end MEASUREMENT
/begin MEASUREMENT LV_ERR_CRK_NOT_PLAUS "logical variable not plausible crankshaft sensor signal detected" UBYTE _CNV_S_2_RANGE______21_R_CM 1 100. 0. 255. ECU_ADDRESS 0x3fd4cb /end MEASUREMENT
/begin MEASUREMENT LV_ERR_GEN "Boolean for error currently present on Generator" UBYTE _CNV_S_2_RANGE______21_R_CM 1 100. 0. 255. ECU_ADDRESS 0x3fd49b /end MEASUREMENT
/begin MEASUREMENT LV_ERR_GEN_IF "Boolean for error currently present on Generator BSD Interface" UBYTE _CNV_S_2_RANGE______21_R_CM 1 100. 0. 255. ECU_ADDRESS 0x3fd49f /end MEASUREMENT
/begin MEASUREMENT LV_ERR_TOUT_ETCU_2 "logical variable timeout error CAN message EGS2" UBYTE _CNV_S_2_RANGE______21_R_CM 1 100. 0. 255. ECU_ADDRESS 0x3fd3fb /end MEASUREMENT
/begin MEASUREMENT LV_INH_IGC_0 "Inhibition Bit for ignition system of cylinder x" UBYTE _CNV_S_2_RANGE______11_CM 1 100. 0. 1. ECU_ADDRESS 0x3fce5a /end MEASUREMENT
/begin MEASUREMENT LV_INH_IGC_1 "Inhibition Bit for ignition system of cylinder x" UBYTE _CNV_S_2_RANGE______11_CM 1 100. 0. 1. ECU_ADDRESS 0x3fce5b /end MEASUREMENT
/begin MEASUREMENT LV_INH_IGC_2 "Inhibition Bit for ignition system of cylinder x" UBYTE _CNV_S_2_RANGE______11_CM 1 100. 0. 1. ECU_ADDRESS 0x3fce5c /end MEASUREMENT
/begin MEASUREMENT LV_INH_IGC_3 "Inhibition Bit for ignition system of cylinder x" UBYTE _CNV_S_2_RANGE______11_CM 1 100. 0. 1. ECU_ADDRESS 0x3fce5d /end MEASUREMENT
/begin MEASUREMENT LV_INH_IGC_4 "Inhibition Bit for ignition system of cylinder x" UBYTE _CNV_S_2_RANGE______11_CM 1 100. 0. 1. ECU_ADDRESS 0x3fce5e /end MEASUREMENT
/begin MEASUREMENT LV_INH_IGC_5 "Inhibition Bit for ignition system of cylinder x" UBYTE _CNV_S_2_RANGE______11_CM 1 100. 0. 1. ECU_ADDRESS 0x3fce5f /end MEASUREMENT
/begin CHARACTERISTIC C_IGA_OFF_CYCNR_HLD "Duration for regeneration cycle (2 engine evolutions); coil has been switched off" VALUE 0x428e9 _REC_VAL_20_u1 255. _CNV_A_R_LINEAR_____10_CM 0. 255. FORMAT "%3.0" /end CHARACTERISTIC
/begin CHARACTERISTIC C_ABC_TD_IGC_CUT "Value of anti-bounce counter after regeneration cycle" VALUE 0x427ba _REC_VAL_20_u1 255. _CNV_A_R_LINEAR_____10_CM 0. 255. FORMAT "%3.0" /end CHARACTERISTIC
/begin CHARACTERISTIC C_SUM_TD_IGC_CUT "Number of allowed trials to check the ignition system in one engine run" VALUE 0x429b3 _REC_VAL_20_u1 255. _CNV_A_R_LINEAR_____10_CM 0. 255. FORMAT "%3.0" /end CHARACTERISTIC
/begin CHARACTERISTIC C_TCO_MIN_DUR_IGC_DIAG "Minimum coolant temperature to enable the diagnosis" VALUE 0x42a69 _REC_VAL_20_u1 190.5 _CNV_A_R_LINEAR_____0_CM -48. 142.5 FORMAT "%5.1" /end CHARACTERISTIC
/begin CHARACTERISTIC ID_V_DUR_IGC_MIN__N__MAF "Minimum duration of the primary over voltage to detect ignition errors" MAP 0x45f00 _REC_MAP_20_u2_u1_u1 20. _CNV_A_R_LINEAR_____208_CM 0. 20. FORMAT "%8.3"
 /begin AXIS_DESCR COM_AXIS N_32 _CNV_A_R_LINEAR_____5_CM 6 0. 8160. FORMAT "%4.0" AXIS_PTS_REF ldp_n__v_dur_igc_min /end AXIS_DESCR
 /begin AXIS_DESCR COM_AXIS MAF _CNV_A_R_LINEAR_____18_CM 4 0. 1389. FORMAT "%4.0" AXIS_PTS_REF ldp_maf__v_dur_igc_min /end AXIS_DESCR
/end CHARACTERISTIC
/begin CHARACTERISTIC C_ESB_IGN_CUT_DIAG "Enable byte for the diagnosis configuration" VALUE 0x42cf8 _REC_VAL_20_u2 65535. _CNV_A_R_LINEAR_____10_CM 0. 65535. FORMAT "%5.0" /end CHARACTERISTIC
/begin MEASUREMENT LV_ERR_IGC "General error flag for ignition" UBYTE _CNV_S_2_RANGE______21_R_CM 1 100. 0. 255. ECU_ADDRESS 0x3fce60 /end MEASUREMENT
/begin MEASUREMENT IGC_DIAG_MIS "No filtered error information for misfire detection" UBYTE _CNV_A_R_LINEAR_____10_CM 1 100. 0. 255. ECU_ADDRESS 0x3fce59 FORMAT "%3.0" /end MEASUREMENT
/begin AXIS_PTS ldp_n__v_dur_igc_min "" 0x4371e N_32 _REC_AXS_20_u1 816. _CNV_A_R_LINEAR_____5_CM 6 0. 8160. FORMAT "%4.0" /end AXIS_PTS
/begin AXIS_PTS ldp_maf__v_dur_igc_min "" 0x4346e MAF _REC_AXS_20_u1 138.9 _CNV_A_R_LINEAR_____18_CM 4 0. 1389. FORMAT "%4.0" /end AXIS_PTS
/begin MEASUREMENT LV_ERR_TD_IGC_CUT_0 "Error bit for short cut to battery" UBYTE _CNV_S_2_RANGE______21_R_CM 1 100. 0. 255. ECU_ADDRESS 0x3fd423 /end MEASUREMENT
/begin MEASUREMENT LV_ERR_TD_IGC_CUT_1 "Error bit for short cut to battery" UBYTE _CNV_S_2_RANGE______21_R_CM 1 100. 0. 255. ECU_ADDRESS 0x3fd427 /end MEASUREMENT
/begin MEASUREMENT LV_ERR_TD_IGC_CUT_2 "Error bit for short cut to battery" UBYTE _CNV_S_2_RANGE______21_R_CM 1 100. 0. 255. ECU_ADDRESS 0x3fd42b /end MEASUREMENT
/begin MEASUREMENT LV_ERR_TD_IGC_CUT_3 "Error bit for short cut to battery" UBYTE _CNV_S_2_RANGE______21_R_CM 1 100. 0. 255. ECU_ADDRESS 0x3fd42f /end MEASUREMENT
/begin MEASUREMENT LV_ERR_TD_IGC_CUT_4 "Error bit for short cut to battery" UBYTE _CNV_S_2_RANGE______21_R_CM 1 100. 0. 255. ECU_ADDRESS 0x3fd433 /end MEASUREMENT
/begin MEASUREMENT LV_ERR_TD_IGC_CUT_5 "Error bit for short cut to battery" UBYTE _CNV_S_2_RANGE______21_R_CM 1 100. 0. 255. ECU_ADDRESS 0x3fd437 /end MEASUREMENT
/begin MEASUREMENT LV_ERR_DUR_IGC_1 "Error bit for short Burntime" UBYTE _CNV_S_2_RANGE______21_R_CM 1 100. 0. 255. ECU_ADDRESS 0x3fd43f /end MEASUREMENT
/begin MEASUREMENT LV_ERR_DUR_IGC_2 "Error bit for short Burntime" UBYTE _CNV_S_2_RANGE______21_R_CM 1 100. 0. 255. ECU_ADDRESS 0x3fd443 /end MEASUREMENT
/begin MEASUREMENT LV_ERR_DUR_IGC_3 "Error bit for short Burntime" UBYTE _CNV_S_2_RANGE______21_R_CM 1 100. 0. 255. ECU_ADDRESS 0x3fd447 /end MEASUREMENT
/begin MEASUREMENT LV_ERR_DUR_IGC_4 "Error bit for short Burntime" UBYTE _CNV_S_2_RANGE______21_R_CM 1 100. 0. 255. ECU_ADDRESS 0x3fd44b /end MEASUREMENT
/begin MEASUREMENT LV_ERR_DUR_IGC_5 "Error bit for short Burntime" UBYTE _CNV_S_2_RANGE______21_R_CM 1 100. 0. 255. ECU_ADDRESS 0x3fd44f /end MEASUREMENT
/begin MEASUREMENT LV_ERR_DUR_IGC_0 "Error bit for short Burntime" UBYTE _CNV_S_2_RANGE______21_R_CM 1 100. 0. 255. ECU_ADDRESS 0x3fd43b /end MEASUREMENT
/begin CHARACTERISTIC C_N_DIF_MAX_DIAG_ISC "Maximum deviation above nominal idle speed" VALUE 0x42ea2 _REC_VAL_20_u2 8160. _CNV_A_R_LINEAR_____17_CM 0. 8160. FORMAT "%4.0" /end CHARACTERISTIC
/begin CHARACTERISTIC C_N_DIF_MIN_DIAG_ISC "Minimum deviation above nominal idle speed" VALUE 0x42ea6 _REC_VAL_20_u2 8160. _CNV_A_R_LINEAR_____17_CM 0. 8160. FORMAT "%4.0" /end CHARACTERISTIC
/begin MEASUREMENT T_ISC_DIAG "Time delay for diagnosis activation" UWORD _CNV_A_R_LINEAR_____14_CM 1 100. 0. 6553.5 ECU_ADDRESS 0x3fe50e FORMAT "%6.1" /end MEASUREMENT
/begin CHARACTERISTIC C_T_DLY_ISC_DIAG "Time delay for diagnosis activation" VALUE 0x42f8e _REC_VAL_20_u2 6553.5 _CNV_A_R_LINEAR_____14_CM 0. 6553.5 FORMAT "%6.1" /end CHARACTERISTIC
/begin MEASUREMENT LV_ERR_ISC "Boolean for fault memory \"Idle Control System: Unplausible speed\" " UBYTE _CNV_S_2_RANGE______21_R_CM 1 100. 0. 255. ECU_ADDRESS 0x3fd507 /end MEASUREMENT
/begin CHARACTERISTIC C_MAF_MAX_DIAG_ISC "Minimum mass air flow to perform idle speed valve Plausibility check" VALUE 0x42901 _REC_VAL_20_u1 1389. _CNV_A_R_LINEAR_____18_CM 0. 1389. FORMAT "%4.0" /end CHARACTERISTIC
/begin CHARACTERISTIC C_FLOW_CPS_MAX_DIAG_ISC "Maximum canister purge fuel flow from CPS to cylinder to perform idle speed plausibility check" VALUE 0x42d60 _REC_VAL_20_u2 7.99987793 _CNV_A_R_LINEAR_____99_CM 0. 7.99987793 FORMAT "%7.4" /end CHARACTERISTIC
/begin CHARACTERISTIC C_AR_RED_DIF_MAX_DIAG "???" VALUE 0x4320a _REC_VAL_20_s2 99.99847412 _CNV_A_R_LINEAR_____98_CM -50. 49.99847412 FORMAT "%7.3" /end CHARACTERISTIC
/begin CHARACTERISTIC C_AR_RED_DIF_MIN_DIAG "???" VALUE 0x4320c _REC_VAL_20_s2 99.99847412 _CNV_A_R_LINEAR_____98_CM -50. 49.99847412 FORMAT "%7.3" /end CHARACTERISTIC
/begin CHARACTERISTIC C_N_ISA_DIAG "engine speed condition - diagnosis of mechanical fault ISA" VALUE 0x42946 _REC_VAL_20_u1 8160. _CNV_A_R_LINEAR_____5_CM 0. 8160. FORMAT "%4.0" /end CHARACTERISTIC
/begin CHARACTERISTIC C_MAF_TURB_RATIO_DIAG "MAF_TURB_RATIO condition - diagnosis of mechanical fault ISA" VALUE 0x42905 _REC_VAL_20_u1 0.9960940000000002 _CNV_A_R_LINEAR_____44_CM 0. 0.996094 FORMAT "%5.3" /end CHARACTERISTIC
/begin CHARACTERISTIC C_TPS_AV_TOL_ISA_AD "MTC condition - diagnosis of mechanical fault ISA" VALUE 0x430b0 _REC_VAL_20_u2 119.5 _CNV_A_R_LINEAR_____226_CM 0. 119.5 FORMAT "%7.3" /end CHARACTERISTIC
/begin CHARACTERISTIC C_T_MIN_MSW_BIT_DIAG "Min. diagnostic threshold - Toggle bit monitoring" VALUE 0x42a1a _REC_VAL_20_u1 2550. _CNV_A_R_LINEAR_____360_CM 10. 2560. FORMAT "%5.0" /end CHARACTERISTIC
/begin CHARACTERISTIC C_T_MAX_MSW_BIT_DIAG "Max. diagnostic threshold - Toggle bit monitoring" VALUE 0x42a0b _REC_VAL_20_u1 2550. _CNV_A_R_LINEAR_____360_CM 10. 2560. FORMAT "%5.0" /end CHARACTERISTIC
/begin MEASUREMENT LV_ERR_MSW_3 "???" UBYTE _CNV_S_2_RANGE______11_CM 1 100. 0. 1. ECU_ADDRESS 0x3fd51b /end MEASUREMENT
/begin MEASUREMENT LV_ERR_MSW_TOG "???" UBYTE _CNV_S_2_RANGE______11_CM 1 100. 0. 1. ECU_ADDRESS 0x3fd513 /end MEASUREMENT
/begin MEASUREMENT LV_ERR_MSW_2 "???" UBYTE _CNV_S_2_RANGE______11_CM 1 100. 0. 1. ECU_ADDRESS 0x3fd517 /end MEASUREMENT
/begin MEASUREMENT LV_ERR_IV_0 "???" UBYTE _CNV_S_2_RANGE______21_R_CM 1 100. 0. 255. ECU_ADDRESS 0x3fd38f /end MEASUREMENT
/begin MEASUREMENT LV_ERR_IV_2 "???" UBYTE _CNV_S_2_RANGE______21_R_CM 1 100. 0. 255. ECU_ADDRESS 0x3fd397 /end MEASUREMENT
/begin MEASUREMENT LV_ERR_IV_3 "???" UBYTE _CNV_S_2_RANGE______21_R_CM 1 100. 0. 255. ECU_ADDRESS 0x3fd39b /end MEASUREMENT
/begin MEASUREMENT LV_ERR_IV_4 "???" UBYTE _CNV_S_2_RANGE______21_R_CM 1 100. 0. 255. ECU_ADDRESS 0x3fd39f /end MEASUREMENT
/begin MEASUREMENT LV_ERR_IV_5 "???" UBYTE _CNV_S_2_RANGE______21_R_CM 1 100. 0. 255. ECU_ADDRESS 0x3fd3a3 /end MEASUREMENT
/begin MEASUREMENT LV_ERR_IV_1 "???" UBYTE _CNV_S_2_RANGE______21_R_CM 1 100. 0. 255. ECU_ADDRESS 0x3fd393 /end MEASUREMENT
/begin CHARACTERISTIC C_ECFPWM_MAX_DIAG "Maximum PWM threshold for ECF diagnosis" VALUE 0x42886 _REC_VAL_20_u1 99.609375 _CNV_A_R_LINEAR_____4_CM 0. 99.609375 FORMAT "%4.1" /end CHARACTERISTIC
/begin CHARACTERISTIC C_ECFPWM_MIN_DIAG "Minimum PWM threshold for ECF diagnosis" VALUE 0x42888 _REC_VAL_20_u1 99.609375 _CNV_A_R_LINEAR_____4_CM 0. 99.609375 FORMAT "%4.1" /end CHARACTERISTIC
/begin MEASUREMENT IV_DIAG_MIS "Detected symptom in a byte mask for misfire function" UBYTE _CNV_A_R_LINEAR_____10_CM 1 100. 0. 255. ECU_ADDRESS 0x3fd01a FORMAT "%3.0" /end MEASUREMENT
/begin MEASUREMENT CPPWM_LIH "Canister purge PWM limp home value" UBYTE _CNV_A_R_LINEAR_____4_CM 1 100. 0. 99.609375 ECU_ADDRESS 0x3fd01b FORMAT "%4.1" /end MEASUREMENT
/begin CHARACTERISTIC C_CPPWM_SUB_DIAG_1 "CPPWM substitute value when SCG failure" VALUE 0x42820 _REC_VAL_20_u1 99.609375 _CNV_A_R_LINEAR_____4_CM 0. 99.609375 FORMAT "%5.1" /end CHARACTERISTIC
/begin CHARACTERISTIC C_CPPWM_SUB_DIAG_2 "CPPWM substitute value when SCB or OL failure" VALUE 0x42821 _REC_VAL_20_u1 99.609375 _CNV_A_R_LINEAR_____4_CM 0. 99.609375 FORMAT "%5.1" /end CHARACTERISTIC
/begin MEASUREMENT STATE_ISA_DIAG "state of idle speed actuator" UBYTE _CNV_S_6_RANGE_STAT_388_CM 1 100. 0. 5. ECU_ADDRESS 0x3fd019 /end MEASUREMENT
/begin MEASUREMENT LV_ERR_CPS "logical value for CPS error" UBYTE _CNV_S_2_RANGE______21_R_CM 1 100. 0. 255. ECU_ADDRESS 0x3fd3bb /end MEASUREMENT
/begin MEASUREMENT LV_ERR_VIM "Boolean for error currently present on intake manifold drive (after debounce)" UBYTE _CNV_S_2_RANGE______21_R_CM 1 100. 0. 255. ECU_ADDRESS 0x3fd4a3 /end MEASUREMENT
/begin MEASUREMENT LV_PVS_H_R_1 "Logical value (set, if PVS - Channel 1 debounced a high resistance)" UBYTE _CNV_S_2_RANGE______28_CM 1 100. 0. 1. ECU_ADDRESS 0x3fcc65 BIT_MASK 0x1 /end MEASUREMENT
/begin MEASUREMENT LV_PVS_H_R_2 "Logical value (set, if PVS - Channel 2 debounced a high resistance)" UBYTE _CNV_S_2_RANGE______28_CM 1 100. 0. 1. ECU_ADDRESS 0x3fcc66 BIT_MASK 0x1 /end MEASUREMENT
/begin MEASUREMENT LV_ERR_PVS_PRED "Logical value (set, if a PVS-error is present)" UBYTE _CNV_S_2_RANGE______21_R_CM 1 100. 0. 255. ECU_ADDRESS 0x3fddb5 /end MEASUREMENT
/begin CHARACTERISTIC C_VCC_DIF_POTI "max. permissible variance of the supply voltage of 5V" VALUE 0x43158 _REC_VAL_20_u2 9.9902 _CNV_A_R_LINEAR_____37_CM 0. 9.9902 FORMAT "%5.3" /end CHARACTERISTIC
/begin CHARACTERISTIC C_V_PVS_MIN_DIAG_2 "lower diagnosis-threshold channel 2" VALUE 0x4312a _REC_VAL_20_u2 4.99511719 _CNV_A_R_LINEAR_____33_CM 0. 4.99511719 FORMAT "%5.3" /end CHARACTERISTIC
/begin CHARACTERISTIC C_T_IS_PVS_ERR "Minimum idle dwell time in error cases" VALUE 0x429fd _REC_VAL_20_u1 2.55 _CNV_A_R_LINEAR_____27_CM 0. 2.55 FORMAT "%4.2" /end CHARACTERISTIC
/begin CHARACTERISTIC IP_PVS_RATIO_HYS "permissible variance of the PVS-values" CURVE 0x49fcc _REC_CUR_20_u2_u2 4.99511719 _CNV_A_R_LINEAR_____33_CM 0. 4.99511719 FORMAT "%5.3"
 /begin AXIS_DESCR COM_AXIS ONLINE_DUMMY _CNV_A_R_LINEAR_____33_CM 2 0. 4.99511719 FORMAT "%5.3" AXIS_PTS_REF ldp_v_pvs_min /end AXIS_DESCR
/end CHARACTERISTIC
/begin MEASUREMENT LV_DYN_LIM_1_ACT "Limited dynamic 1 is  active / passive" UBYTE _CNV_S_2_RANGE______28_CM 1 100. 0. 1. ECU_ADDRESS 0x3fcc60 BIT_MASK 0x1 /end MEASUREMENT
/begin MEASUREMENT LV_DYN_LIM_2_ACT "Limited dynamic 2 is  active / passive" UBYTE _CNV_S_2_RANGE______28_CM 1 100. 0. 1. ECU_ADDRESS 0x3fcc61 BIT_MASK 0x1 /end MEASUREMENT
/begin CHARACTERISTIC C_V_PVS_MIN_DIAG_1 "lower diagnosis-threshold channel 1" VALUE 0x43128 _REC_VAL_20_u2 4.99511719 _CNV_A_R_LINEAR_____33_CM 0. 4.99511719 FORMAT "%5.3" /end CHARACTERISTIC
/begin MEASUREMENT STATE_PVS_DIAG "Status of PVS-diagnosis" UBYTE _CNV_S_9_RANGE_STAT_393_CM 1 100. 0. 128. ECU_ADDRESS 0x3fcc5f /end MEASUREMENT
/begin MEASUREMENT LV_N_SP_IS_LIH_ACT "LIH idle speed setpoint" UBYTE _CNV_S_2_RANGE______11_CM 1 100. 0. 1. ECU_ADDRESS 0x3fcc63 BIT_MASK 0x1 /end MEASUREMENT
/begin MEASUREMENT LV_ERR_PVS "Logical value (set, if a PVS -error is debounced)" UBYTE _CNV_S_2_RANGE______21_R_CM 1 100. 0. 255. ECU_ADDRESS 0x3fcc64 /end MEASUREMENT
/begin MEASUREMENT LV_DET_NOT_PLAUS_ACT "PV_AV / Brake signal current not plausible" UBYTE _CNV_S_2_RANGE______28_CM 1 100. 0. 1. ECU_ADDRESS 0x3fcc6a /end MEASUREMENT
/begin CHARACTERISTIC C_N_PVS_BLS_BTS_PLAUS "Activation threshold for N  " VALUE 0x4296a _REC_VAL_20_u1 8160. _CNV_A_R_LINEAR_____5_CM 0. 8160. FORMAT "%4.0" /end CHARACTERISTIC
/begin CHARACTERISTIC C_VS_PVS_BLS_BTS_PLAUS "Activation threshold for VS  " VALUE 0x42b3e _REC_VAL_20_u1 255. _CNV_A_R_LINEAR_____13_CM 0. 255. FORMAT "%3.0" /end CHARACTERISTIC
/begin CHARACTERISTIC C_PV_AV_PVS_BLS_BTS_PLAUS "Activation threshold for PV_AV" VALUE 0x42988 _REC_VAL_20_u1 99.609375 _CNV_A_R_LINEAR_____4_CM 0. 99.609375 FORMAT "%4.1" /end CHARACTERISTIC
/begin CHARACTERISTIC C_CTR_MAX_PV_AV_CON "PV_AV_CON counter maximum value" VALUE 0x4286d _REC_VAL_20_u1 255. _CNV_A_R_LINEAR_____10_CM 0. 255. FORMAT "%3.0" /end CHARACTERISTIC
/begin CHARACTERISTIC C_PV_AV_HYS_BLS_BTS_PLAUS "Threshold for detection of a constant pedal value" VALUE 0x42987 _REC_VAL_20_u1 99.609375 _CNV_A_R_LINEAR_____4_CM 0. 99.609375 FORMAT "%4.1" /end CHARACTERISTIC
/begin MEASUREMENT LV_PV_AV_STAT_ "Recognisation of constant pedal value" UBYTE _CNV_S_2_RANGE______28_CM 1 100. 0. 1. ECU_ADDRESS 0x3fddc6 /end MEASUREMENT
/begin MEASUREMENT LV_PVS_BLS_NOT_PLAUS_ACT "Plausibility error PVS recognized without error entry" UBYTE _CNV_S_2_RANGE______28_CM 1 100. 0. 1. ECU_ADDRESS 0x3fcc69 /end MEASUREMENT
/begin MEASUREMENT CTR_PVS_BLS_NOT_PLAUS_ACT "Counter plausibility error PVS recognized without error entry" UBYTE _CNV_A_R_LINEAR_____10_CM 1 100. 0. 255. ECU_ADDRESS 0x3fddc5 FORMAT "%3.0" /end MEASUREMENT
/begin CHARACTERISTIC C_PVS_BLS_BTS_PLAUS_CONF "Enable bit for plausibility check" VALUE 0x4298f _REC_VAL_20_u1 2. _CNV_A_R_LINEAR_____10_CM 0. 2. FORMAT "%2.0" /end CHARACTERISTIC
/begin AXIS_PTS ldp_v_pvs_min "" 0x44d46 V_PVS_MIN _REC_AXS_20_u2 4.99511719 _CNV_A_R_LINEAR_____33_CM 2 0. 4.99511719 FORMAT "%5.3" /end AXIS_PTS
/begin MEASUREMENT LV_ERR_V_REF_2 "Logical value (set, if supply voltage PVS- Channel 2 debounced)" UBYTE _CNV_S_2_RANGE______21_R_CM 1 100. 0. 255. ECU_ADDRESS 0x3fd467 /end MEASUREMENT
/begin MEASUREMENT LV_ERR_PVS_DOUBLE "Logical value (set, if a PVS double error is present)" UBYTE _CNV_S_2_RANGE______21_R_CM 1 100. 0. 255. ECU_ADDRESS 0x3fd477 /end MEASUREMENT
/begin MEASUREMENT LV_ERR_V_REF_1 "Logical value (set, if supply voltage PVS- Channel 1  debounced)" UBYTE _CNV_S_2_RANGE______21_R_CM 1 100. 0. 255. ECU_ADDRESS 0x3fd463 /end MEASUREMENT
/begin MEASUREMENT LV_ERR_PVS_BLS_NOT_PLAUS "Plausibility error PVS / Brake recognized" UBYTE _CNV_S_2_RANGE______28_CM 1 100. 0. 1. ECU_ADDRESS 0x3fd5d3 /end MEASUREMENT
/begin MEASUREMENT LV_ERR_PVS_2 "Logical value (set, if PVS - Channel 2 has debounced a range error)" UBYTE _CNV_S_2_RANGE______21_R_CM 1 100. 0. 255. ECU_ADDRESS 0x3fd46f /end MEASUREMENT
/begin MEASUREMENT LV_ERR_PVS_RATIO "Logical value (set, if a synchronous error between PVS_1 and PVS_2 is debounced)" UBYTE _CNV_S_2_RANGE______21_R_CM 1 100. 0. 255. ECU_ADDRESS 0x3fd473 /end MEASUREMENT
/begin MEASUREMENT LV_ERR_PVS_1 "Logical value (set, if PVS - Channel 1 has debounced a range error)" UBYTE _CNV_S_2_RANGE______21_R_CM 1 100. 0. 255. ECU_ADDRESS 0x3fd46b /end MEASUREMENT
/begin MEASUREMENT T_RLY_MAIN_DIAG "Time window to perform the main relay diagnosis" UBYTE _CNV_A_R_LINEAR_____23_CM 1 100. 0. 2550. ECU_ADDRESS 0x3fe630 FORMAT "%4.0" /end MEASUREMENT
/begin CHARACTERISTIC C_T_RLY_MAIN_DIAG "Time window to perform the main relay diagnosis" VALUE 0x42a2a _REC_VAL_20_u1 2550. _CNV_A_R_LINEAR_____23_CM 0. 2550. FORMAT "%4.0" /end CHARACTERISTIC
/begin CHARACTERISTIC C_VB_RLY_MAIN_DIAG "Voltage threshold for detection of battery voltage present" VALUE 0x42b18 _REC_VAL_20_u1 25.8984 _CNV_A_R_LINEAR_____26_CM 0. 25.8984 FORMAT "%3.1" /end CHARACTERISTIC
/begin CHARACTERISTIC C_V_IGK_RLY_MAIN_DIAG "Voltage threshold for detection of main relay on" VALUE 0x42aed _REC_VAL_20_u1 25.8984 _CNV_A_R_LINEAR_____26_CM 0. 25.8984 FORMAT "%3.1" /end CHARACTERISTIC
/begin CHARACTERISTIC C_T_DLY_RLY_MAIN_DIAG "Delay time for the diagnosis to allow switching of the relay" VALUE 0x429f4 _REC_VAL_20_u1 2550. _CNV_A_R_LINEAR_____23_CM 0. 2550. FORMAT "%4.0" /end CHARACTERISTIC
/begin CHARACTERISTIC C_T_PREDRIVE_DLY_MAX "Maximum predrive check delay" VALUE 0x42a26 _REC_VAL_20_u1 2550. _CNV_A_R_LINEAR_____23_CM 0. 2550. FORMAT "%4.0" /end CHARACTERISTIC
/begin MEASUREMENT LV_ERR_RLY_MAIN_DLY "Error detected switch on delay" UBYTE _CNV_S_2_RANGE______21_R_CM 1 100. 0. 255. ECU_ADDRESS 0x3fd4db /end MEASUREMENT
/begin MEASUREMENT LV_ERR_SAV "Boolean for errorcurrently present on secondary air valve command signal" UBYTE _CNV_S_2_RANGE______21_R_CM 1 100. 0. 255. ECU_ADDRESS 0x3fd4e7 /end MEASUREMENT
/begin MEASUREMENT LV_ERR_SAP "Boolean for errorcurrently present on secondary air pump command signal" UBYTE _CNV_S_2_RANGE______21_R_CM 1 100. 0. 255. ECU_ADDRESS 0x3fd4e3 /end MEASUREMENT
/begin MEASUREMENT LV_ERR_LSH_DOWN_1 "Boolean error flag, fault currently present on upstream oxygen sensor heater circuit 1" UBYTE _CNV_S_2_RANGE______184_R_CM 1 100. 0. 255. ECU_ADDRESS 0x3fd3af /end MEASUREMENT
/begin MEASUREMENT LV_ERR_LSH_DOWN_2 "Boolean error flag, fault currently present on upstream oxygen sensor heater circuit 2" UBYTE _CNV_S_2_RANGE______184_R_CM 1 100. 0. 255. ECU_ADDRESS 0x3fd3b3 /end MEASUREMENT
/begin MEASUREMENT LV_ERR_LSH_UP_1 "Boolean error flag, fault currently present on upstream oxygen sensor heater circuit 1" UBYTE _CNV_S_2_RANGE______184_R_CM 1 100. 0. 255. ECU_ADDRESS 0x3fd3a7 /end MEASUREMENT
/begin MEASUREMENT LV_ERR_LSH_UP_2 "Boolean error flag, fault currently present on upstream oxygen sensor heater circuit 2" UBYTE _CNV_S_2_RANGE______184_R_CM 1 100. 0. 255. ECU_ADDRESS 0x3fd3ab /end MEASUREMENT
/begin MEASUREMENT TCO_DIF_DIAG "Difference between minimum and maximum measured coolant temperature value." UBYTE _CNV_A_R_LINEAR_____1_CM 1 100. 0. 190.5 ECU_ADDRESS 0x3fde4f FORMAT "%5.1" /end MEASUREMENT
/begin MEASUREMENT TCO_MIN_DIAG "Measured coolant temperature minimum value." UBYTE _CNV_A_R_LINEAR_____0_CM 1 100. -48. 142.5 ECU_ADDRESS 0x3fde50 FORMAT "%5.1" /end MEASUREMENT
/begin MEASUREMENT TCO_MAX_DIAG "Measured coolant temperature maximum value." UBYTE _CNV_A_R_LINEAR_____0_CM 1 100. -48. 142.5 ECU_ADDRESS 0x3fde51 FORMAT "%5.1" /end MEASUREMENT
/begin MEASUREMENT TCO_SUB_DIF_DIAG "Difference between minimum and maximum substitute coolant temperature value." UBYTE _CNV_A_R_LINEAR_____1_CM 1 100. 0. 190.5 ECU_ADDRESS 0x3fde52 FORMAT "%5.1" /end MEASUREMENT
/begin MEASUREMENT TCO_SUB_MIN_DIAG "Substitute coolant temperature minimum value." UBYTE _CNV_A_R_LINEAR_____0_CM 1 100. -48. 142.5 ECU_ADDRESS 0x3fde53 FORMAT "%5.1" /end MEASUREMENT
/begin MEASUREMENT TCO_SUB_MAX_DIAG "Substitute coolant temperature maximum value." UBYTE _CNV_A_R_LINEAR_____0_CM 1 100. -48. 142.5 ECU_ADDRESS 0x3fde54 FORMAT "%5.1" /end MEASUREMENT
/begin CHARACTERISTIC IP_TCO_SUB_DIF_MIN_DIAG__TCO_ST "Minimum substitute coolant temperature increase to perform stuck signal diagnosis" CURVE 0x507a6 _REC_CUR_20_u1_u1 190.5 _CNV_A_R_LINEAR_____1_CM 0. 190.5 FORMAT "%5.1"
 /begin AXIS_DESCR COM_AXIS TCO_ST _CNV_A_R_LINEAR_____0_CM 6 -48. 142.5 FORMAT "%5.1" AXIS_PTS_REF ldpm_tco_st__tco_dif_diag /end AXIS_DESCR
/end CHARACTERISTIC
/begin CHARACTERISTIC IP_TCO_MES_DIF_MIN_DIAG__TCO_ST "Minimum measured coolant temperature increase to detect a stuck signal" CURVE 0x507a0 _REC_CUR_20_u1_u1 190.5 _CNV_A_R_LINEAR_____1_CM 0. 190.5 FORMAT "%5.1"
 /begin AXIS_DESCR COM_AXIS TCO_ST _CNV_A_R_LINEAR_____0_CM 6 -48. 142.5 FORMAT "%5.1" AXIS_PTS_REF ldpm_tco_st__tco_dif_diag /end AXIS_DESCR
/end CHARACTERISTIC
/begin MEASUREMENT LV_ERR_TCO "TCO error detected" UBYTE _CNV_S_2_RANGE______184_R_CM 1 100. 0. 255. ECU_ADDRESS 0x3fcc96 /end MEASUREMENT
/begin AXIS_PTS ldpm_tco_st__tco_dif_diag "" 0x44036 TCO_ST _REC_AXS_20_u1 190.5 _CNV_A_R_LINEAR_____0_CM 6 -48. 142.5 FORMAT "%5.1" /end AXIS_PTS
/begin MEASUREMENT LV_ERR_TCO_EL "TCO Signal range error active/passive" UBYTE _CNV_S_2_RANGE______184_R_CM 1 100. 0. 255. ECU_ADDRESS 0x3fd4ef /end MEASUREMENT
/begin MEASUREMENT LV_ERR_TCO_STUCK "TCO Stuck signal detected" UBYTE _CNV_S_2_RANGE______184_R_CM 1 100. 0. 255. ECU_ADDRESS 0x3fd4f3 /end MEASUREMENT
/begin MEASUREMENT LV_ERR_TCO_GRD "Boolean for error currently present on coolant temperature signal (gradient of the signal implausible)." UBYTE _CNV_S_2_RANGE______184_R_CM 1 100. 0. 255. ECU_ADDRESS 0x3fd4f7 /end MEASUREMENT
/begin MEASUREMENT LV_ERR_TCO_PLAUS "Boolean for error currently present on TCO-sensor." UBYTE _CNV_S_2_RANGE______184_R_CM 1 100. 0. 255. ECU_ADDRESS 0x3fd503 /end MEASUREMENT
/begin MEASUREMENT T_TCO_MIN "Time after start where TCO Plaus diagnosis is inhibited" UWORD _CNV_A_R_LINEAR_____47_CM 1 100. 0. 65535. ECU_ADDRESS 0x3fde5c FORMAT "%5.0" /end MEASUREMENT
/begin CHARACTERISTIC ID_T_TCO_MIN__TIA "Locking time after start for lambda activation monitoring" CURVE 0x45ec0 _REC_CUR_20_u2_u1 65534. _CNV_A_R_LINEAR_____47_CM 1. 65535. FORMAT "%5.0"
 /begin AXIS_DESCR COM_AXIS TIA _CNV_A_R_LINEAR_____0_CM 6 -48. 142.5 FORMAT "%5.1" AXIS_PTS_REF ldpm_tia_1 /end AXIS_DESCR
/end CHARACTERISTIC
/begin MEASUREMENT LV_ERR_TOUT_ICL_2 "logical variable timeout error CAN message INSTR2" UBYTE _CNV_S_2_RANGE______21_R_CM 1 100. 0. 255. ECU_ADDRESS 0x3fd3ff /end MEASUREMENT
/begin MEASUREMENT LV_ERR_TOUT_ICL_3 "logical variable timeout error CAN message INSTR3" UBYTE _CNV_S_2_RANGE______21_R_CM 1 100. 0. 255. ECU_ADDRESS 0x3fd403 /end MEASUREMENT
/begin CHARACTERISTIC C_V_TPS_MIN_DIAG_1 "lower diagnostic voltage, pot  1" VALUE 0x4314a _REC_VAL_20_u2 4.99511719 _CNV_A_R_LINEAR_____33_CM 0. 4.99511719 FORMAT "%5.3" /end CHARACTERISTIC
/begin CHARACTERISTIC C_V_TPS_MIN_DIAG_2 "lower diagnostic voltage, pot  2" VALUE 0x4314c _REC_VAL_20_u2 4.99511719 _CNV_A_R_LINEAR_____33_CM 0. 4.99511719 FORMAT "%5.3" /end CHARACTERISTIC
/begin CHARACTERISTIC C_V_TPS_MAX_DIAG_2 "upper diagnostic voltage, pot  2" VALUE 0x43148 _REC_VAL_20_u2 4.99511719 _CNV_A_R_LINEAR_____33_CM 0. 4.99511719 FORMAT "%5.3" /end CHARACTERISTIC
/begin MEASUREMENT TPS_MAF_DIF_2 "Deviation of the substitute DK angle from TPS_2" UWORD _CNV_A_R_LINEAR_____95_CM 1 100. 0. 1389. ECU_ADDRESS 0x3fd09e FORMAT "%7.2" /end MEASUREMENT
/begin MEASUREMENT TPS_MAF_DIF_INT_2 "Sum of deviation between DK substitute value and TPS_2" UWORD _CNV_A_R_LINEAR_____95_CM 1 100. 0. 1389. ECU_ADDRESS 0x3fd0a2 FORMAT "%7.2" /end MEASUREMENT
/begin MEASUREMENT TPS_MAF_DIF_INT_1 "Sum of deviation between DK substitute value and TPS_1" UWORD _CNV_A_R_LINEAR_____95_CM 1 100. 0. 1389. ECU_ADDRESS 0x3fd0a0 FORMAT "%7.2" /end MEASUREMENT
/begin MEASUREMENT MAF_SUB_1 "Substitute mass air flow calculated with TPS_AV_1" UWORD _CNV_A_R_LINEAR_____95_CM 1 100. 0. 1389. ECU_ADDRESS 0x3fd0a4 FORMAT "%7.2" /end MEASUREMENT
/begin MEASUREMENT MAF_SUB_2 "Substitute mass air flow calculated with TPS_AV_2" UWORD _CNV_A_R_LINEAR_____95_CM 1 100. 0. 1389. ECU_ADDRESS 0x3fd0a6 FORMAT "%7.2" /end MEASUREMENT
/begin MEASUREMENT LV_ERR_TPS_RATIO "Logic variable (set if TPS ratio has been identified as faulty)" UBYTE _CNV_S_2_RANGE______21_R_CM 1 100. 0. 255. ECU_ADDRESS 0x3fd0ab /end MEASUREMENT
/begin CHARACTERISTIC C_V_TPS_MAX_DIAG_1 "upper diagnostic voltage, pot  1" VALUE 0x43146 _REC_VAL_20_u2 4.99511719 _CNV_A_R_LINEAR_____33_CM 0. 4.99511719 FORMAT "%5.3" /end CHARACTERISTIC
/begin CHARACTERISTIC C_V_TPS_RATIO_HYS "Admissible deviation of DK angle" VALUE 0x4314e _REC_VAL_20_u2 4.99511719 _CNV_A_R_LINEAR_____33_CM 0. 4.99511719 FORMAT "%5.3" /end CHARACTERISTIC
/begin CHARACTERISTIC C_MAF_MES_MAX_TPS_DIAG "Maximum threshold for usable air mass flow signal" VALUE 0x42e6c _REC_VAL_20_u2 1389. _CNV_A_R_LINEAR_____95_CM 0. 1389. FORMAT "%7.2" /end CHARACTERISTIC
/begin CHARACTERISTIC IP_MAF_ADD_TIA_FAC__TIA "Correction of air density" CURVE 0x4fab9 _REC_CUR_20_u1_u1 1.9921875 _CNV_A_R_LINEAR_____103_CM 0. 1.9921875 FORMAT "%5.3"
 /begin AXIS_DESCR COM_AXIS TIA _CNV_A_R_LINEAR_____0_CM 6 -48. 142.5 FORMAT "%5.1" AXIS_PTS_REF ldpm_tia_1 /end AXIS_DESCR
/end CHARACTERISTIC
/begin CHARACTERISTIC IP_FAC_TCO_TQI__TCO "Coolant temperature correction" CURVE 0x4e533 _REC_CUR_20_u1_u1 1.9921875 _CNV_A_R_LINEAR_____103_CM 0. 1.9921875 FORMAT "%5.3"
 /begin AXIS_DESCR COM_AXIS TCO _CNV_A_R_LINEAR_____0_CM 6 -48. 142.5 FORMAT "%5.1" AXIS_PTS_REF ldpm_tco__fac_tco_tqi /end AXIS_DESCR
/end CHARACTERISTIC
/begin MEASUREMENT TPS_MAF_DIF_1 "Deviation of the substitute DK angle from TPS_1" UWORD _CNV_A_R_LINEAR_____95_CM 1 100. 0. 1389. ECU_ADDRESS 0x3fd09c FORMAT "%7.2" /end MEASUREMENT
/begin MEASUREMENT TPS_MAF_DIF_MMV_1 "moving mean value of the difference between the DK position 1 and the map value" UWORD _CNV_A_R_LINEAR_____95_CM 1 100. 0. 1389. ECU_ADDRESS 0x3fe70a FORMAT "%7.2" /end MEASUREMENT
/begin MEASUREMENT TPS_MAF_DIF_MMV_2 "moving mean value of the difference between the DK position 2 and the map value" UWORD _CNV_A_R_LINEAR_____95_CM 1 100. 0. 1389. ECU_ADDRESS 0x3fe70c FORMAT "%7.2" /end MEASUREMENT
/begin CHARACTERISTIC C_TPS_MAF_DIF_MMV_THD "Limit  for calculation of the floating mean value of the deviation between channel X and map value" VALUE 0x430b8 _REC_VAL_20_u2 1389. _CNV_A_R_LINEAR_____95_CM 0. 1389. FORMAT "%7.2" /end CHARACTERISTIC
/begin CHARACTERISTIC C_TPS_MAF_CRLC_DIF "Correlation constant for filtering of error (second error)" VALUE 0x430b4 _REC_VAL_20_u2 0.99998474 _CNV_A_R_LINEAR_____31_CM 0. 0.99998474 FORMAT "%7.5" /end CHARACTERISTIC
/begin CHARACTERISTIC C_T_TPS_DIF_INT "Integration time for deviation between measured and calculated DK value" VALUE 0x42a2f _REC_VAL_20_u1 1.275 _CNV_A_R_LINEAR_____367_CM 0. 1.275 FORMAT "%5.3" /end CHARACTERISTIC
/begin CHARACTERISTIC C_TPS_MAF_DIF_INT_THD "Limit for integrated deviation between DK angle channel X and map value" VALUE 0x430b6 _REC_VAL_20_u2 1389. _CNV_A_R_LINEAR_____95_CM 0. 1389. FORMAT "%7.2" /end CHARACTERISTIC
/begin CHARACTERISTIC C_MAF_DIF_TPS_DIAG "Normalisationfactor for deviation" VALUE 0x42e0e _REC_VAL_20_u2 0.99998474 _CNV_A_R_LINEAR_____31_CM 0. 0.99998474 FORMAT "%7.5" /end CHARACTERISTIC
/begin AXIS_PTS ldpm_tco__fac_tco_tqi "" 0x43f9b TCO _REC_AXS_20_u1 190.5 _CNV_A_R_LINEAR_____0_CM 6 -48. 142.5 FORMAT "%5.1" /end AXIS_PTS
/begin AXIS_PTS ldpm_n_32_6 "" 0x43d64 N_32 _REC_AXS_20_u1 8160. _CNV_A_R_LINEAR_____5_CM 16 0. 8160. FORMAT "%4.0" /end AXIS_PTS
/begin MEASUREMENT LV_ERR_TPS_2 "Logic variable  (set if  TPS_2 is being identified as errored)" UBYTE _CNV_S_2_RANGE______21_R_CM 1 100. 0. 255. ECU_ADDRESS 0x3fd457 /end MEASUREMENT
/begin MEASUREMENT LV_ERR_TPS_MAF_1 "Logic variable (set if TPS_1 has been identified as faulty by the ratio check)" UBYTE _CNV_S_2_RANGE______21_R_CM 1 100. 0. 255. ECU_ADDRESS 0x3fd45b /end MEASUREMENT
/begin MEASUREMENT LV_ERR_TPS_MAF_2 "Logic variable(set if TPS_2 has been identified as faulty by the ratio check)" UBYTE _CNV_S_2_RANGE______21_R_CM 1 100. 0. 255. ECU_ADDRESS 0x3fd45f /end MEASUREMENT
/begin MEASUREMENT LV_ERR_TPS_1 "Logic variable  (set if  TPS_1 is being identified as errored)" UBYTE _CNV_S_2_RANGE______21_R_CM 1 100. 0. 255. ECU_ADDRESS 0x3fd453 /end MEASUREMENT
/begin MEASUREMENT LV_ERR_MTC_DR "MTC_DR-error is present" UBYTE _CNV_S_2_RANGE______21_R_CM 1 100. 0. 255. ECU_ADDRESS 0x3fd47b /end MEASUREMENT
/begin AXIS_PTS ldp_tps_av__maf_1_diag "" 0x44b30 TPS_AV _REC_AXS_20_u2 119.5 _CNV_A_R_LINEAR_____440_CM 16 0. 119.5 FORMAT "%7.3" /end AXIS_PTS
/begin AXIS_PTS ldp_n_32__tps_max_ratio_diag "" 0x43610 N_32 _REC_AXS_20_u1 8160. _CNV_A_R_LINEAR_____5_CM 4 0. 8160. FORMAT "%4.0" /end AXIS_PTS
/begin CHARACTERISTIC IP_MAF_1_DIAG__N__TPS_AV "Substitute mass air flow through MTC" MAP 0x48e12 _REC_MAP_20_u2_u1_u2 1389. _CNV_A_R_LINEAR_____95_CM 0. 1389. FORMAT "%7.2"
 /begin AXIS_DESCR COM_AXIS N_32 _CNV_A_R_LINEAR_____5_CM 16 0. 8160. FORMAT "%4.0" AXIS_PTS_REF ldpm_n_32_6 /end AXIS_DESCR
 /begin AXIS_DESCR COM_AXIS TPS_AV _CNV_A_R_LINEAR_____440_CM 16 0. 119.5 FORMAT "%7.3" AXIS_PTS_REF ldp_tps_av__maf_1_diag /end AXIS_DESCR
/end CHARACTERISTIC
/begin CHARACTERISTIC IP_TPS_MAX_TPS_RATIO_DIAG "Maximum throttle angle for TPS ratio diagnosis" CURVE 0x4bb1c _REC_CUR_20_u2_u1 119.5 _CNV_A_R_LINEAR_____226_CM 0. 119.5 FORMAT "%7.3"
 /begin AXIS_DESCR COM_AXIS N_32 _CNV_A_R_LINEAR_____5_CM 4 0. 8160. FORMAT "%4.0" AXIS_PTS_REF ldp_n_32__tps_max_ratio_diag /end AXIS_DESCR
/end CHARACTERISTIC
/begin MEASUREMENT LV_ERR_TOUT_AMT_1 "logical variable timeout error CAN message SSG1" UBYTE _CNV_S_2_RANGE______21_R_CM 1 100. 0. 255. ECU_ADDRESS 0x3fd413 /end MEASUREMENT
/begin MEASUREMENT LV_ERR_TOUT_ETCU_1 "logical variable timeout error CAN message EGS1" UBYTE _CNV_S_2_RANGE______21_R_CM 1 100. 0. 255. ECU_ADDRESS 0x3fd3f7 /end MEASUREMENT
/begin MEASUREMENT LV_ERR_TOUT_ASR_1 "logical variable timeout error CAN message ASC1" UBYTE _CNV_S_2_RANGE______21_R_CM 1 100. 0. 255. ECU_ADDRESS 0x3fd407 /end MEASUREMENT
/begin MEASUREMENT LV_ERR_TOUT_ASR_3 "logical variable timeout error CAN message ASC3 " UBYTE _CNV_S_2_RANGE______21_R_CM 1 100. 0. 255. ECU_ADDRESS 0x3fd40b /end MEASUREMENT
/begin MEASUREMENT LV_ERR_CAN_BOFF "logical variableCAN bus off in bus off mode" UBYTE _CNV_S_2_RANGE______21_R_CM 1 100. 0. 255. ECU_ADDRESS 0x3fd4d3 /end MEASUREMENT
/begin MEASUREMENT LV_ERR_ISA_1 "electrical error idle speed actuator (ISA) coil 1 (opening)" UBYTE _CNV_S_2_RANGE______21_R_CM 1 100. 0. 255. ECU_ADDRESS 0x3fd51f /end MEASUREMENT
/begin MEASUREMENT LV_ERR_ISA_2 "electrical error idle speed actuator (ISA) coil 2 (closing)" UBYTE _CNV_S_2_RANGE______21_R_CM 1 100. 0. 255. ECU_ADDRESS 0x3fd523 /end MEASUREMENT
/begin MEASUREMENT LV_ERR_MEC_ISA "error bit mechanical fault at ISA-valve" UBYTE _CNV_S_2_RANGE______21_R_CM 1 100. 0. 255. ECU_ADDRESS 0x3fd527 /end MEASUREMENT
/begin MEASUREMENT LV_ERR_TOUT_PSTE_1 "logical variable timeout error CAN message LWS1" UBYTE _CNV_S_2_RANGE______21_R_CM 1 100. 0. 255. ECU_ADDRESS 0x3fd40f /end MEASUREMENT
/begin MEASUREMENT LV_GEN_ERR_MEC_ACT "mechanical error currently present on Generator " UBYTE _CNV_S_2_RANGE______21_R_CM 1 100. 0. 255. ECU_ADDRESS 0x3fc58b /end MEASUREMENT
/begin MEASUREMENT LV_GEN_ERR_TEMP_ACT "High temperature  error currently present on Generator" UBYTE _CNV_S_2_RANGE______21_R_CM 1 100. 0. 255. ECU_ADDRESS 0x3fc58c /end MEASUREMENT
/begin MEASUREMENT LV_GEN_ERR_EL_ACT "ele error currently present on Generator BSD Interface" UBYTE _CNV_S_2_RANGE______21_R_CM 1 100. 0. 255. ECU_ADDRESS 0x3fc58d /end MEASUREMENT
/begin MEASUREMENT LV_GEN_ERR_PLAUS_ACT "Boolean for error currently present on Generator BSD Interface" UBYTE _CNV_S_2_RANGE______21_R_CM 1 100. 0. 255. ECU_ADDRESS 0x3fc58e /end MEASUREMENT
/begin MEASUREMENT LV_GEN_ERR_TOUT_ACT "Boolean for error currently present on Generator BSD Interface active" UBYTE _CNV_S_2_RANGE______21_R_CM 1 100. 0. 255. ECU_ADDRESS 0x3fc58f /end MEASUREMENT
/begin MEASUREMENT LV_GEN_ERR_ACT "error currently present on Generator " UBYTE _CNV_S_2_RANGE______21_R_CM 1 100. 0. 255. ECU_ADDRESS 0x3fc590 /end MEASUREMENT
/begin CHARACTERISTIC C_T_TIA_TCO_DIAG "Time condition - TIA diagnosis" VALUE 0x43042 _REC_VAL_20_u2 65534. _CNV_A_R_LINEAR_____47_CM 1. 65535. FORMAT "%5.0" /end CHARACTERISTIC
/begin CHARACTERISTIC C_TCO_GRD_MAX_DIAG "Maximum allowed gradient for the coolant temperature signal" VALUE 0x42a58 _REC_VAL_20_u1 38.1 _CNV_A_R_LINEAR_____1_CM 0. 190.5 FORMAT "%5.1" /end CHARACTERISTIC
/begin CHARACTERISTIC C_TCO_MAX_DIAG "maximum permissible coolant temperature" VALUE 0x42a5c _REC_VAL_20_u1 28.575 _CNV_A_R_LINEAR_____0_CM -48. 142.5 FORMAT "%5.1" /end CHARACTERISTIC
/begin CHARACTERISTIC C_TCO_MIN_DIAG "minimum permissible coolant temperature" VALUE 0x42a66 _REC_VAL_20_u1 28.575 _CNV_A_R_LINEAR_____0_CM -48. 142.5 FORMAT "%5.1" /end CHARACTERISTIC
/begin CHARACTERISTIC C_TIA_TCO_DIAG "TIA condition - TCO_EX diagnosis" VALUE 0x42abc _REC_VAL_20_u1 190.5 _CNV_A_R_LINEAR_____0_CM -48. 142.5 FORMAT "%5.1" /end CHARACTERISTIC
/begin AXIS_PTS ldpm_tia_1 "" 0x4404b TIA _REC_AXS_20_u1 190.5 _CNV_A_R_LINEAR_____0_CM 6 -48. 142.5 FORMAT "%5.1" /end AXIS_PTS
/begin CHARACTERISTIC C_V_PVS_MAX_DIAG_1 "Upper diagnosis threshold channel 1" VALUE 0x43124 _REC_VAL_20_u2 4.99511719 _CNV_A_R_LINEAR_____33_CM 0. 4.99511719 FORMAT "%5.3" /end CHARACTERISTIC
/begin CHARACTERISTIC C_V_PVS_MAX_DIAG_2 "Upper diagnosis threshold channel 2" VALUE 0x43126 _REC_VAL_20_u2 4.99511719 _CNV_A_R_LINEAR_____33_CM 0. 4.99511719 FORMAT "%5.3" /end CHARACTERISTIC
/begin MEASUREMENT LV_INH_DIAG_ISC "Flag for inhibitation of the idle speed control diagnosis" UBYTE _CNV_S_2_RANGE______11_CM 1 100. 0. 1. ECU_ADDRESS 0x3fcf81 /end MEASUREMENT
/begin COMPU_METHOD _CNV_A_R_LINEAR_____0_CM "" RAT_FUNC "%6.3" "°C" COEFFS 0 1.333333333333333 64. 0 0 1 /end COMPU_METHOD
/begin COMPU_METHOD _CNV_A_R_LINEAR_____1_CM "" RAT_FUNC "%6.3" "°C" COEFFS 0 1.333333333333333 0. 0 0 1 /end COMPU_METHOD
/begin COMPU_METHOD _CNV_A_R_LINEAR_____4_CM "" RAT_FUNC "%6.3" "%" COEFFS 0 2.56 0. 0 0 1 /end COMPU_METHOD
/begin COMPU_METHOD _CNV_A_R_LINEAR_____5_CM "" RAT_FUNC "%6.3" "rpm" COEFFS 0 3.125e-002 0. 0 0 1 /end COMPU_METHOD
/begin COMPU_METHOD _CNV_A_R_LINEAR_____10_CM "" RAT_FUNC "%6.3" "-" COEFFS 0 1. 0. 0 0 1 /end COMPU_METHOD
/begin COMPU_METHOD _CNV_S_2_RANGE______11_CM "" TAB_VERB "%6.3" "-" COMPU_TAB_REF _CNV_S_2_RANGE______11 /end COMPU_METHOD
/begin COMPU_VTAB _CNV_S_2_RANGE______11 "" TAB_VERB 2 0 "0" 1 "1" /end COMPU_VTAB
/begin COMPU_METHOD _CNV_A_R_LINEAR_____12_CM "" RAT_FUNC "%6.3" "[-]" COEFFS 0 1. 0. 0 0 1 /end COMPU_METHOD
/begin COMPU_METHOD _CNV_A_R_LINEAR_____13_CM "" RAT_FUNC "%6.3" "km/h" COEFFS 0 1. 0. 0 0 1 /end COMPU_METHOD
/begin COMPU_METHOD _CNV_A_R_LINEAR_____14_CM "" RAT_FUNC "%6.3" "s" COEFFS 0 10. 0. 0 0 1 /end COMPU_METHOD
/begin COMPU_METHOD _CNV_A_R_LINEAR_____15_CM "" RAT_FUNC "%6.3" "-" COEFFS 0 4095.999999839998 -1.280019205296412e-006 0 0 1 /end COMPU_METHOD
/begin COMPU_METHOD _CNV_A_R_LINEAR_____16_CM "" RAT_FUNC "%6.3" "µs" COEFFS 0 -1. 0. 0 0 1 /end COMPU_METHOD
/begin COMPU_METHOD _CNV_A_R_LINEAR_____17_CM "" RAT_FUNC "%6.3" "rpm" COEFFS 0 1. 0. 0 0 1 /end COMPU_METHOD
/begin COMPU_METHOD _CNV_A_R_LINEAR_____18_CM "" RAT_FUNC "%6.3" "mg/stk" COEFFS 0 0.183585313174946 0. 0 0 1 /end COMPU_METHOD
/begin COMPU_METHOD _CNV_A_R_LINEAR_____19_CM "" RAT_FUNC "%6.3" "-" COEFFS 0 127.9983874218908 1.612578109245533e-003 0 0 1 /end COMPU_METHOD
/begin COMPU_METHOD _CNV_A_R_LINEAR_____20_CM "" RAT_FUNC "%6.3" "-" COEFFS 0 255.9983911655618 0. 0 0 1 /end COMPU_METHOD
/begin COMPU_METHOD _CNV_S_2_RANGE______21_R_CM "" TAB_VERB "%6.3" "[-]" COMPU_TAB_REF _CNV_S_2_RANGE______21_R /end COMPU_METHOD
/begin COMPU_VTAB_RANGE _CNV_S_2_RANGE______21_R "" 2 0 0 "0" 1 255 "1" /end COMPU_VTAB_RANGE
/begin COMPU_METHOD _CNV_S_6_RANGE_ERR__22_CM "" TAB_VERB "%6.3" "[-]" COMPU_TAB_REF _CNV_S_6_RANGE_ERR__22 /end COMPU_METHOD
/begin COMPU_VTAB _CNV_S_6_RANGE_ERR__22 "" TAB_VERB 6 0 "NO_SYM" 1 "SYM_0" 2 "SYM_1" 4 "SYM_2" 8 "SYM_3" 15 "BENCH_MODE" /end COMPU_VTAB
/begin COMPU_METHOD _CNV_A_R_LINEAR_____23_CM "" RAT_FUNC "%6.3" "ms" COEFFS 0 0.1 0. 0 0 1 /end COMPU_METHOD
/begin COMPU_METHOD _CNV_A_R_LINEAR_____26_CM "" RAT_FUNC "%6.3" "V" COEFFS 0 9.846168103048838 0. 0 0 1 /end COMPU_METHOD
/begin COMPU_METHOD _CNV_A_R_LINEAR_____27_CM "" RAT_FUNC "%6.3" "s" COEFFS 0 100. 0. 0 0 1 /end COMPU_METHOD
/begin COMPU_METHOD _CNV_S_2_RANGE______28_CM "" TAB_VERB "%6.3" "[-]" COMPU_TAB_REF _CNV_S_2_RANGE______28 /end COMPU_METHOD
/begin COMPU_VTAB _CNV_S_2_RANGE______28 "" TAB_VERB 2 0 "0" 1 "1" /end COMPU_VTAB
/begin COMPU_METHOD _CNV_A_R_LINEAR_____31_CM "" RAT_FUNC "%6.3" "-" COEFFS 0 65536.00007936121 0. 0 0 1 /end COMPU_METHOD
/begin COMPU_METHOD _CNV_A_R_LINEAR_____33_CM "" RAT_FUNC "%6.3" "V" COEFFS 0 204.7999998974999 0. 0 0 1 /end COMPU_METHOD
/begin COMPU_METHOD _CNV_A_R_LINEAR_____37_CM "" RAT_FUNC "%6.3" "V" COEFFS 0 102.4003523452984 0. 0 0 1 /end COMPU_METHOD
/begin COMPU_METHOD _CNV_A_R_LINEAR_____44_CM "" RAT_FUNC "%6.3" "[-]" COEFFS 0 255.9999357490357 0. 0 0 1 /end COMPU_METHOD
/begin COMPU_METHOD _CNV_A_R_LINEAR_____47_CM "" RAT_FUNC "%6.3" "s" COEFFS 0 1. 0. 0 0 1 /end COMPU_METHOD
/begin COMPU_METHOD _CNV_A_R_LINEAR_____75_CM "" RAT_FUNC "%6.3" "°CRK" COEFFS 0 2.666666666666667 0. 0 0 1 /end COMPU_METHOD
/begin COMPU_METHOD _CNV_S_4_RANGE_STAT_76_CM "" TAB_VERB "%6.3" "-" COMPU_TAB_REF _CNV_S_4_RANGE_STAT_76 /end COMPU_METHOD
/begin COMPU_VTAB _CNV_S_4_RANGE_STAT_76 "" TAB_VERB 4 0 "CAM_EDGE_NO_ERROR" 1 "CAM_EDGE_BELOW" 2 "CAM_EDGE_ABOVE" 4 "CAM_EDGE_WRONG" /end COMPU_VTAB
/begin COMPU_METHOD _CNV_S_7_RANGE_STAT_77_CM "" TAB_VERB "%6.3" "[-]" COMPU_TAB_REF _CNV_S_7_RANGE_STAT_77 /end COMPU_METHOD
/begin COMPU_VTAB _CNV_S_7_RANGE_STAT_77 "" TAB_VERB 7 0 "BIOS_EPO_CAM_SYNC" 4 "BIOS_EPO_CAM_SEG_VLD" 5 "BIOS_EPO_CAM_FIRST_SEG" 6 "BIOS_EPO_CAM_SEC_EDGE" 7 "BIOS_EPO_CAM_FIRST_EDGE" 8 "BIOS_EPO_CAM_ASW_ACT" 9 "BIOS_EPO_CAM_PAS" /end COMPU_VTAB
/begin COMPU_METHOD _CNV_A_R_LINEAR_____95_CM "" RAT_FUNC "%6.3" "mg/stk" COEFFS 0 47.18142548596112 0. 0 0 1 /end COMPU_METHOD
/begin COMPU_METHOD _CNV_A_R_LINEAR_____98_CM "" RAT_FUNC "%6.3" "%" COEFFS 0 655.3600000071681 3.584063961170614e-007 0 0 1 /end COMPU_METHOD
/begin COMPU_METHOD _CNV_A_R_LINEAR_____99_CM "" RAT_FUNC "%6.3" "kg/h" COEFFS 0 8191.999999679995 0. 0 0 1 /end COMPU_METHOD
/begin COMPU_METHOD _CNV_A_R_LINEAR_____103_CM "" RAT_FUNC "%6.3" "-" COEFFS 0 128. 0. 0 0 1 /end COMPU_METHOD
/begin COMPU_METHOD _CNV_S_5_RANGE_STAT_119_CM "" TAB_VERB "%6.3" "[-]" COMPU_TAB_REF _CNV_S_5_RANGE_STAT_119 /end COMPU_METHOD
/begin COMPU_VTAB _CNV_S_5_RANGE_STAT_119 "" TAB_VERB 5 0 "BIOS_EPO_CRK_DIAG_NO_ERR" 1 "BIOS_EPO_CRK_DIAG_ENG_PSN_ERR" 2 "BIOS_EPO_CRK_DIAG_TOOTH_PER_ERR" 4 "BIOS_EPO_CRK_DIAG_TPUA_SYN_ERR" 8 "BIOS_EPO_CRK_DIAG_TPUB_SYN_ERR" /end COMPU_VTAB
/begin COMPU_METHOD _CNV_S_10_RANGE_CRK__120_CM "" TAB_VERB "%6.3" "[-]" COMPU_TAB_REF _CNV_S_10_RANGE_CRK__120 /end COMPU_METHOD
/begin COMPU_VTAB _CNV_S_10_RANGE_CRK__120 "" TAB_VERB 10 0 "BIOS_EPO_CRK_SYNC" 1 "BIOS_EPO_CRK_SYNC_CHK_MIS" 2 "BIOS_EPO_CRK_SYNC_GAP_SIM" 3 "BIOS_EPO_CRK_SYNC_CHK_GAP" 4 "BIOS_EPO_CRK_SYNC_GAP" 5 "BIOS_CRK_VLD_TEETH" 6 "BIOS_CRK_FIRST_TOOTH" 7 "BIOS_EPO_CRK_SENS_DLY" 8 "BIOS_EPO_CRK_FIRST_EDGE" 9 "BIOS_EPO_CRK_PAS" /end COMPU_VTAB
/begin COMPU_METHOD _CNV_S_5_RANGE_STAT_121_CM "" TAB_VERB "%6.3" "[-]" COMPU_TAB_REF _CNV_S_5_RANGE_STAT_121 /end COMPU_METHOD
/begin COMPU_VTAB _CNV_S_5_RANGE_STAT_121 "" TAB_VERB 5 0 "CRK_SYN_REQ_CAM_0" 1 "CRK_SYN_REQ_CAM_1" 2 "CAM_0_SYN_REQ" 3 "CAM_1_SYN_REQ" 4 "SYN_DISABLE" /end COMPU_VTAB
/begin COMPU_METHOD _CNV_A_R_LINEAR_____122_CM "" RAT_FUNC "%6.3" "-" COEFFS 0 2.666666666666667 0. 0 0 1 /end COMPU_METHOD
/begin COMPU_METHOD _CNV_S_2_RANGE______184_R_CM "" TAB_VERB "%6.3" "-" COMPU_TAB_REF _CNV_S_2_RANGE______184_R /end COMPU_METHOD
/begin COMPU_VTAB_RANGE _CNV_S_2_RANGE______184_R "" 2 0 0 "0" 1 255 "1" /end COMPU_VTAB_RANGE
/begin COMPU_METHOD _CNV_A_R_LINEAR_____208_CM "" RAT_FUNC "%6.3" "ms" COEFFS 0 250. 0. 0 0 1 /end COMPU_METHOD
/begin COMPU_METHOD _CNV_A_R_LINEAR_____226_CM "" RAT_FUNC "%6.3" "°TPS" COEFFS 0 137.0962343096234 0. 0 0 1 /end COMPU_METHOD
/begin COMPU_METHOD _CNV_A_R_LINEAR_____360_CM "" RAT_FUNC "%6.3" "ms" COEFFS 0 0.1 -1. 0 0 1 /end COMPU_METHOD
/begin COMPU_METHOD _CNV_A_R_LINEAR_____367_CM "" RAT_FUNC "%6.3" "s" COEFFS 0 200. 0. 0 0 1 /end COMPU_METHOD
/begin COMPU_METHOD _CNV_S_6_RANGE_STAT_388_CM "" TAB_VERB "%6.3" "[-]" COMPU_TAB_REF _CNV_S_6_RANGE_STAT_388 /end COMPU_METHOD
/begin COMPU_VTAB _CNV_S_6_RANGE_STAT_388 "" TAB_VERB 6 0 "no error" 1 "error active / no substitutes" 2 "error active / closing 100%" 3 "error active / substitute opening" 4 "error active / closing 0%" 5 "error active / limp home" /end COMPU_VTAB
/begin COMPU_METHOD _CNV_S_9_RANGE_STAT_393_CM "" TAB_VERB "%6.3" "-" COMPU_TAB_REF _CNV_S_9_RANGE_STAT_393 /end COMPU_METHOD
/begin COMPU_VTAB _CNV_S_9_RANGE_STAT_393 "" TAB_VERB 9 0 "PVS_NO_ERROR" 1 "PVS_LIH_PRED" 2 "PVS_LIH_1" 4 "PVS_LIH_2" 8 "PVS_LIH_MIN" 16 "PVS_DBL_ERROR" 32 "PVS_LIH_BLS" 64 "PVS_LIH_1_PRED" 128 "PVS_LIH_2_PRED" /end COMPU_VTAB
/begin COMPU_METHOD _CNV_A_R_LINEAR_____440_CM "" RAT_FUNC "%6.3" "°TPS" COEFFS 0 548.4100418410042 0. 0 0 1 /end COMPU_METHOD
/begin RECORD_LAYOUT _REC_VAL_20_u1 FNC_VALUES 1 UBYTE COLUMN_DIR DIRECT /end RECORD_LAYOUT
/begin RECORD_LAYOUT _REC_AXS_20_u1 NO_AXIS_PTS_X 1 UBYTE AXIS_PTS_X 2 UBYTE INDEX_INCR DIRECT /end RECORD_LAYOUT
/begin RECORD_LAYOUT _REC_CUR_20_u1_u1 FNC_VALUES 1 UBYTE COLUMN_DIR DIRECT /end RECORD_LAYOUT
/begin RECORD_LAYOUT _REC_MAP_20_u2_u2_u1 FNC_VALUES 1 UWORD COLUMN_DIR DIRECT /end RECORD_LAYOUT
/begin RECORD_LAYOUT _REC_AXS_20_u2 NO_AXIS_PTS_X 1 UWORD AXIS_PTS_X 2 UWORD INDEX_INCR DIRECT /end RECORD_LAYOUT
/begin RECORD_LAYOUT _REC_CUR_20_u2_u2 FNC_VALUES 1 UWORD COLUMN_DIR DIRECT /end RECORD_LAYOUT
/begin RECORD_LAYOUT _REC_VAL_20_u2 FNC_VALUES 1 UWORD COLUMN_DIR DIRECT /end RECORD_LAYOUT
/begin RECORD_LAYOUT _REC_CUR_20_u2_u1 FNC_VALUES 1 UWORD COLUMN_DIR DIRECT /end RECORD_LAYOUT
/begin RECORD_LAYOUT _REC_MAP_20_u2_u1_u1 FNC_VALUES 1 UWORD COLUMN_DIR DIRECT /end RECORD_LAYOUT
/begin RECORD_LAYOUT _REC_MAP_20_u2_u1_u2 FNC_VALUES 1 UWORD COLUMN_DIR DIRECT /end RECORD_LAYOUT
/begin RECORD_LAYOUT _REC_VAL_20_s2 FNC_VALUES 1 SWORD COLUMN_DIR DIRECT /end RECORD_LAYOUT
/begin FUNCTION DIA_Ignition_system_diagnosis "_Ignition system diagnosis"
 /begin DEF_CHARACTERISTIC C_IGA_OFF_CYCNR_HLD C_ABC_TD_IGC_CUT C_SUM_TD_IGC_CUT C_TCO_MIN_DUR_IGC_DIAG ID_V_DUR_IGC_MIN__N__MAF C_ESB_IGN_CUT_DIAG /end DEF_CHARACTERISTIC
 /begin OUT_MEASUREMENT LV_INH_IGC_0 LV_INH_IGC_1 LV_INH_IGC_2 LV_INH_IGC_3 LV_INH_IGC_4 LV_INH_IGC_5 LV_ERR_IGC IGC_DIAG_MIS LV_ERR_TD_IGC_CUT_0 LV_ERR_TD_IGC_CUT_1 LV_ERR_TD_IGC_CUT_2 LV_ERR_TD_IGC_CUT_3 LV_ERR_TD_IGC_CUT_4 LV_ERR_TD_IGC_CUT_5 LV_ERR_DUR_IGC_1 LV_ERR_DUR_IGC_2 LV_ERR_DUR_IGC_3 LV_ERR_DUR_IGC_4 LV_ERR_DUR_IGC_5 LV_ERR_DUR_IGC_0 /end OUT_MEASUREMENT
/end FUNCTION
/begin FUNCTION DIA_Throttle_position_sensor_dia "_Throttle position sensor diagnosis"
 /begin DEF_CHARACTERISTIC C_V_TPS_MIN_DIAG_1 C_V_TPS_MIN_DIAG_2 C_V_TPS_MAX_DIAG_2 C_V_TPS_MAX_DIAG_1 C_V_TPS_RATIO_HYS C_MAF_MES_MAX_TPS_DIAG IP_MAF_ADD_TIA_FAC__TIA IP_FAC_TCO_TQI__TCO C_TPS_MAF_DIF_MMV_THD C_TPS_MAF_CRLC_DIF C_T_TPS_DIF_INT C_TPS_MAF_DIF_INT_THD C_MAF_DIF_TPS_DIAG IP_MAF_1_DIAG__N__TPS_AV IP_TPS_MAX_TPS_RATIO_DIAG /end DEF_CHARACTERISTIC
 /begin OUT_MEASUREMENT TPS_MAF_DIF_2 TPS_MAF_DIF_INT_2 TPS_MAF_DIF_INT_1 MAF_SUB_1 MAF_SUB_2 LV_ERR_TPS_RATIO TPS_MAF_DIF_1 TPS_MAF_DIF_MMV_1 TPS_MAF_DIF_MMV_2 LV_ERR_TPS_2 LV_ERR_TPS_MAF_1 LV_ERR_TPS_MAF_2 LV_ERR_TPS_1 /end OUT_MEASUREMENT
/end FUNCTION
/begin FUNCTION DIA_Injection_valves_IV_1_to_6 "_Injection valves IV 1 to 6"
 /begin OUT_MEASUREMENT LV_ERR_IV_0 LV_ERR_IV_2 LV_ERR_IV_3 LV_ERR_IV_4 LV_ERR_IV_5 LV_ERR_IV_1 IV_DIAG_MIS /end OUT_MEASUREMENT
/end FUNCTION
/begin FUNCTION DIA_Canister_purge_valve_diagnos "_Canister purge valve diagnosis (CPS)" /begin DEF_CHARACTERISTIC C_CPPWM_SUB_DIAG_1 C_CPPWM_SUB_DIAG_2 /end DEF_CHARACTERISTIC /begin OUT_MEASUREMENT CPPWM_LIH LV_ERR_CPS /end OUT_MEASUREMENT /end FUNCTION
/begin FUNCTION DIA_ETC_driver_diagnosis "_ETC driver diagnosis" /begin OUT_MEASUREMENT LV_ERR_MTC_DR /end OUT_MEASUREMENT /end FUNCTION
/begin FUNCTION DIA_Lambda_sensor_upstream_heate "_Lambda sensor upstream heater diagnosis" /begin OUT_MEASUREMENT LV_ERR_LSH_UP_1 LV_ERR_LSH_UP_2 /end OUT_MEASUREMENT /end FUNCTION
/begin FUNCTION DIA_Lambda_sensor_downstream_hea "_Lambda sensor downstream heater diagnosis" /begin OUT_MEASUREMENT LV_ERR_LSH_DOWN_1 LV_ERR_LSH_DOWN_2 /end OUT_MEASUREMENT /end FUNCTION
/begin FUNCTION DIA_Generator_diagnosis "_Generator diagnosis"
 /begin OUT_MEASUREMENT LV_ERR_GEN LV_ERR_GEN_IF LV_GEN_ERR_MEC_ACT LV_GEN_ERR_TEMP_ACT LV_GEN_ERR_EL_ACT LV_GEN_ERR_PLAUS_ACT LV_GEN_ERR_TOUT_ACT LV_GEN_ERR_ACT /end OUT_MEASUREMENT
/end FUNCTION
/begin FUNCTION DIA_Crankshaft_Signal_Diagnosis_ "_Crankshaft Signal Diagnosis and Plausibility Check"
 /begin DEF_CHARACTERISTIC LC_INH_DET_REV_ENG C_CAM_EDGE_SUM_MAX C_CAM_DET_REV_ENG_MAX C_CAM_DET_REV_ENG_MIN /end DEF_CHARACTERISTIC
 /begin OUT_MEASUREMENT STATE_CRK_DIAG STATE_CRK_SYN STATE_SYN_REQ LV_ERR_CRK LV_DET_REV_ENG LV_ERR_ENG_PSN LV_ERR_TOOTH_PER LV_ERR_TPU_SYN LV_ERR_CRK_NOT_PLAUS /end OUT_MEASUREMENT
/end FUNCTION
/begin FUNCTION DIA_Camshaft_Sensor_Diagnosis_an "_Camshaft Sensor Diagnosis and Plausibility Check"
 /begin DEF_CHARACTERISTIC ID_WIN_BOL_CHK_CAM_0 ID_WIN_BOL_CHK_CAM_1 ID_WIN_TOL_CHK_CAM_1 ID_WIN_TOL_CHK_CAM_0 C_T_CAM_DIAG_MAX C_CAM_EDGE_DIF_MAX C_T_MAX_CAM_TOOTH_PER /end DEF_CHARACTERISTIC
 /begin OUT_MEASUREMENT LV_ERR_CAM_0 CAM_EDGE_CTR_0 CAM_EDGE_1 STATE_CAM_EDGE_CTR_0 STATE_CAM_EDGE_CTR_1 LV_ERR_CAM LV_ERR_CAM_1 LV_CAM_SYN_DET_0 LV_CAM_SYN_DET_1 CAM_EDGE_CTR_1 CAM_EDGE_CTR_DIAG_1 T_CAM_DIAG CAM_EDGE_0 STATE_CAM_SYN CAM_EDGE_CTR_DIAG_0 T_MAX_CAM_TOOTH_PER_0 T_MAX_CAM_TOOTH_PER_1 LV_ERR_CAM_PER_0 LV_ERR_CAM_PER_1 LV_ERR_CAM_PSN_0 LV_ERR_CAM_PSN_1 LV_ERR_CAM_0_NOT_PLAUS LV_ERR_CAM_1_NOT_PLAUS /end OUT_MEASUREMENT
/end FUNCTION
/begin FUNCTION DIA_Secondary_Air_Valve_Diagnosi "_Secondary Air Valve Diagnosis (SAV)" /begin OUT_MEASUREMENT LV_ERR_SAV /end OUT_MEASUREMENT /end FUNCTION
/begin FUNCTION DIA_Electronical_Cooling_Fan_Dia "_Electronical Cooling Fan Diagnosis (ECF)" /begin DEF_CHARACTERISTIC C_ECFPWM_MAX_DIAG C_ECFPWM_MIN_DIAG /end DEF_CHARACTERISTIC /begin OUT_MEASUREMENT LV_ERR_ECF /end OUT_MEASUREMENT /end FUNCTION
/begin FUNCTION DIA_Secondary_Air_Pump_Diagnosis "_Secondary Air Pump Diagnosis (SAP)" /begin OUT_MEASUREMENT LV_ERR_SAP /end OUT_MEASUREMENT /end FUNCTION
/begin FUNCTION DIA_Air_Condition_Compressor_Con "_Air Condition Compressor Control Relay Diagnosis (RLY_ACCOUT)" /begin OUT_MEASUREMENT LV_ERR_RLY_ACCOUT /end OUT_MEASUREMENT /end FUNCTION
/begin FUNCTION DIA_Main_Relay_Diagnosis__RLY_MA "_Main Relay Diagnosis (RLY_MAIN)"
 /begin DEF_CHARACTERISTIC C_T_RLY_MAIN_DIAG C_VB_RLY_MAIN_DIAG C_V_IGK_RLY_MAIN_DIAG C_T_DLY_RLY_MAIN_DIAG C_T_PREDRIVE_DLY_MAX /end DEF_CHARACTERISTIC
 /begin OUT_MEASUREMENT LV_ERR_RLY_MAIN T_RLY_MAIN_DIAG LV_ERR_RLY_MAIN_DLY /end OUT_MEASUREMENT
/end FUNCTION
/begin FUNCTION DIA_Coolant_Temperature_Sensor_D "_Coolant Temperature Sensor Diagnosis (TCO)"
 /begin DEF_CHARACTERISTIC IP_TCO_SUB_DIF_MIN_DIAG__TCO_ST IP_TCO_MES_DIF_MIN_DIAG__TCO_ST C_T_TIA_TCO_DIAG C_TCO_GRD_MAX_DIAG C_TCO_MAX_DIAG C_TCO_MIN_DIAG C_TIA_TCO_DIAG /end DEF_CHARACTERISTIC
 /begin OUT_MEASUREMENT TCO_DIF_DIAG TCO_MIN_DIAG TCO_MAX_DIAG TCO_SUB_DIF_DIAG TCO_SUB_MIN_DIAG TCO_SUB_MAX_DIAG LV_ERR_TCO LV_ERR_TCO_EL LV_ERR_TCO_STUCK LV_ERR_TCO_GRD /end OUT_MEASUREMENT
/end FUNCTION
/begin FUNCTION DIA_TCO_Sensor_Plausibility_Diag "_TCO-Sensor Plausibility Diagnosis for Lambda Control Activation Monitoring" /begin DEF_CHARACTERISTIC ID_T_TCO_MIN__TIA /end DEF_CHARACTERISTIC /begin OUT_MEASUREMENT LV_ERR_TCO_PLAUS T_TCO_MIN /end OUT_MEASUREMENT /end FUNCTION
/begin FUNCTION DIA_Idle_Speed_Control_Diagnosis "_Idle Speed Control Diagnosis"
 /begin DEF_CHARACTERISTIC C_N_DIF_MAX_DIAG_ISC C_N_DIF_MIN_DIAG_ISC C_T_DLY_ISC_DIAG C_MAF_MAX_DIAG_ISC C_FLOW_CPS_MAX_DIAG_ISC /end DEF_CHARACTERISTIC
 /begin OUT_MEASUREMENT T_ISC_DIAG LV_ERR_ISC LV_INH_DIAG_ISC /end OUT_MEASUREMENT
/end FUNCTION
/begin FUNCTION DIA_CAN_diagnosis "_CAN diagnosis"
 /begin DEF_CHARACTERISTIC C_ASR_3_CYCNR_MAX C_ASR_1_CYCNR_MAX C_ETCU_1_CYCNR_MAX C_ETCU_2_CYCNR_MAX C_ICL_2_CYCNR_MAX C_ICL_3_CYCNR_MAX C_PSTE_1_CYCNR_MAX C_CTR_DIAG_TCC_CAN_MAX_AMT_1 C_CTR_DIAG_CPL_CAN_MAX_AMT_1 C_AMT_1_CYCNR_MAX C_TXU_1_CYCNR_MAX /end DEF_CHARACTERISTIC
 /begin OUT_MEASUREMENT CYC_CTR_ASR_3_DIAG CYC_CTR_ASR_1_DIAG CYC_CTR_ETCU_1_DIAG CYC_CTR_ETCU_2_DIAG CYC_CTR_ICL_2_DIAG CYC_CTR_ICL_3_DIAG CYC_CTR_PSTE_1_DIAG CYC_CTR_AMT_1_DIAG CYC_CTR_TXU_1_DIAG LV_ERR_TOUT_TXU_1 LV_ERR_TOUT_ETCU_2 LV_ERR_TOUT_ICL_2 LV_ERR_TOUT_ICL_3 LV_ERR_TOUT_AMT_1 LV_ERR_TOUT_ETCU_1 LV_ERR_TOUT_ASR_1 LV_ERR_TOUT_ASR_3 LV_ERR_CAN_BOFF LV_ERR_TOUT_PSTE_1 /end OUT_MEASUREMENT
/end FUNCTION
/begin FUNCTION DIA_Multifunctional_steering_whe "_Multifunctional steering wheel (MSW)"
 /begin DEF_CHARACTERISTIC C_VB_MIN_MSW_DIAG C_T_MIN_MSW_BIT_DIAG C_T_MAX_MSW_BIT_DIAG /end DEF_CHARACTERISTIC
 /begin OUT_MEASUREMENT LV_ERR_MSW_3 LV_ERR_MSW_TOG LV_ERR_MSW_2 /end OUT_MEASUREMENT
/end FUNCTION
/begin FUNCTION DIA_Pedal_value_sensor_diagnosis "_Pedal value sensor diagnosis"
 /begin DEF_CHARACTERISTIC C_VCC_DIF_POTI C_V_PVS_MIN_DIAG_2 C_T_IS_PVS_ERR IP_PVS_RATIO_HYS C_V_PVS_MIN_DIAG_1 C_N_PVS_BLS_BTS_PLAUS C_VS_PVS_BLS_BTS_PLAUS C_PV_AV_PVS_BLS_BTS_PLAUS C_CTR_MAX_PV_AV_CON C_PV_AV_HYS_BLS_BTS_PLAUS C_PVS_BLS_BTS_PLAUS_CONF C_V_PVS_MAX_DIAG_1 C_V_PVS_MAX_DIAG_2 /end DEF_CHARACTERISTIC
 /begin OUT_MEASUREMENT LV_PVS_H_R_1 LV_PVS_H_R_2 LV_ERR_PVS_PRED LV_DYN_LIM_1_ACT LV_DYN_LIM_2_ACT STATE_PVS_DIAG LV_N_SP_IS_LIH_ACT LV_ERR_PVS LV_DET_NOT_PLAUS_ACT LV_PV_AV_STAT_ LV_PVS_BLS_NOT_PLAUS_ACT CTR_PVS_BLS_NOT_PLAUS_ACT LV_ERR_V_REF_2 LV_ERR_PVS_DOUBLE LV_ERR_V_REF_1 LV_ERR_PVS_BLS_NOT_PLAUS LV_ERR_PVS_2 LV_ERR_PVS_RATIO LV_ERR_PVS_1 /end OUT_MEASUREMENT
/end FUNCTION
/begin FUNCTION DIA_Brake_light_switch_diagnosis "_Brake light switch diagnosis (BLS/BTS)" /begin DEF_CHARACTERISTIC C_T_BTS_PLAUS_MAX /end DEF_CHARACTERISTIC
 /begin OUT_MEASUREMENT LV_BRAKE_DET LV_ERR_BLS_PLAUS LV_ERR_IM_BTS_PLAUS LV_ERR_IM_BLS_PLAUS /end OUT_MEASUREMENT
/end FUNCTION
/begin FUNCTION DIA_Idle_Speed_Actuator_Diagnosi "_Idle Speed Actuator Diagnosis"
 /begin DEF_CHARACTERISTIC C_AR_RED_DIF_MAX_DIAG C_AR_RED_DIF_MIN_DIAG C_N_ISA_DIAG C_MAF_TURB_RATIO_DIAG C_TPS_AV_TOL_ISA_AD /end DEF_CHARACTERISTIC
 /begin OUT_MEASUREMENT STATE_ISA_DIAG LV_ERR_ISA_1 LV_ERR_ISA_2 LV_ERR_MEC_ISA /end OUT_MEASUREMENT
/end FUNCTION
/begin FUNCTION DIA_Engine_roughness_idle_diagno "_Engine roughness idle diagnosis"
 /begin DEF_CHARACTERISTIC IP_THD_IS_ER_DIAG__N__MAF IP_FAC_THD_IS_ER_DIAG__TCO C_CRLC_IS_ER_DIAG /end DEF_CHARACTERISTIC
 /begin OUT_MEASUREMENT ER_MMV_IS_DIAG_0 ER_MMV_IS_DIAG_1 ER_MMV_IS_DIAG_2 ER_MMV_IS_DIAG_3 ER_MMV_IS_DIAG_4 ER_MMV_IS_DIAG_5 /end OUT_MEASUREMENT
/end FUNCTION
/begin FUNCTION DIA_Variable_Intake_Manifold__VI "_Variable Intake Manifold (VIM) H-Bridge Diagnosis" /begin OUT_MEASUREMENT LV_ERR_VIM /end OUT_MEASUREMENT /end FUNCTION
/begin FUNCTION DIA_Immobilizer_signal_diagnosis "_Immobilizer signal diagnosis" /begin DEF_CHARACTERISTIC C_TOUT_IMOB /end DEF_CHARACTERISTIC
 /begin OUT_MEASUREMENT LV_ERR_IMOB_2 LV_ERR_IMOB_1 LV_ERR_IMOB_3 LV_LOCK_IMOB INH_IV_IMOB CTR_ERR_IMOB_2 CTR_ERR_IMOB_1 /end OUT_MEASUREMENT
/end FUNCTION
/begin FUNCTION DIA_Exhaust_flap_diagnosis "_Exhaust flap diagnosis" /begin OUT_MEASUREMENT LV_ERR_EF /end OUT_MEASUREMENT /end FUNCTION
/begin FUNCTION DIA_Anti_bounce_algorithm "_Anti-bounce-algorithm"
 /begin OUT_MEASUREMENT CTR_ABC_IMOB_3 ERR_INFO_STAT LV_CDN_DIAG_IMOB_3 LV_END_DIAG_IMOB_3 LV_READY_IMOB_3 ERR_SYM_IMOB_3 LV_ERR_MEM_IMOB_3 CTR_ABC_END_DIAG_IMOB_3 CTR_ABC_IMOB_2 ERR_INFO_STAT LV_CDN_DIAG_IMOB_2 LV_END_DIAG_IMOB_2 LV_READY_IMOB_2 ERR_SYM_IMOB_2 LV_ERR_MEM_IMOB_2 CTR_ABC_END_DIAG_IMOB_2 CTR_ABC_IMOB_1 ERR_INFO_STAT LV_CDN_DIAG_IMOB_1 LV_END_DIAG_IMOB_1 LV_READY_IMOB_1 ERR_SYM_IMOB_1 LV_ERR_MEM_IMOB_1 CTR_ABC_END_DIAG_IMOB_1 CTR_ABC_TD_IGC_CUT_0 ERR_INFO_STAT LV_CDN_DIAG_TD_IGC_CUT_0 LV_END_DIAG_TD_IGC_CUT_0 LV_READY_TD_IGC_CUT_0 ERR_SYM_TD_IGC_CUT_0 LV_ERR_MEM_TD_IGC_CUT_0 CTR_ABC_END_DIAG_TD_IGC_CUT_0 CTR_ABC_TD_IGC_CUT_1 ERR_INFO_STAT LV_CDN_DIAG_TD_IGC_CUT_1 LV_END_DIAG_TD_IGC_CUT_1 LV_READY_TD_IGC_CUT_1 ERR_SYM_TD_IGC_CUT_1 LV_ERR_MEM_TD_IGC_CUT_1 CTR_ABC_END_DIAG_TD_IGC_CUT_1 CTR_ABC_TD_IGC_CUT_2 ERR_INFO_STAT LV_CDN_DIAG_TD_IGC_CUT_2 LV_END_DIAG_TD_IGC_CUT_2 LV_READY_TD_IGC_CUT_2 ERR_SYM_TD_IGC_CUT_2 LV_ERR_MEM_TD_IGC_CUT_2 CTR_ABC_END_DIAG_TD_IGC_CUT_2 CTR_ABC_TD_IGC_CUT_3 ERR_INFO_STAT LV_CDN_DIAG_TD_IGC_CUT_3 LV_END_DIAG_TD_IGC_CUT_3 LV_READY_TD_IGC_CUT_3 ERR_SYM_TD_IGC_CUT_3 LV_ERR_MEM_TD_IGC_CUT_3 CTR_ABC_END_DIAG_TD_IGC_CUT_3 CTR_ABC_TD_IGC_CUT_4 ERR_INFO_STAT LV_CDN_DIAG_TD_IGC_CUT_4 LV_END_DIAG_TD_IGC_CUT_4 LV_READY_TD_IGC_CUT_4 ERR_SYM_TD_IGC_CUT_4 LV_ERR_MEM_TD_IGC_CUT_4 CTR_ABC_END_DIAG_TD_IGC_CUT_4 CTR_ABC_TD_IGC_CUT_5 ERR_INFO_STAT LV_CDN_DIAG_TD_IGC_CUT_5 LV_END_DIAG_TD_IGC_CUT_5 LV_READY_TD_IGC_CUT_5 ERR_SYM_TD_IGC_CUT_5 LV_ERR_MEM_TD_IGC_CUT_5 CTR_ABC_END_DIAG_TD_IGC_CUT_5 CTR_ABC_VLS_UP_MIN_COLD_1 ERR_INFO_STAT LV_CDN_DIAG_VLS_UP_MIN_COLD_1 LV_END_DIAG_VLS_UP_MIN_COLD_1 LV_READY_VLS_UP_MIN_COLD_1 ERR_SYM_VLS_UP_MIN_COLD_1 LV_ERR_MEM_VLS_UP_MIN_COLD_1 CTR_ABC_END_DIAG_VLS_UP_MIN_COLD CTR_ABC_VLS_UP_MIN_COLD_2 ERR_INFO_STAT LV_CDN_DIAG_VLS_UP_MIN_COLD_2 LV_END_DIAG_VLS_UP_MIN_COLD_2 LV_READY_VLS_UP_MIN_COLD_2 ERR_SYM_VLS_UP_MIN_COLD_2 LV_ERR_MEM_VLS_UP_MIN_COLD_2 CTR_ABC_END_DIAG_VLS_UP_MIN_COLD CTR_ABC_POIL_SWI ERR_INFO_STAT LV_CDN_DIAG_POIL_SWI LV_END_DIAG_POIL_SWI LV_READY_POIL_SWI ERR_SYM_POIL_SWI LV_ERR_MEM_POIL_SWI CTR_ABC_END_DIAG_POIL_SWI CTR_ABC_BN_VS_TCS ERR_INFO_STAT LV_CDN_DIAG_BN_VS_TCS LV_END_DIAG_BN_VS_TCS LV_READY_BN_VS_TCS ERR_SYM_BN_VS_TCS LV_ERR_MEM_BN_VS_TCS CTR_ABC_END_DIAG_BN_VS_TCS CTR_ABC_TOUT_ETCU_1 ERR_INFO_STAT LV_CDN_DIAG_TOUT_ETCU_1 LV_END_DIAG_TOUT_ETCU_1 LV_READY_TOUT_ETCU_1 ERR_SYM_TOUT_ETCU_1 LV_ERR_MEM_TOUT_ETCU_1 CTR_ABC_END_DIAG_TOUT_ETCU_1 CTR_ABC_TOUT_ETCU_2 ERR_INFO_STAT LV_CDN_DIAG_TOUT_ETCU_2 LV_END_DIAG_TOUT_ETCU_2 LV_READY_TOUT_ETCU_2 ERR_SYM_TOUT_ETCU_2 LV_ERR_MEM_TOUT_ETCU_2 CTR_ABC_END_DIAG_TOUT_ETCU_2 CTR_ABC_BSD ERR_INFO_STAT LV_CDN_DIAG_BSD LV_END_DIAG_BSD LV_READY_BSD ERR_SYM_BSD LV_ERR_MEM_BSD CTR_ABC_END_DIAG_BSD CTR_ABC_TEG_PCAT_DOWN_1 ERR_INFO_STAT LV_CDN_DIAG_TEG_PCAT_DOWN_1 LV_END_DIAG_TEG_PCAT_DOWN_1 LV_READY_TEG_PCAT_DOWN_1 ERR_SYM_TEG_PCAT_DOWN_1 LV_ERR_MEM_TEG_PCAT_DOWN_1 CTR_ABC_END_DIAG_TEG_PCAT_DOWN_1 CTR_ABC_TEG_PCAT_DOWN_2 ERR_INFO_STAT LV_CDN_DIAG_TEG_PCAT_DOWN_2 LV_END_DIAG_TEG_PCAT_DOWN_2 LV_READY_TEG_PCAT_DOWN_2 ERR_SYM_TEG_PCAT_DOWN_2 LV_ERR_MEM_TEG_PCAT_DOWN_2 CTR_ABC_END_DIAG_TEG_PCAT_DOWN_2 CTR_ABC_CHK_LS_DOWN_1 ERR_INFO_STAT LV_CDN_DIAG_CHK_LS_DOWN_1 LV_END_DIAG_CHK_LS_DOWN_1 LV_READY_CHK_LS_DOWN_1 ERR_SYM_CHK_LS_DOWN_1 LV_ERR_MEM_CHK_LS_DOWN_1 CTR_ABC_END_DIAG_CHK_LS_DOWN_1 CTR_ABC_CHK_LS_DOWN_2 ERR_INFO_STAT LV_CDN_DIAG_CHK_LS_DOWN_2 LV_END_DIAG_CHK_LS_DOWN_2 LV_READY_CHK_LS_DOWN_2 ERR_SYM_CHK_LS_DOWN_2 LV_ERR_MEM_CHK_LS_DOWN_2 CTR_ABC_END_DIAG_CHK_LS_DOWN_2 CTR_ABC_BN_ANG_PSTE ERR_INFO_STAT LV_CDN_DIAG_BN_ANG_PSTE LV_END_DIAG_BN_ANG_PSTE LV_READY_BN_ANG_PSTE ERR_SYM_BN_ANG_PSTE LV_ERR_MEM_BN_ANG_PSTE CTR_ABC_END_DIAG_BN_ANG_PSTE CTR_ABC_CPS ERR_INFO_STAT LV_CDN_DIAG_CPS LV_END_DIAG_CPS LV_READY_CPS ERR_SYM_CPS LV_ERR_MEM_CPS CTR_ABC_END_DIAG_CPS CTR_ABC_TQI_AV_MON_1 ERR_INFO_STAT LV_CDN_DIAG_TQI_AV_MON_1 LV_END_DIAG_TQI_AV_MON_1 LV_READY_TQI_AV_MON_1 ERR_SYM_TQI_AV_MON_1 LV_ERR_MEM_TQI_AV_MON_1 CTR_ABC_END_DIAG_TQI_AV_MON_1 CTR_ABC_GEN ERR_INFO_STAT LV_CDN_DIAG_GEN LV_END_DIAG_GEN LV_READY_GEN ERR_SYM_GEN LV_ERR_MEM_GEN CTR_ABC_END_DIAG_GEN CTR_ABC_MEC_IVVT_IN_1 ERR_INFO_STAT LV_CDN_DIAG_MEC_IVVT_IN_1 LV_END_DIAG_MEC_IVVT_IN_1 LV_READY_MEC_IVVT_IN_1 ERR_SYM_MEC_IVVT_IN_1 LV_ERR_MEM_MEC_IVVT_IN_1 CTR_ABC_END_DIAG_MEC_IVVT_IN_1 CTR_ABC_MEC_IVVT_IN_2 ERR_INFO_STAT LV_CDN_DIAG_MEC_IVVT_IN_2 LV_END_DIAG_MEC_IVVT_IN_2 LV_READY_MEC_IVVT_IN_2 ERR_SYM_MEC_IVVT_IN_2 LV_ERR_MEM_MEC_IVVT_IN_2 CTR_ABC_END_DIAG_MEC_IVVT_IN_2 CTR_ABC_MIS_LOW_FUEL ERR_INFO_STAT LV_CDN_DIAG_MIS_LOW_FUEL LV_END_DIAG_MIS_LOW_FUEL LV_READY_MIS_LOW_FUEL ERR_SYM_MIS_LOW_FUEL LV_ERR_MEM_MIS_LOW_FUEL CTR_ABC_END_DIAG_MIS_LOW_FUEL CTR_ABC_BN_POW_VB ERR_INFO_STAT LV_CDN_DIAG_BN_POW_VB LV_END_DIAG_BN_POW_VB LV_READY_BN_POW_VB ERR_SYM_BN_POW_VB LV_ERR_MEM_BN_POW_VB CTR_ABC_END_DIAG_BN_POW_VB CTR_ABC_CRK_NOT_PLAUS ERR_INFO_STAT LV_CDN_DIAG_CRK_NOT_PLAUS LV_END_DIAG_CRK_NOT_PLAUS LV_READY_CRK_NOT_PLAUS ERR_SYM_CRK_NOT_PLAUS LV_ERR_MEM_CRK_NOT_PLAUS CTR_ABC_END_DIAG_CRK_NOT_PLAUS CTR_ABC_SAP ERR_INFO_STAT LV_CDN_DIAG_SAP LV_END_DIAG_SAP LV_READY_SAP ERR_SYM_SAP LV_ERR_MEM_SAP CTR_ABC_END_DIAG_SAP CTR_ABC_BN_ETCU ERR_INFO_STAT LV_CDN_DIAG_BN_ETCU LV_END_DIAG_BN_ETCU LV_READY_BN_ETCU ERR_SYM_BN_ETCU LV_ERR_MEM_BN_ETCU CTR_ABC_END_DIAG_BN_ETCU CTR_ABC_TCO_EL ERR_INFO_STAT LV_CDN_DIAG_TCO_EL LV_END_DIAG_TCO_EL LV_READY_TCO_EL ERR_SYM_TCO_EL LV_ERR_MEM_TCO_EL CTR_ABC_END_DIAG_TCO_EL CTR_ABC_SAV ERR_INFO_STAT LV_CDN_DIAG_SAV LV_END_DIAG_SAV LV_READY_SAV ERR_SYM_SAV LV_ERR_MEM_SAV CTR_ABC_END_DIAG_SAV CTR_ABC_BN_ACC ERR_INFO_STAT LV_CDN_DIAG_BN_ACC LV_END_DIAG_BN_ACC LV_READY_BN_ACC ERR_SYM_BN_ACC LV_ERR_MEM_BN_ACC CTR_ABC_END_DIAG_BN_ACC CTR_ABC_FSD_1 ERR_INFO_STAT LV_CDN_DIAG_FSD_1 LV_END_DIAG_FSD_1 LV_READY_FSD_1 ERR_SYM_FSD_1 LV_ERR_MEM_FSD_1 CTR_ABC_END_DIAG_FSD_1 CTR_ABC_FSD_2 ERR_INFO_STAT LV_CDN_DIAG_FSD_2 LV_END_DIAG_FSD_2 LV_READY_FSD_2 ERR_SYM_FSD_2 LV_ERR_MEM_FSD_2 CTR_ABC_END_DIAG_FSD_2 CTR_ABC_TCO_EX ERR_INFO_STAT LV_CDN_DIAG_TCO_EX LV_END_DIAG_TCO_EX LV_READY_TCO_EX ERR_SYM_TCO_EX LV_ERR_MEM_TCO_EX CTR_ABC_END_DIAG_TCO_EX CTR_ABC_CAN_BOFF ERR_INFO_STAT LV_CDN_DIAG_CAN_BOFF LV_END_DIAG_CAN_BOFF LV_READY_CAN_BOFF ERR_SYM_CAN_BOFF LV_ERR_MEM_CAN_BOFF CTR_ABC_END_DIAG_CAN_BOFF CTR_ABC_MAF_MON_1 ERR_INFO_STAT LV_CDN_DIAG_MAF_MON_1 LV_END_DIAG_MAF_MON_1 LV_READY_MAF_MON_1 ERR_SYM_MAF_MON_1 LV_ERR_MEM_MAF_MON_1 CTR_ABC_END_DIAG_MAF_MON_1 CTR_ABC_TPS_AD_BOL ERR_INFO_STAT LV_CDN_DIAG_TPS_AD_BOL LV_END_DIAG_TPS_AD_BOL LV_READY_TPS_AD_BOL ERR_SYM_TPS_AD_BOL LV_ERR_MEM_TPS_AD_BOL CTR_ABC_END_DIAG_TPS_AD_BOL CTR_ABC_LOAD_TPS_PLAUS ERR_INFO_STAT LV_CDN_DIAG_LOAD_TPS_PLAUS LV_END_DIAG_LOAD_TPS_PLAUS LV_READY_LOAD_TPS_PLAUS ERR_SYM_LOAD_TPS_PLAUS LV_ERR_MEM_LOAD_TPS_PLAUS CTR_ABC_END_DIAG_LOAD_TPS_PLAUS CTR_ABC_SA_SAFM ERR_INFO_STAT LV_CDN_DIAG_SA_SAFM LV_END_DIAG_SA_SAFM LV_READY_SA_SAFM ERR_SYM_SA_SAFM LV_ERR_MEM_SA_SAFM CTR_ABC_END_DIAG_SA_SAFM CTR_ABC_VLS_UP_OC_1 ERR_INFO_STAT LV_CDN_DIAG_VLS_UP_OC_1 LV_END_DIAG_VLS_UP_OC_1 LV_READY_VLS_UP_OC_1 ERR_SYM_VLS_UP_OC_1 LV_ERR_MEM_VLS_UP_OC_1 CTR_ABC_END_DIAG_VLS_UP_OC_1 CTR_ABC_VLS_UP_OC_2 ERR_INFO_STAT LV_CDN_DIAG_VLS_UP_OC_2 LV_END_DIAG_VLS_UP_OC_2 LV_READY_VLS_UP_OC_2 ERR_SYM_VLS_UP_OC_2 LV_ERR_MEM_VLS_UP_OC_2 CTR_ABC_END_DIAG_VLS_UP_OC_2 CTR_ABC_CAM_PSN_0 ERR_INFO_STAT LV_CDN_DIAG_CAM_PSN_0 LV_END_DIAG_CAM_PSN_0 LV_READY_CAM_PSN_0 ERR_SYM_CAM_PSN_0 LV_ERR_MEM_CAM_PSN_0 CTR_ABC_END_DIAG_CAM_PSN_0 CTR_ABC_CAM_PSN_1 ERR_INFO_STAT LV_CDN_DIAG_CAM_PSN_1 LV_END_DIAG_CAM_PSN_1 LV_READY_CAM_PSN_1 ERR_SYM_CAM_PSN_1 LV_ERR_MEM_CAM_PSN_1 CTR_ABC_END_DIAG_CAM_PSN_1 CTR_ABC_BN_TQ_ETCU ERR_INFO_STAT LV_CDN_DIAG_BN_TQ_ETCU LV_END_DIAG_BN_TQ_ETCU LV_READY_BN_TQ_ETCU ERR_SYM_BN_TQ_ETCU LV_ERR_MEM_BN_TQ_ETCU CTR_ABC_END_DIAG_BN_TQ_ETCU CTR_ABC_BN_T_ICL ERR_INFO_STAT LV_CDN_DIAG_BN_T_ICL LV_END_DIAG_BN_T_ICL LV_READY_BN_T_ICL ERR_SYM_BN_T_ICL LV_ERR_MEM_BN_T_ICL CTR_ABC_END_DIAG_BN_T_ICL CTR_ABC_TQ_MIN_CLU_MON_1 ERR_INFO_STAT LV_CDN_DIAG_TQ_MIN_CLU_MON_1 LV_END_DIAG_TQ_MIN_CLU_MON_1 LV_READY_TQ_MIN_CLU_MON_1 ERR_SYM_TQ_MIN_CLU_MON_1 LV_ERR_MEM_TQ_MIN_CLU_MON_1 CTR_ABC_END_DIAG_TQ_MIN_CLU_MON_ CTR_ABC_MSW_2 ERR_INFO_STAT LV_CDN_DIAG_MSW_2 LV_END_DIAG_MSW_2 LV_READY_MSW_2 ERR_SYM_MSW_2 LV_ERR_MEM_MSW_2 CTR_ABC_END_DIAG_MSW_2 CTR_ABC_MSW_3 ERR_INFO_STAT LV_CDN_DIAG_MSW_3 LV_END_DIAG_MSW_3 LV_READY_MSW_3 ERR_SYM_MSW_3 LV_ERR_MEM_MSW_3 CTR_ABC_END_DIAG_MSW_3 CTR_ABC_TOOTH_PER ERR_INFO_STAT LV_CDN_DIAG_TOOTH_PER LV_END_DIAG_TOOTH_PER LV_READY_TOOTH_PER ERR_SYM_TOOTH_PER LV_ERR_MEM_TOOTH_PER CTR_ABC_END_DIAG_TOOTH_PER CTR_ABC_SLV_IVVT_IN_1 ERR_INFO_STAT LV_CDN_DIAG_SLV_IVVT_IN_1 LV_END_DIAG_SLV_IVVT_IN_1 LV_READY_SLV_IVVT_IN_1 ERR_SYM_SLV_IVVT_IN_1 LV_ERR_MEM_SLV_IVVT_IN_1 CTR_ABC_END_DIAG_SLV_IVVT_IN_1 CTR_ABC_SLV_IVVT_IN_2 ERR_INFO_STAT LV_CDN_DIAG_SLV_IVVT_IN_2 LV_END_DIAG_SLV_IVVT_IN_2 LV_READY_SLV_IVVT_IN_2 ERR_SYM_SLV_IVVT_IN_2 LV_ERR_MEM_SLV_IVVT_IN_2 CTR_ABC_END_DIAG_SLV_IVVT_IN_2 CTR_ABC_DCC_REV ERR_INFO_STAT LV_CDN_DIAG_DCC_REV LV_END_DIAG_DCC_REV LV_READY_DCC_REV ERR_SYM_DCC_REV LV_ERR_MEM_DCC_REV CTR_ABC_END_DIAG_DCC_REV CTR_ABC_IM_BLS_PLAUS ERR_INFO_STAT LV_CDN_DIAG_IM_BLS_PLAUS LV_END_DIAG_IM_BLS_PLAUS LV_READY_IM_BLS_PLAUS ERR_SYM_IM_BLS_PLAUS LV_ERR_MEM_IM_BLS_PLAUS CTR_ABC_END_DIAG_IM_BLS_PLAUS CTR_ABC_DMTL_LEAK ERR_INFO_STAT LV_CDN_DIAG_DMTL_LEAK LV_END_DIAG_DMTL_LEAK LV_READY_DMTL_LEAK ERR_SYM_DMTL_LEAK LV_ERR_MEM_DMTL_LEAK CTR_ABC_END_DIAG_DMTL_LEAK CTR_ABC_ECRAS ERR_INFO_STAT LV_CDN_DIAG_ECRAS LV_END_DIAG_ECRAS LV_READY_ECRAS ERR_SYM_ECRAS LV_ERR_MEM_ECRAS CTR_ABC_END_DIAG_ECRAS CTR_ABC_EBOX_CFA ERR_INFO_STAT LV_CDN_DIAG_EBOX_CFA LV_END_DIAG_EBOX_CFA LV_READY_EBOX_CFA ERR_SYM_EBOX_CFA LV_ERR_MEM_EBOX_CFA CTR_ABC_END_DIAG_EBOX_CFA CTR_ABC_CAT_DIAG_1 ERR_INFO_STAT LV_CDN_DIAG_CAT_DIAG_1 LV_END_DIAG_CAT_DIAG_1 LV_READY_CAT_DIAG_1 ERR_SYM_CAT_DIAG_1 LV_ERR_MEM_CAT_DIAG_1 CTR_ABC_END_DIAG_CAT_DIAG_1 CTR_ABC_CAT_DIAG_2 ERR_INFO_STAT LV_CDN_DIAG_CAT_DIAG_2 LV_END_DIAG_CAT_DIAG_2 LV_READY_CAT_DIAG_2 ERR_SYM_CAT_DIAG_2 LV_ERR_MEM_CAT_DIAG_2 CTR_ABC_END_DIAG_CAT_DIAG_2 CTR_ABC_KNKS_1 ERR_INFO_STAT LV_CDN_DIAG_KNKS_1 LV_END_DIAG_KNKS_1 LV_READY_KNKS_1 ERR_SYM_KNKS_1 LV_ERR_MEM_KNKS_1 CTR_ABC_END_DIAG_KNKS_1 CTR_ABC_KNKS_2 ERR_INFO_STAT LV_CDN_DIAG_KNKS_2 LV_END_DIAG_KNKS_2 LV_READY_KNKS_2 ERR_SYM_KNKS_2 LV_ERR_MEM_KNKS_2 CTR_ABC_END_DIAG_KNKS_2 CTR_ABC_VLS_UP_MIN_1 ERR_INFO_STAT LV_CDN_DIAG_VLS_UP_MIN_1 LV_END_DIAG_VLS_UP_MIN_1 LV_READY_VLS_UP_MIN_1 ERR_SYM_VLS_UP_MIN_1 LV_ERR_MEM_VLS_UP_MIN_1 CTR_ABC_END_DIAG_VLS_UP_MIN_1 CTR_ABC_VLS_UP_MIN_2 ERR_INFO_STAT LV_CDN_DIAG_VLS_UP_MIN_2 LV_END_DIAG_VLS_UP_MIN_2 LV_READY_VLS_UP_MIN_2 ERR_SYM_VLS_UP_MIN_2 LV_ERR_MEM_VLS_UP_MIN_2 CTR_ABC_END_DIAG_VLS_UP_MIN_2 CTR_ABC_TPS_ST_CHK_1 ERR_INFO_STAT LV_CDN_DIAG_TPS_ST_CHK_1 LV_END_DIAG_TPS_ST_CHK_1 LV_READY_TPS_ST_CHK_1 ERR_SYM_TPS_ST_CHK_1 LV_ERR_MEM_TPS_ST_CHK_1 CTR_ABC_END_DIAG_TPS_ST_CHK_1 CTR_ABC_TPS_ST_CHK_2 ERR_INFO_STAT LV_CDN_DIAG_TPS_ST_CHK_2 LV_END_DIAG_TPS_ST_CHK_2 LV_READY_TPS_ST_CHK_2 ERR_SYM_TPS_ST_CHK_2 LV_ERR_MEM_TPS_ST_CHK_2 CTR_ABC_END_DIAG_TPS_ST_CHK_2 CTR_ABC_BN_CAS ERR_INFO_STAT LV_CDN_DIAG_BN_CAS LV_END_DIAG_BN_CAS LV_READY_BN_CAS ERR_SYM_BN_CAS LV_ERR_MEM_BN_CAS CTR_ABC_END_DIAG_BN_CAS CTR_ABC_VLS_DOWN_MIN_1 ERR_INFO_STAT LV_CDN_DIAG_VLS_DOWN_MIN_1 LV_END_DIAG_VLS_DOWN_MIN_1 LV_READY_VLS_DOWN_MIN_1 ERR_SYM_VLS_DOWN_MIN_1 LV_ERR_MEM_VLS_DOWN_MIN_1 CTR_ABC_END_DIAG_VLS_DOWN_MIN_1 CTR_ABC_VLS_DOWN_MIN_2 ERR_INFO_STAT LV_CDN_DIAG_VLS_DOWN_MIN_2 LV_END_DIAG_VLS_DOWN_MIN_2 LV_READY_VLS_DOWN_MIN_2 ERR_SYM_VLS_DOWN_MIN_2 LV_ERR_MEM_VLS_DOWN_MIN_2 CTR_ABC_END_DIAG_VLS_DOWN_MIN_2 CTR_ABC_IM_BTS_PLAUS ERR_INFO_STAT LV_CDN_DIAG_IM_BTS_PLAUS LV_END_DIAG_IM_BTS_PLAUS LV_READY_IM_BTS_PLAUS ERR_SYM_IM_BTS_PLAUS LV_ERR_MEM_IM_BTS_PLAUS CTR_ABC_END_DIAG_IM_BTS_PLAUS CTR_ABC_LS_UP_FRQ_1 ERR_INFO_STAT LV_CDN_DIAG_LS_UP_FRQ_1 LV_END_DIAG_LS_UP_FRQ_1 LV_READY_LS_UP_FRQ_1 ERR_SYM_LS_UP_FRQ_1 LV_ERR_MEM_LS_UP_FRQ_1 CTR_ABC_END_DIAG_LS_UP_FRQ_1 CTR_ABC_LS_UP_FRQ_2 ERR_INFO_STAT LV_CDN_DIAG_LS_UP_FRQ_2 LV_END_DIAG_LS_UP_FRQ_2 LV_READY_LS_UP_FRQ_2 ERR_SYM_LS_UP_FRQ_2 LV_ERR_MEM_LS_UP_FRQ_2 CTR_ABC_END_DIAG_LS_UP_FRQ_2 CTR_ABC_MEC_IVVT_EX_1 ERR_INFO_STAT LV_CDN_DIAG_MEC_IVVT_EX_1 LV_END_DIAG_MEC_IVVT_EX_1 LV_READY_MEC_IVVT_EX_1 ERR_SYM_MEC_IVVT_EX_1 LV_ERR_MEM_MEC_IVVT_EX_1 CTR_ABC_END_DIAG_MEC_IVVT_EX_1 CTR_ABC_MEC_IVVT_EX_2 ERR_INFO_STAT LV_CDN_DIAG_MEC_IVVT_EX_2 LV_END_DIAG_MEC_IVVT_EX_2 LV_READY_MEC_IVVT_EX_2 ERR_SYM_MEC_IVVT_EX_2 LV_ERR_MEM_MEC_IVVT_EX_2 CTR_ABC_END_DIAG_MEC_IVVT_EX_2 CTR_ABC_CAM_1_NOT_PLAUS ERR_INFO_STAT LV_CDN_DIAG_CAM_1_NOT_PLAUS LV_END_DIAG_CAM_1_NOT_PLAUS LV_READY_CAM_1_NOT_PLAUS ERR_SYM_CAM_1_NOT_PLAUS LV_ERR_MEM_CAM_1_NOT_PLAUS CTR_ABC_END_DIAG_CAM_1_NOT_PLAUS CTR_ABC_PVS_DOUBLE ERR_INFO_STAT LV_CDN_DIAG_PVS_DOUBLE LV_END_DIAG_PVS_DOUBLE LV_READY_PVS_DOUBLE ERR_SYM_PVS_DOUBLE LV_ERR_MEM_PVS_DOUBLE CTR_ABC_END_DIAG_PVS_DOUBLE CTR_ABC_CONV_MON_1 ERR_INFO_STAT LV_CDN_DIAG_CONV_MON_1 LV_END_DIAG_CONV_MON_1 LV_READY_CONV_MON_1 ERR_SYM_CONV_MON_1 LV_ERR_MEM_CONV_MON_1 CTR_ABC_END_DIAG_CONV_MON_1 CTR_ABC_N_EFP_HIGH ERR_INFO_STAT LV_CDN_DIAG_N_EFP_HIGH LV_END_DIAG_N_EFP_HIGH LV_READY_N_EFP_HIGH ERR_SYM_N_EFP_HIGH LV_ERR_MEM_N_EFP_HIGH CTR_ABC_END_DIAG_N_EFP_HIGH CTR_ABC_PVS_1 ERR_INFO_STAT LV_CDN_DIAG_PVS_1 LV_END_DIAG_PVS_1 LV_READY_PVS_1 ERR_SYM_PVS_1 LV_ERR_MEM_PVS_1 CTR_ABC_END_DIAG_PVS_1 CTR_ABC_PVS_2 ERR_INFO_STAT LV_CDN_DIAG_PVS_2 LV_END_DIAG_PVS_2 LV_READY_PVS_2 ERR_SYM_PVS_2 LV_ERR_MEM_PVS_2 CTR_ABC_END_DIAG_PVS_2 CTR_ABC_ECU_CKS ERR_INFO_STAT LV_CDN_DIAG_ECU_CKS LV_END_DIAG_ECU_CKS LV_READY_ECU_CKS ERR_SYM_ECU_CKS LV_ERR_MEM_ECU_CKS CTR_ABC_END_DIAG_ECU_CKS CTR_ABC_MSR_INH_MON_1 ERR_INFO_STAT LV_CDN_DIAG_MSR_INH_MON_1 LV_END_DIAG_MSR_INH_MON_1 LV_READY_MSR_INH_MON_1 ERR_SYM_MSR_INH_MON_1 LV_ERR_MEM_MSR_INH_MON_1 CTR_ABC_END_DIAG_MSR_INH_MON_1 CTR_ABC_DMTLH ERR_INFO_STAT LV_CDN_DIAG_DMTLH LV_END_DIAG_DMTLH LV_READY_DMTLH ERR_SYM_DMTLH LV_ERR_MEM_DMTLH CTR_ABC_END_DIAG_DMTLH CTR_ABC_VS ERR_INFO_STAT LV_CDN_DIAG_VS LV_END_DIAG_VS LV_READY_VS ERR_SYM_VS LV_ERR_MEM_VS CTR_ABC_END_DIAG_VS CTR_ABC_DMTLM ERR_INFO_STAT LV_CDN_DIAG_DMTLM LV_END_DIAG_DMTLM LV_READY_DMTLM ERR_SYM_DMTLM LV_ERR_MEM_DMTLM CTR_ABC_END_DIAG_DMTLM CTR_ABC_DMTLS ERR_INFO_STAT LV_CDN_DIAG_DMTLS LV_END_DIAG_DMTLS LV_READY_DMTLS ERR_SYM_DMTLS LV_ERR_MEM_DMTLS CTR_ABC_END_DIAG_DMTLS CTR_ABC_SLV_IVVT_EX_1 ERR_INFO_STAT LV_CDN_DIAG_SLV_IVVT_EX_1 LV_END_DIAG_SLV_IVVT_EX_1 LV_READY_SLV_IVVT_EX_1 ERR_SYM_SLV_IVVT_EX_1 LV_ERR_MEM_SLV_IVVT_EX_1 CTR_ABC_END_DIAG_SLV_IVVT_EX_1 CTR_ABC_SLV_IVVT_EX_2 ERR_INFO_STAT LV_CDN_DIAG_SLV_IVVT_EX_2 LV_END_DIAG_SLV_IVVT_EX_2 LV_READY_SLV_IVVT_EX_2 ERR_SYM_SLV_IVVT_EX_2 LV_ERR_MEM_SLV_IVVT_EX_2 CTR_ABC_END_DIAG_SLV_IVVT_EX_2 CTR_ABC_TQ_DIF_I_IS_MON_1 ERR_INFO_STAT LV_CDN_DIAG_TQ_DIF_I_IS_MON_1 LV_END_DIAG_TQ_DIF_I_IS_MON_1 LV_READY_TQ_DIF_I_IS_MON_1 ERR_SYM_TQ_DIF_I_IS_MON_1 LV_ERR_MEM_TQ_DIF_I_IS_MON_1 CTR_ABC_END_DIAG_TQ_DIF_I_IS_MON CTR_ABC_PVS_BLS_NOT_PLAUS ERR_INFO_STAT LV_CDN_DIAG_PVS_BLS_NOT_PLAUS LV_END_DIAG_PVS_BLS_NOT_PLAUS LV_READY_PVS_BLS_NOT_PLAUS ERR_SYM_PVS_BLS_NOT_PLAUS LV_ERR_MEM_PVS_BLS_NOT_PLAUS CTR_ABC_END_DIAG_PVS_BLS_NOT_PLA CTR_ABC_VLS_DOWN_OC_1 ERR_INFO_STAT LV_CDN_DIAG_VLS_DOWN_OC_1 LV_END_DIAG_VLS_DOWN_OC_1 LV_READY_VLS_DOWN_OC_1 ERR_SYM_VLS_DOWN_OC_1 LV_ERR_MEM_VLS_DOWN_OC_1 CTR_ABC_END_DIAG_VLS_DOWN_OC_1 CTR_ABC_VLS_DOWN_OC_2 ERR_INFO_STAT LV_CDN_DIAG_VLS_DOWN_OC_2 LV_END_DIAG_VLS_DOWN_OC_2 LV_READY_VLS_DOWN_OC_2 ERR_SYM_VLS_DOWN_OC_2 LV_ERR_MEM_VLS_DOWN_OC_2 CTR_ABC_END_DIAG_VLS_DOWN_OC_2 CTR_ABC_RLY_ST ERR_INFO_STAT LV_CDN_DIAG_RLY_ST LV_END_DIAG_RLY_ST LV_READY_RLY_ST ERR_SYM_RLY_ST LV_ERR_MEM_RLY_ST CTR_ABC_END_DIAG_RLY_ST CTR_ABC_TQ_LOSS_MON_1 ERR_INFO_STAT LV_CDN_DIAG_TQ_LOSS_MON_1 LV_END_DIAG_TQ_LOSS_MON_1 LV_READY_TQ_LOSS_MON_1 ERR_SYM_TQ_LOSS_MON_1 LV_ERR_MEM_TQ_LOSS_MON_1 CTR_ABC_END_DIAG_TQ_LOSS_MON_1 CTR_ABC_TQ_DIF_P_D_IS_MON_1 ERR_INFO_STAT LV_CDN_DIAG_TQ_DIF_P_D_IS_MON_1 LV_END_DIAG_TQ_DIF_P_D_IS_MON_1 LV_READY_TQ_DIF_P_D_IS_MON_1 ERR_SYM_TQ_DIF_P_D_IS_MON_1 LV_ERR_MEM_TQ_DIF_P_D_IS_MON_1 CTR_ABC_END_DIAG_TQ_DIF_P_D_IS_M CTR_ABC_OBD2_LSH_UP_1 ERR_INFO_STAT LV_CDN_DIAG_OBD2_LSH_UP_1 LV_END_DIAG_OBD2_LSH_UP_1 LV_READY_OBD2_LSH_UP_1 ERR_SYM_OBD2_LSH_UP_1 LV_ERR_MEM_OBD2_LSH_UP_1 CTR_ABC_END_DIAG_OBD2_LSH_UP_1 CTR_ABC_OBD2_LSH_UP_2 ERR_INFO_STAT LV_CDN_DIAG_OBD2_LSH_UP_2 LV_END_DIAG_OBD2_LSH_UP_2 LV_READY_OBD2_LSH_UP_2 ERR_SYM_OBD2_LSH_UP_2 LV_ERR_MEM_OBD2_LSH_UP_2 CTR_ABC_END_DIAG_OBD2_LSH_UP_2 CTR_ABC_TPS_1 ERR_INFO_STAT LV_CDN_DIAG_TPS_1 LV_END_DIAG_TPS_1 LV_READY_TPS_1 ERR_SYM_TPS_1 /end OUT_MEASUREMENT
/end FUNCTION
/end MODULE
/end PROJECT
