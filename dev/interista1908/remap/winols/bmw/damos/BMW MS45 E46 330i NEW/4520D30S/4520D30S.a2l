ASAP2_VERSION 1 31
/begin PROJECT MS45 "BMW Motorsteuerung R6"
/begin HEADER "_default_HeaderComment" PROJECT_NO _52 /end HEADER
/begin MODULE _default_ModuleName "_default_ModuleLongIdentifier"
/begin MOD_COMMON "_default_ModCommonComment" DEPOSIT ABSOLUTE BYTE_ORDER MSB_FIRST ALIGNMENT_BYTE 1 ALIGNMENT_WORD 2 ALIGNMENT_LONG 4 ALIGNMENT_FLOAT32_IEEE 4 ALIGNMENT_FLOAT64_IEEE 8 /end MOD_COMMON
/begin MEASUREMENT ERR_INFO_STAT "" UBYTE _CNV_S_2_RANGE______21_R_CM 1 100. 0. 255. ECU_ADDRESS 0x3fd4e8 /end MEASUREMENT
/begin MEASUREMENT ERR_INFO_STAT "" UBYTE _CNV_S_2_RANGE______21_R_CM 1 100. 0. 255. ECU_ADDRESS 0x3fd664 /end MEASUREMENT
/begin MEASUREMENT ERR_INFO_STAT "" UBYTE _CNV_S_2_RANGE______21_R_CM 1 100. 0. 255. ECU_ADDRESS 0x3fd660 /end MEASUREMENT
/begin MEASUREMENT ERR_INFO_STAT "" UBYTE _CNV_S_2_RANGE______21_R_CM 1 100. 0. 255. ECU_ADDRESS 0x3fd654 /end MEASUREMENT
/begin MEASUREMENT ERR_INFO_STAT "" UBYTE _CNV_S_2_RANGE______21_R_CM 1 100. 0. 255. ECU_ADDRESS 0x3fd580 /end MEASUREMENT
/begin MEASUREMENT ERR_INFO_STAT "" UBYTE _CNV_S_2_RANGE______21_R_CM 1 100. 0. 255. ECU_ADDRESS 0x3fd670 /end MEASUREMENT
/begin MEASUREMENT ERR_INFO_STAT "" UBYTE _CNV_S_2_RANGE______21_R_CM 1 100. 0. 255. ECU_ADDRESS 0x3fd4cc /end MEASUREMENT
/begin MEASUREMENT ERR_INFO_STAT "" UBYTE _CNV_S_2_RANGE______21_R_CM 1 100. 0. 255. ECU_ADDRESS 0x3fd478 /end MEASUREMENT
/begin MEASUREMENT ERR_INFO_STAT "" UBYTE _CNV_S_2_RANGE______21_R_CM 1 100. 0. 255. ECU_ADDRESS 0x3fd488 /end MEASUREMENT
/begin MEASUREMENT ERR_INFO_STAT "" UBYTE _CNV_S_2_RANGE______21_R_CM 1 100. 0. 255. ECU_ADDRESS 0x3fd60c /end MEASUREMENT
/begin MEASUREMENT ERR_INFO_STAT "" UBYTE _CNV_S_2_RANGE______21_R_CM 1 100. 0. 255. ECU_ADDRESS 0x3fd4a4 /end MEASUREMENT
/begin MEASUREMENT ERR_INFO_STAT "" UBYTE _CNV_S_2_RANGE______21_R_CM 1 100. 0. 255. ECU_ADDRESS 0x3fd4a8 /end MEASUREMENT
/begin MEASUREMENT ERR_INFO_STAT "" UBYTE _CNV_S_2_RANGE______21_R_CM 1 100. 0. 255. ECU_ADDRESS 0x3fd55c /end MEASUREMENT
/begin MEASUREMENT ERR_INFO_STAT "" UBYTE _CNV_S_2_RANGE______21_R_CM 1 100. 0. 255. ECU_ADDRESS 0x3fd5ac /end MEASUREMENT
/begin MEASUREMENT ERR_INFO_STAT "" UBYTE _CNV_S_2_RANGE______21_R_CM 1 100. 0. 255. ECU_ADDRESS 0x3fd5b0 /end MEASUREMENT
/begin MEASUREMENT ERR_INFO_STAT "" UBYTE _CNV_S_2_RANGE______21_R_CM 1 100. 0. 255. ECU_ADDRESS 0x3fd38c /end MEASUREMENT
/begin MEASUREMENT ERR_INFO_STAT "" UBYTE _CNV_S_2_RANGE______21_R_CM 1 100. 0. 255. ECU_ADDRESS 0x3fd390 /end MEASUREMENT
/begin MEASUREMENT ERR_INFO_STAT "" UBYTE _CNV_S_2_RANGE______21_R_CM 1 100. 0. 255. ECU_ADDRESS 0x3fd394 /end MEASUREMENT
/begin MEASUREMENT ERR_INFO_STAT "" UBYTE _CNV_S_2_RANGE______21_R_CM 1 100. 0. 255. ECU_ADDRESS 0x3fd398 /end MEASUREMENT
/begin MEASUREMENT ERR_INFO_STAT "" UBYTE _CNV_S_2_RANGE______21_R_CM 1 100. 0. 255. ECU_ADDRESS 0x3fd39c /end MEASUREMENT
/begin MEASUREMENT ERR_INFO_STAT "" UBYTE _CNV_S_2_RANGE______21_R_CM 1 100. 0. 255. ECU_ADDRESS 0x3fd3a0 /end MEASUREMENT
/begin MEASUREMENT ERR_INFO_STAT "" UBYTE _CNV_S_2_RANGE______21_R_CM 1 100. 0. 255. ECU_ADDRESS 0x3fd608 /end MEASUREMENT
/begin MEASUREMENT ERR_INFO_STAT "" UBYTE _CNV_S_2_RANGE______21_R_CM 1 100. 0. 255. ECU_ADDRESS 0x3fd684 /end MEASUREMENT
/begin MEASUREMENT ERR_INFO_STAT "" UBYTE _CNV_S_2_RANGE______21_R_CM 1 100. 0. 255. ECU_ADDRESS 0x3fd624 /end MEASUREMENT
/begin MEASUREMENT ERR_INFO_STAT "" UBYTE _CNV_S_2_RANGE______21_R_CM 1 100. 0. 255. ECU_ADDRESS 0x3fd658 /end MEASUREMENT
/begin MEASUREMENT ERR_INFO_STAT "" UBYTE _CNV_S_2_RANGE______21_R_CM 1 100. 0. 255. ECU_ADDRESS 0x3fd5cc /end MEASUREMENT
/begin MEASUREMENT ERR_INFO_STAT "" UBYTE _CNV_S_2_RANGE______21_R_CM 1 100. 0. 255. ECU_ADDRESS 0x3fd5e8 /end MEASUREMENT
/begin MEASUREMENT ERR_INFO_STAT "" UBYTE _CNV_S_2_RANGE______21_R_CM 1 100. 0. 255. ECU_ADDRESS 0x3fd550 /end MEASUREMENT
/begin MEASUREMENT ERR_INFO_STAT "" UBYTE _CNV_S_2_RANGE______21_R_CM 1 100. 0. 255. ECU_ADDRESS 0x3fd4f8 /end MEASUREMENT
/begin MEASUREMENT ERR_INFO_STAT "" UBYTE _CNV_S_2_RANGE______21_R_CM 1 100. 0. 255. ECU_ADDRESS 0x3fd644 /end MEASUREMENT
/begin MEASUREMENT ERR_INFO_STAT "" UBYTE _CNV_S_2_RANGE______21_R_CM 1 100. 0. 255. ECU_ADDRESS 0x3fd688 /end MEASUREMENT
/begin MEASUREMENT ERR_INFO_STAT "" UBYTE _CNV_S_2_RANGE______21_R_CM 1 100. 0. 255. ECU_ADDRESS 0x3fd638 /end MEASUREMENT
/begin MEASUREMENT ERR_INFO_STAT "" UBYTE _CNV_S_2_RANGE______21_R_CM 1 100. 0. 255. ECU_ADDRESS 0x3fd574 /end MEASUREMENT
/begin MEASUREMENT ERR_INFO_STAT "" UBYTE _CNV_S_2_RANGE______21_R_CM 1 100. 0. 255. ECU_ADDRESS 0x3fd6cc /end MEASUREMENT
/begin MEASUREMENT ERR_INFO_STAT "" UBYTE _CNV_S_2_RANGE______21_R_CM 1 100. 0. 255. ECU_ADDRESS 0x3fd6d0 /end MEASUREMENT
/begin MEASUREMENT ERR_INFO_STAT "" UBYTE _CNV_S_2_RANGE______21_R_CM 1 100. 0. 255. ECU_ADDRESS 0x3fd4f4 /end MEASUREMENT
/begin MEASUREMENT ERR_INFO_STAT "" UBYTE _CNV_S_2_RANGE______21_R_CM 1 100. 0. 255. ECU_ADDRESS 0x3fd4dc /end MEASUREMENT
/begin MEASUREMENT ERR_INFO_STAT "" UBYTE _CNV_S_2_RANGE______21_R_CM 1 100. 0. 255. ECU_ADDRESS 0x3fd68c /end MEASUREMENT
/begin MEASUREMENT ERR_INFO_STAT "" UBYTE _CNV_S_2_RANGE______21_R_CM 1 100. 0. 255. ECU_ADDRESS 0x3fd56c /end MEASUREMENT
/begin MEASUREMENT ERR_INFO_STAT "" UBYTE _CNV_S_2_RANGE______21_R_CM 1 100. 0. 255. ECU_ADDRESS 0x3fd650 /end MEASUREMENT
/begin MEASUREMENT ERR_INFO_STAT "" UBYTE _CNV_S_2_RANGE______21_R_CM 1 100. 0. 255. ECU_ADDRESS 0x3fd698 /end MEASUREMENT
/begin MEASUREMENT ERR_INFO_STAT "" UBYTE _CNV_S_2_RANGE______21_R_CM 1 100. 0. 255. ECU_ADDRESS 0x3fd5bc /end MEASUREMENT
/begin MEASUREMENT ERR_INFO_STAT "" UBYTE _CNV_S_2_RANGE______21_R_CM 1 100. 0. 255. ECU_ADDRESS 0x3fd3f0 /end MEASUREMENT
/begin MEASUREMENT ERR_INFO_STAT "" UBYTE _CNV_S_2_RANGE______21_R_CM 1 100. 0. 255. ECU_ADDRESS 0x3fd35c /end MEASUREMENT
/begin MEASUREMENT ERR_INFO_STAT "" UBYTE _CNV_S_2_RANGE______21_R_CM 1 100. 0. 255. ECU_ADDRESS 0x3fd4d8 /end MEASUREMENT
/begin MEASUREMENT ERR_INFO_STAT "" UBYTE _CNV_S_2_RANGE______21_R_CM 1 100. 0. 255. ECU_ADDRESS 0x3fd504 /end MEASUREMENT
/begin MEASUREMENT PV_AV_GRD_SUM "su. value for limited PV_AV gradient" UWORD _CNV_A_R_LINEAR_____304_CM 1 100. 0. 639990.2340000001 ECU_ADDRESS 0x3faa1a FORMAT "%8.1" /end MEASUREMENT
/begin MEASUREMENT ERR_INFO_STAT "" UBYTE _CNV_S_2_RANGE______21_R_CM 1 100. 0. 255. ECU_ADDRESS 0x3fd694 /end MEASUREMENT
/begin MEASUREMENT ERR_INFO_STAT "" UBYTE _CNV_S_2_RANGE______21_R_CM 1 100. 0. 255. ECU_ADDRESS 0x3fd690 /end MEASUREMENT
/begin MEASUREMENT ERR_INFO_DYN "" UWORD _CNV_S_2_RANGE______21_R_CM 1 100. 0. 255. ECU_ADDRESS 0x3fd2ec /end MEASUREMENT
/begin MEASUREMENT ERR_INFO_DYN "" UWORD _CNV_S_2_RANGE______21_R_CM 1 100. 0. 255. ECU_ADDRESS 0x3fd2f6 /end MEASUREMENT
/begin MEASUREMENT ERR_INFO_DYN "" UWORD _CNV_S_2_RANGE______21_R_CM 1 100. 0. 255. ECU_ADDRESS 0x3fd300 /end MEASUREMENT
/begin MEASUREMENT ERR_INFO_DYN "" UWORD _CNV_S_2_RANGE______21_R_CM 1 100. 0. 255. ECU_ADDRESS 0x3fd30a /end MEASUREMENT
/begin MEASUREMENT ERR_INFO_DYN "" UWORD _CNV_S_2_RANGE______21_R_CM 1 100. 0. 255. ECU_ADDRESS 0x3fd314 /end MEASUREMENT
/begin MEASUREMENT ERR_INFO_DYN "" UWORD _CNV_S_2_RANGE______21_R_CM 1 100. 0. 255. ECU_ADDRESS 0x3fd31e /end MEASUREMENT
/begin MEASUREMENT ERR_INFO_DYN "" UWORD _CNV_S_2_RANGE______21_R_CM 1 100. 0. 255. ECU_ADDRESS 0x3fd328 /end MEASUREMENT
/begin MEASUREMENT ERR_INFO_DYN "" UWORD _CNV_S_2_RANGE______21_R_CM 1 100. 0. 255. ECU_ADDRESS 0x3fd332 /end MEASUREMENT
/begin MEASUREMENT ERR_INFO_DYN "" UWORD _CNV_S_2_RANGE______21_R_CM 1 100. 0. 255. ECU_ADDRESS 0x3fd33c /end MEASUREMENT
/begin MEASUREMENT X_STATE "" UBYTE _CNV_S_2_RANGE______21_R_CM 1 100. 0. 255. ECU_ADDRESS 0x3fd70f /end MEASUREMENT
/begin MEASUREMENT X_STATE "" UBYTE _CNV_S_2_RANGE______21_R_CM 1 100. 0. 255. ECU_ADDRESS 0x3fd6fb /end MEASUREMENT
/begin MEASUREMENT X_STATE "" UBYTE _CNV_S_2_RANGE______21_R_CM 1 100. 0. 255. ECU_ADDRESS 0x3fd719 /end MEASUREMENT
/begin MEASUREMENT X_STATE "" UBYTE _CNV_S_2_RANGE______21_R_CM 1 100. 0. 255. ECU_ADDRESS 0x3fd723 /end MEASUREMENT
/begin MEASUREMENT ERR_INFO_STAT "" UBYTE _CNV_S_2_RANGE______21_R_CM 1 100. 0. 255. ECU_ADDRESS 0x3fd6d4 /end MEASUREMENT
/begin MEASUREMENT ERR_INFO_STAT "" UBYTE _CNV_S_2_RANGE______21_R_CM 1 100. 0. 255. ECU_ADDRESS 0x3fd6d8 /end MEASUREMENT
/begin MEASUREMENT ERR_INFO_STAT "" UBYTE _CNV_S_2_RANGE______21_R_CM 1 100. 0. 255. ECU_ADDRESS 0x3fd528 /end MEASUREMENT
/begin MEASUREMENT ERR_INFO_STAT "" UBYTE _CNV_S_2_RANGE______21_R_CM 1 100. 0. 255. ECU_ADDRESS 0x3fd52c /end MEASUREMENT
/begin MEASUREMENT CTR_ABC_END_DIAG_SEG_T_AD "" UBYTE _CNV_A_R_LINEAR_____12_CM 1 100. 0. 255. ECU_ADDRESS 0x3fd52d FORMAT "%3.0" /end MEASUREMENT
/begin MEASUREMENT ERR_INFO_STAT "" UBYTE _CNV_S_2_RANGE______21_R_CM 1 100. 0. 255. ECU_ADDRESS 0x3fd530 /end MEASUREMENT
/begin MEASUREMENT ERR_INFO_STAT "" UBYTE _CNV_S_2_RANGE______21_R_CM 1 100. 0. 255. ECU_ADDRESS 0x3fd534 /end MEASUREMENT
/begin MEASUREMENT ERR_INFO_STAT "" UBYTE _CNV_S_2_RANGE______21_R_CM 1 100. 0. 255. ECU_ADDRESS 0x3fd538 /end MEASUREMENT
/begin CHARACTERISTIC IVVTHPWM_AD_IN_2 "" CURVE 0x3feb75 _REC_CUR_20_u1_u1 99.609375 _CNV_A_R_LINEAR_____117_CM -50. 49.609375 FORMAT "%6.2"
 /begin AXIS_DESCR COM_AXIS TMAG_IVVT _CNV_A_R_LINEAR_____3_CM 12 -40. 160. FORMAT "%3.0" AXIS_PTS_REF ldpm_tmag_ivvt_1_ivvt /end AXIS_DESCR
/end CHARACTERISTIC
/begin CHARACTERISTIC IVVTHPWM_AD_IN_1 "" CURVE 0x3feb69 _REC_CUR_20_u1_u1 99.609375 _CNV_A_R_LINEAR_____117_CM -50. 49.609375 FORMAT "%6.2"
 /begin AXIS_DESCR COM_AXIS TMAG_IVVT _CNV_A_R_LINEAR_____3_CM 12 -40. 160. FORMAT "%3.0" AXIS_PTS_REF ldpm_tmag_ivvt_1_ivvt /end AXIS_DESCR
/end CHARACTERISTIC
/begin CHARACTERISTIC IVVTHPWM_AD_EX_2 "" CURVE 0x3feb8d _REC_CUR_20_u1_u1 99.609375 _CNV_A_R_LINEAR_____117_CM -50. 49.609375 FORMAT "%6.2"
 /begin AXIS_DESCR COM_AXIS TMAG_IVVT _CNV_A_R_LINEAR_____3_CM 12 -40. 160. FORMAT "%3.0" AXIS_PTS_REF ldpm_tmag_ivvt_1_ivvt /end AXIS_DESCR
/end CHARACTERISTIC
/begin CHARACTERISTIC IVVTHPWM_AD_EX_1 "" CURVE 0x3feb81 _REC_CUR_20_u1_u1 99.609375 _CNV_A_R_LINEAR_____117_CM -50. 49.609375 FORMAT "%6.2"
 /begin AXIS_DESCR COM_AXIS TMAG_IVVT _CNV_A_R_LINEAR_____3_CM 12 -40. 160. FORMAT "%3.0" AXIS_PTS_REF ldpm_tmag_ivvt_1_ivvt /end AXIS_DESCR
/end CHARACTERISTIC
/begin AXIS_PTS ldpm_tmag_ivvt_1_ivvt "" 0x4405b TMAG _REC_AXS_20_u1 200. _CNV_A_R_LINEAR_____3_CM 12 -40. 160. FORMAT "%3.0" /end AXIS_PTS
/begin MEASUREMENT LV_VLS_NOT_VLD_UP_1 "Boolean flag indicating that VLS_UP_i signal not valid, i.e. masked due to Ri determination" UBYTE _CNV_S_2_RANGE______28_CM 1 100. 0. 1. ECU_ADDRESS 0x3fc02d BIT_MASK 0x1 /end MEASUREMENT
/begin MEASUREMENT LV_VLS_NOT_VLD_UP_2 "Boolean flag indicating that VLS_UP_i signal not valid, i.e. masked due to Ri determination" UBYTE _CNV_S_2_RANGE______28_CM 1 100. 0. 1. ECU_ADDRESS 0x3fc041 BIT_MASK 0x1 /end MEASUREMENT
/begin MEASUREMENT LV_VLS_NOT_VLD_DOWN_1 "Boolean flag indicating that VLS_DOWN_i signal not valid, i.e. masked due to Ri determination" UBYTE _CNV_S_2_RANGE______28_CM 1 100. 0. 1. ECU_ADDRESS 0x3fc036 /end MEASUREMENT
/begin MEASUREMENT LV_VLS_NOT_VLD_DOWN_2 "Boolean flag indicating that VLS_DOWN_i signal not valid, i.e. masked due to Ri determination" UBYTE _CNV_S_2_RANGE______28_CM 1 100. 0. 1. ECU_ADDRESS 0x3fc04a /end MEASUREMENT
/begin COMPU_METHOD _CNV_A_R_LINEAR_____3_CM "" RAT_FUNC "%6.3" "°C" COEFFS 0 1. 40. 0 0 1 /end COMPU_METHOD
/begin COMPU_METHOD _CNV_A_R_LINEAR_____12_CM "" RAT_FUNC "%6.3" "[-]" COEFFS 0 1. 0. 0 0 1 /end COMPU_METHOD
/begin COMPU_METHOD _CNV_S_2_RANGE______21_R_CM "" TAB_VERB "%6.3" "[-]" COMPU_TAB_REF _CNV_S_2_RANGE______21_R /end COMPU_METHOD
/begin COMPU_VTAB_RANGE _CNV_S_2_RANGE______21_R "" 2 0 0 "0" 1 255 "1" /end COMPU_VTAB_RANGE
/begin COMPU_METHOD _CNV_S_2_RANGE______28_CM "" TAB_VERB "%6.3" "[-]" COMPU_TAB_REF _CNV_S_2_RANGE______28 /end COMPU_METHOD
/begin COMPU_VTAB _CNV_S_2_RANGE______28 "" TAB_VERB 2 0 "0" 1 "1" /end COMPU_VTAB
/begin COMPU_METHOD _CNV_A_R_LINEAR_____117_CM "" RAT_FUNC "%6.3" "%" COEFFS 0 2.56 128. 0 0 1 /end COMPU_METHOD
/begin COMPU_METHOD _CNV_A_R_LINEAR_____304_CM "" RAT_FUNC "%6.3" "%/s" COEFFS 0 0.1024000000600009 0. 0 0 1 /end COMPU_METHOD
/begin RECORD_LAYOUT _REC_AXS_20_u1 NO_AXIS_PTS_X 1 UBYTE AXIS_PTS_X 2 UBYTE INDEX_INCR DIRECT /end RECORD_LAYOUT
/begin RECORD_LAYOUT _REC_CUR_20_u1_u1 FNC_VALUES 1 UBYTE COLUMN_DIR DIRECT /end RECORD_LAYOUT
/end MODULE
/end PROJECT
