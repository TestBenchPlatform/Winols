ASAP2_VERSION 1 31
/begin PROJECT MS45 "BMW Motorsteuerung R6"
/begin HEADER "_default_HeaderComment" PROJECT_NO _52 /end HEADER
/begin MODULE _default_ModuleName "_default_ModuleLongIdentifier"
/begin MOD_COMMON "_default_ModCommonComment" DEPOSIT ABSOLUTE BYTE_ORDER MSB_FIRST ALIGNMENT_BYTE 1 ALIGNMENT_WORD 2 ALIGNMENT_LONG 4 ALIGNMENT_FLOAT32_IEEE 4 ALIGNMENT_FLOAT64_IEEE 8 /end MOD_COMMON
/begin MEASUREMENT LV_LAM_TCO_LSCL "Temperature conditions for close loop fulfilled" UBYTE _CNV_S_2_RANGE______11_CM 1 100. 0. 1. ECU_ADDRESS 0x3fcb88 BIT_MASK 0x1 /end MEASUREMENT
/begin CHARACTERISTIC C_LAM_FAC_I "Scale factor for TI_LAM integral component" VALUE 0x428f6 _REC_VAL_20_u1 0.9960940000000002 _CNV_A_R_LINEAR_____44_CM 0. 0.996094 FORMAT "%5.3" /end CHARACTERISTIC
/begin CHARACTERISTIC C_LAM_FAC_P "Scale factor for TI_LAM proportional component" VALUE 0x428f7 _REC_VAL_20_u1 0.9960940000000002 _CNV_A_R_LINEAR_____44_CM 0. 0.996094 FORMAT "%4.3" /end CHARACTERISTIC
/begin CHARACTERISTIC C_LAM_INI_MIN "Minimum TI_LAM_i value" VALUE 0x43270 _REC_VAL_20_s2 99.99847412 _CNV_A_R_LINEAR_____98_CM -50. 49.99847412 FORMAT "%6.2" /end CHARACTERISTIC
/begin CHARACTERISTIC C_LAM_MIN "Minimum TI_LAM_i value" VALUE 0x43276 _REC_VAL_20_s2 99.99847412 _CNV_A_R_LINEAR_____98_CM -50. 49.99847412 FORMAT "%6.2" /end CHARACTERISTIC
/begin CHARACTERISTIC C_LAM_MAX "Maximum TI_LAM_i value" VALUE 0x43272 _REC_VAL_20_s2 99.99847412 _CNV_A_R_LINEAR_____98_CM -50. 49.99847412 FORMAT "%6.2" /end CHARACTERISTIC
/begin CHARACTERISTIC C_LAM_INI_MAX "Maximum TI_LAM_i value" VALUE 0x4326e _REC_VAL_20_s2 99.99847412 _CNV_A_R_LINEAR_____98_CM -50. 49.99847412 FORMAT "%6.2" /end CHARACTERISTIC
/begin CHARACTERISTIC C_LAM_MV_LPF_CRLC "correlation constant for the calculation of LAM_MV_LPF" VALUE 0x428f8 _REC_VAL_20_u1 0.9960940000000002 _CNV_A_R_LINEAR_____44_CM 0. 0.996094 FORMAT "%5.3" /end CHARACTERISTIC
/begin CHARACTERISTIC IP_LAM_NEG_P "Basic value of TI_LAM proportional component out of idle during transition from lambda > 1 to lambda < 1" MAP 0x4f973 _REC_MAP_20_u1_u1_u2 0.49609375 _CNV_A_R_LINEAR_____267_CM 0. 0.49609375 FORMAT "%4.3"
 /begin AXIS_DESCR COM_AXIS N_32 _CNV_A_R_LINEAR_____5_CM 8 0. 8160. FORMAT "%4.0" AXIS_PTS_REF ldpm_n_32_1_lamb_ctl /end AXIS_DESCR
 /begin AXIS_DESCR COM_AXIS MAF _CNV_A_R_LINEAR_____95_CM 8 0. 1389. FORMAT "%7.2" AXIS_PTS_REF ldpm_maf_1_lamb_ctl /end AXIS_DESCR
/end CHARACTERISTIC
/begin CHARACTERISTIC C_LAM_SUM_P_IS "Lambda controller P jump delay to have idle P/I values " VALUE 0x428fb _REC_VAL_20_u1 255. _CNV_A_R_LINEAR_____10_CM 0. 255. FORMAT "%3.0" /end CHARACTERISTIC
/begin CHARACTERISTIC C_CL_MAX_LAM_IS "Maximum canister load of  previous MAX_PURGE to switch to idle parameter" VALUE 0x42c4e _REC_VAL_20_u2 1.99996948 _CNV_A_R_LINEAR_____45_CM 0. 1.99996948 FORMAT "%7.5" /end CHARACTERISTIC
/begin CHARACTERISTIC IP_LAM_POS_P "Basic value of TI_LAM proportional component out of idle during transition from lambda < 1 to lambda > 1" MAP 0x4f9f3 _REC_MAP_20_u1_u1_u2 0.49609375 _CNV_A_R_LINEAR_____267_CM 0. 0.49609375 FORMAT "%4.3"
 /begin AXIS_DESCR COM_AXIS N_32 _CNV_A_R_LINEAR_____5_CM 8 0. 8160. FORMAT "%4.0" AXIS_PTS_REF ldpm_n_32_1_lamb_ctl /end AXIS_DESCR
 /begin AXIS_DESCR COM_AXIS MAF _CNV_A_R_LINEAR_____95_CM 8 0. 1389. FORMAT "%7.2" AXIS_PTS_REF ldpm_maf_1_lamb_ctl /end AXIS_DESCR
/end CHARACTERISTIC
/begin CHARACTERISTIC IP_LAM_POS_P_IS "Basic value of TI_LAM_COR proportional component in idle during transition from lambda < 1 to lambda > 1" MAP 0x4fa33 _REC_MAP_20_u1_u1_u2 0.49609375 _CNV_A_R_LINEAR_____267_CM 0. 0.49609375 FORMAT "%4.3"
 /begin AXIS_DESCR COM_AXIS N_32 _CNV_A_R_LINEAR_____5_CM 8 0. 8160. FORMAT "%4.0" AXIS_PTS_REF ldpm_n_32_2_lamb_ctl /end AXIS_DESCR
 /begin AXIS_DESCR COM_AXIS MAF _CNV_A_R_LINEAR_____95_CM 8 0. 1389. FORMAT "%7.2" AXIS_PTS_REF ldpm_maf_1_lamb_ctl /end AXIS_DESCR
/end CHARACTERISTIC
/begin CHARACTERISTIC IP_LAM_NEG_P_IS "Basic value of TI_LAM_COR proportional component in idle during transition from lambda > 1 to lambda < 1" MAP 0x4f9b3 _REC_MAP_20_u1_u1_u2 0.49609375 _CNV_A_R_LINEAR_____267_CM 0. 0.49609375 FORMAT "%4.3"
 /begin AXIS_DESCR COM_AXIS N_32 _CNV_A_R_LINEAR_____5_CM 8 0. 8160. FORMAT "%4.0" AXIS_PTS_REF ldpm_n_32_2_lamb_ctl /end AXIS_DESCR
 /begin AXIS_DESCR COM_AXIS MAF _CNV_A_R_LINEAR_____95_CM 8 0. 1389. FORMAT "%7.2" AXIS_PTS_REF ldpm_maf_1_lamb_ctl /end AXIS_DESCR
/end CHARACTERISTIC
/begin CHARACTERISTIC IP_LAM_I_IS_2 "Basic value of TI_LAM_COR integral component in idle, cylinderbankspecific" MAP 0x4f933 _REC_MAP_20_u1_u1_u2 0.49609375 _CNV_A_R_LINEAR_____267_CM 0. 0.49609375 FORMAT "%4.3"
 /begin AXIS_DESCR COM_AXIS N_32 _CNV_A_R_LINEAR_____5_CM 8 0. 8160. FORMAT "%4.0" AXIS_PTS_REF ldpm_n_32_2_lamb_ctl /end AXIS_DESCR
 /begin AXIS_DESCR COM_AXIS MAF _CNV_A_R_LINEAR_____95_CM 8 0. 1389. FORMAT "%7.2" AXIS_PTS_REF ldpm_maf_1_lamb_ctl /end AXIS_DESCR
/end CHARACTERISTIC
/begin CHARACTERISTIC IP_LAM_I_IS_1 "Basic value of TI_LAM_COR integral component in idle, cylinderbankspecific" MAP 0x4f8f3 _REC_MAP_20_u1_u1_u2 0.49609375 _CNV_A_R_LINEAR_____267_CM 0. 0.49609375 FORMAT "%4.3"
 /begin AXIS_DESCR COM_AXIS N_32 _CNV_A_R_LINEAR_____5_CM 8 0. 8160. FORMAT "%4.0" AXIS_PTS_REF ldpm_n_32_2_lamb_ctl /end AXIS_DESCR
 /begin AXIS_DESCR COM_AXIS MAF _CNV_A_R_LINEAR_____95_CM 8 0. 1389. FORMAT "%7.2" AXIS_PTS_REF ldpm_maf_1_lamb_ctl /end AXIS_DESCR
/end CHARACTERISTIC
/begin CHARACTERISTIC IP_LAM_I_1 "Basic value of TI_LAM_COR integral component in idle, cylinderbankspecific" MAP 0x4f873 _REC_MAP_20_u1_u1_u2 0.49609375 _CNV_A_R_LINEAR_____267_CM 0. 0.49609375 FORMAT "%4.3"
 /begin AXIS_DESCR COM_AXIS N_32 _CNV_A_R_LINEAR_____5_CM 8 0. 8160. FORMAT "%4.0" AXIS_PTS_REF ldpm_n_32_1_lamb_ctl /end AXIS_DESCR
 /begin AXIS_DESCR COM_AXIS MAF _CNV_A_R_LINEAR_____95_CM 8 0. 1389. FORMAT "%7.2" AXIS_PTS_REF ldpm_maf_1_lamb_ctl /end AXIS_DESCR
/end CHARACTERISTIC
/begin CHARACTERISTIC IP_LAM_I_2 "Basic value of TI_LAM_COR integral component in idle, cylinderbankspecific" MAP 0x4f8b3 _REC_MAP_20_u1_u1_u2 0.49609375 _CNV_A_R_LINEAR_____267_CM 0. 0.49609375 FORMAT "%4.3"
 /begin AXIS_DESCR COM_AXIS N_32 _CNV_A_R_LINEAR_____5_CM 8 0. 8160. FORMAT "%4.0" AXIS_PTS_REF ldpm_n_32_1_lamb_ctl /end AXIS_DESCR
 /begin AXIS_DESCR COM_AXIS MAF _CNV_A_R_LINEAR_____95_CM 8 0. 1389. FORMAT "%7.2" AXIS_PTS_REF ldpm_maf_1_lamb_ctl /end AXIS_DESCR
/end CHARACTERISTIC
/begin CHARACTERISTIC IP_T_LAM_DLY_POS_AT_2 "Basic LAM -P-jump delay time from lean to rich transition, cylinderbank i, (Automatic shifted transmission) " MAP 0x4ad88 _REC_MAP_20_u2_u1_u2 1279.9 _CNV_A_R_LINEAR_____268_CM 0. 1279.9 FORMAT "%7.2"
 /begin AXIS_DESCR COM_AXIS N_32 _CNV_A_R_LINEAR_____5_CM 8 0. 8160. FORMAT "%4.0" AXIS_PTS_REF ldpm_n_32_1_lamb_ctl /end AXIS_DESCR
 /begin AXIS_DESCR COM_AXIS MAF _CNV_A_R_LINEAR_____95_CM 8 0. 1389. FORMAT "%7.2" AXIS_PTS_REF ldpm_maf_1_lamb_ctl /end AXIS_DESCR
/end CHARACTERISTIC
/begin CHARACTERISTIC IP_T_LAM_DLY_NEG_AT_2 "Basic LAM -P-jump delay time from rich to lean transition, cylinderbank i, (Automatic shifted transmission)" MAP 0x4a970 _REC_MAP_20_u2_u1_u2 1279.9 _CNV_A_R_LINEAR_____268_CM 0. 1279.9 FORMAT "%7.2"
 /begin AXIS_DESCR COM_AXIS N_32 _CNV_A_R_LINEAR_____5_CM 8 0. 8160. FORMAT "%4.0" AXIS_PTS_REF ldpm_n_32_1_lamb_ctl /end AXIS_DESCR
 /begin AXIS_DESCR COM_AXIS MAF _CNV_A_R_LINEAR_____95_CM 8 0. 1389. FORMAT "%7.2" AXIS_PTS_REF ldpm_maf_1_lamb_ctl /end AXIS_DESCR
/end CHARACTERISTIC
/begin CHARACTERISTIC IP_T_LAM_DLY_NEG_AT_1 "Basic LAM -P-jump delay time from rich to lean transition, cylinderbank i, (Automatic shifted transmission)" MAP 0x4a8f0 _REC_MAP_20_u2_u1_u2 1279.9 _CNV_A_R_LINEAR_____268_CM 0. 1279.9 FORMAT "%7.2"
 /begin AXIS_DESCR COM_AXIS N_32 _CNV_A_R_LINEAR_____5_CM 8 0. 8160. FORMAT "%4.0" AXIS_PTS_REF ldpm_n_32_1_lamb_ctl /end AXIS_DESCR
 /begin AXIS_DESCR COM_AXIS MAF _CNV_A_R_LINEAR_____95_CM 8 0. 1389. FORMAT "%7.2" AXIS_PTS_REF ldpm_maf_1_lamb_ctl /end AXIS_DESCR
/end CHARACTERISTIC
/begin CHARACTERISTIC IP_T_LAM_DLY_POS_MT_1 "Basic LAM -P-jump delay time from lean to rich transition, cylinderbank i, (Manual shifted transmission)" MAP 0x4b008 _REC_MAP_20_u2_u1_u2 1279.9 _CNV_A_R_LINEAR_____268_CM 0. 1279.9 FORMAT "%7.2"
 /begin AXIS_DESCR COM_AXIS N_32 _CNV_A_R_LINEAR_____5_CM 8 0. 8160. FORMAT "%4.0" AXIS_PTS_REF ldpm_n_32_1_lamb_ctl /end AXIS_DESCR
 /begin AXIS_DESCR COM_AXIS MAF _CNV_A_R_LINEAR_____95_CM 8 0. 1389. FORMAT "%7.2" AXIS_PTS_REF ldpm_maf_1_lamb_ctl /end AXIS_DESCR
/end CHARACTERISTIC
/begin CHARACTERISTIC IP_T_LAM_DLY_POS_MT_2 "Basic LAM -P-jump delay time from lean to rich transition, cylinderbank i, (Manual shifted transmission)" MAP 0x4b088 _REC_MAP_20_u2_u1_u2 1279.9 _CNV_A_R_LINEAR_____268_CM 0. 1279.9 FORMAT "%7.2"
 /begin AXIS_DESCR COM_AXIS N_32 _CNV_A_R_LINEAR_____5_CM 8 0. 8160. FORMAT "%4.0" AXIS_PTS_REF ldpm_n_32_1_lamb_ctl /end AXIS_DESCR
 /begin AXIS_DESCR COM_AXIS MAF _CNV_A_R_LINEAR_____95_CM 8 0. 1389. FORMAT "%7.2" AXIS_PTS_REF ldpm_maf_1_lamb_ctl /end AXIS_DESCR
/end CHARACTERISTIC
/begin CHARACTERISTIC IP_T_LAM_DLY_NEG_MT_2 "Basic LAM -P-jump delay time from rich to lean transition, cylinderbank i, (Manual shifted transmission)" MAP 0x4ac70 _REC_MAP_20_u2_u1_u2 1279.9 _CNV_A_R_LINEAR_____268_CM 0. 1279.9 FORMAT "%7.2"
 /begin AXIS_DESCR COM_AXIS N_32 _CNV_A_R_LINEAR_____5_CM 8 0. 8160. FORMAT "%4.0" AXIS_PTS_REF ldpm_n_32_1_lamb_ctl /end AXIS_DESCR
 /begin AXIS_DESCR COM_AXIS MAF _CNV_A_R_LINEAR_____95_CM 8 0. 1389. FORMAT "%7.2" AXIS_PTS_REF ldpm_maf_1_lamb_ctl /end AXIS_DESCR
/end CHARACTERISTIC
/begin CHARACTERISTIC IP_T_LAM_DLY_NEG_MT_1 "Basic LAM -P-jump delay time from rich to lean transition, cylinderbank i, (Manual shifted transmission)" MAP 0x4abf0 _REC_MAP_20_u2_u1_u2 1279.9 _CNV_A_R_LINEAR_____268_CM 0. 1279.9 FORMAT "%7.2"
 /begin AXIS_DESCR COM_AXIS N_32 _CNV_A_R_LINEAR_____5_CM 8 0. 8160. FORMAT "%4.0" AXIS_PTS_REF ldpm_n_32_1_lamb_ctl /end AXIS_DESCR
 /begin AXIS_DESCR COM_AXIS MAF _CNV_A_R_LINEAR_____95_CM 8 0. 1389. FORMAT "%7.2" AXIS_PTS_REF ldpm_maf_1_lamb_ctl /end AXIS_DESCR
/end CHARACTERISTIC
/begin CHARACTERISTIC IP_T_LAM_DLY_POS_AT_1 "Basic LAM -P-jump delay time from lean to rich transition, cylinderbank i, (Automatic shifted transmission) " MAP 0x4ad08 _REC_MAP_20_u2_u1_u2 1279.9 _CNV_A_R_LINEAR_____268_CM 0. 1279.9 FORMAT "%7.2"
 /begin AXIS_DESCR COM_AXIS N_32 _CNV_A_R_LINEAR_____5_CM 8 0. 8160. FORMAT "%4.0" AXIS_PTS_REF ldpm_n_32_1_lamb_ctl /end AXIS_DESCR
 /begin AXIS_DESCR COM_AXIS MAF _CNV_A_R_LINEAR_____95_CM 8 0. 1389. FORMAT "%7.2" AXIS_PTS_REF ldpm_maf_1_lamb_ctl /end AXIS_DESCR
/end CHARACTERISTIC
/begin CHARACTERISTIC IP_T_LAM_DLY_POS_IS_AT_2 "Basic LAM -P-jump delay time from lean to rich transition in idle, cylinderbank i, (Automatic shifted transmission)" MAP 0x4ae88 _REC_MAP_20_u2_u1_u2 1279.9 _CNV_A_R_LINEAR_____268_CM 0. 1279.9 FORMAT "%7.2"
 /begin AXIS_DESCR COM_AXIS N_32 _CNV_A_R_LINEAR_____5_CM 8 0. 8160. FORMAT "%4.0" AXIS_PTS_REF ldpm_n_32_2_lamb_ctl /end AXIS_DESCR
 /begin AXIS_DESCR COM_AXIS MAF _CNV_A_R_LINEAR_____95_CM 8 0. 1389. FORMAT "%7.2" AXIS_PTS_REF ldpm_maf_2_lamb_ctl /end AXIS_DESCR
/end CHARACTERISTIC
/begin CHARACTERISTIC IP_T_LAM_DLY_NEG_IS_AT_2 "Basic LAM -P-jump delay time from rich to lean transition in idle, cylinderbank i, (Automatic shifted transmission)" MAP 0x4aa70 _REC_MAP_20_u2_u1_u2 1279.9 _CNV_A_R_LINEAR_____268_CM 0. 1279.9 FORMAT "%7.2"
 /begin AXIS_DESCR COM_AXIS N_32 _CNV_A_R_LINEAR_____5_CM 8 0. 8160. FORMAT "%4.0" AXIS_PTS_REF ldpm_n_32_2_lamb_ctl /end AXIS_DESCR
 /begin AXIS_DESCR COM_AXIS MAF _CNV_A_R_LINEAR_____95_CM 8 0. 1389. FORMAT "%7.2" AXIS_PTS_REF ldpm_maf_2_lamb_ctl /end AXIS_DESCR
/end CHARACTERISTIC
/begin CHARACTERISTIC IP_T_LAM_DLY_NEG_IS_AT_1 "Basic LAM -P-jump delay time from rich to lean transition in idle, cylinderbank i, (Automatic shifted transmission)" MAP 0x4a9f0 _REC_MAP_20_u2_u1_u2 1279.9 _CNV_A_R_LINEAR_____268_CM 0. 1279.9 FORMAT "%7.2"
 /begin AXIS_DESCR COM_AXIS N_32 _CNV_A_R_LINEAR_____5_CM 8 0. 8160. FORMAT "%4.0" AXIS_PTS_REF ldpm_n_32_2_lamb_ctl /end AXIS_DESCR
 /begin AXIS_DESCR COM_AXIS MAF _CNV_A_R_LINEAR_____95_CM 8 0. 1389. FORMAT "%7.2" AXIS_PTS_REF ldpm_maf_2_lamb_ctl /end AXIS_DESCR
/end CHARACTERISTIC
/begin CHARACTERISTIC IP_T_LAM_DLY_POS_IS_AT_1 "Basic LAM -P-jump delay time from lean to rich transition in idle, cylinderbank i, (Automatic shifted transmission)" MAP 0x4ae08 _REC_MAP_20_u2_u1_u2 1279.9 _CNV_A_R_LINEAR_____268_CM 0. 1279.9 FORMAT "%7.2"
 /begin AXIS_DESCR COM_AXIS N_32 _CNV_A_R_LINEAR_____5_CM 8 0. 8160. FORMAT "%4.0" AXIS_PTS_REF ldpm_n_32_2_lamb_ctl /end AXIS_DESCR
 /begin AXIS_DESCR COM_AXIS MAF _CNV_A_R_LINEAR_____95_CM 8 0. 1389. FORMAT "%7.2" AXIS_PTS_REF ldpm_maf_2_lamb_ctl /end AXIS_DESCR
/end CHARACTERISTIC
/begin CHARACTERISTIC IP_T_LAM_DLY_POS_IS_MT_1 "Basic LAM -P-jump delay time from lean to rich transition in idle, cylinderbank i, (Manual shifted transmission)" MAP 0x4af08 _REC_MAP_20_u2_u1_u2 1279.9 _CNV_A_R_LINEAR_____268_CM 0. 1279.9 FORMAT "%7.2"
 /begin AXIS_DESCR COM_AXIS N_32 _CNV_A_R_LINEAR_____5_CM 8 0. 8160. FORMAT "%4.0" AXIS_PTS_REF ldpm_n_32_2_lamb_ctl /end AXIS_DESCR
 /begin AXIS_DESCR COM_AXIS MAF _CNV_A_R_LINEAR_____95_CM 8 0. 1389. FORMAT "%7.2" AXIS_PTS_REF ldpm_maf_2_lamb_ctl /end AXIS_DESCR
/end CHARACTERISTIC
/begin CHARACTERISTIC IP_T_LAM_DLY_POS_IS_MT_2 "Basic LAM -P-jump delay time from lean to rich transition in idle, cylinderbank i, (Manual shifted transmission)" MAP 0x4af88 _REC_MAP_20_u2_u1_u2 1279.9 _CNV_A_R_LINEAR_____268_CM 0. 1279.9 FORMAT "%7.2"
 /begin AXIS_DESCR COM_AXIS N_32 _CNV_A_R_LINEAR_____5_CM 8 0. 8160. FORMAT "%4.0" AXIS_PTS_REF ldpm_n_32_2_lamb_ctl /end AXIS_DESCR
 /begin AXIS_DESCR COM_AXIS MAF _CNV_A_R_LINEAR_____95_CM 8 0. 1389. FORMAT "%7.2" AXIS_PTS_REF ldpm_maf_2_lamb_ctl /end AXIS_DESCR
/end CHARACTERISTIC
/begin CHARACTERISTIC IP_T_LAM_DLY_NEG_IS_MT_2 "Basic LAM -P-jump delay time from rich to lean transition in idle, cylinderbank i, (Manual shifted transmission)" MAP 0x4ab70 _REC_MAP_20_u2_u1_u2 1279.9 _CNV_A_R_LINEAR_____268_CM 0. 1279.9 FORMAT "%7.2"
 /begin AXIS_DESCR COM_AXIS N_32 _CNV_A_R_LINEAR_____5_CM 8 0. 8160. FORMAT "%4.0" AXIS_PTS_REF ldpm_n_32_2_lamb_ctl /end AXIS_DESCR
 /begin AXIS_DESCR COM_AXIS MAF _CNV_A_R_LINEAR_____95_CM 8 0. 1389. FORMAT "%7.2" AXIS_PTS_REF ldpm_maf_2_lamb_ctl /end AXIS_DESCR
/end CHARACTERISTIC
/begin CHARACTERISTIC IP_T_LAM_DLY_NEG_IS_MT_1 "Basic LAM -P-jump delay time from rich to lean transition in idle, cylinderbank i, (Manual shifted transmission)" MAP 0x4aaf0 _REC_MAP_20_u2_u1_u2 1279.9 _CNV_A_R_LINEAR_____268_CM 0. 1279.9 FORMAT "%7.2"
 /begin AXIS_DESCR COM_AXIS N_32 _CNV_A_R_LINEAR_____5_CM 8 0. 8160. FORMAT "%4.0" AXIS_PTS_REF ldpm_n_32_2_lamb_ctl /end AXIS_DESCR
 /begin AXIS_DESCR COM_AXIS MAF _CNV_A_R_LINEAR_____95_CM 8 0. 1389. FORMAT "%7.2" AXIS_PTS_REF ldpm_maf_2_lamb_ctl /end AXIS_DESCR
/end CHARACTERISTIC
/begin CHARACTERISTIC IP_T_LAM_DLY_NEG_TCO "Offset P-jump delay negativ TCO dependant" CURVE 0x4acf0 _REC_CUR_20_u2_u1 1279.9 _CNV_A_R_LINEAR_____268_CM 0. 1279.9 FORMAT "%7.2"
 /begin AXIS_DESCR COM_AXIS TCO _CNV_A_R_LINEAR_____0_CM 6 -48. 142.5 FORMAT "%5.1" AXIS_PTS_REF ldpm_tco_1_lam /end AXIS_DESCR
/end CHARACTERISTIC
/begin CHARACTERISTIC IP_T_LAM_DLY_POS_TCO "Offset P-jump delay positiv TCO dependant" CURVE 0x4b108 _REC_CUR_20_u2_u1 1279.9 _CNV_A_R_LINEAR_____268_CM 0. 1279.9 FORMAT "%7.2"
 /begin AXIS_DESCR COM_AXIS TCO _CNV_A_R_LINEAR_____0_CM 6 -48. 142.5 FORMAT "%5.1" AXIS_PTS_REF ldpm_tco_1_lam /end AXIS_DESCR
/end CHARACTERISTIC
/begin CHARACTERISTIC IP_T_LAM_DLY_POS_TEG_CAT "Offset P-jump delay positiv CAT temperature dependant" CURVE 0x4b114 _REC_CUR_20_u2_u2 1279.9 _CNV_A_R_LINEAR_____268_CM 0. 1279.9 FORMAT "%7.2"
 /begin AXIS_DESCR COM_AXIS TEG_CAT_UP_MDL_MAX _CNV_A_R_LINEAR_____269_CM 6 -48. 1459.3 FORMAT "%7.2" AXIS_PTS_REF ldpm_teg_cat_up_mdl_1_lam /end AXIS_DESCR
/end CHARACTERISTIC
/begin CHARACTERISTIC IP_T_LAM_DLY_NEG_TEG_CAT "Offset P-jump delay negativ CAT temperature dependant" CURVE 0x4acfc _REC_CUR_20_u2_u2 1279.9 _CNV_A_R_LINEAR_____268_CM 0. 1279.9 FORMAT "%7.2"
 /begin AXIS_DESCR COM_AXIS TEG_CAT_UP_MDL_MAX _CNV_A_R_LINEAR_____269_CM 6 -48. 1459.3 FORMAT "%7.2" AXIS_PTS_REF ldpm_teg_cat_up_mdl_1_lam /end AXIS_DESCR
/end CHARACTERISTIC
/begin CHARACTERISTIC IP_CRLC_LAM_MV_LPF_CP "Damping constant of the low pass filter used by canister purge" CURVE 0x4da3d _REC_CUR_20_u1_u2 0.99610001 _CNV_A_R_LINEAR_____20_CM 0. 0.99610001 FORMAT "%5.3"
 /begin AXIS_DESCR COM_AXIS MAF_CYL _CNV_A_R_LINEAR_____101_CM 6 0. 2047.96875 FORMAT "%7.2" AXIS_PTS_REF ldp_maf_cyl_ip_crlc_lam_mv_lpf /end AXIS_DESCR
/end CHARACTERISTIC
/begin CHARACTERISTIC C_MAF_DYW "MAF window for limited dynamics." VALUE 0x428ff _REC_VAL_20_u1 1389. _CNV_A_R_LINEAR_____18_CM 0. 1389. FORMAT "%4.0" /end CHARACTERISTIC
/begin CHARACTERISTIC C_N_DYW "N window for limited dynamics." VALUE 0x42ea8 _REC_VAL_20_u2 8160. _CNV_A_R_LINEAR_____17_CM 0. 8160. FORMAT "%4.0" /end CHARACTERISTIC
/begin CHARACTERISTIC C_LAM_MV_DYW "LAM_MV_i window for limited dynamics." VALUE 0x42dbe _REC_VAL_20_u2 99.99847412 _CNV_A_R_LINEAR_____94_CM 0. 99.99847412 /end CHARACTERISTIC
/begin AXIS_PTS ldpm_n_32_1_lamb_ctl "" 0x43cf9 N_32 _REC_AXS_20_u1 8160. _CNV_A_R_LINEAR_____5_CM 8 0. 8160. FORMAT "%4.0" /end AXIS_PTS
/begin AXIS_PTS ldpm_maf_1_lamb_ctl "" 0x45006 MAF _REC_AXS_20_u2 1389. _CNV_A_R_LINEAR_____95_CM 8 0. 1389. FORMAT "%7.2" /end AXIS_PTS
/begin AXIS_PTS ldpm_maf_2_lamb_ctl "" 0x4504c MAF _REC_AXS_20_u2 1389. _CNV_A_R_LINEAR_____95_CM 8 0. 1389. FORMAT "%7.2" /end AXIS_PTS
/begin AXIS_PTS ldpm_tco_1_lam "" 0x43f57 TCO _REC_AXS_20_u1 190.5 _CNV_A_R_LINEAR_____0_CM 6 -48. 142.5 FORMAT "%5.1" /end AXIS_PTS
/begin AXIS_PTS ldpm_n_32_2_lamb_ctl "" 0x43d41 N_32 _REC_AXS_20_u1 8160. _CNV_A_R_LINEAR_____5_CM 8 0. 8160. FORMAT "%4.0" /end AXIS_PTS
/begin AXIS_PTS ldp_maf_cyl_ip_crlc_lam_mv_lpf "" 0x4453c MAF_CYL _REC_AXS_20_u2 2047.96875 _CNV_A_R_LINEAR_____101_CM 6 0. 2047.96875 FORMAT "%7.2" /end AXIS_PTS
/begin AXIS_PTS ldpm_teg_cat_up_mdl_1_lam "" 0x4549a TEG_CAT_UP_MDL _REC_AXS_20_u2 1507.3 _CNV_A_R_LINEAR_____269_CM 6 -48. 1459.3 FORMAT "%7.2" /end AXIS_PTS
/begin MEASUREMENT LAMB_HOM_AFL "lambda setpoint for homogeneous lean combustion" UWORD _CNV_A_R_LINEAR_____148_CM 1 100. 0. 31.99902344 ECU_ADDRESS 0x3fcba8 FORMAT "%7.4" /end MEASUREMENT
/begin CHARACTERISTIC IP_LAMB_BAS_WUP_COR "Warm-up correction of basic lambda" MAP 0x48836 _REC_MAP_20_u2_u1_u1 4. _CNV_A_R_LINEAR_____271_CM -2. 2. FORMAT "%8.5"
 /begin AXIS_DESCR COM_AXIS TCO _CNV_A_R_LINEAR_____0_CM 8 -48. 142.5 FORMAT "%5.1" AXIS_PTS_REF ldp_tco_ip_lamb_bas_wup_cor /end AXIS_DESCR
 /begin AXIS_DESCR COM_AXIS TCO_ST _CNV_A_R_LINEAR_____0_CM 8 -48. 142.5 FORMAT "%5.1" AXIS_PTS_REF ldp_tco_st_ip_lamb_bas_wup_cor /end AXIS_DESCR
/end CHARACTERISTIC
/begin CHARACTERISTIC IP_LAMB_HOM_AFL "lambda setpoint for homogeneous lean combustion" MAP 0x48a0e _REC_MAP_20_u2_u1_u2 31.99902344 _CNV_A_R_LINEAR_____148_CM 0. 31.99902344 FORMAT "%7.4"
 /begin AXIS_DESCR COM_AXIS N_32 _CNV_A_R_LINEAR_____5_CM 8 0. 8160. FORMAT "%4.0" AXIS_PTS_REF ldp_n_32_ip_lamb_hom_afl /end AXIS_DESCR
 /begin AXIS_DESCR COM_AXIS TQI_REQ_SLOW _CNV_A_R_LINEAR_____218_CM 8 -1024. 1023.96875 FORMAT "%6.2" AXIS_PTS_REF ldp_tqi_req_slow_ip_lamb_hom_afl /end AXIS_DESCR
/end CHARACTERISTIC
/begin MEASUREMENT LAMB_AFL_1 "lambda setpoint for homogeneous lean step value" UWORD _CNV_A_R_LINEAR_____148_CM 1 100. 0. 31.99902344 ECU_ADDRESS 0x3fcbaa FORMAT "%7.4" /end MEASUREMENT
/begin CHARACTERISTIC IP_LAMB_BAS_1 "basic lambda setpoint" MAP 0x48736 _REC_MAP_20_u2_u1_u2 4. _CNV_A_R_LINEAR_____113_CM 0. 4. FORMAT "%6.4"
 /begin AXIS_DESCR COM_AXIS N_32 _CNV_A_R_LINEAR_____5_CM 8 0. 8160. FORMAT "%4.0" AXIS_PTS_REF ldpm_n_32_1_lasp /end AXIS_DESCR
 /begin AXIS_DESCR COM_AXIS MAF _CNV_A_R_LINEAR_____95_CM 8 0. 1389. FORMAT "%7.2" AXIS_PTS_REF ldpm_maf_1_lasp /end AXIS_DESCR
/end CHARACTERISTIC
/begin CHARACTERISTIC IP_LAMB_BAS_2 "basic lambda setpoint" MAP 0x487b6 _REC_MAP_20_u2_u1_u2 4. _CNV_A_R_LINEAR_____113_CM 0. 4. FORMAT "%6.4"
 /begin AXIS_DESCR COM_AXIS N_32 _CNV_A_R_LINEAR_____5_CM 8 0. 8160. FORMAT "%4.0" AXIS_PTS_REF ldpm_n_32_1_lasp /end AXIS_DESCR
 /begin AXIS_DESCR COM_AXIS MAF _CNV_A_R_LINEAR_____95_CM 8 0. 1389. FORMAT "%7.2" AXIS_PTS_REF ldpm_maf_1_lasp /end AXIS_DESCR
/end CHARACTERISTIC
/begin MEASUREMENT LAMB_HOM_AFS "stociometric lambda setpoint  " UWORD _CNV_A_R_LINEAR_____148_CM 1 100. 0. 31.99902344 ECU_ADDRESS 0x3fcbac FORMAT "%7.4" /end MEASUREMENT
/begin MEASUREMENT LAMB_BAS "basic lambda setpoint" UWORD _CNV_A_R_LINEAR_____148_CM 1 100. 0. 31.99902344 ECU_ADDRESS 0x3fcba6 FORMAT "%7.4" /end MEASUREMENT
/begin CHARACTERISTIC C_LAMB_BAS_OFS_CAT_DIAG "Offset for lambda setpoint" VALUE 0x4327a _REC_VAL_20_s2 3.999938965 _CNV_A_R_LINEAR_____272_CM -2. 1.999938965 FORMAT "%8.4" /end CHARACTERISTIC
/begin CHARACTERISTIC IP_LAMB_AFL_1 "lambda setpoint for homogeneous lean step value" MAP 0x486b6 _REC_MAP_20_u2_u1_u2 31.99902344 _CNV_A_R_LINEAR_____148_CM 0. 31.99902344 FORMAT "%7.4"
 /begin AXIS_DESCR COM_AXIS N_32 _CNV_A_R_LINEAR_____5_CM 8 0. 8160. FORMAT "%4.0" AXIS_PTS_REF ldp_n_32_ip_lamb_afl_1 /end AXIS_DESCR
 /begin AXIS_DESCR COM_AXIS TQI_REQ_SLOW _CNV_A_R_LINEAR_____218_CM 8 -1024. 1023.96875 FORMAT "%6.2" AXIS_PTS_REF ldp_tqi_req_slow_ip_lamb_afl_1 /end AXIS_DESCR
/end CHARACTERISTIC
/begin CHARACTERISTIC IP_FAC_LAMB_WUP "correction factor for basic lambda warm-up" MAP 0x4e1d5 _REC_MAP_20_u1_u1_u2 1.9921875 _CNV_A_R_LINEAR_____103_CM 0. 1.9921875 FORMAT "%5.3"
 /begin AXIS_DESCR COM_AXIS N_32 _CNV_A_R_LINEAR_____5_CM 6 0. 8160. FORMAT "%4.0" AXIS_PTS_REF ldp_n_32_ip_fac_lamb_wup /end AXIS_DESCR
 /begin AXIS_DESCR COM_AXIS MAF _CNV_A_R_LINEAR_____95_CM 6 0. 1389. FORMAT "%7.2" AXIS_PTS_REF ldp_maf_ip_fac_lamb_wup /end AXIS_DESCR
/end CHARACTERISTIC
/begin CHARACTERISTIC IP_FAC_LAMB_WUP_IS "correction factor for basic lambda warm-up during idle" MAP 0x4e1f9 _REC_MAP_20_u1_u1_u2 1.9921875 _CNV_A_R_LINEAR_____103_CM 0. 1.9921875 FORMAT "%5.3"
 /begin AXIS_DESCR COM_AXIS N_32 _CNV_A_R_LINEAR_____5_CM 3 0. 8160. FORMAT "%4.0" AXIS_PTS_REF ldp_n_32_ip_fac_lamb_wup_is /end AXIS_DESCR
 /begin AXIS_DESCR COM_AXIS MAF _CNV_A_R_LINEAR_____95_CM 4 0. 1389. FORMAT "%7.2" AXIS_PTS_REF ldp_maf_ip_fac_lamb_wup_is /end AXIS_DESCR
/end CHARACTERISTIC
/begin AXIS_PTS ldpm_maf_1_lasp "" 0x45018 MAF _REC_AXS_20_u2 1389. _CNV_A_R_LINEAR_____95_CM 8 0. 1389. FORMAT "%7.2" /end AXIS_PTS
/begin AXIS_PTS ldpm_n_32_1_lasp "" 0x43d02 N_32 _REC_AXS_20_u1 8160. _CNV_A_R_LINEAR_____5_CM 8 0. 8160. FORMAT "%4.0" /end AXIS_PTS
/begin AXIS_PTS ldp_n_32_ip_lamb_afl_1 "" 0x43692 N_32 _REC_AXS_20_u1 8160. _CNV_A_R_LINEAR_____5_CM 8 0. 8160. FORMAT "%4.0" /end AXIS_PTS
/begin AXIS_PTS ldp_tqi_req_slow_ip_lamb_afl_1 "" 0x44cc4 TQI_REQ_SLOW _REC_AXS_20_u2 2047.96875 _CNV_A_R_LINEAR_____218_CM 8 -1024. 1023.96875 FORMAT "%6.2" /end AXIS_PTS
/begin AXIS_PTS ldp_tco_st_ip_lamb_bas_wup_cor "" 0x43972 TCO_ST _REC_AXS_20_u1 190.5 _CNV_A_R_LINEAR_____0_CM 8 -48. 142.5 FORMAT "%5.1" /end AXIS_PTS
/begin AXIS_PTS ldp_n_32_ip_lamb_hom_afl "" 0x4369b N_32 _REC_AXS_20_u1 8160. _CNV_A_R_LINEAR_____5_CM 8 0. 8160. FORMAT "%4.0" /end AXIS_PTS
/begin AXIS_PTS ldp_tqi_req_slow_ip_lamb_hom_afl "" 0x44cd6 TQI_REQ_SLOW _REC_AXS_20_u2 2047.96875 _CNV_A_R_LINEAR_____218_CM 8 -1024. 1023.96875 FORMAT "%6.2" /end AXIS_PTS
/begin AXIS_PTS ldp_tco_ip_lamb_bas_wup_cor "" 0x4390f TCO _REC_AXS_20_u1 190.5 _CNV_A_R_LINEAR_____0_CM 8 -48. 142.5 FORMAT "%5.1" /end AXIS_PTS
/begin AXIS_PTS ldp_n_32_ip_fac_lamb_wup "" 0x43675 N_32 _REC_AXS_20_u1 8160. _CNV_A_R_LINEAR_____5_CM 6 0. 8160. FORMAT "%4.0" /end AXIS_PTS
/begin AXIS_PTS ldp_n_32_ip_fac_lamb_wup_is "" 0x4367c N_32 _REC_AXS_20_u1 8160. _CNV_A_R_LINEAR_____5_CM 3 0. 8160. FORMAT "%4.0" /end AXIS_PTS
/begin AXIS_PTS ldp_maf_ip_fac_lamb_wup "" 0x445ae MAF _REC_AXS_20_u2 1389. _CNV_A_R_LINEAR_____95_CM 6 0. 1389. FORMAT "%7.2" /end AXIS_PTS
/begin AXIS_PTS ldp_maf_ip_fac_lamb_wup_is "" 0x445bc MAF _REC_AXS_20_u2 1389. _CNV_A_R_LINEAR_____95_CM 4 0. 1389. FORMAT "%7.2" /end AXIS_PTS
/begin CHARACTERISTIC IP_TEG_COP_SP_DIF "Temperature offset launching overheat protection" CURVE 0x4b27c _REC_CUR_20_u2_u1 753.641 _CNV_A_R_LINEAR_____274_CM 0. 753.641 FORMAT "%7.3"
 /begin AXIS_DESCR COM_AXIS ONLINE_DUMMY _CNV_A_R_LINEAR_____275_CM 6 0. 127.5 FORMAT "%5.1" AXIS_PTS_REF ldp_t_cop_i__teg_cop /end AXIS_DESCR
/end CHARACTERISTIC
/begin CHARACTERISTIC IP_LAMB_COP "Lambda setpoint for overheat protection" CURVE 0x489b6 _REC_CUR_20_u2_u2 31.99902344 _CNV_A_R_LINEAR_____148_CM 0. 31.99902344 FORMAT "%7.4"
 /begin AXIS_DESCR COM_AXIS ONLINE_DUMMY _CNV_A_R_LINEAR_____45_CM 16 0. 1.99996948 FORMAT "%7.5" AXIS_PTS_REF ldp_fac_cop_i__teg_cop /end AXIS_DESCR
/end CHARACTERISTIC
/begin CHARACTERISTIC IP_TEG_COP_SP "Catalyst overheat protection setpoint" CURVE 0x4b274 _REC_CUR_20_u2_u2 1507.3 _CNV_A_R_LINEAR_____269_CM -48. 1459.3 FORMAT "%7.2"
 /begin AXIS_DESCR COM_AXIS ONLINE_DUMMY _CNV_A_R_LINEAR_____45_CM 4 0. 1.99996948 FORMAT "%7.5" AXIS_PTS_REF ldpm_eff_iga_av_teg_i__teg_cop /end AXIS_DESCR
/end CHARACTERISTIC
/begin CHARACTERISTIC C_LAMB_COP_SP_PAS "passive value for the lambda catalyst overheating prevention" VALUE 0x42dc8 _REC_VAL_20_u2 31.99902344 _CNV_A_R_LINEAR_____148_CM 0. 31.99902344 FORMAT "%7.4" /end CHARACTERISTIC
/begin CHARACTERISTIC C_LGRD_LAMB_COP_INC "Change limitation for the lambda catalyst overheating prevention" VALUE 0x42dec _REC_VAL_20_u2 31.99902344 _CNV_A_R_LINEAR_____148_CM 0. 31.99902344 FORMAT "%7.4" /end CHARACTERISTIC
/begin CHARACTERISTIC C_LGRD_LAMB_COP_DEC "Decrementation for the lambda catalyst overheating prevention" VALUE 0x42dea _REC_VAL_20_u2 31.99902344 _CNV_A_R_LINEAR_____148_CM 0. 31.99902344 FORMAT "%7.4" /end CHARACTERISTIC
/begin CHARACTERISTIC IP_TEG_COP_SP_LIM "Catalyst overheat protection at ewrror" CURVE 0x4b288 _REC_CUR_20_u2_u2 1507.3 _CNV_A_R_LINEAR_____269_CM -48. 1459.3 FORMAT "%7.2"
 /begin AXIS_DESCR COM_AXIS ONLINE_DUMMY _CNV_A_R_LINEAR_____45_CM 4 0. 1.99996948 FORMAT "%7.5" AXIS_PTS_REF ldpm_eff_iga_av_teg_i__teg_cop /end AXIS_DESCR
/end CHARACTERISTIC
/begin AXIS_PTS ldp_t_cop_i__teg_cop "" 0x4381c T_COP _REC_AXS_20_u1 127.5 _CNV_A_R_LINEAR_____275_CM 6 0. 127.5 FORMAT "%5.1" /end AXIS_PTS
/begin AXIS_PTS ldp_fac_cop_i__teg_cop "" 0x44344 FAC_COP _REC_AXS_20_u2 1.99996948 _CNV_A_R_LINEAR_____45_CM 16 0. 1.99996948 FORMAT "%7.5" /end AXIS_PTS
/begin AXIS_PTS ldpm_eff_iga_av_teg_i__teg_cop "" 0x44f10 EFF_IGA_AV_TEG _REC_AXS_20_u2 1.99996948 _CNV_A_R_LINEAR_____45_CM 4 0. 1.99996948 FORMAT "%7.5" /end AXIS_PTS
/begin MEASUREMENT LV_UP_LS_1 "Logical variable for recognized operability of the lambda probe" ULONG _CNV_S_2_RANGE______28_CM 1 100. 0. 1. ECU_ADDRESS 0x3fa8dc BIT_MASK 0x80000000 /end MEASUREMENT
/begin MEASUREMENT LV_UP_LS_CDN_1 "Logical variable for recognized limited operability of the lambda probe" ULONG _CNV_S_2_RANGE______28_CM 1 100. 0. 1. ECU_ADDRESS 0x3fa8dc BIT_MASK 0x40000000 /end MEASUREMENT
/begin MEASUREMENT LV_DELTA_LAMB_1 "Boolean for downstream fuel trim regulation active" ULONG _CNV_S_2_RANGE______28_CM 1 100. 0. 1. ECU_ADDRESS 0x3fa780 BIT_MASK 0x80000000 /end MEASUREMENT
/begin MEASUREMENT LV_LAM_DLY_PER_VLD_1 "internal state variable for the monitoring of the controller difference (sign)" ULONG _CNV_S_2_RANGE______28_CM 1 100. 0. 1. ECU_ADDRESS 0x3fa780 BIT_MASK 0x40000000 /end MEASUREMENT
/begin MEASUREMENT FAC_CAT_DLY_1 "weight factor for P-share regarding catalyst conversion capability" UWORD _CNV_A_R_LINEAR_____31_CM 1 100. 0. 0.99998474 ECU_ADDRESS 0x3fa792 FORMAT "%7.5" /end MEASUREMENT
/begin MEASUREMENT MAF_INT_DLY_1 "integral of air mass flow since LAM activation" UWORD _CNV_A_R_LINEAR_____277_CM 1 100. 0. 1820.398 ECU_ADDRESS 0x3fa794 FORMAT "%7.2" /end MEASUREMENT
/begin MEASUREMENT T_DLY_I_1 "LAM -P-jump delay time from I-share" SWORD _CNV_A_R_LINEAR_____278_CM 1 100. -640. 639.9804688 ECU_ADDRESS 0x3fa788 FORMAT "%7.2" /end MEASUREMENT
/begin MEASUREMENT T_DLY_I_AD_1 "initial value for the I-share (Adaptation value)" SWORD _CNV_A_R_LINEAR_____278_CM 1 100. -640. 639.9804688 ECU_ADDRESS 0x3fa78e FORMAT "%7.2" /end MEASUREMENT
/begin MEASUREMENT T_DLY_P_1 "LAM -P-jump delay time from P-share" SWORD _CNV_A_R_LINEAR_____279_CM 1 100. -2560. 2559.921875 ECU_ADDRESS 0x3fa786 FORMAT "%7.2" /end MEASUREMENT
/begin MEASUREMENT T_LAM_DLY_1 "LAM -P-jump delay time from downstream trim controller" SWORD _CNV_A_R_LINEAR_____280_CM 1 100. -15360. 15359.53125 ECU_ADDRESS 0x3fa790 FORMAT "%8.1" /end MEASUREMENT
/begin MEASUREMENT VLS_DIF_DLY_1 "difference between setpoint and actual downstream LS signal" SWORD _CNV_A_R_LINEAR_____33_CM 1 100. -4.99511719 4.99511719 ECU_ADDRESS 0x3fa784 FORMAT "%4.3" /end MEASUREMENT
/begin MEASUREMENT LV_LAM_LIM_MAX_1 "lambda controller value is limited to TI_LAM_MAX" ULONG _CNV_S_2_RANGE______28_CM 1 100. 0. 1. ECU_ADDRESS 0x3fa7c8 BIT_MASK 0x40000000 /end MEASUREMENT
/begin MEASUREMENT LV_LAM_LIM_MIN_1 "lambda controller value is limited to TI_LAM_MIN" ULONG _CNV_S_2_RANGE______28_CM 1 100. 0. 1. ECU_ADDRESS 0x3fa7c8 BIT_MASK 0x80000000 /end MEASUREMENT
/begin MEASUREMENT LV_LSCL_1 "Close loop enable" ULONG _CNV_S_2_RANGE______28_CM 1 100. 0. 1. ECU_ADDRESS 0x3fa7c8 BIT_MASK 0x20000000 /end MEASUREMENT
/begin MEASUREMENT LV_LSCL_CAT_PURGE_1 "Conditions for closed loop except cat purge cylinder bank i" ULONG _CNV_S_2_RANGE______28_CM 1 100. 0. 1. ECU_ADDRESS 0x3fa7c8 BIT_MASK 0x400000 /end MEASUREMENT
/begin MEASUREMENT LV_LAM_ONCE_ACT_1 " closed loop has been enabled" ULONG _CNV_S_2_RANGE______28_CM 1 100. 0. 1. ECU_ADDRESS 0x3fa7c8 BIT_MASK 0x200000 /end MEASUREMENT
/begin MEASUREMENT LV_LAM_DYW_1 "Limited dynamic conditions recognised for LAM_i" ULONG _CNV_S_2_RANGE______28_CM 1 100. 0. 1. ECU_ADDRESS 0x3fa7c8 BIT_MASK 0x10000000 /end MEASUREMENT
/begin MEASUREMENT LV_N_MAF_DYW_1 "Limited dynamic conditions recognised for N and MAF" ULONG _CNV_S_2_RANGE______28_CM 1 100. 0. 1. ECU_ADDRESS 0x3fa7c8 BIT_MASK 0x80000 /end MEASUREMENT
/begin MEASUREMENT LV_LAM_ADJ_AD_END_1 "Controller shift by lambda adaptation was carried out" ULONG _CNV_S_2_RANGE______28_CM 1 100. 0. 1. ECU_ADDRESS 0x3fa7c8 BIT_MASK 0x100000 /end MEASUREMENT
/begin MEASUREMENT LAM_1 "TI_LAM_i value after a P jump" SWORD _CNV_A_R_LINEAR_____98_CM 1 100. -50. 49.99847412 ECU_ADDRESS 0x3fa7ea FORMAT "%7.3" /end MEASUREMENT
/begin MEASUREMENT LAM_MV_1 "TI_LAM_i average value" SWORD _CNV_A_R_LINEAR_____98_CM 1 100. -50. 49.99847412 ECU_ADDRESS 0x3fa7ec FORMAT "%7.3" /end MEASUREMENT
/begin MEASUREMENT LAM_MV_LPF_1 "LAM_MV_1 average value" SWORD _CNV_A_R_LINEAR_____98_CM 1 100. -50. 49.99847412 ECU_ADDRESS 0x3fa7ee FORMAT "%7.3" /end MEASUREMENT
/begin MEASUREMENT LAM_P_CTR_1 "P-jump-counter, shows the number of executed jumps" UBYTE _CNV_A_R_LINEAR_____10_CM 1 100. 0. 255. ECU_ADDRESS 0x3fa7e4 FORMAT "%3.0" /end MEASUREMENT
/begin MEASUREMENT T_LAM_DLY_NEG_1 "total LAM -P-jump delay time from rich to lean transition  " UWORD _CNV_A_R_LINEAR_____280_CM 1 100. 0. 15359.53125 ECU_ADDRESS 0x3fa7da FORMAT "%8.1" /end MEASUREMENT
/begin MEASUREMENT T_LAM_DLY_POS_1 "total LAM -P-jump delay time from lean to rich transition  " UWORD _CNV_A_R_LINEAR_____280_CM 1 100. 0. 15359.53125 ECU_ADDRESS 0x3fa7d8 FORMAT "%8.1" /end MEASUREMENT
/begin MEASUREMENT TI_LAM_MAX_1 "maximum of lambda control injection time correction" SWORD _CNV_A_R_LINEAR_____98_CM 1 100. -50. 49.99847412 ECU_ADDRESS 0x3fa7e8 FORMAT "%7.3" /end MEASUREMENT
/begin MEASUREMENT TI_LAM_MIN_1 "minimum of lambda control injection time correction" SWORD _CNV_A_R_LINEAR_____98_CM 1 100. -50. 49.99847412 ECU_ADDRESS 0x3fa7e6 FORMAT "%7.3" /end MEASUREMENT
/begin MEASUREMENT TI_LAM_COR_1 "Lambda control uncorrect injection time correction" SWORD _CNV_A_R_LINEAR_____98_CM 1 100. -50. 49.99847412 ECU_ADDRESS 0x3fa7d6 FORMAT "%7.3" /end MEASUREMENT
/begin MEASUREMENT T_LAM_DLY_POS_BAS_1 "Positive basic LAM -P-jump delay time" UWORD _CNV_A_R_LINEAR_____268_CM 1 100. 0. 1279.9 ECU_ADDRESS 0x3fa7e0 FORMAT "%7.2" /end MEASUREMENT
/begin MEASUREMENT T_LAM_DLY_NEG_BAS_1 "Negative basic LAM -P-jump delay time" UWORD _CNV_A_R_LINEAR_____268_CM 1 100. 0. 1279.9 ECU_ADDRESS 0x3fa7e2 FORMAT "%7.2" /end MEASUREMENT
/begin MEASUREMENT LAM_MV_LPF_CP_1 "Mean value of the controller output, used by canister purge" SWORD _CNV_A_R_LINEAR_____98_CM 1 100. -50. 49.99847412 ECU_ADDRESS 0x3fa7f0 FORMAT "%7.3" /end MEASUREMENT
/begin MEASUREMENT MAF_DYW_1 "MAF average value for limited dynamics recognition" UBYTE _CNV_A_R_LINEAR_____18_CM 1 100. 0. 1389. ECU_ADDRESS 0x3fa7f4 FORMAT "%4.0" /end MEASUREMENT
/begin MEASUREMENT N_DYW_1 "N average value for limited dynamics recognition" UWORD _CNV_A_R_LINEAR_____17_CM 1 100. 0. 8160. ECU_ADDRESS 0x3fa7f6 FORMAT "%4.0" /end MEASUREMENT
/begin MEASUREMENT LAM_MV_DYW_1 "LAM_MV_i average value for limited dynamics recognition" SWORD _CNV_A_R_LINEAR_____98_CM 1 100. -50. 49.99847412 ECU_ADDRESS 0x3fa7f2 FORMAT "%7.3" /end MEASUREMENT
/begin MEASUREMENT LV_VLS_DOWN_MMV_ACT_1 "Boolean flag indicating calibrateable delay since PUC deactivation passed" ULONG _CNV_S_2_RANGE______28_CM 1 100. 0. 1. ECU_ADDRESS 0x3fa8b0 BIT_MASK 0x20000000 /end MEASUREMENT
/begin MEASUREMENT LV_VLS_DOWN_MMV_LMT_1 "Boolean flag indicating VLS_DOWN_MMV_xxx_i signals being limited when set" ULONG _CNV_S_2_RANGE______28_CM 1 100. 0. 1. ECU_ADDRESS 0x3fa8b0 BIT_MASK 0x40000000 /end MEASUREMENT
/begin MEASUREMENT LV_TEG_MIN_THD_PREV_1 "Logical variable for holding the previous state of lv_teg_min_thd " ULONG _CNV_S_2_RANGE______28_CM 1 100. 0. 1. ECU_ADDRESS 0x3fa8b0 BIT_MASK 0x8000000 /end MEASUREMENT
/begin MEASUREMENT LV_R_DOWN_LS_DET_1 "Boolean flag indicating that resistance has already been determined in current lean phase(lock out)" ULONG _CNV_S_2_RANGE______28_CM 1 100. 0. 1. ECU_ADDRESS 0x3fa864 BIT_MASK 0x10000000 /end MEASUREMENT
/begin MEASUREMENT LV_R_DOWN_LS_DRV1_VLS_CDN_1 "Boolean flag indicating that low gradient condition met" ULONG _CNV_S_2_RANGE______28_CM 1 100. 0. 1. ECU_ADDRESS 0x3fa864 BIT_MASK 0x80000000 /end MEASUREMENT
/begin MEASUREMENT LV_R_DOWN_LS_ENA_1 "Boolean flag indicating that conditions have been met and resistance determination requested" ULONG _CNV_S_2_RANGE______28_CM 1 100. 0. 1. ECU_ADDRESS 0x3fa864 BIT_MASK 0x20000000 /end MEASUREMENT
/begin MEASUREMENT LV_R_DOWN_LS_VLS_RNG_CDN_1 "Boolean flag indicating that VLS_DOWN at low gradient condition met" ULONG _CNV_S_2_RANGE______28_CM 1 100. 0. 1. ECU_ADDRESS 0x3fa864 BIT_MASK 0x40000000 /end MEASUREMENT
/begin MEASUREMENT LV_VLS_NOT_VLD_DOWN_1 "Boolean flag indicating that VLS_DOWN_i signal not valid, i.e. masked due to Ri determination" ULONG _CNV_S_2_RANGE______28_CM 1 100. 0. 1. ECU_ADDRESS 0x3fa864 BIT_MASK 0x8000000 /end MEASUREMENT
/begin MEASUREMENT CTR_CYCNR_R_DOWN_LS_1 "Handshake counter indicating the number of valid resistance values determined since initial activation" UWORD _CNV_A_R_LINEAR_____10_CM 1 100. 0. 65535. ECU_ADDRESS 0x3fa870 FORMAT "%5.0" /end MEASUREMENT
/begin MEASUREMENT DRV1_VLS_DOWN_MMV_THD_MAX_1 "Upper variable VLS_DOWN gradient threshold" SWORD _CNV_A_R_LINEAR_____282_CM 1 100. -2.5 2.4999 ECU_ADDRESS 0x3fa87a FORMAT "%7.4" /end MEASUREMENT
/begin MEASUREMENT DRV1_VLS_DOWN_MMV_THD_MIN_1 "Lower variable VLS_DOWN gradient threshold" SWORD _CNV_A_R_LINEAR_____282_CM 1 100. -2.5 2.4999 ECU_ADDRESS 0x3fa87c FORMAT "%7.4" /end MEASUREMENT
/begin MEASUREMENT FAC_T_DRV1_VLS_DOWN_ABS_1 "Multiplicative factor modifies C_DRV1_VLS_DOWN_ABS_MAX dependent on T_VLS_CYC_AFL_HLD" UBYTE _CNV_A_R_LINEAR_____40_CM 1 100. 0. 15.9375 ECU_ADDRESS 0x3fa86c FORMAT "%5.2" /end MEASUREMENT
/begin MEASUREMENT FAC_T_DRV1_VLS_DOWN_MMV_1 "Multiplicative factor modifies DRV1_VLS_DOWN_MMV_MIN_THD dependent on T_VLS_CYC_AFL_HLD" UBYTE _CNV_A_R_LINEAR_____284_CM 1 100. 0. 63.75 ECU_ADDRESS 0x3fa86d FORMAT "%4.1" /end MEASUREMENT
/begin MEASUREMENT R_DOWN_LS_1 "Internal resistance of downstream oxygen sensor" UWORD _CNV_A_R_LINEAR_____285_CM 1 100. 0. 65535. ECU_ADDRESS 0x3fa872 FORMAT "%5.0" /end MEASUREMENT
/begin MEASUREMENT R_DOWN_LS_MES_1 "Internal resistance of downstream oxygen sensor (Measured)" UWORD _CNV_A_R_LINEAR_____285_CM 1 100. 0. 65535. ECU_ADDRESS 0x3fa874 FORMAT "%5.0" /end MEASUREMENT
/begin MEASUREMENT T_SAMPLE_R_DOWN_LS_1 "Time measured between internal resistance samples" UWORD _CNV_A_R_LINEAR_____27_CM 1 100. 0. 655.35 ECU_ADDRESS 0x3fa878 FORMAT "%6.2" /end MEASUREMENT
/begin MEASUREMENT T_VLS_CYC_AFL_HLD_R_DOWN_LS_1 "Lean mixture cycle time (measured upstream), held until next threshold crossing downstream" UBYTE _CNV_A_R_LINEAR_____27_CM 1 100. 0. 2.55 ECU_ADDRESS 0x3fa86e FORMAT "%4.2" /end MEASUREMENT
/begin MEASUREMENT TTIP_LS_DOWN_MES_1 "Downstream oxygen sensor ceramic temperature" SWORD _CNV_A_R_LINEAR_____286_CM 1 100. -2048. 2047.938 ECU_ADDRESS 0x3fa87e FORMAT "%8.2" /end MEASUREMENT
/begin MEASUREMENT TTIP_LS_DOWN_MES_BOL_1 "Downstream oxygen sensor ceramic temperature, Lower limit, Unfiltered" SWORD _CNV_A_R_LINEAR_____286_CM 1 100. -2048. 2047.938 ECU_ADDRESS 0x3fa882 FORMAT "%8.2" /end MEASUREMENT
/begin MEASUREMENT TTIP_LS_DOWN_MES_BOL_MMV_1 "Downstream oxygen sensor ceramic temperature, Lower limit, Filtered" SWORD _CNV_A_R_LINEAR_____286_CM 1 100. -2048. 2047.938 ECU_ADDRESS 0x3fa888 FORMAT "%8.2" /end MEASUREMENT
/begin MEASUREMENT TTIP_LS_DOWN_MES_TOL_1 "Downstream oxygen sensor ceramic temperature, Upper limit, Unfiltered" SWORD _CNV_A_R_LINEAR_____286_CM 1 100. -2048. 2047.938 ECU_ADDRESS 0x3fa880 FORMAT "%8.2" /end MEASUREMENT
/begin MEASUREMENT TTIP_LS_DOWN_MES_TOL_MMV_1 "Downstream oxygen sensor ceramic temperature, Upper limit, Filtered" SWORD _CNV_A_R_LINEAR_____286_CM 1 100. -2048. 2047.938 ECU_ADDRESS 0x3fa884 FORMAT "%8.2" /end MEASUREMENT
/begin MEASUREMENT LV_R_UP_LS_DET_1 "Boolean flag indicating that resistance has already been determined in current lean phase(lock out)" ULONG _CNV_S_2_RANGE______28_CM 1 100. 0. 1. ECU_ADDRESS 0x3fa98c BIT_MASK 0x10000000 /end MEASUREMENT
/begin MEASUREMENT LV_R_UP_LS_DRV1_VLS_CDN_1 "Boolean flag indicating that VLS_UP at low gradient condition met" ULONG _CNV_S_2_RANGE______28_CM 1 100. 0. 1. ECU_ADDRESS 0x3fa98c BIT_MASK 0x80000000 /end MEASUREMENT
/begin MEASUREMENT LV_R_UP_LS_ENA_1 "Boolean flag indicating that application conditions have been met" ULONG _CNV_S_2_RANGE______28_CM 1 100. 0. 1. ECU_ADDRESS 0x3fa98c BIT_MASK 0x20000000 /end MEASUREMENT
/begin MEASUREMENT LV_R_UP_LS_VLS_RNG_CDN_1 "Boolean flag indicating that VLS_UP at low gradient condition met" ULONG _CNV_S_2_RANGE______28_CM 1 100. 0. 1. ECU_ADDRESS 0x3fa98c BIT_MASK 0x40000000 /end MEASUREMENT
/begin MEASUREMENT LV_VLS_NOT_VLD_UP_1 "Boolean flag indicating that VLS_UP_i signal not valid, i.e. masked due to Ri determination" ULONG _CNV_S_2_RANGE______28_CM 1 100. 0. 1. ECU_ADDRESS 0x3fa98c BIT_MASK 0x8000000 /end MEASUREMENT
/begin MEASUREMENT CTR_CYCNR_R_UP_LS_1 "Handshake counter indicating the number of valid resistance values determined since initial activation" UWORD _CNV_A_R_LINEAR_____10_CM 1 100. 0. 65535. ECU_ADDRESS 0x3fa996 FORMAT "%5.0" /end MEASUREMENT
/begin MEASUREMENT DRV1_VLS_UP_MMV_THD_MAX_1 "Upper variable VLS_UP gradient threshold" SWORD _CNV_A_R_LINEAR_____282_CM 1 100. -2.5 2.4999 ECU_ADDRESS 0x3fa9a0 FORMAT "%7.4" /end MEASUREMENT
/begin MEASUREMENT DRV1_VLS_UP_MMV_THD_MIN_1 "Lower variable VLS_UP gradient threshold" SWORD _CNV_A_R_LINEAR_____282_CM 1 100. -2.5 2.4999 ECU_ADDRESS 0x3fa9a2 FORMAT "%7.4" /end MEASUREMENT
/begin MEASUREMENT FAC_T_DRV1_VLS_UP_ABS_1 "Multiplicative factor modifies C_DRV1_VLS_UP_ABS_MAX dependent on T_VLS_CYC_AFL_HLD" UBYTE _CNV_A_R_LINEAR_____40_CM 1 100. 0. 15.9375 ECU_ADDRESS 0x3fa994 FORMAT "%5.2" /end MEASUREMENT
/begin MEASUREMENT FAC_T_DRV1_VLS_UP_MMV_1 "Multiplicative factor modifies DRV1_VLS_UP_MMV_MIN_THD dependent on T_VLS_CYC_AFL_HLD" UBYTE _CNV_A_R_LINEAR_____284_CM 1 100. 0. 63.75 ECU_ADDRESS 0x3fa995 FORMAT "%4.1" /end MEASUREMENT
/begin MEASUREMENT R_UP_LS_1 "Internal resistance of upstream oxygen sensor, cylinder bank i" UWORD _CNV_A_R_LINEAR_____285_CM 1 100. 0. 65535. ECU_ADDRESS 0x3fa998 FORMAT "%5.0" /end MEASUREMENT
/begin MEASUREMENT R_UP_LS_MES_1 "Internal resistance of upstream oxygen sensor (Measured)" UWORD _CNV_A_R_LINEAR_____285_CM 1 100. 0. 65535. ECU_ADDRESS 0x3fa99a FORMAT "%5.0" /end MEASUREMENT
/begin MEASUREMENT T_SAMPLE_R_UP_LS_1 "Time measured between internal resistance samples" UWORD _CNV_A_R_LINEAR_____27_CM 1 100. 0. 655.35 ECU_ADDRESS 0x3fa99e FORMAT "%6.2" /end MEASUREMENT
/begin MEASUREMENT TTIP_LS_UP_MES_1 "Upstream oxygen sensor ceramic temperature" SWORD _CNV_A_R_LINEAR_____286_CM 1 100. -2048. 2047.938 ECU_ADDRESS 0x3fa9a4 FORMAT "%8.2" /end MEASUREMENT
/begin MEASUREMENT TTIP_LS_UP_MES_BOL_1 "Upstream oxygen sensor ceramic temperature, Lower limit, Unfiltered" SWORD _CNV_A_R_LINEAR_____286_CM 1 100. -2048. 2047.938 ECU_ADDRESS 0x3fa9a8 FORMAT "%8.2" /end MEASUREMENT
/begin MEASUREMENT TTIP_LS_UP_MES_BOL_MMV_1 "Upstream oxygen sensor ceramic temperature, Lower limit, Unfiltered" SWORD _CNV_A_R_LINEAR_____286_CM 1 100. -2048. 2047.938 ECU_ADDRESS 0x3fa9ae FORMAT "%8.2" /end MEASUREMENT
/begin MEASUREMENT TTIP_LS_UP_MES_TOL_1 "Downstream oxygen sensor ceramic temperature, Upper limit, Unfiltered" SWORD _CNV_A_R_LINEAR_____286_CM 1 100. -2048. 2047.938 ECU_ADDRESS 0x3fa9a6 FORMAT "%8.2" /end MEASUREMENT
/begin MEASUREMENT TTIP_LS_UP_MES_TOL_MMV_1 "Upstream oxygen sensor ceramic temperature, Lower limit, Unfiltered" SWORD _CNV_A_R_LINEAR_____286_CM 1 100. -2048. 2047.938 ECU_ADDRESS 0x3fa9aa FORMAT "%8.2" /end MEASUREMENT
/begin MEASUREMENT LV_AFL_1 "" ULONG _CNV_S_2_RANGE______28_CM 1 100. 0. 1. ECU_ADDRESS 0x3fa8e8 BIT_MASK 0x80000000 /end MEASUREMENT
/begin MEASUREMENT LV_VLS_UP_MMV_LMT_1 "Boolean flag indicating VLS_MMV_xxx_i signals being limited when set" ULONG _CNV_S_2_RANGE______28_CM 1 100. 0. 1. ECU_ADDRESS 0x3fa8e8 BIT_MASK 0x10000000 /end MEASUREMENT
/begin MEASUREMENT LV_VLS_UP_MMV_STK_VLD_1 "Boolean flag indicating VLS_MMV_xxx_i signals valid when set" ULONG _CNV_S_2_RANGE______28_CM 1 100. 0. 1. ECU_ADDRESS 0x3fa8e8 BIT_MASK 0x8000000 /end MEASUREMENT
/begin MEASUREMENT CTR_VLS_AFL_CYC_1 "Denotes number of AF cycles since lambda controller last activated" UWORD _CNV_A_R_LINEAR_____10_CM 1 100. 0. 65535. ECU_ADDRESS 0x3fa8f2 FORMAT "%5.0" /end MEASUREMENT
/begin MEASUREMENT DRV1_VLS_UP_ABS_MAX_1 "Absolute maximum value within buffer containing 1st derivative of VLS_UP_i signal" UWORD _CNV_A_R_LINEAR_____283_CM 1 100. 0. 4.9999237 ECU_ADDRESS 0x3fa902 FORMAT "%6.4" /end MEASUREMENT
/begin MEASUREMENT DRV1_VLS_UP_MMV_1 "Mean of buffer containing 1st derivative of VLS_UP_i signal" SWORD _CNV_A_R_LINEAR_____282_CM 1 100. -2.5 2.4999 ECU_ADDRESS 0x3fa8fe FORMAT "%7.4" /end MEASUREMENT
/begin MEASUREMENT DRV1_VLS_UP_MMV_MIN_1 "Minimum value of mean of buffer containing 1st derivative of VLS_UP_i signal in lean phase" SWORD _CNV_A_R_LINEAR_____282_CM 1 100. -2.5 2.4999 ECU_ADDRESS 0x3fa900 FORMAT "%7.4" /end MEASUREMENT
/begin MEASUREMENT T_AFL_LOCK_1 "Timer indicating duration of LV_AFL lock" UBYTE _CNV_A_R_LINEAR_____27_CM 1 100. 0. 2.55 ECU_ADDRESS 0x3fa915 FORMAT "%4.2" /end MEASUREMENT
/begin MEASUREMENT T_VLS_CYC_AFL_1 "Lean mixture cycle time" UBYTE _CNV_A_R_LINEAR_____27_CM 1 100. 0. 2.55 ECU_ADDRESS 0x3fa8ef FORMAT "%4.2" /end MEASUREMENT
/begin MEASUREMENT T_VLS_CYC_AFL_HLD_1 "Lean mixture cycle time, held until next new value available" UBYTE _CNV_A_R_LINEAR_____27_CM 1 100. 0. 2.55 ECU_ADDRESS 0x3fa8f0 FORMAT "%4.2" /end MEASUREMENT
/begin MEASUREMENT T_VLS_CYC_AFR_1 "Rich mixture cycle time" UBYTE _CNV_A_R_LINEAR_____27_CM 1 100. 0. 2.55 ECU_ADDRESS 0x3fa8ee FORMAT "%4.2" /end MEASUREMENT
/begin MEASUREMENT VLS_BOL_1 "Corrected VLS_MMV_MIN" UWORD _CNV_A_R_LINEAR_____33_CM 1 100. 0. 4.99511719 ECU_ADDRESS 0x3fa8f8 FORMAT "%5.3" /end MEASUREMENT
/begin MEASUREMENT VLS_MMV_MAX_1 "Mean maximum sensor voltage" UWORD _CNV_A_R_LINEAR_____256_CM 1 100. 0. 4.99992371 ECU_ADDRESS 0x3fa8f4 FORMAT "%7.5" /end MEASUREMENT
/begin MEASUREMENT VLS_MMV_MIN_1 "Mean minimum sensor voltage" UWORD _CNV_A_R_LINEAR_____256_CM 1 100. 0. 4.99992371 ECU_ADDRESS 0x3fa8f6 FORMAT "%7.5" /end MEASUREMENT
/begin MEASUREMENT VLS_TOL_1 "Corrected VLS_MMV_MAX" UWORD _CNV_A_R_LINEAR_____33_CM 1 100. 0. 4.99511719 ECU_ADDRESS 0x3fa8fa FORMAT "%5.3" /end MEASUREMENT
/begin MEASUREMENT VLS_UP_MMV_HYS_1 "Variable switching threshold for calculation of VLS_DOWN_MMV_MIN_i" UWORD _CNV_A_R_LINEAR_____281_CM 1 100. 0. 1. ECU_ADDRESS 0x3fa8fc FORMAT "%7.5" /end MEASUREMENT
/begin MEASUREMENT LSHPWM_DOWN_1 "" UBYTE _CNV_A_R_LINEAR_____4_CM 1 100. 0. 99.609375 ECU_ADDRESS 0x3fa81c FORMAT "%4.1" /end MEASUREMENT
/begin MEASUREMENT T_LSH_DOWN_1 "Timer to determine the duration of heating phase" UBYTE _CNV_A_R_LINEAR_____47_CM 1 100. 0. 255. ECU_ADDRESS 0x3fa81d FORMAT "%3.0" /end MEASUREMENT
/begin MEASUREMENT V_EFC_LSH_DOWN_1 "Effective value of heater voltage" UBYTE _CNV_A_R_LINEAR_____26_CM 1 100. 0. 25.8984 ECU_ADDRESS 0x3fa81e FORMAT "%3.1" /end MEASUREMENT
/begin MEASUREMENT T_LSH_DOWN_TOL_1 "Timer to determine the duration of high voltage phases" UBYTE _CNV_A_R_LINEAR_____47_CM 1 100. 0. 255. ECU_ADDRESS 0x3fa81f FORMAT "%3.0" /end MEASUREMENT
/begin MEASUREMENT T_LSH_DOWN_LIM_1 "Timer to determine the duration of heating phases after a high voltage phase" UBYTE _CNV_A_R_LINEAR_____47_CM 1 100. 0. 255. ECU_ADDRESS 0x3fa820 FORMAT "%3.0" /end MEASUREMENT
/begin MEASUREMENT STATE_LSH_DOWN_1 "Heating state recognition" ULONG _CNV_S_6_STATE_LSH__287_CM 1 100. 0. 5. ECU_ADDRESS 0x3fa818 /end MEASUREMENT
/begin MEASUREMENT LV_INH_LSH_UP_1 "Boolean flag indicating project specific application conditions for heating not met" UBYTE _CNV_S_2_RANGE______28_CM 1 100. 0. 1. ECU_ADDRESS 0x3fa844 /end MEASUREMENT
/begin MEASUREMENT LV_INH_LSH_UP_CLL_CTL_1 "Boolean flag indicating project specific application conditions closed loop heater control not met" UBYTE _CNV_S_2_RANGE______28_CM 1 100. 0. 1. ECU_ADDRESS 0x3fa845 /end MEASUREMENT
/begin MEASUREMENT LV_TTIP_LS_UP_MES_VLD_1 "Boolean flag indicating validity of oxygen sensor ceramic temperature TTIP_LS_UP_MES_i" UBYTE _CNV_S_2_RANGE______28_CM 1 100. 0. 1. ECU_ADDRESS 0x3fa846 /end MEASUREMENT
/begin MEASUREMENT LV_V_TEMP_LS_UP_REF_VLD_1 "Boolean flag indicating internal resistance determination circuit references valid" UBYTE _CNV_S_2_RANGE______28_CM 1 100. 0. 1. ECU_ADDRESS 0x3fa847 /end MEASUREMENT
/begin MEASUREMENT TEMP_LS_INI_1 "Oxygen sensor temperature at engine start for the oxygen sensor heating management" SWORD _CNV_A_R_LINEAR_____286_CM 1 100. -2048. 2047.938 ECU_ADDRESS 0x3fa848 FORMAT "%8.2" /end MEASUREMENT
/begin MEASUREMENT LV_LSH_UP_CLL_CTL_1 "Boolean variable indicating closed loop control mode active" ULONG _CNV_S_2_RANGE______28_CM 1 100. 0. 1. ECU_ADDRESS 0x3fa828 BIT_MASK 0x80000000 /end MEASUREMENT
/begin MEASUREMENT LV_V_EFC_LSH_UP_LIM_BOL_1 "Boolean flag indicating effective heater voltage limited due to sum of voltage components falling below zero." ULONG _CNV_S_2_RANGE______28_CM 1 100. 0. 1. ECU_ADDRESS 0x3fa828 BIT_MASK 0x40000000 /end MEASUREMENT
/begin MEASUREMENT LV_V_EFC_LSH_UP_LIM_TOL_1 "Boolean flag indicating effective heater voltage limited due to exceeding threshold for period of time." ULONG _CNV_S_2_RANGE______28_CM 1 100. 0. 1. ECU_ADDRESS 0x3fa828 BIT_MASK 0x20000000 /end MEASUREMENT
/begin MEASUREMENT LV_V_EFC_LSH_UP_LIM_MAX_1 "Boolean flag indicating effective heater voltage limited due to exceeding absolute maximum voltage spec." ULONG _CNV_S_2_RANGE______28_CM 1 100. 0. 1. ECU_ADDRESS 0x3fa828 BIT_MASK 0x10000000 /end MEASUREMENT
/begin MEASUREMENT LV_POW_CTL_ACT_1 "???" ULONG _CNV_S_2_RANGE______28_CM 1 100. 0. 1. ECU_ADDRESS 0x3fa828 BIT_MASK 0x8000000 /end MEASUREMENT
/begin MEASUREMENT T_LSH_UP_1 "Timer to determine the duration of heating phase" UBYTE _CNV_A_R_LINEAR_____14_CM 1 100. 0. 25.5 ECU_ADDRESS 0x3fa831 FORMAT "%4.1" /end MEASUREMENT
/begin MEASUREMENT LSHPWM_UP_1 "" UBYTE _CNV_A_R_LINEAR_____4_CM 1 100. 0. 99.609375 ECU_ADDRESS 0x3fa830 FORMAT "%4.1" /end MEASUREMENT
/begin MEASUREMENT V_EFC_LSH_UP_1 "Effective value of heater voltage" UBYTE _CNV_A_R_LINEAR_____26_CM 1 100. 0. 25.8984 ECU_ADDRESS 0x3fa832 FORMAT "%3.1" /end MEASUREMENT
/begin MEASUREMENT T_LSH_UP_TOL_1 "Timer to determine the duration of high voltage phases" UBYTE _CNV_A_R_LINEAR_____14_CM 1 100. 0. 25.5 ECU_ADDRESS 0x3fa836 FORMAT "%4.1" /end MEASUREMENT
/begin MEASUREMENT T_LSH_UP_LIM_1 "Timer to determine the duration of heating phases after a high voltage phase" UBYTE _CNV_A_R_LINEAR_____14_CM 1 100. 0. 25.5 ECU_ADDRESS 0x3fa837 FORMAT "%4.1" /end MEASUREMENT
/begin MEASUREMENT STATE_LSH_UP_1 "Heating state recognition" ULONG _CNV_S_7_STATE_LSH__296_CM 1 100. 0. 6. ECU_ADDRESS 0x3fa82c /end MEASUREMENT
/begin MEASUREMENT V_EFC_LSH_UP_CLC_1 "Effective calculated heater voltage value prior to overvoltage protection" UWORD _CNV_A_R_LINEAR_____297_CM 1 100. 0. 25.999603 ECU_ADDRESS 0x3fa834 FORMAT "%7.4" /end MEASUREMENT
/begin MEASUREMENT V_EFC_LSH_UP_CTL_ADD_1 "Additive effective heater voltage from closed loop controller" SBYTE _CNV_A_R_LINEAR_____298_CM 1 100. -13.05 12.95 ECU_ADDRESS 0x3fa838 FORMAT "%5.1" /end MEASUREMENT
/begin MEASUREMENT V_EFC_LSH_UP_CTL_P_ADD_1 "Additive effective heater voltage from closed loop controller, P term" SWORD _CNV_A_R_LINEAR_____299_CM 1 100. -13.05 13.05 ECU_ADDRESS 0x3fa83a FORMAT "%8.4" /end MEASUREMENT
/begin MEASUREMENT V_EFC_LSH_UP_CTL_I_ADD_1 "Additive effective heater voltage from closed loop controller, I term" SWORD _CNV_A_R_LINEAR_____299_CM 1 100. -13.05 13.05 ECU_ADDRESS 0x3fa83c FORMAT "%8.4" /end MEASUREMENT
/begin MEASUREMENT TTIP_LS_UP_DIF_SET_MES_1 "Difference between actual and set oxygen sensor tip temperature" SWORD _CNV_A_R_LINEAR_____286_CM 1 100. -2048. 2047.938 ECU_ADDRESS 0x3fa83e FORMAT "%8.2" /end MEASUREMENT
/begin MEASUREMENT LAMB_BAS_H_RES_1 "bank selektive basic lambda setpoint with high resolution" ULONG _CNV_A_R_LINEAR_____300_CM 1 100. 0. 32. ECU_ADDRESS 0x3fa770 FORMAT "%8.5" /end MEASUREMENT
/begin MEASUREMENT LAMB_HOM_AFS_H_RES_1 "stoichiometric lambda setpoint with high resolution" ULONG _CNV_A_R_LINEAR_____300_CM 1 100. 0. 32. ECU_ADDRESS 0x3fa774 FORMAT "%8.5" /end MEASUREMENT
/begin MEASUREMENT LAMB_BAS_1 "bank selektive basic lambda setpoint" UWORD _CNV_A_R_LINEAR_____148_CM 1 100. 0. 31.99902344 ECU_ADDRESS 0x3fa778 FORMAT "%7.4" /end MEASUREMENT
/begin MEASUREMENT LAMB_HOM_AFS_1 "stoichiometric lambda setpoint" UWORD _CNV_A_R_LINEAR_____148_CM 1 100. 0. 31.99902344 ECU_ADDRESS 0x3fa77a FORMAT "%7.4" /end MEASUREMENT
/begin MEASUREMENT LV_LAMB_BAS_OFS_CAT_DIAG_1 "flag_to indicate lambda offset" UBYTE _CNV_S_2_RANGE______28_CM 1 100. 0. 1. ECU_ADDRESS 0x3fa77c /end MEASUREMENT
/begin MEASUREMENT LAMB_BAS_COR_1 "lambda output for TQI_SP_MAF calculation" UWORD _CNV_A_R_LINEAR_____148_CM 1 100. 0. 31.99902344 ECU_ADDRESS 0x3fa7bc FORMAT "%7.4" /end MEASUREMENT
/begin MEASUREMENT LAMB_SP_1 "lambda setpoint" UWORD _CNV_A_R_LINEAR_____148_CM 1 100. 0. 31.99902344 ECU_ADDRESS 0x3fa7c0 FORMAT "%7.4" /end MEASUREMENT
/begin MEASUREMENT LAMB_SP_BAS_1 "lambda feedback for basic torque calculation" UWORD _CNV_A_R_LINEAR_____148_CM 1 100. 0. 31.99902344 ECU_ADDRESS 0x3fa7c2 FORMAT "%7.4" /end MEASUREMENT
/begin MEASUREMENT LAMB_BAS_COR_1_H_RES_1 "lambda setpoint used for lambda = 1 detection" ULONG _CNV_A_R_LINEAR_____300_CM 1 100. 0. 32. ECU_ADDRESS 0x3fa7a8 FORMAT "%8.5" /end MEASUREMENT
/begin MEASUREMENT LAMB_SP_H_RES_1 "lambda setpoint with high resolution" ULONG _CNV_A_R_LINEAR_____300_CM 1 100. 0. 32. ECU_ADDRESS 0x3fa7b8 FORMAT "%8.5" /end MEASUREMENT
/begin MEASUREMENT LV_LAMB_SP_1_1 "boolean to inicate if lambda setpoint is identical to 1" UBYTE _CNV_S_2_RANGE______28_CM 1 100. 0. 1. ECU_ADDRESS 0x3fa7c4 /end MEASUREMENT
/begin MEASUREMENT LAMB_RGN_1 "lambda setpoint for catalyst regeneration" UWORD _CNV_A_R_LINEAR_____148_CM 1 100. 0. 31.99902344 ECU_ADDRESS 0x3fa7a4 FORMAT "%7.4" /end MEASUREMENT
/begin MEASUREMENT LAMB_COP_1 "lambda for catalyst overheating prevention" UWORD _CNV_A_R_LINEAR_____148_CM 1 100. 0. 31.99902344 ECU_ADDRESS 0x3fa730 FORMAT "%7.4" /end MEASUREMENT
/begin MEASUREMENT LV_LAMB_COP_1 "boolean for catalyst overheating prevention" UBYTE _CNV_S_2_RANGE______28_CM 1 100. 0. 1. ECU_ADDRESS 0x3fa732 /end MEASUREMENT
/begin MEASUREMENT FAC_COP_1 "Inverse lambda depency of exhaust gas temperature model" UWORD _CNV_A_R_LINEAR_____45_CM 1 100. 0. 1.99996948 ECU_ADDRESS 0x3fa734 FORMAT "%7.5" /end MEASUREMENT
/begin MEASUREMENT TEG_COP_SP_1 "Temperature threshold for overhea protection" UWORD _CNV_A_R_LINEAR_____269_CM 1 100. -48. 1459.3 ECU_ADDRESS 0x3fa738 FORMAT "%7.2" /end MEASUREMENT
/begin MEASUREMENT T_COP_1 "Time catalyst overheat protection active" UBYTE _CNV_A_R_LINEAR_____275_CM 1 100. 0. 127.5 ECU_ADDRESS 0x3fa73a FORMAT "%5.1" /end MEASUREMENT
/begin MEASUREMENT LV_LDC_DLY_1 "status limited dynamic" ULONG _CNV_S_2_RANGE______28_CM 1 100. 0. 1. ECU_ADDRESS 0x3fa918 BIT_MASK 0x80000000 /end MEASUREMENT
/begin MEASUREMENT LV_LAM_MV_LDC_DLY_1 "status limited dynamic LAM_MV_i" ULONG _CNV_S_2_RANGE______28_CM 1 100. 0. 1. ECU_ADDRESS 0x3fa918 BIT_MASK 0x40000000 /end MEASUREMENT
/begin MEASUREMENT LAM_MV_MMV_DLY_1 "floating mean value for limited lambda deviation" SWORD _CNV_A_R_LINEAR_____98_CM 1 100. -50. 49.99847412 ECU_ADDRESS 0x3fa91c FORMAT "%7.3" /end MEASUREMENT
/begin MEASUREMENT MAF_INT_LDC_DLY_1 "integral of mass air flow since limited dynamic conditions are fulfilled" UWORD _CNV_A_R_LINEAR_____277_CM 1 100. 0. 1820.398 ECU_ADDRESS 0x3fa920 FORMAT "%7.2" /end MEASUREMENT
/begin MEASUREMENT PV_AV_GRD_SUM_DLY_1 "sum. value for limited lambda deviation" UWORD _CNV_A_R_LINEAR_____304_CM 1 100. 0. 639990.2340000001 ECU_ADDRESS 0x3fa91e FORMAT "%8.1" /end MEASUREMENT
/begin MEASUREMENT LV_UP_LS_2 "Logical variable for recognized operability of the lambda probe" ULONG _CNV_S_2_RANGE______28_CM 1 100. 0. 1. ECU_ADDRESS 0x3fabf4 BIT_MASK 0x80000000 /end MEASUREMENT
/begin MEASUREMENT LV_UP_LS_CDN_2 "Logical variable for recognized limited operability of the lambda probe" ULONG _CNV_S_2_RANGE______28_CM 1 100. 0. 1. ECU_ADDRESS 0x3fabf4 BIT_MASK 0x40000000 /end MEASUREMENT
/begin MEASUREMENT LV_DELTA_LAMB_2 "Boolean for downstream fuel trim regulation active" ULONG _CNV_S_2_RANGE______28_CM 1 100. 0. 1. ECU_ADDRESS 0x3faa98 BIT_MASK 0x80000000 /end MEASUREMENT
/begin MEASUREMENT LV_LAM_DLY_PER_VLD_2 "internal state variable for the monitoring of the controller difference (sign)" ULONG _CNV_S_2_RANGE______28_CM 1 100. 0. 1. ECU_ADDRESS 0x3faa98 BIT_MASK 0x40000000 /end MEASUREMENT
/begin MEASUREMENT FAC_CAT_DLY_2 "weight factor for P-share regarding catalyst conversion capability" UWORD _CNV_A_R_LINEAR_____31_CM 1 100. 0. 0.99998474 ECU_ADDRESS 0x3faaaa FORMAT "%7.5" /end MEASUREMENT
/begin MEASUREMENT MAF_INT_DLY_2 "integral of air mass flow since LAM activation" UWORD _CNV_A_R_LINEAR_____277_CM 1 100. 0. 1820.398 ECU_ADDRESS 0x3faaac FORMAT "%7.2" /end MEASUREMENT
/begin MEASUREMENT T_DLY_I_2 "LAM -P-jump delay time from I-share" SWORD _CNV_A_R_LINEAR_____278_CM 1 100. -640. 639.9804688 ECU_ADDRESS 0x3faaa0 FORMAT "%7.2" /end MEASUREMENT
/begin MEASUREMENT T_DLY_I_AD_2 "initial value for the I-share (Adaptation value)" SWORD _CNV_A_R_LINEAR_____278_CM 1 100. -640. 639.9804688 ECU_ADDRESS 0x3faaa6 FORMAT "%7.2" /end MEASUREMENT
/begin MEASUREMENT T_DLY_P_2 "LAM -P-jump delay time from P-share" SWORD _CNV_A_R_LINEAR_____279_CM 1 100. -2560. 2559.921875 ECU_ADDRESS 0x3faa9e FORMAT "%7.2" /end MEASUREMENT
/begin MEASUREMENT T_LAM_DLY_2 "LAM -P-jump delay time from downstream trim controller" SWORD _CNV_A_R_LINEAR_____280_CM 1 100. -15360. 15359.53125 ECU_ADDRESS 0x3faaa8 FORMAT "%8.1" /end MEASUREMENT
/begin MEASUREMENT VLS_DIF_DLY_2 "difference between setpoint and actual downstream LS signal" SWORD _CNV_A_R_LINEAR_____33_CM 1 100. -4.99511719 4.99511719 ECU_ADDRESS 0x3faa9c FORMAT "%4.3" /end MEASUREMENT
/begin MEASUREMENT LV_LAM_LIM_MAX_2 "lambda controller value is limited to TI_LAM_MAX" ULONG _CNV_S_2_RANGE______28_CM 1 100. 0. 1. ECU_ADDRESS 0x3faae0 BIT_MASK 0x40000000 /end MEASUREMENT
/begin MEASUREMENT LV_LAM_LIM_MIN_2 "lambda controller value is limited to TI_LAM_MIN" ULONG _CNV_S_2_RANGE______28_CM 1 100. 0. 1. ECU_ADDRESS 0x3faae0 BIT_MASK 0x80000000 /end MEASUREMENT
/begin MEASUREMENT LV_LSCL_2 "Close loop enable" ULONG _CNV_S_2_RANGE______28_CM 1 100. 0. 1. ECU_ADDRESS 0x3faae0 BIT_MASK 0x20000000 /end MEASUREMENT
/begin MEASUREMENT LV_LSCL_CAT_PURGE_2 "Conditions for closed loop except cat purge cylinder bank i" ULONG _CNV_S_2_RANGE______28_CM 1 100. 0. 1. ECU_ADDRESS 0x3faae0 BIT_MASK 0x400000 /end MEASUREMENT
/begin MEASUREMENT LV_LAM_ONCE_ACT_2 " closed loop has been enabled" ULONG _CNV_S_2_RANGE______28_CM 1 100. 0. 1. ECU_ADDRESS 0x3faae0 BIT_MASK 0x200000 /end MEASUREMENT
/begin MEASUREMENT LV_LAM_DYW_2 "Limited dynamic conditions recognised for LAM_i" ULONG _CNV_S_2_RANGE______28_CM 1 100. 0. 1. ECU_ADDRESS 0x3faae0 BIT_MASK 0x10000000 /end MEASUREMENT
/begin MEASUREMENT LV_N_MAF_DYW_2 "Limited dynamic conditions recognised for N and MAF" ULONG _CNV_S_2_RANGE______28_CM 1 100. 0. 1. ECU_ADDRESS 0x3faae0 BIT_MASK 0x80000 /end MEASUREMENT
/begin MEASUREMENT LV_LAM_ADJ_AD_END_2 "Controller shift by lambda adaptation was carried out" ULONG _CNV_S_2_RANGE______28_CM 1 100. 0. 1. ECU_ADDRESS 0x3faae0 BIT_MASK 0x100000 /end MEASUREMENT
/begin MEASUREMENT LAM_2 "TI_LAM_i value after a P jump" SWORD _CNV_A_R_LINEAR_____98_CM 1 100. -50. 49.99847412 ECU_ADDRESS 0x3fab02 FORMAT "%7.3" /end MEASUREMENT
/begin MEASUREMENT LAM_MV_2 "TI_LAM_i average value" SWORD _CNV_A_R_LINEAR_____98_CM 1 100. -50. 49.99847412 ECU_ADDRESS 0x3fab04 FORMAT "%7.3" /end MEASUREMENT
/begin MEASUREMENT LAM_MV_LPF_2 "LAM_MV_1 average value" SWORD _CNV_A_R_LINEAR_____98_CM 1 100. -50. 49.99847412 ECU_ADDRESS 0x3fab06 FORMAT "%7.3" /end MEASUREMENT
/begin MEASUREMENT LAM_P_CTR_2 "P-jump-counter, shows the number of executed jumps" UBYTE _CNV_A_R_LINEAR_____10_CM 1 100. 0. 255. ECU_ADDRESS 0x3faafc FORMAT "%3.0" /end MEASUREMENT
/begin MEASUREMENT T_LAM_DLY_NEG_2 "total LAM -P-jump delay time from rich to lean transition  " UWORD _CNV_A_R_LINEAR_____280_CM 1 100. 0. 15359.53125 ECU_ADDRESS 0x3faaf2 FORMAT "%8.1" /end MEASUREMENT
/begin MEASUREMENT T_LAM_DLY_POS_2 "total LAM -P-jump delay time from lean to rich transition  " UWORD _CNV_A_R_LINEAR_____280_CM 1 100. 0. 15359.53125 ECU_ADDRESS 0x3faaf0 FORMAT "%8.1" /end MEASUREMENT
/begin MEASUREMENT TI_LAM_MAX_2 "maximum of lambda control injection time correction" SWORD _CNV_A_R_LINEAR_____98_CM 1 100. -50. 49.99847412 ECU_ADDRESS 0x3fab00 FORMAT "%7.3" /end MEASUREMENT
/begin MEASUREMENT TI_LAM_MIN_2 "minimum of lambda control injection time correction" SWORD _CNV_A_R_LINEAR_____98_CM 1 100. -50. 49.99847412 ECU_ADDRESS 0x3faafe FORMAT "%7.3" /end MEASUREMENT
/begin MEASUREMENT TI_LAM_COR_2 "Lambda control uncorrect injection time correction" SWORD _CNV_A_R_LINEAR_____98_CM 1 100. -50. 49.99847412 ECU_ADDRESS 0x3faaee FORMAT "%7.3" /end MEASUREMENT
/begin MEASUREMENT T_LAM_DLY_POS_BAS_2 "Positive basic LAM -P-jump delay time" UWORD _CNV_A_R_LINEAR_____268_CM 1 100. 0. 1279.9 ECU_ADDRESS 0x3faaf8 FORMAT "%7.2" /end MEASUREMENT
/begin MEASUREMENT T_LAM_DLY_NEG_BAS_2 "Negative basic LAM -P-jump delay time" UWORD _CNV_A_R_LINEAR_____268_CM 1 100. 0. 1279.9 ECU_ADDRESS 0x3faafa FORMAT "%7.2" /end MEASUREMENT
/begin MEASUREMENT LAM_MV_LPF_CP_2 "Mean value of the controller output, used by canister purge" SWORD _CNV_A_R_LINEAR_____98_CM 1 100. -50. 49.99847412 ECU_ADDRESS 0x3fab08 FORMAT "%7.3" /end MEASUREMENT
/begin MEASUREMENT MAF_DYW_2 "MAF average value for limited dynamics recognition" UBYTE _CNV_A_R_LINEAR_____18_CM 1 100. 0. 1389. ECU_ADDRESS 0x3fab0c FORMAT "%4.0" /end MEASUREMENT
/begin MEASUREMENT N_DYW_2 "N average value for limited dynamics recognition" UWORD _CNV_A_R_LINEAR_____17_CM 1 100. 0. 8160. ECU_ADDRESS 0x3fab0e FORMAT "%4.0" /end MEASUREMENT
/begin MEASUREMENT LAM_MV_DYW_2 "LAM_MV_i average value for limited dynamics recognition" SWORD _CNV_A_R_LINEAR_____98_CM 1 100. -50. 49.99847412 ECU_ADDRESS 0x3fab0a FORMAT "%7.3" /end MEASUREMENT
/begin MEASUREMENT LV_VLS_DOWN_MMV_ACT_2 "Boolean flag indicating calibrateable delay since PUC deactivation passed" ULONG _CNV_S_2_RANGE______28_CM 1 100. 0. 1. ECU_ADDRESS 0x3fabc8 BIT_MASK 0x20000000 /end MEASUREMENT
/begin MEASUREMENT LV_VLS_DOWN_MMV_LMT_2 "Boolean flag indicating VLS_DOWN_MMV_xxx_i signals being limited when set" ULONG _CNV_S_2_RANGE______28_CM 1 100. 0. 1. ECU_ADDRESS 0x3fabc8 BIT_MASK 0x40000000 /end MEASUREMENT
/begin MEASUREMENT LV_TEG_MIN_THD_PREV_2 "Logical variable for holding the previous state of lv_teg_min_thd " ULONG _CNV_S_2_RANGE______28_CM 1 100. 0. 1. ECU_ADDRESS 0x3fabc8 BIT_MASK 0x8000000 /end MEASUREMENT
/begin MEASUREMENT LV_R_DOWN_LS_DET_2 "Boolean flag indicating that resistance has already been determined in current lean phase(lock out)" ULONG _CNV_S_2_RANGE______28_CM 1 100. 0. 1. ECU_ADDRESS 0x3fab7c BIT_MASK 0x10000000 /end MEASUREMENT
/begin MEASUREMENT LV_R_DOWN_LS_DRV1_VLS_CDN_2 "Boolean flag indicating that low gradient condition met" ULONG _CNV_S_2_RANGE______28_CM 1 100. 0. 1. ECU_ADDRESS 0x3fab7c BIT_MASK 0x80000000 /end MEASUREMENT
/begin MEASUREMENT LV_R_DOWN_LS_ENA_2 "Boolean flag indicating that conditions have been met and resistance determination requested" ULONG _CNV_S_2_RANGE______28_CM 1 100. 0. 1. ECU_ADDRESS 0x3fab7c BIT_MASK 0x20000000 /end MEASUREMENT
/begin MEASUREMENT LV_R_DOWN_LS_VLS_RNG_CDN_2 "Boolean flag indicating that VLS_DOWN at low gradient condition met" ULONG _CNV_S_2_RANGE______28_CM 1 100. 0. 1. ECU_ADDRESS 0x3fab7c BIT_MASK 0x40000000 /end MEASUREMENT
/begin MEASUREMENT LV_VLS_NOT_VLD_DOWN_2 "Boolean flag indicating that VLS_DOWN_i signal not valid, i.e. masked due to Ri determination" ULONG _CNV_S_2_RANGE______28_CM 1 100. 0. 1. ECU_ADDRESS 0x3fab7c BIT_MASK 0x8000000 /end MEASUREMENT
/begin MEASUREMENT CTR_CYCNR_R_DOWN_LS_2 "Handshake counter indicating the number of valid resistance values determined since initial activation" UWORD _CNV_A_R_LINEAR_____10_CM 1 100. 0. 65535. ECU_ADDRESS 0x3fab88 FORMAT "%5.0" /end MEASUREMENT
/begin MEASUREMENT DRV1_VLS_DOWN_MMV_THD_MAX_2 "Upper variable VLS_DOWN gradient threshold" SWORD _CNV_A_R_LINEAR_____282_CM 1 100. -2.5 2.4999 ECU_ADDRESS 0x3fab92 FORMAT "%7.4" /end MEASUREMENT
/begin MEASUREMENT DRV1_VLS_DOWN_MMV_THD_MIN_2 "Lower variable VLS_DOWN gradient threshold" SWORD _CNV_A_R_LINEAR_____282_CM 1 100. -2.5 2.4999 ECU_ADDRESS 0x3fab94 FORMAT "%7.4" /end MEASUREMENT
/begin MEASUREMENT FAC_T_DRV1_VLS_DOWN_ABS_2 "Multiplicative factor modifies C_DRV1_VLS_DOWN_ABS_MAX dependent on T_VLS_CYC_AFL_HLD" UBYTE _CNV_A_R_LINEAR_____40_CM 1 100. 0. 15.9375 ECU_ADDRESS 0x3fab84 FORMAT "%5.2" /end MEASUREMENT
/begin MEASUREMENT FAC_T_DRV1_VLS_DOWN_MMV_2 "Multiplicative factor modifies DRV1_VLS_DOWN_MMV_MIN_THD dependent on T_VLS_CYC_AFL_HLD" UBYTE _CNV_A_R_LINEAR_____284_CM 1 100. 0. 63.75 ECU_ADDRESS 0x3fab85 FORMAT "%4.1" /end MEASUREMENT
/begin MEASUREMENT R_DOWN_LS_2 "Internal resistance of downstream oxygen sensor" UWORD _CNV_A_R_LINEAR_____285_CM 1 100. 0. 65535. ECU_ADDRESS 0x3fab8a FORMAT "%5.0" /end MEASUREMENT
/begin MEASUREMENT R_DOWN_LS_MES_2 "Internal resistance of downstream oxygen sensor (Measured)" UWORD _CNV_A_R_LINEAR_____285_CM 1 100. 0. 65535. ECU_ADDRESS 0x3fab8c FORMAT "%5.0" /end MEASUREMENT
/begin MEASUREMENT T_SAMPLE_R_DOWN_LS_2 "Time measured between internal resistance samples" UWORD _CNV_A_R_LINEAR_____27_CM 1 100. 0. 655.35 ECU_ADDRESS 0x3fab90 FORMAT "%6.2" /end MEASUREMENT
/begin MEASUREMENT T_VLS_CYC_AFL_HLD_R_DOWN_LS_2 "Lean mixture cycle time (measured upstream), held until next threshold crossing downstream" UBYTE _CNV_A_R_LINEAR_____27_CM 1 100. 0. 2.55 ECU_ADDRESS 0x3fab86 FORMAT "%4.2" /end MEASUREMENT
/begin MEASUREMENT TTIP_LS_DOWN_MES_2 "Downstream oxygen sensor ceramic temperature" SWORD _CNV_A_R_LINEAR_____286_CM 1 100. -2048. 2047.938 ECU_ADDRESS 0x3fab96 FORMAT "%8.2" /end MEASUREMENT
/begin MEASUREMENT TTIP_LS_DOWN_MES_BOL_2 "Downstream oxygen sensor ceramic temperature, Lower limit, Unfiltered" SWORD _CNV_A_R_LINEAR_____286_CM 1 100. -2048. 2047.938 ECU_ADDRESS 0x3fab9a FORMAT "%8.2" /end MEASUREMENT
/begin MEASUREMENT TTIP_LS_DOWN_MES_BOL_MMV_2 "Downstream oxygen sensor ceramic temperature, Lower limit, Filtered" SWORD _CNV_A_R_LINEAR_____286_CM 1 100. -2048. 2047.938 ECU_ADDRESS 0x3faba0 FORMAT "%8.2" /end MEASUREMENT
/begin MEASUREMENT TTIP_LS_DOWN_MES_TOL_2 "Downstream oxygen sensor ceramic temperature, Upper limit, Unfiltered" SWORD _CNV_A_R_LINEAR_____286_CM 1 100. -2048. 2047.938 ECU_ADDRESS 0x3fab98 FORMAT "%8.2" /end MEASUREMENT
/begin MEASUREMENT TTIP_LS_DOWN_MES_TOL_MMV_2 "Downstream oxygen sensor ceramic temperature, Upper limit, Filtered" SWORD _CNV_A_R_LINEAR_____286_CM 1 100. -2048. 2047.938 ECU_ADDRESS 0x3fab9c FORMAT "%8.2" /end MEASUREMENT
/begin MEASUREMENT LV_R_UP_LS_DET_2 "Boolean flag indicating that resistance has already been determined in current lean phase(lock out)" ULONG _CNV_S_2_RANGE______28_CM 1 100. 0. 1. ECU_ADDRESS 0x3faca4 BIT_MASK 0x10000000 /end MEASUREMENT
/begin MEASUREMENT LV_R_UP_LS_DRV1_VLS_CDN_2 "Boolean flag indicating that VLS_UP at low gradient condition met" ULONG _CNV_S_2_RANGE______28_CM 1 100. 0. 1. ECU_ADDRESS 0x3faca4 BIT_MASK 0x80000000 /end MEASUREMENT
/begin MEASUREMENT LV_R_UP_LS_ENA_2 "Boolean flag indicating that application conditions have been met" ULONG _CNV_S_2_RANGE______28_CM 1 100. 0. 1. ECU_ADDRESS 0x3faca4 BIT_MASK 0x20000000 /end MEASUREMENT
/begin MEASUREMENT LV_R_UP_LS_VLS_RNG_CDN_2 "Boolean flag indicating that VLS_UP at low gradient condition met" ULONG _CNV_S_2_RANGE______28_CM 1 100. 0. 1. ECU_ADDRESS 0x3faca4 BIT_MASK 0x40000000 /end MEASUREMENT
/begin MEASUREMENT LV_VLS_NOT_VLD_UP_2 "Boolean flag indicating that VLS_UP_i signal not valid, i.e. masked due to Ri determination" ULONG _CNV_S_2_RANGE______28_CM 1 100. 0. 1. ECU_ADDRESS 0x3faca4 BIT_MASK 0x8000000 /end MEASUREMENT
/begin MEASUREMENT CTR_CYCNR_R_UP_LS_2 "Handshake counter indicating the number of valid resistance values determined since initial activation" UWORD _CNV_A_R_LINEAR_____10_CM 1 100. 0. 65535. ECU_ADDRESS 0x3facae FORMAT "%5.0" /end MEASUREMENT
/begin MEASUREMENT DRV1_VLS_UP_MMV_THD_MAX_2 "Upper variable VLS_UP gradient threshold" SWORD _CNV_A_R_LINEAR_____282_CM 1 100. -2.5 2.4999 ECU_ADDRESS 0x3facb8 FORMAT "%7.4" /end MEASUREMENT
/begin MEASUREMENT DRV1_VLS_UP_MMV_THD_MIN_2 "Lower variable VLS_UP gradient threshold" SWORD _CNV_A_R_LINEAR_____282_CM 1 100. -2.5 2.4999 ECU_ADDRESS 0x3facba FORMAT "%7.4" /end MEASUREMENT
/begin MEASUREMENT FAC_T_DRV1_VLS_UP_ABS_2 "Multiplicative factor modifies C_DRV1_VLS_UP_ABS_MAX dependent on T_VLS_CYC_AFL_HLD" UBYTE _CNV_A_R_LINEAR_____40_CM 1 100. 0. 15.9375 ECU_ADDRESS 0x3facac FORMAT "%5.2" /end MEASUREMENT
/begin MEASUREMENT FAC_T_DRV1_VLS_UP_MMV_2 "Multiplicative factor modifies DRV1_VLS_UP_MMV_MIN_THD dependent on T_VLS_CYC_AFL_HLD" UBYTE _CNV_A_R_LINEAR_____284_CM 1 100. 0. 63.75 ECU_ADDRESS 0x3facad FORMAT "%4.1" /end MEASUREMENT
/begin MEASUREMENT R_UP_LS_2 "Internal resistance of upstream oxygen sensor, cylinder bank i" UWORD _CNV_A_R_LINEAR_____285_CM 1 100. 0. 65535. ECU_ADDRESS 0x3facb0 FORMAT "%5.0" /end MEASUREMENT
/begin MEASUREMENT R_UP_LS_MES_2 "Internal resistance of upstream oxygen sensor (Measured)" UWORD _CNV_A_R_LINEAR_____285_CM 1 100. 0. 65535. ECU_ADDRESS 0x3facb2 FORMAT "%5.0" /end MEASUREMENT
/begin MEASUREMENT T_SAMPLE_R_UP_LS_2 "Time measured between internal resistance samples" UWORD _CNV_A_R_LINEAR_____27_CM 1 100. 0. 655.35 ECU_ADDRESS 0x3facb6 FORMAT "%6.2" /end MEASUREMENT
/begin MEASUREMENT TTIP_LS_UP_MES_2 "Upstream oxygen sensor ceramic temperature" SWORD _CNV_A_R_LINEAR_____286_CM 1 100. -2048. 2047.938 ECU_ADDRESS 0x3facbc FORMAT "%8.2" /end MEASUREMENT
/begin MEASUREMENT TTIP_LS_UP_MES_BOL_2 "Upstream oxygen sensor ceramic temperature, Lower limit, Unfiltered" SWORD _CNV_A_R_LINEAR_____286_CM 1 100. -2048. 2047.938 ECU_ADDRESS 0x3facc0 FORMAT "%8.2" /end MEASUREMENT
/begin MEASUREMENT TTIP_LS_UP_MES_BOL_MMV_2 "Upstream oxygen sensor ceramic temperature, Lower limit, Unfiltered" SWORD _CNV_A_R_LINEAR_____286_CM 1 100. -2048. 2047.938 ECU_ADDRESS 0x3facc6 FORMAT "%8.2" /end MEASUREMENT
/begin MEASUREMENT TTIP_LS_UP_MES_TOL_2 "Downstream oxygen sensor ceramic temperature, Upper limit, Unfiltered" SWORD _CNV_A_R_LINEAR_____286_CM 1 100. -2048. 2047.938 ECU_ADDRESS 0x3facbe FORMAT "%8.2" /end MEASUREMENT
/begin MEASUREMENT TTIP_LS_UP_MES_TOL_MMV_2 "Upstream oxygen sensor ceramic temperature, Lower limit, Unfiltered" SWORD _CNV_A_R_LINEAR_____286_CM 1 100. -2048. 2047.938 ECU_ADDRESS 0x3facc2 FORMAT "%8.2" /end MEASUREMENT
/begin MEASUREMENT LV_AFL_2 "" ULONG _CNV_S_2_RANGE______28_CM 1 100. 0. 1. ECU_ADDRESS 0x3fac00 BIT_MASK 0x80000000 /end MEASUREMENT
/begin MEASUREMENT LV_VLS_UP_MMV_LMT_2 "Boolean flag indicating VLS_MMV_xxx_i signals being limited when set" ULONG _CNV_S_2_RANGE______28_CM 1 100. 0. 1. ECU_ADDRESS 0x3fac00 BIT_MASK 0x10000000 /end MEASUREMENT
/begin MEASUREMENT LV_VLS_UP_MMV_STK_VLD_2 "Boolean flag indicating VLS_MMV_xxx_i signals valid when set" ULONG _CNV_S_2_RANGE______28_CM 1 100. 0. 1. ECU_ADDRESS 0x3fac00 BIT_MASK 0x8000000 /end MEASUREMENT
/begin MEASUREMENT CTR_VLS_AFL_CYC_2 "Denotes number of AF cycles since lambda controller last activated" UWORD _CNV_A_R_LINEAR_____10_CM 1 100. 0. 65535. ECU_ADDRESS 0x3fac0a FORMAT "%5.0" /end MEASUREMENT
/begin MEASUREMENT DRV1_VLS_UP_ABS_MAX_2 "Absolute maximum value within buffer containing 1st derivative of VLS_UP_i signal" UWORD _CNV_A_R_LINEAR_____283_CM 1 100. 0. 4.9999237 ECU_ADDRESS 0x3fac1a FORMAT "%6.4" /end MEASUREMENT
/begin MEASUREMENT DRV1_VLS_UP_MMV_2 "Mean of buffer containing 1st derivative of VLS_UP_i signal" SWORD _CNV_A_R_LINEAR_____282_CM 1 100. -2.5 2.4999 ECU_ADDRESS 0x3fac16 FORMAT "%7.4" /end MEASUREMENT
/begin MEASUREMENT DRV1_VLS_UP_MMV_MIN_2 "Minimum value of mean of buffer containing 1st derivative of VLS_UP_i signal in lean phase" SWORD _CNV_A_R_LINEAR_____282_CM 1 100. -2.5 2.4999 ECU_ADDRESS 0x3fac18 FORMAT "%7.4" /end MEASUREMENT
/begin MEASUREMENT T_AFL_LOCK_2 "Timer indicating duration of LV_AFL lock" UBYTE _CNV_A_R_LINEAR_____27_CM 1 100. 0. 2.55 ECU_ADDRESS 0x3fac2d FORMAT "%4.2" /end MEASUREMENT
/begin MEASUREMENT T_VLS_CYC_AFL_2 "Lean mixture cycle time" UBYTE _CNV_A_R_LINEAR_____27_CM 1 100. 0. 2.55 ECU_ADDRESS 0x3fac07 FORMAT "%4.2" /end MEASUREMENT
/begin MEASUREMENT T_VLS_CYC_AFL_HLD_2 "Lean mixture cycle time, held until next new value available" UBYTE _CNV_A_R_LINEAR_____27_CM 1 100. 0. 2.55 ECU_ADDRESS 0x3fac08 FORMAT "%4.2" /end MEASUREMENT
/begin MEASUREMENT T_VLS_CYC_AFR_2 "Rich mixture cycle time" UBYTE _CNV_A_R_LINEAR_____27_CM 1 100. 0. 2.55 ECU_ADDRESS 0x3fac06 FORMAT "%4.2" /end MEASUREMENT
/begin MEASUREMENT VLS_BOL_2 "Corrected VLS_MMV_MIN" UWORD _CNV_A_R_LINEAR_____33_CM 1 100. 0. 4.99511719 ECU_ADDRESS 0x3fac10 FORMAT "%5.3" /end MEASUREMENT
/begin MEASUREMENT VLS_MMV_MAX_2 "Mean maximum sensor voltage" UWORD _CNV_A_R_LINEAR_____256_CM 1 100. 0. 4.99992371 ECU_ADDRESS 0x3fac0c FORMAT "%7.5" /end MEASUREMENT
/begin MEASUREMENT VLS_MMV_MIN_2 "Mean minimum sensor voltage" UWORD _CNV_A_R_LINEAR_____256_CM 1 100. 0. 4.99992371 ECU_ADDRESS 0x3fac0e FORMAT "%7.5" /end MEASUREMENT
/begin MEASUREMENT VLS_TOL_2 "Corrected VLS_MMV_MAX" UWORD _CNV_A_R_LINEAR_____33_CM 1 100. 0. 4.99511719 ECU_ADDRESS 0x3fac12 FORMAT "%5.3" /end MEASUREMENT
/begin MEASUREMENT VLS_UP_MMV_HYS_2 "Variable switching threshold for calculation of VLS_DOWN_MMV_MIN_i" UWORD _CNV_A_R_LINEAR_____281_CM 1 100. 0. 1. ECU_ADDRESS 0x3fac14 FORMAT "%7.5" /end MEASUREMENT
/begin MEASUREMENT LSHPWM_DOWN_2 "" UBYTE _CNV_A_R_LINEAR_____4_CM 1 100. 0. 99.609375 ECU_ADDRESS 0x3fab34 FORMAT "%4.1" /end MEASUREMENT
/begin MEASUREMENT T_LSH_DOWN_2 "Timer to determine the duration of heating phase" UBYTE _CNV_A_R_LINEAR_____47_CM 1 100. 0. 255. ECU_ADDRESS 0x3fab35 FORMAT "%3.0" /end MEASUREMENT
/begin MEASUREMENT V_EFC_LSH_DOWN_2 "Effective value of heater voltage" UBYTE _CNV_A_R_LINEAR_____26_CM 1 100. 0. 25.8984 ECU_ADDRESS 0x3fab36 FORMAT "%3.1" /end MEASUREMENT
/begin MEASUREMENT T_LSH_DOWN_TOL_2 "Timer to determine the duration of high voltage phases" UBYTE _CNV_A_R_LINEAR_____47_CM 1 100. 0. 255. ECU_ADDRESS 0x3fab37 FORMAT "%3.0" /end MEASUREMENT
/begin MEASUREMENT T_LSH_DOWN_LIM_2 "Timer to determine the duration of heating phases after a high voltage phase" UBYTE _CNV_A_R_LINEAR_____47_CM 1 100. 0. 255. ECU_ADDRESS 0x3fab38 FORMAT "%3.0" /end MEASUREMENT
/begin MEASUREMENT STATE_LSH_DOWN_2 "Heating state recognition" ULONG _CNV_S_6_STATE_LSH__287_CM 1 100. 0. 5. ECU_ADDRESS 0x3fab30 /end MEASUREMENT
/begin MEASUREMENT LV_INH_LSH_UP_2 "Boolean flag indicating project specific application conditions for heating not met" UBYTE _CNV_S_2_RANGE______28_CM 1 100. 0. 1. ECU_ADDRESS 0x3fab5c /end MEASUREMENT
/begin MEASUREMENT LV_INH_LSH_UP_CLL_CTL_2 "Boolean flag indicating project specific application conditions closed loop heater control not met" UBYTE _CNV_S_2_RANGE______28_CM 1 100. 0. 1. ECU_ADDRESS 0x3fab5d /end MEASUREMENT
/begin MEASUREMENT LV_TTIP_LS_UP_MES_VLD_2 "Boolean flag indicating validity of oxygen sensor ceramic temperature TTIP_LS_UP_MES_i" UBYTE _CNV_S_2_RANGE______28_CM 1 100. 0. 1. ECU_ADDRESS 0x3fab5e /end MEASUREMENT
/begin MEASUREMENT LV_V_TEMP_LS_UP_REF_VLD_2 "Boolean flag indicating internal resistance determination circuit references valid" UBYTE _CNV_S_2_RANGE______28_CM 1 100. 0. 1. ECU_ADDRESS 0x3fab5f /end MEASUREMENT
/begin MEASUREMENT TEMP_LS_INI_2 "Oxygen sensor temperature at engine start for the oxygen sensor heating management" SWORD _CNV_A_R_LINEAR_____286_CM 1 100. -2048. 2047.938 ECU_ADDRESS 0x3fab60 FORMAT "%8.2" /end MEASUREMENT
/begin MEASUREMENT LV_LSH_UP_CLL_CTL_2 "Boolean variable indicating closed loop control mode active" ULONG _CNV_S_2_RANGE______28_CM 1 100. 0. 1. ECU_ADDRESS 0x3fab40 BIT_MASK 0x80000000 /end MEASUREMENT
/begin MEASUREMENT LV_V_EFC_LSH_UP_LIM_BOL_2 "Boolean flag indicating effective heater voltage limited due to sum of voltage components falling below zero." ULONG _CNV_S_2_RANGE______28_CM 1 100. 0. 1. ECU_ADDRESS 0x3fab40 BIT_MASK 0x40000000 /end MEASUREMENT
/begin MEASUREMENT LV_V_EFC_LSH_UP_LIM_TOL_2 "Boolean flag indicating effective heater voltage limited due to exceeding threshold for period of time." ULONG _CNV_S_2_RANGE______28_CM 1 100. 0. 1. ECU_ADDRESS 0x3fab40 BIT_MASK 0x20000000 /end MEASUREMENT
/begin MEASUREMENT LV_V_EFC_LSH_UP_LIM_MAX_2 "Boolean flag indicating effective heater voltage limited due to exceeding absolute maximum voltage spec." ULONG _CNV_S_2_RANGE______28_CM 1 100. 0. 1. ECU_ADDRESS 0x3fab40 BIT_MASK 0x10000000 /end MEASUREMENT
/begin MEASUREMENT LV_POW_CTL_ACT_2 "???" ULONG _CNV_S_2_RANGE______28_CM 1 100. 0. 1. ECU_ADDRESS 0x3fab40 BIT_MASK 0x8000000 /end MEASUREMENT
/begin MEASUREMENT T_LSH_UP_2 "Timer to determine the duration of heating phase" UBYTE _CNV_A_R_LINEAR_____14_CM 1 100. 0. 25.5 ECU_ADDRESS 0x3fab49 FORMAT "%4.1" /end MEASUREMENT
/begin MEASUREMENT LSHPWM_UP_2 "" UBYTE _CNV_A_R_LINEAR_____4_CM 1 100. 0. 99.609375 ECU_ADDRESS 0x3fab48 FORMAT "%4.1" /end MEASUREMENT
/begin MEASUREMENT V_EFC_LSH_UP_2 "Effective value of heater voltage" UBYTE _CNV_A_R_LINEAR_____26_CM 1 100. 0. 25.8984 ECU_ADDRESS 0x3fab4a FORMAT "%3.1" /end MEASUREMENT
/begin MEASUREMENT T_LSH_UP_TOL_2 "Timer to determine the duration of high voltage phases" UBYTE _CNV_A_R_LINEAR_____14_CM 1 100. 0. 25.5 ECU_ADDRESS 0x3fab4e FORMAT "%4.1" /end MEASUREMENT
/begin MEASUREMENT T_LSH_UP_LIM_2 "Timer to determine the duration of heating phases after a high voltage phase" UBYTE _CNV_A_R_LINEAR_____14_CM 1 100. 0. 25.5 ECU_ADDRESS 0x3fab4f FORMAT "%4.1" /end MEASUREMENT
/begin MEASUREMENT STATE_LSH_UP_2 "Heating state recognition" ULONG _CNV_S_7_STATE_LSH__296_CM 1 100. 0. 6. ECU_ADDRESS 0x3fab44 /end MEASUREMENT
/begin MEASUREMENT V_EFC_LSH_UP_CLC_2 "Effective calculated heater voltage value prior to overvoltage protection" UWORD _CNV_A_R_LINEAR_____297_CM 1 100. 0. 25.999603 ECU_ADDRESS 0x3fab4c FORMAT "%7.4" /end MEASUREMENT
/begin MEASUREMENT V_EFC_LSH_UP_CTL_ADD_2 "Additive effective heater voltage from closed loop controller" SBYTE _CNV_A_R_LINEAR_____298_CM 1 100. -13.05 12.95 ECU_ADDRESS 0x3fab50 FORMAT "%5.1" /end MEASUREMENT
/begin MEASUREMENT V_EFC_LSH_UP_CTL_P_ADD_2 "Additive effective heater voltage from closed loop controller, P term" SWORD _CNV_A_R_LINEAR_____299_CM 1 100. -13.05 13.05 ECU_ADDRESS 0x3fab52 FORMAT "%8.4" /end MEASUREMENT
/begin MEASUREMENT V_EFC_LSH_UP_CTL_I_ADD_2 "Additive effective heater voltage from closed loop controller, I term" SWORD _CNV_A_R_LINEAR_____299_CM 1 100. -13.05 13.05 ECU_ADDRESS 0x3fab54 FORMAT "%8.4" /end MEASUREMENT
/begin MEASUREMENT TTIP_LS_UP_DIF_SET_MES_2 "Difference between actual and set oxygen sensor tip temperature" SWORD _CNV_A_R_LINEAR_____286_CM 1 100. -2048. 2047.938 ECU_ADDRESS 0x3fab56 FORMAT "%8.2" /end MEASUREMENT
/begin MEASUREMENT LAMB_BAS_H_RES_2 "bank selektive basic lambda setpoint with high resolution" ULONG _CNV_A_R_LINEAR_____300_CM 1 100. 0. 32. ECU_ADDRESS 0x3faa88 FORMAT "%8.5" /end MEASUREMENT
/begin MEASUREMENT LAMB_HOM_AFS_H_RES_2 "stoichiometric lambda setpoint with high resolution" ULONG _CNV_A_R_LINEAR_____300_CM 1 100. 0. 32. ECU_ADDRESS 0x3faa8c FORMAT "%8.5" /end MEASUREMENT
/begin MEASUREMENT LAMB_BAS_2 "bank selektive basic lambda setpoint" UWORD _CNV_A_R_LINEAR_____148_CM 1 100. 0. 31.99902344 ECU_ADDRESS 0x3faa90 FORMAT "%7.4" /end MEASUREMENT
/begin MEASUREMENT LAMB_HOM_AFS_2 "stoichiometric lambda setpoint" UWORD _CNV_A_R_LINEAR_____148_CM 1 100. 0. 31.99902344 ECU_ADDRESS 0x3faa92 FORMAT "%7.4" /end MEASUREMENT
/begin MEASUREMENT LV_LAMB_BAS_OFS_CAT_DIAG_2 "flag_to indicate lambda offset" UBYTE _CNV_S_2_RANGE______28_CM 1 100. 0. 1. ECU_ADDRESS 0x3faa94 /end MEASUREMENT
/begin MEASUREMENT LAMB_BAS_COR_2 "lambda output for TQI_SP_MAF calculation" UWORD _CNV_A_R_LINEAR_____148_CM 1 100. 0. 31.99902344 ECU_ADDRESS 0x3faad4 FORMAT "%7.4" /end MEASUREMENT
/begin MEASUREMENT LAMB_SP_2 "lambda setpoint" UWORD _CNV_A_R_LINEAR_____148_CM 1 100. 0. 31.99902344 ECU_ADDRESS 0x3faad8 FORMAT "%7.4" /end MEASUREMENT
/begin MEASUREMENT LAMB_SP_BAS_2 "lambda feedback for basic torque calculation" UWORD _CNV_A_R_LINEAR_____148_CM 1 100. 0. 31.99902344 ECU_ADDRESS 0x3faada FORMAT "%7.4" /end MEASUREMENT
/begin MEASUREMENT LAMB_BAS_COR_1_H_RES_2 "lambda setpoint used for lambda = 1 detection" ULONG _CNV_A_R_LINEAR_____300_CM 1 100. 0. 32. ECU_ADDRESS 0x3faac0 FORMAT "%8.5" /end MEASUREMENT
/begin MEASUREMENT LAMB_SP_H_RES_2 "lambda setpoint with high resolution" ULONG _CNV_A_R_LINEAR_____300_CM 1 100. 0. 32. ECU_ADDRESS 0x3faad0 FORMAT "%8.5" /end MEASUREMENT
/begin MEASUREMENT LV_LAMB_SP_1_2 "boolean to inicate if lambda setpoint is identical to 1" UBYTE _CNV_S_2_RANGE______28_CM 1 100. 0. 1. ECU_ADDRESS 0x3faadc /end MEASUREMENT
/begin MEASUREMENT LAMB_RGN_2 "lambda setpoint for catalyst regeneration" UWORD _CNV_A_R_LINEAR_____148_CM 1 100. 0. 31.99902344 ECU_ADDRESS 0x3faabc FORMAT "%7.4" /end MEASUREMENT
/begin MEASUREMENT LAMB_COP_2 "lambda for catalyst overheating prevention" UWORD _CNV_A_R_LINEAR_____148_CM 1 100. 0. 31.99902344 ECU_ADDRESS 0x3faa48 FORMAT "%7.4" /end MEASUREMENT
/begin MEASUREMENT LV_LAMB_COP_2 "boolean for catalyst overheating prevention" UBYTE _CNV_S_2_RANGE______28_CM 1 100. 0. 1. ECU_ADDRESS 0x3faa4a /end MEASUREMENT
/begin MEASUREMENT FAC_COP_2 "Inverse lambda depency of exhaust gas temperature model" UWORD _CNV_A_R_LINEAR_____45_CM 1 100. 0. 1.99996948 ECU_ADDRESS 0x3faa4c FORMAT "%7.5" /end MEASUREMENT
/begin MEASUREMENT TEG_COP_SP_2 "Temperature threshold for overhea protection" UWORD _CNV_A_R_LINEAR_____269_CM 1 100. -48. 1459.3 ECU_ADDRESS 0x3faa50 FORMAT "%7.2" /end MEASUREMENT
/begin MEASUREMENT T_COP_2 "Time catalyst overheat protection active" UBYTE _CNV_A_R_LINEAR_____275_CM 1 100. 0. 127.5 ECU_ADDRESS 0x3faa52 FORMAT "%5.1" /end MEASUREMENT
/begin MEASUREMENT LV_LDC_DLY_2 "status limited dynamic" ULONG _CNV_S_2_RANGE______28_CM 1 100. 0. 1. ECU_ADDRESS 0x3fac30 BIT_MASK 0x80000000 /end MEASUREMENT
/begin MEASUREMENT LV_LAM_MV_LDC_DLY_2 "status limited dynamic LAM_MV_i" ULONG _CNV_S_2_RANGE______28_CM 1 100. 0. 1. ECU_ADDRESS 0x3fac30 BIT_MASK 0x40000000 /end MEASUREMENT
/begin MEASUREMENT LAM_MV_MMV_DLY_2 "floating mean value for limited lambda deviation" SWORD _CNV_A_R_LINEAR_____98_CM 1 100. -50. 49.99847412 ECU_ADDRESS 0x3fac34 FORMAT "%7.3" /end MEASUREMENT
/begin MEASUREMENT MAF_INT_LDC_DLY_2 "integral of mass air flow since limited dynamic conditions are fulfilled" UWORD _CNV_A_R_LINEAR_____277_CM 1 100. 0. 1820.398 ECU_ADDRESS 0x3fac38 FORMAT "%7.2" /end MEASUREMENT
/begin MEASUREMENT PV_AV_GRD_SUM_DLY_2 "sum. value for limited lambda deviation" UWORD _CNV_A_R_LINEAR_____304_CM 1 100. 0. 639990.2340000001 ECU_ADDRESS 0x3fac36 FORMAT "%8.1" /end MEASUREMENT
/begin CHARACTERISTIC C_LAM_N_MIN "Minimum engine speed to close the A/F-loop" VALUE 0x428f9 _REC_VAL_20_u1 8160. _CNV_A_R_LINEAR_____5_CM 0. 8160. FORMAT "%4.0" /end CHARACTERISTIC
/begin CHARACTERISTIC C_LAM_CYCNR "delay after PUC before reenabling Lambda control" VALUE 0x42db8 _REC_VAL_20_u2 6.553500000000001 _CNV_A_R_LINEAR_____306_CM 0. 655.35 FORMAT "%6.2" /end CHARACTERISTIC
/begin MEASUREMENT LV_LAMB_RGN_FAC_SENS "Flag determining the mode of lambda variation" UBYTE _CNV_S_2_RANGE______11_CM 1 100. 0. 1. ECU_ADDRESS 0x3fdc79 BIT_MASK 0x1 /end MEASUREMENT
/begin CHARACTERISTIC LC_LAMB_RGN_FAC_SENS "Logical constant determining the mode of lambda correction" VALUE 0x42ba8 _REC_VAL_20_u1 1. _CNV_S_2_RANGE______28_CM 0. 1. /end CHARACTERISTIC
/begin CHARACTERISTIC IP_LAMB_RGN_AFR__MAF__N_32 "lambda setpoint for catalyst regeneration" MAP 0x48c62 _REC_MAP_20_u2_u1_u1 31.99902344 _CNV_A_R_LINEAR_____148_CM 0. 31.99902344 FORMAT "%7.4"
 /begin AXIS_DESCR COM_AXIS MAF _CNV_A_R_LINEAR_____18_CM 8 0. 1389. FORMAT "%4.0" AXIS_PTS_REF ldp_maf_ip_lamb_rgn_afr /end AXIS_DESCR
 /begin AXIS_DESCR COM_AXIS N_32 _CNV_A_R_LINEAR_____5_CM 8 0. 8160. FORMAT "%4.0" AXIS_PTS_REF ldp_n_32_ip_lamb_rgn_afr /end AXIS_DESCR
/end CHARACTERISTIC
/begin CHARACTERISTIC IP_LAMB_RGN_FAC_SENS "lambda setpoint correction factor depending on sensor signal" CURVE 0x48cf2 _REC_CUR_20_u2_u2 0.99 _CNV_A_R_LINEAR_____308_CM 1. 1.99 FORMAT "%6.4"
 /begin AXIS_DESCR COM_AXIS ONLINE_DUMMY _CNV_A_R_LINEAR_____33_CM 8 0. 4.99511719 FORMAT "%5.3" AXIS_PTS_REF ldp_vls_down_ip_lamb_rgn /end AXIS_DESCR
/end CHARACTERISTIC
/begin CHARACTERISTIC IP_LAMB_RGN_FAC_MDL "lambda setpoint correction factor depending on remaining modelled loading" CURVE 0x48ce2 _REC_CUR_20_u2_u2 0.99 _CNV_A_R_LINEAR_____308_CM 1. 1.99 FORMAT "%6.4"
 /begin AXIS_DESCR COM_AXIS NTL _CNV_A_R_LINEAR_____309_CM 8 0. 10485.6 FORMAT "%7.1" AXIS_PTS_REF ldp_ntl_ip_lamb_rgn_fac_mdl /end AXIS_DESCR
/end CHARACTERISTIC
/begin CHARACTERISTIC C_LAMB_RGN_PAS "passive value for catalyst regeneration" VALUE 0x42dd0 _REC_VAL_20_u2 31.99902344 _CNV_A_R_LINEAR_____148_CM 0. 31.99902344 FORMAT "%7.4" /end CHARACTERISTIC
/begin CHARACTERISTIC C_LAMB_RGN_MAX "maximum value for regeneration lambda value" VALUE 0x42dce _REC_VAL_20_u2 31.99902344 _CNV_A_R_LINEAR_____148_CM 0. 31.99902344 FORMAT "%7.4" /end CHARACTERISTIC
/begin CHARACTERISTIC C_T_RGN_LAMB_CON "time to stay on base map lambda value" VALUE 0x43028 _REC_VAL_20_u2 655.35 _CNV_A_R_LINEAR_____27_CM 0. 655.35 FORMAT "%6.2" /end CHARACTERISTIC
/begin MEASUREMENT T_RGN "Time counter for active regeneration" UWORD _CNV_A_R_LINEAR_____27_CM 1 100. 0. 655.35 ECU_ADDRESS 0x3fcbb0 FORMAT "%5.2" /end MEASUREMENT
/begin AXIS_PTS ldp_ntl_ip_lamb_rgn_fac_mdl "" 0x4497a NTL _REC_AXS_20_u2 10485.6 _CNV_A_R_LINEAR_____309_CM 8 0. 10485.6 FORMAT "%7.1" /end AXIS_PTS
/begin AXIS_PTS ldp_vls_down_ip_lamb_rgn "" 0x44e00 VLS_DOWN _REC_AXS_20_u2 4.99511719 _CNV_A_R_LINEAR_____33_CM 8 0. 4.99511719 FORMAT "%5.3" /end AXIS_PTS
/begin AXIS_PTS ldp_n_32_ip_lamb_rgn_afr "" 0x436a4 N_32 _REC_AXS_20_u1 8160. _CNV_A_R_LINEAR_____5_CM 8 0. 8160. FORMAT "%4.0" /end AXIS_PTS
/begin AXIS_PTS ldp_maf_ip_lamb_rgn_afr "" 0x4349c MAF _REC_AXS_20_u1 1389. _CNV_A_R_LINEAR_____18_CM 8 0. 1389. FORMAT "%4.0" /end AXIS_PTS
/begin MEASUREMENT LAMB_SAWUP "Basis lambda (pre-control)" UWORD _CNV_A_R_LINEAR_____148_CM 1 100. 0. 31.99902344 ECU_ADDRESS 0x3fcbb2 FORMAT "%7.4" /end MEASUREMENT
/begin MEASUREMENT FAC_LAMB_DE_SA "Lambda deviation through secondary air" UWORD _CNV_A_R_LINEAR_____310_CM 1 100. 0. 3.999939 ECU_ADDRESS 0x3fcbb4 FORMAT "%7.5" /end MEASUREMENT
/begin MEASUREMENT LAMB_SA_CH "Lambda for secondary air catalyst heating" UWORD _CNV_A_R_LINEAR_____148_CM 1 100. 0. 31.99902344 ECU_ADDRESS 0x3fcbb6 FORMAT "%7.4" /end MEASUREMENT
/begin CHARACTERISTIC IP_LAMB_SAWUP "basic lambda correction for rich catalyst heating" MAP 0x48d02 _REC_MAP_20_u2_u2_u1 31.99902344 _CNV_A_R_LINEAR_____148_CM 0. 31.99902344 FORMAT "%7.4"
 /begin AXIS_DESCR COM_AXIS TQI_REQ_SLOW _CNV_A_R_LINEAR_____218_CM 8 -1024. 1023.96875 FORMAT "%6.2" AXIS_PTS_REF ldp_tqi_req_slow__lamb_sawup /end AXIS_DESCR
 /begin AXIS_DESCR COM_AXIS N_32 _CNV_A_R_LINEAR_____5_CM 8 0. 8160. FORMAT "%4.0" AXIS_PTS_REF ldp_n_32__lamb_sawup /end AXIS_DESCR
/end CHARACTERISTIC
/begin CHARACTERISTIC IP_LAMB_SAWUP_IS "basic lambda correction for rich catalyst heating during idle speed" MAP 0x48d82 _REC_MAP_20_u2_u2_u1 31.99902344 _CNV_A_R_LINEAR_____148_CM 0. 31.99902344 FORMAT "%7.4"
 /begin AXIS_DESCR COM_AXIS TQI_REQ_SLOW _CNV_A_R_LINEAR_____218_CM 8 -1024. 1023.96875 FORMAT "%6.2" AXIS_PTS_REF ldp_tqi_req_slow__lamb_sawup_is /end AXIS_DESCR
 /begin AXIS_DESCR COM_AXIS N_32 _CNV_A_R_LINEAR_____5_CM 8 0. 8160. FORMAT "%4.0" AXIS_PTS_REF ldp_n_32__lamb_sawup_is /end AXIS_DESCR
/end CHARACTERISTIC
/begin CHARACTERISTIC IP_LAMB_ADD_SAWUP "additive correction of the basic lambda heating correction" MAP 0x48636 _REC_MAP_20_u2_u2_u1 63.99902344 _CNV_A_R_LINEAR_____273_CM -32. 31.99902344 FORMAT "%8.4"
 /begin AXIS_DESCR COM_AXIS T_AST _CNV_A_R_LINEAR_____14_CM 8 0. 6553.5 FORMAT "%6.1" AXIS_PTS_REF ldp_t_ast__lamb_add_sawup /end AXIS_DESCR
 /begin AXIS_DESCR COM_AXIS TCO _CNV_A_R_LINEAR_____0_CM 8 -48. 142.5 FORMAT "%5.1" AXIS_PTS_REF ldp_tco__lamb_add_sawup /end AXIS_DESCR
/end CHARACTERISTIC
/begin CHARACTERISTIC LC_SA_SWI_CMB "Logical constant to switch between Lambda-combustion / Lambda pre-cat" VALUE 0x42bc2 _REC_VAL_20_u1 1. _CNV_A_R_LINEAR_____10_CM 0. 1. FORMAT "%2.0" /end CHARACTERISTIC
/begin AXIS_PTS ldp_tqi_req_slow__lamb_sawup "" 0x44ca0 TQI_REQ_SLOW _REC_AXS_20_u2 2047.96875 _CNV_A_R_LINEAR_____218_CM 8 -1024. 1023.96875 FORMAT "%6.2" /end AXIS_PTS
/begin AXIS_PTS ldp_tqi_req_slow__lamb_sawup_is "" 0x44cb2 TQI_REQ_SLOW _REC_AXS_20_u2 2047.96875 _CNV_A_R_LINEAR_____218_CM 8 -1024. 1023.96875 FORMAT "%6.2" /end AXIS_PTS
/begin AXIS_PTS ldp_n_32__lamb_sawup "" 0x43571 N_32 _REC_AXS_20_u1 8160. _CNV_A_R_LINEAR_____5_CM 8 0. 8160. FORMAT "%4.0" /end AXIS_PTS
/begin AXIS_PTS ldp_n_32__lamb_sawup_is "" 0x4357a N_32 _REC_AXS_20_u1 8160. _CNV_A_R_LINEAR_____5_CM 8 0. 8160. FORMAT "%4.0" /end AXIS_PTS
/begin AXIS_PTS ldp_t_ast__lamb_add_sawup "" 0x44a64 T_AST _REC_AXS_20_u2 6553.5 _CNV_A_R_LINEAR_____14_CM 8 0. 6553.5 FORMAT "%6.1" /end AXIS_PTS
/begin AXIS_PTS ldp_tco__lamb_add_sawup "" 0x43887 TCO _REC_AXS_20_u1 190.5 _CNV_A_R_LINEAR_____0_CM 8 -48. 142.5 FORMAT "%5.1" /end AXIS_PTS
/begin CHARACTERISTIC C_LAMB_SP_1_HYS "Hysteresis for lambda = 1 detection" VALUE 0x42dd2 _REC_VAL_20_u2 31.99902344 _CNV_A_R_LINEAR_____148_CM 0. 31.99902344 FORMAT "%7.4" /end CHARACTERISTIC
/begin CHARACTERISTIC C_LAMB_SP_OFS_AS "manual lambda setpoint for application" VALUE 0x42dda _REC_VAL_20_u2 31.999023 _CNV_A_R_LINEAR_____311_CM -16. 15.999023 FORMAT "%8.4" /end CHARACTERISTIC
/begin CHARACTERISTIC LC_LAMB_SP_MAN_ACT "Logical variable switch to manual lambda setpoint" VALUE 0x42ba9 _REC_VAL_20_u1 1. _CNV_S_2_RANGE______11_CM 0. 1. /end CHARACTERISTIC
/begin MEASUREMENT LAMB_BAS_COR "Corrected basic lambda mean value" UWORD _CNV_A_R_LINEAR_____148_CM 1 100. 0. 31.99902344 ECU_ADDRESS 0x3fcbba FORMAT "%7.4" /end MEASUREMENT
/begin CHARACTERISTIC C_LAMB_BAS_COR_MIN "Minimum value for lambda setpoint" VALUE 0x42dc6 _REC_VAL_20_u2 31.99902344 _CNV_A_R_LINEAR_____148_CM 0. 31.99902344 FORMAT "%7.4" /end CHARACTERISTIC
/begin CHARACTERISTIC C_LAMB_SP_MAN "manual lambda setpoint" VALUE 0x42dd8 _REC_VAL_20_u2 31.99902344 _CNV_A_R_LINEAR_____148_CM 0. 31.99902344 FORMAT "%7.4" /end CHARACTERISTIC
/begin MEASUREMENT LAMB_SP "lambda setpoint" UWORD _CNV_A_R_LINEAR_____148_CM 1 100. 0. 31.99902344 ECU_ADDRESS 0x3fcbb8 FORMAT "%7.4" /end MEASUREMENT
/begin MEASUREMENT LAMB_SP_BAS "-mean value of LAMB_SP_BAS_i" UWORD _CNV_A_R_LINEAR_____148_CM 1 100. 0. 31.99902344 ECU_ADDRESS 0x3fcbbc FORMAT "%7.4" /end MEASUREMENT
/begin CHARACTERISTIC C_MAF_MFF_AD_MAX "Maximum MAF for adaptive learning" VALUE 0x42e72 _REC_VAL_20_u2 2047.96875 _CNV_A_R_LINEAR_____101_CM 0. 2047.96875 FORMAT "%7.2" /end CHARACTERISTIC
/begin CHARACTERISTIC C_TIA_MFF_AD_MAX "Maximum air temperature for adaptive learning" VALUE 0x42ab4 _REC_VAL_20_u1 190.5 _CNV_A_R_LINEAR_____0_CM -48. 142.5 FORMAT "%5.1" /end CHARACTERISTIC
/begin MEASUREMENT LV_MFF_AD_ACT_1 "Boolean for MFF Adaptation activation" UBYTE _CNV_S_2_RANGE______28_CM 1 100. 0. 1. ECU_ADDRESS 0x3fcb8a /end MEASUREMENT
/begin MEASUREMENT LV_MFF_AD_ACT_2 "Boolean for MFF Adaptation activation" UBYTE _CNV_S_2_RANGE______28_CM 1 100. 0. 1. ECU_ADDRESS 0x3fcb8b /end MEASUREMENT
/begin MEASUREMENT LAMB_RATIO "Current Lambda ratio for interpolation factor" UWORD _CNV_A_R_LINEAR_____271_CM 1 100. -2. 2. ECU_ADDRESS 0x3fcb18 FORMAT "%8.5" /end MEASUREMENT
/begin CHARACTERISTIC IP_LAMB_IGA_AFL__N_32__MAF_HB "Lambda map for interpolation on ignition angle corrected with maps IGA_xxx_AFL" MAP 0x48a8e _REC_MAP_20_u2_u1_u1 31.99902344 _CNV_A_R_LINEAR_____148_CM 0. 31.99902344 FORMAT "%7.4"
 /begin AXIS_DESCR COM_AXIS N_32 _CNV_A_R_LINEAR_____5_CM 16 0. 8160. FORMAT "%4.0" AXIS_PTS_REF ldp_n_32__lamb_iga_afl /end AXIS_DESCR
 /begin AXIS_DESCR COM_AXIS MAF _CNV_A_R_LINEAR_____18_CM 12 0. 1389. FORMAT "%4.0" AXIS_PTS_REF ldp_maf_hb__lamb_iga_afl /end AXIS_DESCR
/end CHARACTERISTIC
/begin CHARACTERISTIC C_LAMB_IGA_AFR "Lambdavalue for ignition angle interpolation correlated with maps IP_IGA_xxx_AFR" VALUE 0x42dcc _REC_VAL_20_u2 31.99902344 _CNV_A_R_LINEAR_____148_CM 0. 31.99902344 FORMAT "%7.4" /end CHARACTERISTIC
/begin AXIS_PTS ldp_n_32__lamb_iga_afl "" 0x43560 N_32 _REC_AXS_20_u1 8160. _CNV_A_R_LINEAR_____5_CM 16 0. 8160. FORMAT "%4.0" /end AXIS_PTS
/begin AXIS_PTS ldp_maf_hb__lamb_iga_afl "" 0x4347a MAF_HB _REC_AXS_20_u1 1389. _CNV_A_R_LINEAR_____18_CM 12 0. 1389. FORMAT "%4.0" /end AXIS_PTS
/begin CHARACTERISTIC C_CAT_DIAG_MAX_DLY "threshold of catalyst conversion capability for activation" VALUE 0x4280b _REC_VAL_20_u1 1.984375 _CNV_A_R_LINEAR_____141_CM 0. 1.984375 FORMAT "%3.2" /end CHARACTERISTIC
/begin CHARACTERISTIC C_MAF_INT_MIN_DLY "MAF integral after setting limited dynamic conditions LV_LDC_DLY_i before starting the monitoring cycle" VALUE 0x42e30 _REC_VAL_20_u2 1820.398 _CNV_A_R_LINEAR_____277_CM 0. 1820.398 FORMAT "%7.2" /end CHARACTERISTIC
/begin CHARACTERISTIC C_LAM_TEMP_MIN_CAT_DLY "min. TEMP_ CAT threshold for activation" VALUE 0x428fc _REC_VAL_20_u1 1020. _CNV_A_R_LINEAR_____160_CM -33. 987. FORMAT "%4.1" /end CHARACTERISTIC
/begin CHARACTERISTIC C_N_LAM_DLY_P_MAX "max N threshold for activation P-share" VALUE 0x42947 _REC_VAL_20_u1 8160. _CNV_A_R_LINEAR_____5_CM 0. 8160. FORMAT "%4.0" /end CHARACTERISTIC
/begin CHARACTERISTIC C_N_LAM_DLY_P_MIN "min N threshold for activation P-share" VALUE 0x42948 _REC_VAL_20_u1 8160. _CNV_A_R_LINEAR_____5_CM 0. 8160. FORMAT "%4.0" /end CHARACTERISTIC
/begin CHARACTERISTIC C_MAF_LAM_DLY_P_MAX "max MAF threshold for activation P-share" VALUE 0x42e64 _REC_VAL_20_u2 1389. _CNV_A_R_LINEAR_____95_CM 0. 1389. FORMAT "%7.2" /end CHARACTERISTIC
/begin CHARACTERISTIC C_MAF_LAM_DLY_P_MIN "min MAF threshold for activation P-share" VALUE 0x42e66 _REC_VAL_20_u2 1389. _CNV_A_R_LINEAR_____95_CM 0. 1389. FORMAT "%7.2" /end CHARACTERISTIC
/begin CHARACTERISTIC IP_FAC_DLY_P__MAF_KGH "weight factor for P-share regarding engine load and speed conditions" CURVE 0x47510 _REC_CUR_20_u2_u2 4. _CNV_A_R_LINEAR_____113_CM 0. 4. FORMAT "%6.4"
 /begin AXIS_DESCR COM_AXIS MAF_KGH _CNV_A_R_LINEAR_____101_CM 6 0. 2047.96875 FORMAT "%6.2" AXIS_PTS_REF ldp_maf_kgh_ip_fac_dly_p /end AXIS_DESCR
/end CHARACTERISTIC
/begin CHARACTERISTIC IP_MAF_LAM_DLY_I_MIN__N "min MAF threshold for calculation I-share-mean-value" CURVE 0x4908e _REC_CUR_20_u2_u1 1389. _CNV_A_R_LINEAR_____95_CM 0. 1389. FORMAT "%7.2"
 /begin AXIS_DESCR COM_AXIS N_32 _CNV_A_R_LINEAR_____5_CM 6 0. 8160. FORMAT "%4.0" AXIS_PTS_REF ldpm_n_32 /end AXIS_DESCR
/end CHARACTERISTIC
/begin CHARACTERISTIC IP_FAC_LAM_DLY__N__MAF "normalization factor for total LAM -P-jump delay time regarding engine load and speed conditions" MAP 0x4752c _REC_MAP_20_u2_u1_u1 3.999939 _CNV_A_R_LINEAR_____310_CM 0. 3.999939 FORMAT "%7.5"
 /begin AXIS_DESCR COM_AXIS N_32 _CNV_A_R_LINEAR_____5_CM 8 0. 8160. FORMAT "%4.0" AXIS_PTS_REF ldp_n_ip_fac_lam_dly /end AXIS_DESCR
 /begin AXIS_DESCR COM_AXIS MAF _CNV_A_R_LINEAR_____18_CM 8 0. 1389. FORMAT "%4.0" AXIS_PTS_REF ldp_maf_ip_fac_lam_dly /end AXIS_DESCR
/end CHARACTERISTIC
/begin CHARACTERISTIC IP_CRLC_DLY_I__MAF_KGH "correlation constant for I-share calculation" CURVE 0x4617e _REC_CUR_20_u2_u2 0.99998474 _CNV_A_R_LINEAR_____31_CM 0. 0.99998474 FORMAT "%7.5"
 /begin AXIS_DESCR COM_AXIS MAF_KGH _CNV_A_R_LINEAR_____101_CM 6 0. 2047.96875 FORMAT "%6.2" AXIS_PTS_REF ldp_maf_kgh_ip_crlc_dly_i /end AXIS_DESCR
/end CHARACTERISTIC
/begin CHARACTERISTIC IP_MAF_LAM_DLY_I_MAX__N "max MAF threshold for calculation I-share-mean-value" CURVE 0x49082 _REC_CUR_20_u2_u1 1389. _CNV_A_R_LINEAR_____95_CM 0. 1389. FORMAT "%7.2"
 /begin AXIS_DESCR COM_AXIS N_32 _CNV_A_R_LINEAR_____5_CM 6 0. 8160. FORMAT "%4.0" AXIS_PTS_REF ldpm_n_32 /end AXIS_DESCR
/end CHARACTERISTIC
/begin CHARACTERISTIC IP_VLS_SP_DLY__N__MAF "setpoint for downstream fuel trim controller" MAP 0x4c97c _REC_MAP_20_u2_u1_u1 4.99511719 _CNV_A_R_LINEAR_____33_CM 0. 4.99511719 FORMAT "%5.3"
 /begin AXIS_DESCR COM_AXIS N_32 _CNV_A_R_LINEAR_____5_CM 8 0. 8160. FORMAT "%4.0" AXIS_PTS_REF ldp_n_ip_vls_sp_dly /end AXIS_DESCR
 /begin AXIS_DESCR COM_AXIS MAF _CNV_A_R_LINEAR_____18_CM 8 0. 1389. FORMAT "%4.0" AXIS_PTS_REF ldp_maf_ip_vls_sp_dly /end AXIS_DESCR
/end CHARACTERISTIC
/begin CHARACTERISTIC IP_T_DLY_I_1__VLS_DIF_DLY "LAM - P - jump delay time from I-share" CURVE 0x4a684 _REC_CUR_20_u2_u2 1279.980469 _CNV_A_R_LINEAR_____312_CM -640. 639.980469 FORMAT "%5.2"
 /begin AXIS_DESCR COM_AXIS ONLINE_DUMMY _CNV_A_R_LINEAR_____313_CM 12 -4.99517 4.99517 FORMAT "%5.3" AXIS_PTS_REF ldpm_vls_dif_dly /end AXIS_DESCR
/end CHARACTERISTIC
/begin CHARACTERISTIC IP_T_DLY_I_2__VLS_DIF_DLY "LAM - P - jump delay time from I-share" CURVE 0x4a69c _REC_CUR_20_u2_u2 1279.980469 _CNV_A_R_LINEAR_____312_CM -640. 639.980469 FORMAT "%5.2"
 /begin AXIS_DESCR COM_AXIS ONLINE_DUMMY _CNV_A_R_LINEAR_____313_CM 12 -4.99517 4.99517 FORMAT "%5.3" AXIS_PTS_REF ldpm_vls_dif_dly /end AXIS_DESCR
/end CHARACTERISTIC
/begin CHARACTERISTIC C_CRLC_DLY_AD "correlation constant for AD-share calculation" VALUE 0x42c6e _REC_VAL_20_u2 0.99998474 _CNV_A_R_LINEAR_____31_CM 0. 0.99998474 FORMAT "%7.5" /end CHARACTERISTIC
/begin CHARACTERISTIC C_CRLC_DLY_I_MV "correlation constant for I-share mean value calculation" VALUE 0x42c70 _REC_VAL_20_u2 0.99998474 _CNV_A_R_LINEAR_____31_CM 0. 0.99998474 FORMAT "%7.5" /end CHARACTERISTIC
/begin CHARACTERISTIC IP_FAC_CAT_DLY_1__CAT_DIAG "weight factor for P-share regarding catalyst conversion capability" CURVE 0x473a0 _REC_CUR_20_u2_u1 0.99998474 _CNV_A_R_LINEAR_____31_CM 0. 0.99998474 FORMAT "%7.5"
 /begin AXIS_DESCR COM_AXIS ONLINE_DUMMY _CNV_A_R_LINEAR_____314_CM 6 0. 1.9968 FORMAT "%4.2" AXIS_PTS_REF ldpm_cat_ip_fac_cat_dly /end AXIS_DESCR
/end CHARACTERISTIC
/begin CHARACTERISTIC IP_FAC_CAT_DLY_2__CAT_DIAG "weight factor for P-share regarding catalyst conversion capability" CURVE 0x473ac _REC_CUR_20_u2_u1 0.99998474 _CNV_A_R_LINEAR_____31_CM 0. 0.99998474 FORMAT "%7.5"
 /begin AXIS_DESCR COM_AXIS ONLINE_DUMMY _CNV_A_R_LINEAR_____314_CM 6 0. 1.9968 FORMAT "%4.2" AXIS_PTS_REF ldpm_cat_ip_fac_cat_dly /end AXIS_DESCR
/end CHARACTERISTIC
/begin CHARACTERISTIC C_T_DLY_I_MV_UPD_CYC "update recurrence for I-share mean value" VALUE 0x429e0 _REC_VAL_20_u1 254. _CNV_A_R_LINEAR_____47_CM 1. 255. FORMAT "%3.0" /end CHARACTERISTIC
/begin CHARACTERISTIC IP_T_DLY_P_1__VLS_DIF_DLY "LAM - P - jump delay time from P-share" CURVE 0x4a6b4 _REC_CUR_20_u2_u2 1279.980469 _CNV_A_R_LINEAR_____312_CM -640. 639.980469 FORMAT "%5.2"
 /begin AXIS_DESCR COM_AXIS ONLINE_DUMMY _CNV_A_R_LINEAR_____313_CM 12 -4.99517 4.99517 FORMAT "%5.3" AXIS_PTS_REF ldpm_vls_dif_dly /end AXIS_DESCR
/end CHARACTERISTIC
/begin CHARACTERISTIC IP_T_DLY_P_2__VLS_DIF_DLY "LAM - P - jump delay time from P-share" CURVE 0x4a6cc _REC_CUR_20_u2_u2 1279.980469 _CNV_A_R_LINEAR_____312_CM -640. 639.980469 FORMAT "%5.2"
 /begin AXIS_DESCR COM_AXIS ONLINE_DUMMY _CNV_A_R_LINEAR_____313_CM 12 -4.99517 4.99517 FORMAT "%5.3" AXIS_PTS_REF ldpm_vls_dif_dly /end AXIS_DESCR
/end CHARACTERISTIC
/begin AXIS_PTS ldpm_n_32 "" 0x43ccc N_32 _REC_AXS_20_u1 8160. _CNV_A_R_LINEAR_____5_CM 6 0. 8160. FORMAT "%4.0" /end AXIS_PTS
/begin AXIS_PTS ldp_n_ip_vls_sp_dly "" 0x4376a N_32 _REC_AXS_20_u1 8160. _CNV_A_R_LINEAR_____5_CM 8 0. 8160. FORMAT "%4.0" /end AXIS_PTS
/begin AXIS_PTS ldp_maf_ip_vls_sp_dly "" 0x434a5 MAF _REC_AXS_20_u1 1389. _CNV_A_R_LINEAR_____18_CM 8 0. 1389. FORMAT "%4.0" /end AXIS_PTS
/begin AXIS_PTS ldp_n_ip_fac_lam_dly "" 0x43761 N_32 _REC_AXS_20_u1 8160. _CNV_A_R_LINEAR_____5_CM 8 0. 8160. FORMAT "%4.0" /end AXIS_PTS
/begin AXIS_PTS ldp_maf_ip_fac_lam_dly "" 0x43493 MAF _REC_AXS_20_u1 1389. _CNV_A_R_LINEAR_____18_CM 8 0. 1389. FORMAT "%4.0" /end AXIS_PTS
/begin AXIS_PTS ldp_maf_kgh_ip_fac_dly_p "" 0x4463e MAF_KGH _REC_AXS_20_u2 2047.96875 _CNV_A_R_LINEAR_____101_CM 6 0. 2047.96875 FORMAT "%6.2" /end AXIS_PTS
/begin AXIS_PTS ldpm_vls_dif_dly "" 0x45632 VLS_DIF_DLY _REC_AXS_20_u2 9.99034 _CNV_A_R_LINEAR_____313_CM 12 -4.99517 4.99517 FORMAT "%5.3" /end AXIS_PTS
/begin AXIS_PTS ldpm_cat_ip_fac_cat_dly "" 0x43b7f CAT_DIAG_1 _REC_AXS_20_u1 1.9968 _CNV_A_R_LINEAR_____314_CM 6 0. 1.9968 FORMAT "%4.2" /end AXIS_PTS
/begin AXIS_PTS ldp_maf_kgh_ip_crlc_dly_i "" 0x44630 MAF_KGH _REC_AXS_20_u2 2047.96875 _CNV_A_R_LINEAR_____101_CM 6 0. 2047.96875 FORMAT "%6.2" /end AXIS_PTS
/begin CHARACTERISTIC C_T_DLY_I_MIN "min limit of I-share" VALUE 0x432c4 _REC_VAL_20_s2 1279.9804688 _CNV_A_R_LINEAR_____278_CM -640. 639.9804688 FORMAT "%7.2" /end CHARACTERISTIC
/begin CHARACTERISTIC C_T_DLY_AD_MIN "min limit of adaptation value" VALUE 0x432c0 _REC_VAL_20_s2 1279.9804688 _CNV_A_R_LINEAR_____278_CM -640. 639.9804688 FORMAT "%7.2" /end CHARACTERISTIC
/begin CHARACTERISTIC C_T_DLY_I_MAX "max limit of I-share" VALUE 0x432c2 _REC_VAL_20_s2 1279.9804688 _CNV_A_R_LINEAR_____278_CM -640. 639.9804688 FORMAT "%7.2" /end CHARACTERISTIC
/begin CHARACTERISTIC C_T_DLY_AD_MAX "max limit of adaptation value" VALUE 0x432be _REC_VAL_20_s2 1279.9804688 _CNV_A_R_LINEAR_____278_CM -640. 639.9804688 FORMAT "%7.2" /end CHARACTERISTIC
/begin MEASUREMENT MAF_MMV_DLY "floating mean value for limited MAF" UWORD _CNV_A_R_LINEAR_____95_CM 1 100. 0. 1389. ECU_ADDRESS 0x3fcb90 FORMAT "%7.2" /end MEASUREMENT
/begin CHARACTERISTIC C_MAF_CRLC_DLY "floating mean value calculation MAF" VALUE 0x42e04 _REC_VAL_20_u2 0.99998474 _CNV_A_R_LINEAR_____31_CM 0. 0.99998474 FORMAT "%7.5" /end CHARACTERISTIC
/begin CHARACTERISTIC C_LAM_MV_CRLC_DLY "floating mean value calculation lambda " VALUE 0x42dbc _REC_VAL_20_u2 0.99998474 _CNV_A_R_LINEAR_____31_CM 0. 0.99998474 FORMAT "%7.5" /end CHARACTERISTIC
/begin CHARACTERISTIC C_N_DYW_DLY "threshold limited dynamic engine speed" VALUE 0x42eae _REC_VAL_20_u2 8159. _CNV_A_R_LINEAR_____17_CM 1. 8160. FORMAT "%4.0" /end CHARACTERISTIC
/begin CHARACTERISTIC C_MAF_DYW_DLY "threshold limited dynamic engine MAF " VALUE 0x42e14 _REC_VAL_20_u2 1389. _CNV_A_R_LINEAR_____95_CM 0. 1389. FORMAT "%7.2" /end CHARACTERISTIC
/begin CHARACTERISTIC C_LAM_MV_DYW_DLY "threshold limited dynamic lambda " VALUE 0x42dc2 _REC_VAL_20_u2 99.99847412 _CNV_A_R_LINEAR_____94_CM 0. 99.99847412 /end CHARACTERISTIC
/begin MEASUREMENT N_MMV_DLY "floating mean value for limited engine speed" UWORD _CNV_A_R_LINEAR_____17_CM 1 100. 0. 8160. ECU_ADDRESS 0x3fcb8e FORMAT "%4.0" /end MEASUREMENT
/begin MEASUREMENT LV_N_LDC_DLY "status limited dynamic N" UBYTE _CNV_S_2_RANGE______28_CM 1 100. 0. 1. ECU_ADDRESS 0x3fcb92 /end MEASUREMENT
/begin MEASUREMENT LV_MAF_LDC_DLY "status limited dynamic MAF" UBYTE _CNV_S_2_RANGE______28_CM 1 100. 0. 1. ECU_ADDRESS 0x3fcb93 /end MEASUREMENT
/begin CHARACTERISTIC C_N_CRLC_DLY "floating mean value calculation engine speed" VALUE 0x42e9a _REC_VAL_20_u2 0.99998474 _CNV_A_R_LINEAR_____31_CM 0. 0.99998474 FORMAT "%7.5" /end CHARACTERISTIC
/begin CHARACTERISTIC C_PV_AV_GRD_DEC_DLY "decrement for calculation PV_AV gradient" VALUE 0x42985 _REC_VAL_20_u1 2490.234 _CNV_A_R_LINEAR_____315_CM 0. 2490.234 FORMAT "%6.1" /end CHARACTERISTIC
/begin CHARACTERISTIC C_PV_AV_GRD_SUM_MAX_DLY "max. threshold limited dynamic PV_AV gradient" VALUE 0x42f06 _REC_VAL_20_u2 639990.2340000001 _CNV_A_R_LINEAR_____304_CM 0. 639990.2340000001 FORMAT "%8.1" /end CHARACTERISTIC
/begin CHARACTERISTIC C_PV_AV_GRD_SUM_MIN_DLY "min. threshold limited dynamic PV_AV gradient" VALUE 0x42f0a _REC_VAL_20_u2 639990.2340000001 _CNV_A_R_LINEAR_____304_CM 0. 639990.2340000001 FORMAT "%8.1" /end CHARACTERISTIC
/begin CHARACTERISTIC C_T_PV_AV_GRD_DEC_SUM_DLY "time periods for calculation limited dynamic PV_AV gradient" VALUE 0x42a28 _REC_VAL_20_u1 5.1 _CNV_A_R_LINEAR_____169_CM 0. 5.1 FORMAT "%4.2" /end CHARACTERISTIC
/begin CHARACTERISTIC C_TEMP_CUR_ON_LS_DOWN "Temperature threshold for the activation of sensor pumping" VALUE 0x43080 _REC_VAL_20_u2 2047. _CNV_A_R_LINEAR_____211_CM 0. 2047. FORMAT "%7.2" /end CHARACTERISTIC
/begin CHARACTERISTIC C_T_CUR_ON_LS_DOWN "Duration for pump current active" VALUE 0x429c9 _REC_VAL_20_u1 8.e-003 _CNV_A_R_LINEAR_____319_CM 0. 8.e-003 FORMAT "%4.3" /end CHARACTERISTIC
/begin CHARACTERISTIC C_T_CUR_OFF_LS_DOWN "Minimum delay between consecutive pump current activation" VALUE 0x42f6c _REC_VAL_20_u2 655.35 _CNV_A_R_LINEAR_____27_CM 0. 655.35 FORMAT "%6.2" /end CHARACTERISTIC
/begin CHARACTERISTIC C_T_CUR_DLY_LS_DOWN "Duration in which VLS_DOWN_i signal masked directly after Ri determination" VALUE 0x429c7 _REC_VAL_20_u1 0.255 _CNV_A_R_LINEAR_____319_CM 0. 0.255 FORMAT "%5.3" /end CHARACTERISTIC
/begin CHARACTERISTIC C_VLS_MMV_MIN_RNG_TOL_LS_DOWN "Permitted range of VLS_DOWN_i above VLS_DOWN_MMV_MIN_i at low gradient for Ri determination" VALUE 0x431aa _REC_VAL_20_u2 4.99992371 _CNV_A_R_LINEAR_____256_CM 0. 4.99992371 FORMAT "%7.5" /end CHARACTERISTIC
/begin CHARACTERISTIC C_VLS_MMV_MIN_RNG_BOL_LS_DOWN "Permitted range of VLS_DOWN_i below VLS_DOWN_MMV_MIN_i at low gradient for Ri determination" VALUE 0x431a6 _REC_VAL_20_u2 4.99992371 _CNV_A_R_LINEAR_____256_CM 0. 4.99992371 FORMAT "%7.5" /end CHARACTERISTIC
/begin CHARACTERISTIC C_DRV1_VLS_DOWN_MMV_THD_MIN "Minimum threshold for mean 1st derivative of VLS_DOWN_i signal for Ri determination" VALUE 0x4323e _REC_VAL_20_s2 4.9999 _CNV_A_R_LINEAR_____282_CM -2.5 2.4999 FORMAT "%7.4" /end CHARACTERISTIC
/begin CHARACTERISTIC C_DRV1_VLS_DOWN_MMV_THD_MAX "Maximum threshold for mean 1st derivative of VLS_DOWN_i signal for Ri determination" VALUE 0x4323c _REC_VAL_20_s2 4.9999 _CNV_A_R_LINEAR_____282_CM -2.5 2.4999 FORMAT "%7.4" /end CHARACTERISTIC
/begin CHARACTERISTIC C_FAC_STK_DRV1_VLS_DOWN_MMV "Multiplicative factor used to weight gradient thresholds dependent on VLS_DOWN_MMV_xxx_i amplitude" VALUE 0x428b8 _REC_VAL_20_u1 1.99220002 _CNV_A_R_LINEAR_____34_CM 0. 1.99220002 FORMAT "%5.3" /end CHARACTERISTIC
/begin CHARACTERISTIC C_FAC_DRV1_VLS_DOWN_MMV_MIN "Hysteresis factor of DRV1_VLS_DOWN_MMV_MIN governing limiting of DRV1_VLS_DOWN_MMV_MIN_THD" VALUE 0x428a1 _REC_VAL_20_u1 0.99610001 _CNV_A_R_LINEAR_____20_CM 0. 0.99610001 FORMAT "%5.3" /end CHARACTERISTIC
/begin CHARACTERISTIC C_DRV1_VLS_DOWN_ABS_MAX "Threshold for absolute maximum 1st derivative of VLS_DOWN_i signal for Ri determination" VALUE 0x42ccc _REC_VAL_20_u2 4.9999237 _CNV_A_R_LINEAR_____283_CM 0. 4.9999237 FORMAT "%6.4" /end CHARACTERISTIC
/begin CHARACTERISTIC C_CTR_VLS_AFL_CYC_R_DOWN_LS "Min. no. AF cycles post lambda controller activation to permit use of T_VLS_CYC_AFL_HLD dependency" VALUE 0x42c9e _REC_VAL_20_u2 65535. _CNV_A_R_LINEAR_____10_CM 0. 65535. FORMAT "%5.0" /end CHARACTERISTIC
/begin CHARACTERISTIC C_MAF_KGH_R_DOWN_LS "Maximum MAF_KGH threshold for activation of internal resistance determination" VALUE 0x42e60 _REC_VAL_20_u2 2047.96875 _CNV_A_R_LINEAR_____101_CM 0. 2047.96875 FORMAT "%7.2" /end CHARACTERISTIC
/begin CHARACTERISTIC C_FAC_ERR_POS_R_DOWN_LS "Internal resistance measurement positive error (i.e. 0% to 100%)" VALUE 0x428a8 _REC_VAL_20_u1 0.9960940000000002 _CNV_A_R_LINEAR_____44_CM 0. 0.996094 FORMAT "%5.3" /end CHARACTERISTIC
/begin CHARACTERISTIC C_FAC_ERR_NEG_R_DOWN_LS "Internal resistance measurement negative error (i.e. 100% to 0%)" VALUE 0x428a6 _REC_VAL_20_u1 0.9960940000000002 _CNV_A_R_LINEAR_____44_CM 0. 0.996094 FORMAT "%5.3" /end CHARACTERISTIC
/begin CHARACTERISTIC C_CRLC_TTIP_FALL_R_DOWN_LS "Correlation (filter) constant for falling ceramic temperature, limit calculation" VALUE 0x42841 _REC_VAL_20_u1 0.99610001 _CNV_A_R_LINEAR_____320_CM 0. 0.99610001 FORMAT "%5.3" /end CHARACTERISTIC
/begin CHARACTERISTIC C_CRLC_TTIP_RISE_R_DOWN_LS "Correlation (filter) constant for rising ceramic temperature, limit calculation" VALUE 0x42843 _REC_VAL_20_u1 0.99610001 _CNV_A_R_LINEAR_____320_CM 0. 0.99610001 FORMAT "%5.3" /end CHARACTERISTIC
/begin CHARACTERISTIC LC_INH_R_DOWN_LS_VLD "Boolean flag inhibiting internal resistance determination validity function" VALUE 0x42b9b _REC_VAL_20_u1 1. _CNV_A_R_LINEAR_____10_CM 0. 1. FORMAT "%2.0" /end CHARACTERISTIC
/begin CHARACTERISTIC IP_FAC_T_DRV1_VLS_DOWN_ABS "Multiplicative factor modifies C_DRV1_VLS_DOWN_ABS_MAX dependent on T_VLS_CYC_AFL_HLD" CURVE 0x4e4fd _REC_CUR_20_u1_u1 15.9375 _CNV_A_R_LINEAR_____40_CM 0. 15.9375 FORMAT "%5.2"
 /begin AXIS_DESCR COM_AXIS LAM_BANK_1.LS_UP_STRUCT.T_VLS_CYC_AFL_HLD _CNV_A_R_LINEAR_____27_CM 8 0. 2.55 FORMAT "%4.2" AXIS_PTS_REF ldpm_t_vls_cyc_afl_hld /end AXIS_DESCR
/end CHARACTERISTIC
/begin CHARACTERISTIC IP_TTIP_LS_DOWN "Oxygen sensor temperature vs. internal resistance characteristic" CURVE 0x4c944 _REC_CUR_20_u2_u2 2047.96875 _CNV_A_R_LINEAR_____321_CM 0. 2047.96875 FORMAT "%7.2"
 /begin AXIS_DESCR COM_AXIS LAM_BANK_1.LS_DOWN_CUR_STRUCT.R_DOWN_LS _CNV_A_R_LINEAR_____285_CM 8 0. 65535. FORMAT "%5.0" AXIS_PTS_REF ldp_r_down_ls_ip_ttip_ls_down /end AXIS_DESCR
/end CHARACTERISTIC
/begin CHARACTERISTIC IP_FAC_T_DRV1_VLS_DOWN_MMV "Multiplicative factor modifies DRV1_VLS_DOWN_MMV_MIN_THD dependent on T_VLS_CYC_AFL_HLD" CURVE 0x4e505 _REC_CUR_20_u1_u1 63.75 _CNV_A_R_LINEAR_____284_CM 0. 63.75 FORMAT "%4.1"
 /begin AXIS_DESCR COM_AXIS LAM_BANK_1.LS_UP_STRUCT.T_VLS_CYC_AFL_HLD _CNV_A_R_LINEAR_____27_CM 8 0. 2.55 FORMAT "%4.2" AXIS_PTS_REF ldpm_t_vls_cyc_afl_hld /end AXIS_DESCR
/end CHARACTERISTIC
/begin AXIS_PTS ldp_r_down_ls_ip_ttip_ls_down "" 0x44a04 R_DOWN_LS _REC_AXS_20_u2 65535. _CNV_A_R_LINEAR_____285_CM 8 0. 65535. FORMAT "%5.0" /end AXIS_PTS
/begin CHARACTERISTIC C_T_CUR_DLY_LS_UP "Duration in which VLS_UP_i signal masked directly after Ri determination" VALUE 0x429c8 _REC_VAL_20_u1 0.255 _CNV_A_R_LINEAR_____319_CM 0. 0.255 FORMAT "%5.3" /end CHARACTERISTIC
/begin CHARACTERISTIC C_T_CUR_ON_LS_UP "Pulse duration for pump current" VALUE 0x429ca _REC_VAL_20_u1 8.e-003 _CNV_A_R_LINEAR_____319_CM 0. 8.e-003 FORMAT "%4.3" /end CHARACTERISTIC
/begin CHARACTERISTIC C_T_CUR_OFF_LS_UP "Pulse off time for pump current" VALUE 0x42f6e _REC_VAL_20_u2 655.35 _CNV_A_R_LINEAR_____27_CM 0. 655.35 FORMAT "%6.2" /end CHARACTERISTIC
/begin CHARACTERISTIC C_VLS_MMV_MIN_RNG_TOL_LS_UP "Permitted range of VLS_UP_i above VLS_MMV_MIN_i at low gradient for Ri determination" VALUE 0x431ac _REC_VAL_20_u2 4.99992371 _CNV_A_R_LINEAR_____256_CM 0. 4.99992371 FORMAT "%7.5" /end CHARACTERISTIC
/begin CHARACTERISTIC C_VLS_MMV_MIN_RNG_BOL_LS_UP "Permitted range of VLS_UP_i below VLS_MMV_MIN_i at low gradient for Ri determination" VALUE 0x431a8 _REC_VAL_20_u2 4.99992371 _CNV_A_R_LINEAR_____256_CM 0. 4.99992371 FORMAT "%7.5" /end CHARACTERISTIC
/begin CHARACTERISTIC C_DRV1_VLS_UP_MMV_THD_MIN "Minimum threshold for mean 1st derivative of VLS_UP_i signal for Ri determination" VALUE 0x43242 _REC_VAL_20_s2 4.9999 _CNV_A_R_LINEAR_____282_CM -2.5 2.4999 FORMAT "%7.4" /end CHARACTERISTIC
/begin CHARACTERISTIC C_DRV1_VLS_UP_MMV_THD_MAX "Maximum threshold for mean 1st derivative of VLS_UP_i signal for Ri determination" VALUE 0x43240 _REC_VAL_20_s2 4.9999 _CNV_A_R_LINEAR_____282_CM -2.5 2.4999 FORMAT "%7.4" /end CHARACTERISTIC
/begin CHARACTERISTIC C_FAC_STK_DRV1_VLS_UP_MMV "Multiplicative factor used to weight gradient thresholds dependent on VLS_MMV_xxx_i amplitude" VALUE 0x428b9 _REC_VAL_20_u1 1.99220002 _CNV_A_R_LINEAR_____34_CM 0. 1.99220002 FORMAT "%5.3" /end CHARACTERISTIC
/begin CHARACTERISTIC C_FAC_DRV1_VLS_UP_MMV_MIN "Hysteresis factor of DRV1_VLS_UP_MMV_MIN governing limiting of DRV1_VLS_UP_MMV_MIN_THD" VALUE 0x428a2 _REC_VAL_20_u1 0.99610001 _CNV_A_R_LINEAR_____20_CM 0. 0.99610001 FORMAT "%5.3" /end CHARACTERISTIC
/begin CHARACTERISTIC C_CTR_VLS_AFL_CYC_R_UP_LS "Min. no. AF cycles post lambda controller activation to permit use of T_VLS_CYC_AFL_HLD dependency" VALUE 0x42ca0 _REC_VAL_20_u2 65535. _CNV_A_R_LINEAR_____10_CM 0. 65535. FORMAT "%5.0" /end CHARACTERISTIC
/begin CHARACTERISTIC C_MAF_KGH_R_UP_LS "Maximum MAF_KGH threshold for activation of internal resistance determination" VALUE 0x42e62 _REC_VAL_20_u2 2047.96875 _CNV_A_R_LINEAR_____101_CM 0. 2047.96875 FORMAT "%7.2" /end CHARACTERISTIC
/begin CHARACTERISTIC C_FAC_ERR_POS_R_UP_LS "Internal resistance measurement positive error (i.e. 0% to 100%)" VALUE 0x428a9 _REC_VAL_20_u1 0.9960940000000002 _CNV_A_R_LINEAR_____44_CM 0. 0.996094 FORMAT "%5.3" /end CHARACTERISTIC
/begin CHARACTERISTIC C_FAC_ERR_NEG_R_UP_LS "Internal resistance measurement negative error (i.e. 100% to 0%)" VALUE 0x428a7 _REC_VAL_20_u1 0.9960940000000002 _CNV_A_R_LINEAR_____44_CM 0. 0.996094 FORMAT "%5.3" /end CHARACTERISTIC
/begin CHARACTERISTIC C_CRLC_TTIP_FALL_R_UP_LS "Correlation (filter) constant for falling ceramic temperature, limit calculation" VALUE 0x42842 _REC_VAL_20_u1 0.99610001 _CNV_A_R_LINEAR_____320_CM 0. 0.99610001 FORMAT "%5.3" /end CHARACTERISTIC
/begin CHARACTERISTIC C_CRLC_TTIP_RISE_R_UP_LS "Correlation (filter) constant for rising ceramic temperature, limit calculation" VALUE 0x42844 _REC_VAL_20_u1 0.99610001 _CNV_A_R_LINEAR_____320_CM 0. 0.99610001 FORMAT "%5.3" /end CHARACTERISTIC
/begin CHARACTERISTIC LC_INH_R_UP_LS_VLD "Boolean flag inhibiting internal resistance determination validity function" VALUE 0x42b9c _REC_VAL_20_u1 1. _CNV_A_R_LINEAR_____12_CM 0. 1. FORMAT "%1.0" /end CHARACTERISTIC
/begin CHARACTERISTIC C_TEMP_CUR_ON_LS_UP "Temperature threshold for the activation of sensor pumping" VALUE 0x43082 _REC_VAL_20_u2 2047. _CNV_A_R_LINEAR_____211_CM 0. 2047. FORMAT "%7.2" /end CHARACTERISTIC
/begin CHARACTERISTIC IP_FAC_T_DRV1_VLS_UP_MMV "Multiplicative factor modifies DRV1_VLS_UP_MMV_MIN_THD dependent on T_VLS_CYC_AFL_HLD" CURVE 0x4e515 _REC_CUR_20_u1_u1 63.75 _CNV_A_R_LINEAR_____284_CM 0. 63.75 FORMAT "%4.1"
 /begin AXIS_DESCR COM_AXIS LAM_BANK_1.LS_UP_STRUCT.T_VLS_CYC_AFL_HLD _CNV_A_R_LINEAR_____27_CM 8 0. 2.55 FORMAT "%4.2" AXIS_PTS_REF ldpm_t_vls_cyc_afl_hld /end AXIS_DESCR
/end CHARACTERISTIC
/begin CHARACTERISTIC IP_FAC_T_DRV1_VLS_UP_ABS "Multiplicative factor modifies C_DRV1_VLS_UP_ABS_MAX dependent on T_VLS_CYC_AFL_HLD" CURVE 0x4e50d _REC_CUR_20_u1_u1 15.9375 _CNV_A_R_LINEAR_____40_CM 0. 15.9375 FORMAT "%5.2"
 /begin AXIS_DESCR COM_AXIS LAM_BANK_1.LS_UP_STRUCT.T_VLS_CYC_AFL_HLD _CNV_A_R_LINEAR_____27_CM 8 0. 2.55 FORMAT "%4.2" AXIS_PTS_REF ldpm_t_vls_cyc_afl_hld /end AXIS_DESCR
/end CHARACTERISTIC
/begin CHARACTERISTIC C_DRV1_VLS_UP_ABS_MAX "Threshold for absolute maximum 1st derivative of VLS_UP_i signal for Ri determination" VALUE 0x42cce _REC_VAL_20_u2 4.9999237 _CNV_A_R_LINEAR_____283_CM 0. 4.9999237 FORMAT "%6.4" /end CHARACTERISTIC
/begin CHARACTERISTIC IP_TTIP_LS_UP "Oxygen sensor temperature vs. internal resistance characteristic" CURVE 0x4c954 _REC_CUR_20_u2_u2 2047.96875 _CNV_A_R_LINEAR_____321_CM 0. 2047.96875 FORMAT "%7.2"
 /begin AXIS_DESCR COM_AXIS LAM_BANK_1.LS_UP_CUR_STRUCT.R_UP_LS _CNV_A_R_LINEAR_____285_CM 8 0. 65535. FORMAT "%5.0" AXIS_PTS_REF ldp_r_up_ls_ip_ttip_ls_up /end AXIS_DESCR
/end CHARACTERISTIC
/begin AXIS_PTS ldp_r_up_ls_ip_ttip_ls_up "" 0x44a16 R_UP_LS _REC_AXS_20_u2 65535. _CNV_A_R_LINEAR_____285_CM 8 0. 65535. FORMAT "%5.0" /end AXIS_PTS
/begin CHARACTERISTIC C_MAF_INT_PUC_MAX_DOWN_LS_READY "Maximum MAF integral during PUC for operability reset\n" VALUE 0x42e3e _REC_VAL_20_u2 1820.4167 _CNV_A_R_LINEAR_____322_CM 0. 1820.4167 FORMAT "%9.4" /end CHARACTERISTIC
/begin CHARACTERISTIC C_VLS_DOWN_AFL_READY "Lean VLS_xxxx_i threshold for operative readiness detection" VALUE 0x4317e _REC_VAL_20_u2 4.99511719 _CNV_A_R_LINEAR_____33_CM 0. 4.99511719 FORMAT "%5.3" /end CHARACTERISTIC
/begin CHARACTERISTIC C_VLS_DOWN_AFR_READY "Rich VLS_xxxx_i threshold for operative readiness detection" VALUE 0x43182 _REC_VAL_20_u2 4.99511719 _CNV_A_R_LINEAR_____33_CM 0. 4.99511719 FORMAT "%5.3" /end CHARACTERISTIC
/begin CHARACTERISTIC C_VLS_AFL_READY "Lean VLS_xxxx_i threshold for operative readiness detection" VALUE 0x43166 _REC_VAL_20_u2 4.99511719 _CNV_A_R_LINEAR_____33_CM 0. 4.99511719 FORMAT "%5.3" /end CHARACTERISTIC
/begin CHARACTERISTIC C_VLS_AFR_READY "Rich VLS_xxxx_i threshold for operative readiness detection" VALUE 0x43170 _REC_VAL_20_u2 4.99511719 _CNV_A_R_LINEAR_____33_CM 0. 4.99511719 FORMAT "%5.3" /end CHARACTERISTIC
/begin CHARACTERISTIC C_VLS_DOWN_MMV_HYS_MIN "Minimum hysteresis for the computation of the thresholds VLS_DOWN_TOL_i and VLS_DOWN_BOL_i" VALUE 0x43198 _REC_VAL_20_u2 1. _CNV_A_R_LINEAR_____281_CM 0. 1. FORMAT "%7.5" /end CHARACTERISTIC
/begin CHARACTERISTIC C_VLS_DOWN_INI_MIN "Lower initialisation value for VLS_DOWN_TOL_i. VLS_DOWN_MMV_MIN_i" VALUE 0x43190 _REC_VAL_20_u2 4.99511719 _CNV_A_R_LINEAR_____33_CM 0. 4.99511719 FORMAT "%5.3" /end CHARACTERISTIC
/begin CHARACTERISTIC C_VLS_DOWN_INI_MAX "Upper initialisation value for VLS_DOWN_BOL_i. VLS_DOWN_MMV_MAX_i" VALUE 0x4318e _REC_VAL_20_u2 4.99511719 _CNV_A_R_LINEAR_____33_CM 0. 4.99511719 FORMAT "%5.3" /end CHARACTERISTIC
/begin CHARACTERISTIC C_VLS_DOWN_CRLC "Filter constant for determination of VLS_DOWN_MMV_xxx_i values when respective threshold passed" VALUE 0x43184 _REC_VAL_20_u2 0.99998474 _CNV_A_R_LINEAR_____323_CM 0. 0.99998474 FORMAT "%7.5" /end CHARACTERISTIC
/begin CHARACTERISTIC C_VLS_DOWN_CRLC_OFF "Filter constant for determination of VLS_DOWN_MMV_xxx_i values when respective threshold not passed" VALUE 0x43186 _REC_VAL_20_u2 0.99998474 _CNV_A_R_LINEAR_____323_CM 0. 0.99998474 FORMAT "%7.5" /end CHARACTERISTIC
/begin CHARACTERISTIC C_FAC_VLS_DOWN_MMV_HYS "Multiplicative factor governing amplitude of hysteresis" VALUE 0x428c2 _REC_VAL_20_u1 0.99610001 _CNV_A_R_LINEAR_____324_CM 0. 0.99610001 FORMAT "%5.3" /end CHARACTERISTIC
/begin CHARACTERISTIC C_T_DLY_PUC_END_VLS_DOWN "Delay between completion of engine state PUC and computation of VLS_DOWN_MMV_xxx_i" VALUE 0x429f2 _REC_VAL_20_u1 25.5 _CNV_A_R_LINEAR_____14_CM 0. 25.5 FORMAT "%4.1" /end CHARACTERISTIC
/begin CHARACTERISTIC IP_T_LSH_TEMP_THD "Duration until critical water splash sensor temperature reached" CURVE 0x506f0 _REC_CUR_20_u1_u2 25.5 _CNV_A_R_LINEAR_____14_CM 0. 25.5 FORMAT "%4.1"
 /begin AXIS_DESCR COM_AXIS ONLINE_DUMMY _CNV_A_R_LINEAR_____326_CM 6 -2048. 2047.938 FORMAT "%8.2" AXIS_PTS_REF ldpm_temp_ls_ini_1_egcp /end AXIS_DESCR
/end CHARACTERISTIC
/begin CHARACTERISTIC IP_FAC_NEG_P_LSH_UP_CTL "Closed loop controller P-term factor for temperature too high; decrease heater voltage" MAP 0x4e2cf _REC_MAP_20_u1_u1_u2 0.255 _CNV_A_R_LINEAR_____327_CM 0. 0.255 FORMAT "%5.3"
 /begin AXIS_DESCR COM_AXIS N_32 _CNV_A_R_LINEAR_____5_CM 6 0. 8160. FORMAT "%4.0" AXIS_PTS_REF ldpm_n_32_1_egcp /end AXIS_DESCR
 /begin AXIS_DESCR COM_AXIS TEG_CAT_UP_MDL_MAX _CNV_A_R_LINEAR_____211_CM 6 0. 2047. FORMAT "%7.2" AXIS_PTS_REF ldpm_teg_cat_up_mdl_1_egcp /end AXIS_DESCR
/end CHARACTERISTIC
/begin CHARACTERISTIC IP_FAC_POS_P_LSH_UP_CTL "Closed loop controller P-term factor for temperature too low; increase heater voltage" MAP 0x4e33b _REC_MAP_20_u1_u1_u2 0.255 _CNV_A_R_LINEAR_____327_CM 0. 0.255 FORMAT "%5.3"
 /begin AXIS_DESCR COM_AXIS N_32 _CNV_A_R_LINEAR_____5_CM 6 0. 8160. FORMAT "%4.0" AXIS_PTS_REF ldpm_n_32_1_egcp /end AXIS_DESCR
 /begin AXIS_DESCR COM_AXIS TEG_CAT_UP_MDL_MAX _CNV_A_R_LINEAR_____211_CM 6 0. 2047. FORMAT "%7.2" AXIS_PTS_REF ldpm_teg_cat_up_mdl_1_egcp /end AXIS_DESCR
/end CHARACTERISTIC
/begin CHARACTERISTIC IP_FAC_NEG_I_LSH_UP_CTL "Closed loop controller I-term factor for temperature too high; decrease heater voltage" MAP 0x4e2ab _REC_MAP_20_u1_u1_u2 0.255 _CNV_A_R_LINEAR_____327_CM 0. 0.255 FORMAT "%5.3"
 /begin AXIS_DESCR COM_AXIS N_32 _CNV_A_R_LINEAR_____5_CM 6 0. 8160. FORMAT "%4.0" AXIS_PTS_REF ldpm_n_32_1_egcp /end AXIS_DESCR
 /begin AXIS_DESCR COM_AXIS TEG_CAT_UP_MDL_MAX _CNV_A_R_LINEAR_____211_CM 6 0. 2047. FORMAT "%7.2" AXIS_PTS_REF ldpm_teg_cat_up_mdl_1_egcp /end AXIS_DESCR
/end CHARACTERISTIC
/begin CHARACTERISTIC IP_FAC_POS_I_LSH_UP_CTL "Closed loop controller I-term factor for temperature too low; increase heater voltage" MAP 0x4e317 _REC_MAP_20_u1_u1_u2 0.255 _CNV_A_R_LINEAR_____327_CM 0. 0.255 FORMAT "%5.3"
 /begin AXIS_DESCR COM_AXIS N_32 _CNV_A_R_LINEAR_____5_CM 6 0. 8160. FORMAT "%4.0" AXIS_PTS_REF ldpm_n_32_1_egcp /end AXIS_DESCR
 /begin AXIS_DESCR COM_AXIS TEG_CAT_UP_MDL_MAX _CNV_A_R_LINEAR_____211_CM 6 0. 2047. FORMAT "%7.2" AXIS_PTS_REF ldpm_teg_cat_up_mdl_1_egcp /end AXIS_DESCR
/end CHARACTERISTIC
/begin CHARACTERISTIC IP_FAC_V_EFC_TEG "Coorection factor for the assumtion of the heat transfer exclusive for bank 2" CURVE 0x4e7c9 _REC_CUR_20_u1_u1 3.984375 _CNV_A_R_LINEAR_____195_CM 0. 3.984375 FORMAT "%4.2"
 /begin AXIS_DESCR COM_AXIS VS _CNV_A_R_LINEAR_____13_CM 6 0. 255. FORMAT "%3.0" AXIS_PTS_REF ldp_vs_fac_v_efc_teg /end AXIS_DESCR
/end CHARACTERISTIC
/begin CHARACTERISTIC C_V_EFC_LSH_UP_TOL "voltage threshold to the higher voltage range of the heater" VALUE 0x42aeb _REC_VAL_20_u1 25.8984 _CNV_A_R_LINEAR_____26_CM 0. 25.8984 FORMAT "%3.1" /end CHARACTERISTIC
/begin CHARACTERISTIC C_V_EFC_RED "Reduced heater voltage during danger of water splash damage" VALUE 0x42aec _REC_VAL_20_u1 25.8984 _CNV_A_R_LINEAR_____26_CM 0. 25.8984 FORMAT "%3.1" /end CHARACTERISTIC
/begin CHARACTERISTIC C_V_EFC_LSH_UP_PROT "heater voltage in the case of overvoltage conditions" VALUE 0x42aea _REC_VAL_20_u1 25.8984 _CNV_A_R_LINEAR_____26_CM 0. 25.8984 FORMAT "%3.1" /end CHARACTERISTIC
/begin CHARACTERISTIC C_T_LSH_UP_TOL "maximum of the tolerable heating time with in a higher voltage range " VALUE 0x42a05 _REC_VAL_20_u1 25.5 _CNV_A_R_LINEAR_____14_CM 0. 25.5 FORMAT "%4.1" /end CHARACTERISTIC
/begin CHARACTERISTIC C_V_EFC_LSH_UP_LIM "limited voltage range of the heater" VALUE 0x42ae7 _REC_VAL_20_u1 25.8984 _CNV_A_R_LINEAR_____26_CM 0. 25.8984 FORMAT "%3.1" /end CHARACTERISTIC
/begin CHARACTERISTIC C_VB_PROT_MAX "maximum battery voltage threshold for the detection of overvoltage" VALUE 0x42b17 _REC_VAL_20_u1 25.8984 _CNV_A_R_LINEAR_____26_CM 0. 25.8984 FORMAT "%3.1" /end CHARACTERISTIC
/begin CHARACTERISTIC C_T_LSH_RISE "Total heating time with increasing heater power" VALUE 0x42a02 _REC_VAL_20_u1 25.5 _CNV_A_R_LINEAR_____14_CM 0. 25.5 FORMAT "%4.1" /end CHARACTERISTIC
/begin CHARACTERISTIC C_INC_V_EFC "Heater voltage increment to raise temperature" VALUE 0x428ea _REC_VAL_20_u1 1.625 _CNV_A_R_LINEAR_____328_CM 0. 1.625 FORMAT "%5.3" /end CHARACTERISTIC
/begin CHARACTERISTIC C_FAC_V_EFC_LSH_UP_AS "Multiplicative correction factor to effective heater voltage" VALUE 0x428bf _REC_VAL_20_u1 1.9921875 _CNV_A_R_LINEAR_____103_CM 0. 1.9921875 FORMAT "%5.3" /end CHARACTERISTIC
/begin CHARACTERISTIC C_DEC_V_EFC "Heater voltage decrement to lower temperature" VALUE 0x42879 _REC_VAL_20_u1 1.625 _CNV_A_R_LINEAR_____328_CM 0. 1.625 FORMAT "%5.3" /end CHARACTERISTIC
/begin CHARACTERISTIC IP_V_EFC_LSH_UP_INI "Initial effective heater voltage" CURVE 0x50d35 _REC_CUR_20_u1_u2 25.8984 _CNV_A_R_LINEAR_____26_CM 0. 25.8984 FORMAT "%3.1"
 /begin AXIS_DESCR COM_AXIS ONLINE_DUMMY _CNV_A_R_LINEAR_____326_CM 6 -2048. 2047.938 FORMAT "%8.2" AXIS_PTS_REF ldpm_temp_ls_ini_1_egcp /end AXIS_DESCR
/end CHARACTERISTIC
/begin CHARACTERISTIC C_V_EFC_LSH_UP_STEP "Additional effective heater voltage step on transition from LSH_POW_RED to LSH_POW_RISE" VALUE 0x43361 _REC_VAL_20_s1 26. _CNV_A_R_LINEAR_____298_CM -13.05 12.95 FORMAT "%5.1" /end CHARACTERISTIC
/begin CHARACTERISTIC C_V_EFC_LSH_UP_AS "Effective heater voltage calibration system additive factor" VALUE 0x43360 _REC_VAL_20_s1 26. _CNV_A_R_LINEAR_____298_CM -13.05 12.95 FORMAT "%5.1" /end CHARACTERISTIC
/begin CHARACTERISTIC C_T_LSH_UP_LIM "time after a heating phase with a higher voltage range" VALUE 0x42a03 _REC_VAL_20_u1 25.5 _CNV_A_R_LINEAR_____14_CM 0. 25.5 FORMAT "%4.1" /end CHARACTERISTIC
/begin CHARACTERISTIC C_T_LSH_UP_MAX_STEP "time after at which step in max effective heater voltage applied" VALUE 0x42a04 _REC_VAL_20_u1 25.5 _CNV_A_R_LINEAR_____14_CM 0. 25.5 FORMAT "%4.1" /end CHARACTERISTIC
/begin CHARACTERISTIC C_V_EFC_LSH_UP_MAX "maximum allowed heater voltage " VALUE 0x42ae8 _REC_VAL_20_u1 25.8984 _CNV_A_R_LINEAR_____26_CM 0. 25.8984 FORMAT "%3.1" /end CHARACTERISTIC
/begin CHARACTERISTIC C_V_EFC_LSH_UP_MAX_ST "absolute maximum permitted effective heater voltage during initial phase; threshold & limit" VALUE 0x42ae9 _REC_VAL_20_u1 25.8984 _CNV_A_R_LINEAR_____26_CM 0. 25.8984 FORMAT "%3.1" /end CHARACTERISTIC
/begin CHARACTERISTIC C_TTIP_LS_UP_SET_1 "Oxygen sensor set temperature for closed loop control" VALUE 0x43320 _REC_VAL_20_s2 4095.938 _CNV_A_R_LINEAR_____286_CM -2048. 2047.938 FORMAT "%8.2" /end CHARACTERISTIC
/begin CHARACTERISTIC C_TTIP_LS_UP_SET_2 "Oxygen sensor set temperature for closed loop control" VALUE 0x43322 _REC_VAL_20_s2 4095.938 _CNV_A_R_LINEAR_____286_CM -2048. 2047.938 FORMAT "%8.2" /end CHARACTERISTIC
/begin CHARACTERISTIC C_TTIP_LS_UP_DIF_MIN_P_ADD "Minimum required temperature difference in order to calculate P-term of controller" VALUE 0x43112 _REC_VAL_20_u2 2047.96875 _CNV_A_R_LINEAR_____321_CM 0. 2047.96875 FORMAT "%7.2" /end CHARACTERISTIC
/begin CHARACTERISTIC C_FAC_P_LSH_UP_CTL "Multiplicative scaling factor for closed loop P-term" VALUE 0x428ad _REC_VAL_20_u1 6.348 _CNV_A_R_LINEAR_____329_CM 0. 6.348 FORMAT "%4.2" /end CHARACTERISTIC
/begin CHARACTERISTIC C_FAC_I_LSH_UP_CTL "Multiplicative scaling factor for closed loop I-term" VALUE 0x428ac _REC_VAL_20_u1 6.348 _CNV_A_R_LINEAR_____329_CM 0. 6.348 FORMAT "%4.2" /end CHARACTERISTIC
/begin CHARACTERISTIC C_TEG_CAT_UP_MDL_MAX_LSH_UP "Maximum permited exhaust gas temperature above which LSH switched off" VALUE 0x43060 _REC_VAL_20_u2 2047. _CNV_A_R_LINEAR_____211_CM 0. 2047. FORMAT "%7.2" /end CHARACTERISTIC
/begin CHARACTERISTIC LC_INH_LSH_UP_CLL_CTL_1 "Boolean constant to permit suspension of closed loop heater control" VALUE 0x42b98 _REC_VAL_20_u1 1. _CNV_A_R_LINEAR_____10_CM 0. 1. FORMAT "%2.0" /end CHARACTERISTIC
/begin CHARACTERISTIC LC_INH_LSH_UP_CLL_CTL_2 "Boolean constant to permit suspension of closed loop heater control" VALUE 0x42b99 _REC_VAL_20_u1 1. _CNV_A_R_LINEAR_____10_CM 0. 1. FORMAT "%2.0" /end CHARACTERISTIC
/begin MEASUREMENT LV_V_EFC_LSH_UP_PROT "Boolean variable indicating effective heater voltage limited due to excessive battery voltage level" UBYTE _CNV_S_2_RANGE______28_CM 1 100. 0. 1. ECU_ADDRESS 0x3fcbc2 /end MEASUREMENT
/begin AXIS_PTS ldpm_temp_ls_ini_1_egcp "" 0x45550 TEMP_LS_INI _REC_AXS_20_u2 4095.938 _CNV_A_R_LINEAR_____326_CM 6 -2048. 2047.938 FORMAT "%8.2" /end AXIS_PTS
/begin AXIS_PTS ldp_vs_fac_v_efc_teg "" 0x43b4f VS _REC_AXS_20_u1 255. _CNV_A_R_LINEAR_____13_CM 6 0. 255. FORMAT "%3.0" /end AXIS_PTS
/begin CHARACTERISTIC C_V_EFC_LSH_DOWN_TOL "voltage threshold to the higher voltage range of the heater" VALUE 0x42ae6 _REC_VAL_20_u1 25.8984 _CNV_A_R_LINEAR_____26_CM 0. 25.8984 FORMAT "%3.1" /end CHARACTERISTIC
/begin CHARACTERISTIC C_V_EFC_LSH_DOWN_MAX "maximum allowed heater voltage " VALUE 0x42ae4 _REC_VAL_20_u1 25.8984 _CNV_A_R_LINEAR_____26_CM 0. 25.8984 FORMAT "%3.1" /end CHARACTERISTIC
/begin CHARACTERISTIC C_V_EFC_LSH_DOWN_PROT "heater voltage in the case of overvoltage conditions" VALUE 0x42ae5 _REC_VAL_20_u1 25.8984 _CNV_A_R_LINEAR_____26_CM 0. 25.8984 FORMAT "%3.1" /end CHARACTERISTIC
/begin CHARACTERISTIC C_T_LSH_DOWN_TOL "maximum of the tolerable heating time with in a higher voltage range " VALUE 0x42a01 _REC_VAL_20_u1 255. _CNV_A_R_LINEAR_____47_CM 0. 255. FORMAT "%3.0" /end CHARACTERISTIC
/begin CHARACTERISTIC C_V_EFC_LSH_DOWN_LIM "limited voltage range of the heater" VALUE 0x42ae3 _REC_VAL_20_u1 25.8984 _CNV_A_R_LINEAR_____26_CM 0. 25.8984 FORMAT "%3.1" /end CHARACTERISTIC
/begin CHARACTERISTIC C_V_EFC_LSH_DOWN_AS "Additive correction to effective heater voltage" VALUE 0x4335e _REC_VAL_20_s1 26. _CNV_A_R_LINEAR_____298_CM -13.05 12.95 FORMAT "%5.1" /end CHARACTERISTIC
/begin CHARACTERISTIC IP_V_EFC_LSH_DOWN_CTL "Heater voltage effective value after completion of the heating phase" MAP 0x50ce7 _REC_MAP_20_u1_u1_u2 25.8984 _CNV_A_R_LINEAR_____26_CM 0. 25.8984 FORMAT "%3.1"
 /begin AXIS_DESCR COM_AXIS N_32 _CNV_A_R_LINEAR_____5_CM 6 0. 8160. FORMAT "%4.0" AXIS_PTS_REF ldp_n_32_ip_v_efc_lsh_down_ctl /end AXIS_DESCR
 /begin AXIS_DESCR COM_AXIS ONLINE_DUMMY _CNV_A_R_LINEAR_____211_CM 6 0. 2047. FORMAT "%7.2" AXIS_PTS_REF ldpm_teg_cat_down_mdl_1_egcp /end AXIS_DESCR
/end CHARACTERISTIC
/begin CHARACTERISTIC IP_V_EFC_LSH_DOWN_INI "Initial heater voltage value" CURVE 0x50d0b _REC_CUR_20_u1_u2 25.8984 _CNV_A_R_LINEAR_____26_CM 0. 25.8984 FORMAT "%3.1"
 /begin AXIS_DESCR COM_AXIS ONLINE_DUMMY _CNV_A_R_LINEAR_____326_CM 6 -2048. 2047.938 FORMAT "%8.2" AXIS_PTS_REF ldpm_temp_ls_down_ini_1_egcp /end AXIS_DESCR
/end CHARACTERISTIC
/begin CHARACTERISTIC IP_T_LSH_DOWN_TEMP_THD "Duration until critical water splash sensor temperature reached" CURVE 0x506ea _REC_CUR_20_u1_u2 255. _CNV_A_R_LINEAR_____47_CM 0. 255. FORMAT "%3.0"
 /begin AXIS_DESCR COM_AXIS ONLINE_DUMMY _CNV_A_R_LINEAR_____326_CM 6 -2048. 2047.938 FORMAT "%8.2" AXIS_PTS_REF ldpm_temp_ls_down_ini_1_egcp /end AXIS_DESCR
/end CHARACTERISTIC
/begin CHARACTERISTIC IP_FAC_V_EFC_DOWN_TEG "Coorection factor for the assumtion of the heat transfer exclusive for bank 2" CURVE 0x4e7c3 _REC_CUR_20_u1_u1 3.984375 _CNV_A_R_LINEAR_____195_CM 0. 3.984375 FORMAT "%4.2"
 /begin AXIS_DESCR COM_AXIS VS _CNV_A_R_LINEAR_____13_CM 6 0. 255. FORMAT "%3.0" AXIS_PTS_REF ldp_vs_ip_fac_v_efc_down_teg /end AXIS_DESCR
/end CHARACTERISTIC
/begin CHARACTERISTIC C_DEC_V_EFC_DOWN "Heater voltage decrement to lower temperature" VALUE 0x4287a _REC_VAL_20_u1 25.8984 _CNV_A_R_LINEAR_____26_CM 0. 25.8984 FORMAT "%3.1" /end CHARACTERISTIC
/begin CHARACTERISTIC C_INC_V_EFC_DOWN "Heater voltage increment to raise temperature" VALUE 0x428eb _REC_VAL_20_u1 25.8984 _CNV_A_R_LINEAR_____26_CM 0. 25.8984 FORMAT "%3.1" /end CHARACTERISTIC
/begin CHARACTERISTIC C_V_EFC_DOWN_RED "Reduced heater voltage during danger of water splash damage" VALUE 0x42ae2 _REC_VAL_20_u1 25.8984 _CNV_A_R_LINEAR_____26_CM 0. 25.8984 FORMAT "%3.1" /end CHARACTERISTIC
/begin CHARACTERISTIC C_T_LSH_DOWN_LIM "time after a heating phase with a higher voltage range" VALUE 0x429ff _REC_VAL_20_u1 255. _CNV_A_R_LINEAR_____47_CM 0. 255. FORMAT "%3.0" /end CHARACTERISTIC
/begin CHARACTERISTIC C_T_LSH_DOWN_RISE "Duration of open loop heating in PREHEATING" VALUE 0x42a00 _REC_VAL_20_u1 255. _CNV_A_R_LINEAR_____47_CM 0. 255. FORMAT "%3.0" /end CHARACTERISTIC
/begin CHARACTERISTIC C_VB_PROT_DOWN_MAX "maximum battery voltage threshold for the detection of overvoltage" VALUE 0x42b16 _REC_VAL_20_u1 25.8984 _CNV_A_R_LINEAR_____26_CM 0. 25.8984 FORMAT "%3.1" /end CHARACTERISTIC
/begin CHARACTERISTIC C_V_EFC_LSH_DOWN_STEP "Additional effective heater voltage step on transition from LSH_POW_RED to LSH_POW_RISE" VALUE 0x4335f _REC_VAL_20_s1 26. _CNV_A_R_LINEAR_____298_CM -13.05 12.95 FORMAT "%5.1" /end CHARACTERISTIC
/begin CHARACTERISTIC C_T_LSHPWM_DOWN_FAST_VB_COR "Additional effective heater voltage step on transition from LSH_POW_RED to LSH_POW_RISE" VALUE 0x42a06 _REC_VAL_20_u1 2.55 _CNV_A_R_LINEAR_____27_CM 0. 2.55 FORMAT "%4.2" /end CHARACTERISTIC
/begin CHARACTERISTIC C_FAC_V_EFC_LSH_DOWN_AS "Multiplicative correction factor to effective heater voltage" VALUE 0x428be _REC_VAL_20_u1 1.9921875 _CNV_A_R_LINEAR_____103_CM 0. 1.9921875 FORMAT "%5.3" /end CHARACTERISTIC
/begin AXIS_PTS ldpm_teg_cat_down_mdl_1_egcp "" 0x4547e TEG_CAT_DOWN_MDL _REC_AXS_20_u2 2047. _CNV_A_R_LINEAR_____211_CM 6 0. 2047. FORMAT "%7.2" /end AXIS_PTS
/begin AXIS_PTS ldpm_temp_ls_down_ini_1_egcp "" 0x45542 TEMP_LS_INI _REC_AXS_20_u2 4095.938 _CNV_A_R_LINEAR_____326_CM 6 -2048. 2047.938 FORMAT "%8.2" /end AXIS_PTS
/begin AXIS_PTS ldp_n_32_ip_v_efc_lsh_down_ctl "" 0x436cb N_32 _REC_AXS_20_u1 8160. _CNV_A_R_LINEAR_____5_CM 6 0. 8160. FORMAT "%4.0" /end AXIS_PTS
/begin AXIS_PTS ldp_vs_ip_fac_v_efc_down_teg "" 0x43b56 VS _REC_AXS_20_u1 255. _CNV_A_R_LINEAR_____13_CM 6 0. 255. FORMAT "%3.0" /end AXIS_PTS
/begin CHARACTERISTIC LC_LSH_UP_CLL_CTL_2 "Boolean constant to permit suspension of closed loop heater control" VALUE 0x42baf _REC_VAL_20_u1 1. _CNV_A_R_LINEAR_____12_CM 0. 1. FORMAT "%1.0" /end CHARACTERISTIC
/begin CHARACTERISTIC LC_TTIP_LS_UP_MES_VLD_1 "Boolean constant for the validity of oxygen sensor ceramic temperature TTIP_LS_UP_MES_i" VALUE 0x42bf0 _REC_VAL_20_u1 1. _CNV_A_R_LINEAR_____12_CM 0. 1. FORMAT "%1.0" /end CHARACTERISTIC
/begin CHARACTERISTIC LC_TTIP_LS_UP_MES_VLD_2 "Boolean constant for the validity of oxygen sensor ceramic temperature TTIP_LS_UP_MES_i" VALUE 0x42bf1 _REC_VAL_20_u1 1. _CNV_A_R_LINEAR_____12_CM 0. 1. FORMAT "%1.0" /end CHARACTERISTIC
/begin CHARACTERISTIC LC_LSH_UP_CLL_CTL_1 "Boolean constant to permit suspension of closed loop heater control" VALUE 0x42bae _REC_VAL_20_u1 1. _CNV_A_R_LINEAR_____12_CM 0. 1. FORMAT "%1.0" /end CHARACTERISTIC
/begin CHARACTERISTIC C_MAF_INT_PUC_UP_LS "Upperlimit of air mass flow integral while puc active" VALUE 0x42e42 _REC_VAL_20_u2 1820.398 _CNV_A_R_LINEAR_____277_CM 0. 1820.398 FORMAT "%7.2" /end CHARACTERISTIC
/begin CHARACTERISTIC ID_T_MAX_LS "maximum duration with open A/F control loop if the O2 sensors are not ready" CURVE 0x45e94 _REC_CUR_20_u2_u1 6553.400000000001 _CNV_A_R_LINEAR_____14_CM 0.1 6553.5 FORMAT "%6.1"
 /begin AXIS_DESCR COM_AXIS TCO_ST _CNV_A_R_LINEAR_____0_CM 6 -48. 142.5 FORMAT "%5.1" AXIS_PTS_REF ldpm_tco_st_1_laco /end AXIS_DESCR
/end CHARACTERISTIC
/begin AXIS_PTS ldpm_tco_st_1_laco "" 0x44014 TCO_ST _REC_AXS_20_u1 190.5 _CNV_A_R_LINEAR_____0_CM 6 -48. 142.5 FORMAT "%5.1" /end AXIS_PTS
/begin CHARACTERISTIC C_VLS_AFR "Minimum duration for Full load after which VLS_TOL_i is effected" VALUE 0x4316a _REC_VAL_20_u2 4.99511719 _CNV_A_R_LINEAR_____33_CM 0. 4.99511719 FORMAT "%5.3" /end CHARACTERISTIC
/begin CHARACTERISTIC C_VLS_INI_MAX "Upper initialization value for VLS_TOL_i, VLS_MMV_MAX_i" VALUE 0x431a2 _REC_VAL_20_u2 4.99511719 _CNV_A_R_LINEAR_____33_CM 0. 4.99511719 FORMAT "%5.3" /end CHARACTERISTIC
/begin CHARACTERISTIC C_VLS_INI_MIN "Lower initialization value for VLS_BOL_i, VLS_MMV_MIN_i" VALUE 0x431a4 _REC_VAL_20_u2 4.99511719 _CNV_A_R_LINEAR_____33_CM 0. 4.99511719 FORMAT "%5.3" /end CHARACTERISTIC
/begin CHARACTERISTIC C_VLS_CRLC_OFF "Filter constant for determination of VLS_MMV_xxx_i values when respective threshold not passed" VALUE 0x43176 _REC_VAL_20_u2 0.99998474 _CNV_A_R_LINEAR_____31_CM 0. 0.99998474 FORMAT "%7.5" /end CHARACTERISTIC
/begin CHARACTERISTIC C_CTR_VLS_UP_AFL_CYC_MIN "Minimum number of AF cycles after lambda controller activation prior to validating VLS_MMV_xxx_i signals" VALUE 0x42ca2 _REC_VAL_20_u2 65535. _CNV_A_R_LINEAR_____10_CM 0. 65535. FORMAT "%5.0" /end CHARACTERISTIC
/begin CHARACTERISTIC IP_T_AFL_LOCK "LV_AFL transition lock-out time after transition of AF mixture" MAP 0x4fe3a _REC_MAP_20_u1_u1_u2 2.55 _CNV_A_R_LINEAR_____27_CM 0. 2.55 FORMAT "%4.2"
 /begin AXIS_DESCR COM_AXIS N_32 _CNV_A_R_LINEAR_____5_CM 8 0. 8160. FORMAT "%4.0" AXIS_PTS_REF ldpm_n_32__ti_lam /end AXIS_DESCR
 /begin AXIS_DESCR COM_AXIS MAF _CNV_A_R_LINEAR_____95_CM 8 0. 1389. FORMAT "%7.2" AXIS_PTS_REF ldpm_maf__ti_lam /end AXIS_DESCR
/end CHARACTERISTIC
/begin CHARACTERISTIC C_FAC_VLS_UP_MMV_HYS "Multiplicative factor governing amplitude of hysteresis" VALUE 0x428c3 _REC_VAL_20_u1 0.99610001 _CNV_A_R_LINEAR_____20_CM 0. 0.99610001 FORMAT "%5.3" /end CHARACTERISTIC
/begin CHARACTERISTIC C_VLS_UP_MMV_HYS_MIN "Minimum hysteresis for the computation of the thresholds VLS_TOL_i and VLS_BOL_i" VALUE 0x431b8 _REC_VAL_20_u2 1. _CNV_A_R_LINEAR_____281_CM 0. 1. FORMAT "%7.5" /end CHARACTERISTIC
/begin AXIS_PTS ldpm_n_32__ti_lam "" 0x43de8 N_32 _REC_AXS_20_u1 8160. _CNV_A_R_LINEAR_____5_CM 8 0. 8160. FORMAT "%4.0" /end AXIS_PTS
/begin AXIS_PTS ldpm_maf__ti_lam "" 0x45098 MAF _REC_AXS_20_u2 1389. _CNV_A_R_LINEAR_____95_CM 8 0. 1389. FORMAT "%7.2" /end AXIS_PTS
/begin CHARACTERISTIC C_MFF_SP_MAN "manual setpoint for fuel mass in homogeneous mode" VALUE 0x42e88 _REC_VAL_20_u2 1389. _CNV_A_R_LINEAR_____95_CM 0. 1389. FORMAT "%7.2" /end CHARACTERISTIC
/begin CHARACTERISTIC C_MFF_SP_HOM_OFS_AS "additive mass fuel offset value for application" VALUE 0x42e86 _REC_VAL_20_u2 1389. _CNV_A_R_LINEAR_____95_CM 0. 1389. FORMAT "%7.2" /end CHARACTERISTIC
/begin MEASUREMENT MFF_SP_CLC_1 "Calculated mass fuel flow setpoint for homogenious charge" UWORD _CNV_A_R_LINEAR_____95_CM 1 100. 0. 1389. ECU_ADDRESS 0x3fe3fa FORMAT "%7.2" /end MEASUREMENT
/begin MEASUREMENT MFF_SP_CLC_2 "Calculated mass fuel flow setpoint for homogenious charge" UWORD _CNV_A_R_LINEAR_____95_CM 1 100. 0. 1389. ECU_ADDRESS 0x3fe3fe FORMAT "%7.2" /end MEASUREMENT
/begin MEASUREMENT MFF_SP_HOM_ENG_1 "Calculated mass fuel flow output for canister purge" UWORD _CNV_A_R_LINEAR_____95_CM 1 100. 0. 1389. ECU_ADDRESS 0x3fceda FORMAT "%7.2" /end MEASUREMENT
/begin MEASUREMENT MFF_SP_HOM_ENG_2 "Calculated mass fuel flow output for canister purge" UWORD _CNV_A_R_LINEAR_____95_CM 1 100. 0. 1389. ECU_ADDRESS 0x3fcedc FORMAT "%7.2" /end MEASUREMENT
/begin CHARACTERISTIC IP_MFF_COR_2 "Operating point correction of the basic injection fuel nass" MAP 0x494aa _REC_MAP_20_u2_u2_u2 1.99996948 _CNV_A_R_LINEAR_____45_CM 0. 1.99996948 FORMAT "%7.5"
 /begin AXIS_DESCR COM_AXIS MAF _CNV_A_R_LINEAR_____95_CM 12 0. 1389. FORMAT "%7.2" AXIS_PTS_REF ldp_maf__mff_cor_2 /end AXIS_DESCR
 /begin AXIS_DESCR COM_AXIS N _CNV_A_R_LINEAR_____17_CM 16 0. 8160. FORMAT "%4.0" AXIS_PTS_REF ldp_n__mff_cor_2 /end AXIS_DESCR
/end CHARACTERISTIC
/begin CHARACTERISTIC IP_MFF_COR_1 "Operating point correction of the basic injection fuel nass" MAP 0x4932a _REC_MAP_20_u2_u2_u2 1.99996948 _CNV_A_R_LINEAR_____45_CM 0. 1.99996948 FORMAT "%7.5"
 /begin AXIS_DESCR COM_AXIS MAF _CNV_A_R_LINEAR_____95_CM 12 0. 1389. FORMAT "%7.2" AXIS_PTS_REF ldp_maf__mff_cor_1 /end AXIS_DESCR
 /begin AXIS_DESCR COM_AXIS N _CNV_A_R_LINEAR_____17_CM 16 0. 8160. FORMAT "%4.0" AXIS_PTS_REF ldp_n__mff_cor_1 /end AXIS_DESCR
/end CHARACTERISTIC
/begin CHARACTERISTIC LC_MFF_SP_HOM_MAN_ACT "switch for manual setpoint for fuel mass in homogeneous mode" VALUE 0x42bb3 _REC_VAL_20_u1 1. _CNV_S_2_RANGE______11_CM 0. 1. /end CHARACTERISTIC
/begin MEASUREMENT MFF_SP_HOM_1 "Mass fuel flow setpoint for homogeneous charge (output)" UWORD _CNV_A_R_LINEAR_____95_CM 1 100. 0. 1389. ECU_ADDRESS 0x3fced6 FORMAT "%7.2" /end MEASUREMENT
/begin MEASUREMENT MFF_SP_HOM_2 "Mass fuel flow setpoint for homogeneous charge (output)" UWORD _CNV_A_R_LINEAR_____95_CM 1 100. 0. 1389. ECU_ADDRESS 0x3fced8 FORMAT "%7.2" /end MEASUREMENT
/begin AXIS_PTS ldp_maf__mff_cor_1 "" 0x444b4 MAF _REC_AXS_20_u2 138.9 _CNV_A_R_LINEAR_____95_CM 12 0. 1389. FORMAT "%7.2" /end AXIS_PTS
/begin AXIS_PTS ldp_maf__mff_cor_2 "" 0x444ce MAF _REC_AXS_20_u2 138.9 _CNV_A_R_LINEAR_____95_CM 12 0. 1389. FORMAT "%7.2" /end AXIS_PTS
/begin AXIS_PTS ldp_n__mff_cor_1 "" 0x447c8 N _REC_AXS_20_u2 816. _CNV_A_R_LINEAR_____17_CM 16 0. 8160. FORMAT "%4.0" /end AXIS_PTS
/begin AXIS_PTS ldp_n__mff_cor_2 "" 0x447ea N _REC_AXS_20_u2 816. _CNV_A_R_LINEAR_____17_CM 16 0. 8160. FORMAT "%4.0" /end AXIS_PTS
/begin MEASUREMENT TQI_SP_MFF "Engine torque in stratified combustion for injection setpoint." SWORD _CNV_A_R_LINEAR_____48_CM 1 100. -1024. 1023.96875 ECU_ADDRESS 0x3fcee4 FORMAT "%8.2" /end MEASUREMENT
/begin MEASUREMENT TQI_SP_MFF_1 "Engine torque in stratified combustion for injection setpoint before manual switch." UWORD _CNV_A_R_LINEAR_____48_CM 1 100. 0. 1023.96875 ECU_ADDRESS 0x3fe400 FORMAT "%7.2" /end MEASUREMENT
/begin MEASUREMENT MFF_SP_S_1 "fuel mass flow setpoint intermitted value for stratified mode" UWORD _CNV_A_R_LINEAR_____95_CM 1 100. 0. 1389. ECU_ADDRESS 0x3fcee2 FORMAT "%7.2" /end MEASUREMENT
/begin MEASUREMENT MFF_SP_S "Fuel mass in stratified combustion." UWORD _CNV_A_R_LINEAR_____95_CM 1 100. 0. 1389. ECU_ADDRESS 0x3fcede FORMAT "%7.2" /end MEASUREMENT
/begin MEASUREMENT MFF_SP_S_ENG "calculated mass fuel flow output for canister purge" UWORD _CNV_A_R_LINEAR_____95_CM 1 100. 0. 1389. ECU_ADDRESS 0x3fcee0 FORMAT "%7.2" /end MEASUREMENT
/begin MEASUREMENT EFF_TOT_BAS_S "Total basic efficiency for stratified mode" UWORD _CNV_A_R_LINEAR_____45_CM 1 100. 0. 1.99996948 ECU_ADDRESS 0x3fe402 FORMAT "%7.5" /end MEASUREMENT
/begin CHARACTERISTIC IP_MFF_SP_S "Fuel mass stratified mode" MAP 0x4966a _REC_MAP_20_u2_u1_u2 1389. _CNV_A_R_LINEAR_____95_CM 0. 1389. FORMAT "%7.2"
 /begin AXIS_DESCR COM_AXIS N_32 _CNV_A_R_LINEAR_____5_CM 16 0. 8160. FORMAT "%4.0" AXIS_PTS_REF ldpm_n_32_s /end AXIS_DESCR
 /begin AXIS_DESCR COM_AXIS TQI_SP_MFF _CNV_A_R_LINEAR_____48_CM 12 0. 1023.96875 FORMAT "%7.2" AXIS_PTS_REF ldpm_tqi_sp_mff_s /end AXIS_DESCR
/end CHARACTERISTIC
/begin CHARACTERISTIC LC_TQI_SP_MFF_MAN_ACT "Logiacl constant for manual torque-switch" VALUE 0x42bef _REC_VAL_20_u1 1. _CNV_A_R_LINEAR_____10_CM 0. 1. FORMAT "%2.0" /end CHARACTERISTIC
/begin CHARACTERISTIC C_TQI_SP_MFF_MAN "manual torque switch value" VALUE 0x43110 _REC_VAL_20_u2 1023.96875 _CNV_A_R_LINEAR_____48_CM 0. 1023.96875 FORMAT "%7.2" /end CHARACTERISTIC
/begin CHARACTERISTIC LC_MFF_SP_S_MAN_ACT "Logical constant for manual MFF-switch" VALUE 0x42bb4 _REC_VAL_20_u1 1. _CNV_A_R_LINEAR_____10_CM 0. 1. FORMAT "%2.0" /end CHARACTERISTIC
/begin CHARACTERISTIC C_MFF_SP_S_MAN "Manual fuel mass flow setpoint for stratified mode" VALUE 0x42e8a _REC_VAL_20_u2 1389. _CNV_A_R_LINEAR_____95_CM 0. 1389. FORMAT "%7.2" /end CHARACTERISTIC
/begin CHARACTERISTIC C_MFF_SP_S_OFS_AS "Manual fuel mass flow setpoint for application" VALUE 0x42e8c _REC_VAL_20_u2 1389. _CNV_A_R_LINEAR_____95_CM 0. 1389. FORMAT "%7.2" /end CHARACTERISTIC
/begin AXIS_PTS ldpm_tqi_sp_mff_s "" 0x455da TQI_SP_MFF _REC_AXS_20_u2 1023.96875 _CNV_A_R_LINEAR_____48_CM 12 0. 1023.96875 FORMAT "%7.2" /end AXIS_PTS
/begin MEASUREMENT TI_HOM_2 "fuel injection time for homogeneous mode" UWORD _CNV_A_R_LINEAR_____208_CM 1 100. 0. 262.14 ECU_ADDRESS 0x3fcece FORMAT "%7.3" /end MEASUREMENT
/begin CHARACTERISTIC C_TI_HOM_MAN "manual setpoint for injection time in homogeneous mode" VALUE 0x4309a _REC_VAL_20_u2 262.14 _CNV_A_R_LINEAR_____208_CM 0. 262.14 FORMAT "%7.3" /end CHARACTERISTIC
/begin CHARACTERISTIC LC_TI_HOM_MAN_ACT "switch for manual setpoint for injection time in homogeneous mode" VALUE 0x42bd1 _REC_VAL_20_u1 1. _CNV_S_2_RANGE______11_CM 0. 1. /end CHARACTERISTIC
/begin MEASUREMENT TI_HOM_1 "fuel injection time for homogeneous mode" UWORD _CNV_A_R_LINEAR_____208_CM 1 100. 0. 262.14 ECU_ADDRESS 0x3fcecc FORMAT "%7.3" /end MEASUREMENT
/begin MEASUREMENT LV_TI_LIM_MIN "boolean variable for injection time limitation" UBYTE _CNV_S_2_RANGE______28_CM 1 100. 0. 1. ECU_ADDRESS 0x3fced0 /end MEASUREMENT
/begin MEASUREMENT FAC_TI_PRS_1 "factor  for correction of fuel injection time due to a change of pressure decrease at the injector" UWORD _CNV_A_R_LINEAR_____432_CM 1 100. 0. 15.99975586 ECU_ADDRESS 0x3fe3d8 /end MEASUREMENT
/begin MEASUREMENT FAC_TI_PRS_2 "factor  for correction of fuel injection time due to a change of pressure decrease at the injector" UWORD _CNV_A_R_LINEAR_____432_CM 1 100. 0. 15.99975586 ECU_ADDRESS 0x3fe3da /end MEASUREMENT
/begin MEASUREMENT PRS_INJ_MV_1 "mean cylinder pressure during injection " UWORD _CNV_A_R_LINEAR_____190_CM 1 100. 0. 173888. ECU_ADDRESS 0x3fe3dc FORMAT "%6.0" /end MEASUREMENT
/begin MEASUREMENT PRS_INJ_MV_2 "mean cylinder pressure during injection " UWORD _CNV_A_R_LINEAR_____190_CM 1 100. 0. 173888. ECU_ADDRESS 0x3fe3de FORMAT "%6.0" /end MEASUREMENT
/begin MEASUREMENT PRS_DEC_INJ_1 "pressure decrease at the injector " UWORD _CNV_A_R_LINEAR_____190_CM 1 100. 0. 173888. ECU_ADDRESS 0x3fe3e4 FORMAT "%6.0" /end MEASUREMENT
/begin MEASUREMENT PRS_DEC_INJ_2 "pressure decrease at the injector " UWORD _CNV_A_R_LINEAR_____190_CM 1 100. 0. 173888. ECU_ADDRESS 0x3fe3e6 FORMAT "%6.0" /end MEASUREMENT
/begin MEASUREMENT TI_STND_HOM_1 "fuel injection time without fuel pressure correction for homogeneous mode" UWORD _CNV_A_R_LINEAR_____208_CM 1 100. 0. 262.14 ECU_ADDRESS 0x3fe3e8 FORMAT "%7.3" /end MEASUREMENT
/begin MEASUREMENT TI_STND_HOM_2 "fuel injection time without fuel pressure correction for homogeneous mode" UWORD _CNV_A_R_LINEAR_____208_CM 1 100. 0. 262.14 ECU_ADDRESS 0x3fe3ea FORMAT "%7.3" /end MEASUREMENT
/begin MEASUREMENT TI_HOM_CLC_1 "calculated fuel injection time for homogeneous mode" UWORD _CNV_A_R_LINEAR_____208_CM 1 100. 0. 262.14 ECU_ADDRESS 0x3fe3ec FORMAT "%7.3" /end MEASUREMENT
/begin MEASUREMENT TI_HOM_CLC_2 "calculated fuel injection time for homogeneous mode" UWORD _CNV_A_R_LINEAR_____208_CM 1 100. 0. 262.14 ECU_ADDRESS 0x3fe3ee FORMAT "%7.3" /end MEASUREMENT
/begin MEASUREMENT CRK_INJ_1 "rough value for injection angle (EOI-SOI) " UWORD _CNV_A_R_LINEAR_____75_CM 1 100. 0. 600. ECU_ADDRESS 0x3fe3e0 FORMAT "%5.1" /end MEASUREMENT
/begin MEASUREMENT CRK_INJ_2 "rough value for injection angle (EOI-SOI) " UWORD _CNV_A_R_LINEAR_____75_CM 1 100. 0. 600. ECU_ADDRESS 0x3fe3e2 FORMAT "%5.1" /end MEASUREMENT
/begin MEASUREMENT TI_ST_AMP "Injection correction at start upon AMP " UBYTE _CNV_A_R_LINEAR_____34_CM 1 100. 0. 1.99220002 ECU_ADDRESS 0x3fced1 FORMAT "%5.3" /end MEASUREMENT
/begin CHARACTERISTIC C_TI_MIN_POST_PULSE "minimum duration of ti post pulses" VALUE 0x430a2 _REC_VAL_20_u2 0.5 _CNV_A_R_LINEAR_____208_CM 0. 5. FORMAT "%5.3" /end CHARACTERISTIC
/begin MEASUREMENT BIOS_TI_0 "injection time cylinder logical " UWORD _CNV_A_R_LINEAR_____208_CM 1 100. 0. 262.14 ECU_ADDRESS 0x3fcef8 FORMAT "%7.3" /end MEASUREMENT
/begin MEASUREMENT BIOS_TI_1 "injection time cylinder logical " UWORD _CNV_A_R_LINEAR_____208_CM 1 100. 0. 262.14 ECU_ADDRESS 0x3fcefa FORMAT "%7.3" /end MEASUREMENT
/begin MEASUREMENT BIOS_TI_2 "injection time cylinder logical " UWORD _CNV_A_R_LINEAR_____208_CM 1 100. 0. 262.14 ECU_ADDRESS 0x3fcefc FORMAT "%7.3" /end MEASUREMENT
/begin MEASUREMENT BIOS_TI_3 "injection time cylinder logical " UWORD _CNV_A_R_LINEAR_____208_CM 1 100. 0. 262.14 ECU_ADDRESS 0x3fcefe FORMAT "%7.3" /end MEASUREMENT
/begin MEASUREMENT BIOS_TI_4 "injection time cylinder logical " UWORD _CNV_A_R_LINEAR_____208_CM 1 100. 0. 262.14 ECU_ADDRESS 0x3fcf00 FORMAT "%7.3" /end MEASUREMENT
/begin MEASUREMENT BIOS_TI_5 "injection time cylinder logical " UWORD _CNV_A_R_LINEAR_____208_CM 1 100. 0. 262.14 ECU_ADDRESS 0x3fcf02 FORMAT "%7.3" /end MEASUREMENT
/begin MEASUREMENT BIOS_TI_OFS "offset injection time for dead time correction" SWORD _CNV_A_R_LINEAR_____208_CM 1 100. 0. 131.068 ECU_ADDRESS 0x3fe464 FORMAT "%7.3" /end MEASUREMENT
/begin MEASUREMENT BIOS_TI_MIN_POST_PULSE_INJ "minimum duration of ti post pulses" UWORD _CNV_A_R_LINEAR_____208_CM 1 100. 0. 5. ECU_ADDRESS 0x3fe466 FORMAT "%5.3" /end MEASUREMENT
/begin MEASUREMENT BIOS_EOI_LIM "latest possible end of injection before TDC" UWORD _CNV_A_R_LINEAR_____232_CM 1 100. 0. 720. ECU_ADDRESS 0x3fe468 FORMAT "%6.2" /end MEASUREMENT
/begin MEASUREMENT BIOS_LV_POST_PULS_INJ "logical variable to enable post pulses" UBYTE _CNV_S_2_RANGE______11_CM 1 100. 0. 1. ECU_ADDRESS 0x3fe46d BIT_MASK 0x1 /end MEASUREMENT
/begin MEASUREMENT BIOS_EOI_0 "end of injection in °crk before BIOS_EOI_LIM" UWORD _CNV_A_R_LINEAR_____232_CM 1 100. 0. 720. ECU_ADDRESS 0x3fe458 FORMAT "%6.2" /end MEASUREMENT
/begin MEASUREMENT BIOS_EOI_1 "end of injection in °crk before BIOS_EOI_LIM" UWORD _CNV_A_R_LINEAR_____232_CM 1 100. 0. 720. ECU_ADDRESS 0x3fe45a FORMAT "%6.2" /end MEASUREMENT
/begin MEASUREMENT BIOS_EOI_2 "end of injection in °crk before BIOS_EOI_LIM" UWORD _CNV_A_R_LINEAR_____232_CM 1 100. 0. 720. ECU_ADDRESS 0x3fe45c FORMAT "%6.2" /end MEASUREMENT
/begin MEASUREMENT BIOS_EOI_3 "end of injection in °crk before BIOS_EOI_LIM" UWORD _CNV_A_R_LINEAR_____232_CM 1 100. 0. 720. ECU_ADDRESS 0x3fe45e FORMAT "%6.2" /end MEASUREMENT
/begin MEASUREMENT BIOS_EOI_4 "end of injection in °crk before BIOS_EOI_LIM" UWORD _CNV_A_R_LINEAR_____232_CM 1 100. 0. 720. ECU_ADDRESS 0x3fe460 FORMAT "%6.2" /end MEASUREMENT
/begin MEASUREMENT BIOS_EOI_5 "end of injection in °crk before BIOS_EOI_LIM" UWORD _CNV_A_R_LINEAR_____232_CM 1 100. 0. 720. ECU_ADDRESS 0x3fe462 FORMAT "%6.2" /end MEASUREMENT
/begin CHARACTERISTIC LC_POST_PULS_INJ_ENA "Logical constant for enabling post pulse" VALUE 0x42bbb _REC_VAL_20_u1 1. _CNV_A_R_LINEAR_____12_CM 0. 1. FORMAT "%1.0" /end CHARACTERISTIC
/begin CHARACTERISTIC C_TI_AS_CYL_0 "injection time factor to correct cylinder injection value cyl. 0" VALUE 0x42a9f _REC_VAL_20_u1 1.99220002 _CNV_A_R_LINEAR_____34_CM 0. 1.99220002 FORMAT "%5.3" /end CHARACTERISTIC
/begin CHARACTERISTIC C_TI_AS_CYL_1 "injection time factor to correct cylinder injection value cyl. 1" VALUE 0x42aa0 _REC_VAL_20_u1 1.99220002 _CNV_A_R_LINEAR_____34_CM 0. 1.99220002 FORMAT "%5.3" /end CHARACTERISTIC
/begin CHARACTERISTIC C_TI_AS_CYL_2 "injection time factor to correct cylinder injection value cyl. 2" VALUE 0x42aa1 _REC_VAL_20_u1 1.99220002 _CNV_A_R_LINEAR_____34_CM 0. 1.99220002 FORMAT "%5.3" /end CHARACTERISTIC
/begin CHARACTERISTIC C_TI_AS_CYL_3 "injection time factor to correct cylinder injection value cyl. 3" VALUE 0x42aa2 _REC_VAL_20_u1 1.99220002 _CNV_A_R_LINEAR_____34_CM 0. 1.99220002 FORMAT "%5.3" /end CHARACTERISTIC
/begin CHARACTERISTIC C_TI_AS_CYL_4 "injection time factor to correct cylinder injection value cyl. 4" VALUE 0x42aa3 _REC_VAL_20_u1 1.99220002 _CNV_A_R_LINEAR_____34_CM 0. 1.99220002 FORMAT "%5.3" /end CHARACTERISTIC
/begin CHARACTERISTIC C_TI_AS_CYL_5 "injection time factor to correct cylinder injection value cyl. 5" VALUE 0x42aa4 _REC_VAL_20_u1 1.99220002 _CNV_A_R_LINEAR_____34_CM 0. 1.99220002 FORMAT "%5.3" /end CHARACTERISTIC
/begin CHARACTERISTIC IP_MFF_LGRD_AST "Injection time change limitation after Start" CURVE 0x4965a _REC_CUR_20_u2_u1 1389. _CNV_A_R_LINEAR_____95_CM 0. 1389. FORMAT "%7.2"
 /begin AXIS_DESCR COM_AXIS TCO _CNV_A_R_LINEAR_____0_CM 8 -48. 142.5 FORMAT "%5.1" AXIS_PTS_REF ldp_tco__mff_lgrd_ast /end AXIS_DESCR
/end CHARACTERISTIC
/begin AXIS_PTS ldp_tco__mff_lgrd_ast "" 0x4389c TCO _REC_AXS_20_u1 190.5 _CNV_A_R_LINEAR_____0_CM 8 -48. 142.5 FORMAT "%5.1" /end AXIS_PTS
/begin CHARACTERISTIC IP_EOI_MIN_TIPR "Latest permitted predicted end of injection for pre-injection" CURVE 0x47378 _REC_CUR_20_u2_u1 720. _CNV_A_R_LINEAR_____75_CM 0. 720. FORMAT "%6.2"
 /begin AXIS_DESCR COM_AXIS TCO _CNV_A_R_LINEAR_____0_CM 8 -48. 142.5 FORMAT "%5.1" AXIS_PTS_REF ldp_tco__eoi_min_tipr /end AXIS_DESCR
/end CHARACTERISTIC
/begin CHARACTERISTIC C_NR_MAX_TOOTH_TIPR "Maximum tooth number till preliminary synchronisation for preinjection" VALUE 0x42976 _REC_VAL_20_u1 63. _CNV_A_R_LINEAR_____10_CM 1. 64. FORMAT "%3.0" /end CHARACTERISTIC
/begin AXIS_PTS ldp_tco__eoi_min_tipr "" 0x43833 TCO _REC_AXS_20_u1 190.5 _CNV_A_R_LINEAR_____0_CM 8 -48. 142.5 FORMAT "%5.1" /end AXIS_PTS
/begin MEASUREMENT FAC_TI_PRS_S "factor  for correction of fuel injection time due to a change of pressure decrease at the injector (stratified mode)" UWORD _CNV_A_R_LINEAR_____432_CM 1 100. 0. 15.99975586 ECU_ADDRESS 0x3fced2 FORMAT "%7.4" /end MEASUREMENT
/begin MEASUREMENT PRS_INJ_MV_S "mean cylinder pressure during injection (stratified mode)" UWORD _CNV_A_R_LINEAR_____190_CM 1 100. 0. 173888. ECU_ADDRESS 0x3fe3f0 FORMAT "%6.0" /end MEASUREMENT
/begin MEASUREMENT CRK_INJ_S "rough value for injection angle (EOI-SOI) (stratified mode)" UWORD _CNV_A_R_LINEAR_____75_CM 1 100. 0. 600. ECU_ADDRESS 0x3fe3f2 FORMAT "%5.1" /end MEASUREMENT
/begin MEASUREMENT PRS_DEC_INJ_S "pressure decrease at the injector at the end of injection (stratified mode)" UWORD _CNV_A_R_LINEAR_____190_CM 1 100. 0. 173888. ECU_ADDRESS 0x3fe3f4 FORMAT "%6.0" /end MEASUREMENT
/begin MEASUREMENT TI_STND_S "fuel injection time without fuel pressure correction for stratified mode" UWORD _CNV_A_R_LINEAR_____208_CM 1 100. 0. 262.14 ECU_ADDRESS 0x3fe3f6 FORMAT "%7.3" /end MEASUREMENT
/begin MEASUREMENT TI_S_CLC "calculated fuel injection time for stratified mode" UWORD _CNV_A_R_LINEAR_____208_CM 1 100. 0. 262.14 ECU_ADDRESS 0x3fe3f8 FORMAT "%7.3" /end MEASUREMENT
/begin CHARACTERISTIC LC_TI_S_MAN_ACT "switch for manual setpoint for injection time in stratified mode " VALUE 0x42bd2 _REC_VAL_20_u1 1. _CNV_A_R_LINEAR_____10_CM 0. 1. FORMAT "%2.0" /end CHARACTERISTIC
/begin MEASUREMENT LV_TI_S_LIM_MIN "bolean variable for injection time limitation" UBYTE _CNV_S_2_RANGE______28_CM 1 100. 0. 1. ECU_ADDRESS 0x3fced4 /end MEASUREMENT
/begin CHARACTERISTIC C_TI_S_MAN "manual setpoint for injection time in stratified mode " VALUE 0x430a6 _REC_VAL_20_u2 262.14 _CNV_A_R_LINEAR_____208_CM 0. 262.14 FORMAT "%7.3" /end CHARACTERISTIC
/begin MEASUREMENT TI_S_1 "fuel injection time for stratified mode" UWORD _CNV_A_R_LINEAR_____208_CM 1 100. 0. 262.14 ECU_ADDRESS 0x3fbfc4 FORMAT "%7.3" /end MEASUREMENT
/begin CHARACTERISTIC C_TI_AS "global injection time correction" VALUE 0x42a9e _REC_VAL_20_u1 1.99220002 _CNV_A_R_LINEAR_____34_CM 0. 1.99220002 FORMAT "%5.3" /end CHARACTERISTIC
/begin CHARACTERISTIC IP_V_EFC_LSH_UP_CTL "Open loop control effective heater voltage" MAP 0x50d11 _REC_MAP_20_u1_u1_u2 25.8984 _CNV_A_R_LINEAR_____26_CM 0. 25.8984 FORMAT "%3.1"
 /begin AXIS_DESCR COM_AXIS N_32 _CNV_A_R_LINEAR_____5_CM 6 0. 8160. FORMAT "%4.0" AXIS_PTS_REF ldpm_n_32_1_egcp /end AXIS_DESCR
 /begin AXIS_DESCR COM_AXIS TEG_CAT_UP_MDL_MAX _CNV_A_R_LINEAR_____211_CM 6 0. 2047. FORMAT "%7.2" AXIS_PTS_REF ldpm_teg_cat_up_mdl_1_egcp /end AXIS_DESCR
/end CHARACTERISTIC
/begin CHARACTERISTIC IP_PRS_INC_CMP "mean pressure increase in cylinder due to compression" MAP 0x49e4c _REC_MAP_20_u2_u2_u2 31.99951171875 _CNV_A_R_LINEAR_____379_CM 0. 31.99951171875 FORMAT "%7.4"
 /begin AXIS_DESCR COM_AXIS ONLINE_DUMMY _CNV_A_R_LINEAR_____75_CM 12 0. 720. FORMAT "%6.2" AXIS_PTS_REF ldp_eoi__prs_inc_cmp /end AXIS_DESCR
 /begin AXIS_DESCR COM_AXIS ONLINE_DUMMY _CNV_A_R_LINEAR_____75_CM 16 0. 600. FORMAT "%5.1" AXIS_PTS_REF ldp_crk_inj__prs_inc_cmp /end AXIS_DESCR
/end CHARACTERISTIC
/begin CHARACTERISTIC C_TI_MIN_THD "minimum threshold of the injection time limitation" VALUE 0x430a4 _REC_VAL_20_u2 262.14 _CNV_A_R_LINEAR_____208_CM 0. 262.14 FORMAT "%7.3" /end CHARACTERISTIC
/begin CHARACTERISTIC C_TI_MIN "minimum injection time limitation" VALUE 0x4309e _REC_VAL_20_u2 262.14 _CNV_A_R_LINEAR_____208_CM 0. 262.14 FORMAT "%7.3" /end CHARACTERISTIC
/begin CHARACTERISTIC IP_FAC_TI_PRS "Factor for correction of fuel injection due to pressure decrease at the injector" CURVE 0x47b6c _REC_CUR_20_u2_u2 31.99951171875 _CNV_A_R_LINEAR_____379_CM 0. 31.99951171875 FORMAT "%7.4"
 /begin AXIS_DESCR COM_AXIS FUP _CNV_A_R_LINEAR_____190_CM 12 0. 173888. FORMAT "%6.0" AXIS_PTS_REF ldpm_prs_dec_inj__fac_ti_prs /end AXIS_DESCR
/end CHARACTERISTIC
/begin CHARACTERISTIC ID_TCO_LAM_MIN_IS__TCO_ST "Minimum coolant temperature to close the A/F-loop in idle" CURVE 0x4cfbf _REC_CUR_20_u1_u1 190.5 _CNV_A_R_LINEAR_____0_CM -48. 142.5 FORMAT "%5.1"
 /begin AXIS_DESCR COM_AXIS TCO_ST _CNV_A_R_LINEAR_____0_CM 6 -48. 142.5 FORMAT "%5.1" AXIS_PTS_REF ldpm_tco_st_tco_lam_min /end AXIS_DESCR
/end CHARACTERISTIC
/begin CHARACTERISTIC ID_TCO_LAM_MIN__TCO_ST "Minimum coolant temperature to close the A/F-loop out of idle" CURVE 0x4cfb9 _REC_CUR_20_u1_u1 190.5 _CNV_A_R_LINEAR_____0_CM -48. 142.5 FORMAT "%5.1"
 /begin AXIS_DESCR COM_AXIS TCO_ST _CNV_A_R_LINEAR_____0_CM 6 -48. 142.5 FORMAT "%5.1" AXIS_PTS_REF ldpm_tco_st_tco_lam_min /end AXIS_DESCR
/end CHARACTERISTIC
/begin CHARACTERISTIC C_VLS_AFL "Threshold for detection of lean mixture" VALUE 0x43160 _REC_VAL_20_u2 4.99511719 _CNV_A_R_LINEAR_____33_CM 0. 4.99511719 FORMAT "%5.3" /end CHARACTERISTIC
/begin CHARACTERISTIC C_VLS_CRLC "Averaging constant for finding the values VLS_MMV_MIN_i resp. VLS_MMV_MAX_i" VALUE 0x43174 _REC_VAL_20_u2 0.99998474 _CNV_A_R_LINEAR_____31_CM 0. 0.99998474 FORMAT "%7.5" /end CHARACTERISTIC
/begin CHARACTERISTIC C_MAF_INT_MIN_DLY_PUC "threshold for MAF integral while restart of LAM after PUC " VALUE 0x42e32 _REC_VAL_20_u2 1820.398 _CNV_A_R_LINEAR_____277_CM 0. 1820.398 FORMAT "%7.2" /end CHARACTERISTIC
/begin CHARACTERISTIC C_TCO_MFF_AD_MIN "Minimum coolant temperature for adaptive learning" VALUE 0x42a63 _REC_VAL_20_u1 190.5 _CNV_A_R_LINEAR_____0_CM -48. 142.5 FORMAT "%5.1" /end CHARACTERISTIC
/begin CHARACTERISTIC C_FAC_MFF_TI_STND_2 "Injectionvalve characteristic for fuel mass flow to injection time at standard conditions" VALUE 0x42d24 _REC_VAL_20_u2 0.37745 _CNV_A_R_LINEAR_____581_CM 0. 0.37745 FORMAT "%7.5" /end CHARACTERISTIC
/begin CHARACTERISTIC C_FAC_MFF_TI_STND_1 "Injectionvalve characteristic for fuel mass flow to injection time at standard conditions" VALUE 0x42d22 _REC_VAL_20_u2 0.37745 _CNV_A_R_LINEAR_____581_CM 0. 0.37745 FORMAT "%7.5" /end CHARACTERISTIC
/begin AXIS_PTS ldpm_teg_cat_up_mdl_1_egcp "" 0x4548c TEG_CAT_UP_MDL _REC_AXS_20_u2 2047. _CNV_A_R_LINEAR_____211_CM 6 0. 2047. FORMAT "%7.2" /end AXIS_PTS
/begin AXIS_PTS ldpm_n_32_1_egcp "" 0x43ce4 N_32 _REC_AXS_20_u1 8160. _CNV_A_R_LINEAR_____5_CM 6 0. 8160. FORMAT "%4.0" /end AXIS_PTS
/begin AXIS_PTS ldp_eoi__prs_inc_cmp "" 0x44310 EOI_HOM _REC_AXS_20_u2 36. _CNV_A_R_LINEAR_____75_CM 12 0. 720. FORMAT "%6.2" /end AXIS_PTS
/begin AXIS_PTS ldp_crk_inj__prs_inc_cmp "" 0x44236 CRK_INJ _REC_AXS_20_u2 30. _CNV_A_R_LINEAR_____75_CM 16 0. 600. FORMAT "%5.1" /end AXIS_PTS
/begin AXIS_PTS ldpm_prs_dec_inj__fac_ti_prs "" 0x453ee FUP _REC_AXS_20_u2 173888. _CNV_A_R_LINEAR_____190_CM 12 0. 173888. FORMAT "%6.0" /end AXIS_PTS
/begin AXIS_PTS ldpm_n_32_s "" 0x43e91 N_32 _REC_AXS_20_u1 8160. _CNV_A_R_LINEAR_____5_CM 16 0. 8160. FORMAT "%4.0" /end AXIS_PTS
/begin AXIS_PTS ldpm_tco_st_tco_lam_min "" 0x4403d TCO_ST _REC_AXS_20_u1 190.5 _CNV_A_R_LINEAR_____0_CM 6 -48. 142.5 FORMAT "%5.1" /end AXIS_PTS
/begin AXIS_PTS ldpm_t_vls_cyc_afl_hld "" 0x43f25 T_VLS_CYC_AFL_HLD _REC_AXS_20_u1 2.55 _CNV_A_R_LINEAR_____27_CM 8 0. 2.55 FORMAT "%4.2" /end AXIS_PTS
/begin MEASUREMENT INJ_HOM_REQ "homogeneous injection requested, binary coded" UBYTE _CNV_A_R_LINEAR_____10_CM 1 100. 0. 255. ECU_ADDRESS 0x3fe46c FORMAT "%3.0" /end MEASUREMENT
/begin CHARACTERISTIC C_VLS_CUR_ON_MIN "Threshold for the oxygen sensor output signal for the activation of pumping" VALUE 0x43178 _REC_VAL_20_u2 4.99511719 _CNV_A_R_LINEAR_____33_CM 0. 4.99511719 FORMAT "%5.3" /end CHARACTERISTIC
/begin MEASUREMENT VLS_CUR_ON_VLS_UP_1 "Upstream oxygen sensor voltage C_T_CUR_ON_LS_UP after switching on pump current switch" UWORD _CNV_A_R_LINEAR_____33_CM 1 100. 0. 4.99511719 ECU_ADDRESS 0x3fc026 FORMAT "%5.3" /end MEASUREMENT
/begin MEASUREMENT VLS_CUR_ON_VLS_UP_2 "Upstream oxygen sensor voltage C_T_CUR_ON_LS_UP after switching on pump current switch" UWORD _CNV_A_R_LINEAR_____33_CM 1 100. 0. 4.99511719 ECU_ADDRESS 0x3fc03a FORMAT "%5.3" /end MEASUREMENT
/begin MEASUREMENT VLS_CUR_OFF_VLS_UP_2 "Upstream oxygen sensor voltage prior to switching on pump current switch" UWORD _CNV_A_R_LINEAR_____33_CM 1 100. 0. 4.99511719 ECU_ADDRESS 0x3fc03c FORMAT "%5.3" /end MEASUREMENT
/begin MEASUREMENT VLS_CUR_OFF_VLS_UP_1 "Upstream oxygen sensor voltage prior to switching on pump current switch" UWORD _CNV_A_R_LINEAR_____33_CM 1 100. 0. 4.99511719 ECU_ADDRESS 0x3fc028 FORMAT "%5.3" /end MEASUREMENT
/begin MEASUREMENT VLS_CUR_ON_VLS_DOWN_1 "Downstream oxygen sensor voltage C_T_CUR_ON_LS_DOWN after switching on pump current switch" UWORD _CNV_A_R_LINEAR_____33_CM 1 100. 0. 4.99511719 ECU_ADDRESS 0x3fc030 FORMAT "%5.3" /end MEASUREMENT
/begin MEASUREMENT VLS_CUR_ON_VLS_DOWN_2 "Downstream oxygen sensor voltage C_T_CUR_ON_LS_DOWN after switching on pump current switch" UWORD _CNV_A_R_LINEAR_____33_CM 1 100. 0. 4.99511719 ECU_ADDRESS 0x3fc044 FORMAT "%5.3" /end MEASUREMENT
/begin MEASUREMENT VLS_CUR_OFF_VLS_DOWN_2 "Downstream oxygen sensor voltage prior to switching on pump current switch" UWORD _CNV_A_R_LINEAR_____33_CM 1 100. 0. 4.99511719 ECU_ADDRESS 0x3fc046 FORMAT "%5.3" /end MEASUREMENT
/begin MEASUREMENT VLS_CUR_OFF_VLS_DOWN_1 "Downstream oxygen sensor voltage prior to switching on pump current switch" UWORD _CNV_A_R_LINEAR_____33_CM 1 100. 0. 4.99511719 ECU_ADDRESS 0x3fc032 FORMAT "%5.3" /end MEASUREMENT
/begin COMPU_METHOD _CNV_A_R_LINEAR_____0_CM "" RAT_FUNC "%6.3" "°C" COEFFS 0 1.333333333333333 64. 0 0 1 /end COMPU_METHOD
/begin COMPU_METHOD _CNV_A_R_LINEAR_____4_CM "" RAT_FUNC "%6.3" "%" COEFFS 0 2.56 0. 0 0 1 /end COMPU_METHOD
/begin COMPU_METHOD _CNV_A_R_LINEAR_____5_CM "" RAT_FUNC "%6.3" "rpm" COEFFS 0 3.125e-002 0. 0 0 1 /end COMPU_METHOD
/begin COMPU_METHOD _CNV_A_R_LINEAR_____10_CM "" RAT_FUNC "%6.3" "-" COEFFS 0 1. 0. 0 0 1 /end COMPU_METHOD
/begin COMPU_METHOD _CNV_S_2_RANGE______11_CM "" TAB_VERB "%6.3" "-" COMPU_TAB_REF _CNV_S_2_RANGE______11 /end COMPU_METHOD
/begin COMPU_VTAB _CNV_S_2_RANGE______11 "" TAB_VERB 2 0 "0" 1 "1" /end COMPU_VTAB
/begin COMPU_METHOD _CNV_A_R_LINEAR_____12_CM "" RAT_FUNC "%6.3" "[-]" COEFFS 0 1. 0. 0 0 1 /end COMPU_METHOD
/begin COMPU_METHOD _CNV_A_R_LINEAR_____13_CM "" RAT_FUNC "%6.3" "km/h" COEFFS 0 1. 0. 0 0 1 /end COMPU_METHOD
/begin COMPU_METHOD _CNV_A_R_LINEAR_____14_CM "" RAT_FUNC "%6.3" "s" COEFFS 0 10. 0. 0 0 1 /end COMPU_METHOD
/begin COMPU_METHOD _CNV_A_R_LINEAR_____17_CM "" RAT_FUNC "%6.3" "rpm" COEFFS 0 1. 0. 0 0 1 /end COMPU_METHOD
/begin COMPU_METHOD _CNV_A_R_LINEAR_____18_CM "" RAT_FUNC "%6.3" "mg/stk" COEFFS 0 0.183585313174946 0. 0 0 1 /end COMPU_METHOD
/begin COMPU_METHOD _CNV_A_R_LINEAR_____20_CM "" RAT_FUNC "%6.3" "-" COEFFS 0 255.9983911655618 0. 0 0 1 /end COMPU_METHOD
/begin COMPU_METHOD _CNV_A_R_LINEAR_____26_CM "" RAT_FUNC "%6.3" "V" COEFFS 0 9.846168103048838 0. 0 0 1 /end COMPU_METHOD
/begin COMPU_METHOD _CNV_A_R_LINEAR_____27_CM "" RAT_FUNC "%6.3" "s" COEFFS 0 100. 0. 0 0 1 /end COMPU_METHOD
/begin COMPU_METHOD _CNV_S_2_RANGE______28_CM "" TAB_VERB "%6.3" "[-]" COMPU_TAB_REF _CNV_S_2_RANGE______28 /end COMPU_METHOD
/begin COMPU_VTAB _CNV_S_2_RANGE______28 "" TAB_VERB 2 0 "0" 1 "1" /end COMPU_VTAB
/begin COMPU_METHOD _CNV_A_R_LINEAR_____31_CM "" RAT_FUNC "%6.3" "-" COEFFS 0 65536.00007936121 0. 0 0 1 /end COMPU_METHOD
/begin COMPU_METHOD _CNV_A_R_LINEAR_____33_CM "" RAT_FUNC "%6.3" "V" COEFFS 0 204.7999998974999 0. 0 0 1 /end COMPU_METHOD
/begin COMPU_METHOD _CNV_A_R_LINEAR_____34_CM "" RAT_FUNC "%6.3" "-" COEFFS 0 127.9991955827809 0. 0 0 1 /end COMPU_METHOD
/begin COMPU_METHOD _CNV_A_R_LINEAR_____40_CM "" RAT_FUNC "%6.3" "-" COEFFS 0 16. 0. 0 0 1 /end COMPU_METHOD
/begin COMPU_METHOD _CNV_A_R_LINEAR_____44_CM "" RAT_FUNC "%6.3" "[-]" COEFFS 0 255.9999357490357 0. 0 0 1 /end COMPU_METHOD
/begin COMPU_METHOD _CNV_A_R_LINEAR_____45_CM "" RAT_FUNC "%6.3" "-" COEFFS 0 32768.00003968061 0. 0 0 1 /end COMPU_METHOD
/begin COMPU_METHOD _CNV_A_R_LINEAR_____47_CM "" RAT_FUNC "%6.3" "s" COEFFS 0 1. 0. 0 0 1 /end COMPU_METHOD
/begin COMPU_METHOD _CNV_A_R_LINEAR_____48_CM "" RAT_FUNC "%6.3" "Nm" COEFFS 0 32. 0. 0 0 1 /end COMPU_METHOD
/begin COMPU_METHOD _CNV_A_R_LINEAR_____75_CM "" RAT_FUNC "%6.3" "°CRK" COEFFS 0 2.666666666666667 0. 0 0 1 /end COMPU_METHOD
/begin COMPU_METHOD _CNV_A_R_LINEAR_____94_CM "" RAT_FUNC "%6.3" "%" COEFFS 0 655.3600000071681 0. 0 0 1 /end COMPU_METHOD
/begin COMPU_METHOD _CNV_A_R_LINEAR_____95_CM "" RAT_FUNC "%6.3" "mg/stk" COEFFS 0 47.18142548596112 0. 0 0 1 /end COMPU_METHOD
/begin COMPU_METHOD _CNV_A_R_LINEAR_____98_CM "" RAT_FUNC "%6.3" "%" COEFFS 0 655.3600000071681 3.584063961170614e-007 0 0 1 /end COMPU_METHOD
/begin COMPU_METHOD _CNV_A_R_LINEAR_____101_CM "" RAT_FUNC "%6.3" "kg/h" COEFFS 0 32. 0. 0 0 1 /end COMPU_METHOD
/begin COMPU_METHOD _CNV_A_R_LINEAR_____103_CM "" RAT_FUNC "%6.3" "-" COEFFS 0 128. 0. 0 0 1 /end COMPU_METHOD
/begin COMPU_METHOD _CNV_A_R_LINEAR_____113_CM "" RAT_FUNC "%6.3" "-" COEFFS 0 16383.75 0. 0 0 1 /end COMPU_METHOD
/begin COMPU_METHOD _CNV_A_R_LINEAR_____141_CM "" RAT_FUNC "%6.3" "-" COEFFS 0 64. 0. 0 0 1 /end COMPU_METHOD
/begin COMPU_METHOD _CNV_A_R_LINEAR_____148_CM "" RAT_FUNC "%6.3" "-" COEFFS 0 1023.999999919998 0. 0 0 1 /end COMPU_METHOD
/begin COMPU_METHOD _CNV_A_R_LINEAR_____160_CM "" RAT_FUNC "%6.3" "°C" COEFFS 0 0.25 8.25 0 0 1 /end COMPU_METHOD
/begin COMPU_METHOD _CNV_A_R_LINEAR_____169_CM "" RAT_FUNC "%6.3" "s" COEFFS 0 50. 0. 0 0 1 /end COMPU_METHOD
/begin COMPU_METHOD _CNV_A_R_LINEAR_____190_CM "" RAT_FUNC "%6.3" "hPa" COEFFS 0 0.3768805207949945 0. 0 0 1 /end COMPU_METHOD
/begin COMPU_METHOD _CNV_A_R_LINEAR_____195_CM "" RAT_FUNC "%6.3" "[-]" COEFFS 0 64. 0. 0 0 1 /end COMPU_METHOD
/begin COMPU_METHOD _CNV_A_R_LINEAR_____208_CM "" RAT_FUNC "%6.3" "ms" COEFFS 0 250. 0. 0 0 1 /end COMPU_METHOD
/begin COMPU_METHOD _CNV_A_R_LINEAR_____211_CM "" RAT_FUNC "%6.3" "°C" COEFFS 0 16. 0. 0 0 1 /end COMPU_METHOD
/begin COMPU_METHOD _CNV_A_R_LINEAR_____218_CM "" RAT_FUNC "%6.3" "Nm" COEFFS 0 32. 32768. 0 0 1 /end COMPU_METHOD
/begin COMPU_METHOD _CNV_A_R_LINEAR_____232_CM "" RAT_FUNC "%6.3" "°CRK" COEFFS 0 42.66666666666666 0. 0 0 1 /end COMPU_METHOD
/begin COMPU_METHOD _CNV_A_R_LINEAR_____256_CM "" RAT_FUNC "%6.3" "V" COEFFS 0 13107.19998965744 0. 0 0 1 /end COMPU_METHOD
/begin COMPU_METHOD _CNV_A_R_LINEAR_____267_CM "" RAT_FUNC "%6.3" "-" COEFFS 0 256. 0. 0 0 1 /end COMPU_METHOD
/begin COMPU_METHOD _CNV_A_R_LINEAR_____268_CM "" RAT_FUNC "%6.3" "ms" COEFFS 0 51.20321900148448 0. 0 0 1 /end COMPU_METHOD
/begin COMPU_METHOD _CNV_A_R_LINEAR_____269_CM "" RAT_FUNC "%6.3" "°C" COEFFS 0 43.47840509520334 2086.96344456976 0 0 1 /end COMPU_METHOD
/begin COMPU_METHOD _CNV_A_R_LINEAR_____271_CM "" RAT_FUNC "%6.3" "-" COEFFS 0 16383.75 32767.5 0 0 1 /end COMPU_METHOD
/begin COMPU_METHOD _CNV_A_R_LINEAR_____272_CM "" RAT_FUNC "%6.3" "-" COEFFS 0 16383.99999935999 -1.280019205296412e-006 0 0 1 /end COMPU_METHOD
/begin COMPU_METHOD _CNV_A_R_LINEAR_____273_CM "" RAT_FUNC "%6.3" "[-]" COEFFS 0 1023.999999959999 32767.99999871998 0 0 1 /end COMPU_METHOD
/begin COMPU_METHOD _CNV_A_R_LINEAR_____274_CM "" RAT_FUNC "%6.3" "°C" COEFFS 0 43.47826086956522 0. 0 0 1 /end COMPU_METHOD
/begin COMPU_METHOD _CNV_A_R_LINEAR_____275_CM "" RAT_FUNC "%6.3" "s" COEFFS 0 2. 0. 0 0 1 /end COMPU_METHOD
/begin COMPU_METHOD _CNV_A_R_LINEAR_____277_CM "" RAT_FUNC "%6.3" "g" COEFFS 0 36.00036915004301 0. 0 0 1 /end COMPU_METHOD
/begin COMPU_METHOD _CNV_A_R_LINEAR_____278_CM "" RAT_FUNC "%6.3" "ms" COEFFS 0 51.19999999799997 -1.280015567317605e-006 0 0 1 /end COMPU_METHOD
/begin COMPU_METHOD _CNV_A_R_LINEAR_____279_CM "" RAT_FUNC "%6.3" "ms" COEFFS 0 12.8 0. 0 0 1 /end COMPU_METHOD
/begin COMPU_METHOD _CNV_A_R_LINEAR_____280_CM "" RAT_FUNC "%6.3" "ms" COEFFS 0 2.133333333333333 0. 0 0 1 /end COMPU_METHOD
/begin COMPU_METHOD _CNV_A_R_LINEAR_____281_CM "" RAT_FUNC "%6.3" "V" COEFFS 0 13107. 0. 0 0 1 /end COMPU_METHOD
/begin COMPU_METHOD _CNV_A_R_LINEAR_____282_CM "" RAT_FUNC "%6.3" "V/10ms" COEFFS 0 13107.26214524291 0.1553631072602002 0 0 1 /end COMPU_METHOD
/begin COMPU_METHOD _CNV_A_R_LINEAR_____283_CM "" RAT_FUNC "%6.3" "V/10ms" COEFFS 0 13107.20001587224 0. 0 0 1 /end COMPU_METHOD
/begin COMPU_METHOD _CNV_A_R_LINEAR_____284_CM "" RAT_FUNC "%6.3" "[-]" COEFFS 0 4. 0. 0 0 1 /end COMPU_METHOD
/begin COMPU_METHOD _CNV_A_R_LINEAR_____285_CM "" RAT_FUNC "%6.3" "ohm" COEFFS 0 1. 0. 0 0 1 /end COMPU_METHOD
/begin COMPU_METHOD _CNV_A_R_LINEAR_____286_CM "" RAT_FUNC "%6.3" "°C" COEFFS 0 15.99999804684544 -4.000060547696194e-003 0 0 1 /end COMPU_METHOD
/begin COMPU_METHOD _CNV_S_6_STATE_LSH__287_CM "" TAB_VERB "%6.3" "[-]" COMPU_TAB_REF _CNV_S_6_STATE_LSH__287 /end COMPU_METHOD
/begin COMPU_VTAB _CNV_S_6_STATE_LSH__287 "" TAB_VERB 6 0 "LSH_OFF_DOWN" 1 "PREHEATING_DOWN" 2 "LSH_POW_RED_DOWN" 3 "HEATING_GRD_DOWN" 4 "HEATING_DOWN" 5 "VB_PROTECTION_DOWN" /end COMPU_VTAB
/begin COMPU_METHOD _CNV_S_7_STATE_LSH__296_CM "" TAB_VERB "%6.3" "[-]" COMPU_TAB_REF _CNV_S_7_STATE_LSH__296 /end COMPU_METHOD
/begin COMPU_VTAB _CNV_S_7_STATE_LSH__296 "" TAB_VERB 7 0 "LSH_OFF" 1 "LSH_POW_RISE" 2 "LSH_POW_RED" 3 "LSH_POW_FALL" 4 "LSH_POW_CTL" 5 "LSH_VB_PROT" 6 "LSH_TEMP_PROT" /end COMPU_VTAB
/begin COMPU_METHOD _CNV_A_R_LINEAR_____297_CM "" RAT_FUNC "%6.3" "V" COEFFS 0 2520.615410935313 0. 0 0 1 /end COMPU_METHOD
/begin COMPU_METHOD _CNV_A_R_LINEAR_____298_CM "" RAT_FUNC "%6.3" "V" COEFFS 0 9.807692307692308 -9.615384615372591e-003 0 0 1 /end COMPU_METHOD
/begin COMPU_METHOD _CNV_A_R_LINEAR_____299_CM "" RAT_FUNC "%6.3" "V" COEFFS 0 2510.919540229885 -0.499999999996362 0 0 1 /end COMPU_METHOD
/begin COMPU_METHOD _CNV_A_R_LINEAR_____300_CM "" RAT_FUNC "%6.3" "-" COEFFS 0 16383.96875 0. 0 0 1 /end COMPU_METHOD
/begin COMPU_METHOD _CNV_A_R_LINEAR_____304_CM "" RAT_FUNC "%6.3" "%/s" COEFFS 0 0.1024000000600009 0. 0 0 1 /end COMPU_METHOD
/begin COMPU_METHOD _CNV_A_R_LINEAR_____306_CM "" RAT_FUNC "%6.3" "-" COEFFS 0 100. 0. 0 0 1 /end COMPU_METHOD
/begin COMPU_METHOD _CNV_A_R_LINEAR_____308_CM "" RAT_FUNC "%6.3" "-" COEFFS 0 33097.9797979798 -329.979797979795 0 0 1 /end COMPU_METHOD
/begin COMPU_METHOD _CNV_A_R_LINEAR_____309_CM "" RAT_FUNC "%6.3" "mg" COEFFS 0 6.25 0. 0 0 1 /end COMPU_METHOD
/begin COMPU_METHOD _CNV_A_R_LINEAR_____310_CM "" RAT_FUNC "%6.3" "-" COEFFS 0 16383.99985599781 0. 0 0 1 /end COMPU_METHOD
/begin COMPU_METHOD _CNV_A_R_LINEAR_____311_CM "" RAT_FUNC "%6.3" "[-]" COEFFS 0 1024.000014000427 16384.00022400684 0 0 1 /end COMPU_METHOD
/begin COMPU_METHOD _CNV_A_R_LINEAR_____312_CM "" RAT_FUNC "%6.3" "ms" COEFFS 0 51.19999998999985 32767.9999935999 0 0 1 /end COMPU_METHOD
/begin COMPU_METHOD _CNV_A_R_LINEAR_____313_CM "" RAT_FUNC "%6.3" "V" COEFFS 0 204.8979314017341 1023.5 0 0 1 /end COMPU_METHOD
/begin COMPU_METHOD _CNV_A_R_LINEAR_____314_CM "" RAT_FUNC "%6.3" "-" COEFFS 0 63.60176282051283 0. 0 0 1 /end COMPU_METHOD
/begin COMPU_METHOD _CNV_A_R_LINEAR_____315_CM "" RAT_FUNC "%6.3" "%/s" COEFFS 0 0.1024000154202376 0. 0 0 1 /end COMPU_METHOD
/begin COMPU_METHOD _CNV_A_R_LINEAR_____319_CM "" RAT_FUNC "%6.3" "s" COEFFS 0 1000. 0. 0 0 1 /end COMPU_METHOD
/begin COMPU_METHOD _CNV_A_R_LINEAR_____320_CM "" RAT_FUNC "%6.3" "1/s" COEFFS 0 255.9983911655618 0. 0 0 1 /end COMPU_METHOD
/begin COMPU_METHOD _CNV_A_R_LINEAR_____321_CM "" RAT_FUNC "%6.3" "°C" COEFFS 0 15.99975585564965 0. 0 0 1 /end COMPU_METHOD
/begin COMPU_METHOD _CNV_A_R_LINEAR_____322_CM "" RAT_FUNC "%6.3" "g" COEFFS 0 35.99999934081027 0. 0 0 1 /end COMPU_METHOD
/begin COMPU_METHOD _CNV_A_R_LINEAR_____323_CM "" RAT_FUNC "%6.3" "V" COEFFS 0 65536.00007936121 0. 0 0 1 /end COMPU_METHOD
/begin COMPU_METHOD _CNV_A_R_LINEAR_____324_CM "" RAT_FUNC "%6.3" "V" COEFFS 0 255.9983911655618 0. 0 0 1 /end COMPU_METHOD
/begin COMPU_METHOD _CNV_A_R_LINEAR_____326_CM "" RAT_FUNC "%6.3" "°C" COEFFS 0 15.99999804684544 32767.99599993945 0 0 1 /end COMPU_METHOD
/begin COMPU_METHOD _CNV_A_R_LINEAR_____327_CM "" RAT_FUNC "%6.3" "V/K" COEFFS 0 1000. 0. 0 0 1 /end COMPU_METHOD
/begin COMPU_METHOD _CNV_A_R_LINEAR_____328_CM "" RAT_FUNC "%6.3" "V/100ms" COEFFS 0 156.9230769230769 0. 0 0 1 /end COMPU_METHOD
/begin COMPU_METHOD _CNV_A_R_LINEAR_____329_CM "" RAT_FUNC "%6.3" "-" COEFFS 0 40.17013232514178 0. 0 0 1 /end COMPU_METHOD
/begin COMPU_METHOD _CNV_A_R_LINEAR_____379_CM "" RAT_FUNC "%6.3" "-" COEFFS 0 2048. 0. 0 0 1 /end COMPU_METHOD
/begin COMPU_METHOD _CNV_A_R_LINEAR_____432_CM "" RAT_FUNC "%6.3" "-" COEFFS 0 4095.999999839998 0. 0 0 1 /end COMPU_METHOD
/begin COMPU_METHOD _CNV_A_R_LINEAR_____581_CM "" RAT_FUNC "%6.3" "ms/(mg/stk)" COEFFS 0 173625.6457808981 0. 0 0 1 /end COMPU_METHOD
/begin RECORD_LAYOUT _REC_VAL_20_u1 FNC_VALUES 1 UBYTE COLUMN_DIR DIRECT /end RECORD_LAYOUT
/begin RECORD_LAYOUT _REC_AXS_20_u1 NO_AXIS_PTS_X 1 UBYTE AXIS_PTS_X 2 UBYTE INDEX_INCR DIRECT /end RECORD_LAYOUT
/begin RECORD_LAYOUT _REC_CUR_20_u1_u1 FNC_VALUES 1 UBYTE COLUMN_DIR DIRECT /end RECORD_LAYOUT
/begin RECORD_LAYOUT _REC_MAP_20_u2_u2_u1 FNC_VALUES 1 UWORD COLUMN_DIR DIRECT /end RECORD_LAYOUT
/begin RECORD_LAYOUT _REC_AXS_20_u2 NO_AXIS_PTS_X 1 UWORD AXIS_PTS_X 2 UWORD INDEX_INCR DIRECT /end RECORD_LAYOUT
/begin RECORD_LAYOUT _REC_CUR_20_u2_u2 FNC_VALUES 1 UWORD COLUMN_DIR DIRECT /end RECORD_LAYOUT
/begin RECORD_LAYOUT _REC_VAL_20_u2 FNC_VALUES 1 UWORD COLUMN_DIR DIRECT /end RECORD_LAYOUT
/begin RECORD_LAYOUT _REC_CUR_20_u2_u1 FNC_VALUES 1 UWORD COLUMN_DIR DIRECT /end RECORD_LAYOUT
/begin RECORD_LAYOUT _REC_MAP_20_u1_u1_u2 FNC_VALUES 1 UBYTE COLUMN_DIR DIRECT /end RECORD_LAYOUT
/begin RECORD_LAYOUT _REC_CUR_20_u1_u2 FNC_VALUES 1 UBYTE COLUMN_DIR DIRECT /end RECORD_LAYOUT
/begin RECORD_LAYOUT _REC_MAP_20_u2_u1_u1 FNC_VALUES 1 UWORD COLUMN_DIR DIRECT /end RECORD_LAYOUT
/begin RECORD_LAYOUT _REC_MAP_20_u2_u1_u2 FNC_VALUES 1 UWORD COLUMN_DIR DIRECT /end RECORD_LAYOUT
/begin RECORD_LAYOUT _REC_VAL_20_s2 FNC_VALUES 1 SWORD COLUMN_DIR DIRECT /end RECORD_LAYOUT
/begin RECORD_LAYOUT _REC_VAL_20_s1 FNC_VALUES 1 SBYTE COLUMN_DIR DIRECT /end RECORD_LAYOUT
/begin RECORD_LAYOUT _REC_MAP_20_u2_u2_u2 FNC_VALUES 1 UWORD COLUMN_DIR DIRECT /end RECORD_LAYOUT
/begin FUNCTION INJ_Upstream_oxygen_sensor_signa "_Upstream oxygen sensor signal voltage VLS"
 /begin DEF_CHARACTERISTIC C_T_CUR_DLY_LS_UP C_T_CUR_ON_LS_UP C_T_CUR_OFF_LS_UP C_VLS_MMV_MIN_RNG_TOL_LS_UP C_VLS_MMV_MIN_RNG_BOL_LS_UP C_DRV1_VLS_UP_MMV_THD_MIN C_DRV1_VLS_UP_MMV_THD_MAX C_FAC_STK_DRV1_VLS_UP_MMV C_FAC_DRV1_VLS_UP_MMV_MIN C_CTR_VLS_AFL_CYC_R_UP_LS C_MAF_KGH_R_UP_LS C_FAC_ERR_POS_R_UP_LS C_FAC_ERR_NEG_R_UP_LS C_CRLC_TTIP_FALL_R_UP_LS C_CRLC_TTIP_RISE_R_UP_LS C_DRV1_VLS_UP_ABS_MAX C_MAF_INT_PUC_UP_LS ID_T_MAX_LS C_VLS_AFR C_VLS_INI_MAX C_VLS_INI_MIN C_VLS_CRLC_OFF C_CTR_VLS_UP_AFL_CYC_MIN IP_T_AFL_LOCK C_FAC_VLS_UP_MMV_HYS C_VLS_UP_MMV_HYS_MIN C_VLS_AFL C_VLS_CRLC C_VLS_CUR_ON_MIN /end DEF_CHARACTERISTIC
 /begin OUT_MEASUREMENT LV_UP_LS_1 LV_UP_LS_CDN_1 LV_AFL_1 LV_VLS_UP_MMV_LMT_1 LV_VLS_UP_MMV_STK_VLD_1 CTR_VLS_AFL_CYC_1 DRV1_VLS_UP_ABS_MAX_1 DRV1_VLS_UP_MMV_1 DRV1_VLS_UP_MMV_MIN_1 T_AFL_LOCK_1 T_VLS_CYC_AFL_1 T_VLS_CYC_AFL_HLD_1 T_VLS_CYC_AFR_1 VLS_BOL_1 VLS_MMV_MAX_1 VLS_MMV_MIN_1 VLS_TOL_1 LV_UP_LS_2 LV_UP_LS_CDN_2 LV_AFL_2 LV_VLS_UP_MMV_LMT_2 LV_VLS_UP_MMV_STK_VLD_2 CTR_VLS_AFL_CYC_2 DRV1_VLS_UP_ABS_MAX_2 DRV1_VLS_UP_MMV_2 DRV1_VLS_UP_MMV_MIN_2 T_AFL_LOCK_2 T_VLS_CYC_AFL_2 T_VLS_CYC_AFL_HLD_2 T_VLS_CYC_AFR_2 VLS_BOL_2 VLS_MMV_MAX_2 VLS_MMV_MIN_2 VLS_TOL_2 /end OUT_MEASUREMENT
/end FUNCTION
/begin FUNCTION INJ_Upstream_oxygen_sensor_heate "_Upstream oxygen sensor heater managment LSH"
 /begin DEF_CHARACTERISTIC IP_T_LSH_TEMP_THD IP_FAC_NEG_P_LSH_UP_CTL IP_FAC_POS_P_LSH_UP_CTL IP_FAC_NEG_I_LSH_UP_CTL IP_FAC_POS_I_LSH_UP_CTL IP_FAC_V_EFC_TEG C_V_EFC_LSH_UP_TOL C_V_EFC_RED C_V_EFC_LSH_UP_PROT C_T_LSH_UP_TOL C_V_EFC_LSH_UP_LIM C_VB_PROT_MAX C_T_LSH_RISE C_INC_V_EFC C_FAC_V_EFC_LSH_UP_AS C_DEC_V_EFC IP_V_EFC_LSH_UP_INI C_V_EFC_LSH_UP_STEP C_V_EFC_LSH_UP_AS C_T_LSH_UP_LIM C_T_LSH_UP_MAX_STEP C_V_EFC_LSH_UP_MAX C_V_EFC_LSH_UP_MAX_ST C_TTIP_LS_UP_SET_1 C_TTIP_LS_UP_SET_2 C_TTIP_LS_UP_DIF_MIN_P_ADD C_FAC_P_LSH_UP_CTL C_FAC_I_LSH_UP_CTL C_TEG_CAT_UP_MDL_MAX_LSH_UP LC_INH_LSH_UP_CLL_CTL_1 LC_INH_LSH_UP_CLL_CTL_2 LC_LSH_UP_CLL_CTL_2 LC_TTIP_LS_UP_MES_VLD_1 LC_TTIP_LS_UP_MES_VLD_2 LC_LSH_UP_CLL_CTL_1 IP_V_EFC_LSH_UP_CTL /end DEF_CHARACTERISTIC
 /begin OUT_MEASUREMENT LV_INH_LSH_UP_1 LV_INH_LSH_UP_CLL_CTL_1 LV_TTIP_LS_UP_MES_VLD_1 LV_V_TEMP_LS_UP_REF_VLD_1 TEMP_LS_INI_1 LV_LSH_UP_CLL_CTL_1 LV_V_EFC_LSH_UP_LIM_BOL_1 LV_V_EFC_LSH_UP_LIM_TOL_1 LV_V_EFC_LSH_UP_LIM_MAX_1 LV_POW_CTL_ACT_1 T_LSH_UP_1 LSHPWM_UP_1 V_EFC_LSH_UP_1 T_LSH_UP_TOL_1 T_LSH_UP_LIM_1 STATE_LSH_UP_1 V_EFC_LSH_UP_CLC_1 V_EFC_LSH_UP_CTL_ADD_1 V_EFC_LSH_UP_CTL_P_ADD_1 V_EFC_LSH_UP_CTL_I_ADD_1 TTIP_LS_UP_DIF_SET_MES_1 LV_INH_LSH_UP_2 LV_INH_LSH_UP_CLL_CTL_2 LV_TTIP_LS_UP_MES_VLD_2 LV_V_TEMP_LS_UP_REF_VLD_2 TEMP_LS_INI_2 LV_LSH_UP_CLL_CTL_2 LV_V_EFC_LSH_UP_LIM_BOL_2 LV_V_EFC_LSH_UP_LIM_TOL_2 LV_V_EFC_LSH_UP_LIM_MAX_2 LV_POW_CTL_ACT_2 T_LSH_UP_2 LSHPWM_UP_2 V_EFC_LSH_UP_2 T_LSH_UP_TOL_2 T_LSH_UP_LIM_2 STATE_LSH_UP_2 V_EFC_LSH_UP_CLC_2 V_EFC_LSH_UP_CTL_ADD_2 V_EFC_LSH_UP_CTL_P_ADD_2 V_EFC_LSH_UP_CTL_I_ADD_2 TTIP_LS_UP_DIF_SET_MES_2 LV_V_EFC_LSH_UP_PROT /end OUT_MEASUREMENT
/end FUNCTION
/begin FUNCTION INJ_Lambda_control_A_F_Feedback_ "_Lambda control A/F Feedback Loop"
 /begin DEF_CHARACTERISTIC C_LAM_N_MIN ID_TCO_LAM_MIN_IS__TCO_ST ID_TCO_LAM_MIN__TCO_ST /end DEF_CHARACTERISTIC
 /begin OUT_MEASUREMENT LV_LAM_TCO_LSCL LV_LSCL_1 LV_LSCL_CAT_PURGE_1 LV_LAM_ONCE_ACT_1 LV_LSCL_2 LV_LSCL_CAT_PURGE_2 LV_LAM_ONCE_ACT_2 /end OUT_MEASUREMENT
/end FUNCTION
/begin FUNCTION INJ_Lambda_control_correction_TI "_Lambda control correction TI_LAM_COR"
 /begin DEF_CHARACTERISTIC C_LAM_FAC_I C_LAM_FAC_P C_LAM_INI_MIN C_LAM_MIN C_LAM_MAX C_LAM_INI_MAX C_LAM_MV_LPF_CRLC IP_LAM_NEG_P C_LAM_SUM_P_IS C_CL_MAX_LAM_IS IP_LAM_POS_P IP_LAM_POS_P_IS IP_LAM_NEG_P_IS IP_LAM_I_IS_2 IP_LAM_I_IS_1 IP_LAM_I_1 IP_LAM_I_2 IP_T_LAM_DLY_POS_AT_2 IP_T_LAM_DLY_NEG_AT_2 IP_T_LAM_DLY_NEG_AT_1 IP_T_LAM_DLY_POS_MT_1 IP_T_LAM_DLY_POS_MT_2 IP_T_LAM_DLY_NEG_MT_2 IP_T_LAM_DLY_NEG_MT_1 IP_T_LAM_DLY_POS_AT_1 IP_T_LAM_DLY_POS_IS_AT_2 IP_T_LAM_DLY_NEG_IS_AT_2 IP_T_LAM_DLY_NEG_IS_AT_1 IP_T_LAM_DLY_POS_IS_AT_1 IP_T_LAM_DLY_POS_IS_MT_1 IP_T_LAM_DLY_POS_IS_MT_2 IP_T_LAM_DLY_NEG_IS_MT_2 IP_T_LAM_DLY_NEG_IS_MT_1 IP_T_LAM_DLY_NEG_TCO IP_T_LAM_DLY_POS_TCO IP_T_LAM_DLY_POS_TEG_CAT IP_T_LAM_DLY_NEG_TEG_CAT IP_CRLC_LAM_MV_LPF_CP C_MAF_DYW C_N_DYW C_LAM_MV_DYW C_LAM_CYCNR /end DEF_CHARACTERISTIC
 /begin OUT_MEASUREMENT LV_LAM_LIM_MAX_1 LV_LAM_LIM_MIN_1 LV_LAM_DYW_1 LV_N_MAF_DYW_1 LV_LAM_ADJ_AD_END_1 LAM_1 LAM_MV_1 LAM_MV_LPF_1 LAM_P_CTR_1 T_LAM_DLY_NEG_1 T_LAM_DLY_POS_1 TI_LAM_MAX_1 TI_LAM_MIN_1 TI_LAM_COR_1 T_LAM_DLY_POS_BAS_1 T_LAM_DLY_NEG_BAS_1 LAM_MV_LPF_CP_1 MAF_DYW_1 N_DYW_1 LAM_MV_DYW_1 LV_LAM_LIM_MAX_2 LV_LAM_LIM_MIN_2 LV_LAM_DYW_2 LV_N_MAF_DYW_2 LV_LAM_ADJ_AD_END_2 LAM_2 LAM_MV_2 LAM_MV_LPF_2 LAM_P_CTR_2 T_LAM_DLY_NEG_2 T_LAM_DLY_POS_2 TI_LAM_MAX_2 TI_LAM_MIN_2 TI_LAM_COR_2 T_LAM_DLY_POS_BAS_2 T_LAM_DLY_NEG_BAS_2 LAM_MV_LPF_CP_2 MAF_DYW_2 N_DYW_2 LAM_MV_DYW_2 /end OUT_MEASUREMENT
/end FUNCTION
/begin FUNCTION INJ_Application_incidence_for_th "_Application incidence for the lambda Adaptation" /begin DEF_CHARACTERISTIC C_MAF_MFF_AD_MAX C_TIA_MFF_AD_MAX C_TCO_MFF_AD_MIN /end DEF_CHARACTERISTIC /begin OUT_MEASUREMENT LV_MFF_AD_ACT_1 LV_MFF_AD_ACT_2 /end OUT_MEASUREMENT /end FUNCTION
/begin FUNCTION INJ_Downstream_fuel_trim_regulat "_Downstream fuel trim regulation by LAM - P - Jump delay time"
 /begin DEF_CHARACTERISTIC C_CAT_DIAG_MAX_DLY C_MAF_INT_MIN_DLY C_LAM_TEMP_MIN_CAT_DLY C_N_LAM_DLY_P_MAX C_N_LAM_DLY_P_MIN C_MAF_LAM_DLY_P_MAX C_MAF_LAM_DLY_P_MIN IP_FAC_DLY_P__MAF_KGH IP_MAF_LAM_DLY_I_MIN__N IP_FAC_LAM_DLY__N__MAF IP_CRLC_DLY_I__MAF_KGH IP_MAF_LAM_DLY_I_MAX__N IP_VLS_SP_DLY__N__MAF IP_T_DLY_I_1__VLS_DIF_DLY IP_T_DLY_I_2__VLS_DIF_DLY C_CRLC_DLY_AD C_CRLC_DLY_I_MV IP_FAC_CAT_DLY_1__CAT_DIAG IP_FAC_CAT_DLY_2__CAT_DIAG C_T_DLY_I_MV_UPD_CYC IP_T_DLY_P_1__VLS_DIF_DLY IP_T_DLY_P_2__VLS_DIF_DLY C_T_DLY_I_MIN C_T_DLY_AD_MIN C_T_DLY_I_MAX C_T_DLY_AD_MAX C_MAF_INT_MIN_DLY_PUC /end DEF_CHARACTERISTIC
 /begin OUT_MEASUREMENT LV_DELTA_LAMB_1 LV_LAM_DLY_PER_VLD_1 FAC_CAT_DLY_1 MAF_INT_DLY_1 T_DLY_I_1 T_DLY_I_AD_1 T_DLY_P_1 T_LAM_DLY_1 VLS_DIF_DLY_1 LV_DELTA_LAMB_2 LV_LAM_DLY_PER_VLD_2 FAC_CAT_DLY_2 MAF_INT_DLY_2 T_DLY_I_2 T_DLY_I_AD_2 T_DLY_P_2 T_LAM_DLY_2 VLS_DIF_DLY_2 /end OUT_MEASUREMENT
/end FUNCTION
/begin FUNCTION INJ_Detection_of_limited_dynamic "_Detection of limited dynamic condition for dynamic fuel trim"
 /begin DEF_CHARACTERISTIC C_MAF_CRLC_DLY C_LAM_MV_CRLC_DLY C_N_DYW_DLY C_MAF_DYW_DLY C_LAM_MV_DYW_DLY C_N_CRLC_DLY C_PV_AV_GRD_DEC_DLY C_PV_AV_GRD_SUM_MAX_DLY C_PV_AV_GRD_SUM_MIN_DLY C_T_PV_AV_GRD_DEC_SUM_DLY /end DEF_CHARACTERISTIC
 /begin OUT_MEASUREMENT LV_LDC_DLY_1 LV_LAM_MV_LDC_DLY_1 LAM_MV_MMV_DLY_1 MAF_INT_LDC_DLY_1 PV_AV_GRD_SUM_DLY_1 LV_LDC_DLY_2 LV_LAM_MV_LDC_DLY_2 LAM_MV_MMV_DLY_2 MAF_INT_LDC_DLY_2 PV_AV_GRD_SUM_DLY_2 MAF_MMV_DLY N_MMV_DLY LV_N_LDC_DLY LV_MAF_LDC_DLY /end OUT_MEASUREMENT
/end FUNCTION
/begin FUNCTION INJ_Downstream_oxygen_sensor_sig "_Downstream oxygen sensor signal voltage"
 /begin DEF_CHARACTERISTIC C_MAF_INT_PUC_MAX_DOWN_LS_READY C_VLS_DOWN_AFL_READY C_VLS_DOWN_AFR_READY C_VLS_AFL_READY C_VLS_AFR_READY C_VLS_DOWN_MMV_HYS_MIN C_VLS_DOWN_INI_MIN C_VLS_DOWN_INI_MAX C_VLS_DOWN_CRLC C_VLS_DOWN_CRLC_OFF C_FAC_VLS_DOWN_MMV_HYS C_T_DLY_PUC_END_VLS_DOWN /end DEF_CHARACTERISTIC
 /begin OUT_MEASUREMENT LV_VLS_DOWN_MMV_ACT_1 LV_VLS_DOWN_MMV_LMT_1 LV_TEG_MIN_THD_PREV_1 R_DOWN_LS_1 VLS_UP_MMV_HYS_1 LV_VLS_DOWN_MMV_ACT_2 LV_VLS_DOWN_MMV_LMT_2 LV_TEG_MIN_THD_PREV_2 R_DOWN_LS_2 VLS_UP_MMV_HYS_2 /end OUT_MEASUREMENT
/end FUNCTION
/begin FUNCTION INJ_Downstream_oxygen_sensor_hea "_Downstream oxygen sensor heater managment LSH_DOWN"
 /begin DEF_CHARACTERISTIC C_V_EFC_LSH_DOWN_TOL C_V_EFC_LSH_DOWN_MAX C_V_EFC_LSH_DOWN_PROT C_T_LSH_DOWN_TOL C_V_EFC_LSH_DOWN_LIM C_V_EFC_LSH_DOWN_AS IP_V_EFC_LSH_DOWN_CTL IP_V_EFC_LSH_DOWN_INI IP_T_LSH_DOWN_TEMP_THD IP_FAC_V_EFC_DOWN_TEG C_DEC_V_EFC_DOWN C_INC_V_EFC_DOWN C_V_EFC_DOWN_RED C_T_LSH_DOWN_LIM C_T_LSH_DOWN_RISE C_VB_PROT_DOWN_MAX C_V_EFC_LSH_DOWN_STEP C_T_LSHPWM_DOWN_FAST_VB_COR C_FAC_V_EFC_LSH_DOWN_AS /end DEF_CHARACTERISTIC
 /begin OUT_MEASUREMENT LSHPWM_DOWN_1 T_LSH_DOWN_1 V_EFC_LSH_DOWN_1 T_LSH_DOWN_TOL_1 T_LSH_DOWN_LIM_1 STATE_LSH_DOWN_1 LSHPWM_DOWN_2 T_LSH_DOWN_2 V_EFC_LSH_DOWN_2 T_LSH_DOWN_TOL_2 T_LSH_DOWN_LIM_2 STATE_LSH_DOWN_2 /end OUT_MEASUREMENT
/end FUNCTION
/begin FUNCTION INJ_Injection_fuel_setpoint_for_ "_Injection fuel setpoint for homogeneous mode"
 /begin DEF_CHARACTERISTIC C_MFF_SP_MAN C_MFF_SP_HOM_OFS_AS IP_MFF_COR_2 IP_MFF_COR_1 LC_MFF_SP_HOM_MAN_ACT IP_MFF_LGRD_AST /end DEF_CHARACTERISTIC
 /begin OUT_MEASUREMENT MFF_SP_CLC_1 MFF_SP_CLC_2 MFF_SP_HOM_ENG_1 MFF_SP_HOM_ENG_2 MFF_SP_HOM_1 MFF_SP_HOM_2 TI_ST_AMP /end OUT_MEASUREMENT
/end FUNCTION
/begin FUNCTION INJ_Injection_pressure_correctio "_Injection pressure correction" /begin DEF_CHARACTERISTIC C_TI_HOM_MAN LC_TI_HOM_MAN_ACT /end DEF_CHARACTERISTIC
 /begin OUT_MEASUREMENT TI_HOM_2 TI_HOM_1 LV_TI_LIM_MIN FAC_TI_PRS_1 FAC_TI_PRS_2 PRS_INJ_MV_1 PRS_INJ_MV_2 PRS_DEC_INJ_1 PRS_DEC_INJ_2 TI_STND_HOM_1 TI_STND_HOM_2 TI_HOM_CLC_1 TI_HOM_CLC_2 CRK_INJ_1 CRK_INJ_2 /end OUT_MEASUREMENT
/end FUNCTION
/begin FUNCTION INJ_Lambda_coordination "_Lambda coordination"
 /begin DEF_CHARACTERISTIC C_LAMB_SP_1_HYS C_LAMB_SP_OFS_AS LC_LAMB_SP_MAN_ACT C_LAMB_BAS_COR_MIN C_LAMB_SP_MAN /end DEF_CHARACTERISTIC
 /begin OUT_MEASUREMENT LAMB_BAS_COR_1 LAMB_SP_1 LAMB_SP_BAS_1 LAMB_BAS_COR_1_H_RES_1 LAMB_SP_H_RES_1 LV_LAMB_SP_1_1 LAMB_BAS_COR_2 LAMB_SP_2 LAMB_SP_BAS_2 LAMB_BAS_COR_1_H_RES_2 LAMB_SP_H_RES_2 LV_LAMB_SP_1_2 LAMB_BAS_COR LAMB_SP LAMB_SP_BAS /end OUT_MEASUREMENT
/end FUNCTION
/begin FUNCTION INJ_Lambda_Catalyst_overheating_ "_Lambda Catalyst overheating prevention"
 /begin DEF_CHARACTERISTIC IP_TEG_COP_SP_DIF IP_LAMB_COP IP_TEG_COP_SP C_LAMB_COP_SP_PAS C_LGRD_LAMB_COP_INC C_LGRD_LAMB_COP_DEC IP_TEG_COP_SP_LIM /end DEF_CHARACTERISTIC
 /begin OUT_MEASUREMENT LAMB_COP_1 LV_LAMB_COP_1 FAC_COP_1 TEG_COP_SP_1 T_COP_1 LAMB_COP_2 LV_LAMB_COP_2 FAC_COP_2 TEG_COP_SP_2 T_COP_2 /end OUT_MEASUREMENT
/end FUNCTION
/begin FUNCTION INJ_Conversion_MFF_to_TI "_Conversion MFF to TI" /end FUNCTION
/begin FUNCTION INJ_Basic_Lambda_Setpoint_includ "_Basic Lambda Setpoint including Homogeneous Lean Mode"
 /begin DEF_CHARACTERISTIC IP_LAMB_BAS_WUP_COR IP_LAMB_HOM_AFL IP_LAMB_BAS_1 IP_LAMB_BAS_2 C_LAMB_BAS_OFS_CAT_DIAG IP_LAMB_AFL_1 IP_FAC_LAMB_WUP IP_FAC_LAMB_WUP_IS /end DEF_CHARACTERISTIC
 /begin OUT_MEASUREMENT LAMB_HOM_AFL LAMB_AFL_1 LAMB_HOM_AFS LAMB_BAS LAMB_BAS_H_RES_1 LAMB_HOM_AFS_H_RES_1 LAMB_BAS_1 LAMB_HOM_AFS_1 LV_LAMB_BAS_OFS_CAT_DIAG_1 LAMB_BAS_H_RES_2 LAMB_HOM_AFS_H_RES_2 LAMB_BAS_2 LAMB_HOM_AFS_2 LV_LAMB_BAS_OFS_CAT_DIAG_2 /end OUT_MEASUREMENT
/end FUNCTION
/begin FUNCTION INJ_Ambient_pressure_correction "_Ambient pressure correction" /end FUNCTION
/begin FUNCTION INJ_Lambda_setpoint_for_catalyst "_Lambda setpoint for catalyst regeneration"
 /begin DEF_CHARACTERISTIC LC_LAMB_RGN_FAC_SENS IP_LAMB_RGN_AFR__MAF__N_32 IP_LAMB_RGN_FAC_SENS IP_LAMB_RGN_FAC_MDL C_LAMB_RGN_PAS C_LAMB_RGN_MAX C_T_RGN_LAMB_CON /end DEF_CHARACTERISTIC
 /begin OUT_MEASUREMENT LAMB_RGN_1 LAMB_RGN_2 LV_LAMB_RGN_FAC_SENS T_RGN /end OUT_MEASUREMENT
/end FUNCTION
/begin FUNCTION INJ_Injection_Pressure_Correctio "_Injection Pressure Correction for Stratified Charge"
 /begin DEF_CHARACTERISTIC LC_TI_S_MAN_ACT C_TI_S_MAN IP_PRS_INC_CMP C_TI_MIN_THD C_TI_MIN IP_FAC_TI_PRS C_FAC_MFF_TI_STND_2 C_FAC_MFF_TI_STND_1 /end DEF_CHARACTERISTIC
 /begin OUT_MEASUREMENT FAC_TI_PRS_S PRS_INJ_MV_S CRK_INJ_S PRS_DEC_INJ_S TI_STND_S TI_S_CLC LV_TI_S_LIM_MIN TI_S_1 /end OUT_MEASUREMENT
/end FUNCTION
/begin FUNCTION INJ_Injection_setpoint_for_strat "_Injection setpoint for stratified mode" /end FUNCTION
/begin FUNCTION INJ_Mass_Fuel_Flow_Setpoint_for_ "_Mass Fuel Flow Setpoint for Stratified Mode"
 /begin DEF_CHARACTERISTIC IP_MFF_SP_S LC_TQI_SP_MFF_MAN_ACT C_TQI_SP_MFF_MAN LC_MFF_SP_S_MAN_ACT C_MFF_SP_S_MAN C_MFF_SP_S_OFS_AS /end DEF_CHARACTERISTIC
 /begin OUT_MEASUREMENT TQI_SP_MFF TQI_SP_MFF_1 MFF_SP_S_1 MFF_SP_S MFF_SP_S_ENG EFF_TOT_BAS_S /end OUT_MEASUREMENT
/end FUNCTION
/begin FUNCTION INJ_LAMB_RATIO_calculation "_LAMB_RATIO calculation" /begin DEF_CHARACTERISTIC IP_LAMB_IGA_AFL__N_32__MAF_HB C_LAMB_IGA_AFR /end DEF_CHARACTERISTIC /begin OUT_MEASUREMENT LAMB_RATIO /end OUT_MEASUREMENT /end FUNCTION
/begin FUNCTION INJ_Catalyst_heating_with_second "_Catalyst heating with secondary air"
 /begin DEF_CHARACTERISTIC IP_LAMB_SAWUP IP_LAMB_SAWUP_IS IP_LAMB_ADD_SAWUP LC_SA_SWI_CMB /end DEF_CHARACTERISTIC
 /begin OUT_MEASUREMENT LAMB_SAWUP FAC_LAMB_DE_SA LAMB_SA_CH /end OUT_MEASUREMENT
/end FUNCTION
/begin FUNCTION INJ_Injection_Time_Correction_by "_Injection Time Correction by the Application System"
 /begin DEF_CHARACTERISTIC C_TI_AS_CYL_0 C_TI_AS_CYL_1 C_TI_AS_CYL_2 C_TI_AS_CYL_3 C_TI_AS_CYL_4 C_TI_AS_CYL_5 IP_EOI_MIN_TIPR C_NR_MAX_TOOTH_TIPR C_TI_AS /end DEF_CHARACTERISTIC
 /begin OUT_MEASUREMENT BIOS_TI_0 BIOS_TI_1 BIOS_TI_2 BIOS_TI_3 BIOS_TI_4 BIOS_TI_5 INJ_HOM_REQ /end OUT_MEASUREMENT
/end FUNCTION
/begin FUNCTION INJ_Transformation_layer_for_bas "_Transformation layer for basic software" /begin DEF_CHARACTERISTIC C_TI_MIN_POST_PULSE LC_POST_PULS_INJ_ENA /end DEF_CHARACTERISTIC
 /begin OUT_MEASUREMENT BIOS_TI_OFS BIOS_TI_MIN_POST_PULSE_INJ BIOS_EOI_LIM BIOS_LV_POST_PULS_INJ BIOS_EOI_0 BIOS_EOI_1 BIOS_EOI_2 BIOS_EOI_3 BIOS_EOI_4 BIOS_EOI_5 /end OUT_MEASUREMENT
/end FUNCTION
/begin FUNCTION INJ_Upstream_oxygen_sensor_inter "_Upstream oxygen sensor internal resistance determination"
 /begin DEF_CHARACTERISTIC LC_INH_R_UP_LS_VLD C_TEMP_CUR_ON_LS_UP IP_FAC_T_DRV1_VLS_UP_MMV IP_FAC_T_DRV1_VLS_UP_ABS IP_TTIP_LS_UP /end DEF_CHARACTERISTIC
 /begin OUT_MEASUREMENT LV_R_UP_LS_DET_1 LV_R_UP_LS_DRV1_VLS_CDN_1 LV_R_UP_LS_ENA_1 LV_R_UP_LS_VLS_RNG_CDN_1 LV_VLS_NOT_VLD_UP_1 CTR_CYCNR_R_UP_LS_1 DRV1_VLS_UP_MMV_THD_MAX_1 DRV1_VLS_UP_MMV_THD_MIN_1 FAC_T_DRV1_VLS_UP_ABS_1 FAC_T_DRV1_VLS_UP_MMV_1 R_UP_LS_1 R_UP_LS_MES_1 T_SAMPLE_R_UP_LS_1 TTIP_LS_UP_MES_1 TTIP_LS_UP_MES_BOL_1 TTIP_LS_UP_MES_BOL_MMV_1 TTIP_LS_UP_MES_TOL_MMV_1 LV_R_UP_LS_DET_2 LV_R_UP_LS_DRV1_VLS_CDN_2 LV_R_UP_LS_ENA_2 LV_R_UP_LS_VLS_RNG_CDN_2 LV_VLS_NOT_VLD_UP_2 CTR_CYCNR_R_UP_LS_2 DRV1_VLS_UP_MMV_THD_MAX_2 DRV1_VLS_UP_MMV_THD_MIN_2 FAC_T_DRV1_VLS_UP_ABS_2 FAC_T_DRV1_VLS_UP_MMV_2 R_UP_LS_2 R_UP_LS_MES_2 T_SAMPLE_R_UP_LS_2 TTIP_LS_UP_MES_2 TTIP_LS_UP_MES_BOL_2 TTIP_LS_UP_MES_BOL_MMV_2 TTIP_LS_UP_MES_TOL_MMV_2 LV_VLS_NOT_VLD_UP_1 LV_VLS_NOT_VLD_UP_2 VLS_CUR_ON_VLS_UP_1 VLS_CUR_ON_VLS_UP_2 VLS_CUR_OFF_VLS_UP_2 VLS_CUR_OFF_VLS_UP_1 /end OUT_MEASUREMENT
/end FUNCTION
/begin FUNCTION INJ_Downstream_oxygen_sensor_int "_Downstream oxygen sensor internal resistance determination"
 /begin DEF_CHARACTERISTIC C_TEMP_CUR_ON_LS_DOWN C_T_CUR_ON_LS_DOWN C_T_CUR_OFF_LS_DOWN C_T_CUR_DLY_LS_DOWN C_VLS_MMV_MIN_RNG_TOL_LS_DOWN C_VLS_MMV_MIN_RNG_BOL_LS_DOWN C_DRV1_VLS_DOWN_MMV_THD_MIN C_DRV1_VLS_DOWN_MMV_THD_MAX C_FAC_STK_DRV1_VLS_DOWN_MMV C_FAC_DRV1_VLS_DOWN_MMV_MIN C_DRV1_VLS_DOWN_ABS_MAX C_CTR_VLS_AFL_CYC_R_DOWN_LS C_MAF_KGH_R_DOWN_LS C_FAC_ERR_POS_R_DOWN_LS C_FAC_ERR_NEG_R_DOWN_LS C_CRLC_TTIP_FALL_R_DOWN_LS C_CRLC_TTIP_RISE_R_DOWN_LS LC_INH_R_DOWN_LS_VLD IP_FAC_T_DRV1_VLS_DOWN_ABS IP_TTIP_LS_DOWN IP_FAC_T_DRV1_VLS_DOWN_MMV /end DEF_CHARACTERISTIC
 /begin OUT_MEASUREMENT LV_R_DOWN_LS_DET_1 LV_R_DOWN_LS_DRV1_VLS_CDN_1 LV_R_DOWN_LS_ENA_1 LV_R_DOWN_LS_VLS_RNG_CDN_1 LV_VLS_NOT_VLD_DOWN_1 CTR_CYCNR_R_DOWN_LS_1 DRV1_VLS_DOWN_MMV_THD_MAX_1 DRV1_VLS_DOWN_MMV_THD_MIN_1 FAC_T_DRV1_VLS_DOWN_ABS_1 FAC_T_DRV1_VLS_DOWN_MMV_1 R_DOWN_LS_MES_1 T_SAMPLE_R_DOWN_LS_1 T_VLS_CYC_AFL_HLD_R_DOWN_LS_1 TTIP_LS_DOWN_MES_1 TTIP_LS_DOWN_MES_BOL_1 TTIP_LS_DOWN_MES_BOL_MMV_1 TTIP_LS_DOWN_MES_TOL_1 TTIP_LS_DOWN_MES_TOL_MMV_1 TTIP_LS_UP_MES_TOL_1 LV_R_DOWN_LS_DET_2 LV_R_DOWN_LS_DRV1_VLS_CDN_2 LV_R_DOWN_LS_ENA_2 LV_R_DOWN_LS_VLS_RNG_CDN_2 LV_VLS_NOT_VLD_DOWN_2 CTR_CYCNR_R_DOWN_LS_2 DRV1_VLS_DOWN_MMV_THD_MAX_2 DRV1_VLS_DOWN_MMV_THD_MIN_2 FAC_T_DRV1_VLS_DOWN_ABS_2 FAC_T_DRV1_VLS_DOWN_MMV_2 R_DOWN_LS_MES_2 T_SAMPLE_R_DOWN_LS_2 T_VLS_CYC_AFL_HLD_R_DOWN_LS_2 TTIP_LS_DOWN_MES_2 TTIP_LS_DOWN_MES_BOL_2 TTIP_LS_DOWN_MES_BOL_MMV_2 TTIP_LS_DOWN_MES_TOL_2 TTIP_LS_DOWN_MES_TOL_MMV_2 TTIP_LS_UP_MES_TOL_2 VLS_CUR_ON_VLS_DOWN_1 VLS_CUR_ON_VLS_DOWN_2 VLS_CUR_OFF_VLS_DOWN_2 VLS_CUR_OFF_VLS_DOWN_1 LV_VLS_NOT_VLD_DOWN_1 LV_VLS_NOT_VLD_DOWN_2 /end OUT_MEASUREMENT
/end FUNCTION
/end MODULE
/end PROJECT
