ASAP2_VERSION 1 31
/begin PROJECT MS45 "BMW Motorsteuerung R6"
/begin HEADER "_default_HeaderComment" PROJECT_NO _52 /end HEADER
/begin MODULE _default_ModuleName "_default_ModuleLongIdentifier"
/begin MOD_COMMON "_default_ModCommonComment" DEPOSIT ABSOLUTE BYTE_ORDER MSB_FIRST ALIGNMENT_BYTE 1 ALIGNMENT_WORD 2 ALIGNMENT_LONG 4 ALIGNMENT_FLOAT32_IEEE 4 ALIGNMENT_FLOAT64_IEEE 8 /end MOD_COMMON
/begin MEASUREMENT IGA_AV_1_0 "Intermediate ignition angle till gradiant limitation after start is terminated" UBYTE _CNV_A_R_LINEAR_____202_CM 1 100. -35.625 60. ECU_ADDRESS 0x3fe31a FORMAT "%5.1" /end MEASUREMENT
/begin MEASUREMENT IGA_AV_1_1 "Intermediate ignition angle till gradiant limitation after start is terminated" UBYTE _CNV_A_R_LINEAR_____202_CM 1 100. -35.625 60. ECU_ADDRESS 0x3fe31b FORMAT "%5.1" /end MEASUREMENT
/begin MEASUREMENT IGA_AV_1_2 "Intermediate ignition angle till gradiant limitation after start is terminated" UBYTE _CNV_A_R_LINEAR_____202_CM 1 100. -35.625 60. ECU_ADDRESS 0x3fe31c FORMAT "%5.1" /end MEASUREMENT
/begin MEASUREMENT IGA_AV_1_3 "Intermediate ignition angle till gradiant limitation after start is terminated" UBYTE _CNV_A_R_LINEAR_____202_CM 1 100. -35.625 60. ECU_ADDRESS 0x3fe31d FORMAT "%5.1" /end MEASUREMENT
/begin MEASUREMENT IGA_AV_1_4 "Intermediate ignition angle till gradiant limitation after start is terminated" UBYTE _CNV_A_R_LINEAR_____202_CM 1 100. -35.625 60. ECU_ADDRESS 0x3fe31e FORMAT "%5.1" /end MEASUREMENT
/begin MEASUREMENT IGA_AV_1_5 "Intermediate ignition angle till gradiant limitation after start is terminated" UBYTE _CNV_A_R_LINEAR_____202_CM 1 100. -35.625 60. ECU_ADDRESS 0x3fe31f FORMAT "%5.1" /end MEASUREMENT
/begin MEASUREMENT IGA_0 "Basic ignition angle application correction and knock control included" UBYTE _CNV_A_R_LINEAR_____202_CM 1 100. -35.625 60. ECU_ADDRESS 0x3fce28 FORMAT "%5.1" /end MEASUREMENT
/begin MEASUREMENT IGA_1 "Basic ignition angle application correction and knock control included" UBYTE _CNV_A_R_LINEAR_____202_CM 1 100. -35.625 60. ECU_ADDRESS 0x3fce29 FORMAT "%5.1" /end MEASUREMENT
/begin MEASUREMENT IGA_2 "Basic ignition angle application correction and knock control included" UBYTE _CNV_A_R_LINEAR_____202_CM 1 100. -35.625 60. ECU_ADDRESS 0x3fce2a FORMAT "%5.1" /end MEASUREMENT
/begin MEASUREMENT IGA_3 "Basic ignition angle application correction and knock control included" UBYTE _CNV_A_R_LINEAR_____202_CM 1 100. -35.625 60. ECU_ADDRESS 0x3fce2b FORMAT "%5.1" /end MEASUREMENT
/begin MEASUREMENT IGA_4 "Basic ignition angle application correction and knock control included" UBYTE _CNV_A_R_LINEAR_____202_CM 1 100. -35.625 60. ECU_ADDRESS 0x3fce2c FORMAT "%5.1" /end MEASUREMENT
/begin MEASUREMENT IGA_5 "Basic ignition angle application correction and knock control included" UBYTE _CNV_A_R_LINEAR_____202_CM 1 100. -35.625 60. ECU_ADDRESS 0x3fce2d FORMAT "%5.1" /end MEASUREMENT
/begin MEASUREMENT IGA_MIN "Minimum ignition Angle" UBYTE _CNV_A_R_LINEAR_____202_CM 1 100. -35.625 60. ECU_ADDRESS 0x3fce34 FORMAT "%5.1" /end MEASUREMENT
/begin MEASUREMENT EFF_IGA_BAS_COR "Ignition efficiency  basic ignition angle" UWORD _CNV_A_R_LINEAR_____45_CM 1 100. 0. 1.99996948 ECU_ADDRESS 0x3fce10 FORMAT "%7.5" /end MEASUREMENT
/begin MEASUREMENT EFF_IGA_RON_98_1 "Ignition efficiency actual ignition angle" UWORD _CNV_A_R_LINEAR_____45_CM 1 100. 0. 1.99996948 ECU_ADDRESS 0x3fce1a FORMAT "%7.5" /end MEASUREMENT
/begin MEASUREMENT EFF_IGA_RON_98_2 "Ignition efficiency actual ignition angle" UWORD _CNV_A_R_LINEAR_____45_CM 1 100. 0. 1.99996948 ECU_ADDRESS 0x3fce1e FORMAT "%7.5" /end MEASUREMENT
/begin MEASUREMENT EFF_IGA_AV_1 "Ignition efficiency actual ignition angle bank selective" UWORD _CNV_A_R_LINEAR_____45_CM 1 100. 0. 1.99996948 ECU_ADDRESS 0x3fce1c FORMAT "%7.5" /end MEASUREMENT
/begin MEASUREMENT EFF_IGA_AV_2 "Ignition efficiency actual ignition angle bank selective" UWORD _CNV_A_R_LINEAR_____45_CM 1 100. 0. 1.99996948 ECU_ADDRESS 0x3fce20 FORMAT "%7.5" /end MEASUREMENT
/begin MEASUREMENT EFF_IGA_MIN "Ignition efficiency minimum ignition angle" UWORD _CNV_A_R_LINEAR_____45_CM 1 100. 0. 1.99996948 ECU_ADDRESS 0x3fce16 FORMAT "%7.5" /end MEASUREMENT
/begin MEASUREMENT IGA_BAS_COR_KNK_ADD "Basic corrected ignition angle knock  mean value IGA_MV_ADJ_KNK included" UBYTE _CNV_A_R_LINEAR_____202_CM 1 100. -35.625 60. ECU_ADDRESS 0x3fe320 FORMAT "%5.1" /end MEASUREMENT
/begin MEASUREMENT IGA_AV_MV_1 "Mean value of actual ignition angle" UBYTE _CNV_A_R_LINEAR_____202_CM 1 100. -35.625 60. ECU_ADDRESS 0x3fe32d FORMAT "%5.1" /end MEASUREMENT
/begin MEASUREMENT IGA_AV_MV_2 "Mean value of actual ignition angle" UBYTE _CNV_A_R_LINEAR_____202_CM 1 100. -35.625 60. ECU_ADDRESS 0x3fe330 FORMAT "%5.1" /end MEASUREMENT
/begin MEASUREMENT IGA_DIF_BAS "Difference of basic ignition angle to reference ignition angle" UBYTE _CNV_A_R_LINEAR_____203_CM 1 100. 0. -95.625 ECU_ADDRESS 0x3fe325 FORMAT "%5.1" /end MEASUREMENT
/begin MEASUREMENT IGA_DIF_AV_1 "Difference of actual ignition angle to reference ignition angle" UBYTE _CNV_A_R_LINEAR_____203_CM 1 100. 0. -95.625 ECU_ADDRESS 0x3fe32e FORMAT "%5.1" /end MEASUREMENT
/begin MEASUREMENT IGA_DIF_AV_2 "Difference of actual ignition angle to reference ignition angle" UBYTE _CNV_A_R_LINEAR_____203_CM 1 100. 0. -95.625 ECU_ADDRESS 0x3fe331 FORMAT "%5.1" /end MEASUREMENT
/begin MEASUREMENT IGA_DIF_RON_98_1 "Difference of actual ignition angle to reference ignition angle" UBYTE _CNV_A_R_LINEAR_____203_CM 1 100. 0. -95.625 ECU_ADDRESS 0x3fe32f FORMAT "%5.1" /end MEASUREMENT
/begin MEASUREMENT IGA_DIF_RON_98_2 "Difference of actual ignition angle to reference ignition angle" UBYTE _CNV_A_R_LINEAR_____203_CM 1 100. 0. -95.625 ECU_ADDRESS 0x3fe332 FORMAT "%5.1" /end MEASUREMENT
/begin MEASUREMENT IGA_MV_KNK_FIL "Filtered mean knock correction" SBYTE _CNV_A_R_LINEAR_____75_CM 1 100. -48. 47.625 ECU_ADDRESS 0x3fe328 FORMAT "%5.1" /end MEASUREMENT
/begin MEASUREMENT IGA_BAS_COR_KNK_FIL "Corrected basic ignition angle with mean knock correction" UBYTE _CNV_A_R_LINEAR_____202_CM 1 100. -35.625 60. ECU_ADDRESS 0x3fe329 FORMAT "%5.1" /end MEASUREMENT
/begin MEASUREMENT EFF_IGA_BAS_COR_KNK_FIL "Ignition efficiency referenced to IGA_BAS_COR_KNK_FIL" UWORD _CNV_A_R_LINEAR_____45_CM 1 100. 0. 1.99996948 ECU_ADDRESS 0x3fce18 FORMAT "%7.5" /end MEASUREMENT
/begin MEASUREMENT LV_IGA_GRD_ACT "FLag for ignition angle gradient limitation out of start active" UBYTE _CNV_S_2_RANGE______28_CM 1 100. 0. 1. ECU_ADDRESS 0x3fce37 /end MEASUREMENT
/begin CHARACTERISTIC C_CRLC_IGA_KNK "Correlation constant knock correction filter" VALUE 0x42831 _REC_VAL_20_u1 0.9960940000000002 _CNV_A_R_LINEAR_____44_CM 0. 0.996094 FORMAT "%5.3" /end CHARACTERISTIC
/begin MEASUREMENT IGA_DIF_BAS_KNK_FIL "Difference of IGA_BAS_COR_KNK_FIL to reference ignition angle" UBYTE _CNV_A_R_LINEAR_____203_CM 1 100. 0. -95.625 ECU_ADDRESS 0x3fce36 FORMAT "%5.1" /end MEASUREMENT
/begin CHARACTERISTIC C_CYCNR_IGA_ES "Number of cycles for wich ignition is maintained after detection of LV_IGK = 0" VALUE 0x42876 _REC_VAL_20_u1 15. _CNV_A_R_LINEAR_____10_CM 0. 15. FORMAT "%2.0" /end CHARACTERISTIC
/begin MEASUREMENT IGA_IGC_0 "Ignition angle applied on cylinder CYL" UBYTE _CNV_A_R_LINEAR_____202_CM 1 100. -35.625 60. ECU_ADDRESS 0x3fce22 FORMAT "%5.1" /end MEASUREMENT
/begin MEASUREMENT IGA_IGC_1 "Ignition angle applied on cylinder CYL" UBYTE _CNV_A_R_LINEAR_____202_CM 1 100. -35.625 60. ECU_ADDRESS 0x3fce23 FORMAT "%5.1" /end MEASUREMENT
/begin MEASUREMENT IGA_IGC_2 "Ignition angle applied on cylinder CYL" UBYTE _CNV_A_R_LINEAR_____202_CM 1 100. -35.625 60. ECU_ADDRESS 0x3fce24 FORMAT "%5.1" /end MEASUREMENT
/begin MEASUREMENT IGA_IGC_3 "Ignition angle applied on cylinder CYL" UBYTE _CNV_A_R_LINEAR_____202_CM 1 100. -35.625 60. ECU_ADDRESS 0x3fce25 FORMAT "%5.1" /end MEASUREMENT
/begin MEASUREMENT IGA_IGC_4 "Ignition angle applied on cylinder CYL" UBYTE _CNV_A_R_LINEAR_____202_CM 1 100. -35.625 60. ECU_ADDRESS 0x3fce26 FORMAT "%5.1" /end MEASUREMENT
/begin MEASUREMENT IGA_IGC_5 "Ignition angle applied on cylinder CYL" UBYTE _CNV_A_R_LINEAR_____202_CM 1 100. -35.625 60. ECU_ADDRESS 0x3fce27 FORMAT "%5.1" /end MEASUREMENT
/begin MEASUREMENT IGA_WOUT_KNK_0 "actual ignition angle" UBYTE _CNV_A_R_LINEAR_____202_CM 1 100. -35.625 60. ECU_ADDRESS 0x3fce2e FORMAT "%5.1" /end MEASUREMENT
/begin MEASUREMENT IGA_WOUT_KNK_1 "actual ignition angle" UBYTE _CNV_A_R_LINEAR_____202_CM 1 100. -35.625 60. ECU_ADDRESS 0x3fce2f FORMAT "%5.1" /end MEASUREMENT
/begin MEASUREMENT IGA_WOUT_KNK_2 "actual ignition angle" UBYTE _CNV_A_R_LINEAR_____202_CM 1 100. -35.625 60. ECU_ADDRESS 0x3fce30 FORMAT "%5.1" /end MEASUREMENT
/begin MEASUREMENT IGA_WOUT_KNK_3 "actual ignition angle" UBYTE _CNV_A_R_LINEAR_____202_CM 1 100. -35.625 60. ECU_ADDRESS 0x3fce31 FORMAT "%5.1" /end MEASUREMENT
/begin MEASUREMENT IGA_WOUT_KNK_4 "actual ignition angle" UBYTE _CNV_A_R_LINEAR_____202_CM 1 100. -35.625 60. ECU_ADDRESS 0x3fce32 FORMAT "%5.1" /end MEASUREMENT
/begin MEASUREMENT IGA_WOUT_KNK_5 "actual ignition angle" UBYTE _CNV_A_R_LINEAR_____202_CM 1 100. -35.625 60. ECU_ADDRESS 0x3fce33 FORMAT "%5.1" /end MEASUREMENT
/begin CHARACTERISTIC LC_IGA_ST_ENA "Logical constant for seperated start ignition angle" VALUE 0x42b87 _REC_VAL_20_u1 1. _CNV_A_R_LINEAR_____12_CM 0. 1. FORMAT "%1.0" /end CHARACTERISTIC
/begin CHARACTERISTIC LC_INH_IGA_TRA_KNK_EFF "Logical constant to exclude IGA_TRA_KNK from efficiency calculation" VALUE 0x42b94 _REC_VAL_20_u1 1. _CNV_A_R_LINEAR_____12_CM 0. 1. FORMAT "%1.0" /end CHARACTERISTIC
/begin CHARACTERISTIC IP_IGA_LGRD_AST "Gradient limitation IGA after start phase" CURVE 0x4f2f4 _REC_CUR_20_u1_u1 95.625 _CNV_A_R_LINEAR_____75_CM 0. 95.625 FORMAT "%5.2"
 /begin AXIS_DESCR COM_AXIS TCO _CNV_A_R_LINEAR_____0_CM 8 -48. 142.5 FORMAT "%5.1" AXIS_PTS_REF ldpm_tco_1_igsp /end AXIS_DESCR
/end CHARACTERISTIC
/begin MEASUREMENT EFF_IGA_AV "Ignition efficiency actual ignition angle" UWORD _CNV_A_R_LINEAR_____45_CM 1 100. 0. 1.99996948 ECU_ADDRESS 0x3fce12 FORMAT "%7.5" /end MEASUREMENT
/begin MEASUREMENT EFF_IGA_AV_CAN "Ignition efficiency actual ignition angle for CAN" UWORD _CNV_A_R_LINEAR_____45_CM 1 100. 0. 1.99996948 ECU_ADDRESS 0x3fce14 FORMAT "%7.5" /end MEASUREMENT
/begin MEASUREMENT IGA_SP_MAX_1 "Maximum ignition angle depending on torque intervention" UBYTE _CNV_A_R_LINEAR_____202_CM 1 100. -35.625 60. ECU_ADDRESS 0x3fe321 FORMAT "%5.1" /end MEASUREMENT
/begin MEASUREMENT IGA_SP_MAX_1_CAN "Maximum ignition angle depending on torque intervention" UBYTE _CNV_A_R_LINEAR_____202_CM 1 100. -35.625 60. ECU_ADDRESS 0x3fe322 FORMAT "%5.1" /end MEASUREMENT
/begin MEASUREMENT IGA_AV_MV "Mean value of actual ignition angle" UBYTE _CNV_A_R_LINEAR_____202_CM 1 100. -35.625 60. ECU_ADDRESS 0x3fce35 FORMAT "%5.1" /end MEASUREMENT
/begin MEASUREMENT IGA_AV_MV_CAN "Mean value of actual ignition angle" UBYTE _CNV_A_R_LINEAR_____202_CM 1 100. -35.625 60. ECU_ADDRESS 0x3fe324 FORMAT "%5.1" /end MEASUREMENT
/begin MEASUREMENT IGA_DIF_AV "Difference of actual ignition angle to reference ignition angle" UBYTE _CNV_A_R_LINEAR_____203_CM 1 100. 0. -95.625 ECU_ADDRESS 0x3fe326 FORMAT "%5.1" /end MEASUREMENT
/begin MEASUREMENT IGA_DIF_AV_CAN "Difference of actual ignition angle to reference ignition angle for CAN" UBYTE _CNV_A_R_LINEAR_____203_CM 1 100. 0. -95.625 ECU_ADDRESS 0x3fe327 FORMAT "%5.1" /end MEASUREMENT
/begin MEASUREMENT IGA_BAS_COR "Corrected basic ignition angle" UBYTE _CNV_A_R_LINEAR_____202_CM 1 100. -35.625 60. ECU_ADDRESS 0x3fce38 FORMAT "%5.1" /end MEASUREMENT
/begin MEASUREMENT IGA_BAS_IVVT "basic ignition angle including influences of IVVT" UBYTE _CNV_A_R_LINEAR_____202_CM 1 100. -35.625 60. ECU_ADDRESS 0x3fe335 FORMAT "%5.1" /end MEASUREMENT
/begin MEASUREMENT IGA_BAS_LAMB_COR "additive LAMBDA correction of IGA_BAS_IVVT" SBYTE _CNV_A_R_LINEAR_____75_CM 1 100. -48. 47.625 ECU_ADDRESS 0x3fe336 FORMAT "%5.1" /end MEASUREMENT
/begin MEASUREMENT IGA_BAS_IVVT_OFS "additive basic ignition angle of influences of valve overlap" UBYTE _CNV_A_R_LINEAR_____202_CM 1 100. -35.625 60. ECU_ADDRESS 0x3fe337 FORMAT "%5.1" /end MEASUREMENT
/begin MEASUREMENT IGA_BAS_RON "basic ignition angle of RON factor" UBYTE _CNV_A_R_LINEAR_____202_CM 1 100. -35.625 60. ECU_ADDRESS 0x3fe338 FORMAT "%5.1" /end MEASUREMENT
/begin CHARACTERISTIC C_IGA_BAS_ADD_MAX "IGA max offset (VANOS)" VALUE 0x428df _REC_VAL_20_u1 95.625 _CNV_A_R_LINEAR_____202_CM -35.625 60. FORMAT "%5.1" /end CHARACTERISTIC
/begin CHARACTERISTIC C_IGA_BAS_ADD_MIN "IGA min offset (VANOS)" VALUE 0x428e0 _REC_VAL_20_u1 95.625 _CNV_A_R_LINEAR_____202_CM -35.625 60. FORMAT "%5.1" /end CHARACTERISTIC
/begin CHARACTERISTIC IP_IGA_BAS_RON_91__N__MAF "Basic ignition angle for RON 91" MAP 0x4ee0f _REC_MAP_20_u1_u2_u2 95.625 _CNV_A_R_LINEAR_____202_CM -35.625 60. FORMAT "%5.1"
 /begin AXIS_DESCR COM_AXIS N _CNV_A_R_LINEAR_____17_CM 20 0. 8160. FORMAT "%4.0" AXIS_PTS_REF ldpm_n_14 /end AXIS_DESCR
 /begin AXIS_DESCR COM_AXIS MAF _CNV_A_R_LINEAR_____95_CM 16 0. 1389. FORMAT "%7.2" AXIS_PTS_REF ldpm_maf_2 /end AXIS_DESCR
/end CHARACTERISTIC
/begin CHARACTERISTIC IP_IGA_BAS_ADD_MAX__IVVT__N__MAF "Basic ignition angle offset VO max" MAP 0x4eab1 _REC_MAP_20_u1_u2_u2 95.625 _CNV_A_R_LINEAR_____202_CM -35.625 60. FORMAT "%5.1"
 /begin AXIS_DESCR COM_AXIS N _CNV_A_R_LINEAR_____17_CM 20 0. 8160. FORMAT "%4.0" AXIS_PTS_REF ldpm_n_14 /end AXIS_DESCR
 /begin AXIS_DESCR COM_AXIS MAF _CNV_A_R_LINEAR_____95_CM 16 0. 1389. FORMAT "%7.2" AXIS_PTS_REF ldpm_maf_2 /end AXIS_DESCR
/end CHARACTERISTIC
/begin CHARACTERISTIC IP_IGA_BAS_ADD_MIN__IVVT__N__MAF "Basic ignition offset VO min" MAP 0x4ebf1 _REC_MAP_20_u1_u2_u2 95.625 _CNV_A_R_LINEAR_____202_CM -35.625 60. FORMAT "%5.1"
 /begin AXIS_DESCR COM_AXIS N _CNV_A_R_LINEAR_____17_CM 20 0. 8160. FORMAT "%4.0" AXIS_PTS_REF ldpm_n_14 /end AXIS_DESCR
 /begin AXIS_DESCR COM_AXIS MAF _CNV_A_R_LINEAR_____95_CM 16 0. 1389. FORMAT "%7.2" AXIS_PTS_REF ldpm_maf_2 /end AXIS_DESCR
/end CHARACTERISTIC
/begin CHARACTERISTIC IP_IGA_BAS_LAMB_LAMB_SP "additive lambda setpoint correction of IGA_BAS" CURVE 0x4edc7 _REC_CUR_20_u1_u2 4.78125 _CNV_A_R_LINEAR_____204_CM -48. 47.625 FORMAT "%5.1"
 /begin AXIS_DESCR COM_AXIS LAMB_SP _CNV_A_R_LINEAR_____148_CM 8 0. 31.99902344 FORMAT "%7.4" AXIS_PTS_REF ldp_lamb_sp__iga_bas_lamb /end AXIS_DESCR
/end CHARACTERISTIC
/begin CHARACTERISTIC IP_IGA_BAS__N__MAF "Basic ignition angle IVVT passive" MAP 0x4e971 _REC_MAP_20_u1_u2_u2 95.625 _CNV_A_R_LINEAR_____202_CM -35.625 60. FORMAT "%5.1"
 /begin AXIS_DESCR COM_AXIS N _CNV_A_R_LINEAR_____17_CM 20 0. 8160. FORMAT "%4.0" AXIS_PTS_REF ldpm_n_14 /end AXIS_DESCR
 /begin AXIS_DESCR COM_AXIS MAF _CNV_A_R_LINEAR_____95_CM 16 0. 1389. FORMAT "%7.2" AXIS_PTS_REF ldpm_maf_2 /end AXIS_DESCR
/end CHARACTERISTIC
/begin AXIS_PTS ldp_lamb_sp__iga_bas_lamb "" 0x44466 LAMB_SP _REC_AXS_20_u2 31.99902344 _CNV_A_R_LINEAR_____148_CM 8 0. 31.99902344 FORMAT "%7.4" /end AXIS_PTS
/begin MEASUREMENT TQ_ADD_CH "torque reserve for catalyst heating" SWORD _CNV_A_R_LINEAR_____48_CM 1 100. -1024. 1023.96875 ECU_ADDRESS 0x3fce3a FORMAT "%6.2" /end MEASUREMENT
/begin MEASUREMENT IGA_CH_BAS "latest desired IGA for catalyst heating" UBYTE _CNV_A_R_LINEAR_____202_CM 1 100. -35.625 60. ECU_ADDRESS 0x3fce3c FORMAT "%5.1" /end MEASUREMENT
/begin MEASUREMENT IGA_DIF_CH_BAS "difference IGA_REF_COR - IGA_CH_BAS" UBYTE _CNV_A_R_LINEAR_____203_CM 1 100. 0. -95.625 ECU_ADDRESS 0x3fe340 FORMAT "%5.1" /end MEASUREMENT
/begin MEASUREMENT EFF_IGA_CH_BAS "IGA efficiency with IGA_CH_BAS" UWORD _CNV_A_R_LINEAR_____45_CM 1 100. 0. 1.99996948 ECU_ADDRESS 0x3fe33a FORMAT "%7.5" /end MEASUREMENT
/begin MEASUREMENT TQ_ADD_CH_BAS "maximum torque reserve for catalyst heating" SWORD _CNV_A_R_LINEAR_____48_CM 1 100. -1024. 1023.96875 ECU_ADDRESS 0x3fe33c FORMAT "%8.2" /end MEASUREMENT
/begin MEASUREMENT FAC_DEAC_CH "deactivation ramp at function termination" UBYTE _CNV_A_R_LINEAR_____20_CM 1 100. 0. 0.99610001 ECU_ADDRESS 0x3fe341 FORMAT "%5.3" /end MEASUREMENT
/begin MEASUREMENT FAC_RED_TQ_ADD_CH "reduction of TQ_ADD_CH_BAS" UBYTE _CNV_A_R_LINEAR_____20_CM 1 100. 0. 0.99610001 ECU_ADDRESS 0x3fe342 FORMAT "%5.3" /end MEASUREMENT
/begin MEASUREMENT FAC_DEAC_CH_DRI "interpolation factor concerning 'drive train engaged'" UBYTE _CNV_A_R_LINEAR_____20_CM 1 100. 0. 0.99610001 ECU_ADDRESS 0x3fe343 FORMAT "%5.3" /end MEASUREMENT
/begin MEASUREMENT TQ_ADD_CH_RED "unfiltered torque reserve for catalyst heating" SWORD _CNV_A_R_LINEAR_____48_CM 1 100. -1024. 1023.96875 ECU_ADDRESS 0x3fe33e FORMAT "%8.2" /end MEASUREMENT
/begin CHARACTERISTIC IP_FAC_IGA_CH_TCO "interpolation factor latest IGA" CURVE 0x4e05e _REC_CUR_20_u1_u1 0.99610001 _CNV_A_R_LINEAR_____20_CM 0. 0.99610001 FORMAT "%5.3"
 /begin AXIS_DESCR COM_AXIS TCO _CNV_A_R_LINEAR_____0_CM 8 -48. 142.5 FORMAT "%6.2" AXIS_PTS_REF ldp_tco__fac_iga_ch_tco /end AXIS_DESCR
/end CHARACTERISTIC
/begin CHARACTERISTIC IP_IGA_CH_COLD_PL "latest IGA cold engine, later idle phases and part load" MAP 0x4f183 _REC_MAP_20_u1_u1_u1 95.625 _CNV_A_R_LINEAR_____202_CM -35.625 60. FORMAT "%5.1"
 /begin AXIS_DESCR COM_AXIS N_32 _CNV_A_R_LINEAR_____5_CM 8 0. 8160. FORMAT "%4.0" AXIS_PTS_REF ldpm_n_32_1_iga /end AXIS_DESCR
 /begin AXIS_DESCR COM_AXIS MAF _CNV_A_R_LINEAR_____18_CM 8 0. 1389. FORMAT "%4.0" AXIS_PTS_REF ldpm_maf_hb_1_iga /end AXIS_DESCR
/end CHARACTERISTIC
/begin CHARACTERISTIC IP_IGA_CH_HOT_PL "latest IGA warm engine, later idle phases and part load" MAP 0x4f1d3 _REC_MAP_20_u1_u1_u1 95.625 _CNV_A_R_LINEAR_____202_CM -35.625 60. FORMAT "%5.1"
 /begin AXIS_DESCR COM_AXIS N_32 _CNV_A_R_LINEAR_____5_CM 8 0. 8160. FORMAT "%4.0" AXIS_PTS_REF ldpm_n_32_1_iga /end AXIS_DESCR
 /begin AXIS_DESCR COM_AXIS MAF _CNV_A_R_LINEAR_____18_CM 8 0. 1389. FORMAT "%4.0" AXIS_PTS_REF ldpm_maf_hb_1_iga /end AXIS_DESCR
/end CHARACTERISTIC
/begin CHARACTERISTIC IP_IGA_CH_COLD_IS_ALTER "latest IGA cold engine, first idle phases and alternator switched on" CURVE 0x4f17b _REC_CUR_20_u1_u1 95.625 _CNV_A_R_LINEAR_____202_CM -35.625 60. FORMAT "%5.1"
 /begin AXIS_DESCR COM_AXIS N_32 _CNV_A_R_LINEAR_____5_CM 8 0. 8160. FORMAT "%4.0" AXIS_PTS_REF ldpm_n_32_2_iga /end AXIS_DESCR
/end CHARACTERISTIC
/begin CHARACTERISTIC IP_IGA_CH_COLD_IS "latest IGA cold engine, first idle phases and alternator switched off" CURVE 0x4f173 _REC_CUR_20_u1_u1 95.625 _CNV_A_R_LINEAR_____202_CM -35.625 60. FORMAT "%5.1"
 /begin AXIS_DESCR COM_AXIS N_32 _CNV_A_R_LINEAR_____5_CM 8 0. 8160. FORMAT "%4.0" AXIS_PTS_REF ldpm_n_32_2_iga /end AXIS_DESCR
/end CHARACTERISTIC
/begin CHARACTERISTIC IP_IGA_CH_HOT_IS_ALTER "latest IGA warm engine, first idle phases and alternator switched on" CURVE 0x4f1cb _REC_CUR_20_u1_u1 95.625 _CNV_A_R_LINEAR_____202_CM -35.625 60. FORMAT "%5.1"
 /begin AXIS_DESCR COM_AXIS N_32 _CNV_A_R_LINEAR_____5_CM 8 0. 8160. FORMAT "%4.0" AXIS_PTS_REF ldpm_n_32_2_iga /end AXIS_DESCR
/end CHARACTERISTIC
/begin CHARACTERISTIC IP_IGA_CH_HOT_IS "latest IGA warm engine, first idle phases and alternator switched off" CURVE 0x4f1c3 _REC_CUR_20_u1_u1 95.625 _CNV_A_R_LINEAR_____202_CM -35.625 60. FORMAT "%5.1"
 /begin AXIS_DESCR COM_AXIS N_32 _CNV_A_R_LINEAR_____5_CM 8 0. 8160. FORMAT "%4.0" AXIS_PTS_REF ldpm_n_32_2_iga /end AXIS_DESCR
/end CHARACTERISTIC
/begin CHARACTERISTIC IP_FAC_RED_CH_MT "reduction map manual transmission vehicle, valid in later idle phases and part load" MAP 0x4e437 _REC_MAP_20_u1_u2_u1 0.99610001 _CNV_A_R_LINEAR_____20_CM 0. 0.99610001 FORMAT "%5.3"
 /begin AXIS_DESCR COM_AXIS T_AST _CNV_A_R_LINEAR_____14_CM 8 0. 6553.5 FORMAT "%6.1" AXIS_PTS_REF ldpm_t_ast_1_iga /end AXIS_DESCR
 /begin AXIS_DESCR COM_AXIS TCO_ST _CNV_A_R_LINEAR_____0_CM 8 -48. 142.5 FORMAT "%5.1" AXIS_PTS_REF ldpm_tco_st_1_iga /end AXIS_DESCR
/end CHARACTERISTIC
/begin CHARACTERISTIC IP_FAC_RED_CH_CTR_KM "reduction map depending on km counter" CURVE 0x4e3b3 _REC_CUR_20_u1_u2 0.99610001 _CNV_A_R_LINEAR_____20_CM 0. 0.99610001 FORMAT "%5.3"
 /begin AXIS_DESCR COM_AXIS CTR_KM_CAN _CNV_A_R_LINEAR_____80_CM 4 0. 655350. FORMAT "%7.0" AXIS_PTS_REF ldpm_ctr_km_can_1 /end AXIS_DESCR
/end CHARACTERISTIC
/begin CHARACTERISTIC IP_FAC_RED_CH_AT "reduction map automatic transmission vehicle, valid in later idle phases and part load" MAP 0x4e373 _REC_MAP_20_u1_u2_u1 0.99610001 _CNV_A_R_LINEAR_____20_CM 0. 0.99610001 FORMAT "%5.3"
 /begin AXIS_DESCR COM_AXIS T_AST _CNV_A_R_LINEAR_____14_CM 8 0. 6553.5 FORMAT "%6.1" AXIS_PTS_REF ldpm_t_ast_1_iga /end AXIS_DESCR
 /begin AXIS_DESCR COM_AXIS TCO_ST _CNV_A_R_LINEAR_____0_CM 8 -48. 142.5 FORMAT "%5.1" AXIS_PTS_REF ldpm_tco_st_1_iga /end AXIS_DESCR
/end CHARACTERISTIC
/begin CHARACTERISTIC IP_FAC_RED_CH_IS "reduction map drive train not engaged, valid in first idle phases" MAP 0x4e3b7 _REC_MAP_20_u1_u2_u1 0.99610001 _CNV_A_R_LINEAR_____20_CM 0. 0.99610001 FORMAT "%5.3"
 /begin AXIS_DESCR COM_AXIS T_AST _CNV_A_R_LINEAR_____14_CM 8 0. 6553.5 FORMAT "%6.1" AXIS_PTS_REF ldpm_t_ast_1_iga /end AXIS_DESCR
 /begin AXIS_DESCR COM_AXIS TCO_ST _CNV_A_R_LINEAR_____0_CM 8 -48. 142.5 FORMAT "%5.1" AXIS_PTS_REF ldpm_tco_st_1_iga /end AXIS_DESCR
/end CHARACTERISTIC
/begin CHARACTERISTIC IP_FAC_RED_CH_IS_DRI "reduction map drive train engaged, valid in first idle phases" MAP 0x4e3f7 _REC_MAP_20_u1_u2_u1 0.99610001 _CNV_A_R_LINEAR_____20_CM 0. 0.99610001 FORMAT "%5.3"
 /begin AXIS_DESCR COM_AXIS T_AST _CNV_A_R_LINEAR_____14_CM 8 0. 6553.5 FORMAT "%6.1" AXIS_PTS_REF ldpm_t_ast_1_iga /end AXIS_DESCR
 /begin AXIS_DESCR COM_AXIS TCO_ST _CNV_A_R_LINEAR_____0_CM 8 -48. 142.5 FORMAT "%5.1" AXIS_PTS_REF ldpm_tco_st_1_iga /end AXIS_DESCR
/end CHARACTERISTIC
/begin CHARACTERISTIC IP_CRLC_TQ_ADD_CH "correlation constant" CURVE 0x4da53 _REC_CUR_20_u1_u2 0.99610001 _CNV_A_R_LINEAR_____20_CM 0. 0.99610001 FORMAT "%5.3"
 /begin AXIS_DESCR COM_AXIS FAC_TQ_REQ_CLU _CNV_A_R_LINEAR_____45_CM 4 0. 1.99996948 FORMAT "%7.5" AXIS_PTS_REF ldp_fac_tq_req_clu__crlc_tq_add /end AXIS_DESCR
/end CHARACTERISTIC
/begin CHARACTERISTIC C_T_DEAC_CH_TQ_ADD "duration of deactivation ramp" VALUE 0x42f70 _REC_VAL_20_u2 655.34 _CNV_A_R_LINEAR_____27_CM 1.e-002 655.35 FORMAT "%5.2" /end CHARACTERISTIC
/begin CHARACTERISTIC C_T_DRI_CH "duration of ramp LV_DRI change" VALUE 0x42fba _REC_VAL_20_u2 655.35 _CNV_A_R_LINEAR_____27_CM 0. 655.35 FORMAT "%6.2" /end CHARACTERISTIC
/begin AXIS_PTS ldp_tco__fac_iga_ch_tco "" 0x4383f TCO _REC_AXS_20_u1 190.5 _CNV_A_R_LINEAR_____0_CM 8 -48. 142.5 FORMAT "%6.2" /end AXIS_PTS
/begin AXIS_PTS ldpm_n_32_1_iga "" 0x43ceb N_32 _REC_AXS_20_u1 8160. _CNV_A_R_LINEAR_____5_CM 8 0. 8160. FORMAT "%4.0" /end AXIS_PTS
/begin AXIS_PTS ldpm_t_ast_1_iga "" 0x45416 T_AST _REC_AXS_20_u2 6553.5 _CNV_A_R_LINEAR_____14_CM 8 0. 6553.5 FORMAT "%6.1" /end AXIS_PTS
/begin AXIS_PTS ldpm_tco_st_1_iga "" 0x44002 TCO_ST _REC_AXS_20_u1 190.5 _CNV_A_R_LINEAR_____0_CM 8 -48. 142.5 FORMAT "%5.1" /end AXIS_PTS
/begin AXIS_PTS ldp_fac_tq_req_clu__crlc_tq_add "" 0x44390 FAC_TQ_REQ_CLU _REC_AXS_20_u2 1.99996948 _CNV_A_R_LINEAR_____45_CM 4 0. 1.99996948 FORMAT "%7.5" /end AXIS_PTS
/begin AXIS_PTS ldpm_n_32_2_iga "" 0x43d26 N_32 _REC_AXS_20_u1 8160. _CNV_A_R_LINEAR_____5_CM 8 0. 8160. FORMAT "%4.0" /end AXIS_PTS
/begin AXIS_PTS ldpm_maf_hb_1_iga "" 0x43c51 MAF_HB _REC_AXS_20_u1 1389. _CNV_A_R_LINEAR_____18_CM 8 0. 1389. FORMAT "%4.0" /end AXIS_PTS
/begin MEASUREMENT IGA_BAS_TEMP_COR "additive temperature correction of IGA_BAS_IVVT" SBYTE _CNV_A_R_LINEAR_____75_CM 1 100. -48. 47.625 ECU_ADDRESS 0x3fce3d FORMAT "%5.1" /end MEASUREMENT
/begin CHARACTERISTIC IP_IGA_BAS_TEMP_COR__TCO__TIA "Maximum ignition angle correction for temperature effects" MAP 0x4f14f _REC_MAP_20_u1_u1_u1 95.625 _CNV_A_R_LINEAR_____204_CM -48. 47.625 FORMAT "%5.1"
 /begin AXIS_DESCR COM_AXIS TCO _CNV_A_R_LINEAR_____0_CM 6 -48. 142.5 FORMAT "%5.1" AXIS_PTS_REF ldp_tco__iga_bas_temp_cor /end AXIS_DESCR
 /begin AXIS_DESCR COM_AXIS TIA _CNV_A_R_LINEAR_____0_CM 6 -48. 142.5 FORMAT "%5.1" AXIS_PTS_REF ldp_tia__iga_bas_temp_cor /end AXIS_DESCR
/end CHARACTERISTIC
/begin CHARACTERISTIC IP_FAC_IGA_POS__N_32__MAF "Weighting factor on ignition angle correction for temperature effects" MAP 0x4e0a6 _REC_MAP_20_u1_u1_u1 0.9960940000000002 _CNV_A_R_LINEAR_____44_CM 0. 0.996094 FORMAT "%5.3"
 /begin AXIS_DESCR COM_AXIS N_32 _CNV_A_R_LINEAR_____5_CM 8 0. 8160. FORMAT "%4.0" AXIS_PTS_REF ldpm_n_32_fac_iga_pos_neg /end AXIS_DESCR
 /begin AXIS_DESCR COM_AXIS MAF _CNV_A_R_LINEAR_____18_CM 6 0. 1389. FORMAT "%4.0" AXIS_PTS_REF ldp_maf_fac_iga_pos_neg /end AXIS_DESCR
/end CHARACTERISTIC
/begin CHARACTERISTIC IP_FAC_IGA_NEG__N_32__MAF "Weighting factor on ignition angle correction for temperature effects" MAP 0x4e076 _REC_MAP_20_u1_u1_u1 0.9960940000000002 _CNV_A_R_LINEAR_____44_CM 0. 0.996094 FORMAT "%5.3"
 /begin AXIS_DESCR COM_AXIS N_32 _CNV_A_R_LINEAR_____5_CM 8 0. 8160. FORMAT "%4.0" AXIS_PTS_REF ldpm_n_32_fac_iga_pos_neg /end AXIS_DESCR
 /begin AXIS_DESCR COM_AXIS MAF _CNV_A_R_LINEAR_____18_CM 6 0. 1389. FORMAT "%4.0" AXIS_PTS_REF ldp_maf_fac_iga_pos_neg /end AXIS_DESCR
/end CHARACTERISTIC
/begin AXIS_PTS ldp_tco__iga_bas_temp_cor "" 0x4386b TCO _REC_AXS_20_u1 190.5 _CNV_A_R_LINEAR_____0_CM 6 -48. 142.5 FORMAT "%5.1" /end AXIS_PTS
/begin AXIS_PTS ldp_tia__iga_bas_temp_cor "" 0x439c2 TIA _REC_AXS_20_u1 28.575 _CNV_A_R_LINEAR_____0_CM 6 -48. 142.5 FORMAT "%5.1" /end AXIS_PTS
/begin AXIS_PTS ldpm_n_32_fac_iga_pos_neg "" 0x43e2e N_32 _REC_AXS_20_u1 8160. _CNV_A_R_LINEAR_____5_CM 8 0. 8160. FORMAT "%4.0" /end AXIS_PTS
/begin AXIS_PTS ldp_maf_fac_iga_pos_neg "" 0x43473 MAF _REC_AXS_20_u1 1389. _CNV_A_R_LINEAR_____18_CM 6 0. 1389. FORMAT "%4.0" /end AXIS_PTS
/begin MEASUREMENT IGA_BAS_EGR_COR_HOM "Additive basic ignition angle correction due to EGR influence to homogenous mode" SBYTE _CNV_A_R_LINEAR_____75_CM 1 100. -48. 47.625 ECU_ADDRESS 0x3fe358 FORMAT "%5.1" /end MEASUREMENT
/begin MEASUREMENT IGA_BAS_EGR_COR_S "Additive basic ignition angle correction due to EGR influence to stratified mode" SBYTE _CNV_A_R_LINEAR_____75_CM 1 100. -48. 47.625 ECU_ADDRESS 0x3fe359 FORMAT "%5.1" /end MEASUREMENT
/begin CHARACTERISTIC IP_FAC_RATE_EGR_AFL "Temperature corrective factor (air/fuel lean)" CURVE 0x4e363 _REC_CUR_20_u1_u1 1.99220002 _CNV_A_R_LINEAR_____34_CM 0. 1.99220002 FORMAT "%5.3"
 /begin AXIS_DESCR COM_AXIS TCO _CNV_A_R_LINEAR_____0_CM 8 -48. 142.5 FORMAT "%5.1" AXIS_PTS_REF ldpm_tco__iga_egr /end AXIS_DESCR
/end CHARACTERISTIC
/begin CHARACTERISTIC IP_FAC_RATE_EGR_S "temperature corrective factor (stratified mode)" CURVE 0x4e36b _REC_CUR_20_u1_u1 1.99220002 _CNV_A_R_LINEAR_____34_CM 0. 1.99220002 FORMAT "%5.3"
 /begin AXIS_DESCR COM_AXIS TCO _CNV_A_R_LINEAR_____0_CM 8 -48. 142.5 FORMAT "%5.1" AXIS_PTS_REF ldpm_tco__iga_egr /end AXIS_DESCR
/end CHARACTERISTIC
/begin CHARACTERISTIC IP_IGA_EGR_S "Spark advance added to basic value with EGR function (stratified mode)" MAP 0x4f2db _REC_MAP_20_u1_u1_u2 95.625 _CNV_A_R_LINEAR_____204_CM -48. 47.625 FORMAT "%5.1"
 /begin AXIS_DESCR COM_AXIS N_32 _CNV_A_R_LINEAR_____5_CM 5 0. 8160. FORMAT "%4.0" AXIS_PTS_REF ldp_n_32__iga_egr_s /end AXIS_DESCR
 /begin AXIS_DESCR COM_AXIS MFF_SP_S _CNV_A_R_LINEAR_____95_CM 5 0. 1389. FORMAT "%7.2" AXIS_PTS_REF ldp_mff_sp_s__egr_iga /end AXIS_DESCR
/end CHARACTERISTIC
/begin MEASUREMENT IGA_BAS_EGR_COR "Additive basic ignition angle correction due to EGR influence" SBYTE _CNV_A_R_LINEAR_____75_CM 1 100. -48. 47.625 ECU_ADDRESS 0x3fce3e FORMAT "%5.1" /end MEASUREMENT
/begin MEASUREMENT EGR_RATIO_COR_2 "Corrected EGR_RATIO for LDP of LPD_IGA_BAS_EGR" UWORD _CNV_A_R_LINEAR_____94_CM 1 100. 0. 99.99847412 ECU_ADDRESS 0x3fe354 /end MEASUREMENT
/begin CHARACTERISTIC IP_FAC_IGA_BAS_EGR_LAMB "Factor for EGR_RATIO list of datapoints" MAP 0x4dfce _REC_MAP_20_u1_u1_u2 0.9960940000000002 _CNV_A_R_LINEAR_____44_CM 0. 0.996094 FORMAT "%5.3"
 /begin AXIS_DESCR COM_AXIS N_32 _CNV_A_R_LINEAR_____5_CM 12 0. 8160. FORMAT "%4.0" AXIS_PTS_REF ldpm_n_32_ip_egr_ratio /end AXIS_DESCR
 /begin AXIS_DESCR COM_AXIS MAF _CNV_A_R_LINEAR_____95_CM 12 0. 1389. FORMAT "%7.2" AXIS_PTS_REF ldpm_maf_ip_egr_ratio /end AXIS_DESCR
/end CHARACTERISTIC
/begin CHARACTERISTIC IP_IGA_BAS_EGR "Basis for EGR correction IGA_BAS" CURVE 0x4ed31 _REC_CUR_20_u1_u2 95.625 _CNV_A_R_LINEAR_____204_CM -48. 47.625 FORMAT "%5.1"
 /begin AXIS_DESCR COM_AXIS EGR_RATIO_COR_2 _CNV_A_R_LINEAR_____205_CM 6 0. 99.99847412 AXIS_PTS_REF ldp_egr_ratio_cor_2__iga_bas /end AXIS_DESCR
/end CHARACTERISTIC
/begin CHARACTERISTIC IP_IGA_BAS_EGR_FAC__N__MAF "" MAP 0x4ed37 _REC_MAP_20_u1_u1_u2 1.99220002 _CNV_A_R_LINEAR_____34_CM 0. 1.99220002 FORMAT "%5.3"
 /begin AXIS_DESCR COM_AXIS N_32 _CNV_A_R_LINEAR_____5_CM 12 0. 8160. FORMAT "%4.0" AXIS_PTS_REF ldpm_n_32_ip_egr_ratio /end AXIS_DESCR
 /begin AXIS_DESCR COM_AXIS MAF _CNV_A_R_LINEAR_____95_CM 12 0. 1389. FORMAT "%7.2" AXIS_PTS_REF ldpm_maf_ip_egr_ratio /end AXIS_DESCR
/end CHARACTERISTIC
/begin AXIS_PTS ldpm_tco__iga_egr "" 0x43fa2 TCO _REC_AXS_20_u1 190.5 _CNV_A_R_LINEAR_____0_CM 8 -48. 142.5 FORMAT "%5.1" /end AXIS_PTS
/begin AXIS_PTS ldp_n_32__iga_egr_s "" 0x4352e N_32 _REC_AXS_20_u1 8160. _CNV_A_R_LINEAR_____5_CM 5 0. 8160. FORMAT "%4.0" /end AXIS_PTS
/begin AXIS_PTS ldp_mff_sp_s__egr_iga "" 0x4475c MFF_SP_S _REC_AXS_20_u2 1389. _CNV_A_R_LINEAR_____95_CM 5 0. 1389. FORMAT "%7.2" /end AXIS_PTS
/begin AXIS_PTS ldp_egr_ratio_cor_2__iga_bas "" 0x442f4 EGR_RATIO_COR_2 _REC_AXS_20_u2 99.99847412 _CNV_A_R_LINEAR_____205_CM 6 0. 99.99847412 /end AXIS_PTS
/begin MEASUREMENT IGA_DIF_MIN "Difference of minimum ignition angle to reference ignition angle" UBYTE _CNV_A_R_LINEAR_____203_CM 1 100. 0. -95.625 ECU_ADDRESS 0x3fce3f FORMAT "%5.1" /end MEASUREMENT
/begin MEASUREMENT IGA_DIF_MIN_DELTA "Extra retard on IGA_DIF_MIN in case of torque intervention" UBYTE _CNV_A_R_LINEAR_____203_CM 1 100. 0. -95.625 ECU_ADDRESS 0x3fe35a FORMAT "%5.1" /end MEASUREMENT
/begin MEASUREMENT LV_IGA_DIF_MIN_DELTA_ACT "Flag to enable and declare the acting of the extra retard on IGA_DIF_MIN" UBYTE _CNV_S_2_RANGE______28_CM 1 100. 0. 1. ECU_ADDRESS 0x3fe35c /end MEASUREMENT
/begin MEASUREMENT IGA_DIF_MIN_AST "Intermediate variable: correction on IGA_DIF_MIN for combustion cycles after start management" SBYTE _CNV_A_R_LINEAR_____75_CM 1 100. -48. 47.625 ECU_ADDRESS 0x3fe35b FORMAT "%5.1" /end MEASUREMENT
/begin CHARACTERISTIC C_IGA_DIF_MIN_DELTA_TEMP_ENA "Maintaining time of extra retard on IGA_DIF_MIN" VALUE 0x428e3 _REC_VAL_20_u1 2.55 _CNV_A_R_LINEAR_____27_CM 0. 2.55 FORMAT "%4.2" /end CHARACTERISTIC
/begin CHARACTERISTIC C_IGA_DIF_MIN_DELTA_LGRD "Step gradient limitation after extra spark retard on IGA_DIF_MIN" VALUE 0x428e1 _REC_VAL_20_u1 -95.625 _CNV_A_R_LINEAR_____203_CM 0. -95.625 FORMAT "%5.1" /end CHARACTERISTIC
/begin CHARACTERISTIC IP_IGA_DIF_MIN_TCO "TCO correction for minimum ignition angle" CURVE 0x4f2b3 _REC_CUR_20_u1_u1 95.625 _CNV_A_R_LINEAR_____204_CM -48. 47.625 FORMAT "%5.1"
 /begin AXIS_DESCR COM_AXIS TCO _CNV_A_R_LINEAR_____0_CM 8 -48. 142.5 FORMAT "%5.1" AXIS_PTS_REF ldpm_tco_1_igsp /end AXIS_DESCR
/end CHARACTERISTIC
/begin CHARACTERISTIC IP_IGA_DIF_MIN_CYC "Correction on minimum ignition angle for combustion cycles after start" MAP 0x4f213 _REC_MAP_20_u1_u2_u1 95.625 _CNV_A_R_LINEAR_____204_CM -48. 47.625 FORMAT "%5.1"
 /begin AXIS_DESCR COM_AXIS CYC_CAST _CNV_A_R_LINEAR_____10_CM 8 0. 65535. FORMAT "%5.0" AXIS_PTS_REF ldp_cyc_cast_ip_iga_dif_min_cyc /end AXIS_DESCR
 /begin AXIS_DESCR COM_AXIS TCO _CNV_A_R_LINEAR_____0_CM 8 -48. 142.5 FORMAT "%5.1" AXIS_PTS_REF ldpm_tco_1_igsp /end AXIS_DESCR
/end CHARACTERISTIC
/begin CHARACTERISTIC IP_IGA_DIF_MIN_N_MAF "Basic minimum ignition angle difference value" MAP 0x4f283 _REC_MAP_20_u1_u1_u1 -95.625 _CNV_A_R_LINEAR_____203_CM 0. -95.625 FORMAT "%5.1"
 /begin AXIS_DESCR COM_AXIS N_32 _CNV_A_R_LINEAR_____5_CM 8 0. 8160. FORMAT "%4.0" AXIS_PTS_REF ldpm_n_32_2_igsp /end AXIS_DESCR
 /begin AXIS_DESCR COM_AXIS MAF _CNV_A_R_LINEAR_____18_CM 6 0. 1389. FORMAT "%4.0" AXIS_PTS_REF ldpm_maf_hb_2_igsp /end AXIS_DESCR
/end CHARACTERISTIC
/begin CHARACTERISTIC IP_IGA_DIF_MIN_DELTA "Extra spark retard on minimum ignition angle in case of torque intervention" MAP 0x4f253 _REC_MAP_20_u1_u1_u1 -95.625 _CNV_A_R_LINEAR_____203_CM 0. -95.625 FORMAT "%5.1"
 /begin AXIS_DESCR COM_AXIS N_32 _CNV_A_R_LINEAR_____5_CM 8 0. 8160. FORMAT "%4.0" AXIS_PTS_REF ldpm_n_32_2_igsp /end AXIS_DESCR
 /begin AXIS_DESCR COM_AXIS MAF _CNV_A_R_LINEAR_____18_CM 6 0. 1389. FORMAT "%4.0" AXIS_PTS_REF ldpm_maf_hb_2_igsp /end AXIS_DESCR
/end CHARACTERISTIC
/begin CHARACTERISTIC C_IGA_DIF_MIN_DELTA_TEMP_DIS "Disable time of extra spark retard on IGA_DIF_MIN after end of gradient return" VALUE 0x428e2 _REC_VAL_20_u1 2.55 _CNV_A_R_LINEAR_____27_CM 0. 2.55 FORMAT "%4.2" /end CHARACTERISTIC
/begin AXIS_PTS ldp_cyc_cast_ip_iga_dif_min_cyc "" 0x4426a CYC_CAST _REC_AXS_20_u2 65535. _CNV_A_R_LINEAR_____10_CM 8 0. 65535. FORMAT "%5.0" /end AXIS_PTS
/begin AXIS_PTS ldpm_n_32_2_igsp "" 0x43d2f N_32 _REC_AXS_20_u1 8160. _CNV_A_R_LINEAR_____5_CM 8 0. 8160. FORMAT "%4.0" /end AXIS_PTS
/begin AXIS_PTS ldpm_maf_hb_2_igsp "" 0x43c5a MAF_HB _REC_AXS_20_u1 1389. _CNV_A_R_LINEAR_____18_CM 6 0. 1389. FORMAT "%4.0" /end AXIS_PTS
/begin CHARACTERISTIC IP_IGA_REF "Basic reference ignition angle at max. spread" MAP 0x4f33c _REC_MAP_20_u1_u1_u2 4.78125 _CNV_A_R_LINEAR_____202_CM -35.625 60. FORMAT "%5.1"
 /begin AXIS_DESCR COM_AXIS N_32 _CNV_A_R_LINEAR_____5_CM 16 0. 8160. FORMAT "%4.0" AXIS_PTS_REF ldpm_n_32_100 /end AXIS_DESCR
 /begin AXIS_DESCR COM_AXIS MAF _CNV_A_R_LINEAR_____95_CM 12 0. 1389. FORMAT "%7.2" AXIS_PTS_REF ldpm_maf_100 /end AXIS_DESCR
/end CHARACTERISTIC
/begin CHARACTERISTIC IP_IGA_REF_LAMB__LAMB_SP "additive lambda setpoint correction of IGA_REF" CURVE 0x4f492 _REC_CUR_20_u1_u2 95.625 _CNV_A_R_LINEAR_____204_CM -48. 47.625 FORMAT "%5.1"
 /begin AXIS_DESCR COM_AXIS LAMB_SP _CNV_A_R_LINEAR_____148_CM 8 0. 31.99902344 FORMAT "%7.4" AXIS_PTS_REF ldp_lamb_sp_iga_ref_lamb /end AXIS_DESCR
/end CHARACTERISTIC
/begin MEASUREMENT IGA_REF_COR "corrected reference ignition angle" UBYTE _CNV_A_R_LINEAR_____202_CM 1 100. -35.625 60. ECU_ADDRESS 0x3fce41 FORMAT "%5.1" /end MEASUREMENT
/begin MEASUREMENT IGA_REF_TEMP_COR "additive temperature correction of IGA_REF" SBYTE _CNV_A_R_LINEAR_____75_CM 1 100. -48. 47.625 ECU_ADDRESS 0x3fe369 FORMAT "%5.1" /end MEASUREMENT
/begin MEASUREMENT IGA_REF_VVT_COR "additive valve timing correction of IGA_REF" SBYTE _CNV_A_R_LINEAR_____75_CM 1 100. -48. 47.625 ECU_ADDRESS 0x3fe368 FORMAT "%5.1" /end MEASUREMENT
/begin MEASUREMENT IGA_REF_EGR_COR "additive EGR correction of IGA_REF" SBYTE _CNV_A_R_LINEAR_____75_CM 1 100. -48. 47.625 ECU_ADDRESS 0x3fce42 FORMAT "%5.1" /end MEASUREMENT
/begin CHARACTERISTIC IP_IGA_REF_TEMP__N__MAF "Max. reference ignition angle adjustment due to temperature influence" MAP 0x4f51a _REC_MAP_20_u1_u1_u1 95.625 _CNV_A_R_LINEAR_____204_CM -48. 47.625 FORMAT "%5.1"
 /begin AXIS_DESCR COM_AXIS N_32 _CNV_A_R_LINEAR_____5_CM 8 0. 8160. FORMAT "%4.0" AXIS_PTS_REF ldp_n_iga_ref_temp /end AXIS_DESCR
 /begin AXIS_DESCR COM_AXIS MAF _CNV_A_R_LINEAR_____18_CM 6 0. 1389. FORMAT "%4.0" AXIS_PTS_REF ldp_maf_iga_ref_temp /end AXIS_DESCR
/end CHARACTERISTIC
/begin CHARACTERISTIC IP_IGA_REF_VVT__N__MAF "basis for additive valve timing correction of IGA_REF" MAP 0x4f56e _REC_MAP_20_u1_u1_u1 95.625 _CNV_A_R_LINEAR_____204_CM -48. 47.625 FORMAT "%5.1"
 /begin AXIS_DESCR COM_AXIS N_32 _CNV_A_R_LINEAR_____5_CM 16 0. 8160. FORMAT "%4.0" AXIS_PTS_REF ldp_n__iga_ref_vvt /end AXIS_DESCR
 /begin AXIS_DESCR COM_AXIS MAF _CNV_A_R_LINEAR_____18_CM 12 0. 1389. FORMAT "%4.0" AXIS_PTS_REF ldp_maf__iga_ref_vvt /end AXIS_DESCR
/end CHARACTERISTIC
/begin CHARACTERISTIC IP_IGA_REF_TEMP_FAC "Correction factor for reference IGA temperature correction" MAP 0x4f54a _REC_MAP_20_u1_u1_u1 1.9921875 _CNV_A_R_LINEAR_____206_CM -1. 0.9921875 FORMAT "%5.3"
 /begin AXIS_DESCR COM_AXIS TIA _CNV_A_R_LINEAR_____0_CM 6 -48. 142.5 FORMAT "%5.1" AXIS_PTS_REF ldp_tia__iga_ref_temp_fac /end AXIS_DESCR
 /begin AXIS_DESCR COM_AXIS TCO _CNV_A_R_LINEAR_____0_CM 6 -48. 142.5 FORMAT "%5.1" AXIS_PTS_REF ldp_tco__iga_ref_temp_fac /end AXIS_DESCR
/end CHARACTERISTIC
/begin CHARACTERISTIC IP_IGA_REF_EGR_FAC "factor for EGR correction of IGA_REF" MAP 0x4f402 _REC_MAP_20_u1_u1_u2 1.9921875 _CNV_A_R_LINEAR_____103_CM 0. 1.9921875 FORMAT "%5.3"
 /begin AXIS_DESCR COM_AXIS N_32 _CNV_A_R_LINEAR_____5_CM 12 0. 8160. FORMAT "%4.0" AXIS_PTS_REF ldpm_n_32_ip_egr_ratio /end AXIS_DESCR
 /begin AXIS_DESCR COM_AXIS MAF _CNV_A_R_LINEAR_____95_CM 12 0. 1389. FORMAT "%7.2" AXIS_PTS_REF ldpm_maf_ip_egr_ratio /end AXIS_DESCR
/end CHARACTERISTIC
/begin CHARACTERISTIC IP_IGA_REF_EGR "basis for EGR correection of IGA_REF" CURVE 0x4f3fc _REC_CUR_20_u1_u2 95.625 _CNV_A_R_LINEAR_____204_CM -48. 47.625 FORMAT "%5.1"
 /begin AXIS_DESCR COM_AXIS EGR_RATIO_COR_2 _CNV_A_R_LINEAR_____94_CM 6 0. 99.99847412 AXIS_PTS_REF ldp_egr_ratio_cor__iga_ref_egr /end AXIS_DESCR
/end CHARACTERISTIC
/begin CHARACTERISTIC IP_FAC_IGA_REF_PORT "port flap position correction of IGA_REF" CURVE 0x4e166 _REC_CUR_20_u1_u2 0.9960940000000002 _CNV_A_R_LINEAR_____44_CM 0. 0.996094 FORMAT "%5.3"
 /begin AXIS_DESCR COM_AXIS PORT_AV _CNV_A_R_LINEAR_____207_CM 8 0. 99.99847412 AXIS_PTS_REF ldp_port_av__fac_iga_bas_port /end AXIS_DESCR
/end CHARACTERISTIC
/begin CHARACTERISTIC IP_FAC_IGA_REF_EGR_LAMB "factor for EGR_RATIO list of data points" MAP 0x4e0d6 _REC_MAP_20_u1_u1_u2 0.9960940000000002 _CNV_A_R_LINEAR_____44_CM 0. 0.996094 FORMAT "%5.3"
 /begin AXIS_DESCR COM_AXIS N_32 _CNV_A_R_LINEAR_____5_CM 12 0. 8160. FORMAT "%4.0" AXIS_PTS_REF ldpm_n_32_ip_egr_ratio /end AXIS_DESCR
 /begin AXIS_DESCR COM_AXIS MAF _CNV_A_R_LINEAR_____95_CM 12 0. 1389. FORMAT "%7.2" AXIS_PTS_REF ldpm_maf_ip_egr_ratio /end AXIS_DESCR
/end CHARACTERISTIC
/begin CHARACTERISTIC IP_IGA_REF_PORT "basic map for additive port flap position correction of IGA_REF" MAP 0x4f4da _REC_MAP_20_u1_u1_u2 95.625 _CNV_A_R_LINEAR_____204_CM -48. 47.625 FORMAT "%5.1"
 /begin AXIS_DESCR COM_AXIS N_32 _CNV_A_R_LINEAR_____5_CM 8 0. 8160. FORMAT "%4.0" AXIS_PTS_REF ldp_n_32__iga_bas_port /end AXIS_DESCR
 /begin AXIS_DESCR COM_AXIS MAF _CNV_A_R_LINEAR_____95_CM 8 0. 1389. FORMAT "%7.2" AXIS_PTS_REF ldp_maf__iga_ref_port /end AXIS_DESCR
/end CHARACTERISTIC
/begin AXIS_PTS ldp_lamb_sp_iga_ref_lamb "" 0x44478 LAMB_SP _REC_AXS_20_u2 31.99902344 _CNV_A_R_LINEAR_____148_CM 8 0. 31.99902344 FORMAT "%7.4" /end AXIS_PTS
/begin AXIS_PTS ldp_n_iga_ref_temp "" 0x43758 N_32 _REC_AXS_20_u1 8160. _CNV_A_R_LINEAR_____5_CM 8 0. 8160. FORMAT "%4.0" /end AXIS_PTS
/begin AXIS_PTS ldp_maf_iga_ref_temp "" 0x4348c MAF _REC_AXS_20_u1 1389. _CNV_A_R_LINEAR_____18_CM 6 0. 1389. FORMAT "%4.0" /end AXIS_PTS
/begin AXIS_PTS ldp_tia__iga_ref_temp_fac "" 0x439c9 TIA _REC_AXS_20_u1 190.5 _CNV_A_R_LINEAR_____0_CM 6 -48. 142.5 FORMAT "%5.1" /end AXIS_PTS
/begin AXIS_PTS ldp_n__iga_ref_vvt "" 0x436f9 N_32 _REC_AXS_20_u1 8160. _CNV_A_R_LINEAR_____5_CM 16 0. 8160. FORMAT "%4.0" /end AXIS_PTS
/begin AXIS_PTS ldp_tco__iga_ref_temp_fac "" 0x43872 TCO _REC_AXS_20_u1 190.5 _CNV_A_R_LINEAR_____0_CM 6 -48. 142.5 FORMAT "%5.1" /end AXIS_PTS
/begin AXIS_PTS ldp_maf__iga_ref_vvt "" 0x43450 MAF _REC_AXS_20_u1 1389. _CNV_A_R_LINEAR_____18_CM 12 0. 1389. FORMAT "%4.0" /end AXIS_PTS
/begin AXIS_PTS ldp_egr_ratio_cor__iga_ref_egr "" 0x44302 EGR_RATIO_COR _REC_AXS_20_u2 99.99847412 _CNV_A_R_LINEAR_____94_CM 6 0. 99.99847412 /end AXIS_PTS
/begin AXIS_PTS ldp_maf__iga_ref_port "" 0x444a2 MAF _REC_AXS_20_u2 1389. _CNV_A_R_LINEAR_____95_CM 8 0. 1389. FORMAT "%7.2" /end AXIS_PTS
/begin AXIS_PTS ldp_n_32__iga_bas_port "" 0x43508 N_32 _REC_AXS_20_u1 8160. _CNV_A_R_LINEAR_____5_CM 8 0. 8160. FORMAT "%4.0" /end AXIS_PTS
/begin AXIS_PTS ldp_port_av__fac_iga_bas_port "" 0x449a6 PORT_AV _REC_AXS_20_u2 99.99847412 _CNV_A_R_LINEAR_____207_CM 8 0. 99.99847412 /end AXIS_PTS
/begin MEASUREMENT EGR_RATIO_COR "Corrected EGR ratio" UWORD _CNV_A_R_LINEAR_____94_CM 1 100. 0. 99.99847412 ECU_ADDRESS 0x3fe366 /end MEASUREMENT
/begin MEASUREMENT IGA_REF_LAMB_COR "additive Lambda correction of IGA_REF" SBYTE _CNV_A_R_LINEAR_____75_CM 1 100. -48. 47.625 ECU_ADDRESS 0x3fe36a FORMAT "%5.1" /end MEASUREMENT
/begin MEASUREMENT IGA_REF_PORT_COR "additive port-flap correction of IGA_REF" SBYTE _CNV_A_R_LINEAR_____75_CM 1 100. -48. 47.625 ECU_ADDRESS 0x3fe36b FORMAT "%5.1" /end MEASUREMENT
/begin MEASUREMENT IGA_IGC_S_0 "Ignition angle for stratified mode (absolute value)" UBYTE _CNV_A_R_LINEAR_____202_CM 1 100. -35.625 60. ECU_ADDRESS 0x3fce43 FORMAT "%5.1" /end MEASUREMENT
/begin MEASUREMENT IGA_IGC_S_1 "Ignition angle for stratified mode (absolute value)" UBYTE _CNV_A_R_LINEAR_____202_CM 1 100. -35.625 60. ECU_ADDRESS 0x3fce44 FORMAT "%5.1" /end MEASUREMENT
/begin MEASUREMENT IGA_IGC_S_2 "Ignition angle for stratified mode (absolute value)" UBYTE _CNV_A_R_LINEAR_____202_CM 1 100. -35.625 60. ECU_ADDRESS 0x3fce45 FORMAT "%5.1" /end MEASUREMENT
/begin MEASUREMENT IGA_IGC_S_3 "Ignition angle for stratified mode (absolute value)" UBYTE _CNV_A_R_LINEAR_____202_CM 1 100. -35.625 60. ECU_ADDRESS 0x3fce46 FORMAT "%5.1" /end MEASUREMENT
/begin MEASUREMENT IGA_IGC_S_4 "Ignition angle for stratified mode (absolute value)" UBYTE _CNV_A_R_LINEAR_____202_CM 1 100. -35.625 60. ECU_ADDRESS 0x3fce47 FORMAT "%5.1" /end MEASUREMENT
/begin MEASUREMENT IGA_IGC_S_5 "Ignition angle for stratified mode (absolute value)" UBYTE _CNV_A_R_LINEAR_____202_CM 1 100. -35.625 60. ECU_ADDRESS 0x3fce48 FORMAT "%5.1" /end MEASUREMENT
/begin MEASUREMENT IGA_BAS_S "Basic ignition angle for stratified mode" UBYTE _CNV_A_R_LINEAR_____202_CM 1 100. -35.625 60. ECU_ADDRESS 0x3fe36d FORMAT "%5.1" /end MEASUREMENT
/begin CHARACTERISTIC IP_IGA_BAS_S "Basic ignition angle for stratified mode" MAP 0x4f08f _REC_MAP_20_u1_u1_u2 95.625 _CNV_A_R_LINEAR_____202_CM -35.625 60. FORMAT "%5.1"
 /begin AXIS_DESCR COM_AXIS N_32 _CNV_A_R_LINEAR_____5_CM 16 0. 8160. FORMAT "%4.0" AXIS_PTS_REF ldp_n_32__iga_bas_s /end AXIS_DESCR
 /begin AXIS_DESCR COM_AXIS MFF_SP _CNV_A_R_LINEAR_____95_CM 12 0. 1389. FORMAT "%7.2" AXIS_PTS_REF ldp_mff_sp__iga_bas_s /end AXIS_DESCR
/end CHARACTERISTIC
/begin AXIS_PTS ldp_mff_sp__iga_bas_s "" 0x4471a MFF_SP _REC_AXS_20_u2 1389. _CNV_A_R_LINEAR_____95_CM 12 0. 1389. FORMAT "%7.2" /end AXIS_PTS
/begin AXIS_PTS ldp_n_32__iga_bas_s "" 0x43511 N_32 _REC_AXS_20_u1 816. _CNV_A_R_LINEAR_____5_CM 16 0. 8160. FORMAT "%4.0" /end AXIS_PTS
/begin CHARACTERISTIC IP_IGA_DIF_SP__EFF_IGA_SP "Setpoint spark retard for torque setpoint" CURVE 0x4f2cb _REC_CUR_20_u1_u2 -95.625 _CNV_A_R_LINEAR_____203_CM 0. -95.625 FORMAT "%5.1"
 /begin AXIS_DESCR COM_AXIS EFF_IGA_SP _CNV_A_R_LINEAR_____45_CM 16 0. 1.99996948 FORMAT "%7.5" AXIS_PTS_REF ldp_eff_iga_sp_iga_dif_sp /end AXIS_DESCR
/end CHARACTERISTIC
/begin MEASUREMENT IGA_DIF_SP "Setpoint subtrahend ignition angle" UBYTE _CNV_A_R_LINEAR_____203_CM 1 100. 0. -95.625 ECU_ADDRESS 0x3fce4b FORMAT "%5.1" /end MEASUREMENT
/begin MEASUREMENT LV_TQ_IGA_ACT "Logical variable torque intervention by spark retard is active" UBYTE _CNV_S_2_RANGE______28_CM 1 100. 0. 1. ECU_ADDRESS 0x3fce4c /end MEASUREMENT
/begin MEASUREMENT LV_TQ_IGA_REQ "Logical variable torque intervention by spark retard is request" UBYTE _CNV_S_2_RANGE______28_CM 1 100. 0. 1. ECU_ADDRESS 0x3fe377 BIT_MASK 0x1 /end MEASUREMENT
/begin CHARACTERISTIC LC_TQ_IGA_INH "Logical constant inhibition torque intervention by spark retard" VALUE 0x42bdf _REC_VAL_20_u1 1. _CNV_A_R_LINEAR_____12_CM 0. 1. FORMAT "%1.0" /end CHARACTERISTIC
/begin CHARACTERISTIC C_EFF_IGA_THD_1 "Threshold ignition efficiency for deactivation spark retard" VALUE 0x42cd0 _REC_VAL_20_u2 1.99996948 _CNV_A_R_LINEAR_____45_CM 0. 1.99996948 FORMAT "%7.5" /end CHARACTERISTIC
/begin CHARACTERISTIC C_EFF_IGA_THD_AJ "Threshold ignition efficiency for deactivation spark retard in anti-jerk intervention" VALUE 0x42cd2 _REC_VAL_20_u2 1.99996948 _CNV_A_R_LINEAR_____45_CM 0. 1.99996948 FORMAT "%7.5" /end CHARACTERISTIC
/begin CHARACTERISTIC C_EFF_IGA_THD_IS "Threshold ignition efficiency for deactivation spark retard" VALUE 0x42cd4 _REC_VAL_20_u2 1.99996948 _CNV_A_R_LINEAR_____45_CM 0. 1.99996948 FORMAT "%7.5" /end CHARACTERISTIC
/begin AXIS_PTS ldp_eff_iga_sp_iga_dif_sp "" 0x44294 EFF_IGA_SP _REC_AXS_20_u2 1.99996948 _CNV_A_R_LINEAR_____45_CM 16 0. 1.99996948 FORMAT "%7.5" /end AXIS_PTS
/begin MEASUREMENT EFF_IGA_SP "Setpoint ignition efficiency" UWORD _CNV_A_R_LINEAR_____45_CM 1 100. 0. 1.99996948 ECU_ADDRESS 0x3fe36e FORMAT "%7.5" /end MEASUREMENT
/begin MEASUREMENT EFF_IGA_SP_CAN "Setpoint ignition efficiency for CAN" UWORD _CNV_A_R_LINEAR_____45_CM 1 100. 0. 1.99996948 ECU_ADDRESS 0x3fe372 FORMAT "%7.5" /end MEASUREMENT
/begin MEASUREMENT EFF_IGA_SP_1 "Setpoint ignition efficiency" UWORD _CNV_A_R_LINEAR_____45_CM 1 100. 0. 1.99996948 ECU_ADDRESS 0x3fe370 FORMAT "%7.5" /end MEASUREMENT
/begin MEASUREMENT EFF_IGA_SP_1_CAN "Setpoint ignition efficiency for CAN" UWORD _CNV_A_R_LINEAR_____45_CM 1 100. 0. 1.99996948 ECU_ADDRESS 0x3fe374 FORMAT "%7.5" /end MEASUREMENT
/begin MEASUREMENT IGA_SP "Setpoint ignition angle from torque management" UBYTE _CNV_A_R_LINEAR_____202_CM 1 100. -35.625 60. ECU_ADDRESS 0x3fce49 FORMAT "%5.1" /end MEASUREMENT
/begin MEASUREMENT IGA_SP_CAN "Setpoint ignition angle from torque management for CAN" UBYTE _CNV_A_R_LINEAR_____202_CM 1 100. -35.625 60. ECU_ADDRESS 0x3fce4a FORMAT "%5.1" /end MEASUREMENT
/begin MEASUREMENT IGA_ST "Basic ignition angle at start" UBYTE _CNV_A_R_LINEAR_____202_CM 1 100. -35.625 60. ECU_ADDRESS 0x3fce4d FORMAT "%5.1" /end MEASUREMENT
/begin CHARACTERISTIC IP_IGA_ST_BAS "Basic ignition angle at start" MAP 0x4f634 _REC_MAP_20_u1_u2_u1 4.78125 _CNV_A_R_LINEAR_____202_CM -35.625 60. FORMAT "%5.1"
 /begin AXIS_DESCR COM_AXIS N _CNV_A_R_LINEAR_____17_CM 6 0. 8160. FORMAT "%4.0" AXIS_PTS_REF ldp_n_ip_iga_st_bas /end AXIS_DESCR
 /begin AXIS_DESCR COM_AXIS TCO _CNV_A_R_LINEAR_____0_CM 8 -48. 142.5 FORMAT "%5.1" AXIS_PTS_REF ldpm_tco_1_igsp /end AXIS_DESCR
/end CHARACTERISTIC
/begin CHARACTERISTIC IP_IGA_ST_CYC_ST_COR "Basic ignition angle at start" MAP 0x4f664 _REC_MAP_20_u1_u1_u1 4.78125 _CNV_A_R_LINEAR_____204_CM -48. 47.625 FORMAT "%5.1"
 /begin AXIS_DESCR COM_AXIS CYCNR_ST _CNV_A_R_LINEAR_____10_CM 6 0. 255. FORMAT "%3.0" AXIS_PTS_REF ldp_cyc_st_ip_iga_st_cyc_st_cor /end AXIS_DESCR
 /begin AXIS_DESCR COM_AXIS TCO _CNV_A_R_LINEAR_____0_CM 8 -48. 142.5 FORMAT "%5.1" AXIS_PTS_REF ldpm_tco_1_igsp /end AXIS_DESCR
/end CHARACTERISTIC
/begin CHARACTERISTIC IP_IGA_ST_AMP_COR "Basic ignition angle at start" CURVE 0x4f62e _REC_CUR_20_u1_u2 4.78125 _CNV_A_R_LINEAR_____204_CM -48. 47.625 FORMAT "%5.1"
 /begin AXIS_DESCR COM_AXIS AMP _CNV_A_R_LINEAR_____43_CM 6 0. 5434. FORMAT "%7.2" AXIS_PTS_REF ldp_amp_ip_iga_st_amp_cor /end AXIS_DESCR
/end CHARACTERISTIC
/begin AXIS_PTS ldp_cyc_st_ip_iga_st_cyc_st_cor "" 0x43391 CYC_ST _REC_AXS_20_u1 255. _CNV_A_R_LINEAR_____10_CM 6 0. 255. FORMAT "%3.0" /end AXIS_PTS
/begin AXIS_PTS ldp_n_ip_iga_st_bas "" 0x448be N _REC_AXS_20_u2 8160. _CNV_A_R_LINEAR_____17_CM 6 0. 8160. FORMAT "%4.0" /end AXIS_PTS
/begin AXIS_PTS ldp_amp_ip_iga_st_amp_cor "" 0x44130 AMP _REC_AXS_20_u2 5434. _CNV_A_R_LINEAR_____43_CM 6 0. 5434. FORMAT "%7.2" /end AXIS_PTS
/begin CHARACTERISTIC C_TD_INI "initial value for dwell time control" VALUE 0x43052 _REC_VAL_20_u2 10. _CNV_A_R_LINEAR_____208_CM 0. 10. FORMAT "%5.2" /end CHARACTERISTIC
/begin CHARACTERISTIC C_TD_AS "Application intervention" VALUE 0x4335d _REC_VAL_20_s1 16.32 _CNV_A_R_LINEAR_____209_CM -8.192 8.128 FORMAT "%6.2" /end CHARACTERISTIC
/begin MEASUREMENT TD_MAX_WDT "Maximum executable dwell time" UWORD _CNV_A_R_LINEAR_____208_CM 1 100. 0. 50. ECU_ADDRESS 0x3fce50 FORMAT "%7.4" /end MEASUREMENT
/begin MEASUREMENT TD "Nominal dwell time" UWORD _CNV_A_R_LINEAR_____208_CM 1 100. 0. 50. ECU_ADDRESS 0x3fce4e FORMAT "%7.4" /end MEASUREMENT
/begin CHARACTERISTIC IP_TD__VB "Dwell time correction versus battery voltage" CURVE 0x4b1ec _REC_CUR_20_u2_u2 10. _CNV_A_R_LINEAR_____208_CM 0. 10. FORMAT "%5.2"
 /begin AXIS_DESCR COM_AXIS VB _CNV_A_R_LINEAR_____210_CM 8 0. 28.7055 FORMAT "%5.2" AXIS_PTS_REF ldpm_vb__td /end AXIS_DESCR
/end CHARACTERISTIC
/begin MEASUREMENT IGA_MIN_TEG "minimum ignition angle" UBYTE _CNV_A_R_LINEAR_____202_CM 1 100. -35.625 60. ECU_ADDRESS 0x3fce56 FORMAT "%5.1" /end MEASUREMENT
/begin MEASUREMENT IGA_DIF_MIN_TEG "Difference of minimum ignition angle with reference one - TEG correction included" UBYTE _CNV_A_R_LINEAR_____203_CM 1 100. 0. -95.625 ECU_ADDRESS 0x3fce57 FORMAT "%5.1" /end MEASUREMENT
/begin MEASUREMENT EFF_IGA_MIN_TEG "Ignition efficiency minimum ignition angle with TEG correction" UWORD _CNV_A_R_LINEAR_____45_CM 1 100. 0. 1.99996948 ECU_ADDRESS 0x3fce52 FORMAT "%7.5" /end MEASUREMENT
/begin CHARACTERISTIC C_TEG_MAX_IGA_HYS "Hysterisis on exhaust gas temperature for spark retard control" VALUE 0x4306e _REC_VAL_20_u2 2047. _CNV_A_R_LINEAR_____211_CM 0. 2047. FORMAT "%7.2" /end CHARACTERISTIC
/begin CHARACTERISTIC C_TEG_MAX_IGA "Maximum allowable exhaust gas temperature for spark retard control" VALUE 0x4306c _REC_VAL_20_u2 2047. _CNV_A_R_LINEAR_____211_CM 0. 2047. FORMAT "%7.2" /end CHARACTERISTIC
/begin CHARACTERISTIC IP_IGA_DIF_MIN_TEG__TEG "Minimum ignition angle versus exhaust gas temperature" CURVE 0x4f2bb _REC_CUR_20_u1_u2 -95.625 _CNV_A_R_LINEAR_____203_CM 0. -95.625 FORMAT "%5.1"
 /begin AXIS_DESCR COM_AXIS TEG_DYN_HYS _CNV_A_R_LINEAR_____211_CM 16 0. 2047. FORMAT "%7.2" AXIS_PTS_REF ldp_teg_dyn_hys /end AXIS_DESCR
/end CHARACTERISTIC
/begin MEASUREMENT TEG_DYN_HYS "Temperature of exhaust gas with hysterisis for IGA_MIN limitation" UWORD _CNV_A_R_LINEAR_____211_CM 1 100. 0. 2047. ECU_ADDRESS 0x3fe378 FORMAT "%7.2" /end MEASUREMENT
/begin MEASUREMENT TEG_CAT_UP_MDL_MAX "Maximal temperature of exhaust gas between all cylinder bank" UWORD _CNV_A_R_LINEAR_____211_CM 1 100. 0. 2047. ECU_ADDRESS 0x3fce54 FORMAT "%7.2" /end MEASUREMENT
/begin AXIS_PTS ldp_teg_dyn_hys "" 0x44ac4 TEG_DYN_HYS _REC_AXS_20_u2 2047. _CNV_A_R_LINEAR_____211_CM 16 0. 2047. FORMAT "%7.2" /end AXIS_PTS
/begin CHARACTERISTIC ID_PAT_IND__NR_PAT "Cylinder shut-off patterns" CURVE 0x45c1e _REC_CUR_20_u2_u1 65535. _CNV_A_R_LINEAR_____10_CM 0. 65535. FORMAT "%5.0"
 /begin AXIS_DESCR COM_AXIS ONLINE_DUMMY _CNV_A_R_LINEAR_____10_CM 7 0. 255. FORMAT "%3.0" AXIS_PTS_REF ldp_nr_pat__pat_ind /end AXIS_DESCR
/end CHARACTERISTIC
/begin MEASUREMENT LV_SCC "Logical value for single cylinder cut off" UBYTE _CNV_S_2_RANGE______28_CM 1 100. 0. 1. ECU_ADDRESS 0x3fcf51 /end MEASUREMENT
/begin MEASUREMENT INH_CYC_IV "Shut off request for cylinder x (individual)" UBYTE _CNV_A_R_LINEAR_____10_CM 1 100. 0. 255. ECU_ADDRESS 0x3fcf4e FORMAT "%3.0" /end MEASUREMENT
/begin MEASUREMENT INH_IV_IGK "Shut off sequence of IGK (off) " UBYTE _CNV_A_R_LINEAR_____10_CM 1 100. 0. 255. ECU_ADDRESS 0x3fe4d8 FORMAT "%3.0" /end MEASUREMENT
/begin MEASUREMENT INH_SWI_IV "Shut off sequence of coordinated pattern " UWORD _CNV_A_R_LINEAR_____10_CM 1 100. 0. 65535. ECU_ADDRESS 0x3fcf4c FORMAT "%5.0" /end MEASUREMENT
/begin MEASUREMENT LV_INJ_CUT "All cylinders are shut off" UBYTE _CNV_S_2_RANGE______28_CM 1 100. 0. 1. ECU_ADDRESS 0x3fcf50 BIT_MASK 0x1 /end MEASUREMENT
/begin MEASUREMENT LV_IND_FCUT "At least 1 Cyl. is shut off" UBYTE _CNV_S_2_RANGE______11_CM 1 100. 0. 1. ECU_ADDRESS 0x3fcf4f BIT_MASK 0x1 /end MEASUREMENT
/begin MEASUREMENT INH_IV_FCUT "Shut off sequence of pull fuel cut off " UBYTE _CNV_A_R_LINEAR_____10_CM 1 100. 0. 255. ECU_ADDRESS 0x3fe4d9 FORMAT "%3.0" /end MEASUREMENT
/begin AXIS_PTS ldp_nr_pat__pat_ind "" 0x43793 NUMMER_DES_ABSCHALTPATTERNS _REC_AXS_20_u1 255. _CNV_A_R_LINEAR_____10_CM 7 0. 255. FORMAT "%3.0" /end AXIS_PTS
/begin MEASUREMENT INH_IV "" UWORD _CNV_A_R_LINEAR_____10_CM 1 100. 0. 65535. ECU_ADDRESS 0x3fcf4a FORMAT "%5.0" /end MEASUREMENT
/begin MEASUREMENT INH_IV_MON_CUT_OFF "Shut off sequence of monitoring" UBYTE _CNV_A_R_LINEAR_____10_CM 1 100. 0. 255. ECU_ADDRESS 0x3fed15 FORMAT "%3.0" /end MEASUREMENT
/begin CHARACTERISTIC C_CYCNR_AD2_DEC_KNK "Cycle counter for adjustment into retard direction" VALUE 0x42cb8 _REC_VAL_20_u2 65535. _CNV_A_R_LINEAR_____254_CM 0. 65535. FORMAT "%5.0" /end CHARACTERISTIC
/begin CHARACTERISTIC IP_MAF_MIN_KNK "Air-mass Threshold Release KNK" MAP 0x4faf1 _REC_MAP_20_u1_u1_u1 1389. _CNV_A_R_LINEAR_____18_CM 0. 1389. FORMAT "%4.0"
 /begin AXIS_DESCR COM_AXIS N_32 _CNV_A_R_LINEAR_____5_CM 8 0. 8160. FORMAT "%4.0" AXIS_PTS_REF ldpm_n_3_9 /end AXIS_DESCR
 /begin AXIS_DESCR COM_AXIS TCO _CNV_A_R_LINEAR_____0_CM 4 -48. 142.5 FORMAT "%3.0" AXIS_PTS_REF ldp_tco__maf_min_knk /end AXIS_DESCR
/end CHARACTERISTIC
/begin CHARACTERISTIC ID_IGA_AD1_KNK_SIZE "Table for the definition of the size and the LDP division of Adaptation table circuit 1" MAP 0x4cd22 _REC_MAP_20_u1_u1_u1 48. _CNV_A_R_LINEAR_____204_CM -48. 0. FORMAT "%6.2"
 /begin AXIS_DESCR COM_AXIS N_KNK _CNV_A_R_LINEAR_____5_CM 8 0. 8160. FORMAT "%4.0" AXIS_PTS_REF ldpm_n_iga_ad /end AXIS_DESCR
 /begin AXIS_DESCR COM_AXIS MAF_KNK _CNV_A_R_LINEAR_____18_CM 6 0. 1389. FORMAT "%7.2" AXIS_PTS_REF ldpm_maf_iga_ad /end AXIS_DESCR
/end CHARACTERISTIC
/begin CHARACTERISTIC ID_IGA_DEC_KNK_1 "Spark retard at recognised knocking, Intensity 1" CURVE 0x4cd52 _REC_CUR_20_u1_u1 47.25 _CNV_A_R_LINEAR_____122_CM 0.375 47.625 FORMAT "%4.1"
 /begin AXIS_DESCR COM_AXIS N_KNK _CNV_A_R_LINEAR_____5_CM 3 0. 8160. FORMAT "%4.0" AXIS_PTS_REF ldpm_n_4_9 /end AXIS_DESCR
/end CHARACTERISTIC
/begin CHARACTERISTIC ID_IGA_DEC_KNK_2 "Spark retard at recognised knocking, Intensity 2" CURVE 0x4cd55 _REC_CUR_20_u1_u1 47.25 _CNV_A_R_LINEAR_____122_CM 0.375 47.625 FORMAT "%4.1"
 /begin AXIS_DESCR COM_AXIS N_KNK _CNV_A_R_LINEAR_____5_CM 3 0. 8160. FORMAT "%4.0" AXIS_PTS_REF ldpm_n_4_9 /end AXIS_DESCR
/end CHARACTERISTIC
/begin CHARACTERISTIC ID_MAF_MIN_AD_KNK__N "Air-mass Threshold for Knock Adaptation" CURVE 0x4cd88 _REC_CUR_20_u1_u1 1389. _CNV_A_R_LINEAR_____18_CM 0. 1389. FORMAT "%4.0"
 /begin AXIS_DESCR COM_AXIS N_KNK _CNV_A_R_LINEAR_____5_CM 8 0. 8160. FORMAT "%4.0" AXIS_PTS_REF ldpm_n_iga_ad /end AXIS_DESCR
/end CHARACTERISTIC
/begin CHARACTERISTIC ID_N_GRD_MAX_KNK__N "Speed Gradient for dynamic identification" CURVE 0x4cdc8 _REC_CUR_20_u1_u1 4064. _CNV_A_R_LINEAR_____215_CM 0. 4064. FORMAT "%4.0"
 /begin AXIS_DESCR COM_AXIS N_KNK _CNV_A_R_LINEAR_____5_CM 8 0. 8160. FORMAT "%4.0" AXIS_PTS_REF ldpm_n_iga_ad /end AXIS_DESCR
/end CHARACTERISTIC
/begin CHARACTERISTIC IP_IGA_INC_KNK "Re-set Increment KNK" CURVE 0x481b6 _REC_CUR_20_u2_u1 47.99707032000001 _CNV_A_R_LINEAR_____255_CM 1.46484e-003 47.99853516 FORMAT "%8.5"
 /begin AXIS_DESCR COM_AXIS N_KNK _CNV_A_R_LINEAR_____5_CM 4 0. 8160. FORMAT "%4.0" AXIS_PTS_REF ldpm_n_fil_frq_knk /end AXIS_DESCR
/end CHARACTERISTIC
/begin MEASUREMENT IGA_AD1_KNK_0 "Actual Adaptation value for Cyl. x (Adaptation circuit 1)" UBYTE _CNV_A_R_LINEAR_____204_CM 1 100. -48. 0. ECU_ADDRESS 0x3fe38a FORMAT "%5.1" /end MEASUREMENT
/begin MEASUREMENT IGA_AD1_KNK_1 "Actual Adaptation value for Cyl. x (Adaptation circuit 1)" UBYTE _CNV_A_R_LINEAR_____204_CM 1 100. -48. 0. ECU_ADDRESS 0x3fe38c FORMAT "%5.1" /end MEASUREMENT
/begin MEASUREMENT IGA_AD1_KNK_2 "Actual Adaptation value for Cyl. x (Adaptation circuit 1)" UBYTE _CNV_A_R_LINEAR_____204_CM 1 100. -48. 0. ECU_ADDRESS 0x3fe38e FORMAT "%5.1" /end MEASUREMENT
/begin MEASUREMENT IGA_AD1_KNK_3 "Actual Adaptation value for Cyl. x (Adaptation circuit 1)" UBYTE _CNV_A_R_LINEAR_____204_CM 1 100. -48. 0. ECU_ADDRESS 0x3fe390 FORMAT "%5.1" /end MEASUREMENT
/begin MEASUREMENT IGA_AD1_KNK_4 "Actual Adaptation value for Cyl. x (Adaptation circuit 1)" UBYTE _CNV_A_R_LINEAR_____204_CM 1 100. -48. 0. ECU_ADDRESS 0x3fe392 FORMAT "%5.1" /end MEASUREMENT
/begin MEASUREMENT IGA_AD1_KNK_5 "Actual Adaptation value for Cyl. x (Adaptation circuit 1)" UBYTE _CNV_A_R_LINEAR_____204_CM 1 100. -48. 0. ECU_ADDRESS 0x3fe394 FORMAT "%5.1" /end MEASUREMENT
/begin MEASUREMENT IGA_AD2_KNK "Adaptation spark retard due to Adaptation circuit 2" UBYTE _CNV_A_R_LINEAR_____204_CM 1 100. -48. 0. ECU_ADDRESS 0x3fcea6 FORMAT "%4.1" /end MEASUREMENT
/begin MEASUREMENT IGA_KNK_0 "Spark retard through knock control without Adaptation(cylinder individual)" UBYTE _CNV_A_R_LINEAR_____204_CM 1 100. -48. 0. ECU_ADDRESS 0x3fceb0 FORMAT "%7.3" /end MEASUREMENT
/begin MEASUREMENT IGA_KNK_1 "Spark retard through knock control without Adaptation(cylinder individual)" UBYTE _CNV_A_R_LINEAR_____204_CM 1 100. -48. 0. ECU_ADDRESS 0x3fceb2 FORMAT "%7.3" /end MEASUREMENT
/begin MEASUREMENT IGA_KNK_2 "Spark retard through knock control without Adaptation(cylinder individual)" UBYTE _CNV_A_R_LINEAR_____204_CM 1 100. -48. 0. ECU_ADDRESS 0x3fceb4 FORMAT "%7.3" /end MEASUREMENT
/begin MEASUREMENT IGA_KNK_3 "Spark retard through knock control without Adaptation(cylinder individual)" UBYTE _CNV_A_R_LINEAR_____204_CM 1 100. -48. 0. ECU_ADDRESS 0x3fceb6 FORMAT "%7.3" /end MEASUREMENT
/begin MEASUREMENT IGA_KNK_4 "Spark retard through knock control without Adaptation(cylinder individual)" UBYTE _CNV_A_R_LINEAR_____204_CM 1 100. -48. 0. ECU_ADDRESS 0x3fceb8 FORMAT "%7.3" /end MEASUREMENT
/begin MEASUREMENT IGA_KNK_5 "Spark retard through knock control without Adaptation(cylinder individual)" UBYTE _CNV_A_R_LINEAR_____204_CM 1 100. -48. 0. ECU_ADDRESS 0x3fceba FORMAT "%7.3" /end MEASUREMENT
/begin MEASUREMENT KNK_THD_0 "Knock Threshold cylinder x" UBYTE _CNV_A_R_LINEAR_____38_CM 1 100. 0. 4.998 ECU_ADDRESS 0x3fcea8 FORMAT "%6.4" /end MEASUREMENT
/begin MEASUREMENT KNK_THD_1 "Knock Threshold cylinder x" UBYTE _CNV_A_R_LINEAR_____38_CM 1 100. 0. 4.998 ECU_ADDRESS 0x3fcea9 FORMAT "%6.4" /end MEASUREMENT
/begin MEASUREMENT KNK_THD_2 "Knock Threshold cylinder x" UBYTE _CNV_A_R_LINEAR_____38_CM 1 100. 0. 4.998 ECU_ADDRESS 0x3fceaa FORMAT "%6.4" /end MEASUREMENT
/begin MEASUREMENT KNK_THD_3 "Knock Threshold cylinder x" UBYTE _CNV_A_R_LINEAR_____38_CM 1 100. 0. 4.998 ECU_ADDRESS 0x3fceab FORMAT "%6.4" /end MEASUREMENT
/begin MEASUREMENT KNK_THD_4 "Knock Threshold cylinder x" UBYTE _CNV_A_R_LINEAR_____38_CM 1 100. 0. 4.998 ECU_ADDRESS 0x3fceac FORMAT "%6.4" /end MEASUREMENT
/begin MEASUREMENT KNK_THD_5 "Knock Threshold cylinder x" UBYTE _CNV_A_R_LINEAR_____38_CM 1 100. 0. 4.998 ECU_ADDRESS 0x3fcead FORMAT "%6.4" /end MEASUREMENT
/begin MEASUREMENT KNKS_CMD_FIL_0 "Knock Filter Frequency and Reference Filter Frequency Cyl.x" UBYTE _CNV_A_R_LINEAR_____10_CM 1 100. 0. 63. ECU_ADDRESS 0x3fce8e FORMAT "%2.0" /end MEASUREMENT
/begin MEASUREMENT KNKS_CMD_FIL_1 "Knock Filter Frequency and Reference Filter Frequency Cyl.x" UBYTE _CNV_A_R_LINEAR_____10_CM 1 100. 0. 63. ECU_ADDRESS 0x3fce8f FORMAT "%2.0" /end MEASUREMENT
/begin MEASUREMENT KNKS_CMD_FIL_2 "Knock Filter Frequency and Reference Filter Frequency Cyl.x" UBYTE _CNV_A_R_LINEAR_____10_CM 1 100. 0. 63. ECU_ADDRESS 0x3fce90 FORMAT "%2.0" /end MEASUREMENT
/begin MEASUREMENT KNKS_CMD_FIL_3 "Knock Filter Frequency and Reference Filter Frequency Cyl.x" UBYTE _CNV_A_R_LINEAR_____10_CM 1 100. 0. 63. ECU_ADDRESS 0x3fce91 FORMAT "%2.0" /end MEASUREMENT
/begin MEASUREMENT KNKS_CMD_FIL_4 "Knock Filter Frequency and Reference Filter Frequency Cyl.x" UBYTE _CNV_A_R_LINEAR_____10_CM 1 100. 0. 63. ECU_ADDRESS 0x3fce92 FORMAT "%2.0" /end MEASUREMENT
/begin MEASUREMENT KNKS_CMD_FIL_5 "Knock Filter Frequency and Reference Filter Frequency Cyl.x" UBYTE _CNV_A_R_LINEAR_____10_CM 1 100. 0. 63. ECU_ADDRESS 0x3fce93 FORMAT "%2.0" /end MEASUREMENT
/begin MEASUREMENT KNKWB_0 "Beginning of Measurement Window Cyl.x" UWORD _CNV_A_R_LINEAR_____75_CM 1 100. 0. 108. ECU_ADDRESS 0x3fce6e FORMAT "%5.1" /end MEASUREMENT
/begin MEASUREMENT KNKWB_1 "Beginning of Measurement Window Cyl.x" UWORD _CNV_A_R_LINEAR_____75_CM 1 100. 0. 108. ECU_ADDRESS 0x3fce70 FORMAT "%5.1" /end MEASUREMENT
/begin MEASUREMENT KNKWB_2 "Beginning of Measurement Window Cyl.x" UWORD _CNV_A_R_LINEAR_____75_CM 1 100. 0. 108. ECU_ADDRESS 0x3fce72 FORMAT "%5.1" /end MEASUREMENT
/begin MEASUREMENT KNKWB_3 "Beginning of Measurement Window Cyl.x" UWORD _CNV_A_R_LINEAR_____75_CM 1 100. 0. 108. ECU_ADDRESS 0x3fce74 FORMAT "%5.1" /end MEASUREMENT
/begin MEASUREMENT KNKWB_4 "Beginning of Measurement Window Cyl.x" UWORD _CNV_A_R_LINEAR_____75_CM 1 100. 0. 108. ECU_ADDRESS 0x3fce76 FORMAT "%5.1" /end MEASUREMENT
/begin MEASUREMENT KNKWB_5 "Beginning of Measurement Window Cyl.x" UWORD _CNV_A_R_LINEAR_____75_CM 1 100. 0. 108. ECU_ADDRESS 0x3fce78 FORMAT "%5.1" /end MEASUREMENT
/begin MEASUREMENT KNKWE_0 "End of Measurement Window Cyl.x" UWORD _CNV_A_R_LINEAR_____75_CM 1 100. 0.375 114. ECU_ADDRESS 0x3fce7a FORMAT "%5.1" /end MEASUREMENT
/begin MEASUREMENT KNKWE_1 "End of Measurement Window Cyl.x" UWORD _CNV_A_R_LINEAR_____75_CM 1 100. 0.375 114. ECU_ADDRESS 0x3fce7c FORMAT "%5.1" /end MEASUREMENT
/begin MEASUREMENT KNKWE_2 "End of Measurement Window Cyl.x" UWORD _CNV_A_R_LINEAR_____75_CM 1 100. 0.375 114. ECU_ADDRESS 0x3fce7e FORMAT "%5.1" /end MEASUREMENT
/begin MEASUREMENT KNKWE_3 "End of Measurement Window Cyl.x" UWORD _CNV_A_R_LINEAR_____75_CM 1 100. 0.375 114. ECU_ADDRESS 0x3fce80 FORMAT "%5.1" /end MEASUREMENT
/begin MEASUREMENT KNKWE_4 "End of Measurement Window Cyl.x" UWORD _CNV_A_R_LINEAR_____75_CM 1 100. 0.375 114. ECU_ADDRESS 0x3fce82 FORMAT "%5.1" /end MEASUREMENT
/begin MEASUREMENT KNKWE_5 "End of Measurement Window Cyl.x" UWORD _CNV_A_R_LINEAR_____75_CM 1 100. 0.375 114. ECU_ADDRESS 0x3fce84 FORMAT "%5.1" /end MEASUREMENT
/begin MEASUREMENT LV_KNK_AD1_ENA "Knock Adaptation circuit 1 enabled" UBYTE _CNV_S_2_RANGE______11_CM 1 100. 0. 1. ECU_ADDRESS 0x3fceaf BIT_MASK 0x1 /end MEASUREMENT
/begin MEASUREMENT LV_KNK_AD2_ENA "Knock Adaptation circuit 2 enabled" UBYTE _CNV_S_2_RANGE______11_CM 1 100. 0. 1. ECU_ADDRESS 0x3fe3a9 BIT_MASK 0x1 /end MEASUREMENT
/begin MEASUREMENT LV_KNK_CTL_ENA "Boolean for knock control enabled" UBYTE _CNV_S_2_RANGE______11_CM 1 100. 0. 1. ECU_ADDRESS 0x3fceae BIT_MASK 0x1 /end MEASUREMENT
/begin MEASUREMENT LV_KNK_TRA_MAF "Logical variable for Load Dynamic Function active or passive" UBYTE _CNV_S_2_RANGE______11_CM 1 100. 0. 1. ECU_ADDRESS 0x3fe3a8 BIT_MASK 0x1 /end MEASUREMENT
/begin MEASUREMENT MAF_KNK "Mass air flow with hysteresis" UBYTE _CNV_A_R_LINEAR_____18_CM 1 100. 0. 1389. ECU_ADDRESS 0x3fce86 FORMAT "%7.2" /end MEASUREMENT
/begin MEASUREMENT N_KNK "Engine speed with hysteresis" UBYTE _CNV_A_R_LINEAR_____5_CM 1 100. 0. 8160. ECU_ADDRESS 0x3fe3a2 FORMAT "%4.0" /end MEASUREMENT
/begin MEASUREMENT NL_0 "Floating mean value of the noise signal" UWORD _CNV_A_R_LINEAR_____256_CM 1 100. 0. 4.99992371 ECU_ADDRESS 0x3fce62 FORMAT "%7.5" /end MEASUREMENT
/begin MEASUREMENT NL_1 "Floating mean value of the noise signal" UWORD _CNV_A_R_LINEAR_____256_CM 1 100. 0. 4.99992371 ECU_ADDRESS 0x3fce64 FORMAT "%7.5" /end MEASUREMENT
/begin MEASUREMENT NL_2 "Floating mean value of the noise signal" UWORD _CNV_A_R_LINEAR_____256_CM 1 100. 0. 4.99992371 ECU_ADDRESS 0x3fce66 FORMAT "%7.5" /end MEASUREMENT
/begin MEASUREMENT NL_3 "Floating mean value of the noise signal" UWORD _CNV_A_R_LINEAR_____256_CM 1 100. 0. 4.99992371 ECU_ADDRESS 0x3fce68 FORMAT "%7.5" /end MEASUREMENT
/begin MEASUREMENT NL_4 "Floating mean value of the noise signal" UWORD _CNV_A_R_LINEAR_____256_CM 1 100. 0. 4.99992371 ECU_ADDRESS 0x3fce6a FORMAT "%7.5" /end MEASUREMENT
/begin MEASUREMENT NL_5 "Floating mean value of the noise signal" UWORD _CNV_A_R_LINEAR_____256_CM 1 100. 0. 4.99992371 ECU_ADDRESS 0x3fce6c FORMAT "%7.5" /end MEASUREMENT
/begin CHARACTERISTIC C_CYCNR_AD2_INC_KNK "Cycle counter for adjustment into advance direction" VALUE 0x42cba _REC_VAL_20_u2 65535. _CNV_A_R_LINEAR_____254_CM 0. 65535. FORMAT "%5.0" /end CHARACTERISTIC
/begin CHARACTERISTIC C_FAC_TRA_KNK "correction factor for load dynamic active" VALUE 0x428bd _REC_VAL_20_u1 6.96875 _CNV_A_R_LINEAR_____240_CM 1. 7.96875 FORMAT "%5.3" /end CHARACTERISTIC
/begin CHARACTERISTIC C_IGA_AD1_FAC_DEC_KNK "Factor to control the speed of knock Adaptation circuit 1 in retard direction" VALUE 0x428d4 _REC_VAL_20_u1 0.9960940000000002 _CNV_A_R_LINEAR_____44_CM 0. 0.996094 FORMAT "%5.3" /end CHARACTERISTIC
/begin CHARACTERISTIC C_IGA_AD1_FAC_FAST_KNK "factor for fast knock Adaptation" VALUE 0x428d5 _REC_VAL_20_u1 3.984375 _CNV_A_R_LINEAR_____257_CM 0. 3.984375 FORMAT "%5.3" /end CHARACTERISTIC
/begin CHARACTERISTIC C_IGA_AD1_FAC_INC_KNK "Factor to control the speed of knock Adaptation circuit 1 in advance direction" VALUE 0x428d6 _REC_VAL_20_u1 0.9960940000000002 _CNV_A_R_LINEAR_____44_CM 0. 0.996094 FORMAT "%5.3" /end CHARACTERISTIC
/begin CHARACTERISTIC C_IGA_AD1_INC_KNK "Increment of adapted retardation values during post operating phase" VALUE 0x428d7 _REC_VAL_20_u1 48. _CNV_A_R_LINEAR_____75_CM 0. 48. FORMAT "%4.1" /end CHARACTERISTIC
/begin CHARACTERISTIC C_IGA_AD1_LGRD_NEG_KNK "Change limitation in retard direction for Adaptation circuit 1 while crossing from one operating point to another" VALUE 0x428d8 _REC_VAL_20_u1 11.90625 _CNV_A_R_LINEAR_____258_CM 9.375e-002 12. /end CHARACTERISTIC
/begin CHARACTERISTIC C_IGA_AD1_LGRD_POS_KNK "Change limitation in advance direction for Adaptation circuit 1 while crossing from one operating point to another" VALUE 0x428d9 _REC_VAL_20_u1 11.90625 _CNV_A_R_LINEAR_____258_CM 9.375e-002 12. /end CHARACTERISTIC
/begin CHARACTERISTIC C_IGA_AD1_THD_DEC_KNK "" VALUE 0x43345 _REC_VAL_20_s1 24. _CNV_A_R_LINEAR_____75_CM -12. 12. FORMAT "%3.1" /end CHARACTERISTIC
/begin CHARACTERISTIC C_IGA_AD1_THD_FAST_KNK "" VALUE 0x428da _REC_VAL_20_u1 23.625 _CNV_A_R_LINEAR_____75_CM 0.375 24. FORMAT "%3.1" /end CHARACTERISTIC
/begin CHARACTERISTIC C_IGA_AD2_MAX_KNK "maximum threshold of IGA_AD2_KNK in retard direction" VALUE 0x428dc _REC_VAL_20_u1 48. _CNV_A_R_LINEAR_____204_CM -48. 0. FORMAT "%4.1" /end CHARACTERISTIC
/begin CHARACTERISTIC C_IGA_AD2_THD_DEC_KNK "Threshold for adjustment of adaptive ignition angle into retard direction" VALUE 0x428dd _REC_VAL_20_u1 48. _CNV_A_R_LINEAR_____204_CM -48. 0. FORMAT "%4.1" /end CHARACTERISTIC
/begin CHARACTERISTIC C_IGA_AD2_THD_INC_KNK "Threshold for adjustment of adaptive ignition angle into advance direction" VALUE 0x428de _REC_VAL_20_u1 48. _CNV_A_R_LINEAR_____204_CM -48. 0. FORMAT "%4.1" /end CHARACTERISTIC
/begin CHARACTERISTIC C_IGA_DIF_MIN_MAX_KNK "Control excursion limit valid for spark advance and spark retard " VALUE 0x428e4 _REC_VAL_20_u1 48. _CNV_A_R_LINEAR_____75_CM 0. 48. FORMAT "%4.1" /end CHARACTERISTIC
/begin CHARACTERISTIC C_IGA_LGRD_3 "gradient limitation when  underspending knock load threshold" VALUE 0x42d9a _REC_VAL_20_u2 47.625 _CNV_A_R_LINEAR_____259_CM 0.375 48. /end CHARACTERISTIC
/begin CHARACTERISTIC C_MAF_IGA_HYS_KNK "Air-Mass Hysteresis for Knock Control" VALUE 0x42900 _REC_VAL_20_u1 1389. _CNV_A_R_LINEAR_____18_CM 0. 1389. FORMAT "%4.0" /end CHARACTERISTIC
/begin CHARACTERISTIC C_N_IGA_HYS_KNK "Speed Hysteresis for Knock Control" VALUE 0x42945 _REC_VAL_20_u1 8160. _CNV_A_R_LINEAR_____5_CM 0. 8160. FORMAT "%4.0" /end CHARACTERISTIC
/begin CHARACTERISTIC C_NL_CRLC "Averaging Constant for Noise Value Calculation" VALUE 0x42970 _REC_VAL_20_u1 0.9960940000000002 _CNV_A_R_LINEAR_____44_CM 0. 0.996094 FORMAT "%5.3" /end CHARACTERISTIC
/begin CHARACTERISTIC C_NL_CRLC_TRA "Averaging Constant for Noise Value Calculation for Transient Case" VALUE 0x42971 _REC_VAL_20_u1 0.9960940000000002 _CNV_A_R_LINEAR_____44_CM 0. 0.996094 FORMAT "%5.3" /end CHARACTERISTIC
/begin CHARACTERISTIC C_SWI_AD_KNK "calculation of Adaptation circuit 1 and 2 enabled" VALUE 0x429b5 _REC_VAL_20_u1 1. _CNV_A_R_LINEAR_____10_CM 0. 1. FORMAT "%2.0" /end CHARACTERISTIC
/begin MEASUREMENT LV_KNK_TRA_N "Logical variable for Engine Speed Dynamic Function active or passive" UBYTE _CNV_S_2_RANGE______11_CM 1 100. 0. 1. ECU_ADDRESS 0x3fe3a7 BIT_MASK 0x1 /end MEASUREMENT
/begin MEASUREMENT IGA_ADJ_KNK_0_ "Total spark retard through knock control with Adaptation (cylinder individual)" UBYTE _CNV_A_R_LINEAR_____204_CM 1 100. -48. 0. ECU_ADDRESS 0x3fcea0 FORMAT "%5.1" /end MEASUREMENT
/begin MEASUREMENT IGA_ADJ_KNK_1_ "Total spark retard through knock control with Adaptation (cylinder individual)" UBYTE _CNV_A_R_LINEAR_____204_CM 1 100. -48. 0. ECU_ADDRESS 0x3fcea1 FORMAT "%5.1" /end MEASUREMENT
/begin MEASUREMENT IGA_ADJ_KNK_2_ "Total spark retard through knock control with Adaptation (cylinder individual)" UBYTE _CNV_A_R_LINEAR_____204_CM 1 100. -48. 0. ECU_ADDRESS 0x3fcea2 FORMAT "%5.1" /end MEASUREMENT
/begin MEASUREMENT IGA_ADJ_KNK_3_ "Total spark retard through knock control with Adaptation (cylinder individual)" UBYTE _CNV_A_R_LINEAR_____204_CM 1 100. -48. 0. ECU_ADDRESS 0x3fcea3 FORMAT "%5.1" /end MEASUREMENT
/begin MEASUREMENT IGA_ADJ_KNK_4_ "Total spark retard through knock control with Adaptation (cylinder individual)" UBYTE _CNV_A_R_LINEAR_____204_CM 1 100. -48. 0. ECU_ADDRESS 0x3fcea4 FORMAT "%5.1" /end MEASUREMENT
/begin MEASUREMENT IGA_ADJ_KNK_5_ "Total spark retard through knock control with Adaptation (cylinder individual)" UBYTE _CNV_A_R_LINEAR_____204_CM 1 100. -48. 0. ECU_ADDRESS 0x3fcea5 FORMAT "%5.1" /end MEASUREMENT
/begin MEASUREMENT IGA_ADJ_MAX_KNK "Total spark retard through knock control with Adaptation (cylinder individual)" UBYTE _CNV_A_R_LINEAR_____202_CM 1 100. -35.625 60. ECU_ADDRESS 0x3fe3a3 FORMAT "%5.1" /end MEASUREMENT
/begin MEASUREMENT DLY_IGA_ADJ_KNK_DIAG "inhibition time for knock Adaptation" UBYTE _CNV_A_R_LINEAR_____14_CM 1 100. 0. 25.5 ECU_ADDRESS 0x3fe3a5 FORMAT "%4.1" /end MEASUREMENT
/begin MEASUREMENT IGA_MV_ADJ_KNK "meanvalue of actual retard adjustment with Adaptation values" UBYTE _CNV_A_R_LINEAR_____204_CM 1 100. -48. 0. ECU_ADDRESS 0x3fcea7 FORMAT "%4.1" /end MEASUREMENT
/begin MEASUREMENT CYL_ID_KNK "cylinder number for knock control" UBYTE _CNV_A_R_LINEAR_____10_CM 1 100. 0. 255. ECU_ADDRESS 0x3fce87 FORMAT "%3.0" /end MEASUREMENT
/begin MEASUREMENT LV_KNK "Logical variable for recognition of knock" UBYTE _CNV_S_2_RANGE______11_CM 1 100. 0. 1. ECU_ADDRESS 0x3fcebc BIT_MASK 0x1 /end MEASUREMENT
/begin MEASUREMENT IGA_MV_KNK "meanvalue of actual retard adjustment without Adaptation values" UBYTE _CNV_A_R_LINEAR_____204_CM 1 100. -48. 0. ECU_ADDRESS 0x3fe3a6 FORMAT "%4.1" /end MEASUREMENT
/begin MEASUREMENT FAC_IGA_MAX_KNK "Weighting factor for the max. spark retard against coolant" UBYTE _CNV_A_R_LINEAR_____44_CM 1 100. 0. 0.996094 ECU_ADDRESS 0x3fe3a4 FORMAT "%5.3" /end MEASUREMENT
/begin MEASUREMENT KNKS_CMD_GAIN_0 "Amplification precontrol Cyl.x" UBYTE _CNV_A_R_LINEAR_____10_CM 1 100. 0. 63. ECU_ADDRESS 0x3fce9a FORMAT "%2.0" /end MEASUREMENT
/begin MEASUREMENT KNKS_CMD_GAIN_1 "Amplification precontrol Cyl.x" UBYTE _CNV_A_R_LINEAR_____10_CM 1 100. 0. 63. ECU_ADDRESS 0x3fce9b FORMAT "%2.0" /end MEASUREMENT
/begin MEASUREMENT KNKS_CMD_GAIN_2 "Amplification precontrol Cyl.x" UBYTE _CNV_A_R_LINEAR_____10_CM 1 100. 0. 63. ECU_ADDRESS 0x3fce9c FORMAT "%2.0" /end MEASUREMENT
/begin MEASUREMENT KNKS_CMD_GAIN_3 "Amplification precontrol Cyl.x" UBYTE _CNV_A_R_LINEAR_____10_CM 1 100. 0. 63. ECU_ADDRESS 0x3fce9d FORMAT "%2.0" /end MEASUREMENT
/begin MEASUREMENT KNKS_CMD_GAIN_4 "Amplification precontrol Cyl.x" UBYTE _CNV_A_R_LINEAR_____10_CM 1 100. 0. 63. ECU_ADDRESS 0x3fce9e FORMAT "%2.0" /end MEASUREMENT
/begin MEASUREMENT KNKS_CMD_GAIN_5 "Amplification precontrol Cyl.x" UBYTE _CNV_A_R_LINEAR_____10_CM 1 100. 0. 63. ECU_ADDRESS 0x3fce9f FORMAT "%2.0" /end MEASUREMENT
/begin MEASUREMENT KNKS_CMD_INT_0 "Integration time constant Cyl.x" UBYTE _CNV_A_R_LINEAR_____10_CM 1 100. 0. 31. ECU_ADDRESS 0x3fce94 FORMAT "%2.0" /end MEASUREMENT
/begin MEASUREMENT KNKS_CMD_INT_1 "Integration time constant Cyl.x" UBYTE _CNV_A_R_LINEAR_____10_CM 1 100. 0. 31. ECU_ADDRESS 0x3fce95 FORMAT "%2.0" /end MEASUREMENT
/begin MEASUREMENT KNKS_CMD_INT_2 "Integration time constant Cyl.x" UBYTE _CNV_A_R_LINEAR_____10_CM 1 100. 0. 31. ECU_ADDRESS 0x3fce96 FORMAT "%2.0" /end MEASUREMENT
/begin MEASUREMENT KNKS_CMD_INT_3 "Integration time constant Cyl.x" UBYTE _CNV_A_R_LINEAR_____10_CM 1 100. 0. 31. ECU_ADDRESS 0x3fce97 FORMAT "%2.0" /end MEASUREMENT
/begin MEASUREMENT KNKS_CMD_INT_4 "Integration time constant Cyl.x" UBYTE _CNV_A_R_LINEAR_____10_CM 1 100. 0. 31. ECU_ADDRESS 0x3fce98 FORMAT "%2.0" /end MEASUREMENT
/begin MEASUREMENT KNKS_CMD_INT_5 "Integration time constant Cyl.x" UBYTE _CNV_A_R_LINEAR_____10_CM 1 100. 0. 31. ECU_ADDRESS 0x3fce99 FORMAT "%2.0" /end MEASUREMENT
/begin CHARACTERISTIC IP_FAC_AD_KNK_TCO__TCO "Weighting factor Adaptation circuit 1 an 2 via coolant temperature" CURVE 0x4dd69 _REC_CUR_20_u1_u1 0.9960940000000002 _CNV_A_R_LINEAR_____44_CM 0. 0.996094 FORMAT "%5.3"
 /begin AXIS_DESCR COM_AXIS TCO _CNV_A_R_LINEAR_____0_CM 2 -48. 142.5 FORMAT "%6.2" AXIS_PTS_REF ldp_tco__fac_ad_knk_tco /end AXIS_DESCR
/end CHARACTERISTIC
/begin MEASUREMENT IGA_AD1_AD2_KNK_0_ "Adaptation value for Cyl. x (Adaptation circuit 1 and 2)" UBYTE _CNV_A_R_LINEAR_____204_CM 1 100. -48. 0. ECU_ADDRESS 0x3fe396 FORMAT "%5.1" /end MEASUREMENT
/begin MEASUREMENT IGA_AD1_AD2_KNK_1_ "Adaptation value for Cyl. x (Adaptation circuit 1 and 2)" UBYTE _CNV_A_R_LINEAR_____204_CM 1 100. -48. 0. ECU_ADDRESS 0x3fe398 FORMAT "%5.1" /end MEASUREMENT
/begin MEASUREMENT IGA_AD1_AD2_KNK_2_ "Adaptation value for Cyl. x (Adaptation circuit 1 and 2)" UBYTE _CNV_A_R_LINEAR_____204_CM 1 100. -48. 0. ECU_ADDRESS 0x3fe39a FORMAT "%5.1" /end MEASUREMENT
/begin MEASUREMENT IGA_AD1_AD2_KNK_3_ "Adaptation value for Cyl. x (Adaptation circuit 1 and 2)" UBYTE _CNV_A_R_LINEAR_____204_CM 1 100. -48. 0. ECU_ADDRESS 0x3fe39c FORMAT "%5.1" /end MEASUREMENT
/begin MEASUREMENT IGA_AD1_AD2_KNK_4_ "Adaptation value for Cyl. x (Adaptation circuit 1 and 2)" UBYTE _CNV_A_R_LINEAR_____204_CM 1 100. -48. 0. ECU_ADDRESS 0x3fe39e FORMAT "%5.1" /end MEASUREMENT
/begin MEASUREMENT IGA_AD1_AD2_KNK_5_ "Adaptation value for Cyl. x (Adaptation circuit 1 and 2)" UBYTE _CNV_A_R_LINEAR_____204_CM 1 100. -48. 0. ECU_ADDRESS 0x3fe3a0 FORMAT "%5.1" /end MEASUREMENT
/begin CHARACTERISTIC ID_CYCNR_FAC_TRA_KNK "Cycle counter during which the Load Dynamic Function stays active after triggering" CURVE 0x4cc59 _REC_CUR_20_u1_u1 255. _CNV_A_R_LINEAR_____10_CM 0. 255. FORMAT "%3.0"
 /begin AXIS_DESCR COM_AXIS N_KNK _CNV_A_R_LINEAR_____5_CM 4 0. 8160. FORMAT "%4.0" AXIS_PTS_REF ldpm_n_6_4 /end AXIS_DESCR
/end CHARACTERISTIC
/begin CHARACTERISTIC IP_KNKWB_1__N__MAF "Beginning of Measurement Window Cyl.2" MAP 0x48246 _REC_MAP_20_u2_u1_u1 108. _CNV_A_R_LINEAR_____75_CM 0. 108. FORMAT "%5.1"
 /begin AXIS_DESCR COM_AXIS N_KNK _CNV_A_R_LINEAR_____5_CM 10 0. 8160. FORMAT "%4.0" AXIS_PTS_REF ldpm_n_knkwb /end AXIS_DESCR
 /begin AXIS_DESCR COM_AXIS MAF_KNK _CNV_A_R_LINEAR_____18_CM 4 0. 1389. FORMAT "%4.0" AXIS_PTS_REF ldpm_maf_knkwb /end AXIS_DESCR
/end CHARACTERISTIC
/begin CHARACTERISTIC IP_GAIN_KNK_1__N__MAF "Amplification precontrol Cyl.2" MAP 0x4e831 _REC_MAP_20_u1_u1_u1 63. _CNV_A_R_LINEAR_____10_CM 0. 63. FORMAT "%2.0"
 /begin AXIS_DESCR COM_AXIS N_KNK _CNV_A_R_LINEAR_____5_CM 16 0. 8160. FORMAT "%4.0" AXIS_PTS_REF ldpm_n_2_9 /end AXIS_DESCR
 /begin AXIS_DESCR COM_AXIS MAF_KNK _CNV_A_R_LINEAR_____18_CM 4 0. 1389. FORMAT "%4.0" AXIS_PTS_REF ldpm_maf_1_9 /end AXIS_DESCR
/end CHARACTERISTIC
/begin CHARACTERISTIC IP_FAC_THD_KNK_0__N__MAF "Knock Factor Table Cyl. 1" MAP 0x4e541 _REC_MAP_20_u1_u1_u1 7.96875 _CNV_A_R_LINEAR_____240_CM 0. 7.96875 FORMAT "%4.2"
 /begin AXIS_DESCR COM_AXIS N_KNK _CNV_A_R_LINEAR_____5_CM 16 0. 8160. FORMAT "%4.0" AXIS_PTS_REF ldpm_n_2_9 /end AXIS_DESCR
 /begin AXIS_DESCR COM_AXIS MAF_KNK _CNV_A_R_LINEAR_____18_CM 4 0. 1389. FORMAT "%4.0" AXIS_PTS_REF ldpm_maf_1_9 /end AXIS_DESCR
/end CHARACTERISTIC
/begin CHARACTERISTIC IP_FAC_THD_KNK_1__N__MAF "Knock Factor Table Cyl. 2" MAP 0x4e581 _REC_MAP_20_u1_u1_u1 7.96875 _CNV_A_R_LINEAR_____240_CM 0. 7.96875 FORMAT "%4.2"
 /begin AXIS_DESCR COM_AXIS N_KNK _CNV_A_R_LINEAR_____5_CM 16 0. 8160. FORMAT "%4.0" AXIS_PTS_REF ldpm_n_2_9 /end AXIS_DESCR
 /begin AXIS_DESCR COM_AXIS MAF_KNK _CNV_A_R_LINEAR_____18_CM 4 0. 1389. FORMAT "%4.0" AXIS_PTS_REF ldpm_maf_1_9 /end AXIS_DESCR
/end CHARACTERISTIC
/begin CHARACTERISTIC IP_FAC_THD_KNK_2__N__MAF "Knock Factor Table Cyl. 3" MAP 0x4e5c1 _REC_MAP_20_u1_u1_u1 7.96875 _CNV_A_R_LINEAR_____240_CM 0. 7.96875 FORMAT "%4.2"
 /begin AXIS_DESCR COM_AXIS N_KNK _CNV_A_R_LINEAR_____5_CM 16 0. 8160. FORMAT "%4.0" AXIS_PTS_REF ldpm_n_2_9 /end AXIS_DESCR
 /begin AXIS_DESCR COM_AXIS MAF_KNK _CNV_A_R_LINEAR_____18_CM 4 0. 1389. FORMAT "%4.0" AXIS_PTS_REF ldpm_maf_1_9 /end AXIS_DESCR
/end CHARACTERISTIC
/begin CHARACTERISTIC IP_FAC_THD_KNK_3__N__MAF "Knock Factor Table Cyl. 4" MAP 0x4e601 _REC_MAP_20_u1_u1_u1 7.96875 _CNV_A_R_LINEAR_____240_CM 0. 7.96875 FORMAT "%4.2"
 /begin AXIS_DESCR COM_AXIS N_KNK _CNV_A_R_LINEAR_____5_CM 16 0. 8160. FORMAT "%4.0" AXIS_PTS_REF ldpm_n_2_9 /end AXIS_DESCR
 /begin AXIS_DESCR COM_AXIS MAF_KNK _CNV_A_R_LINEAR_____18_CM 4 0. 1389. FORMAT "%4.0" AXIS_PTS_REF ldpm_maf_1_9 /end AXIS_DESCR
/end CHARACTERISTIC
/begin CHARACTERISTIC IP_FAC_THD_KNK_4__N__MAF "Knock Factor Table Cyl. 5" MAP 0x4e641 _REC_MAP_20_u1_u1_u1 7.96875 _CNV_A_R_LINEAR_____240_CM 0. 7.96875 FORMAT "%4.2"
 /begin AXIS_DESCR COM_AXIS N_KNK _CNV_A_R_LINEAR_____5_CM 16 0. 8160. FORMAT "%4.0" AXIS_PTS_REF ldpm_n_2_9 /end AXIS_DESCR
 /begin AXIS_DESCR COM_AXIS MAF_KNK _CNV_A_R_LINEAR_____18_CM 4 0. 1389. FORMAT "%4.0" AXIS_PTS_REF ldpm_maf_1_9 /end AXIS_DESCR
/end CHARACTERISTIC
/begin CHARACTERISTIC IP_FAC_THD_KNK_5__N__MAF "Knock Factor Table Cyl. 6" MAP 0x4e681 _REC_MAP_20_u1_u1_u1 7.96875 _CNV_A_R_LINEAR_____240_CM 0. 7.96875 FORMAT "%4.2"
 /begin AXIS_DESCR COM_AXIS N_KNK _CNV_A_R_LINEAR_____5_CM 16 0. 8160. FORMAT "%4.0" AXIS_PTS_REF ldpm_n_2_9 /end AXIS_DESCR
 /begin AXIS_DESCR COM_AXIS MAF_KNK _CNV_A_R_LINEAR_____18_CM 4 0. 1389. FORMAT "%4.0" AXIS_PTS_REF ldpm_maf_1_9 /end AXIS_DESCR
/end CHARACTERISTIC
/begin CHARACTERISTIC IP_KNK_THD_ADD__N "Knock summand" CURVE 0x4f863 _REC_CUR_20_u1_u1 5.1 _CNV_A_R_LINEAR_____260_CM -2.56 2.54 FORMAT "%4.2"
 /begin AXIS_DESCR COM_AXIS N_KNK _CNV_A_R_LINEAR_____5_CM 16 0. 8160. FORMAT "%4.0" AXIS_PTS_REF ldpm_n_2_9 /end AXIS_DESCR
/end CHARACTERISTIC
/begin CHARACTERISTIC C_NL_MIN "Minimum noise value" VALUE 0x42973 _REC_VAL_20_u1 4.998 _CNV_A_R_LINEAR_____38_CM 0. 4.998 FORMAT "%5.3" /end CHARACTERISTIC
/begin CHARACTERISTIC ID_MAF_DIF_TRA_KNK__N "Throttle Position Gradient for Load Dynamik Recognition" CURVE 0x50dc8 _REC_CUR_20_s2_u1 1388.978806 _CNV_A_R_LINEAR_____261_CM -694.5 694.478806 FORMAT "%7.2"
 /begin AXIS_DESCR COM_AXIS N_KNK _CNV_A_R_LINEAR_____5_CM 4 0. 8160. FORMAT "%4.0" AXIS_PTS_REF ldpm_n_6_4 /end AXIS_DESCR
/end CHARACTERISTIC
/begin CHARACTERISTIC IP_IGA_BAS_MAX_KNK__N__MAF "Maximum value for spark retard" MAP 0x4edcf _REC_MAP_20_u1_u1_u1 95.625 _CNV_A_R_LINEAR_____202_CM -35.625 60. FORMAT "%5.1"
 /begin AXIS_DESCR COM_AXIS N_32 _CNV_A_R_LINEAR_____5_CM 8 0. 8160. FORMAT "%4.0" AXIS_PTS_REF ldpm_n_iga_max_knk /end AXIS_DESCR
 /begin AXIS_DESCR COM_AXIS MAF _CNV_A_R_LINEAR_____18_CM 8 0. 1389. FORMAT "%4.0" AXIS_PTS_REF ldpm_maf_iga_max_knk /end AXIS_DESCR
/end CHARACTERISTIC
/begin CHARACTERISTIC IP_IGA_OFS_MAX_KNK__N__MAF "Maximum value for spark retard" MAP 0x4f2fc _REC_MAP_20_u1_u1_u1 95.625 _CNV_A_R_LINEAR_____204_CM -48. 47.625 FORMAT "%5.1"
 /begin AXIS_DESCR COM_AXIS N_32 _CNV_A_R_LINEAR_____5_CM 8 0. 8160. FORMAT "%4.0" AXIS_PTS_REF ldpm_n_iga_max_knk /end AXIS_DESCR
 /begin AXIS_DESCR COM_AXIS MAF _CNV_A_R_LINEAR_____18_CM 8 0. 1389. FORMAT "%4.0" AXIS_PTS_REF ldpm_maf_iga_max_knk /end AXIS_DESCR
/end CHARACTERISTIC
/begin CHARACTERISTIC IP_FAC_IGA_MAX_KNK__TCO__TIA "Weighting factor for the max. spark retard against coolant" MAP 0x4e066 _REC_MAP_20_u1_u1_u1 0.9960940000000002 _CNV_A_R_LINEAR_____44_CM 0. 0.996094 FORMAT "%5.3"
 /begin AXIS_DESCR COM_AXIS TCO _CNV_A_R_LINEAR_____0_CM 4 -48. 142.5 FORMAT "%5.1" AXIS_PTS_REF ldp_tco__fac_iga_max_knk /end AXIS_DESCR
 /begin AXIS_DESCR COM_AXIS TIA _CNV_A_R_LINEAR_____0_CM 4 -48. 142.5 FORMAT "%5.1" AXIS_PTS_REF ldp_tia__fac_iga_max_knk /end AXIS_DESCR
/end CHARACTERISTIC
/begin CHARACTERISTIC C_IGA_AD1_THD_INC_KNK "" VALUE 0x428db _REC_VAL_20_u1 23.625 _CNV_A_R_LINEAR_____204_CM -24. -0.375 FORMAT "%3.1" /end CHARACTERISTIC
/begin CHARACTERISTIC C_TCO_AD1_MIN_KNK "minimum TCO threshold for knock adaptation circuit 1" VALUE 0x42a3e _REC_VAL_20_u1 190.5 _CNV_A_R_LINEAR_____0_CM -48. 142.5 FORMAT "%5.1" /end CHARACTERISTIC
/begin CHARACTERISTIC C_TCO_AD2_MIN_KNK "minimum TCO threshold for knock adaptation circuit 2" VALUE 0x42a40 _REC_VAL_20_u1 190.5 _CNV_A_R_LINEAR_____0_CM -48. 142.5 FORMAT "%5.1" /end CHARACTERISTIC
/begin CHARACTERISTIC C_TCO_AD1_MAX_KNK "maximum TCO threshold for knock adaptation circuit 1" VALUE 0x42a3d _REC_VAL_20_u1 190.5 _CNV_A_R_LINEAR_____0_CM -48. 142.5 FORMAT "%5.1" /end CHARACTERISTIC
/begin CHARACTERISTIC C_TCO_AD2_MAX_KNK "maximum TCO threshold for knock adaptation circuit 2" VALUE 0x42a3f _REC_VAL_20_u1 190.5 _CNV_A_R_LINEAR_____0_CM -48. 142.5 FORMAT "%5.1" /end CHARACTERISTIC
/begin AXIS_PTS ldp_tco__maf_min_knk "" 0x43897 TCO _REC_AXS_20_u1 190.5 _CNV_A_R_LINEAR_____0_CM 4 -48. 142.5 FORMAT "%3.0" /end AXIS_PTS
/begin AXIS_PTS ldpm_n_3_9 "" 0x43ea9 N_32 _REC_AXS_20_u1 8160. _CNV_A_R_LINEAR_____5_CM 8 0. 8160. FORMAT "%4.0" /end AXIS_PTS
/begin AXIS_PTS ldpm_n_4_9 "" 0x43eb2 N_KNK _REC_AXS_20_u1 8160. _CNV_A_R_LINEAR_____5_CM 3 0. 8160. FORMAT "%4.0" /end AXIS_PTS
/begin AXIS_PTS ldp_tco__fac_ad_knk_tco "" 0x4383c TCO _REC_AXS_20_u1 190.5 _CNV_A_R_LINEAR_____0_CM 2 -48. 142.5 FORMAT "%6.2" /end AXIS_PTS
/begin AXIS_PTS ldpm_n_6_4 "" 0x43eb6 N_KNK _REC_AXS_20_u1 8160. _CNV_A_R_LINEAR_____5_CM 4 0. 8160. FORMAT "%4.0" /end AXIS_PTS
/begin AXIS_PTS ldpm_n_iga_max_knk "" 0x43ed0 N_32 _REC_AXS_20_u1 8160. _CNV_A_R_LINEAR_____5_CM 8 0. 8160. FORMAT "%4.0" /end AXIS_PTS
/begin AXIS_PTS ldpm_maf_iga_max_knk "" 0x43c83 MAF _REC_AXS_20_u1 1389. _CNV_A_R_LINEAR_____18_CM 8 0. 1389. FORMAT "%4.0" /end AXIS_PTS
/begin AXIS_PTS ldp_tco__fac_iga_max_knk "" 0x43848 TCO _REC_AXS_20_u1 190.5 _CNV_A_R_LINEAR_____0_CM 4 -48. 142.5 FORMAT "%5.1" /end AXIS_PTS
/begin AXIS_PTS ldp_tia__fac_iga_max_knk "" 0x439b8 TIA _REC_AXS_20_u1 190.5 _CNV_A_R_LINEAR_____0_CM 4 -48. 142.5 FORMAT "%5.1" /end AXIS_PTS
/begin CHARACTERISTIC C_MAF_MIN_KNK_AD2 "min. mass air for Adaptation circuit 2" VALUE 0x42903 _REC_VAL_20_u1 416.7 _CNV_A_R_LINEAR_____18_CM 0. 1389. FORMAT "%4.0" /end CHARACTERISTIC
/begin MEASUREMENT KNK_CTL_DIS "knock control disabled due to malfunctions" UBYTE _CNV_S_2_RANGE______11_CM 1 100. 0. 1. ECU_ADDRESS 0x3fcebd /end MEASUREMENT
/begin MEASUREMENT LV_KNK_AD_RD_ENA "reading from Adaptation table enabled" UBYTE _CNV_S_2_RANGE______11_CM 1 100. 0. 1. ECU_ADDRESS 0x3fcec0 /end MEASUREMENT
/begin MEASUREMENT KNK_AD1_DIS "Adaptation circuit 1 disabled" UBYTE _CNV_S_2_RANGE______11_CM 1 100. 0. 1. ECU_ADDRESS 0x3fcebe /end MEASUREMENT
/begin MEASUREMENT KNK_AD2_DIS "Adaptation circuit 2 disabled" UBYTE _CNV_S_2_RANGE______11_CM 1 100. 0. 1. ECU_ADDRESS 0x3fcebf /end MEASUREMENT
/begin CHARACTERISTIC C_TCO_AD_MIN_RON "Bottom limit TCO" VALUE 0x42a43 _REC_VAL_20_u1 190.5 _CNV_A_R_LINEAR_____0_CM -48. 142.5 FORMAT "%5.1" /end CHARACTERISTIC
/begin CHARACTERISTIC C_CYCNR_AD_RTD_KNK "Number of combustion cycles for  RON adjustment" VALUE 0x42cbc _REC_VAL_20_u2 65535. _CNV_A_R_LINEAR_____262_CM 0. 65535. FORMAT "%5.0" /end CHARACTERISTIC
/begin CHARACTERISTIC C_IGA_MIN_AD "MIN limit IGA for RON adjustment" VALUE 0x428e8 _REC_VAL_20_u1 48. _CNV_A_R_LINEAR_____204_CM -48. 0. FORMAT "%5.1" /end CHARACTERISTIC
/begin CHARACTERISTIC C_IGA_MAX_AD "MAX limit IGA for RON adjustment" VALUE 0x428e7 _REC_VAL_20_u1 48. _CNV_A_R_LINEAR_____204_CM -48. 0. FORMAT "%5.1" /end CHARACTERISTIC
/begin CHARACTERISTIC C_CYCNR_FAC_RON "Adjustment value for RON incrementation  " VALUE 0x42875 _REC_VAL_20_u1 254. _CNV_A_R_LINEAR_____10_CM 1. 255. FORMAT "%3.0" /end CHARACTERISTIC
/begin CHARACTERISTIC C_TCO_FAC_RON_MIN "TCO-Threshold RON Factor  changing after initialisation cold" VALUE 0x42a57 _REC_VAL_20_u1 190.5 _CNV_A_R_LINEAR_____0_CM -48. 142.5 FORMAT "%5.1" /end CHARACTERISTIC
/begin CHARACTERISTIC C_TCO_FAC_RON_MAX "TCO-Threshold RON Factor  changing after initialisation hot" VALUE 0x42a56 _REC_VAL_20_u1 190.5 _CNV_A_R_LINEAR_____0_CM -48. 142.5 FORMAT "%5.1" /end CHARACTERISTIC
/begin CHARACTERISTIC C_FAC_RON_AD_COLD "Factor moving to ® RON_98 after ECU initialisation" VALUE 0x428b6 _REC_VAL_20_u1 1.99220002 _CNV_A_R_LINEAR_____34_CM 0. 1.99220002 FORMAT "%5.3" /end CHARACTERISTIC
/begin CHARACTERISTIC C_FAC_RON_AD_HOT "Factor moving to ® RON_91 after ECU initialisation" VALUE 0x428b7 _REC_VAL_20_u1 1.99220002 _CNV_A_R_LINEAR_____34_CM 0. 1.99220002 FORMAT "%5.3" /end CHARACTERISTIC
/begin CHARACTERISTIC ID_MAF_MIN_KNK_AD_2__N_32 "MAF-theshold for activation  RON-Adaptation" CURVE 0x4cd90 _REC_CUR_20_u1_u1 1389. _CNV_A_R_LINEAR_____18_CM 0. 1389. FORMAT "%4.0"
 /begin AXIS_DESCR COM_AXIS N_32 _CNV_A_R_LINEAR_____5_CM 16 0. 8160. FORMAT "%4.0" AXIS_PTS_REF ldp_n_32__maf_min_knk_ad_2 /end AXIS_DESCR
/end CHARACTERISTIC
/begin CHARACTERISTIC IP_FAC_RON_INC__N "RON-factor increment " CURVE 0x47864 _REC_CUR_20_u2_u1 0.99998474 _CNV_A_R_LINEAR_____31_CM 0. 0.99998474 FORMAT "%7.5"
 /begin AXIS_DESCR COM_AXIS N_32 _CNV_A_R_LINEAR_____5_CM 4 0. 8160. FORMAT "%4.0" AXIS_PTS_REF ldpm_n_32_3_iga /end AXIS_DESCR
/end CHARACTERISTIC
/begin CHARACTERISTIC IP_FAC_RON_DEC__N "RON factor decrement" CURVE 0x4785c _REC_CUR_20_u2_u1 0.99998474 _CNV_A_R_LINEAR_____31_CM 0. 0.99998474 FORMAT "%7.5"
 /begin AXIS_DESCR COM_AXIS N_32 _CNV_A_R_LINEAR_____5_CM 4 0. 8160. FORMAT "%4.0" AXIS_PTS_REF ldpm_n_32_3_iga /end AXIS_DESCR
/end CHARACTERISTIC
/begin CHARACTERISTIC IP_FAC_RON_AD_MAX__TIA__TCO "Threshold for RON Factor = 1 recognition for the whole  driving cycle" MAP 0x4e4b7 _REC_MAP_20_u1_u1_u1 0.9960940000000002 _CNV_A_R_LINEAR_____44_CM 0. 0.996094 FORMAT "%5.3"
 /begin AXIS_DESCR COM_AXIS TIA _CNV_A_R_LINEAR_____0_CM 4 -48. 142.5 FORMAT "%5.1" AXIS_PTS_REF ldp_tia__ip_fac_ron_ad_max /end AXIS_DESCR
 /begin AXIS_DESCR COM_AXIS TCO _CNV_A_R_LINEAR_____0_CM 4 -48. 142.5 FORMAT "%5.1" AXIS_PTS_REF ldp_tco__ip_fac_ron_ad_max /end AXIS_DESCR
/end CHARACTERISTIC
/begin MEASUREMENT FAC_RON_AD "Adaptive RON factor" UWORD _CNV_A_R_LINEAR_____31_CM 1 100. 0. 0.99998474 ECU_ADDRESS 0x3fcec2 FORMAT "%7.5" /end MEASUREMENT
/begin MEASUREMENT LV_FAC_RON_AD_ACT "Adaptive RON factor" UBYTE _CNV_S_2_RANGE______28_CM 1 100. 0. 1. ECU_ADDRESS 0x3fe3c8 /end MEASUREMENT
/begin AXIS_PTS ldp_n_32__maf_min_knk_ad_2 "" 0x4358c N_32 _REC_AXS_20_u1 8160. _CNV_A_R_LINEAR_____5_CM 16 0. 8160. FORMAT "%4.0" /end AXIS_PTS
/begin AXIS_PTS ldp_tia__ip_fac_ron_ad_max "" 0x439d0 TIA _REC_AXS_20_u1 190.5 _CNV_A_R_LINEAR_____0_CM 4 -48. 142.5 FORMAT "%5.1" /end AXIS_PTS
/begin AXIS_PTS ldp_tco__ip_fac_ron_ad_max "" 0x43879 TCO _REC_AXS_20_u1 190.5 _CNV_A_R_LINEAR_____0_CM 4 -48. 142.5 FORMAT "%5.1" /end AXIS_PTS
/begin AXIS_PTS ldpm_n_32_3_iga "" 0x43d53 N_32 _REC_AXS_20_u1 8160. _CNV_A_R_LINEAR_____5_CM 4 0. 8160. FORMAT "%4.0" /end AXIS_PTS
/begin MEASUREMENT IGA_TRA_KNK "Spark retard till high TPS_GRD or MAP_DRV1 applied to engnie" UBYTE _CNV_A_R_LINEAR_____204_CM 1 100. -48. 0. ECU_ADDRESS 0x3fcec4 FORMAT "%5.1" /end MEASUREMENT
/begin MEASUREMENT IGA_TRA_KNK_INTER "Spark retard till high TPS_GRD or MAP_DRV1 intermediate" UBYTE _CNV_A_R_LINEAR_____204_CM 1 100. -48. 0. ECU_ADDRESS 0x3fe3cf FORMAT "%5.1" /end MEASUREMENT
/begin MEASUREMENT LV_IGA_TRA_KNK "Flag for instationary correction avtive" UBYTE _CNV_S_2_RANGE______28_CM 1 100. 0. 1. ECU_ADDRESS 0x3fcec5 /end MEASUREMENT
/begin MEASUREMENT CTR_CYC_IGA_TRA_KNK_DLY "Cycle counter for delay period before ignition intervention" UBYTE _CNV_A_R_LINEAR_____10_CM 1 100. 0. 255. ECU_ADDRESS 0x3fe3d0 FORMAT "%3.0" /end MEASUREMENT
/begin MEASUREMENT CTR_CYC_IGA_TRA_KNK_ACT "Cycle counter during active ignition intervention" UBYTE _CNV_A_R_LINEAR_____10_CM 1 100. 0. 255. ECU_ADDRESS 0x3fe3d1 FORMAT "%3.0" /end MEASUREMENT
/begin MEASUREMENT CTR_CYC_IGA_TRA_KNK_WAIT "Cycle counter for delay time before follow up ignition intervention" UBYTE _CNV_A_R_LINEAR_____10_CM 1 100. 0. 255. ECU_ADDRESS 0x3fe3d2 FORMAT "%3.0" /end MEASUREMENT
/begin MEASUREMENT STATE_IGA_TRA_KNK "State of ignition angle intervention for knock prevention" UBYTE _CNV_S_6_STATE_IGA__263_CM 1 100. 0. 5. ECU_ADDRESS 0x3fe3d3 /end MEASUREMENT
/begin CHARACTERISTIC ID_TPS_GRD_IGA_TRA_KNK "TPS_GRD-threshold for activation of the IGA retard adjustment" CURVE 0x4d073 _REC_CUR_20_u1_u1 2987.5 _CNV_A_R_LINEAR_____264_CM 0. 2987.5 FORMAT "%6.1"
 /begin AXIS_DESCR COM_AXIS N_32 _CNV_A_R_LINEAR_____5_CM 4 0. 8160. FORMAT "%4.0" AXIS_PTS_REF ldpm_n_32_7 /end AXIS_DESCR
/end CHARACTERISTIC
/begin CHARACTERISTIC ID_MAP_DRV1_IGA_TRA_KNK "MAP_DRV1-threshold for activation of the IGA retard adjustment" CURVE 0x50dd0 _REC_CUR_20_s2_u1 165.8 _CNV_A_R_LINEAR_____265_CM -82.90000000000001 82.90000000000001 FORMAT "%7.3"
 /begin AXIS_DESCR COM_AXIS N_32 _CNV_A_R_LINEAR_____5_CM 4 0. 8160. FORMAT "%4.0" AXIS_PTS_REF ldpm_n_32_7 /end AXIS_DESCR
/end CHARACTERISTIC
/begin CHARACTERISTIC IP_IGA_TRA_KNK "Ignition adjustment angle in retard direction" MAP 0x4f694 _REC_MAP_20_u1_u1_u1 48. _CNV_A_R_LINEAR_____204_CM -48. 0. FORMAT "%5.1"
 /begin AXIS_DESCR COM_AXIS MAF _CNV_A_R_LINEAR_____18_CM 4 0. 1389. FORMAT "%4.0" AXIS_PTS_REF ldp_maf_iga__iga_tra_knk /end AXIS_DESCR
 /begin AXIS_DESCR COM_AXIS N_32 _CNV_A_R_LINEAR_____5_CM 4 0. 8160. FORMAT "%4.0" AXIS_PTS_REF ldpm_n_32_7 /end AXIS_DESCR
/end CHARACTERISTIC
/begin CHARACTERISTIC IP_FAC_IGA_TRA "TIA correction factor" MAP 0x4e16e _REC_MAP_20_u1_u1_u1 0.99610001 _CNV_A_R_LINEAR_____20_CM 0. 0.99610001 FORMAT "%5.3"
 /begin AXIS_DESCR COM_AXIS TIA _CNV_A_R_LINEAR_____0_CM 4 -48. 142.5 FORMAT "%5.1" AXIS_PTS_REF ldp_tia_fac_iga_tra /end AXIS_DESCR
 /begin AXIS_DESCR COM_AXIS FAC_RON_AD _CNV_A_R_LINEAR_____20_CM 3 0. 0.99610001 FORMAT "%5.3" AXIS_PTS_REF ldp_fac_ron_ad_fac_iga_tra /end AXIS_DESCR
/end CHARACTERISTIC
/begin CHARACTERISTIC IP_FAC_IGA_TRA_GEAR_MT "GEAR/VS correction factor" MAP 0x4e19e _REC_MAP_20_u1_u1_u1 0.99610001 _CNV_A_R_LINEAR_____20_CM 0. 0.99610001 FORMAT "%5.3"
 /begin AXIS_DESCR COM_AXIS VS _CNV_A_R_LINEAR_____13_CM 6 0. 255. FORMAT "%3.0" AXIS_PTS_REF ldp_vs_fac_iga_tra_gear_mt /end AXIS_DESCR
 /begin AXIS_DESCR COM_AXIS GEAR _CNV_A_R_LINEAR_____10_CM 6 0. 7. FORMAT "%2.0" AXIS_PTS_REF ldpm_gear_1 /end AXIS_DESCR
/end CHARACTERISTIC
/begin CHARACTERISTIC IP_FAC_IGA_TRA_GEAR_AT "GEAR/VS correction factor" MAP 0x4e17a _REC_MAP_20_u1_u1_u1 0.99610001 _CNV_A_R_LINEAR_____20_CM 0. 0.99610001 FORMAT "%5.3"
 /begin AXIS_DESCR COM_AXIS VS _CNV_A_R_LINEAR_____13_CM 6 0. 255. FORMAT "%3.0" AXIS_PTS_REF ldp_vs_fac_iga_tra_gear_at /end AXIS_DESCR
 /begin AXIS_DESCR COM_AXIS GEAR _CNV_A_R_LINEAR_____10_CM 6 0. 7. FORMAT "%2.0" AXIS_PTS_REF ldpm_gear_1 /end AXIS_DESCR
/end CHARACTERISTIC
/begin CHARACTERISTIC ID_CYC_IGA_TRA_KNK_DLY "Delay after the load dynamics has been triggered initially" CURVE 0x4cc51 _REC_CUR_20_u1_u1 255. _CNV_A_R_LINEAR_____10_CM 0. 255. FORMAT "%3.0"
 /begin AXIS_DESCR COM_AXIS N_32 _CNV_A_R_LINEAR_____5_CM 4 0. 8160. FORMAT "%4.0" AXIS_PTS_REF ldpm_n_32_7 /end AXIS_DESCR
/end CHARACTERISTIC
/begin CHARACTERISTIC IP_IGA_TRA_INC "IGA limitation gradient for controlled reset of the ignition angle adjustment IP_IGA_TRA_KNK__N__MAF" CURVE 0x481be _REC_CUR_20_u2_u1 47.99707032000001 _CNV_A_R_LINEAR_____266_CM 1.46484e-003 47.99853516
 /begin AXIS_DESCR COM_AXIS N_32 _CNV_A_R_LINEAR_____5_CM 4 0. 8160. FORMAT "%4.0" AXIS_PTS_REF ldpm_n_32_7 /end AXIS_DESCR
/end CHARACTERISTIC
/begin CHARACTERISTIC ID_CYC_IGA_TRA_KNK_ACT "Number of cycles for ignition angle adjustment active" CURVE 0x4cc4d _REC_CUR_20_u1_u1 255. _CNV_A_R_LINEAR_____10_CM 0. 255. FORMAT "%3.0"
 /begin AXIS_DESCR COM_AXIS N_32 _CNV_A_R_LINEAR_____5_CM 4 0. 8160. FORMAT "%4.0" AXIS_PTS_REF ldpm_n_32_7 /end AXIS_DESCR
/end CHARACTERISTIC
/begin CHARACTERISTIC ID_CYC_IGA_TRA_KNK_WAIT "Delay between two ignition angle interventions due to load dynamics" CURVE 0x4cc55 _REC_CUR_20_u1_u1 255. _CNV_A_R_LINEAR_____10_CM 0. 255. FORMAT "%3.0"
 /begin AXIS_DESCR COM_AXIS N_32 _CNV_A_R_LINEAR_____5_CM 4 0. 8160. FORMAT "%4.0" AXIS_PTS_REF ldpm_n_32_7 /end AXIS_DESCR
/end CHARACTERISTIC
/begin CHARACTERISTIC C_N_MIN_IGA_TRA_CS "Engine speed threshold for load dynamics IGA" VALUE 0x42eba _REC_VAL_20_u2 8160. _CNV_A_R_LINEAR_____17_CM 0. 8160. FORMAT "%4.0" /end CHARACTERISTIC
/begin AXIS_PTS ldp_maf_iga__iga_tra_knk "" 0x43487 MAF _REC_AXS_20_u1 1389. _CNV_A_R_LINEAR_____18_CM 4 0. 1389. FORMAT "%4.0" /end AXIS_PTS
/begin AXIS_PTS ldpm_n_32_7 "" 0x43d75 N_32 _REC_AXS_20_u1 8160. _CNV_A_R_LINEAR_____5_CM 4 0. 8160. FORMAT "%4.0" /end AXIS_PTS
/begin AXIS_PTS ldp_fac_ron_ad_fac_iga_tra "" 0x433a8 FAC_RON_AD _REC_AXS_20_u1 0.99610001 _CNV_A_R_LINEAR_____20_CM 3 0. 0.99610001 FORMAT "%5.3" /end AXIS_PTS
/begin AXIS_PTS ldp_tia_fac_iga_tra "" 0x439d5 TIA _REC_AXS_20_u1 190.5 _CNV_A_R_LINEAR_____0_CM 4 -48. 142.5 FORMAT "%5.1" /end AXIS_PTS
/begin AXIS_PTS ldpm_gear_1 "" 0x43bb4 GEAR _REC_AXS_20_u1 7. _CNV_A_R_LINEAR_____10_CM 6 0. 7. FORMAT "%2.0" /end AXIS_PTS
/begin AXIS_PTS ldp_vs_fac_iga_tra_gear_mt "" 0x43b48 VS _REC_AXS_20_u1 255. _CNV_A_R_LINEAR_____13_CM 6 0. 255. FORMAT "%3.0" /end AXIS_PTS
/begin AXIS_PTS ldp_vs_fac_iga_tra_gear_at "" 0x43b41 VS _REC_AXS_20_u1 255. _CNV_A_R_LINEAR_____13_CM 6 0. 255. FORMAT "%3.0" /end AXIS_PTS
/begin MEASUREMENT LAMB_CH "Lambda catalyst heating" UWORD _CNV_A_R_LINEAR_____148_CM 1 100. 0. 31.99902344 ECU_ADDRESS 0x3fcb1a FORMAT "%7.4" /end MEASUREMENT
/begin MEASUREMENT LAMB_AFL_CH "Lambda catalyst heating with lean strategy" UWORD _CNV_A_R_LINEAR_____148_CM 1 100. 0. 31.99902344 ECU_ADDRESS 0x3fdc0a FORMAT "%7.4" /end MEASUREMENT
/begin CHARACTERISTIC IP_LAMB_ADD_AFL_CH "additive correction of the basic lambda heating correction" MAP 0x485b6 _REC_MAP_20_u2_u2_u1 63.99902344 _CNV_A_R_LINEAR_____273_CM -32. 31.99902344 FORMAT "%8.4"
 /begin AXIS_DESCR COM_AXIS T_AST _CNV_A_R_LINEAR_____14_CM 8 0. 6553.5 FORMAT "%5.1" AXIS_PTS_REF ldp_t_ast__lamb_add_afl_ch /end AXIS_DESCR
 /begin AXIS_DESCR COM_AXIS TCO _CNV_A_R_LINEAR_____0_CM 8 -48. 142.5 FORMAT "%5.1" AXIS_PTS_REF ldp_tco__lamb_add_afl_ch /end AXIS_DESCR
/end CHARACTERISTIC
/begin CHARACTERISTIC IP_LAMB_CH_RGL "basic lambda correction for lean catalyst heating" MAP 0x48936 _REC_MAP_20_u2_u2_u1 31.99902344 _CNV_A_R_LINEAR_____148_CM 0. 31.99902344 FORMAT "%7.4"
 /begin AXIS_DESCR COM_AXIS TQI_REQ_SLOW _CNV_A_R_LINEAR_____218_CM 8 -1024. 1023.96875 FORMAT "%6.2" AXIS_PTS_REF ldp_tqi_req_slow__lamb_ch_rgl /end AXIS_DESCR
 /begin AXIS_DESCR COM_AXIS N_32 _CNV_A_R_LINEAR_____5_CM 8 0. 8160. FORMAT "%4.0" AXIS_PTS_REF ldp_n_32__lamb_ch_rgl /end AXIS_DESCR
/end CHARACTERISTIC
/begin CHARACTERISTIC IP_LAMB_CH_IS "basic lambda correction for lean catalyst heating during idle" MAP 0x488b6 _REC_MAP_20_u2_u2_u1 31.99902344 _CNV_A_R_LINEAR_____148_CM 0. 31.99902344 FORMAT "%7.4"
 /begin AXIS_DESCR COM_AXIS TQI_REQ_SLOW _CNV_A_R_LINEAR_____218_CM 8 -1024. 1023.96875 FORMAT "%6.2" AXIS_PTS_REF ldp_tqi_req_slow__lamb_ch_is /end AXIS_DESCR
 /begin AXIS_DESCR COM_AXIS N_32 _CNV_A_R_LINEAR_____5_CM 8 0. 8160. FORMAT "%4.0" AXIS_PTS_REF ldp_n_32__lamb_ch_is /end AXIS_DESCR
/end CHARACTERISTIC
/begin AXIS_PTS ldp_tco__lamb_add_afl_ch "" 0x4387e TCO _REC_AXS_20_u1 190.5 _CNV_A_R_LINEAR_____0_CM 8 -48. 142.5 FORMAT "%5.1" /end AXIS_PTS
/begin AXIS_PTS ldp_t_ast__lamb_add_afl_ch "" 0x44a52 T_AST _REC_AXS_20_u2 983.025 _CNV_A_R_LINEAR_____14_CM 8 0. 6553.5 FORMAT "%5.1" /end AXIS_PTS
/begin AXIS_PTS ldp_tqi_req_slow__lamb_ch_rgl "" 0x44c8e TQI_REQ_SLOW _REC_AXS_20_u2 2047.96875 _CNV_A_R_LINEAR_____218_CM 8 -1024. 1023.96875 FORMAT "%6.2" /end AXIS_PTS
/begin AXIS_PTS ldp_n_32__lamb_ch_rgl "" 0x43557 N_32 _REC_AXS_20_u1 8160. _CNV_A_R_LINEAR_____5_CM 8 0. 8160. FORMAT "%4.0" /end AXIS_PTS
/begin AXIS_PTS ldp_tqi_req_slow__lamb_ch_is "" 0x44c7c TQI_REQ_SLOW _REC_AXS_20_u2 2047.96875 _CNV_A_R_LINEAR_____218_CM 8 -1024. 1023.96875 FORMAT "%6.2" /end AXIS_PTS
/begin AXIS_PTS ldp_n_32__lamb_ch_is "" 0x4354e N_32 _REC_AXS_20_u1 8160. _CNV_A_R_LINEAR_____5_CM 8 0. 8160. FORMAT "%4.0" /end AXIS_PTS
/begin MEASUREMENT LV_SCC_1 "Logical value for single cylinder cut off, cylinder bank 1/2" UBYTE _CNV_S_2_RANGE______28_CM 1 100. 0. 1. ECU_ADDRESS 0x3fa73c /end MEASUREMENT
/begin MEASUREMENT LV_SCC_2 "Logical value for single cylinder cut off, cylinder bank 1/2" UBYTE _CNV_S_2_RANGE______28_CM 1 100. 0. 1. ECU_ADDRESS 0x3faa54 /end MEASUREMENT
/begin MEASUREMENT LAMB_FL "Lambda Requirement for Full Load Enrichment" UWORD _CNV_A_R_LINEAR_____148_CM 1 100. 0. 31.99902344 ECU_ADDRESS 0x3fcb1e FORMAT "%7.4" /end MEASUREMENT
/begin CHARACTERISTIC C_LAMB_FL_PAS "Passive value for full load enrichment" VALUE 0x42dca _REC_VAL_20_u2 31.99902344 _CNV_A_R_LINEAR_____148_CM 0. 31.99902344 FORMAT "%7.4" /end CHARACTERISTIC
/begin CHARACTERISTIC IP_LAMB_FL__N "Lambda full load enrichment" CURVE 0x489f6 _REC_CUR_20_u2_u1 31.99902344 _CNV_A_R_LINEAR_____148_CM 0. 31.99902344 FORMAT "%7.4"
 /begin AXIS_DESCR COM_AXIS N_32 _CNV_A_R_LINEAR_____5_CM 12 0. 8160. FORMAT "%4.0" AXIS_PTS_REF ldp_n__lamb_fl /end AXIS_DESCR
/end CHARACTERISTIC
/begin AXIS_PTS ldp_n__lamb_fl "" 0x4370a N_32 _REC_AXS_20_u1 8160. _CNV_A_R_LINEAR_____5_CM 12 0. 8160. FORMAT "%4.0" /end AXIS_PTS
/begin CHARACTERISTIC C_MFF_FAC "Constannt for stoichiometric air/fuel ratio (=1/14.7)" VALUE 0x42e84 _REC_VAL_20_u2 0.125 _CNV_A_R_LINEAR_____359_CM 0. 0.125 FORMAT "%7.5" /end CHARACTERISTIC
/begin MEASUREMENT MFF_BAS "Basic injection fuel mass flow (homogenious charge)" UWORD _CNV_A_R_LINEAR_____95_CM 1 100. 0. 1389. ECU_ADDRESS 0x3fceca FORMAT "%7.2" /end MEASUREMENT
/begin AXIS_PTS ldpm_n_tooth__eoi_st "" 0x4535c N_TOOTH _REC_AXS_20_u2 816. _CNV_A_R_LINEAR_____17_CM 4 0. 8160. FORMAT "%4.0" /end AXIS_PTS
/begin AXIS_PTS ldpm_tco__eoi_tco "" 0x43f89 TCO _REC_AXS_20_u1 19.05 _CNV_A_R_LINEAR_____0_CM 8 -48. 142.5 FORMAT "%5.1" /end AXIS_PTS
/begin CHARACTERISTIC IP_EOI_H_PRS_CST "Basic map end of injection at high pressure cold start" MAP 0x472f8 _REC_MAP_20_u2_u1_u2 720. _CNV_A_R_LINEAR_____75_CM 0. 720. FORMAT "%6.2"
 /begin AXIS_DESCR COM_AXIS TCO _CNV_A_R_LINEAR_____0_CM 8 -48. 142.5 FORMAT "%5.1" AXIS_PTS_REF ldpm_tco__eoi_tco /end AXIS_DESCR
 /begin AXIS_DESCR COM_AXIS N_TOOTH _CNV_A_R_LINEAR_____17_CM 4 0. 8160. FORMAT "%4.0" AXIS_PTS_REF ldpm_n_tooth__eoi_st /end AXIS_DESCR
/end CHARACTERISTIC
/begin CHARACTERISTIC IP_EOI_L_PRS_CST "Basic map end of injection at low pressure cold start" MAP 0x47338 _REC_MAP_20_u2_u1_u2 720. _CNV_A_R_LINEAR_____75_CM 0. 720. FORMAT "%6.2"
 /begin AXIS_DESCR COM_AXIS TCO _CNV_A_R_LINEAR_____0_CM 8 -48. 142.5 FORMAT "%5.1" AXIS_PTS_REF ldpm_tco__eoi_tco /end AXIS_DESCR
 /begin AXIS_DESCR COM_AXIS N_TOOTH _CNV_A_R_LINEAR_____17_CM 4 0. 8160. FORMAT "%4.0" AXIS_PTS_REF ldpm_n_tooth__eoi_st /end AXIS_DESCR
/end CHARACTERISTIC
/begin MEASUREMENT OPG_SP_ST_ISA "ISAPWM setpoint at start" UWORD _CNV_A_R_LINEAR_____94_CM 1 100. 0. 99.99847412 ECU_ADDRESS 0x3fd0c6 /end MEASUREMENT
/begin MEASUREMENT OPG_REL_ST "relative ISAPWM setpoint at start" UWORD _CNV_A_R_LINEAR_____94_CM 1 100. 0. 99.99847412 ECU_ADDRESS 0x3fe72e /end MEASUREMENT
/begin CHARACTERISTIC IP_OPG_REL_ST_ISA_AT "Specified relative ISAPWM setpoint at start" MAP 0x49934 _REC_MAP_20_u2_u2_u1 99.99847412 _CNV_A_R_LINEAR_____94_CM 0. 99.99847412
 /begin AXIS_DESCR COM_AXIS N _CNV_A_R_LINEAR_____17_CM 8 0. 8160. FORMAT "%4.0" AXIS_PTS_REF ldpm_n_1_thro /end AXIS_DESCR
 /begin AXIS_DESCR COM_AXIS TCO _CNV_A_R_LINEAR_____0_CM 8 -48. 142.5 FORMAT "%5.1" AXIS_PTS_REF ldpm_tco_1_thro /end AXIS_DESCR
/end CHARACTERISTIC
/begin CHARACTERISTIC IP_OPG_REL_ST_ISA_MT "Specified relative ISAPWM setpoint at start" MAP 0x499b4 _REC_MAP_20_u2_u2_u1 99.99847412 _CNV_A_R_LINEAR_____94_CM 0. 99.99847412
 /begin AXIS_DESCR COM_AXIS N _CNV_A_R_LINEAR_____17_CM 8 0. 8160. FORMAT "%4.0" AXIS_PTS_REF ldpm_n_1_thro /end AXIS_DESCR
 /begin AXIS_DESCR COM_AXIS TCO _CNV_A_R_LINEAR_____0_CM 8 -48. 142.5 FORMAT "%5.1" AXIS_PTS_REF ldpm_tco_1_thro /end AXIS_DESCR
/end CHARACTERISTIC
/begin CHARACTERISTIC IP_OPG_REL_ST_ISA_PV "correction of the ralative ISAPWM setpoint at start via driver's demand" CURVE 0x49a34 _REC_CUR_20_u2_u1 99.99847412 _CNV_A_R_LINEAR_____94_CM 0. 99.99847412
 /begin AXIS_DESCR COM_AXIS PV_AV _CNV_A_R_LINEAR_____4_CM 6 0. 99.609375 FORMAT "%4.1" AXIS_PTS_REF ldp_pv_av_ip_opg_rel_st_isa_pv /end AXIS_DESCR
/end CHARACTERISTIC
/begin CHARACTERISTIC IP_FAC_TIA_OPG_ST_ISA "TIA correction of the relative ISAPWM setpoint at start" CURVE 0x4e727 _REC_CUR_20_u1_u1 1.99220002 _CNV_A_R_LINEAR_____34_CM 0. 1.99220002 FORMAT "%5.3"
 /begin AXIS_DESCR COM_AXIS TIA _CNV_A_R_LINEAR_____0_CM 6 -48. 142.5 FORMAT "%5.1" AXIS_PTS_REF ldp_tia_ip_fac_tia_opg_st_isa /end AXIS_DESCR
/end CHARACTERISTIC
/begin CHARACTERISTIC IP_FAC_AMP_OPG_ST_ISA "Altitude correction of the relative ISAPWM setpoint at start" MAP 0x4dd71 _REC_MAP_20_u1_u2_u2 1.99220002 _CNV_A_R_LINEAR_____34_CM 0. 1.99220002 FORMAT "%5.3"
 /begin AXIS_DESCR COM_AXIS N _CNV_A_R_LINEAR_____17_CM 8 0. 8160. FORMAT "%4.0" AXIS_PTS_REF ldpm_n_1_thro /end AXIS_DESCR
 /begin AXIS_DESCR COM_AXIS AMP _CNV_A_R_LINEAR_____43_CM 6 0. 5434. FORMAT "%7.2" AXIS_PTS_REF ldp_amp_ip_fac_amp_opg_st_isa /end AXIS_DESCR
/end CHARACTERISTIC
/begin CHARACTERISTIC IP_OPG_SP_ST_ISA "ISAPWM at start" MAP 0x49a40 _REC_MAP_20_u2_u2_u2 99.99847412 _CNV_A_R_LINEAR_____94_CM 0. 99.99847412
 /begin AXIS_DESCR COM_AXIS N _CNV_A_R_LINEAR_____17_CM 8 0. 8160. FORMAT "%4.0" AXIS_PTS_REF ldpm_n_1_thro /end AXIS_DESCR
 /begin AXIS_DESCR COM_AXIS OPG_REL_ST _CNV_A_R_LINEAR_____94_CM 12 0. 99.99847412 AXIS_PTS_REF ldp_opg_rel_st_ip_opg_sp_st_isa /end AXIS_DESCR
/end CHARACTERISTIC
/begin AXIS_PTS ldp_opg_rel_st_ip_opg_sp_st_isa "" 0x4498c OPG_REG_ST _REC_AXS_20_u2 99.99847412 _CNV_A_R_LINEAR_____94_CM 12 0. 99.99847412 /end AXIS_PTS
/begin AXIS_PTS ldp_amp_ip_fac_amp_opg_st_isa "" 0x44122 AMP _REC_AXS_20_u2 5434. _CNV_A_R_LINEAR_____43_CM 6 0. 5434. FORMAT "%7.2" /end AXIS_PTS
/begin AXIS_PTS ldp_tia_ip_fac_tia_opg_st_isa "" 0x439ea TIA _REC_AXS_20_u1 190.5 _CNV_A_R_LINEAR_____0_CM 6 -48. 142.5 FORMAT "%5.1" /end AXIS_PTS
/begin AXIS_PTS ldp_pv_av_ip_opg_rel_st_isa_pv "" 0x437b0 PV_AV _REC_AXS_20_u1 99.609375 _CNV_A_R_LINEAR_____4_CM 6 0. 99.609375 FORMAT "%4.1" /end AXIS_PTS
/begin MEASUREMENT INH_IV_AMT "Shut off sequence of AMT transmission" UBYTE _CNV_A_R_LINEAR_____10_CM 1 100. 0. 255. ECU_ADDRESS 0x3fd023 FORMAT "%3.0" /end MEASUREMENT
/begin CHARACTERISTIC IP_TI_ST_AMP_FAC__AMP "Cranking injection time correction upon ambient pressure" CURVE 0x50a6b _REC_CUR_20_u1_u2 9.9610001e-002 _CNV_A_R_LINEAR_____34_CM 0. 1.99220002 FORMAT "%5.3"
 /begin AXIS_DESCR COM_AXIS AMP_MES _CNV_A_R_LINEAR_____43_CM 6 0. 5434. FORMAT "%7.2" AXIS_PTS_REF ldp_amp_mes_ti_st_amp_fac /end AXIS_DESCR
/end CHARACTERISTIC
/begin AXIS_PTS ldp_amp_mes_ti_st_amp_fac "" 0x4415a AMP _REC_AXS_20_u2 5434. _CNV_A_R_LINEAR_____43_CM 6 0. 5434. FORMAT "%7.2" /end AXIS_PTS
/begin MEASUREMENT TI_CAST "Cold post start injection time correction" UWORD _CNV_A_R_LINEAR_____113_CM 1 100. 0. 4. ECU_ADDRESS 0x3fcf04 FORMAT "%6.4" /end MEASUREMENT
/begin CHARACTERISTIC IP_TI_CAST__TIA__TCO "Initialization value of post start enrichment factor" MAP 0x508a4 _REC_MAP_20_u1_u1_u1 0.3984375 _CNV_A_R_LINEAR_____195_CM 0. 3.984375 FORMAT "%4.2"
 /begin AXIS_DESCR COM_AXIS TIA _CNV_A_R_LINEAR_____0_CM 2 -48. 142.5 FORMAT "%5.1" AXIS_PTS_REF ldp_tia_ip_ti_cast /end AXIS_DESCR
 /begin AXIS_DESCR COM_AXIS TCO _CNV_A_R_LINEAR_____0_CM 8 -48. 142.5 FORMAT "%5.1" AXIS_PTS_REF ldpm_tco_3 /end AXIS_DESCR
/end CHARACTERISTIC
/begin CHARACTERISTIC IP_TI_DEAC_CAST__CYC_CAST__TCO "Deactivation factor of post start enrichment" MAP 0x508d4 _REC_MAP_20_u1_u2_u1 9.960940000000002e-002 _CNV_A_R_LINEAR_____44_CM 0. 0.996094 FORMAT "%5.3"
 /begin AXIS_DESCR COM_AXIS CYC_CAST _CNV_A_R_LINEAR_____10_CM 6 0. 65535. FORMAT "%5.0" AXIS_PTS_REF ldp_cyc_cast_ip_ti_deac_cast /end AXIS_DESCR
 /begin AXIS_DESCR COM_AXIS TCO _CNV_A_R_LINEAR_____0_CM 8 -48. 142.5 FORMAT "%5.1" AXIS_PTS_REF ldpm_tco_3 /end AXIS_DESCR
/end CHARACTERISTIC
/begin MEASUREMENT LV_AST_END "logical bit for \"After-start end\"" UBYTE _CNV_S_2_RANGE______28_CM 1 100. 0. 1. ECU_ADDRESS 0x3fcf0b BIT_MASK 0x1 /end MEASUREMENT
/begin AXIS_PTS ldp_tia_ip_ti_cast "" 0x439f8 TIA _REC_AXS_20_u1 28.575 _CNV_A_R_LINEAR_____0_CM 2 -48. 142.5 FORMAT "%5.1" /end AXIS_PTS
/begin AXIS_PTS ldp_cyc_cast_ip_ti_deac_cast "" 0x4427c CYC_CAST _REC_AXS_20_u2 65535. _CNV_A_R_LINEAR_____10_CM 6 0. 65535. FORMAT "%5.0" /end AXIS_PTS
/begin AXIS_PTS ldpm_tco_3 "" 0x43f76 TCO _REC_AXS_20_u1 190.5 _CNV_A_R_LINEAR_____0_CM 8 -48. 142.5 FORMAT "%5.1" /end AXIS_PTS
/begin MEASUREMENT MFF_SP "Mass fuel flow setpoint after combustion selection" UWORD _CNV_A_R_LINEAR_____95_CM 1 100. 0. 1389. ECU_ADDRESS 0x3fcf0e FORMAT "%7.2" /end MEASUREMENT
/begin MEASUREMENT TI_ADD_DLY "Injector dead time correction" SWORD _CNV_A_R_LINEAR_____208_CM 1 100. -131.072 131.068 ECU_ADDRESS 0x3fcf10 FORMAT "%8.3" /end MEASUREMENT
/begin CHARACTERISTIC IP_TI_ADD_DLY "Injector dead time correction" MAP 0x4ba18 _REC_MAP_20_u2_u1_u2 26.214 _CNV_A_R_LINEAR_____434_CM -131.072 131.068 FORMAT "%6.2"
 /begin AXIS_DESCR COM_AXIS VB _CNV_A_R_LINEAR_____26_CM 8 0. 25.8984 FORMAT "%3.1" AXIS_PTS_REF ldp_vb__ti_add_dly /end AXIS_DESCR
 /begin AXIS_DESCR COM_AXIS FUP _CNV_A_R_LINEAR_____190_CM 6 0. 173888. FORMAT "%6.0" AXIS_PTS_REF ldp_fup_map_dif__ti_add_dly /end AXIS_DESCR
/end CHARACTERISTIC
/begin AXIS_PTS ldp_vb__ti_add_dly "" 0x43ad4 VB _REC_AXS_20_u1 3.107808 _CNV_A_R_LINEAR_____26_CM 8 0. 25.8984 FORMAT "%3.1" /end AXIS_PTS
/begin AXIS_PTS ldp_fup_map_dif__ti_add_dly "Injector dead time correction" 0x443d4 FUP_MAP_DIF _REC_AXS_20_u2 17388.8 _CNV_A_R_LINEAR_____190_CM 6 0. 173888. FORMAT "%6.0" /end AXIS_PTS
/begin MEASUREMENT TIB "Basic injection time - equivalent to MFF_BAS (interface to wall film compensation function)" UWORD _CNV_A_R_LINEAR_____208_CM 1 100. 0. 262.14 ECU_ADDRESS 0x3fcf20 FORMAT "%7.3" /end MEASUREMENT
/begin MEASUREMENT MFF_ADD_WF "Fuel mass flow for wall film compensation - equivalent to TI_ADD_WF (interface to total injection formula)" SWORD _CNV_A_R_LINEAR_____261_CM 1 100. -694.5 694.478806 ECU_ADDRESS 0x3fcf1e FORMAT "%7.2" /end MEASUREMENT
/begin MEASUREMENT TI_ADD_REAC_0 "Reactivation fuel feed injection time correction" UWORD _CNV_A_R_LINEAR_____208_CM 1 100. 0. 262.14 ECU_ADDRESS 0x3fcf12 FORMAT "%7.3" /end MEASUREMENT
/begin MEASUREMENT TI_ADD_REAC_1 "Reactivation fuel feed injection time correction" UWORD _CNV_A_R_LINEAR_____208_CM 1 100. 0. 262.14 ECU_ADDRESS 0x3fcf14 FORMAT "%7.3" /end MEASUREMENT
/begin MEASUREMENT TI_ADD_REAC_2 "Reactivation fuel feed injection time correction" UWORD _CNV_A_R_LINEAR_____208_CM 1 100. 0. 262.14 ECU_ADDRESS 0x3fcf16 FORMAT "%7.3" /end MEASUREMENT
/begin MEASUREMENT TI_ADD_REAC_3 "Reactivation fuel feed injection time correction" UWORD _CNV_A_R_LINEAR_____208_CM 1 100. 0. 262.14 ECU_ADDRESS 0x3fcf18 FORMAT "%7.3" /end MEASUREMENT
/begin MEASUREMENT TI_ADD_REAC_4 "Reactivation fuel feed injection time correction" UWORD _CNV_A_R_LINEAR_____208_CM 1 100. 0. 262.14 ECU_ADDRESS 0x3fcf1a FORMAT "%7.3" /end MEASUREMENT
/begin MEASUREMENT TI_ADD_REAC_5 "Reactivation fuel feed injection time correction" UWORD _CNV_A_R_LINEAR_____208_CM 1 100. 0. 262.14 ECU_ADDRESS 0x3fcf1c FORMAT "%7.3" /end MEASUREMENT
/begin CHARACTERISTIC C_EOI_LIM "Latest possible EOI" VALUE 0x42cf4 _REC_VAL_20_u2 720. _CNV_A_R_LINEAR_____75_CM 0. 720. FORMAT "%6.2" /end CHARACTERISTIC
/begin MEASUREMENT SOI_HOM "start of injection for homogeneous combustion mode" UWORD _CNV_A_R_LINEAR_____75_CM 1 100. 0. 720. ECU_ADDRESS 0x3fcf2e FORMAT "%6.2" /end MEASUREMENT
/begin MEASUREMENT EOI_HOM_CLC "calculated end of injection for homogeneous combustion mode" UWORD _CNV_A_R_LINEAR_____75_CM 1 100. 0. 720. ECU_ADDRESS 0x3fe476 FORMAT "%6.2" /end MEASUREMENT
/begin MEASUREMENT EOI_TCO "Temperature correction for end of injection" UWORD _CNV_A_R_LINEAR_____75_CM 1 100. 0. 720. ECU_ADDRESS 0x3fe478 FORMAT "%6.2" /end MEASUREMENT
/begin MEASUREMENT TI_HOM_MAX_CST "Maximum injection time to fulfill required C_SOI_MIN_CST_H_PRS / C_SOI_MIN_CST_L_PRS" UWORD _CNV_A_R_LINEAR_____208_CM 1 100. 0. 262.14 ECU_ADDRESS 0x3fcf30 FORMAT "%7.3" /end MEASUREMENT
/begin CHARACTERISTIC LC_EOI_HOM_MAN "switch for using the manual setpoint for EOI" VALUE 0x42b7f _REC_VAL_20_u1 1. _CNV_S_2_RANGE______11_CM 0. 1. /end CHARACTERISTIC
/begin CHARACTERISTIC C_EOI_HOM_MAN "manual setpoint for EOI" VALUE 0x42cf2 _REC_VAL_20_u2 720. _CNV_A_R_LINEAR_____75_CM 0. 720. FORMAT "%6.2" /end CHARACTERISTIC
/begin CHARACTERISTIC C_SOI_MIN_CST_L_PRS "minimum start of injection angle during low pressure start" VALUE 0x42f3a _REC_VAL_20_u2 720. _CNV_A_R_LINEAR_____75_CM 0. 720. FORMAT "%6.2" /end CHARACTERISTIC
/begin CHARACTERISTIC C_SOI_MIN_CST_H_PRS "minimum start of injection angle during high pressure start" VALUE 0x42f38 _REC_VAL_20_u2 720. _CNV_A_R_LINEAR_____75_CM 0. 720. FORMAT "%6.2" /end CHARACTERISTIC
/begin CHARACTERISTIC IP_EOI_BAS "Basic map end of injection" MAP 0x47268 _REC_MAP_20_u2_u1_u2 720. _CNV_A_R_LINEAR_____75_CM 0. 720. FORMAT "%6.2"
 /begin AXIS_DESCR COM_AXIS N_32 _CNV_A_R_LINEAR_____5_CM 6 0. 8160. FORMAT "%4.0" AXIS_PTS_REF ldp_n_32__eoi_bas /end AXIS_DESCR
 /begin AXIS_DESCR COM_AXIS TI_HOM_1 _CNV_A_R_LINEAR_____208_CM 6 0. 262.14 FORMAT "%7.3" AXIS_PTS_REF ldp_ti_hom__eoi_bas /end AXIS_DESCR
/end CHARACTERISTIC
/begin CHARACTERISTIC IP_EOI_TCO "Coolant temperature correction EOI" CURVE 0x47388 _REC_CUR_20_u2_u1 720. _CNV_A_R_LINEAR_____75_CM 0. 720. FORMAT "%6.2"
 /begin AXIS_DESCR COM_AXIS TCO _CNV_A_R_LINEAR_____0_CM 8 -48. 142.5 FORMAT "%5.1" AXIS_PTS_REF ldpm_tco__eoi_tco /end AXIS_DESCR
/end CHARACTERISTIC
/begin MEASUREMENT EOI_BAS "Basic map end of injection versus engine speed and injection time" UWORD _CNV_A_R_LINEAR_____75_CM 1 100. 0. 720. ECU_ADDRESS 0x3fe474 FORMAT "%6.2" /end MEASUREMENT
/begin CHARACTERISTIC C_EOI_AS "EOI-correction of application system" VALUE 0x4324c _REC_VAL_20_s2 1440. _CNV_A_R_LINEAR_____75_CM -720. 720. FORMAT "%6.1" /end CHARACTERISTIC
/begin CHARACTERISTIC LC_EOI_COR_IVVT_VVL "switch to activate (1) or deactivate (0) the EOI-correction for inlet-CWM-position and variable valve lift" VALUE 0x42b7e _REC_VAL_20_u1 1. _CNV_A_R_LINEAR_____10_CM 0. 1. FORMAT "%2.0" /end CHARACTERISTIC
/begin CHARACTERISTIC IP_CAM_OP_IN_VVL__VLFT_AV "inlet valve opening angle vs. actual inlet valve lift" CURVE 0x46148 _REC_CUR_20_u2_u2 1535.9765625 _CNV_A_R_LINEAR_____350_CM -768. 767.9765625 FORMAT "%7.2"
 /begin AXIS_DESCR COM_AXIS ONLINE_DUMMY _CNV_A_R_LINEAR_____387_CM 6 0. 65.535 AXIS_PTS_REF ldp_vlft_av__cam_op_in_vvl /end AXIS_DESCR
/end CHARACTERISTIC
/begin MEASUREMENT EOI_LIM "latest possible EOI" UWORD _CNV_A_R_LINEAR_____75_CM 1 100. 0. 720. ECU_ADDRESS 0x3fcf32 FORMAT "%6.2" /end MEASUREMENT
/begin MEASUREMENT CAM_OP_IN_VVL "actual value inlet valve opening angle" SWORD _CNV_A_R_LINEAR_____232_CM 1 100. -768. 767.9765625 ECU_ADDRESS 0x3fe47c FORMAT "%7.2" /end MEASUREMENT
/begin MEASUREMENT EOI_IVVT_VVL "Correction for inlet-CAM-position and inlet valve opening angle" UWORD _CNV_A_R_LINEAR_____75_CM 1 100. 0. 720. ECU_ADDRESS 0x3fe47e FORMAT "%6.2" /end MEASUREMENT
/begin AXIS_PTS ldp_ti_hom__eoi_bas "" 0x44b22 TI_HOM _REC_AXS_20_u2 26.214 _CNV_A_R_LINEAR_____208_CM 6 0. 262.14 FORMAT "%7.3" /end AXIS_PTS
/begin AXIS_PTS ldp_vlft_av__cam_op_in_vvl "" 0x44dd2 VLFT_AV _REC_AXS_20_u2 65.535 _CNV_A_R_LINEAR_____387_CM 6 0. 65.535 /end AXIS_PTS
/begin AXIS_PTS ldp_n_32__eoi_bas "" 0x434dc N_32 _REC_AXS_20_u1 816. _CNV_A_R_LINEAR_____5_CM 6 0. 8160. FORMAT "%4.0" /end AXIS_PTS
/begin CHARACTERISTIC IP_TI_ST_REST "Cold start reduction factor in case of re-start with no engine stop time T_ES available" CURVE 0x50a71 _REC_CUR_20_u1_u1 0.199220002 _CNV_A_R_LINEAR_____20_CM 0. 0.99610001 FORMAT "%5.3"
 /begin AXIS_DESCR COM_AXIS TCO _CNV_A_R_LINEAR_____0_CM 8 -48. 142.5 FORMAT "%5.1" AXIS_PTS_REF ldpm_tco__ti_st_rest /end AXIS_DESCR
/end CHARACTERISTIC
/begin CHARACTERISTIC IP_REST "Considering the shut-off time for re-start calculation" CURVE 0x4fe0c _REC_CUR_20_u1_u2 0.199220002 _CNV_A_R_LINEAR_____20_CM 0. 0.99610001 FORMAT "%5.3"
 /begin AXIS_DESCR COM_AXIS T_ES _CNV_A_R_LINEAR_____35_CM 8 0. 65535. FORMAT "%5.0" AXIS_PTS_REF ldp_t_es__rest /end AXIS_DESCR
/end CHARACTERISTIC
/begin CHARACTERISTIC IP_FAC_REST "Considering coolant stop temperature and after start time for re-start calculation" MAP 0x4e477 _REC_MAP_20_u1_u2_u1 0.199220002 _CNV_A_R_LINEAR_____20_CM 0. 0.99610001 FORMAT "%5.3"
 /begin AXIS_DESCR COM_AXIS T_AST_REST _CNV_A_R_LINEAR_____14_CM 8 0. 6553.5 FORMAT "%6.1" AXIS_PTS_REF ldp_t_ast_rest /end AXIS_DESCR
 /begin AXIS_DESCR COM_AXIS TCO_STOP _CNV_A_R_LINEAR_____0_CM 8 -48. 142.5 FORMAT "%5.1" AXIS_PTS_REF ldp_tco_stop__fac_rest /end AXIS_DESCR
/end CHARACTERISTIC
/begin CHARACTERISTIC IP_FAC_STALL "Special cold start reduction factor in case of re-start after engine stall out" CURVE 0x4e4f5 _REC_CUR_20_u1_u1 0.199220002 _CNV_A_R_LINEAR_____20_CM 0. 0.99610001 FORMAT "%5.3"
 /begin AXIS_DESCR COM_AXIS TCO _CNV_A_R_LINEAR_____0_CM 8 -48. 142.5 FORMAT "%5.1" AXIS_PTS_REF ldpm_tco__fac_stall /end AXIS_DESCR
/end CHARACTERISTIC
/begin AXIS_PTS ldpm_tco__ti_st_rest "" 0x43fc2 TCO _REC_AXS_20_u1 28.575 _CNV_A_R_LINEAR_____0_CM 8 -48. 142.5 FORMAT "%5.1" /end AXIS_PTS
/begin AXIS_PTS ldp_tco_stop__fac_rest "" 0x43989 TCO_STOP _REC_AXS_20_u1 28.575 _CNV_A_R_LINEAR_____0_CM 8 -48. 142.5 FORMAT "%5.1" /end AXIS_PTS
/begin AXIS_PTS ldpm_tco__fac_stall "" 0x43f92 TCO _REC_AXS_20_u1 28.575 _CNV_A_R_LINEAR_____0_CM 8 -48. 142.5 FORMAT "%5.1" /end AXIS_PTS
/begin AXIS_PTS ldp_t_es__rest "" 0x44a96 T_ES _REC_AXS_20_u2 9830.25 _CNV_A_R_LINEAR_____35_CM 8 0. 65535. FORMAT "%5.0" /end AXIS_PTS
/begin AXIS_PTS ldp_t_ast_rest "" 0x44a76 T_AST_REST _REC_AXS_20_u2 983.025 _CNV_A_R_LINEAR_____14_CM 8 0. 6553.5 FORMAT "%6.1" /end AXIS_PTS
/begin CHARACTERISTIC IP_TI_WUP__N__MAF "TI warm up correction" MAP 0x50bed _REC_MAP_20_u1_u1_u1 0.1494141 _CNV_A_R_LINEAR_____44_CM 0. 0.996094 FORMAT "%5.3"
 /begin AXIS_DESCR COM_AXIS MAF _CNV_A_R_LINEAR_____18_CM 8 0. 1389. FORMAT "%4.0" AXIS_PTS_REF ldpm_maf_hb__ti_wup /end AXIS_DESCR
 /begin AXIS_DESCR COM_AXIS N_32 _CNV_A_R_LINEAR_____5_CM 8 0. 8160. FORMAT "%4.0" AXIS_PTS_REF ldpm_n_32__ti_wup /end AXIS_DESCR
/end CHARACTERISTIC
/begin MEASUREMENT TI_WUP_1 "Warm-up enrichment part, intermediate value" UWORD _CNV_A_R_LINEAR_____113_CM 1 100. 0. 4. ECU_ADDRESS 0x3fcf46 FORMAT "%6.4" /end MEASUREMENT
/begin MEASUREMENT TI_WUP "Warm-up injection time correction" UWORD _CNV_A_R_LINEAR_____113_CM 1 100. 0. 4. ECU_ADDRESS 0x3fcf44 FORMAT "%6.4" /end MEASUREMENT
/begin MEASUREMENT TI_TEMP "Warm-up enrichment part, intermediate, permanent part" UWORD _CNV_A_R_LINEAR_____113_CM 1 100. 0. 4. ECU_ADDRESS 0x3fe4a2 FORMAT "%6.4" /end MEASUREMENT
/begin CHARACTERISTIC IP_TI_TCO_WUP__TCO__TCO_ST "TCO/TCO_ST-dependent warm up correction" MAP 0x50b7d _REC_MAP_20_u1_u1_u1 0.199220002 _CNV_A_R_LINEAR_____34_CM 0. 1.99220002 FORMAT "%5.3"
 /begin AXIS_DESCR COM_AXIS TCO_ST _CNV_A_R_LINEAR_____0_CM 3 -48. 142.5 FORMAT "%5.1" AXIS_PTS_REF ldp_tco_st__ti_tco_wup /end AXIS_DESCR
 /begin AXIS_DESCR COM_AXIS TCO _CNV_A_R_LINEAR_____0_CM 8 -48. 142.5 FORMAT "%5.1" AXIS_PTS_REF ldpm_tco__ti_wup /end AXIS_DESCR
/end CHARACTERISTIC
/begin CHARACTERISTIC IP_TI_VO_WUP__TCO__VO "TCO/VO dependent warm up correction" MAP 0x50bad _REC_MAP_20_u1_u1_u1 0.1 _CNV_A_R_LINEAR_____103_CM 0.5 1.5 FORMAT "%5.3"
 /begin AXIS_DESCR COM_AXIS VO _CNV_A_R_LINEAR_____75_CM 8 0. 95.625 FORMAT "%5.2" AXIS_PTS_REF ldp_vo__ti_vo_wup /end AXIS_DESCR
 /begin AXIS_DESCR COM_AXIS TCO _CNV_A_R_LINEAR_____0_CM 8 -48. 142.5 FORMAT "%5.1" AXIS_PTS_REF ldpm_tco__ti_wup /end AXIS_DESCR
/end CHARACTERISTIC
/begin CHARACTERISTIC IP_FAC_TI_VO_WUP "Factor map for TCO/VO dependent warm up correction" MAP 0x4e6d1 _REC_MAP_20_u1_u2_u1 0.199220002 _CNV_A_R_LINEAR_____34_CM 0. 1.99220002 FORMAT "%5.3"
 /begin AXIS_DESCR COM_AXIS ONLINE_DUMMY _CNV_A_R_LINEAR_____43_CM 8 0. 5434. FORMAT "%7.2" AXIS_PTS_REF ldp_map_dif__fac_ti_vo_wup /end AXIS_DESCR
 /begin AXIS_DESCR COM_AXIS N_32 _CNV_A_R_LINEAR_____5_CM 8 0. 8160. FORMAT "%4.0" AXIS_PTS_REF ldpm_n_32__ti_wup /end AXIS_DESCR
/end CHARACTERISTIC
/begin CHARACTERISTIC IP_TI_FAC_N_MAP "Injection time weighting for temperature influence f(operating point)" MAP 0x50904 _REC_MAP_20_u1_u2_u1 9.9610001e-002 _CNV_A_R_LINEAR_____20_CM 0. 0.99610001 FORMAT "%5.3"
 /begin AXIS_DESCR COM_AXIS MAP _CNV_A_R_LINEAR_____43_CM 8 0. 5434. FORMAT "%7.2" AXIS_PTS_REF ldp_map__ti_fac_n_map /end AXIS_DESCR
 /begin AXIS_DESCR COM_AXIS N_32 _CNV_A_R_LINEAR_____5_CM 8 0. 8160. FORMAT "%4.0" AXIS_PTS_REF ldp_n_32__ti_fac_n_map /end AXIS_DESCR
/end CHARACTERISTIC
/begin CHARACTERISTIC IP_TI_FAC_TIA_TOIL "Injection time weighting for temperature influence f(TIA, TOIL)" MAP 0x50a47 _REC_MAP_20_u1_u1_u1 0.199220002 _CNV_A_R_LINEAR_____34_CM 0. 1.99220002 FORMAT "%5.3"
 /begin AXIS_DESCR COM_AXIS TIA _CNV_A_R_LINEAR_____0_CM 6 -48. 142.5 FORMAT "%5.1" AXIS_PTS_REF ldp_tia_ti_fac_tia_toil /end AXIS_DESCR
 /begin AXIS_DESCR COM_AXIS TOIL _CNV_A_R_LINEAR_____3_CM 6 -40. 160. FORMAT "%3.0" AXIS_PTS_REF ldp_toil_ti_fac_tia_toil /end AXIS_DESCR
/end CHARACTERISTIC
/begin CHARACTERISTIC IP_TI_FAC_TCO "Injection time weighting for temperature influence f(coolant temperature)" CURVE 0x50a44 _REC_CUR_20_u1_u1 9.9610001e-002 _CNV_A_R_LINEAR_____20_CM 0. 0.99610001 FORMAT "%5.3"
 /begin AXIS_DESCR COM_AXIS TCO _CNV_A_R_LINEAR_____0_CM 3 -48. 142.5 FORMAT "%5.1" AXIS_PTS_REF ldp_tco__ti_fac_tco /end AXIS_DESCR
/end CHARACTERISTIC
/begin AXIS_PTS ldpm_maf_hb__ti_wup "" 0x43c61 MAF_HB _REC_AXS_20_u1 1389. _CNV_A_R_LINEAR_____18_CM 8 0. 1389. FORMAT "%4.0" /end AXIS_PTS
/begin AXIS_PTS ldpm_tco__ti_wup "" 0x43fcb TCO _REC_AXS_20_u1 190.5 _CNV_A_R_LINEAR_____0_CM 8 -48. 142.5 FORMAT "%5.1" /end AXIS_PTS
/begin AXIS_PTS ldp_tco_st__ti_tco_wup "" 0x4395b TCO_ST _REC_AXS_20_u1 190.5 _CNV_A_R_LINEAR_____0_CM 3 -48. 142.5 FORMAT "%5.1" /end AXIS_PTS
/begin AXIS_PTS ldp_vo__ti_vo_wup "" 0x43b12 VO _REC_AXS_20_u1 95.625 _CNV_A_R_LINEAR_____75_CM 8 0. 95.625 FORMAT "%5.2" /end AXIS_PTS
/begin AXIS_PTS ldpm_n_32__ti_wup "" 0x43df1 N_32 _REC_AXS_20_u1 8160. _CNV_A_R_LINEAR_____5_CM 8 0. 8160. FORMAT "%4.0" /end AXIS_PTS
/begin AXIS_PTS ldp_map_dif__fac_ti_vo_wup "" 0x446cc MAP_DIF _REC_AXS_20_u2 5434. _CNV_A_R_LINEAR_____43_CM 8 0. 5434. FORMAT "%7.2" /end AXIS_PTS
/begin AXIS_PTS ldp_map__ti_fac_n_map "" 0x446ba MAP _REC_AXS_20_u2 5434. _CNV_A_R_LINEAR_____43_CM 8 0. 5434. FORMAT "%7.2" /end AXIS_PTS
/begin AXIS_PTS ldp_n_32__ti_fac_n_map "" 0x43607 N_32 _REC_AXS_20_u1 8160. _CNV_A_R_LINEAR_____5_CM 8 0. 8160. FORMAT "%4.0" /end AXIS_PTS
/begin AXIS_PTS ldp_toil_ti_fac_tia_toil "" 0x43a62 TOIL _REC_AXS_20_u1 200. _CNV_A_R_LINEAR_____3_CM 6 -40. 160. FORMAT "%3.0" /end AXIS_PTS
/begin AXIS_PTS ldp_tia_ti_fac_tia_toil "" 0x43a0b TIA _REC_AXS_20_u1 190.5 _CNV_A_R_LINEAR_____0_CM 6 -48. 142.5 FORMAT "%5.1" /end AXIS_PTS
/begin AXIS_PTS ldp_tco__ti_fac_tco "" 0x438d9 TCO _REC_AXS_20_u1 190.5 _CNV_A_R_LINEAR_____0_CM 3 -48. 142.5 FORMAT "%5.1" /end AXIS_PTS
/begin CHARACTERISTIC C_FAC_WF_PUC "transposition factor for PUC" VALUE 0x428c7 _REC_VAL_20_u1 0.9960940000000002 _CNV_A_R_LINEAR_____44_CM 0. 0.996094 FORMAT "%5.3" /end CHARACTERISTIC
/begin CHARACTERISTIC C_TI_CRLC_FAST_WF_IS "fast correlation constant for idle speed" VALUE 0x42aa5 _REC_VAL_20_u1 0.4980468800000001 _CNV_A_R_LINEAR_____439_CM 0. 0.49804688 FORMAT "%5.3" /end CHARACTERISTIC
/begin MEASUREMENT SEG_CTR_WF "wall film segment counter running down after engine start" UWORD _CNV_A_R_LINEAR_____178_CM 1 100. 0. 65535. ECU_ADDRESS 0x3fe4ca FORMAT "%5.0" /end MEASUREMENT
/begin CHARACTERISTIC IP_SEG_CTR_FAC_WF__SEG_CTR_WF "number of segments depending factor for first tip in" CURVE 0x4fe24 _REC_CUR_20_u1_u2 0.9960940000000002 _CNV_A_R_LINEAR_____44_CM 0. 0.996094 FORMAT "%5.3"
 /begin AXIS_DESCR COM_AXIS SEG_CTR_WF _CNV_A_R_LINEAR_____178_CM 4 0. 65535. FORMAT "%5.0" AXIS_PTS_REF ldp_seg_ctr_fac_wf /end AXIS_DESCR
/end CHARACTERISTIC
/begin CHARACTERISTIC IP_TI_CRLC_NEG_FAST_WF__N "fast negative correlation constant" CURVE 0x508b4 _REC_CUR_20_u1_u1 0.4980468800000001 _CNV_A_R_LINEAR_____439_CM 0. 0.49804688 FORMAT "%5.3"
 /begin AXIS_DESCR COM_AXIS N_32 _CNV_A_R_LINEAR_____5_CM 8 0. 8160. FORMAT "%4.0" AXIS_PTS_REF ldpm_n_29 /end AXIS_DESCR
/end CHARACTERISTIC
/begin CHARACTERISTIC IP_TI_CRLC_NEG_SLOW_WF__N "slow negative correlation constant" CURVE 0x508bc _REC_CUR_20_u1_u1 0.4980468800000001 _CNV_A_R_LINEAR_____439_CM 0. 0.49804688 FORMAT "%5.3"
 /begin AXIS_DESCR COM_AXIS N_32 _CNV_A_R_LINEAR_____5_CM 8 0. 8160. FORMAT "%4.0" AXIS_PTS_REF ldpm_n_29 /end AXIS_DESCR
/end CHARACTERISTIC
/begin CHARACTERISTIC IP_TI_CRLC_POS_FAST_WF__N "fast positive correlation constant" CURVE 0x508c4 _REC_CUR_20_u1_u1 0.4980468800000001 _CNV_A_R_LINEAR_____439_CM 0. 0.49804688 FORMAT "%5.3"
 /begin AXIS_DESCR COM_AXIS N_32 _CNV_A_R_LINEAR_____5_CM 8 0. 8160. FORMAT "%4.0" AXIS_PTS_REF ldpm_n_29 /end AXIS_DESCR
/end CHARACTERISTIC
/begin CHARACTERISTIC IP_TI_CRLC_POS_SLOW_WF__N "slow positive correlation constant" CURVE 0x508cc _REC_CUR_20_u1_u1 0.4980468800000001 _CNV_A_R_LINEAR_____439_CM 0. 0.49804688 FORMAT "%5.3"
 /begin AXIS_DESCR COM_AXIS N_32 _CNV_A_R_LINEAR_____5_CM 8 0. 8160. FORMAT "%4.0" AXIS_PTS_REF ldpm_n_29 /end AXIS_DESCR
/end CHARACTERISTIC
/begin CHARACTERISTIC IP_TI_DIF_WF_THD__TCO "threshold for suppressing small variations of tib" CURVE 0x4bb04 _REC_CUR_20_u2_u1 262.14 _CNV_A_R_LINEAR_____208_CM 0. 262.14 FORMAT "%7.3"
 /begin AXIS_DESCR COM_AXIS TCO _CNV_A_R_LINEAR_____0_CM 4 -48. 142.5 FORMAT "%5.1" AXIS_PTS_REF ldp_tco_ti_wf_thd /end AXIS_DESCR
/end CHARACTERISTIC
/begin CHARACTERISTIC IP_TI_FAC_NEG_FAST_WF__N__MAF "load correction fast wall film negative" MAP 0x50944 _REC_MAP_20_u1_u1_u1 1.9921875 _CNV_A_R_LINEAR_____103_CM 0. 1.9921875 FORMAT "%5.3"
 /begin AXIS_DESCR COM_AXIS N_32 _CNV_A_R_LINEAR_____5_CM 8 0. 8160. FORMAT "%4.0" AXIS_PTS_REF ldpm_n_29 /end AXIS_DESCR
 /begin AXIS_DESCR COM_AXIS MAF _CNV_A_R_LINEAR_____18_CM 8 0. 1389. FORMAT "%4.0" AXIS_PTS_REF ldpm_maf_6 /end AXIS_DESCR
/end CHARACTERISTIC
/begin CHARACTERISTIC IP_TI_FAC_NEG_SLOW_WF__N__MAF "load correction slow wall film negative" MAP 0x50984 _REC_MAP_20_u1_u1_u1 1.9921875 _CNV_A_R_LINEAR_____103_CM 0. 1.9921875 FORMAT "%5.3"
 /begin AXIS_DESCR COM_AXIS N_32 _CNV_A_R_LINEAR_____5_CM 8 0. 8160. FORMAT "%4.0" AXIS_PTS_REF ldpm_n_29 /end AXIS_DESCR
 /begin AXIS_DESCR COM_AXIS MAF _CNV_A_R_LINEAR_____18_CM 8 0. 1389. FORMAT "%4.0" AXIS_PTS_REF ldpm_maf_6 /end AXIS_DESCR
/end CHARACTERISTIC
/begin CHARACTERISTIC IP_TI_FAC_POS_SLOW_WF__N__MAF "load correction slow wall film positive" MAP 0x50a04 _REC_MAP_20_u1_u1_u1 1.9921875 _CNV_A_R_LINEAR_____103_CM 0. 1.9921875 FORMAT "%5.3"
 /begin AXIS_DESCR COM_AXIS N_32 _CNV_A_R_LINEAR_____5_CM 8 0. 8160. FORMAT "%4.0" AXIS_PTS_REF ldpm_n_29 /end AXIS_DESCR
 /begin AXIS_DESCR COM_AXIS MAF _CNV_A_R_LINEAR_____18_CM 8 0. 1389. FORMAT "%4.0" AXIS_PTS_REF ldpm_maf_6 /end AXIS_DESCR
/end CHARACTERISTIC
/begin CHARACTERISTIC IP_TI_FAST_WF_THD__TIB "threshold for fast wall film correction" CURVE 0x4bb0c _REC_CUR_20_u2_u2 262.14 _CNV_A_R_LINEAR_____208_CM 0. 262.14 FORMAT "%7.3"
 /begin AXIS_DESCR COM_AXIS TIB _CNV_A_R_LINEAR_____208_CM 4 0. 262.14 FORMAT "%7.3" AXIS_PTS_REF ldpm_tib_ti_wf_thd /end AXIS_DESCR
/end CHARACTERISTIC
/begin CHARACTERISTIC IP_TI_SLOW_WF_THD__TIB "threshold for slow wall film correction" CURVE 0x4bb14 _REC_CUR_20_u2_u2 262.14 _CNV_A_R_LINEAR_____208_CM 0. 262.14 FORMAT "%7.3"
 /begin AXIS_DESCR COM_AXIS TIB _CNV_A_R_LINEAR_____208_CM 4 0. 262.14 FORMAT "%7.3" AXIS_PTS_REF ldpm_tib_ti_wf_thd /end AXIS_DESCR
/end CHARACTERISTIC
/begin CHARACTERISTIC IP_TI_TCO_NEG_FAST_WF__N__TCO "fast negative wall film factor" MAP 0x50a79 _REC_MAP_20_u1_u1_u1 127.5 _CNV_A_R_LINEAR_____411_CM 0. 127.5 FORMAT "%5.1"
 /begin AXIS_DESCR COM_AXIS N_32 _CNV_A_R_LINEAR_____5_CM 8 0. 8160. FORMAT "%4.0" AXIS_PTS_REF ldpm_n_29 /end AXIS_DESCR
 /begin AXIS_DESCR COM_AXIS TCO _CNV_A_R_LINEAR_____0_CM 8 -48. 142.5 FORMAT "%5.1" AXIS_PTS_REF ldpm_tco_15 /end AXIS_DESCR
/end CHARACTERISTIC
/begin CHARACTERISTIC IP_TI_TCO_NEG_SLOW_WF__N__TCO "total negativewall film factor" MAP 0x50ab9 _REC_MAP_20_u1_u1_u1 127.5 _CNV_A_R_LINEAR_____411_CM 0. 127.5 FORMAT "%5.1"
 /begin AXIS_DESCR COM_AXIS N_32 _CNV_A_R_LINEAR_____5_CM 8 0. 8160. FORMAT "%4.0" AXIS_PTS_REF ldpm_n_29 /end AXIS_DESCR
 /begin AXIS_DESCR COM_AXIS TCO _CNV_A_R_LINEAR_____0_CM 8 -48. 142.5 FORMAT "%5.1" AXIS_PTS_REF ldpm_tco_15 /end AXIS_DESCR
/end CHARACTERISTIC
/begin CHARACTERISTIC IP_TI_TCO_POS_FAST_WF__N__TCO "fast positive wall film factor" MAP 0x50af9 _REC_MAP_20_u1_u1_u1 127.5 _CNV_A_R_LINEAR_____411_CM 0. 127.5 FORMAT "%5.1"
 /begin AXIS_DESCR COM_AXIS N_32 _CNV_A_R_LINEAR_____5_CM 8 0. 8160. FORMAT "%4.0" AXIS_PTS_REF ldpm_n_29 /end AXIS_DESCR
 /begin AXIS_DESCR COM_AXIS TCO _CNV_A_R_LINEAR_____0_CM 8 -48. 142.5 FORMAT "%5.1" AXIS_PTS_REF ldpm_tco_15 /end AXIS_DESCR
/end CHARACTERISTIC
/begin CHARACTERISTIC IP_TI_TCO_POS_SLOW_WF__N__TCO "total positive wall film factor" MAP 0x50b39 _REC_MAP_20_u1_u1_u1 127.5 _CNV_A_R_LINEAR_____411_CM 0. 127.5 FORMAT "%5.1"
 /begin AXIS_DESCR COM_AXIS N_32 _CNV_A_R_LINEAR_____5_CM 8 0. 8160. FORMAT "%4.0" AXIS_PTS_REF ldpm_n_29 /end AXIS_DESCR
 /begin AXIS_DESCR COM_AXIS TCO _CNV_A_R_LINEAR_____0_CM 8 -48. 142.5 FORMAT "%5.1" AXIS_PTS_REF ldpm_tco_15 /end AXIS_DESCR
/end CHARACTERISTIC
/begin CHARACTERISTIC IP_TI_TCO_ST_FAC_WF__TCO_ST "TCO_ST depending factor for first tip in" CURVE 0x50b79 _REC_CUR_20_u1_u1 0.9960940000000002 _CNV_A_R_LINEAR_____44_CM 0. 0.996094 FORMAT "%5.3"
 /begin AXIS_DESCR COM_AXIS TCO_ST _CNV_A_R_LINEAR_____0_CM 4 -48. 142.5 FORMAT "%5.1" AXIS_PTS_REF ldp_tco_st_ti_fac_wf /end AXIS_DESCR
/end CHARACTERISTIC
/begin CHARACTERISTIC IP_TI_VO_FAST_WF__VO "VO-dependent wall film amount correction factor for fast compensation" CURVE 0x50b95 _REC_CUR_20_u1_u1 1.99220002 _CNV_A_R_LINEAR_____34_CM 0. 1.99220002 FORMAT "%5.3"
 /begin AXIS_DESCR COM_AXIS VO _CNV_A_R_LINEAR_____75_CM 8 0. 95.625 FORMAT "%4.1" AXIS_PTS_REF ldpm_vo_1 /end AXIS_DESCR
/end CHARACTERISTIC
/begin MEASUREMENT TI_ADD_WF "Total amount of wall film compensation" SWORD _CNV_A_R_LINEAR_____208_CM 1 100. -131.072 131.068 ECU_ADDRESS 0x3fcf48 /end MEASUREMENT
/begin MEASUREMENT TI_FAST_WF_POST_THD "Fast term of wall film compensation" SWORD _CNV_A_R_LINEAR_____208_CM 1 100. -131.072 131.068 ECU_ADDRESS 0x3fe4c2 FORMAT "%8.3" /end MEASUREMENT
/begin CHARACTERISTIC C_FAC_WF_PU "transposition factor for PU" VALUE 0x428c6 _REC_VAL_20_u1 0.9960940000000002 _CNV_A_R_LINEAR_____44_CM 0. 0.996094 FORMAT "%5.3" /end CHARACTERISTIC
/begin CHARACTERISTIC IP_TI_FAC_POS_FAST_WF__N__MAF "load correction fast wall film positive" MAP 0x509c4 _REC_MAP_20_u1_u1_u1 1.9921875 _CNV_A_R_LINEAR_____103_CM 0. 1.9921875 FORMAT "%5.3"
 /begin AXIS_DESCR COM_AXIS N_32 _CNV_A_R_LINEAR_____5_CM 8 0. 8160. FORMAT "%4.0" AXIS_PTS_REF ldpm_n_29 /end AXIS_DESCR
 /begin AXIS_DESCR COM_AXIS MAF _CNV_A_R_LINEAR_____18_CM 8 0. 1389. FORMAT "%4.0" AXIS_PTS_REF ldpm_maf_6 /end AXIS_DESCR
/end CHARACTERISTIC
/begin CHARACTERISTIC C_SEG_CTR_WF_INI "initial value for number of segments after start with increased pos. wall film compensation" VALUE 0x42f36 _REC_VAL_20_u2 65535. _CNV_A_R_LINEAR_____10_CM 0. 65535. FORMAT "%5.0" /end CHARACTERISTIC
/begin AXIS_PTS ldp_seg_ctr_fac_wf "" 0x44a28 SEG_CTR_FAC_WF _REC_AXS_20_u2 65535. _CNV_A_R_LINEAR_____178_CM 4 0. 65535. FORMAT "%5.0" /end AXIS_PTS
/begin AXIS_PTS ldp_tco_st_ti_fac_wf "" 0x43984 TCO_ST _REC_AXS_20_u1 190.5 _CNV_A_R_LINEAR_____0_CM 4 -48. 142.5 FORMAT "%5.1" /end AXIS_PTS
/begin AXIS_PTS ldp_tco_ti_wf_thd "" 0x43999 TCO _REC_AXS_20_u1 28.575 _CNV_A_R_LINEAR_____0_CM 4 -48. 142.5 FORMAT "%5.1" /end AXIS_PTS
/begin AXIS_PTS ldpm_maf_6 "" 0x43c3b MAF _REC_AXS_20_u1 1389. _CNV_A_R_LINEAR_____18_CM 8 0. 1389. FORMAT "%4.0" /end AXIS_PTS
/begin AXIS_PTS ldpm_n_29 "" 0x43cb2 N_32 _REC_AXS_20_u1 8160. _CNV_A_R_LINEAR_____5_CM 8 0. 8160. FORMAT "%4.0" /end AXIS_PTS
/begin AXIS_PTS ldpm_tco_15 "" 0x43f35 TCO _REC_AXS_20_u1 190.5 _CNV_A_R_LINEAR_____0_CM 8 -48. 142.5 FORMAT "%5.1" /end AXIS_PTS
/begin AXIS_PTS ldpm_tib_ti_wf_thd "" 0x455ac TIB _REC_AXS_20_u2 262.14 _CNV_A_R_LINEAR_____208_CM 4 0. 262.14 FORMAT "%7.3" /end AXIS_PTS
/begin AXIS_PTS ldpm_vo_1 "" 0x440ae VO _REC_AXS_20_u1 95.625 _CNV_A_R_LINEAR_____75_CM 8 0. 95.625 FORMAT "%4.1" /end AXIS_PTS
/begin MEASUREMENT TI_SLOW_WF_POST_THD "Slow term of wall film compensation" SWORD _CNV_A_R_LINEAR_____208_CM 1 100. -131.072 131.068 ECU_ADDRESS 0x3fe4c4 FORMAT "%8.3" /end MEASUREMENT
/begin MEASUREMENT TI_MAF_SP_WF "Air mass flow setpoint term of wall film compensation" SWORD _CNV_A_R_LINEAR_____208_CM 1 100. -131.072 131.068 ECU_ADDRESS 0x3fe4b0 FORMAT "%8.3" /end MEASUREMENT
/begin CHARACTERISTIC IP_TI_VO_SLOW_WF__VO "VO-dependent wall film amount correction factor for slow compensation" CURVE 0x50ba5 _REC_CUR_20_u1_u1 1.99220002 _CNV_A_R_LINEAR_____34_CM 0. 1.99220002 FORMAT "%5.3"
 /begin AXIS_DESCR COM_AXIS VO _CNV_A_R_LINEAR_____75_CM 8 0. 95.625 FORMAT "%4.1" AXIS_PTS_REF ldpm_vo_1 /end AXIS_DESCR
/end CHARACTERISTIC
/begin CHARACTERISTIC IP_TI_VO_MAF_SP_WF__VO "VO-dependent wall film amount correction factor for air mass flow setpoint triggered compensation" CURVE 0x50b9d _REC_CUR_20_u1_u1 1.99220002 _CNV_A_R_LINEAR_____34_CM 0. 1.99220002 FORMAT "%5.3"
 /begin AXIS_DESCR COM_AXIS VO _CNV_A_R_LINEAR_____75_CM 8 0. 95.625 FORMAT "%4.1" AXIS_PTS_REF ldpm_vo_1 /end AXIS_DESCR
/end CHARACTERISTIC
/begin AXIS_PTS ldp_maf_sp_tqi "" 0x4469e MAF_SP_TQI _REC_AXS_20_u2 1389. _CNV_A_R_LINEAR_____95_CM 8 0. 1389. FORMAT "%7.2" /end AXIS_PTS
/begin CHARACTERISTIC IP_TI_COR_MAF_SP_WF "injection correction due to air mass flow setpoint triggered wallfilm" MAP 0x4ba78 _REC_MAP_20_u2_u1_u2 262.14 _CNV_A_R_LINEAR_____434_CM -131.072 131.068 FORMAT "%6.2"
 /begin AXIS_DESCR COM_AXIS N_32 _CNV_A_R_LINEAR_____5_CM 8 0. 8160. FORMAT "%4.0" AXIS_PTS_REF ldpm_n_29 /end AXIS_DESCR
 /begin AXIS_DESCR COM_AXIS MAF_SP_TQI _CNV_A_R_LINEAR_____95_CM 8 0. 1389. FORMAT "%7.2" AXIS_PTS_REF ldp_maf_sp_tqi /end AXIS_DESCR
/end CHARACTERISTIC
/begin CHARACTERISTIC IP_FAC_TI_COR_MAF_SP_WF_POS "coolant temperature correction for air mass flow setpoint triggered wallfilm - positive (MAF_SP increasing)" CURVE 0x4e6c9 _REC_CUR_20_u1_u1 1.99220002 _CNV_A_R_LINEAR_____34_CM 0. 1.99220002 FORMAT "%5.3"
 /begin AXIS_DESCR COM_AXIS TCO _CNV_A_R_LINEAR_____0_CM 8 -48. 142.5 FORMAT "%5.1" AXIS_PTS_REF ldpm_tco_15 /end AXIS_DESCR
/end CHARACTERISTIC
/begin CHARACTERISTIC IP_FAC_TI_COR_MAF_SP_WF_NEG "coolant temperature correction for air mass flow setpoint triggered wallfilm - negative (MAF_SP decreasing)" CURVE 0x4e6c1 _REC_CUR_20_u1_u1 1.99220002 _CNV_A_R_LINEAR_____34_CM 0. 1.99220002 FORMAT "%5.3"
 /begin AXIS_DESCR COM_AXIS TCO _CNV_A_R_LINEAR_____0_CM 8 -48. 142.5 FORMAT "%5.1" AXIS_PTS_REF ldpm_tco_15 /end AXIS_DESCR
/end CHARACTERISTIC
/begin CHARACTERISTIC IP_CRLC_POS_MAF_SP_WF "correlation constant for air mass flow setpoint triggered wallfilm - positive (MAF_SP increasing)" CURVE 0x4da4b _REC_CUR_20_u1_u1 0.4980468800000001 _CNV_A_R_LINEAR_____439_CM 0. 0.49804688 FORMAT "%5.3"
 /begin AXIS_DESCR COM_AXIS N_32 _CNV_A_R_LINEAR_____5_CM 8 0. 8160. FORMAT "%4.0" AXIS_PTS_REF ldpm_n_29 /end AXIS_DESCR
/end CHARACTERISTIC
/begin CHARACTERISTIC IP_CRLC_NEG_MAF_SP_WF "correlation constant for air mass flow setpoint triggered wallfilm - negative (MAF_SP decreasing)" CURVE 0x4da43 _REC_CUR_20_u1_u1 0.4980468800000001 _CNV_A_R_LINEAR_____439_CM 0. 0.49804688 FORMAT "%5.3"
 /begin AXIS_DESCR COM_AXIS N_32 _CNV_A_R_LINEAR_____5_CM 8 0. 8160. FORMAT "%4.0" AXIS_PTS_REF ldpm_n_29 /end AXIS_DESCR
/end CHARACTERISTIC
/begin CHARACTERISTIC IP_FAC_TI_WF "temperature correction for total wallfilm" MAP 0x4e711 _REC_MAP_20_u1_u1_u1 1.99220002 _CNV_A_R_LINEAR_____34_CM 0. 1.99220002 FORMAT "%5.3"
 /begin AXIS_DESCR COM_AXIS TCO _CNV_A_R_LINEAR_____0_CM 4 -48. 142.5 FORMAT "%5.1" AXIS_PTS_REF ldp_tco__fac_ti_wf /end AXIS_DESCR
 /begin AXIS_DESCR COM_AXIS TIA _CNV_A_R_LINEAR_____0_CM 4 -48. 142.5 FORMAT "%5.1" AXIS_PTS_REF ldp_tia__fac_ti_wf /end AXIS_DESCR
/end CHARACTERISTIC
/begin CHARACTERISTIC C_T_TI_TRA_PAS "time before activation of wall film correction" VALUE 0x42a2b _REC_VAL_20_u1 2.55 _CNV_A_R_LINEAR_____27_CM 0. 2.55 FORMAT "%4.2" /end CHARACTERISTIC
/begin CHARACTERISTIC C_THD_MAF_SP_WF "activation treshold for air mass flow setpoint triggered wallfilm" VALUE 0x43090 _REC_VAL_20_u2 1389. _CNV_A_R_LINEAR_____95_CM 0. 1389. FORMAT "%7.2" /end CHARACTERISTIC
/begin AXIS_PTS ldp_tia__fac_ti_wf "" 0x439bd TIA _REC_AXS_20_u1 190.5 _CNV_A_R_LINEAR_____0_CM 4 -48. 142.5 FORMAT "%5.1" /end AXIS_PTS
/begin AXIS_PTS ldp_tco__fac_ti_wf "" 0x43866 TCO _REC_AXS_20_u1 190.5 _CNV_A_R_LINEAR_____0_CM 4 -48. 142.5 FORMAT "%5.1" /end AXIS_PTS
/begin CHARACTERISTIC C_KNK_THD_MAX "Maximum knock threshold" VALUE 0x428f3 _REC_VAL_20_u1 4.998 _CNV_A_R_LINEAR_____38_CM 0. 4.998 FORMAT "%4.2" /end CHARACTERISTIC
/begin CHARACTERISTIC IGA_AD1_KNK_5__N__MAF "" MAP 0x3fec89 _REC_MAP_20_u1_u1_u1 48. _CNV_A_R_LINEAR_____204_CM -48. 0. READ_ONLY FORMAT "%6.2"
 /begin AXIS_DESCR COM_AXIS N_KNK _CNV_A_R_LINEAR_____5_CM 8 0. 8160. FORMAT "%4.0" AXIS_PTS_REF ldpm_n_iga_ad /end AXIS_DESCR
 /begin AXIS_DESCR COM_AXIS MAF_KNK _CNV_A_R_LINEAR_____18_CM 6 0. 1389. FORMAT "%7.2" AXIS_PTS_REF ldpm_maf_iga_ad /end AXIS_DESCR
/end CHARACTERISTIC
/begin CHARACTERISTIC IGA_AD1_KNK_4__N__MAF "" MAP 0x3fec59 _REC_MAP_20_u1_u1_u1 48. _CNV_A_R_LINEAR_____204_CM -48. 0. READ_ONLY FORMAT "%6.2"
 /begin AXIS_DESCR COM_AXIS N_KNK _CNV_A_R_LINEAR_____5_CM 8 0. 8160. FORMAT "%4.0" AXIS_PTS_REF ldpm_n_iga_ad /end AXIS_DESCR
 /begin AXIS_DESCR COM_AXIS MAF_KNK _CNV_A_R_LINEAR_____18_CM 6 0. 1389. FORMAT "%7.2" AXIS_PTS_REF ldpm_maf_iga_ad /end AXIS_DESCR
/end CHARACTERISTIC
/begin CHARACTERISTIC IGA_AD1_KNK_3__N__MAF "" MAP 0x3fec29 _REC_MAP_20_u1_u1_u1 48. _CNV_A_R_LINEAR_____204_CM -48. 0. READ_ONLY FORMAT "%6.2"
 /begin AXIS_DESCR COM_AXIS N_KNK _CNV_A_R_LINEAR_____5_CM 8 0. 8160. FORMAT "%4.0" AXIS_PTS_REF ldpm_n_iga_ad /end AXIS_DESCR
 /begin AXIS_DESCR COM_AXIS MAF_KNK _CNV_A_R_LINEAR_____18_CM 6 0. 1389. FORMAT "%7.2" AXIS_PTS_REF ldpm_maf_iga_ad /end AXIS_DESCR
/end CHARACTERISTIC
/begin CHARACTERISTIC IGA_AD1_KNK_2__N__MAF "" MAP 0x3febf9 _REC_MAP_20_u1_u1_u1 48. _CNV_A_R_LINEAR_____204_CM -48. 0. READ_ONLY FORMAT "%6.2"
 /begin AXIS_DESCR COM_AXIS N_KNK _CNV_A_R_LINEAR_____5_CM 8 0. 8160. FORMAT "%4.0" AXIS_PTS_REF ldpm_n_iga_ad /end AXIS_DESCR
 /begin AXIS_DESCR COM_AXIS MAF_KNK _CNV_A_R_LINEAR_____18_CM 6 0. 1389. FORMAT "%7.2" AXIS_PTS_REF ldpm_maf_iga_ad /end AXIS_DESCR
/end CHARACTERISTIC
/begin CHARACTERISTIC IGA_AD1_KNK_1__N__MAF "" MAP 0x3febc9 _REC_MAP_20_u1_u1_u1 48. _CNV_A_R_LINEAR_____204_CM -48. 0. READ_ONLY FORMAT "%6.2"
 /begin AXIS_DESCR COM_AXIS N_KNK _CNV_A_R_LINEAR_____5_CM 8 0. 8160. FORMAT "%4.0" AXIS_PTS_REF ldpm_n_iga_ad /end AXIS_DESCR
 /begin AXIS_DESCR COM_AXIS MAF_KNK _CNV_A_R_LINEAR_____18_CM 6 0. 1389. FORMAT "%7.2" AXIS_PTS_REF ldpm_maf_iga_ad /end AXIS_DESCR
/end CHARACTERISTIC
/begin CHARACTERISTIC IGA_AD1_KNK_0__N__MAF "" MAP 0x3feb99 _REC_MAP_20_u1_u1_u1 48. _CNV_A_R_LINEAR_____204_CM -48. 0. READ_ONLY FORMAT "%6.2"
 /begin AXIS_DESCR COM_AXIS N_KNK _CNV_A_R_LINEAR_____5_CM 8 0. 8160. FORMAT "%4.0" AXIS_PTS_REF ldpm_n_iga_ad /end AXIS_DESCR
 /begin AXIS_DESCR COM_AXIS MAF_KNK _CNV_A_R_LINEAR_____18_CM 6 0. 1389. FORMAT "%7.2" AXIS_PTS_REF ldpm_maf_iga_ad /end AXIS_DESCR
/end CHARACTERISTIC
/begin CHARACTERISTIC IP_IGA_BAS_RON_98__N__MAF "Basic ignition angle for RON 98" MAP 0x4ef4f _REC_MAP_20_u1_u2_u2 95.625 _CNV_A_R_LINEAR_____202_CM -35.625 60. FORMAT "%5.1"
 /begin AXIS_DESCR COM_AXIS N _CNV_A_R_LINEAR_____17_CM 20 0. 8160. FORMAT "%4.0" AXIS_PTS_REF ldpm_n_14 /end AXIS_DESCR
 /begin AXIS_DESCR COM_AXIS MAF _CNV_A_R_LINEAR_____95_CM 16 0. 1389. FORMAT "%7.2" AXIS_PTS_REF ldpm_maf_2 /end AXIS_DESCR
/end CHARACTERISTIC
/begin CHARACTERISTIC LC_IGA_MAN "Logical constant for stratified mode" VALUE 0x42b86 _REC_VAL_20_u1 1. _CNV_A_R_LINEAR_____12_CM 0. 1. FORMAT "%1.0" /end CHARACTERISTIC
/begin CHARACTERISTIC C_IGA_INI "Init value for ignition angle" VALUE 0x428e5 _REC_VAL_20_u1 95.625 _CNV_A_R_LINEAR_____202_CM -35.625 60. FORMAT "%5.1" /end CHARACTERISTIC
/begin CHARACTERISTIC C_IGA_AS_CYL_0 "Spark retard by application system cyl. 0" VALUE 0x43347 _REC_VAL_20_s1 4.78125 _CNV_A_R_LINEAR_____75_CM -48. 47.625 FORMAT "%5.1" /end CHARACTERISTIC
/begin CHARACTERISTIC C_IGA_AS_CYL_1 "Spark retard by application system cyl. 1" VALUE 0x43348 _REC_VAL_20_s1 4.78125 _CNV_A_R_LINEAR_____75_CM -48. 47.625 FORMAT "%5.1" /end CHARACTERISTIC
/begin CHARACTERISTIC C_IGA_AS_CYL_2 "Spark retard by application system cyl. 2" VALUE 0x43349 _REC_VAL_20_s1 4.78125 _CNV_A_R_LINEAR_____75_CM -48. 47.625 FORMAT "%5.1" /end CHARACTERISTIC
/begin CHARACTERISTIC C_IGA_AS_CYL_3 "Spark retard by application system cyl. 3" VALUE 0x4334a _REC_VAL_20_s1 4.78125 _CNV_A_R_LINEAR_____75_CM -48. 47.625 FORMAT "%5.1" /end CHARACTERISTIC
/begin CHARACTERISTIC C_IGA_AS_CYL_4 "Spark retard by application system cyl. 4" VALUE 0x4334b _REC_VAL_20_s1 4.78125 _CNV_A_R_LINEAR_____75_CM -48. 47.625 FORMAT "%5.1" /end CHARACTERISTIC
/begin CHARACTERISTIC C_IGA_AS_CYL_5 "Spark retard by application system cyl. 5" VALUE 0x4334c _REC_VAL_20_s1 4.78125 _CNV_A_R_LINEAR_____75_CM -48. 47.625 FORMAT "%5.1" /end CHARACTERISTIC
/begin CHARACTERISTIC C_IGA_AS "Spark retard by application system global" VALUE 0x43346 _REC_VAL_20_s1 95.625 _CNV_A_R_LINEAR_____75_CM -48. 47.625 FORMAT "%5.1" /end CHARACTERISTIC
/begin CHARACTERISTIC IPM_EFF_IGA__IGA_DIF "Basic Ignition Efficiency" CURVE 0x4cb70 _REC_CUR_20_u2_u1 1.99996948 _CNV_A_R_LINEAR_____45_CM 0. 1.99996948 FORMAT "%7.5"
 /begin AXIS_DESCR COM_AXIS IGA_DIF_MIN _CNV_A_R_LINEAR_____203_CM 16 0. -95.625 FORMAT "%5.1" AXIS_PTS_REF ldp_iga_dif_eff_iga /end AXIS_DESCR
/end CHARACTERISTIC
/begin CHARACTERISTIC C_IGA_MAN "Constant for stratified mode" VALUE 0x428e6 _REC_VAL_20_u1 95.625 _CNV_A_R_LINEAR_____202_CM -35.625 60. FORMAT "%5.1" /end CHARACTERISTIC
/begin AXIS_PTS ldpm_maf_iga_ad "" 0x43c7c MAF_KNK _REC_AXS_20_u1 1389. _CNV_A_R_LINEAR_____18_CM 6 0. 1389. FORMAT "%7.2" /end AXIS_PTS
/begin AXIS_PTS ldpm_n_iga_ad "" 0x43ec7 N_KNK _REC_AXS_20_u1 8160. _CNV_A_R_LINEAR_____5_CM 8 0. 8160. FORMAT "%4.0" /end AXIS_PTS
/begin AXIS_PTS ldpm_n_2_9 "" 0x43cbb N _REC_AXS_20_u1 8160. _CNV_A_R_LINEAR_____5_CM 16 0. 8160. FORMAT "%4.0" /end AXIS_PTS
/begin AXIS_PTS ldpm_ctr_km_can_1 "" 0x44edc CTR_KM_CAN _REC_AXS_20_u2 655350. _CNV_A_R_LINEAR_____80_CM 4 0. 655350. FORMAT "%7.0" /end AXIS_PTS
/begin AXIS_PTS ldpm_maf_knkwb "" 0x43ca0 MAF_KNK _REC_AXS_20_u1 1389. _CNV_A_R_LINEAR_____18_CM 4 0. 1389. FORMAT "%4.0" /end AXIS_PTS
/begin AXIS_PTS ldpm_n_knkwb "" 0x43ed9 N_KNK _REC_AXS_20_u1 8160. _CNV_A_R_LINEAR_____5_CM 10 0. 8160. FORMAT "%4.0" /end AXIS_PTS
/begin AXIS_PTS ldpm_n_fil_frq_knk "" 0x43ec2 N_KNK _REC_AXS_20_u1 8160. _CNV_A_R_LINEAR_____5_CM 4 0. 8160. FORMAT "%4.0" /end AXIS_PTS
/begin AXIS_PTS ldpm_maf_1_9 "" 0x43c36 MAF_KNK _REC_AXS_20_u1 69.45 _CNV_A_R_LINEAR_____18_CM 4 0. 1389. FORMAT "%4.0" /end AXIS_PTS
/begin AXIS_PTS ldpm_n_32_ip_egr_ratio "" 0x43e49 N_32 _REC_AXS_20_u1 8160. _CNV_A_R_LINEAR_____5_CM 12 0. 8160. FORMAT "%4.0" /end AXIS_PTS
/begin AXIS_PTS ldpm_maf_ip_egr_ratio "" 0x450ea MAF _REC_AXS_20_u2 1389. _CNV_A_R_LINEAR_____95_CM 12 0. 1389. FORMAT "%7.2" /end AXIS_PTS
/begin AXIS_PTS ldpm_tco_1_igsp "" 0x43f4e TCO _REC_AXS_20_u1 190.5 _CNV_A_R_LINEAR_____0_CM 8 -48. 142.5 FORMAT "%5.1" /end AXIS_PTS
/begin AXIS_PTS ldpm_n_14 "" 0x45202 N _REC_AXS_20_u2 8160. _CNV_A_R_LINEAR_____17_CM 20 0. 8160. FORMAT "%4.0" /end AXIS_PTS
/begin AXIS_PTS ldpm_maf_2 "" 0x4502a MAF _REC_AXS_20_u2 69.45 _CNV_A_R_LINEAR_____95_CM 16 0. 1389. FORMAT "%7.2" /end AXIS_PTS
/begin AXIS_PTS ldp_iga_dif_eff_iga "" 0x43436 IGA_DIF_REF _REC_AXS_20_u1 -95.625 _CNV_A_R_LINEAR_____203_CM 16 0. -95.625 FORMAT "%5.1" /end AXIS_PTS
/begin AXIS_PTS ldpm_n_1_thro "" 0x4523e N _REC_AXS_20_u2 8160. _CNV_A_R_LINEAR_____17_CM 8 0. 8160. FORMAT "%4.0" /end AXIS_PTS
/begin AXIS_PTS ldpm_tco_1_thro "" 0x43f64 TCO _REC_AXS_20_u1 190.5 _CNV_A_R_LINEAR_____0_CM 8 -48. 142.5 FORMAT "%5.1" /end AXIS_PTS
/begin AXIS_PTS ldpm_maf_100 "" 0x44fec MAF _REC_AXS_20_u2 1389. _CNV_A_R_LINEAR_____95_CM 12 0. 1389. FORMAT "%7.2" /end AXIS_PTS
/begin AXIS_PTS ldpm_n_32_100 "" 0x43cd3 N_32 _REC_AXS_20_u1 8160. _CNV_A_R_LINEAR_____5_CM 16 0. 8160. FORMAT "%4.0" /end AXIS_PTS
/begin MEASUREMENT EOI_HOM "end of injection for homogeneous combustion mode" UWORD _CNV_A_R_LINEAR_____75_CM 1 100. 0. 720. ECU_ADDRESS 0x3fbfc2 FORMAT "%6.2" /end MEASUREMENT
/begin CHARACTERISTIC ID_FIL_FRQ_KNK_1 "Knock Filter Frequency and Reference Filter Frequency Cyl.2" CURVE 0x4cd01 _REC_CUR_20_u1_u1 63. _CNV_A_R_LINEAR_____10_CM 0. 63. FORMAT "%2.0"
 /begin AXIS_DESCR COM_AXIS N_KNK _CNV_A_R_LINEAR_____5_CM 4 0. 8160. FORMAT "%4.0" AXIS_PTS_REF ldpm_n_fil_frq_knk /end AXIS_DESCR
/end CHARACTERISTIC
/begin CHARACTERISTIC ID_FIL_FRQ_KNK_2 "Knock Filter Frequency and Reference Filter Frequency Cyl.3" CURVE 0x4cd05 _REC_CUR_20_u1_u1 63. _CNV_A_R_LINEAR_____10_CM 0. 63. FORMAT "%2.0"
 /begin AXIS_DESCR COM_AXIS N_KNK _CNV_A_R_LINEAR_____5_CM 4 0. 8160. FORMAT "%4.0" AXIS_PTS_REF ldpm_n_fil_frq_knk /end AXIS_DESCR
/end CHARACTERISTIC
/begin CHARACTERISTIC ID_FIL_FRQ_KNK_3 "Knock Filter Frequency and Reference Filter Frequency Cyl.4" CURVE 0x4cd09 _REC_CUR_20_u1_u1 63. _CNV_A_R_LINEAR_____10_CM 0. 63. FORMAT "%2.0"
 /begin AXIS_DESCR COM_AXIS N_KNK _CNV_A_R_LINEAR_____5_CM 4 0. 8160. FORMAT "%4.0" AXIS_PTS_REF ldpm_n_fil_frq_knk /end AXIS_DESCR
/end CHARACTERISTIC
/begin MEASUREMENT KNKS_0 "" UWORD _CNV_A_R_LINEAR_____256_CM 1 100. 0. 4.99992371 ECU_ADDRESS 0x3fbfca FORMAT "%7.5" /end MEASUREMENT
/begin MEASUREMENT KNKS_1 "" UWORD _CNV_A_R_LINEAR_____256_CM 1 100. 0. 4.99992371 ECU_ADDRESS 0x3fbfcc FORMAT "%7.5" /end MEASUREMENT
/begin MEASUREMENT KNKS_2 "" UWORD _CNV_A_R_LINEAR_____256_CM 1 100. 0. 4.99992371 ECU_ADDRESS 0x3fbfce FORMAT "%7.5" /end MEASUREMENT
/begin MEASUREMENT KNKS_3 "" UWORD _CNV_A_R_LINEAR_____256_CM 1 100. 0. 4.99992371 ECU_ADDRESS 0x3fbfd0 FORMAT "%7.5" /end MEASUREMENT
/begin MEASUREMENT KNKS_4 "" UWORD _CNV_A_R_LINEAR_____256_CM 1 100. 0. 4.99992371 ECU_ADDRESS 0x3fbfd2 FORMAT "%7.5" /end MEASUREMENT
/begin MEASUREMENT KNKS_5 "" UWORD _CNV_A_R_LINEAR_____256_CM 1 100. 0. 4.99992371 ECU_ADDRESS 0x3fbfd4 FORMAT "%7.5" /end MEASUREMENT
/begin CHARACTERISTIC ID_FIL_FRQ_KNK_0 "Knock Filter Frequency and Reference Filter Frequency Cyl.1" CURVE 0x4ccfd _REC_CUR_20_u1_u1 63. _CNV_A_R_LINEAR_____10_CM 0. 63. FORMAT "%2.0"
 /begin AXIS_DESCR COM_AXIS N_KNK _CNV_A_R_LINEAR_____5_CM 4 0. 8160. FORMAT "%4.0" AXIS_PTS_REF ldpm_n_fil_frq_knk /end AXIS_DESCR
/end CHARACTERISTIC
/begin CHARACTERISTIC ID_FIL_FRQ_KNK_4 "Knock Filter Frequency and Reference Filter Frequency Cyl.5" CURVE 0x4cd0d _REC_CUR_20_u1_u1 63. _CNV_A_R_LINEAR_____10_CM 0. 63. FORMAT "%2.0"
 /begin AXIS_DESCR COM_AXIS N_KNK _CNV_A_R_LINEAR_____5_CM 4 0. 8160. FORMAT "%4.0" AXIS_PTS_REF ldpm_n_fil_frq_knk /end AXIS_DESCR
/end CHARACTERISTIC
/begin CHARACTERISTIC ID_FIL_FRQ_KNK_5 "Knock Filter Frequency and Reference Filter Frequency Cyl.6" CURVE 0x4cd11 _REC_CUR_20_u1_u1 63. _CNV_A_R_LINEAR_____10_CM 0. 63. FORMAT "%2.0"
 /begin AXIS_DESCR COM_AXIS N_KNK _CNV_A_R_LINEAR_____5_CM 4 0. 8160. FORMAT "%4.0" AXIS_PTS_REF ldpm_n_fil_frq_knk /end AXIS_DESCR
/end CHARACTERISTIC
/begin CHARACTERISTIC IP_KNKWB_2__N__MAF "Beginning of Measurement Window Cyl.3" MAP 0x48296 _REC_MAP_20_u2_u1_u1 108. _CNV_A_R_LINEAR_____75_CM 0. 108. FORMAT "%5.1"
 /begin AXIS_DESCR COM_AXIS N_KNK _CNV_A_R_LINEAR_____5_CM 10 0. 8160. FORMAT "%4.0" AXIS_PTS_REF ldpm_n_knkwb /end AXIS_DESCR
 /begin AXIS_DESCR COM_AXIS MAF_KNK _CNV_A_R_LINEAR_____18_CM 4 0. 1389. FORMAT "%4.0" AXIS_PTS_REF ldpm_maf_knkwb /end AXIS_DESCR
/end CHARACTERISTIC
/begin CHARACTERISTIC IP_KNKWB_3__N__MAF "Beginning of Measurement Window Cyl.4" MAP 0x482e6 _REC_MAP_20_u2_u1_u1 108. _CNV_A_R_LINEAR_____75_CM 0. 108. FORMAT "%5.1"
 /begin AXIS_DESCR COM_AXIS N_KNK _CNV_A_R_LINEAR_____5_CM 10 0. 8160. FORMAT "%4.0" AXIS_PTS_REF ldpm_n_knkwb /end AXIS_DESCR
 /begin AXIS_DESCR COM_AXIS MAF_KNK _CNV_A_R_LINEAR_____18_CM 4 0. 1389. FORMAT "%4.0" AXIS_PTS_REF ldpm_maf_knkwb /end AXIS_DESCR
/end CHARACTERISTIC
/begin CHARACTERISTIC IP_KNKWB_4__N__MAF "Beginning of Measurement Window Cyl.5" MAP 0x48336 _REC_MAP_20_u2_u1_u1 108. _CNV_A_R_LINEAR_____75_CM 0. 108. FORMAT "%5.1"
 /begin AXIS_DESCR COM_AXIS N_KNK _CNV_A_R_LINEAR_____5_CM 10 0. 8160. FORMAT "%4.0" AXIS_PTS_REF ldpm_n_knkwb /end AXIS_DESCR
 /begin AXIS_DESCR COM_AXIS MAF_KNK _CNV_A_R_LINEAR_____18_CM 4 0. 1389. FORMAT "%4.0" AXIS_PTS_REF ldpm_maf_knkwb /end AXIS_DESCR
/end CHARACTERISTIC
/begin CHARACTERISTIC IP_KNKWB_5__N__MAF "Beginning of Measurement Window Cyl.6" MAP 0x48386 _REC_MAP_20_u2_u1_u1 108. _CNV_A_R_LINEAR_____75_CM 0. 108. FORMAT "%5.1"
 /begin AXIS_DESCR COM_AXIS N_KNK _CNV_A_R_LINEAR_____5_CM 10 0. 8160. FORMAT "%4.0" AXIS_PTS_REF ldpm_n_knkwb /end AXIS_DESCR
 /begin AXIS_DESCR COM_AXIS MAF_KNK _CNV_A_R_LINEAR_____18_CM 4 0. 1389. FORMAT "%4.0" AXIS_PTS_REF ldpm_maf_knkwb /end AXIS_DESCR
/end CHARACTERISTIC
/begin CHARACTERISTIC IP_KNKWE_0__N__MAF "End of Measurement Window Cyl.1" MAP 0x483d6 _REC_MAP_20_u2_u1_u1 113.625 _CNV_A_R_LINEAR_____75_CM 0.375 114. FORMAT "%5.1"
 /begin AXIS_DESCR COM_AXIS N_KNK _CNV_A_R_LINEAR_____5_CM 10 0. 8160. FORMAT "%4.0" AXIS_PTS_REF ldpm_n_knkwb /end AXIS_DESCR
 /begin AXIS_DESCR COM_AXIS MAF_KNK _CNV_A_R_LINEAR_____18_CM 4 0. 1389. FORMAT "%4.0" AXIS_PTS_REF ldpm_maf_knkwb /end AXIS_DESCR
/end CHARACTERISTIC
/begin CHARACTERISTIC IP_KNKWE_1__N__MAF "End of Measurement Window Cyl.2" MAP 0x48426 _REC_MAP_20_u2_u1_u1 113.625 _CNV_A_R_LINEAR_____75_CM 0.375 114. FORMAT "%5.1"
 /begin AXIS_DESCR COM_AXIS N_KNK _CNV_A_R_LINEAR_____5_CM 10 0. 8160. FORMAT "%4.0" AXIS_PTS_REF ldpm_n_knkwb /end AXIS_DESCR
 /begin AXIS_DESCR COM_AXIS MAF_KNK _CNV_A_R_LINEAR_____18_CM 4 0. 1389. FORMAT "%4.0" AXIS_PTS_REF ldpm_maf_knkwb /end AXIS_DESCR
/end CHARACTERISTIC
/begin CHARACTERISTIC IP_KNKWE_2__N__MAF "End of Measurement Window Cyl.3" MAP 0x48476 _REC_MAP_20_u2_u1_u1 113.625 _CNV_A_R_LINEAR_____75_CM 0.375 114. FORMAT "%5.1"
 /begin AXIS_DESCR COM_AXIS N_KNK _CNV_A_R_LINEAR_____5_CM 10 0. 8160. FORMAT "%4.0" AXIS_PTS_REF ldpm_n_knkwb /end AXIS_DESCR
 /begin AXIS_DESCR COM_AXIS MAF_KNK _CNV_A_R_LINEAR_____18_CM 4 0. 1389. FORMAT "%4.0" AXIS_PTS_REF ldpm_maf_knkwb /end AXIS_DESCR
/end CHARACTERISTIC
/begin CHARACTERISTIC IP_KNKWE_3__N__MAF "End of Measurement Window Cyl.4" MAP 0x484c6 _REC_MAP_20_u2_u1_u1 113.625 _CNV_A_R_LINEAR_____75_CM 0.375 114. FORMAT "%5.1"
 /begin AXIS_DESCR COM_AXIS N_KNK _CNV_A_R_LINEAR_____5_CM 10 0. 8160. FORMAT "%4.0" AXIS_PTS_REF ldpm_n_knkwb /end AXIS_DESCR
 /begin AXIS_DESCR COM_AXIS MAF_KNK _CNV_A_R_LINEAR_____18_CM 4 0. 1389. FORMAT "%4.0" AXIS_PTS_REF ldpm_maf_knkwb /end AXIS_DESCR
/end CHARACTERISTIC
/begin CHARACTERISTIC IP_KNKWE_4__N__MAF "End of Measurement Window Cyl.5" MAP 0x48516 _REC_MAP_20_u2_u1_u1 113.625 _CNV_A_R_LINEAR_____75_CM 0.375 114. FORMAT "%5.1"
 /begin AXIS_DESCR COM_AXIS N_KNK _CNV_A_R_LINEAR_____5_CM 10 0. 8160. FORMAT "%4.0" AXIS_PTS_REF ldpm_n_knkwb /end AXIS_DESCR
 /begin AXIS_DESCR COM_AXIS MAF_KNK _CNV_A_R_LINEAR_____18_CM 4 0. 1389. FORMAT "%4.0" AXIS_PTS_REF ldpm_maf_knkwb /end AXIS_DESCR
/end CHARACTERISTIC
/begin CHARACTERISTIC IP_KNKWE_5__N__MAF "End of Measurement Window Cyl.6" MAP 0x48566 _REC_MAP_20_u2_u1_u1 113.625 _CNV_A_R_LINEAR_____75_CM 0.375 114. FORMAT "%5.1"
 /begin AXIS_DESCR COM_AXIS N_KNK _CNV_A_R_LINEAR_____5_CM 10 0. 8160. FORMAT "%4.0" AXIS_PTS_REF ldpm_n_knkwb /end AXIS_DESCR
 /begin AXIS_DESCR COM_AXIS MAF_KNK _CNV_A_R_LINEAR_____18_CM 4 0. 1389. FORMAT "%4.0" AXIS_PTS_REF ldpm_maf_knkwb /end AXIS_DESCR
/end CHARACTERISTIC
/begin CHARACTERISTIC IP_GAIN_KNK_0__N__MAF "Amplification precontrol Cyl.1" MAP 0x4e7f1 _REC_MAP_20_u1_u1_u1 63. _CNV_A_R_LINEAR_____10_CM 0. 63. FORMAT "%2.0"
 /begin AXIS_DESCR COM_AXIS N_KNK _CNV_A_R_LINEAR_____5_CM 16 0. 8160. FORMAT "%4.0" AXIS_PTS_REF ldpm_n_2_9 /end AXIS_DESCR
 /begin AXIS_DESCR COM_AXIS MAF_KNK _CNV_A_R_LINEAR_____18_CM 4 0. 1389. FORMAT "%4.0" AXIS_PTS_REF ldpm_maf_1_9 /end AXIS_DESCR
/end CHARACTERISTIC
/begin CHARACTERISTIC IP_GAIN_KNK_2__N__MAF "Amplification precontrol Cyl.3" MAP 0x4e871 _REC_MAP_20_u1_u1_u1 63. _CNV_A_R_LINEAR_____10_CM 0. 63. FORMAT "%2.0"
 /begin AXIS_DESCR COM_AXIS N_KNK _CNV_A_R_LINEAR_____5_CM 16 0. 8160. FORMAT "%4.0" AXIS_PTS_REF ldpm_n_2_9 /end AXIS_DESCR
 /begin AXIS_DESCR COM_AXIS MAF_KNK _CNV_A_R_LINEAR_____18_CM 4 0. 1389. FORMAT "%4.0" AXIS_PTS_REF ldpm_maf_1_9 /end AXIS_DESCR
/end CHARACTERISTIC
/begin CHARACTERISTIC IP_GAIN_KNK_3__N__MAF "Amplification precontrol Cyl.4" MAP 0x4e8b1 _REC_MAP_20_u1_u1_u1 63. _CNV_A_R_LINEAR_____10_CM 0. 63. FORMAT "%2.0"
 /begin AXIS_DESCR COM_AXIS N_KNK _CNV_A_R_LINEAR_____5_CM 16 0. 8160. FORMAT "%4.0" AXIS_PTS_REF ldpm_n_2_9 /end AXIS_DESCR
 /begin AXIS_DESCR COM_AXIS MAF_KNK _CNV_A_R_LINEAR_____18_CM 4 0. 1389. FORMAT "%4.0" AXIS_PTS_REF ldpm_maf_1_9 /end AXIS_DESCR
/end CHARACTERISTIC
/begin CHARACTERISTIC IP_GAIN_KNK_4__N__MAF "Amplification precontrol Cyl.5" MAP 0x4e8f1 _REC_MAP_20_u1_u1_u1 63. _CNV_A_R_LINEAR_____10_CM 0. 63. FORMAT "%2.0"
 /begin AXIS_DESCR COM_AXIS N_KNK _CNV_A_R_LINEAR_____5_CM 16 0. 8160. FORMAT "%4.0" AXIS_PTS_REF ldpm_n_2_9 /end AXIS_DESCR
 /begin AXIS_DESCR COM_AXIS MAF_KNK _CNV_A_R_LINEAR_____18_CM 4 0. 1389. FORMAT "%4.0" AXIS_PTS_REF ldpm_maf_1_9 /end AXIS_DESCR
/end CHARACTERISTIC
/begin CHARACTERISTIC IP_GAIN_KNK_5__N__MAF "Amplification precontrol Cyl.6" MAP 0x4e931 _REC_MAP_20_u1_u1_u1 63. _CNV_A_R_LINEAR_____10_CM 0. 63. FORMAT "%2.0"
 /begin AXIS_DESCR COM_AXIS N_KNK _CNV_A_R_LINEAR_____5_CM 16 0. 8160. FORMAT "%4.0" AXIS_PTS_REF ldpm_n_2_9 /end AXIS_DESCR
 /begin AXIS_DESCR COM_AXIS MAF_KNK _CNV_A_R_LINEAR_____18_CM 4 0. 1389. FORMAT "%4.0" AXIS_PTS_REF ldpm_maf_1_9 /end AXIS_DESCR
/end CHARACTERISTIC
/begin CHARACTERISTIC IP_ITC_KNK_0__N__MAF "Integration time constant Cyl.1" MAP 0x4f6a4 _REC_MAP_20_u1_u1_u1 31. _CNV_A_R_LINEAR_____10_CM 0. 31. FORMAT "%2.0"
 /begin AXIS_DESCR COM_AXIS N_KNK _CNV_A_R_LINEAR_____5_CM 16 0. 8160. FORMAT "%4.0" AXIS_PTS_REF ldpm_n_2_9 /end AXIS_DESCR
 /begin AXIS_DESCR COM_AXIS MAF_KNK _CNV_A_R_LINEAR_____18_CM 4 0. 1389. FORMAT "%4.0" AXIS_PTS_REF ldpm_maf_1_9 /end AXIS_DESCR
/end CHARACTERISTIC
/begin CHARACTERISTIC IP_ITC_KNK_1__N__MAF "Integration time constant Cyl.2" MAP 0x4f6e4 _REC_MAP_20_u1_u1_u1 31. _CNV_A_R_LINEAR_____10_CM 0. 31. FORMAT "%2.0"
 /begin AXIS_DESCR COM_AXIS N_KNK _CNV_A_R_LINEAR_____5_CM 16 0. 8160. FORMAT "%4.0" AXIS_PTS_REF ldpm_n_2_9 /end AXIS_DESCR
 /begin AXIS_DESCR COM_AXIS MAF_KNK _CNV_A_R_LINEAR_____18_CM 4 0. 1389. FORMAT "%4.0" AXIS_PTS_REF ldpm_maf_1_9 /end AXIS_DESCR
/end CHARACTERISTIC
/begin CHARACTERISTIC IP_ITC_KNK_2__N__MAF "Integration time constant Cyl.3" MAP 0x4f724 _REC_MAP_20_u1_u1_u1 31. _CNV_A_R_LINEAR_____10_CM 0. 31. FORMAT "%2.0"
 /begin AXIS_DESCR COM_AXIS N_KNK _CNV_A_R_LINEAR_____5_CM 16 0. 8160. FORMAT "%4.0" AXIS_PTS_REF ldpm_n_2_9 /end AXIS_DESCR
 /begin AXIS_DESCR COM_AXIS MAF_KNK _CNV_A_R_LINEAR_____18_CM 4 0. 1389. FORMAT "%4.0" AXIS_PTS_REF ldpm_maf_1_9 /end AXIS_DESCR
/end CHARACTERISTIC
/begin CHARACTERISTIC IP_ITC_KNK_3__N__MAF "Integration time constant Cyl.4" MAP 0x4f764 _REC_MAP_20_u1_u1_u1 31. _CNV_A_R_LINEAR_____10_CM 0. 31. FORMAT "%2.0"
 /begin AXIS_DESCR COM_AXIS N_KNK _CNV_A_R_LINEAR_____5_CM 16 0. 8160. FORMAT "%4.0" AXIS_PTS_REF ldpm_n_2_9 /end AXIS_DESCR
 /begin AXIS_DESCR COM_AXIS MAF_KNK _CNV_A_R_LINEAR_____18_CM 4 0. 1389. FORMAT "%4.0" AXIS_PTS_REF ldpm_maf_1_9 /end AXIS_DESCR
/end CHARACTERISTIC
/begin CHARACTERISTIC IP_ITC_KNK_4__N__MAF "Integration time constant Cyl.5" MAP 0x4f7a4 _REC_MAP_20_u1_u1_u1 31. _CNV_A_R_LINEAR_____10_CM 0. 31. FORMAT "%2.0"
 /begin AXIS_DESCR COM_AXIS N_KNK _CNV_A_R_LINEAR_____5_CM 16 0. 8160. FORMAT "%4.0" AXIS_PTS_REF ldpm_n_2_9 /end AXIS_DESCR
 /begin AXIS_DESCR COM_AXIS MAF_KNK _CNV_A_R_LINEAR_____18_CM 4 0. 1389. FORMAT "%4.0" AXIS_PTS_REF ldpm_maf_1_9 /end AXIS_DESCR
/end CHARACTERISTIC
/begin CHARACTERISTIC IP_ITC_KNK_5__N__MAF "Integration time constant Cyl.6" MAP 0x4f7e4 _REC_MAP_20_u1_u1_u1 31. _CNV_A_R_LINEAR_____10_CM 0. 31. FORMAT "%2.0"
 /begin AXIS_DESCR COM_AXIS N_KNK _CNV_A_R_LINEAR_____5_CM 16 0. 8160. FORMAT "%4.0" AXIS_PTS_REF ldpm_n_2_9 /end AXIS_DESCR
 /begin AXIS_DESCR COM_AXIS MAF_KNK _CNV_A_R_LINEAR_____18_CM 4 0. 1389. FORMAT "%4.0" AXIS_PTS_REF ldpm_maf_1_9 /end AXIS_DESCR
/end CHARACTERISTIC
/begin CHARACTERISTIC IP_KNKWB_0__N__MAF "Beginning of Measurement Window Cyl.1" MAP 0x481f6 _REC_MAP_20_u2_u1_u1 108. _CNV_A_R_LINEAR_____75_CM 0. 108. FORMAT "%5.1"
 /begin AXIS_DESCR COM_AXIS N_KNK _CNV_A_R_LINEAR_____5_CM 10 0. 8160. FORMAT "%4.0" AXIS_PTS_REF ldpm_n_knkwb /end AXIS_DESCR
 /begin AXIS_DESCR COM_AXIS MAF_KNK _CNV_A_R_LINEAR_____18_CM 4 0. 1389. FORMAT "%4.0" AXIS_PTS_REF ldpm_maf_knkwb /end AXIS_DESCR
/end CHARACTERISTIC
/begin AXIS_PTS ldp_val_mo3_x "" 0x43aa0 VAL_MO3_X _REC_AXS_20_u1 255. _CNV_A_R_LINEAR_____10_CM 4 0. 255. FORMAT "%3.0" /end AXIS_PTS
/begin AXIS_PTS ldp_val_mo3_y "" 0x43aa5 VAL_MO3_Y _REC_AXS_20_u1 255. _CNV_A_R_LINEAR_____10_CM 10 0. 255. FORMAT "%3.0" /end AXIS_PTS
/begin MEASUREMENT LV_MPL_IGA_ACT "Status for multiple advance active" UBYTE _CNV_S_2_RANGE______11_CM 1 100. 0. 1. ECU_ADDRESS 0x3fce40 BIT_MASK 0x1 /end MEASUREMENT
/begin MEASUREMENT TD_MPL_DLY "Spark duration" UBYTE _CNV_A_R_LINEAR_____208_CM 1 100. 0. 1.02 ECU_ADDRESS 0x3fe364 FORMAT "%5.3" /end MEASUREMENT
/begin MEASUREMENT TD_MPL "Dwell time with multiple spark" UWORD _CNV_A_R_LINEAR_____208_CM 1 100. 0. 50. ECU_ADDRESS 0x3fe362 FORMAT "%7.4" /end MEASUREMENT
/begin MEASUREMENT IGN_MPL_NR "Number of maximum allowed multiple sparks" UBYTE _CNV_A_R_LINEAR_____10_CM 1 100. 0. 255. ECU_ADDRESS 0x3fe365 FORMAT "%3.0" /end MEASUREMENT
/begin CHARACTERISTIC C_TCO_MAX_MPL_IS "Max. Coolant Temp. at start to have multiple spark during idle" VALUE 0x42a5f _REC_VAL_20_u1 190.5 _CNV_A_R_LINEAR_____0_CM -48. 142.5 FORMAT "%5.1" /end CHARACTERISTIC
/begin CHARACTERISTIC C_TCO_MAX_MPL_ST "Max. Coolant Temp. at start to have multiple spark during engine start" VALUE 0x42a60 _REC_VAL_20_u1 190.5 _CNV_A_R_LINEAR_____0_CM -48. 142.5 FORMAT "%5.1" /end CHARACTERISTIC
/begin CHARACTERISTIC C_VB_MAX_MPL "Max. Battery voltage to have multiple spark (requested valve 16V)" VALUE 0x42b09 _REC_VAL_20_u1 25.8984 _CNV_A_R_LINEAR_____26_CM 0. 25.8984 FORMAT "%3.1" /end CHARACTERISTIC
/begin CHARACTERISTIC C_TD_T_MPL "Minimum time between two ignition" VALUE 0x42a92 _REC_VAL_20_u1 1.02 _CNV_A_R_LINEAR_____208_CM 0. 1.02 FORMAT "%5.3" /end CHARACTERISTIC
/begin CHARACTERISTIC C_N_MAX_IGN_MPL "Maximum engine speed for multipla spark at idle" VALUE 0x42953 _REC_VAL_20_u1 408. _CNV_A_R_LINEAR_____5_CM 0. 8160. FORMAT "%4.0" /end CHARACTERISTIC
/begin CHARACTERISTIC IP_NR_MPL_ST "Dwell time for multiple spark" CURVE 0x4fd07 _REC_CUR_20_u1_u1 255. _CNV_A_R_LINEAR_____10_CM 0. 255. FORMAT "%3.0"
 /begin AXIS_DESCR COM_AXIS TCO _CNV_A_R_LINEAR_____0_CM 8 -48. 142.5 FORMAT "%5.1" AXIS_PTS_REF ldp_tco__nr_mpl_st /end AXIS_DESCR
/end CHARACTERISTIC
/begin CHARACTERISTIC IP_NR_MPL_IS "Number of successive ignition sparks for idle" CURVE 0x4fcff _REC_CUR_20_u1_u1 255. _CNV_A_R_LINEAR_____10_CM 0. 255. FORMAT "%3.0"
 /begin AXIS_DESCR COM_AXIS TCO _CNV_A_R_LINEAR_____0_CM 8 -48. 142.5 FORMAT "%5.1" AXIS_PTS_REF ldp_tco__nr_mpl_is /end AXIS_DESCR
/end CHARACTERISTIC
/begin AXIS_PTS ldp_tco__nr_mpl_st "" 0x438c0 TCO _REC_AXS_20_u1 190.5 _CNV_A_R_LINEAR_____0_CM 8 -48. 142.5 FORMAT "%5.1" /end AXIS_PTS
/begin AXIS_PTS ldp_tco__nr_mpl_is "" 0x438b7 TCO _REC_AXS_20_u1 190.5 _CNV_A_R_LINEAR_____0_CM 8 -48. 142.5 FORMAT "%5.1" /end AXIS_PTS
/begin CHARACTERISTIC IP_TD_MPL "Dwell time for multiple spark" CURVE 0x4b1fc _REC_CUR_20_u2_u2 50. _CNV_A_R_LINEAR_____208_CM 0. 50. FORMAT "%7.4"
 /begin AXIS_DESCR COM_AXIS VB _CNV_A_R_LINEAR_____210_CM 8 0. 28.7055 FORMAT "%5.2" AXIS_PTS_REF ldpm_vb__td /end AXIS_DESCR
/end CHARACTERISTIC
/begin AXIS_PTS ldpm_vb__td "" 0x4560e VB _REC_AXS_20_u2 28.7055 _CNV_A_R_LINEAR_____210_CM 8 0. 28.7055 FORMAT "%5.2" /end AXIS_PTS
/begin COMPU_METHOD _CNV_A_R_LINEAR_____0_CM "" RAT_FUNC "%6.3" "°C" COEFFS 0 1.333333333333333 64. 0 0 1 /end COMPU_METHOD
/begin COMPU_METHOD _CNV_A_R_LINEAR_____3_CM "" RAT_FUNC "%6.3" "°C" COEFFS 0 1. 40. 0 0 1 /end COMPU_METHOD
/begin COMPU_METHOD _CNV_A_R_LINEAR_____4_CM "" RAT_FUNC "%6.3" "%" COEFFS 0 2.56 0. 0 0 1 /end COMPU_METHOD
/begin COMPU_METHOD _CNV_A_R_LINEAR_____5_CM "" RAT_FUNC "%6.3" "rpm" COEFFS 0 3.125e-002 0. 0 0 1 /end COMPU_METHOD
/begin COMPU_METHOD _CNV_A_R_LINEAR_____10_CM "" RAT_FUNC "%6.3" "-" COEFFS 0 1. 0. 0 0 1 /end COMPU_METHOD
/begin COMPU_METHOD _CNV_S_2_RANGE______11_CM "" TAB_VERB "%6.3" "-" COMPU_TAB_REF _CNV_S_2_RANGE______11 /end COMPU_METHOD
/begin COMPU_VTAB _CNV_S_2_RANGE______11 "" TAB_VERB 2 0 "0" 1 "1" /end COMPU_VTAB
/begin COMPU_METHOD _CNV_A_R_LINEAR_____12_CM "" RAT_FUNC "%6.3" "[-]" COEFFS 0 1. 0. 0 0 1 /end COMPU_METHOD
/begin COMPU_METHOD _CNV_A_R_LINEAR_____13_CM "" RAT_FUNC "%6.3" "km/h" COEFFS 0 1. 0. 0 0 1 /end COMPU_METHOD
/begin COMPU_METHOD _CNV_A_R_LINEAR_____14_CM "" RAT_FUNC "%6.3" "s" COEFFS 0 10. 0. 0 0 1 /end COMPU_METHOD
/begin COMPU_METHOD _CNV_A_R_LINEAR_____17_CM "" RAT_FUNC "%6.3" "rpm" COEFFS 0 1. 0. 0 0 1 /end COMPU_METHOD
/begin COMPU_METHOD _CNV_A_R_LINEAR_____18_CM "" RAT_FUNC "%6.3" "mg/stk" COEFFS 0 0.183585313174946 0. 0 0 1 /end COMPU_METHOD
/begin COMPU_METHOD _CNV_A_R_LINEAR_____20_CM "" RAT_FUNC "%6.3" "-" COEFFS 0 255.9983911655618 0. 0 0 1 /end COMPU_METHOD
/begin COMPU_METHOD _CNV_A_R_LINEAR_____26_CM "" RAT_FUNC "%6.3" "V" COEFFS 0 9.846168103048838 0. 0 0 1 /end COMPU_METHOD
/begin COMPU_METHOD _CNV_A_R_LINEAR_____27_CM "" RAT_FUNC "%6.3" "s" COEFFS 0 100. 0. 0 0 1 /end COMPU_METHOD
/begin COMPU_METHOD _CNV_S_2_RANGE______28_CM "" TAB_VERB "%6.3" "[-]" COMPU_TAB_REF _CNV_S_2_RANGE______28 /end COMPU_METHOD
/begin COMPU_VTAB _CNV_S_2_RANGE______28 "" TAB_VERB 2 0 "0" 1 "1" /end COMPU_VTAB
/begin COMPU_METHOD _CNV_A_R_LINEAR_____31_CM "" RAT_FUNC "%6.3" "-" COEFFS 0 65536.00007936121 0. 0 0 1 /end COMPU_METHOD
/begin COMPU_METHOD _CNV_A_R_LINEAR_____34_CM "" RAT_FUNC "%6.3" "-" COEFFS 0 127.9991955827809 0. 0 0 1 /end COMPU_METHOD
/begin COMPU_METHOD _CNV_A_R_LINEAR_____35_CM "" RAT_FUNC "%6.3" "min" COEFFS 0 1. 0. 0 0 1 /end COMPU_METHOD
/begin COMPU_METHOD _CNV_A_R_LINEAR_____38_CM "" RAT_FUNC "%6.3" "V" COEFFS 0 51.0204081632653 0. 0 0 1 /end COMPU_METHOD
/begin COMPU_METHOD _CNV_A_R_LINEAR_____43_CM "" RAT_FUNC "%6.3" "hPa" COEFFS 0 12.06017666543982 0. 0 0 1 /end COMPU_METHOD
/begin COMPU_METHOD _CNV_A_R_LINEAR_____44_CM "" RAT_FUNC "%6.3" "[-]" COEFFS 0 255.9999357490357 0. 0 0 1 /end COMPU_METHOD
/begin COMPU_METHOD _CNV_A_R_LINEAR_____45_CM "" RAT_FUNC "%6.3" "-" COEFFS 0 32768.00003968061 0. 0 0 1 /end COMPU_METHOD
/begin COMPU_METHOD _CNV_A_R_LINEAR_____48_CM "" RAT_FUNC "%6.3" "Nm" COEFFS 0 32. 0. 0 0 1 /end COMPU_METHOD
/begin COMPU_METHOD _CNV_A_R_LINEAR_____75_CM "" RAT_FUNC "%6.3" "°CRK" COEFFS 0 2.666666666666667 0. 0 0 1 /end COMPU_METHOD
/begin COMPU_METHOD _CNV_A_R_LINEAR_____80_CM "" RAT_FUNC "%6.3" "km" COEFFS 0 0.1 0. 0 0 1 /end COMPU_METHOD
/begin COMPU_METHOD _CNV_A_R_LINEAR_____94_CM "" RAT_FUNC "%6.3" "%" COEFFS 0 655.3600000071681 0. 0 0 1 /end COMPU_METHOD
/begin COMPU_METHOD _CNV_A_R_LINEAR_____95_CM "" RAT_FUNC "%6.3" "mg/stk" COEFFS 0 47.18142548596112 0. 0 0 1 /end COMPU_METHOD
/begin COMPU_METHOD _CNV_A_R_LINEAR_____103_CM "" RAT_FUNC "%6.3" "-" COEFFS 0 128. 0. 0 0 1 /end COMPU_METHOD
/begin COMPU_METHOD _CNV_A_R_LINEAR_____113_CM "" RAT_FUNC "%6.3" "-" COEFFS 0 16383.75 0. 0 0 1 /end COMPU_METHOD
/begin COMPU_METHOD _CNV_A_R_LINEAR_____122_CM "" RAT_FUNC "%6.3" "-" COEFFS 0 2.666666666666667 0. 0 0 1 /end COMPU_METHOD
/begin COMPU_METHOD _CNV_A_R_LINEAR_____148_CM "" RAT_FUNC "%6.3" "-" COEFFS 0 1023.999999919998 0. 0 0 1 /end COMPU_METHOD
/begin COMPU_METHOD _CNV_A_R_LINEAR_____178_CM "" RAT_FUNC "%6.3" "Seg" COEFFS 0 1. 0. 0 0 1 /end COMPU_METHOD
/begin COMPU_METHOD _CNV_A_R_LINEAR_____190_CM "" RAT_FUNC "%6.3" "hPa" COEFFS 0 0.3768805207949945 0. 0 0 1 /end COMPU_METHOD
/begin COMPU_METHOD _CNV_A_R_LINEAR_____195_CM "" RAT_FUNC "%6.3" "[-]" COEFFS 0 64. 0. 0 0 1 /end COMPU_METHOD
/begin COMPU_METHOD _CNV_A_R_LINEAR_____202_CM "" RAT_FUNC "%6.3" "°CRK" COEFFS 0 2.666666666666667 95. 0 0 1 /end COMPU_METHOD
/begin COMPU_METHOD _CNV_A_R_LINEAR_____203_CM "" RAT_FUNC "%6.3" "°CRK" COEFFS 0 -2.666666666666667 0. 0 0 1 /end COMPU_METHOD
/begin COMPU_METHOD _CNV_A_R_LINEAR_____204_CM "" RAT_FUNC "%6.3" "°CRK" COEFFS 0 2.666666666666667 128. 0 0 1 /end COMPU_METHOD
/begin COMPU_METHOD _CNV_A_R_LINEAR_____205_CM "" RAT_FUNC "%6.3" "-" COEFFS 0 655.3600000071681 0. 0 0 1 /end COMPU_METHOD
/begin COMPU_METHOD _CNV_A_R_LINEAR_____206_CM "" RAT_FUNC "%6.3" "-" COEFFS 0 128. 128. 0 0 1 /end COMPU_METHOD
/begin COMPU_METHOD _CNV_A_R_LINEAR_____207_CM "" RAT_FUNC "%6.3" "°PORT" COEFFS 0 655.3600000071681 0. 0 0 1 /end COMPU_METHOD
/begin COMPU_METHOD _CNV_A_R_LINEAR_____208_CM "" RAT_FUNC "%6.3" "ms" COEFFS 0 250. 0. 0 0 1 /end COMPU_METHOD
/begin COMPU_METHOD _CNV_A_R_LINEAR_____209_CM "" RAT_FUNC "%6.3" "ms" COEFFS 0 15.625 0. 0 0 1 /end COMPU_METHOD
/begin COMPU_METHOD _CNV_A_R_LINEAR_____210_CM "" RAT_FUNC "%6.3" "V" COEFFS 0 35.63776976537597 0. 0 0 1 /end COMPU_METHOD
/begin COMPU_METHOD _CNV_A_R_LINEAR_____211_CM "" RAT_FUNC "%6.3" "°C" COEFFS 0 16. 0. 0 0 1 /end COMPU_METHOD
/begin COMPU_METHOD _CNV_A_R_LINEAR_____215_CM "" RAT_FUNC "%6.3" "rpm/s" COEFFS 0 3.125e-002 0. 0 0 1 /end COMPU_METHOD
/begin COMPU_METHOD _CNV_A_R_LINEAR_____218_CM "" RAT_FUNC "%6.3" "Nm" COEFFS 0 32. 32768. 0 0 1 /end COMPU_METHOD
/begin COMPU_METHOD _CNV_A_R_LINEAR_____232_CM "" RAT_FUNC "%6.3" "°CRK" COEFFS 0 42.66666666666666 0. 0 0 1 /end COMPU_METHOD
/begin COMPU_METHOD _CNV_A_R_LINEAR_____240_CM "" RAT_FUNC "%6.3" "-" COEFFS 0 32. 0. 0 0 1 /end COMPU_METHOD
/begin COMPU_METHOD _CNV_A_R_LINEAR_____254_CM "" RAT_FUNC "%6.3" "°CRK" COEFFS 0 1. 0. 0 0 1 /end COMPU_METHOD
/begin COMPU_METHOD _CNV_A_R_LINEAR_____255_CM "" RAT_FUNC "%6.3" "-" COEFFS 0 682.6666665599934 2.560156259323598e-006 0 0 1 /end COMPU_METHOD
/begin COMPU_METHOD _CNV_A_R_LINEAR_____256_CM "" RAT_FUNC "%6.3" "V" COEFFS 0 13107.19998965744 0. 0 0 1 /end COMPU_METHOD
/begin COMPU_METHOD _CNV_A_R_LINEAR_____257_CM "" RAT_FUNC "%6.3" "°CRK/wcyc" COEFFS 0 64. 0. 0 0 1 /end COMPU_METHOD
/begin COMPU_METHOD _CNV_A_R_LINEAR_____258_CM "" RAT_FUNC "%6.3" "°CRK/wcyc" COEFFS 0 10.66666666666667 0. 0 0 1 /end COMPU_METHOD
/begin COMPU_METHOD _CNV_A_R_LINEAR_____259_CM "" RAT_FUNC "%6.3" "°CRK" COEFFS 0 682.6456692913386 7.874015748029706e-003 0 0 1 /end COMPU_METHOD
/begin COMPU_METHOD _CNV_A_R_LINEAR_____260_CM "" RAT_FUNC "%6.3" "V" COEFFS 0 50. 128. 0 0 1 /end COMPU_METHOD
/begin COMPU_METHOD _CNV_A_R_LINEAR_____261_CM "" RAT_FUNC "%6.3" "mg/stk" COEFFS 0 47.18214541280769 -1.080506262951531e-005 0 0 1 /end COMPU_METHOD
/begin COMPU_METHOD _CNV_A_R_LINEAR_____262_CM "" RAT_FUNC "%6.3" "*wcyc" COEFFS 0 1. 0. 0 0 1 /end COMPU_METHOD
/begin COMPU_METHOD _CNV_S_6_STATE_IGA__263_CM "" TAB_VERB "%6.3" "[-]" COMPU_TAB_REF _CNV_S_6_STATE_IGA__263 /end COMPU_METHOD
/begin COMPU_VTAB _CNV_S_6_STATE_IGA__263 "" TAB_VERB 6 0 "INIT" 1 "TRIGGER" 2 "DELAY" 3 "ACTIVE" 4 "RAMP" 5 "WAIT" /end COMPU_VTAB
/begin COMPU_METHOD _CNV_A_R_LINEAR_____264_CM "" RAT_FUNC "%6.3" "°TPS/s" COEFFS 0 8.535564853556485e-002 0. 0 0 1 /end COMPU_METHOD
/begin COMPU_METHOD _CNV_A_R_LINEAR_____265_CM "" RAT_FUNC "%6.3" "hPa/ms" COEFFS 0 395.2653799758745 -0.5 0 0 1 /end COMPU_METHOD
/begin COMPU_METHOD _CNV_A_R_LINEAR_____266_CM "" RAT_FUNC "%6.3" "°CRK/wcyc" COEFFS 0 682.6666665599934 2.560156259323598e-006 0 0 1 /end COMPU_METHOD
/begin COMPU_METHOD _CNV_A_R_LINEAR_____273_CM "" RAT_FUNC "%6.3" "[-]" COEFFS 0 1023.999999959999 32767.99999871998 0 0 1 /end COMPU_METHOD
/begin COMPU_METHOD _CNV_A_R_LINEAR_____350_CM "" RAT_FUNC "%6.3" "°CRK" COEFFS 0 42.66666666666666 32768. 0 0 1 /end COMPU_METHOD
/begin COMPU_METHOD _CNV_A_R_LINEAR_____359_CM "" RAT_FUNC "%6.3" "-" COEFFS 0 524280. 0. 0 0 1 /end COMPU_METHOD
/begin COMPU_METHOD _CNV_A_R_LINEAR_____387_CM "" RAT_FUNC "%6.3" "mm" COEFFS 0 1000. 0. 0 0 1 /end COMPU_METHOD
/begin COMPU_METHOD _CNV_A_R_LINEAR_____411_CM "" RAT_FUNC "%6.3" "-" COEFFS 0 2. 0. 0 0 1 /end COMPU_METHOD
/begin COMPU_METHOD _CNV_A_R_LINEAR_____434_CM "" RAT_FUNC "%6.3" "ms" COEFFS 0 250. 32768. 0 0 1 /end COMPU_METHOD
/begin COMPU_METHOD _CNV_A_R_LINEAR_____439_CM "" RAT_FUNC "%6.3" "-" COEFFS 0 511.9999948599216 0. 0 0 1 /end COMPU_METHOD
/begin RECORD_LAYOUT _REC_VAL_20_u1 FNC_VALUES 1 UBYTE COLUMN_DIR DIRECT /end RECORD_LAYOUT
/begin RECORD_LAYOUT _REC_MAP_20_u1_u1_u1 FNC_VALUES 1 UBYTE COLUMN_DIR DIRECT /end RECORD_LAYOUT
/begin RECORD_LAYOUT _REC_AXS_20_u1 NO_AXIS_PTS_X 1 UBYTE AXIS_PTS_X 2 UBYTE INDEX_INCR DIRECT /end RECORD_LAYOUT
/begin RECORD_LAYOUT _REC_CUR_20_u1_u1 FNC_VALUES 1 UBYTE COLUMN_DIR DIRECT /end RECORD_LAYOUT
/begin RECORD_LAYOUT _REC_MAP_20_u2_u2_u1 FNC_VALUES 1 UWORD COLUMN_DIR DIRECT /end RECORD_LAYOUT
/begin RECORD_LAYOUT _REC_AXS_20_u2 NO_AXIS_PTS_X 1 UWORD AXIS_PTS_X 2 UWORD INDEX_INCR DIRECT /end RECORD_LAYOUT
/begin RECORD_LAYOUT _REC_CUR_20_u2_u2 FNC_VALUES 1 UWORD COLUMN_DIR DIRECT /end RECORD_LAYOUT
/begin RECORD_LAYOUT _REC_VAL_20_u2 FNC_VALUES 1 UWORD COLUMN_DIR DIRECT /end RECORD_LAYOUT
/begin RECORD_LAYOUT _REC_CUR_20_u2_u1 FNC_VALUES 1 UWORD COLUMN_DIR DIRECT /end RECORD_LAYOUT
/begin RECORD_LAYOUT _REC_MAP_20_u1_u1_u2 FNC_VALUES 1 UBYTE COLUMN_DIR DIRECT /end RECORD_LAYOUT
/begin RECORD_LAYOUT _REC_CUR_20_u1_u2 FNC_VALUES 1 UBYTE COLUMN_DIR DIRECT /end RECORD_LAYOUT
/begin RECORD_LAYOUT _REC_MAP_20_u2_u1_u1 FNC_VALUES 1 UWORD COLUMN_DIR DIRECT /end RECORD_LAYOUT
/begin RECORD_LAYOUT _REC_MAP_20_u2_u1_u2 FNC_VALUES 1 UWORD COLUMN_DIR DIRECT /end RECORD_LAYOUT
/begin RECORD_LAYOUT _REC_VAL_20_s2 FNC_VALUES 1 SWORD COLUMN_DIR DIRECT /end RECORD_LAYOUT
/begin RECORD_LAYOUT _REC_MAP_20_u1_u2_u2 FNC_VALUES 1 UBYTE COLUMN_DIR DIRECT /end RECORD_LAYOUT
/begin RECORD_LAYOUT _REC_VAL_20_s1 FNC_VALUES 1 SBYTE COLUMN_DIR DIRECT /end RECORD_LAYOUT
/begin RECORD_LAYOUT _REC_MAP_20_u2_u2_u2 FNC_VALUES 1 UWORD COLUMN_DIR DIRECT /end RECORD_LAYOUT
/begin RECORD_LAYOUT _REC_MAP_20_u1_u2_u1 FNC_VALUES 1 UBYTE COLUMN_DIR DIRECT /end RECORD_LAYOUT
/begin RECORD_LAYOUT _REC_CUR_20_s2_u1 FNC_VALUES 1 SWORD COLUMN_DIR DIRECT /end RECORD_LAYOUT
/begin FUNCTION ETC_Idle_speed_actuator_opening_ "_Idle speed actuator opening at start"
 /begin DEF_CHARACTERISTIC IP_OPG_REL_ST_ISA_AT IP_OPG_REL_ST_ISA_MT IP_OPG_REL_ST_ISA_PV IP_FAC_TIA_OPG_ST_ISA IP_FAC_AMP_OPG_ST_ISA IP_OPG_SP_ST_ISA /end DEF_CHARACTERISTIC
 /begin OUT_MEASUREMENT OPG_SP_ST_ISA OPG_REL_ST /end OUT_MEASUREMENT
/end FUNCTION
/begin FUNCTION IGA_Ignition_Angle "IGA"
 /begin SUB_FUNCTION IGA_Ignition_angle_general IGA_Dwell_time_control_open_loop IGA_Ignition_with_multiple_spark IGA_Corrected_basic_ignition_ang IGA_Setpoint_ignition_angle IGA_Minimum_ignition_angle IGA_Basic_ignition_angle_at_star IGA_KnockControl IGA_Ignition_angle_for_stratifie IGA_Corrected_Reference_Ignition IGA_Ignition_angle_correction_du IGA_Temperature_Correction IGA_RON_Adaptation IGA_Minimum_IGA_limitation_for_e IGA_Catalyst_heating_correction IGA_Load_dynamics_correction /end SUB_FUNCTION
/end FUNCTION
/begin FUNCTION IGA_Ignition_angle_general "_Ignition angle general"
 /begin DEF_CHARACTERISTIC C_CRLC_IGA_KNK C_CYCNR_IGA_ES LC_IGA_ST_ENA LC_INH_IGA_TRA_KNK_EFF IP_IGA_LGRD_AST LC_IGA_MAN C_IGA_INI C_IGA_AS_CYL_0 C_IGA_AS_CYL_1 C_IGA_AS_CYL_2 C_IGA_AS_CYL_3 C_IGA_AS_CYL_4 C_IGA_AS_CYL_5 C_IGA_AS IPM_EFF_IGA__IGA_DIF C_IGA_MAN /end DEF_CHARACTERISTIC
 /begin OUT_MEASUREMENT IGA_AV_1_0 IGA_AV_1_1 IGA_AV_1_2 IGA_AV_1_3 IGA_AV_1_4 IGA_AV_1_5 IGA_0 IGA_1 IGA_2 IGA_3 IGA_4 IGA_5 IGA_MIN EFF_IGA_BAS_COR EFF_IGA_RON_98_1 EFF_IGA_RON_98_2 EFF_IGA_AV_1 EFF_IGA_AV_2 EFF_IGA_MIN IGA_BAS_COR_KNK_ADD IGA_AV_MV_1 IGA_AV_MV_2 IGA_DIF_BAS IGA_DIF_AV_1 IGA_DIF_AV_2 IGA_DIF_RON_98_1 IGA_DIF_RON_98_2 IGA_MV_KNK_FIL IGA_BAS_COR_KNK_FIL EFF_IGA_BAS_COR_KNK_FIL LV_IGA_GRD_ACT IGA_DIF_BAS_KNK_FIL IGA_IGC_0 IGA_IGC_1 IGA_IGC_2 IGA_IGC_3 IGA_IGC_4 IGA_IGC_5 IGA_WOUT_KNK_0 IGA_WOUT_KNK_1 IGA_WOUT_KNK_2 IGA_WOUT_KNK_3 IGA_WOUT_KNK_4 IGA_WOUT_KNK_5 EFF_IGA_AV EFF_IGA_AV_CAN IGA_SP_MAX_1 IGA_SP_MAX_1_CAN IGA_AV_MV IGA_AV_MV_CAN IGA_DIF_AV IGA_DIF_AV_CAN /end OUT_MEASUREMENT
/end FUNCTION
/begin FUNCTION IGA_Dwell_time_control_open_loop "_Dwell time control open loop" /begin DEF_CHARACTERISTIC C_TD_INI C_TD_AS IP_TD__VB /end DEF_CHARACTERISTIC /begin OUT_MEASUREMENT TD_MAX_WDT TD /end OUT_MEASUREMENT /end FUNCTION
/begin FUNCTION IGA_Ignition_with_multiple_spark "_Ignition with multiple spark"
 /begin DEF_CHARACTERISTIC C_TCO_MAX_MPL_IS C_TCO_MAX_MPL_ST C_VB_MAX_MPL C_TD_T_MPL C_N_MAX_IGN_MPL IP_NR_MPL_ST IP_NR_MPL_IS ldp_tco__nr_mpl_st ldp_tco__nr_mpl_is IP_TD_MPL /end DEF_CHARACTERISTIC
 /begin OUT_MEASUREMENT LV_MPL_IGA_ACT TD_MPL_DLY TD_MPL IGN_MPL_NR /end OUT_MEASUREMENT
/end FUNCTION
/begin FUNCTION IGA_Corrected_basic_ignition_ang "_Corrected basic ignition angle"
 /begin DEF_CHARACTERISTIC C_IGA_BAS_ADD_MAX C_IGA_BAS_ADD_MIN IP_IGA_BAS_RON_91__N__MAF IP_IGA_BAS_ADD_MAX__IVVT__N__MAF IP_IGA_BAS_ADD_MIN__IVVT__N__MAF IP_IGA_BAS_LAMB_LAMB_SP IP_IGA_BAS__N__MAF IP_IGA_BAS_RON_98__N__MAF /end DEF_CHARACTERISTIC
 /begin OUT_MEASUREMENT IGA_BAS_COR IGA_BAS_IVVT IGA_BAS_LAMB_COR IGA_BAS_IVVT_OFS IGA_BAS_RON /end OUT_MEASUREMENT
/end FUNCTION
/begin FUNCTION IGA_Setpoint_ignition_angle "_Setpoint ignition angle"
 /begin DEF_CHARACTERISTIC IP_IGA_DIF_SP__EFF_IGA_SP LC_TQ_IGA_INH C_EFF_IGA_THD_1 C_EFF_IGA_THD_AJ C_EFF_IGA_THD_IS /end DEF_CHARACTERISTIC
 /begin OUT_MEASUREMENT IGA_DIF_SP LV_TQ_IGA_ACT LV_TQ_IGA_REQ EFF_IGA_SP EFF_IGA_SP_CAN EFF_IGA_SP_1 EFF_IGA_SP_1_CAN IGA_SP IGA_SP_CAN /end OUT_MEASUREMENT
/end FUNCTION
/begin FUNCTION IGA_Minimum_ignition_angle "_Minimum ignition angle"
 /begin DEF_CHARACTERISTIC C_IGA_DIF_MIN_DELTA_TEMP_ENA C_IGA_DIF_MIN_DELTA_LGRD IP_IGA_DIF_MIN_TCO IP_IGA_DIF_MIN_CYC IP_IGA_DIF_MIN_N_MAF IP_IGA_DIF_MIN_DELTA C_IGA_DIF_MIN_DELTA_TEMP_DIS /end DEF_CHARACTERISTIC
 /begin OUT_MEASUREMENT IGA_DIF_MIN IGA_DIF_MIN_DELTA LV_IGA_DIF_MIN_DELTA_ACT IGA_DIF_MIN_AST /end OUT_MEASUREMENT
/end FUNCTION
/begin FUNCTION IGA_Basic_ignition_angle_at_star "_Basic ignition angle at start" /begin DEF_CHARACTERISTIC IP_IGA_ST_BAS IP_IGA_ST_CYC_ST_COR IP_IGA_ST_AMP_COR /end DEF_CHARACTERISTIC /begin OUT_MEASUREMENT IGA_ST /end OUT_MEASUREMENT /end FUNCTION
/begin FUNCTION IGA_KnockControl "_KnockControl"
 /begin DEF_CHARACTERISTIC C_CYCNR_AD2_DEC_KNK IP_MAF_MIN_KNK ID_IGA_AD1_KNK_SIZE ID_IGA_DEC_KNK_1 ID_IGA_DEC_KNK_2 ID_MAF_MIN_AD_KNK__N ID_N_GRD_MAX_KNK__N IP_IGA_INC_KNK C_CYCNR_AD2_INC_KNK C_FAC_TRA_KNK C_IGA_AD1_FAC_DEC_KNK C_IGA_AD1_FAC_FAST_KNK C_IGA_AD1_FAC_INC_KNK C_IGA_AD1_INC_KNK C_IGA_AD1_LGRD_NEG_KNK C_IGA_AD1_LGRD_POS_KNK C_IGA_AD1_THD_DEC_KNK C_IGA_AD1_THD_FAST_KNK C_IGA_AD2_MAX_KNK C_IGA_AD2_THD_DEC_KNK C_IGA_AD2_THD_INC_KNK C_IGA_DIF_MIN_MAX_KNK C_IGA_LGRD_3 C_MAF_IGA_HYS_KNK C_N_IGA_HYS_KNK C_NL_CRLC C_NL_CRLC_TRA C_SWI_AD_KNK IP_FAC_AD_KNK_TCO__TCO ID_CYCNR_FAC_TRA_KNK IP_KNKWB_1__N__MAF IP_GAIN_KNK_1__N__MAF IP_FAC_THD_KNK_0__N__MAF IP_FAC_THD_KNK_1__N__MAF IP_FAC_THD_KNK_2__N__MAF IP_FAC_THD_KNK_3__N__MAF IP_FAC_THD_KNK_4__N__MAF IP_FAC_THD_KNK_5__N__MAF IP_KNK_THD_ADD__N C_NL_MIN ID_MAF_DIF_TRA_KNK__N IP_IGA_BAS_MAX_KNK__N__MAF IP_IGA_OFS_MAX_KNK__N__MAF IP_FAC_IGA_MAX_KNK__TCO__TIA C_IGA_AD1_THD_INC_KNK C_TCO_AD1_MIN_KNK C_TCO_AD2_MIN_KNK C_TCO_AD1_MAX_KNK C_TCO_AD2_MAX_KNK ldp_tco__maf_min_knk ldpm_n_3_9 ldp_tco__fac_ad_knk_tco C_MAF_MIN_KNK_AD2 C_KNK_THD_MAX IGA_AD1_KNK_5__N__MAF IGA_AD1_KNK_4__N__MAF IGA_AD1_KNK_3__N__MAF IGA_AD1_KNK_2__N__MAF IGA_AD1_KNK_1__N__MAF IGA_AD1_KNK_0__N__MAF ldpm_maf_iga_ad ldpm_n_iga_ad ldpm_maf_knkwb ldpm_n_knkwb ldpm_n_fil_frq_knk ID_FIL_FRQ_KNK_1 ID_FIL_FRQ_KNK_2 ID_FIL_FRQ_KNK_3 ID_FIL_FRQ_KNK_0 ID_FIL_FRQ_KNK_4 ID_FIL_FRQ_KNK_5 IP_KNKWB_2__N__MAF IP_KNKWB_3__N__MAF IP_KNKWB_4__N__MAF IP_KNKWB_5__N__MAF IP_KNKWE_0__N__MAF IP_KNKWE_1__N__MAF IP_KNKWE_2__N__MAF IP_KNKWE_3__N__MAF IP_KNKWE_4__N__MAF IP_KNKWE_5__N__MAF IP_GAIN_KNK_0__N__MAF IP_GAIN_KNK_2__N__MAF IP_GAIN_KNK_3__N__MAF IP_GAIN_KNK_4__N__MAF IP_GAIN_KNK_5__N__MAF IP_ITC_KNK_0__N__MAF IP_ITC_KNK_1__N__MAF IP_ITC_KNK_2__N__MAF IP_ITC_KNK_3__N__MAF IP_ITC_KNK_4__N__MAF IP_ITC_KNK_5__N__MAF IP_KNKWB_0__N__MAF ldp_val_mo3_x ldp_val_mo3_y /end DEF_CHARACTERISTIC
 /begin OUT_MEASUREMENT IGA_AD1_KNK_0 IGA_AD1_KNK_1 IGA_AD1_KNK_2 IGA_AD1_KNK_3 IGA_AD1_KNK_4 IGA_AD1_KNK_5 IGA_AD2_KNK IGA_KNK_0 IGA_KNK_1 IGA_KNK_2 IGA_KNK_3 IGA_KNK_4 IGA_KNK_5 KNK_THD_0 KNK_THD_1 KNK_THD_2 KNK_THD_3 KNK_THD_4 KNK_THD_5 KNKS_CMD_FIL_0 KNKS_CMD_FIL_1 KNKS_CMD_FIL_2 KNKS_CMD_FIL_3 KNKS_CMD_FIL_4 KNKS_CMD_FIL_5 KNKWB_0 KNKWB_1 KNKWB_2 KNKWB_3 KNKWB_4 KNKWB_5 KNKWE_0 KNKWE_1 KNKWE_2 KNKWE_3 KNKWE_4 KNKWE_5 LV_KNK_AD1_ENA LV_KNK_AD2_ENA LV_KNK_CTL_ENA LV_KNK_TRA_MAF MAF_KNK N_KNK NL_0 NL_1 NL_2 NL_3 NL_4 NL_5 LV_KNK_TRA_N IGA_ADJ_KNK_0_ IGA_ADJ_KNK_1_ IGA_ADJ_KNK_2_ IGA_ADJ_KNK_3_ IGA_ADJ_KNK_4_ IGA_ADJ_KNK_5_ IGA_ADJ_MAX_KNK DLY_IGA_ADJ_KNK_DIAG IGA_MV_ADJ_KNK CYL_ID_KNK LV_KNK IGA_MV_KNK FAC_IGA_MAX_KNK KNKS_CMD_GAIN_0 KNKS_CMD_GAIN_1 KNKS_CMD_GAIN_2 KNKS_CMD_GAIN_3 KNKS_CMD_GAIN_4 KNKS_CMD_GAIN_5 KNKS_CMD_INT_0 KNKS_CMD_INT_1 KNKS_CMD_INT_2 KNKS_CMD_INT_3 KNKS_CMD_INT_4 KNKS_CMD_INT_5 IGA_AD1_AD2_KNK_0_ IGA_AD1_AD2_KNK_1_ IGA_AD1_AD2_KNK_2_ IGA_AD1_AD2_KNK_3_ IGA_AD1_AD2_KNK_4_ IGA_AD1_AD2_KNK_5_ KNK_CTL_DIS LV_KNK_AD_RD_ENA KNK_AD1_DIS KNK_AD2_DIS KNKS_0 KNKS_1 KNKS_2 KNKS_3 KNKS_4 KNKS_5 /end OUT_MEASUREMENT
/end FUNCTION
/begin FUNCTION IGA_Ignition_angle_for_stratifie "_Ignition angle for stratified mode" /begin DEF_CHARACTERISTIC IP_IGA_BAS_S /end DEF_CHARACTERISTIC
 /begin OUT_MEASUREMENT IGA_IGC_S_0 IGA_IGC_S_1 IGA_IGC_S_2 IGA_IGC_S_3 IGA_IGC_S_4 IGA_IGC_S_5 IGA_BAS_S /end OUT_MEASUREMENT
/end FUNCTION
/begin FUNCTION IGA_Corrected_Reference_Ignition "_Corrected Reference Ignition Angle"
 /begin DEF_CHARACTERISTIC IP_IGA_REF IP_IGA_REF_LAMB__LAMB_SP IP_IGA_REF_TEMP__N__MAF IP_IGA_REF_VVT__N__MAF IP_IGA_REF_TEMP_FAC IP_IGA_REF_EGR_FAC IP_IGA_REF_EGR IP_FAC_IGA_REF_PORT IP_FAC_IGA_REF_EGR_LAMB IP_IGA_REF_PORT /end DEF_CHARACTERISTIC
 /begin OUT_MEASUREMENT IGA_REF_COR IGA_REF_TEMP_COR IGA_REF_VVT_COR IGA_REF_EGR_COR EGR_RATIO_COR IGA_REF_LAMB_COR IGA_REF_PORT_COR /end OUT_MEASUREMENT
/end FUNCTION
/begin FUNCTION IGA_Ignition_angle_correction_du "_Ignition angle correction due to EGR"
 /begin DEF_CHARACTERISTIC IP_FAC_RATE_EGR_AFL IP_FAC_RATE_EGR_S IP_IGA_EGR_S IP_FAC_IGA_BAS_EGR_LAMB IP_IGA_BAS_EGR IP_IGA_BAS_EGR_FAC__N__MAF /end DEF_CHARACTERISTIC
 /begin OUT_MEASUREMENT IGA_BAS_EGR_COR_HOM IGA_BAS_EGR_COR_S IGA_BAS_EGR_COR EGR_RATIO_COR_2 /end OUT_MEASUREMENT
/end FUNCTION
/begin FUNCTION IGA_Temperature_Correction "_Temperature Correction"
 /begin DEF_CHARACTERISTIC IP_IGA_BAS_TEMP_COR__TCO__TIA IP_FAC_IGA_POS__N_32__MAF IP_FAC_IGA_NEG__N_32__MAF /end DEF_CHARACTERISTIC
 /begin OUT_MEASUREMENT IGA_BAS_TEMP_COR /end OUT_MEASUREMENT
/end FUNCTION
/begin FUNCTION IGA_RON_Adaptation "_RON Adaptation"
 /begin DEF_CHARACTERISTIC C_TCO_AD_MIN_RON C_CYCNR_AD_RTD_KNK C_IGA_MIN_AD C_IGA_MAX_AD C_CYCNR_FAC_RON C_TCO_FAC_RON_MIN C_TCO_FAC_RON_MAX C_FAC_RON_AD_COLD C_FAC_RON_AD_HOT ID_MAF_MIN_KNK_AD_2__N_32 IP_FAC_RON_INC__N IP_FAC_RON_DEC__N IP_FAC_RON_AD_MAX__TIA__TCO /end DEF_CHARACTERISTIC
 /begin OUT_MEASUREMENT FAC_RON_AD LV_FAC_RON_AD_ACT /end OUT_MEASUREMENT
/end FUNCTION
/begin FUNCTION IGA_Minimum_IGA_limitation_for_e "_Minimum IGA limitation for exhaust gas temperature protection" /begin DEF_CHARACTERISTIC C_TEG_MAX_IGA_HYS C_TEG_MAX_IGA IP_IGA_DIF_MIN_TEG__TEG /end DEF_CHARACTERISTIC
 /begin OUT_MEASUREMENT IGA_MIN_TEG IGA_DIF_MIN_TEG EFF_IGA_MIN_TEG TEG_DYN_HYS TEG_CAT_UP_MDL_MAX /end OUT_MEASUREMENT
/end FUNCTION
/begin FUNCTION IGA_Catalyst_heating_correction "_Catalyst heating correction"
 /begin DEF_CHARACTERISTIC IP_FAC_IGA_CH_TCO IP_IGA_CH_COLD_PL IP_IGA_CH_HOT_PL IP_IGA_CH_COLD_IS_ALTER IP_IGA_CH_COLD_IS IP_IGA_CH_HOT_IS_ALTER IP_IGA_CH_HOT_IS IP_FAC_RED_CH_MT IP_FAC_RED_CH_CTR_KM IP_FAC_RED_CH_AT IP_FAC_RED_CH_IS IP_FAC_RED_CH_IS_DRI IP_CRLC_TQ_ADD_CH C_T_DEAC_CH_TQ_ADD C_T_DRI_CH /end DEF_CHARACTERISTIC
 /begin OUT_MEASUREMENT TQ_ADD_CH IGA_CH_BAS IGA_DIF_CH_BAS EFF_IGA_CH_BAS TQ_ADD_CH_BAS FAC_DEAC_CH FAC_RED_TQ_ADD_CH FAC_DEAC_CH_DRI TQ_ADD_CH_RED /end OUT_MEASUREMENT
/end FUNCTION
/begin FUNCTION IGA_Load_dynamics_correction "_Load dynamics correction"
 /begin DEF_CHARACTERISTIC ID_TPS_GRD_IGA_TRA_KNK ID_MAP_DRV1_IGA_TRA_KNK IP_IGA_TRA_KNK IP_FAC_IGA_TRA IP_FAC_IGA_TRA_GEAR_MT IP_FAC_IGA_TRA_GEAR_AT ID_CYC_IGA_TRA_KNK_DLY IP_IGA_TRA_INC ID_CYC_IGA_TRA_KNK_ACT ID_CYC_IGA_TRA_KNK_WAIT C_N_MIN_IGA_TRA_CS /end DEF_CHARACTERISTIC
 /begin OUT_MEASUREMENT IGA_TRA_KNK IGA_TRA_KNK_INTER LV_IGA_TRA_KNK CTR_CYC_IGA_TRA_KNK_DLY CTR_CYC_IGA_TRA_KNK_ACT CTR_CYC_IGA_TRA_KNK_WAIT STATE_IGA_TRA_KNK /end OUT_MEASUREMENT
/end FUNCTION
/begin FUNCTION INJ_Injection "INJ"
 /begin SUB_FUNCTION INJ_General_Calculation_of_Fuel_ INJ_Injection_phase INJ_Start_injection_time_for_sta INJ_Injector_dead_time_correctio INJ_Cold_post_start_correction INJ_Warm_up_correction INJ_Catalyst_heating_correction INJ_High_torque_request_enrichme INJ_Wall_film_correction_TI_ADD_ INJ_Cylinder_shut_off INJ_Upstream_oxygen_sensor_signa INJ_Upstream_oxygen_sensor_heate INJ_Lambda_control_A_F_Feedback_ INJ_Lambda_control_correction_TI INJ_Application_incidence_for_th INJ_Downstream_fuel_trim_regulat INJ_Detection_of_limited_dynamic INJ_Downstream_oxygen_sensor_sig INJ_Downstream_oxygen_sensor_hea INJ_Injection_fuel_setpoint_for_ INJ_Injection_pressure_correctio INJ_Lambda_coordination INJ_Lambda_Catalyst_overheating_ INJ_Conversion_MFF_to_TI INJ_Basic_Lambda_Setpoint_includ INJ_Ambient_pressure_correction INJ_Lambda_setpoint_for_catalyst INJ_Injection_Pressure_Correctio INJ_Injection_setpoint_for_strat INJ_Mass_Fuel_Flow_Setpoint_for_ INJ_LAMB_RATIO_calculation INJ_Catalyst_heating_with_second INJ_Injection_Time_Correction_by INJ_Transformation_layer_for_bas INJ_Upstream_oxygen_sensor_inter INJ_Downstream_oxygen_sensor_int INJ_Exhaust_Gas_temperature_mode INJ_Detection_of_dew_point INJ_Cylinder_selective_mixture_c INJ_Injection_at_restart_fuel_fe INJ_Catalyst_enrichment_function INJ_Application_incidences_for_c INJ_Fuel_mass_setpoint_and_pre_i INJ_Application_Incidences_for_D INJ_Application_incidences_for_u INJ_Application_incidences_for_d INJ_Lambda_Adaptation INJ_Injection_Phase_for_Stratifi INJ_Restart_function INJ_MFF_Split_Up_for_DUI_at_Stra INJ_Application_incidences_for_i INJ_Upstream_oxygen_sensor_opera INJ_Downstream_oxygen_sensor_ope INJ_Application_incidence_exhaus INJ_Lambda_Setpoint_for_Single_C /end SUB_FUNCTION
/end FUNCTION
/begin FUNCTION INJ_General_Calculation_of_Fuel_ "_General Calculation of Fuel Inj Time"
 /begin DEF_CHARACTERISTIC C_MFF_FAC IP_TI_ST_AMP_FAC__AMP IP_TI_CAST__TIA__TCO IP_TI_DEAC_CAST__CYC_CAST__TCO IP_TI_ADD_DLY IP_TI_ST_REST IP_REST IP_FAC_REST IP_FAC_STALL /end DEF_CHARACTERISTIC
 /begin OUT_MEASUREMENT MFF_BAS TI_CAST LV_AST_END MFF_SP TI_ADD_DLY /end OUT_MEASUREMENT
/end FUNCTION
/begin FUNCTION INJ_Injection_phase "_Injection phase"
 /begin DEF_CHARACTERISTIC IP_EOI_H_PRS_CST IP_EOI_L_PRS_CST C_EOI_LIM LC_EOI_HOM_MAN C_EOI_HOM_MAN C_SOI_MIN_CST_L_PRS C_SOI_MIN_CST_H_PRS IP_EOI_BAS IP_EOI_TCO C_EOI_AS LC_EOI_COR_IVVT_VVL IP_CAM_OP_IN_VVL__VLFT_AV /end DEF_CHARACTERISTIC
 /begin OUT_MEASUREMENT SOI_HOM EOI_HOM_CLC EOI_TCO TI_HOM_MAX_CST EOI_BAS EOI_LIM CAM_OP_IN_VVL EOI_IVVT_VVL EOI_HOM /end OUT_MEASUREMENT
/end FUNCTION
/begin FUNCTION INJ_Start_injection_time_for_sta "_Start injection time for start injection amount" /end FUNCTION
/begin FUNCTION INJ_Injector_dead_time_correctio "_Injector dead time correction" /end FUNCTION
/begin FUNCTION INJ_Cold_post_start_correction "_Cold post start correction" /end FUNCTION
/begin FUNCTION INJ_Warm_up_correction "_Warm up correction"
 /begin DEF_CHARACTERISTIC IP_TI_WUP__N__MAF IP_TI_TCO_WUP__TCO__TCO_ST IP_TI_VO_WUP__TCO__VO IP_FAC_TI_VO_WUP IP_TI_FAC_N_MAP IP_TI_FAC_TIA_TOIL IP_TI_FAC_TCO /end DEF_CHARACTERISTIC
 /begin OUT_MEASUREMENT TI_WUP_1 TI_WUP TI_TEMP /end OUT_MEASUREMENT
/end FUNCTION
/begin FUNCTION INJ_Catalyst_heating_correction "_Catalyst heating correction" /begin DEF_CHARACTERISTIC IP_LAMB_ADD_AFL_CH IP_LAMB_CH_RGL IP_LAMB_CH_IS /end DEF_CHARACTERISTIC /begin OUT_MEASUREMENT LAMB_CH LAMB_AFL_CH /end OUT_MEASUREMENT /end FUNCTION
/begin FUNCTION INJ_High_torque_request_enrichme "_High torque request enrichment" /begin DEF_CHARACTERISTIC C_LAMB_FL_PAS IP_LAMB_FL__N /end DEF_CHARACTERISTIC /begin OUT_MEASUREMENT LAMB_FL /end OUT_MEASUREMENT /end FUNCTION
/begin FUNCTION INJ_Wall_film_correction_TI_ADD_ "_Wall film correction TI_ADD_WF"
 /begin DEF_CHARACTERISTIC C_FAC_WF_PUC C_TI_CRLC_FAST_WF_IS IP_SEG_CTR_FAC_WF__SEG_CTR_WF IP_TI_CRLC_NEG_FAST_WF__N IP_TI_CRLC_NEG_SLOW_WF__N IP_TI_CRLC_POS_FAST_WF__N IP_TI_CRLC_POS_SLOW_WF__N IP_TI_DIF_WF_THD__TCO IP_TI_FAC_NEG_FAST_WF__N__MAF IP_TI_FAC_NEG_SLOW_WF__N__MAF IP_TI_FAC_POS_SLOW_WF__N__MAF IP_TI_FAST_WF_THD__TIB IP_TI_SLOW_WF_THD__TIB IP_TI_TCO_NEG_FAST_WF__N__TCO IP_TI_TCO_NEG_SLOW_WF__N__TCO IP_TI_TCO_POS_FAST_WF__N__TCO IP_TI_TCO_POS_SLOW_WF__N__TCO IP_TI_TCO_ST_FAC_WF__TCO_ST IP_TI_VO_FAST_WF__VO C_FAC_WF_PU IP_TI_FAC_POS_FAST_WF__N__MAF C_SEG_CTR_WF_INI IP_TI_VO_SLOW_WF__VO IP_TI_VO_MAF_SP_WF__VO IP_TI_COR_MAF_SP_WF IP_FAC_TI_COR_MAF_SP_WF_POS IP_FAC_TI_COR_MAF_SP_WF_NEG IP_CRLC_POS_MAF_SP_WF IP_CRLC_NEG_MAF_SP_WF IP_FAC_TI_WF C_T_TI_TRA_PAS C_THD_MAF_SP_WF /end DEF_CHARACTERISTIC
 /begin OUT_MEASUREMENT TIB MFF_ADD_WF TI_ADD_REAC_0 TI_ADD_REAC_1 TI_ADD_REAC_2 TI_ADD_REAC_3 TI_ADD_REAC_4 TI_ADD_REAC_5 SEG_CTR_WF TI_ADD_WF TI_FAST_WF_POST_THD TI_SLOW_WF_POST_THD TI_MAF_SP_WF /end OUT_MEASUREMENT
/end FUNCTION
/begin FUNCTION INJ_Cylinder_shut_off "_Cylinder shut off" /begin DEF_CHARACTERISTIC ID_PAT_IND__NR_PAT /end DEF_CHARACTERISTIC
 /begin OUT_MEASUREMENT LV_SCC INH_CYC_IV INH_IV_IGK INH_SWI_IV LV_INJ_CUT LV_IND_FCUT INH_IV_FCUT INH_IV INH_IV_MON_CUT_OFF LV_SCC_1 LV_SCC_2 INH_IV_AMT /end OUT_MEASUREMENT
/end FUNCTION
/end MODULE
/end PROJECT
