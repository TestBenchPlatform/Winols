ASAP2_VERSION 1 31
/begin PROJECT MS45 "BMW Motorsteuerung R6"
/begin HEADER "_default_HeaderComment" PROJECT_NO _52 /end HEADER
/begin MODULE _default_ModuleName "_default_ModuleLongIdentifier"
/begin MOD_COMMON "_default_ModCommonComment" DEPOSIT ABSOLUTE BYTE_ORDER MSB_FIRST ALIGNMENT_BYTE 1 ALIGNMENT_WORD 2 ALIGNMENT_LONG 4 ALIGNMENT_FLOAT32_IEEE 4 ALIGNMENT_FLOAT64_IEEE 8 /end MOD_COMMON
/begin CHARACTERISTIC C_T_CYC_DISP_ICL_CAN "recurrence for transmission of  check control message" VALUE 0x429cb _REC_VAL_20_u1 15. _CNV_A_R_LINEAR_____47_CM 0. 15. FORMAT "%2.0" /end CHARACTERISTIC
/begin MEASUREMENT CTL_ACIN_ENG_TYP "special function for air conditioning control - not used with engine type M54" UBYTE _CNV_A_R_LINEAR_____10_CM 1 100. 0. 3. ECU_ADDRESS 0x3fd7b5 FORMAT "%1.0" /end MEASUREMENT
/begin MEASUREMENT STATE_SWI_OFF_VB "state switch off battery voltage (kl30)" UBYTE _CNV_A_R_LINEAR_____10_CM 1 100. 0. 3. ECU_ADDRESS 0x3fd7ba FORMAT "%1.0" /end MEASUREMENT
/begin MEASUREMENT CKS_CAN_TQ_DCC "Checksum TQ_DCC from CAN" UBYTE _CNV_A_R_LINEAR_____10_CM 1 100. 0. 255. ECU_ADDRESS 0x3fd795 FORMAT "%3.0" /end MEASUREMENT
/begin MEASUREMENT CKS_CAN_TQ_TCS "checksum traction control system TQ_TCS from CAN" UBYTE _CNV_A_R_LINEAR_____10_CM 1 100. 0. 255. ECU_ADDRESS 0x3fd7a5 FORMAT "%3.0" /end MEASUREMENT
/begin MEASUREMENT CKS_CAN_TQ_ETCU "check sum TQ_ETCU from CAN" UBYTE _CNV_A_R_LINEAR_____10_CM 1 100. 0. 255. ECU_ADDRESS 0x3fd7a9 FORMAT "%3.0" /end MEASUREMENT
/begin MEASUREMENT CKS_CAN_TQ_AMT "check sum TQ_AMT from CAN" UBYTE _CNV_A_R_LINEAR_____10_CM 1 100. 0. 255. ECU_ADDRESS 0x3fd7ad FORMAT "%3.0" /end MEASUREMENT
/begin MEASUREMENT CKS_CAN_MSW "checksum MSW - SZL" UBYTE _CNV_A_R_LINEAR_____10_CM 1 100. 0. 255. ECU_ADDRESS 0x3fd7b1 FORMAT "%3.0" /end MEASUREMENT
/begin MEASUREMENT LV_TEMP_ENG_1 "engine temperature - pre-indication overtemperature" UBYTE _CNV_S_2_RANGE______28_CM 1 100. 0. 1. ECU_ADDRESS 0x3fd7c6 /end MEASUREMENT
/begin MEASUREMENT LV_TEMP_ENG_2 "engine temperature - indication overtemperature" UBYTE _CNV_S_2_RANGE______28_CM 1 100. 0. 1. ECU_ADDRESS 0x3fd7c7 /end MEASUREMENT
/begin MEASUREMENT LV_TOIL_GS "Request GS due to high TOIL" UBYTE _CNV_S_2_RANGE______28_CM 1 100. 0. 1. ECU_ADDRESS 0x3fd7c8 /end MEASUREMENT
/begin MEASUREMENT TCC_CAN_ECU "free running test cycle counter ECU1 (alive counter)" UBYTE _CNV_A_R_LINEAR_____12_CM 1 100. 0. 14. ECU_ADDRESS 0x3fd7bc FORMAT "%2.0" /end MEASUREMENT
/begin MEASUREMENT TCC_CAN_ECU1 "free running test cycle counter ECU1 (alive counter)" UBYTE _CNV_A_R_LINEAR_____12_CM 1 100. 0. 14. ECU_ADDRESS 0x3fd7bd FORMAT "%2.0" /end MEASUREMENT
/begin MEASUREMENT TCC_CAN_ECU2 "free running test cycle counter ECU2 (alive counter)" UBYTE _CNV_A_R_LINEAR_____12_CM 1 100. 0. 14. ECU_ADDRESS 0x3fd7be FORMAT "%2.0" /end MEASUREMENT
/begin MEASUREMENT TCC_CAN_ECU3 "free running test cycle counter ECU3 (alive counter)" UBYTE _CNV_A_R_LINEAR_____12_CM 1 100. 0. 14. ECU_ADDRESS 0x3fd7bf FORMAT "%2.0" /end MEASUREMENT
/begin CHARACTERISTIC C_ICL_DISP_FRQ "calibratable constant for display messages on ICL" VALUE 0x428d3 _REC_VAL_20_u1 3. _CNV_A_R_LINEAR_____10_CM 0. 3. FORMAT "%2.0" /end CHARACTERISTIC
/begin CHARACTERISTIC C_TOIL_GS_MAX "Temperature threshold for actuating the pre-warning light (orange) for overtemperature " VALUE 0x42ac0 _REC_VAL_20_u1 200. _CNV_A_R_LINEAR_____3_CM -40. 160. FORMAT "%3.0" /end CHARACTERISTIC
/begin CHARACTERISTIC C_TCO_CHK_CTL_1 "Temperature threshold for actuating the pre-warning light (orange) for overtemperature " VALUE 0x42a46 _REC_VAL_20_u1 190.5 _CNV_A_R_LINEAR_____0_CM -48. 142.5 FORMAT "%5.1" /end CHARACTERISTIC
/begin CHARACTERISTIC C_TCO_CHK_CTL_2 "Temperature threshold for actuating the warning light (red) for overtemperature " VALUE 0x42a47 _REC_VAL_20_u1 190.5 _CNV_A_R_LINEAR_____0_CM -48. 142.5 FORMAT "%5.1" /end CHARACTERISTIC
/begin CHARACTERISTIC C_TCO_SUM_HYS_1 "Hysteresis for temperature threshold C_TCO_CHK_CTL_1" VALUE 0x42a84 _REC_VAL_20_u1 190.5 _CNV_A_R_LINEAR_____1_CM 0. 190.5 FORMAT "%5.1" /end CHARACTERISTIC
/begin CHARACTERISTIC C_TCO_SUM_HYS_2 "Hysteresis for temperature threshold C_TCO_CHK_CTL_2" VALUE 0x42a85 _REC_VAL_20_u1 190.5 _CNV_A_R_LINEAR_____1_CM 0. 190.5 FORMAT "%5.1" /end CHARACTERISTIC
/begin MEASUREMENT CKS_CAN_CAS "check sum CAS from CAN" UBYTE _CNV_A_R_LINEAR_____10_CM 1 100. 0. 255. ECU_ADDRESS 0x3fd79c FORMAT "%3.0" /end MEASUREMENT
/begin MEASUREMENT CKS_CLC_CAS "check sum CAS" UBYTE _CNV_A_R_LINEAR_____10_CM 1 100. 0. 255. ECU_ADDRESS 0x3fd79d FORMAT "%3.0" /end MEASUREMENT
/begin MEASUREMENT CKS_CLC_TQ_DCC "check sum TQ_DCC" UBYTE _CNV_A_R_LINEAR_____10_CM 1 100. 0. 255. ECU_ADDRESS 0x3fd796 FORMAT "%3.0" /end MEASUREMENT
/begin MEASUREMENT CKS_CLC_TQ_TCS "check sum TQ_TCS" UBYTE _CNV_A_R_LINEAR_____10_CM 1 100. 0. 255. ECU_ADDRESS 0x3fd7a6 FORMAT "%3.0" /end MEASUREMENT
/begin MEASUREMENT CKS_CLC_TQ_ETCU "check sum TQ_ETCU" UBYTE _CNV_A_R_LINEAR_____10_CM 1 100. 0. 255. ECU_ADDRESS 0x3fd7aa FORMAT "%3.0" /end MEASUREMENT
/begin MEASUREMENT CKS_CLC_TQ_AMT "check sum TQ_AMT" UBYTE _CNV_A_R_LINEAR_____10_CM 1 100. 0. 255. ECU_ADDRESS 0x3fd7ae FORMAT "%3.0" /end MEASUREMENT
/begin MEASUREMENT CKS_CLC_MSW "check sum CRU (SZL)" UBYTE _CNV_A_R_LINEAR_____10_CM 1 100. 0. 255. ECU_ADDRESS 0x3fd7b2 FORMAT "%3.0" /end MEASUREMENT
/begin MEASUREMENT CKS_CLC_ECU1 "check sum ECU 1" UBYTE _CNV_A_R_LINEAR_____10_CM 1 100. 0. 255. ECU_ADDRESS 0x3fd7c0 FORMAT "%3.0" /end MEASUREMENT
/begin MEASUREMENT CKS_CLC_ECU2 "check sum ECU 2" UBYTE _CNV_A_R_LINEAR_____10_CM 1 100. 0. 255. ECU_ADDRESS 0x3fd7c1 FORMAT "%3.0" /end MEASUREMENT
/begin MEASUREMENT CKS_CLC_ECU3 "check sum ECU 3" UBYTE _CNV_A_R_LINEAR_____10_CM 1 100. 0. 255. ECU_ADDRESS 0x3fd7c2 FORMAT "%3.0" /end MEASUREMENT
/begin CHARACTERISTIC C_TQ_MAX_ACC "torque limitation for torque loss ACC" VALUE 0x42adb _REC_VAL_20_u1 127. _CNV_A_R_LINEAR_____72_CM 0. 127. FORMAT "%5.1" /end CHARACTERISTIC
/begin CHARACTERISTIC C_CC_MESS "ID2 check-control message standard ID2_CC_MESS_STD (Standard CC-report)" VALUE 0x4280c _REC_VAL_20_u1 255. _CNV_A_R_LINEAR_____10_CM 0. 255. FORMAT "%3.0" /end CHARACTERISTIC
/begin MEASUREMENT CKS_CAN_VEH_MOD "check sum VEH_MOD from CAN" UBYTE _CNV_A_R_LINEAR_____10_CM 1 100. 0. 255. ECU_ADDRESS 0x3fd7a0 FORMAT "%3.0" /end MEASUREMENT
/begin MEASUREMENT CC_ID "Checkcontrol ID" UWORD _CNV_A_R_LINEAR_____10_CM 1 100. 0. 65535. ECU_ADDRESS 0x3fd790 FORMAT "%5.0" /end MEASUREMENT
/begin MEASUREMENT LV_MIL_FLL "bit for MIL flash light" UBYTE _CNV_S_2_RANGE______28_CM 1 100. 0. 1. ECU_ADDRESS 0x3fd7cb /end MEASUREMENT
/begin MEASUREMENT TQ_AMT_FAST_DEC_BN "fast torque decreased intervention due to AMT" SWORD _CNV_A_R_LINEAR_____48_CM 1 100. -1024. 1023.96875 ECU_ADDRESS 0x3fc456 FORMAT "%8.2" /end MEASUREMENT
/begin MEASUREMENT TQ_AMT_SLOW_DEC_BN "slow torque decreased intervention due to AMT" SWORD _CNV_A_R_LINEAR_____48_CM 1 100. -1024. 1023.96875 ECU_ADDRESS 0x3fc458 FORMAT "%8.2" /end MEASUREMENT
/begin MEASUREMENT TQ_AMT_FAST_INC_BN "fast torque increased intervention due to AMT" SWORD _CNV_A_R_LINEAR_____48_CM 1 100. -1024. 1023.96875 ECU_ADDRESS 0x3fc452 FORMAT "%8.2" /end MEASUREMENT
/begin MEASUREMENT TQ_AMT_SLOW_INC_BN "slow torque increased intervention due to AMT" SWORD _CNV_A_R_LINEAR_____48_CM 1 100. -1024. 1023.96875 ECU_ADDRESS 0x3fc454 FORMAT "%8.2" /end MEASUREMENT
/begin MEASUREMENT TQ_DCC_FAST_INC_BN "fast torque increased intervention due to DCC" SWORD _CNV_A_R_LINEAR_____48_CM 1 100. -1024. 1023.96875 ECU_ADDRESS 0x3fc45a FORMAT "%8.2" /end MEASUREMENT
/begin MEASUREMENT TQ_DCC_SLOW_INC_BN "slow torque increased intervention due to DCC" SWORD _CNV_A_R_LINEAR_____48_CM 1 100. -1024. 1023.96875 ECU_ADDRESS 0x3fc45c FORMAT "%8.2" /end MEASUREMENT
/begin MEASUREMENT TQ_GS_FAST_DEC_BN "fast torque decreased intervention due to GS" SWORD _CNV_A_R_LINEAR_____48_CM 1 100. -1024. 1023.96875 ECU_ADDRESS 0x3fc44e FORMAT "%8.2" /end MEASUREMENT
/begin MEASUREMENT TQ_GS_FAST_INC_BN "fast torque increased intervention due to GS" SWORD _CNV_A_R_LINEAR_____48_CM 1 100. -1024. 1023.96875 ECU_ADDRESS 0x3fc44a FORMAT "%8.2" /end MEASUREMENT
/begin MEASUREMENT TQ_GS_SLOW_DEC_BN "slow torque decreased intervention due to GS" SWORD _CNV_A_R_LINEAR_____48_CM 1 100. -1024. 1023.96875 ECU_ADDRESS 0x3fc450 FORMAT "%8.2" /end MEASUREMENT
/begin MEASUREMENT TQ_GS_SLOW_INC_BN "slow torque increased intervention due to GS" SWORD _CNV_A_R_LINEAR_____48_CM 1 100. -1024. 1023.96875 ECU_ADDRESS 0x3fc44c FORMAT "%8.2" /end MEASUREMENT
/begin MEASUREMENT TQ_MSR_FAST_INC_BN "fast torque increased intervention due to TCS" SWORD _CNV_A_R_LINEAR_____48_CM 1 100. -1024. 1023.96875 ECU_ADDRESS 0x3fc45e FORMAT "%8.2" /end MEASUREMENT
/begin MEASUREMENT TQ_MSR_SLOW_INC_BN "slow torque increased intervention due to TCS" SWORD _CNV_A_R_LINEAR_____48_CM 1 100. -1024. 1023.96875 ECU_ADDRESS 0x3fc460 FORMAT "%8.2" /end MEASUREMENT
/begin MEASUREMENT TQ_ASR_FAST_DEC_BN "fast torque decreased intervention due to TCS" SWORD _CNV_A_R_LINEAR_____48_CM 1 100. -1024. 1023.96875 ECU_ADDRESS 0x3fc462 FORMAT "%8.2" /end MEASUREMENT
/begin MEASUREMENT TQ_ASR_SLOW_DEC_BN "slow torque decreased intervention due to TCS" SWORD _CNV_A_R_LINEAR_____48_CM 1 100. -1024. 1023.96875 ECU_ADDRESS 0x3fc464 FORMAT "%8.2" /end MEASUREMENT
/begin CHARACTERISTIC C_MAX_MSG_MISS_ASR_CAN "maximum number of mised ASC messages (default value 10)" VALUE 0x42907 _REC_VAL_20_u1 255. _CNV_A_R_LINEAR_____10_CM 0. 255. FORMAT "%3.0" /end CHARACTERISTIC
/begin CHARACTERISTIC C_TMOT_SUM_HYS "Hysteresis for temperature threshold C_TCO_TMOT_STA" VALUE 0x42abe _REC_VAL_20_u1 190.5 _CNV_A_R_LINEAR_____1_CM 0. 190.5 FORMAT "%5.1" /end CHARACTERISTIC
/begin CHARACTERISTIC C_T_TCO_CAN_AST "Time condition for transmitting the coolant temperature to the CAN" VALUE 0x43032 _REC_VAL_20_u2 6553.5 _CNV_A_R_LINEAR_____14_CM 0. 6553.5 FORMAT "%6.1" /end CHARACTERISTIC
/begin CHARACTERISTIC C_TCO_SWI_WUP "TCO condition for setting the bit S_WL" VALUE 0x42a86 _REC_VAL_20_u1 190.5 _CNV_A_R_LINEAR_____0_CM -48. 142.5 FORMAT "%5.1" /end CHARACTERISTIC
/begin MEASUREMENT LV_ACK_TCS "Logical variable TCS acknowledge" UBYTE _CNV_S_2_RANGE______28_CM 1 100. 0. 1. ECU_ADDRESS 0x3fd8c1 BIT_MASK 0x1 /end MEASUREMENT
/begin CHARACTERISTIC C_T_CTR_MAX_ASR_CAN "maximum value timeout counter ASC message (default value 10)" VALUE 0x429c5 _REC_VAL_20_u1 2.55 _CNV_A_R_LINEAR_____27_CM 0. 2.55 FORMAT "%4.2" /end CHARACTERISTIC
/begin CHARACTERISTIC C_TCO_TMOT_STA "Temperature threshold for actuating the overtemperature warning light" VALUE 0x42a8d _REC_VAL_20_u1 190.5 _CNV_A_R_LINEAR_____0_CM -48. 142.5 FORMAT "%5.1" /end CHARACTERISTIC
/begin CHARACTERISTIC C_FAC_MFF_FCO "Transition factor MFF to FCO" VALUE 0x42d20 _REC_VAL_20_u2 0.99998474 _CNV_A_R_LINEAR_____31_CM 0. 0.99998474 FORMAT "%7.5" /end CHARACTERISTIC
/begin MEASUREMENT FCO "integrated fuel consumption" ULONG _CNV_A_R_LINEAR_____79_CM 1 100. 0. 4294967295. ECU_ADDRESS 0x3fc494 FORMAT "%11.0" /end MEASUREMENT
/begin MEASUREMENT LV_WUP_CAN "Indication for CAT heating ended" UBYTE _CNV_S_2_RANGE______11_CM 1 100. 0. 1. ECU_ADDRESS 0x3fc499 /end MEASUREMENT
/begin CHARACTERISTIC IP_T_AST_SWI_WUP__CTR_KM_CAN "time condition for setting the bit S_WL" CURVE 0x4a4e4 _REC_CUR_20_u2_u2 6553.5 _CNV_A_R_LINEAR_____14_CM 0. 6553.5 FORMAT "%6.1"
 /begin AXIS_DESCR COM_AXIS CTR_KM_CAN _CNV_A_R_LINEAR_____80_CM 4 0. 655340. FORMAT "%6.0" AXIS_PTS_REF ldpm_ctr_km_can /end AXIS_DESCR
/end CHARACTERISTIC
/begin CHARACTERISTIC C_PV_CAN_DIAG "limitation of PV_CAN at MTC error is active" VALUE 0x4298b _REC_VAL_20_u1 99.609375 _CNV_A_R_LINEAR_____4_CM 0. 99.609375 FORMAT "%4.1" /end CHARACTERISTIC
/begin CHARACTERISTIC C_ENG_ETCU "?????" VALUE 0x42894 _REC_VAL_20_u1 255. _CNV_A_R_LINEAR_____10_CM 0. 255. FORMAT "%3.0" /end CHARACTERISTIC
/begin MEASUREMENT CTL_SHIFT_LOCK_CAN "control shift-lock" UBYTE _CNV_A_R_LINEAR_____10_CM 1 100. 0. 3. ECU_ADDRESS 0x3fc498 FORMAT "%1.0" /end MEASUREMENT
/begin MEASUREMENT LV_LEVEL_IS "status switch level rpm" UBYTE _CNV_S_2_RANGE______28_CM 1 100. 0. 1. ECU_ADDRESS 0x3fc49a /end MEASUREMENT
/begin AXIS_PTS ldpm_ctr_km_can "" 0x44ed2 CTR_KM_CAN _REC_AXS_20_u2 655340. _CNV_A_R_LINEAR_____80_CM 4 0. 655340. FORMAT "%6.0" /end AXIS_PTS
/begin MEASUREMENT TQI_MAF "indicated engine torque after charging interventions (converted for CAN)" SWORD _CNV_A_R_LINEAR_____48_CM 1 100. -1024. 1023.96875 ECU_ADDRESS 0x3fc47a FORMAT "%8.2" /end MEASUREMENT
/begin MEASUREMENT LV_N_MAF_DYW_CP "Dynamic windw on N and MAF" UBYTE _CNV_S_2_RANGE______28_CM 1 100. 0. 1. ECU_ADDRESS 0x3fc508 BIT_MASK 0x1 /end MEASUREMENT
/begin MEASUREMENT N_DYW_CP "N average value for dynamic window" UWORD _CNV_A_R_LINEAR_____17_CM 1 100. 0. 8160. ECU_ADDRESS 0x3fd97e FORMAT "%4.0" /end MEASUREMENT
/begin MEASUREMENT MAF_DYW_CP "MAF  average value for dynamic window" UWORD _CNV_A_R_LINEAR_____95_CM 1 100. 0. 1389. ECU_ADDRESS 0x3fd980 FORMAT "%7.2" /end MEASUREMENT
/begin MEASUREMENT LV_CP_ACT "Logical value for EVAP-Control active" UBYTE _CNV_S_2_RANGE______11_CM 1 100. 0. 1. ECU_ADDRESS 0x3fc507 BIT_MASK 0x1 /end MEASUREMENT
/begin MEASUREMENT CDN_STATE_CP "Activation conditions for evaporative emission control function" UBYTE _CNV_S_6_RANGE_CDN__96_CM 1 100. 0. 5. ECU_ADDRESS 0x3fc506 /end MEASUREMENT
/begin MEASUREMENT LV_CP_ACT_REQ "Request to inhib Catalyst and  O2 sensor diagnosis for allowing purge canister activation" UBYTE _CNV_S_2_RANGE______11_CM 1 100. 0. 1. ECU_ADDRESS 0x3fc509 BIT_MASK 0x1 /end MEASUREMENT
/begin MEASUREMENT LV_PU_CP "Flag to interrupt the purge in PU mode" UBYTE _CNV_S_2_RANGE______11_CM 1 100. 0. 1. ECU_ADDRESS 0x3fc50a BIT_MASK 0x1 /end MEASUREMENT
/begin MEASUREMENT PRS_CPS "Pressure difference at CPS" SWORD _CNV_A_R_LINEAR_____97_CM 1 100. -2717.04 2716.96 ECU_ADDRESS 0x3fc504 FORMAT "%8.2" /end MEASUREMENT
/begin CHARACTERISTIC C_T_DLY_PU_CPS "" VALUE 0x42f9a _REC_VAL_20_u2 6553.400000000001 _CNV_A_R_LINEAR_____14_CM 0.1 6553.5 FORMAT "%6.1" /end CHARACTERISTIC
/begin CHARACTERISTIC C_PRS_MAX_CPS "" VALUE 0x432b8 _REC_VAL_20_s2 5434. _CNV_A_R_LINEAR_____97_CM -2717.04 2716.96 FORMAT "%8.2" /end CHARACTERISTIC
/begin CHARACTERISTIC C_TIA_MIN_CP "" VALUE 0x42ab5 _REC_VAL_20_u1 190.5 _CNV_A_R_LINEAR_____0_CM -48. 142.5 FORMAT "%5.1" /end CHARACTERISTIC
/begin CHARACTERISTIC C_N_CP_TOL "" VALUE 0x42935 _REC_VAL_20_u1 8160. _CNV_A_R_LINEAR_____5_CM 0. 8160. FORMAT "%4.0" /end CHARACTERISTIC
/begin CHARACTERISTIC C_N_CP_BOL "" VALUE 0x42934 _REC_VAL_20_u1 8160. _CNV_A_R_LINEAR_____5_CM 0. 8160. FORMAT "%4.0" /end CHARACTERISTIC
/begin CHARACTERISTIC C_MAF_CP_BOL "" VALUE 0x428fd _REC_VAL_20_u1 1389. _CNV_A_R_LINEAR_____18_CM 0. 1389. FORMAT "%4.0" /end CHARACTERISTIC
/begin CHARACTERISTIC C_MAF_CP_TOL "" VALUE 0x428fe _REC_VAL_20_u1 1389. _CNV_A_R_LINEAR_____18_CM 0. 1389. FORMAT "%4.0" /end CHARACTERISTIC
/begin CHARACTERISTIC C_T_LAM_LIM_CP "" VALUE 0x42fea _REC_VAL_20_u2 6553.5 _CNV_A_R_LINEAR_____14_CM 0. 6553.5 FORMAT "%5.1" /end CHARACTERISTIC
/begin CHARACTERISTIC C_CL_MMV_REQ "" VALUE 0x42c56 _REC_VAL_20_u2 1.99996948 _CNV_A_R_LINEAR_____45_CM 0. 1.99996948 FORMAT "%7.5" /end CHARACTERISTIC
/begin CHARACTERISTIC C_T_LAM_CP_DLY "" VALUE 0x42fe8 _REC_VAL_20_u2 65534. _CNV_A_R_LINEAR_____47_CM 1. 65535. FORMAT "%5.0" /end CHARACTERISTIC
/begin CHARACTERISTIC C_LAM_CP_BOL "" VALUE 0x43268 _REC_VAL_20_s2 99.99847412 _CNV_A_R_LINEAR_____98_CM -50. 49.99847412 FORMAT "%5.4" /end CHARACTERISTIC
/begin CHARACTERISTIC C_LAM_CP_TOL "" VALUE 0x4326a _REC_VAL_20_s2 99.99847412 _CNV_A_R_LINEAR_____98_CM -50. 49.99847412 FORMAT "%5.4" /end CHARACTERISTIC
/begin CHARACTERISTIC C_DLY_N_MAF_DYW_CP "" VALUE 0x42cca _REC_VAL_20_u2 655.35 _CNV_A_R_LINEAR_____27_CM 0. 655.35 FORMAT "%5.2" /end CHARACTERISTIC
/begin CHARACTERISTIC C_MAF_DYW_CP "" VALUE 0x42e12 _REC_VAL_20_u2 1389. _CNV_A_R_LINEAR_____95_CM 0. 1389. FORMAT "%7.2" /end CHARACTERISTIC
/begin CHARACTERISTIC C_N_DYW_CP "" VALUE 0x42eac _REC_VAL_20_u2 8159. _CNV_A_R_LINEAR_____17_CM 1. 8160. FORMAT "%4.0" /end CHARACTERISTIC
/begin CHARACTERISTIC C_TCO_MIN_CP "" VALUE 0x42a65 _REC_VAL_20_u1 28.575 _CNV_A_R_LINEAR_____0_CM -48. 142.5 FORMAT "%5.1" /end CHARACTERISTIC
/begin MEASUREMENT LV_ETCU_DISABLE "Logical variable for disabling GS intervention due to EMS error" UBYTE _CNV_S_2_RANGE______28_CM 1 100. 0. 1. ECU_ADDRESS 0x3fd0e2 /end MEASUREMENT
/begin MEASUREMENT LV_ETCU_DISABLE_CAN "logical variable for disabling GS intervention due to CAN error" UBYTE _CNV_S_2_RANGE______28_CM 1 100. 0. 1. ECU_ADDRESS 0x3fd0e3 BIT_MASK 0x1 /end MEASUREMENT
/begin MEASUREMENT LV_GS_ENA_DEC "logical variable for decreased torque intervention due to gear shift" UBYTE _CNV_S_2_RANGE______28_CM 1 100. 0. 1. ECU_ADDRESS 0x3fd0e4 BIT_MASK 0x1 /end MEASUREMENT
/begin MEASUREMENT LV_GS_ENA "Logical variable for GS intervention enabling" UBYTE _CNV_S_2_RANGE______28_CM 1 100. 0. 1. ECU_ADDRESS 0x3fe732 BIT_MASK 0x1 /end MEASUREMENT
/begin CHARACTERISTIC C_T_MAX_TQR_GS_INTV "Maximum duration of torque reduction due gear shift intervention" VALUE 0x42ffe _REC_VAL_20_u2 655.35 _CNV_A_R_LINEAR_____27_CM 0. 655.35 FORMAT "%6.2" /end CHARACTERISTIC
/begin MEASUREMENT TQI_GS_FAST_DEC_REQ_1 "Torque decrement for fast torque intervention during gear shift" SWORD _CNV_A_R_LINEAR_____48_CM 1 100. -1024. 1023.96875 ECU_ADDRESS 0x3fd0d2 FORMAT "%8.2" /end MEASUREMENT
/begin MEASUREMENT TQI_GS_SLOW_DEC_REQ "Torque decrement for slow torque intervention during gear shift" SWORD _CNV_A_R_LINEAR_____48_CM 1 100. -1024. 1023.96875 ECU_ADDRESS 0x3fd0cc FORMAT "%8.2" /end MEASUREMENT
/begin MEASUREMENT TQI_GS_FAST_INC_REQ_1 "torque increase for fast torque intervention during gear shift" SWORD _CNV_A_R_LINEAR_____48_CM 1 100. -1024. 1023.96875 ECU_ADDRESS 0x3fd0d6 FORMAT "%8.2" /end MEASUREMENT
/begin MEASUREMENT TQI_GS_SLOW_INC_REQ "torque increase for slow torque intervention during gear shift" SWORD _CNV_A_R_LINEAR_____48_CM 1 100. -1024. 1023.96875 ECU_ADDRESS 0x3fd0d0 FORMAT "%8.2" /end MEASUREMENT
/begin MEASUREMENT T_TQR_GS_INTV "duration of gear shift torque intervention" UWORD _CNV_A_R_LINEAR_____27_CM 1 100. 0. 655.35 ECU_ADDRESS 0x3fd0c8 FORMAT "%6.2" /end MEASUREMENT
/begin MEASUREMENT TQI_GS_FAST_DEC_REQ "Torque decrement for fast torque intervention during gear shift" SWORD _CNV_A_R_LINEAR_____48_CM 1 100. -1024. 1023.96875 ECU_ADDRESS 0x3fd0ca FORMAT "%8.2" /end MEASUREMENT
/begin MEASUREMENT TQI_GS_FAST_DEC "torque decrement for fast torque intervention during gear shift" SWORD _CNV_A_R_LINEAR_____48_CM 1 100. -1024. 1023.96875 ECU_ADDRESS 0x3fd0da FORMAT "%8.2" /end MEASUREMENT
/begin MEASUREMENT TQI_GS_SLOW_DEC_REQ_1 "Torque decrement for slow torque intervention during gear shift" SWORD _CNV_A_R_LINEAR_____48_CM 1 100. -1024. 1023.96875 ECU_ADDRESS 0x3fd0d4 FORMAT "%8.2" /end MEASUREMENT
/begin MEASUREMENT TQI_GS_SLOW_DEC "Torque decrement for slow torque intervention during gear shift" SWORD _CNV_A_R_LINEAR_____48_CM 1 100. -1024. 1023.96875 ECU_ADDRESS 0x3fd0dc FORMAT "%8.2" /end MEASUREMENT
/begin MEASUREMENT LV_GS_ENA_INC "logical variable for increased torque intervention due to gear shift" UBYTE _CNV_S_2_RANGE______28_CM 1 100. 0. 1. ECU_ADDRESS 0x3fd0e5 BIT_MASK 0x1 /end MEASUREMENT
/begin MEASUREMENT LV_GS_DEC_LIH "logical variable for torque intervention LIH due to gear shift" UBYTE _CNV_S_2_RANGE______28_CM 1 100. 0. 1. ECU_ADDRESS 0x3fe733 /end MEASUREMENT
/begin CHARACTERISTIC C_GS_ENA_INC_DEC "Enable switch GS intervention" VALUE 0x428cf _REC_VAL_20_u1 3. _CNV_S_4_STATE_AMT__200_CM 0. 3. /end CHARACTERISTIC
/begin MEASUREMENT TQI_GS_FAST_INC_REQ "torque increase for fast torque intervention during gear shift" SWORD _CNV_A_R_LINEAR_____48_CM 1 100. -1024. 1023.96875 ECU_ADDRESS 0x3fd0ce FORMAT "%8.2" /end MEASUREMENT
/begin MEASUREMENT TQI_GS_FAST_INC "torque increase for fast torque intervention during gear shift" SWORD _CNV_A_R_LINEAR_____48_CM 1 100. -1024. 1023.96875 ECU_ADDRESS 0x3fd0de FORMAT "%8.2" /end MEASUREMENT
/begin MEASUREMENT TQI_GS_SLOW_INC_REQ_1 "torque increase for slow torque intervention during gear shift" SWORD _CNV_A_R_LINEAR_____48_CM 1 100. -1024. 1023.96875 ECU_ADDRESS 0x3fd0d8 FORMAT "%8.2" /end MEASUREMENT
/begin MEASUREMENT TQI_GS_SLOW_INC "torque increase for slow torque intervention during gear shift" SWORD _CNV_A_R_LINEAR_____48_CM 1 100. -1024. 1023.96875 ECU_ADDRESS 0x3fd0e0 FORMAT "%8.2" /end MEASUREMENT
/begin MEASUREMENT LV_GS_DEC_ACT "logical variable for torque intervention due to gear shift" UBYTE _CNV_S_2_RANGE______28_CM 1 100. 0. 1. ECU_ADDRESS 0x3fd0e6 /end MEASUREMENT
/begin MEASUREMENT LV_GS_INC_LIH "logical variable for torque intervention LIH due to gear shift" UBYTE _CNV_S_2_RANGE______28_CM 1 100. 0. 1. ECU_ADDRESS 0x3fd0e8 /end MEASUREMENT
/begin CHARACTERISTIC C_LGRD_LIH_GS_DEC "limiting gradient for GS emergency ramp function (default  0.6 Nm/10ms)" VALUE 0x42df6 _REC_VAL_20_u2 1023.96875 _CNV_A_R_LINEAR_____201_CM 0. 1023.96875 FORMAT "%7.2" /end CHARACTERISTIC
/begin CHARACTERISTIC C_LGRD_LIH_GS_INC "limiting gradient for GS emergency ramp function (default  0.6 Nm/10ms)" VALUE 0x42df8 _REC_VAL_20_u2 1023.96875 _CNV_A_R_LINEAR_____201_CM 0. 1023.96875 FORMAT "%7.2" /end CHARACTERISTIC
/begin CHARACTERISTIC C_T_DLY_LIH_GS_DEC "delay time for activation of GS emergency ramp function (default 0s)" VALUE 0x429e8 _REC_VAL_20_u1 2.55 _CNV_A_R_LINEAR_____27_CM 0. 2.55 FORMAT "%4.2" /end CHARACTERISTIC
/begin CHARACTERISTIC C_T_DLY_LIH_GS_INC "delay time for activation of GS emergency ramp function (default 0s)" VALUE 0x429e9 _REC_VAL_20_u1 2.55 _CNV_A_R_LINEAR_____27_CM 0. 2.55 FORMAT "%4.2" /end CHARACTERISTIC
/begin MEASUREMENT LV_GS_INC_ACT "logical variable for torque intervention due to gear shift" UBYTE _CNV_S_2_RANGE______28_CM 1 100. 0. 1. ECU_ADDRESS 0x3fd0e7 /end MEASUREMENT
/begin MEASUREMENT T_GS_INC_LIH_CTR "delay time for activation of GS emergency ramp function " UBYTE _CNV_A_R_LINEAR_____27_CM 1 100. 0. 2.55 ECU_ADDRESS 0x3fe731 FORMAT "%4.2" /end MEASUREMENT
/begin MEASUREMENT T_GS_DEC_LIH_CTR "delay time for activation of GS emergency ramp function" UBYTE _CNV_A_R_LINEAR_____27_CM 1 100. 0. 2.55 ECU_ADDRESS 0x3fe730 FORMAT "%4.2" /end MEASUREMENT
/begin MEASUREMENT EFF_LAMB_BAS_COR "Basic lambda efficiency" UWORD _CNV_A_R_LINEAR_____45_CM 1 100. 0. 1.99996948 ECU_ADDRESS 0x3fcb20 FORMAT "%7.5" /end MEASUREMENT
/begin MEASUREMENT LAMB_REF_COR "Corrected lambda reference value" UWORD _CNV_A_R_LINEAR_____148_CM 1 100. 0. 31.99902344 ECU_ADDRESS 0x3fcb26 FORMAT "%7.4" /end MEASUREMENT
/begin MEASUREMENT LAMB_DIF_BAS "Basic lambda difference to corrected reference lambda" SWORD _CNV_A_R_LINEAR_____307_CM 1 100. -32.00000000125 31.99902343875 ECU_ADDRESS 0x3fdc10 /end MEASUREMENT
/begin MEASUREMENT LAMB_DIF_AV "Actual lambda difference to corrected reference lambda" SWORD _CNV_A_R_LINEAR_____307_CM 1 100. -32.00000000125 31.99902343875 ECU_ADDRESS 0x3fdc12 /end MEASUREMENT
/begin MEASUREMENT LAMB_REF_ADD_TCO "Additive correction of reference lambda value " SWORD _CNV_A_R_LINEAR_____307_CM 1 100. -32.00000000125 31.99902343875 ECU_ADDRESS 0x3fdc0e /end MEASUREMENT
/begin MEASUREMENT LAMB_DIF_MAX "Maximum lambda difference to corrected reference lambda" SWORD _CNV_A_R_LINEAR_____307_CM 1 100. -32.00000000125 31.99902343875 ECU_ADDRESS 0x3fdc14 /end MEASUREMENT
/begin MEASUREMENT EFF_LAMB_AV "Actual lambda efficiency" UWORD _CNV_A_R_LINEAR_____45_CM 1 100. 0. 1.99996948 ECU_ADDRESS 0x3fcb22 FORMAT "%7.5" /end MEASUREMENT
/begin MEASUREMENT EFF_LAMB_MIN "Minimum lambda efficiency" UWORD _CNV_A_R_LINEAR_____45_CM 1 100. 0. 1.99996948 ECU_ADDRESS 0x3fcb24 FORMAT "%7.5" /end MEASUREMENT
/begin CHARACTERISTIC IP_LAMB_REF_ADD "Additive lambda correction versus coolant temperature" CURVE 0x48c56 _REC_CUR_20_u2_u1 63.99902344 _CNV_A_R_LINEAR_____273_CM -32. 31.99902344 FORMAT "%8.4"
 /begin AXIS_DESCR COM_AXIS TCO _CNV_A_R_LINEAR_____0_CM 6 -48. 142.5 FORMAT "%5.1" AXIS_PTS_REF ldp_tco__lamb_ref_add /end AXIS_DESCR
/end CHARACTERISTIC
/begin CHARACTERISTIC IP_LAMB_REF "Reference lambda" MAP 0x48c0e _REC_MAP_20_u2_u1_u1 31.99902344 _CNV_A_R_LINEAR_____148_CM 0. 31.99902344 FORMAT "%7.4"
 /begin AXIS_DESCR COM_AXIS N_32 _CNV_A_R_LINEAR_____5_CM 6 0. 8160. FORMAT "%4.0" AXIS_PTS_REF ldp_n__lamb_ref /end AXIS_DESCR
 /begin AXIS_DESCR COM_AXIS MAF _CNV_A_R_LINEAR_____18_CM 6 0. 1389. FORMAT "%4.0" AXIS_PTS_REF ldp_maf__lamb_ref /end AXIS_DESCR
/end CHARACTERISTIC
/begin MEASUREMENT EFF_LAMB_SP_BAS "Basic lambda setpoint efficiency" UWORD _CNV_A_R_LINEAR_____45_CM 1 100. 0. 1.99996948 ECU_ADDRESS 0x3fcb28 FORMAT "%7.5" /end MEASUREMENT
/begin MEASUREMENT LAMB_REF "Lambda reference valua" UWORD _CNV_A_R_LINEAR_____148_CM 1 100. 0. 31.99902344 ECU_ADDRESS 0x3fdc0c FORMAT "%7.4" /end MEASUREMENT
/begin MEASUREMENT LAMB_DIF_SP_BAS "Basic lambda setpoint difference to corrected reference lambda" SWORD _CNV_A_R_LINEAR_____307_CM 1 100. -32.00000000125 31.99902343875 ECU_ADDRESS 0x3fdc16 /end MEASUREMENT
/begin AXIS_PTS ldp_tco__lamb_ref_add "" 0x43890 TCO _REC_AXS_20_u1 190.5 _CNV_A_R_LINEAR_____0_CM 6 -48. 142.5 FORMAT "%5.1" /end AXIS_PTS
/begin AXIS_PTS ldp_n__lamb_ref "" 0x43717 N_32 _REC_AXS_20_u1 816. _CNV_A_R_LINEAR_____5_CM 6 0. 8160. FORMAT "%4.0" /end AXIS_PTS
/begin AXIS_PTS ldp_maf__lamb_ref "" 0x4345d MAF _REC_AXS_20_u1 1389. _CNV_A_R_LINEAR_____18_CM 6 0. 1389. FORMAT "%4.0" /end AXIS_PTS
/begin MEASUREMENT LAMB_SP_TQI "Lambda setpoint torque based" UWORD _CNV_A_R_LINEAR_____148_CM 1 100. 0. 31.99902344 ECU_ADDRESS 0x3fcb2a FORMAT "%7.4" /end MEASUREMENT
/begin MEASUREMENT LV_TQ_LAMB_ACT "Logical variable torque based lambda output is active" UBYTE _CNV_S_2_RANGE______11_CM 1 100. 0. 1. ECU_ADDRESS 0x3fcb30 /end MEASUREMENT
/begin MEASUREMENT EFF_LAMB_SP "Lambda efficiency setpoint torque based" UWORD _CNV_A_R_LINEAR_____45_CM 1 100. 0. 1.99996948 ECU_ADDRESS 0x3fcb2c FORMAT "%7.5" /end MEASUREMENT
/begin MEASUREMENT EFF_LAMB_SP_1 "Unlimited lambda efficiency setpoint torque based" UWORD _CNV_A_R_LINEAR_____45_CM 1 100. 0. 1.99996948 ECU_ADDRESS 0x3fcb2e FORMAT "%7.5" /end MEASUREMENT
/begin MEASUREMENT TQI_FAST_LAMB "Fast torque setpoint for torque based lambda setpoint calculation" SWORD _CNV_A_R_LINEAR_____48_CM 1 100. -1024. 1023.96875 ECU_ADDRESS 0x3fdc18 FORMAT "%8.2" /end MEASUREMENT
/begin MEASUREMENT LAMB_DIF_SP "Setpoint lambda difference to corrected reference lambda for LAMB_SP_TQI calculation" SWORD _CNV_A_R_LINEAR_____307_CM 1 100. -32.00000000125 31.99902343875 ECU_ADDRESS 0x3fdc1a /end MEASUREMENT
/begin CHARACTERISTIC IP_LAMB_DIF_SP "Setpoiont difference lambda applied on LAMB_REF_COR" CURVE 0x489d6 _REC_CUR_20_u2_u2 63.99902344 _CNV_A_R_LINEAR_____273_CM -32. 31.99902344 FORMAT "%8.4"
 /begin AXIS_DESCR COM_AXIS EFF_LAMB_SP _CNV_A_R_LINEAR_____45_CM 16 0. 1.99996948 FORMAT "%7.5" AXIS_PTS_REF ldp_eff_lamb_sp__lamb_dif_sp /end AXIS_DESCR
/end CHARACTERISTIC
/begin CHARACTERISTIC C_EFF_LAMB_SP_MAX "Maximum allowable efficiency lambda setpoint value" VALUE 0x42cd6 _REC_VAL_20_u2 1.99996948 _CNV_A_R_LINEAR_____45_CM 0. 1.99996948 FORMAT "%7.5" /end CHARACTERISTIC
/begin CHARACTERISTIC LC_TQ_LAMB_INH_MAN "Manual inihibition of torque based lambda setpoint calculation" VALUE 0x42be3 _REC_VAL_20_u1 1. _CNV_A_R_LINEAR_____10_CM 0. 1. FORMAT "%2.0" /end CHARACTERISTIC
/begin CHARACTERISTIC LC_TQ_LAMB_ENA_MAN "Manual switching on of torque based lamba setpoint calculation" VALUE 0x42be2 _REC_VAL_20_u1 1. _CNV_A_R_LINEAR_____10_CM 0. 1. FORMAT "%2.0" /end CHARACTERISTIC
/begin AXIS_PTS ldp_eff_lamb_sp__lamb_dif_sp "" 0x442b6 EFF_LAMB_SP _REC_AXS_20_u2 0.199996948 _CNV_A_R_LINEAR_____45_CM 16 0. 1.99996948 FORMAT "%7.5" /end AXIS_PTS
/begin MEASUREMENT LV_INH_R_DOWN_LS_1 "Boolean flag indicating that downstream sensor internal resistance determiantion shall be inhibited when set" UBYTE _CNV_S_2_RANGE______11_CM 1 100. 0. 1. ECU_ADDRESS 0x3faf95 /end MEASUREMENT
/begin MEASUREMENT LV_INH_R_DOWN_LS_2 "Boolean flag indicating that downstream sensor internal resistance determiantion shall be inhibited when set" UBYTE _CNV_S_2_RANGE______11_CM 1 100. 0. 1. ECU_ADDRESS 0x3faf96 /end MEASUREMENT
/begin MEASUREMENT LV_INH_R_UP_LS_2 "Boolean flag indicating that upstrem sensor internal resistance determination shall be inhibited when set" UBYTE _CNV_S_2_RANGE______11_CM 1 100. 0. 1. ECU_ADDRESS 0x3faf9c /end MEASUREMENT
/begin MEASUREMENT LV_INH_R_UP_LS_1 "Boolean flag indicating that upstrem sensor internal resistance determination shall be inhibited when set" UBYTE _CNV_S_2_RANGE______11_CM 1 100. 0. 1. ECU_ADDRESS 0x3faf9b /end MEASUREMENT
/begin MEASUREMENT MAF_MAX_COR "Maximum intake air depending on engine speed an air density" UWORD _CNV_A_R_LINEAR_____95_CM 1 100. 0. 1389. ECU_ADDRESS 0x3fc648 FORMAT "%6.2" /end MEASUREMENT
/begin MEASUREMENT LV_AMP_AD_STOP "Adaptation of ambient pressure is stopped" UBYTE _CNV_S_2_RANGE______28_CM 1 100. 0. 1. ECU_ADDRESS 0x3fc6ba BIT_MASK 0x1 /end MEASUREMENT
/begin MEASUREMENT LV_AMP_CTL_STOP "Ambient pressure controller is stopped" UBYTE _CNV_S_2_RANGE______28_CM 1 100. 0. 1. ECU_ADDRESS 0x3fc6b8 BIT_MASK 0x1 /end MEASUREMENT
/begin MEASUREMENT LV_AR_RED_AD_RST "Adaptation of reduced area is reseted to \"0\"" UBYTE _CNV_S_2_RANGE______28_CM 1 100. 0. 1. ECU_ADDRESS 0x3fc6bd BIT_MASK 0x1 /end MEASUREMENT
/begin MEASUREMENT LV_AR_RED_AD_STOP "Adaptation of reduced area is stopped" UBYTE _CNV_S_2_RANGE______28_CM 1 100. 0. 1. ECU_ADDRESS 0x3fc6bc BIT_MASK 0x1 /end MEASUREMENT
/begin MEASUREMENT LV_AR_RED_CTL_STOP "Reduced area controller is stopped" UBYTE _CNV_S_2_RANGE______28_CM 1 100. 0. 1. ECU_ADDRESS 0x3fc6b9 BIT_MASK 0x1 /end MEASUREMENT
/begin MEASUREMENT MAF_KGH_MES_FAC "Correction factor for MAF_KGH_MES" UBYTE _CNV_A_R_LINEAR_____34_CM 1 100. 0. 1.99220002 ECU_ADDRESS 0x3fc6b6 FORMAT "%5.3" /end MEASUREMENT
/begin CHARACTERISTIC IP_FAC_MAF_KGH_COR "Correction for MAF_KGH_MES depending on MAF_KGH_MES_BAS" CURVE 0x4e21b _REC_CUR_20_u1_u2 1.9921875 _CNV_A_R_LINEAR_____103_CM 0. 1.9921875 FORMAT "%5.3"
 /begin AXIS_DESCR COM_AXIS MAF_KGH_MES_BAS _CNV_A_R_LINEAR_____101_CM 16 0. 2047.96875 FORMAT "%7.2" AXIS_PTS_REF ldp_maf_kgh_mes_bas /end AXIS_DESCR
/end CHARACTERISTIC
/begin MEASUREMENT LV_MAP_CTL "MAP controlled system" UBYTE _CNV_S_2_RANGE______28_CM 1 100. 0. 1. ECU_ADDRESS 0x3fc6be BIT_MASK 0x1 /end MEASUREMENT
/begin MEASUREMENT LV_AMP_AD_RST "Adaptation of ambient pressure is reseted to \"0\"" UBYTE _CNV_S_2_RANGE______28_CM 1 100. 0. 1. ECU_ADDRESS 0x3fc6bb BIT_MASK 0x1 /end MEASUREMENT
/begin MEASUREMENT LV_MAF_CTL "MAF controlled system" UBYTE _CNV_S_2_RANGE______28_CM 1 100. 0. 1. ECU_ADDRESS 0x3fdb56 BIT_MASK 0x1 /end MEASUREMENT
/begin AXIS_PTS ldp_maf_kgh_mes_bas "" 0x44668 MAF_KGH_MES_BAS _REC_AXS_20_u2 2047.96875 _CNV_A_R_LINEAR_____101_CM 16 0. 2047.96875 FORMAT "%7.2" /end AXIS_PTS
/begin MEASUREMENT MAP_MES "measured manifold air pressure" UWORD _CNV_A_R_LINEAR_____43_CM 1 100. 0. 5434. ECU_ADDRESS 0x3fc6b4 FORMAT "%7.2" /end MEASUREMENT
/begin MEASUREMENT STATE_CTL_INSY "State_of intake manifold model adaption" UBYTE _CNV_S_3_STATE_CTL__353_CM 1 100. 0. 2. ECU_ADDRESS 0x3fc6b7 /end MEASUREMENT
/begin CHARACTERISTIC C_PQ_AMP_CTL "Pressure quotient to switch from area to pressure control" VALUE 0x42ee0 _REC_VAL_20_u2 0.99998474 _CNV_A_R_LINEAR_____31_CM 0. 0.99998474 FORMAT "%7.5" /end CHARACTERISTIC
/begin CHARACTERISTIC C_PQ_AMP_CTL_HYS "Hysteresis around pressure ratio to switch from area to pressure control" VALUE 0x42ee2 _REC_VAL_20_u2 0.99998474 _CNV_A_R_LINEAR_____31_CM 0. 0.99998474 FORMAT "%7.5" /end CHARACTERISTIC
/begin MEASUREMENT EFF_MAF_S "Air efficiency in stratified combustion" UWORD _CNV_A_R_LINEAR_____45_CM 1 100. 0. 1.99996948 ECU_ADDRESS 0x3fc608 FORMAT "%7.5" /end MEASUREMENT
/begin MEASUREMENT IGA_IGC_0_5 "Ignition angle applied on the respective cylinder (0 to 5)" UBYTE _CNV_A_R_LINEAR_____202_CM 1 100. -35.625 60. ECU_ADDRESS 0x3fe2ca FORMAT "%5.1" /end MEASUREMENT
/begin MEASUREMENT IGA_KNK_0_5 "Spark retard due to knocking combustion of the respective cylinder (0 to 5)" UBYTE _CNV_A_R_LINEAR_____204_CM 1 100. -48. 0. ECU_ADDRESS 0x3fe2cb FORMAT "%5.1" /end MEASUREMENT
/begin MEASUREMENT KNK_THD_0_5 "Knock threshold of the respective cylinder (0 to 5)" UBYTE _CNV_A_R_LINEAR_____38_CM 1 100. 0. 4.998 ECU_ADDRESS 0x3fe2cc FORMAT "%6.4" /end MEASUREMENT
/begin MEASUREMENT NL_0_5 "Noise level of the respective cylinder (0 to 5)" UWORD _CNV_A_R_LINEAR_____256_CM 1 100. 0. 4.99992371 ECU_ADDRESS 0x3fe2c6 FORMAT "%7.5" /end MEASUREMENT
/begin MEASUREMENT TI_CYL_0_5 "fuel injection time for the respective cylinder (0 to 5)" UWORD _CNV_A_R_LINEAR_____208_CM 1 100. 0. 262.14 ECU_ADDRESS 0x3fe2c8 FORMAT "%7.3" /end MEASUREMENT
/begin MEASUREMENT KNKS_0_5 "Knock control signal of the respective cylinder (0 to 5)" UWORD _CNV_A_R_LINEAR_____256_CM 1 100. 0. 4.99992371 ECU_ADDRESS 0x3fe2c4 FORMAT "%7.5" /end MEASUREMENT
/begin MEASUREMENT ACP "AC-fluid presssure" UBYTE _CNV_A_R_LINEAR_____380_CM 1 100. 0. 127.5 ECU_ADDRESS 0x3fcd2e FORMAT "%6.2" /end MEASUREMENT
/begin MEASUREMENT CTR_STC_TECU_1 "statistic counter 1 for TECU monitoring" UWORD _CNV_A_R_LINEAR_____10_CM 1 100. 0. 65535. ECU_ADDRESS 0x3fccaa FORMAT "%5.0" /end MEASUREMENT
/begin MEASUREMENT CTR_STC_TECU_2 "statistic counter 2 for TECU monitoring" UWORD _CNV_A_R_LINEAR_____10_CM 1 100. 0. 65535. ECU_ADDRESS 0x3fccac FORMAT "%5.0" /end MEASUREMENT
/begin MEASUREMENT CTR_STC_TECU_3 "statistic counter 3 for TECU monitoring" UWORD _CNV_A_R_LINEAR_____10_CM 1 100. 0. 65535. ECU_ADDRESS 0x3fccae FORMAT "%5.0" /end MEASUREMENT
/begin CHARACTERISTIC IP_TECU "NTC characteristic" CURVE 0x507b0 _REC_CUR_20_u1_u2 190.5 _CNV_A_R_LINEAR_____0_CM -48. 142.5 FORMAT "%5.1"
 /begin AXIS_DESCR COM_AXIS V_TECU _CNV_A_R_LINEAR_____33_CM 16 0. 4.99511719 FORMAT "%5.3" AXIS_PTS_REF ldp_v_tecu__tecu /end AXIS_DESCR
/end CHARACTERISTIC
/begin CHARACTERISTIC C_TECU_SUB "TECU substitute value" VALUE 0x42a94 _REC_VAL_20_u1 190.5 _CNV_A_R_LINEAR_____0_CM -48. 142.5 FORMAT "%5.1" /end CHARACTERISTIC
/begin CHARACTERISTIC C_TECU_THD_1 "ETCU threshold 1" VALUE 0x43054 _REC_VAL_20_u2 65535. _CNV_A_R_LINEAR_____10_CM 0. 65535. FORMAT "%5.0" /end CHARACTERISTIC
/begin CHARACTERISTIC C_TECU_THD_2 "ETCU threshold 2" VALUE 0x43056 _REC_VAL_20_u2 65535. _CNV_A_R_LINEAR_____10_CM 0. 65535. FORMAT "%5.0" /end CHARACTERISTIC
/begin CHARACTERISTIC C_TECU_THD_3 "ETCU threshold 3" VALUE 0x43058 _REC_VAL_20_u2 65535. _CNV_A_R_LINEAR_____10_CM 0. 65535. FORMAT "%5.0" /end CHARACTERISTIC
/begin CHARACTERISTIC C_TRT_DIF_TECU "TRT difference for ETCU statistic" VALUE 0x43368 _REC_VAL_20_u4 119304.6471 _CNV_A_R_LINEAR_____155_CM 0. 119304.6471 FORMAT "%12.5" /end CHARACTERISTIC
/begin MEASUREMENT TECU "ECU temperature" UBYTE _CNV_A_R_LINEAR_____0_CM 1 100. -48. 142.5 ECU_ADDRESS 0x3fccb0 FORMAT "%5.1" /end MEASUREMENT
/begin MEASUREMENT TECU_MES "???" UBYTE _CNV_A_R_LINEAR_____0_CM 1 100. -48. 142.5 ECU_ADDRESS 0x3fccb1 FORMAT "%5.1" /end MEASUREMENT
/begin AXIS_PTS ldp_v_tecu__tecu "" 0x44d6e V_TECU _REC_AXS_20_u2 4.495605471 _CNV_A_R_LINEAR_____33_CM 16 0. 4.99511719 FORMAT "%5.3" /end AXIS_PTS
/begin MEASUREMENT TPS_AV_1 "Opening angle of the throttle valve of TPS-Poti 1" UWORD _CNV_A_R_LINEAR_____226_CM 1 100. 0. 119.5 ECU_ADDRESS 0x3fd054 FORMAT "%7.3" /end MEASUREMENT
/begin MEASUREMENT TPS_AV_2 "Opening angle of the throttle valve of TPS-Poti 2" UWORD _CNV_A_R_LINEAR_____226_CM 1 100. 0. 119.5 ECU_ADDRESS 0x3fd056 FORMAT "%7.3" /end MEASUREMENT
/begin MEASUREMENT TPS_GRD "Throttle position gradient, absolute value" UBYTE _CNV_A_R_LINEAR_____264_CM 1 100. 0. 2987.5 ECU_ADDRESS 0x3fd068 FORMAT "%4.0" /end MEASUREMENT
/begin MEASUREMENT TPS_SEG "Segment synchronous measured throttle valve position" UWORD _CNV_A_R_LINEAR_____226_CM 1 100. 0. 119.5 ECU_ADDRESS 0x3fd05c FORMAT "%7.3" /end MEASUREMENT
/begin MEASUREMENT TPS_SEG_1 "Segment synchronous measured throttle valve position channel 1" UWORD _CNV_A_R_LINEAR_____226_CM 1 100. 0. 119.5 ECU_ADDRESS 0x3fd05e FORMAT "%7.3" /end MEASUREMENT
/begin MEASUREMENT TPS_SEG_2 "Segment synchronous measured throttle valve position channel 2" UWORD _CNV_A_R_LINEAR_____226_CM 1 100. 0. 119.5 ECU_ADDRESS 0x3fd060 FORMAT "%7.3" /end MEASUREMENT
/begin MEASUREMENT TPS_SEG_GAIN_1 "Segment synchronous measured throttle valve position amplified channel 1" UWORD _CNV_A_R_LINEAR_____226_CM 1 100. 0. 119.5 ECU_ADDRESS 0x3fd062 FORMAT "%7.3" /end MEASUREMENT
/begin MEASUREMENT TPS_AV_GAIN_1 "Opening angle of the throttle valve of amplified TPS-Poti 1" UWORD _CNV_A_R_LINEAR_____226_CM 1 100. 0. 119.5 ECU_ADDRESS 0x3fe6b8 FORMAT "%7.3" /end MEASUREMENT
/begin MEASUREMENT V_TPS_GAIN_TOL_ENA_1 "TPS1-voltage to switch from amplified to non-amplified sensor signal" UWORD _CNV_A_R_LINEAR_____33_CM 1 100. 0. 4.99511719 ECU_ADDRESS 0x3fe6bc FORMAT "%5.3" /end MEASUREMENT
/begin MEASUREMENT V_TPS_GAIN_BOL_ENA_1 "TPS1-voltage to switch from non-amplified to amplified sensor signal" UWORD _CNV_A_R_LINEAR_____33_CM 1 100. 0. 4.99511719 ECU_ADDRESS 0x3fe6be FORMAT "%5.3" /end MEASUREMENT
/begin CHARACTERISTIC C_V_TPS_SWI_GAIN_1 "" VALUE 0x43150 _REC_VAL_20_u2 4.99511719 _CNV_A_R_LINEAR_____33_CM 0. 4.99511719 FORMAT "%5.3" /end CHARACTERISTIC
/begin CHARACTERISTIC C_V_TPS_HYS_GAIN_1 "" VALUE 0x43144 _REC_VAL_20_u2 4.99511719 _CNV_A_R_LINEAR_____33_CM 0. 4.99511719 FORMAT "%5.3" /end CHARACTERISTIC
/begin MEASUREMENT TPS_LIH "Limp home position of the throttle valve" UWORD _CNV_A_R_LINEAR_____226_CM 1 100. 0. 119.5 ECU_ADDRESS 0x3fd05a FORMAT "%7.3" /end MEASUREMENT
/begin MEASUREMENT TPS_AV "Opening angle of the throttle valve" UWORD _CNV_A_R_LINEAR_____226_CM 1 100. 0. 119.5 ECU_ADDRESS 0x3fd052 FORMAT "%7.3" /end MEASUREMENT
/begin MEASUREMENT TPS_AV_CTL "Control opening angle of the throttle valve" SWORD _CNV_A_R_LINEAR_____366_CM 1 100. -119.5 119.5 ECU_ADDRESS 0x3fd058 FORMAT "%8.3" /end MEASUREMENT
/begin MEASUREMENT TPS_AV_CTL_1 "Control opening angle of the throttle valve of TPS-Poti 1" SWORD _CNV_A_R_LINEAR_____366_CM 1 100. -119.5 119.5 ECU_ADDRESS 0x3fd064 FORMAT "%8.3" /end MEASUREMENT
/begin MEASUREMENT TPS_AV_CTL_2 "Control opening angle of the throttle valve of TPS-Poti 2" SWORD _CNV_A_R_LINEAR_____366_CM 1 100. -119.5 119.5 ECU_ADDRESS 0x3fd066 FORMAT "%8.3" /end MEASUREMENT
/begin MEASUREMENT TPS_AV_CTL_GAIN_1 "Control opening angle of the throttle valve of amplified TPS-Poti 1" SWORD _CNV_A_R_LINEAR_____366_CM 1 100. -119.5 119.5 ECU_ADDRESS 0x3fe6ba FORMAT "%8.3" /end MEASUREMENT
/begin CHARACTERISTIC C_V_TPS_GRD_MAX "" VALUE 0x43142 _REC_VAL_20_u2 4.99511719 _CNV_A_R_LINEAR_____33_CM 0. 4.99511719 FORMAT "%5.3" /end CHARACTERISTIC
/begin CHARACTERISTIC C_V_TPS_GAIN_GRD_MAX "TPS voltage gradient limitation" VALUE 0x43140 _REC_VAL_20_u2 4.99511719 _CNV_A_R_LINEAR_____33_CM 0. 4.99511719 FORMAT "%5.3" /end CHARACTERISTIC
/begin MEASUREMENT LV_TPS_GAIN_ACT_1 "Logical variable for TPS_AV based on amplified TPS 1 " UBYTE _CNV_S_2_RANGE______28_CM 1 100. 0. 1. ECU_ADDRESS 0x3fd069 BIT_MASK 0x1 /end MEASUREMENT
/begin MEASUREMENT LV_TPS_GRD_UP "Logical variable for throttle position gradient direction" UBYTE _CNV_S_2_RANGE______28_CM 1 100. 0. 1. ECU_ADDRESS 0x3fd06a /end MEASUREMENT
/begin MEASUREMENT T_ACC "Timer for duration of transient TQ_LOSS_ACC correction " UBYTE _CNV_A_R_LINEAR_____27_CM 1 100. 0. 2.55 ECU_ADDRESS 0x3fcf84 FORMAT "%4.2" /end MEASUREMENT
/begin CHARACTERISTIC IP_FAC_TQ_LOSS_ACC_ON "TQ_LOSS_ACC weighting factor at ACC activation" MAP 0x4e73b _REC_MAP_20_u1_u1_u1 1.99220002 _CNV_A_R_LINEAR_____34_CM 0. 1.99220002 FORMAT "%5.3"
 /begin AXIS_DESCR COM_AXIS T_ACC _CNV_A_R_LINEAR_____27_CM 8 0. 2.55 FORMAT "%4.2" AXIS_PTS_REF ldp_t_acc_ip_fac_tq_loss_acc_on /end AXIS_DESCR
 /begin AXIS_DESCR COM_AXIS N_32 _CNV_A_R_LINEAR_____5_CM 8 0. 8160. FORMAT "%4.0" AXIS_PTS_REF ldp_n_32_ip_fac_tq_loss_acc_on /end AXIS_DESCR
/end CHARACTERISTIC
/begin CHARACTERISTIC IP_FAC_TQ_LOSS_ACC_OFF "TQ_LOSS_ACC weighting factor at ACC deactivation" CURVE 0x4e733 _REC_CUR_20_u1_u1 1.99220002 _CNV_A_R_LINEAR_____34_CM 0. 1.99220002 FORMAT "%5.3"
 /begin AXIS_DESCR COM_AXIS T_ACC _CNV_A_R_LINEAR_____27_CM 8 0. 2.55 FORMAT "%4.2" AXIS_PTS_REF ldp_t_acc_fac_tq_loss_acc /end AXIS_DESCR
/end CHARACTERISTIC
/begin MEASUREMENT TQ_ADD_ACC "Torque reserve for switching on air conditioning compressor" SWORD _CNV_A_R_LINEAR_____48_CM 1 100. -1024. 1023.96875 ECU_ADDRESS 0x3fd15e FORMAT "%7.1" /end MEASUREMENT
/begin MEASUREMENT TQ_LOSS_ACC "Engine torque losses air conditioning compressor" SWORD _CNV_A_R_LINEAR_____48_CM 1 100. -1024. 1023.96875 ECU_ADDRESS 0x3fd15a FORMAT "%8.2" /end MEASUREMENT
/begin MEASUREMENT TQ_ADD_HEAT_ACC "Torque reserve for switching on additional heating by ACC" SWORD _CNV_A_R_LINEAR_____48_CM 1 100. -1024. 1023.96875 ECU_ADDRESS 0x3fd160 FORMAT "%8.2" /end MEASUREMENT
/begin MEASUREMENT LV_TOUT_ACC "logical variable to start deactivation of torque reserve and condition for switch off TQ_LOSS_ACC calculation" UBYTE _CNV_S_2_RANGE______28_CM 1 100. 0. 1. ECU_ADDRESS 0x3fcf87 /end MEASUREMENT
/begin MEASUREMENT LV_REQ_HEAT_ACC_ENA "LV indicating that the conditions for additional heating are fulfilled" UBYTE _CNV_S_2_RANGE______28_CM 1 100. 0. 1. ECU_ADDRESS 0x3fd163 /end MEASUREMENT
/begin MEASUREMENT LV_TOUT_REQ_HEAT_ACC "logical variable to start deactivation of torque reserve TQ_ADD_HEAT_ACC" UBYTE _CNV_S_2_RANGE______28_CM 1 100. 0. 1. ECU_ADDRESS 0x3fd164 /end MEASUREMENT
/begin MEASUREMENT T_REQ_HEAT_ACC "timer for duration of torque reserve TQ_ADD_HEAT_ACC calculation" UBYTE _CNV_A_R_LINEAR_____27_CM 1 100. 0. 2.55 ECU_ADDRESS 0x3fd162 FORMAT "%4.2" /end MEASUREMENT
/begin CHARACTERISTIC IP_TQ_ADD_ACC "Torque reserve for switching on air conditioning compressor" CURVE 0x4bdf4 _REC_CUR_20_u2_u1 2047.96875 _CNV_A_R_LINEAR_____218_CM -1024. 1023.96875 FORMAT "%6.2"
 /begin AXIS_DESCR COM_AXIS N_32 _CNV_A_R_LINEAR_____5_CM 6 0. 8160. FORMAT "%4.0" AXIS_PTS_REF ldp_n_32_ip_tq_add_acc /end AXIS_DESCR
/end CHARACTERISTIC
/begin CHARACTERISTIC IP_TQ_ADD_HEAT_ACC "Torque reserve for switching on additional heating" CURVE 0x4be24 _REC_CUR_20_u2_u1 2047.96875 _CNV_A_R_LINEAR_____218_CM -1024. 1023.96875 FORMAT "%6.2"
 /begin AXIS_DESCR COM_AXIS N_32 _CNV_A_R_LINEAR_____5_CM 6 0. 8160. FORMAT "%4.0" AXIS_PTS_REF ldp_n_32__tq_add_heat_acc /end AXIS_DESCR
/end CHARACTERISTIC
/begin CHARACTERISTIC C_TQ_ADD_ACC_LGRD "Limitation gradiant for TQ_ADD_ACC decrease after deactivation" VALUE 0x430e8 _REC_VAL_20_u2 1023.96875 _CNV_A_R_LINEAR_____48_CM 0. 1023.96875 FORMAT "%7.2" /end CHARACTERISTIC
/begin CHARACTERISTIC C_TQ_ADD_HEAT_ACC_LGRD "Limitation gradient for TQ_ADD_HEAT_ACC decrease after deactivation" VALUE 0x430ee _REC_VAL_20_u2 1023.96875 _CNV_A_R_LINEAR_____48_CM 0. 1023.96875 FORMAT "%7.2" /end CHARACTERISTIC
/begin CHARACTERISTIC C_TCO_MIN_REQ_HEAT_ACC "TCO threshold for enabling additional heat request" VALUE 0x42a73 _REC_VAL_20_u1 190.5 _CNV_A_R_LINEAR_____0_CM -48. 142.5 FORMAT "%5.1" /end CHARACTERISTIC
/begin CHARACTERISTIC C_TAM_MIN_REQ_HEAT_ACC "TAM threshold for enabling additional heat request" VALUE 0x42a38 _REC_VAL_20_u1 190.5 _CNV_A_R_LINEAR_____0_CM -48. 142.5 FORMAT "%5.1" /end CHARACTERISTIC
/begin CHARACTERISTIC C_TQ_LOSS_MAX_ACC "Maximum TQ_LOSS_ACC" VALUE 0x43308 _REC_VAL_20_s2 2047.96875 _CNV_A_R_LINEAR_____48_CM -1024. 1023.96875 FORMAT "%8.2" /end CHARACTERISTIC
/begin AXIS_PTS ldp_t_acc_ip_fac_tq_loss_acc_on "" 0x43813 T_ACC _REC_AXS_20_u1 2.55 _CNV_A_R_LINEAR_____27_CM 8 0. 2.55 FORMAT "%4.2" /end AXIS_PTS
/begin AXIS_PTS ldp_n_32_ip_fac_tq_loss_acc_on "" 0x43680 N_32 _REC_AXS_20_u1 8160. _CNV_A_R_LINEAR_____5_CM 8 0. 8160. FORMAT "%4.0" /end AXIS_PTS
/begin AXIS_PTS ldp_n_32_ip_tq_add_acc "" 0x436b6 N_32 _REC_AXS_20_u1 8160. _CNV_A_R_LINEAR_____5_CM 6 0. 8160. FORMAT "%4.0" /end AXIS_PTS
/begin AXIS_PTS ldp_t_acc_fac_tq_loss_acc "" 0x4380a T_ACC _REC_AXS_20_u1 2.55 _CNV_A_R_LINEAR_____27_CM 8 0. 2.55 FORMAT "%4.2" /end AXIS_PTS
/begin AXIS_PTS ldp_n_32__tq_add_heat_acc "" 0x4361e N_32 _REC_AXS_20_u1 8160. _CNV_A_R_LINEAR_____5_CM 6 0. 8160. FORMAT "%4.0" /end AXIS_PTS
/begin CHARACTERISTIC C_FIL_AJ_INP_0 "Filter constant 0 applied on input value of second order low pass filter" VALUE 0x43254 _REC_VAL_20_s2 3.125e-002 _CNV_A_R_LINEAR_____448_CM -1.5625e-002 1.5625e-002 FORMAT "%6.5" /end CHARACTERISTIC
/begin CHARACTERISTIC C_FIL_AJ_INP_1 "Filter constant 1 applied on input value of second order low pass filter" VALUE 0x43256 _REC_VAL_20_s2 3.125e-002 _CNV_A_R_LINEAR_____448_CM -1.5625e-002 1.5625e-002 FORMAT "%6.5" /end CHARACTERISTIC
/begin CHARACTERISTIC C_FIL_AJ_INP_2 "Filter constant 2 applied on input value of second order low pass filter" VALUE 0x43258 _REC_VAL_20_s2 3.125e-002 _CNV_A_R_LINEAR_____448_CM -1.5625e-002 1.5625e-002 FORMAT "%6.5" /end CHARACTERISTIC
/begin CHARACTERISTIC C_FIL_AJ_OUT_1 "Filter constant 1 applied in output value of second order low pass filter" VALUE 0x4325a _REC_VAL_20_s2 3.999938965 _CNV_A_R_LINEAR_____272_CM -2. 1.999938965 FORMAT "%8.4" /end CHARACTERISTIC
/begin CHARACTERISTIC C_FIL_AJ_OUT_2 "Filter constant 2 applied on output value of second order low pass filter" VALUE 0x4325c _REC_VAL_20_s2 3.999938965 _CNV_A_R_LINEAR_____272_CM -2. 1.999938965 FORMAT "%8.4" /end CHARACTERISTIC
/begin CHARACTERISTIC ID_FAC_INV_VEH_MASS_AT "Inverse vehicle mass equivalent for automatic transmission" CURVE 0x456fa _REC_CUR_20_u2_u1 0.99998474 _CNV_A_R_LINEAR_____449_CM 0. 0.99998474 FORMAT "%6.4"
 /begin AXIS_DESCR COM_AXIS GR_AT _CNV_A_R_LINEAR_____10_CM 13 0. 255. FORMAT "%3.0" AXIS_PTS_REF ldpm_gr_at_100 /end AXIS_DESCR
/end CHARACTERISTIC
/begin CHARACTERISTIC ID_FAC_INV_VEH_MASS_MT "Inverse vehicle mass equivalent for manual transmission" CURVE 0x45714 _REC_CUR_20_u2_u1 0.99998474 _CNV_A_R_LINEAR_____449_CM 0. 0.99998474 FORMAT "%6.4"
 /begin AXIS_DESCR COM_AXIS GR_MT _CNV_A_R_LINEAR_____10_CM 13 0. 255. FORMAT "%3.0" AXIS_PTS_REF ldpm_gr_mt_100 /end AXIS_DESCR
/end CHARACTERISTIC
/begin CHARACTERISTIC ID_FAC_TQ_DE_AJ_AT "Torque deviation compensation factor for AJ  N_DIF_REF determination" CURVE 0x45762 _REC_CUR_20_u2_u1 7.99987793 _CNV_A_R_LINEAR_____376_CM 0. 7.99987793 FORMAT "%6.4"
 /begin AXIS_DESCR COM_AXIS GR_AT _CNV_A_R_LINEAR_____10_CM 13 0. 255. FORMAT "%3.0" AXIS_PTS_REF ldpm_gr_at_100 /end AXIS_DESCR
/end CHARACTERISTIC
/begin CHARACTERISTIC ID_FAC_TQ_DE_AJ_MT "Engine speed difference threshold for acitvation anti jerk function" CURVE 0x4577c _REC_CUR_20_u2_u1 7.99987793 _CNV_A_R_LINEAR_____376_CM 0. 7.99987793 FORMAT "%6.4"
 /begin AXIS_DESCR COM_AXIS GR_MT _CNV_A_R_LINEAR_____10_CM 13 0. 255. FORMAT "%3.0" AXIS_PTS_REF ldpm_gr_mt_100 /end AXIS_DESCR
/end CHARACTERISTIC
/begin MEASUREMENT N_DIF_AJ "engine-speed deviation at jerking vehicle" SWORD _CNV_A_R_LINEAR_____17_CM 1 100. -32768. 32767. ECU_ADDRESS 0x3fd274 FORMAT "%6.0" /end MEASUREMENT
/begin MEASUREMENT N_DIF_REF_LPF_AJ "low-pass filtered N_DIF_REF_AJ for AJ function " SWORD _CNV_A_R_LINEAR_____450_CM 1 100. -512. 511.98 ECU_ADDRESS 0x3fe822 FORMAT "%7.2" /end MEASUREMENT
/begin MEASUREMENT TQ_DIF_AJ "Torque output for anti  jerk " SWORD _CNV_A_R_LINEAR_____48_CM 1 100. -1024. 1023.96875 ECU_ADDRESS 0x3fd272 FORMAT "%6.2" /end MEASUREMENT
/begin MEASUREMENT TQ_FAST_CLU "fast torque request at clutch" SWORD _CNV_A_R_LINEAR_____48_CM 1 100. -1024. 1023.96875 ECU_ADDRESS 0x3fe824 FORMAT "%6.2" /end MEASUREMENT
/begin MEASUREMENT TQ_MDL_DE_AJ "torque deviation compensation for AJ" SWORD _CNV_A_R_LINEAR_____48_CM 1 100. -1024. 1023.96875 ECU_ADDRESS 0x3fe826 FORMAT "%6.2" /end MEASUREMENT
/begin MEASUREMENT N_REF_AJ "reference engine-speed for anti-jerk function" SWORD _CNV_A_R_LINEAR_____17_CM 1 100. -32768. 32767. ECU_ADDRESS 0x3fe81c FORMAT "%6.0" /end MEASUREMENT
/begin CHARACTERISTIC C_N_DIF_REF_AJ_MAX "Maximum limitation of N_DIF_REF_AJ" VALUE 0x432ae _REC_VAL_20_s2 65535. _CNV_A_R_LINEAR_____17_CM -32768. 32767. FORMAT "%6.0" /end CHARACTERISTIC
/begin CHARACTERISTIC C_N_DIF_REF_AJ_MIN "Minimum limitation of N_DIF_REF_AJ" VALUE 0x432b0 _REC_VAL_20_s2 65535. _CNV_A_R_LINEAR_____17_CM -32768. 32767. FORMAT "%6.0" /end CHARACTERISTIC
/begin MEASUREMENT N_DIF_REF_AJ "limited reference engine-speed deviation for anti-jerk function" SWORD _CNV_A_R_LINEAR_____17_CM 1 100. -32768. 32767. ECU_ADDRESS 0x3fe820 FORMAT "%6.0" /end MEASUREMENT
/begin MEASUREMENT N_DIF_REF_AJ_INTER "reference engine-speed deviation for anti-jerk function without limitation" SWORD _CNV_A_R_LINEAR_____17_CM 1 100. -32768. 32767. ECU_ADDRESS 0x3fe828 FORMAT "%6.0" /end MEASUREMENT
/begin CHARACTERISTIC IP_FAC_TQ_AJ "Torque conversion factor for anti-jerk funktion" MAP 0x47b90 _REC_MAP_20_u2_u1_u1 4. _CNV_A_R_LINEAR_____271_CM -2. 2. FORMAT "%8.5"
 /begin AXIS_DESCR COM_AXIS N_32 _CNV_A_R_LINEAR_____5_CM 8 0. 8160. FORMAT "%4.0" AXIS_PTS_REF ldp_n_32__fac_tq_aj /end AXIS_DESCR
 /begin AXIS_DESCR COM_AXIS GEAR _CNV_A_R_LINEAR_____10_CM 6 0. 6. FORMAT "%1.0" AXIS_PTS_REF ldp_gear__fac_tq_aj /end AXIS_DESCR
/end CHARACTERISTIC
/begin AXIS_PTS ldpm_gr_at_100 "" 0x43be4 GR_AT _REC_AXS_20_u1 255. _CNV_A_R_LINEAR_____10_CM 13 0. 255. FORMAT "%3.0" /end AXIS_PTS
/begin AXIS_PTS ldpm_gr_mt_100 "" 0x43c00 GR_MT _REC_AXS_20_u1 255. _CNV_A_R_LINEAR_____10_CM 13 0. 255. FORMAT "%3.0" /end AXIS_PTS
/begin AXIS_PTS ldp_n_32__fac_tq_aj "" 0x434ec N_32 _REC_AXS_20_u1 8160. _CNV_A_R_LINEAR_____5_CM 8 0. 8160. FORMAT "%4.0" /end AXIS_PTS
/begin AXIS_PTS ldp_gear__fac_tq_aj "" 0x433d4 GEAR _REC_AXS_20_u1 6. _CNV_A_R_LINEAR_____10_CM 6 0. 6. FORMAT "%1.0" /end AXIS_PTS
/begin CHARACTERISTIC C_T_PAS_AJ_DLY "Delay time after closed drivetrain determination for PT2 filter actualisation" VALUE 0x42a24 _REC_VAL_20_u1 2.55 _CNV_A_R_LINEAR_____27_CM 0. 2.55 FORMAT "%3.2" /end CHARACTERISTIC
/begin MEASUREMENT TQ_CONV_CAN_1 "converter torque of CAN" SWORD _CNV_A_R_LINEAR_____48_CM 1 100. -1024. 1023.96875 ECU_ADDRESS 0x3fd16a FORMAT "%6.2" /end MEASUREMENT
/begin MEASUREMENT TQ_ADD_CONV "Torque reserve for switching converter Torque" SWORD _CNV_A_R_LINEAR_____48_CM 1 100. -1024. 1023.96875 ECU_ADDRESS 0x3fd16c FORMAT "%6.2" /end MEASUREMENT
/begin MEASUREMENT LV_TOUT_CONV "logical variable to start deactivation of torque reserve and condition for switch off TQ_CONV calculation" UBYTE _CNV_S_2_RANGE______28_CM 1 100. 0. 1. ECU_ADDRESS 0x3fe794 /end MEASUREMENT
/begin MEASUREMENT T_CONV "timer for duration of transient TQ_LOSS_CONV correction" UWORD _CNV_A_R_LINEAR_____27_CM 1 100. 0. 5.1 ECU_ADDRESS 0x3fe796 FORMAT "%4.2" /end MEASUREMENT
/begin CHARACTERISTIC C_TQ_ADD_CONV_LGRD "Limitation gradient for TQ_ADD_CONV decrease after deactivation" VALUE 0x430ec _REC_VAL_20_u2 1023.96875 _CNV_A_R_LINEAR_____48_CM 0. 1023.96875 FORMAT "%7.2" /end CHARACTERISTIC
/begin MEASUREMENT TQ_ADD_TRANS "Torque reserve for Transmission" SWORD _CNV_A_R_LINEAR_____48_CM 1 100. -1024. 1023.96875 ECU_ADDRESS 0x3fd16e FORMAT "%8.2" /end MEASUREMENT
/begin CHARACTERISTIC IP_TQ_ADD_CONV "Torque reserve for switch GS" CURVE 0x4be0c _REC_CUR_20_u2_u1 2047.96875 _CNV_A_R_LINEAR_____218_CM -1024. 1023.96875 FORMAT "%6.2"
 /begin AXIS_DESCR COM_AXIS N_32 _CNV_A_R_LINEAR_____5_CM 6 0. 8160. FORMAT "%4.0" AXIS_PTS_REF ldp_n_32_ip_tq_add_conv /end AXIS_DESCR
/end CHARACTERISTIC
/begin MEASUREMENT LV_DLY_N_SP_IS "Flag for idle speed setpoint change" UBYTE _CNV_S_2_RANGE______11_CM 1 100. 0. 1. ECU_ADDRESS 0x3fd174 BIT_MASK 0x1 /end MEASUREMENT
/begin MEASUREMENT TQ_CONV_STN "Stationary Converter Torque" SWORD _CNV_A_R_LINEAR_____48_CM 1 100. -1024. 1023.96875 ECU_ADDRESS 0x3fe79e FORMAT "%6.2" /end MEASUREMENT
/begin CHARACTERISTIC LC_TQ_CONV_DRI_INH "logical constant converter torque calculation at LV_DRI = 0 inhibit" VALUE 0x42bd7 _REC_VAL_20_u1 1. _CNV_A_R_LINEAR_____10_CM 0. 1. FORMAT "%2.0" /end CHARACTERISTIC
/begin CHARACTERISTIC LC_TQ_CONV_CAN_INH "logical constant converter torque by CAN-interface inhibit" VALUE 0x42bd6 _REC_VAL_20_u1 1. _CNV_A_R_LINEAR_____10_CM 0. 1. FORMAT "%2.0" /end CHARACTERISTIC
/begin CHARACTERISTIC IP_FAC_CONV__TOIL "Converter characteristic" CURVE 0x473b8 _REC_CUR_20_u2_u1 4.88e-004 _CNV_A_R_LINEAR_____452_CM 0. 4.88e-004 FORMAT "%8.7"
 /begin AXIS_DESCR COM_AXIS TOIL _CNV_A_R_LINEAR_____3_CM 8 -40. 160. FORMAT "%3.0" AXIS_PTS_REF ldp_toil_fac_conv /end AXIS_DESCR
/end CHARACTERISTIC
/begin CHARACTERISTIC IP_FAC_CONV_DRI__TOIL "Converter characteristic" CURVE 0x473c8 _REC_CUR_20_u2_u1 4.88e-004 _CNV_A_R_LINEAR_____452_CM 0. 4.88e-004 FORMAT "%8.7"
 /begin AXIS_DESCR COM_AXIS TOIL _CNV_A_R_LINEAR_____3_CM 8 -40. 160. FORMAT "%3.0" AXIS_PTS_REF ldp_toil_fac_conv /end AXIS_DESCR
/end CHARACTERISTIC
/begin CHARACTERISTIC IP_T_DLY_CONV__TOIL "Time delay for TQ_CONV activation" CURVE 0x5031a _REC_CUR_20_u1_u1 2550. _CNV_A_R_LINEAR_____23_CM 0. 2550. FORMAT "%4.0"
 /begin AXIS_DESCR COM_AXIS TOIL _CNV_A_R_LINEAR_____3_CM 8 -40. 160. FORMAT "%3.0" AXIS_PTS_REF ldp_toil_t_dly_conv /end AXIS_DESCR
/end CHARACTERISTIC
/begin CHARACTERISTIC IP_T_DLY_N_SP_IS__TOIL "Time delay for change of idle speed setpoint " CURVE 0x50322 _REC_CUR_20_u1_u1 2550. _CNV_A_R_LINEAR_____23_CM 0. 2550. FORMAT "%4.0"
 /begin AXIS_DESCR COM_AXIS TOIL _CNV_A_R_LINEAR_____3_CM 8 -40. 160. FORMAT "%3.0" AXIS_PTS_REF ldp_toil_t_dly_n_sp_is /end AXIS_DESCR
/end CHARACTERISTIC
/begin CHARACTERISTIC IP_FAC_TQ_CONV__N_RATIO_CONV "Torque request factor" CURVE 0x47bf0 _REC_CUR_20_u2_u1 1.99996948 _CNV_A_R_LINEAR_____45_CM 0. 1.99996948 FORMAT "%7.5"
 /begin AXIS_DESCR COM_AXIS N_RATIO_CONV _CNV_A_R_LINEAR_____44_CM 8 0. 0.996094 FORMAT "%5.3" AXIS_PTS_REF ldp_n_ratio_conv_fac_tq_conv /end AXIS_DESCR
/end CHARACTERISTIC
/begin MEASUREMENT TQ_CONV "Converter Torque" SWORD _CNV_A_R_LINEAR_____48_CM 1 100. -1024. 1023.96875 ECU_ADDRESS 0x3fd168 FORMAT "%6.2" /end MEASUREMENT
/begin CHARACTERISTIC IP_N_TUR__GR_AT__VS "Turbine speed" MAP 0x498fa _REC_MAP_20_u2_u1_u1 65535. _CNV_A_R_LINEAR_____17_CM 0. 65535. FORMAT "%5.0"
 /begin AXIS_DESCR COM_AXIS GR_AT _CNV_A_R_LINEAR_____10_CM 13 0. 8. FORMAT "%1.0" AXIS_PTS_REF ldp_gr_at_n_tur /end AXIS_DESCR
 /begin AXIS_DESCR COM_AXIS VS _CNV_A_R_LINEAR_____13_CM 2 0. 255. FORMAT "%3.0" AXIS_PTS_REF ldp_vs_n_tur /end AXIS_DESCR
/end CHARACTERISTIC
/begin CHARACTERISTIC IP_TQ_CONV_CAN "Corrected Converter tourque via N_32" MAP 0x4beac _REC_MAP_20_u2_u1_u2 2047.96875 _CNV_A_R_LINEAR_____218_CM -1024. 1023.96875 FORMAT "%6.2"
 /begin AXIS_DESCR COM_AXIS N_32 _CNV_A_R_LINEAR_____5_CM 8 0. 8160. FORMAT "%4.0" AXIS_PTS_REF ldp_n_32__tq_conv /end AXIS_DESCR
 /begin AXIS_DESCR COM_AXIS TQ_CONV_CAN _CNV_A_R_LINEAR_____218_CM 8 -1024. 1023.96875 FORMAT "%6.2" AXIS_PTS_REF ldp_tq_conv_can__tq_conv /end AXIS_DESCR
/end CHARACTERISTIC
/begin AXIS_PTS ldp_n_32_ip_tq_add_conv "" 0x436c4 N_32 _REC_AXS_20_u1 8160. _CNV_A_R_LINEAR_____5_CM 6 0. 8160. FORMAT "%4.0" /end AXIS_PTS
/begin AXIS_PTS ldp_n_ratio_conv_fac_tq_conv "" 0x43773 N_RATIO_CONV _REC_AXS_20_u1 0.9960940000000002 _CNV_A_R_LINEAR_____44_CM 8 0. 0.996094 FORMAT "%5.3" /end AXIS_PTS
/begin AXIS_PTS ldp_toil_t_dly_n_sp_is "" 0x43a47 TOIL _REC_AXS_20_u1 200. _CNV_A_R_LINEAR_____3_CM 8 -40. 160. FORMAT "%3.0" /end AXIS_PTS
/begin AXIS_PTS ldp_toil_t_dly_conv "" 0x43a3e TOIL _REC_AXS_20_u1 200. _CNV_A_R_LINEAR_____3_CM 8 -40. 160. FORMAT "%3.0" /end AXIS_PTS
/begin AXIS_PTS ldp_toil_fac_conv "" 0x43a1c TOIL _REC_AXS_20_u1 200. _CNV_A_R_LINEAR_____3_CM 8 -40. 160. FORMAT "%3.0" /end AXIS_PTS
/begin AXIS_PTS ldp_gr_at_n_tur "" 0x433db GR_AT _REC_AXS_20_u1 8. _CNV_A_R_LINEAR_____10_CM 13 0. 8. FORMAT "%1.0" /end AXIS_PTS
/begin AXIS_PTS ldp_n_32__tq_conv "" 0x4362c N_32 _REC_AXS_20_u1 8160. _CNV_A_R_LINEAR_____5_CM 8 0. 8160. FORMAT "%4.0" /end AXIS_PTS
/begin AXIS_PTS ldp_vs_n_tur "" 0x43b5d VS _REC_AXS_20_u1 255. _CNV_A_R_LINEAR_____13_CM 2 0. 255. FORMAT "%3.0" /end AXIS_PTS
/begin AXIS_PTS ldp_tq_conv_can__tq_conv "" 0x44bf2 TQ_CONV_CAN _REC_AXS_20_u2 2047.96875 _CNV_A_R_LINEAR_____218_CM 8 -1024. 1023.96875 FORMAT "%6.2" /end AXIS_PTS
/begin MEASUREMENT LV_TQ_FAST_ENA "Logical output to switch to fast torque mode" UBYTE _CNV_S_2_RANGE______11_CM 1 100. 0. 1. ECU_ADDRESS 0x3fd181 /end MEASUREMENT
/begin MEASUREMENT LV_TQ_IGA_ENA "Logical output to switch to IGA intervention mode" UBYTE _CNV_S_2_RANGE______11_CM 1 100. 0. 1. ECU_ADDRESS 0x3fd182 /end MEASUREMENT
/begin MEASUREMENT STATE_TQ_DYN_IGA "Actual state of the torque dynamic state machine IGA intervention" UBYTE _CNV_S_4_STATE_TQ_D_453_CM 1 100. 0. 3. ECU_ADDRESS 0x3fe7a6 /end MEASUREMENT
/begin MEASUREMENT LV_LAMB_TQ_CTL "Logical output to switch to lambda calculation torque controlled  (if equal to 1)" UBYTE _CNV_S_2_RANGE______11_CM 1 100. 0. 1. ECU_ADDRESS 0x3fd17e /end MEASUREMENT
/begin MEASUREMENT LV_TQ_LAMB_INH "Logical output to inhibit torque based lambda setpoint calculation" UBYTE _CNV_S_2_RANGE______11_CM 1 100. 0. 1. ECU_ADDRESS 0x3fd17f /end MEASUREMENT
/begin MEASUREMENT LV_TQ_LAMB_ENA "Logical output to switch on torque based lambda setpoint calculation" UBYTE _CNV_S_2_RANGE______11_CM 1 100. 0. 1. ECU_ADDRESS 0x3fd180 BIT_MASK 0x1 /end MEASUREMENT
/begin MEASUREMENT TQI_REQ_FAST_DTM "Indicated torque request fast" SWORD _CNV_A_R_LINEAR_____48_CM 1 100. -1024. 1023.96875 ECU_ADDRESS 0x3fd178 FORMAT "%8.2" /end MEASUREMENT
/begin MEASUREMENT TQI_REQ_FAST_DTM_CAN "Indicated torque request fast for torque calculation CAN" SWORD _CNV_A_R_LINEAR_____48_CM 1 100. -1024. 1023.96875 ECU_ADDRESS 0x3fd17a FORMAT "%8.2" /end MEASUREMENT
/begin MEASUREMENT TQI_REQ_SLOW_DTM "Indicated torque request slow" SWORD _CNV_A_R_LINEAR_____48_CM 1 100. -1024. 1023.96875 ECU_ADDRESS 0x3fd17c FORMAT "%8.2" /end MEASUREMENT
/begin CHARACTERISTIC C_TQ_DELTA_ECO_MOD "Maximum torque difference before transition to state 'economy_mode'" VALUE 0x430f0 _REC_VAL_20_u2 1023.96875 _CNV_A_R_LINEAR_____48_CM 0. 1023.96875 FORMAT "%7.2" /end CHARACTERISTIC
/begin CHARACTERISTIC C_TQ_DELTA_MAX_COMP "Maximum torque delta for compensation in state 'conditional_transition_mode'" VALUE 0x430f2 _REC_VAL_20_u2 1023.96875 _CNV_A_R_LINEAR_____48_CM 0. 1023.96875 FORMAT "%7.2" /end CHARACTERISTIC
/begin MEASUREMENT STATE_TQ_DYN_LAMB "State dynamic torque manager lambda intervention" UBYTE _CNV_A_R_LINEAR_____10_CM 1 100. 0. 255. ECU_ADDRESS 0x3fe7a5 FORMAT "%3.0" /end MEASUREMENT
/begin CHARACTERISTIC C_STATE_TQ_DYN_LAMB "Manual setting of state dynamic torque manager lambda intervention" VALUE 0x429a2 _REC_VAL_20_u1 255. _CNV_A_R_LINEAR_____10_CM 0. 255. FORMAT "%3.0" /end CHARACTERISTIC
/begin MEASUREMENT TQ_LOSS "Engine torque losses" SWORD _CNV_A_R_LINEAR_____48_CM 1 100. -1024. 1023.96875 ECU_ADDRESS 0x3fd184 FORMAT "%6.2" /end MEASUREMENT
/begin MEASUREMENT TQ_LOSS_1 "Engine torque losses before limiting" SWORD _CNV_A_R_LINEAR_____48_CM 1 100. -1024. 1023.96875 ECU_ADDRESS 0x3fe7a8 FORMAT "%6.2" /end MEASUREMENT
/begin MEASUREMENT TQ_LOSS_REQ_CLU "Engine torque losses without pumping losses for calculation of TQ_REQ_CLU" SWORD _CNV_A_R_LINEAR_____48_CM 1 100. -1024. 1023.96875 ECU_ADDRESS 0x3fd186 FORMAT "%6.2" /end MEASUREMENT
/begin MEASUREMENT TQFR_MEC "Mechanical friction torque of the engine" SWORD _CNV_A_R_LINEAR_____48_CM 1 100. -1024. 1023.96875 ECU_ADDRESS 0x3fe7aa FORMAT "%6.2" /end MEASUREMENT
/begin MEASUREMENT LV_TQ_LOSS_LIM_ACT "Flag for limiting torque losses is active" UBYTE _CNV_S_2_RANGE______28_CM 1 100. 0. 1. ECU_ADDRESS 0x3fd18c /end MEASUREMENT
/begin MEASUREMENT TQFR "Basis engine friction torque {visible is high word TQFR^sword(1)}" SWORD _CNV_A_R_LINEAR_____48_CM 1 100. -1024. 1023.96875 ECU_ADDRESS 0x3fe7ac FORMAT "%6.2" /end MEASUREMENT
/begin MEASUREMENT TQFR_BAS "Basis engine friction torque inclusive Adaptation value" SWORD _CNV_A_R_LINEAR_____48_CM 1 100. -1024. 1023.96875 ECU_ADDRESS 0x3fe7ae FORMAT "%6.2" /end MEASUREMENT
/begin MEASUREMENT TQFR_ADD "Additive temperature correction of engine friction torque " SWORD _CNV_A_R_LINEAR_____48_CM 1 100. -1024. 1023.96875 ECU_ADDRESS 0x3fe7b0 FORMAT "%6.2" /end MEASUREMENT
/begin MEASUREMENT TQFR_ST "Additive start correction of engine friction torque" SWORD _CNV_A_R_LINEAR_____48_CM 1 100. -1024. 1023.96875 ECU_ADDRESS 0x3fe7b2 FORMAT "%6.2" /end MEASUREMENT
/begin CHARACTERISTIC IP_TQFR "Base friction torque and pumping losses" MAP 0x4c454 _REC_MAP_20_u2_u2_u2 1024. _CNV_A_R_LINEAR_____218_CM -1024. 0. FORMAT "%6.2"
 /begin AXIS_DESCR COM_AXIS N _CNV_A_R_LINEAR_____17_CM 16 0. 8160. FORMAT "%4.0" AXIS_PTS_REF ldpm_n_100 /end AXIS_DESCR
 /begin AXIS_DESCR COM_AXIS MAF _CNV_A_R_LINEAR_____95_CM 8 0. 1389. FORMAT "%7.2" AXIS_PTS_REF ldp_maf_cyl_stk__tqfr /end AXIS_DESCR
/end CHARACTERISTIC
/begin CHARACTERISTIC IP_TQFR_ADD "Coolant and oil temperature correction of friction  torque" MAP 0x4c554 _REC_MAP_20_u2_u1_u1 2047.96875 _CNV_A_R_LINEAR_____218_CM -1024. 1023.96875 FORMAT "%6.2"
 /begin AXIS_DESCR COM_AXIS TCO _CNV_A_R_LINEAR_____0_CM 8 -48. 142.5 FORMAT "%5.1" AXIS_PTS_REF ldp_tco__tqfr_add /end AXIS_DESCR
 /begin AXIS_DESCR COM_AXIS TOIL _CNV_A_R_LINEAR_____3_CM 8 -40. 160. FORMAT "%3.0" AXIS_PTS_REF ldp_toil_tqfr_add /end AXIS_DESCR
/end CHARACTERISTIC
/begin CHARACTERISTIC IP_TQ_LOSS_LIM "Torque losses limitation for safety" MAP 0x4c2ac _REC_MAP_20_u2_u2_u1 2047.96875 _CNV_A_R_LINEAR_____218_CM -1024. 1023.96875 FORMAT "%6.2"
 /begin AXIS_DESCR COM_AXIS N _CNV_A_R_LINEAR_____17_CM 6 0. 8160. FORMAT "%4.0" AXIS_PTS_REF ldp_n_tq_loss_lim /end AXIS_DESCR
 /begin AXIS_DESCR COM_AXIS TCO _CNV_A_R_LINEAR_____0_CM 6 -48. 142.5 FORMAT "%5.1" AXIS_PTS_REF ldp_tco_tq_loss_lim /end AXIS_DESCR
/end CHARACTERISTIC
/begin CHARACTERISTIC IP_TQFR_ST "Friction torque increase after start" CURVE 0x4c5dc _REC_CUR_20_u2_u1 1024. _CNV_A_R_LINEAR_____218_CM -1024. 0. FORMAT "%6.2"
 /begin AXIS_DESCR COM_AXIS TCO_ST _CNV_A_R_LINEAR_____0_CM 4 -48. 142.5 FORMAT "%5.1" AXIS_PTS_REF ldp_tco_st__tqfr_st /end AXIS_DESCR
/end CHARACTERISTIC
/begin CHARACTERISTIC IP_TQFR_DEC_ST "Decrement for start correction of friction torque" CURVE 0x4c5d4 _REC_CUR_20_u2_u1 1024. _CNV_A_R_LINEAR_____218_CM -1024. 0. FORMAT "%6.2"
 /begin AXIS_DESCR COM_AXIS TCO_ST _CNV_A_R_LINEAR_____0_CM 4 -48. 142.5 FORMAT "%5.1" AXIS_PTS_REF ldp_tco_st__tqfr_dec_st /end AXIS_DESCR
/end CHARACTERISTIC
/begin CHARACTERISTIC C_MAF_CYL_STK_REF "Constant for the determination of the friction losses" VALUE 0x42e08 _REC_VAL_20_u2 1389. _CNV_A_R_LINEAR_____95_CM 0. 1389. FORMAT "%7.2" /end CHARACTERISTIC
/begin CHARACTERISTIC C_CRLC_TQ_LOSS_REQ_CLU "Correlation constant for TQ_LOSS_REQ_CLU filtering" VALUE 0x4283f _REC_VAL_20_u1 0.9960940000000002 _CNV_A_R_LINEAR_____44_CM 0. 0.996094 FORMAT "%5.3" /end CHARACTERISTIC
/begin AXIS_PTS ldpm_n_100 "" 0x451b0 N _REC_AXS_20_u2 8160. _CNV_A_R_LINEAR_____17_CM 16 0. 8160. FORMAT "%4.0" /end AXIS_PTS
/begin AXIS_PTS ldp_maf_cyl_stk__tqfr "" 0x4454a MAF _REC_AXS_20_u2 1389. _CNV_A_R_LINEAR_____95_CM 8 0. 1389. FORMAT "%7.2" /end AXIS_PTS
/begin AXIS_PTS ldp_tco__tqfr_add "" 0x438e4 TCO _REC_AXS_20_u1 190.5 _CNV_A_R_LINEAR_____0_CM 8 -48. 142.5 FORMAT "%5.1" /end AXIS_PTS
/begin AXIS_PTS ldp_toil_tqfr_add "" 0x43a69 TOIL _REC_AXS_20_u1 200. _CNV_A_R_LINEAR_____3_CM 8 -40. 160. FORMAT "%3.0" /end AXIS_PTS
/begin AXIS_PTS ldp_n_tq_loss_lim "" 0x4496c N _REC_AXS_20_u2 8160. _CNV_A_R_LINEAR_____17_CM 6 0. 8160. FORMAT "%4.0" /end AXIS_PTS
/begin AXIS_PTS ldp_tco_tq_loss_lim "" 0x439a3 TCO _REC_AXS_20_u1 190.5 _CNV_A_R_LINEAR_____0_CM 6 -48. 142.5 FORMAT "%5.1" /end AXIS_PTS
/begin AXIS_PTS ldp_tco_st__tqfr_st "" 0x43964 TCO_ST _REC_AXS_20_u1 190.5 _CNV_A_R_LINEAR_____0_CM 4 -48. 142.5 FORMAT "%5.1" /end AXIS_PTS
/begin AXIS_PTS ldp_tco_st__tqfr_dec_st "" 0x4395f TCO_ST _REC_AXS_20_u1 190.5 _CNV_A_R_LINEAR_____0_CM 4 -48. 142.5 FORMAT "%5.1" /end AXIS_PTS
/begin MEASUREMENT TQFR_REQ_CLU "Engine Friction torque without pumping losses for calculation of TQ_MIN_CLU" SWORD _CNV_A_R_LINEAR_____48_CM 1 100. -1024. 1023.96875 ECU_ADDRESS 0x3fd188 FORMAT "%8.2" /end MEASUREMENT
/begin MEASUREMENT TQ_LOSS_CLU_ADD "Engine  torque losses without pumping and friction losses for calculation of TQ_MIN_CLU" SWORD _CNV_A_R_LINEAR_____48_CM 1 100. -1024. 1023.96875 ECU_ADDRESS 0x3fd18a FORMAT "%8.2" /end MEASUREMENT
/begin MEASUREMENT TQI_REQ_TRA_SLOW "Requested indicated torque for slow path" SWORD _CNV_A_R_LINEAR_____48_CM 1 100. -1024. 1023.96875 ECU_ADDRESS 0x3fd18e FORMAT "%8.2" /end MEASUREMENT
/begin MEASUREMENT TQ_REQ_TRA_SLOW "Requested torque at clutch for slow path" SWORD _CNV_A_R_LINEAR_____48_CM 1 100. -1024. 1023.96875 ECU_ADDRESS 0x3fe7b8 FORMAT "%8.2" /end MEASUREMENT
/begin MEASUREMENT TQ_REQ_TRA_FAST "Requested torque at clutch for fast path" SWORD _CNV_A_R_LINEAR_____48_CM 1 100. -1024. 1023.96875 ECU_ADDRESS 0x3fe7ba FORMAT "%8.2" /end MEASUREMENT
/begin MEASUREMENT TQI_REQ_TRA_FAST "Requested indicated torque for fast path" SWORD _CNV_A_R_LINEAR_____48_CM 1 100. -1024. 1023.96875 ECU_ADDRESS 0x3fd190 FORMAT "%8.2" /end MEASUREMENT
/begin MEASUREMENT TQI_REQ_TRA_1 "Intermediate value requested indicated torque after torque transient " SWORD _CNV_A_R_LINEAR_____48_CM 1 100. -1024. 1023.96875 ECU_ADDRESS 0x3fe7bc FORMAT "%8.2" /end MEASUREMENT
/begin MEASUREMENT TQI_REQ_DRIV "Driver requested indicated torque not filtered by torque transient" SWORD _CNV_A_R_LINEAR_____48_CM 1 100. -1024. 1023.96875 ECU_ADDRESS 0x3fe7be FORMAT "%8.2" /end MEASUREMENT
/begin MEASUREMENT FAC_DYN_DRIV "Converging Factor" UWORD _CNV_A_R_LINEAR_____182_CM 1 100. 0. 1. ECU_ADDRESS 0x3fe7c0 FORMAT "%7.5" /end MEASUREMENT
/begin CHARACTERISTIC C_FAC_DYN_DRIV_CT "Integrator decrement for converging factor in case of Closed Throttle" VALUE 0x42d16 _REC_VAL_20_u2 0.99998474 _CNV_A_R_LINEAR_____31_CM 0. 0.99998474 FORMAT "%7.6" /end CHARACTERISTIC
/begin CHARACTERISTIC C_FAC_DYN_DRIV "Integrator decrement for converging factor" VALUE 0x42d14 _REC_VAL_20_u2 0.99998474 _CNV_A_R_LINEAR_____31_CM 0. 0.99998474 FORMAT "%7.6" /end CHARACTERISTIC
/begin CHARACTERISTIC LC_TQI_REQ_TRA_SLOW_SEL "Switch for slow path setpoint selection 0:scaling factor  1:control loop" VALUE 0x42bed _REC_VAL_20_u1 1. _CNV_A_R_LINEAR_____10_CM 0. 1. FORMAT "%2.0" /end CHARACTERISTIC
/begin CHARACTERISTIC LC_TQI_REQ_TRA_FAST_TRAN_INH "Switch for disabling transition function for fast path torque request" VALUE 0x42bec _REC_VAL_20_u1 1. _CNV_A_R_LINEAR_____10_CM 0. 1. FORMAT "%2.0" /end CHARACTERISTIC
/begin CHARACTERISTIC C_FAC_TQI_REQ_TRA_HPF "Gain of HPF for TQI_BAS delay adjust " VALUE 0x42d54 _REC_VAL_20_u2 255.996094 _CNV_A_R_LINEAR_____111_CM 0. 255.996094 FORMAT "%7.3" /end CHARACTERISTIC
/begin CHARACTERISTIC C_FAC_TQI_REQ_TRA_SLOW "Scaling factor for torque transient ramp for slow path" VALUE 0x42d56 _REC_VAL_20_u2 1.99996948 _CNV_A_R_LINEAR_____45_CM 0. 1.99996948 FORMAT "%7.5" /end CHARACTERISTIC
/begin MEASUREMENT EFF_SCC_AV "Actual efficiency fuel cut-off" UWORD _CNV_A_R_LINEAR_____45_CM 1 100. 0. 1.99996948 ECU_ADDRESS 0x3fd194 FORMAT "%7.5" /end MEASUREMENT
/begin MEASUREMENT EFF_SCC_AV_CAN "Actual efficiency fuel cut-off for CAN" UWORD _CNV_A_R_LINEAR_____45_CM 1 100. 0. 1.99996948 ECU_ADDRESS 0x3fd196 FORMAT "%7.5" /end MEASUREMENT
/begin MEASUREMENT EFF_SCC_SP_HYS "Setpoint efficiency fuel cut-off pattern with hysteresis" UWORD _CNV_A_R_LINEAR_____45_CM 1 100. 0. 1.99996948 ECU_ADDRESS 0x3fe7cc FORMAT "%7.5" /end MEASUREMENT
/begin MEASUREMENT EFF_SCC_BAS "Basic efficiency fuel  cut-off" UWORD _CNV_A_R_LINEAR_____45_CM 1 100. 0. 1.99996948 ECU_ADDRESS 0x3fd192 FORMAT "%7.5" /end MEASUREMENT
/begin MEASUREMENT EFF_SCC_SP "Setpoint efficiency fuel cut-off pattern" UWORD _CNV_A_R_LINEAR_____45_CM 1 100. 0. 1.99996948 ECU_ADDRESS 0x3fe7c2 FORMAT "%7.5" /end MEASUREMENT
/begin MEASUREMENT TQI_REF_IGA_MIN_SCC "indicated reference torque for single cylinder cut-off " SWORD _CNV_A_R_LINEAR_____48_CM 1 100. -1024. 1023.96875 ECU_ADDRESS 0x3fd198 FORMAT "%8.2" /end MEASUREMENT
/begin MEASUREMENT EFF_IGA_MIN_SCC "minimum reference efficiency for single cylinder cut-off " UWORD _CNV_A_R_LINEAR_____45_CM 1 100. 0. 1.99996948 ECU_ADDRESS 0x3fe7c4 FORMAT "%7.5" /end MEASUREMENT
/begin MEASUREMENT FAC_IGA_MIN_TEG_IGA_BAS "scaling factor for efficiency calculation with EFF_IGA_MIN_TEG and EFF_IGA_BAS_COR" UWORD _CNV_A_R_LINEAR_____45_CM 1 100. 0. 1.99996948 ECU_ADDRESS 0x3fe7ce FORMAT "%7.5" /end MEASUREMENT
/begin MEASUREMENT LV_AUTH_TQ_PAT "Logical variable for authorizing fuel cut-off pattern" UBYTE _CNV_S_2_RANGE______28_CM 1 100. 0. 1. ECU_ADDRESS 0x3fe7d2 /end MEASUREMENT
/begin MEASUREMENT NR_PAT_SCC "Selected index of fuel cut-off pattern" UBYTE _CNV_A_R_LINEAR_____10_CM 1 100. 0. 255. ECU_ADDRESS 0x3fd19a FORMAT "%3.0" /end MEASUREMENT
/begin CHARACTERISTIC LC_EFF_SCC_SP_MAN "flag for setting EFF_SCC_SP by application system" VALUE 0x42b74 _REC_VAL_20_u1 1. _CNV_A_R_LINEAR_____10_CM 0. 1. FORMAT "%2.0" /end CHARACTERISTIC
/begin CHARACTERISTIC LC_INH_FCUT_FAST "inhibition flag for fuel cut-off due fast fuel cut-off" VALUE 0x42b8f _REC_VAL_20_u1 1. _CNV_A_R_LINEAR_____10_CM 0. 1. FORMAT "%2.0" /end CHARACTERISTIC
/begin CHARACTERISTIC LC_ENA_EFF_SCC_BAS_MAN "logical variable for manually adjusting basic efficiency fuel cut-off" VALUE 0x42b75 _REC_VAL_20_u1 1. _CNV_A_R_LINEAR_____10_CM 0. 1. FORMAT "%2.0" /end CHARACTERISTIC
/begin CHARACTERISTIC C_EFF_SCC_SP_HYS "Hysteresis applied on EFF_SCC_SP for NR_PAT_SCC calculation" VALUE 0x42cda _REC_VAL_20_u2 1.99996948 _CNV_A_R_LINEAR_____45_CM 0. 1.99996948 FORMAT "%7.5" /end CHARACTERISTIC
/begin CHARACTERISTIC C_EFF_SCC_BAS_MAN "manually adjusted basic efficiency fuel cut-off" VALUE 0x42cd8 _REC_VAL_20_u2 1.99996948 _CNV_A_R_LINEAR_____45_CM 0. 1.99996948 FORMAT "%7.5" /end CHARACTERISTIC
/begin CHARACTERISTIC LC_ENA_FCUT_TOT_GS "logical variable for setting scaling factor due to gear shift intervention" VALUE 0x42b7a _REC_VAL_20_u1 1. _CNV_A_R_LINEAR_____10_CM 0. 1. FORMAT "%2.0" /end CHARACTERISTIC
/begin CHARACTERISTIC LC_INH_FCUT_GS_IGA "inhibition flag for fuel cut-off due to gear shift intervention with spark retarding" VALUE 0x42b91 _REC_VAL_20_u1 1. _CNV_A_R_LINEAR_____10_CM 0. 1. FORMAT "%2.0" /end CHARACTERISTIC
/begin CHARACTERISTIC LC_INH_FCUT_ASR "inhibition flag for fuel cut-off due to ASR" VALUE 0x42b8d _REC_VAL_20_u1 1. _CNV_A_R_LINEAR_____10_CM 0. 1. FORMAT "%2.0" /end CHARACTERISTIC
/begin CHARACTERISTIC LC_ENA_FCUT_TOT_ASR "logical variable for setting scaling factor due to ASR" VALUE 0x42b77 _REC_VAL_20_u1 1. _CNV_A_R_LINEAR_____10_CM 0. 1. FORMAT "%2.0" /end CHARACTERISTIC
/begin CHARACTERISTIC LC_INH_FCUT_N_MAX "inhibition flag for fuel cut-off due to speed limitation" VALUE 0x42b92 _REC_VAL_20_u1 1. _CNV_A_R_LINEAR_____10_CM 0. 1. FORMAT "%2.0" /end CHARACTERISTIC
/begin CHARACTERISTIC LC_TQ_SCC_INH_MAN "inhibition flag for fuel cut-off due to torque management" VALUE 0x42be9 _REC_VAL_20_u1 1. _CNV_A_R_LINEAR_____10_CM 0. 1. FORMAT "%2.0" /end CHARACTERISTIC
/begin CHARACTERISTIC LC_ENA_FCUT_TOT_FAST "logical variable for setting scaling factor due to fast fuel cut-off" VALUE 0x42b79 _REC_VAL_20_u1 1. _CNV_A_R_LINEAR_____10_CM 0. 1. FORMAT "%2.0" /end CHARACTERISTIC
/begin CHARACTERISTIC LC_TQ_SCC_ENA_MAN "flag for enabling SCC by application system" VALUE 0x42be8 _REC_VAL_20_u1 1. _CNV_A_R_LINEAR_____10_CM 0. 1. FORMAT "%2.0" /end CHARACTERISTIC
/begin CHARACTERISTIC C_EFF_SCC_SP_MAN "setpoint for efficiency of fuel cut-off set by application intervention" VALUE 0x42cdc _REC_VAL_20_u2 1.99996948 _CNV_A_R_LINEAR_____45_CM 0. 1.99996948 FORMAT "%7.5" /end CHARACTERISTIC
/begin CHARACTERISTIC C_FAC_IGA_MIN_TEG_IGA_BAS "manually adjusted scaling factor for efficiency calculation with EFF_IGA_MIN_TEG and EFF_IGA_BAS_COR" VALUE 0x42d18 _REC_VAL_20_u2 1. _CNV_A_R_LINEAR_____454_CM 0. 1. FORMAT "%6.4" /end CHARACTERISTIC
/begin CHARACTERISTIC C_HYS_EFF_IGA_MIN_TEG "hysteresis in falling direction for IGA_MIN_TEG correction" VALUE 0x42d98 _REC_VAL_20_u2 1.99996948 _CNV_A_R_LINEAR_____45_CM 0. 1.99996948 FORMAT "%7.5" /end CHARACTERISTIC
/begin CHARACTERISTIC C_MIN_DEC_EFF_IGA_MIN_TEG_1 "minimum decrement for first decrease phase " VALUE 0x42e90 _REC_VAL_20_u2 1.99996948 _CNV_A_R_LINEAR_____45_CM 0. 1.99996948 FORMAT "%7.5" /end CHARACTERISTIC
/begin CHARACTERISTIC C_MIN_DEC_EFF_IGA_MIN_TEG_2 "minimum decrement for second decrease phase " VALUE 0x42e92 _REC_VAL_20_u2 1.99996948 _CNV_A_R_LINEAR_____45_CM 0. 1.99996948 FORMAT "%7.5" /end CHARACTERISTIC
/begin CHARACTERISTIC ID_NR_PAT_SCC "SCC pattern depending on SCC efficiency" CURVE 0x4ce38 _REC_CUR_20_u1_u2 255. _CNV_A_R_LINEAR_____10_CM 0. 255. FORMAT "%3.0"
 /begin AXIS_DESCR COM_AXIS EFF_SCC_SP _CNV_A_R_LINEAR_____45_CM 13 0. 1.99996948 FORMAT "%7.5" AXIS_PTS_REF ldp_eff_scc_sp__nr_pat_scc /end AXIS_DESCR
/end CHARACTERISTIC
/begin CHARACTERISTIC LC_INH_FCUT_GS "inhibition flag for fuel cut-off due to gear shift intervention" VALUE 0x42b90 _REC_VAL_20_u1 1. _CNV_A_R_LINEAR_____10_CM 0. 1. FORMAT "%2.0" /end CHARACTERISTIC
/begin CHARACTERISTIC LC_ENA_FCUT_TOT_N_MAX "logical variable for setting scaling factor due to engine speed limitation" VALUE 0x42b7b _REC_VAL_20_u1 1. _CNV_A_R_LINEAR_____10_CM 0. 1. FORMAT "%2.0" /end CHARACTERISTIC
/begin AXIS_PTS ldp_eff_scc_sp__nr_pat_scc "" 0x442d8 EFF_SCC_SP _REC_AXS_20_u2 1.99996948 _CNV_A_R_LINEAR_____45_CM 13 0. 1.99996948 FORMAT "%7.5" /end AXIS_PTS
/begin MEASUREMENT T_MAX_FCUT_FAST "time counter for clutch switch observation fast fuel cut off" UBYTE _CNV_A_R_LINEAR_____27_CM 1 100. 0. 2.55 ECU_ADDRESS 0x3fe7d4 FORMAT "%4.2" /end MEASUREMENT
/begin CHARACTERISTIC C_MAF_DIF_MIN_FCUT_FAST "min. load decrease fast fuel cut-off" VALUE 0x42e0c _REC_VAL_20_u2 1389. _CNV_A_R_LINEAR_____95_CM 0. 1389. FORMAT "%7.2" /end CHARACTERISTIC
/begin CHARACTERISTIC C_T_MAX_FCUT_FAST "max. time cllutch switch observation fast fuel cut-off" VALUE 0x42a0a _REC_VAL_20_u1 2.55 _CNV_A_R_LINEAR_____27_CM 0. 2.55 FORMAT "%4.2" /end CHARACTERISTIC
/begin CHARACTERISTIC C_TCO_MIN_FCUT_FAST "min. coolant temperature fast fuel cut-off" VALUE 0x42a6c _REC_VAL_20_u1 190.5 _CNV_A_R_LINEAR_____0_CM -48. 142.5 FORMAT "%5.1" /end CHARACTERISTIC
/begin MEASUREMENT LV_CS_CHG "Logical variable" UBYTE _CNV_S_2_RANGE______11_CM 1 100. 0. 1. ECU_ADDRESS 0x3fe7d8 /end MEASUREMENT
/begin MEASUREMENT LV_FCUT_FAST "Logical variable for authorizing fuel cut off pattern" UBYTE _CNV_S_2_RANGE______11_CM 1 100. 0. 1. ECU_ADDRESS 0x3fd19b BIT_MASK 0x1 /end MEASUREMENT
/begin MEASUREMENT LV_CT_CHG "Logical variable" UBYTE _CNV_S_2_RANGE______11_CM 1 100. 0. 1. ECU_ADDRESS 0x3fe7d7 /end MEASUREMENT
/begin MEASUREMENT TQ_ST "Engine Start Torque" SWORD _CNV_A_R_LINEAR_____48_CM 1 100. -1024. 1023.96875 ECU_ADDRESS 0x3fd19c FORMAT "%6.2" /end MEASUREMENT
/begin MEASUREMENT TQ_ST_1 "Engine Start Torque raw value" SWORD _CNV_A_R_LINEAR_____48_CM 1 100. -1024. 1023.96875 ECU_ADDRESS 0x3fe7da FORMAT "%6.2" /end MEASUREMENT
/begin CHARACTERISTIC IP_TQ_ST "Engine torque at start" MAP 0x4c38c _REC_MAP_20_u2_u2_u1 2047.96875 _CNV_A_R_LINEAR_____218_CM -1024. 1023.96875 FORMAT "%6.2"
 /begin AXIS_DESCR COM_AXIS N_DIF _CNV_A_R_LINEAR_____213_CM 8 -32768. 32767. FORMAT "%6.0" AXIS_PTS_REF ldp_n_dif_ip_tq_st /end AXIS_DESCR
 /begin AXIS_DESCR COM_AXIS TCO _CNV_A_R_LINEAR_____0_CM 8 -48. 142.5 FORMAT "%5.1" AXIS_PTS_REF ldp_tco_ip_tq_st /end AXIS_DESCR
/end CHARACTERISTIC
/begin AXIS_PTS ldp_tco_ip_tq_st "" 0x4393b TCO _REC_AXS_20_u1 190.5 _CNV_A_R_LINEAR_____0_CM 8 -48. 142.5 FORMAT "%5.1" /end AXIS_PTS
/begin AXIS_PTS ldp_n_dif_ip_tq_st "" 0x4489a N_DIF _REC_AXS_20_u2 65535. _CNV_A_R_LINEAR_____213_CM 8 -32768. 32767. FORMAT "%6.0" /end AXIS_PTS
/begin CHARACTERISTIC C_CRLC_TQ_ST "" VALUE 0x42840 _REC_VAL_20_u1 0.9960940000000002 _CNV_A_R_LINEAR_____44_CM 0. 0.996094 FORMAT "%5.3" /end CHARACTERISTIC
/begin MEASUREMENT FAC_TQ_REQ_CRU "Torque factor request for cruise control" UWORD _CNV_A_R_LINEAR_____45_CM 1 100. 0. 1.99996948 ECU_ADDRESS 0x3fd206 FORMAT "%7.5" /end MEASUREMENT
/begin MEASUREMENT FAC_TQ_REQ_DCC "Scaling factor of inverse  DCC model" UWORD _CNV_A_R_LINEAR_____45_CM 1 100. 0. 1.99996948 ECU_ADDRESS 0x3fd208 FORMAT "%7.5" /end MEASUREMENT
/begin MEASUREMENT STATE_TQ_DCC "State of DCC torque intervention" UBYTE _CNV_S_6_STATE_TQ_D_455_CM 1 100. 0. 11. ECU_ADDRESS 0x3fd20e /end MEASUREMENT
/begin MEASUREMENT LV_TQ_DCC_ACT "Torque structure leaded by DCC intervention" UBYTE _CNV_S_2_RANGE______28_CM 1 100. 0. 1. ECU_ADDRESS 0x3fd20f /end MEASUREMENT
/begin MEASUREMENT TQ_DELTA_MAX_CLU "Difference between TQ_MAX_CLU and TQ_MIN_CLU" SWORD _CNV_A_R_LINEAR_____48_CM 1 100. -1024. 1023.96875 ECU_ADDRESS 0x3fd20a FORMAT "%8.2" /end MEASUREMENT
/begin CHARACTERISTIC C_LGRD_TQ_CRU_INC_1 "Change limitation for cruise control request out of lower vehicle speed" VALUE 0x42dfc _REC_VAL_20_u2 1.99996948 _CNV_A_R_LINEAR_____45_CM 0. 1.99996948 FORMAT "%7.5" /end CHARACTERISTIC
/begin CHARACTERISTIC C_LGRD_TQ_CRU_INC_2 "Change limitation for cruise control request out of higher vehicle speed" VALUE 0x42dfe _REC_VAL_20_u2 1.99996948 _CNV_A_R_LINEAR_____45_CM 0. 1.99996948 FORMAT "%7.5" /end CHARACTERISTIC
/begin CHARACTERISTIC IP_FAC_TQ_REQ_DRIV_RNG_L "Scaling factor for requested torque at clutch from driver in low range mode" MAP 0x47e50 _REC_MAP_20_u2_u2_u1 1.99996948 _CNV_A_R_LINEAR_____45_CM 0. 1.99996948 FORMAT "%7.5"
 /begin AXIS_DESCR COM_AXIS N _CNV_A_R_LINEAR_____17_CM 12 0. 8160. FORMAT "%4.0" AXIS_PTS_REF ldpm_n_fac_tq_req_driv /end AXIS_DESCR
 /begin AXIS_DESCR COM_AXIS PV_AV _CNV_A_R_LINEAR_____4_CM 12 0. 99.609375 FORMAT "%4.1" AXIS_PTS_REF ldpm_pv_av_fac_tq_req_driv /end AXIS_DESCR
/end CHARACTERISTIC
/begin CHARACTERISTIC IP_FAC_TQ_REQ_DRIV "Scaling factor for requested torque at clutch from driver" MAP 0x47d30 _REC_MAP_20_u2_u2_u1 1.99996948 _CNV_A_R_LINEAR_____45_CM 0. 1.99996948 FORMAT "%7.5"
 /begin AXIS_DESCR COM_AXIS N _CNV_A_R_LINEAR_____17_CM 12 0. 8160. FORMAT "%4.0" AXIS_PTS_REF ldpm_n_fac_tq_req_driv /end AXIS_DESCR
 /begin AXIS_DESCR COM_AXIS PV_AV _CNV_A_R_LINEAR_____4_CM 12 0. 99.609375 FORMAT "%4.1" AXIS_PTS_REF ldpm_pv_av_fac_tq_req_driv /end AXIS_DESCR
/end CHARACTERISTIC
/begin CHARACTERISTIC C_PV_AV_SOF_MIN "PV_AV threshold for activation IP_FAC_TQ_REQ_DRIV_RNG_L" VALUE 0x4298a _REC_VAL_20_u1 99.609375 _CNV_A_R_LINEAR_____4_CM 0. 99.609375 FORMAT "%4.1" /end CHARACTERISTIC
/begin CHARACTERISTIC C_FAC_TQ_REQ_DRIV_SOF_MAX "Scaling factor threshold for activation IP_FAC_TQ_REQ_DRIV_RNG_L" VALUE 0x42d4e _REC_VAL_20_u2 1.99996948 _CNV_A_R_LINEAR_____45_CM 0. 1.99996948 FORMAT "%7.5" /end CHARACTERISTIC
/begin CHARACTERISTIC C_PV_AV_GRD_SOF_MAX "Pedal value gradient rheshold for recognition of LV_RNG_L" VALUE 0x42986 _REC_VAL_20_u1 2490.234 _CNV_A_R_LINEAR_____390_CM -1250. 1240.234 FORMAT "%6.1" /end CHARACTERISTIC
/begin CHARACTERISTIC C_T_PV_AV_GRD_SOF_MAX "Minimum time for pedal value gradient for recognition of LV_RNG_L" VALUE 0x43016 _REC_VAL_20_u2 655.35 _CNV_A_R_LINEAR_____27_CM 0. 655.35 FORMAT "%6.2" /end CHARACTERISTIC
/begin MEASUREMENT FAC_TQ_REQ_DRIV "Scaling factor for requested torque at clutch from driver" UWORD _CNV_A_R_LINEAR_____45_CM 1 100. 0. 1.99996948 ECU_ADDRESS 0x3fd210 FORMAT "%7.5" /end MEASUREMENT
/begin MEASUREMENT LV_RNG_L_REQ "Activation condition for low-range-mode" UBYTE _CNV_S_2_RANGE______28_CM 1 100. 0. 1. ECU_ADDRESS 0x3fd212 /end MEASUREMENT
/begin AXIS_PTS ldpm_n_fac_tq_req_driv "" 0x452e4 N _REC_AXS_20_u2 8160. _CNV_A_R_LINEAR_____17_CM 12 0. 8160. FORMAT "%4.0" /end AXIS_PTS
/begin AXIS_PTS ldpm_pv_av_fac_tq_req_driv "" 0x43efa PV_AV _REC_AXS_20_u1 99.609375 _CNV_A_R_LINEAR_____4_CM 12 0. 99.609375 FORMAT "%4.1" /end AXIS_PTS
/begin MEASUREMENT TQI_REF_MAX "Maximum indicated torque from IP_TQI_REF" SWORD _CNV_A_R_LINEAR_____48_CM 1 100. -1024. 1023.96875 ECU_ADDRESS 0x3fd0f0 FORMAT "%6.2" /end MEASUREMENT
/begin MEASUREMENT TQ_MAX_CLU "Maximum torque at clutch" SWORD _CNV_A_R_LINEAR_____48_CM 1 100. -1024. 1023.96875 ECU_ADDRESS 0x3fd0ec FORMAT "%6.2" /end MEASUREMENT
/begin MEASUREMENT TQI_MAX "Maximum indicated torque " SWORD _CNV_A_R_LINEAR_____48_CM 1 100. -1024. 1023.96875 ECU_ADDRESS 0x3fd0ee FORMAT "%6.2" /end MEASUREMENT
/begin CHARACTERISTIC C_TQI_FAC_FL "Maximum torque series variation factor" VALUE 0x4310a _REC_VAL_20_u2 1.99996948 _CNV_A_R_LINEAR_____45_CM 0. 1.99996948 FORMAT "%7.5" /end CHARACTERISTIC
/begin MEASUREMENT TQ_MIN_CLU "Minimum  torque at clutch " SWORD _CNV_A_R_LINEAR_____48_CM 1 100. -1024. 1023.96875 ECU_ADDRESS 0x3fd0f2 FORMAT "%6.2" /end MEASUREMENT
/begin MEASUREMENT TQ_MIN_CLU_1 "Minimum  torque at clutch intermitted value 1" SWORD _CNV_A_R_LINEAR_____48_CM 1 100. -1024. 1023.96875 ECU_ADDRESS 0x3fe734 FORMAT "%6.2" /end MEASUREMENT
/begin MEASUREMENT TQ_MIN_CLU_2 "Minimum  torque at clutch intermitted value 2" SWORD _CNV_A_R_LINEAR_____48_CM 1 100. -1024. 1023.96875 ECU_ADDRESS 0x3fe736 FORMAT "%6.2" /end MEASUREMENT
/begin MEASUREMENT FAC_N_DIF_IS "Control factor for the engine self stabilizing" SWORD _CNV_A_R_LINEAR_____15_CM 1 100. -8. 7.99975586 ECU_ADDRESS 0x3fe738 FORMAT "%7.4" /end MEASUREMENT
/begin MEASUREMENT LV_TQ_MIN_CLU "Logical variable for coordination engine start torque and minimum torque and clutch" UBYTE _CNV_S_2_RANGE______28_CM 1 100. 0. 1. ECU_ADDRESS 0x3fd0f6 BIT_MASK 0x1 /end MEASUREMENT
/begin MEASUREMENT TQI_MIN_REQ_PU "Minimum requested indicated torque in PU phase" SWORD _CNV_A_R_LINEAR_____48_CM 1 100. -1024. 1023.96875 ECU_ADDRESS 0x3fd0f4 FORMAT "%6.2" /end MEASUREMENT
/begin MEASUREMENT TQ_MIN_REQ_PU "Minimum requested torque at clutch in PU phase" SWORD _CNV_A_R_LINEAR_____48_CM 1 100. -1024. 1023.96875 ECU_ADDRESS 0x3fe73a FORMAT "%6.2" /end MEASUREMENT
/begin CHARACTERISTIC C_N_DIF_TQ_ST_1 "N_DIF threshold 1 for deactivating TQ_ST" VALUE 0x432b2 _REC_VAL_20_s2 65535. _CNV_A_R_LINEAR_____17_CM -32768. 32767. FORMAT "%5.0" /end CHARACTERISTIC
/begin CHARACTERISTIC C_N_DIF_TQ_ST_2 "N_DIF threshold 2 for deactivating TQ_ST" VALUE 0x432b4 _REC_VAL_20_s2 65535. _CNV_A_R_LINEAR_____17_CM -32768. 32767. FORMAT "%5.0" /end CHARACTERISTIC
/begin CHARACTERISTIC LC_INH_PU_REQ "Manual inhibition to consider LV_PU for TQ_MIN_CLU calculation" VALUE 0x42b9a _REC_VAL_20_u1 1. _CNV_A_R_LINEAR_____10_CM 0. 1. FORMAT "%2.0" /end CHARACTERISTIC
/begin CHARACTERISTIC IP_FAC_N_DIF_IS "Idle self stabilizing factor" CURVE 0x4760c _REC_CUR_20_u2_u2 15.999756 _CNV_A_R_LINEAR_____456_CM -8. 7.999756 FORMAT "%7.5"
 /begin AXIS_DESCR COM_AXIS N_SP_IS_RATIO _CNV_A_R_LINEAR_____348_CM 8 0. 7.99987793 FORMAT "%6.4" AXIS_PTS_REF ldp_n_sp_is_ratio /end AXIS_DESCR
/end CHARACTERISTIC
/begin CHARACTERISTIC IP_TQI_MIN_REQ_PU "Minimum requested indicated torque in PU phase" MAP 0x4c5e4 _REC_MAP_20_u2_u1_u1 1023.96875 _CNV_A_R_LINEAR_____48_CM 0. 1023.96875 FORMAT "%7.2"
 /begin AXIS_DESCR COM_AXIS N_32 _CNV_A_R_LINEAR_____5_CM 12 0. 8160. FORMAT "%4.0" AXIS_PTS_REF ldpm_n_32__tqi_min_pu /end AXIS_DESCR
 /begin AXIS_DESCR COM_AXIS TCO _CNV_A_R_LINEAR_____0_CM 4 -48. 142.5 FORMAT "%5.1" AXIS_PTS_REF ldpm_tco__tqi_min_pu /end AXIS_DESCR
/end CHARACTERISTIC
/begin AXIS_PTS ldp_n_sp_is_ratio "" 0x44940 N_SP_IS_RATIO _REC_AXS_20_u2 7.99987793 _CNV_A_R_LINEAR_____348_CM 8 0. 7.99987793 FORMAT "%6.4" /end AXIS_PTS
/begin CHARACTERISTIC LC_TQ_LOSS_MIN_CLU "Change of  TQ_MIN_CLU_1 calculation" VALUE 0x42be4 _REC_VAL_20_u1 1. _CNV_A_R_LINEAR_____12_CM 0. 1. FORMAT "%1.0" /end CHARACTERISTIC
/begin CHARACTERISTIC LC_TQ_LOSS_MIN_CLU_1 "Change of  TQ_MIN_CLU_1 calculation addional TQ lossses" VALUE 0x42be5 _REC_VAL_20_u1 1. _CNV_A_R_LINEAR_____12_CM 0. 1. FORMAT "%1.0" /end CHARACTERISTIC
/begin CHARACTERISTIC LC_TQ_LOSS_MIN_CLU_IS "Change of  TQ_MIN_CLU_1 calculation addional switch at LV_IS " VALUE 0x42be6 _REC_VAL_20_u1 1. _CNV_A_R_LINEAR_____12_CM 0. 1. FORMAT "%1.0" /end CHARACTERISTIC
/begin MEASUREMENT FAC_TQ_REQ_CLU "Torque scaling factor for calculation requested torque at clutch" UWORD _CNV_A_R_LINEAR_____45_CM 1 100. 0. 1.99996948 ECU_ADDRESS 0x3fd216 FORMAT "%7.5" /end MEASUREMENT
/begin MEASUREMENT LV_TQ_CRU_ACT "Logical variable cruise control active" UBYTE _CNV_S_2_RANGE______28_CM 1 100. 0. 1. ECU_ADDRESS 0x3fd21c /end MEASUREMENT
/begin MEASUREMENT TQ_REQ_CLU "Requested torque at clutch" SWORD _CNV_A_R_LINEAR_____48_CM 1 100. -1024. 1023.96875 ECU_ADDRESS 0x3fd218 FORMAT "%6.2" /end MEASUREMENT
/begin MEASUREMENT TQI_MIN_REQ "Minimum indicated engine torque which can be requested from driver or cruise control" SWORD _CNV_A_R_LINEAR_____48_CM 1 100. -1024. 1023.96875 ECU_ADDRESS 0x3fd21a FORMAT "%8.2" /end MEASUREMENT
/begin MEASUREMENT FAC_TQ_REQ "Torque factor from pedal value interpretation and cruise control" UWORD _CNV_A_R_LINEAR_____45_CM 1 100. 0. 1.99996948 ECU_ADDRESS 0x3fd214 FORMAT "%7.5" /end MEASUREMENT
/begin MEASUREMENT TQI_VS_MAX "???" SWORD _CNV_A_R_LINEAR_____48_CM 1 100. -1024. 1023.96875 ECU_ADDRESS 0x3fd23e FORMAT "%6.2" /end MEASUREMENT
/begin MEASUREMENT TQ_LOSS_SCHA "Torque losses super-charger" SWORD _CNV_A_R_LINEAR_____48_CM 1 100. -1024. 1023.96875 ECU_ADDRESS 0x3fd236 FORMAT "%8.2" /end MEASUREMENT
/begin MEASUREMENT LV_TQ_LOSS_ACC_INP_ORNG "???" UBYTE _CNV_S_2_RANGE______28_CM 1 100. 0. 1. ECU_ADDRESS 0x3fd24c BIT_MASK 0x1 /end MEASUREMENT
/begin MEASUREMENT LAMB_BAS_COR_MAX "Maximum value basic lambda value" UWORD _CNV_A_R_LINEAR_____148_CM 1 100. 0. 31.99902344 ECU_ADDRESS 0x3fd220 FORMAT "%7.4" /end MEASUREMENT
/begin MEASUREMENT LV_CAN_GS_ACK "???" UBYTE _CNV_S_2_RANGE______28_CM 1 100. 0. 1. ECU_ADDRESS 0x3fd24b BIT_MASK 0x1 /end MEASUREMENT
/begin MEASUREMENT LV_ACP_ORNG "???" UBYTE _CNV_S_2_RANGE______11_CM 1 100. 0. 1. ECU_ADDRESS 0x3fd24d /end MEASUREMENT
/begin MEASUREMENT EFF_EGR_S "???" UWORD _CNV_A_R_LINEAR_____45_CM 1 100. 0. 1.99996948 ECU_ADDRESS 0x3fd222 FORMAT "%7.5" /end MEASUREMENT
/begin MEASUREMENT EFF_PHA_S "???" UWORD _CNV_A_R_LINEAR_____45_CM 1 100. 0. 1.99996948 ECU_ADDRESS 0x3fd224 FORMAT "%7.5" /end MEASUREMENT
/begin MEASUREMENT TQ_AD_ADD_S_SWI "Adaptive engine torque value for switch between hom. and strat." SWORD _CNV_A_R_LINEAR_____48_CM 1 100. -1024. 1023.96875 ECU_ADDRESS 0x3fd242 FORMAT "%7.1" /end MEASUREMENT
/begin MEASUREMENT TQI_CAT_PROT "???" SWORD _CNV_A_R_LINEAR_____48_CM 1 100. -1024. 1023.96875 ECU_ADDRESS 0x3fd240 FORMAT "%6.2" /end MEASUREMENT
/begin MEASUREMENT TQ_LOSS_SA "Torque losses power steering" SWORD _CNV_A_R_LINEAR_____48_CM 1 100. -1024. 1023.96875 ECU_ADDRESS 0x3fd234 FORMAT "%6.2" /end MEASUREMENT
/begin MEASUREMENT TQ_LOSS_THERMO "Engine torque losses thermostat" SWORD _CNV_A_R_LINEAR_____48_CM 1 100. -1024. 1023.96875 ECU_ADDRESS 0x3fd238 FORMAT "%8.2" /end MEASUREMENT
/begin MEASUREMENT TQ_LOSS_WIN_HEAT "Engine torque losses rar window heater" SWORD _CNV_A_R_LINEAR_____48_CM 1 100. -1024. 1023.96875 ECU_ADDRESS 0x3fd23a FORMAT "%8.2" /end MEASUREMENT
/begin CHARACTERISTIC C_TQ_AD_ADD_S_SWI "Adaptive engine torque Adaptation value for switch between hom and strat" VALUE 0x432d4 _REC_VAL_20_s2 2047.96875 _CNV_A_R_LINEAR_____48_CM -1024. 1023.96875 FORMAT "%7.1" /end CHARACTERISTIC
/begin MEASUREMENT LV_TQ_DYN_1_REQ "Coordinated Dynamic control bit general" UBYTE _CNV_S_2_RANGE______28_CM 1 100. 0. 1. ECU_ADDRESS 0x3fd0f9 /end MEASUREMENT
/begin MEASUREMENT LV_TQ_DYN_0_DRIV "Coordinated Dynamic control bit (Driver)" UBYTE _CNV_S_2_RANGE______28_CM 1 100. 0. 1. ECU_ADDRESS 0x3fe73d /end MEASUREMENT
/begin MEASUREMENT LV_TQ_DYN_1_DRIV "Coordinated Dynamic control bit (Driver)" UBYTE _CNV_S_2_RANGE______28_CM 1 100. 0. 1. ECU_ADDRESS 0x3fe73e /end MEASUREMENT
/begin MEASUREMENT LV_TQ_DYN_DRIV "Coordinated Dynamic control bit (Driver)" UBYTE _CNV_S_2_RANGE______28_CM 1 100. 0. 1. ECU_ADDRESS 0x3fd0f7 /end MEASUREMENT
/begin CHARACTERISTIC LC_TQ_DYN_DRIV "Manual switch for fast torque request enabled" VALUE 0x42bdc _REC_VAL_20_u1 1. _CNV_A_R_LINEAR_____10_CM 0. 1. FORMAT "%2.0" /end CHARACTERISTIC
/begin CHARACTERISTIC LC_TQ_DYN_DRIV_INH "Manual switch for disabling high dynamic request from driver" VALUE 0x42bdd _REC_VAL_20_u1 1. _CNV_A_R_LINEAR_____10_CM 0. 1. FORMAT "%2.0" /end CHARACTERISTIC
/begin CHARACTERISTIC LC_TQ_DYN_REQ_MAN "Manual switch for adjusting Dynamic Torque intervention Manager mode" VALUE 0x42bde _REC_VAL_20_u1 1. _CNV_A_R_LINEAR_____10_CM 0. 1. FORMAT "%2.0" /end CHARACTERISTIC
/begin CHARACTERISTIC LC_TQ_DYN_0_REQ "Request bit for adjusting Dynamic Torque intervention Manager mode" VALUE 0x42bda _REC_VAL_20_u1 1. _CNV_A_R_LINEAR_____10_CM 0. 1. FORMAT "%2.0" /end CHARACTERISTIC
/begin CHARACTERISTIC LC_TQ_DYN_1_REQ "Request bit for adjusting Dynamic Torque intervention Manager mode" VALUE 0x42bdb _REC_VAL_20_u1 1. _CNV_A_R_LINEAR_____10_CM 0. 1. FORMAT "%2.0" /end CHARACTERISTIC
/begin MEASUREMENT LV_TQ_DYN_0_REQ "Coordinated Dynamic control bit general" UBYTE _CNV_S_2_RANGE______28_CM 1 100. 0. 1. ECU_ADDRESS 0x3fd0f8 /end MEASUREMENT
/begin CHARACTERISTIC C_VS_MIN_DT_FAST "Minimum vehicle speed for fast torque mode at open drive train" VALUE 0x42b36 _REC_VAL_20_u1 255. _CNV_A_R_LINEAR_____13_CM 0. 255. FORMAT "%3.0" /end CHARACTERISTIC
/begin CHARACTERISTIC C_VS_MAX_FAST "Maximum vehicle speed for fast torque mode" VALUE 0x42b2f _REC_VAL_20_u1 255. _CNV_A_R_LINEAR_____13_CM 0. 255. FORMAT "%3.0" /end CHARACTERISTIC
/begin MEASUREMENT TQ_LOSS_ECF "Engine torque losses electric cooling fan" SWORD _CNV_A_R_LINEAR_____48_CM 1 100. -1024. 1023.96875 ECU_ADDRESS 0x3fd25a FORMAT "%6.2" /end MEASUREMENT
/begin CHARACTERISTIC C_LGRD_TQ_LOSS_ECF "ECF-torque loss limitation gradient" VALUE 0x42e00 _REC_VAL_20_u2 1023.96875 _CNV_A_R_LINEAR_____457_CM 0. 1023.96875 FORMAT "%7.2" /end CHARACTERISTIC
/begin CHARACTERISTIC IP_POW_LOSS_ECF "" CURVE 0x4fd21 _REC_CUR_20_u1_u1 -5100. _CNV_A_R_LINEAR_____458_CM 0. -5100. FORMAT "%5.0"
 /begin AXIS_DESCR COM_AXIS ECFPWM_ECF _CNV_A_R_LINEAR_____4_CM 8 0. 99.609375 FORMAT "%4.1" AXIS_PTS_REF ldp_ecfpwm_ecf__pow_loss_ecf /end AXIS_DESCR
/end CHARACTERISTIC
/begin AXIS_PTS ldp_ecfpwm_ecf__pow_loss_ecf "" 0x4339f ECFPWM_ECF _REC_AXS_20_u1 99.609375 _CNV_A_R_LINEAR_____4_CM 8 0. 99.609375 FORMAT "%4.1" /end AXIS_PTS
/begin CHARACTERISTIC C_FAC_TQE "Effective engine torque at clutch" VALUE 0x428bc _REC_VAL_20_u1 0.24902344 _CNV_A_R_LINEAR_____459_CM 0. 0.24902344 FORMAT "%6.4" /end CHARACTERISTIC
/begin MEASUREMENT TQI_AV_HOM "Actual indicated engine torque for homogeneous mode" SWORD _CNV_A_R_LINEAR_____48_CM 1 100. -1024. 1023.96875 ECU_ADDRESS 0x3fe756 FORMAT "%6.2" /end MEASUREMENT
/begin MEASUREMENT TQ_AV "Actual engine torque static at clutch" SWORD _CNV_A_R_LINEAR_____48_CM 1 100. -1024. 1023.96875 ECU_ADDRESS 0x3fd10e FORMAT "%6.2" /end MEASUREMENT
/begin MEASUREMENT TQE "Effective engine torque at clutch" SWORD _CNV_A_R_LINEAR_____48_CM 1 100. -1024. 1023.96875 ECU_ADDRESS 0x3fd110 FORMAT "%6.2" /end MEASUREMENT
/begin MEASUREMENT TQI_AV "Actual indicated engine torque" SWORD _CNV_A_R_LINEAR_____48_CM 1 100. -1024. 1023.96875 ECU_ADDRESS 0x3fd10c FORMAT "%6.2" /end MEASUREMENT
/begin MEASUREMENT TQE_DIF "Difference effective engine torque at clutch" SWORD _CNV_A_R_LINEAR_____48_CM 1 100. -1024. 1023.96875 ECU_ADDRESS 0x3fe758 FORMAT "%6.2" /end MEASUREMENT
/begin MEASUREMENT EFF_TOT_AV "Total actual efficiency (in homogeneous mode)" UWORD _CNV_A_R_LINEAR_____45_CM 1 100. 0. 1.99996948 ECU_ADDRESS 0x3fe754 FORMAT "%7.5" /end MEASUREMENT
/begin MEASUREMENT TQI_AV_S "Actual indicated engine torque for stratified mode" SWORD _CNV_A_R_LINEAR_____48_CM 1 100. -1024. 1023.96875 ECU_ADDRESS 0x3fd112 FORMAT "%6.2" /end MEASUREMENT
/begin MEASUREMENT EFF_TOT_AV_S "Total actual efficiency in stratified mode" UWORD _CNV_A_R_LINEAR_____45_CM 1 100. 0. 1.99996948 ECU_ADDRESS 0x3fe75a FORMAT "%7.5" /end MEASUREMENT
/begin MEASUREMENT TQI_REF_S "Indicated  reference engine torque for stratified mode" SWORD _CNV_A_R_LINEAR_____48_CM 1 100. -1024. 1023.96875 ECU_ADDRESS 0x3fd118 FORMAT "%8.2" /end MEASUREMENT
/begin CHARACTERISTIC IP_TQI_REF_S "Referenced indicated engine torque for stratified mode" MAP 0x4c7c4 _REC_MAP_20_u2_u1_u2 2047.96875 _CNV_A_R_LINEAR_____218_CM -1024. 1023.96875 FORMAT "%6.2"
 /begin AXIS_DESCR COM_AXIS N_32 _CNV_A_R_LINEAR_____5_CM 16 0. 8160. FORMAT "%4.0" AXIS_PTS_REF ldpm_n_32_s /end AXIS_DESCR
 /begin AXIS_DESCR COM_AXIS MFF_SP_S _CNV_A_R_LINEAR_____95_CM 12 0. 1389. FORMAT "%7.2" AXIS_PTS_REF ldp_mff_sp_s__tqi_ref_s /end AXIS_DESCR
/end CHARACTERISTIC
/begin AXIS_PTS ldp_mff_sp_s__tqi_ref_s "" 0x44792 MFF_SP_S _REC_AXS_20_u2 1389. _CNV_A_R_LINEAR_____95_CM 12 0. 1389. FORMAT "%7.2" /end AXIS_PTS
/begin MEASUREMENT TQI_BAS "Basic indicated engine torque" SWORD _CNV_A_R_LINEAR_____48_CM 1 100. -1024. 1023.96875 ECU_ADDRESS 0x3fd120 FORMAT "%6.2" /end MEASUREMENT
/begin MEASUREMENT TQI_REF_IGA "Indicated engine torque corrected by EFF_IGA_BAS_COR" SWORD _CNV_A_R_LINEAR_____48_CM 1 100. -1024. 1023.96875 ECU_ADDRESS 0x3fd128 FORMAT "%6.2" /end MEASUREMENT
/begin MEASUREMENT TQI_REF_IGA_LAMB "Indicated engine torque corrected by EFF_IGA_BAS_COR and EFF_LAMB_BAS" SWORD _CNV_A_R_LINEAR_____48_CM 1 100. -1024. 1023.96875 ECU_ADDRESS 0x3fd126 FORMAT "%6.2" /end MEASUREMENT
/begin MEASUREMENT TQI_REF_IGA_MIN_LAMB "Indicated engine torque corrected by EFF_IGA_MIN and EFF_LAMB_BAS" SWORD _CNV_A_R_LINEAR_____48_CM 1 100. -1024. 1023.96875 ECU_ADDRESS 0x3fd12e FORMAT "%6.2" /end MEASUREMENT
/begin MEASUREMENT TQI_REF_IGA_SCC "Indicated engine torque corrected by EFF_IGA_BAS_COR and EFF_SCC_BAS" SWORD _CNV_A_R_LINEAR_____48_CM 1 100. -1024. 1023.96875 ECU_ADDRESS 0x3fd12c FORMAT "%6.2" /end MEASUREMENT
/begin MEASUREMENT TQI_REF_LAMB "Indicated engine torque corrected by EFF_LAMB_BAS" SWORD _CNV_A_R_LINEAR_____48_CM 1 100. -1024. 1023.96875 ECU_ADDRESS 0x3fd124 FORMAT "%6.2" /end MEASUREMENT
/begin MEASUREMENT TQI_REF_LAMB_SCC "Indicated engine torque corrected by EFF_LAMB_BAS and EFF_SCC_BAS" SWORD _CNV_A_R_LINEAR_____48_CM 1 100. -1024. 1023.96875 ECU_ADDRESS 0x3fd122 FORMAT "%6.2" /end MEASUREMENT
/begin MEASUREMENT TQI_REF_SCC "Indicated engine torque corrected by EFF_SCC_BAS" SWORD _CNV_A_R_LINEAR_____48_CM 1 100. -1024. 1023.96875 ECU_ADDRESS 0x3fd12a FORMAT "%6.2" /end MEASUREMENT
/begin MEASUREMENT TQI_REF "Reference indicated engine torque" SWORD _CNV_A_R_LINEAR_____48_CM 1 100. -1024. 1023.96875 ECU_ADDRESS 0x3fd11e FORMAT "%8.2" /end MEASUREMENT
/begin MEASUREMENT EFF_TOT_BAS "Total basic efficiency" UWORD _CNV_A_R_LINEAR_____45_CM 1 100. 0. 1.99996948 ECU_ADDRESS 0x3fd11a FORMAT "%7.5" /end MEASUREMENT
/begin MEASUREMENT EFF_TOT_BAS_SLOW "Total basic efficiency for feedback to slow torque path" UWORD _CNV_A_R_LINEAR_____45_CM 1 100. 0. 1.99996948 ECU_ADDRESS 0x3fd11c FORMAT "%7.5" /end MEASUREMENT
/begin CHARACTERISTIC LC_MOD_EFF_AV "Logical variable switch to EFF_LAMB_AV and EFF_SCC_AV calculation mode for TQI_BAS" VALUE 0x42bb5 _REC_VAL_20_u1 1. _CNV_A_R_LINEAR_____12_CM 0. 1. FORMAT "%1.0" /end CHARACTERISTIC
/begin MEASUREMENT LV_TQ_INC "Logical variable torque increase active" UBYTE _CNV_S_2_RANGE______28_CM 1 100. 0. 1. ECU_ADDRESS 0x3fd138 /end MEASUREMENT
/begin MEASUREMENT TQI_EMS "Requested indicated engine torque without external interventions" SWORD _CNV_A_R_LINEAR_____48_CM 1 100. -1024. 1023.96875 ECU_ADDRESS 0x3fd134 FORMAT "%6.2" /end MEASUREMENT
/begin MEASUREMENT TQI_REQ_FAST_DEC "Fast torque decrease request" SWORD _CNV_A_R_LINEAR_____48_CM 1 100. -1024. 1023.96875 ECU_ADDRESS 0x3fe76c FORMAT "%6.2" /end MEASUREMENT
/begin MEASUREMENT TQI_INTER_FAST "Intermitted value fast torque request after minimum selection" SWORD _CNV_A_R_LINEAR_____48_CM 1 100. -1024. 1023.96875 ECU_ADDRESS 0x3fe768 FORMAT "%6.2" /end MEASUREMENT
/begin MEASUREMENT TQI_REQ_FAST_INC "Fast torque increase request" SWORD _CNV_A_R_LINEAR_____48_CM 1 100. -1024. 1023.96875 ECU_ADDRESS 0x3fe76a FORMAT "%6.2" /end MEASUREMENT
/begin MEASUREMENT TQI_INTER_SLOW "Intermitted value slow torque request after minimum selection" SWORD _CNV_A_R_LINEAR_____48_CM 1 100. -1024. 1023.96875 ECU_ADDRESS 0x3fe766 FORMAT "%6.2" /end MEASUREMENT
/begin MEASUREMENT TQI_REQ_SLOW_SEL "Slow indicated engine torque request selected" SWORD _CNV_A_R_LINEAR_____48_CM 1 100. -1024. 1023.96875 ECU_ADDRESS 0x3fd130 FORMAT "%6.2" /end MEASUREMENT
/begin MEASUREMENT TQI_REQ_FAST_SEL "Fast indicated engine torque request selected" SWORD _CNV_A_R_LINEAR_____48_CM 1 100. -1024. 1023.96875 ECU_ADDRESS 0x3fd132 FORMAT "%6.2" /end MEASUREMENT
/begin MEASUREMENT TQI_REQ_FAST_SEL_CAN "Requested indicated engine torque without external interventions for CAN" SWORD _CNV_A_R_LINEAR_____48_CM 1 100. -1024. 1023.96875 ECU_ADDRESS 0x3fd136 FORMAT "%6.2" /end MEASUREMENT
/begin MEASUREMENT T_TRA "Actual time value for torque ramps" UBYTE _CNV_A_R_LINEAR_____27_CM 1 100. 0. 2.55 ECU_ADDRESS 0x3fe814 FORMAT "%4.2" /end MEASUREMENT
/begin MEASUREMENT TQ_REQ_DIF_TRA "Deviation of TQ_REQ_CLU and TQ_REQ_TRA_CLU limited to \"0\" Nm" SWORD _CNV_A_R_LINEAR_____48_CM 1 100. -1024. 1023.96875 ECU_ADDRESS 0x3fd26c FORMAT "%6.2" /end MEASUREMENT
/begin MEASUREMENT TQ_RANGE "Range of TQ_REQ_TRA_CLU" ULONG _CNV_S_3_STATE_TQ_R_460_CM 1 100. 1. 3. ECU_ADDRESS 0x3fe80c /end MEASUREMENT
/begin MEASUREMENT TQ_REQ_TRA_CLU "Torque request at clutch after transient torque function" SWORD _CNV_A_R_LINEAR_____48_CM 1 100. -1024. 1023.96875 ECU_ADDRESS 0x3fd26a FORMAT "%6.2" /end MEASUREMENT
/begin MEASUREMENT TQ_REQ_TRA_OLD_CLU "Old torque value at steady state conditions" SWORD _CNV_A_R_LINEAR_____48_CM 1 100. -1024. 1023.96875 ECU_ADDRESS 0x3fe812 FORMAT "%6.2" /end MEASUREMENT
/begin MEASUREMENT TQI_REQ_TRA "Indicated torque request after transient torque function" SWORD _CNV_A_R_LINEAR_____48_CM 1 100. -1024. 1023.96875 ECU_ADDRESS 0x3fd268 FORMAT "%6.2" /end MEASUREMENT
/begin MEASUREMENT TQ_REQ_TRA_STATE "State of torque transient phase" ULONG _CNV_S_3_STATE_TQ_R_461_CM 1 100. 0. 2. ECU_ADDRESS 0x3fe808 /end MEASUREMENT
/begin CHARACTERISTIC C_TQ_TRA_THD_UP_2 "Torque threshold 2 for increasing torque" VALUE 0x4331a _REC_VAL_20_s2 2047.96875 _CNV_A_R_LINEAR_____48_CM -1024. 1023.96875 FORMAT "%7.1" /end CHARACTERISTIC
/begin CHARACTERISTIC C_N_GRD_THD_NEG "Engine speed gradient for torque increase" VALUE 0x43351 _REC_VAL_20_s1 8160. _CNV_A_R_LINEAR_____215_CM -4096. 4064. FORMAT "%5.0" /end CHARACTERISTIC
/begin CHARACTERISTIC C_N_GRD_THD_POS "Engine speed gradient for torque decrease" VALUE 0x43352 _REC_VAL_20_s1 8160. _CNV_A_R_LINEAR_____215_CM -4096. 4064. FORMAT "%5.0" /end CHARACTERISTIC
/begin CHARACTERISTIC LC_TQ_TRA_INH "Logical parameter inhibition torque transient (0 ... torque transient active, 1... torque transient passive)" VALUE 0x42bea _REC_VAL_20_u1 1. _CNV_A_R_LINEAR_____12_CM 0. 1. FORMAT "%1.0" /end CHARACTERISTIC
/begin CHARACTERISTIC C_TQ_TRA_THD_DOWN_1 "Torque threshold 1 for decreasing torque" VALUE 0x43314 _REC_VAL_20_s2 2047.96875 _CNV_A_R_LINEAR_____48_CM -1024. 1023.96875 FORMAT "%7.1" /end CHARACTERISTIC
/begin CHARACTERISTIC C_TQ_TRA_THD_DOWN_2 "Torque threshold 2 for decreasing torque" VALUE 0x43316 _REC_VAL_20_s2 2047.96875 _CNV_A_R_LINEAR_____48_CM -1024. 1023.96875 FORMAT "%7.1" /end CHARACTERISTIC
/begin CHARACTERISTIC C_TQ_TRA_THD_UP_1 "Torque threshold 1 for increasing torque" VALUE 0x43318 _REC_VAL_20_s2 2047.96875 _CNV_A_R_LINEAR_____48_CM -1024. 1023.96875 FORMAT "%7.1" /end CHARACTERISTIC
/begin MEASUREMENT LV_TQ_TRA "Logical variable transient torque function acitve" UBYTE _CNV_S_2_RANGE______28_CM 1 100. 0. 1. ECU_ADDRESS 0x3fe815 BIT_MASK 0x1 /end MEASUREMENT
/begin MEASUREMENT LV_TQ_TRA_DYN "Logical variable spark retard requested due to driver dynamics" UBYTE _CNV_S_2_RANGE______28_CM 1 100. 0. 1. ECU_ADDRESS 0x3fd26e /end MEASUREMENT
/begin MEASUREMENT TQI_SP_S "Torque setpoint for stratified combustion mode" SWORD _CNV_A_R_LINEAR_____48_CM 1 100. -1024. 1023.96875 ECU_ADDRESS 0x3fd10a FORMAT "%8.2" /end MEASUREMENT
/begin MEASUREMENT TQI_REQ_SLOW "Slow indicated engine torque request" SWORD _CNV_A_R_LINEAR_____48_CM 1 100. -1024. 1023.96875 ECU_ADDRESS 0x3fd0fc FORMAT "%6.2" /end MEASUREMENT
/begin MEASUREMENT TQI_REQ_FAST "Fast indicated engine torque request" SWORD _CNV_A_R_LINEAR_____48_CM 1 100. -1024. 1023.96875 ECU_ADDRESS 0x3fd0fe FORMAT "%6.2" /end MEASUREMENT
/begin MEASUREMENT TQI_REQ_FAST_CAN "Limited torque request for fast path to CAN" SWORD _CNV_A_R_LINEAR_____48_CM 1 100. -1024. 1023.96875 ECU_ADDRESS 0x3fd100 FORMAT "%6.2" /end MEASUREMENT
/begin MEASUREMENT TQI_BAS_COR_CH "Corrected indicated basic engine torque at active torque lead with TQI_ADD_CH_FIL" SWORD _CNV_A_R_LINEAR_____48_CM 1 100. -1024. 1023.96875 ECU_ADDRESS 0x3fe74c FORMAT "%8.2" /end MEASUREMENT
/begin MEASUREMENT TQI_SP "Setpoint indicated engine torque" SWORD _CNV_A_R_LINEAR_____48_CM 1 100. -1024. 1023.96875 ECU_ADDRESS 0x3fd104 FORMAT "%6.2" /end MEASUREMENT
/begin MEASUREMENT TQI_SP_1 "Non smoothed setpoint indicated engine torque" SWORD _CNV_A_R_LINEAR_____48_CM 1 100. -1024. 1023.96875 ECU_ADDRESS 0x3fe740 FORMAT "%6.2" /end MEASUREMENT
/begin MEASUREMENT TQI_SP_2 "Smooth setpoint indicated engine torque" SWORD _CNV_A_R_LINEAR_____48_CM 1 100. -1024. 1023.96875 ECU_ADDRESS 0x3fe742 FORMAT "%6.2" /end MEASUREMENT
/begin MEASUREMENT TQI_SP_3 "Intermitted setpoint indicated engine torque after selection" SWORD _CNV_A_R_LINEAR_____48_CM 1 100. -1024. 1023.96875 ECU_ADDRESS 0x3fe744 FORMAT "%6.2" /end MEASUREMENT
/begin MEASUREMENT TQI_SP_MAF "Indicated engine torque set-point has to realized by mass air flow control" SWORD _CNV_A_R_LINEAR_____48_CM 1 100. -1024. 1023.96875 ECU_ADDRESS 0x3fe746 FORMAT "%6.2" /end MEASUREMENT
/begin MEASUREMENT TQI_BAS_COR "Corrected indicated basic engine torque at active torque lead" SWORD _CNV_A_R_LINEAR_____48_CM 1 100. -1024. 1023.96875 ECU_ADDRESS 0x3fd108 FORMAT "%6.2" /end MEASUREMENT
/begin MEASUREMENT MAF_SP_TQI "MAF setpoint for torque interventions" UWORD _CNV_A_R_LINEAR_____95_CM 1 100. 0. 1389. ECU_ADDRESS 0x3fd0fa FORMAT "%6.2" /end MEASUREMENT
/begin MEASUREMENT TQI_FAST "Indicated engine torque fast request" SWORD _CNV_A_R_LINEAR_____48_CM 1 100. -1024. 1023.96875 ECU_ADDRESS 0x3fd102 FORMAT "%6.2" /end MEASUREMENT
/begin MEASUREMENT TQI_SP_MAF_1 "Indicated engine torque set-point has to realized by mass air flow control intermediate 1" SWORD _CNV_A_R_LINEAR_____48_CM 1 100. -1024. 1023.96875 ECU_ADDRESS 0x3fe748 FORMAT "%6.2" /end MEASUREMENT
/begin MEASUREMENT LV_TQ_INTV "Logical variable fast torque intervention allowed" UBYTE _CNV_S_2_RANGE______28_CM 1 100. 0. 1. ECU_ADDRESS 0x3fe753 BIT_MASK 0x1 /end MEASUREMENT
/begin MEASUREMENT TQI_SP_MAF_2 "Indicated engine torque set-point has to realized by mass air flow control intermediate 2" SWORD _CNV_A_R_LINEAR_____48_CM 1 100. -1024. 1023.96875 ECU_ADDRESS 0x3fe74a FORMAT "%6.2" /end MEASUREMENT
/begin MEASUREMENT LV_TQ_INTV_REQ "Logical variable fast torque intervention requested" UBYTE _CNV_S_2_RANGE______28_CM 1 100. 0. 1. ECU_ADDRESS 0x3fe752 BIT_MASK 0x1 /end MEASUREMENT
/begin CHARACTERISTIC C_TQ_DIF_1 "Torque threshold 1 for bottom level offset of smoothing zone" VALUE 0x432e4 _REC_VAL_20_s2 2047.96875 _CNV_A_R_LINEAR_____48_CM -1024. 1023.96875 FORMAT "%7.1" /end CHARACTERISTIC
/begin CHARACTERISTIC C_TQ_DIF_2 "Torque threshold 2 for top level offset of smoothing zone" VALUE 0x432e6 _REC_VAL_20_s2 2047.96875 _CNV_A_R_LINEAR_____48_CM -1024. 1023.96875 FORMAT "%7.1" /end CHARACTERISTIC
/begin CHARACTERISTIC C_TQ_DIF_HYS_1 "Torque hysteresis 1 for bottom level offset of smoothing zone" VALUE 0x432e8 _REC_VAL_20_s2 2047.96875 _CNV_A_R_LINEAR_____48_CM -1024. 1023.96875 FORMAT "%7.1" /end CHARACTERISTIC
/begin CHARACTERISTIC LC_TQ_INTV_ENA_AS "Logical constant fast torque intervention enabled by application system" VALUE 0x42be0 _REC_VAL_20_u1 1. _CNV_A_R_LINEAR_____12_CM 0. 1. FORMAT "%1.0" /end CHARACTERISTIC
/begin CHARACTERISTIC C_TQ_DIF_HYS_2 "Torque hysteresis 2 for top level offset of smoothing zone" VALUE 0x432ea _REC_VAL_20_s2 2047.96875 _CNV_A_R_LINEAR_____48_CM -1024. 1023.96875 FORMAT "%7.1" /end CHARACTERISTIC
/begin CHARACTERISTIC LC_TQ_INTV_INH_AS "Logical constant fast torque intervention inhibited by application system" VALUE 0x42be1 _REC_VAL_20_u1 1. _CNV_A_R_LINEAR_____12_CM 0. 1. FORMAT "%1.0" /end CHARACTERISTIC
/begin CHARACTERISTIC C_TQ_DIF_HYS_IS_1 "Torque hysteresis 1 for bottom level offset of smoothing zone during idle speed control " VALUE 0x432ec _REC_VAL_20_s2 2047.96875 _CNV_A_R_LINEAR_____48_CM -1024. 1023.96875 FORMAT "%7.1" /end CHARACTERISTIC
/begin CHARACTERISTIC C_TQ_DIF_HYS_IS_2 "Torque hysteresis 2 for top level offset of smoothing zone during idle speed control" VALUE 0x432ee _REC_VAL_20_s2 2047.96875 _CNV_A_R_LINEAR_____48_CM -1024. 1023.96875 FORMAT "%7.1" /end CHARACTERISTIC
/begin CHARACTERISTIC LC_TQI_SP_MAN_ACT "Logical constant manual torque active" VALUE 0x42bee _REC_VAL_20_u1 1. _CNV_A_R_LINEAR_____12_CM 0. 1. FORMAT "%1.0" /end CHARACTERISTIC
/begin CHARACTERISTIC C_TQ_DIF_IS_1 "Torque threshold 1 for bottom level offset of smoothing zone during idle speed control" VALUE 0x432f0 _REC_VAL_20_s2 2047.96875 _CNV_A_R_LINEAR_____48_CM -1024. 1023.96875 FORMAT "%7.1" /end CHARACTERISTIC
/begin CHARACTERISTIC C_TQ_DIF_IS_2 "Torque threshold 2 for top level offset of smoothing zone during idle speed control" VALUE 0x432f2 _REC_VAL_20_s2 2047.96875 _CNV_A_R_LINEAR_____48_CM -1024. 1023.96875 FORMAT "%7.1" /end CHARACTERISTIC
/begin CHARACTERISTIC C_TQI_SP_MAN "Manual torque setpoint request by application tool" VALUE 0x4331e _REC_VAL_20_s2 2047.96875 _CNV_A_R_LINEAR_____48_CM -1024. 1023.96875 FORMAT "%7.1" /end CHARACTERISTIC
/begin MEASUREMENT TQI_SP_CAN "Setpoint indicated engine torque for CAN calculations" SWORD _CNV_A_R_LINEAR_____48_CM 1 100. -1024. 1023.96875 ECU_ADDRESS 0x3fd106 FORMAT "%6.2" /end MEASUREMENT
/begin MEASUREMENT TQI_FAST_CAN "Indicated engine torque fast request for CAN" SWORD _CNV_A_R_LINEAR_____48_CM 1 100. -1024. 1023.96875 ECU_ADDRESS 0x3fe74e FORMAT "%6.2" /end MEASUREMENT
/begin MEASUREMENT TQI_SP_1_CAN "Non smoothed setpoint indicated engine torque for CAN" SWORD _CNV_A_R_LINEAR_____48_CM 1 100. -1024. 1023.96875 ECU_ADDRESS 0x3fe750 FORMAT "%6.2" /end MEASUREMENT
/begin CHARACTERISTIC LC_TQ_LIM_INH "logical constant inhibition torque intervetion for safety in general" VALUE 0x40285 _REC_VAL_20_u1 1. _CNV_A_R_LINEAR_____10_CM 0. 1. FORMAT "%2.0" /end CHARACTERISTIC
/begin CHARACTERISTIC LC_TQ_LIM_INH_FAST "logical constant inhibition torque intervetion for safety for fast path" VALUE 0x40286 _REC_VAL_20_u1 1. _CNV_A_R_LINEAR_____10_CM 0. 1. FORMAT "%2.0" /end CHARACTERISTIC
/begin CHARACTERISTIC LC_TQ_LIM_INH_SLOW "logical constant inhibition torque intervetion for safety for slow path" VALUE 0x40287 _REC_VAL_20_u1 1. _CNV_A_R_LINEAR_____10_CM 0. 1. FORMAT "%2.0" /end CHARACTERISTIC
/begin CHARACTERISTIC C_TQI_REQ_LIM_PAS "Maximum positive gradient of the requested torque TQI_REQ_LIM" VALUE 0x40296 _REC_VAL_20_u2 1023.96875 _CNV_A_R_LINEAR_____48_CM 0. 1023.96875 FORMAT "%7.2" /end CHARACTERISTIC
/begin CHARACTERISTIC C_TQ_LIM_INC "Maximum positive gradient of the requested torque TQI_REQ_LIM" VALUE 0x40294 _REC_VAL_20_u2 1023.96875 _CNV_A_R_LINEAR_____48_CM 0. 1023.96875 FORMAT "%7.2" /end CHARACTERISTIC
/begin CHARACTERISTIC C_TQ_LIM_DEC "Maximum negative gradient of the requested torque TQI_REQ_LIM" VALUE 0x40292 _REC_VAL_20_u2 1023.96875 _CNV_A_R_LINEAR_____48_CM 0. 1023.96875 FORMAT "%7.2" /end CHARACTERISTIC
/begin CHARACTERISTIC C_T_TQ_LIM_INTV "Time after active torque intervention to reset LV_TQ_LIM_INTV" VALUE 0x40290 _REC_VAL_20_u2 2621.4 _CNV_A_R_LINEAR_____87_CM 0. 2621.4 FORMAT "%7.2" /end CHARACTERISTIC
/begin CHARACTERISTIC IP_TQI_DIF_LIM "Torque after torque interventionj to reset LV_TQ_LIM_INTV" MAP 0x40552 _REC_MAP_20_u2_u1_u1 2047.96875 _CNV_A_R_LINEAR_____218_CM -1024. 1023.96875 FORMAT "%6.2"
 /begin AXIS_DESCR COM_AXIS N_32 _CNV_A_R_LINEAR_____5_CM 4 0. 8160. FORMAT "%4.0" AXIS_PTS_REF ldp_n_32__tqi_dif_lim /end AXIS_DESCR
 /begin AXIS_DESCR COM_AXIS TQI_SP_MON _CNV_A_R_LINEAR_____88_CM 4 0. 510. FORMAT "%3.0" AXIS_PTS_REF ldp_tqi_sp_mon__tqi_dif_lim /end AXIS_DESCR
/end CHARACTERISTIC
/begin AXIS_PTS ldp_n_32__tqi_dif_lim "" 0x402e1 N_32 _REC_AXS_20_u1 8160. _CNV_A_R_LINEAR_____5_CM 4 0. 8160. FORMAT "%4.0" /end AXIS_PTS
/begin AXIS_PTS ldp_tqi_sp_mon__tqi_dif_lim "" 0x40380 TQI_SP_MON _REC_AXS_20_u1 510. _CNV_A_R_LINEAR_____88_CM 4 0. 510. FORMAT "%3.0" /end AXIS_PTS
/begin MEASUREMENT T_TQ_LIM_INTV "Time counter after transition LV_TQ_INTV_ACT 1-->0 to set LV_TQ_LIM_INTV = 0" UWORD _CNV_A_R_LINEAR_____87_CM 1 100. 0. 2621.4 ECU_ADDRESS 0x3fe7f2 FORMAT "%7.2" /end MEASUREMENT
/begin MEASUREMENT SUM_TQI_REQ_LIM "Event counter of active torque limitations" UWORD _CNV_A_R_LINEAR_____10_CM 1 100. 0. 65535. ECU_ADDRESS 0x3fd25c FORMAT "%5.0" /end MEASUREMENT
/begin MEASUREMENT TQI_REQ_LIM_4 "Intermediate value 4 for requested torque for safety" SWORD _CNV_A_R_LINEAR_____48_CM 1 100. -1024. 1023.96875 ECU_ADDRESS 0x3fe7fe FORMAT "%6.2" /end MEASUREMENT
/begin MEASUREMENT TQI_REQ_LIM_SLOW "???" SWORD _CNV_A_R_LINEAR_____48_CM 1 100. -1024. 1023.96875 ECU_ADDRESS 0x3fd264 FORMAT "%8.2" /end MEASUREMENT
/begin MEASUREMENT TQI_REQ_LIM_3 "Intermediate value 3 for requested torque for safety" SWORD _CNV_A_R_LINEAR_____48_CM 1 100. -1024. 1023.96875 ECU_ADDRESS 0x3fe7fc FORMAT "%6.2" /end MEASUREMENT
/begin MEASUREMENT LV_TQ_LIM_INTV "Bit for torque intervention for safety active" UBYTE _CNV_S_2_RANGE______11_CM 1 100. 0. 1. ECU_ADDRESS 0x3fd266 BIT_MASK 0x1 /end MEASUREMENT
/begin MEASUREMENT TQI_REQ_LIM_1 "Intermediate value 1 for requested torque for safety" SWORD _CNV_A_R_LINEAR_____48_CM 1 100. -1024. 1023.96875 ECU_ADDRESS 0x3fe7f8 FORMAT "%6.2" /end MEASUREMENT
/begin MEASUREMENT TQI_REQ_LIM_2 "Intermediate value 2 for requested torque for safety" SWORD _CNV_A_R_LINEAR_____48_CM 1 100. -1024. 1023.96875 ECU_ADDRESS 0x3fe7fa FORMAT "%6.2" /end MEASUREMENT
/begin MEASUREMENT TQI_DIF_LIM "Torque offset for regnition torque intervention active" SWORD _CNV_A_R_LINEAR_____48_CM 1 100. -1024. 1023.96875 ECU_ADDRESS 0x3fe7f6 FORMAT "%6.2" /end MEASUREMENT
/begin MEASUREMENT T_TQI_REQ_LIM "incremented time counter after transition LV_TQ_LIM_INTV_\" 0 -> 1 to set LV_TQ_LIM_INTV = 0" UWORD _CNV_A_R_LINEAR_____87_CM 1 100. 0. 2621.4 ECU_ADDRESS 0x3fe7f4 FORMAT "%7.2" /end MEASUREMENT
/begin MEASUREMENT T_TQI_REQ_LIM_MAX "max time counter after transition LV_TQ_LIM_INTV_\" 0 -> 1 to set LV_TQ_LIM_INTV = 0" UWORD _CNV_A_R_LINEAR_____87_CM 1 100. 0. 2621.4 ECU_ADDRESS 0x3fd25e FORMAT "%7.2" /end MEASUREMENT
/begin MEASUREMENT TQI_REQ_LIM_FAST "???" SWORD _CNV_A_R_LINEAR_____48_CM 1 100. -1024. 1023.96875 ECU_ADDRESS 0x3fd262 FORMAT "%8.2" /end MEASUREMENT
/begin MEASUREMENT TQI_REQ_LIM_DIF "difference of torque request for safety" SWORD _CNV_A_R_LINEAR_____48_CM 1 100. -1024. 1023.96875 ECU_ADDRESS 0x3fe800 FORMAT "%8.2" /end MEASUREMENT
/begin MEASUREMENT TQI_REQ_LIM_DIF_MAX "max. difference of torque request for safety" SWORD _CNV_A_R_LINEAR_____48_CM 1 100. -1024. 1023.96875 ECU_ADDRESS 0x3fd260 FORMAT "%8.2" /end MEASUREMENT
/begin MEASUREMENT LV_TQ_LIM_INTV_1 "Result for TQI_REF_IGA_LAMB > TQI_SP_MAN" UBYTE _CNV_S_2_RANGE______11_CM 1 100. 0. 1. ECU_ADDRESS 0x3fe802 BIT_MASK 0x1 /end MEASUREMENT
/begin MEASUREMENT LV_TQ_LIM_INTV_2 "ON-Delayed (40 ms) result for TQI_REF_IGA_LAMB > TQI_SP_MAN" UBYTE _CNV_S_2_RANGE______11_CM 1 100. 0. 1. ECU_ADDRESS 0x3fe804 BIT_MASK 0x1 /end MEASUREMENT
/begin MEASUREMENT TQ_ADD_REQ_CH "Requested torque reserve for catalyt-heating" SWORD _CNV_A_R_LINEAR_____48_CM 1 100. -1024. 1023.96875 ECU_ADDRESS 0x3fe77a FORMAT "%6.2" /end MEASUREMENT
/begin MEASUREMENT TQ_ADD_MAX "Maximum possible torque reserve" SWORD _CNV_A_R_LINEAR_____48_CM 1 100. -1024. 1023.96875 ECU_ADDRESS 0x3fd148 FORMAT "%6.2" /end MEASUREMENT
/begin MEASUREMENT TQ_ADD_REQ_MAX_TEG "Maximum possible torque reserve request due to EFF_IGA_MIN_TEG" SWORD _CNV_A_R_LINEAR_____48_CM 1 100. -1024. 1023.96875 ECU_ADDRESS 0x3fe778 FORMAT "%6.2" /end MEASUREMENT
/begin MEASUREMENT MAF_KGH_ADD_MAX "Maximum possible engine load for catalyst heating - kg/h" UWORD _CNV_A_R_LINEAR_____101_CM 1 100. 0. 2047.96875 ECU_ADDRESS 0x3fd13a FORMAT "%7.2" /end MEASUREMENT
/begin MEASUREMENT MAF_ADD_MAX "Maximum possible engine load for catalyst heating - mg/Stk" UWORD _CNV_A_R_LINEAR_____95_CM 1 100. 0. 1389. ECU_ADDRESS 0x3fd13c FORMAT "%7.2" /end MEASUREMENT
/begin MEASUREMENT TQI_ADD_ACT "Active indicated engine torque inclusive torque reserve" SWORD _CNV_A_R_LINEAR_____48_CM 1 100. -1024. 1023.96875 ECU_ADDRESS 0x3fd140 FORMAT "%6.2" /end MEASUREMENT
/begin MEASUREMENT EFF_IGA_MIN_ADD_MAX "Minimum possible ignition efficiency for catalyst heating" UWORD _CNV_A_R_LINEAR_____45_CM 1 100. 0. 1.99996948 ECU_ADDRESS 0x3fd13e FORMAT "%7.5" /end MEASUREMENT
/begin MEASUREMENT TQI_ADD_MAX "Maximum possible indicated engine torque inclusive torque reserve" SWORD _CNV_A_R_LINEAR_____48_CM 1 100. -1024. 1023.96875 ECU_ADDRESS 0x3fd142 FORMAT "%6.2" /end MEASUREMENT
/begin MEASUREMENT LV_TQ_ADD_REQ "Logical variable torque reserve request can be applied" UBYTE _CNV_S_2_RANGE______28_CM 1 100. 0. 1. ECU_ADDRESS 0x3fd14e /end MEASUREMENT
/begin MEASUREMENT TQ_ADD_ACT "Active clutch torque inclusive torque reserve" SWORD _CNV_A_R_LINEAR_____48_CM 1 100. -1024. 1023.96875 ECU_ADDRESS 0x3fd144 FORMAT "%7.1" /end MEASUREMENT
/begin MEASUREMENT TQI_ADD_ACT_TMP_1 "Temporary indicated engine-torque request inclusive torque reserve - for slow torque coordination input" SWORD _CNV_A_R_LINEAR_____48_CM 1 100. -1024. 1023.96875 ECU_ADDRESS 0x3fe770 FORMAT "%6.2" /end MEASUREMENT
/begin MEASUREMENT TQ_ADD_REQ "Requested torque reserve after max.coordination" SWORD _CNV_A_R_LINEAR_____48_CM 1 100. -1024. 1023.96875 ECU_ADDRESS 0x3fd14c FORMAT "%6.2" /end MEASUREMENT
/begin MEASUREMENT TQI_ADD_ACT_TMP_2 "Indicated engine-torque request inclusive torque reserve - for general torque-reserve request" SWORD _CNV_A_R_LINEAR_____48_CM 1 100. -1024. 1023.96875 ECU_ADDRESS 0x3fe772 FORMAT "%6.2" /end MEASUREMENT
/begin MEASUREMENT TQI_ADD_ACT_TMP_3 "Indicated engine-torque request inclusive torque reserve - for catalyst-heating torque-reserve request" SWORD _CNV_A_R_LINEAR_____48_CM 1 100. -1024. 1023.96875 ECU_ADDRESS 0x3fe774 FORMAT "%6.2" /end MEASUREMENT
/begin MEASUREMENT TQI_ADD_MAX_TOL "Maximum possible indicated engine torque inclusive torque reserve at IGA_MIN" SWORD _CNV_A_R_LINEAR_____48_CM 1 100. -1024. 1023.96875 ECU_ADDRESS 0x3fd14a FORMAT "%6.2" /end MEASUREMENT
/begin MEASUREMENT TQI_ADD_MAX_TEG "Maximum possible indicated engine torque inclusive torque reserve at IGA_MIN_TEG" SWORD _CNV_A_R_LINEAR_____48_CM 1 100. -1024. 1023.96875 ECU_ADDRESS 0x3fe776 FORMAT "%6.2" /end MEASUREMENT
/begin MEASUREMENT LV_TQ_ADD_REQ_1 "Logical variable torque reserve request can be applied" UBYTE _CNV_S_2_RANGE______11_CM 1 100. 0. 1. ECU_ADDRESS 0x3fe77c /end MEASUREMENT
/begin MEASUREMENT TQ_ADD_REQ_ACT "Actual realized torque-reserve-request for slow torque coordination input" SWORD _CNV_A_R_LINEAR_____48_CM 1 100. -1024. 1023.96875 ECU_ADDRESS 0x3fd146 FORMAT "%6.2" /end MEASUREMENT
/begin MEASUREMENT LV_TQ_ADD_REQ_2 "Logical variable torque reserve request can be applied" UBYTE _CNV_S_2_RANGE______11_CM 1 100. 0. 1. ECU_ADDRESS 0x3fe77d /end MEASUREMENT
/begin CHARACTERISTIC LC_INH_TQ_ADD_CH "Logical constant for deactivation torque-reserve request for catalyst heating" VALUE 0x42ba0 _REC_VAL_20_u1 1. _CNV_A_R_LINEAR_____10_CM 0. 1. FORMAT "%2.0" /end CHARACTERISTIC
/begin CHARACTERISTIC LC_INH_TQ_ADD "Logical constant for deactivation general torque-reserve request" VALUE 0x42b9f _REC_VAL_20_u1 1. _CNV_A_R_LINEAR_____10_CM 0. 1. FORMAT "%2.0" /end CHARACTERISTIC
/begin CHARACTERISTIC C_TQ_ADD_MIN_CH "Minimum threshold for authorizing torque request for catalyst heating" VALUE 0x432dc _REC_VAL_20_s2 2047.96875 _CNV_A_R_LINEAR_____48_CM -1024. 1023.96875 FORMAT "%7.1" /end CHARACTERISTIC
/begin CHARACTERISTIC C_TQ_ADD_HYS "Torque lead hysteresis for deactivation torque lead request" VALUE 0x432d6 _REC_VAL_20_s2 2047.96875 _CNV_A_R_LINEAR_____48_CM -1024. 1023.96875 FORMAT "%7.1" /end CHARACTERISTIC
/begin CHARACTERISTIC C_TQ_ADD_HYS_CRU "Torque lead hysteresis for deactivation torque lead request at active cruise control" VALUE 0x432d8 _REC_VAL_20_s2 2047.96875 _CNV_A_R_LINEAR_____48_CM -1024. 1023.96875 FORMAT "%7.1" /end CHARACTERISTIC
/begin CHARACTERISTIC C_TQ_ADD_MIN "Minimum threshold for authorizing torque lead request" VALUE 0x432da _REC_VAL_20_s2 2047.96875 _CNV_A_R_LINEAR_____48_CM -1024. 1023.96875 FORMAT "%7.1" /end CHARACTERISTIC
/begin CHARACTERISTIC C_TQ_ADD_MIN_CRU "Minimum threshold for authorizing torque lead request at active cruise control" VALUE 0x432de _REC_VAL_20_s2 2047.96875 _CNV_A_R_LINEAR_____48_CM -1024. 1023.96875 FORMAT "%7.1" /end CHARACTERISTIC
/begin MEASUREMENT TQ_ADD_ST "Torque reserve at engine start" SWORD _CNV_A_R_LINEAR_____48_CM 1 100. -1024. 1023.96875 ECU_ADDRESS 0x3fd19e FORMAT "%6.2" /end MEASUREMENT
/begin MEASUREMENT LV_TQ_ADD_ST "Logical variable torque reserve at engine start" UBYTE _CNV_S_2_RANGE______28_CM 1 100. 0. 1. ECU_ADDRESS 0x3fe7de BIT_MASK 0x1 /end MEASUREMENT
/begin CHARACTERISTIC C_T_TQ_ADD_DLY_ST "Time delay for deactivation torque lead" VALUE 0x43046 _REC_VAL_20_u2 655.35 _CNV_A_R_LINEAR_____27_CM 0. 655.35 FORMAT "%5.2" /end CHARACTERISTIC
/begin CHARACTERISTIC C_TQ_ADD_CRLC_ST "Correlation constant for torque  lead" VALUE 0x42ad9 _REC_VAL_20_u1 0.9960940000000002 _CNV_A_R_LINEAR_____44_CM 0. 0.996094 FORMAT "%5.3" /end CHARACTERISTIC
/begin AXIS_PTS ldp_n_tq_add_st "" 0x4377c N_32 _REC_AXS_20_u1 8160. _CNV_A_R_LINEAR_____5_CM 8 0. 8160. FORMAT "%4.0" /end AXIS_PTS
/begin AXIS_PTS ldp_tco_tq_add_st "" 0x4399e TCO _REC_AXS_20_u1 190.5 _CNV_A_R_LINEAR_____0_CM 4 -48. 142.5 FORMAT "%5.1" /end AXIS_PTS
/begin CHARACTERISTIC IP_TQ_ADD_ST "Torque lead at engine start" MAP 0x4be50 _REC_MAP_20_u2_u1_u1 2047.96875 _CNV_A_R_LINEAR_____218_CM -1024. 1023.96875 FORMAT "%6.2"
 /begin AXIS_DESCR COM_AXIS N_32 _CNV_A_R_LINEAR_____5_CM 8 0. 8160. FORMAT "%4.0" AXIS_PTS_REF ldp_n_tq_add_st /end AXIS_DESCR
 /begin AXIS_DESCR COM_AXIS TCO _CNV_A_R_LINEAR_____0_CM 4 -48. 142.5 FORMAT "%5.1" AXIS_PTS_REF ldp_tco_tq_add_st /end AXIS_DESCR
/end CHARACTERISTIC
/begin MEASUREMENT TQ_ADD_TRA_1 "Torque lead output from map IP_TQ_ADD_TRA for transient torque" SWORD _CNV_A_R_LINEAR_____48_CM 1 100. -1024. 1023.96875 ECU_ADDRESS 0x3fe77e FORMAT "%6.2" /end MEASUREMENT
/begin MEASUREMENT TQ_ADD_TRA_2 "Torque reserve output from map IP_FAC_TQ_REQ_DIF_TRA  for transient torque" SWORD _CNV_A_R_LINEAR_____48_CM 1 100. -1024. 1023.96875 ECU_ADDRESS 0x3fe780 FORMAT "%6.2" /end MEASUREMENT
/begin MEASUREMENT FAC_TQ_TRA "Weighting factor for TQ_REQ_DIF_TRA" UWORD _CNV_A_R_LINEAR_____379_CM 1 100. 0. 31.99951171875 ECU_ADDRESS 0x3fe782 FORMAT "%7.4" /end MEASUREMENT
/begin CHARACTERISTIC IP_TQ_ADD_TRA__N_32 "Torque lead at transient torque conditions" CURVE 0x4be90 _REC_CUR_20_u2_u1 1023.96875 _CNV_A_R_LINEAR_____48_CM 0. 1023.96875 FORMAT "%7.2"
 /begin AXIS_DESCR COM_AXIS N_32 _CNV_A_R_LINEAR_____5_CM 8 0. 8160. FORMAT "%4.0" AXIS_PTS_REF ldp_n_32_tq_add_tra /end AXIS_DESCR
/end CHARACTERISTIC
/begin CHARACTERISTIC IP_FAC_TQ_TRA__TQ_REQ_DIF_TRA "Torque reserve at transient torque conditions" CURVE 0x47f70 _REC_CUR_20_u2_u2 31.99951171875 _CNV_A_R_LINEAR_____379_CM 0. 31.99951171875 FORMAT "%7.4"
 /begin AXIS_DESCR COM_AXIS TQ_REQ_DIF_TRA _CNV_A_R_LINEAR_____48_CM 6 0. 1023.96875 FORMAT "%7.2" AXIS_PTS_REF ldp_tq_req_dif_tra_fac_tq_tra /end AXIS_DESCR
/end CHARACTERISTIC
/begin MEASUREMENT TQ_ADD_TRA "Torque lead for transient trorque" SWORD _CNV_A_R_LINEAR_____48_CM 1 100. -1024. 1023.96875 ECU_ADDRESS 0x3fd150 FORMAT "%6.2" /end MEASUREMENT
/begin AXIS_PTS ldp_n_32_tq_add_tra "" 0x436e0 N_32 _REC_AXS_20_u1 8160. _CNV_A_R_LINEAR_____5_CM 8 0. 8160. FORMAT "%4.0" /end AXIS_PTS
/begin AXIS_PTS ldp_tq_req_dif_tra_fac_tq_tra "" 0x44c36 TQ_REQ_DIF_TRA _REC_AXS_20_u2 1023.96875 _CNV_A_R_LINEAR_____48_CM 6 0. 1023.96875 FORMAT "%7.2" /end AXIS_PTS
/begin MEASUREMENT TQI_P_MAX "???" SWORD _CNV_A_R_LINEAR_____48_CM 1 100. -1024. 1023.96875 ECU_ADDRESS 0x3fd270 FORMAT "%6.2" /end MEASUREMENT
/begin CHARACTERISTIC IP_TQ_LIM_AMT "Maximum allowed torque at clutch due to torque limitation depending on gear ratio by AMT" CURVE 0x4c004 _REC_CUR_20_u2_u2 1023.96875 _CNV_A_R_LINEAR_____48_CM 0. 1023.96875 FORMAT "%7.2"
 /begin AXIS_DESCR COM_AXIS VS_FIL _CNV_A_R_LINEAR_____78_CM 6 0. 511.99218 FORMAT "%7.3" AXIS_PTS_REF ldpm_vs_fil__tq_p_max /end AXIS_DESCR
/end CHARACTERISTIC
/begin CHARACTERISTIC IP_TQ_LIM_AT "Maximum allowed torque at clutch due to torque limitation depending on gear ratio by AT" CURVE 0x4c010 _REC_CUR_20_u2_u2 1023.96875 _CNV_A_R_LINEAR_____48_CM 0. 1023.96875 FORMAT "%7.2"
 /begin AXIS_DESCR COM_AXIS VS_FIL _CNV_A_R_LINEAR_____78_CM 6 0. 511.99218 FORMAT "%7.3" AXIS_PTS_REF ldpm_vs_fil__tq_p_max /end AXIS_DESCR
/end CHARACTERISTIC
/begin CHARACTERISTIC C_T_TQ_LIM "Time delay vehicle speed activation" VALUE 0x43048 _REC_VAL_20_u2 20.47 _CNV_A_R_LINEAR_____27_CM 0. 20.47 FORMAT "%5.3" /end CHARACTERISTIC
/begin CHARACTERISTIC LC_TQI_P_MAX_INH_AS "Logical constant for torque limitation ON/OFF (0=ON)" VALUE 0x42beb _REC_VAL_20_u1 1. _CNV_A_R_LINEAR_____12_CM 0. 1. FORMAT "%1.0" /end CHARACTERISTIC
/begin CHARACTERISTIC ID_TQ_P_MAX_MT "Maximum allowed torque at clutch due to torque limitation depending on gear ratio" CURVE 0x45ee6 _REC_CUR_20_u2_u1 1023.96875 _CNV_A_R_LINEAR_____48_CM 0. 1023.96875 FORMAT "%7.2"
 /begin AXIS_DESCR COM_AXIS GEAR _CNV_A_R_LINEAR_____12_CM 13 0. 12. FORMAT "%3.0" AXIS_PTS_REF ldpm_gear__tq_p_max /end AXIS_DESCR
/end CHARACTERISTIC
/begin CHARACTERISTIC ID_TQ_P_MAX_AT "Minimum allowed torque at clutch due to torque limitation depending on gear ratio" CURVE 0x45ecc _REC_CUR_20_u2_u1 1023.96875 _CNV_A_R_LINEAR_____48_CM 0. 1023.96875 FORMAT "%7.2"
 /begin AXIS_DESCR COM_AXIS GEAR _CNV_A_R_LINEAR_____12_CM 13 0. 12. FORMAT "%3.0" AXIS_PTS_REF ldpm_gear__tq_p_max /end AXIS_DESCR
/end CHARACTERISTIC
/begin AXIS_PTS ldpm_gear__tq_p_max "" 0x43bc8 GEAR _REC_AXS_20_u1 12. _CNV_A_R_LINEAR_____12_CM 13 0. 12. FORMAT "%3.0" /end AXIS_PTS
/begin AXIS_PTS ldpm_vs_fil__tq_p_max "" 0x4568c VS_FIL _REC_AXS_20_u2 511.99218 _CNV_A_R_LINEAR_____78_CM 6 0. 511.99218 FORMAT "%7.3" /end AXIS_PTS
/begin MEASUREMENT TQ_LOSS_PSTE "Torque losses power steering" SWORD _CNV_A_R_LINEAR_____48_CM 1 100. -1024. 1023.96875 ECU_ADDRESS 0x3fd152 FORMAT "%8.2" /end MEASUREMENT
/begin MEASUREMENT LV_PSTE_DISABLE "LV for disabling PSTE intervention due to EMS error" UBYTE _CNV_S_2_RANGE______28_CM 1 100. 0. 1. ECU_ADDRESS 0x3fd157 /end MEASUREMENT
/begin MEASUREMENT LV_PSTE_DISABLE_CAN "LV for disabling PSTE intervention due to CAN error" UBYTE _CNV_S_2_RANGE______28_CM 1 100. 0. 1. ECU_ADDRESS 0x3fd156 /end MEASUREMENT
/begin MEASUREMENT LV_PSTE_ENA "LV for enabling PSTE intervention" UBYTE _CNV_S_2_RANGE______28_CM 1 100. 0. 1. ECU_ADDRESS 0x3fd158 /end MEASUREMENT
/begin CHARACTERISTIC LC_PSTE_ENA "Logical constant for enabling of power steering" VALUE 0x42bbd _REC_VAL_20_u1 1. _CNV_A_R_LINEAR_____12_CM 0. 1. FORMAT "%1.0" /end CHARACTERISTIC
/begin MEASUREMENT TQ_ADD_PSTE "Engine torque reserve for power steering" SWORD _CNV_A_R_LINEAR_____48_CM 1 100. -1024. 1023.96875 ECU_ADDRESS 0x3fd154 FORMAT "%8.2" /end MEASUREMENT
/begin CHARACTERISTIC IP_TQ_LOSS_PSTE "Power steering torque loss versus engine-speed" MAP 0x4c2f4 _REC_MAP_20_u2_u2_u2 2047.96875 _CNV_A_R_LINEAR_____218_CM -1024. 1023.96875 FORMAT "%6.2"
 /begin AXIS_DESCR COM_AXIS ANG_PSTE _CNV_A_R_LINEAR_____465_CM 8 -1433.6 1433.6 FORMAT "%8.2" AXIS_PTS_REF ldp_ang_pste__tq_loss_pste /end AXIS_DESCR
 /begin AXIS_DESCR COM_AXIS VEL_ANG_PSTE _CNV_A_R_LINEAR_____466_CM 8 -1433.6 1433.6 FORMAT "%8.2" AXIS_PTS_REF ldp_vel_ang_pste__tq_loss_pste /end AXIS_DESCR
/end CHARACTERISTIC
/begin CHARACTERISTIC IP_TQ_ADD_PSTE "Power steering torque reserve depending on engine-speed" CURVE 0x4be40 _REC_CUR_20_u2_u2 1023.96875 _CNV_A_R_LINEAR_____48_CM 0. 1023.96875 FORMAT "%7.2"
 /begin AXIS_DESCR COM_AXIS ANG_PSTE _CNV_A_R_LINEAR_____465_CM 8 -1433.6 1433.6 FORMAT "%8.2" AXIS_PTS_REF ldp_ang_pste__tq_add_pste /end AXIS_DESCR
/end CHARACTERISTIC
/begin CHARACTERISTIC IP_FAC_TQ_LOSS_PSTE "Factor weighting the torque request" CURVE 0x4e77b _REC_CUR_20_u1_u2 3.984375 _CNV_A_R_LINEAR_____195_CM 0. 3.984375 FORMAT "%4.2"
 /begin AXIS_DESCR COM_AXIS N _CNV_A_R_LINEAR_____17_CM 8 0. 8160. FORMAT "%4.0" AXIS_PTS_REF ldp_n__fac_tq_add_pste /end AXIS_DESCR
/end CHARACTERISTIC
/begin AXIS_PTS ldp_ang_pste__tq_loss_pste "" 0x4417a ANG_PSTE _REC_AXS_20_u2 2867.2 _CNV_A_R_LINEAR_____465_CM 8 -1433.6 1433.6 FORMAT "%8.2" /end AXIS_PTS
/begin AXIS_PTS ldp_vel_ang_pste__tq_loss_pste "" 0x44dc0 VEL_ANG_PSTE _REC_AXS_20_u2 2867.2 _CNV_A_R_LINEAR_____466_CM 8 -1433.6 1433.6 FORMAT "%8.2" /end AXIS_PTS
/begin AXIS_PTS ldp_ang_pste__tq_add_pste "" 0x44168 ANG_PSTE _REC_AXS_20_u2 2867.2 _CNV_A_R_LINEAR_____465_CM 8 -1433.6 1433.6 FORMAT "%8.2" /end AXIS_PTS
/begin AXIS_PTS ldp_n__fac_tq_add_pste "" 0x447b6 N _REC_AXS_20_u2 8160. _CNV_A_R_LINEAR_____17_CM 8 0. 8160. FORMAT "%4.0" /end AXIS_PTS
/begin CHARACTERISTIC LC_VAR_BN "" VALUE 0x42bf4 _REC_VAL_20_u1 1. _CNV_A_R_LINEAR_____10_CM 0. 1. FORMAT "%2.0" /end CHARACTERISTIC
/begin MEASUREMENT STATE_LRN_AMP "Predicted variant for ambient pressure sensor recognition" UBYTE _CNV_S_3_STATE_LRN__472_CM 1 100. 0. 2. ECU_ADDRESS 0x3fcd1a /end MEASUREMENT
/begin CHARACTERISTIC C_T_IGK_LIH "" VALUE 0x429fc _REC_VAL_20_u1 2.55 _CNV_A_R_LINEAR_____27_CM 0. 2.55 FORMAT "%4.2" /end CHARACTERISTIC
/begin CHARACTERISTIC DOLNIV "" VALUE 0x5b7e6 _REC_VAL_20_u1 127.5 _CNV_R_R_tog_ub_q0p_500_CM 0. 127.5 FORMAT "%5.1" /end CHARACTERISTIC
/begin CHARACTERISTIC ORIVERZ "" VALUE 0x5b7e7 _REC_VAL_20_u1 255. _CNV_A_R_LINEAR_____12_CM 0. 255. FORMAT "%5.1" /end CHARACTERISTIC
/begin CHARACTERISTIC PT1NMOT "" VALUE 0x5b7e8 _REC_VAL_20_u1 100. _CNV_R_R_rel_ub_b10_501_CM 0. 100. FORMAT "%5.1" /end CHARACTERISTIC
/begin CHARACTERISTIC PT1TOEL "" VALUE 0x5b7de _REC_VAL_20_u2 99.99847 _CNV_R_R_rel_uw_b10_502_CM 0. 99.99847 FORMAT "%8.5" /end CHARACTERISTIC
/begin CHARACTERISTIC TOGANZ "" VALUE 0x5b7e0 _REC_VAL_20_u2 2999. _CNV_R_R_igen_ub_q1_483_CM 1. 3000. FORMAT "%8.3" /end CHARACTERISTIC
/begin CHARACTERISTIC TOGKURZANZ "" VALUE 0x5b7e2 _REC_VAL_20_u2 999. _CNV_A_R_LINEAR_____12_CM 1. 1000. FORMAT "%5.0" /end CHARACTERISTIC
/begin CHARACTERISTIC TOGMWK "" VALUE 0x5b7e9 _REC_VAL_20_u1 99. _CNV_A_R_LINEAR_____12_CM 1. 100. FORMAT "%5.1" /end CHARACTERISTIC
/begin CHARACTERISTIC TOGNMOT "" VALUE 0x5b7ea _REC_VAL_20_u1 10200. _CNV_A_R_nmot_ub_q4_503_CM 0. 10200. FORMAT "%5.0" /end CHARACTERISTIC
/begin CHARACTERISTIC TOGORIANZ "" VALUE 0x5b7eb _REC_VAL_20_u1 254. _CNV_R_R_igen_ub_q1_483_CM 1. 255. FORMAT "%5.1" /end CHARACTERISTIC
/begin CHARACTERISTIC TOGTMOT "" VALUE 0x5b7ec _REC_VAL_20_u1 191.3 _CNV_R_R_temp_uw_q0_504_CM -48. 143.3 FORMAT "%5.1" /end CHARACTERISTIC
/begin CHARACTERISTIC TOGTMOTORI "" VALUE 0x5b7ed _REC_VAL_20_u1 191.3 _CNV_R_R_temp_uw_q0_504_CM -48. 143.3 FORMAT "%5.1" /end CHARACTERISTIC
/begin CHARACTERISTIC TOGVERBKZ "" VALUE 0x5b7ee _REC_VAL_20_u1 127.5 _CNV_R_R_tog_ub_q0p_500_CM 0. 127.5 FORMAT "%5.1" /end CHARACTERISTIC
/begin CHARACTERISTIC TOGVERBNOR "" VALUE 0x5b7ef _REC_VAL_20_u1 127.5 _CNV_R_R_tog_ub_q0p_500_CM 0. 127.5 FORMAT "%5.1" /end CHARACTERISTIC
/begin CHARACTERISTIC TOGVERLKZ "" VALUE 0x5b7f0 _REC_VAL_20_u1 127.5 _CNV_R_R_tog_ub_q0p_500_CM 0. 127.5 FORMAT "%5.1" /end CHARACTERISTIC
/begin CHARACTERISTIC TOGVERLNOR "" VALUE 0x5b7f1 _REC_VAL_20_u1 127.5 _CNV_R_R_tog_ub_q0p_500_CM 0. 127.5 FORMAT "%5.1" /end CHARACTERISTIC
/begin CHARACTERISTIC TOGVERLORI "" VALUE 0x5b7f2 _REC_VAL_20_u1 127.5 _CNV_R_R_tog_ub_q0p_500_CM 0. 127.5 FORMAT "%5.1" /end CHARACTERISTIC
/begin CHARACTERISTIC TRTYP "" VALUE 0x5b7e4 _REC_VAL_20_u2 6553.5 _CNV_R_R_t_q0p1ms_505_CM 0. 6553.5 FORMAT "%8.3" /end CHARACTERISTIC
/begin CHARACTERISTIC KLTOGNKOR "" CURVE 0x5b7bc _REC_CUR_52_UBYTE_s1_u1 127.5 _CNV_R_R_tog_ub_q0p_500_CM -64. 63.5 FORMAT "%5.2"
 /begin AXIS_DESCR STD_AXIS nmotfm _CNV_A_R_nmot_ub_q4_503_CM 16 0. 10200. FORMAT "%6.1" /end AXIS_DESCR
/end CHARACTERISTIC
/begin CHARACTERISTIC KLTKTOENIV "" CURVE 0x5b780 _REC_CUR_52_UWORD_u2_u2 65.535 _CNV_A_R_LINEAR_____387_CM 0. 65.535
 /begin AXIS_DESCR STD_AXIS Tog_tk _CNV_A_R_LINEAR_____506_CM 7 0. 6553.5 FORMAT "%6.1" /end AXIS_DESCR
/end CHARACTERISTIC
/begin CHARACTERISTIC KLTVTOEL "" CURVE 0x5b79e _REC_CUR_52_u2_u2 208. _CNV_A_R_LINEAR_____507_CM -48. 160. FORMAT "%5.1"
 /begin AXIS_DESCR STD_AXIS Toel_t _CNV_A_R_LINEAR_____506_CM 7 0.1 6553.5 FORMAT "%7.2" /end AXIS_DESCR
/end CHARACTERISTIC
/begin CHARACTERISTIC IP_EFF_LAMB__LAMB_DIF "Lambda Efficiency" CURVE 0x46660 _REC_CUR_20_u2_u2 1.99996948 _CNV_A_R_LINEAR_____45_CM 0. 1.99996948 FORMAT "%7.5"
 /begin AXIS_DESCR COM_AXIS ONLINE_DUMMY _CNV_A_R_LINEAR_____273_CM 16 -32. 31.99902344 FORMAT "%8.4" AXIS_PTS_REF ldp_lamb_dif__eff_lamb /end AXIS_DESCR
/end CHARACTERISTIC
/begin CHARACTERISTIC IP_TQI_REF__N__MAF "Indicated engine torque at reference conditions" MAP 0x4c644 _REC_MAP_20_u2_u1_u2 1023.96875 _CNV_A_R_LINEAR_____48_CM 0. 1023.96875 FORMAT "%7.2"
 /begin AXIS_DESCR COM_AXIS N_32 _CNV_A_R_LINEAR_____5_CM 16 0. 8160. FORMAT "%4.0" AXIS_PTS_REF ldpm_n_32_100 /end AXIS_DESCR
 /begin AXIS_DESCR COM_AXIS MAF _CNV_A_R_LINEAR_____95_CM 12 0. 1389. FORMAT "%7.2" AXIS_PTS_REF ldpm_maf_100 /end AXIS_DESCR
/end CHARACTERISTIC
/begin CHARACTERISTIC C_TPS_SLOP "" VALUE 0x430c0 _REC_VAL_20_u2 48. _CNV_A_R_LINEAR_____577_CM 0. 48. FORMAT "%7.4" /end CHARACTERISTIC
/begin CHARACTERISTIC C_TPS_MAX "Maximum mechanical opening angle of the throttle valve in degree" VALUE 0x430ba _REC_VAL_20_u2 119.5 _CNV_A_R_LINEAR_____226_CM 0. 119.5 /end CHARACTERISTIC
/begin CHARACTERISTIC LC_RNG_L_MAN_AS "logical constant for to activate IP_FAC_TQ_REQ_DRIV_RNG_L (low range mode) in case if LV_RNG_L = 0 (default value = 0)" VALUE 0x42bc0 _REC_VAL_20_u1 1. _CNV_A_R_LINEAR_____10_CM 0. 1. FORMAT "%2.0" /end CHARACTERISTIC
/begin CHARACTERISTIC C_N_SP_IS_THD_CAN "engine speed setpoint threshold for reconition of ST_SW_LEV_RPM condition" VALUE 0x42ec4 _REC_VAL_20_u2 8159. _CNV_A_R_LINEAR_____17_CM 1. 8160. FORMAT "%4.0" /end CHARACTERISTIC
/begin CHARACTERISTIC IP_MAF_SP "Setpoint mass air flow depending on slow torque setpoint" MAP 0x49196 _REC_MAP_20_u2_u1_u2 1389. _CNV_A_R_LINEAR_____95_CM 0. 1389. FORMAT "%7.2"
 /begin AXIS_DESCR COM_AXIS N_32 _CNV_A_R_LINEAR_____5_CM 16 0. 8160. FORMAT "%4.0" AXIS_PTS_REF ldpm_n_32_100 /end AXIS_DESCR
 /begin AXIS_DESCR COM_AXIS TQI_SP_MAF _CNV_A_R_LINEAR_____48_CM 12 0. 1023.96875 FORMAT "%7.2" AXIS_PTS_REF ldp_tqi_sp_maf__maf_sp /end AXIS_DESCR
/end CHARACTERISTIC
/begin AXIS_PTS ldp_lamb_dif__eff_lamb "" 0x44444 LAMB_DIF _REC_AXS_20_u2 63.99902344 _CNV_A_R_LINEAR_____273_CM 16 -32. 31.99902344 FORMAT "%8.4" /end AXIS_PTS
/begin AXIS_PTS ldpm_n_32__tqi_min_pu "" 0x43e0a N_32 _REC_AXS_20_u1 8160. _CNV_A_R_LINEAR_____5_CM 12 0. 8160. FORMAT "%4.0" /end AXIS_PTS
/begin AXIS_PTS ldpm_tco__tqi_min_pu "" 0x43fdb TCO _REC_AXS_20_u1 190.5 _CNV_A_R_LINEAR_____0_CM 4 -48. 142.5 FORMAT "%5.1" /end AXIS_PTS
/begin AXIS_PTS ldpm_n_32_s "" 0x43e91 N_32 _REC_AXS_20_u1 8160. _CNV_A_R_LINEAR_____5_CM 16 0. 8160. FORMAT "%4.0" /end AXIS_PTS
/begin AXIS_PTS ldp_tqi_sp_maf__maf_sp "" 0x44ce8 TQI_SP_MAF _REC_AXS_20_u2 1023.96875 _CNV_A_R_LINEAR_____48_CM 12 0. 1023.96875 FORMAT "%7.2" /end AXIS_PTS
/begin AXIS_PTS ldpm_maf_100 "" 0x44fec MAF _REC_AXS_20_u2 1389. _CNV_A_R_LINEAR_____95_CM 12 0. 1389. FORMAT "%7.2" /end AXIS_PTS
/begin AXIS_PTS ldpm_n_32_100 "" 0x43cd3 N_32 _REC_AXS_20_u1 8160. _CNV_A_R_LINEAR_____5_CM 16 0. 8160. FORMAT "%4.0" /end AXIS_PTS
/begin CHARACTERISTIC IP_T_INC_TRA_3_MT "Time constant for torque increase 3 for manual transmission" MAP 0x50452 _REC_MAP_20_u1_u1_u1 2.55 _CNV_A_R_LINEAR_____27_CM 0. 2.55 FORMAT "%4.2"
 /begin AXIS_DESCR COM_AXIS N_32 _CNV_A_R_LINEAR_____5_CM 8 0. 8160. FORMAT "%4.0" AXIS_PTS_REF ldpm_n_110 /end AXIS_DESCR
 /begin AXIS_DESCR COM_AXIS GR_MT _CNV_A_R_LINEAR_____10_CM 8 0. 255. FORMAT "%3.0" AXIS_PTS_REF ldpm_gr_tra_mt_2 /end AXIS_DESCR
/end CHARACTERISTIC
/begin CHARACTERISTIC IP_T_DEC_TRA_RNG_L_3_AT "Time constant for torque decrease 3 for automatic transmission" MAP 0x5020a _REC_MAP_20_u1_u1_u1 2.55 _CNV_A_R_LINEAR_____27_CM 0. 2.55 FORMAT "%3.2"
 /begin AXIS_DESCR COM_AXIS N_32 _CNV_A_R_LINEAR_____5_CM 8 0. 8160. FORMAT "%4.0" AXIS_PTS_REF ldpm_n_110 /end AXIS_DESCR
 /begin AXIS_DESCR COM_AXIS GR_AT _CNV_A_R_LINEAR_____10_CM 7 0. 255. FORMAT "%3.0" AXIS_PTS_REF ldpm_gr_tra_at_2 /end AXIS_DESCR
/end CHARACTERISTIC
/begin CHARACTERISTIC IP_T_INC_TRA_RNG_L_3_MT "Time constant for torque increase 3 for manual transmission" MAP 0x50632 _REC_MAP_20_u1_u1_u1 2.55 _CNV_A_R_LINEAR_____27_CM 0. 2.55 FORMAT "%3.2"
 /begin AXIS_DESCR COM_AXIS N_32 _CNV_A_R_LINEAR_____5_CM 8 0. 8160. FORMAT "%4.0" AXIS_PTS_REF ldpm_n_110 /end AXIS_DESCR
 /begin AXIS_DESCR COM_AXIS GR_MT _CNV_A_R_LINEAR_____10_CM 8 0. 255. FORMAT "%3.0" AXIS_PTS_REF ldpm_gr_tra_mt_2 /end AXIS_DESCR
/end CHARACTERISTIC
/begin CHARACTERISTIC IP_T_DEC_TRA_2_MT "Time constant for torque decrease 2 for manual transmission" MAP 0x4ffea _REC_MAP_20_u1_u1_u1 2.55 _CNV_A_R_LINEAR_____27_CM 0. 2.55 FORMAT "%4.2"
 /begin AXIS_DESCR COM_AXIS N_32 _CNV_A_R_LINEAR_____5_CM 8 0. 8160. FORMAT "%4.0" AXIS_PTS_REF ldpm_n_110 /end AXIS_DESCR
 /begin AXIS_DESCR COM_AXIS GR_MT _CNV_A_R_LINEAR_____10_CM 8 0. 255. FORMAT "%3.0" AXIS_PTS_REF ldpm_gr_tra_mt_2 /end AXIS_DESCR
/end CHARACTERISTIC
/begin CHARACTERISTIC IP_T_INC_TRA_IS_MT "Time constant for torque increase at idle for manual transmission" MAP 0x504ca _REC_MAP_20_u1_u1_u1 2.55 _CNV_A_R_LINEAR_____27_CM 0. 2.55 FORMAT "%4.2"
 /begin AXIS_DESCR COM_AXIS N_32 _CNV_A_R_LINEAR_____5_CM 8 0. 8160. FORMAT "%4.0" AXIS_PTS_REF ldpm_n_110 /end AXIS_DESCR
 /begin AXIS_DESCR COM_AXIS GR_MT _CNV_A_R_LINEAR_____10_CM 8 0. 255. FORMAT "%3.0" AXIS_PTS_REF ldpm_gr_tra_mt_2 /end AXIS_DESCR
/end CHARACTERISTIC
/begin CHARACTERISTIC IP_T_DEC_TRA_3_MT "Time constant for torque decrease 3 for manual transmission" MAP 0x50062 _REC_MAP_20_u1_u1_u1 2.55 _CNV_A_R_LINEAR_____27_CM 0. 2.55 FORMAT "%4.2"
 /begin AXIS_DESCR COM_AXIS N_32 _CNV_A_R_LINEAR_____5_CM 8 0. 8160. FORMAT "%4.0" AXIS_PTS_REF ldpm_n_110 /end AXIS_DESCR
 /begin AXIS_DESCR COM_AXIS GR_MT _CNV_A_R_LINEAR_____10_CM 8 0. 255. FORMAT "%3.0" AXIS_PTS_REF ldpm_gr_tra_mt_2 /end AXIS_DESCR
/end CHARACTERISTIC
/begin CHARACTERISTIC IP_T_DEC_TRA_RNG_L_3_MT "Time constant for torque decrease 3 for manual transmission" MAP 0x50242 _REC_MAP_20_u1_u1_u1 2.55 _CNV_A_R_LINEAR_____27_CM 0. 2.55 FORMAT "%3.2"
 /begin AXIS_DESCR COM_AXIS N_32 _CNV_A_R_LINEAR_____5_CM 8 0. 8160. FORMAT "%4.0" AXIS_PTS_REF ldpm_n_110 /end AXIS_DESCR
 /begin AXIS_DESCR COM_AXIS GR_MT _CNV_A_R_LINEAR_____10_CM 8 0. 255. FORMAT "%3.0" AXIS_PTS_REF ldpm_gr_tra_mt_2 /end AXIS_DESCR
/end CHARACTERISTIC
/begin CHARACTERISTIC IP_T_INC_TRA_RNG_L_IS_AT "Time constant for torque increase at idle for automatic transmission" MAP 0x50672 _REC_MAP_20_u1_u1_u1 2.55 _CNV_A_R_LINEAR_____27_CM 0. 2.55 FORMAT "%3.2"
 /begin AXIS_DESCR COM_AXIS N_32 _CNV_A_R_LINEAR_____5_CM 8 0. 8160. FORMAT "%4.0" AXIS_PTS_REF ldpm_n_110 /end AXIS_DESCR
 /begin AXIS_DESCR COM_AXIS GR_AT _CNV_A_R_LINEAR_____10_CM 7 0. 255. FORMAT "%3.0" AXIS_PTS_REF ldpm_gr_tra_at_2 /end AXIS_DESCR
/end CHARACTERISTIC
/begin CHARACTERISTIC IP_T_DEC_TRA_IS_MT "Time constant for torque decrease at idle for manual transmission" MAP 0x500da _REC_MAP_20_u1_u1_u1 2.55 _CNV_A_R_LINEAR_____27_CM 0. 2.55 FORMAT "%4.2"
 /begin AXIS_DESCR COM_AXIS N_32 _CNV_A_R_LINEAR_____5_CM 8 0. 8160. FORMAT "%4.0" AXIS_PTS_REF ldpm_n_110 /end AXIS_DESCR
 /begin AXIS_DESCR COM_AXIS GR_MT _CNV_A_R_LINEAR_____10_CM 8 0. 255. FORMAT "%3.0" AXIS_PTS_REF ldpm_gr_tra_mt_2 /end AXIS_DESCR
/end CHARACTERISTIC
/begin CHARACTERISTIC IP_T_DEC_TRA_RNG_L_IS_AT "Time constant for torque decrease at idle for automatic transmission" MAP 0x50282 _REC_MAP_20_u1_u1_u1 2.55 _CNV_A_R_LINEAR_____27_CM 0. 2.55 FORMAT "%3.2"
 /begin AXIS_DESCR COM_AXIS N_32 _CNV_A_R_LINEAR_____5_CM 8 0. 8160. FORMAT "%4.0" AXIS_PTS_REF ldpm_n_110 /end AXIS_DESCR
 /begin AXIS_DESCR COM_AXIS GR_AT _CNV_A_R_LINEAR_____10_CM 7 0. 255. FORMAT "%3.0" AXIS_PTS_REF ldpm_gr_tra_at_2 /end AXIS_DESCR
/end CHARACTERISTIC
/begin CHARACTERISTIC IP_T_INC_TRA_1_AT "Time constant for torque increase 1 for automatic transmission" MAP 0x5032a _REC_MAP_20_u1_u1_u1 2.55 _CNV_A_R_LINEAR_____27_CM 0. 2.55 FORMAT "%4.2"
 /begin AXIS_DESCR COM_AXIS N_32 _CNV_A_R_LINEAR_____5_CM 8 0. 8160. FORMAT "%4.0" AXIS_PTS_REF ldpm_n_110 /end AXIS_DESCR
 /begin AXIS_DESCR COM_AXIS GR_AT _CNV_A_R_LINEAR_____10_CM 7 0. 255. FORMAT "%3.0" AXIS_PTS_REF ldpm_gr_tra_at_2 /end AXIS_DESCR
/end CHARACTERISTIC
/begin CHARACTERISTIC IP_T_INC_TRA_RNG_L_IS_MT "Time constant for torque increase at idle for manual transmission" MAP 0x506aa _REC_MAP_20_u1_u1_u1 2.55 _CNV_A_R_LINEAR_____27_CM 0. 2.55 FORMAT "%3.2"
 /begin AXIS_DESCR COM_AXIS N_32 _CNV_A_R_LINEAR_____5_CM 8 0. 8160. FORMAT "%4.0" AXIS_PTS_REF ldpm_n_110 /end AXIS_DESCR
 /begin AXIS_DESCR COM_AXIS GR_MT _CNV_A_R_LINEAR_____10_CM 8 0. 255. FORMAT "%3.0" AXIS_PTS_REF ldpm_gr_tra_mt_2 /end AXIS_DESCR
/end CHARACTERISTIC
/begin CHARACTERISTIC IP_T_INC_TRA_2_AT "Time constant for torque increase 2 for automatic transmission" MAP 0x503a2 _REC_MAP_20_u1_u1_u1 2.55 _CNV_A_R_LINEAR_____27_CM 0. 2.55 FORMAT "%4.2"
 /begin AXIS_DESCR COM_AXIS N_32 _CNV_A_R_LINEAR_____5_CM 8 0. 8160. FORMAT "%4.0" AXIS_PTS_REF ldpm_n_110 /end AXIS_DESCR
 /begin AXIS_DESCR COM_AXIS GR_AT _CNV_A_R_LINEAR_____10_CM 7 0. 255. FORMAT "%3.0" AXIS_PTS_REF ldpm_gr_tra_at_2 /end AXIS_DESCR
/end CHARACTERISTIC
/begin CHARACTERISTIC IP_T_DEC_TRA_RNG_L_IS_MT "Time constant for torque decrease at idle for manual transmission" MAP 0x502ba _REC_MAP_20_u1_u1_u1 2.55 _CNV_A_R_LINEAR_____27_CM 0. 2.55 FORMAT "%3.2"
 /begin AXIS_DESCR COM_AXIS N_32 _CNV_A_R_LINEAR_____5_CM 8 0. 8160. FORMAT "%4.0" AXIS_PTS_REF ldpm_n_110 /end AXIS_DESCR
 /begin AXIS_DESCR COM_AXIS GR_MT _CNV_A_R_LINEAR_____10_CM 8 0. 255. FORMAT "%3.0" AXIS_PTS_REF ldpm_gr_tra_mt_2 /end AXIS_DESCR
/end CHARACTERISTIC
/begin CHARACTERISTIC IP_T_INC_TRA_3_AT "Time constant for torque increase 3 for automatic transmission" MAP 0x5041a _REC_MAP_20_u1_u1_u1 2.55 _CNV_A_R_LINEAR_____27_CM 0. 2.55 FORMAT "%4.2"
 /begin AXIS_DESCR COM_AXIS N_32 _CNV_A_R_LINEAR_____5_CM 8 0. 8160. FORMAT "%4.0" AXIS_PTS_REF ldpm_n_110 /end AXIS_DESCR
 /begin AXIS_DESCR COM_AXIS GR_AT _CNV_A_R_LINEAR_____10_CM 7 0. 255. FORMAT "%3.0" AXIS_PTS_REF ldpm_gr_tra_at_2 /end AXIS_DESCR
/end CHARACTERISTIC
/begin CHARACTERISTIC IP_T_DEC_TRA_1_AT "Time constant for torquedecrease 1 for automatic transmission" MAP 0x4ff3a _REC_MAP_20_u1_u1_u1 2.55 _CNV_A_R_LINEAR_____27_CM 0. 2.55 FORMAT "%4.2"
 /begin AXIS_DESCR COM_AXIS N_32 _CNV_A_R_LINEAR_____5_CM 8 0. 8160. FORMAT "%4.0" AXIS_PTS_REF ldpm_n_110 /end AXIS_DESCR
 /begin AXIS_DESCR COM_AXIS GR_AT _CNV_A_R_LINEAR_____10_CM 7 0. 255. FORMAT "%3.0" AXIS_PTS_REF ldpm_gr_tra_at_2 /end AXIS_DESCR
/end CHARACTERISTIC
/begin CHARACTERISTIC IP_T_DEC_TRA_2_AT "Time constant for torquedecrease 2 for automatic transmission" MAP 0x4ffb2 _REC_MAP_20_u1_u1_u1 2.55 _CNV_A_R_LINEAR_____27_CM 0. 2.55 FORMAT "%4.2"
 /begin AXIS_DESCR COM_AXIS N_32 _CNV_A_R_LINEAR_____5_CM 8 0. 8160. FORMAT "%4.0" AXIS_PTS_REF ldpm_n_110 /end AXIS_DESCR
 /begin AXIS_DESCR COM_AXIS GR_AT _CNV_A_R_LINEAR_____10_CM 7 0. 255. FORMAT "%3.0" AXIS_PTS_REF ldpm_gr_tra_at_2 /end AXIS_DESCR
/end CHARACTERISTIC
/begin CHARACTERISTIC IP_T_INC_TRA_RNG_L_1_AT "Time constant for torque increase 1 for automatic transmission" MAP 0x5050a _REC_MAP_20_u1_u1_u1 2.55 _CNV_A_R_LINEAR_____27_CM 0. 2.55 FORMAT "%3.2"
 /begin AXIS_DESCR COM_AXIS N_32 _CNV_A_R_LINEAR_____5_CM 8 0. 8160. FORMAT "%4.0" AXIS_PTS_REF ldpm_n_110 /end AXIS_DESCR
 /begin AXIS_DESCR COM_AXIS GR_AT _CNV_A_R_LINEAR_____10_CM 7 0. 255. FORMAT "%3.0" AXIS_PTS_REF ldpm_gr_tra_at_2 /end AXIS_DESCR
/end CHARACTERISTIC
/begin CHARACTERISTIC IP_T_DEC_TRA_3_AT "Time constant for torquedecrease 3 for automatic transmission" MAP 0x5002a _REC_MAP_20_u1_u1_u1 2.55 _CNV_A_R_LINEAR_____27_CM 0. 2.55 FORMAT "%4.2"
 /begin AXIS_DESCR COM_AXIS N_32 _CNV_A_R_LINEAR_____5_CM 8 0. 8160. FORMAT "%4.0" AXIS_PTS_REF ldpm_n_110 /end AXIS_DESCR
 /begin AXIS_DESCR COM_AXIS GR_AT _CNV_A_R_LINEAR_____10_CM 7 0. 255. FORMAT "%3.0" AXIS_PTS_REF ldpm_gr_tra_at_2 /end AXIS_DESCR
/end CHARACTERISTIC
/begin CHARACTERISTIC IP_T_DEC_TRA_RNG_L_1_AT "Time constant for torque decrease 1 for automatic transmission" MAP 0x5011a _REC_MAP_20_u1_u1_u1 2.55 _CNV_A_R_LINEAR_____27_CM 0. 2.55 FORMAT "%3.2"
 /begin AXIS_DESCR COM_AXIS N_32 _CNV_A_R_LINEAR_____5_CM 8 0. 8160. FORMAT "%4.0" AXIS_PTS_REF ldpm_n_110 /end AXIS_DESCR
 /begin AXIS_DESCR COM_AXIS GR_AT _CNV_A_R_LINEAR_____10_CM 7 0. 255. FORMAT "%3.0" AXIS_PTS_REF ldpm_gr_tra_at_2 /end AXIS_DESCR
/end CHARACTERISTIC
/begin CHARACTERISTIC IP_T_DEC_TRA_IS_AT "Time constant for torque decrease at idle for automatic transmission" MAP 0x500a2 _REC_MAP_20_u1_u1_u1 2.55 _CNV_A_R_LINEAR_____27_CM 0. 2.55 FORMAT "%4.2"
 /begin AXIS_DESCR COM_AXIS N_32 _CNV_A_R_LINEAR_____5_CM 8 0. 8160. FORMAT "%4.0" AXIS_PTS_REF ldpm_n_110 /end AXIS_DESCR
 /begin AXIS_DESCR COM_AXIS GR_AT _CNV_A_R_LINEAR_____10_CM 7 0. 255. FORMAT "%3.0" AXIS_PTS_REF ldpm_gr_tra_at_2 /end AXIS_DESCR
/end CHARACTERISTIC
/begin CHARACTERISTIC IP_T_INC_TRA_RNG_L_1_MT "Time constant for torque increase 1 for manual transmission" MAP 0x50542 _REC_MAP_20_u1_u1_u1 2.55 _CNV_A_R_LINEAR_____27_CM 0. 2.55 FORMAT "%3.2"
 /begin AXIS_DESCR COM_AXIS N_32 _CNV_A_R_LINEAR_____5_CM 8 0. 8160. FORMAT "%4.0" AXIS_PTS_REF ldpm_n_110 /end AXIS_DESCR
 /begin AXIS_DESCR COM_AXIS GR_MT _CNV_A_R_LINEAR_____10_CM 8 0. 255. FORMAT "%3.0" AXIS_PTS_REF ldpm_gr_tra_mt_2 /end AXIS_DESCR
/end CHARACTERISTIC
/begin CHARACTERISTIC IP_T_INC_TRA_IS_AT "Time constant for torque increase at idle for automatic transmission" MAP 0x50492 _REC_MAP_20_u1_u1_u1 2.55 _CNV_A_R_LINEAR_____27_CM 0. 2.55 FORMAT "%4.2"
 /begin AXIS_DESCR COM_AXIS N_32 _CNV_A_R_LINEAR_____5_CM 8 0. 8160. FORMAT "%4.0" AXIS_PTS_REF ldpm_n_110 /end AXIS_DESCR
 /begin AXIS_DESCR COM_AXIS GR_AT _CNV_A_R_LINEAR_____10_CM 7 0. 255. FORMAT "%3.0" AXIS_PTS_REF ldpm_gr_tra_at_2 /end AXIS_DESCR
/end CHARACTERISTIC
/begin CHARACTERISTIC IP_T_DEC_TRA_RNG_L_1_MT "Time constant for torque decrease 1 for manual transmission" MAP 0x50152 _REC_MAP_20_u1_u1_u1 2.55 _CNV_A_R_LINEAR_____27_CM 0. 2.55 FORMAT "%3.2"
 /begin AXIS_DESCR COM_AXIS N_32 _CNV_A_R_LINEAR_____5_CM 8 0. 8160. FORMAT "%4.0" AXIS_PTS_REF ldpm_n_110 /end AXIS_DESCR
 /begin AXIS_DESCR COM_AXIS GR_MT _CNV_A_R_LINEAR_____10_CM 8 0. 255. FORMAT "%3.0" AXIS_PTS_REF ldpm_gr_tra_mt_2 /end AXIS_DESCR
/end CHARACTERISTIC
/begin CHARACTERISTIC IP_T_INC_TRA_RNG_L_2_AT "Time constant for torque increase 2 for automatic transmission" MAP 0x50582 _REC_MAP_20_u1_u1_u1 2.55 _CNV_A_R_LINEAR_____27_CM 0. 2.55 FORMAT "%3.2"
 /begin AXIS_DESCR COM_AXIS N_32 _CNV_A_R_LINEAR_____5_CM 8 0. 8160. FORMAT "%4.0" AXIS_PTS_REF ldpm_n_110 /end AXIS_DESCR
 /begin AXIS_DESCR COM_AXIS GR_AT _CNV_A_R_LINEAR_____10_CM 7 0. 255. FORMAT "%3.0" AXIS_PTS_REF ldpm_gr_tra_at_2 /end AXIS_DESCR
/end CHARACTERISTIC
/begin CHARACTERISTIC IP_T_DEC_TRA_RNG_L_2_AT "Time constant for torque decrease 2 for automatic transmission" MAP 0x50192 _REC_MAP_20_u1_u1_u1 2.55 _CNV_A_R_LINEAR_____27_CM 0. 2.55 FORMAT "%3.2"
 /begin AXIS_DESCR COM_AXIS N_32 _CNV_A_R_LINEAR_____5_CM 8 0. 8160. FORMAT "%4.0" AXIS_PTS_REF ldpm_n_110 /end AXIS_DESCR
 /begin AXIS_DESCR COM_AXIS GR_AT _CNV_A_R_LINEAR_____10_CM 7 0. 255. FORMAT "%3.0" AXIS_PTS_REF ldpm_gr_tra_at_2 /end AXIS_DESCR
/end CHARACTERISTIC
/begin CHARACTERISTIC IP_T_INC_TRA_RNG_L_2_MT "Time constant for torque increase 2 for manual transmission" MAP 0x505ba _REC_MAP_20_u1_u1_u1 2.55 _CNV_A_R_LINEAR_____27_CM 0. 2.55 FORMAT "%3.2"
 /begin AXIS_DESCR COM_AXIS N_32 _CNV_A_R_LINEAR_____5_CM 8 0. 8160. FORMAT "%4.0" AXIS_PTS_REF ldpm_n_110 /end AXIS_DESCR
 /begin AXIS_DESCR COM_AXIS GR_MT _CNV_A_R_LINEAR_____10_CM 8 0. 255. FORMAT "%3.0" AXIS_PTS_REF ldpm_gr_tra_mt_2 /end AXIS_DESCR
/end CHARACTERISTIC
/begin CHARACTERISTIC IP_T_INC_TRA_1_MT "Time constant for torque increase 1 for manual transmission" MAP 0x50362 _REC_MAP_20_u1_u1_u1 2.55 _CNV_A_R_LINEAR_____27_CM 0. 2.55 FORMAT "%4.2"
 /begin AXIS_DESCR COM_AXIS N_32 _CNV_A_R_LINEAR_____5_CM 8 0. 8160. FORMAT "%4.0" AXIS_PTS_REF ldpm_n_110 /end AXIS_DESCR
 /begin AXIS_DESCR COM_AXIS GR_MT _CNV_A_R_LINEAR_____10_CM 8 0. 255. FORMAT "%3.0" AXIS_PTS_REF ldpm_gr_tra_mt_2 /end AXIS_DESCR
/end CHARACTERISTIC
/begin CHARACTERISTIC IP_T_DEC_TRA_RNG_L_2_MT "Time constant for torque decrease 2 for manual transmission" MAP 0x501ca _REC_MAP_20_u1_u1_u1 2.55 _CNV_A_R_LINEAR_____27_CM 0. 2.55 FORMAT "%3.2"
 /begin AXIS_DESCR COM_AXIS N_32 _CNV_A_R_LINEAR_____5_CM 8 0. 8160. FORMAT "%4.0" AXIS_PTS_REF ldpm_n_110 /end AXIS_DESCR
 /begin AXIS_DESCR COM_AXIS GR_MT _CNV_A_R_LINEAR_____10_CM 8 0. 255. FORMAT "%3.0" AXIS_PTS_REF ldpm_gr_tra_mt_2 /end AXIS_DESCR
/end CHARACTERISTIC
/begin CHARACTERISTIC IP_T_INC_TRA_2_MT "Time constant for torque increase 2 for manual transmission" MAP 0x503da _REC_MAP_20_u1_u1_u1 2.55 _CNV_A_R_LINEAR_____27_CM 0. 2.55 FORMAT "%4.2"
 /begin AXIS_DESCR COM_AXIS N_32 _CNV_A_R_LINEAR_____5_CM 8 0. 8160. FORMAT "%4.0" AXIS_PTS_REF ldpm_n_110 /end AXIS_DESCR
 /begin AXIS_DESCR COM_AXIS GR_MT _CNV_A_R_LINEAR_____10_CM 8 0. 255. FORMAT "%3.0" AXIS_PTS_REF ldpm_gr_tra_mt_2 /end AXIS_DESCR
/end CHARACTERISTIC
/begin CHARACTERISTIC IP_T_INC_TRA_RNG_L_3_AT "Time constant for torque increase 3 for automatic transmission" MAP 0x505fa _REC_MAP_20_u1_u1_u1 2.55 _CNV_A_R_LINEAR_____27_CM 0. 2.55 FORMAT "%3.2"
 /begin AXIS_DESCR COM_AXIS N_32 _CNV_A_R_LINEAR_____5_CM 8 0. 8160. FORMAT "%4.0" AXIS_PTS_REF ldpm_n_110 /end AXIS_DESCR
 /begin AXIS_DESCR COM_AXIS GR_AT _CNV_A_R_LINEAR_____10_CM 7 0. 255. FORMAT "%3.0" AXIS_PTS_REF ldpm_gr_tra_at_2 /end AXIS_DESCR
/end CHARACTERISTIC
/begin CHARACTERISTIC IP_T_DEC_TRA_1_MT "Time constant for torque decrease 1 for manual transmission" MAP 0x4ff72 _REC_MAP_20_u1_u1_u1 2.55 _CNV_A_R_LINEAR_____27_CM 0. 2.55 FORMAT "%4.2"
 /begin AXIS_DESCR COM_AXIS N_32 _CNV_A_R_LINEAR_____5_CM 8 0. 8160. FORMAT "%4.0" AXIS_PTS_REF ldpm_n_110 /end AXIS_DESCR
 /begin AXIS_DESCR COM_AXIS GR_MT _CNV_A_R_LINEAR_____10_CM 8 0. 255. FORMAT "%3.0" AXIS_PTS_REF ldpm_gr_tra_mt_2 /end AXIS_DESCR
/end CHARACTERISTIC
/begin CHARACTERISTIC IP_T_RAMP_CONV_NEG__TOIL "Ramp after shift disengaging" CURVE 0x506fe _REC_CUR_20_u1_u1 2550. _CNV_A_R_LINEAR_____23_CM 0. 2550. FORMAT "%4.0"
 /begin AXIS_DESCR COM_AXIS TOIL _CNV_A_R_LINEAR_____3_CM 8 -40. 160. FORMAT "%3.0" AXIS_PTS_REF ldp_toil_t_ramp_conv_neg /end AXIS_DESCR
/end CHARACTERISTIC
/begin CHARACTERISTIC IP_T_RAMP_CONV_POS__TOIL "Ramp after shift engaging" CURVE 0x50706 _REC_CUR_20_u1_u1 2550. _CNV_A_R_LINEAR_____23_CM 0. 2550. FORMAT "%4.0"
 /begin AXIS_DESCR COM_AXIS TOIL _CNV_A_R_LINEAR_____3_CM 8 -40. 160. FORMAT "%3.0" AXIS_PTS_REF ldp_toil_t_ramp_conv_pos /end AXIS_DESCR
/end CHARACTERISTIC
/begin CHARACTERISTIC LC_INH_FCUT_AMT "inhibition flag for fuel cut-off due to AMT intervention" VALUE 0x42b8c _REC_VAL_20_u1 1. _CNV_A_R_LINEAR_____10_CM 0. 1. FORMAT "%2.0" /end CHARACTERISTIC
/begin CHARACTERISTIC LC_INH_FCUT_DCC "inhibition flag for fuel cut-off due to DCC intervention" VALUE 0x42b8e _REC_VAL_20_u1 1. _CNV_A_R_LINEAR_____10_CM 0. 1. FORMAT "%2.0" /end CHARACTERISTIC
/begin CHARACTERISTIC LC_ENA_FCUT_TOT_AMT "logical variable for setting scaling factor due AMT" VALUE 0x42b76 _REC_VAL_20_u1 1. _CNV_A_R_LINEAR_____10_CM 0. 1. FORMAT "%2.0" /end CHARACTERISTIC
/begin CHARACTERISTIC LC_ENA_FCUT_TOT_DCC "logical variable for setting scaling factor due DCC" VALUE 0x42b78 _REC_VAL_20_u1 1. _CNV_A_R_LINEAR_____10_CM 0. 1. FORMAT "%2.0" /end CHARACTERISTIC
/begin MEASUREMENT B_OELVERB "" UBYTE _CNV_S_2_B_TRUE_519_CM 1 100. 0. 1. ECU_ADDRESS 0x3fb1dd /end MEASUREMENT
/begin MEASUREMENT NMOTF "" UBYTE _CNV_A_R_nmot_ub_q4_503_CM 1 100. 0. 10200. ECU_ADDRESS 0x3fb1e4 FORMAT "%5.0" /end MEASUREMENT
/begin MEASUREMENT NMOTFM "" UBYTE _CNV_A_R_nmot_ub_q4_503_CM 1 100. 0. 10200. ECU_ADDRESS 0x3fb1e5 FORMAT "%6.1" /end MEASUREMENT
/begin MEASUREMENT NMOTFSUM "" UWORD _CNV_A_R_nmot_ub_q4_503_CM 1 100. 0. 2621400. ECU_ADDRESS 0x3fb1e0 FORMAT "%8.0" /end MEASUREMENT
/begin MEASUREMENT OELNIVAK "" UBYTE _CNV_R_R_tog_ub_q0p_500_CM 1 100. 0. 127.5 ECU_ADDRESS 0x3fa48c FORMAT "%5.1" /end MEASUREMENT
/begin MEASUREMENT OELNIVAKNK "" UBYTE _CNV_R_R_tog_ub_q0p_500_CM 1 100. 0. 127.5 ECU_ADDRESS 0x3fb1e6 FORMAT "%5.1" /end MEASUREMENT
/begin MEASUREMENT OELNIVNKSM "" UWORD _CNV_R_R_tog_ub_q0p_500_CM 1 100. 0. 32767.5 ECU_ADDRESS 0x3fb1e2 FORMAT "%8.2" /end MEASUREMENT
/begin MEASUREMENT OELNIVNORM "" UBYTE _CNV_R_R_tog_ub_q0p_500_CM 1 100. 0. 127.5 ECU_ADDRESS 0x3fa48f FORMAT "%5.1" /end MEASUREMENT
/begin MEASUREMENT OELNIVORI "" UBYTE _CNV_R_R_tog_ub_q0p_500_CM 1 100. 0. 127.5 ECU_ADDRESS 0x3fa490 FORMAT "%5.1" /end MEASUREMENT
/begin MEASUREMENT OELNIVSUM "" ULONG _CNV_A_R_LINEAR_____589_CM 1 100. 0. 2147483647.5 ECU_ADDRESS 0x3fa484 FORMAT "%13.2" /end MEASUREMENT
/begin MEASUREMENT OELNIVSUMW "" ULONG _CNV_A_R_LINEAR_____589_CM 1 100. 0. 2147483647.5 ECU_ADDRESS 0x3fa488 FORMAT "%13.2" /end MEASUREMENT
/begin MEASUREMENT ORIVERZZ "" UBYTE _CNV_R_R_igen_ub_q1_483_CM 1 100. 0. 255. ECU_ADDRESS 0x3fb1e7 FORMAT "%5.1" /end MEASUREMENT
/begin MEASUREMENT TOEL_T "" UWORD _CNV_R_R_t_q0p1ms_505_CM 1 100. 0. 6553.5 ECU_ADDRESS 0x3fa480 FORMAT "%8.3" /end MEASUREMENT
/begin MEASUREMENT TOEL_W "" UWORD _CNV_A_R_LINEAR_____590_CM 1 100. -48. 207. ECU_ADDRESS 0x3fb1f2 FORMAT "%5.1" /end MEASUREMENT
/begin MEASUREMENT TOGBW_I "" UWORD _CNV_R_R_igen_ub_q1_483_CM 1 100. 0. 255. ECU_ADDRESS 0x3fa482 FORMAT "%8.4" /end MEASUREMENT
/begin MEASUREMENT TOGK_I "" UBYTE _CNV_R_R_igen_ub_q1_483_CM 1 100. 0. 255. ECU_ADDRESS 0x3fa491 FORMAT "%5.1" /end MEASUREMENT
/begin MEASUREMENT TOG_I "" UBYTE _CNV_A_R_LINEAR_____12_CM 1 100. 0. 255. ECU_ADDRESS 0x3fb1e8 FORMAT "%5.1" /end MEASUREMENT
/begin MEASUREMENT TOG_K "" UBYTE _CNV_S_2_B_TRUE_519_CM 1 100. 0. 1. ECU_ADDRESS 0x3fb1df /end MEASUREMENT
/begin MEASUREMENT B_OELVERL "" UBYTE _CNV_S_2_B_TRUE_519_CM 1 100. 0. 1. ECU_ADDRESS 0x3fb1de /end MEASUREMENT
/begin MEASUREMENT OELNIVKURZ "" UBYTE _CNV_R_R_tog_ub_q0p_500_CM 1 100. 0. 127.5 ECU_ADDRESS 0x3fa48d FORMAT "%5.1" /end MEASUREMENT
/begin MEASUREMENT OELNIVM "" UBYTE _CNV_R_R_tog_ub_q0p_500_CM 1 100. 0. 127.5 ECU_ADDRESS 0x3fa48e FORMAT "%5.1" /end MEASUREMENT
/begin AXIS_PTS ldpm_n_110 "" 0x43ca5 N_32 _REC_AXS_20_u1 8160. _CNV_A_R_LINEAR_____5_CM 8 0. 8160. FORMAT "%4.0" /end AXIS_PTS
/begin AXIS_PTS ldpm_gr_tra_at_2 "" 0x43c25 GR_AT _REC_AXS_20_u1 255. _CNV_A_R_LINEAR_____10_CM 7 0. 255. FORMAT "%3.0" /end AXIS_PTS
/begin AXIS_PTS ldpm_gr_tra_mt_2 "" 0x43c2d GR_MT _REC_AXS_20_u1 255. _CNV_A_R_LINEAR_____10_CM 8 0. 255. FORMAT "%3.0" /end AXIS_PTS
/begin AXIS_PTS ldp_toil_t_ramp_conv_pos "" 0x43a59 TOIL _REC_AXS_20_u1 200. _CNV_A_R_LINEAR_____3_CM 8 -40. 160. FORMAT "%3.0" /end AXIS_PTS
/begin AXIS_PTS ldp_toil_t_ramp_conv_neg "" 0x43a50 TOIL _REC_AXS_20_u1 200. _CNV_A_R_LINEAR_____3_CM 8 -40. 160. FORMAT "%3.0" /end AXIS_PTS
/begin COMPU_METHOD _CNV_A_R_LINEAR_____0_CM "" RAT_FUNC "%6.3" "°C" COEFFS 0 1.333333333333333 64. 0 0 1 /end COMPU_METHOD
/begin COMPU_METHOD _CNV_A_R_LINEAR_____1_CM "" RAT_FUNC "%6.3" "°C" COEFFS 0 1.333333333333333 0. 0 0 1 /end COMPU_METHOD
/begin COMPU_METHOD _CNV_A_R_LINEAR_____3_CM "" RAT_FUNC "%6.3" "°C" COEFFS 0 1. 40. 0 0 1 /end COMPU_METHOD
/begin COMPU_METHOD _CNV_A_R_LINEAR_____4_CM "" RAT_FUNC "%6.3" "%" COEFFS 0 2.56 0. 0 0 1 /end COMPU_METHOD
/begin COMPU_METHOD _CNV_A_R_LINEAR_____5_CM "" RAT_FUNC "%6.3" "rpm" COEFFS 0 3.125e-002 0. 0 0 1 /end COMPU_METHOD
/begin COMPU_METHOD _CNV_A_R_LINEAR_____10_CM "" RAT_FUNC "%6.3" "-" COEFFS 0 1. 0. 0 0 1 /end COMPU_METHOD
/begin COMPU_METHOD _CNV_S_2_RANGE______11_CM "" TAB_VERB "%6.3" "-" COMPU_TAB_REF _CNV_S_2_RANGE______11 /end COMPU_METHOD
/begin COMPU_VTAB _CNV_S_2_RANGE______11 "" TAB_VERB 2 0 "0" 1 "1" /end COMPU_VTAB
/begin COMPU_METHOD _CNV_A_R_LINEAR_____12_CM "" RAT_FUNC "%6.3" "[-]" COEFFS 0 1. 0. 0 0 1 /end COMPU_METHOD
/begin COMPU_METHOD _CNV_A_R_LINEAR_____13_CM "" RAT_FUNC "%6.3" "km/h" COEFFS 0 1. 0. 0 0 1 /end COMPU_METHOD
/begin COMPU_METHOD _CNV_A_R_LINEAR_____14_CM "" RAT_FUNC "%6.3" "s" COEFFS 0 10. 0. 0 0 1 /end COMPU_METHOD
/begin COMPU_METHOD _CNV_A_R_LINEAR_____15_CM "" RAT_FUNC "%6.3" "-" COEFFS 0 4095.999999839998 -1.280019205296412e-006 0 0 1 /end COMPU_METHOD
/begin COMPU_METHOD _CNV_A_R_LINEAR_____17_CM "" RAT_FUNC "%6.3" "rpm" COEFFS 0 1. 0. 0 0 1 /end COMPU_METHOD
/begin COMPU_METHOD _CNV_A_R_LINEAR_____18_CM "" RAT_FUNC "%6.3" "mg/stk" COEFFS 0 0.183585313174946 0. 0 0 1 /end COMPU_METHOD
/begin COMPU_METHOD _CNV_A_R_LINEAR_____23_CM "" RAT_FUNC "%6.3" "ms" COEFFS 0 0.1 0. 0 0 1 /end COMPU_METHOD
/begin COMPU_METHOD _CNV_A_R_LINEAR_____27_CM "" RAT_FUNC "%6.3" "s" COEFFS 0 100. 0. 0 0 1 /end COMPU_METHOD
/begin COMPU_METHOD _CNV_S_2_RANGE______28_CM "" TAB_VERB "%6.3" "[-]" COMPU_TAB_REF _CNV_S_2_RANGE______28 /end COMPU_METHOD
/begin COMPU_VTAB _CNV_S_2_RANGE______28 "" TAB_VERB 2 0 "0" 1 "1" /end COMPU_VTAB
/begin COMPU_METHOD _CNV_A_R_LINEAR_____31_CM "" RAT_FUNC "%6.3" "-" COEFFS 0 65536.00007936121 0. 0 0 1 /end COMPU_METHOD
/begin COMPU_METHOD _CNV_A_R_LINEAR_____33_CM "" RAT_FUNC "%6.3" "V" COEFFS 0 204.7999998974999 0. 0 0 1 /end COMPU_METHOD
/begin COMPU_METHOD _CNV_A_R_LINEAR_____34_CM "" RAT_FUNC "%6.3" "-" COEFFS 0 127.9991955827809 0. 0 0 1 /end COMPU_METHOD
/begin COMPU_METHOD _CNV_A_R_LINEAR_____38_CM "" RAT_FUNC "%6.3" "V" COEFFS 0 51.0204081632653 0. 0 0 1 /end COMPU_METHOD
/begin COMPU_METHOD _CNV_A_R_LINEAR_____43_CM "" RAT_FUNC "%6.3" "hPa" COEFFS 0 12.06017666543982 0. 0 0 1 /end COMPU_METHOD
/begin COMPU_METHOD _CNV_A_R_LINEAR_____44_CM "" RAT_FUNC "%6.3" "[-]" COEFFS 0 255.9999357490357 0. 0 0 1 /end COMPU_METHOD
/begin COMPU_METHOD _CNV_A_R_LINEAR_____45_CM "" RAT_FUNC "%6.3" "-" COEFFS 0 32768.00003968061 0. 0 0 1 /end COMPU_METHOD
/begin COMPU_METHOD _CNV_A_R_LINEAR_____47_CM "" RAT_FUNC "%6.3" "s" COEFFS 0 1. 0. 0 0 1 /end COMPU_METHOD
/begin COMPU_METHOD _CNV_A_R_LINEAR_____48_CM "" RAT_FUNC "%6.3" "Nm" COEFFS 0 32. 0. 0 0 1 /end COMPU_METHOD
/begin COMPU_METHOD _CNV_A_R_LINEAR_____72_CM "" RAT_FUNC "%6.3" "Nm" COEFFS 0 2. 0. 0 0 1 /end COMPU_METHOD
/begin COMPU_METHOD _CNV_A_R_LINEAR_____78_CM "" RAT_FUNC "%6.3" "km/h" COEFFS 0 128.0000018750286 0. 0 0 1 /end COMPU_METHOD
/begin COMPU_METHOD _CNV_A_R_LINEAR_____79_CM "" RAT_FUNC "%6.3" "µl" COEFFS 0 1. 0. 0 0 1 /end COMPU_METHOD
/begin COMPU_METHOD _CNV_A_R_LINEAR_____80_CM "" RAT_FUNC "%6.3" "km" COEFFS 0 0.1 0. 0 0 1 /end COMPU_METHOD
/begin COMPU_METHOD _CNV_A_R_LINEAR_____87_CM "" RAT_FUNC "%6.3" "s" COEFFS 0 25. 0. 0 0 1 /end COMPU_METHOD
/begin COMPU_METHOD _CNV_A_R_LINEAR_____88_CM "" RAT_FUNC "%6.3" "Nm" COEFFS 0 0.5 0. 0 0 1 /end COMPU_METHOD
/begin COMPU_METHOD _CNV_A_R_LINEAR_____95_CM "" RAT_FUNC "%6.3" "mg/stk" COEFFS 0 47.18142548596112 0. 0 0 1 /end COMPU_METHOD
/begin COMPU_METHOD _CNV_S_6_RANGE_CDN__96_CM "" TAB_VERB "%6.3" "-" COMPU_TAB_REF _CNV_S_6_RANGE_CDN__96 /end COMPU_METHOD
/begin COMPU_VTAB _CNV_S_6_RANGE_CDN__96 "" TAB_VERB 6 0 "NO_CDN" 1 "CDN_NO_PURGE" 2 "CDN_MIN_PURGE" 3 "CDN_RAMP_OPEN" 4 "CDN_RAMP_OPEN_FAST" 5 "CDN_PURGE" /end COMPU_VTAB
/begin COMPU_METHOD _CNV_A_R_LINEAR_____97_CM "" RAT_FUNC "%6.3" "hPa" COEFFS 0 12.06017666543982 -1.759293338545831e-002 0 0 1 /end COMPU_METHOD
/begin COMPU_METHOD _CNV_A_R_LINEAR_____98_CM "" RAT_FUNC "%6.3" "%" COEFFS 0 655.3600000071681 3.584063961170614e-007 0 0 1 /end COMPU_METHOD
/begin COMPU_METHOD _CNV_A_R_LINEAR_____101_CM "" RAT_FUNC "%6.3" "kg/h" COEFFS 0 32. 0. 0 0 1 /end COMPU_METHOD
/begin COMPU_METHOD _CNV_A_R_LINEAR_____103_CM "" RAT_FUNC "%6.3" "-" COEFFS 0 128. 0. 0 0 1 /end COMPU_METHOD
/begin COMPU_METHOD _CNV_A_R_LINEAR_____111_CM "" RAT_FUNC "%6.3" "-" COEFFS 0 255.9999997499962 0. 0 0 1 /end COMPU_METHOD
/begin COMPU_METHOD _CNV_A_R_LINEAR_____148_CM "" RAT_FUNC "%6.3" "-" COEFFS 0 1023.999999919998 0. 0 0 1 /end COMPU_METHOD
/begin COMPU_METHOD _CNV_A_R_LINEAR_____155_CM "" RAT_FUNC "%6.3" "h" COEFFS 0 35999.99999497086 0. 0 0 1 /end COMPU_METHOD
/begin COMPU_METHOD _CNV_A_R_LINEAR_____182_CM "" RAT_FUNC "%6.3" "-" COEFFS 0 65535. 0. 0 0 1 /end COMPU_METHOD
/begin COMPU_METHOD _CNV_A_R_LINEAR_____195_CM "" RAT_FUNC "%6.3" "[-]" COEFFS 0 64. 0. 0 0 1 /end COMPU_METHOD
/begin COMPU_METHOD _CNV_S_4_STATE_AMT__200_CM "" TAB_VERB "%6.3" "[-]" COMPU_TAB_REF _CNV_S_4_STATE_AMT__200 /end COMPU_METHOD
/begin COMPU_VTAB _CNV_S_4_STATE_AMT__200 "" TAB_VERB 4 0 "NO" 1 "DEC" 2 "INC" 3 "DEC_INC" /end COMPU_VTAB
/begin COMPU_METHOD _CNV_A_R_LINEAR_____201_CM "" RAT_FUNC "%6.3" "Nm/10ms" COEFFS 0 32. 0. 0 0 1 /end COMPU_METHOD
/begin COMPU_METHOD _CNV_A_R_LINEAR_____202_CM "" RAT_FUNC "%6.3" "°CRK" COEFFS 0 2.666666666666667 95. 0 0 1 /end COMPU_METHOD
/begin COMPU_METHOD _CNV_A_R_LINEAR_____204_CM "" RAT_FUNC "%6.3" "°CRK" COEFFS 0 2.666666666666667 128. 0 0 1 /end COMPU_METHOD
/begin COMPU_METHOD _CNV_A_R_LINEAR_____208_CM "" RAT_FUNC "%6.3" "ms" COEFFS 0 250. 0. 0 0 1 /end COMPU_METHOD
/begin COMPU_METHOD _CNV_A_R_LINEAR_____213_CM "" RAT_FUNC "%6.3" "rpm" COEFFS 0 1. 32768. 0 0 1 /end COMPU_METHOD
/begin COMPU_METHOD _CNV_A_R_LINEAR_____215_CM "" RAT_FUNC "%6.3" "rpm/s" COEFFS 0 3.125e-002 0. 0 0 1 /end COMPU_METHOD
/begin COMPU_METHOD _CNV_A_R_LINEAR_____218_CM "" RAT_FUNC "%6.3" "Nm" COEFFS 0 32. 32768. 0 0 1 /end COMPU_METHOD
/begin COMPU_METHOD _CNV_A_R_LINEAR_____226_CM "" RAT_FUNC "%6.3" "°TPS" COEFFS 0 137.0962343096234 0. 0 0 1 /end COMPU_METHOD
/begin COMPU_METHOD _CNV_A_R_LINEAR_____256_CM "" RAT_FUNC "%6.3" "V" COEFFS 0 13107.19998965744 0. 0 0 1 /end COMPU_METHOD
/begin COMPU_METHOD _CNV_A_R_LINEAR_____264_CM "" RAT_FUNC "%6.3" "°TPS/s" COEFFS 0 8.535564853556485e-002 0. 0 0 1 /end COMPU_METHOD
/begin COMPU_METHOD _CNV_A_R_LINEAR_____271_CM "" RAT_FUNC "%6.3" "-" COEFFS 0 16383.75 32767.5 0 0 1 /end COMPU_METHOD
/begin COMPU_METHOD _CNV_A_R_LINEAR_____272_CM "" RAT_FUNC "%6.3" "-" COEFFS 0 16383.99999935999 -1.280019205296412e-006 0 0 1 /end COMPU_METHOD
/begin COMPU_METHOD _CNV_A_R_LINEAR_____273_CM "" RAT_FUNC "%6.3" "[-]" COEFFS 0 1023.999999959999 32767.99999871998 0 0 1 /end COMPU_METHOD
/begin COMPU_METHOD _CNV_A_R_LINEAR_____307_CM "" RAT_FUNC "%6.3" "-" COEFFS 0 1023.999999959999 -1.818989403545857e-011 0 0 1 /end COMPU_METHOD
/begin COMPU_METHOD _CNV_A_R_LINEAR_____348_CM "" RAT_FUNC "%6.3" "-" COEFFS 0 8191.999999679995 0. 0 0 1 /end COMPU_METHOD
/begin COMPU_METHOD _CNV_S_3_STATE_CTL__353_CM "" TAB_VERB "%6.3" "[-]" COMPU_TAB_REF _CNV_S_3_STATE_CTL__353 /end COMPU_METHOD
/begin COMPU_VTAB _CNV_S_3_STATE_CTL__353 "" TAB_VERB 3 0 "INSY_OPL" 1 "INSY_AR_CTL" 2 "INSY_AMP_CTL" /end COMPU_VTAB
/begin COMPU_METHOD _CNV_A_R_LINEAR_____366_CM "" RAT_FUNC "%6.3" "°TPS" COEFFS 0 137.0962343096234 1.818989403545857e-012 0 0 1 /end COMPU_METHOD
/begin COMPU_METHOD _CNV_A_R_LINEAR_____376_CM "" RAT_FUNC "%6.3" "Nm/rpm" COEFFS 0 8191.999999679995 0. 0 0 1 /end COMPU_METHOD
/begin COMPU_METHOD _CNV_A_R_LINEAR_____379_CM "" RAT_FUNC "%6.3" "-" COEFFS 0 2048. 0. 0 0 1 /end COMPU_METHOD
/begin COMPU_METHOD _CNV_A_R_LINEAR_____380_CM "" RAT_FUNC "%6.3" "hPa" COEFFS 0 2. 0. 0 0 1 /end COMPU_METHOD
/begin COMPU_METHOD _CNV_A_R_LINEAR_____387_CM "" RAT_FUNC "%6.3" "mm" COEFFS 0 1000. 0. 0 0 1 /end COMPU_METHOD
/begin COMPU_METHOD _CNV_A_R_LINEAR_____390_CM "" RAT_FUNC "%6.3" "%/s" COEFFS 0 0.1024000154202376 128.000019275297 0 0 1 /end COMPU_METHOD
/begin COMPU_METHOD _CNV_A_R_LINEAR_____448_CM "" RAT_FUNC "%6.3" "-" COEFFS 0 1048576. 0. 0 0 1 /end COMPU_METHOD
/begin COMPU_METHOD _CNV_A_R_LINEAR_____449_CM "" RAT_FUNC "%6.3" "rpm/Nm" COEFFS 0 65536.00007936121 0. 0 0 1 /end COMPU_METHOD
/begin COMPU_METHOD _CNV_A_R_LINEAR_____450_CM "" RAT_FUNC "%6.3" "rpm" COEFFS 0 64.00027344284068 0.1400027344279806 0 0 1 /end COMPU_METHOD
/begin COMPU_METHOD _CNV_A_R_LINEAR_____452_CM "" RAT_FUNC "%6.3" "Nm/rpm*rpm" COEFFS 0 134293032.7868853 0. 0 0 1 /end COMPU_METHOD
/begin COMPU_METHOD _CNV_S_4_STATE_TQ_D_453_CM "" TAB_VERB "%6.3" "[-]" COMPU_TAB_REF _CNV_S_4_STATE_TQ_D_453 /end COMPU_METHOD
/begin COMPU_VTAB _CNV_S_4_STATE_TQ_D_453 "" TAB_VERB 4 0 "\"economy\"" 1 "\"high_dynamic\"" 2 "\"transition\"" 3 "\"tq_reserve\"" /end COMPU_VTAB
/begin COMPU_METHOD _CNV_A_R_LINEAR_____454_CM "" RAT_FUNC "%6.3" "-" COEFFS 0 32768. 0. 0 0 1 /end COMPU_METHOD
/begin COMPU_METHOD _CNV_S_6_STATE_TQ_D_455_CM "" TAB_VERB "%6.3" "[-]" COMPU_TAB_REF _CNV_S_6_STATE_TQ_D_455 /end COMPU_METHOD
/begin COMPU_VTAB _CNV_S_6_STATE_TQ_D_455 "" TAB_VERB 6 0 "0" 1 "1" 8 "2" 9 "3" 10 "4" 11 "5" /end COMPU_VTAB
/begin COMPU_METHOD _CNV_A_R_LINEAR_____456_CM "" RAT_FUNC "%6.3" "-" COEFFS 0 4095.999963999451 32767.99971199561 0 0 1 /end COMPU_METHOD
/begin COMPU_METHOD _CNV_A_R_LINEAR_____457_CM "" RAT_FUNC "%6.3" "Nm/100ms" COEFFS 0 32. 0. 0 0 1 /end COMPU_METHOD
/begin COMPU_METHOD _CNV_A_R_LINEAR_____458_CM "" RAT_FUNC "%6.3" "W" COEFFS 0 -5.e-002 0. 0 0 1 /end COMPU_METHOD
/begin COMPU_METHOD _CNV_A_R_LINEAR_____459_CM "" RAT_FUNC "%6.3" "[-]" COEFFS 0 1023.999989719843 0. 0 0 1 /end COMPU_METHOD
/begin COMPU_METHOD _CNV_S_3_STATE_TQ_R_460_CM "" TAB_VERB "%6.3" "Nm" COMPU_TAB_REF _CNV_S_3_STATE_TQ_R_460 /end COMPU_METHOD
/begin COMPU_VTAB _CNV_S_3_STATE_TQ_R_460 "" TAB_VERB 3 1 "RANGE_1" 2 "RANGE_2" 3 "RANGE_3" /end COMPU_VTAB
/begin COMPU_METHOD _CNV_S_3_STATE_TQ_R_461_CM "" TAB_VERB "%6.3" "[-]" COMPU_TAB_REF _CNV_S_3_STATE_TQ_R_461 /end COMPU_METHOD
/begin COMPU_VTAB _CNV_S_3_STATE_TQ_R_461 "" TAB_VERB 3 0 "CONST" 1 "INC" 2 "DEC" /end COMPU_VTAB
/begin COMPU_METHOD _CNV_A_R_LINEAR_____465_CM "" RAT_FUNC "%6.3" "°STW" COEFFS 0 22.8564453125 32768. 0 0 1 /end COMPU_METHOD
/begin COMPU_METHOD _CNV_A_R_LINEAR_____466_CM "" RAT_FUNC "%6.3" "°STW/s" COEFFS 0 22.8564453125 32768. 0 0 1 /end COMPU_METHOD
/begin COMPU_METHOD _CNV_S_3_STATE_LRN__472_CM "" TAB_VERB "%6.3" "[-]" COMPU_TAB_REF _CNV_S_3_STATE_LRN__472 /end COMPU_METHOD
/begin COMPU_VTAB _CNV_S_3_STATE_LRN__472 "" TAB_VERB 3 0 "Variant unknown" 1 "Motorola sensor" 2 "KP120 - sensor" /end COMPU_VTAB
/begin COMPU_METHOD _CNV_R_R_igen_ub_q1_483_CM "" RAT_FUNC "%6.3" "[-]" COEFFS 0. 1. 0. 0. 0. 1. /end COMPU_METHOD
/begin COMPU_METHOD _CNV_R_R_tog_ub_q0p_500_CM "" RAT_FUNC "%6.3" "[-]" COEFFS 0. 2. 0. 0. 0. 1. /end COMPU_METHOD
/begin COMPU_METHOD _CNV_R_R_rel_ub_b10_501_CM "" RAT_FUNC "%6.3" "%" COEFFS 0. 255. 0. 0. 0. 100. /end COMPU_METHOD
/begin COMPU_METHOD _CNV_R_R_rel_uw_b10_502_CM "" RAT_FUNC "%6.3" "%" COEFFS 0. 65536. 0. 0. 0. 100. /end COMPU_METHOD
/begin COMPU_METHOD _CNV_A_R_nmot_ub_q4_503_CM "" RAT_FUNC "%6.3" "1/min" COEFFS 0 2.5e-002 0. 0 0 1 /end COMPU_METHOD
/begin COMPU_METHOD _CNV_R_R_temp_uw_q0_504_CM "" RAT_FUNC "%6.3" "Grad C" COEFFS 0. 1. 48. 0. 0. 0.75 /end COMPU_METHOD
/begin COMPU_METHOD _CNV_R_R_t_q0p1ms_505_CM "" RAT_FUNC "%6.3" "ms" COEFFS 0. 10. 0. 0. 0. 1. /end COMPU_METHOD
/begin COMPU_METHOD _CNV_A_R_LINEAR_____506_CM "" RAT_FUNC "%6.3" "ms" COEFFS 0 10. 0. 0 0 1 /end COMPU_METHOD
/begin COMPU_METHOD _CNV_A_R_LINEAR_____507_CM "" RAT_FUNC "%6.3" "°C" COEFFS 0 1.331730769230769 63.92307692307692 0 0 1 /end COMPU_METHOD
/begin COMPU_METHOD _CNV_S_2_B_TRUE_519_CM "" TAB_VERB "%6.3" "[-]" COMPU_TAB_REF _CNV_S_2_B_TRUE_519 /end COMPU_METHOD
/begin COMPU_VTAB _CNV_S_2_B_TRUE_519 "" TAB_VERB 2 0 "----" 1 "TRUE" /end COMPU_VTAB
/begin COMPU_METHOD _CNV_A_R_LINEAR_____577_CM "" RAT_FUNC "%6.3" "°TPS/V" COEFFS 0 1365.3125 0. 0 0 1 /end COMPU_METHOD
/begin COMPU_METHOD _CNV_A_R_LINEAR_____589_CM "" RAT_FUNC "%6.3" "mm" COEFFS 0 2. 0. 0 0 1 /end COMPU_METHOD
/begin COMPU_METHOD _CNV_A_R_LINEAR_____590_CM "" RAT_FUNC "%6.3" "Grad C" COEFFS 0 1.333333333333333 64. 0 0 1 /end COMPU_METHOD
/begin RECORD_LAYOUT _REC_VAL_20_u1 FNC_VALUES 1 UBYTE COLUMN_DIR DIRECT /end RECORD_LAYOUT
/begin RECORD_LAYOUT _REC_MAP_20_u1_u1_u1 FNC_VALUES 1 UBYTE COLUMN_DIR DIRECT /end RECORD_LAYOUT
/begin RECORD_LAYOUT _REC_AXS_20_u1 NO_AXIS_PTS_X 1 UBYTE AXIS_PTS_X 2 UBYTE INDEX_INCR DIRECT /end RECORD_LAYOUT
/begin RECORD_LAYOUT _REC_CUR_20_u1_u1 FNC_VALUES 1 UBYTE COLUMN_DIR DIRECT /end RECORD_LAYOUT
/begin RECORD_LAYOUT _REC_MAP_20_u2_u2_u1 FNC_VALUES 1 UWORD COLUMN_DIR DIRECT /end RECORD_LAYOUT
/begin RECORD_LAYOUT _REC_AXS_20_u2 NO_AXIS_PTS_X 1 UWORD AXIS_PTS_X 2 UWORD INDEX_INCR DIRECT /end RECORD_LAYOUT
/begin RECORD_LAYOUT _REC_CUR_20_u2_u2 FNC_VALUES 1 UWORD COLUMN_DIR DIRECT /end RECORD_LAYOUT
/begin RECORD_LAYOUT _REC_VAL_20_u2 FNC_VALUES 1 UWORD COLUMN_DIR DIRECT /end RECORD_LAYOUT
/begin RECORD_LAYOUT _REC_CUR_20_u2_u1 FNC_VALUES 1 UWORD COLUMN_DIR DIRECT /end RECORD_LAYOUT
/begin RECORD_LAYOUT _REC_CUR_20_u1_u2 FNC_VALUES 1 UBYTE COLUMN_DIR DIRECT /end RECORD_LAYOUT
/begin RECORD_LAYOUT _REC_MAP_20_u2_u1_u1 FNC_VALUES 1 UWORD COLUMN_DIR DIRECT /end RECORD_LAYOUT
/begin RECORD_LAYOUT _REC_VAL_20_u4 FNC_VALUES 1 ULONG COLUMN_DIR DIRECT /end RECORD_LAYOUT
/begin RECORD_LAYOUT _REC_MAP_20_u2_u1_u2 FNC_VALUES 1 UWORD COLUMN_DIR DIRECT /end RECORD_LAYOUT
/begin RECORD_LAYOUT _REC_VAL_20_s2 FNC_VALUES 1 SWORD COLUMN_DIR DIRECT /end RECORD_LAYOUT
/begin RECORD_LAYOUT _REC_VAL_20_s1 FNC_VALUES 1 SBYTE COLUMN_DIR DIRECT /end RECORD_LAYOUT
/begin RECORD_LAYOUT _REC_MAP_20_u2_u2_u2 FNC_VALUES 1 UWORD COLUMN_DIR DIRECT /end RECORD_LAYOUT
/begin RECORD_LAYOUT _REC_CUR_52_u2_u2 NO_AXIS_PTS_X 1 UWORD AXIS_PTS_X 2 UWORD INDEX_INCR DIRECT FNC_VALUES 3 UWORD COLUMN_DIR DIRECT /end RECORD_LAYOUT
/begin RECORD_LAYOUT _REC_CUR_52_UBYTE_s1_u1 NO_AXIS_PTS_X 1 UBYTE AXIS_PTS_X 2 UBYTE INDEX_INCR DIRECT FNC_VALUES 3 SBYTE COLUMN_DIR DIRECT /end RECORD_LAYOUT
/begin RECORD_LAYOUT _REC_CUR_52_UWORD_u2_u2 NO_AXIS_PTS_X 1 UWORD AXIS_PTS_X 2 UWORD INDEX_INCR DIRECT FNC_VALUES 3 UWORD COLUMN_DIR DIRECT /end RECORD_LAYOUT
/begin FUNCTION SYS_Determination_of_Throttle_Po "_Determination of Throttle Position"
 /begin DEF_CHARACTERISTIC C_V_TPS_SWI_GAIN_1 C_V_TPS_HYS_GAIN_1 C_V_TPS_GRD_MAX C_V_TPS_GAIN_GRD_MAX C_TPS_SLOP C_TPS_MAX /end DEF_CHARACTERISTIC
 /begin OUT_MEASUREMENT TPS_AV_1 TPS_AV_2 TPS_GRD TPS_SEG TPS_SEG_1 TPS_SEG_2 TPS_SEG_GAIN_1 TPS_AV_GAIN_1 V_TPS_GAIN_TOL_ENA_1 V_TPS_GAIN_BOL_ENA_1 TPS_LIH TPS_AV TPS_AV_CTL TPS_AV_CTL_1 TPS_AV_CTL_2 TPS_AV_CTL_GAIN_1 LV_TPS_GAIN_ACT_1 LV_TPS_GRD_UP /end OUT_MEASUREMENT
/end FUNCTION
/begin FUNCTION _Intake_manifold_model "_Appl. Inc. Intake manifold model" /begin DEF_CHARACTERISTIC IP_FAC_MAF_KGH_COR C_PQ_AMP_CTL C_PQ_AMP_CTL_HYS /end DEF_CHARACTERISTIC
 /begin OUT_MEASUREMENT LV_AMP_AD_STOP LV_AMP_CTL_STOP LV_AR_RED_AD_RST LV_AR_RED_AD_STOP LV_AR_RED_CTL_STOP MAF_KGH_MES_FAC LV_MAP_CTL LV_AMP_AD_RST LV_MAF_CTL MAP_MES STATE_CTL_INSY /end OUT_MEASUREMENT
/end FUNCTION
/begin FUNCTION SYS_Vol_Eff_Cor_due_to_VIM_Influ "_Vol Eff Cor due to VIM Influences" /end FUNCTION
/begin FUNCTION SYS_ECU_Temperature "_ECU Temperature"
 /begin DEF_CHARACTERISTIC IP_TECU C_TECU_SUB C_TECU_THD_1 C_TECU_THD_2 C_TECU_THD_3 C_TRT_DIF_TECU /end DEF_CHARACTERISTIC
 /begin OUT_MEASUREMENT CTR_STC_TECU_1 CTR_STC_TECU_2 CTR_STC_TECU_3 TECU TECU_MES /end OUT_MEASUREMENT
/end FUNCTION
/begin FUNCTION SYS_Vol_Eff_Cor_due_to_Port_Flap "_Vol Eff Cor due to Port Flap Influences" /end FUNCTION
/begin FUNCTION SYS_Output_signals_of_the_DME_to "_Output signals of the DME to the CAN bus"
 /begin DEF_CHARACTERISTIC C_T_CYC_DISP_ICL_CAN C_ICL_DISP_FRQ C_TOIL_GS_MAX C_TCO_CHK_CTL_1 C_TCO_CHK_CTL_2 C_TCO_SUM_HYS_1 C_TCO_SUM_HYS_2 C_TQ_MAX_ACC C_CC_MESS C_MAX_MSG_MISS_ASR_CAN C_TMOT_SUM_HYS C_T_TCO_CAN_AST C_TCO_SWI_WUP C_T_CTR_MAX_ASR_CAN C_TCO_TMOT_STA C_FAC_MFF_FCO IP_T_AST_SWI_WUP__CTR_KM_CAN C_PV_CAN_DIAG C_ENG_ETCU LC_VAR_BN C_T_IGK_LIH C_N_SP_IS_THD_CAN /end DEF_CHARACTERISTIC
 /begin OUT_MEASUREMENT LV_TEMP_ENG_1 LV_TEMP_ENG_2 LV_TOIL_GS TCC_CAN_ECU TCC_CAN_ECU1 TCC_CAN_ECU2 TCC_CAN_ECU3 CC_ID LV_MIL_FLL LV_ACK_TCS FCO LV_WUP_CAN CTL_SHIFT_LOCK_CAN LV_LEVEL_IS TQI_MAF STATE_LRN_AMP /end OUT_MEASUREMENT
/end FUNCTION
/begin FUNCTION SYS_Check_Sum_Calculation "_Check Sum Calculation"
 /begin OUT_MEASUREMENT CTL_ACIN_ENG_TYP STATE_SWI_OFF_VB CKS_CAN_TQ_DCC CKS_CAN_TQ_TCS CKS_CAN_TQ_ETCU CKS_CAN_TQ_AMT CKS_CAN_MSW CKS_CAN_CAS CKS_CLC_CAS CKS_CLC_TQ_DCC CKS_CLC_TQ_TCS CKS_CLC_TQ_ETCU CKS_CLC_TQ_AMT CKS_CLC_MSW CKS_CLC_ECU1 CKS_CLC_ECU2 CKS_CLC_ECU3 CKS_CAN_VEH_MOD /end OUT_MEASUREMENT
/end FUNCTION
/begin FUNCTION SYS_Multiplexed_segment_synchron "_Multiplexed segment-synchronous output variables"
 /begin OUT_MEASUREMENT IGA_IGC_0_5 IGA_KNK_0_5 KNK_THD_0_5 NL_0_5 TI_CYL_0_5 KNKS_0_5 /end OUT_MEASUREMENT
/end FUNCTION
/begin FUNCTION SYS_Oil_temperature_and_level_se "_Oil temperature and level sensor (GGTOENS)"
 /begin DEF_CHARACTERISTIC DOLNIV ORIVERZ PT1NMOT PT1TOEL TOGANZ TOGKURZANZ TOGMWK TOGNMOT TOGORIANZ TOGTMOT TOGTMOTORI TOGVERBKZ TOGVERBNOR TOGVERLKZ TOGVERLNOR TOGVERLORI TRTYP KLTOGNKOR KLTKTOENIV KLTVTOEL /end DEF_CHARACTERISTIC
 /begin OUT_MEASUREMENT B_OELVERB NMOTF NMOTFM NMOTFSUM OELNIVAK OELNIVAKNK OELNIVNKSM OELNIVNORM OELNIVORI OELNIVSUM OELNIVSUMW ORIVERZZ TOEL_T TOEL_W TOGBW_I TOGK_I TOG_I TOG_K B_OELVERL OELNIVKURZ OELNIVM /end OUT_MEASUREMENT
/end FUNCTION
/begin FUNCTION SYS_Evaporative_Emission_Control "_Evaporative Emission Control activation conditions variables"
 /begin DEF_CHARACTERISTIC C_T_DLY_PU_CPS C_PRS_MAX_CPS C_TIA_MIN_CP C_N_CP_TOL C_N_CP_BOL C_MAF_CP_BOL C_MAF_CP_TOL C_T_LAM_LIM_CP C_CL_MMV_REQ C_T_LAM_CP_DLY C_LAM_CP_BOL C_LAM_CP_TOL C_DLY_N_MAF_DYW_CP C_MAF_DYW_CP C_N_DYW_CP C_TCO_MIN_CP /end DEF_CHARACTERISTIC
 /begin OUT_MEASUREMENT LV_N_MAF_DYW_CP N_DYW_CP MAF_DYW_CP LV_CP_ACT CDN_STATE_CP LV_CP_ACT_REQ LV_PU_CP PRS_CPS /end OUT_MEASUREMENT
/end FUNCTION
/begin FUNCTION SYS_BN2000_interface_torque_dist "_BN2000 interface torque distribution"
 /begin OUT_MEASUREMENT TQ_AMT_FAST_DEC_BN TQ_AMT_SLOW_DEC_BN TQ_AMT_FAST_INC_BN TQ_AMT_SLOW_INC_BN TQ_DCC_FAST_INC_BN TQ_DCC_SLOW_INC_BN TQ_GS_FAST_DEC_BN TQ_GS_FAST_INC_BN TQ_GS_SLOW_DEC_BN TQ_GS_SLOW_INC_BN TQ_MSR_FAST_INC_BN TQ_MSR_SLOW_INC_BN TQ_ASR_FAST_DEC_BN TQ_ASR_SLOW_DEC_BN /end OUT_MEASUREMENT
/end FUNCTION
/begin FUNCTION SYS_Application_incidences_for_o "_Application incidences for oxygen sensor internal resistance"
 /begin OUT_MEASUREMENT LV_INH_R_DOWN_LS_1 LV_INH_R_DOWN_LS_2 LV_INH_R_UP_LS_2 LV_INH_R_UP_LS_1 /end OUT_MEASUREMENT
/end FUNCTION
/begin FUNCTION TQM_Torque_Managment "TQM"
 /begin SUB_FUNCTION TQM_Torque_request_for_gear_shif TQM_Initialization_module TQM_Torque_control_at_engine_sta TQM_Reference_and_basic_torque TQM_Torque_losses TQM_Torque_loss_and_reserve_for_ TQM_Torque_based_pattern_calcula TQM_Minimum_torque_at_clutch TQM_Converter_torque TQM_Torque_Transient TQM_Torque_reserve_coordination TQM_Torque_Monitoring_Limitation TQM_Torque_based_anti_jerk_funct TQM_Basic__actual_and_minimum_la TQM_Pedal_value_interpretation TQM_Maximum_torque_at_clutch TQM_Characteristic_quantity_stra TQM_Reference_and_basic_torque_f TQM_Torque_Request_at_Clutch_Gen TQM_Minimum_Maximum_Torque_Reque TQM_Torque_setpoint_for_stratifi TQM_Actual_Engine_Torque TQM_Actual_indicated_engine_torq TQM_Characteristic_quantity_homo TQM_Engine_torque_limitation TQM_Torque_Request_for_Cruise_Co TQM_Torque_Request_for_safety TQM_Torque_based_lambda_setpoint TQM_Dynamic_torque_intervention_ TQM_Torque_loss_for_power_steeri TQM_Appl_IncTorque_loss_and_rese TQM_Application_incidences_for_t TQM_Torque_Reserve_for_Torque_Tr TQM_Dynamic_Torque_request_coord TQM_Separation_for_slow_and_fast TQM_Anti_Jerk_Controller_Activat TQM_Minimum_indicated_engine_tor TQM_Coordination_of_additional_t TQM_Torque_request_for_AMT_inter TQM_AMT_Clutch_torque TQM_Torque_request_for_distance_ TQM_Torque_Request_for_Traction_ TQM_Torque_Loss___Anti_Roll_Stab TQM_Alternator_torque_losses /end SUB_FUNCTION
/end FUNCTION
/begin FUNCTION TQM_Torque_request_for_gear_shif "_Torque request for gear shift intervention"
 /begin DEF_CHARACTERISTIC C_T_MAX_TQR_GS_INTV C_GS_ENA_INC_DEC C_LGRD_LIH_GS_DEC C_LGRD_LIH_GS_INC C_T_DLY_LIH_GS_DEC C_T_DLY_LIH_GS_INC /end DEF_CHARACTERISTIC
 /begin OUT_MEASUREMENT LV_ETCU_DISABLE LV_ETCU_DISABLE_CAN LV_GS_ENA_DEC LV_GS_ENA TQI_GS_FAST_DEC_REQ_1 TQI_GS_SLOW_DEC_REQ TQI_GS_FAST_INC_REQ_1 TQI_GS_SLOW_INC_REQ T_TQR_GS_INTV TQI_GS_FAST_DEC_REQ TQI_GS_FAST_DEC TQI_GS_SLOW_DEC_REQ_1 TQI_GS_SLOW_DEC LV_GS_ENA_INC LV_GS_DEC_LIH TQI_GS_FAST_INC_REQ TQI_GS_FAST_INC TQI_GS_SLOW_INC_REQ_1 TQI_GS_SLOW_INC LV_GS_DEC_ACT LV_GS_INC_LIH LV_GS_INC_ACT T_GS_INC_LIH_CTR T_GS_DEC_LIH_CTR /end OUT_MEASUREMENT
/end FUNCTION
/begin FUNCTION TQM_Initialization_module "_Initialization module"
 /begin OUT_MEASUREMENT EFF_MAF_S ACP TQI_VS_MAX TQ_LOSS_SCHA LV_TQ_LOSS_ACC_INP_ORNG LAMB_BAS_COR_MAX LV_CAN_GS_ACK LV_ACP_ORNG EFF_EGR_S EFF_PHA_S TQ_AD_ADD_S_SWI TQI_CAT_PROT TQ_LOSS_SA TQ_LOSS_THERMO TQ_LOSS_WIN_HEAT TQI_P_MAX /end OUT_MEASUREMENT
/end FUNCTION
/begin FUNCTION TQM_Torque_control_at_engine_sta "_Torque control at engine start"
 /begin DEF_CHARACTERISTIC IP_TQ_ST C_CRLC_TQ_ST C_T_TQ_ADD_DLY_ST C_TQ_ADD_CRLC_ST IP_TQ_ADD_ST /end DEF_CHARACTERISTIC
 /begin OUT_MEASUREMENT TQ_ST TQ_ST_1 TQ_ADD_ST LV_TQ_ADD_ST /end OUT_MEASUREMENT
/end FUNCTION
/begin FUNCTION TQM_Reference_and_basic_torque "_Reference and basic torque" /begin DEF_CHARACTERISTIC LC_MOD_EFF_AV IP_TQI_REF__N__MAF /end DEF_CHARACTERISTIC
 /begin OUT_MEASUREMENT TQI_BAS TQI_REF_IGA TQI_REF_IGA_LAMB TQI_REF_IGA_MIN_LAMB TQI_REF_IGA_SCC TQI_REF_LAMB TQI_REF_LAMB_SCC TQI_REF_SCC TQI_REF EFF_TOT_BAS EFF_TOT_BAS_SLOW /end OUT_MEASUREMENT
/end FUNCTION
/begin FUNCTION TQM_Torque_losses "_Torque losses"
 /begin DEF_CHARACTERISTIC IP_TQFR IP_TQFR_ADD IP_TQ_LOSS_LIM IP_TQFR_ST IP_TQFR_DEC_ST C_MAF_CYL_STK_REF C_CRLC_TQ_LOSS_REQ_CLU C_LGRD_TQ_LOSS_ECF IP_POW_LOSS_ECF /end DEF_CHARACTERISTIC
 /begin OUT_MEASUREMENT TQ_LOSS TQ_LOSS_1 TQ_LOSS_REQ_CLU TQFR_MEC LV_TQ_LOSS_LIM_ACT TQFR TQFR_BAS TQFR_ADD TQFR_ST TQFR_REQ_CLU TQ_LOSS_CLU_ADD TQ_LOSS_ECF /end OUT_MEASUREMENT
/end FUNCTION
/begin FUNCTION TQM_Torque_loss_and_reserve_for_ "_Torque loss and reserve for ACC"
 /begin DEF_CHARACTERISTIC IP_FAC_TQ_LOSS_ACC_ON IP_FAC_TQ_LOSS_ACC_OFF IP_TQ_ADD_ACC IP_TQ_ADD_HEAT_ACC C_TQ_ADD_ACC_LGRD C_TQ_ADD_HEAT_ACC_LGRD C_TCO_MIN_REQ_HEAT_ACC C_TAM_MIN_REQ_HEAT_ACC C_TQ_LOSS_MAX_ACC /end DEF_CHARACTERISTIC
 /begin OUT_MEASUREMENT T_ACC TQ_ADD_ACC TQ_LOSS_ACC TQ_ADD_HEAT_ACC LV_TOUT_ACC LV_REQ_HEAT_ACC_ENA LV_TOUT_REQ_HEAT_ACC T_REQ_HEAT_ACC /end OUT_MEASUREMENT
/end FUNCTION
/begin FUNCTION TQM_Torque_based_pattern_calcula "_Torque based pattern calculation"
 /begin DEF_CHARACTERISTIC LC_EFF_SCC_SP_MAN LC_INH_FCUT_FAST LC_ENA_EFF_SCC_BAS_MAN C_EFF_SCC_SP_HYS C_EFF_SCC_BAS_MAN LC_ENA_FCUT_TOT_GS LC_INH_FCUT_GS_IGA LC_INH_FCUT_ASR LC_ENA_FCUT_TOT_ASR LC_INH_FCUT_N_MAX LC_TQ_SCC_INH_MAN LC_ENA_FCUT_TOT_FAST LC_TQ_SCC_ENA_MAN C_EFF_SCC_SP_MAN C_FAC_IGA_MIN_TEG_IGA_BAS C_HYS_EFF_IGA_MIN_TEG C_MIN_DEC_EFF_IGA_MIN_TEG_1 C_MIN_DEC_EFF_IGA_MIN_TEG_2 ID_NR_PAT_SCC LC_INH_FCUT_GS LC_ENA_FCUT_TOT_N_MAX LC_INH_FCUT_AMT LC_INH_FCUT_DCC LC_ENA_FCUT_TOT_AMT LC_ENA_FCUT_TOT_DCC /end DEF_CHARACTERISTIC
 /begin OUT_MEASUREMENT EFF_SCC_AV EFF_SCC_AV_CAN EFF_SCC_SP_HYS EFF_SCC_BAS EFF_SCC_SP TQI_REF_IGA_MIN_SCC EFF_IGA_MIN_SCC FAC_IGA_MIN_TEG_IGA_BAS LV_AUTH_TQ_PAT NR_PAT_SCC T_MAX_FCUT_FAST /end OUT_MEASUREMENT
/end FUNCTION
/begin FUNCTION TQM_Minimum_torque_at_clutch "_Minimum torque at clutch"
 /begin DEF_CHARACTERISTIC C_N_DIF_TQ_ST_1 C_N_DIF_TQ_ST_2 LC_INH_PU_REQ IP_FAC_N_DIF_IS IP_TQI_MIN_REQ_PU LC_TQ_LOSS_MIN_CLU LC_TQ_LOSS_MIN_CLU_1 LC_TQ_LOSS_MIN_CLU_IS /end DEF_CHARACTERISTIC
 /begin OUT_MEASUREMENT TQ_MIN_CLU TQ_MIN_CLU_1 TQ_MIN_CLU_2 FAC_N_DIF_IS LV_TQ_MIN_CLU TQI_MIN_REQ_PU TQ_MIN_REQ_PU /end OUT_MEASUREMENT
/end FUNCTION
/begin FUNCTION TQM_Converter_torque "_Converter torque"
 /begin DEF_CHARACTERISTIC C_TQ_ADD_CONV_LGRD IP_TQ_ADD_CONV LC_TQ_CONV_DRI_INH LC_TQ_CONV_CAN_INH IP_FAC_CONV__TOIL IP_FAC_CONV_DRI__TOIL IP_T_DLY_CONV__TOIL IP_T_DLY_N_SP_IS__TOIL IP_FAC_TQ_CONV__N_RATIO_CONV IP_N_TUR__GR_AT__VS IP_TQ_CONV_CAN IP_T_RAMP_CONV_NEG__TOIL IP_T_RAMP_CONV_POS__TOIL /end DEF_CHARACTERISTIC
 /begin OUT_MEASUREMENT TQ_CONV_CAN_1 TQ_ADD_CONV LV_TOUT_CONV T_CONV TQ_ADD_TRANS LV_DLY_N_SP_IS TQ_CONV_STN TQ_CONV /end OUT_MEASUREMENT
/end FUNCTION
/begin FUNCTION TQM_Torque_Transient "_Torque Transient"
 /begin DEF_CHARACTERISTIC C_TQ_TRA_THD_UP_2 C_N_GRD_THD_NEG C_N_GRD_THD_POS LC_TQ_TRA_INH C_TQ_TRA_THD_DOWN_1 C_TQ_TRA_THD_DOWN_2 C_TQ_TRA_THD_UP_1 IP_T_INC_TRA_3_MT IP_T_DEC_TRA_RNG_L_3_AT IP_T_INC_TRA_RNG_L_3_MT IP_T_DEC_TRA_2_MT IP_T_INC_TRA_IS_MT IP_T_DEC_TRA_3_MT IP_T_DEC_TRA_RNG_L_3_MT IP_T_INC_TRA_RNG_L_IS_AT IP_T_DEC_TRA_IS_MT IP_T_DEC_TRA_RNG_L_IS_AT IP_T_INC_TRA_1_AT IP_T_INC_TRA_RNG_L_IS_MT IP_T_INC_TRA_2_AT IP_T_DEC_TRA_RNG_L_IS_MT IP_T_INC_TRA_3_AT IP_T_DEC_TRA_1_AT IP_T_DEC_TRA_2_AT IP_T_INC_TRA_RNG_L_1_AT IP_T_DEC_TRA_3_AT IP_T_DEC_TRA_RNG_L_1_AT IP_T_DEC_TRA_IS_AT IP_T_INC_TRA_RNG_L_1_MT IP_T_INC_TRA_IS_AT IP_T_DEC_TRA_RNG_L_1_MT IP_T_INC_TRA_RNG_L_2_AT IP_T_DEC_TRA_RNG_L_2_AT IP_T_INC_TRA_RNG_L_2_MT IP_T_INC_TRA_1_MT IP_T_DEC_TRA_RNG_L_2_MT IP_T_INC_TRA_2_MT IP_T_INC_TRA_RNG_L_3_AT IP_T_DEC_TRA_1_MT /end DEF_CHARACTERISTIC
 /begin OUT_MEASUREMENT T_TRA TQ_REQ_DIF_TRA TQ_RANGE TQ_REQ_TRA_CLU TQ_REQ_TRA_OLD_CLU TQI_REQ_TRA TQ_REQ_TRA_STATE LV_TQ_TRA LV_TQ_TRA_DYN /end OUT_MEASUREMENT
/end FUNCTION
/begin FUNCTION TQM_Torque_reserve_coordination "_Torque reserve coordination"
 /begin DEF_CHARACTERISTIC LC_INH_TQ_ADD_CH LC_INH_TQ_ADD C_TQ_ADD_MIN_CH C_TQ_ADD_HYS C_TQ_ADD_HYS_CRU C_TQ_ADD_MIN C_TQ_ADD_MIN_CRU /end DEF_CHARACTERISTIC
 /begin OUT_MEASUREMENT TQ_ADD_REQ_CH TQ_ADD_MAX TQ_ADD_REQ_MAX_TEG MAF_KGH_ADD_MAX MAF_ADD_MAX TQI_ADD_ACT EFF_IGA_MIN_ADD_MAX TQI_ADD_MAX LV_TQ_ADD_REQ TQ_ADD_ACT TQI_ADD_ACT_TMP_1 TQ_ADD_REQ TQI_ADD_ACT_TMP_2 TQI_ADD_ACT_TMP_3 TQI_ADD_MAX_TOL TQI_ADD_MAX_TEG LV_TQ_ADD_REQ_1 TQ_ADD_REQ_ACT LV_TQ_ADD_REQ_2 /end OUT_MEASUREMENT
/end FUNCTION
/begin FUNCTION TQM_Torque_Monitoring_Limitation "_Torque Monitoring Limitation and Coordination"
 /begin DEF_CHARACTERISTIC C_TQ_AD_ADD_S_SWI C_TQ_DIF_1 C_TQ_DIF_2 C_TQ_DIF_HYS_1 LC_TQ_INTV_ENA_AS C_TQ_DIF_HYS_2 LC_TQ_INTV_INH_AS C_TQ_DIF_HYS_IS_1 C_TQ_DIF_HYS_IS_2 LC_TQI_SP_MAN_ACT C_TQ_DIF_IS_1 C_TQ_DIF_IS_2 C_TQI_SP_MAN IP_MAF_SP /end DEF_CHARACTERISTIC
 /begin OUT_MEASUREMENT TQI_REQ_SLOW TQI_REQ_FAST TQI_REQ_FAST_CAN TQI_BAS_COR_CH TQI_SP TQI_SP_1 TQI_SP_2 TQI_SP_3 TQI_SP_MAF TQI_BAS_COR MAF_SP_TQI TQI_FAST TQI_SP_MAF_1 LV_TQ_INTV TQI_SP_MAF_2 LV_TQ_INTV_REQ TQI_SP_CAN TQI_FAST_CAN TQI_SP_1_CAN /end OUT_MEASUREMENT
/end FUNCTION
/begin FUNCTION TQM_Torque_based_anti_jerk_funct "_Torque based anti jerk function"
 /begin DEF_CHARACTERISTIC C_FIL_AJ_INP_0 C_FIL_AJ_INP_1 C_FIL_AJ_INP_2 C_FIL_AJ_OUT_1 C_FIL_AJ_OUT_2 ID_FAC_INV_VEH_MASS_AT ID_FAC_INV_VEH_MASS_MT ID_FAC_TQ_DE_AJ_AT ID_FAC_TQ_DE_AJ_MT C_N_DIF_REF_AJ_MAX C_N_DIF_REF_AJ_MIN IP_FAC_TQ_AJ C_T_PAS_AJ_DLY /end DEF_CHARACTERISTIC
 /begin OUT_MEASUREMENT N_DIF_AJ N_DIF_REF_LPF_AJ TQ_DIF_AJ TQ_FAST_CLU TQ_MDL_DE_AJ N_REF_AJ N_DIF_REF_AJ N_DIF_REF_AJ_INTER /end OUT_MEASUREMENT
/end FUNCTION
/begin FUNCTION TQM_Basic__actual_and_minimum_la "_Basic, actual and minimum lambda efficiency" /begin DEF_CHARACTERISTIC IP_LAMB_REF_ADD IP_LAMB_REF IP_EFF_LAMB__LAMB_DIF /end DEF_CHARACTERISTIC
 /begin OUT_MEASUREMENT EFF_LAMB_BAS_COR LAMB_REF_COR LAMB_DIF_BAS LAMB_DIF_AV LAMB_REF_ADD_TCO LAMB_DIF_MAX EFF_LAMB_AV EFF_LAMB_MIN EFF_LAMB_SP_BAS LAMB_REF LAMB_DIF_SP_BAS /end OUT_MEASUREMENT
/end FUNCTION
/begin FUNCTION TQM_Pedal_value_interpretation "_Pedal value interpretation"
 /begin DEF_CHARACTERISTIC IP_FAC_TQ_REQ_DRIV_RNG_L IP_FAC_TQ_REQ_DRIV C_PV_AV_SOF_MIN C_FAC_TQ_REQ_DRIV_SOF_MAX C_PV_AV_GRD_SOF_MAX C_T_PV_AV_GRD_SOF_MAX LC_RNG_L_MAN_AS /end DEF_CHARACTERISTIC
 /begin OUT_MEASUREMENT FAC_TQ_REQ_DRIV LV_RNG_L_REQ /end OUT_MEASUREMENT
/end FUNCTION
/begin FUNCTION TQM_Maximum_torque_at_clutch "_Maximum torque at clutch" /begin DEF_CHARACTERISTIC C_TQI_FAC_FL /end DEF_CHARACTERISTIC /begin OUT_MEASUREMENT MAF_MAX_COR TQI_REF_MAX TQ_MAX_CLU TQI_MAX /end OUT_MEASUREMENT /end FUNCTION
/begin FUNCTION TQM_Characteristic_quantity_stra "_Characteristic quantity stratified mode" /end FUNCTION
/begin FUNCTION TQM_Reference_and_basic_torque_f "_Reference and basic torque for stratified mode" /begin DEF_CHARACTERISTIC IP_TQI_REF_S /end DEF_CHARACTERISTIC /begin OUT_MEASUREMENT TQI_REF_S /end OUT_MEASUREMENT /end FUNCTION
/begin FUNCTION TQM_Torque_Request_at_Clutch_Gen "_Torque Request at Clutch General"
 /begin OUT_MEASUREMENT FAC_TQ_REQ_CLU LV_TQ_CRU_ACT TQ_REQ_CLU TQI_MIN_REQ FAC_TQ_REQ /end OUT_MEASUREMENT
/end FUNCTION
/begin FUNCTION TQM_Minimum_Maximum_Torque_Reque "_Minimum/Maximum Torque Request Selection"
 /begin OUT_MEASUREMENT LV_TQ_INC TQI_EMS TQI_REQ_FAST_DEC TQI_INTER_FAST TQI_REQ_FAST_INC TQI_INTER_SLOW TQI_REQ_SLOW_SEL TQI_REQ_FAST_SEL TQI_REQ_FAST_SEL_CAN /end OUT_MEASUREMENT
/end FUNCTION
/begin FUNCTION TQM_Torque_setpoint_for_stratifi "_Torque setpoint for stratified mode" /begin OUT_MEASUREMENT TQI_SP_S /end OUT_MEASUREMENT /end FUNCTION
/begin FUNCTION TQM_Actual_Engine_Torque "_Actual Engine Torque" /begin DEF_CHARACTERISTIC C_FAC_TQE /end DEF_CHARACTERISTIC /begin OUT_MEASUREMENT TQI_AV_HOM TQ_AV TQE TQI_AV TQE_DIF EFF_TOT_AV /end OUT_MEASUREMENT /end FUNCTION
/begin FUNCTION TQM_Actual_indicated_engine_torq "_Actual indicated engine torque for stratified" /begin OUT_MEASUREMENT TQI_AV_S EFF_TOT_AV_S /end OUT_MEASUREMENT /end FUNCTION
/begin FUNCTION TQM_Characteristic_quantity_homo "_Characteristic quantity homogeneous mode" /end FUNCTION
/begin FUNCTION TQM_Engine_torque_limitation "_Engine torque limitation"
 /begin DEF_CHARACTERISTIC IP_TQ_LIM_AMT IP_TQ_LIM_AT C_T_TQ_LIM LC_TQI_P_MAX_INH_AS ID_TQ_P_MAX_MT ID_TQ_P_MAX_AT /end DEF_CHARACTERISTIC
/end FUNCTION
/begin FUNCTION TQM_Torque_Request_for_Cruise_Co "_Torque Request for Cruise Control" /begin DEF_CHARACTERISTIC C_LGRD_TQ_CRU_INC_1 C_LGRD_TQ_CRU_INC_2 /end DEF_CHARACTERISTIC
 /begin OUT_MEASUREMENT FAC_TQ_REQ_CRU FAC_TQ_REQ_DCC STATE_TQ_DCC LV_TQ_DCC_ACT TQ_DELTA_MAX_CLU /end OUT_MEASUREMENT
/end FUNCTION
/begin FUNCTION TQM_Torque_Request_for_safety "_Torque Request for safety"
 /begin DEF_CHARACTERISTIC LC_TQ_LIM_INH LC_TQ_LIM_INH_FAST LC_TQ_LIM_INH_SLOW C_TQI_REQ_LIM_PAS C_TQ_LIM_INC C_TQ_LIM_DEC C_T_TQ_LIM_INTV IP_TQI_DIF_LIM /end DEF_CHARACTERISTIC
 /begin OUT_MEASUREMENT T_TQ_LIM_INTV SUM_TQI_REQ_LIM TQI_REQ_LIM_4 TQI_REQ_LIM_SLOW TQI_REQ_LIM_3 LV_TQ_LIM_INTV TQI_REQ_LIM_1 TQI_REQ_LIM_2 TQI_DIF_LIM T_TQI_REQ_LIM T_TQI_REQ_LIM_MAX TQI_REQ_LIM_FAST TQI_REQ_LIM_DIF TQI_REQ_LIM_DIF_MAX LV_TQ_LIM_INTV_1 LV_TQ_LIM_INTV_2 /end OUT_MEASUREMENT
/end FUNCTION
/begin FUNCTION TQM_Torque_based_lambda_setpoint "_Torque based lambda setpoint calculation"
 /begin DEF_CHARACTERISTIC IP_LAMB_DIF_SP C_EFF_LAMB_SP_MAX LC_TQ_LAMB_INH_MAN LC_TQ_LAMB_ENA_MAN /end DEF_CHARACTERISTIC
 /begin OUT_MEASUREMENT LAMB_SP_TQI LV_TQ_LAMB_ACT EFF_LAMB_SP EFF_LAMB_SP_1 TQI_FAST_LAMB LAMB_DIF_SP /end OUT_MEASUREMENT
/end FUNCTION
/begin FUNCTION TQM_Dynamic_torque_intervention_ "_Dynamic torque intervention manager" /begin DEF_CHARACTERISTIC C_TQ_DELTA_ECO_MOD C_TQ_DELTA_MAX_COMP C_STATE_TQ_DYN_LAMB /end DEF_CHARACTERISTIC
 /begin OUT_MEASUREMENT LV_TQ_FAST_ENA LV_TQ_IGA_ENA STATE_TQ_DYN_IGA LV_LAMB_TQ_CTL LV_TQ_LAMB_INH LV_TQ_LAMB_ENA TQI_REQ_FAST_DTM TQI_REQ_FAST_DTM_CAN TQI_REQ_SLOW_DTM STATE_TQ_DYN_LAMB /end OUT_MEASUREMENT
/end FUNCTION
/begin FUNCTION TQM_Torque_loss_for_power_steeri "_Torque loss for power steering"
 /begin DEF_CHARACTERISTIC LC_PSTE_ENA IP_TQ_LOSS_PSTE IP_TQ_ADD_PSTE IP_FAC_TQ_LOSS_PSTE /end DEF_CHARACTERISTIC
 /begin OUT_MEASUREMENT TQ_LOSS_PSTE LV_PSTE_DISABLE LV_PSTE_DISABLE_CAN LV_PSTE_ENA TQ_ADD_PSTE /end OUT_MEASUREMENT
/end FUNCTION
/begin FUNCTION TQM_Appl_IncTorque_loss_and_rese "_Appl IncTorque loss and reserve for ACC" /end FUNCTION
/begin FUNCTION TQM_Application_incidences_for_t "_Application incidences for torque based pattern calculation"
 /begin DEF_CHARACTERISTIC C_MAF_DIF_MIN_FCUT_FAST C_T_MAX_FCUT_FAST C_TCO_MIN_FCUT_FAST /end DEF_CHARACTERISTIC
 /begin OUT_MEASUREMENT LV_CS_CHG LV_FCUT_FAST LV_CT_CHG /end OUT_MEASUREMENT
/end FUNCTION
/begin FUNCTION TQM_Torque_Reserve_for_Torque_Tr "_Torque Reserve for Torque Transient" /begin DEF_CHARACTERISTIC IP_TQ_ADD_TRA__N_32 IP_FAC_TQ_TRA__TQ_REQ_DIF_TRA /end DEF_CHARACTERISTIC /begin OUT_MEASUREMENT TQ_ADD_TRA_1 TQ_ADD_TRA_2 FAC_TQ_TRA TQ_ADD_TRA /end OUT_MEASUREMENT /end FUNCTION
/begin FUNCTION TQM_Dynamic_Torque_request_coord "_Dynamic Torque request coordination"
 /begin DEF_CHARACTERISTIC LC_TQ_DYN_DRIV LC_TQ_DYN_DRIV_INH LC_TQ_DYN_REQ_MAN LC_TQ_DYN_0_REQ LC_TQ_DYN_1_REQ C_VS_MIN_DT_FAST C_VS_MAX_FAST /end DEF_CHARACTERISTIC
 /begin OUT_MEASUREMENT LV_TQ_DYN_1_REQ LV_TQ_DYN_0_DRIV LV_TQ_DYN_1_DRIV LV_TQ_DYN_DRIV LV_TQ_DYN_0_REQ /end OUT_MEASUREMENT
/end FUNCTION
/begin FUNCTION TQM_Separation_for_slow_and_fast "_Separation for slow and fast path torque request"
 /begin DEF_CHARACTERISTIC C_FAC_DYN_DRIV_CT C_FAC_DYN_DRIV LC_TQI_REQ_TRA_SLOW_SEL LC_TQI_REQ_TRA_FAST_TRAN_INH C_FAC_TQI_REQ_TRA_HPF C_FAC_TQI_REQ_TRA_SLOW /end DEF_CHARACTERISTIC
 /begin OUT_MEASUREMENT TQI_REQ_TRA_SLOW TQ_REQ_TRA_SLOW TQ_REQ_TRA_FAST TQI_REQ_TRA_FAST TQI_REQ_TRA_1 TQI_REQ_DRIV FAC_DYN_DRIV /end OUT_MEASUREMENT
/end FUNCTION
/end MODULE
/end PROJECT
