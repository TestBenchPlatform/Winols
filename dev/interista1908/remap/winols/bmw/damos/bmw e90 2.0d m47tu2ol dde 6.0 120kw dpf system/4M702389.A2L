ASAP2_VERSION 1 3
/begin PROJECT P389 "BMW DDE6.0 4-Zylinder V70.2 30.03.2004"
/begin HEADER "" VERSION "V70.2_4Z" PROJECT_NO P389 /end HEADER
/begin MODULE DIM ""
/begin MOD_COMMON "" BYTE_ORDER MSB_FIRST ALIGNMENT_BYTE 1 ALIGNMENT_WORD 2 ALIGNMENT_LONG 4 ALIGNMENT_FLOAT32_IEEE 4 /end MOD_COMMON
/begin CHARACTERISTIC Dmd_gen_C "" VALUE 0xE4BEC Kw_Ws16 65535.00 OneToOne -32768.00 32767.00 FORMAT "%8.2" /end CHARACTERISTIC
/begin AXIS_PTS InjVCD_pRailZFCETCor_AXIS "gemeinsame Raildruck-Achse fuer ZFC Ansteuerdauerkorrektur-Kennfelder" 0xE3604 RailCD_pAct_mp GSst_Xs16 600000.0 Pres_Rail 6 200000.0 800000.0 FORMAT "%8.1" EXTENDED_LIMITS -3276800. 3276700. DEPOSIT ABSOLUTE /end AXIS_PTS
/begin AXIS_PTS InjVCD_qZFCETCor_AXIS "Stuetzstellen der Menge fuer Korrekturfaktor-Gruppenkennfelder der Ansteuerdauerkorrektur der Nullmengenkalibrierung" 0xE3612 InjVCD_qInZFCETGMap_mp GSst_Xs16 3.000000 InjMassInj 6 0.00 3.000000 FORMAT "%8.6" EXTENDED_LIMITS -327.6800 327.6700 DEPOSIT ABSOLUTE /end AXIS_PTS
/begin CHARACTERISTIC InjVCD_rZFCETDif0_GMAP "Gruppenkennfeld Bewertungsfaktor fuer Ansteuerdauerkorrektur durch Nullmengenkalibrierung am Raildruck-Kalibrierpunkt 0" MAP 0xE3620 Gkf_Ws16 100.0000 Prc 0.00 100.0000 FORMAT "%8.4" EXTENDED_LIMITS -400.0000 399.9878
 /begin AXIS_DESCR COM_AXIS RailCD_pAct_mp Pres_Rail 6 200.0000 2000.0000 FORMAT "%5.4" EXTENDED_LIMITS -3276.8000 3276.7000 AXIS_PTS_REF InjVCD_pRailZFCETCor_AXIS /end AXIS_DESCR
 /begin AXIS_DESCR COM_AXIS InjVCD_qInZFCETGMap_mp InjMassInj 6 0.00 3.000000 FORMAT "%8.6" EXTENDED_LIMITS -327.6800 327.6700 AXIS_PTS_REF InjVCD_qZFCETCor_AXIS /end AXIS_DESCR
/end CHARACTERISTIC
/begin CHARACTERISTIC InjVCD_rZFCETDif1_GMAP "Gruppenkennfeld Bewertungsfaktor fuer Ansteuerdauerkorrektur durch Nullmengenkalibrierung am Raildruck-Kalibrierpunkt 1" MAP 0xE3668 Gkf_Ws16 100.0000 Prc 0.00 100.0000 FORMAT "%8.4" EXTENDED_LIMITS -400.0000 399.9878
 /begin AXIS_DESCR COM_AXIS RailCD_pAct_mp Pres_Rail 6 200.0000 2000.0000 FORMAT "%5.4" EXTENDED_LIMITS -3276.8000 3276.7000 AXIS_PTS_REF InjVCD_pRailZFCETCor_AXIS /end AXIS_DESCR
 /begin AXIS_DESCR COM_AXIS InjVCD_qInZFCETGMap_mp InjMassInj 6 0.00 3.000000 FORMAT "%8.6" EXTENDED_LIMITS -327.6800 327.6700 AXIS_PTS_REF InjVCD_qZFCETCor_AXIS /end AXIS_DESCR
/end CHARACTERISTIC
/begin CHARACTERISTIC InjVCD_rZFCETDif2_GMAP "#SSD Gruppenkennfeld Bewertungsfaktor fuer Ansteuerdauerkorrektur durch Nullmengenkalibrierung am Raildruck-Kalibrierpunkt 2" MAP 0xE36B0 Gkf_Ws16 100.0000 Prc 0.00 100.0000 FORMAT "%8.4" EXTENDED_LIMITS -400.0000 399.9878
 /begin AXIS_DESCR COM_AXIS RailCD_pAct_mp Pres_Rail 6 200.0000 2000.0000 FORMAT "%5.4" EXTENDED_LIMITS -3276.8000 3276.7000 AXIS_PTS_REF InjVCD_pRailZFCETCor_AXIS /end AXIS_DESCR
 /begin AXIS_DESCR COM_AXIS InjVCD_qInZFCETGMap_mp InjMassInj 6 0.00 3.000000 FORMAT "%8.6" EXTENDED_LIMITS -327.6800 327.6700 AXIS_PTS_REF InjVCD_qZFCETCor_AXIS /end AXIS_DESCR
/end CHARACTERISTIC
/begin CHARACTERISTIC InjVCD_rZFCETMsk_GMAP "Gruppenkennfeld Gesamtbewertungsfaktor der Ansteuerdauerkorrektur durch Nullmengenkalibrierung" MAP 0xE36F8 Gkf_Ws16 100.0000 Prc 0.00 100.0000 FORMAT "%8.4" EXTENDED_LIMITS -400.0000 399.9878
 /begin AXIS_DESCR COM_AXIS RailCD_pAct_mp Pres_Rail 6 200.0000 2000.0000 FORMAT "%5.4" EXTENDED_LIMITS -3276.8000 3276.7000 AXIS_PTS_REF InjVCD_pRailZFCETCor_AXIS /end AXIS_DESCR
 /begin AXIS_DESCR COM_AXIS InjVCD_qInZFCETGMap_mp InjMassInj 6 0.00 3.000000 FORMAT "%8.6" EXTENDED_LIMITS -327.6800 327.6700 AXIS_PTS_REF InjVCD_qZFCETCor_AXIS /end AXIS_DESCR
/end CHARACTERISTIC
/begin CHARACTERISTIC InjVCD_stInputZFCETGMap_C "Auswahl der Menge fuer Anzeige der Gruppenkennfelder InjVCD_rZFCETDif0_GMAP, ...Dif1_GMAP, ...Msk_GMAP" VALUE 0xE3740 Kw_Wu8 255.0 OneToOne 0.00 255.0 FORMAT "%5.1" /end CHARACTERISTIC
/begin CHARACTERISTIC InjVCD_stZFCETCorActv_C "Aktivierungsstatus der ZFC Ansteuerdauerkorrektur (0 = keine Korrektur)" VALUE 0xE3741 Kw_Wu8 0.00 OneToOne 0.00 0.00 FORMAT "%5.2" EXTENDED_LIMITS 0.00 255.0 /end CHARACTERISTIC
/begin CHARACTERISTIC InjVCD_swtZFCCorOvrRunOn_C "Schalter zum Einschalten der ZFC-Korrektur bei aktiver Schubüberwachung (1= Korrektur auch bei aktiver Schubüberwachung)" VALUE 0xE3742 Kw_Wu8 0.00 OneToOne 0.00 0.00 FORMAT "%5.2" EXTENDED_LIMITS 0.00 255.0 /end CHARACTERISTIC
/begin CHARACTERISTIC InjVCD_tiZFCETCorMax_C "maximale ZFC Ansteuerdauerkorrektur" VALUE 0xE3744 Kw_Ws16 5300.0000 InjTime_us -300.0000 5000.0000 FORMAT "%8.4" EXTENDED_LIMITS -32768.00 32767.00 /end CHARACTERISTIC
/begin CHARACTERISTIC InjVCD_tiZFCETCorMin_C "minimale ZFC Ansteuerdauerkorrektur" VALUE 0xE3746 Kw_Ws16 5300.0000 InjTime_us -300.0000 5000.0000 FORMAT "%8.4" EXTENDED_LIMITS -32768.00 32767.00 /end CHARACTERISTIC
/begin CHARACTERISTIC InjVlv_DebBnkA0Def_C "#SSD Defektentprellung für A Bankfehlerpfade Bit 0" VALUE 0xE3780 Kw_Wu16 65534.00 OneToOne 1.000000 65535.00 FORMAT "%8.2" EXTENDED_LIMITS 0.00 65535.00 /end CHARACTERISTIC
/begin CHARACTERISTIC InjVlv_DebBnkA0Ok_C "#SSD Heilungsentprellung für A Bankfehlerpfade Bit 0" VALUE 0xE3782 Kw_Wu16 65535.00 OneToOne 0.00 65535.00 FORMAT "%8.2" /end CHARACTERISTIC
/begin CHARACTERISTIC InjVlv_DebBnkA1Def_C "#SSD Defektentprellung für A Bankfehlerpfade Bit 1" VALUE 0xE3784 Kw_Wu16 65534.00 OneToOne 1.000000 65535.00 FORMAT "%8.2" EXTENDED_LIMITS 0.00 65535.00 /end CHARACTERISTIC
/begin CHARACTERISTIC InjVlv_DebBnkA1Ok_C "#SSD Heilungsentprellung für A Bankfehlerpfade Bit 1" VALUE 0xE3786 Kw_Wu16 65535.00 OneToOne 0.00 65535.00 FORMAT "%8.2" /end CHARACTERISTIC
/begin CHARACTERISTIC InjVlv_DebBnkA2Def_C "#SSD Defektentprellung für A Bankfehlerpfade Bit 2" VALUE 0xE3788 Kw_Wu16 65534.00 OneToOne 1.000000 65535.00 FORMAT "%8.2" EXTENDED_LIMITS 0.00 65535.00 /end CHARACTERISTIC
/begin CHARACTERISTIC InjVlv_DebBnkA2Ok_C "#SSD Heilungsentprellung für A Bankfehlerpfade Bit 2" VALUE 0xE378A Kw_Wu16 65535.00 OneToOne 0.00 65535.00 FORMAT "%8.2" /end CHARACTERISTIC
/begin CHARACTERISTIC InjVlv_DebBnkA3Def_C "#SSD Defektentprellung für A Bankfehlerpfade Bit 3" VALUE 0xE378C Kw_Wu16 65534.00 OneToOne 1.000000 65535.00 FORMAT "%8.2" EXTENDED_LIMITS 0.00 65535.00 /end CHARACTERISTIC
/begin CHARACTERISTIC InjVlv_DebBnkA3Ok_C "#SSD Heilungsentprellung für A Bankfehlerpfade Bit 3" VALUE 0xE378E Kw_Wu16 65535.00 OneToOne 0.00 65535.00 FORMAT "%8.2" /end CHARACTERISTIC
/begin CHARACTERISTIC InjVlv_DebBnkB0Def_C "#SSD Defektentprellung für B Bankfehlerpfade Bit 0" VALUE 0xE3790 Kw_Wu16 65534.00 OneToOne 1.000000 65535.00 FORMAT "%8.2" EXTENDED_LIMITS 0.00 65535.00 /end CHARACTERISTIC
/begin CHARACTERISTIC InjVlv_DebBnkB0Ok_C "#SSD Heilungsentprellung für B Bankfehlerpfade Bit 0" VALUE 0xE3792 Kw_Wu16 65535.00 OneToOne 0.00 65535.00 FORMAT "%8.2" /end CHARACTERISTIC
/begin CHARACTERISTIC InjVlv_DebBnkB1Def_C "#SSD Defektentprellung für B Bankfehlerpfade Bit 1" VALUE 0xE3794 Kw_Wu16 65534.00 OneToOne 1.000000 65535.00 FORMAT "%8.2" EXTENDED_LIMITS 0.00 65535.00 /end CHARACTERISTIC
/begin CHARACTERISTIC InjVlv_DebBnkB1Ok_C "#SSD Heilungsentprellung für B Bankfehlerpfade Bit 1" VALUE 0xE3796 Kw_Wu16 65535.00 OneToOne 0.00 65535.00 FORMAT "%8.2" /end CHARACTERISTIC
/begin CHARACTERISTIC InjVlv_DebBnkB2Def_C "#SSD Defektentprellung für B Bankfehlerpfade Bit 2" VALUE 0xE3798 Kw_Wu16 65534.00 OneToOne 1.000000 65535.00 FORMAT "%8.2" EXTENDED_LIMITS 0.00 65535.00 /end CHARACTERISTIC
/begin CHARACTERISTIC InjVlv_DebBnkB2Ok_C "#SSD Heilungsentprellung für B Bankfehlerpfade Bit 2" VALUE 0xE379A Kw_Wu16 65535.00 OneToOne 0.00 65535.00 FORMAT "%8.2" /end CHARACTERISTIC
/begin CHARACTERISTIC InjVlv_DebBnkB3Def_C "#SSD Defektentprellung für B Bankfehlerpfade Bit 3" VALUE 0xE379C Kw_Wu16 65534.00 OneToOne 1.000000 65535.00 FORMAT "%8.2" EXTENDED_LIMITS 0.00 65535.00 /end CHARACTERISTIC
/begin CHARACTERISTIC InjVlv_DebBnkB3Ok_C "#SSD Heilungsentprellung für B Bankfehlerpfade Bit 3" VALUE 0xE379E Kw_Wu16 65535.00 OneToOne 0.00 65535.00 FORMAT "%8.2" /end CHARACTERISTIC
/begin CHARACTERISTIC InjVlv_DebChipA0Def_C "#SSD Defektentprellung für  A Bausteinfehlerpfade Bit 0" VALUE 0xE37A0 Kw_Wu16 65534.00 OneToOne 1.000000 65535.00 FORMAT "%8.2" EXTENDED_LIMITS 0.00 65535.00 /end CHARACTERISTIC
/begin CHARACTERISTIC InjVlv_DebChipA0Ok_C "#SSD Heilungsentprellung für  A Bausteinfehlerpfade Bit 0" VALUE 0xE37A2 Kw_Wu16 65535.00 OneToOne 0.00 65535.00 FORMAT "%8.2" /end CHARACTERISTIC
/begin CHARACTERISTIC InjVlv_DebChipA1Def_C "#SSD Defektentprellung für  A Bausteinfehlerpfade Bit 1" VALUE 0xE37A4 Kw_Wu16 65534.00 OneToOne 1.000000 65535.00 FORMAT "%8.2" EXTENDED_LIMITS 0.00 65535.00 /end CHARACTERISTIC
/begin CHARACTERISTIC InjVlv_DebChipA1Ok_C "#SSD Heilungsentprellung für  A Bausteinfehlerpfade Bit 1" VALUE 0xE37A6 Kw_Wu16 65535.00 OneToOne 0.00 65535.00 FORMAT "%8.2" /end CHARACTERISTIC
/begin CHARACTERISTIC InjVlv_DebChipA2Def_C "#SSD Defektentprellung für  A Bausteinfehlerpfade Bit 2" VALUE 0xE37A8 Kw_Wu16 65534.00 OneToOne 1.000000 65535.00 FORMAT "%8.2" EXTENDED_LIMITS 0.00 65535.00 /end CHARACTERISTIC
/begin CHARACTERISTIC InjVlv_DebChipA2Ok_C "#SSD Heilungsentprellung für  A Bausteinfehlerpfade Bit 2" VALUE 0xE37AA Kw_Wu16 65535.00 OneToOne 0.00 65535.00 FORMAT "%8.2" /end CHARACTERISTIC
/begin CHARACTERISTIC InjVlv_DebChipA3Def_C "#SSD Defektentprellung für  A Bausteinfehlerpfade Bit 3" VALUE 0xE37AC Kw_Wu16 65534.00 OneToOne 1.000000 65535.00 FORMAT "%8.2" EXTENDED_LIMITS 0.00 65535.00 /end CHARACTERISTIC
/begin CHARACTERISTIC InjVlv_DebChipA3Ok_C "#SSD Heilungsentprellung für  A Bausteinfehlerpfade Bit 3" VALUE 0xE37AE Kw_Wu16 65535.00 OneToOne 0.00 65535.00 FORMAT "%8.2" /end CHARACTERISTIC
/begin CHARACTERISTIC InjVlv_DebChipB0Def_C "#SSD Defektentprellung für  B Bausteinfehlerpfade Bit 0" VALUE 0xE37B0 Kw_Wu16 65534.00 OneToOne 1.000000 65535.00 FORMAT "%8.2" EXTENDED_LIMITS 0.00 65535.00 /end CHARACTERISTIC
/begin CHARACTERISTIC InjVlv_DebChipB0Ok_C "#SSD Heilungsentprellung für  B Bausteinfehlerpfade Bit 0" VALUE 0xE37B2 Kw_Wu16 65535.00 OneToOne 0.00 65535.00 FORMAT "%8.2" /end CHARACTERISTIC
/begin CHARACTERISTIC InjVlv_DebChipB1Def_C "#SSD Defektentprellung für  B Bausteinfehlerpfade Bit 1" VALUE 0xE37B4 Kw_Wu16 65534.00 OneToOne 1.000000 65535.00 FORMAT "%8.2" EXTENDED_LIMITS 0.00 65535.00 /end CHARACTERISTIC
/begin CHARACTERISTIC InjVlv_DebChipB1Ok_C "#SSD Heilungsentprellung für  B Bausteinfehlerpfade Bit 1" VALUE 0xE37B6 Kw_Wu16 65535.00 OneToOne 0.00 65535.00 FORMAT "%8.2" /end CHARACTERISTIC
/begin CHARACTERISTIC InjVlv_DebChipB2Def_C "#SSD Defektentprellung für  B Bausteinfehlerpfade Bit 2" VALUE 0xE37B8 Kw_Wu16 65534.00 OneToOne 1.000000 65535.00 FORMAT "%8.2" EXTENDED_LIMITS 0.00 65535.00 /end CHARACTERISTIC
/begin CHARACTERISTIC InjVlv_DebChipB2Ok_C "#SSD Heilungsentprellung für  B Bausteinfehlerpfade Bit 2" VALUE 0xE37BA Kw_Wu16 65535.00 OneToOne 0.00 65535.00 FORMAT "%8.2" /end CHARACTERISTIC
/begin CHARACTERISTIC InjVlv_DebChipB3Def_C "#SSD Defektentprellung für  B Bausteinfehlerpfade Bit 3" VALUE 0xE37BC Kw_Wu16 65534.00 OneToOne 1.000000 65535.00 FORMAT "%8.2" EXTENDED_LIMITS 0.00 65535.00 /end CHARACTERISTIC
/begin CHARACTERISTIC InjVlv_DebChipB3Ok_C "#SSD Heilungsentprellung für  B Bausteinfehlerpfade Bit 3" VALUE 0xE37BE Kw_Wu16 65535.00 OneToOne 0.00 65535.00 FORMAT "%8.2" /end CHARACTERISTIC
/begin CHARACTERISTIC InjVlv_DebCylA0Def_C "#SSD Defektentprellung für A Zylinderfehlerpfade Bit 0" VALUE 0xE37C0 Kw_Wu16 65534.00 OneToOne 1.000000 65535.00 FORMAT "%8.2" EXTENDED_LIMITS 0.00 65535.00 /end CHARACTERISTIC
/begin CHARACTERISTIC InjVlv_DebCylA0Ok_C "#SSD Heilungsentprellung für A Zylinderfehlerpfade Bit 0" VALUE 0xE37C2 Kw_Wu16 65535.00 OneToOne 0.00 65535.00 FORMAT "%8.2" /end CHARACTERISTIC
/begin CHARACTERISTIC InjVlv_DebCylA1Def_C "#SSD Defektentprellung für A Zylinderfehlerpfade Bit 1" VALUE 0xE37C4 Kw_Wu16 65534.00 OneToOne 1.000000 65535.00 FORMAT "%8.2" EXTENDED_LIMITS 0.00 65535.00 /end CHARACTERISTIC
/begin CHARACTERISTIC InjVlv_DebCylA1Ok_C "#SSD Heilungsentprellung für A Zylinderfehlerpfade Bit 1" VALUE 0xE37C6 Kw_Wu16 65535.00 OneToOne 0.00 65535.00 FORMAT "%8.2" /end CHARACTERISTIC
/begin CHARACTERISTIC InjVlv_DebCylA2Def_C "#SSD Defektentprellung für A Zylinderfehlerpfade Bit 2" VALUE 0xE37C8 Kw_Wu16 65534.00 OneToOne 1.000000 65535.00 FORMAT "%8.2" EXTENDED_LIMITS 0.00 65535.00 /end CHARACTERISTIC
/begin CHARACTERISTIC InjVlv_DebCylA2Ok_C "#SSD Heilungsentprellung für A Zylinderfehlerpfade Bit 2" VALUE 0xE37CA Kw_Wu16 65535.00 OneToOne 0.00 65535.00 FORMAT "%8.2" /end CHARACTERISTIC
/begin CHARACTERISTIC InjVlv_DebCylA3Def_C "#SSD Defektentprellung für A Zylinderfehlerpfade Bit 3" VALUE 0xE37CC Kw_Wu16 65534.00 OneToOne 1.000000 65535.00 FORMAT "%8.2" EXTENDED_LIMITS 0.00 65535.00 /end CHARACTERISTIC
/begin CHARACTERISTIC InjVlv_DebCylA3Ok_C "#SSD Heilungsentprellung für A Zylinderfehlerpfade Bit 3" VALUE 0xE37CE Kw_Wu16 65535.00 OneToOne 0.00 65535.00 FORMAT "%8.2" /end CHARACTERISTIC
/begin CHARACTERISTIC InjVlv_DebCylB0Def_C "#SSD Defektentprellung für B Zylinderfehlerpfade Bit 0" VALUE 0xE37D0 Kw_Wu16 65534.00 OneToOne 1.000000 65535.00 FORMAT "%8.2" EXTENDED_LIMITS 0.00 65535.00 /end CHARACTERISTIC
/begin CHARACTERISTIC InjVlv_DebCylB0Ok_C "#SSD Heilungsentprellung für B Zylinderfehlerpfade Bit 0" VALUE 0xE37D2 Kw_Wu16 65535.00 OneToOne 0.00 65535.00 FORMAT "%8.2" /end CHARACTERISTIC
/begin CHARACTERISTIC InjVlv_DebCylB1Def_C "#SSD Defektentprellung für B Zylinderfehlerpfade Bit 1" VALUE 0xE37D4 Kw_Wu16 65534.00 OneToOne 1.000000 65535.00 FORMAT "%8.2" EXTENDED_LIMITS 0.00 65535.00 /end CHARACTERISTIC
/begin CHARACTERISTIC InjVlv_DebCylB1Ok_C "#SSD Heilungsentprellung für B Zylinderfehlerpfade Bit 1" VALUE 0xE37D6 Kw_Wu16 65535.00 OneToOne 0.00 65535.00 FORMAT "%8.2" /end CHARACTERISTIC
/begin CHARACTERISTIC InjVlv_DebCylB2Def_C "#SSD Defektentprellung für B Zylinderfehlerpfade Bit 2" VALUE 0xE37D8 Kw_Wu16 65534.00 OneToOne 1.000000 65535.00 FORMAT "%8.2" EXTENDED_LIMITS 0.00 65535.00 /end CHARACTERISTIC
/begin CHARACTERISTIC InjVlv_DebCylB2Ok_C "#SSD Heilungsentprellung für B Zylinderfehlerpfade Bit 2" VALUE 0xE37DA Kw_Wu16 65535.00 OneToOne 0.00 65535.00 FORMAT "%8.2" /end CHARACTERISTIC
/begin CHARACTERISTIC InjVlv_DebCylB3Def_C "#SSD Defektentprellung für B Zylinderfehlerpfade Bit 3" VALUE 0xE37DC Kw_Wu16 65534.00 OneToOne 1.000000 65535.00 FORMAT "%8.2" EXTENDED_LIMITS 0.00 65535.00 /end CHARACTERISTIC
/begin CHARACTERISTIC InjVlv_DebCylB3Ok_C "#SSD Heilungsentprellung für B Zylinderfehlerpfade Bit 3" VALUE 0xE37DE Kw_Wu16 65535.00 OneToOne 0.00 65535.00 FORMAT "%8.2" /end CHARACTERISTIC
/begin CHARACTERISTIC InjVlv_facAddBalRls_MAP "Freigabekennfeld zur Aufrechnung der Mengenkorrektur" MAP 0xE3748 Kf_Xs16_Ys16_Ws16 1.000000 Fact 0.00 1.000000 FORMAT "%8.6" EXTENDED_LIMITS -4.000000 3.999878
 /begin AXIS_DESCR STD_AXIS RailCD_pPeak Pres_Rail 3 0.00 2000.000 FORMAT "%5.3" EXTENDED_LIMITS -3276.800 3276.700 DEPOSIT ABSOLUTE /end AXIS_DESCR
 /begin AXIS_DESCR STD_AXIS InjCtl_qSetUnBal InjMassCyc 2 0.00 327.6700 FORMAT "%8.4" EXTENDED_LIMITS -327.6800 327.6700 DEPOSIT ABSOLUTE /end AXIS_DESCR
/end CHARACTERISTIC
/begin CHARACTERISTIC InjVlv_facFTSWvCor_MAP "KF für die Berechnung des kraftstofftemperaturabhängigen Druckwellenkorrekturfaktors" MAP 0xE3CEA Kf_Xs16_Ys16_Ws16 2.000000 Fact 0.00 2.000000 FORMAT "%8.6" EXTENDED_LIMITS -4.000000 3.999878
 /begin AXIS_DESCR STD_AXIS RailCD_pPeak Pres_Rail 16 0.00 2000.000 FORMAT "%5.3" EXTENDED_LIMITS -3276.800 3276.700 DEPOSIT ABSOLUTE /end AXIS_DESCR
 /begin AXIS_DESCR STD_AXIS InjVlv_tWvCor_mp Temp_Cels 8 -50.1400 199.8600 FORMAT "%8.4" EXTENDED_LIMITS -3549.940 3003.560 DEPOSIT ABSOLUTE /end AXIS_DESCR
/end CHARACTERISTIC
/begin CHARACTERISTIC InjVlv_facPiI2WvCor_C "Gewichtungsfaktor der Druckwellenkorrekturmenge der MI1 abhängig von PiI2" VALUE 0xE40B6 Kw_Ws16 1.000000 Fact 0.00 1.000000 FORMAT "%8.6" EXTENDED_LIMITS -4.000000 3.999878 /end CHARACTERISTIC
/begin CHARACTERISTIC InjVlv_facWvCor1_MAP "KF 1 für Gewichtungsfaktor der Druckwellenkorrektur" MAP 0xE40B8 Kf_Xs16_Ys16_Ws16 10.00000 Fact1 0.00 10.00000 FORMAT "%8.5" EXTENDED_LIMITS -256.0000 255.9922
 /begin AXIS_DESCR STD_AXIS InjCrv_qMI1Des InjMassInj 8 0.00 327.6700 FORMAT "%8.4" EXTENDED_LIMITS -327.6800 327.6700 DEPOSIT ABSOLUTE /end AXIS_DESCR
 /begin AXIS_DESCR STD_AXIS RailCD_pAct_mp Pres_Rail 16 0.00 2000.000 FORMAT "%5.3" EXTENDED_LIMITS -3276.800 3276.700 DEPOSIT ABSOLUTE /end AXIS_DESCR
/end CHARACTERISTIC
/begin CHARACTERISTIC InjVlv_facWvCor2_MAP "KF 2 für Gewichtungsfaktor der Druckwellenkorrektur" MAP 0xE41EC Kf_Xs16_Ys16_Ws16 10.00000 Fact1 0.00 10.00000 FORMAT "%8.5" EXTENDED_LIMITS -256.0000 255.9922
 /begin AXIS_DESCR STD_AXIS InjCrv_qPoI2Des_mp InjMassInj 8 0.00 327.6700 FORMAT "%8.4" EXTENDED_LIMITS -327.6800 327.6700 DEPOSIT ABSOLUTE /end AXIS_DESCR
 /begin AXIS_DESCR STD_AXIS RailCD_pAct_mp Pres_Rail 16 0.00 2000.000 FORMAT "%5.3" EXTENDED_LIMITS -3276.800 3276.700 DEPOSIT ABSOLUTE /end AXIS_DESCR
/end CHARACTERISTIC
/begin CHARACTERISTIC InjVlv_numInjChrgBal_MAP "#SSD max. Anzahl an Einspritzungen aufgrund Ladungsbilanz Boosterkondensators" MAP 0xE3764 Kf_Xs16_Ys16_Ws16 6.000000 OneToOne 0.00 6.000000 FORMAT "%8.6" EXTENDED_LIMITS -32768.00 32767.00
 /begin AXIS_DESCR STD_AXIS Eng_nAvrg EngN 2 0.00 6000.000 FORMAT "%8.3" EXTENDED_LIMITS -32768.00 32767.00 DEPOSIT ABSOLUTE /end AXIS_DESCR
 /begin AXIS_DESCR STD_AXIS BattCD_u Volt_Batt 2 -640625.6 640606.1 FORMAT "%8.1" DEPOSIT ABSOLUTE /end AXIS_DESCR
/end CHARACTERISTIC
/begin CHARACTERISTIC InjVlv_numNoLoadCylMax_C "#SSD maximale zulässige Anzahl von Zylindern mit Lastabfall" VALUE 0xE37E0 Kw_Wu8 8.000 OneToOne 0.00 8.000 FORMAT "%5.3" EXTENDED_LIMITS 0.00 255.0 /end CHARACTERISTIC
/begin CHARACTERISTIC InjVlv_numSegOfs1_C "Semgentoffset für die Bestimmung der zylinderselektiven Drehzahlen für Testmodus a" VALUE 0xE377C Kw_Wu8 11.00 OneToOne 0.00 11.00 FORMAT "%5.2" EXTENDED_LIMITS 0.00 255.0 /end CHARACTERISTIC
/begin CHARACTERISTIC InjVlv_numSegOfs2_C "Semgentoffset für die Bestimmung der zylinderselektiven Drehzahlen für Testmodus b und c" VALUE 0xE377D Kw_Wu8 11.00 OneToOne 0.00 11.00 FORMAT "%5.2" EXTENDED_LIMITS 0.00 255.0 /end CHARACTERISTIC
/begin CHARACTERISTIC InjVlv_pMin_C "#SSD Injektorabhängige Druckschwelle zur Freigabe/Sperrung der Einspritzung" VALUE 0xE38E4 Kw_Ws16 2000.000 Pres_Rail 0.00 2000.000 FORMAT "%5.3" EXTENDED_LIMITS -3276.800 3276.700 /end CHARACTERISTIC
/begin CHARACTERISTIC InjVlv_pMin_CUR "#SSD Kühlmitteltemperaturabhängige Druckschwelle zur Freigabe der Einspritzungen" CURVE 0xE38E6 Kl_Xs16_Ws16 2000.000 Pres_Rail 0.00 2000.000 FORMAT "%5.3" EXTENDED_LIMITS -3276.800 3276.700
 /begin AXIS_DESCR STD_AXIS Eng_tEng Temp_Cels 8 -50.14000 199.8600 FORMAT "%8.4" EXTENDED_LIMITS -3549.940 3003.560 DEPOSIT ABSOLUTE /end AXIS_DESCR
/end CHARACTERISTIC
/begin CHARACTERISTIC InjVlv_qWvCor1_MAP "Grundwerte-KF 1 der Druckwellenkorrekturmenge" MAP 0xE4320 Kf_Xs16_Ys16_Ws16 655.3400 InjMassInj -327.6700 327.6700 FORMAT "%8.4" EXTENDED_LIMITS -327.6800 327.6700
 /begin AXIS_DESCR STD_AXIS InjVlv_tiPiI1MI1Cor_mp InjTime_us 32 0.00 13000.00 FORMAT "%8.2" EXTENDED_LIMITS -32768.00 32767.00 DEPOSIT ABSOLUTE /end AXIS_DESCR
 /begin AXIS_DESCR STD_AXIS InjCrv_qPiI1Des InjMassInj 16 0.00 327.6700 FORMAT "%8.4" EXTENDED_LIMITS -327.6800 327.6700 DEPOSIT ABSOLUTE /end AXIS_DESCR
/end CHARACTERISTIC
/begin CHARACTERISTIC InjVlv_qWvCor2_MAP "Grundwerte-KF 2 der Druckwellenkorrekturmenge" MAP 0xE4784 Kf_Xs16_Ys16_Ws16 655.3400 InjMassInj -327.6700 327.6700 FORMAT "%8.4" EXTENDED_LIMITS -327.6800 327.6700
 /begin AXIS_DESCR STD_AXIS InjVlv_tiMI1PoI2Cor_mp InjTime_us 32 0.00 13000.00 FORMAT "%8.2" EXTENDED_LIMITS -32768.00 32767.00 DEPOSIT ABSOLUTE /end AXIS_DESCR
 /begin AXIS_DESCR STD_AXIS InjVlv_rMI1WvCorNorm_mp QntR 16 0.0009765625 24.00000 FORMAT "%8.5" EXTENDED_LIMITS -32.00000 31.99902 DEPOSIT ABSOLUTE /end AXIS_DESCR
/end CHARACTERISTIC
/begin CHARACTERISTIC InjVlv_qWvCorMax_C "#SSD maximale Begrenzungsmenge der Druckwellenkorrektur" VALUE 0xE4BE8 Kw_Ws16 20.00000 InjMassInj -10.00000 10.00000 FORMAT "%8.5" EXTENDED_LIMITS -327.6800 327.6700 /end CHARACTERISTIC
/begin CHARACTERISTIC InjVlv_qWvCorMin_C "#SSD minimale Begrenzungsmenge der Druckwellenkorrektur" VALUE 0xE4BEA Kw_Ws16 20.00000 InjMassInj -10.00000 10.00000 FORMAT "%8.5" EXTENDED_LIMITS -327.6800 327.6700 /end CHARACTERISTIC
/begin CHARACTERISTIC InjVlv_qWvCorNorm_CUR "Kennlinie für die raildruckabhängige Einspritznormierungsmenge" CURVE 0xE3E1E Kl_Xs16_Ws16 327.6600 InjMassInj 0.01000000 327.6700 FORMAT "%8.4" EXTENDED_LIMITS -327.6800 327.6700
 /begin AXIS_DESCR STD_AXIS RailCD_pPeak Pres_Rail 20 0.00 2000.000 FORMAT "%5.3" EXTENDED_LIMITS -3276.800 3276.700 DEPOSIT ABSOLUTE /end AXIS_DESCR
/end CHARACTERISTIC
/begin CHARACTERISTIC InjVlv_rChrgBalEngSpdHys_C "#SSD Drehzahl Hystereseschwelle für die Auswahl der max. Anzahl an Einspritzungen aufgrund der Ladungsbilanz des Boosterkondensators" VALUE 0xE3778 Kw_Wu16 100.0000 Prc 0.00 100.0000 FORMAT "%8.4" EXTENDED_LIMITS 0.00 799.9878 /end CHARACTERISTIC
/begin CHARACTERISTIC InjVlv_rChrgBalVltgHys_C "#SSD Batteriespannungs Hystereseschwelle für Auswahl der max. Anzahl an Einspritzungen aufgrund Ladungsbilanz Boosterkondensators" VALUE 0xE377A Kw_Wu16 100.0000 Prc 0.00 100.0000 FORMAT "%8.4" EXTENDED_LIMITS 0.00 799.9878 /end CHARACTERISTIC
/begin CHARACTERISTIC InjVlv_stErrDet_C "Status der Injektorfehlererkennung" VALUE 0xE377E Kw_Wu8 1.000 OneToOne 0.00 1.000 FORMAT "%5.3" EXTENDED_LIMITS 0.00 255.0 /end CHARACTERISTIC
/begin CHARACTERISTIC InjVlv_stErrMskPattern_C "#SSD Pattern-Matrix zur Mustererkennung" VAL_BLK 0xE37E4 Kwb_Wu32 4294967295.00 OneToOne 0.00 4294967295.00 FORMAT "%13.2" NUMBER 32 /end CHARACTERISTIC
/begin CHARACTERISTIC InjVlv_stErrMskSelect_C "#SSD Select-Matrix zur Mustererkennung" VAL_BLK 0xE3864 Kwb_Wu32 4294967295.00 OneToOne 0.00 4294967295.00 FORMAT "%13.2" NUMBER 32 /end CHARACTERISTIC
/begin CHARACTERISTIC InjVlv_stInputAddBalMap_C "y-Eingang des Kennfelds InjVCD_facAddBalRls_MAP auf dem Applikationswerkzeug" VALUE 0xE3762 Kw_Wu8 255.0 OneToOne 0.00 255.0 FORMAT "%5.1" /end CHARACTERISTIC
/begin CHARACTERISTIC InjVlv_stQntAdjRepl_C "Ersatzwerte für Injektormengenabgleich" VAL_BLK 0xE3A70 Kwb_Wu32 4294967295.00 OneToOne 0.00 4294967295.00 FORMAT "%13.2" NUMBER 12 /end CHARACTERISTIC
/begin CHARACTERISTIC InjVlv_stQntAdj_MAP "Statuskennfeld (Index und Gewichtungsfaktor) für den Injektor-Mengenabgleich" MAP 0xE3908 Kf_Xs16_Ys16_Ws16 32767.00 OneToOne 0.00 32767.00 FORMAT "%8.2" EXTENDED_LIMITS -32768.00 32767.00
 /begin AXIS_DESCR STD_AXIS RailCD_pPeak Pres_Rail 10 0.00 2000.000 FORMAT "%5.3" EXTENDED_LIMITS -3276.800 3276.700 DEPOSIT ABSOLUTE /end AXIS_DESCR
 /begin AXIS_DESCR STD_AXIS InjUn_volMI1Cor_mp InjQntInj 10 0.00 100.0000 FORMAT "%8.4" EXTENDED_LIMITS -327.6800 327.6700 DEPOSIT ABSOLUTE /end AXIS_DESCR
/end CHARACTERISTIC
/begin CHARACTERISTIC InjVlv_stWvCorActv_C "Freigabe der Druckwellenkorrektur" VALUE 0xE3E70 Kw_Wu8 1.000 OneToOne 0.00 1.000 FORMAT "%5.3" EXTENDED_LIMITS 0.00 255.0 /end CHARACTERISTIC
/begin CHARACTERISTIC InjVlv_swtDiffHydInSel_C "Auswahl für Darstellung des Betriebspunktes im Kennfeld InjVlv_tiDiffHyd_MAP (1,2,3: Darstellung, sonst: keine Darstellung)" VALUE 0xE3AA4 Kw_Wu8 2.000 OneToOne 0.00 2.000 FORMAT "%5.3" EXTENDED_LIMITS 0.00 255.0 /end CHARACTERISTIC
/begin CHARACTERISTIC InjVlv_swtQntAdj_C "Schalter zum Ersetzen der Mengenabgleichwerte (0...EEPROM, 1...Ersatzwerte)" VALUE 0xE3AA0 Kw_Wu8 1.000 OneToOne 0.00 1.000 FORMAT "%5.3" EXTENDED_LIMITS 0.00 255.0 /end CHARACTERISTIC
/begin CHARACTERISTIC InjVlv_tiDiffHyd_MAP "Kennfeld mit Differenzzeiten zwischen hydraulischem Nadelschliessende und elektrischem Ansteuerende" MAP 0xE3AA6 Kf_Xs16_Ys16_Ws16 10000.00 InjTime_us -5000.000 5000.000 FORMAT "%8.3" EXTENDED_LIMITS -32768.00 32767.00
 /begin AXIS_DESCR STD_AXIS InjVlv_pActInDiffHyd_mp Pres_Rail 16 0.00 2000.000 FORMAT "%5.3" EXTENDED_LIMITS -3276.800 3276.700 DEPOSIT ABSOLUTE /end AXIS_DESCR
 /begin AXIS_DESCR STD_AXIS InjVlv_qDesInDiffHyd_mp InjMassInj 16 0.00 327.6700 FORMAT "%8.4" EXTENDED_LIMITS -327.6800 327.6700 DEPOSIT ABSOLUTE /end AXIS_DESCR
/end CHARACTERISTIC
/begin CHARACTERISTIC InjVlv_tWvCor_MAP "KF fuer die Eingangstemperatur der Druckwellenkorrektur" MAP 0xE3E72 Kf_Xs16_Ys16_Ws16 250.0000 Temp_Cels -50.1400 199.8600 FORMAT "%8.4" EXTENDED_LIMITS -3549.940 3003.560
 /begin AXIS_DESCR STD_AXIS FTSCD_tFuel Temp_Cels 16 -50.14000 199.8600 FORMAT "%8.4" EXTENDED_LIMITS -3549.940 3003.560 DEPOSIT ABSOLUTE /end AXIS_DESCR
 /begin AXIS_DESCR STD_AXIS CTSCD_tClnt Temp_Cels 16 -50.14000 199.8600 FORMAT "%8.4" EXTENDED_LIMITS -3549.940 3003.560 DEPOSIT ABSOLUTE /end AXIS_DESCR
/end CHARACTERISTIC
/begin CHARACTERISTIC InjVlv_volQntAdjLim_C "#SSD symmetrische Begrenzung des Mengen-Abgleichwertes" VALUE 0xE39FC Kw_Ws16 128.0000 InjQntInj 0.00 128.0000 FORMAT "%8.4" EXTENDED_LIMITS -327.6800 327.6700 /end CHARACTERISTIC
/begin CHARACTERISTIC InjVlv_volQntAdjMax0_C "obere Grenzwerte der Mengen-Abgleichwerte für die ""0""-Quantisierungsschrittweite (0d=00b)" VAL_BLK 0xE39FE Kwb_Ws16 6.300000 InjQntInj 0.00 6.300000 FORMAT "%8.6" EXTENDED_LIMITS -327.6800 327.6700 NUMBER 7 /end CHARACTERISTIC
/begin CHARACTERISTIC InjVlv_volQntAdjMax1_C "obere Grenzwerte der Mengen-Abgleichwerte für die ""1""-Quantisierungsschrittweite (1d=01b)" VAL_BLK 0xE3A0C Kwb_Ws16 9.450000 InjQntInj 0.00 9.450000 FORMAT "%8.6" EXTENDED_LIMITS -327.6800 327.6700 NUMBER 7 /end CHARACTERISTIC
/begin CHARACTERISTIC InjVlv_volQntAdjMax2_C "obere Grenzwerte der Mengen-Abgleichwerte für die ""2""-Quantisierungsschrittweite (2d=10b)" VAL_BLK 0xE3A1A Kwb_Ws16 15.75000 InjQntInj 0.00 15.75000 FORMAT "%8.5" EXTENDED_LIMITS -327.6800 327.6700 NUMBER 7 /end CHARACTERISTIC
/begin CHARACTERISTIC InjVlv_volQntAdjMax3_C "obere Grenzwerte der Mengen-Abgleichwerte für die ""3""-Quantisierungsschrittweite (3d=11b)" VAL_BLK 0xE3A28 Kwb_Ws16 31.50000 InjQntInj 0.00 31.50000 FORMAT "%8.5" EXTENDED_LIMITS -327.6800 327.6700 NUMBER 7 /end CHARACTERISTIC
/begin CHARACTERISTIC InjVlv_volQntAdjMin0_C "untere Grenzwerte der Mengen-Abgleichwerte für die ""0""-Quantisierungsschrittweite (0d=00b)" VAL_BLK 0xE3A36 Kwb_Ws16 6.400000 InjQntInj -6.400000 0.00 FORMAT "%8.6" EXTENDED_LIMITS -327.6800 327.6700 NUMBER 7 /end CHARACTERISTIC
/begin CHARACTERISTIC InjVlv_volQntAdjMin1_C "untere Grenzwerte der Mengen-Abgleichwerte für die ""1""-Quantisierungsschrittweite (1d=01b)" VAL_BLK 0xE3A44 Kwb_Ws16 9.600000 InjQntInj -9.600000 0.00 FORMAT "%8.6" EXTENDED_LIMITS -327.6800 327.6700 NUMBER 7 /end CHARACTERISTIC
/begin CHARACTERISTIC InjVlv_volQntAdjMin2_C "untere Grenzwerte der Mengen-Abgleichwerte für die ""2""-Quantisierungsschrittweite (2d=10b)" VAL_BLK 0xE3A52 Kwb_Ws16 16.00000 InjQntInj -16.00000 0.00 FORMAT "%8.5" EXTENDED_LIMITS -327.6800 327.6700 NUMBER 7 /end CHARACTERISTIC
/begin CHARACTERISTIC InjVlv_volQntAdjMin3_C "untere Grenzwerte der Mengen-Abgleichwerte für die ""3""-Quantisierungsschrittweite (3d=11b)" VAL_BLK 0xE3A60 Kwb_Ws16 32.00000 InjQntInj -32.00000 0.00 FORMAT "%8.5" EXTENDED_LIMITS -327.6800 327.6700 NUMBER 7 /end CHARACTERISTIC
/begin CHARACTERISTIC K2RDLI_dDataSetVer_C "Array für Datensatzversion" ASCII 0xC0626 Kwb_Wu8 255.0 defaultAscii 0.00 255.0 NUMBER 10 /end CHARACTERISTIC
/begin CHARACTERISTIC Layer_ctDebBSDStep_C "" VALUE 0xE4C28 Kw_Wu8 255.0 OneToOne 0.00 255.0 FORMAT "%5.1" /end CHARACTERISTIC
/begin CHARACTERISTIC Layer_ctDebGENStep_C "" VALUE 0xE4C29 Kw_Wu8 255.0 OneToOne 0.00 255.0 FORMAT "%5.1" /end CHARACTERISTIC
/begin CHARACTERISTIC Layer_ctDebIBS1Step_C "" VALUE 0xE4C2A Kw_Wu8 255.0 OneToOne 0.00 255.0 FORMAT "%5.1" /end CHARACTERISTIC
/begin CHARACTERISTIC Layer_ctDebIBS2Step_C "" VALUE 0xE4C2B Kw_Wu8 255.0 OneToOne 0.00 255.0 FORMAT "%5.1" /end CHARACTERISTIC
/begin CHARACTERISTIC Layer_ctDebIBS3Step_C "" VALUE 0xE4C2C Kw_Wu8 255.0 OneToOne 0.00 255.0 FORMAT "%5.1" /end CHARACTERISTIC
/begin CHARACTERISTIC Layer_ctDebMANHYDRStep_C "" VALUE 0xE4C2D Kw_Wu8 255.0 OneToOne 0.00 255.0 FORMAT "%5.1" /end CHARACTERISTIC
/begin CHARACTERISTIC Layer_ctDebMANLUFTStep_C "" VALUE 0xE4C2E Kw_Wu8 255.0 OneToOne 0.00 255.0 FORMAT "%5.1" /end CHARACTERISTIC
/begin CHARACTERISTIC Layer_ctDebPMBATTStep_C "" VALUE 0xE4C2F Kw_Wu8 255.0 OneToOne 0.00 255.0 FORMAT "%5.1" /end CHARACTERISTIC
/begin CHARACTERISTIC Layer_ctDebPMBNStep_C "" VALUE 0xE4C30 Kw_Wu8 255.0 OneToOne 0.00 255.0 FORMAT "%5.1" /end CHARACTERISTIC
/begin CHARACTERISTIC Layer_ctDebPMRUHVERLStep_C "" VALUE 0xE4C31 Kw_Wu8 255.0 OneToOne 0.00 255.0 FORMAT "%5.1" /end CHARACTERISTIC
/begin CHARACTERISTIC Layer_ctDebQLTStep_C "" VALUE 0xE4C32 Kw_Wu8 255.0 OneToOne 0.00 255.0 FORMAT "%5.1" /end CHARACTERISTIC
/begin CHARACTERISTIC Layer_ctDebTANSStep_C "" VALUE 0xE4C33 Kw_Wu8 255.0 OneToOne 0.00 255.0 FORMAT "%5.1" /end CHARACTERISTIC
/begin CHARACTERISTIC Layer_ctDebTOENSStep_C "" VALUE 0xE4C34 Kw_Wu8 255.0 OneToOne 0.00 255.0 FORMAT "%5.1" /end CHARACTERISTIC
/begin CHARACTERISTIC Layer_ctDebTUMGStep_C "" VALUE 0xE4C35 Kw_Wu8 255.0 OneToOne 0.00 255.0 FORMAT "%5.1" /end CHARACTERISTIC
/begin CHARACTERISTIC Layer_ctDebBSDDef_C "" VALUE 0xE4C36 Kw_Wu16 65535.00 OneToOne 0.00 65535.00 FORMAT "%8.2" /end CHARACTERISTIC
/begin CHARACTERISTIC Layer_ctDebBSDOk_C "" VALUE 0xE4C38 Kw_Wu16 65535.00 OneToOne 0.00 65535.00 FORMAT "%8.2" /end CHARACTERISTIC
/begin CHARACTERISTIC Layer_ctDebGENDef_C "" VALUE 0xE4C3A Kw_Wu16 65535.00 OneToOne 0.00 65535.00 FORMAT "%8.2" /end CHARACTERISTIC
/begin CHARACTERISTIC Layer_ctDebGENOk_C "" VALUE 0xE4C3C Kw_Wu16 65535.00 OneToOne 0.00 65535.00 FORMAT "%8.2" /end CHARACTERISTIC
/begin CHARACTERISTIC Layer_ctDebIBS1Def_C "" VALUE 0xE4C3E Kw_Wu16 65535.00 OneToOne 0.00 65535.00 FORMAT "%8.2" /end CHARACTERISTIC
/begin CHARACTERISTIC Layer_ctDebIBS1Ok_C "" VALUE 0xE4C40 Kw_Wu16 65535.00 OneToOne 0.00 65535.00 FORMAT "%8.2" /end CHARACTERISTIC
/begin CHARACTERISTIC Layer_ctDebIBS2Def_C "" VALUE 0xE4C42 Kw_Wu16 65535.00 OneToOne 0.00 65535.00 FORMAT "%8.2" /end CHARACTERISTIC
/begin CHARACTERISTIC Layer_ctDebIBS2Ok_C "" VALUE 0xE4C44 Kw_Wu16 65535.00 OneToOne 0.00 65535.00 FORMAT "%8.2" /end CHARACTERISTIC
/begin CHARACTERISTIC Layer_ctDebIBS3Def_C "" VALUE 0xE4C46 Kw_Wu16 65535.00 OneToOne 0.00 65535.00 FORMAT "%8.2" /end CHARACTERISTIC
/begin CHARACTERISTIC Layer_ctDebIBS3Ok_C "" VALUE 0xE4C48 Kw_Wu16 65535.00 OneToOne 0.00 65535.00 FORMAT "%8.2" /end CHARACTERISTIC
/begin CHARACTERISTIC Layer_ctDebMANHYDRDef_C "" VALUE 0xE4C4A Kw_Wu16 65535.00 OneToOne 0.00 65535.00 FORMAT "%8.2" /end CHARACTERISTIC
/begin CHARACTERISTIC Layer_ctDebMANHYDROk_C "" VALUE 0xE4C4C Kw_Wu16 65535.00 OneToOne 0.00 65535.00 FORMAT "%8.2" /end CHARACTERISTIC
/begin CHARACTERISTIC Layer_ctDebMANLUFTDef_C "" VALUE 0xE4C4E Kw_Wu16 65535.00 OneToOne 0.00 65535.00 FORMAT "%8.2" /end CHARACTERISTIC
/begin CHARACTERISTIC Layer_ctDebMANLUFTOk_C "" VALUE 0xE4C50 Kw_Wu16 65535.00 OneToOne 0.00 65535.00 FORMAT "%8.2" /end CHARACTERISTIC
/begin CHARACTERISTIC Layer_ctDebPMBATTDef_C "" VALUE 0xE4C52 Kw_Wu16 65535.00 OneToOne 0.00 65535.00 FORMAT "%8.2" /end CHARACTERISTIC
/begin CHARACTERISTIC Layer_ctDebPMBATTOk_C "" VALUE 0xE4C54 Kw_Wu16 65535.00 OneToOne 0.00 65535.00 FORMAT "%8.2" /end CHARACTERISTIC
/begin CHARACTERISTIC Layer_ctDebPMBNDef_C "" VALUE 0xE4C56 Kw_Wu16 65535.00 OneToOne 0.00 65535.00 FORMAT "%8.2" /end CHARACTERISTIC
/begin CHARACTERISTIC Layer_ctDebPMBNOk_C "" VALUE 0xE4C58 Kw_Wu16 65535.00 OneToOne 0.00 65535.00 FORMAT "%8.2" /end CHARACTERISTIC
/begin CHARACTERISTIC Layer_ctDebPMRUHVERLDef_C "" VALUE 0xE4C5A Kw_Wu16 65535.00 OneToOne 0.00 65535.00 FORMAT "%8.2" /end CHARACTERISTIC
/begin CHARACTERISTIC Layer_ctDebPMRUHVERLOk_C "" VALUE 0xE4C5C Kw_Wu16 65535.00 OneToOne 0.00 65535.00 FORMAT "%8.2" /end CHARACTERISTIC
/begin CHARACTERISTIC Layer_ctDebQLTDef_C "" VALUE 0xE4C5E Kw_Wu16 65535.00 OneToOne 0.00 65535.00 FORMAT "%8.2" /end CHARACTERISTIC
/begin CHARACTERISTIC Layer_ctDebQLTOk_C "" VALUE 0xE4C60 Kw_Wu16 65535.00 OneToOne 0.00 65535.00 FORMAT "%8.2" /end CHARACTERISTIC
/begin CHARACTERISTIC Layer_ctDebTANSDef_C "" VALUE 0xE4C62 Kw_Wu16 65535.00 OneToOne 0.00 65535.00 FORMAT "%8.2" /end CHARACTERISTIC
/begin CHARACTERISTIC Layer_ctDebTANSOk_C "" VALUE 0xE4C64 Kw_Wu16 65535.00 OneToOne 0.00 65535.00 FORMAT "%8.2" /end CHARACTERISTIC
/begin CHARACTERISTIC Layer_ctDebTOENSDef_C "" VALUE 0xE4C66 Kw_Wu16 65535.00 OneToOne 0.00 65535.00 FORMAT "%8.2" /end CHARACTERISTIC
/begin CHARACTERISTIC Layer_ctDebTOENSOk_C "" VALUE 0xE4C68 Kw_Wu16 65535.00 OneToOne 0.00 65535.00 FORMAT "%8.2" /end CHARACTERISTIC
/begin CHARACTERISTIC Layer_ctDebTUMGDef_C "" VALUE 0xE4C6A Kw_Wu16 65535.00 OneToOne 0.00 65535.00 FORMAT "%8.2" /end CHARACTERISTIC
/begin CHARACTERISTIC Layer_ctDebTUMGOk_C "" VALUE 0xE4C6C Kw_Wu16 65535.00 OneToOne 0.00 65535.00 FORMAT "%8.2" /end CHARACTERISTIC
/begin CHARACTERISTIC Layer_stAirCtlBits_C "" VALUE 0xE4BF0 Kw_Wu32 4294967295.00 OneToOne 0.00 4294967295.00 FORMAT "%13.2" /end CHARACTERISTIC
/begin CHARACTERISTIC Layer_stPCR_C "" VALUE 0xE4BF4 Kw_Wu16 65535.00 OneToOne 0.00 65535.00 FORMAT "%8.2" /end CHARACTERISTIC
/begin CHARACTERISTIC Layer_swtB_bsdprot "" VALUE 0xE4BF6 Kw_Wu8 255.0 OneToOne 0.00 255.0 FORMAT "%5.1" /end CHARACTERISTIC
/begin CHARACTERISTIC Layer_swtTunProt_C "" VALUE 0xE4BF7 Kw_Wu8 1.000 OneToOne 0.00 1.000 FORMAT "%5.3" EXTENDED_LIMITS 0.00 255.0 /end CHARACTERISTIC
/begin CHARACTERISTIC Layer_tiDefWrEep_C "" VALUE 0xE4BF8 Kw_Wu16 10000.00 Time_ms 0.00 10000.00 FORMAT "%8.2" EXTENDED_LIMITS 0.00 655350.0 /end CHARACTERISTIC
/begin CHARACTERISTIC LIGov_tiCldCltchDT1_C "Koeffizient D-Glied (T)" VALUE 0xE50E0 Kw_Wu32 4294.9673 TimeDelay_s 0.0000010000000 4294.9673 FORMAT "%9.4" /end CHARACTERISTIC
/begin CHARACTERISTIC LIGov_CldCltchDKd_C "Koeffizient D-Glied (K)" VALUE 0xE50E4 Kw_Ws32 6553.59999847 Kd_rpm2Nm -3276.80000000 3276.79999847 FORMAT "%13.8" /end CHARACTERISTIC
/begin CHARACTERISTIC LIGov_CldCltchFlt1T1_C "T1 Komponente für erstes PDT1-Glied wenn ausgekuppelt und Motor kalt" VALUE 0xE4C70 Kw_Wu32 4294.9673 TimeDelay_s 0.0000010000000 4294.9673 FORMAT "%9.4" /end CHARACTERISTIC
/begin CHARACTERISTIC LIGov_CldCltchFlt2T1_C "T1 Komponente für zweites PDT1-Glied wenn ausgekuppelt und Motor kalt" VALUE 0xE4C74 Kw_Wu32 4294.9673 TimeDelay_s 0.0000010000000 4294.9673 FORMAT "%9.4" /end CHARACTERISTIC
/begin CHARACTERISTIC LIGov_CldCltchIKi_C "Kleinsignalverstärkung" VALUE 0xE4C78 Kw_Wu32 799999.999814 Ki_rpm2Nm 0.00 799999.999814 FORMAT "%13.6" /end CHARACTERISTIC
/begin CHARACTERISTIC LIGov_CldCltchIKiPos_C "Verstärkung für positive Großsignale" VALUE 0xE4C7C Kw_Wu32 799999.999814 Ki_rpm2Nm 0.00 799999.999814 FORMAT "%13.6" /end CHARACTERISTIC
/begin CHARACTERISTIC LIGov_CldCltchIKiNeg_C "Verstärkung für negative Großsignale" VALUE 0xE4C80 Kw_Wu32 799999.999814 Ki_rpm2Nm 0.00 799999.999814 FORMAT "%13.6" /end CHARACTERISTIC
/begin CHARACTERISTIC LIGov_CldCltchIWinPos_C "Kleinsignalfenster positiv" VALUE 0xE4C84 Kw_Ws16 8191.875 EngN_HiRes -4096.000 4095.875 FORMAT "%8.3" /end CHARACTERISTIC
/begin CHARACTERISTIC LIGov_CldCltchIWinNeg_C "Kleinsignalfenster negativ" VALUE 0xE4C86 Kw_Ws16 8191.875 EngN_HiRes -4096.000 4095.875 FORMAT "%8.3" /end CHARACTERISTIC
/begin CHARACTERISTIC LIGov_CldCltchPredef_C "Einschrittmoment Vorsteuerung" VALUE 0xE4C88 Kw_Ws16 6553.500 Trq -3276.800 3276.700 FORMAT "%8.3" /end CHARACTERISTIC
/begin CHARACTERISTIC LIGov_CldCltchPKp_C "Kleinsignalverstärkung" VALUE 0xE4C8C Kw_Wu32 52428.7999878 Kp_rpm2Nm 0.00 52428.7999878 FORMAT "%13.7" /end CHARACTERISTIC
/begin CHARACTERISTIC LIGov_CldCltchPKpPos_C "Verstärkung für positive Großsignale" VALUE 0xE4C90 Kw_Wu32 52428.7999878 Kp_rpm2Nm 0.00 52428.7999878 FORMAT "%13.7" /end CHARACTERISTIC
/begin CHARACTERISTIC LIGov_CldCltchPKpNeg_C "Verstärkung für negative Großsignale" VALUE 0xE4C94 Kw_Wu32 52428.7999878 Kp_rpm2Nm 0.00 52428.7999878 FORMAT "%13.7" /end CHARACTERISTIC
/begin CHARACTERISTIC LIGov_CldCltchPWinPos_C "Kleinsignalfenster positiv" VALUE 0xE4C98 Kw_Ws16 8191.875 EngN_HiRes -4096.000 4095.875 FORMAT "%8.3" /end CHARACTERISTIC
/begin CHARACTERISTIC LIGov_CldCltchPWinNeg_C "Kleinsignalfenster negativ" VALUE 0xE4C9A Kw_Ws16 8191.875 EngN_HiRes -4096.000 4095.875 FORMAT "%8.3" /end CHARACTERISTIC
/begin CHARACTERISTIC LIGov_tiCldGearDT1_C "Koeffizient D-Glied (T)" VALUE 0xE4C9C Kw_Wu32 4294.9673 TimeDelay_s 0.0000010000000 4294.9673 FORMAT "%9.4" /end CHARACTERISTIC
/begin CHARACTERISTIC LIGov_CldGearDKd_C "Koeffizient D-Glied (K)" VALUE 0xE4CA0 Kw_Ws32 6553.59999847 Kd_rpm2Nm -3276.80000000 3276.79999847 FORMAT "%13.8" /end CHARACTERISTIC
/begin CHARACTERISTIC LIGov_CldGearIKi_C "Kleinsignalverstärkung" VALUE 0xE4CA4 Kw_Wu32 799999.999814 Ki_rpm2Nm 0.00 799999.999814 FORMAT "%13.6" /end CHARACTERISTIC
/begin CHARACTERISTIC LIGov_CldGearIKiPos_C "Verstärkung für positive Großsignale" VALUE 0xE4CA8 Kw_Wu32 799999.999814 Ki_rpm2Nm 0.00 799999.999814 FORMAT "%13.6" /end CHARACTERISTIC
/begin CHARACTERISTIC LIGov_CldGearIKiNeg_C "Verstärkung für negative Großsignale" VALUE 0xE4CAC Kw_Wu32 799999.999814 Ki_rpm2Nm 0.00 799999.999814 FORMAT "%13.6" /end CHARACTERISTIC
/begin CHARACTERISTIC LIGov_CldGearIWinPos_C "Kleinsignalfenster positiv" VALUE 0xE4CB0 Kw_Ws16 8191.875 EngN_HiRes -4096.000 4095.875 FORMAT "%8.3" /end CHARACTERISTIC
/begin CHARACTERISTIC LIGov_CldGearIWinNeg_C "Kleinsignalfenster negativ" VALUE 0xE4CB2 Kw_Ws16 8191.875 EngN_HiRes -4096.000 4095.875 FORMAT "%8.3" /end CHARACTERISTIC
/begin CHARACTERISTIC LIGov_CldGearPredef_C "Einschrittmoment Vorsteuerung" VALUE 0xE4CB4 Kw_Ws16 6553.500 Trq -3276.800 3276.700 FORMAT "%8.3" /end CHARACTERISTIC
/begin CHARACTERISTIC LIGov_CldGearPKp_C "Kleinsignalverstärkung" VALUE 0xE4CB8 Kw_Wu32 52428.7999878 Kp_rpm2Nm 0.00 52428.7999878 FORMAT "%13.7" /end CHARACTERISTIC
/begin CHARACTERISTIC LIGov_CldGearPKpPos_C "Verstärkung für positive Großsignale" VALUE 0xE4CBC Kw_Wu32 52428.7999878 Kp_rpm2Nm 0.00 52428.7999878 FORMAT "%13.7" /end CHARACTERISTIC
/begin CHARACTERISTIC LIGov_CldGearPKpNeg_C "Verstärkung für negative Großsignale" VALUE 0xE4CC0 Kw_Wu32 52428.7999878 Kp_rpm2Nm 0.00 52428.7999878 FORMAT "%13.7" /end CHARACTERISTIC
/begin CHARACTERISTIC LIGov_CldGearPWinPos_C "Kleinsignalfenster positiv" VALUE 0xE4CC4 Kw_Ws16 8191.875 EngN_HiRes -4096.000 4095.875 FORMAT "%8.3" /end CHARACTERISTIC
/begin CHARACTERISTIC LIGov_CldGearPWinNeg_C "Kleinsignalfenster negativ" VALUE 0xE4CC6 Kw_Ws16 8191.875 EngN_HiRes -4096.000 4095.875 FORMAT "%8.3" /end CHARACTERISTIC
/begin CHARACTERISTIC LIGov_dnLimHighTrm_C "obere dn-Grenze für Abgleich" VALUE 0xE4EB0 Kw_Ws16 65535.00 EngN -32768.00 32767.00 FORMAT "%8.2" /end CHARACTERISTIC
/begin CHARACTERISTIC LIGov_dnLimLowTrm_C "untere dn-Grenze für Abgleich" VALUE 0xE4EB2 Kw_Ws16 65535.00 EngN -32768.00 32767.00 FORMAT "%8.2" /end CHARACTERISTIC
/begin CHARACTERISTIC LIGov_tiGear1DT1_C "Koeffizient D-Glied (T)" VALUE 0xE4CC8 Kw_Wu32 4294.9673 TimeDelay_s 0.0000010000000 4294.9673 FORMAT "%9.4" /end CHARACTERISTIC
/begin CHARACTERISTIC LIGov_Gear1DKd_C "Koeffizient D-Glied (K)" VALUE 0xE4CCC Kw_Ws32 6553.59999847 Kd_rpm2Nm -3276.80000000 3276.79999847 FORMAT "%13.8" /end CHARACTERISTIC
/begin CHARACTERISTIC LIGov_Gear1Flt1T1_C "T1 Komponente für erstes PDT1-Glied bei Verwendung des ersten Ganges" VALUE 0xE4CD0 Kw_Wu32 4294.9673 TimeDelay_s 0.0000010000000 4294.9673 FORMAT "%9.4" /end CHARACTERISTIC
/begin CHARACTERISTIC LIGov_Gear1Flt2T1_C "T1 Komponente für zweites PDT1-Glied bei Verwendung des ersten Ganges" VALUE 0xE4CD4 Kw_Wu32 4294.9673 TimeDelay_s 0.0000010000000 4294.9673 FORMAT "%9.4" /end CHARACTERISTIC
/begin CHARACTERISTIC LIGov_Gear1IKi_C "Kleinsignalverstärkung" VALUE 0xE4CD8 Kw_Wu32 799999.999814 Ki_rpm2Nm 0.00 799999.999814 FORMAT "%13.6" /end CHARACTERISTIC
/begin CHARACTERISTIC LIGov_Gear1IKiPos_C "Verstärkung für positive Großsignale" VALUE 0xE4CDC Kw_Wu32 799999.999814 Ki_rpm2Nm 0.00 799999.999814 FORMAT "%13.6" /end CHARACTERISTIC
/begin CHARACTERISTIC LIGov_Gear1IKiNeg_C "Verstärkung für negative Großsignale" VALUE 0xE4CE0 Kw_Wu32 799999.999814 Ki_rpm2Nm 0.00 799999.999814 FORMAT "%13.6" /end CHARACTERISTIC
/begin CHARACTERISTIC LIGov_Gear1IWinPos_C "Kleinsignalfenster positiv" VALUE 0xE4CE4 Kw_Ws16 8191.875 EngN_HiRes -4096.000 4095.875 FORMAT "%8.3" /end CHARACTERISTIC
/begin CHARACTERISTIC LIGov_Gear1IWinNeg_C "Kleinsignalfenster negativ" VALUE 0xE4CE6 Kw_Ws16 8191.875 EngN_HiRes -4096.000 4095.875 FORMAT "%8.3" /end CHARACTERISTIC
/begin CHARACTERISTIC LIGov_Gear1Predef_C "Einschrittmoment Vorsteuerung" VALUE 0xE4CE8 Kw_Ws16 6553.500 Trq -3276.800 3276.700 FORMAT "%8.3" /end CHARACTERISTIC
/begin CHARACTERISTIC LIGov_Gear1PKp_C "Kleinsignalverstärkung" VALUE 0xE4CEC Kw_Wu32 52428.7999878 Kp_rpm2Nm 0.00 52428.7999878 FORMAT "%13.7" /end CHARACTERISTIC
/begin CHARACTERISTIC LIGov_Gear1PKpPos_C "Verstärkung für positive Großsignale" VALUE 0xE4CF0 Kw_Wu32 52428.7999878 Kp_rpm2Nm 0.00 52428.7999878 FORMAT "%13.7" /end CHARACTERISTIC
/begin CHARACTERISTIC LIGov_Gear1PKpNeg_C "Verstärkung für negative Großsignale" VALUE 0xE4CF4 Kw_Wu32 52428.7999878 Kp_rpm2Nm 0.00 52428.7999878 FORMAT "%13.7" /end CHARACTERISTIC
/begin CHARACTERISTIC LIGov_Gear1PWinPos_C "Kleinsignalfenster positiv" VALUE 0xE4CF8 Kw_Ws16 8191.875 EngN_HiRes -4096.000 4095.875 FORMAT "%8.3" /end CHARACTERISTIC
/begin CHARACTERISTIC LIGov_Gear1PWinNeg_C "Kleinsignalfenster negativ" VALUE 0xE4CFA Kw_Ws16 8191.875 EngN_HiRes -4096.000 4095.875 FORMAT "%8.3" /end CHARACTERISTIC
/begin CHARACTERISTIC LIGov_tiGear2DT1_C "Koeffizient D-Glied (T)" VALUE 0xE4CFC Kw_Wu32 4294.9673 TimeDelay_s 0.0000010000000 4294.9673 FORMAT "%9.4" /end CHARACTERISTIC
/begin CHARACTERISTIC LIGov_Gear2DKd_C "Koeffizient D-Glied (K)" VALUE 0xE4D00 Kw_Ws32 6553.59999847 Kd_rpm2Nm -3276.80000000 3276.79999847 FORMAT "%13.8" /end CHARACTERISTIC
/begin CHARACTERISTIC LIGov_Gear2Flt1T1_C "T1 Komponente für erstes PDT1-Glied bei Verwendung des zweiten Ganges" VALUE 0xE4D04 Kw_Wu32 4294.9673 TimeDelay_s 0.0000010000000 4294.9673 FORMAT "%9.4" /end CHARACTERISTIC
/begin CHARACTERISTIC LIGov_Gear2Flt2T1_C "T1 Komponente für zweites PDT1-Glied bei Verwendung des zweiten Ganges" VALUE 0xE4D08 Kw_Wu32 4294.9673 TimeDelay_s 0.0000010000000 4294.9673 FORMAT "%9.4" /end CHARACTERISTIC
/begin CHARACTERISTIC LIGov_Gear2IKi_C "Kleinsignalverstärkung" VALUE 0xE4D0C Kw_Wu32 799999.999814 Ki_rpm2Nm 0.00 799999.999814 FORMAT "%13.6" /end CHARACTERISTIC
/begin CHARACTERISTIC LIGov_Gear2IKiPos_C "Verstärkung für positive Großsignale" VALUE 0xE4D10 Kw_Wu32 799999.999814 Ki_rpm2Nm 0.00 799999.999814 FORMAT "%13.6" /end CHARACTERISTIC
/begin CHARACTERISTIC LIGov_Gear2IKiNeg_C "Verstärkung für negative Großsignale" VALUE 0xE4D14 Kw_Wu32 799999.999814 Ki_rpm2Nm 0.00 799999.999814 FORMAT "%13.6" /end CHARACTERISTIC
/begin CHARACTERISTIC LIGov_Gear2IWinPos_C "Kleinsignalfenster positiv" VALUE 0xE4D18 Kw_Ws16 8191.875 EngN_HiRes -4096.000 4095.875 FORMAT "%8.3" /end CHARACTERISTIC
/begin CHARACTERISTIC LIGov_Gear2IWinNeg_C "Kleinsignalfenster negativ" VALUE 0xE4D1A Kw_Ws16 8191.875 EngN_HiRes -4096.000 4095.875 FORMAT "%8.3" /end CHARACTERISTIC
/begin CHARACTERISTIC LIGov_Gear2Predef_C "Einschrittmoment Vorsteuerung" VALUE 0xE4D1C Kw_Ws16 6553.500 Trq -3276.800 3276.700 FORMAT "%8.3" /end CHARACTERISTIC
/begin CHARACTERISTIC LIGov_Gear2PKp_C "Kleinsignalverstärkung" VALUE 0xE4D20 Kw_Wu32 52428.7999878 Kp_rpm2Nm 0.00 52428.7999878 FORMAT "%13.7" /end CHARACTERISTIC
/begin CHARACTERISTIC LIGov_Gear2PKpPos_C "Verstärkung für positive Großsignale" VALUE 0xE4D24 Kw_Wu32 52428.7999878 Kp_rpm2Nm 0.00 52428.7999878 FORMAT "%13.7" /end CHARACTERISTIC
/begin CHARACTERISTIC LIGov_Gear2PKpNeg_C "Verstärkung für negative Großsignale" VALUE 0xE4D28 Kw_Wu32 52428.7999878 Kp_rpm2Nm 0.00 52428.7999878 FORMAT "%13.7" /end CHARACTERISTIC
/begin CHARACTERISTIC LIGov_Gear2PWinPos_C "Kleinsignalfenster positiv" VALUE 0xE4D2C Kw_Ws16 8191.875 EngN_HiRes -4096.000 4095.875 FORMAT "%8.3" /end CHARACTERISTIC
/begin CHARACTERISTIC LIGov_Gear2PWinNeg_C "Kleinsignalfenster negativ" VALUE 0xE4D2E Kw_Ws16 8191.875 EngN_HiRes -4096.000 4095.875 FORMAT "%8.3" /end CHARACTERISTIC
/begin CHARACTERISTIC LIGov_tiGear3DT1_C "Koeffizient D-Glied (T)" VALUE 0xE4D30 Kw_Wu32 4294.9673 TimeDelay_s 0.0000010000000 4294.9673 FORMAT "%9.4" /end CHARACTERISTIC
/begin CHARACTERISTIC LIGov_Gear3DKd_C "Koeffizient D-Glied (K)" VALUE 0xE4D34 Kw_Ws32 6553.59999847 Kd_rpm2Nm -3276.80000000 3276.79999847 FORMAT "%13.8" /end CHARACTERISTIC
/begin CHARACTERISTIC LIGov_Gear3Flt1T1_C "T1 Komponente für erstes PDT1-Glied bei Verwendung des dritten Ganges" VALUE 0xE4D38 Kw_Wu32 4294.9673 TimeDelay_s 0.0000010000000 4294.9673 FORMAT "%9.4" /end CHARACTERISTIC
/begin CHARACTERISTIC LIGov_Gear3Flt2T1_C "T1 Komponente für zweites PDT1-Glied bei Verwendung des dritten Ganges" VALUE 0xE4D3C Kw_Wu32 4294.9673 TimeDelay_s 0.0000010000000 4294.9673 FORMAT "%9.4" /end CHARACTERISTIC
/begin CHARACTERISTIC LIGov_Gear3IKi_C "Kleinsignalverstärkung" VALUE 0xE4D40 Kw_Wu32 799999.999814 Ki_rpm2Nm 0.00 799999.999814 FORMAT "%13.6" /end CHARACTERISTIC
/begin CHARACTERISTIC LIGov_Gear3IKiPos_C "Verstärkung für positive Großsignale" VALUE 0xE4D44 Kw_Wu32 799999.999814 Ki_rpm2Nm 0.00 799999.999814 FORMAT "%13.6" /end CHARACTERISTIC
/begin CHARACTERISTIC LIGov_Gear3IKiNeg_C "Verstärkung für negative Großsignale" VALUE 0xE4D48 Kw_Wu32 799999.999814 Ki_rpm2Nm 0.00 799999.999814 FORMAT "%13.6" /end CHARACTERISTIC
/begin CHARACTERISTIC LIGov_Gear3IWinPos_C "Kleinsignalfenster positiv" VALUE 0xE4D4C Kw_Ws16 8191.875 EngN_HiRes -4096.000 4095.875 FORMAT "%8.3" /end CHARACTERISTIC
/begin CHARACTERISTIC LIGov_Gear3IWinNeg_C "Kleinsignalfenster negativ" VALUE 0xE4D4E Kw_Ws16 8191.875 EngN_HiRes -4096.000 4095.875 FORMAT "%8.3" /end CHARACTERISTIC
/begin CHARACTERISTIC LIGov_Gear3Predef_C "Einschrittmoment Vorsteuerung" VALUE 0xE4D50 Kw_Ws16 6553.500 Trq -3276.800 3276.700 FORMAT "%8.3" /end CHARACTERISTIC
/begin CHARACTERISTIC LIGov_Gear3PKp_C "Kleinsignalverstärkung" VALUE 0xE4D54 Kw_Wu32 52428.7999878 Kp_rpm2Nm 0.00 52428.7999878 FORMAT "%13.7" /end CHARACTERISTIC
/begin CHARACTERISTIC LIGov_Gear3PKpPos_C "Verstärkung für positive Großsignale" VALUE 0xE4D58 Kw_Wu32 52428.7999878 Kp_rpm2Nm 0.00 52428.7999878 FORMAT "%13.7" /end CHARACTERISTIC
/begin CHARACTERISTIC LIGov_Gear3PKpNeg_C "Verstärkung für negative Großsignale" VALUE 0xE4D5C Kw_Wu32 52428.7999878 Kp_rpm2Nm 0.00 52428.7999878 FORMAT "%13.7" /end CHARACTERISTIC
/begin CHARACTERISTIC LIGov_Gear3PWinPos_C "Kleinsignalfenster positiv" VALUE 0xE4D60 Kw_Ws16 8191.875 EngN_HiRes -4096.000 4095.875 FORMAT "%8.3" /end CHARACTERISTIC
/begin CHARACTERISTIC LIGov_Gear3PWinNeg_C "Kleinsignalfenster negativ" VALUE 0xE4D62 Kw_Ws16 8191.875 EngN_HiRes -4096.000 4095.875 FORMAT "%8.3" /end CHARACTERISTIC
/begin CHARACTERISTIC LIGov_tiGear4DT1_C "Koeffizient D-Glied (T)" VALUE 0xE4D64 Kw_Wu32 4294.9673 TimeDelay_s 0.0000010000000 4294.9673 FORMAT "%9.4" /end CHARACTERISTIC
/begin CHARACTERISTIC LIGov_Gear4DKd_C "Koeffizient D-Glied (K)" VALUE 0xE4D68 Kw_Ws32 6553.59999847 Kd_rpm2Nm -3276.80000000 3276.79999847 FORMAT "%13.8" /end CHARACTERISTIC
/begin CHARACTERISTIC LIGov_Gear4Flt1T1_C "T1 Komponente für erstes PDT1-Glied bei Verwendung des vierte Ganges" VALUE 0xE4D6C Kw_Wu32 4294.9673 TimeDelay_s 0.0000010000000 4294.9673 FORMAT "%9.4" /end CHARACTERISTIC
/begin CHARACTERISTIC LIGov_Gear4Flt2T1_C "T1 Komponente für zweites PDT1-Glied bei Verwendung des vierte Ganges" VALUE 0xE4D70 Kw_Wu32 4294.9673 TimeDelay_s 0.0000010000000 4294.9673 FORMAT "%9.4" /end CHARACTERISTIC
/begin CHARACTERISTIC LIGov_Gear4IKi_C "Kleinsignalverstärkung" VALUE 0xE4D74 Kw_Wu32 799999.999814 Ki_rpm2Nm 0.00 799999.999814 FORMAT "%13.6" /end CHARACTERISTIC
/begin CHARACTERISTIC LIGov_Gear4IKiPos_C "Verstärkung für positive Großsignale" VALUE 0xE4D78 Kw_Wu32 799999.999814 Ki_rpm2Nm 0.00 799999.999814 FORMAT "%13.6" /end CHARACTERISTIC
/begin CHARACTERISTIC LIGov_Gear4IKiNeg_C "Verstärkung für negative Großsignale" VALUE 0xE4D7C Kw_Wu32 799999.999814 Ki_rpm2Nm 0.00 799999.999814 FORMAT "%13.6" /end CHARACTERISTIC
/begin CHARACTERISTIC LIGov_Gear4IWinPos_C "Kleinsignalfenster positiv" VALUE 0xE4D80 Kw_Ws16 8191.875 EngN_HiRes -4096.000 4095.875 FORMAT "%8.3" /end CHARACTERISTIC
/begin CHARACTERISTIC LIGov_Gear4IWinNeg_C "Kleinsignalfenster negativ" VALUE 0xE4D82 Kw_Ws16 8191.875 EngN_HiRes -4096.000 4095.875 FORMAT "%8.3" /end CHARACTERISTIC
/begin CHARACTERISTIC LIGov_Gear4Predef_C "Einschrittmoment Vorsteuerung" VALUE 0xE4D84 Kw_Ws16 6553.500 Trq -3276.800 3276.700 FORMAT "%8.3" /end CHARACTERISTIC
/begin CHARACTERISTIC LIGov_Gear4PKp_C "Kleinsignalverstärkung" VALUE 0xE4D88 Kw_Wu32 52428.7999878 Kp_rpm2Nm 0.00 52428.7999878 FORMAT "%13.7" /end CHARACTERISTIC
/begin CHARACTERISTIC LIGov_Gear4PKpPos_C "Verstärkung für positive Großsignale" VALUE 0xE4D8C Kw_Wu32 52428.7999878 Kp_rpm2Nm 0.00 52428.7999878 FORMAT "%13.7" /end CHARACTERISTIC
/begin CHARACTERISTIC LIGov_Gear4PKpNeg_C "Verstärkung für negative Großsignale" VALUE 0xE4D90 Kw_Wu32 52428.7999878 Kp_rpm2Nm 0.00 52428.7999878 FORMAT "%13.7" /end CHARACTERISTIC
/begin CHARACTERISTIC LIGov_Gear4PWinPos_C "Kleinsignalfenster positiv" VALUE 0xE4D94 Kw_Ws16 8191.875 EngN_HiRes -4096.000 4095.875 FORMAT "%8.3" /end CHARACTERISTIC
/begin CHARACTERISTIC LIGov_Gear4PWinNeg_C "Kleinsignalfenster negativ" VALUE 0xE4D96 Kw_Ws16 8191.875 EngN_HiRes -4096.000 4095.875 FORMAT "%8.3" /end CHARACTERISTIC
/begin CHARACTERISTIC LIGov_tiGear5DT1_C "Koeffizient D-Glied (T)" VALUE 0xE4D98 Kw_Wu32 4294.9673 TimeDelay_s 0.0000010000000 4294.9673 FORMAT "%9.4" /end CHARACTERISTIC
/begin CHARACTERISTIC LIGov_Gear5DKd_C "Koeffizient D-Glied (K)" VALUE 0xE4D9C Kw_Ws32 6553.59999847 Kd_rpm2Nm -3276.80000000 3276.79999847 FORMAT "%13.8" /end CHARACTERISTIC
/begin CHARACTERISTIC LIGov_Gear5Flt1T1_C "T1 Komponente für erstes PDT1-Glied bei Verwendung des fünften Ganges" VALUE 0xE4DA0 Kw_Wu32 4294.9673 TimeDelay_s 0.0000010000000 4294.9673 FORMAT "%9.4" /end CHARACTERISTIC
/begin CHARACTERISTIC LIGov_Gear5Flt2T1_C "T1 Komponente für zweites PDT1-Glied bei Verwendung des fünften Ganges" VALUE 0xE4DA4 Kw_Wu32 4294.9673 TimeDelay_s 0.0000010000000 4294.9673 FORMAT "%9.4" /end CHARACTERISTIC
/begin CHARACTERISTIC LIGov_Gear5IKi_C "Kleinsignalverstärkung" VALUE 0xE4DA8 Kw_Wu32 799999.999814 Ki_rpm2Nm 0.00 799999.999814 FORMAT "%13.6" /end CHARACTERISTIC
/begin CHARACTERISTIC LIGov_Gear5IKiPos_C "Verstärkung für positive Großsignale" VALUE 0xE4DAC Kw_Wu32 799999.999814 Ki_rpm2Nm 0.00 799999.999814 FORMAT "%13.6" /end CHARACTERISTIC
/begin CHARACTERISTIC LIGov_Gear5IKiNeg_C "Verstärkung für negative Großsignale" VALUE 0xE4DB0 Kw_Wu32 799999.999814 Ki_rpm2Nm 0.00 799999.999814 FORMAT "%13.6" /end CHARACTERISTIC
/begin CHARACTERISTIC LIGov_Gear5IWinPos_C "Kleinsignalfenster positiv" VALUE 0xE4DB4 Kw_Ws16 8191.875 EngN_HiRes -4096.000 4095.875 FORMAT "%8.3" /end CHARACTERISTIC
/begin CHARACTERISTIC LIGov_Gear5IWinNeg_C "Kleinsignalfenster negativ" VALUE 0xE4DB6 Kw_Ws16 8191.875 EngN_HiRes -4096.000 4095.875 FORMAT "%8.3" /end CHARACTERISTIC
/begin CHARACTERISTIC LIGov_Gear5Predef_C "Einschrittmoment Vorsteuerung" VALUE 0xE4DB8 Kw_Ws16 6553.500 Trq -3276.800 3276.700 FORMAT "%8.3" /end CHARACTERISTIC
/begin CHARACTERISTIC LIGov_Gear5PKp_C "Kleinsignalverstärkung" VALUE 0xE4DBC Kw_Wu32 52428.7999878 Kp_rpm2Nm 0.00 52428.7999878 FORMAT "%13.7" /end CHARACTERISTIC
/begin CHARACTERISTIC LIGov_Gear5PKpPos_C "Verstärkung für positive Großsignale" VALUE 0xE4DC0 Kw_Wu32 52428.7999878 Kp_rpm2Nm 0.00 52428.7999878 FORMAT "%13.7" /end CHARACTERISTIC
/begin CHARACTERISTIC LIGov_Gear5PKpNeg_C "Verstärkung für negative Großsignale" VALUE 0xE4DC4 Kw_Wu32 52428.7999878 Kp_rpm2Nm 0.00 52428.7999878 FORMAT "%13.7" /end CHARACTERISTIC
/begin CHARACTERISTIC LIGov_Gear5PWinPos_C "Kleinsignalfenster positiv" VALUE 0xE4DC8 Kw_Ws16 8191.875 EngN_HiRes -4096.000 4095.875 FORMAT "%8.3" /end CHARACTERISTIC
/begin CHARACTERISTIC LIGov_Gear5PWinNeg_C "Kleinsignalfenster negativ" VALUE 0xE4DCA Kw_Ws16 8191.875 EngN_HiRes -4096.000 4095.875 FORMAT "%8.3" /end CHARACTERISTIC
/begin CHARACTERISTIC LIGov_tiGear6DT1_C "Koeffizient D-Glied (T)" VALUE 0xE4DCC Kw_Wu32 4294.9673 TimeDelay_s 0.0000010000000 4294.9673 FORMAT "%9.4" /end CHARACTERISTIC
/begin CHARACTERISTIC LIGov_Gear6DKd_C "Koeffizient D-Glied (K)" VALUE 0xE4DD0 Kw_Ws32 6553.59999847 Kd_rpm2Nm -3276.80000000 3276.79999847 FORMAT "%13.8" /end CHARACTERISTIC
/begin CHARACTERISTIC LIGov_Gear6Flt1T1_C "T1 Komponente für erstes PDT1-Glied bei Verwendung des sechsten Ganges" VALUE 0xE4DD4 Kw_Wu32 4294.9673 TimeDelay_s 0.0000010000000 4294.9673 FORMAT "%9.4" /end CHARACTERISTIC
/begin CHARACTERISTIC LIGov_Gear6Flt2T1_C "T1 Komponente für zweites PDT1-Glied bei Verwendung des sechsten Ganges" VALUE 0xE4DD8 Kw_Wu32 4294.9673 TimeDelay_s 0.0000010000000 4294.9673 FORMAT "%9.4" /end CHARACTERISTIC
/begin CHARACTERISTIC LIGov_Gear6IKi_C "Kleinsignalverstärkung" VALUE 0xE4DDC Kw_Wu32 799999.999814 Ki_rpm2Nm 0.00 799999.999814 FORMAT "%13.6" /end CHARACTERISTIC
/begin CHARACTERISTIC LIGov_Gear6IKiPos_C "Verstärkung für positie Großsingnale" VALUE 0xE4DE0 Kw_Wu32 799999.999814 Ki_rpm2Nm 0.00 799999.999814 FORMAT "%13.6" /end CHARACTERISTIC
/begin CHARACTERISTIC LIGov_Gear6IKiNeg_C "Verstärkung für negative Großsignale" VALUE 0xE4DE4 Kw_Wu32 799999.999814 Ki_rpm2Nm 0.00 799999.999814 FORMAT "%13.6" /end CHARACTERISTIC
/begin CHARACTERISTIC LIGov_Gear6IWinPos_C "Kleinsignalfenster positiv" VALUE 0xE4DE8 Kw_Ws16 8191.875 EngN_HiRes -4096.000 4095.875 FORMAT "%8.3" /end CHARACTERISTIC
/begin CHARACTERISTIC LIGov_Gear6IWinNeg_C "Kleinsignalfenster negativ" VALUE 0xE4DEA Kw_Ws16 8191.875 EngN_HiRes -4096.000 4095.875 FORMAT "%8.3" /end CHARACTERISTIC
/begin CHARACTERISTIC LIGov_Gear6Predef_C "Einschrittmoment Vorsteuerung" VALUE 0xE4DEC Kw_Ws16 6553.500 Trq -3276.800 3276.700 FORMAT "%8.3" /end CHARACTERISTIC
/begin CHARACTERISTIC LIGov_Gear6PKp_C "Kleinsignalverstärkung" VALUE 0xE4DF0 Kw_Wu32 52428.7999878 Kp_rpm2Nm 0.00 52428.7999878 FORMAT "%13.7" /end CHARACTERISTIC
/begin CHARACTERISTIC LIGov_Gear6PKpPos_C "Verstärkung für positive Großsignale" VALUE 0xE4DF4 Kw_Wu32 52428.7999878 Kp_rpm2Nm 0.00 52428.7999878 FORMAT "%13.7" /end CHARACTERISTIC
/begin CHARACTERISTIC LIGov_Gear6PKpNeg_C "Verstärkung für negative Großsignale" VALUE 0xE4DF8 Kw_Wu32 52428.7999878 Kp_rpm2Nm 0.00 52428.7999878 FORMAT "%13.7" /end CHARACTERISTIC
/begin CHARACTERISTIC LIGov_Gear6PWinPos_C "Kleinsignalfenster positiv" VALUE 0xE4DFC Kw_Ws16 8191.875 EngN_HiRes -4096.000 4095.875 FORMAT "%8.3" /end CHARACTERISTIC
/begin CHARACTERISTIC LIGov_Gear6PWinNeg_C "Kleinsignalfenster negativ" VALUE 0xE4DFE Kw_Ws16 8191.875 EngN_HiRes -4096.000 4095.875 FORMAT "%8.3" /end CHARACTERISTIC
/begin CHARACTERISTIC LIGov_nDeltaSec_C "#SSD Delta allgemein zu Drehzahlschwelle Sicherheitsrampe" VALUE 0xE4EB4 Kw_Ws16 32767.00 EngN 0.00 32767.00 FORMAT "%8.2" EXTENDED_LIMITS -32768.00 32767.00 /end CHARACTERISTIC
/begin CHARACTERISTIC LIGov_nDflTrmVal_C "Datensatz-Abgleichwert" VALUE 0xE4E00 Kw_Ws16 65535.00 EngN -32768.00 32767.00 FORMAT "%8.2" /end CHARACTERISTIC
/begin CHARACTERISTIC LIGov_nDHypDenom_C "Nennerparameter für Hyperbel zur Aufschaltung LLR D-Anteil" VALUE 0xE4E02 Kw_Ws16 32766.00 EngN 1.000000 32767.00 FORMAT "%8.2" EXTENDED_LIMITS -32768.00 32767.00 /end CHARACTERISTIC
/begin CHARACTERISTIC LIGov_nDHypNum_C "Zählerparameter für Hyperbel zur Aufschaltung LLR D-Anteil" VALUE 0xE4E04 Kw_Ws16 65535.00 EngN -32768.00 32767.00 FORMAT "%8.2" /end CHARACTERISTIC
/begin CHARACTERISTIC LIGov_nDiffDelta_C "#SSD Delta zur Drehzahlschwelle Sicherheitsrampe" VALUE 0xE4EB6 Kw_Ws16 32767.00 EngN 0.00 32767.00 FORMAT "%8.2" EXTENDED_LIMITS -32768.00 32767.00 /end CHARACTERISTIC
/begin CHARACTERISTIC LIGov_nHDC_C "Applizierbare LL-Solldrehzahl aufgrund HDC" VALUE 0xE4EB8 Kw_Ws16 32767.00 EngN 0.00 32767.00 FORMAT "%8.2" EXTENDED_LIMITS -32768.00 32767.00 /end CHARACTERISTIC
/begin CHARACTERISTIC LIGov_nLimHighOfs_C "Offset from the high engine speed limit for low-idle governor" VALUE 0xE4EBA Kw_Ws16 32767.00 EngN 0.00 32767.00 FORMAT "%8.2" EXTENDED_LIMITS -32768.00 32767.00 /end CHARACTERISTIC
/begin CHARACTERISTIC LIGov_nLimHighTrmAct_C "Überdrehzahllimit Trimmung für den Leerlaufregler" VALUE 0xE4EBC Kw_Ws16 65535.00 EngN -32768.00 32767.00 FORMAT "%8.2" /end CHARACTERISTIC
/begin CHARACTERISTIC LIGov_nLimHigh_C "#SSD obere Drehzahlgrenze für LLR" VALUE 0xE4E06 Kw_Ws16 65535.00 EngN -32768.00 32767.00 FORMAT "%8.2" /end CHARACTERISTIC
/begin CHARACTERISTIC LIGov_nLimLow_C "untere Drehzahlgrenze für LLR" VALUE 0xE4E08 Kw_Ws16 65535.00 EngN -32768.00 32767.00 FORMAT "%8.2" /end CHARACTERISTIC
/begin CHARACTERISTIC LIGov_nMSDiffMax_C "#SSD Max zulässige Differenz zwischen Master Solldrehzahl und der vom Slave berechneten Solldrehzahl" VALUE 0xE4E0A Kw_Ws16 5960.000 EngN 40.00000 6000.000 FORMAT "%8.3" EXTENDED_LIMITS -32768.00 32767.00 /end CHARACTERISTIC
/begin CHARACTERISTIC LIGov_nOffsetPreCtrltrqDem_C "Vorsteuerung aktiv n-Offset auf Basisdrehzahl und Momentenwunsch" VALUE 0xE4E0C Kw_Ws16 65535.00 EngN -32768.00 32767.00 FORMAT "%8.2" /end CHARACTERISTIC
/begin CHARACTERISTIC LIGov_nOffsetPreCtrl_C "Vorsteuerung aktiv n-Offset auf Basisdrehzahl" VALUE 0xE4E0E Kw_Ws16 65535.00 EngN -32768.00 32767.00 FORMAT "%8.2" /end CHARACTERISTIC
/begin CHARACTERISTIC LIGov_nOffsetPredef_C "Einschrittmoment aktiv n-Offset auf Basisdrehzahl" VALUE 0xE4E10 Kw_Ws16 65535.00 EngN -32768.00 32767.00 FORMAT "%8.2" /end CHARACTERISTIC
/begin CHARACTERISTIC LIGov_nOffsetUbr_C "Drehzahlschwelle für Erkennung für Leerlaufregler-Zustand Unterbremsen" VALUE 0xE4E12 Kw_Ws16 65535.00 EngN -32768.00 32767.00 FORMAT "%8.2" /end CHARACTERISTIC
/begin CHARACTERISTIC LIGov_nRmpBaseDwn_C "Schrittweite der Rampe bei Absenkung LL-Solldrehzahl aus LL-Grundfunktion" VALUE 0xE4EBE Kw_Ws16 32767.00 dn_dZfine 0.00 32767.00 FORMAT "%8.2" EXTENDED_LIMITS -32768.00 32767.00 /end CHARACTERISTIC
/begin CHARACTERISTIC LIGov_nRmpBaseUp_C "Schrittweite der Rampe bei Erhöhung LL-Solldrehzahl aus LL-Grundfunktion" VALUE 0xE4EC0 Kw_Ws16 32767.00 dn_dZfine 0.00 32767.00 FORMAT "%8.2" EXTENDED_LIMITS -32768.00 32767.00 /end CHARACTERISTIC
/begin CHARACTERISTIC LIGov_nRmpCoEngDwn_C "Schrittweite der Rampe bei Absenkung LL-Solldrehzahl aus CoEng_nMin" VALUE 0xE4EC2 Kw_Ws16 32767.00 dn_dZfine 0.00 32767.00 FORMAT "%8.2" EXTENDED_LIMITS -32768.00 32767.00 /end CHARACTERISTIC
/begin CHARACTERISTIC LIGov_nRmpCoEngUp_C "Schrittweite der Rampe bei Erhöhung LL-Solldrehzahl aus CoEng_nMin" VALUE 0xE4EC4 Kw_Ws16 32767.00 dn_dZfine 0.00 32767.00 FORMAT "%8.2" EXTENDED_LIMITS -32768.00 32767.00 /end CHARACTERISTIC
/begin CHARACTERISTIC LIGov_nRmpCutOutUp_C "Ramp by raising setpoint" VALUE 0xE4EC8 Kw_Wu32 65535999.9847 RmpEngN 0.00 65535999.9847 FORMAT "%13.4" /end CHARACTERISTIC
/begin CHARACTERISTIC LIGov_nRmpCutOutDwn_C "Ramp by lowing setpoint" VALUE 0xE4ECC Kw_Wu32 65535999.9847 RmpEngN 0.00 65535999.9847 FORMAT "%13.4" /end CHARACTERISTIC
/begin CHARACTERISTIC LIGov_nRmpGearbxDwn_C "Schrittweite der Rampe bei Absenkung LL-Solldrehzahl aus Getriebe" VALUE 0xE4ED0 Kw_Ws16 32767.00 dn_dZfine 0.00 32767.00 FORMAT "%8.2" EXTENDED_LIMITS -32768.00 32767.00 /end CHARACTERISTIC
/begin CHARACTERISTIC LIGov_nRmpGearbxUp_C "Schrittweite der Rampe bei Absenkung LL-Solldrehzahl aus Getriebe" VALUE 0xE4ED2 Kw_Ws16 32767.00 dn_dZfine 0.00 32767.00 FORMAT "%8.2" EXTENDED_LIMITS -32768.00 32767.00 /end CHARACTERISTIC
/begin CHARACTERISTIC LIGov_nRmpHDCDwn_C "Drehzahl Rampenschritt für HDC Eingriff - fallende Drehzahl" VALUE 0xE4ED4 Kw_Ws16 32767.00 dn_dZfine 0.00 32767.00 FORMAT "%8.2" EXTENDED_LIMITS -32768.00 32767.00 /end CHARACTERISTIC
/begin CHARACTERISTIC LIGov_nRmpHDCUp_C "Drehzahl Rampenschrittweite des HDC-Eingriffes - steigende Drehzahl" VALUE 0xE4ED6 Kw_Ws16 32767.00 dn_dZfine 0.00 32767.00 FORMAT "%8.2" EXTENDED_LIMITS -32768.00 32767.00 /end CHARACTERISTIC
/begin CHARACTERISTIC LIGov_nRmpPwrMngDwn_C "Schrittweite der Rampe bei Absenkung LL-Solldrehzahl aus Getriebe" VALUE 0xE4ED8 Kw_Ws16 32767.00 dn_dZfine 0.00 32767.00 FORMAT "%8.2" EXTENDED_LIMITS -32768.00 32767.00 /end CHARACTERISTIC
/begin CHARACTERISTIC LIGov_nRmpPwrMngUp_C "Schrittweite der Rampe bei Absenkung LL-Solldrehzahl aus PwrMng" VALUE 0xE4EDA Kw_Ws16 32767.00 dn_dZfine 0.00 32767.00 FORMAT "%8.2" EXTENDED_LIMITS -32768.00 32767.00 /end CHARACTERISTIC
/begin CHARACTERISTIC LIGov_nRmpSecDelta_C "Schrittweite der SicherheitsRampe bei Erhöhung LL-Solldrehzahl" VALUE 0xE4EDC Kw_Ws16 32767.00 dn_dZfine 0.00 32767.00 FORMAT "%8.2" EXTENDED_LIMITS -32768.00 32767.00 /end CHARACTERISTIC
/begin CHARACTERISTIC LIGov_nRmpSurgeDwn_C "Schrittweite der Rampe bei Absenkung LL-Solldrehzahl aus AntiSurge" VALUE 0xE4EDE Kw_Ws16 32767.00 dn_dZfine 0.00 32767.00 FORMAT "%8.2" EXTENDED_LIMITS -32768.00 32767.00 /end CHARACTERISTIC
/begin CHARACTERISTIC LIGov_nRmpSurgeUp_C "Schrittweite der Rampe bei Erhöhung LL-Solldrehzahl aus AntiSurge" VALUE 0xE4EE0 Kw_Ws16 32767.00 dn_dZfine 0.00 32767.00 FORMAT "%8.2" EXTENDED_LIMITS -32768.00 32767.00 /end CHARACTERISTIC
/begin CHARACTERISTIC LIGov_nSetpointDia_C "Sollwert des LLR über Diagnoseschnittstelle" VALUE 0xE4EE2 Kw_Ws16 32767.00 EngN 0.00 32767.00 FORMAT "%8.2" EXTENDED_LIMITS -32768.00 32767.00 /end CHARACTERISTIC
/begin CHARACTERISTIC LIGov_nSetpointDriveAway_C "LL-Solldrehzahl Fahrzeug fährt (V > 0)" VALUE 0xE4EE4 Kw_Ws16 65535.00 EngN -32768.00 32767.00 FORMAT "%8.2" /end CHARACTERISTIC
/begin CHARACTERISTIC LIGov_nSetpointInit2_MAP "Initialisierungskennfeld des Leerlaufreglers - abhängig von der Kühlmitteltemperatur und dem Atmosphärendruck" MAP 0xE4EE6 Kf_Xs16_Ys16_Ws16 6000.000 EngN 0.00 6000.000 FORMAT "%8.3" EXTENDED_LIMITS -32768.00 32767.00
 /begin AXIS_DESCR STD_AXIS CTSCD_tClnt Temp_Cels 8 -50.1400 199.8600 FORMAT "%8.4" EXTENDED_LIMITS -3549.940 3003.560 DEPOSIT ABSOLUTE /end AXIS_DESCR
 /begin AXIS_DESCR STD_AXIS APSCD_pVal Pres_hPa 8 0.00 3500.0000 FORMAT "%8.4" EXTENDED_LIMITS -32768.00 32767.00 DEPOSIT ABSOLUTE /end AXIS_DESCR
/end CHARACTERISTIC
/begin CHARACTERISTIC LIGov_nSetpointInit_MAP "Initialisierungskennfeld zur Berechnung der Leerlaufsolldrehzahl" MAP 0xE4F8A Kf_Xs16_Ys16_Ws16 6000.000 EngN 0.00 6000.000 FORMAT "%8.3" EXTENDED_LIMITS -32768.00 32767.00
 /begin AXIS_DESCR STD_AXIS CTSCD_tClnt Temp_Cels 8 -50.1400 199.8600 FORMAT "%8.4" EXTENDED_LIMITS -3549.940 3003.560 DEPOSIT ABSOLUTE /end AXIS_DESCR
 /begin AXIS_DESCR STD_AXIS APSCD_pVal Pres_hPa 8 0.00 3500.0000 FORMAT "%8.4" EXTENDED_LIMITS -32768.00 32767.00 DEPOSIT ABSOLUTE /end AXIS_DESCR
/end CHARACTERISTIC
/begin CHARACTERISTIC LIGov_nSetpointTrmLim_C "Schwelle für LL-Drehzahlanhebungserkennung" VALUE 0xE502E Kw_Ws16 65535.00 EngN -32768.00 32767.00 FORMAT "%8.2" /end CHARACTERISTIC
/begin CHARACTERISTIC LIGov_nSetpointTrm_C "Ersatzwert für LL-Drehzahlanhebung" VALUE 0xE5030 Kw_Ws16 65535.00 EngN -32768.00 32767.00 FORMAT "%8.2" /end CHARACTERISTIC
/begin CHARACTERISTIC LIGov_nSetPointWarm_C "LL-Solldrehzahl Fahrzeug steht / warmer Motor" VALUE 0xE5032 Kw_Ws16 65535.00 EngN -32768.00 32767.00 FORMAT "%8.2" /end CHARACTERISTIC
/begin CHARACTERISTIC LIGov_nSetpoint_Vector "#SSD Bypass label, nicht editieren" VALUE 0xC3186 Kw_Wu8 255.0 OneToOne 0.00 255.0 FORMAT "%5.1" /end CHARACTERISTIC
/begin CHARACTERISTIC LIGov_nSetpoint_Channel "Bypass Label, nicht editieren!" VALUE 0xC3187 Kw_Wu8 255.0 OneToOne 0.00 255.0 FORMAT "%5.1" /end CHARACTERISTIC
/begin CHARACTERISTIC LIGov_rAPPThresFreezeI_C "Schwelle für PWG-Wert zum Rücksetzen des LLR Status ""freezeI""" VALUE 0xE4E14 Kw_Ws16 100.0000 Prc 0.00 100.0000 FORMAT "%8.4" EXTENDED_LIMITS -400.0000 399.9878 /end CHARACTERISTIC
/begin CHARACTERISTIC LIGov_rAPPThresTrqDem_C "Schwelle für PWG-Wert zum Rücksetzen des LLR Status ""torque demand""" VALUE 0xE4E16 Kw_Ws16 100.0000 Prc 0.00 100.0000 FORMAT "%8.4" EXTENDED_LIMITS -400.0000 399.9878 /end CHARACTERISTIC
/begin CHARACTERISTIC LIGov_stActiveHDC_C "Applizierbarer Zustand für aktivierte LL-Solldrehzahl aufgrund HDC" VALUE 0xE5034 Kw_Wu8 3.000 OneToOne 0.00 3.000 FORMAT "%5.3" EXTENDED_LIMITS 0.00 255.0 /end CHARACTERISTIC
/begin CHARACTERISTIC LIGov_stPsRev_C "Wählt Paramtersatz für Rückwärtsgang (1 entspricht PS 1.Gang, 2 entspricht PS 2.Gang)" VALUE 0xE4E18 Kw_Ws8 1.000 OneToOne 1.000 2.000 FORMAT "%5.3" EXTENDED_LIMITS -128.0 127.0 /end CHARACTERISTIC
/begin CHARACTERISTIC LIGov_stReleaseHDC_C "Bitweises Freischalten der LL-Solldrehzahl aufgrund HDC über CAN" VALUE 0xE5035 Kw_Wu8 127.0 OneToOne 0.00 127.0 FORMAT "%5.1" EXTENDED_LIMITS 0.00 255.0 /end CHARACTERISTIC
/begin CHARACTERISTIC LIGov_swtAPPFreezeI_C "Schalter für die Auswahl gefilterter (0) oder ungefilterter (1) PWG-Wert für die Entscheidung des LLR-Status ""freezeI""" VALUE 0xE4E19 Kw_Wu8 1.000 OneToOne 0.00 1.000 FORMAT "%5.3" EXTENDED_LIMITS 0.00 255.0 /end CHARACTERISTIC
/begin CHARACTERISTIC LIGov_swtAPPTrqDem_C "Schalter für die Auswahl gefilterter (0) oder ungefilterter (1) PWG-Wert für die Entscheidung des LLR-Status ""torque demanded""" VALUE 0xE4E1A Kw_Wu8 1.000 OneToOne 0.00 1.000 FORMAT "%5.3" EXTENDED_LIMITS 0.00 255.0 /end CHARACTERISTIC
/begin CHARACTERISTIC LIGov_swtGear_C "Konstante zur Auswahl des Initialisierungsfeldes der Leerlaufdrehzahl" VALUE 0xE5036 Kw_Wu8 255.0 OneToOne 0.00 255.0 FORMAT "%5.1" /end CHARACTERISTIC
/begin CHARACTERISTIC LIGov_swtInitPreCtrlNotLck_C "Startzustand des LLR Zustands ""Vorsteuerung nicht gesperrt"" (0: nicht gesperrt, 1: gesperrt)" VALUE 0xE4E1B Kw_Wu8 1.000 OneToOne 0.00 1.000 FORMAT "%5.3" EXTENDED_LIMITS 0.00 255.0 /end CHARACTERISTIC
/begin CHARACTERISTIC LIGov_tClntXLow_C "Schwelle 1 für Wassertemperaturhysterese" VALUE 0xE4E1C Kw_Ws16 250.0000 Temp_Cels -50.14000 199.8600 FORMAT "%8.4" EXTENDED_LIMITS -3549.940 3003.560 /end CHARACTERISTIC
/begin CHARACTERISTIC LIGov_tClntXHigh_C "Schwelle 2 für Wassertemperaturhysterese" VALUE 0xE4E1E Kw_Ws16 250.0000 Temp_Cels -50.14000 199.8600 FORMAT "%8.4" EXTENDED_LIMITS -3549.940 3003.560 /end CHARACTERISTIC
/begin CHARACTERISTIC LIGov_stCold_C "Konstante für LiGov Status kalt" VALUE 0xE4E20 Kw_Ws16 65535.00 OneToOne -32768.00 32767.00 FORMAT "%8.2" READ_ONLY /end CHARACTERISTIC
/begin CHARACTERISTIC LIGov_stWarm_C "Konstante für LIGov Status warm" VALUE 0xE4E22 Kw_Ws16 65535.00 OneToOne -32768.00 32767.00 FORMAT "%8.2" READ_ONLY /end CHARACTERISTIC
/begin CHARACTERISTIC LIGov_tiDelCutOut_C "delay time after CoEng_stEng moves from status COENG_STSTART to COENG_STNORMAL" VALUE 0xE4E24 Kw_Wu16 2000.000 Time_ms 0.00 2000.000 FORMAT "%8.3" EXTENDED_LIMITS 0.00 655350.0 /end CHARACTERISTIC
/begin CHARACTERISTIC LIGov_tiPT1_CUR "Kennlinie der Zeitkonstanten für die PT1 Flterung über der Drehzahl" CURVE 0xE4E26 Kl_Xs16_Ws16 5.000000 TimeDelay_s_Lin_16 0.00 5.000000 FORMAT "%8.6" EXTENDED_LIMITS -5.000153 5.000000
 /begin AXIS_DESCR STD_AXIS LIGov_nDiff_mp EngN 8 -5000.000 1000.000 FORMAT "%8.3" EXTENDED_LIMITS -32768.00 32767.00 DEPOSIT ABSOLUTE /end AXIS_DESCR
/end CHARACTERISTIC
/begin CHARACTERISTIC LIGov_tiTW_C "Zeit nach Start für T_W-abh. LL-Solldrehzahl" VALUE 0xE5038 Kw_Wu16 655.3500 Time_s 0.00 655.3500 FORMAT "%8.4" /end CHARACTERISTIC
/begin CHARACTERISTIC LIGov_trqInitI_MAP "Kennfeld zur integrator Initialisierung" MAP 0xE503A Kf_Xs16_Ys16_Ws16 400.0000 Trq 0.00 400.0000 FORMAT "%8.4" EXTENDED_LIMITS -3276.800 3276.700
 /begin AXIS_DESCR STD_AXIS CTSCD_tClnt Temp_Cels 8 -50.1400 899.8600 FORMAT "%8.4" EXTENDED_LIMITS -3549.940 3003.560 DEPOSIT ABSOLUTE /end AXIS_DESCR
 /begin AXIS_DESCR STD_AXIS APSCD_pVal Pres_hPa 8 0.00 3500.000 FORMAT "%8.3" EXTENDED_LIMITS -32768.00 32767.00 DEPOSIT ABSOLUTE /end AXIS_DESCR
/end CHARACTERISTIC
/begin CHARACTERISTIC LIGov_trqMax_CUR "Wassertemperaturabhängiges Begrenzungsmoment für den LLR" CURVE 0xE4E48 Kl_Xs16_Ws16 400.0000 Trq 0.00 400.0000 FORMAT "%8.4" EXTENDED_LIMITS -3276.800 3276.700
 /begin AXIS_DESCR STD_AXIS Eng_nAvrg EngN 8 -32768.00 32767.00 FORMAT "%8.2" DEPOSIT ABSOLUTE /end AXIS_DESCR
/end CHARACTERISTIC
/begin CHARACTERISTIC LIGov_trqSetMax_C "Maximale begrenze fuer Moment anforderung über Diagnose für NMK Schnellernen" VALUE 0xE4E6A Kw_Ws16 70.00000 Trq 0.00 70.00000 FORMAT "%8.5" EXTENDED_LIMITS -3276.800 3276.700 /end CHARACTERISTIC
/begin CHARACTERISTIC LIGov_trqThresDefrostI_C "Mengenschwelle Integrator einfrieren/auftauen" VALUE 0xE4E6C Kw_Ws16 6553.500 Trq -3276.800 3276.700 FORMAT "%8.3" /end CHARACTERISTIC
/begin CHARACTERISTIC LIGov_trq_Vector "#SSD Bypasslabel, nicht editieren!" VALUE 0xC3188 Kw_Wu8 255.0 OneToOne 0.00 255.0 FORMAT "%5.1" /end CHARACTERISTIC
/begin CHARACTERISTIC LIGov_trq_Channel "#SSD Bypasslabel, nicht editieren!" VALUE 0xC3189 Kw_Wu8 255.0 OneToOne 0.00 255.0 FORMAT "%5.1" /end CHARACTERISTIC
/begin CHARACTERISTIC LIGov_UbrPKp_C "Kleinsignalverstärkung" VALUE 0xE4E70 Kw_Wu32 52428.7999878 Kp_rpm2Nm 0.00 52428.7999878 FORMAT "%13.7" /end CHARACTERISTIC
/begin CHARACTERISTIC LIGov_UbrPKpPos_C "Verstärkung für positive Großsignale" VALUE 0xE4E74 Kw_Wu32 52428.7999878 Kp_rpm2Nm 0.00 52428.7999878 FORMAT "%13.7" /end CHARACTERISTIC
/begin CHARACTERISTIC LIGov_UbrPKpNeg_C "Verstärkung für negative Großsignale" VALUE 0xE4E78 Kw_Wu32 52428.7999878 Kp_rpm2Nm 0.00 52428.7999878 FORMAT "%13.7" /end CHARACTERISTIC
/begin CHARACTERISTIC LIGov_UbrPWinPos_C "Kleinsignalfenster positiv" VALUE 0xE4E7C Kw_Ws16 8191.875 EngN_HiRes -4096.000 4095.875 FORMAT "%8.3" /end CHARACTERISTIC
/begin CHARACTERISTIC LIGov_UbrPWinNeg_C "Kleinsignalfenster negativ" VALUE 0xE4E7E Kw_Ws16 8191.875 EngN_HiRes -4096.000 4095.875 FORMAT "%8.3" /end CHARACTERISTIC
/begin CHARACTERISTIC LIGov_vThresUbr_C "Schwellgeschwindigkeit bei Unterbremsen" VALUE 0xE4E80 Kw_Ws16 655.3500 Vel -327.6800 327.6700 FORMAT "%8.4" /end CHARACTERISTIC
/begin CHARACTERISTIC LIGov_tiWrmCltchDT1_C "Koeffizient D-Glied (T)" VALUE 0xE50E8 Kw_Wu32 4294.9673 TimeDelay_s 0.0000010000000 4294.9673 FORMAT "%9.4" /end CHARACTERISTIC
/begin CHARACTERISTIC LIGov_WrmCltchDKd_C "Koeffizient D-Glied (K)" VALUE 0xE50EC Kw_Ws32 6553.59999847 Kd_rpm2Nm -3276.80000000 3276.79999847 FORMAT "%13.8" /end CHARACTERISTIC
/begin CHARACTERISTIC LIGov_WrmCltchFlt1T1_C "T1 Komponente für erstes PDT1-Glied wenn ausgekuppelt und Motor warm" VALUE 0xE4E84 Kw_Wu32 4294.9673 TimeDelay_s 0.0000010000000 4294.9673 FORMAT "%9.4" /end CHARACTERISTIC
/begin CHARACTERISTIC LIGov_WrmCltchFlt2T1_C "T1 Komponente für zweites PDT1-Glied wenn ausgekuppelt und Motor warm" VALUE 0xE4E88 Kw_Wu32 4294.9673 TimeDelay_s 0.0000010000000 4294.9673 FORMAT "%9.4" /end CHARACTERISTIC
/begin CHARACTERISTIC LIGov_WrmCltchIKi_C "Kleinsignalverstärkung" VALUE 0xE4E8C Kw_Wu32 799999.999814 Ki_rpm2Nm 0.00 799999.999814 FORMAT "%13.6" /end CHARACTERISTIC
/begin CHARACTERISTIC LIGov_WrmCltchIKiPos_C "Verstärkung für positive Großsignale" VALUE 0xE4E90 Kw_Wu32 799999.999814 Ki_rpm2Nm 0.00 799999.999814 FORMAT "%13.6" /end CHARACTERISTIC
/begin CHARACTERISTIC LIGov_WrmCltchIKiNeg_C "Verstärkung für negative Großsignale" VALUE 0xE4E94 Kw_Wu32 799999.999814 Ki_rpm2Nm 0.00 799999.999814 FORMAT "%13.6" /end CHARACTERISTIC
/begin CHARACTERISTIC LIGov_WrmCltchIWinPos_C "Kleinsignalfenster positiv" VALUE 0xE4E98 Kw_Ws16 8191.875 EngN_HiRes -4096.000 4095.875 FORMAT "%8.3" /end CHARACTERISTIC
/begin CHARACTERISTIC LIGov_WrmCltchIWinNeg_C "Kleinsignalfenster negativ" VALUE 0xE4E9A Kw_Ws16 8191.875 EngN_HiRes -4096.000 4095.875 FORMAT "%8.3" /end CHARACTERISTIC
/begin CHARACTERISTIC LIGov_WrmCltchPredef_C "Einschrittmoment Vorsteuerung" VALUE 0xE4E9C Kw_Ws16 6553.500 Trq -3276.800 3276.700 FORMAT "%8.3" /end CHARACTERISTIC
/begin CHARACTERISTIC LIGov_WrmCltchPKp_C "Kleinsignalverstärkung" VALUE 0xE4EA0 Kw_Wu32 52428.7999878 Kp_rpm2Nm 0.00 52428.7999878 FORMAT "%13.7" /end CHARACTERISTIC
/begin CHARACTERISTIC LIGov_WrmCltchPKpPos_C "Verstärkung für positive Großsignale" VALUE 0xE4EA4 Kw_Wu32 52428.7999878 Kp_rpm2Nm 0.00 52428.7999878 FORMAT "%13.7" /end CHARACTERISTIC
/begin CHARACTERISTIC LIGov_WrmCltchPKpNeg_C "Verstärkung für negative Großsignale" VALUE 0xE4EA8 Kw_Wu32 52428.7999878 Kp_rpm2Nm 0.00 52428.7999878 FORMAT "%13.7" /end CHARACTERISTIC
/begin CHARACTERISTIC LIGov_WrmCltchPWinPos_C "Kleinsignalfenster positiv" VALUE 0xE4EAC Kw_Ws16 8191.875 EngN_HiRes -4096.000 4095.875 FORMAT "%8.3" /end CHARACTERISTIC
/begin CHARACTERISTIC LIGov_WrmCltchPWinNeg_C "Kleinsignalfenster negativ" VALUE 0xE4EAE Kw_Ws16 8191.875 EngN_HiRes -4096.000 4095.875 FORMAT "%8.3" /end CHARACTERISTIC
/begin CHARACTERISTIC LPACD_ctPwrStgOnMax_C "Maximale Anzahl der Endstufenaktivierung im Fehlerfall" VALUE 0xE50F0 Kw_Wu16 65535.00 OneToOne 0.00 65535.00 FORMAT "%8.2" /end CHARACTERISTIC
/begin CHARACTERISTIC LPACD_DebExcTempDef_C "Fehlerentprellzeit fuer Uebertemperatur" VALUE 0xE50F2 Kw_Wu16 655350.0 Time_ms 0.00 655350.0 FORMAT "%8.1" /end CHARACTERISTIC
/begin CHARACTERISTIC LPACD_DebExcTempOk_C "Heilungsentprellzeit fuer Uebertemperatur" VALUE 0xE50F4 Kw_Wu16 655350.0 Time_ms 0.00 655350.0 FORMAT "%8.1" /end CHARACTERISTIC
/begin CHARACTERISTIC LPACD_DebNoLoadDef_C "Fehlerentprellzeit fuer Lastabfall" VALUE 0xE50F6 Kw_Wu16 655350.0 Time_ms 0.00 655350.0 FORMAT "%8.1" /end CHARACTERISTIC
/begin CHARACTERISTIC LPACD_DebNoLoadOk_C "Heilungsentprellzeit fuer Lastabfall" VALUE 0xE50F8 Kw_Wu16 655350.0 Time_ms 0.00 655350.0 FORMAT "%8.1" /end CHARACTERISTIC
/begin CHARACTERISTIC LPACD_DebShortCircBatDef_C "Fehlerentprellzeit fuer Kurzschluss nach Batteriespannung" VALUE 0xE50FA Kw_Wu16 655350.0 Time_ms 0.00 655350.0 FORMAT "%8.1" /end CHARACTERISTIC
/begin CHARACTERISTIC LPACD_DebShortCircBatOk_C "Heilungsentprellzeit fuer Kurzschluss nach Batteriespannung" VALUE 0xE50FC Kw_Wu16 655350.0 Time_ms 0.00 655350.0 FORMAT "%8.1" /end CHARACTERISTIC
/begin CHARACTERISTIC LPACD_DebShortCircGndDef_C "Fehlerentprellzeit fuer Kurzschluss nach Masse" VALUE 0xE50FE Kw_Wu16 655350.0 Time_ms 0.00 655350.0 FORMAT "%8.1" /end CHARACTERISTIC
/begin CHARACTERISTIC LPACD_DebShortCircGndOk_C "Heilungsentprellzeit fuer Kurzschluss nach Masse" VALUE 0xE5100 Kw_Wu16 655350.0 Time_ms 0.00 655350.0 FORMAT "%8.1" /end CHARACTERISTIC
/begin CHARACTERISTIC LPACD_numDia_C "Parameter fuer Hardware Diagnose-Pin Auswahl" VALUE 0xE5102 Kw_Wu8 27.0000000000 NumPinDia 0.00 27.0000000000 FORMAT "%13.10" /end CHARACTERISTIC
/begin CHARACTERISTIC LPACD_numPwmOut_C "Parameter fuer Hardware Endstufen-Pin Auswahl" VALUE 0xE5103 Kw_Wu8 13.0000000000 NumPinPwmOut 0.00 13.0000000000 FORMAT "%13.10" /end CHARACTERISTIC
/begin CHARACTERISTIC LPACD_stInvOut_C "Invertierungsparameter fuer das Signal der Ladedruckstellerendstufe" VALUE 0xE5104 Kw_Wu8 1.000 OneToOne 0.00 1.000 FORMAT "%5.3" EXTENDED_LIMITS 0.00 255.0 /end CHARACTERISTIC
/begin CHARACTERISTIC LPACD_tiPer_C "Periodendauer des Ladedruckstellers" VALUE 0xE5106 Kw_Ws16 6553.500 Period -3276.800 3276.700 FORMAT "%8.3" /end CHARACTERISTIC
/begin CHARACTERISTIC LPACD_rCnv_CUR "Kennlinie zur Konvertierung von Oeffnungsgrad in Tastverhaeltnis" CURVE 0xE5108 Kl_Xs16_Ws16 100.0000 DtyCyc 0.00 100.0000 FORMAT "%8.4" EXTENDED_LIMITS -327.6800 327.6700
 /begin AXIS_DESCR STD_AXIS BPA_rLPACD Prc 25 -100.0000 200.0000 FORMAT "%8.4" EXTENDED_LIMITS -400.0000 399.9878 DEPOSIT ABSOLUTE /end AXIS_DESCR
/end CHARACTERISTIC
/begin CHARACTERISTIC LPACD_rOutMax_C "Maximal auszugebendes Tastverhaeltnis" VALUE 0xE516E Kw_Ws16 655.3500 DtyCyc -327.6800 327.6700 FORMAT "%8.4" /end CHARACTERISTIC
/begin CHARACTERISTIC LPACD_rOutMin_C "Minimal auszugebendes Tastverhaeltnis" VALUE 0xE5170 Kw_Ws16 655.3500 DtyCyc -327.6800 327.6700 FORMAT "%8.4" /end CHARACTERISTIC
/begin CHARACTERISTIC LPACD_stPwrStgActv_C "Aktivierung der Abschaltbedingungen der Endstufe" VALUE 0xE5172 Kw_Wu8 255.0 OneToOne 0.00 255.0 FORMAT "%5.1" /end CHARACTERISTIC
/begin CHARACTERISTIC LPACD_stPwrStgDia_C "Aktivierung der Abschaltbedingungen der Endstufendiagnose" VALUE 0xE5173 Kw_Wu8 255.0 OneToOne 0.00 255.0 FORMAT "%5.1" /end CHARACTERISTIC
/begin CHARACTERISTIC LPACD_stSPICtl_C "Status ob Endstufe SPI = 1 oder nicht SPI = 0 ist" VALUE 0xE5174 Kw_Wu8 1.000 OneToOne 0.00 1.000 FORMAT "%5.3" EXTENDED_LIMITS 0.00 255.0 /end CHARACTERISTIC
/begin CHARACTERISTIC LPACD_swt_C "Schalter fuer Batteriespannungskorrektur (0 = AUS, 1 = EIN)" VALUE 0xE5175 Kw_Wu8 255.0 OneToOne 0.00 255.0 FORMAT "%5.1" /end CHARACTERISTIC
/begin CHARACTERISTIC LPACD_tiBtwTst_C "Zeitabstand, in dem im Fehlerfall die Endstufe getestet wird" VALUE 0xE5176 Kw_Wu16 29980.00 Time_ms 20.00000 30000.00 FORMAT "%8.2" EXTENDED_LIMITS 0.00 655350.0 /end CHARACTERISTIC
/begin CHARACTERISTIC LPACD_tiPwrStgOn_C "Zeit für die Endstufe aktiviert wird, wenn keine SPI Endstufe" VALUE 0xE5178 Kw_Wu16 655140.0 Time_ms 0.00 655140.0 FORMAT "%8.1" EXTENDED_LIMITS 0.00 655350.0 /end CHARACTERISTIC
/begin CHARACTERISTIC LSUCD_tiAdptFltInit_C "Zeitkonstante Adaptionsfilter für nicht adaptierten Zustand" VALUE 0xE5254 Kw_Wu32 4294.9673 TimeDelay_s 0.0000010000000 4294.9673 FORMAT "%9.4" /end CHARACTERISTIC
/begin CHARACTERISTIC LSUCD_tiAdptFlt_C "Zeitkonstante Adaptionsfilter für adaptierten Zustand" VALUE 0xE5258 Kw_Wu32 4294.9673 TimeDelay_s 0.0000010000000 4294.9673 FORMAT "%9.4" /end CHARACTERISTIC
/begin CHARACTERISTIC LSUCD_d2rInit_C "Initialisierungswert Bewertungsfilter" VALUE 0xE525C Kw_Ws16 0.6553500 O2 -0.3276800 0.3276700 FORMAT "%9.7" /end CHARACTERISTIC
/begin CHARACTERISTIC LSUCD_DebO2ClbDef_C "Defektentprellzähler für O2-Kalibrierungsfehler" VALUE 0xE52A8 Kw_Wu16 65535.00 OneToOne 0.00 65535.00 FORMAT "%8.2" /end CHARACTERISTIC
/begin CHARACTERISTIC LSUCD_DebO2ClbOk_C "Heilungsentprellzähler für O2-Kalibrierungsfehler" VALUE 0xE52AA Kw_Wu16 65535.00 OneToOne 0.00 65535.00 FORMAT "%8.2" /end CHARACTERISTIC
/begin CHARACTERISTIC LSUCD_DebRiClbDef_C "Defektentprellzähler des Ri-Kalibrierungsfehlers" VALUE 0xE536C Kw_Wu16 65535.00 OneToOne 0.00 65535.00 FORMAT "%8.2" /end CHARACTERISTIC
/begin CHARACTERISTIC LSUCD_DebRiClbOk_C "Heilungsentprellzähler des Ri-Kalibrierungsfehlers" VALUE 0xE536E Kw_Wu16 65535.00 OneToOne 0.00 65535.00 FORMAT "%8.2" /end CHARACTERISTIC
/begin CHARACTERISTIC LSUCD_dmAirIKi_C "Verstärkung I-Regler bei Kleinsignalen" VALUE 0xE5260 Kw_Wu32 5.00003807247 Ki 0.00 5.00003807247 FORMAT "%13.11" EXTENDED_LIMITS 0.00 999999.999767 READ_ONLY /end CHARACTERISTIC
/begin CHARACTERISTIC LSUCD_dmAirIKiPos_C "Verstärkung I-Regler bei positiven Großsignalen" VALUE 0xE5264 Kw_Wu32 5.00003807247 Ki 0.00 5.00003807247 FORMAT "%13.11" EXTENDED_LIMITS 0.00 999999.999767 READ_ONLY /end CHARACTERISTIC
/begin CHARACTERISTIC LSUCD_dmAirIKiNeg_C "Verstärkung I-Regler bei negativen Großsignalen" VALUE 0xE5268 Kw_Wu32 5.00003807247 Ki 0.00 5.00003807247 FORMAT "%13.11" EXTENDED_LIMITS 0.00 999999.999767 READ_ONLY /end CHARACTERISTIC
/begin CHARACTERISTIC LSUCD_dmAirIWinPos_C "Obere Kleinsignalgrenze für  den I-Regler" VALUE 0xE526C Kw_Ws16 250.0000 AirMassPerTime 223.0000 473.0000 FORMAT "%8.4" EXTENDED_LIMITS -3276.800 3276.700 READ_ONLY /end CHARACTERISTIC
/begin CHARACTERISTIC LSUCD_dmAirIWinNeg_C "Untere Kleinsignalgrenze für den I-Regler" VALUE 0xE526E Kw_Ws16 250.0000 AirMassPerTime 223.0000 473.0000 FORMAT "%8.4" EXTENDED_LIMITS -3276.800 3276.700 READ_ONLY /end CHARACTERISTIC
/begin CHARACTERISTIC LSUCD_EvalMaxVal_C "Oberer Grenzwert für Lernfortschrittsbewertung" VALUE 0xE5270 Kw_Ws16 0.6553500 O2 -0.3276800 0.3276700 FORMAT "%9.7" /end CHARACTERISTIC
/begin CHARACTERISTIC LSUCD_EvalMinVal_C "Unterer Grenzwert für Lernfortschrittsbewertung" VALUE 0xE5272 Kw_Ws16 0.6553500 O2 -0.3276800 0.3276700 FORMAT "%9.7" /end CHARACTERISTIC
/begin CHARACTERISTIC LSUCD_tiEvalFltInit_C "Zeitkonstante Bewertungsfilter für nicht adaptierten Zustand" VALUE 0xE5274 Kw_Wu32 4294.9673 TimeDelay_s 0.0000010000000 4294.9673 FORMAT "%9.4" /end CHARACTERISTIC
/begin CHARACTERISTIC LSUCD_tiEvalFlt_C "Zeitkonstante Bewertungsfilter für adaptierten Zustand" VALUE 0xE5278 Kw_Wu32 4294.9673 TimeDelay_s 0.0000010000000 4294.9673 FORMAT "%9.4" /end CHARACTERISTIC
/begin CHARACTERISTIC LSUCD_facPresCompLean_CUR "#SSD Kennlinie für Druckkorrekturfaktor bei magerem Luft-Kraftstoff-Gemisch" CURVE 0xE5314 Kl_Xs16_Ws16 7.999878 Fact -4.000000 3.999878 FORMAT "%8.6"
 /begin AXIS_DESCR STD_AXIS LSUCD_pExhGasLstVal_mp Pres_hPa 10 -32768.00 32767.00 FORMAT "%8.2" DEPOSIT ABSOLUTE /end AXIS_DESCR
/end CHARACTERISTIC
/begin CHARACTERISTIC LSUCD_facPresCompRich_CUR "#SSD Kennlinie für Druckkorrekturfaktor bei fettem Luft-Kraftstoff-Gemisch" CURVE 0xE533E Kl_Xs16_Ws16 7.999878 Fact -4.000000 3.999878 FORMAT "%8.6"
 /begin AXIS_DESCR STD_AXIS LSUCD_pExhGasLstVal_mp Pres_hPa 10 -32768.00 32767.00 FORMAT "%8.2" DEPOSIT ABSOLUTE /end AXIS_DESCR
/end CHARACTERISTIC
/begin CHARACTERISTIC LSUCD_mAirAdptActv_C "Minimalwert für Integral über Luftmassenstrom seit Schubbeginn für Aktivierung der Adaption" VAL_BLK 0xE527C Kwb_Ws16 6553.500 AirMass_2 -3276.800 3276.700 FORMAT "%8.3" NUMBER 1 /end CHARACTERISTIC
/begin CHARACTERISTIC LSUCD_stHtInvOut_C "Lambdas Sensor Heizerendstufe Invertierungsstatus" VALUE 0xE5284 Kw_Wu8 1.000 OneToOne 0.00 1.000 FORMAT "%5.3" EXTENDED_LIMITS 0.00 255.0 /end CHARACTERISTIC
/begin CHARACTERISTIC LSUCD_tiHtPer_C "#SSD Periodendauer PWM Signal Heizwiderstand Ansteuerung" VALUE 0xE5286 Kw_Ws16 6553.500 Period -3276.800 3276.700 FORMAT "%8.3" /end CHARACTERISTIC
/begin CHARACTERISTIC LSUCD_rO2SwtPresComp_C "Sauerstoffkonzentrationsgrenzwert für Umschaltung zwischen Druckkompensation für mageres und fettes Luft-Ktraftstoff-Gemisch" VALUE 0xE5368 Kw_Ws16 0.6553500 O2 -0.3276800 0.3276700 FORMAT "%9.7" /end CHARACTERISTIC
/begin CHARACTERISTIC LSUCD_rO2_CUR "#SSD Kennlinie zur Umrechnung von Spannung in Sauerstoffkonzentration" CURVE 0xE52AC Kl_Xs16_Ws16 0.6000000 O2 -0.3000000 0.3000000 FORMAT "%9.7" EXTENDED_LIMITS -0.3276800 0.3276700
 /begin AXIS_DESCR STD_AXIS LSUCD_uO2OfsCor_mp Volt 15 -1598.240 3998.045 FORMAT "%8.3" EXTENDED_LIMITS -160156.4 160151.5 DEPOSIT ABSOLUTE /end AXIS_DESCR
/end CHARACTERISTIC
/begin CHARACTERISTIC LSUCD_stCJ125CS_C "CJ125 chip select letzter Eintrag 0xC: LSU Funktionalität, 0xF: keine LSU Funktionalität" VAL_BLK 0xE53D0 Kwb_Wu8 15.00 OneToOne 0.00 15.00 FORMAT "%5.2" EXTENDED_LIMITS 0.00 255.0 NUMBER 5 /end CHARACTERISTIC
/begin CHARACTERISTIC LSUCD_stPumpCtlDis_C "#SSD Maske zur Auswahl der Betriebsart abhängigen Abschaltbedingungen für den Pumpstromregler" VALUE 0xE536A Kw_Wu8 255.0 OneToOne 0.00 255.0 FORMAT "%5.1" /end CHARACTERISTIC
/begin CHARACTERISTIC LSUCD_stRefCurHigh_C "Applikationskonstante zur Konfiguration des hohen Referenzpumpstroms von 0 bis 150uA" VALUE 0xE53D5 Kw_Wu8 15.0000000000 CurRefPump 0.00 15.0000000000 FORMAT "%13.10" /end CHARACTERISTIC
/begin CHARACTERISTIC LSUCD_stRefCurNormal_C "Applikationskonstante zur Konfiguration des normalen Referenzpumpstroms von 0 bis 150uA" VALUE 0xE53D6 Kw_Wu8 15.0000000000 CurRefPump 0.00 15.0000000000 FORMAT "%13.10" /end CHARACTERISTIC
/begin CHARACTERISTIC LSUCD_swtAdptVal_C "Schalterwert für Adaption der Lambda-Sonde (0= keine Adaption/ 1=Adaption)" VALUE 0xE527E Kw_Wu8 1.000 OneToOne 0.00 1.000 FORMAT "%5.3" EXTENDED_LIMITS 0.00 255.0 /end CHARACTERISTIC
/begin CHARACTERISTIC LSUCD_swtAdptType_C "SW-Schaltertyp für Adaption der Lambda-Sonde (0=Datensatzwert, nicht applizierbar/1=EEPROM-Wert/2=Datensatzwert)" VALUE 0xE527F Kw_Wu8 0.00 OneToOne 2.000 2.000 FORMAT "%5.3" EXTENDED_LIMITS 0.00 255.0 /end CHARACTERISTIC
/begin CHARACTERISTIC LSUCD_tAirAdptActv_C "Maximale Lufttemperatur für Aktivierung der Adaption" VALUE 0xE5280 Kw_Ws16 950.000 Temp_Cels -50.140 899.860 FORMAT "%8.3" EXTENDED_LIMITS -3549.940 3003.560 /end CHARACTERISTIC
/begin CHARACTERISTIC LSUCD_tiO2ClbPT1_C "Filterzeitkonstante für Lernen Abgleichwert" VALUE 0xE52EC Kw_Wu32 4294.9673 TimeDelay_s 0.0000010000000 4294.9673 FORMAT "%9.4" /end CHARACTERISTIC
/begin CHARACTERISTIC LSUCD_tiO2PT1_C "Filterzeitkonstante für O2 Rohwertfilterung" VALUE 0xE52F0 Kw_Wu32 4294.9673 TimeDelay_s 0.0000010000000 4294.9673 FORMAT "%9.4" /end CHARACTERISTIC
/begin CHARACTERISTIC LSUCD_tiRiClbPT1_C "Zeitkonstante Ri Abgleichfilter" VALUE 0xE5370 Kw_Wu32 4294.9673 TimeDelay_s 0.0000010000000 4294.9673 FORMAT "%9.4" /end CHARACTERISTIC
/begin CHARACTERISTIC LSUCD_tiRiPT1_C "Zeitkonstante Ri Filter" VALUE 0xE5374 Kw_Wu32 4294.9673 TimeDelay_s 0.0000010000000 4294.9673 FORMAT "%9.4" /end CHARACTERISTIC
/begin CHARACTERISTIC LSUCD_tRi_CUR "#SSD Kennlinie zur Umrechnung des Innenwiderstands auf Äquivalenztemperatur" CURVE 0xE5378 Kl_Xs16_Ws16 950.000 Temp_Cels -50.140 899.860 FORMAT "%8.3" EXTENDED_LIMITS -3549.940 3003.560
 /begin AXIS_DESCR STD_AXIS LSUCD_resRi_mp Resist 16 0.00 3000.000 FORMAT "%8.3" EXTENDED_LIMITS -3276.800 3276.700 DEPOSIT ABSOLUTE /end AXIS_DESCR
/end CHARACTERISTIC
/begin CHARACTERISTIC LSUCD_tiDebHeaterDef_C "Defektentprellung Lambdasonden Heizerendstufe" VALUE 0xE5288 Kw_Wu16 655350.0 Time_ms 0.00 655350.0 FORMAT "%8.1" /end CHARACTERISTIC
/begin CHARACTERISTIC LSUCD_tiDebHeaterOk_C "Heilungsentprellung der Heizerendstufe Lambdasensor" VALUE 0xE528A Kw_Wu16 655350.0 Time_ms 0.00 655350.0 FORMAT "%8.1" /end CHARACTERISTIC
/begin CHARACTERISTIC LSUCD_uBattNominal_C "#SSD Nominale Batteriespannung für Heizleistungskorrektur (= Spannung die 100 % entspricht)" VALUE 0xE528C Kw_Wu16 15992.18 Volt_Batt 0.00 15992.18 FORMAT "%8.2" EXTENDED_LIMITS 0.00 1281232. /end CHARACTERISTIC
/begin CHARACTERISTIC LSUCD_uBattMaxHigh_C "#SSD Schwelle für Abschaltung Heizeransteuern aufgrund zu hoher Batteriespannung" VALUE 0xE528E Kw_Ws16 665630.5 Volt_Batt -640625.6 25004.89 FORMAT "%8.1" EXTENDED_LIMITS -640625.6 640606.1 /end CHARACTERISTIC
/begin CHARACTERISTIC LSUCD_uBattMaxLow_C "#SSD Schwelle für Rücknahme Abschaltung Heizeransteuern aufgrund zu hoher Batteriespannung" VALUE 0xE5290 Kw_Ws16 665630.5 Volt_Batt -640625.6 25004.89 FORMAT "%8.1" EXTENDED_LIMITS -640625.6 640606.1 /end CHARACTERISTIC
/begin CHARACTERISTIC LSUCD_stPwrStgDia_C "#SSD Verriegelungsmaske für Heizer Endstufen Diagnose" VALUE 0xE5292 Kw_Wu8 255.0 OneToOne 0.00 255.0 FORMAT "%5.1" /end CHARACTERISTIC
/begin CHARACTERISTIC LSUCD_dcycTstPowerStage_C "Tastverhältnis zum Einschalten der nicht-SPI-steuerbare Endstufe bei einem SCB-Fehler" VALUE 0xE5294 Kw_Ws16 50.00000 DtyCyc 0.00 50.00000 FORMAT "%8.5" EXTENDED_LIMITS -327.6800 327.6700 /end CHARACTERISTIC
/begin CHARACTERISTIC LSUCD_tiDebReset_C "Zeitverzögerung für zurücksetzen PWM Fehlerentprellung bei nicht aktiver Ansteuerung" VALUE 0xE5296 Kw_Wu16 655350.0 Time_ms 0.00 655350.0 FORMAT "%8.1" /end CHARACTERISTIC
/begin CHARACTERISTIC LSUCD_stHtDis_C "#SSD Maske zur Auswahl der Betriebsmode abhängigen Abschaltbedingungen der Heizer Endstufe" VALUE 0xE5298 Kw_Wu8 255.0 OneToOne 0.00 255.0 FORMAT "%5.1" /end CHARACTERISTIC
/begin CHARACTERISTIC LSUCD_stHeaterPwrStgSel_C "Applikationsparameter für die Heizerendstufe (1 für TLE6232)" VALUE 0xE5299 Kw_Wu8 255.0 OneToOne 0.00 255.0 FORMAT "%5.1" /end CHARACTERISTIC
/begin CHARACTERISTIC LSUCD_tiHeaterBattDefDelay_C "Zeitverzögerung der Heizerdiagnose nachdem der Heizungsregeler aktiv ist" VALUE 0xE529A Kw_Wu16 655350.0 Time_ms 0.00 655350.0 FORMAT "%8.1" /end CHARACTERISTIC
/begin CHARACTERISTIC LSUCD_stRefPumpDis_C "#SSD Maske zur Auswahl der Betriebsart abhängigen Abschaltbedingungen für den Referenzpumpstrom" VALUE 0xE529C Kw_Wu8 255.0 OneToOne 0.00 255.0 FORMAT "%5.1" /end CHARACTERISTIC
/begin CHARACTERISTIC LSUCD_tiRefPumpHigh_C "Zeit für Regeneration Referenzzelle mit erhöhtem Pumpstrom" VALUE 0xE529E Kw_Wu16 655350.0 Time_ms 0.00 655350.0 FORMAT "%8.1" /end CHARACTERISTIC
/begin CHARACTERISTIC LSUCD_tiRefTransLow_C "Verzögerungszeit bis zum Setzen des Bits in LSUCD_stRefPmp nach Übergang von hohem zu niedrigem Referenzpumpstrom" VALUE 0xE52A0 Kw_Wu16 655350.0 Time_ms 0.00 655350.0 FORMAT "%8.1" /end CHARACTERISTIC
/begin CHARACTERISTIC LSUCD_tiRgnEna_C "Zeit-Periode für Regeneration" VALUE 0xE52A2 Kw_Wu16 655350.0 Time_ms 0.00 655350.0 FORMAT "%8.1" /end CHARACTERISTIC
/begin CHARACTERISTIC LSUCD_tiRgnIpSettle_C "Zeitdauer zum Ausregeln des Pumpstroms nach Regeneration (nur für CJ125)" VALUE 0xE52A4 Kw_Wu16 655350.0 Time_ms 0.00 655350.0 FORMAT "%8.1" /end CHARACTERISTIC
/begin CHARACTERISTIC LSUCD_swtRgnChngCirct_C "Schalter der geänderten Hardware für die Pumpstromumkehr (T1120-->1, sonst-->0)" VALUE 0xE52A6 Kw_Wu8 255.0 OneToOne 0.00 255.0 FORMAT "%5.1" /end CHARACTERISTIC
/begin CHARACTERISTIC LSUCD_tiDebO2MaxTstDef_C "Defekt Entprellung der oberen Grenze  Sauerstoffsignal mit reduzierter Verstärkung" VALUE 0xE52F4 Kw_Wu16 655350.0 Time_ms 0.00 655350.0 FORMAT "%8.1" /end CHARACTERISTIC
/begin CHARACTERISTIC LSUCD_tiDebO2MaxTstOk_C "Heilungs Entprellung der oberen Grenze  Sauerstoffsignal mit reduzierter Verstärkung" VALUE 0xE52F6 Kw_Wu16 655350.0 Time_ms 0.00 655350.0 FORMAT "%8.1" /end CHARACTERISTIC
/begin CHARACTERISTIC LSUCD_tiDebO2MinDef_C "Defekt Entprellung der unteren Genze Sauerstoffsignal" VALUE 0xE52F8 Kw_Wu16 655350.0 Time_ms 0.00 655350.0 FORMAT "%8.1" /end CHARACTERISTIC
/begin CHARACTERISTIC LSUCD_tiDebO2MinOk_C "Heilungsentprellung untere Grenze Sauerstoffsignal" VALUE 0xE52FA Kw_Wu16 655350.0 Time_ms 0.00 655350.0 FORMAT "%8.1" /end CHARACTERISTIC
/begin CHARACTERISTIC LSUCD_tiDelO2Clb_C "Wartezeit auf Einschwingen O2 Abgleichwert" VALUE 0xE52FC Kw_Wu16 100.0000 Time_ms 0.00 100.0000 FORMAT "%8.4" EXTENDED_LIMITS 0.00 655350.0 /end CHARACTERISTIC
/begin CHARACTERISTIC LSUCD_tiO2Clb_C "Lernzeit O2 Abgleichwert" VALUE 0xE52FE Kw_Wu16 100.0000 Time_ms 0.00 100.0000 FORMAT "%8.4" EXTENDED_LIMITS 0.00 655350.0 /end CHARACTERISTIC
/begin CHARACTERISTIC LSUCD_tiDelO2Val_C "Wartezeit auf Einschwingen O2 Meßwert nach Abgleich" VALUE 0xE5300 Kw_Wu16 100.0000 Time_ms 0.00 100.0000 FORMAT "%8.4" EXTENDED_LIMITS 0.00 655350.0 /end CHARACTERISTIC
/begin CHARACTERISTIC LSUCD_uO2Ref_C "#SSD Sollspannung Auswerteschaltung bei Lambda = 1" VALUE 0xE5302 Kw_Ws16 5000.000 Volt 0.00 5000.000 FORMAT "%8.3" EXTENDED_LIMITS -160156.4 160151.5 /end CHARACTERISTIC
/begin CHARACTERISTIC LSUCD_uO2ClbMax_C "Maximal zulässiger O2 Spannungskorrekturwert" VALUE 0xE5304 Kw_Ws16 320307.9 Volt -160156.4 160151.5 FORMAT "%8.1" /end CHARACTERISTIC
/begin CHARACTERISTIC LSUCD_uO2ClbMin_C "Minimal zulässiger O2 Spannungskorrekturwert" VALUE 0xE5306 Kw_Ws16 320307.9 Volt -160156.4 160151.5 FORMAT "%8.1" /end CHARACTERISTIC
/begin CHARACTERISTIC LSUCD_swtO2Filter_C "Schalter zur aktivierung der O2 Rohspannungs Filterung (0= Filter aus, 1 = Filter an)" VALUE 0xE5308 Kw_Wu8 1.000 OneToOne 0.00 1.000 FORMAT "%5.3" EXTENDED_LIMITS 0.00 255.0 /end CHARACTERISTIC
/begin CHARACTERISTIC LSUCD_uO2MaxNorm_C "Zulässige obere Spannungsgrenze für Normalkennlinie" VALUE 0xE530A Kw_Ws16 5000.000 Volt 0.00 5000.000 FORMAT "%8.3" EXTENDED_LIMITS -160156.4 160151.5 /end CHARACTERISTIC
/begin CHARACTERISTIC LSUCD_uO2MaxTst_C "Zulässige obere Spannungsgrenze für Fettkennlinie (Nur für Test verwendet)" VALUE 0xE530C Kw_Ws16 5000.000 Volt 0.00 5000.000 FORMAT "%8.3" EXTENDED_LIMITS -160156.4 160151.5 /end CHARACTERISTIC
/begin CHARACTERISTIC LSUCD_uO2Min_C "Unter Grenze Signalbereich" VALUE 0xE530E Kw_Ws16 5000.000 Volt 0.00 5000.000 FORMAT "%8.3" EXTENDED_LIMITS -160156.4 160151.5 /end CHARACTERISTIC
/begin CHARACTERISTIC LSUCD_swtSensDrftComp_C "Schalter zur Driftkompensation bei Auswahl eines Sensors hoher Empfindlichkeit[-]" VALUE 0xE5310 Kw_Wu8 1.000 OneToOne 0.00 1.000 FORMAT "%5.3" EXTENDED_LIMITS 0.00 255.0 /end CHARACTERISTIC
/begin CHARACTERISTIC LSUCD_tiDelRiClb_C "Wartezeit auf Einschwingen Ri Abgleichwert" VALUE 0xE53BA Kw_Wu16 100.0000 Time_ms 0.00 100.0000 FORMAT "%8.4" EXTENDED_LIMITS 0.00 655350.0 /end CHARACTERISTIC
/begin CHARACTERISTIC LSUCD_tiRiClb_C "Lernzeit Ri Abgleichwert" VALUE 0xE53BC Kw_Wu16 150.0000 Time_ms 0.00 150.0000 FORMAT "%8.4" EXTENDED_LIMITS 0.00 655350.0 /end CHARACTERISTIC
/begin CHARACTERISTIC LSUCD_tiDelRiVal_C "Wartezeit auf Einschwingen Ri Meßwert nach Abgleich" VALUE 0xE53BE Kw_Wu16 100.0000 Time_ms 0.00 100.0000 FORMAT "%8.4" EXTENDED_LIMITS 0.00 655350.0 /end CHARACTERISTIC
/begin CHARACTERISTIC LSUCD_tiRiFltSettle_C "Maximale Zeitdauer zur Deaktivierung der Störungsunterdrückung" VALUE 0xE53C0 Kw_Wu16 3000.000 Time_ms 0.00 3000.000 FORMAT "%8.3" EXTENDED_LIMITS 0.00 655350.0 /end CHARACTERISTIC
/begin CHARACTERISTIC LSUCD_resRiMaxJmp_C "Maximal zulässige Ri-Änderung zwischen gemessenem und zuletzt gefiltertem Wert" VALUE 0xE53C2 Kw_Wu16 6553.500 Resist 0.00 6553.500 FORMAT "%8.3" /end CHARACTERISTIC
/begin CHARACTERISTIC LSUCD_uRiOfs_C "#SSD Sollspannung während Ri Offsetabgleich" VALUE 0xE53C4 Kw_Ws16 5000.000 Volt 0.00 5000.000 FORMAT "%8.3" EXTENDED_LIMITS -160156.4 160151.5 /end CHARACTERISTIC
/begin CHARACTERISTIC LSUCD_facUToRi_C "#SSD Umrechnungsfaktor Meßspannung in Ri" VALUE 0xE53C6 Kw_Ws16 1.289275 VoltToRes -0.6446474 0.6446277 FORMAT "%9.7" /end CHARACTERISTIC
/begin CHARACTERISTIC LSUCD_resRiClbRef_C "Wert Ri Referenzwiderstand" VALUE 0xE53C8 Kw_Ws16 6553.500 Resist -3276.800 3276.700 FORMAT "%8.3" /end CHARACTERISTIC
/begin CHARACTERISTIC LSUCD_resRiClbMax_C "Maximal zulässiger Ri Korrekturwert" VALUE 0xE53CA Kw_Ws16 6553.500 Resist -3276.800 3276.700 FORMAT "%8.3" /end CHARACTERISTIC
/begin CHARACTERISTIC LSUCD_resRiClbMin_C "Minimal zulässiger Ri Korrekturwert" VALUE 0xE53CC Kw_Ws16 6553.500 Resist -3276.800 3276.700 FORMAT "%8.3" /end CHARACTERISTIC
/begin CHARACTERISTIC LSUCD_numRiDistSupp_C "Anzahl der aufeinanderfolgenden Zyklen zur Störungsunterdrückung" VALUE 0xE53CE Kw_Wu8 255.0 OneToOne 0.00 255.0 FORMAT "%5.1" /end CHARACTERISTIC
/begin CHARACTERISTIC PwrMng_B_ulcp_C "Applikationslabel fuer Powermanagement" VALUE 0xE4BFA Kw_Wu8 255.0 OneToOne 0.00 255.0 FORMAT "%5.1" /end CHARACTERISTIC
/begin CHARACTERISTIC PwrMng_dmAirPerTimeCor_C "correction factor for air mass per time" VALUE 0xE4BFC Kw_Ws16 1500.000 SlopeRes10000 0.00 1500.000 FORMAT "%8.3" EXTENDED_LIMITS -3.276800 3.276700 /end CHARACTERISTIC
/begin CHARACTERISTIC PwrMng_dmAirPerTimeIMax_C "Maximum integrated air mass" VALUE 0xE4BFE Kw_Wu8 1500. AirMassPerTime 0.00 1500. FORMAT "%5.0" EXTENDED_LIMITS 0.00 25.50 /end CHARACTERISTIC
/begin CHARACTERISTIC PwrMng_dmAirPerTimeIMin_C "Integrated air mass minimum value" VALUE 0xE4BFF Kw_Wu8 1500. AirMassPerTime 0.00 1500. FORMAT "%5.0" EXTENDED_LIMITS 0.00 25.50 /end CHARACTERISTIC
/begin CHARACTERISTIC PwrMng_dmAirPerTimeIKi_C "I-governor gain, deviation is within small signal bounds" VALUE 0xE4C00 Kw_Wu32 5.00003807247 Ki 0.00 5.00003807247 FORMAT "%13.11" EXTENDED_LIMITS 0.00 999999.999767 /end CHARACTERISTIC
/begin CHARACTERISTIC PwrMng_dmAirPerTimeIKiPos_C "I-governor gain, deviation is greater than small signal bound" VALUE 0xE4C04 Kw_Wu32 5.00003807247 Ki 0.00 5.00003807247 FORMAT "%13.11" EXTENDED_LIMITS 0.00 999999.999767 /end CHARACTERISTIC
/begin CHARACTERISTIC PwrMng_dmAirPerTimeIKiNeg_C "I-governor gain, deviation is less than small signal bound" VALUE 0xE4C08 Kw_Wu32 5.00003807247 Ki 0.00 5.00003807247 FORMAT "%13.11" EXTENDED_LIMITS 0.00 999999.999767 /end CHARACTERISTIC
/begin CHARACTERISTIC PwrMng_dmAirPerTimeIWinPos_C "I-governor positive window border" VALUE 0xE4C0C Kw_Ws16 1500.000 AirMassPerTime 0.00 1500.000 FORMAT "%8.3" EXTENDED_LIMITS -3276.800 3276.700 /end CHARACTERISTIC
/begin CHARACTERISTIC PwrMng_dmAirPerTimeIWinNeg_C "I-governor negative window border" VALUE 0xE4C0E Kw_Ws16 1500.000 AirMassPerTime 0.00 1500.000 FORMAT "%8.3" EXTENDED_LIMITS -3276.800 3276.700 /end CHARACTERISTIC
/begin CHARACTERISTIC PwrMng_nB_kwdrehtHi_C "" VALUE 0xE4C10 Kw_Ws16 6000.000 EngN 0.00 6000.000 FORMAT "%8.3" EXTENDED_LIMITS -32768.00 32767.00 /end CHARACTERISTIC
/begin CHARACTERISTIC PwrMng_nB_kwdrehtLo_C "" VALUE 0xE4C12 Kw_Ws16 6000.000 EngN 0.00 6000.000 FORMAT "%8.3" EXTENDED_LIMITS -32768.00 32767.00 /end CHARACTERISTIC
/begin CHARACTERISTIC PwrMng_nB_llHigh_C "High threshold for condition low idle" VALUE 0xE4C14 Kw_Ws16 6000.000 EngN 0.00 6000.000 FORMAT "%8.3" EXTENDED_LIMITS -32768.00 32767.00 /end CHARACTERISTIC
/begin CHARACTERISTIC PwrMng_nB_llLow_C "Low threshold for condition low idle" VALUE 0xE4C16 Kw_Ws16 6000.000 EngN 0.00 6000.000 FORMAT "%8.3" EXTENDED_LIMITS -32768.00 32767.00 /end CHARACTERISTIC
/begin CHARACTERISTIC PwrMng_rLoadMax_C "Threshold for condition maximum load" VALUE 0xE4C18 Kw_Ws16 100.0000 Prc 0.00 100.0000 FORMAT "%8.4" EXTENDED_LIMITS -400.0000 399.9878 /end CHARACTERISTIC
/begin CHARACTERISTIC PwrMng_stIdlingDefVal_C "defect value for n_idlms" VALUE 0xE4C1A Kw_Wu8 255.0 OneToOne 0.00 255.0 FORMAT "%5.1" /end CHARACTERISTIC
/begin CHARACTERISTIC PwrMng_swtnmot_w_C "switch for nmot_w (Eng_nAvrg/CrSCD_nCurr)" VALUE 0xE4C1B Kw_Wu8 1.000 OneToOne 0.00 1.000 FORMAT "%5.3" EXTENDED_LIMITS 0.00 255.0 /end CHARACTERISTIC
/begin CHARACTERISTIC PwrMng_swtPmsvActiv_C "Applikationslabel fuer Powermanagement" VALUE 0xE4C1C Kw_Wu8 1.000 OneToOne 0.00 1.000 FORMAT "%5.3" EXTENDED_LIMITS 0.00 255.0 /end CHARACTERISTIC
/begin CHARACTERISTIC PwrMng_swttumg_C "switch for tumg (IATSCD_tAir/EATSCD_tAir)" VALUE 0xE4C1D Kw_Wu8 1.000 OneToOne 0.00 1.000 FORMAT "%5.3" EXTENDED_LIMITS 0.00 255.0 /end CHARACTERISTIC
/begin CHARACTERISTIC PwrMng_tiChgBatt_C "Applikationslabel fuer Powermanagement" VALUE 0xE4C1E Kw_Wu16 10000.00 Time_ms 0.00 10000.00 FORMAT "%8.2" EXTENDED_LIMITS 0.00 655350.0 /end CHARACTERISTIC
/begin CHARACTERISTIC PwrMng_tiHisRst_C "Applikationslabel fuer Powermanagement" VALUE 0xE4C20 Kw_Wu16 10000.00 Time_ms 0.00 10000.00 FORMAT "%8.2" EXTENDED_LIMITS 0.00 655350.0 /end CHARACTERISTIC
/begin CHARACTERISTIC PwrMng_Tkat_mod_C "" VALUE 0xE4C22 Kw_Ws16 327675.0 temp_ub_q5_o50 -163890.0 163785.0 FORMAT "%8.1" /end CHARACTERISTIC
/begin CHARACTERISTIC PwrMng_uAltTargetDefVal_C "defect value for ctrgnms" VALUE 0xE4C24 Kw_Ws16 65535.00 OneToOne -32768.00 32767.00 FORMAT "%8.2" /end CHARACTERISTIC
/begin MEASUREMENT BD_BSD "" UBYTE OneToOne 1 100 0.00 255.0 FORMAT "%5.1" ECU_ADDRESS 0x8FF5EC /end MEASUREMENT
/begin MEASUREMENT BD_GEN "" UBYTE OneToOne 1 100 0.00 255.0 FORMAT "%5.1" ECU_ADDRESS 0x8FF5ED /end MEASUREMENT
/begin MEASUREMENT BD_IBS1 "" UBYTE OneToOne 1 100 0.00 255.0 FORMAT "%5.1" ECU_ADDRESS 0x8FF5EE /end MEASUREMENT
/begin MEASUREMENT BD_IBS2 "" UBYTE OneToOne 1 100 0.00 255.0 FORMAT "%5.1" ECU_ADDRESS 0x8FF5EF /end MEASUREMENT
/begin MEASUREMENT BD_IBS3 "" UBYTE OneToOne 1 100 0.00 255.0 FORMAT "%5.1" ECU_ADDRESS 0x8FF5F0 /end MEASUREMENT
/begin MEASUREMENT BD_MANHYDR "" UBYTE OneToOne 1 100 0.00 255.0 FORMAT "%5.1" ECU_ADDRESS 0x8FF5F1 /end MEASUREMENT
/begin MEASUREMENT BD_MANLUFT "" UBYTE OneToOne 1 100 0.00 255.0 FORMAT "%5.1" ECU_ADDRESS 0x8FF5F2 /end MEASUREMENT
/begin MEASUREMENT BD_PMBATT "" UBYTE OneToOne 1 100 0.00 255.0 FORMAT "%5.1" ECU_ADDRESS 0x8FF5F3 /end MEASUREMENT
/begin MEASUREMENT BD_PMBN "" UBYTE OneToOne 1 100 0.00 255.0 FORMAT "%5.1" ECU_ADDRESS 0x8FF5F4 /end MEASUREMENT
/begin MEASUREMENT BD_PMRUHVERL "" UBYTE OneToOne 1 100 0.00 255.0 FORMAT "%5.1" ECU_ADDRESS 0x8FF5F5 /end MEASUREMENT
/begin MEASUREMENT BD_QLT "" UBYTE OneToOne 1 100 0.00 255.0 FORMAT "%5.1" ECU_ADDRESS 0x8FF5F6 /end MEASUREMENT
/begin MEASUREMENT BD_TANS "" UBYTE OneToOne 1 100 0.00 255.0 FORMAT "%5.1" ECU_ADDRESS 0x8FF5F7 /end MEASUREMENT
/begin MEASUREMENT BD_TOENS "" UBYTE OneToOne 1 100 0.00 255.0 FORMAT "%5.1" ECU_ADDRESS 0x8FF5F8 /end MEASUREMENT
/begin MEASUREMENT BD_TUMG "" UBYTE OneToOne 1 100 0.00 255.0 FORMAT "%5.1" ECU_ADDRESS 0x8FF5F9 /end MEASUREMENT
/begin MEASUREMENT Counter_Layer_fp1000_mp "" UBYTE OneToOne 1 100 0.00 255.0 FORMAT "%5.1" ECU_ADDRESS 0x8FF624 /end MEASUREMENT
/begin MEASUREMENT Counter_Layer_fp100_mp "" UBYTE OneToOne 1 100 0.00 255.0 FORMAT "%5.1" ECU_ADDRESS 0x8FF625 /end MEASUREMENT
/begin MEASUREMENT Counter_Layer_fp10_mp "" UBYTE OneToOne 1 100 0.00 255.0 FORMAT "%5.1" ECU_ADDRESS 0x8FF626 /end MEASUREMENT
/begin MEASUREMENT Counter_Layer_fp200_mp "" UBYTE OneToOne 1 100 0.00 255.0 FORMAT "%5.1" ECU_ADDRESS 0x8FF627 /end MEASUREMENT
/begin MEASUREMENT Counter_Layer_ini_mp "" UBYTE OneToOne 1 100 0.00 255.0 FORMAT "%5.1" ECU_ADDRESS 0x8FF628 /end MEASUREMENT
/begin MEASUREMENT Counter_Layer_nl1000_mp "" UBYTE OneToOne 1 100 0.00 255.0 FORMAT "%5.1" ECU_ADDRESS 0x8FF629 /end MEASUREMENT
/begin MEASUREMENT Counter_Layer_nl100_mp "" UBYTE OneToOne 1 100 0.00 255.0 FORMAT "%5.1" ECU_ADDRESS 0x8FF62A /end MEASUREMENT
/begin MEASUREMENT Counter_Layer_nl10_mp "" UBYTE OneToOne 1 100 0.00 255.0 FORMAT "%5.1" ECU_ADDRESS 0x8FF62B /end MEASUREMENT
/begin MEASUREMENT Counter_Layer_nl200_mp "" UBYTE OneToOne 1 100 0.00 255.0 FORMAT "%5.1" ECU_ADDRESS 0x8FF62C /end MEASUREMENT
/begin MEASUREMENT Counter_Layer_wakeup1000_mp "" UBYTE OneToOne 1 100 0.00 255.0 FORMAT "%5.1" ECU_ADDRESS 0x8FF62D /end MEASUREMENT
/begin MEASUREMENT Counter_Layer_wakeup100_mp "" UBYTE OneToOne 1 100 0.00 255.0 FORMAT "%5.1" ECU_ADDRESS 0x8FF62E /end MEASUREMENT
/begin MEASUREMENT Counter_Layer_wakeup10_mp "" UBYTE OneToOne 1 100 0.00 255.0 FORMAT "%5.1" ECU_ADDRESS 0x8FF62F /end MEASUREMENT
/begin MEASUREMENT Counter_Layer_wakeup200_mp "" UBYTE OneToOne 1 100 0.00 255.0 FORMAT "%5.1" ECU_ADDRESS 0x8FF630 /end MEASUREMENT
/begin MEASUREMENT E_BSD "" UBYTE OneToOne 1 100 0.00 255.0 FORMAT "%5.1" ECU_ADDRESS 0x8FF5FA /end MEASUREMENT
/begin MEASUREMENT E_GEN "" UBYTE OneToOne 1 100 0.00 255.0 FORMAT "%5.1" ECU_ADDRESS 0x8FF5FB /end MEASUREMENT
/begin MEASUREMENT E_IBS1 "" UBYTE OneToOne 1 100 0.00 255.0 FORMAT "%5.1" ECU_ADDRESS 0x8FF5FC /end MEASUREMENT
/begin MEASUREMENT E_IBS2 "" UBYTE OneToOne 1 100 0.00 255.0 FORMAT "%5.1" ECU_ADDRESS 0x8FF5FD /end MEASUREMENT
/begin MEASUREMENT E_IBS3 "" UBYTE OneToOne 1 100 0.00 255.0 FORMAT "%5.1" ECU_ADDRESS 0x8FF5FE /end MEASUREMENT
/begin MEASUREMENT E_MANHYDR "" UBYTE OneToOne 1 100 0.00 255.0 FORMAT "%5.1" ECU_ADDRESS 0x8FF5FF /end MEASUREMENT
/begin MEASUREMENT E_MANLUFT "" UBYTE OneToOne 1 100 0.00 255.0 FORMAT "%5.1" ECU_ADDRESS 0x8FF600 /end MEASUREMENT
/begin MEASUREMENT E_PMBATT "" UBYTE OneToOne 1 100 0.00 255.0 FORMAT "%5.1" ECU_ADDRESS 0x8FF601 /end MEASUREMENT
/begin MEASUREMENT E_PMBN "" UBYTE OneToOne 1 100 0.00 255.0 FORMAT "%5.1" ECU_ADDRESS 0x8FF602 /end MEASUREMENT
/begin MEASUREMENT E_PMRUHVERL "" UBYTE OneToOne 1 100 0.00 255.0 FORMAT "%5.1" ECU_ADDRESS 0x8FF603 /end MEASUREMENT
/begin MEASUREMENT E_QLT "" UBYTE OneToOne 1 100 0.00 255.0 FORMAT "%5.1" ECU_ADDRESS 0x8FF604 /end MEASUREMENT
/begin MEASUREMENT E_TANS "" UBYTE OneToOne 1 100 0.00 255.0 FORMAT "%5.1" ECU_ADDRESS 0x8FF605 /end MEASUREMENT
/begin MEASUREMENT E_TOENS "" UBYTE OneToOne 1 100 0.00 255.0 FORMAT "%5.1" ECU_ADDRESS 0x8FF606 /end MEASUREMENT
/begin MEASUREMENT E_TUMG "" UBYTE OneToOne 1 100 0.00 255.0 FORMAT "%5.1" ECU_ADDRESS 0x8FF607 /end MEASUREMENT
/begin MEASUREMENT InjVCD_ctMI1AgDiff_mp "Zähler für Winkelverletzungen bei Programmierung des Ansteuerbeginns der MI1" UWORD OneToOne 1 100 0.00 65535.00 FORMAT "%8.2" ECU_ADDRESS 0x8FF564 /end MEASUREMENT
/begin MEASUREMENT InjVCD_ctPiI1AgDiff_mp "Zähler für Winkelverletzungen bei Programmierung des Ansteuerbeginns der PiI1" UWORD OneToOne 1 100 0.00 65535.00 FORMAT "%8.2" ECU_ADDRESS 0x8FF56C /end MEASUREMENT
/begin MEASUREMENT InjVCD_ctPiI2AgDiff_mp "Zähler für Winkelverletzungen bei Programmierung des Ansteuerbeginns der PiI2" UWORD OneToOne 1 100 0.00 65535.00 FORMAT "%8.2" ECU_ADDRESS 0x8FF568 /end MEASUREMENT
/begin MEASUREMENT InjVCD_phiMI1Diff_mp "Winkeldifferenz zwischen dem gewünschten Ansteuerbeginn und dem systembed. frühesten Ansteuerbeginn der MI1" SWORD AngleCrS 1 100 -768.0000 767.9766 FORMAT "%8.4" ECU_ADDRESS 0x8FF566 /end MEASUREMENT
/begin MEASUREMENT InjVCD_phiPiI1Diff_mp "Winkeldifferenz zwischen dem gewünschten Ansteuerbeginn und dem systembed. frühesten Ansteuerbeginn der PiI1" SWORD AngleCrS 1 100 -768.0000 767.9766 FORMAT "%8.4" ECU_ADDRESS 0x8FF56E /end MEASUREMENT
/begin MEASUREMENT InjVCD_phiPiI2Diff_mp "Winkeldifferenz zwischen dem gewünschten Ansteuerbeginn und dem systembed. frühesten Ansteuerbeginn der PiI2" SWORD AngleCrS 1 100 -768.0000 767.9766 FORMAT "%8.4" ECU_ADDRESS 0x8FF56A /end MEASUREMENT
/begin MEASUREMENT InjVCD_qInZFCETGMap_mp "Menge fuer Eingangsanzeige der Gruppenkennfelder InjVCD_rZFCETMsk_GMAP, ...Dif0_GMAP, ...Dif1_GMAP" SWORD InjMassInj 1 100 -327.6800 327.6700 FORMAT "%8.4" ECU_ADDRESS 0x8FF578 /end MEASUREMENT
/begin MEASUREMENT InjVCD_rZFCETCoeffDif_mp "Bewertungsfaktoren fuer Ansteuerdauerkorrektur durch Nullmengenkalibrierung" SWORD Prc 1 100 -400.0000 399.9878 FORMAT "%8.4" ARRAY_SIZE 3 ECU_ADDRESS 0x8FF570 /end MEASUREMENT
/begin MEASUREMENT InjVCD_rZFCETCoeffMsk_mp "Gesamtbewertungsfaktor der Ansteuerdauerkorrektur durch Nullmengenkalibrierung" SWORD Prc 1 100 -400.0000 399.9878 FORMAT "%8.4" ECU_ADDRESS 0x8FF576 /end MEASUREMENT
/begin MEASUREMENT InjVCD_stInjZFC_mp "Status der ZFC Programmierung" UBYTE OneToOne 1 100 0.00 255.0 FORMAT "%5.1" ECU_ADDRESS 0x8FF563 /end MEASUREMENT
/begin MEASUREMENT InjVCD_tiPiI1ZFCETCor_mp "Ansteuerdauerkorrektur der ZFC für Voreinspritzung 1 und jeden Zylinder" SWORD InjTime_us 1 100 -32768.00 32767.00 FORMAT "%8.2" ARRAY_SIZE 6 ECU_ADDRESS 0x6F818A /end MEASUREMENT
/begin MEASUREMENT InjVCD_tiPiI2ZFCETCor_mp "Ansteuerdauerkorrektur der ZFC für Voreinspritzung 2 und jeden Zylinder" SWORD InjTime_us 1 100 -32768.00 32767.00 FORMAT "%8.2" ARRAY_SIZE 6 ECU_ADDRESS 0x6F8196 /end MEASUREMENT
/begin MEASUREMENT InjVCD_tiPiI3ZFCETCor_mp "Ansteuerdauerkorrektur der ZFC für Voreinspritzung 3 und jeden Zylinder" SWORD InjTime_us 1 100 -32768.00 32767.00 FORMAT "%8.2" ARRAY_SIZE 6 ECU_ADDRESS 0x6F81A2 /end MEASUREMENT
/begin MEASUREMENT InjVlv_facAddBalRls "Ergebniss aus Freigabekennfeld zur Aufrechnung der Mengenkorrektur als Array (zylinderspezifisch)" SWORD Fact 1 100 -4.000000 3.999878 FORMAT "%8.6" ARRAY_SIZE 6 ECU_ADDRESS 0x7F92FC /end MEASUREMENT
/begin MEASUREMENT InjVlv_facFTSWvCor "Faktor der Druckwellenkorrektur abhängig von der Kraftstofftemperatur" SWORD Fact 1 100 -4.000000 3.999878 FORMAT "%8.6" ECU_ADDRESS 0x7F8EFE /end MEASUREMENT
/begin MEASUREMENT InjVlv_facMI1PoI2WvCor_mp "Druckwellenkorrekturfaktor für PoI2" SWORD Fact1 1 100 -256.0000 255.9922 FORMAT "%8.4" ECU_ADDRESS 0x8FF5C6 /end MEASUREMENT
/begin MEASUREMENT InjVlv_facPiI2PiI1WvCor_mp "Druckwellenkorrekturfaktor der PiI1" SWORD Fact1 1 100 -256.0000 255.9922 FORMAT "%8.4" ECU_ADDRESS 0x8FF5C8 /end MEASUREMENT
/begin MEASUREMENT InjVlv_facPiIMI1WvCor_mp "Druckwellenkorrekturfaktor der MI1" SWORD Fact1 1 100 -256.0000 255.9922 FORMAT "%8.4" ECU_ADDRESS 0x8FF5CA /end MEASUREMENT
/begin MEASUREMENT InjVlv_nCyl "Zylinderspezifische Drehzahl für alle Zylinder" SWORD EngN 1 100 -32768.00 32767.00 FORMAT "%8.2" ARRAY_SIZE 6 ECU_ADDRESS 0x7F9308 /end MEASUREMENT
/begin MEASUREMENT InjVlv_numIdxErrCyl1_mp "Indizes erkannter Muster für Zylinder 1" ULONG OneToOne 1 100 0.00 4294967295.00 FORMAT "%13.2" ECU_ADDRESS 0x8FF58C /end MEASUREMENT
/begin MEASUREMENT InjVlv_numIdxErrCyl2_mp "Indizes erkannter Muster für Zylinder 2" ULONG OneToOne 1 100 0.00 4294967295.00 FORMAT "%13.2" ECU_ADDRESS 0x8FF590 /end MEASUREMENT
/begin MEASUREMENT InjVlv_numIdxErrCyl3_mp "Indizes erkannter Muster für Zylinder 3" ULONG OneToOne 1 100 0.00 4294967295.00 FORMAT "%13.2" ECU_ADDRESS 0x8FF594 /end MEASUREMENT
/begin MEASUREMENT InjVlv_numIdxErrCyl4_mp "Indizes erkannter Muster für Zylinder 4" ULONG OneToOne 1 100 0.00 4294967295.00 FORMAT "%13.2" ECU_ADDRESS 0x8FF598 /end MEASUREMENT
/begin MEASUREMENT InjVlv_numIdxErrCyl5_mp "Indizes erkannter Muster für Zylinder 5" ULONG OneToOne 1 100 0.00 4294967295.00 FORMAT "%13.2" ECU_ADDRESS 0x8FF59C /end MEASUREMENT
/begin MEASUREMENT InjVlv_numIdxErrCyl6_mp "Indizes erkannter Muster für Zylinder 6" ULONG OneToOne 1 100 0.00 4294967295.00 FORMAT "%13.2" ECU_ADDRESS 0x8FF5A0 /end MEASUREMENT
/begin MEASUREMENT InjVlv_numInjChrgBal_mp "Maximale Anzahl an Einspritzungen aufgrund der Ladungsbilanz des Boosterkondensators" UBYTE OneToOne 1 100 0.00 255.0 FORMAT "%5.1" ECU_ADDRESS 0x8FF588 /end MEASUREMENT
/begin MEASUREMENT InjVlv_pActInDiffHyd_mp "Aktueller Raildruck als Eingangswert für das Kennfeld InjVlv_tiDiffHydMAP" SWORD Pres_Rail 1 100 -3276.800 3276.700 FORMAT "%5.3" ECU_ADDRESS 0x8FF5BA /end MEASUREMENT
/begin MEASUREMENT InjVlv_qDesInDiffHyd_mp "Gewünschte Einspritzmenge als Eingangswert für das Kennfeld InjVlv_tiDiffHydMAP" SWORD InjMassInj 1 100 -327.6800 327.6700 FORMAT "%8.4" ECU_ADDRESS 0x8FF5BC /end MEASUREMENT
/begin MEASUREMENT InjVlv_qFBCCyl "Zylinderselektive FBC-Mengenkorrektur für alle Zylinder" SWORD InjMass 1 100 -327.6800 327.6700 FORMAT "%8.4" ARRAY_SIZE 6 ECU_ADDRESS 0x7F9314 /end MEASUREMENT
/begin MEASUREMENT InjVlv_qMI1Bal_mp "Korrekturmenge Haupteinspritzung 1" SWORD InjMassInj 1 100 -327.6800 327.6700 FORMAT "%8.4" ECU_ADDRESS 0x8FF57A /end MEASUREMENT
/begin MEASUREMENT InjVlv_qMI1PoI2WvCor_mp "Grundwert der Druckwellenkorrekturmenge der PoI2" SWORD InjMassInj 1 100 -327.6800 327.6700 FORMAT "%8.4" ECU_ADDRESS 0x8FF5CC /end MEASUREMENT
/begin MEASUREMENT InjVlv_qMI1WvCor_mp "Druckwellenkorrekturmenge der MI1" SWORD InjMassInj 1 100 -327.6800 327.6700 FORMAT "%8.4" ECU_ADDRESS 0x8FF5CE /end MEASUREMENT
/begin MEASUREMENT InjVlv_qPiI1Bal_mp "Korrekturmenge Voreinspritzung 1" SWORD InjMassInj 1 100 -327.6800 327.6700 FORMAT "%8.4" ECU_ADDRESS 0x8FF57C /end MEASUREMENT
/begin MEASUREMENT InjVlv_qPiI1MI1WvCor_mp "Grundwert der Druckwellenkorrekturmenge der MI1 abhängig von PiI1" SWORD InjMassInj 1 100 -327.6800 327.6700 FORMAT "%8.4" ECU_ADDRESS 0x8FF5D0 /end MEASUREMENT
/begin MEASUREMENT InjVlv_qPiI1WvCor_mp "Druckwellenkorrekturmenge der PiI1" SWORD InjMassInj 1 100 -327.6800 327.6700 FORMAT "%8.4" ECU_ADDRESS 0x8FF5D2 /end MEASUREMENT
/begin MEASUREMENT InjVlv_qPiI2Bal_mp "Korrekturmenge Voreinspritzung 2" SWORD InjMassInj 1 100 -327.6800 327.6700 FORMAT "%8.4" ECU_ADDRESS 0x8FF57E /end MEASUREMENT
/begin MEASUREMENT InjVlv_qPiI2MI1WvCor_mp "Grundwert der Druckwellenkorrekturmenge der MI1 abhängig von PiI2" SWORD InjMassInj 1 100 -327.6800 327.6700 FORMAT "%8.4" ECU_ADDRESS 0x8FF5D4 /end MEASUREMENT
/begin MEASUREMENT InjVlv_qPiI2PiI1WvCor_mp "Grundwert der Druckwellenkorrekturmenge der PiI1" SWORD InjMassInj 1 100 -327.6800 327.6700 FORMAT "%8.4" ECU_ADDRESS 0x8FF5D6 /end MEASUREMENT
/begin MEASUREMENT InjVlv_qPiI3Bal_mp "Korrekturmenge Voreinspritzung 3" SWORD InjMassInj 1 100 -327.6800 327.6700 FORMAT "%8.4" ECU_ADDRESS 0x8FF580 /end MEASUREMENT
/begin MEASUREMENT InjVlv_qPoI1Bal_mp "Korrekturmenge Nacheinspritzung 1" SWORD InjMassInj 1 100 -327.6800 327.6700 FORMAT "%8.4" ECU_ADDRESS 0x8FF582 /end MEASUREMENT
/begin MEASUREMENT InjVlv_qPoI2BalEff_mp "Korrekturmenge für Nacheinspritzung 2, Moment bildender Teil" SWORD InjMassInj 1 100 -327.6800 327.6700 FORMAT "%8.4" ECU_ADDRESS 0x8FF584 /end MEASUREMENT
/begin MEASUREMENT InjVlv_qPoI2Bal_mp "Korrekturmenge Nacheinspritzung 2" SWORD InjMassInj 1 100 -327.6800 327.6700 FORMAT "%8.4" ECU_ADDRESS 0x8FF586 /end MEASUREMENT
/begin MEASUREMENT InjVlv_qPoI2WvCor_mp "Druckwellenkorrekturmenge der PoI2" SWORD InjMassInj 1 100 -327.6800 327.6700 FORMAT "%8.4" ECU_ADDRESS 0x8FF5D8 /end MEASUREMENT
/begin MEASUREMENT InjVlv_qWvCorNorm "Einspritznormierungsmenge" SWORD InjMassInj 1 100 -327.6800 327.6700 FORMAT "%8.4" ECU_ADDRESS 0x7F8F00 /end MEASUREMENT
/begin MEASUREMENT InjVlv_rMI1WvCorNorm_mp "Raildruckabhängiges normiertes MI1 Einspritzverhältnis für Druckwellenkorrektur" SWORD QntR 1 100 -32.00000 31.99902 FORMAT "%8.5" ECU_ADDRESS 0x8FF5DA /end MEASUREMENT
/begin MEASUREMENT InjVlv_stChipVerCy33x_mp "Versionsnummer des Bausteins CY33x" UBYTE OneToOne 1 100 0.00 255.0 FORMAT "%5.1" ECU_ADDRESS 0x8FF5A4 /end MEASUREMENT
/begin MEASUREMENT InjVlv_stErrBnk1 "lowlevel Fehlermeldung für Bank1" UBYTE OneToOne 1 100 0.00 255.0 FORMAT "%5.1" ECU_ADDRESS 0x7F8911 /end MEASUREMENT
/begin MEASUREMENT InjVlv_stErrBnk2 "lowlevel Fehlermeldung für  Bank2" UBYTE OneToOne 1 100 0.00 255.0 FORMAT "%5.1" ECU_ADDRESS 0x7F8912 /end MEASUREMENT
/begin MEASUREMENT InjVlv_stErrChip "lowlevel Fehlermeldung für CY33x" UBYTE OneToOne 1 100 0.00 255.0 FORMAT "%5.1" ECU_ADDRESS 0x7F8913 /end MEASUREMENT
/begin MEASUREMENT InjVlv_stErrChipPrep "lowlevel Fehlermeldung für CY33x vorverarbeitet" UBYTE OneToOne 1 100 0.00 255.0 FORMAT "%5.1" ECU_ADDRESS 0x7F8914 /end MEASUREMENT
/begin MEASUREMENT InjVlv_stErrClctCyl1 "gesammelte Fehlermeldungen für Zylinder 1" ULONG OneToOne 1 100 0.00 4294967295.00 FORMAT "%13.2" ECU_ADDRESS 0x7F91E0 /end MEASUREMENT
/begin MEASUREMENT InjVlv_stErrClctCyl2 "gesammelte Fehlermeldungen für Zylinder 2" ULONG OneToOne 1 100 0.00 4294967295.00 FORMAT "%13.2" ECU_ADDRESS 0x7F91E4 /end MEASUREMENT
/begin MEASUREMENT InjVlv_stErrClctCyl3 "gesammelte Fehlermeldungen für Zylinder 3" ULONG OneToOne 1 100 0.00 4294967295.00 FORMAT "%13.2" ECU_ADDRESS 0x7F91E8 /end MEASUREMENT
/begin MEASUREMENT InjVlv_stErrClctCyl4 "gesammelte Fehlermeldungen für Zylinder 4" ULONG OneToOne 1 100 0.00 4294967295.00 FORMAT "%13.2" ECU_ADDRESS 0x7F91EC /end MEASUREMENT
/begin MEASUREMENT InjVlv_stErrClctCyl5 "gesammelte Fehlermeldungen für Zylinder 5" ULONG OneToOne 1 100 0.00 4294967295.00 FORMAT "%13.2" ECU_ADDRESS 0x7F91F0 /end MEASUREMENT
/begin MEASUREMENT InjVlv_stErrClctCyl6 "gesammelte Fehlermeldungen für Zylinder 6" ULONG OneToOne 1 100 0.00 4294967295.00 FORMAT "%13.2" ECU_ADDRESS 0x7F91F4 /end MEASUREMENT
/begin MEASUREMENT InjVlv_stErrCyl1_mp "lowlevel Fehlermeldung für Zylinder1" UBYTE OneToOne 1 100 0.00 255.0 FORMAT "%5.1" ECU_ADDRESS 0x8FF5A5 /end MEASUREMENT
/begin MEASUREMENT InjVlv_stErrCyl2_mp "lowlevel Fehlermeldung für Zylinder 2" UBYTE OneToOne 1 100 0.00 255.0 FORMAT "%5.1" ECU_ADDRESS 0x8FF5A6 /end MEASUREMENT
/begin MEASUREMENT InjVlv_stErrCyl3_mp "lowlevel Fehlermeldung für Zylinder 3" UBYTE OneToOne 1 100 0.00 255.0 FORMAT "%5.1" ECU_ADDRESS 0x8FF5A7 /end MEASUREMENT
/begin MEASUREMENT InjVlv_stErrCyl4_mp "lowlevel Fehlermeldung für Zylinder 4" UBYTE OneToOne 1 100 0.00 255.0 FORMAT "%5.1" ECU_ADDRESS 0x8FF5A8 /end MEASUREMENT
/begin MEASUREMENT InjVlv_stErrCyl5_mp "lowlevel Fehlermeldung für Zylinder 5" UBYTE OneToOne 1 100 0.00 255.0 FORMAT "%5.1" ECU_ADDRESS 0x8FF5A9 /end MEASUREMENT
/begin MEASUREMENT InjVlv_stErrCyl6_mp "lowlevel Fehlermeldung für Zylinder 6" UBYTE OneToOne 1 100 0.00 255.0 FORMAT "%5.1" ECU_ADDRESS 0x8FF5AA /end MEASUREMENT
/begin MEASUREMENT InjVlv_stErrUnknown "Fehlermuster des letzten nicht klassifizierbaren Fehlers" ULONG OneToOne 1 100 0.00 4294967295.00 FORMAT "%13.2" ECU_ADDRESS 0x7F91F8 /end MEASUREMENT
/begin MEASUREMENT InjVlv_stIniCy331_mp "Status der Initialisierung des CY331" UWORD OneToOne 1 100 0.00 65535.00 FORMAT "%8.2" ECU_ADDRESS 0x8FF5AC /end MEASUREMENT
/begin MEASUREMENT InjVlv_stInjValve "Zustand des Einspritzventils" UBYTE OneToOne 1 100 0.00 255.0 FORMAT "%5.1" ECU_ADDRESS 0x7F8915 /end MEASUREMENT
/begin MEASUREMENT InjVlv_stWvCor "Status der Druckwellenkorrektur" UBYTE OneToOne 1 100 0.00 255.0 FORMAT "%5.1" ECU_ADDRESS 0x7F8916 /end MEASUREMENT
/begin MEASUREMENT InjVlv_tiMI1DiffHydCor_mp "Differenz zwischen hydraulischem Nadelschliessende und elektrischem Ansteuerende des Injektors für die MI1" SWORD InjTime_us 1 100 -32768.00 32767.00 FORMAT "%8.2" ECU_ADDRESS 0x8FF5BE /end MEASUREMENT
/begin MEASUREMENT InjVlv_tiMI1PoI2Cor_mp "korrigierter Zeitabstand Ende MI1 bis Beginn PoI2" SWORD InjTime_us 1 100 -32768.00 32767.00 FORMAT "%8.2" ECU_ADDRESS 0x8FF5DC /end MEASUREMENT
/begin MEASUREMENT InjVlv_tiMI1PoI2_mp "Zeitabstand ende MI1 bis Beginn PoI2" UWORD InjTime_us 1 100 0.00 65535.00 FORMAT "%8.2" ECU_ADDRESS 0x8FF5DE /end MEASUREMENT
/begin MEASUREMENT InjVlv_tiPiI1DiffHydCor_mp "Differenz zwischen hydraulischem Nadelschliessende und elektrischem Ansteuerende des Injektors für die PiI1" SWORD InjTime_us 1 100 -32768.00 32767.00 FORMAT "%8.2" ECU_ADDRESS 0x8FF5C0 /end MEASUREMENT
/begin MEASUREMENT InjVlv_tiPiI1MI1Cor_mp "korrigierter Zeitabstand Ende PiI1 bis Beginn MI1" SWORD InjTime_us 1 100 -32768.00 32767.00 FORMAT "%8.2" ECU_ADDRESS 0x8FF5E0 /end MEASUREMENT
/begin MEASUREMENT InjVlv_tiPiI1MI1_mp "korrigierter Zeitabstand Ende PiI1 bis Beginn MI1" UWORD InjTime_us 1 100 0.00 65535.00 FORMAT "%8.2" ECU_ADDRESS 0x8FF5E2 /end MEASUREMENT
/begin MEASUREMENT InjVlv_tiPiI2DiffHydCor_mp "Differenz zwischen hydraulischem Nadelschliessende und elektrischem Ansteuerende des Injektors für die PiI2" SWORD InjTime_us 1 100 -32768.00 32767.00 FORMAT "%8.2" ECU_ADDRESS 0x8FF5C2 /end MEASUREMENT
/begin MEASUREMENT InjVlv_tiPiI2MI1Cor_mp "korrigierter Zeitabstand Ende PiI2 bis Beginn MI1" SWORD InjTime_us 1 100 -32768.00 32767.00 FORMAT "%8.2" ECU_ADDRESS 0x8FF5E4 /end MEASUREMENT
/begin MEASUREMENT InjVlv_tiPiI2MI1_mp "Zeitabstand Ende PiI2 bis Beginn MI1" UWORD InjTime_us 1 100 0.00 65535.00 FORMAT "%8.2" ECU_ADDRESS 0x8FF5E6 /end MEASUREMENT
/begin MEASUREMENT InjVlv_tiPiI2PiI1Cor_mp "korrigierter Zeitabstand Ende PiI2 bis Beginn PiI1" SWORD InjTime_us 1 100 -32768.00 32767.00 FORMAT "%8.2" ECU_ADDRESS 0x8FF5E8 /end MEASUREMENT
/begin MEASUREMENT InjVlv_tiPiI2PiI1_mp "Zeitabstand Ende PiI2 bis Beginn PiI1" UWORD InjTime_us 1 100 0.00 65535.00 FORMAT "%8.2" ECU_ADDRESS 0x8FF5EA /end MEASUREMENT
/begin MEASUREMENT InjVlv_tWvCor_mp "Eingangstemperatur fuer die Druckwellenkorrektur" SWORD Temp_Cels 1 100 -50.140 899.860 FORMAT "%8.3" ECU_ADDRESS 0x8FF5C4 /end MEASUREMENT
/begin MEASUREMENT InjVlv_volMI1QntAdj_mp "Injektor-Abgleichmenge der Haupteinspritzung 1" SWORD InjQntInj 1 100 -327.6800 327.6700 FORMAT "%8.4" ECU_ADDRESS 0x8FF5AE /end MEASUREMENT
/begin MEASUREMENT InjVlv_volPiI1QntAdj_mp "Injektor-Abgleichmenge der Voreinspritzung 1" SWORD InjQntInj 1 100 -327.6800 327.6700 FORMAT "%8.4" ECU_ADDRESS 0x8FF5B0 /end MEASUREMENT
/begin MEASUREMENT InjVlv_volPiI2QntAdj_mp "Injektor-Abgleichmenge der Voreinspritzung 2" SWORD InjQntInj 1 100 -327.6800 327.6700 FORMAT "%8.4" ECU_ADDRESS 0x8FF5B2 /end MEASUREMENT
/begin MEASUREMENT InjVlv_volPiI3QntAdj_mp "Injektor-Abgleichmenge der Voreinspritzung 3" SWORD InjQntInj 1 100 -327.6800 327.6700 FORMAT "%8.4" ECU_ADDRESS 0x8FF5B4 /end MEASUREMENT
/begin MEASUREMENT InjVlv_volPoI1QntAdj_mp "Injektor-Abgleichmenge der Nacheinspritzung 1" SWORD InjQntInj 1 100 -327.6800 327.6700 FORMAT "%8.4" ECU_ADDRESS 0x8FF5B6 /end MEASUREMENT
/begin MEASUREMENT InjVlv_volPoI2QntAdj_mp "Injektor-Abgleichmenge der Nacheinspritzung 2" SWORD InjQntInj 1 100 -327.6800 327.6700 FORMAT "%8.4" ECU_ADDRESS 0x8FF5B8 /end MEASUREMENT
/begin MEASUREMENT Layer_bos01_w "" SWORD km_sw_q10 1 100 -327680.0 327670.0 FORMAT "%8.1" ECU_ADDRESS 0x7F8F78 /end MEASUREMENT
/begin MEASUREMENT Layer_bosbtvfbk "" UBYTE rel_ub_q1 1 100 0.00 255.0 FORMAT "%5.1" ECU_ADDRESS 0x7F8945 /end MEASUREMENT
/begin MEASUREMENT Layer_bosstate "" UBYTE DEZ 1 100 0.00 255.0 FORMAT "%5.1" ECU_ADDRESS 0x7F8946 /end MEASUREMENT
/begin MEASUREMENT Layer_bosvalue_DIAG "" UBYTE OneToOne 1 100 0.00 255.0 FORMAT "%5.1" ARRAY_SIZE 6 ECU_ADDRESS 0x7F9272 /end MEASUREMENT
/begin MEASUREMENT Layer_FRC_INTM_T_BOS2 "" UBYTE DEZ 1 100 0.00 255.0 FORMAT "%5.1" ECU_ADDRESS 0x7F8940 /end MEASUREMENT
/begin MEASUREMENT Layer_FRC_INTM_WAY_BOS2 "" UBYTE DEZ 1 100 0.00 255.0 FORMAT "%5.1" ECU_ADDRESS 0x7F8941 /end MEASUREMENT
/begin MEASUREMENT Layer_ID2_BOS2 "" UBYTE DEZ 1 100 0.00 255.0 FORMAT "%5.1" ECU_ADDRESS 0x7F8942 /end MEASUREMENT
/begin MEASUREMENT Layer_idbosmsg "" UBYTE DEZ 1 100 0.00 255.0 FORMAT "%5.1" ECU_ADDRESS 0x7F8947 /end MEASUREMENT
/begin MEASUREMENT Layer_idfbosmg_w "" UWORD DEZ 1 100 0.00 65535.00 FORMAT "%8.2" ECU_ADDRESS 0x7F8F7A /end MEASUREMENT
/begin MEASUREMENT Layer_ID_FN_BOS2 "" SWORD DEZ 1 100 -32768.00 32767.00 FORMAT "%8.2" ECU_ADDRESS 0x7F8F76 /end MEASUREMENT
/begin MEASUREMENT Layer_stExtWaitRdy "" UBYTE DEZ 1 100 0.00 255.0 FORMAT "%5.1" ECU_ADDRESS 0x7F8948 /end MEASUREMENT
/begin MEASUREMENT Layer_stLayer "" UWORD OneToOne 1 100 0.00 65535.00 FORMAT "%8.2" ECU_ADDRESS 0x7F8F7C /end MEASUREMENT
/begin MEASUREMENT Layer_stOelTog "" UBYTE DEZ 1 100 0.00 255.0 FORMAT "%5.1" ECU_ADDRESS 0x7F8949 /end MEASUREMENT
/begin MEASUREMENT Layer_stOelVerb "" UBYTE DEZ 1 100 0.00 255.0 FORMAT "%5.1" ECU_ADDRESS 0x7F894A /end MEASUREMENT
/begin MEASUREMENT Layer_stOelVerl "" UBYTE DEZ 1 100 0.00 255.0 FORMAT "%5.1" ECU_ADDRESS 0x7F894B /end MEASUREMENT
/begin MEASUREMENT Layer_stProcess_u8_CBS_mp "" UBYTE OneToOne 1 100 0.00 255.0 FORMAT "%5.1" ECU_ADDRESS 0x8FF631 /end MEASUREMENT
/begin MEASUREMENT Layer_stProcess_u8_mp "" UBYTE OneToOne 1 100 0.00 255.0 FORMAT "%5.1" ECU_ADDRESS 0x8FF632 /end MEASUREMENT
/begin MEASUREMENT Layer_stProcess_u8_Tuning2_mp "" UBYTE OneToOne 1 100 0.00 255.0 FORMAT "%5.1" ECU_ADDRESS 0x8FF633 /end MEASUREMENT
/begin MEASUREMENT Layer_stProcess_u8_Tuning3_mp "" UBYTE OneToOne 1 100 0.00 255.0 FORMAT "%5.1" ECU_ADDRESS 0x8FF634 /end MEASUREMENT
/begin MEASUREMENT Layer_stProcess_u8_Tuning4_mp "" UBYTE OneToOne 1 100 0.00 255.0 FORMAT "%5.1" ECU_ADDRESS 0x8FF635 /end MEASUREMENT
/begin MEASUREMENT Layer_stProcess_u8_Tuning5_mp "" UBYTE OneToOne 1 100 0.00 255.0 FORMAT "%5.1" ECU_ADDRESS 0x8FF636 /end MEASUREMENT
/begin MEASUREMENT Layer_stProcess_u8_Tuning6_mp "" UBYTE OneToOne 1 100 0.00 255.0 FORMAT "%5.1" ECU_ADDRESS 0x8FF637 /end MEASUREMENT
/begin MEASUREMENT Layer_stProcess_u8_Tuning7_mp "" UBYTE OneToOne 1 100 0.00 255.0 FORMAT "%5.1" ECU_ADDRESS 0x8FF638 /end MEASUREMENT
/begin MEASUREMENT Layer_stProcess_u8_Tuning8_mp "" UBYTE OneToOne 1 100 0.00 255.0 FORMAT "%5.1" ECU_ADDRESS 0x8FF639 /end MEASUREMENT
/begin MEASUREMENT Layer_stProcess_u8_Tuning_mp "" UBYTE OneToOne 1 100 0.00 255.0 FORMAT "%5.1" ECU_ADDRESS 0x8FF63A /end MEASUREMENT
/begin MEASUREMENT Layer_TARD_MON_BOS2 "" UBYTE DEZ 1 100 0.00 255.0 FORMAT "%5.1" ECU_ADDRESS 0x7F8943 /end MEASUREMENT
/begin MEASUREMENT Layer_TARD_YR_BOS2 "" UBYTE DEZ 1 100 0.00 255.0 FORMAT "%5.1" ECU_ADDRESS 0x7F8944 /end MEASUREMENT
/begin MEASUREMENT Layer_volOil "" UBYTE DEZ 1 100 0.00 255.0 FORMAT "%5.1" ECU_ADDRESS 0x7F894D /end MEASUREMENT
/begin MEASUREMENT Layer_volOilRefill "" UBYTE DEZ 1 100 0.00 255.0 FORMAT "%5.1" ECU_ADDRESS 0x7F894E /end MEASUREMENT
/begin MEASUREMENT Layer_zrbosmld "" UBYTE DEZ 1 100 0.00 255.0 FORMAT "%5.1" ECU_ADDRESS 0x7F894F /end MEASUREMENT
/begin MEASUREMENT LIGov_CurrDKd_mp "Aktueller Parametersatzwert kp für den D-Anteil" SLONG Kd_rpm2Nm 1 100 -3276.80000000 3276.79999847 FORMAT "%13.8" ECU_ADDRESS 0x8FF66C /end MEASUREMENT
/begin MEASUREMENT LIGov_CurrDT1_mp "Aktueller Parametersatzwert T1 für den D-Anteil" ULONG TimeDelay_s 1 100 0.0000010000000 4294.9673 FORMAT "%9.4" ECU_ADDRESS 0x8FF670 /end MEASUREMENT
/begin MEASUREMENT LIGov_CurrFlt1T1_mp "Aktueller Parametersatzwert T1 für erstes PT1-Filter (n-Filterung)" ULONG TimeDelay_s 1 100 0.0000010000000 4294.9673 FORMAT "%9.4" ECU_ADDRESS 0x8FF674 /end MEASUREMENT
/begin MEASUREMENT LIGov_CurrFlt2T1_mp "Aktueller Parametersatzwert T1 für zweites PT1-Filter (n-Filterung)" ULONG TimeDelay_s 1 100 0.0000010000000 4294.9673 FORMAT "%9.4" ECU_ADDRESS 0x8FF678 /end MEASUREMENT
/begin MEASUREMENT LIGov_CurrIKiNeg_mp "Aktueller Parametersatzwert ki (negatives Großsignal) für den I-Anteil" SLONG Ki_rpm2Nm 1 100 -400000.000000 399999.999814 FORMAT "%13.6" ECU_ADDRESS 0x8FF67C /end MEASUREMENT
/begin MEASUREMENT LIGov_CurrIKiPos_mp "Aktueller Parametersatzwert ki (positives Großsignal) für den I-Anteil" SLONG Ki_rpm2Nm 1 100 -400000.000000 399999.999814 FORMAT "%13.6" ECU_ADDRESS 0x8FF680 /end MEASUREMENT
/begin MEASUREMENT LIGov_CurrIKi_mp "Aktueller Parametersatzwert ki (Kleinsignal) für den I-Anteil" SLONG Ki_rpm2Nm 1 100 -400000.000000 399999.999814 FORMAT "%13.6" ECU_ADDRESS 0x8FF684 /end MEASUREMENT
/begin MEASUREMENT LIGov_CurrIWinNeg_mp "Aktueller Parametersatzwert Fensterbreite (negatives Großsignal) für den I-Anteil" SWORD EngN_HiRes 1 100 -4096.000 4095.875 FORMAT "%8.3" ECU_ADDRESS 0x8FF688 /end MEASUREMENT
/begin MEASUREMENT LIGov_CurrIWinPos_mp "Aktueller Parametersatzwert Fensterbreite (positives Großsignal) für den I-Anteil" SWORD EngN_HiRes 1 100 -4096.000 4095.875 FORMAT "%8.3" ECU_ADDRESS 0x8FF68A /end MEASUREMENT
/begin MEASUREMENT LIGov_CurrPKpNeg_mp "Aktueller Parametersatzwert kp (negatives Großsignal) für den P-Anteil" SLONG Kp_rpm2Nm 1 100 -26214.4000000 26214.3999878 FORMAT "%13.7" ECU_ADDRESS 0x8FF68C /end MEASUREMENT
/begin MEASUREMENT LIGov_CurrPKpPos_mp "Aktueller Parametersatzwert kp (positives Großsignal) für den P-Anteil" SLONG Kp_rpm2Nm 1 100 -26214.4000000 26214.3999878 FORMAT "%13.7" ECU_ADDRESS 0x8FF690 /end MEASUREMENT
/begin MEASUREMENT LIGov_CurrPKp_mp "Aktueller Parametersatzwert kp (Kleinsignal) für P-Anteil" SLONG Kp_rpm2Nm 1 100 -26214.4000000 26214.3999878 FORMAT "%13.7" ECU_ADDRESS 0x8FF694 /end MEASUREMENT
/begin MEASUREMENT LIGov_CurrPWinNeg_mp "Aktueller Parametersatzwert Fensterbreite (negatives Großsignal) für den P-Anteil" SWORD EngN_HiRes 1 100 -4096.000 4095.875 FORMAT "%8.3" ECU_ADDRESS 0x8FF698 /end MEASUREMENT
/begin MEASUREMENT LIGov_CurrPWinPos_mp "Aktueller Parametersatzwert Fensterbreite (positives Großsignal) für den P-Anteil" SWORD EngN_HiRes 1 100 -4096.000 4095.875 FORMAT "%8.3" ECU_ADDRESS 0x8FF69A /end MEASUREMENT
/begin MEASUREMENT LIGov_nAvrg_mp "OLDA-Größe für Eng_nAvrg" SWORD EngN 1 100 -32768.00 32767.00 FORMAT "%8.2" ECU_ADDRESS 0x8FF69C /end MEASUREMENT
/begin MEASUREMENT LIGov_nDiffDelta_mp "Delta zur Drehzahlschwelle Sicherheitsrampe" SWORD EngN 1 100 -32768.00 32767.00 FORMAT "%8.2" ECU_ADDRESS 0x8FF63E /end MEASUREMENT
/begin MEASUREMENT LIGov_nDiffFlt1_mp "Regelabweichung hinter dem ersten PT1-Filter" SWORD EngN_HiRes 1 100 -4096.000 4095.875 FORMAT "%8.3" ECU_ADDRESS 0x8FF69E /end MEASUREMENT
/begin MEASUREMENT LIGov_nDiffFlt2_mp "Regelabweichung hinter zweitem PT1-Filter" SWORD EngN_HiRes 1 100 -4096.000 4095.875 FORMAT "%8.3" ECU_ADDRESS 0x8FF6A0 /end MEASUREMENT
/begin MEASUREMENT LIGov_nDiff_mp "n Regelabweichung" SWORD EngN 1 100 -32768.00 32767.00 FORMAT "%8.2" ECU_ADDRESS 0x8FF6A2 /end MEASUREMENT
/begin MEASUREMENT LIGov_nHDC_mp "LL-Solldrehzahl aufgrund HDC" SWORD EngN 1 100 -32768.00 32767.00 FORMAT "%8.2" ECU_ADDRESS 0x8FF640 /end MEASUREMENT
/begin MEASUREMENT LIGov_nLimHigh "" SWORD EngN 1 100 -32768.00 32767.00 FORMAT "%8.2" ECU_ADDRESS 0x7F8F02 /end MEASUREMENT
/begin MEASUREMENT LIGov_nMaxTrq "Drehzahldifferenz zur Vermeidung von Momentensprüngen aufgrund sprungförmiger LL-Solldrehzahl" SWORD EngN 1 100 -32768.00 32767.00 FORMAT "%8.2" ECU_ADDRESS 0x7F8F04 /end MEASUREMENT
/begin MEASUREMENT LIGov_nSetCoEngOld_mp "Vorhergehende LL-Solldrehzahl aus CoEng_nMin (nach Rampe)" SWORD EngN 1 100 -32768.00 32767.00 FORMAT "%8.2" ECU_ADDRESS 0x8FF642 /end MEASUREMENT
/begin MEASUREMENT LIGov_nSetCoEng_mp "LL-Solldrehzahl aus CoEng_nMin (nach Rampe)" SWORD EngN 1 100 -32768.00 32767.00 FORMAT "%8.2" ECU_ADDRESS 0x8FF644 /end MEASUREMENT
/begin MEASUREMENT LIGov_nSetGearbxOld_mp "Vorhergehende LL-Solldrehzahl aus Gearbx_nMin (nach Rampe)" SWORD EngN 1 100 -32768.00 32767.00 FORMAT "%8.2" ECU_ADDRESS 0x8FF646 /end MEASUREMENT
/begin MEASUREMENT LIGov_nSetGearbx_mp "LL-Solldrehzahl aus Gearbx_nMin (nach Rampe)" SWORD EngN 1 100 -32768.00 32767.00 FORMAT "%8.2" ECU_ADDRESS 0x8FF648 /end MEASUREMENT
/begin MEASUREMENT LIGov_nSetHDCOld_mp "Vorhergehende LL-Solldrehzahl aufgrund HDC (nach Rampe)" SWORD EngN 1 100 -32768.00 32767.00 FORMAT "%8.2" ECU_ADDRESS 0x8FF64A /end MEASUREMENT
/begin MEASUREMENT LIGov_nSetHDC_mp "LL-Solldrehzahl aufgrund HDC (nach Rampe)" SWORD EngN 1 100 -32768.00 32767.00 FORMAT "%8.2" ECU_ADDRESS 0x8FF64C /end MEASUREMENT
/begin MEASUREMENT LIGov_nSetLocal0_mp "LIGov set point before adding trimming setpoint" SWORD EngN 1 100 -32768.00 32767.00 FORMAT "%8.2" ECU_ADDRESS 0x8FF64E /end MEASUREMENT
/begin MEASUREMENT LIGov_nSetLocal2 "LL-Solldrehzahl aus ""langsamen' Anforderem"" (Startabwurf, temp.abhängig, Diagnoseabgleich)" SWORD EngN 1 100 -32768.00 32767.00 FORMAT "%8.2" ECU_ADDRESS 0x7F8F06 /end MEASUREMENT
/begin MEASUREMENT LIGov_nSetLocalRampOld_mp "Vorhergegangene LL-Solldrehzahl aus ""langsamen Anforderern"" (nach Rampe)" SWORD EngN 1 100 -32768.00 32767.00 FORMAT "%8.2" ECU_ADDRESS 0x8FF650 /end MEASUREMENT
/begin MEASUREMENT LIGov_nSetLocalRamp_mp "LL-Solldrehzahl aus ""langsamen' Anforderem"" (nach Rampe)" SWORD EngN 1 100 -32768.00 32767.00 FORMAT "%8.2" ECU_ADDRESS 0x8FF652 /end MEASUREMENT
/begin MEASUREMENT LIGov_nSetpoint "Leerlaufsolldrehzahl" SWORD EngN 1 100 -32768.00 32767.00 FORMAT "%8.2" ECU_ADDRESS 0x7F8F08 /end MEASUREMENT
/begin MEASUREMENT LIGov_nSetpointOld_mp "Vorhergegangene LL-Solldrehzahl" SWORD EngN 1 100 -32768.00 32767.00 FORMAT "%8.2" ECU_ADDRESS 0x8FF654 /end MEASUREMENT
/begin MEASUREMENT LIGov_nSetpointTemp_mp "Sollwert Leerlaufregler temperaturabhängig" SWORD EngN 1 100 -32768.00 32767.00 FORMAT "%8.2" ECU_ADDRESS 0x8FF656 /end MEASUREMENT
/begin MEASUREMENT LIGov_nSetpointTrm "Abgleich LLR-Solldrehzahl" SWORD EngN 1 100 -32768.00 32767.00 FORMAT "%8.2" ECU_ADDRESS 0x7F8F0A /end MEASUREMENT
/begin MEASUREMENT LIGov_nSetpointTrm_mp "Meßpunkt zeigt den Leerlaufsollwert nach der Korrektur mit dem Abgleichwert" SWORD EngN 1 100 -32768.00 32767.00 FORMAT "%8.2" ECU_ADDRESS 0x8FF658 /end MEASUREMENT
/begin MEASUREMENT LIGov_nSetPwrMngOld_mp "Vorhergegangene LL-Solldrehzahl aus PwrMng_nMin (nach Rampe)" SWORD EngN 1 100 -32768.00 32767.00 FORMAT "%8.2" ECU_ADDRESS 0x8FF65A /end MEASUREMENT
/begin MEASUREMENT LIGov_nSetPwrMng_mp "LL-Solldrehzahl aus PwrMng_nMin (nach Rampe)" SWORD EngN 1 100 -32768.00 32767.00 FORMAT "%8.2" ECU_ADDRESS 0x8FF65C /end MEASUREMENT
/begin MEASUREMENT LIGov_nSetSec1_mp "Erster Sicherheitswert zur Begrenzung der LL-Solldrehzahl" SWORD EngN 1 100 -32768.00 32767.00 FORMAT "%8.2" ECU_ADDRESS 0x8FF65E /end MEASUREMENT
/begin MEASUREMENT LIGov_nSetSec2_mp "Zweiter Sicherheitswert zur Begrenzung der LL-Solldrehzahl" SWORD EngN 1 100 -32768.00 32767.00 FORMAT "%8.2" ECU_ADDRESS 0x8FF660 /end MEASUREMENT
/begin MEASUREMENT LIGov_nSetSec4_mp "Viertter Sicherheitswert zur Begrenzung der LL-Solldrehzahl" SWORD EngN 1 100 -32768.00 32767.00 FORMAT "%8.2" ECU_ADDRESS 0x8FF662 /end MEASUREMENT
/begin MEASUREMENT LIGov_nSetSurgeOld_mp "Vorhergegangene LL-Solldrehzahl aus PCR_nSetPointSurge (nach Rampe)" SWORD EngN 1 100 -32768.00 32767.00 FORMAT "%8.2" ECU_ADDRESS 0x8FF664 /end MEASUREMENT
/begin MEASUREMENT LIGov_nSetSurge_mp "LL-Solldrehzahl aus PCR_nSetPointSurge (nach Rampe)" SWORD EngN 1 100 -32768.00 32767.00 FORMAT "%8.2" ECU_ADDRESS 0x8FF666 /end MEASUREMENT
/begin MEASUREMENT LIGov_rIpoConvPS_mp "Verhältnis für die Interpolation zwischen Kalt- und Warmparametersatz" SWORD Fact 1 100 -4.000000 3.999878 FORMAT "%8.6" ECU_ADDRESS 0x8FF6A4 /end MEASUREMENT
/begin MEASUREMENT LIGov_st "Zustand des Leerlaufreglers" UWORD OneToOne 1 100 0.00 65535.00 FORMAT "%8.2" ECU_ADDRESS 0x7F8F0C /end MEASUREMENT
/begin MEASUREMENT LIGov_stActiveHDC "Zustand für aktivierte LL-Solldrehzahl aufgrund HDC" UBYTE OneToOne 1 100 0.00 255.0 FORMAT "%5.1" ECU_ADDRESS 0x7F8917 /end MEASUREMENT
/begin MEASUREMENT LIGov_stSetPoint "Status Leerlauf-Solldrehzahl-Anforderung" UWORD OneToOne 1 100 0.00 65535.00 FORMAT "%8.2" ECU_ADDRESS 0x7F8F0E /end MEASUREMENT
/begin MEASUREMENT LIGov_stSetpointTrmActive "" UBYTE OneToOne 1 100 0.00 255.0 FORMAT "%5.1" ECU_ADDRESS 0x7F8919 /end MEASUREMENT
/begin MEASUREMENT LIGov_stSetpointTrmAlw_mp "" UBYTE OneToOne 1 100 0.00 255.0 FORMAT "%5.1" ECU_ADDRESS 0x8FF668 /end MEASUREMENT
/begin MEASUREMENT LIGov_stSetTrqActive "Status zum Moment anforderung über Diagnose für NMK Schnellernen" UBYTE OneToOne 1 100 0.00 255.0 FORMAT "%5.1" ECU_ADDRESS 0x7F8918 /end MEASUREMENT
/begin MEASUREMENT LIGov_stSetTrqAlw_mp "Status zum Erlauben oder nicht Erlauben der Moment anforderung über Diagnose für NMK Schnellernen" UBYTE OneToOne 1 100 0.00 255.0 FORMAT "%5.1" ECU_ADDRESS 0x8FF6A6 /end MEASUREMENT
/begin MEASUREMENT LIGov_tiPT1_mp "aktuelle PT1 Zeitkonstante für PT1 filtern des LLR Ausgangs" SWORD TimeDelay_s_Lin_16 1 100 -5.000153 5.000000 FORMAT "%8.6" ECU_ADDRESS 0x8FF6A8 /end MEASUREMENT
/begin MEASUREMENT LIGov_trq "Leerlaufreglermoment" SWORD Trq 1 100 -3276.800 3276.700 FORMAT "%8.3" ECU_ADDRESS 0x7F8F10 /end MEASUREMENT
/begin MEASUREMENT LIGov_trqCurrPredef "aktuell verwendetes Einsschrittmoment" SWORD Trq 1 100 -3276.800 3276.700 FORMAT "%8.3" ECU_ADDRESS 0x7F8F12 /end MEASUREMENT
/begin MEASUREMENT LIGov_trqDRaw_mp "LLR D-Anteil Rohwert (ohne Gewichtsfaktor)" SWORD Trq 1 100 -3276.800 3276.700 FORMAT "%8.3" ECU_ADDRESS 0x8FF6AA /end MEASUREMENT
/begin MEASUREMENT LIGov_trqD_mp "Messpunkt für den Wert des D-Anteils des LLR" SWORD Trq 1 100 -3276.800 3276.700 FORMAT "%8.3" ECU_ADDRESS 0x8FF6AC /end MEASUREMENT
/begin MEASUREMENT LIGov_trqFlt "Leerlaufreglermoment PT1 gefiltert" SWORD Trq 1 100 -3276.800 3276.700 FORMAT "%8.3" ECU_ADDRESS 0x7F8F14 /end MEASUREMENT
/begin MEASUREMENT LIGov_trqI "Wert des I-Anteils des LLR" SWORD Trq 1 100 -3276.800 3276.700 FORMAT "%8.3" ECU_ADDRESS 0x7F8F16 /end MEASUREMENT
/begin MEASUREMENT LIGov_trqInitI "Initialisierungsmoment für I-Anteil nach Start" SWORD Trq 1 100 -3276.800 3276.700 FORMAT "%8.3" ECU_ADDRESS 0x7F8F18 /end MEASUREMENT
/begin MEASUREMENT LIGov_trqLISetRdDIAG_mp "Begrenzt Moment anforderung über Diagnose für NMK Schnellernen" SWORD Trq 1 100 -3276.800 3276.700 FORMAT "%8.3" ECU_ADDRESS 0x8FF6AE /end MEASUREMENT
/begin MEASUREMENT LIGov_trqMax_mp "aktueller LLR Begrenzungswert" SWORD Trq 1 100 -3276.800 3276.700 FORMAT "%8.3" ECU_ADDRESS 0x8FF6B0 /end MEASUREMENT
/begin MEASUREMENT LIGov_trqP "Wert des P-Anteils des LLR" SWORD Trq 1 100 -3276.800 3276.700 FORMAT "%8.3" ECU_ADDRESS 0x7F8F1A /end MEASUREMENT
/begin MEASUREMENT LIGov_trqPreInitI_mp "Initialisierungswert für Integrator als Ergebnis der Integrator-Rückrechnung" SLONG Trq32 1 100 -3276.80000000 3276.79999847 FORMAT "%13.8" ECU_ADDRESS 0x8FF6B4 /end MEASUREMENT
/begin MEASUREMENT LIGov_trqSetDIAG "Moment anforderung über Diagnose für NMK Schnellernen" SWORD Trq 1 100 -3276.800 3276.700 FORMAT "%8.3" ECU_ADDRESS 0x7F8F1C /end MEASUREMENT
/begin MEASUREMENT LIGov_trqSet_mp "Begrenzt Moment anforderung über Diagnose für NMK Schnellernen" SWORD Trq 1 100 -3276.800 3276.700 FORMAT "%8.3" ECU_ADDRESS 0x8FF6B8 /end MEASUREMENT
/begin MEASUREMENT LIGov_trq_mp "" SWORD Trq 1 100 -3276.800 3276.700 FORMAT "%8.3" ECU_ADDRESS 0x8FF6BA /end MEASUREMENT
/begin MEASUREMENT LPACD_rCnv_mp "TV on steller" SWORD DtyCyc 1 100 -327.6800 327.6700 FORMAT "%8.4" ECU_ADDRESS 0x8FF6BC /end MEASUREMENT
/begin MEASUREMENT LPACD_rOut "Ausgabewert on PWM-EST nach batteriespannung korrectur" SWORD DtyCyc 1 100 -327.6800 327.6700 FORMAT "%8.4" ECU_ADDRESS 0x7F8F1E /end MEASUREMENT
/begin MEASUREMENT LSUCD_d2rO2Eval_mp "Bewertungsgröße für Lernfortschritt" SWORD O2 1 100 -0.3276800 0.3276700 FORMAT "%9.7" ARRAY_SIZE 1 ECU_ADDRESS 0x8FF6DE /end MEASUREMENT
/begin MEASUREMENT LSUCD_d2rO2_mp "Eingangsgröße des Bewertungsfilters" SWORD O2 1 100 -0.3276800 0.3276700 FORMAT "%9.7" ARRAY_SIZE 1 ECU_ADDRESS 0x8FF6E0 /end MEASUREMENT
/begin MEASUREMENT LSUCD_dcycHtCor "Tastverhältnis Heizer Endstufe nach Batteriespannungs Korrektur" SWORD DtyCyc 1 100 -327.6800 327.6700 FORMAT "%8.4" ARRAY_SIZE 1 ECU_ADDRESS 0x7F8F22 /end MEASUREMENT
/begin MEASUREMENT LSUCD_dcycLimActHt "Aktuelle Tastverhältnisgrenze Heizeransteuerung für nominales Tastverhältnis (vor Korrektur)" SWORD DtyCyc 1 100 -327.6800 327.6700 FORMAT "%8.4" ECU_ADDRESS 0x7F8F2A /end MEASUREMENT
/begin MEASUREMENT LSUCD_drO2Adpt "Eingelernter absoluter Messfehler der Sauerstoffkonzentration" SWORD O2 1 100 -0.3276800 0.3276700 FORMAT "%9.7" ARRAY_SIZE 1 ECU_ADDRESS 0x7F8F2C /end MEASUREMENT
/begin MEASUREMENT LSUCD_drO2Flt_mp "Ausgangsgröße des Adaptionsfilters" SWORD O2 1 100 -0.3276800 0.3276700 FORMAT "%9.7" ARRAY_SIZE 1 ECU_ADDRESS 0x8FF6E2 /end MEASUREMENT
/begin MEASUREMENT LSUCD_facO2Corr_mp "Aktueller Korrekturfaktor der Adaption" SWORD Fact 1 100 -4.000000 3.999878 FORMAT "%8.6" ARRAY_SIZE 1 ECU_ADDRESS 0x6F81AE /end MEASUREMENT
/begin MEASUREMENT LSUCD_facPresComp_mp "Druckkorrekturfaktor" SWORD Fact 1 100 -4.000000 3.999878 FORMAT "%8.6" ARRAY_SIZE 1 ECU_ADDRESS 0x8FF6F6 /end MEASUREMENT
/begin MEASUREMENT LSUCD_facUCor_mp "Korrektur Faktor für Heizeranforderung" SWORD Fact 1 100 -4.000000 3.999878 FORMAT "%8.6" ECU_ADDRESS 0x8FF6EA /end MEASUREMENT
/begin MEASUREMENT LSUCD_mAirAftOvrRun_mp "Integral über Luftmassenstrom seit Beginn der Schubphase" SWORD AirMass_2 1 100 -3276.800 3276.700 FORMAT "%8.3" ECU_ADDRESS 0x8FF6E4 /end MEASUREMENT
/begin MEASUREMENT LSUCD_pExhGasLstVal_mp "Abgas-Wert des letzten geschätzten Sensors" SWORD Pres_hPa 1 100 -32768.00 32767.00 FORMAT "%8.2" ECU_ADDRESS 0x8FF6F8 /end MEASUREMENT
/begin MEASUREMENT LSUCD_resRi "Ri Meßwert (gefiltert und korrigiert)" SWORD Resist 1 100 -3276.800 3276.700 FORMAT "%8.3" ARRAY_SIZE 1 ECU_ADDRESS 0x7F8F36 /end MEASUREMENT
/begin MEASUREMENT LSUCD_resRiChange_mp "Betrag der Ri-Änderung mit dem letzten gefilterten Wert" SWORD Resist 1 100 -3276.800 3276.700 FORMAT "%8.3" ARRAY_SIZE 1 ECU_ADDRESS 0x8FF6FA /end MEASUREMENT
/begin MEASUREMENT LSUCD_resRiClb "Korrekturwert Ri Offset" SWORD Resist 1 100 -3276.800 3276.700 FORMAT "%8.3" ARRAY_SIZE 1 ECU_ADDRESS 0x7F8F38 /end MEASUREMENT
/begin MEASUREMENT LSUCD_resRiClbRaw_mp "Rohwert Ri Korrektur ohne Filterung" SWORD Resist 1 100 -3276.800 3276.700 FORMAT "%8.3" ARRAY_SIZE 1 ECU_ADDRESS 0x8FF6FC /end MEASUREMENT
/begin MEASUREMENT LSUCD_resRiRaw "Ri Meßwert ohne Korrektur" SWORD Resist 1 100 -3276.800 3276.700 FORMAT "%8.3" ARRAY_SIZE 1 ECU_ADDRESS 0x7F8F40 /end MEASUREMENT
/begin MEASUREMENT LSUCD_resRi_mp "Ri-Messwert gefiltert und korrigiert" SWORD Resist 1 100 -3276.800 3276.700 FORMAT "%8.3" ECU_ADDRESS 0x8FF6FE /end MEASUREMENT
/begin MEASUREMENT LSUCD_rO2Act "Aktueller O2 Meßwert ohne Ausblendung Abgleichvorgang" SWORD O2 1 100 -0.3276800 0.3276700 FORMAT "%9.7" ARRAY_SIZE 1 ECU_ADDRESS 0x7F8F2E /end MEASUREMENT
/begin MEASUREMENT LSUCD_rO2Adpt "Adaptierte Sauerstoffkonzentration" SWORD O2 1 100 -0.3276800 0.3276700 FORMAT "%9.7" ARRAY_SIZE 1 ECU_ADDRESS 0x7F8F30 /end MEASUREMENT
/begin MEASUREMENT LSUCD_rO2PresComp "Druckkompensierte Sauerstoffkonzentration" SWORD O2 1 100 -0.3276800 0.3276700 FORMAT "%9.7" ARRAY_SIZE 1 ECU_ADDRESS 0x7F8F32 /end MEASUREMENT
/begin MEASUREMENT LSUCD_rO2Raw "O2 Wert ohne Druck- und Empfindlichkeitskorrektur" SWORD O2 1 100 -0.3276800 0.3276700 FORMAT "%9.7" ARRAY_SIZE 1 ECU_ADDRESS 0x7F8F34 /end MEASUREMENT
/begin MEASUREMENT LSUCD_rOutHWE_mp "Tastverhältnis Heizerendstufe nach Stellertest Anforderung und Endstufen Diagnose." SWORD DtyCyc 1 100 -327.6800 327.6700 FORMAT "%8.4" ARRAY_SIZE 1 ECU_ADDRESS 0x8FF6EC /end MEASUREMENT
/begin MEASUREMENT LSUCD_stAdpt "Zustandsgröße der Adaption (adaptiert / nicht adaptiert)" UBYTE OneToOne 1 100 0.00 255.0 FORMAT "%5.1" ARRAY_SIZE 1 ECU_ADDRESS 0x7F891C /end MEASUREMENT
/begin MEASUREMENT LSUCD_stAdptActv_mp "Zustand der Lernphase (aktiv / nicht aktiv)" UBYTE OneToOne 1 100 0.00 255.0 FORMAT "%5.1" ARRAY_SIZE 1 ECU_ADDRESS 0x8FF6E6 /end MEASUREMENT
/begin MEASUREMENT LSUCD_stChange_mp "Neues Lernergebnis im aktuellen Fahrzyklus" UBYTE OneToOne 1 100 0.00 255.0 FORMAT "%5.1" ARRAY_SIZE 1 ECU_ADDRESS 0x8FF6E7 /end MEASUREMENT
/begin MEASUREMENT LSUCD_stCircModeNew "Aktueller Wert des Auswerteschaltungs Modes (CJ 120 Konfiguration)" UWORD OneToOne 1 100 0.00 65535.00 FORMAT "%8.2" ARRAY_SIZE 1 ECU_ADDRESS 0x7F8F42 /end MEASUREMENT
/begin MEASUREMENT LSUCD_stHold_mp "Zustandsgröße der Adaption (gestört / nicht gestört)" UBYTE OneToOne 1 100 0.00 255.0 FORMAT "%5.1" ARRAY_SIZE 1 ECU_ADDRESS 0x8FF6E8 /end MEASUREMENT
/begin MEASUREMENT LSUCD_stHtDis "Zustand Heizerabschaltung wegen Batteriespannung oder Betriebsmodus" UBYTE OneToOne 1 100 0.00 255.0 FORMAT "%5.1" ECU_ADDRESS 0x7F891F /end MEASUREMENT
/begin MEASUREMENT LSUCD_stIpHighCurEna "Status-Message für hohen (0 bis 150ua) Referenzpumpstrom für CJ125" UBYTE OneToOne 1 100 0.00 255.0 FORMAT "%5.1" ARRAY_SIZE 1 ECU_ADDRESS 0x7F8921 /end MEASUREMENT
/begin MEASUREMENT LSUCD_stIpNormCurEna "Status-Message für normalen (0 bis 150ua) Referenzpumpstrom für CJ125" UBYTE OneToOne 1 100 0.00 255.0 FORMAT "%5.1" ARRAY_SIZE 1 ECU_ADDRESS 0x7F8922 /end MEASUREMENT
/begin MEASUREMENT LSUCD_stO2Act "Gültigkeitsstatus des aktuellen O2 Signals (0 = ungültig, 1 = gültig)" UBYTE OneToOne 1 100 0.00 255.0 FORMAT "%5.1" ARRAY_SIZE 1 ECU_ADDRESS 0x7F8926 /end MEASUREMENT
/begin MEASUREMENT LSUCD_stO2ClbEna "Auslösesignal für O2 Offsetspannung Kalibriersequenz" UBYTE OneToOne 1 100 0.00 255.0 FORMAT "%5.1" ECU_ADDRESS 0x7F8927 /end MEASUREMENT
/begin MEASUREMENT LSUCD_stO2Clb_mp "Zusatands Bits der O2 Offset Abgleich Sequenz" UBYTE OneToOne 1 100 0.00 255.0 FORMAT "%5.1" ECU_ADDRESS 0x8FF6EF /end MEASUREMENT
/begin MEASUREMENT LSUCD_stO2IntValid "Status des internen O2-Rohsignals (gültig/ungültig)" UBYTE OneToOne 1 100 0.00 255.0 FORMAT "%5.1" ARRAY_SIZE 1 ECU_ADDRESS 0x7F8928 /end MEASUREMENT
/begin MEASUREMENT LSUCD_stO2SPICalDem "SPI Status-Message um die Schaltung in den Kalibriermodus zu versetzen" UBYTE OneToOne 1 100 0.00 255.0 FORMAT "%5.1" ECU_ADDRESS 0x7F8929 /end MEASUREMENT
/begin MEASUREMENT LSUCD_stO2SPISens "Modus-Bits zum Setzen der Empfindlichkeit der O2-Auswertung" UWORD OneToOne 1 100 0.00 65535.00 FORMAT "%8.2" ARRAY_SIZE 1 ECU_ADDRESS 0x7F8F44 /end MEASUREMENT
/begin MEASUREMENT LSUCD_stO2Valid "Zustand O2 Signal (0 = ungültig, 1 = gültig)" UBYTE OneToOne 1 100 0.00 255.0 FORMAT "%5.1" ARRAY_SIZE 1 ECU_ADDRESS 0x7F892A /end MEASUREMENT
/begin MEASUREMENT LSUCD_stPumpCtl "Status der Pumpensteuerung (ein/aus)" UBYTE OneToOne 1 100 0.00 255.0 FORMAT "%5.1" ARRAY_SIZE 1 ECU_ADDRESS 0x7F892D /end MEASUREMENT
/begin MEASUREMENT LSUCD_stPumpDemRef "externe Anforderung Referenzpumpströme" UBYTE OneToOne 1 100 0.00 255.0 FORMAT "%5.1" ARRAY_SIZE 1 ECU_ADDRESS 0x7F892E /end MEASUREMENT
/begin MEASUREMENT LSUCD_stRefCurTrans_mp "Status des Übergangs von hohem zu niedrigem Strom" UBYTE OneToOne 1 100 0.00 255.0 FORMAT "%5.1" ARRAY_SIZE 1 ECU_ADDRESS 0x8FF6EE /end MEASUREMENT
/begin MEASUREMENT LSUCD_stRefPump "Status der Referenz Pumpströme (0 = off, 1 = 20 uA, 2 = 40 uA, 3 = 60 uA)" UBYTE OneToOne 1 100 0.00 255.0 FORMAT "%5.1" ARRAY_SIZE 1 ECU_ADDRESS 0x7F8930 /end MEASUREMENT
/begin MEASUREMENT LSUCD_stRgnEna "Nachricht, um Regeneration zu befähigen" UBYTE OneToOne 1 100 0.00 255.0 FORMAT "%5.1" ECU_ADDRESS 0x7F8931 /end MEASUREMENT
/begin MEASUREMENT LSUCD_stRgnIpSettle "Status des Pumpe-Stromes, der nach Regeneration setzt" UBYTE OneToOne 1 100 0.00 255.0 FORMAT "%5.1" ECU_ADDRESS 0x7F8932 /end MEASUREMENT
/begin MEASUREMENT LSUCD_stRiClb "Status der Ri-Kalibrierungssequenz" UBYTE OneToOne 1 100 0.00 255.0 FORMAT "%5.1" ECU_ADDRESS 0x7F8933 /end MEASUREMENT
/begin MEASUREMENT LSUCD_stRiClbEna "Auslöser für Ri Abgleichsequenz" UBYTE OneToOne 1 100 0.00 255.0 FORMAT "%5.1" ECU_ADDRESS 0x7F8934 /end MEASUREMENT
/begin MEASUREMENT LSUCD_stRiFltAct_mp "Messpunkt für den Status der Filteraktivierung" UBYTE OneToOne 1 100 0.00 255.0 FORMAT "%5.1" ARRAY_SIZE 1 ECU_ADDRESS 0x8FF700 /end MEASUREMENT
/begin MEASUREMENT LSUCD_stRiLimSlp_mp "Zustand der Ri Störungsunterdrückung" UBYTE OneToOne 1 100 0.00 255.0 FORMAT "%5.1" ARRAY_SIZE 1 ECU_ADDRESS 0x8FF701 /end MEASUREMENT
/begin MEASUREMENT LSUCD_stRiSPICalDem "Anforderung der Ri-Regelung Einschaltung des Lern- oder Messmodus" UBYTE OneToOne 1 100 0.00 255.0 FORMAT "%5.1" ECU_ADDRESS 0x7F8935 /end MEASUREMENT
/begin MEASUREMENT LSUCD_stRiValid "Zustand Ri Signals (0 = ungültig, 1 = gültig)" UBYTE OneToOne 1 100 0.00 255.0 FORMAT "%5.1" ARRAY_SIZE 1 ECU_ADDRESS 0x7F8936 /end MEASUREMENT
/begin MEASUREMENT LSUCD_stSPIDiaInfo "Status der SPI Chip Diagnose" UWORD OneToOne 1 100 0.00 65535.00 FORMAT "%8.2" ARRAY_SIZE 1 ECU_ADDRESS 0x7F8F46 /end MEASUREMENT
/begin MEASUREMENT LSUCD_stSPIInitVal "Wert des CJ12x Initialisierungsregisters" UWORD OneToOne 1 100 0.00 65535.00 FORMAT "%8.2" ARRAY_SIZE 1 ECU_ADDRESS 0x7F8F48 /end MEASUREMENT
/begin MEASUREMENT LSUCD_stSRCState_mp "Status der SRC Überwachung des O2 Rohsignales" UBYTE OneToOne 1 100 0.00 255.0 FORMAT "%5.1" ARRAY_SIZE 1 ECU_ADDRESS 0x8FF6F0 /end MEASUREMENT
/begin MEASUREMENT LSUCD_swtAdpt "Schalter für Adaption der Lambda-Sonde" UBYTE OneToOne 1 100 0.00 255.0 FORMAT "%5.1" ECU_ADDRESS 0x7F8937 /end MEASUREMENT
/begin MEASUREMENT LSUCD_tRi "Äquivalenztemperatur des gemessenen Ri-Werts" SWORD Temp_Cels 1 100 -50.140 899.860 FORMAT "%8.3" ARRAY_SIZE 1 ECU_ADDRESS 0x7F8F4A /end MEASUREMENT
/begin MEASUREMENT LSUCD_uO2Clb "Offsetspannungs Korrekturwert für Lambda Spannungswert" SWORD Volt 1 100 -160156.4 160151.5 FORMAT "%8.1" ARRAY_SIZE 1 ECU_ADDRESS 0x7F8F4C /end MEASUREMENT
/begin MEASUREMENT LSUCD_uO2OfsCor_mp "O2 Spannungswert nach Offset Kompensation" SWORD Volt 1 100 -160156.4 160151.5 FORMAT "%8.1" ECU_ADDRESS 0x8FF6F2 /end MEASUREMENT
/begin MEASUREMENT LSUCD_uO2Raw "Spannungsrohwert Lambdasignal nach Mittelung und Subtraktion Referenzwert" SWORD Volt 1 100 -160156.4 160151.5 FORMAT "%8.1" ARRAY_SIZE 1 ECU_ADDRESS 0x7F8F54 /end MEASUREMENT
/begin MEASUREMENT LSUCD_uO2Raw_mp "O2 Spannung nach Mittelwertbildung" SWORD Volt 1 100 -160156.4 160151.5 FORMAT "%8.1" ARRAY_SIZE 1 ECU_ADDRESS 0x8FF6F4 /end MEASUREMENT
/begin MEASUREMENT LSUCD_uRiRaw "Spannungsrohwert Ri nach Mittelung" SWORD Volt 1 100 -160156.4 160151.5 FORMAT "%8.1" ARRAY_SIZE 1 ECU_ADDRESS 0x7F8F56 /end MEASUREMENT
/begin MEASUREMENT LSU_swtEna "Status-Message zu Freigabe oder Sperren der gesamten LSU-Funktionen" UBYTE OneToOne 1 100 0.00 255.0 FORMAT "%5.1" ECU_ADDRESS 0x7F893F /end MEASUREMENT
/begin MEASUREMENT PwrMng_absch_korr "correction value shut off" UWORD OneToOne 1 100 0.00 65535.00 FORMAT "%8.2" ECU_ADDRESS 0x7F9052 /end MEASUREMENT
/begin MEASUREMENT PwrMng_dmAirPerTimeI_mp "integrated air mass" SWORD AirMassPerTime 1 100 -3276.800 3276.700 FORMAT "%8.3" ECU_ADDRESS 0x8FF63C /end MEASUREMENT
/begin MEASUREMENT PwrMng_d_soc "battery load state" UWORD OneToOne 1 100 0.00 65535.00 FORMAT "%8.2" ECU_ADDRESS 0x7F9054 /end MEASUREMENT
/begin MEASUREMENT PwrMng_iEngine "engine current" SWORD igen_ub_q1 1 100 -32768.00 32767.00 FORMAT "%8.2" ECU_ADDRESS 0x7F9056 /end MEASUREMENT
/begin MEASUREMENT PwrMng_iGen "Alternator current" UBYTE igen_ub_q1 1 100 0.00 255.0 FORMAT "%5.1" ECU_ADDRESS 0x7F8992 /end MEASUREMENT
/begin MEASUREMENT PwrMng_nMin "low idle demand from PwrMng" SWORD EngN 1 100 -32768.00 32767.00 FORMAT "%8.2" ECU_ADDRESS 0x7F9058 /end MEASUREMENT
/begin MEASUREMENT PwrMng_nnnstart "start rpm engine" SWORD OneToOne 1 100 -32768.00 32767.00 FORMAT "%8.2" ECU_ADDRESS 0x7F905A /end MEASUREMENT
/begin MEASUREMENT PwrMng_pwrDes "alternator power" SWORD Pwr 1 100 -308831.1 308821.7 FORMAT "%8.1" ECU_ADDRESS 0x7F905C /end MEASUREMENT
/begin MEASUREMENT PwrMng_pwrPTC "dummy power management message" SWORD DtyCyc 1 100 -327.6800 327.6700 FORMAT "%8.4" ECU_ADDRESS 0x7F905E /end MEASUREMENT
/begin MEASUREMENT PwrMng_rCtrPwrSpCos "controlling power extra-consumers" UBYTE fak_q0p5 1 100 0.00 127.5 FORMAT "%5.1" ECU_ADDRESS 0x7F8993 /end MEASUREMENT
/begin MEASUREMENT PwrMng_rdffgen "DF-signal in GS-resolution for CAN" UBYTE PCENT 1 100 0.00 99.61 FORMAT "%5.2" ECU_ADDRESS 0x7F8994 /end MEASUREMENT
/begin MEASUREMENT PwrMng_stB_ccbtnach "Powermanagement value" UBYTE OneToOne 1 100 0.00 255.0 FORMAT "%5.1" ECU_ADDRESS 0x7F8995 /end MEASUREMENT
/begin MEASUREMENT PwrMng_stB_ccbttdfk "Powermanagement value" UBYTE OneToOne 1 100 0.00 255.0 FORMAT "%5.1" ECU_ADDRESS 0x7F8996 /end MEASUREMENT
/begin MEASUREMENT PwrMng_stB_ccbttknt "Powermanagement value" UBYTE OneToOne 1 100 0.00 255.0 FORMAT "%5.1" ECU_ADDRESS 0x7F8997 /end MEASUREMENT
/begin MEASUREMENT PwrMng_stB_ccpmerr "Powermanagement value" UBYTE OneToOne 1 100 0.00 255.0 FORMAT "%5.1" ECU_ADDRESS 0x7F8998 /end MEASUREMENT
/begin MEASUREMENT PwrMng_stB_ccprio "Powermanagement value" UBYTE OneToOne 1 100 0.00 255.0 FORMAT "%5.1" ECU_ADDRESS 0x7F8999 /end MEASUREMENT
/begin MEASUREMENT PwrMng_stB_ccruhver "Powermanagement value" UBYTE OneToOne 1 100 0.00 255.0 FORMAT "%5.1" ECU_ADDRESS 0x7F899A /end MEASUREMENT
/begin MEASUREMENT PwrMng_stB_codierpm "Powermanagement value" UBYTE OneToOne 1 100 0.00 255.0 FORMAT "%5.1" ECU_ADDRESS 0x7F899B /end MEASUREMENT
/begin MEASUREMENT PwrMng_stCtrCbr "controlling current branch" UBYTE DEZ 1 100 0.00 255.0 FORMAT "%5.1" ECU_ADDRESS 0x7F899C /end MEASUREMENT
/begin MEASUREMENT PwrMng_stCtrPCos "controlling stand-consumers" UBYTE DEZ 1 100 0.00 255.0 FORMAT "%5.1" ECU_ADDRESS 0x7F899D /end MEASUREMENT
/begin MEASUREMENT PwrMng_stCtrPrio "controlling priority peak decreasing" UBYTE DEZ 1 100 0.00 255.0 FORMAT "%5.1" ECU_ADDRESS 0x7F899E /end MEASUREMENT
/begin MEASUREMENT PwrMng_stCtrPrioCf "controlling priority peak decreasing" UBYTE DEZ 1 100 0.00 255.0 FORMAT "%5.1" ECU_ADDRESS 0x7F899F /end MEASUREMENT
/begin MEASUREMENT PwrMng_stCtrPwrCos "controlling power consumers bit-coded" UWORD DEZ 1 100 0.00 65535.00 FORMAT "%8.2" ECU_ADDRESS 0x7F9060 /end MEASUREMENT
/begin MEASUREMENT PwrMng_stGen "State alternator" UBYTE OneToOne 1 100 0.00 255.0 FORMAT "%5.1" ECU_ADDRESS 0x7F89A0 /end MEASUREMENT
/begin MEASUREMENT PwrMng_stLdstGen "alternator load state" UBYTE OneToOne 1 100 0.00 255.0 FORMAT "%5.1" ECU_ADDRESS 0x7F89A2 /end MEASUREMENT
/begin MEASUREMENT PwrMng_stLIGov "State of low idle governor" UWORD OneToOne 1 100 0.00 65535.00 FORMAT "%8.2" ECU_ADDRESS 0x7F89A1 /end MEASUREMENT
/begin MEASUREMENT PwrMng_stPCos "state stand-consumers" UBYTE DEZ 1 100 0.00 255.0 FORMAT "%5.1" ECU_ADDRESS 0x7F89A3 /end MEASUREMENT
/begin MEASUREMENT PwrMng_stRqPCos "Demand stand-consumers" UBYTE DEZ 1 100 0.00 255.0 FORMAT "%5.1" ECU_ADDRESS 0x7F89A4 /end MEASUREMENT
/begin MEASUREMENT PwrMng_stSelSpCos "status extra-consumers detection" UBYTE DEZ 1 100 0.00 255.0 FORMAT "%5.1" ECU_ADDRESS 0x7F89A5 /end MEASUREMENT
/begin MEASUREMENT PwrMng_stTerminal61 "Status Klemme 61" UBYTE OneToOne 1 100 0.00 255.0 FORMAT "%5.1" ECU_ADDRESS 0x7F89A6 /end MEASUREMENT
/begin MEASUREMENT PwrMng_stULev "voltage level" UBYTE DEZ 1 100 0.00 255.0 FORMAT "%5.1" ECU_ADDRESS 0x7F89A7 /end MEASUREMENT
/begin MEASUREMENT PwrMng_tiLRGen "Load-Response Zeit" UWORD Time_s 1 100 0.00 655.3500 FORMAT "%8.4" ECU_ADDRESS 0x7F9062 /end MEASUREMENT
/begin MEASUREMENT PwrMng_ubt "Battery voltage" UWORD spg_uw_q0p015 1 100 0.00 983.02500 ECU_ADDRESS 0x7F9068 /end MEASUREMENT
/begin MEASUREMENT PwrMng_uGen "Sollwert Generatorspannung" UWORD Volt_Batt 1 100 0.00 1281232. FORMAT "%8.0" ECU_ADDRESS 0x7F9064 /end MEASUREMENT
/begin MEASUREMENT PwrMng_uGen2 "" UWORD Volt_Batt 1 100 0.00 1281232. FORMAT "%8.0" ECU_ADDRESS 0x7F9066 /end MEASUREMENT
/begin MEASUREMENT RF_BSD "" UBYTE OneToOne 1 100 0.00 255.0 FORMAT "%5.1" ECU_ADDRESS 0x8FF608 /end MEASUREMENT
/begin MEASUREMENT RF_GEN "" UBYTE OneToOne 1 100 0.00 255.0 FORMAT "%5.1" ECU_ADDRESS 0x8FF609 /end MEASUREMENT
/begin MEASUREMENT RF_IBS1 "" UBYTE OneToOne 1 100 0.00 255.0 FORMAT "%5.1" ECU_ADDRESS 0x8FF60A /end MEASUREMENT
/begin MEASUREMENT RF_IBS2 "" UBYTE OneToOne 1 100 0.00 255.0 FORMAT "%5.1" ECU_ADDRESS 0x8FF60B /end MEASUREMENT
/begin MEASUREMENT RF_IBS3 "" UBYTE OneToOne 1 100 0.00 255.0 FORMAT "%5.1" ECU_ADDRESS 0x8FF60C /end MEASUREMENT
/begin MEASUREMENT RF_MANHYDR "" UBYTE OneToOne 1 100 0.00 255.0 FORMAT "%5.1" ECU_ADDRESS 0x8FF60D /end MEASUREMENT
/begin MEASUREMENT RF_MANLUFT "" UBYTE OneToOne 1 100 0.00 255.0 FORMAT "%5.1" ECU_ADDRESS 0x8FF60E /end MEASUREMENT
/begin MEASUREMENT RF_PMBATT "" UBYTE OneToOne 1 100 0.00 255.0 FORMAT "%5.1" ECU_ADDRESS 0x8FF60F /end MEASUREMENT
/begin MEASUREMENT RF_PMBN "" UBYTE OneToOne 1 100 0.00 255.0 FORMAT "%5.1" ECU_ADDRESS 0x8FF610 /end MEASUREMENT
/begin MEASUREMENT RF_PMRUHVERL "" UBYTE OneToOne 1 100 0.00 255.0 FORMAT "%5.1" ECU_ADDRESS 0x8FF611 /end MEASUREMENT
/begin MEASUREMENT RF_QLT "" UBYTE OneToOne 1 100 0.00 255.0 FORMAT "%5.1" ECU_ADDRESS 0x8FF612 /end MEASUREMENT
/begin MEASUREMENT RF_TANS "" UBYTE OneToOne 1 100 0.00 255.0 FORMAT "%5.1" ECU_ADDRESS 0x8FF613 /end MEASUREMENT
/begin MEASUREMENT RF_TOENS "" UBYTE OneToOne 1 100 0.00 255.0 FORMAT "%5.1" ECU_ADDRESS 0x8FF614 /end MEASUREMENT
/begin MEASUREMENT RF_TUMG "" UBYTE OneToOne 1 100 0.00 255.0 FORMAT "%5.1" ECU_ADDRESS 0x8FF615 /end MEASUREMENT
/begin MEASUREMENT ZF_BSD "" UBYTE OneToOne 1 100 0.00 255.0 FORMAT "%5.1" ECU_ADDRESS 0x8FF616 /end MEASUREMENT
/begin MEASUREMENT ZF_GEN "" UBYTE OneToOne 1 100 0.00 255.0 FORMAT "%5.1" ECU_ADDRESS 0x8FF617 /end MEASUREMENT
/begin MEASUREMENT ZF_IBS1 "" UBYTE OneToOne 1 100 0.00 255.0 FORMAT "%5.1" ECU_ADDRESS 0x8FF618 /end MEASUREMENT
/begin MEASUREMENT ZF_IBS2 "" UBYTE OneToOne 1 100 0.00 255.0 FORMAT "%5.1" ECU_ADDRESS 0x8FF619 /end MEASUREMENT
/begin MEASUREMENT ZF_IBS3 "" UBYTE OneToOne 1 100 0.00 255.0 FORMAT "%5.1" ECU_ADDRESS 0x8FF61A /end MEASUREMENT
/begin MEASUREMENT ZF_MANHYDR "" UBYTE OneToOne 1 100 0.00 255.0 FORMAT "%5.1" ECU_ADDRESS 0x8FF61B /end MEASUREMENT
/begin MEASUREMENT ZF_MANLUFT "" UBYTE OneToOne 1 100 0.00 255.0 FORMAT "%5.1" ECU_ADDRESS 0x8FF61C /end MEASUREMENT
/begin MEASUREMENT ZF_PMBATT "" UBYTE OneToOne 1 100 0.00 255.0 FORMAT "%5.1" ECU_ADDRESS 0x8FF61D /end MEASUREMENT
/begin MEASUREMENT ZF_PMBN "" UBYTE OneToOne 1 100 0.00 255.0 FORMAT "%5.1" ECU_ADDRESS 0x8FF61E /end MEASUREMENT
/begin MEASUREMENT ZF_PMRUHVERL "" UBYTE OneToOne 1 100 0.00 255.0 FORMAT "%5.1" ECU_ADDRESS 0x8FF61F /end MEASUREMENT
/begin MEASUREMENT ZF_QLT "" UBYTE OneToOne 1 100 0.00 255.0 FORMAT "%5.1" ECU_ADDRESS 0x8FF620 /end MEASUREMENT
/begin MEASUREMENT ZF_TANS "" UBYTE OneToOne 1 100 0.00 255.0 FORMAT "%5.1" ECU_ADDRESS 0x8FF621 /end MEASUREMENT
/begin MEASUREMENT ZF_TOENS "" UBYTE OneToOne 1 100 0.00 255.0 FORMAT "%5.1" ECU_ADDRESS 0x8FF622 /end MEASUREMENT
/begin MEASUREMENT ZF_TUMG "" UBYTE OneToOne 1 100 0.00 255.0 FORMAT "%5.1" ECU_ADDRESS 0x8FF623 /end MEASUREMENT
/begin FUNCTION injvcd_progetzfc_uic "" /begin OUT_MEASUREMENT InjVCD_stInjZFC_mp /end OUT_MEASUREMENT /end FUNCTION
/begin FUNCTION injvcd_progmi "Programmierung der MI1, Initialisierung von Schnelllöschung und Haltestrom" /end FUNCTION
/begin FUNCTION injvcd_progmi_uic "" /begin OUT_MEASUREMENT InjVCD_ctMI1AgDiff_mp InjVCD_phiMI1Diff_mp /end OUT_MEASUREMENT /end FUNCTION
/begin FUNCTION injvcd_progpii "Programmierung der Voreinspritzung" /end FUNCTION
/begin FUNCTION injvcd_progpii2 "" /end FUNCTION
/begin FUNCTION injvcd_progpii2_uic "" /begin OUT_MEASUREMENT InjVCD_ctPiI2AgDiff_mp InjVCD_phiPiI2Diff_mp /end OUT_MEASUREMENT /end FUNCTION
/begin FUNCTION injvcd_progpii3 "" /end FUNCTION
/begin FUNCTION injvcd_progpii3_uic "" /end FUNCTION
/begin FUNCTION injvcd_progpii_uic "" /begin OUT_MEASUREMENT InjVCD_ctPiI1AgDiff_mp InjVCD_phiPiI1Diff_mp /end OUT_MEASUREMENT /end FUNCTION
/begin FUNCTION injvcd_progpoi1 "" /end FUNCTION
/begin FUNCTION injvcd_progpoi1_uic "" /end FUNCTION
/begin FUNCTION injvcd_progpoi2 "" /end FUNCTION
/begin FUNCTION injvcd_progpoi2_uic "" /end FUNCTION
/begin FUNCTION injvcd_progzfc "" /end FUNCTION
/begin FUNCTION injvcd_progzfc_uic "" /end FUNCTION
/begin FUNCTION injvcd_zfcetcor "Ansteuerdauerkorrektur durch Nullmengenkalibrierung"
 /begin DEF_CHARACTERISTIC InjVCD_pRailZFCETCor_AXIS InjVCD_qZFCETCor_AXIS InjVCD_rZFCETDif0_GMAP InjVCD_rZFCETDif1_GMAP InjVCD_rZFCETDif2_GMAP InjVCD_rZFCETMsk_GMAP InjVCD_stInputZFCETGMap_C InjVCD_stZFCETCorActv_C InjVCD_swtZFCCorOvrRunOn_C InjVCD_tiZFCETCorMax_C InjVCD_tiZFCETCorMin_C /end DEF_CHARACTERISTIC
 /begin IN_MEASUREMENT InjVCD_qInZFCETGMap_mp RailCD_pAct_mp /end IN_MEASUREMENT
 /begin OUT_MEASUREMENT InjVCD_rZFCETCoeffDif_mp InjVCD_rZFCETCoeffMsk_mp InjVCD_tiPiI1ZFCETCor_mp InjVCD_tiPiI2ZFCETCor_mp InjVCD_tiPiI3ZFCETCor_mp /end OUT_MEASUREMENT
/end FUNCTION
/begin FUNCTION injvcd_zfcetcor_uic "" /begin OUT_MEASUREMENT InjVCD_qInZFCETGMap_mp /end OUT_MEASUREMENT /end FUNCTION
/begin FUNCTION injvlv_addbal "Korrektur Einspritzmenge aus Laufruheregler" /begin DEF_CHARACTERISTIC InjVlv_facAddBalRls_MAP /end DEF_CHARACTERISTIC /begin IN_MEASUREMENT InjCtl_qSetUnBal RailCD_pPeak /end IN_MEASUREMENT /end FUNCTION
/begin FUNCTION injvlv_addballib "" /begin DEF_CHARACTERISTIC InjVlv_stInputAddBalMap_C /end DEF_CHARACTERISTIC /end FUNCTION
/begin FUNCTION injvlv_addballib_uic ""
 /begin OUT_MEASUREMENT InjVlv_qMI1Bal_mp InjVlv_qPiI1Bal_mp InjVlv_qPiI2Bal_mp InjVlv_qPiI3Bal_mp InjVlv_qPoI1Bal_mp InjVlv_qPoI2BalEff_mp InjVlv_qPoI2Bal_mp /end OUT_MEASUREMENT
/end FUNCTION
/begin FUNCTION injvlv_addbalzfc "" /end FUNCTION
/begin FUNCTION injvlv_addbalzfc_uic "" /end FUNCTION
/begin FUNCTION injvlv_addbal_msg "" /begin OUT_MEASUREMENT InjVlv_facAddBalRls /end OUT_MEASUREMENT /end FUNCTION
/begin FUNCTION injvlv_addbal_uic "" /end FUNCTION
/begin FUNCTION injvlv_chrgbalinjlim "maximale Anzahl an Einspritzungen aufgrund der Ladungsbilanz des Boosterkondensators"
 /begin DEF_CHARACTERISTIC InjVlv_numInjChrgBal_MAP InjVlv_rChrgBalEngSpdHys_C InjVlv_rChrgBalVltgHys_C /end DEF_CHARACTERISTIC
 /begin IN_MEASUREMENT BattCD_u Eng_nAvrg /end IN_MEASUREMENT
/end FUNCTION
/begin FUNCTION injvlv_chrgbalinjlim_uic "" /begin OUT_MEASUREMENT InjVlv_numInjChrgBal_mp /end OUT_MEASUREMENT /end FUNCTION
/begin FUNCTION injvlv_errdet "Injektorfehlererkennung" /begin DEF_CHARACTERISTIC InjVlv_numSegOfs1_C InjVlv_numSegOfs2_C InjVlv_stErrDet_C /end DEF_CHARACTERISTIC /end FUNCTION
/begin FUNCTION injvlv_errdet_msg "" /begin OUT_MEASUREMENT InjVlv_nCyl InjVlv_qFBCCyl /end OUT_MEASUREMENT /end FUNCTION
/begin FUNCTION injvlv_errdet_uic "" /end FUNCTION
/begin FUNCTION injvlv_mon "Injektordiagnose"
 /begin DEF_CHARACTERISTIC InjVlv_DebBnkA0Def_C InjVlv_DebBnkA0Ok_C InjVlv_DebBnkA1Def_C InjVlv_DebBnkA1Ok_C InjVlv_DebBnkA2Def_C InjVlv_DebBnkA2Ok_C InjVlv_DebBnkA3Def_C InjVlv_DebBnkA3Ok_C InjVlv_DebBnkB0Def_C InjVlv_DebBnkB0Ok_C InjVlv_DebBnkB1Def_C InjVlv_DebBnkB1Ok_C InjVlv_DebBnkB2Def_C InjVlv_DebBnkB2Ok_C InjVlv_DebBnkB3Def_C InjVlv_DebBnkB3Ok_C InjVlv_DebChipA0Def_C InjVlv_DebChipA0Ok_C InjVlv_DebChipA1Def_C InjVlv_DebChipA1Ok_C InjVlv_DebChipA2Def_C InjVlv_DebChipA2Ok_C InjVlv_DebChipA3Def_C InjVlv_DebChipA3Ok_C InjVlv_DebChipB0Def_C InjVlv_DebChipB0Ok_C InjVlv_DebChipB1Def_C InjVlv_DebChipB1Ok_C InjVlv_DebChipB2Def_C InjVlv_DebChipB2Ok_C InjVlv_DebChipB3Def_C InjVlv_DebChipB3Ok_C InjVlv_DebCylA0Def_C InjVlv_DebCylA0Ok_C InjVlv_DebCylA1Def_C InjVlv_DebCylA1Ok_C InjVlv_DebCylA2Def_C InjVlv_DebCylA2Ok_C InjVlv_DebCylA3Def_C InjVlv_DebCylA3Ok_C InjVlv_DebCylB0Def_C InjVlv_DebCylB0Ok_C InjVlv_DebCylB1Def_C InjVlv_DebCylB1Ok_C InjVlv_DebCylB2Def_C InjVlv_DebCylB2Ok_C InjVlv_DebCylB3Def_C InjVlv_DebCylB3Ok_C InjVlv_numNoLoadCylMax_C InjVlv_stErrMskPattern_C InjVlv_stErrMskSelect_C /end DEF_CHARACTERISTIC
 /begin OUT_MEASUREMENT InjVlv_numIdxErrCyl1_mp InjVlv_numIdxErrCyl2_mp InjVlv_numIdxErrCyl3_mp InjVlv_numIdxErrCyl4_mp InjVlv_numIdxErrCyl5_mp InjVlv_numIdxErrCyl6_mp InjVlv_stChipVerCy33x_mp InjVlv_stErrCyl1_mp InjVlv_stErrCyl2_mp InjVlv_stErrCyl3_mp InjVlv_stErrCyl4_mp InjVlv_stErrCyl5_mp InjVlv_stErrCyl6_mp InjVlv_stIniCy331_mp /end OUT_MEASUREMENT
/end FUNCTION
/begin FUNCTION injvlv_mon_msg ""
 /begin OUT_MEASUREMENT InjVlv_stErrBnk1 InjVlv_stErrBnk2 InjVlv_stErrChip InjVlv_stErrChipPrep InjVlv_stErrClctCyl1 InjVlv_stErrClctCyl2 InjVlv_stErrClctCyl3 InjVlv_stErrClctCyl4 InjVlv_stErrClctCyl5 InjVlv_stErrClctCyl6 InjVlv_stErrUnknown InjVlv_stInjValve /end OUT_MEASUREMENT
/end FUNCTION
/begin FUNCTION injvlv_mon_uic "" /end FUNCTION
/begin FUNCTION injvlv_presmin "Abschaltanforderung aufgrund Mindestdruck" /begin DEF_CHARACTERISTIC InjVlv_pMin_C InjVlv_pMin_CUR /end DEF_CHARACTERISTIC /begin IN_MEASUREMENT Eng_tEng /end IN_MEASUREMENT /end FUNCTION
/begin FUNCTION injvlv_qntadj "Injektor-Mengenabgleich"
 /begin DEF_CHARACTERISTIC InjVlv_stQntAdj_MAP InjVlv_volQntAdjLim_C InjVlv_volQntAdjMax0_C InjVlv_volQntAdjMax1_C InjVlv_volQntAdjMax2_C InjVlv_volQntAdjMax3_C InjVlv_volQntAdjMin0_C InjVlv_volQntAdjMin1_C InjVlv_volQntAdjMin2_C InjVlv_volQntAdjMin3_C /end DEF_CHARACTERISTIC
 /begin IN_MEASUREMENT InjUn_volMI1Cor_mp RailCD_pPeak /end IN_MEASUREMENT
/end FUNCTION
/begin FUNCTION injvlv_qntadjrepl "" /begin DEF_CHARACTERISTIC InjVlv_stQntAdjRepl_C InjVlv_swtQntAdj_C /end DEF_CHARACTERISTIC /end FUNCTION
/begin FUNCTION injvlv_qntadj_uic ""
 /begin OUT_MEASUREMENT InjVlv_volMI1QntAdj_mp InjVlv_volPiI1QntAdj_mp InjVlv_volPiI2QntAdj_mp InjVlv_volPiI3QntAdj_mp InjVlv_volPoI1QntAdj_mp InjVlv_volPoI2QntAdj_mp /end OUT_MEASUREMENT
/end FUNCTION
/begin FUNCTION injvlv_tdiffhyd "" /begin DEF_CHARACTERISTIC InjVlv_swtDiffHydInSel_C InjVlv_tiDiffHyd_MAP /end DEF_CHARACTERISTIC /begin IN_MEASUREMENT InjVlv_pActInDiffHyd_mp InjVlv_qDesInDiffHyd_mp /end IN_MEASUREMENT /end FUNCTION
/begin FUNCTION injvlv_tdiffhyd_uic ""
 /begin OUT_MEASUREMENT InjVlv_pActInDiffHyd_mp InjVlv_qDesInDiffHyd_mp InjVlv_tiMI1DiffHydCor_mp InjVlv_tiPiI1DiffHydCor_mp InjVlv_tiPiI2DiffHydCor_mp /end OUT_MEASUREMENT
/end FUNCTION
/begin FUNCTION injvlv_wvcor "Druckwellenkorrektur"
 /begin DEF_CHARACTERISTIC InjVlv_facFTSWvCor_MAP InjVlv_qWvCorNorm_CUR InjVlv_stWvCorActv_C InjVlv_tWvCor_MAP /end DEF_CHARACTERISTIC
 /begin IN_MEASUREMENT CTSCD_tClnt FTSCD_tFuel InjVlv_tWvCor_mp RailCD_pPeak /end IN_MEASUREMENT
/end FUNCTION
/begin FUNCTION injvlv_wvcorlib "Druckwellenkorrektur Funktionsbibliothek"
 /begin DEF_CHARACTERISTIC InjVlv_facPiI2WvCor_C InjVlv_facWvCor1_MAP InjVlv_facWvCor2_MAP InjVlv_qWvCor1_MAP InjVlv_qWvCor2_MAP InjVlv_qWvCorMax_C InjVlv_qWvCorMin_C /end DEF_CHARACTERISTIC
 /begin IN_MEASUREMENT InjCrv_qMI1Des InjCrv_qPiI1Des InjCrv_qPoI2Des_mp InjVlv_rMI1WvCorNorm_mp InjVlv_tiMI1PoI2Cor_mp InjVlv_tiPiI1MI1Cor_mp RailCD_pAct_mp /end IN_MEASUREMENT
/end FUNCTION
/begin FUNCTION injvlv_wvcorlib_uic ""
 /begin OUT_MEASUREMENT InjVlv_facMI1PoI2WvCor_mp InjVlv_facPiI2PiI1WvCor_mp InjVlv_facPiIMI1WvCor_mp InjVlv_qMI1PoI2WvCor_mp InjVlv_qMI1WvCor_mp InjVlv_qPiI1MI1WvCor_mp InjVlv_qPiI1WvCor_mp InjVlv_qPiI2MI1WvCor_mp InjVlv_qPiI2PiI1WvCor_mp InjVlv_qPoI2WvCor_mp InjVlv_rMI1WvCorNorm_mp InjVlv_tiMI1PoI2Cor_mp InjVlv_tiMI1PoI2_mp InjVlv_tiPiI1MI1Cor_mp InjVlv_tiPiI1MI1_mp InjVlv_tiPiI2MI1Cor_mp InjVlv_tiPiI2MI1_mp InjVlv_tiPiI2PiI1Cor_mp InjVlv_tiPiI2PiI1_mp /end OUT_MEASUREMENT
/end FUNCTION
/begin FUNCTION injvlv_wvcor_msg "" /begin OUT_MEASUREMENT InjVlv_facFTSWvCor InjVlv_qWvCorNorm InjVlv_stWvCor /end OUT_MEASUREMENT /end FUNCTION
/begin FUNCTION injvlv_wvcor_uic "" /begin OUT_MEASUREMENT InjVlv_tWvCor_mp /end OUT_MEASUREMENT /end FUNCTION
/begin FUNCTION k2rdli "" /begin DEF_CHARACTERISTIC K2RDLI_dDataSetVer_C /end DEF_CHARACTERISTIC /end FUNCTION
/begin FUNCTION layer "Interface function to customer code"
 /begin DEF_CHARACTERISTIC Dmd_gen_C Layer_stAirCtlBits_C Layer_stPCR_C Layer_swtB_bsdprot Layer_swtTunProt_C Layer_tiDefWrEep_C PwrMng_B_ulcp_C PwrMng_dmAirPerTimeCor_C PwrMng_dmAirPerTimeIMax_C PwrMng_dmAirPerTimeIMin_C PwrMng_dmAirPerTimeIKi_C PwrMng_dmAirPerTimeIKiPos_C PwrMng_dmAirPerTimeIKiNeg_C PwrMng_dmAirPerTimeIWinPos_C PwrMng_dmAirPerTimeIWinNeg_C PwrMng_nB_kwdrehtHi_C PwrMng_nB_kwdrehtLo_C PwrMng_nB_llHigh_C PwrMng_nB_llLow_C PwrMng_rLoadMax_C PwrMng_stIdlingDefVal_C PwrMng_swtnmot_w_C PwrMng_swtPmsvActiv_C PwrMng_swttumg_C PwrMng_tiChgBatt_C PwrMng_tiHisRst_C PwrMng_Tkat_mod_C PwrMng_uAltTargetDefVal_C /end DEF_CHARACTERISTIC
/end FUNCTION
/begin FUNCTION layer_fltmng ""
 /begin DEF_CHARACTERISTIC Layer_ctDebBSDStep_C Layer_ctDebGENStep_C Layer_ctDebIBS1Step_C Layer_ctDebIBS2Step_C Layer_ctDebIBS3Step_C Layer_ctDebMANHYDRStep_C Layer_ctDebMANLUFTStep_C Layer_ctDebPMBATTStep_C Layer_ctDebPMBNStep_C Layer_ctDebPMRUHVERLStep_C Layer_ctDebQLTStep_C Layer_ctDebTANSStep_C Layer_ctDebTOENSStep_C Layer_ctDebTUMGStep_C Layer_ctDebBSDDef_C Layer_ctDebBSDOk_C Layer_ctDebGENDef_C Layer_ctDebGENOk_C Layer_ctDebIBS1Def_C Layer_ctDebIBS1Ok_C Layer_ctDebIBS2Def_C Layer_ctDebIBS2Ok_C Layer_ctDebIBS3Def_C Layer_ctDebIBS3Ok_C Layer_ctDebMANHYDRDef_C Layer_ctDebMANHYDROk_C Layer_ctDebMANLUFTDef_C Layer_ctDebMANLUFTOk_C Layer_ctDebPMBATTDef_C Layer_ctDebPMBATTOk_C Layer_ctDebPMBNDef_C Layer_ctDebPMBNOk_C Layer_ctDebPMRUHVERLDef_C Layer_ctDebPMRUHVERLOk_C Layer_ctDebQLTDef_C Layer_ctDebQLTOk_C Layer_ctDebTANSDef_C Layer_ctDebTANSOk_C Layer_ctDebTOENSDef_C Layer_ctDebTOENSOk_C Layer_ctDebTUMGDef_C Layer_ctDebTUMGOk_C /end DEF_CHARACTERISTIC
/end FUNCTION
/begin FUNCTION layer_fltmng_uic ""
 /begin OUT_MEASUREMENT BD_BSD BD_GEN BD_IBS1 BD_IBS2 BD_IBS3 BD_MANHYDR BD_MANLUFT BD_PMBATT BD_PMBN BD_PMRUHVERL BD_QLT BD_TANS BD_TOENS BD_TUMG E_BSD E_GEN E_IBS1 E_IBS2 E_IBS3 E_MANHYDR E_MANLUFT E_PMBATT E_PMBN E_PMRUHVERL E_QLT E_TANS E_TOENS E_TUMG RF_BSD RF_GEN RF_IBS1 RF_IBS2 RF_IBS3 RF_MANHYDR RF_MANLUFT RF_PMBATT RF_PMBN RF_PMRUHVERL RF_QLT RF_TANS RF_TOENS RF_TUMG ZF_BSD ZF_GEN ZF_IBS1 ZF_IBS2 ZF_IBS3 ZF_MANHYDR ZF_MANLUFT ZF_PMBATT ZF_PMBN ZF_PMRUHVERL ZF_QLT ZF_TANS ZF_TOENS ZF_TUMG /end OUT_MEASUREMENT
/end FUNCTION
/begin FUNCTION layer_msg ""
 /begin OUT_MEASUREMENT Layer_bos01_w Layer_bosbtvfbk Layer_bosstate Layer_bosvalue_DIAG Layer_FRC_INTM_T_BOS2 Layer_FRC_INTM_WAY_BOS2 Layer_ID2_BOS2 Layer_idbosmsg Layer_idfbosmg_w Layer_ID_FN_BOS2 Layer_stExtWaitRdy Layer_stLayer Layer_stOelTog Layer_stOelVerb Layer_stOelVerl Layer_TARD_MON_BOS2 Layer_TARD_YR_BOS2 Layer_volOil Layer_volOilRefill Layer_zrbosmld PwrMng_absch_korr PwrMng_d_soc PwrMng_iEngine PwrMng_iGen PwrMng_nMin PwrMng_nnnstart PwrMng_pwrDes PwrMng_pwrPTC PwrMng_rCtrPwrSpCos PwrMng_rdffgen PwrMng_stB_ccbtnach PwrMng_stB_ccbttdfk PwrMng_stB_ccbttknt PwrMng_stB_ccpmerr PwrMng_stB_ccprio PwrMng_stB_ccruhver PwrMng_stB_codierpm PwrMng_stCtrCbr PwrMng_stCtrPCos PwrMng_stCtrPrio PwrMng_stCtrPrioCf PwrMng_stCtrPwrCos PwrMng_stGen PwrMng_stLdstGen PwrMng_stLIGov PwrMng_stPCos PwrMng_stRqPCos PwrMng_stSelSpCos PwrMng_stTerminal61 PwrMng_stULev PwrMng_tiLRGen PwrMng_ubt PwrMng_uGen PwrMng_uGen2 /end OUT_MEASUREMENT
/end FUNCTION
/begin FUNCTION layer_uic ""
 /begin OUT_MEASUREMENT Counter_Layer_fp1000_mp Counter_Layer_fp100_mp Counter_Layer_fp10_mp Counter_Layer_fp200_mp Counter_Layer_ini_mp Counter_Layer_nl1000_mp Counter_Layer_nl100_mp Counter_Layer_nl10_mp Counter_Layer_nl200_mp Counter_Layer_wakeup1000_mp Counter_Layer_wakeup100_mp Counter_Layer_wakeup10_mp Counter_Layer_wakeup200_mp Layer_stProcess_u8_CBS_mp Layer_stProcess_u8_mp Layer_stProcess_u8_Tuning2_mp Layer_stProcess_u8_Tuning3_mp Layer_stProcess_u8_Tuning4_mp Layer_stProcess_u8_Tuning5_mp Layer_stProcess_u8_Tuning6_mp Layer_stProcess_u8_Tuning7_mp Layer_stProcess_u8_Tuning8_mp Layer_stProcess_u8_Tuning_mp PwrMng_dmAirPerTimeI_mp /end OUT_MEASUREMENT
/end FUNCTION
/begin FUNCTION ligov "Leerlaufregler"
 /begin DEF_CHARACTERISTIC LIGov_CldCltchFlt1T1_C LIGov_CldCltchFlt2T1_C LIGov_CldCltchIKi_C LIGov_CldCltchIKiPos_C LIGov_CldCltchIKiNeg_C LIGov_CldCltchIWinPos_C LIGov_CldCltchIWinNeg_C LIGov_CldCltchPredef_C LIGov_CldCltchPKp_C LIGov_CldCltchPKpPos_C LIGov_CldCltchPKpNeg_C LIGov_CldCltchPWinPos_C LIGov_CldCltchPWinNeg_C LIGov_tiCldGearDT1_C LIGov_CldGearDKd_C LIGov_CldGearIKi_C LIGov_CldGearIKiPos_C LIGov_CldGearIKiNeg_C LIGov_CldGearIWinPos_C LIGov_CldGearIWinNeg_C LIGov_CldGearPredef_C LIGov_CldGearPKp_C LIGov_CldGearPKpPos_C LIGov_CldGearPKpNeg_C LIGov_CldGearPWinPos_C LIGov_CldGearPWinNeg_C LIGov_tiGear1DT1_C LIGov_Gear1DKd_C LIGov_Gear1Flt1T1_C LIGov_Gear1Flt2T1_C LIGov_Gear1IKi_C LIGov_Gear1IKiPos_C LIGov_Gear1IKiNeg_C LIGov_Gear1IWinPos_C LIGov_Gear1IWinNeg_C LIGov_Gear1Predef_C LIGov_Gear1PKp_C LIGov_Gear1PKpPos_C LIGov_Gear1PKpNeg_C LIGov_Gear1PWinPos_C LIGov_Gear1PWinNeg_C LIGov_tiGear2DT1_C LIGov_Gear2DKd_C LIGov_Gear2Flt1T1_C LIGov_Gear2Flt2T1_C LIGov_Gear2IKi_C LIGov_Gear2IKiPos_C LIGov_Gear2IKiNeg_C LIGov_Gear2IWinPos_C LIGov_Gear2IWinNeg_C LIGov_Gear2Predef_C LIGov_Gear2PKp_C LIGov_Gear2PKpPos_C LIGov_Gear2PKpNeg_C LIGov_Gear2PWinPos_C LIGov_Gear2PWinNeg_C LIGov_tiGear3DT1_C LIGov_Gear3DKd_C LIGov_Gear3Flt1T1_C LIGov_Gear3Flt2T1_C LIGov_Gear3IKi_C LIGov_Gear3IKiPos_C LIGov_Gear3IKiNeg_C LIGov_Gear3IWinPos_C LIGov_Gear3IWinNeg_C LIGov_Gear3Predef_C LIGov_Gear3PKp_C LIGov_Gear3PKpPos_C LIGov_Gear3PKpNeg_C LIGov_Gear3PWinPos_C LIGov_Gear3PWinNeg_C LIGov_tiGear4DT1_C LIGov_Gear4DKd_C LIGov_Gear4Flt1T1_C LIGov_Gear4Flt2T1_C LIGov_Gear4IKi_C LIGov_Gear4IKiPos_C LIGov_Gear4IKiNeg_C LIGov_Gear4IWinPos_C LIGov_Gear4IWinNeg_C LIGov_Gear4Predef_C LIGov_Gear4PKp_C LIGov_Gear4PKpPos_C LIGov_Gear4PKpNeg_C LIGov_Gear4PWinPos_C LIGov_Gear4PWinNeg_C LIGov_tiGear5DT1_C LIGov_Gear5DKd_C LIGov_Gear5Flt1T1_C LIGov_Gear5Flt2T1_C LIGov_Gear5IKi_C LIGov_Gear5IKiPos_C LIGov_Gear5IKiNeg_C LIGov_Gear5IWinPos_C LIGov_Gear5IWinNeg_C LIGov_Gear5Predef_C LIGov_Gear5PKp_C LIGov_Gear5PKpPos_C LIGov_Gear5PKpNeg_C LIGov_Gear5PWinPos_C LIGov_Gear5PWinNeg_C LIGov_tiGear6DT1_C LIGov_Gear6DKd_C LIGov_Gear6Flt1T1_C LIGov_Gear6Flt2T1_C LIGov_Gear6IKi_C LIGov_Gear6IKiPos_C LIGov_Gear6IKiNeg_C LIGov_Gear6IWinPos_C LIGov_Gear6IWinNeg_C LIGov_Gear6Predef_C LIGov_Gear6PKp_C LIGov_Gear6PKpPos_C LIGov_Gear6PKpNeg_C LIGov_Gear6PWinPos_C LIGov_Gear6PWinNeg_C LIGov_nDflTrmVal_C LIGov_nDHypDenom_C LIGov_nDHypNum_C LIGov_nLimHigh_C LIGov_nLimLow_C LIGov_nMSDiffMax_C LIGov_nOffsetPreCtrltrqDem_C LIGov_nOffsetPreCtrl_C LIGov_nOffsetPredef_C LIGov_nOffsetUbr_C LIGov_rAPPThresFreezeI_C LIGov_rAPPThresTrqDem_C LIGov_stPsRev_C LIGov_swtAPPFreezeI_C LIGov_swtAPPTrqDem_C LIGov_swtInitPreCtrlNotLck_C LIGov_tClntXLow_C LIGov_tClntXHigh_C LIGov_stCold_C LIGov_stWarm_C LIGov_tiDelCutOut_C LIGov_tiPT1_CUR LIGov_trqMax_CUR LIGov_trqSetMax_C LIGov_trqThresDefrostI_C LIGov_UbrPKp_C LIGov_UbrPKpPos_C LIGov_UbrPKpNeg_C LIGov_UbrPWinPos_C LIGov_UbrPWinNeg_C LIGov_vThresUbr_C LIGov_WrmCltchFlt1T1_C LIGov_WrmCltchFlt2T1_C LIGov_WrmCltchIKi_C LIGov_WrmCltchIKiPos_C LIGov_WrmCltchIKiNeg_C LIGov_WrmCltchIWinPos_C LIGov_WrmCltchIWinNeg_C LIGov_WrmCltchPredef_C LIGov_WrmCltchPKp_C LIGov_WrmCltchPKpPos_C LIGov_WrmCltchPKpNeg_C LIGov_WrmCltchPWinPos_C LIGov_WrmCltchPWinNeg_C /end DEF_CHARACTERISTIC
 /begin IN_MEASUREMENT Eng_nAvrg LIGov_nDiff_mp /end IN_MEASUREMENT
/end FUNCTION
/begin FUNCTION ligov_msg ""
 /begin OUT_MEASUREMENT LIGov_st LIGov_stSetTrqActive LIGov_trq LIGov_trqCurrPredef LIGov_trqFlt LIGov_trqI LIGov_trqP LIGov_trqSetDIAG /end OUT_MEASUREMENT
/end FUNCTION
/begin FUNCTION ligov_ms_msg "" /end FUNCTION
/begin FUNCTION ligov_setpoint ""
 /begin DEF_CHARACTERISTIC LIGov_dnLimHighTrm_C LIGov_dnLimLowTrm_C LIGov_nDeltaSec_C LIGov_nDiffDelta_C LIGov_nHDC_C LIGov_nLimHighOfs_C LIGov_nLimHighTrmAct_C LIGov_nRmpBaseDwn_C LIGov_nRmpBaseUp_C LIGov_nRmpCoEngDwn_C LIGov_nRmpCoEngUp_C LIGov_nRmpCutOutUp_C LIGov_nRmpCutOutDwn_C LIGov_nRmpGearbxDwn_C LIGov_nRmpGearbxUp_C LIGov_nRmpHDCDwn_C LIGov_nRmpHDCUp_C LIGov_nRmpPwrMngDwn_C LIGov_nRmpPwrMngUp_C LIGov_nRmpSecDelta_C LIGov_nRmpSurgeDwn_C LIGov_nRmpSurgeUp_C LIGov_nSetpointDia_C LIGov_nSetpointDriveAway_C LIGov_nSetpointInit2_MAP LIGov_nSetpointInit_MAP LIGov_nSetpointTrmLim_C LIGov_nSetpointTrm_C LIGov_nSetPointWarm_C LIGov_stActiveHDC_C LIGov_stReleaseHDC_C LIGov_swtGear_C LIGov_tiTW_C LIGov_trqInitI_MAP /end DEF_CHARACTERISTIC
 /begin IN_MEASUREMENT APSCD_pVal CTSCD_tClnt /end IN_MEASUREMENT
/end FUNCTION
/begin FUNCTION ligov_setpoint_msg ""
 /begin OUT_MEASUREMENT LIGov_nLimHigh LIGov_nMaxTrq LIGov_nSetLocal2 LIGov_nSetpoint LIGov_nSetpointTrm LIGov_stActiveHDC LIGov_stSetPoint LIGov_stSetpointTrmActive LIGov_trqInitI /end OUT_MEASUREMENT
/end FUNCTION
/begin FUNCTION ligov_setpoint_uic "" /begin DEF_CHARACTERISTIC LIGov_nSetpoint_Vector LIGov_nSetpoint_Channel /end DEF_CHARACTERISTIC
 /begin OUT_MEASUREMENT LIGov_nDiffDelta_mp LIGov_nHDC_mp LIGov_nSetCoEngOld_mp LIGov_nSetCoEng_mp LIGov_nSetGearbxOld_mp LIGov_nSetGearbx_mp LIGov_nSetHDCOld_mp LIGov_nSetHDC_mp LIGov_nSetLocal0_mp LIGov_nSetLocalRampOld_mp LIGov_nSetLocalRamp_mp LIGov_nSetpointOld_mp LIGov_nSetpointTemp_mp LIGov_nSetpointTrm_mp LIGov_nSetPwrMngOld_mp LIGov_nSetPwrMng_mp LIGov_nSetSec1_mp LIGov_nSetSec2_mp LIGov_nSetSec4_mp LIGov_nSetSurgeOld_mp LIGov_nSetSurge_mp LIGov_stSetpointTrmAlw_mp /end OUT_MEASUREMENT
/end FUNCTION
/begin FUNCTION ligov_tsync_ps_conv ""
 /begin DEF_CHARACTERISTIC LIGov_tiCldCltchDT1_C LIGov_CldCltchDKd_C LIGov_tiWrmCltchDT1_C LIGov_WrmCltchDKd_C /end DEF_CHARACTERISTIC
/end FUNCTION
/begin FUNCTION ligov_uic "" /begin DEF_CHARACTERISTIC LIGov_trq_Vector LIGov_trq_Channel /end DEF_CHARACTERISTIC
 /begin OUT_MEASUREMENT LIGov_CurrDKd_mp LIGov_CurrDT1_mp LIGov_CurrFlt1T1_mp LIGov_CurrFlt2T1_mp LIGov_CurrIKiNeg_mp LIGov_CurrIKiPos_mp LIGov_CurrIKi_mp LIGov_CurrIWinNeg_mp LIGov_CurrIWinPos_mp LIGov_CurrPKpNeg_mp LIGov_CurrPKpPos_mp LIGov_CurrPKp_mp LIGov_CurrPWinNeg_mp LIGov_CurrPWinPos_mp LIGov_nAvrg_mp LIGov_nDiffFlt1_mp LIGov_nDiffFlt2_mp LIGov_nDiff_mp LIGov_rIpoConvPS_mp LIGov_stSetTrqAlw_mp LIGov_tiPT1_mp LIGov_trqDRaw_mp LIGov_trqD_mp LIGov_trqLISetRdDIAG_mp LIGov_trqMax_mp LIGov_trqPreInitI_mp LIGov_trqSet_mp LIGov_trq_mp /end OUT_MEASUREMENT
/end FUNCTION
/begin FUNCTION lpacd ""
 /begin DEF_CHARACTERISTIC LPACD_ctPwrStgOnMax_C LPACD_DebExcTempDef_C LPACD_DebExcTempOk_C LPACD_DebNoLoadDef_C LPACD_DebNoLoadOk_C LPACD_DebShortCircBatDef_C LPACD_DebShortCircBatOk_C LPACD_DebShortCircGndDef_C LPACD_DebShortCircGndOk_C LPACD_numDia_C LPACD_numPwmOut_C LPACD_stInvOut_C LPACD_tiPer_C LPACD_rCnv_CUR LPACD_rOutMax_C LPACD_rOutMin_C LPACD_stPwrStgActv_C LPACD_stPwrStgDia_C LPACD_stSPICtl_C LPACD_swt_C LPACD_tiBtwTst_C LPACD_tiPwrStgOn_C /end DEF_CHARACTERISTIC
 /begin IN_MEASUREMENT BPA_rLPACD /end IN_MEASUREMENT
/end FUNCTION
/begin FUNCTION lpacd_msg "" /begin OUT_MEASUREMENT LPACD_rOut /end OUT_MEASUREMENT /end FUNCTION
/begin FUNCTION lpacd_uic "" /begin OUT_MEASUREMENT LPACD_rCnv_mp /end OUT_MEASUREMENT /end FUNCTION
/begin FUNCTION lsucd_adaption "Adaption des Lambdasondensignals"
 /begin DEF_CHARACTERISTIC LSUCD_tiAdptFltInit_C LSUCD_tiAdptFlt_C LSUCD_d2rInit_C LSUCD_dmAirIKi_C LSUCD_dmAirIKiPos_C LSUCD_dmAirIKiNeg_C LSUCD_dmAirIWinPos_C LSUCD_dmAirIWinNeg_C LSUCD_EvalMaxVal_C LSUCD_EvalMinVal_C LSUCD_tiEvalFltInit_C LSUCD_tiEvalFlt_C LSUCD_mAirAdptActv_C LSUCD_swtAdptVal_C LSUCD_swtAdptType_C LSUCD_tAirAdptActv_C /end DEF_CHARACTERISTIC
 /begin OUT_MEASUREMENT LSUCD_d2rO2Eval_mp LSUCD_d2rO2_mp LSUCD_drO2Flt_mp LSUCD_facO2Corr_mp LSUCD_mAirAftOvrRun_mp LSUCD_stAdptActv_mp LSUCD_stChange_mp LSUCD_stHold_mp /end OUT_MEASUREMENT
/end FUNCTION
/begin FUNCTION lsucd_adaption_msg "" /begin OUT_MEASUREMENT LSUCD_drO2Adpt LSUCD_rO2Adpt LSUCD_stAdpt LSUCD_swtAdpt /end OUT_MEASUREMENT /end FUNCTION
/begin FUNCTION lsucd_adaption_uic "" /end FUNCTION
/begin FUNCTION lsucd_heater "Heizung der Lambdasonde"
 /begin DEF_CHARACTERISTIC LSUCD_stHtInvOut_C LSUCD_tiHtPer_C LSUCD_tiDebHeaterDef_C LSUCD_tiDebHeaterOk_C LSUCD_uBattNominal_C LSUCD_uBattMaxHigh_C LSUCD_uBattMaxLow_C LSUCD_stPwrStgDia_C LSUCD_dcycTstPowerStage_C LSUCD_tiDebReset_C LSUCD_stHtDis_C LSUCD_stHeaterPwrStgSel_C LSUCD_tiHeaterBattDefDelay_C /end DEF_CHARACTERISTIC
 /begin OUT_MEASUREMENT LSUCD_facUCor_mp LSUCD_rOutHWE_mp /end OUT_MEASUREMENT
/end FUNCTION
/begin FUNCTION lsucd_heater_msg "" /begin OUT_MEASUREMENT LSUCD_dcycHtCor LSUCD_dcycLimActHt LSUCD_stHtDis /end OUT_MEASUREMENT /end FUNCTION
/begin FUNCTION lsucd_iprefctl "Controlling of the reference pump current"
 /begin DEF_CHARACTERISTIC LSUCD_stRefPumpDis_C LSUCD_tiRefPumpHigh_C LSUCD_tiRefTransLow_C LSUCD_tiRgnEna_C LSUCD_tiRgnIpSettle_C LSUCD_swtRgnChngCirct_C /end DEF_CHARACTERISTIC
 /begin OUT_MEASUREMENT LSUCD_stRefCurTrans_mp /end OUT_MEASUREMENT
/end FUNCTION
/begin FUNCTION lsucd_iprefctl_msg ""
 /begin OUT_MEASUREMENT LSUCD_stIpHighCurEna LSUCD_stIpNormCurEna LSUCD_stPumpDemRef LSUCD_stRefPump LSUCD_stRgnEna LSUCD_stRgnIpSettle /end OUT_MEASUREMENT
/end FUNCTION
/begin FUNCTION lsucd_iprefctl_uic "" /end FUNCTION
/begin FUNCTION lsucd_o2raw "Sauerstoffrohwert der Lambdasonde"
 /begin DEF_CHARACTERISTIC LSUCD_DebO2ClbDef_C LSUCD_DebO2ClbOk_C LSUCD_rO2_CUR LSUCD_tiO2ClbPT1_C LSUCD_tiO2PT1_C LSUCD_tiDebO2MaxTstDef_C LSUCD_tiDebO2MaxTstOk_C LSUCD_tiDebO2MinDef_C LSUCD_tiDebO2MinOk_C LSUCD_tiDelO2Clb_C LSUCD_tiO2Clb_C LSUCD_tiDelO2Val_C LSUCD_uO2Ref_C LSUCD_uO2ClbMax_C LSUCD_uO2ClbMin_C LSUCD_swtO2Filter_C LSUCD_uO2MaxNorm_C LSUCD_uO2MaxTst_C LSUCD_uO2Min_C LSUCD_swtSensDrftComp_C /end DEF_CHARACTERISTIC
 /begin OUT_MEASUREMENT LSUCD_stO2Clb_mp LSUCD_stSRCState_mp LSUCD_uO2OfsCor_mp LSUCD_uO2Raw_mp /end OUT_MEASUREMENT
/end FUNCTION
/begin FUNCTION lsucd_o2raw_msg ""
 /begin OUT_MEASUREMENT LSUCD_rO2Act LSUCD_rO2Raw LSUCD_stO2Act LSUCD_stO2ClbEna LSUCD_stO2IntValid LSUCD_stO2SPICalDem LSUCD_stO2SPISens LSUCD_uO2Clb LSUCD_uO2Raw LSU_swtEna /end OUT_MEASUREMENT
/end FUNCTION
/begin FUNCTION lsucd_o2raw_msg_var "" /begin OUT_MEASUREMENT LSUCD_stO2Valid /end OUT_MEASUREMENT /end FUNCTION
/begin FUNCTION lsucd_prescomp "Druckkompensation der mit Lambdasonde gemessenen Sauerstoffkonzentration"
 /begin DEF_CHARACTERISTIC LSUCD_facPresCompLean_CUR LSUCD_facPresCompRich_CUR LSUCD_rO2SwtPresComp_C /end DEF_CHARACTERISTIC
 /begin OUT_MEASUREMENT LSUCD_facPresComp_mp LSUCD_pExhGasLstVal_mp /end OUT_MEASUREMENT
/end FUNCTION
/begin FUNCTION lsucd_prescomp_msg "" /begin OUT_MEASUREMENT LSUCD_rO2PresComp /end OUT_MEASUREMENT /end FUNCTION
/begin FUNCTION lsucd_prescomp_uic "" /end FUNCTION
/begin FUNCTION lsucd_pumpctl "Pump current control" /begin DEF_CHARACTERISTIC LSUCD_stPumpCtlDis_C /end DEF_CHARACTERISTIC /end FUNCTION
/begin FUNCTION lsucd_pumpctl_msg "" /begin OUT_MEASUREMENT LSUCD_stPumpCtl /end OUT_MEASUREMENT /end FUNCTION
/begin FUNCTION lsucd_pumpctl_uic "" /end FUNCTION
/begin FUNCTION lsucd_ri "Ri der Lambdasonde"
 /begin DEF_CHARACTERISTIC LSUCD_DebRiClbDef_C LSUCD_DebRiClbOk_C LSUCD_tiRiClbPT1_C LSUCD_tiRiPT1_C LSUCD_tRi_CUR LSUCD_tiDelRiClb_C LSUCD_tiRiClb_C LSUCD_tiDelRiVal_C LSUCD_tiRiFltSettle_C LSUCD_resRiMaxJmp_C LSUCD_uRiOfs_C LSUCD_facUToRi_C LSUCD_resRiClbRef_C LSUCD_resRiClbMax_C LSUCD_resRiClbMin_C LSUCD_numRiDistSupp_C /end DEF_CHARACTERISTIC
 /begin OUT_MEASUREMENT LSUCD_resRiChange_mp LSUCD_resRiClbRaw_mp LSUCD_resRi_mp LSUCD_stRiFltAct_mp LSUCD_stRiLimSlp_mp /end OUT_MEASUREMENT
/end FUNCTION
/begin FUNCTION lsucd_ri_msg ""
 /begin OUT_MEASUREMENT LSUCD_resRi LSUCD_resRiClb LSUCD_resRiRaw LSUCD_stRiClb LSUCD_stRiClbEna LSUCD_stRiSPICalDem LSUCD_stRiValid LSUCD_tRi LSUCD_uRiRaw /end OUT_MEASUREMENT
/end FUNCTION
/begin FUNCTION lsucd_spictl "SPI Chip control"
 /begin DEF_CHARACTERISTIC LSUCD_stCJ125CS_C LSUCD_stRefCurHigh_C LSUCD_stRefCurNormal_C /end DEF_CHARACTERISTIC
/end FUNCTION
/begin FUNCTION lsucd_spictl_msg "" /begin OUT_MEASUREMENT LSUCD_stCircModeNew LSUCD_stSPIDiaInfo LSUCD_stSPIInitVal /end OUT_MEASUREMENT /end FUNCTION
/begin FUNCTION lsucd_spictl_uic "" /end FUNCTION
/begin COMPU_METHOD AirMassPerTime "Luftmasse pro Zeit" RAT_FUNC "%6.3" "Kg/h" COEFFS 0 10 0 0 0 1 /end COMPU_METHOD
/begin COMPU_METHOD AirMass_2 "Luftmasse (geringere Auflösung)" RAT_FUNC "%6.3" "g" COEFFS 0 10 0 0 0 1 /end COMPU_METHOD
/begin COMPU_METHOD AngleCrS "Winkel Kurbelwelle" RAT_FUNC "%6.4" "deg CrS" COEFFS 0 42.6666666666667 0 0 0 1 /end COMPU_METHOD
/begin COMPU_METHOD CurRefPump "Applizierbarer Pumpreferenzstrom" TAB_VERB "%6.3" "-" COMPU_TAB_REF CurRefPump /end COMPU_METHOD
/begin COMPU_VTAB CurRefPump "Applizierbarer Pumpreferenzstrom" TAB_VERB 16 0 "0 uA" 1 "10 uA" 2 "20 uA" 3 "30 uA" 4 "40 uA" 5 "50 uA" 6 "60 uA" 7 "70 uA" 8 "80 uA" 9 "90 uA" 10 "100 uA" 11 "110 uA" 12 "120 uA" 13 "130 uA" 14 "140 uA" 15 "150 uA" /end COMPU_VTAB
/begin COMPU_METHOD DEZ "K3 Umwandlungen" RAT_FUNC "%6.2" "-" COEFFS 0 1 0 0 0 1 /end COMPU_METHOD
/begin COMPU_METHOD dn_dZfine "Engine acceleration per time (dn/dt) fine resolution" RAT_FUNC "%6.2" "rpm/s" COEFFS 0 1 0 0 0 1 /end COMPU_METHOD
/begin COMPU_METHOD DtyCyc "Tastverhaeltnis" RAT_FUNC "%6.4" "%" COEFFS 0 100 0 0 0 1 /end COMPU_METHOD
/begin COMPU_METHOD EngN "Motordrehzahl" RAT_FUNC "%6.2" "rpm" COEFFS 0 1 0 0 0 1 /end COMPU_METHOD
/begin COMPU_METHOD EngN_HiRes "Motordrehzahl, höhere Auflösung als EngM" RAT_FUNC "%6.3" "rpm" COEFFS 0 8 0 0 0 1 /end COMPU_METHOD
/begin COMPU_METHOD Fact "Faktor mit Auflösung 1 / 8192, hauptsächlich für einen Faktorenbereich 0...1 verwendet" RAT_FUNC "%6.5" "-" COEFFS 0 8192 0 0 0 1 /end COMPU_METHOD
/begin COMPU_METHOD Fact1 "Faktor mit Auflösung 0,01 (100 mal höherer Bereich als Fact)" RAT_FUNC "%6.4" "-" COEFFS 0 128 0 0 0 1 /end COMPU_METHOD
/begin COMPU_METHOD fak_q0p5 "K3 Umwandlungen" RAT_FUNC "%6.3" "-" COEFFS 0 1 0 0 0 0.5 /end COMPU_METHOD
/begin COMPU_METHOD igen_ub_q1 "K3 Umwandlungen" RAT_FUNC "%6.2" "-" COEFFS 0 1 0 0 0 1 /end COMPU_METHOD
/begin COMPU_METHOD InjMass "Einspritzmenge" RAT_FUNC "%6.4" "mg/hub" COEFFS 0 100 0 0 0 1 /end COMPU_METHOD
/begin COMPU_METHOD InjMassCyc "Einspritzmenge pro Zyklus (mg/Zyklus)" RAT_FUNC "%6.4" "mg/cyc" COEFFS 0 100 0 0 0 1 /end COMPU_METHOD
/begin COMPU_METHOD InjMassInj "Einspritzmenge pro Einspritzung (mg/Einspritzung)" RAT_FUNC "%6.4" "mg/inj" COEFFS 0 100 0 0 0 1 /end COMPU_METHOD
/begin COMPU_METHOD InjQntInj "Einspritzmenge der einzelnen Einspritzung" RAT_FUNC "%6.4" "mm^3/inj" COEFFS 0 100 0 0 0 1 /end COMPU_METHOD
/begin COMPU_METHOD InjTime_us "Zeit in Microsekunden für das Einspritztiming" RAT_FUNC "%6.2" "us" COEFFS 0 1 0 0 0 1 /end COMPU_METHOD
/begin COMPU_METHOD Kd_rpm2Nm "Differentialverstärkung Kd (Motordrehzahl EngN zu Motormoment Trq)" RAT_FUNC "%8.7" "Nm/rpm" COEFFS 0 655360 0 0 0 1 /end COMPU_METHOD
/begin COMPU_METHOD Ki "Integrale Verstärkung Ki (gleiche Einheit/Umrechnungsregel an Ein- und Ausgang)" RAT_FUNC "%6.5" "1/s" COEFFS 0 4294.967296 0 0 0 1 /end COMPU_METHOD
/begin COMPU_METHOD Ki_rpm2Nm "Integralverstärkung Ki (Motordrehzahl EngN zu Motormoment Trq)" RAT_FUNC "%6.5" "Nm/(rpm*s)" COEFFS 0 5368.70912 0 0 0 1 /end COMPU_METHOD
/begin COMPU_METHOD km_sw_q10 "K3 Umwandlungen" RAT_FUNC "%6.1" "-" COEFFS 0 0.1 0 0 0 1 /end COMPU_METHOD
/begin COMPU_METHOD Kp_rpm2Nm "Proportionale Verstärkung Kp (Motordrehzahl EngN zu Moment Trq)" RAT_FUNC "%7.6" "Nm/rpm" COEFFS 0 81920 0 0 0 1 /end COMPU_METHOD
/begin COMPU_METHOD NumPinDia "Verbale Umrechnung für Diagnose Signale" TAB_VERB "%6.3" "-" COMPU_TAB_REF NumPinDia /end COMPU_METHOD
/begin COMPU_VTAB NumPinDia "Verbale Umrechnung für Diagnose Signale" TAB_VERB 28 0 "CJ945_Diagnostic_Signal" 1 "AC_Compressor_DiaSig" 2 "Fuel_Pump_Diagnostic_Signal_232" 3 "Starter_234" 4 "Oil_Pressure_Lamp_Switch_245" 5 "Engine_Bay_Air_Flaps_123" 6 "Ebox_Fan_Actuator_Diagnostic_Signal_219" 7 "Shuttr_Actuator_Diagnostic_Signal_231" 8 "Twostage_TurboLoading_SW_DiaSig" 9 "DIO_OUT_DIAGNOSTIC_DUMMY_NOT_USED" 10 "Alternator" 11 "Boost_Pressure_Actuator_Diagnostic_Signal_193" 12 "EGR_Actuator_Diagnostic_Signal_194" 13 "1st_Pressure_Control_Valve_Diagnostic_Signal_172" 14 "2nd_Pressure_Control_Valve_Diagnostic_Signal_172" 15 "1st_Metering_Unit_Diagnostic_Signal_171" 16 "2nd_Metering_Unit_Diagnostic_Signal_171" 17 "Variable_Swirl_Actuator_Diagnostic_Signal_195" 18 "FAN_240" 19 "Add_On_Heater_244" 20 "EngM_Bearing_Actuator_Diagnostic_Signal_124" 21 "EngM_Bearing_Actuator_Diagnostic_Signal_121" 22 "Throttle_Valve_Diagnostic_Signal_196" 23 "Low pressure stage BPA_Diagnostic_Signal_117" 24 "PWM_DIAGNOSTIC_DUMMY_NOT_USED" 25 "1st_Sensor_Supply_Voltage_DiaSig" 26 "2nd_Sensor_Supply_Voltage_DiaSig" 27 "3rd_Sensor_Supply_Voltage_DiaSig" /end COMPU_VTAB
/begin COMPU_METHOD NumPinPwmOut "Verbale Umrechnung für PWM-Ausgang Signale" TAB_VERB "%6.3" "-" COMPU_TAB_REF NumPinPwmOut /end COMPU_METHOD
/begin COMPU_VTAB NumPinPwmOut "Verbale Umrechnung für PWM-Ausgang Signale" TAB_VERB 14 0 "Boost_Pressure_Actuator_193" 1 "EGR_Actuator_194" 2 "PCV_Actuator_172" 3 "MeUn_Actuator_171" 4 "Variable_Swirl_Actuator_195" 5 "Fan_Actuator_240" 6 "Add_On_Heater_244" 7 "EngM_Bearing_Actuator_124" 8 "EngM_Bearing_Actuator_121" 9 "Throttle_Valve_196" 10 "LSU_Heater_PWMOutput" 11 "Low pressure stage BPA_117" 12 "Shuttr_Actuator_PWM_231" 13 "PWM_DUMMY_NOT_USED" /end COMPU_VTAB
/begin COMPU_METHOD O2 "Sauerstoffkonzentration" RAT_FUNC "%8.7" "-" COEFFS 0 100000 0 0 0 1 /end COMPU_METHOD
/begin COMPU_METHOD OneToOne "eins zu eins (physikalischer Wert ist gleich dem internen Wert)" RAT_FUNC "%6.2" "-" COEFFS 0 1 0 0 0 1 /end COMPU_METHOD
/begin COMPU_METHOD PCENT "K3 Umwandlungen" RAT_FUNC "%6.3" "%" COEFFS 0 256 0 0 0 100 /end COMPU_METHOD
/begin COMPU_METHOD Period "Periodendauer" RAT_FUNC "%6.3" "ms" COEFFS 0 10 0 0 0 1 /end COMPU_METHOD
/begin COMPU_METHOD Prc "Prozent, gleiche interne Auflösung wie Fact, aber Darstellung in Prozent (0...100%)" RAT_FUNC "%6.4" "%" COEFFS 0 81.92 0 0 0 1 /end COMPU_METHOD
/begin COMPU_METHOD Pres_hPa "Druck (angezeigt in [hPa])" RAT_FUNC "%6.2" "hPa" COEFFS 0 1 0 0 0 1 /end COMPU_METHOD
/begin COMPU_METHOD Pres_Rail "Raildruck in hPa" RAT_FUNC "%4.3" "bar" COEFFS 0 10.000000 0 0 0 1 /end COMPU_METHOD
/begin COMPU_METHOD Pwr "Leistung" RAT_FUNC "%6.2" "W" COEFFS 0 0.10610329539459 0 0 0 1 /end COMPU_METHOD
/begin COMPU_METHOD Pwr_kW "Leistung in kW" RAT_FUNC "%6.4" "kW" COEFFS 0 100 0 0 0 1 /end COMPU_METHOD
/begin COMPU_METHOD QntR "Normierungsverhältnis Einspritzmenge / Normierungsmenge" RAT_FUNC "%6.5" "-" COEFFS 0 1024 0 0 0 1 /end COMPU_METHOD
/begin COMPU_METHOD rel_ub_q1 "K3 Umwandlungen" RAT_FUNC "%6.2" "%" COEFFS 0 1 0 0 0 1 /end COMPU_METHOD
/begin COMPU_METHOD Resist "Widerstand" RAT_FUNC "%6.3" "Ohm" COEFFS 0 10 0 0 0 1 /end COMPU_METHOD
/begin COMPU_METHOD Rk "conversion formula for gas constant" RAT_FUNC "%6.5" "kJ/(kg*K)" COEFFS 0 1000 0 0 0 1 /end COMPU_METHOD
/begin COMPU_METHOD RmpEngN "Rampengradient für Motordrehzahl" RAT_FUNC "%6.4" "rpm/s" COEFFS 0 65.536 0 0 0 1 /end COMPU_METHOD
/begin COMPU_METHOD SlopeRes10000 "Umrechnung für Slope: Slopewert mit Verhältnis 0,0001" RAT_FUNC "%7.6" "-" COEFFS 0 10000 0 0 0 1 /end COMPU_METHOD
/begin COMPU_METHOD spg_uw_q0p015 "K3 Umwandlungen" RAT_FUNC "%9.5" "V" COEFFS 0 1 0 0 0 0.015 /end COMPU_METHOD
/begin COMPU_METHOD Temp_Cels "Temperatur dargestellt in °C (gleiche interne Darstellung wie Temp_Kelv)" RAT_FUNC "%6.1" "deg C" COEFFS 0 10 2731.4 0 0 1 /end COMPU_METHOD
/begin COMPU_METHOD temp_ub_q5_o50 "K3 Umwandlungen" RAT_FUNC "%6.2" "Grad C" COEFFS 0 1 50 0 0 5 /end COMPU_METHOD
/begin COMPU_METHOD TimeDelay_s "Zeitkonstante T1 (in s) für PT1, DT1, etc." RAT_FUNC "%9.3" "s" COEFFS 0 0 1 0 0.00023283064365387 0 /end COMPU_METHOD
/begin COMPU_METHOD TimeDelay_s_Lin_16 "Zeitkonstante T1 (in s) für PT1, DT1, etc. für SINT16, kein Kehrwert" RAT_FUNC "%6.5" "s" COEFFS 0 6553.4 0 0 0 1 /end COMPU_METHOD
/begin COMPU_METHOD Time_ms "Zeit in ms für Fehlerentprellung (DSM) und SW-Timer" RAT_FUNC "%6.1" "ms" COEFFS 0 0.1 0 0 0 1 /end COMPU_METHOD
/begin COMPU_METHOD Time_s "Zeit in s für Fehlerentprellung (DSM) und SW-Timer" RAT_FUNC "%6.4" "s" COEFFS 0 100 0 0 0 1 /end COMPU_METHOD
/begin COMPU_METHOD Trq "Motormoment" RAT_FUNC "%6.3" "Nm" COEFFS 0 10 0 0 0 1 /end COMPU_METHOD
/begin COMPU_METHOD Trq32 "Umrechungsformel für inneres Moment in 32bit Zahlendarstellung" RAT_FUNC "%8.7" "Nm" COEFFS 0 655360 0 0 0 1 /end COMPU_METHOD
/begin COMPU_METHOD Vel "Fahrzeuggeschwindigkeit, gleiche interne Auflösung wie Vel_SI" RAT_FUNC "%6.4" "km/h" COEFFS 0 100 0 0 0 1 /end COMPU_METHOD
/begin COMPU_METHOD Volt "Spannung in V (von ADC)" RAT_FUNC "%6.2" "mV" COEFFS 0 0.2046 0 0 0 1 /end COMPU_METHOD
/begin COMPU_METHOD VoltToRes "Umrechnung für Faktor Spannung zu Widerstand" RAT_FUNC "%7.6" "Ohm/mV" COEFFS 0 50830.889540567 0 0 0 1 /end COMPU_METHOD
/begin COMPU_METHOD Volt_Batt "Batteriespannung" RAT_FUNC "%6.1" "mV" COEFFS 0 0.05115 0 0 0 1 /end COMPU_METHOD
/begin COMPU_METHOD defaultAscii "" RAT_FUNC "%6.2" "-" COEFFS 0 1 0 0 0 1 /end COMPU_METHOD
/begin RECORD_LAYOUT Gkf_Ws16 FNC_VALUES 1 SWORD COLUMN_DIR DIRECT /end RECORD_LAYOUT
/begin RECORD_LAYOUT GSst_Xs16 NO_AXIS_PTS_X 1 SWORD AXIS_PTS_X 2 SWORD INDEX_INCR DIRECT /end RECORD_LAYOUT
/begin RECORD_LAYOUT Kf_Xs16_Ys16_Ws16 NO_AXIS_PTS_X 1 SWORD NO_AXIS_PTS_Y 2 SWORD AXIS_PTS_X 3 SWORD INDEX_INCR DIRECT AXIS_PTS_Y 4 SWORD INDEX_INCR DIRECT FNC_VALUES 5 SWORD COLUMN_DIR DIRECT /end RECORD_LAYOUT
/begin RECORD_LAYOUT Kl_Xs16_Ws16 NO_AXIS_PTS_X 1 SWORD AXIS_PTS_X 2 SWORD INDEX_INCR DIRECT FNC_VALUES 3 SWORD COLUMN_DIR DIRECT /end RECORD_LAYOUT
/begin RECORD_LAYOUT Kwb_Ws16 FNC_VALUES 1 SWORD COLUMN_DIR DIRECT /end RECORD_LAYOUT
/begin RECORD_LAYOUT Kwb_Wu32 FNC_VALUES 1 ULONG COLUMN_DIR DIRECT /end RECORD_LAYOUT
/begin RECORD_LAYOUT Kwb_Wu8 FNC_VALUES 1 UBYTE COLUMN_DIR DIRECT /end RECORD_LAYOUT
/begin RECORD_LAYOUT Kw_Ws16 FNC_VALUES 1 SWORD COLUMN_DIR DIRECT /end RECORD_LAYOUT
/begin RECORD_LAYOUT Kw_Ws32 FNC_VALUES 1 SLONG COLUMN_DIR DIRECT /end RECORD_LAYOUT
/begin RECORD_LAYOUT Kw_Ws8 FNC_VALUES 1 SBYTE COLUMN_DIR DIRECT /end RECORD_LAYOUT
/begin RECORD_LAYOUT Kw_Wu16 FNC_VALUES 1 UWORD COLUMN_DIR DIRECT /end RECORD_LAYOUT
/begin RECORD_LAYOUT Kw_Wu32 FNC_VALUES 1 ULONG COLUMN_DIR DIRECT /end RECORD_LAYOUT
/begin RECORD_LAYOUT Kw_Wu8 FNC_VALUES 1 UBYTE COLUMN_DIR DIRECT /end RECORD_LAYOUT
/end MODULE
/end PROJECT
