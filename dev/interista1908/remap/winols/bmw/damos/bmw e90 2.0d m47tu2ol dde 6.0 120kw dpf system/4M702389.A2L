ASAP2_VERSION 1 3
/begin PROJECT P389 "BMW DDE6.0 4-Zylinder V70.2 30.03.2004"
/begin HEADER "" VERSION "V70.2_4Z" PROJECT_NO P389 /end HEADER
/begin MODULE DIM ""
/begin MOD_COMMON "" BYTE_ORDER MSB_FIRST ALIGNMENT_BYTE 1 ALIGNMENT_WORD 2 ALIGNMENT_LONG 4 ALIGNMENT_FLOAT32_IEEE 4 /end MOD_COMMON
/begin CHARACTERISTIC FBC_AACoeff_C "Antialiasingfilterkoeffizienten" VAL_BLK 0xD1B54 Kwb_Wr32 2.00000000 OneToOne -1.00000000 1.00000000 FORMAT "%10.8" EXTENDED_LIMITS -1.00000000E+37 1.00000000E+37 NUMBER 9 /end CHARACTERISTIC
/begin CHARACTERISTIC FBC_AAOrd_C "Filterordnung des Antialiasingfilter" VALUE 0xD1B78 Kw_Wu8 8.000 OneToOne 0.00 8.000 FORMAT "%5.3" EXTENDED_LIMITS 0.00 255.0 /end CHARACTERISTIC
/begin CHARACTERISTIC FBC_Act_C "=0: Geberradadaption inaktiv; =1 aktiv; =2 lösche Adaptionsergebnisspeicher (EEPROM)" VALUE 0xD1B79 Kw_Wu8 2.000 OneToOne 0.00 2.000 FORMAT "%5.3" EXTENDED_LIMITS 0.00 255.0 /end CHARACTERISTIC
/begin CHARACTERISTIC FBC_DXadptl_C "Untere Schwelle der Adaptionsgüte" VALUE 0xD1B7C Kw_Wr32 1.00000000 Prc_float 0.00 1.00000000 FORMAT "%10.8" EXTENDED_LIMITS -1.00000000E+39 1.00000000E+39 /end CHARACTERISTIC
/begin CHARACTERISTIC FBC_DXadptu_C "Obere Schwelle der Adaptionsgüte" VALUE 0xD1B80 Kw_Wr32 1.00000000 Prc_float 0.00 1.00000000 FORMAT "%10.8" EXTENDED_LIMITS -1.00000000E+39 1.00000000E+39 /end CHARACTERISTIC
/begin CHARACTERISTIC FBC_DXalf0_C "Startwerte für FBC_DXSfn, FBC_DXSfp" VALUE 0xD1B84 Kw_Wr32 3.00000000 Prc_float 0.00 3.00000000 FORMAT "%10.8" EXTENDED_LIMITS -1.00000000E+39 1.00000000E+39 READ_ONLY /end CHARACTERISTIC
/begin CHARACTERISTIC FBC_lrn_Vector "#SSD Bypass Label, nicht ändern!" VALUE 0xC30EE Kw_Wu8 255.0 OneToOne 0.00 255.0 FORMAT "%5.1" /end CHARACTERISTIC
/begin CHARACTERISTIC FBC_lrn_Channel "#SSD Bypass Label, nicht ändern!" VALUE 0xC30EF Kw_Wu8 255.0 OneToOne 0.00 255.0 FORMAT "%5.1" /end CHARACTERISTIC
/begin CHARACTERISTIC FBC_nLrnThres_C "Drehzahlschwellen der Lernbereiche der Geberradadaption" VAL_BLK 0xD1B88 Kwb_Ws16 6000.000 EngN 0.00 6000.000 FORMAT "%8.3" EXTENDED_LIMITS -32768.00 32767.00 NUMBER 3 /end CHARACTERISTIC
/begin CHARACTERISTIC FBC_nThresFbc_C "Komfortdrehzahlbereich für Segmentwerte" VALUE 0xD1B8E Kw_Ws16 65535.00 EngN -32768.00 32767.00 FORMAT "%8.2" /end CHARACTERISTIC
/begin CHARACTERISTIC FBC_TFlrn_C "Filterkoeffizient des Bewertungsfilters" VALUE 0xD1B90 Kw_Wr32 1.00000000 OneToOne 0.00 1.00000000 FORMAT "%10.8" EXTENDED_LIMITS -1.00000000E+37 1.00000000E+37 /end CHARACTERISTIC
/begin CHARACTERISTIC FBC_TF_C "Filterkoeffizient des Adaptionsfilters" VALUE 0xD1B94 Kw_Wr32 1.00000000 OneToOne 0.00 1.00000000 FORMAT "%10.8" EXTENDED_LIMITS -1.00000000E+37 1.00000000E+37 /end CHARACTERISTIC
/begin CHARACTERISTIC FBC_ThresDyn_C "Drehzahldynamikgrenzwert um die Adaption zu deaktivieren" VALUE 0xD1B98 Kw_Wr32 1.00000000 OneToOne 0.00 1.00000000 FORMAT "%10.8" EXTENDED_LIMITS -1.00000000E+37 1.00000000E+37 /end CHARACTERISTIC
/begin CHARACTERISTIC FBC_TSm_C "Koeffizienten für Mittelwertfilter" VAL_BLK 0xD1B9C Kwb_Wr32 13.0000000 OneToOne -6.00000000 7.00000000 FORMAT "%10.8" EXTENDED_LIMITS -1.00000000E+37 1.00000000E+37 NUMBER 2 /end CHARACTERISTIC
/begin CHARACTERISTIC FlFCD_numDioIn_C "#SSD Auswahl des digitalen Eingangspins des Sensors der Wasserstandserkennung im Kraftstofffilter" VALUE 0xD1BA4 Kw_Wu8 14.0000000000 NumPinDioIn 0.00 14.0000000000 FORMAT "%13.10" /end CHARACTERISTIC
/begin CHARACTERISTIC FlFCD_swtFlFltInv_C "Schalter zum Invertieren des Eingangssignals (1...invertiert, 0...standard)" VALUE 0xD1BA5 Kw_Wu8 1.000 OneToOne 0.00 1.000 FORMAT "%5.3" EXTENDED_LIMITS 0.00 255.0 /end CHARACTERISTIC
/begin CHARACTERISTIC FlFCD_swtFlFltSens_C "Kraftstofffilter-Sensor vorhanden oder nicht vorhanden (0...vorhanden, 1...nicht vorhanden)" VALUE 0xD1BA6 Kw_Wu8 1.000 OneToOne 0.00 1.000 FORMAT "%5.3" EXTENDED_LIMITS 0.00 255.0 /end CHARACTERISTIC
/begin CHARACTERISTIC FlFCD_tiDebFlFltDef_C "Fehlerentprellzeit für Kraftstofffilter-Sensor" VALUE 0xD1BA8 Kw_Wu16 655350.0 Time_ms 0.00 655350.0 FORMAT "%8.1" /end CHARACTERISTIC
/begin CHARACTERISTIC FlFCD_tiDebFlFltOk_C "Heilungsentprellzeit für Kraftstofffilter-Sensor" VALUE 0xD1BAA Kw_Wu16 655350.0 Time_ms 0.00 655350.0 FORMAT "%8.1" /end CHARACTERISTIC
/begin CHARACTERISTIC FlFCD_tiFlFltDebNeg_C "Entprellzeit für negative Flanken" VALUE 0xD1BAC Kw_Wu16 2000.000 TimeDeb 0.00 2000.000 FORMAT "%8.3" EXTENDED_LIMITS 0.00 655350.0 /end CHARACTERISTIC
/begin CHARACTERISTIC FlFCD_tiFlFltDebPos_C "Entprellzeit für positive Flanken" VALUE 0xD1BAE Kw_Wu16 2000.000 TimeDeb 0.00 2000.000 FORMAT "%8.3" EXTENDED_LIMITS 0.00 655350.0 /end CHARACTERISTIC
/begin CHARACTERISTIC FlMng_tiDebSmkDefectDef_C "debounce duration for detached charge air tube error detection" VALUE 0xD1BB0 Kw_Wu16 655350.0 Time_ms 0.00 655350.0 FORMAT "%8.1" /end CHARACTERISTIC
/begin CHARACTERISTIC FlMng_tiDebSmkDefectOk_C "debounce duration for detached charge air tube error healing" VALUE 0xD1BB2 Kw_Wu16 655350.0 Time_ms 0.00 655350.0 FORMAT "%8.1" /end CHARACTERISTIC
/begin CHARACTERISTIC FlMng_dqLimUp_C "step per time interval for ramping up" VALUE 0xD1BB4 Kw_Wu32 655359.999847 RmpInjMass 0.00 655359.999847 FORMAT "%13.6" /end CHARACTERISTIC
/begin CHARACTERISTIC FlMng_dqLimDwn_C "step per time interval for ramping down" VALUE 0xD1BB8 Kw_Wu32 655359.999847 RmpInjMass 0.00 655359.999847 FORMAT "%13.6" /end CHARACTERISTIC
/begin CHARACTERISTIC FlMng_dSmkLimUp_C "ramp gradient for ramping up" VALUE 0xD1BBC Kw_Wu32 2621439999.39 PrcPerSec 0.00 2621439999.39 FORMAT "%13.2" /end CHARACTERISTIC
/begin CHARACTERISTIC FlMng_dSmkLimDwn_C "ramp gradient for ramping down" VALUE 0xD1BC0 Kw_Wu32 2621439999.39 PrcPerSec 0.00 2621439999.39 FORMAT "%13.2" /end CHARACTERISTIC
/begin CHARACTERISTIC FlMng_facAPSCorNeg_CUR "Kennlinie zur multiplikativen Korrektur der Filterzeitkonstante bei negativer Änderung der Luftmasse" CURVE 0xD1BC4 Kl_Xs16_Ws16 5.000000 Fact 0.00 5.000000 FORMAT "%8.6" EXTENDED_LIMITS -4.000000 3.999878
 /begin AXIS_DESCR STD_AXIS APSCD_pVal Pres_hPa 8 0.00 3500.0000 FORMAT "%8.4" EXTENDED_LIMITS -32768.00 32767.00 DEPOSIT ABSOLUTE /end AXIS_DESCR
/end CHARACTERISTIC
/begin CHARACTERISTIC FlMng_facAPSCorPos_CUR "Kennlinie zur multiplikativen Korrektur der Filterzeitkonstante bei positiver Änderung der Luftmasse" CURVE 0xD1BE6 Kl_Xs16_Ws16 5.000000 Fact 0.00 5.000000 FORMAT "%8.6" EXTENDED_LIMITS -4.000000 3.999878
 /begin AXIS_DESCR STD_AXIS APSCD_pVal Pres_hPa 8 0.00 3500.0000 FORMAT "%8.4" EXTENDED_LIMITS -32768.00 32767.00 DEPOSIT ABSOLUTE /end AXIS_DESCR
/end CHARACTERISTIC
/begin CHARACTERISTIC FlMng_facLmbdAPSCor_CUR "Multiplicative air pressure correction" CURVE 0xD1C08 Kl_Xs16_Ws16 5.000000 Fact 0.00 5.000000 FORMAT "%8.6" EXTENDED_LIMITS -4.000000 3.999878
 /begin AXIS_DESCR STD_AXIS APSCD_pVal Pres_hPa 8 0.00 3500.0000 FORMAT "%8.4" EXTENDED_LIMITS -32768.00 32767.00 DEPOSIT ABSOLUTE /end AXIS_DESCR
/end CHARACTERISTIC
/begin CHARACTERISTIC FlMng_facLmbdATSCor_CUR "Multiplicative ATS correction" CURVE 0xD1C2A Kl_Xs16_Ws16 5.000000 Fact 0.00 5.000000 FORMAT "%8.6" EXTENDED_LIMITS -4.000000 3.999878
 /begin AXIS_DESCR STD_AXIS IATSCD_tAir Temp_Cels 8 -50.1400 899.8600 FORMAT "%8.4" EXTENDED_LIMITS -3549.940 3003.560 DEPOSIT ABSOLUTE /end AXIS_DESCR
/end CHARACTERISTIC
/begin CHARACTERISTIC FlMng_facLmbdETSCor_CUR "Multiplicative ETS correction" CURVE 0xD1C4C Kl_Xs16_Ws16 5.000000 Fact 0.00 5.000000 FORMAT "%8.6" EXTENDED_LIMITS -4.000000 3.999878
 /begin AXIS_DESCR STD_AXIS Eng_tEng Temp_Cels 8 -50.1400 899.8600 FORMAT "%8.4" EXTENDED_LIMITS -3549.940 3003.560 DEPOSIT ABSOLUTE /end AXIS_DESCR
/end CHARACTERISTIC
/begin CHARACTERISTIC FlMng_FullLdRglIKi_CUR "Drehzahlabhängige Ki-Parameter der Vollastregelung" CURVE 0xD3E54 Kl_Xs16_Ws16 762.9162 Ki_LmbdRec2InjMass 0.00 762.9162 FORMAT "%8.4" EXTENDED_LIMITS -762.9395 762.9162
 /begin AXIS_DESCR STD_AXIS Eng_nAvrg EngN 7 0.00 6000.000 FORMAT "%8.3" EXTENDED_LIMITS -32768.00 32767.00 DEPOSIT ABSOLUTE /end AXIS_DESCR
/end CHARACTERISTIC
/begin CHARACTERISTIC FlMng_qFullLdRglMax_C "Maximale Stellgröße für Vollastregler" VALUE 0xD3E72 Kw_Ws16 327.6700 InjMass 0.00 327.6700 FORMAT "%8.4" EXTENDED_LIMITS -327.6800 327.6700 /end CHARACTERISTIC
/begin CHARACTERISTIC FlMng_qFullLdRglMin_C "Minimale Stellgröße für Volllastregler" VALUE 0xD3E74 Kw_Ws16 327.6800 InjMass -327.6800 0.00 FORMAT "%8.4" EXTENDED_LIMITS -327.6800 327.6700 /end CHARACTERISTIC
/begin CHARACTERISTIC FlMng_FullLdRglPKp_CUR "Drehzahlabhängige P-Parameter der Vollastregelung" CURVE 0xD3E76 Kl_Xs16_Ws16 399.9878 Kp_LmbdRec2InjMass_1 0.00 399.9878 FORMAT "%8.4" EXTENDED_LIMITS -400.0000 399.9878
 /begin AXIS_DESCR STD_AXIS Eng_nAvrg EngN 7 0.00 6000.000 FORMAT "%8.3" EXTENDED_LIMITS -32768.00 32767.00 DEPOSIT ABSOLUTE /end AXIS_DESCR
/end CHARACTERISTIC
/begin CHARACTERISTIC FlMng_mAirPerCylMin_C "untere Begrenzung der Luftmasse" VALUE 0xD1C6E Kw_Ws16 6553.500 AirMassPerCyl -3276.800 3276.700 FORMAT "%8.3" /end CHARACTERISTIC
/begin CHARACTERISTIC FlMng_numRevEng_C "Threshold for revolution counter" VALUE 0xD1C70 Kw_Wu16 65535.00 OneToOne 0.00 65535.00 FORMAT "%8.2" /end CHARACTERISTIC
/begin CHARACTERISTIC FlMng_pThresLmbd0_C "environment pressure threshold for dynamic smoke limitation" VALUE 0xD1C72 Kw_Ws16 3500.000 Pres_hPa 0.00 3500.000 FORMAT "%8.3" EXTENDED_LIMITS -32768.00 32767.00 /end CHARACTERISTIC
/begin CHARACTERISTIC FlMng_pThresLmbd1_C "environment pressure threshold  for static smoke limitation" VALUE 0xD1C74 Kw_Ws16 3500.000 Pres_hPa 0.00 3500.000 FORMAT "%8.3" EXTENDED_LIMITS -32768.00 32767.00 /end CHARACTERISTIC
/begin CHARACTERISTIC FlMng_pThresLmbd2_C "environment pressure threshold for static smoke limitation" VALUE 0xD1C76 Kw_Ws16 3500.000 Pres_hPa 0.00 3500.000 FORMAT "%8.3" EXTENDED_LIMITS -32768.00 32767.00 /end CHARACTERISTIC
/begin CHARACTERISTIC FlMng_qDefectMin_MAP "Rauchbegrenzungsmenge bei abgefallenen Ladeluftschlauch" MAP 0xD1C78 Kf_Xs16_Ys16_Ws16 327.6700 InjMass 0.00 327.6700 FORMAT "%8.4" EXTENDED_LIMITS -327.6800 327.6700
 /begin AXIS_DESCR STD_AXIS Eng_nAvrg EngN 16 0.00 6000.000 FORMAT "%8.3" EXTENDED_LIMITS -32768.00 32767.00 DEPOSIT ABSOLUTE /end AXIS_DESCR
 /begin AXIS_DESCR STD_AXIS APSCD_pVal Pres_hPa 16 0.00 3500.000 FORMAT "%8.3" EXTENDED_LIMITS -32768.00 32767.00 DEPOSIT ABSOLUTE /end AXIS_DESCR
/end CHARACTERISTIC
/begin CHARACTERISTIC FlMng_qDefectOfs_C "Offset Wert für Erkennung eines abgefallenen Ladeluftschlauch" VALUE 0xD1EBC Kw_Ws16 327.6700 InjMass 0.00 327.6700 FORMAT "%8.4" EXTENDED_LIMITS -327.6800 327.6700 /end CHARACTERISTIC
/begin CHARACTERISTIC FlMng_qEngTemp_CUR "fuel mass = f(engine temperature)" CURVE 0xD1EBE Kl_Xs16_Ws16 327.6700 InjMassInj 0.00 327.6700 FORMAT "%8.4" EXTENDED_LIMITS -327.6800 327.6700
 /begin AXIS_DESCR STD_AXIS Eng_tEng Temp_Cels 5 -50.14000 199.8600 FORMAT "%8.4" EXTENDED_LIMITS -3549.940 3003.560 DEPOSIT ABSOLUTE /end AXIS_DESCR
/end CHARACTERISTIC
/begin CHARACTERISTIC FlMng_rLmbdAPSCor_MAP "Kennfeld zur Ermittlung des Lambda-Korrekturwertes in Abhängigkeit des Umgebungsdrucks" MAP 0xD1ED4 Kf_Xs16_Ys16_Ws16 32.00000 lambda 0.00 32.00000 FORMAT "%8.5" EXTENDED_LIMITS -32.76800 32.76700
 /begin AXIS_DESCR STD_AXIS Eng_nAvrg EngN 16 0.00 6000.000 FORMAT "%8.3" EXTENDED_LIMITS -32768.00 32767.00 DEPOSIT ABSOLUTE /end AXIS_DESCR
 /begin AXIS_DESCR STD_AXIS ASMod_mAirPerCylCorr AirMassPerCyl 16 0.00 2500.000 FORMAT "%8.3" EXTENDED_LIMITS -3276.800 3276.700 DEPOSIT ABSOLUTE /end AXIS_DESCR
/end CHARACTERISTIC
/begin CHARACTERISTIC FlMng_rLmbdATSCor_MAP "map to determine the lambda value of smoke limitation for Intake air temperature correction" MAP 0xD2118 Kf_Xs16_Ys16_Ws16 32.00000 lambda 0.00 32.00000 FORMAT "%8.5" EXTENDED_LIMITS -32.76800 32.76700
 /begin AXIS_DESCR STD_AXIS Eng_nAvrg EngN 16 0.00 6000.000 FORMAT "%8.3" EXTENDED_LIMITS -32768.00 32767.00 DEPOSIT ABSOLUTE /end AXIS_DESCR
 /begin AXIS_DESCR STD_AXIS ASMod_mAirPerCylCorr AirMassPerCyl 16 0.00 2500.000 FORMAT "%8.3" EXTENDED_LIMITS -3276.800 3276.700 DEPOSIT ABSOLUTE /end AXIS_DESCR
/end CHARACTERISTIC
/begin CHARACTERISTIC FlMng_rLmbdETSCor_MAP "map to determine the lambda value of smoke limitation for Engine temperature correction" MAP 0xD235C Kf_Xs16_Ys16_Ws16 32.00000 lambda 0.00 32.00000 FORMAT "%8.5" EXTENDED_LIMITS -32.76800 32.76700
 /begin AXIS_DESCR STD_AXIS Eng_nAvrg EngN 16 0.00 6000.000 FORMAT "%8.3" EXTENDED_LIMITS -32768.00 32767.00 DEPOSIT ABSOLUTE /end AXIS_DESCR
 /begin AXIS_DESCR STD_AXIS ASMod_mAirPerCylCorr AirMassPerCyl 16 0.00 2500.000 FORMAT "%8.3" EXTENDED_LIMITS -3276.800 3276.700 DEPOSIT ABSOLUTE /end AXIS_DESCR
/end CHARACTERISTIC
/begin CHARACTERISTIC FlMng_rLmbdRecDvtMax_C "Maximale reziproke Lamda-Regelabweichung der Volllastregelung" VALUE 0xD3E94 Kw_Ws16 1.330000 lambdaRec 0.00 1.330000 FORMAT "%8.6" EXTENDED_LIMITS -3.276800 3.276700 /end CHARACTERISTIC
/begin CHARACTERISTIC FlMng_rLmbdRecDvtMin_C "Minimale reziproke Lambda-Regelabweichung der Vollastregelung" VALUE 0xD3E96 Kw_Ws16 1.330000 lambdaRec -1.330000 0.00 FORMAT "%8.6" EXTENDED_LIMITS -3.276800 3.276700 /end CHARACTERISTIC
/begin CHARACTERISTIC FlMng_rLmbdSmk2FDC_MAP " 2nd map to determine the lambda value of smoke limitation" MAP 0xD25A0 Kf_Xs16_Ys16_Ws16 32.00000 lambda 0.00 32.00000 FORMAT "%8.5" EXTENDED_LIMITS -32.76800 32.76700
 /begin AXIS_DESCR STD_AXIS Eng_nAvrg EngN 16 0.00 6000.000 FORMAT "%8.3" EXTENDED_LIMITS -32768.00 32767.00 DEPOSIT ABSOLUTE /end AXIS_DESCR
 /begin AXIS_DESCR STD_AXIS FlMng_mAirPerCylFltSmk_mp AirMassPerCyl 16 0.00 2500.000 FORMAT "%8.3" EXTENDED_LIMITS -3276.800 3276.700 DEPOSIT ABSOLUTE /end AXIS_DESCR
/end CHARACTERISTIC
/begin CHARACTERISTIC FlMng_rLmbdSmk2UpperGbxFDC_MAP "2nd map to determine the lambda value of smoke limitation in case the gear belongs to upper gear box" MAP 0xD27E4 Kf_Xs16_Ys16_Ws16 32.00000 lambda 0.00 32.00000 FORMAT "%8.5" EXTENDED_LIMITS -32.76800 32.76700
 /begin AXIS_DESCR STD_AXIS Eng_nAvrg EngN 16 0.00 6000.000 FORMAT "%8.3" EXTENDED_LIMITS -32768.00 32767.00 DEPOSIT ABSOLUTE /end AXIS_DESCR
 /begin AXIS_DESCR STD_AXIS FlMng_mAirPerCylFltSmk_mp AirMassPerCyl 16 0.00 2500.000 FORMAT "%8.3" EXTENDED_LIMITS -3276.800 3276.700 DEPOSIT ABSOLUTE /end AXIS_DESCR
/end CHARACTERISTIC
/begin CHARACTERISTIC FlMng_rLmbdSmk2UpperGbx_MAP "2nd map to determine the lambda value of smoke limitation in case the gear belongs to upper gear box" MAP 0xD2A28 Kf_Xs16_Ys16_Ws16 32.00000 lambda 0.00 32.00000 FORMAT "%8.5" EXTENDED_LIMITS -32.76800 32.76700
 /begin AXIS_DESCR STD_AXIS Eng_nAvrg EngN 16 0.00 6000.000 FORMAT "%8.3" EXTENDED_LIMITS -32768.00 32767.00 DEPOSIT ABSOLUTE /end AXIS_DESCR
 /begin AXIS_DESCR STD_AXIS ASMod_mAirPerCylCorr AirMassPerCyl 16 0.00 2500.000 FORMAT "%8.3" EXTENDED_LIMITS -3276.800 3276.700 DEPOSIT ABSOLUTE /end AXIS_DESCR
/end CHARACTERISTIC
/begin CHARACTERISTIC FlMng_rLmbdSmk2_MAP "Map number 2 for determining the lambda value for smoke limitation" MAP 0xD2C6C Kf_Xs16_Ys16_Ws16 32.00000 lambda 0.00 32.00000 FORMAT "%8.5" EXTENDED_LIMITS -32.76800 32.76700
 /begin AXIS_DESCR STD_AXIS Eng_nAvrg EngN 16 0.00 6000.000 FORMAT "%8.3" EXTENDED_LIMITS -32768.00 32767.00 DEPOSIT ABSOLUTE /end AXIS_DESCR
 /begin AXIS_DESCR STD_AXIS ASMod_mAirPerCylCorr AirMassPerCyl 16 0.00 2500.000 FORMAT "%8.3" EXTENDED_LIMITS -3276.800 3276.700 DEPOSIT ABSOLUTE /end AXIS_DESCR
/end CHARACTERISTIC
/begin CHARACTERISTIC FlMng_rLmbdSmkFDC_MAP "map to determine the lambda value of smoke limitation" MAP 0xD2EB0 Kf_Xs16_Ys16_Ws16 32.00000 lambda 0.00 32.00000 FORMAT "%8.5" EXTENDED_LIMITS -32.76800 32.76700
 /begin AXIS_DESCR STD_AXIS Eng_nAvrg EngN 16 0.00 6000.000 FORMAT "%8.3" EXTENDED_LIMITS -32768.00 32767.00 DEPOSIT ABSOLUTE /end AXIS_DESCR
 /begin AXIS_DESCR STD_AXIS FlMng_mAirPerCylFltSmk_mp AirMassPerCyl 16 0.00 2500.000 FORMAT "%8.3" EXTENDED_LIMITS -3276.800 3276.700 DEPOSIT ABSOLUTE /end AXIS_DESCR
/end CHARACTERISTIC
/begin CHARACTERISTIC FlMng_rLmbdSmkRgn1_MAP "Kennfeld zur Ermittlung des Lambda-Wertes der Rauchbegrenzung im Regenerationszustand 1" MAP 0xD30F4 Kf_Xs16_Ys16_Ws16 32.00000 lambda 0.00 32.00000 FORMAT "%8.5" EXTENDED_LIMITS -32.76800 32.76700
 /begin AXIS_DESCR STD_AXIS Eng_nAvrg EngN 16 0.00 6000.000 FORMAT "%8.3" EXTENDED_LIMITS -32768.00 32767.00 DEPOSIT ABSOLUTE /end AXIS_DESCR
 /begin AXIS_DESCR STD_AXIS ASMod_mAirPerCylCorr AirMassPerCyl 16 0.00 2500.000 FORMAT "%8.3" EXTENDED_LIMITS -3276.800 3276.700 DEPOSIT ABSOLUTE /end AXIS_DESCR
/end CHARACTERISTIC
/begin CHARACTERISTIC FlMng_rLmbdSmkRgn2_MAP "Kennfeld zur Ermittlung des Lambda-Wertes der Rauchbegrenzung im Regenerationszustand 2" MAP 0xD3338 Kf_Xs16_Ys16_Ws16 32.00000 lambda 0.00 32.00000 FORMAT "%8.5" EXTENDED_LIMITS -32.76800 32.76700
 /begin AXIS_DESCR STD_AXIS Eng_nAvrg EngN 16 0.00 6000.000 FORMAT "%8.3" EXTENDED_LIMITS -32768.00 32767.00 DEPOSIT ABSOLUTE /end AXIS_DESCR
 /begin AXIS_DESCR STD_AXIS ASMod_mAirPerCylCorr AirMassPerCyl 16 0.00 2500.000 FORMAT "%8.3" EXTENDED_LIMITS -3276.800 3276.700 DEPOSIT ABSOLUTE /end AXIS_DESCR
/end CHARACTERISTIC
/begin CHARACTERISTIC FlMng_rLmbdSmkUpperGbxFDC_MAP "map to determine the lambda value of smoke limitation in case the gear belongs to upper gear box" MAP 0xD357C Kf_Xs16_Ys16_Ws16 32.00000 lambda 0.00 32.00000 FORMAT "%8.5" EXTENDED_LIMITS -32.76800 32.76700
 /begin AXIS_DESCR STD_AXIS Eng_nAvrg EngN 16 0.00 6000.000 FORMAT "%8.3" EXTENDED_LIMITS -32768.00 32767.00 DEPOSIT ABSOLUTE /end AXIS_DESCR
 /begin AXIS_DESCR STD_AXIS FlMng_mAirPerCylFltSmk_mp AirMassPerCyl 16 0.00 2500.000 FORMAT "%8.3" EXTENDED_LIMITS -3276.800 3276.700 DEPOSIT ABSOLUTE /end AXIS_DESCR
/end CHARACTERISTIC
/begin CHARACTERISTIC FlMng_rLmbdSmkUpperGbx_MAP "map to determine the lambda value of smoke limitation in case the gear belongs to upper gear box" MAP 0xD37C0 Kf_Xs16_Ys16_Ws16 32.00000 lambda 0.00 32.00000 FORMAT "%8.5" EXTENDED_LIMITS -32.76800 32.76700
 /begin AXIS_DESCR STD_AXIS Eng_nAvrg EngN 16 0.00 6000.000 FORMAT "%8.3" EXTENDED_LIMITS -32768.00 32767.00 DEPOSIT ABSOLUTE /end AXIS_DESCR
 /begin AXIS_DESCR STD_AXIS ASMod_mAirPerCylCorr AirMassPerCyl 16 0.00 2500.000 FORMAT "%8.3" EXTENDED_LIMITS -3276.800 3276.700 DEPOSIT ABSOLUTE /end AXIS_DESCR
/end CHARACTERISTIC
/begin CHARACTERISTIC FlMng_rLmbdSmk_MAP "Kennfeld zur Ermittlung des Lambda-Werts der Rauchbegrenzung" MAP 0xD3A04 Kf_Xs16_Ys16_Ws16 32.00000 lambda 0.00 32.00000 FORMAT "%8.5" EXTENDED_LIMITS -32.76800 32.76700
 /begin AXIS_DESCR STD_AXIS Eng_nAvrg EngN 16 0.00 6000.000 FORMAT "%8.3" EXTENDED_LIMITS -32768.00 32767.00 DEPOSIT ABSOLUTE /end AXIS_DESCR
 /begin AXIS_DESCR STD_AXIS ASMod_mAirPerCylCorr AirMassPerCyl 16 0.00 2500.000 FORMAT "%8.3" EXTENDED_LIMITS -3276.800 3276.700 DEPOSIT ABSOLUTE /end AXIS_DESCR
/end CHARACTERISTIC
/begin CHARACTERISTIC FlMng_dqSlpPos_C "Positive Steigung der Abklingrampe der Vollastregelung" VALUE 0xD3E98 Kw_Wu32 655359.999847 RmpInjMass 0.00 655359.999847 FORMAT "%13.6" /end CHARACTERISTIC
/begin CHARACTERISTIC FlMng_dqSlpNeg_C "Negative Steigung der Abklingrampe der Vollastregelung" VALUE 0xD3E9C Kw_Wu32 655359.999847 RmpInjMass 0.00 655359.999847 FORMAT "%13.6" /end CHARACTERISTIC
/begin CHARACTERISTIC FlMng_stEGTRglOff_C "Maske zur Abschaltung des Reglers bei Regenerationsbetrieb bei Abgasnachbehandlung" VALUE 0xD3EA0 Kw_Ws32 4294967295.00 OneToOne -2147483648.00 2147483647.00 FORMAT "%13.2" /end CHARACTERISTIC
/begin CHARACTERISTIC FlMng_stGearGroupSwitch_C "Switch to determine the upper gear group and the lower gear group" VALUE 0xD3C48 Kw_Wu8 9.000 OneToOne 1.000 10.00 FORMAT "%5.2" EXTENDED_LIMITS 0.00 255.0 /end CHARACTERISTIC
/begin CHARACTERISTIC FlMng_stRgnMsk1_C "applizierbare Bitmaske für Regenerationsanforderung 1 der Abgasnachbehandlung" VALUE 0xD3C4C Kw_Wu32 2147483647.00 OneToOne 0.00 2147483647.00 FORMAT "%13.2" EXTENDED_LIMITS 0.00 4294967295.00 /end CHARACTERISTIC
/begin CHARACTERISTIC FlMng_stRgnMsk2_C "applizierbare Bitmaske für Regenerationsanforderung 2 der Abgasnachbehandlung" VALUE 0xD3C50 Kw_Wu32 2147483647.00 OneToOne 0.00 2147483647.00 FORMAT "%13.2" EXTENDED_LIMITS 0.00 4294967295.00 /end CHARACTERISTIC
/begin CHARACTERISTIC FlMng_swtFullLdRglVal_C "#SSD Schalter um Volllastregelung zu (de)aktivieren (1: aktiev, 0: inaktiev)" VALUE 0xD3EA4 Kw_Wu8 1.000 OneToOne 0.00 1.000 FORMAT "%5.3" EXTENDED_LIMITS 0.00 255.0 /end CHARACTERISTIC
/begin CHARACTERISTIC FlMng_swtFullLdRglType_C "#SSD Typ des Schalters um Volllastregelung zu (de)aktivieren" VALUE 0xD3EA5 Kw_Wu8 1.000 OneToOne 1.000 2.000 FORMAT "%5.3" EXTENDED_LIMITS 0.00 255.0 /end CHARACTERISTIC
/begin CHARACTERISTIC FlMng_tiAirPerCylPT1_MAP "map to get filter time constant for AFSCD_mAirPerCyl PT1 filtering" MAP 0xD3C54 Kf_Xs16_Ys16_Ws16 16.776216 TimeDelay_s_2 0.0010000129 16.777216 FORMAT "%9.6" EXTENDED_LIMITS 0.00051201563 16.777216
 /begin AXIS_DESCR STD_AXIS Eng_nAvrg EngN 8 0.00 6000.000 FORMAT "%8.3" EXTENDED_LIMITS -32768.00 32767.00 DEPOSIT ABSOLUTE /end AXIS_DESCR
 /begin AXIS_DESCR STD_AXIS PCR_pBGDev Pres_hPa 8 -5000.000 5000.000 FORMAT "%8.3" EXTENDED_LIMITS -32768.00 32767.00 DEPOSIT ABSOLUTE /end AXIS_DESCR
/end CHARACTERISTIC
/begin CHARACTERISTIC FlMng_tiDefectDead_C "Zeitverzögerung zur Erkennung eines abgefallenen Ladeluftschlauchs" VALUE 0xD3CF8 Kw_Wu16 655.1400 Time_s 0.00 655.1400 FORMAT "%8.4" EXTENDED_LIMITS 0.00 655.3500 /end CHARACTERISTIC
/begin CHARACTERISTIC FlMng_tiFullLdRglDel_CUR "Drehzahlabhängige Einschaltverzögerung der Vollastregelung" CURVE 0xD3EA6 Kl_Xs16_Ws16 327670.0 Time_ms 0.00 327670.0 FORMAT "%8.1" EXTENDED_LIMITS -327680.0 327670.0
 /begin AXIS_DESCR STD_AXIS Eng_nAvrg EngN 10 0.00 6000.000 FORMAT "%8.3" EXTENDED_LIMITS -32768.00 32767.00 DEPOSIT ABSOLUTE /end AXIS_DESCR
/end CHARACTERISTIC
/begin CHARACTERISTIC FlMng_tiPT1Neg_MAP "Kennfeld zur Ermittlung der Basisfilterzeitkonstante zur Filterung der Luftmasse bei negativer Änderung" MAP 0xD3CFA Kf_Xs16_Ys16_Ws16 16.776216 TimeDelay_s_2 0.0010000129 16.777216 FORMAT "%9.6" EXTENDED_LIMITS 0.00051201563 16.777216
 /begin AXIS_DESCR STD_AXIS Eng_nAvrg EngN 8 0.00 6000.000 FORMAT "%8.3" EXTENDED_LIMITS -32768.00 32767.00 DEPOSIT ABSOLUTE /end AXIS_DESCR
 /begin AXIS_DESCR STD_AXIS PCR_pBGDev Pres_hPa 8 -5000.000 5000.000 FORMAT "%8.3" EXTENDED_LIMITS -32768.00 32767.00 DEPOSIT ABSOLUTE /end AXIS_DESCR
/end CHARACTERISTIC
/begin CHARACTERISTIC FlMng_tiPT1Pos_MAP "Kennfeld zur Ermittlung der Basisfilterzeitkonstante zur Filterung der Luftmasse bei positiver Änderung" MAP 0xD3D9E Kf_Xs16_Ys16_Ws16 16.776216 TimeDelay_s_2 0.0010000129 16.777216 FORMAT "%9.6" EXTENDED_LIMITS 0.00051201563 16.777216
 /begin AXIS_DESCR STD_AXIS Eng_nAvrg EngN 8 0.00 6000.000 FORMAT "%8.3" EXTENDED_LIMITS -32768.00 32767.00 DEPOSIT ABSOLUTE /end AXIS_DESCR
 /begin AXIS_DESCR STD_AXIS PCR_pBGDev Pres_hPa 8 -5000.000 5000.000 FORMAT "%8.3" EXTENDED_LIMITS -32768.00 32767.00 DEPOSIT ABSOLUTE /end AXIS_DESCR
/end CHARACTERISTIC
/begin CHARACTERISTIC FlMng_tiRmpSlp_C "Rampenlaufzeit für Mehrfachschalter EGT_RgnSwtE" VALUE 0xD3E44 Kw_Wu32 31.775030303030302 TimeEGTRmp 0.99296969696969695 32.768000000000001 FORMAT "%19.16" EXTENDED_LIMITS 0.000000015258789066052715 65.536000000000001 /end CHARACTERISTIC
/begin CHARACTERISTIC FlMng_trqEpsLim_C "halbe Intervallbreite für Abfrage der Abschaltbedingung" VALUE 0xD3ED0 Kw_Ws16 3276.700 Trq 0.00 3276.700 FORMAT "%8.3" EXTENDED_LIMITS -3276.800 3276.700 /end CHARACTERISTIC
/begin CHARACTERISTIC FlMng_trqEps_C "Hysterese für Momentenschwellwert der Vollastregelung" VALUE 0xD3ED2 Kw_Ws16 3276.700 Trq 0.00 3276.700 FORMAT "%8.3" EXTENDED_LIMITS -3276.800 3276.700 /end CHARACTERISTIC
/begin CHARACTERISTIC FlMng_trqThresInrDes0_C "torque threshold for dynamic smoke limitation" VALUE 0xD3E48 Kw_Ws16 1500.000 Trq -500.0000 1000.000 FORMAT "%8.3" EXTENDED_LIMITS -3276.800 3276.700 /end CHARACTERISTIC
/begin CHARACTERISTIC FlMng_trqThresInrDes1_C "torque threshold for static smoke limitation" VALUE 0xD3E4A Kw_Ws16 1500.000 Trq -500.0000 1000.000 FORMAT "%8.3" EXTENDED_LIMITS -3276.800 3276.700 /end CHARACTERISTIC
/begin CHARACTERISTIC FlMng_trqThresInrDes2_C "torque threshold for static smoke limitation" VALUE 0xD3E4C Kw_Ws16 1500.000 Trq -500.0000 1000.000 FORMAT "%8.3" EXTENDED_LIMITS -3276.800 3276.700 /end CHARACTERISTIC
/begin CHARACTERISTIC FlMng_trqThresInr_C "torque threshold for smoke limitation" VALUE 0xD3E4E Kw_Ws16 1500.000 Trq -500.0000 1000.000 FORMAT "%8.3" EXTENDED_LIMITS -3276.800 3276.700 /end CHARACTERISTIC
/begin CHARACTERISTIC FlMng_tThresLmbdHigh_C "temperature threshold high for smoke limitation" VALUE 0xD3E50 Kw_Ws16 250.0000 Temp_Cels -50.14000 199.8600 FORMAT "%8.4" EXTENDED_LIMITS -3549.940 3003.560 /end CHARACTERISTIC
/begin CHARACTERISTIC FlMng_tThresLmbdLow_C "temperature threshold low for smoke limitation" VALUE 0xD3E52 Kw_Ws16 250.0000 Temp_Cels -50.14000 199.8600 FORMAT "%8.4" EXTENDED_LIMITS -3549.940 3003.560 /end CHARACTERISTIC
/begin CHARACTERISTIC FlSys_nDeflateMax_C "#SSD obere Drehzahlschwelle für die Entlueftung Niederdruckkreis" VALUE 0xD3EE0 Kw_Ws16 32767.00 EngN 0.00 32767.00 FORMAT "%8.2" EXTENDED_LIMITS -32768.00 32767.00 /end CHARACTERISTIC
/begin CHARACTERISTIC FlSys_nDeflateMin_C "#SSD untere Drehzahlschwelle für die Entlueftung Niederdruckkreis" VALUE 0xD3EE2 Kw_Ws16 32767.00 EngN 0.00 32767.00 FORMAT "%8.2" EXTENDED_LIMITS -32768.00 32767.00 /end CHARACTERISTIC
/begin CHARACTERISTIC FlSys_pDeflate_C "#SSD Raildruckschwelle für die Entlueftung Niederdruckkreis" VALUE 0xD3EE4 Kw_Ws16 2000.000 Pres_Rail 0.00 2000.000 FORMAT "%5.3" EXTENDED_LIMITS -3276.800 3276.700 /end CHARACTERISTIC
/begin CHARACTERISTIC FlSys_rhoFl_C "#SSD Kraftstoffdichte bei Normtemperatur" VALUE 0xD3ED4 Kw_Ws16 999.9000 RhoFuel 0.1000000 1000.000 FORMAT "%8.3" EXTENDED_LIMITS -3276.800 3276.700 /end CHARACTERISTIC
/begin CHARACTERISTIC FlSys_rhoFl_CUR "#SSD temperaturabhängige Kraftstoffdichte" CURVE 0xD3ED6 Kl_Xs16_Ws16 999.9000 RhoFuel 0.1000000 1000.000 FORMAT "%8.3" EXTENDED_LIMITS -3276.800 3276.700
 /begin AXIS_DESCR STD_AXIS FTSCD_tFuel Temp_Cels 2 -50.14000 199.8600 FORMAT "%8.4" EXTENDED_LIMITS -3549.940 3003.560 DEPOSIT ABSOLUTE /end AXIS_DESCR
/end CHARACTERISTIC
/begin CHARACTERISTIC FlSys_swtTempSel_C "Auswahl der Kraftstoffsystemtemperatur (0: Kraftstofftemperatur, 1: Wassertemperatur, 2: Ersatzwert)" VALUE 0xD3EE8 Kw_Wu8 2.000 OneToOne 0.00 2.000 FORMAT "%5.3" EXTENDED_LIMITS 0.00 255.0 /end CHARACTERISTIC
/begin CHARACTERISTIC FlSys_swtTempSensCfgVal_C "Schalterwert, ob Kraftstofftemperaturfühler vorhanden (0: nicht vorhanden, 1: vorhanden)" VALUE 0xD3EE9 Kw_Wu8 1.000 OneToOne 0.00 1.000 FORMAT "%5.3" EXTENDED_LIMITS 0.00 255.0 /end CHARACTERISTIC
/begin CHARACTERISTIC FlSys_swtTempSensCfgType_C "#SSD Auswahl der Quelle des Softwareschalters ob Kraftstofftemperaturfühler vorhanden. (Datensatz oder EEPROM)" VALUE 0xD3EEA Kw_Wu8 0.00 OneToOne 2.000 2.000 FORMAT "%5.3" EXTENDED_LIMITS 0.00 255.0 /end CHARACTERISTIC
/begin CHARACTERISTIC FlSys_tDfl_C "Ersatzwert für Kraftstoffsystemtemperatur" VALUE 0xD3EEC Kw_Ws16 250.0000 Temp_Cels -50.14000 199.8600 FORMAT "%8.4" EXTENDED_LIMITS -3549.940 3003.560 /end CHARACTERISTIC
/begin CHARACTERISTIC FlSys_tiDeflateDel_C "#SSD Verzoegerungszeit für die Entlueftung Niederdruckkreis" VALUE 0xD3EE6 Kw_Wu16 655350.0 Time_ms 0.00 655350.0 FORMAT "%8.1" /end CHARACTERISTIC
/begin CHARACTERISTIC FMA_dfacSwtOffMax_C "Maximal zulässige Änderungsgeschwindigkeit der temperaturabhängigen Abschaltfaktoren" VALUE 0xD3FF4 Kw_Wu32 50.0000007451 Rmp_Fact 0.00 50.0000007451 FORMAT "%13.10" EXTENDED_LIMITS 0.00 7999.99999814 /end CHARACTERISTIC
/begin CHARACTERISTIC FMA_dqThrs_C "Schwelle für Erkennung starker Einspritzmengenänderungen der FMA" VALUE 0xD3FF8 Kw_Ws16 200.0000 InjMassSec 0.00 200.0000 FORMAT "%8.4" EXTENDED_LIMITS -327.6800 327.6700 /end CHARACTERISTIC
/begin CHARACTERISTIC FMA_drLmbdThrs_C "Schwelle für Erkennung starker Lambdaänderung der FMA" VALUE 0xD3FFA Kw_Ws16 10.20000 lambdaSec -0.2000000 10.00000 FORMAT "%8.5" EXTENDED_LIMITS -32.76800 32.76700 /end CHARACTERISTIC
/begin CHARACTERISTIC FMA_facAirSwtOff_CUR "Kennlinie des ansauglufttemperaturabhängigen Abschaltfaktors der FMA" CURVE 0xD3FFC Kl_Xs16_Ws16 1.000000 Fact 0.00 1.000000 FORMAT "%8.6" EXTENDED_LIMITS -4.000000 3.999878
 /begin AXIS_DESCR STD_AXIS IATSCD_tAir Temp_Cels 8 -50.14000 199.8600 FORMAT "%8.4" EXTENDED_LIMITS -3549.940 3003.560 DEPOSIT ABSOLUTE /end AXIS_DESCR
/end CHARACTERISTIC
/begin CHARACTERISTIC FMA_facAPSwtOff_CUR "Kennlinie des atmosphärendruckabhängigen Abschaltfaktors der FMA" CURVE 0xD401E Kl_Xs16_Ws16 1.000000 Fact 0.00 1.000000 FORMAT "%8.6" EXTENDED_LIMITS -4.000000 3.999878
 /begin AXIS_DESCR STD_AXIS APSCD_pVal Pres_hPa 8 0.00 3500.000 FORMAT "%8.3" EXTENDED_LIMITS -32768.00 32767.00 DEPOSIT ABSOLUTE /end AXIS_DESCR
/end CHARACTERISTIC
/begin CHARACTERISTIC FMA_facDensCor_C "Faktor für Dichtekorrektur bei Angabe der Kraftstoffmenge in" VALUE 0xD3EEE Kw_Ws16 0.1999512 Fact 0.8000488 1.000000 FORMAT "%8.6" EXTENDED_LIMITS -4.000000 3.999878 /end CHARACTERISTIC
/begin CHARACTERISTIC FMA_facEngSwtOff_CUR "Kennlinie des motortemperaturabhängigen Abschaltfaktors der FMA" CURVE 0xD4040 Kl_Xs16_Ws16 1.000000 Fact 0.00 1.000000 FORMAT "%8.6" EXTENDED_LIMITS -4.000000 3.999878
 /begin AXIS_DESCR STD_AXIS Eng_tEng Temp_Cels 8 -50.14000 199.8600 FORMAT "%8.4" EXTENDED_LIMITS -3549.940 3003.560 DEPOSIT ABSOLUTE /end AXIS_DESCR
/end CHARACTERISTIC
/begin CHARACTERISTIC FMA_facFlSwtOff_CUR "Kennlinie des kraftstofftemperaturabhängigen Abschaltfaktors der FMA" CURVE 0xD4062 Kl_Xs16_Ws16 1.000000 Fact 0.00 1.000000 FORMAT "%8.6" EXTENDED_LIMITS -4.000000 3.999878
 /begin AXIS_DESCR STD_AXIS FTSCD_tFuel Temp_Cels 8 -50.14000 199.8600 FORMAT "%8.4" EXTENDED_LIMITS -3549.940 3003.560 DEPOSIT ABSOLUTE /end AXIS_DESCR
/end CHARACTERISTIC
/begin CHARACTERISTIC FMA_facNQSwtOff_MAP "Kennfeld des motodrehzahl-/einspritzmengenabhängigen Abschaltfaktors der FMA für betriebsbereichsabhängige Abschaltung" MAP 0xD3EF4 Kf_Xs16_Ys16_Ws16 1.000000 Fact 0.00 1.000000 FORMAT "%8.6" EXTENDED_LIMITS -4.000000 3.999878
 /begin AXIS_DESCR STD_AXIS Eng_nAvrg EngN 8 0.00 8000.000 FORMAT "%8.3" EXTENDED_LIMITS -32768.00 32767.00 DEPOSIT ABSOLUTE /end AXIS_DESCR
 /begin AXIS_DESCR STD_AXIS FMA_qCtl_mp InjMass 8 0.00 200.0000 FORMAT "%8.4" EXTENDED_LIMITS -327.6800 327.6700 DEPOSIT ABSOLUTE /end AXIS_DESCR
/end CHARACTERISTIC
/begin CHARACTERISTIC FMA_IKiFst_C "Integriererverstärkung der FMA bei Kleinsignalen (schnelles Einlernen des Kennfelds)" VALUE 0xD3F98 Kw_Wu32 4.00003045797 Ki 0.00 4.00003045797 FORMAT "%13.11" EXTENDED_LIMITS 0.00 999999.999767 /end CHARACTERISTIC
/begin CHARACTERISTIC FMA_IKiPosFst_C "Integriererverstärkung der FMA bei positiven Großsignalen (schnelles Einlernen des Kennfelds)" VALUE 0xD3F9C Kw_Wu32 4.00003045797 Ki 0.00 4.00003045797 FORMAT "%13.11" EXTENDED_LIMITS 0.00 999999.999767 /end CHARACTERISTIC
/begin CHARACTERISTIC FMA_IKiNegFst_C "Integriererverstärkung der FMA bei negativen Großsignalen (schnelles Einlernen des Kennfelds)" VALUE 0xD3FA0 Kw_Wu32 4.00003045797 Ki 0.00 4.00003045797 FORMAT "%13.11" EXTENDED_LIMITS 0.00 999999.999767 /end CHARACTERISTIC
/begin CHARACTERISTIC FMA_qIWinPosFst_C "Obere Kleinsignalgrenze für Integratoren der FMA (schnelles Einlernen des Kennfelds)" VALUE 0xD3FA4 Kw_Ws16 20.00000 InjMass 0.00 20.00000 FORMAT "%8.5" EXTENDED_LIMITS -327.6800 327.6700 /end CHARACTERISTIC
/begin CHARACTERISTIC FMA_qIWinNegFst_C "Untere Kleinsignalgrenze für Integratoren der FMA (schnelles Einlernen des Kennfelds)" VALUE 0xD3FA6 Kw_Ws16 20.00000 InjMass -20.00000 0.00 FORMAT "%8.5" EXTENDED_LIMITS -327.6800 327.6700 /end CHARACTERISTIC
/begin CHARACTERISTIC FMA_IKiSlw_C "Integriererverstärkung der FMA bei Kleinsignalen (langsames Einlernen des Kennfelds)" VALUE 0xD3FA8 Kw_Wu32 4.00003045797 Ki 0.00 4.00003045797 FORMAT "%13.11" EXTENDED_LIMITS 0.00 999999.999767 /end CHARACTERISTIC
/begin CHARACTERISTIC FMA_IKiPosSlw_C "Integriererverstärkung der FMA bei positiven Großsignalen (langsames Einlernen des Kennfelds)" VALUE 0xD3FAC Kw_Wu32 4.00003045797 Ki 0.00 4.00003045797 FORMAT "%13.11" EXTENDED_LIMITS 0.00 999999.999767 /end CHARACTERISTIC
/begin CHARACTERISTIC FMA_IKiNegSlw_C "Integriererverstärkung der FMA bei negativen Großsignalen (langsames Einlernen des Kennfelds)" VALUE 0xD3FB0 Kw_Wu32 4.00003045797 Ki 0.00 4.00003045797 FORMAT "%13.11" EXTENDED_LIMITS 0.00 999999.999767 /end CHARACTERISTIC
/begin CHARACTERISTIC FMA_qIWinPosSlw_C "Obere Kleinsignalgrenze für Integratoren der FMA (langsames Einlernen des Kennfelds)" VALUE 0xD3FB4 Kw_Ws16 20.00000 InjMass 0.00 20.00000 FORMAT "%8.5" EXTENDED_LIMITS -327.6800 327.6700 /end CHARACTERISTIC
/begin CHARACTERISTIC FMA_qIWinNegSlw_C "Untere Kleinsignalgrenze für Integratoren der FMA (langsames Einlernen des Kennfelds)" VALUE 0xD3FB6 Kw_Ws16 20.00000 InjMass -20.00000 0.00 FORMAT "%8.5" EXTENDED_LIMITS -327.6800 327.6700 /end CHARACTERISTIC
/begin CHARACTERISTIC FMA_nGrid_C "Vektor der Drehzahlwerte der Kennfeldstützstellen" VAL_BLK 0xD3FB8 Kwb_Ws16 4000.000 EngN 0.00 4000.000 FORMAT "%8.3" EXTENDED_LIMITS -32768.00 32767.00 NUMBER 8 /end CHARACTERISTIC
/begin CHARACTERISTIC FMA_nThrs_C "Drehzahlschwelle für Schuberkennung der FMA" VALUE 0xD4084 Kw_Ws16 5960.000 EngN 40.00000 6000.000 FORMAT "%8.3" EXTENDED_LIMITS -32768.00 32767.00 /end CHARACTERISTIC
/begin CHARACTERISTIC FMA_numNGrid_C "Anzahl der Drehzahlstützstellen des adaptiven Kenfelds" VALUE 0xD3FC8 Kw_Wu8 6.000 OneToOne 2.000 8.000 FORMAT "%5.3" EXTENDED_LIMITS 0.00 255.0 /end CHARACTERISTIC
/begin CHARACTERISTIC FMA_numQGrid_C "Anzahl der Mengenstützstellen des adaptiven Kenfelds" VALUE 0xD3FC9 Kw_Wu8 6.000 OneToOne 2.000 8.000 FORMAT "%5.3" EXTENDED_LIMITS 0.00 255.0 /end CHARACTERISTIC
/begin CHARACTERISTIC FMA_tiPT1Fst_C "Zeitkonstante der PT1-Filter zur Filterung des aktuellen Mengenfehlers (schnelles Einlernen des Kennfelds)" VALUE 0xD3FCC Kw_Wu32 4294.9663 TimeDelay_s 0.0010000001 4294.9673 FORMAT "%9.4" EXTENDED_LIMITS 0.0000010000000 4294.9673 /end CHARACTERISTIC
/begin CHARACTERISTIC FMA_tiPT1Slw_C "Zeitkonstante der PT1-Filter zur Filterung des aktuellen Mengenfehlers (langsames Einlernen des Kennfelds)" VALUE 0xD3FD0 Kw_Wu32 4294.9663 TimeDelay_s 0.0010000001 4294.9673 FORMAT "%9.4" EXTENDED_LIMITS 0.0000010000000 4294.9673 /end CHARACTERISTIC
/begin CHARACTERISTIC FMA_qGrid_C "Vektor der Mengenwerte der Kennfeldstützstellen" VAL_BLK 0xD3FD4 Kwb_Ws16 80.00000 InjMass -40.00000 40.00000 FORMAT "%8.5" EXTENDED_LIMITS -327.6800 327.6700 NUMBER 8 /end CHARACTERISTIC
/begin CHARACTERISTIC FMA_qIntMax_C "Maximal zulässiger Wert für adaptierte Mengenfehler in den Lernpunkten , d.h. für Zustände der Integratoren und PT1-Glieder" VALUE 0xD3FE4 Kw_Ws16 80.00000 InjMass -40.00000 40.00000 FORMAT "%8.5" EXTENDED_LIMITS -327.6800 327.6700 /end CHARACTERISTIC
/begin CHARACTERISTIC FMA_qIntMin_C "Minimal zulässiger Wert für adaptierte Mengenfehler in den Lernpunkten , d.h. für Zustände der Integratoren und PT1-Glieder" VALUE 0xD3FE6 Kw_Ws16 80.00000 InjMass -40.00000 40.00000 FORMAT "%8.5" EXTENDED_LIMITS -327.6800 327.6700 /end CHARACTERISTIC
/begin CHARACTERISTIC FMA_qMax_C "Oberer Grenzwert für Einspritzmengenkorrektur der FMA" VALUE 0xD3FE8 Kw_Ws16 80.00000 InjMass -40.00000 40.00000 FORMAT "%8.5" EXTENDED_LIMITS -327.6800 327.6700 /end CHARACTERISTIC
/begin CHARACTERISTIC FMA_qMin_C "Unterer Grenzwert für Einspritzmengenkorrektur der FMA" VALUE 0xD3FEA Kw_Ws16 80.00000 InjMass -40.00000 40.00000 FORMAT "%8.5" EXTENDED_LIMITS -327.6800 327.6700 /end CHARACTERISTIC
/begin CHARACTERISTIC FMA_qThrs_C "Einspritzmengenschwelle für Schuberkennung der FMA" VALUE 0xD4086 Kw_Ws16 40.00000 InjMass 0.00 40.00000 FORMAT "%8.5" EXTENDED_LIMITS -327.6800 327.6700 /end CHARACTERISTIC
/begin CHARACTERISTIC FMA_rLmbdThrsMax_C "Obere Grenze des für FMA zulässigen Lambdabereichs" VALUE 0xD4088 Kw_Ws16 10.20000 lambda -0.2000000 10.00000 FORMAT "%8.5" EXTENDED_LIMITS -32.76800 32.76700 /end CHARACTERISTIC
/begin CHARACTERISTIC FMA_rLmbdThrsMin_C "Untere Grenze des für FMA zulässigen Lambdabereichs" VALUE 0xD408A Kw_Ws16 10.20000 lambda -0.2000000 10.00000 FORMAT "%8.5" EXTENDED_LIMITS -32.76800 32.76700 /end CHARACTERISTIC
/begin CHARACTERISTIC FMA_stRgnMsk_C "Bitmaske zur Abschaltung der FMA bei bestimmten Regenerationszuständen EGT_st" VALUE 0xD408C Kw_Wu32 4294967295.00 OneToOne 0.00 4294967295.00 FORMAT "%13.2" /end CHARACTERISTIC
/begin CHARACTERISTIC FMA_swtIC_C "Schalter für Betriebsartauswahl der FMA (1: Indirect Control, 0: Direct Control)" VALUE 0xD3EF0 Kw_Wu8 1.000 OneToOne 0.00 1.000 FORMAT "%5.3" EXTENDED_LIMITS 0.00 255.0 READ_ONLY /end CHARACTERISTIC
/begin CHARACTERISTIC FMA_swtOnFMA_C "Schalter zum Ein-/Ausschalten der gesamten FMA (1...ein, 0...aus)" VALUE 0xD4090 Kw_Wu8 1.000 OneToOne 0.00 1.000 FORMAT "%5.3" EXTENDED_LIMITS 0.00 255.0 /end CHARACTERISTIC
/begin CHARACTERISTIC FMA_swtRst_C "Schalter zur Reinitialisierung des Fehlermodells (1: Rücksetzen, 0: Startet die Adaption nach dem Rücksetzen)" VALUE 0xD3FEC Kw_Wu8 1.000 OneToOne 0.00 1.000 FORMAT "%5.3" EXTENDED_LIMITS 0.00 255.0 /end CHARACTERISTIC
/begin CHARACTERISTIC FMA_tiDLmbdThrs_C "Wartezeit bis der FMA- Lambdaänderungsstatus nach Ende der Lambdaänderung zurückgesetzt wird" VALUE 0xD4092 Kw_Wu16 20.00000 Time_s 0.00 20.00000 FORMAT "%8.5" EXTENDED_LIMITS 0.00 655.3500 /end CHARACTERISTIC
/begin CHARACTERISTIC FMA_tiDynThrs_C "Wartezeit bis der FMA-Einspritzmengendynamikstatus nach Ende der Einspritzmengenänderung zurückgesetzt wird" VALUE 0xD4094 Kw_Wu16 20.00000 Time_s 0.00 20.00000 FORMAT "%8.5" EXTENDED_LIMITS 0.00 655.3500 /end CHARACTERISTIC
/begin CHARACTERISTIC FMA_tiFaultRmp_C "Dauer des rampenförmigen Abschaltens der FMA bei schweren Systemfehlern" VALUE 0xD4098 Kw_Wu32 40.0000000000 Time_s 0.00 40.0000000000 FORMAT "%13.10" EXTENDED_LIMITS 0.00 42949672.9500 /end CHARACTERISTIC
/begin CHARACTERISTIC FMA_tiLmbdDT1_C "Verzögerungszeitkonstante der Differentiation von Lambda in der FMA" VALUE 0xD409C Kw_Wu32 3.9980385 TimeDelay_s 0.0010000001 3.9990385 FORMAT "%9.7" EXTENDED_LIMITS 0.0000010000000 4294.9673 /end CHARACTERISTIC
/begin CHARACTERISTIC FMA_tiLmbdThrs_C "Wartezeit bis der FMA- Lambdabereichstatus nach Bereichs-verletzung zurückgesetzt wird" VALUE 0xD40A0 Kw_Wu16 20.00000 Time_s 0.00 20.00000 FORMAT "%8.5" EXTENDED_LIMITS 0.00 655.3500 /end CHARACTERISTIC
/begin CHARACTERISTIC FMA_tiOvrRun_C "Wartezeit bis der FMA-Schbstatus nach Schubende zurückgesetzt wird" VALUE 0xD40A2 Kw_Wu16 20.00000 Time_s 0.00 20.00000 FORMAT "%8.5" EXTENDED_LIMITS 0.00 655.3500 /end CHARACTERISTIC
/begin CHARACTERISTIC FMA_tiQDT1_C "Vezögerungszeitkonstante der Differentiation der Einspritzmenge für Erkennung starker Mengenänderungen der FMA" VALUE 0xD40A4 Kw_Wu32 3.9980385 TimeDelay_s 0.0010000001 3.9990385 FORMAT "%9.7" EXTENDED_LIMITS 0.0000010000000 4294.9673 /end CHARACTERISTIC
/begin CHARACTERISTIC FMA_tiQLmbd_C "Verzögerungszeit nach einer Resetierung um die Adaption zuzulassen" VALUE 0xD40A8 Kw_Wu16 20.00000 Time_s 0.00 20.00000 FORMAT "%8.5" EXTENDED_LIMITS 0.00 655.3500 /end CHARACTERISTIC
/begin CHARACTERISTIC FMA_tiSwtPar_C "Betriebszeit der FMA, nach der von schnellem auf langsames Lernen umgeschaltet wird" VALUE 0xD3FF0 Kw_Ws32 1000000.00000 Time_s 0.00 1000000.00000 FORMAT "%13.5" EXTENDED_LIMITS -21474836.4800 21474836.4700 /end CHARACTERISTIC
/begin CHARACTERISTIC FMTC_dqtrq2qBasRmpUp_C "Positiver Rampengradient" VALUE 0xD40AC Kw_Wu32 655359.999847 RmpInjMass 0.00 655359.999847 FORMAT "%13.6" /end CHARACTERISTIC
/begin CHARACTERISTIC FMTC_dqtrq2qBasRmpDwn_C "Negativer Rampengradient" VALUE 0xD40B0 Kw_Wu32 655359.999847 RmpInjMass 0.00 655359.999847 FORMAT "%13.6" /end CHARACTERISTIC
/begin CHARACTERISTIC FMTC_eta0_C "fester Wirkungsgradfaktor zur Umrechnung Startmoment in Startmenge" VALUE 0xD40B4 Kw_Ws16 100.0000 Eta 0.00 100.0000 FORMAT "%8.4" EXTENDED_LIMITS -256.0000 255.9922 /end CHARACTERISTIC
/begin CHARACTERISTIC FMTC_facAirCorr_CUR "Gewichtungsfaktor der Eta-Korrektur für die Abweichug der Luft pro Zylinder vom Referenzwert" CURVE 0xD4C74 Kl_Xs16_Ws16 503.9999 Fact -500.0000 3.999878 FORMAT "%8.4" EXTENDED_LIMITS -4.000000 3.999878
 /begin AXIS_DESCR STD_AXIS CoEng_trqInrSet Trq 8 -3276.800 3276.700 FORMAT "%8.3" DEPOSIT ABSOLUTE /end AXIS_DESCR
/end CHARACTERISTIC
/begin CHARACTERISTIC FMTC_facAirCorr_MAP "eta correction for start of injection, base value" MAP 0xD4C96 Kf_Xs16_Ys16_Ws16 10.00000 Fact 0.00 10.00000 FORMAT "%8.5" EXTENDED_LIMITS -4.000000 3.999878
 /begin AXIS_DESCR STD_AXIS Eng_nAvrg EngN 8 0.00 6000.000 FORMAT "%8.3" EXTENDED_LIMITS -32768.00 32767.00 DEPOSIT ABSOLUTE /end AXIS_DESCR
 /begin AXIS_DESCR STD_AXIS FMTC_mAirDiff_mp AirMassPerCyl 8 -30.00000 30.00000 FORMAT "%8.5" EXTENDED_LIMITS -3276.800 3276.700 DEPOSIT ABSOLUTE /end AXIS_DESCR
/end CHARACTERISTIC
/begin CHARACTERISTIC FMTC_facStrtInjCorr_CUR "Eta-Korrektur für die Abweichug des Spritzbeginns vom Referenzwert, Gewichtungsfaktor" CURVE 0xD4D3A Kl_Xs16_Ws16 3.999878 Fact 0.00 3.999878 FORMAT "%8.6" EXTENDED_LIMITS -4.000000 3.999878
 /begin AXIS_DESCR STD_AXIS CoEng_trqInrSet Trq 8 -500.0000 1000.000 FORMAT "%8.3" EXTENDED_LIMITS -3276.800 3276.700 DEPOSIT ABSOLUTE /end AXIS_DESCR
/end CHARACTERISTIC
/begin CHARACTERISTIC FMTC_facStrtInjCorr_MAP "eta correction for start of injection, base value" MAP 0xD4D5C Kf_Xs16_Ys16_Ws16 10.00000 Fact 0.00 10.00000 FORMAT "%8.5" EXTENDED_LIMITS -4.000000 3.999878
 /begin AXIS_DESCR STD_AXIS Eng_nAvrg EngN 8 0.00 6000.000 FORMAT "%8.3" EXTENDED_LIMITS -32768.00 32767.00 DEPOSIT ABSOLUTE /end AXIS_DESCR
 /begin AXIS_DESCR STD_AXIS FMTC_phiStrtInjDiff_mp AngleCrS 8 -30.00000 30.00000 FORMAT "%8.5" EXTENDED_LIMITS -768.0000 767.9766 DEPOSIT ABSOLUTE /end AXIS_DESCR
/end CHARACTERISTIC
/begin CHARACTERISTIC FMTC_mAirOpt_MAP "optimale Frischluftmasse  (bzgl. Wirkungsgrad)" MAP 0xD4E00 Kf_Xs16_Ys16_Ws16 3276.700 AirMassPerCyl 0.00 3276.700 FORMAT "%8.3" EXTENDED_LIMITS -3276.800 3276.700
 /begin AXIS_DESCR STD_AXIS Eng_nAvrg EngN 16 0.00 6000.000 FORMAT "%8.3" EXTENDED_LIMITS -32768.00 32767.00 DEPOSIT ABSOLUTE /end AXIS_DESCR
 /begin AXIS_DESCR STD_AXIS CoEng_trqInrSet Trq 16 -500.0000 1000.000 FORMAT "%8.3" EXTENDED_LIMITS -3276.800 3276.700 DEPOSIT ABSOLUTE /end AXIS_DESCR
/end CHARACTERISTIC
/begin CHARACTERISTIC FMTC_phiStrtInjOpt_MAP "Eta-Korrektur, Referenzwert für den Spritzbeginn" MAP 0xD5044 Kf_Xs16_Ys16_Ws16 60.00000 AngleCrS -30.00000 30.00000 FORMAT "%8.5" EXTENDED_LIMITS -768.0000 767.9766
 /begin AXIS_DESCR STD_AXIS Eng_nAvrg EngN 16 0.00 6000.000 FORMAT "%8.3" EXTENDED_LIMITS -32768.00 32767.00 DEPOSIT ABSOLUTE /end AXIS_DESCR
 /begin AXIS_DESCR STD_AXIS CoEng_trqInrSet Trq 16 -500.0000 1000.000 FORMAT "%8.3" EXTENDED_LIMITS -3276.800 3276.700 DEPOSIT ABSOLUTE /end AXIS_DESCR
/end CHARACTERISTIC
/begin CHARACTERISTIC FMTC_stRgnMsk1_C "applizierbare Bitmaske für Regenerationsstatus 1" VALUE 0xD40B8 Kw_Wu32 4294967295.00 OneToOne 0.00 4294967295.00 FORMAT "%13.2" /end CHARACTERISTIC
/begin CHARACTERISTIC FMTC_stRgnMsk2_C "applizierbare Bitmaske für Regenerationsstatus 2" VALUE 0xD40BC Kw_Wu32 4294967295.00 OneToOne 0.00 4294967295.00 FORMAT "%13.2" /end CHARACTERISTIC
/begin CHARACTERISTIC FMTC_swtCorr_C "Wirkungsgradkorrekturen. Bit0: Korrektur Spritzbeginn (1: ein, 0: aus); Bit1: Korrektur Ansaugluft (1: ein, 0: aus)" VALUE 0xD5288 Kw_Wu8 3.000 OneToOne 0.00 3.000 FORMAT "%5.3" EXTENDED_LIMITS 0.00 255.0 /end CHARACTERISTIC
/begin CHARACTERISTIC FMTC_tiRmpSlp_C "Rampenlaufzeit für Mehrfachschalter" VALUE 0xD40C0 Kw_Wu16 65.435945038 TimeEGTRmp 0.10005496183 65.536000000 FORMAT "%12.9" EXTENDED_LIMITS 0.0010000152590 65.536000000 /end CHARACTERISTIC
/begin CHARACTERISTIC FMTC_trq2qBasCBOpn_MAP "Basis-Grundkennfeld fuer Drehmoment zu q Umwandlung bei geoeffnetem Verdichterbypass" MAP 0xD40C2 Kf_Xs16_Ys16_Ws16 327.6700 InjMassCyc 0.00 327.6700 FORMAT "%8.4" EXTENDED_LIMITS -327.6800 327.6700
 /begin AXIS_DESCR STD_AXIS Eng_nAvrg EngN 16 0.00 6000.000 FORMAT "%8.3" EXTENDED_LIMITS -32768.00 32767.00 DEPOSIT ABSOLUTE /end AXIS_DESCR
 /begin AXIS_DESCR STD_AXIS CoEng_trqInrSet Trq 16 -500.0000 1000.000 FORMAT "%8.3" EXTENDED_LIMITS -3276.800 3276.700 DEPOSIT ABSOLUTE /end AXIS_DESCR
/end CHARACTERISTIC
/begin CHARACTERISTIC FMTC_trq2qBas_MAP "#SSD Grundkennfeld für Moment/Menge Umrechnung als Funktion des Arbeitspunktes" MAP 0xD4306 Kf_Xs16_Ys16_Ws16 327.6700 InjMassCyc 0.00 327.6700 FORMAT "%8.4" EXTENDED_LIMITS -327.6800 327.6700
 /begin AXIS_DESCR STD_AXIS Eng_nAvrg EngN 24 0.00 6000.000 FORMAT "%8.3" EXTENDED_LIMITS -32768.00 32767.00 DEPOSIT ABSOLUTE /end AXIS_DESCR
 /begin AXIS_DESCR STD_AXIS CoEng_trqInrSet Trq 24 -500.0000 1000.000 FORMAT "%8.3" EXTENDED_LIMITS -3276.800 3276.700 DEPOSIT ABSOLUTE /end AXIS_DESCR
/end CHARACTERISTIC
/begin CHARACTERISTIC FMTC_trq2qRgn1_MAP "#SSD Grundkennfeld für Moment-/Mengenumrechnung unter Regenerationsanforderung 1 der Abgasnachbehandlung" MAP 0xD47EA Kf_Xs16_Ys16_Ws16 327.6700 InjMassCyc 0.00 327.6700 FORMAT "%8.4" EXTENDED_LIMITS -327.6800 327.6700
 /begin AXIS_DESCR STD_AXIS Eng_nAvrg EngN 16 0.00 6000.000 FORMAT "%8.3" EXTENDED_LIMITS -32768.00 32767.00 DEPOSIT ABSOLUTE /end AXIS_DESCR
 /begin AXIS_DESCR STD_AXIS CoEng_trqInrSet Trq 16 -500.0000 1000.000 FORMAT "%8.3" EXTENDED_LIMITS -3276.800 3276.700 DEPOSIT ABSOLUTE /end AXIS_DESCR
/end CHARACTERISTIC
/begin CHARACTERISTIC FMTC_trq2qRgn2_MAP "#SSD Grundkennfeld für Moment-/Mengenumrechnung unter Regenerationsanforderung 2 der Abgasnachbehandlung" MAP 0xD4A2E Kf_Xs16_Ys16_Ws16 327.6700 InjMassCyc 0.00 327.6700 FORMAT "%8.4" EXTENDED_LIMITS -327.6800 327.6700
 /begin AXIS_DESCR STD_AXIS Eng_nAvrg EngN 16 0.00 6000.000 FORMAT "%8.3" EXTENDED_LIMITS -32768.00 32767.00 DEPOSIT ABSOLUTE /end AXIS_DESCR
 /begin AXIS_DESCR STD_AXIS CoEng_trqInrSet Trq 16 -500.0000 1000.000 FORMAT "%8.3" EXTENDED_LIMITS -3276.800 3276.700 DEPOSIT ABSOLUTE /end AXIS_DESCR
/end CHARACTERISTIC
/begin CHARACTERISTIC FrmMng_ACCSelfRec_C "Switch to disable/enable ACC self recognition" VALUE 0xD528C Kw_Wu8 1.000 OneToOne 0.00 1.000 FORMAT "%5.3" EXTENDED_LIMITS 0.00 255.0 /end CHARACTERISTIC
/begin CHARACTERISTIC FrmMng_ACSelfRec_C "" VALUE 0xD528D Kw_Wu8 1.000 OneToOne 0.00 1.000 FORMAT "%5.3" EXTENDED_LIMITS 0.00 255.0 /end CHARACTERISTIC
/begin CHARACTERISTIC FrmMng_aDirectDef_C "" VALUE 0xD528E Kw_Ws16 65.53500 Acc -32.76800 32.76700 FORMAT "%8.5" /end CHARACTERISTIC
/begin CHARACTERISTIC FrmMng_AFSSelfRec_C "Switch for enabling self recognition of AFS" VALUE 0xD5290 Kw_Wu8 1.000 OneToOne 0.00 1.000 FORMAT "%5.3" EXTENDED_LIMITS 0.00 255.0 /end CHARACTERISTIC
/begin CHARACTERISTIC FrmMng_ARSSelfRec_C "Switch to disable ARS recognition" VALUE 0xD5291 Kw_Wu8 1.000 OneToOne 0.00 1.000 FORMAT "%5.3" EXTENDED_LIMITS 0.00 255.0 /end CHARACTERISTIC
/begin CHARACTERISTIC FrmMng_aSideDef_C "#SSD Defektwert für FrmMng_aSideDef_C Botschaft" VALUE 0xD5292 Kw_Ws16 65.53500 Acc -32.76800 32.76700 FORMAT "%8.5" /end CHARACTERISTIC
/begin CHARACTERISTIC FrmMng_cnvAccmLimTrq_Offset_C "#SSD HEATING_CURRENT" VALUE 0xD5294 Kw_Ws16 6553.500 Trq -3276.800 3276.700 FORMAT "%8.3" /end CHARACTERISTIC
/begin CHARACTERISTIC FrmMng_cnvAccmLimTrq_Slope_C "#SSD HEATING_CURRENT" VALUE 0xD5296 Kw_Ws16 65.53500 SlopeRes1000 -32.76800 32.76700 FORMAT "%8.5" /end CHARACTERISTIC
/begin CHARACTERISTIC FrmMng_cnvACCtrq_Offset_C "#SSD DREHMOMENT_ANF_ACC   Signal: TORQ_TAR_ACC" VALUE 0xD5298 Kw_Ws16 6553.500 Trq -3276.800 3276.700 FORMAT "%8.3" /end CHARACTERISTIC
/begin CHARACTERISTIC FrmMng_cnvACCtrq_Slope_C "#SSD DREHMOMENT_ANF_ACC   Signal: TORQ_TAR_ACC" VALUE 0xD529A Kw_Ws16 65.53500 SlopeRes1000 -32.76800 32.76700 FORMAT "%8.5" /end CHARACTERISTIC
/begin CHARACTERISTIC FrmMng_cnvAVA_DSC_Offset_C "#SSD Offset for conversion of ACLN_VEH_ACRO_DSC" VALUE 0xD529C Kw_Ws16 65.53500 Acc -32.76800 32.76700 FORMAT "%8.5" /end CHARACTERISTIC
/begin CHARACTERISTIC FrmMng_cnvAVA_DSC_Slope_C "#SSD slope for conversion of ACLN_VEH_ACRO_DSC" VALUE 0xD529E Kw_Ws16 65.53500 SlopeRes1000 -32.76800 32.76700 FORMAT "%8.5" /end CHARACTERISTIC
/begin CHARACTERISTIC FrmMng_cnvLN_DSC_Offset_C "" VALUE 0xD52A0 Kw_Ws16 65.53500 Acc -32.76800 32.76700 FORMAT "%8.5" /end CHARACTERISTIC
/begin CHARACTERISTIC FrmMng_cnvLN_DSC_Slope_C "" VALUE 0xD52A2 Kw_Ws16 65.53500 SlopeRes1000 -32.76800 32.76700 FORMAT "%8.5" /end CHARACTERISTIC
/begin CHARACTERISTIC FrmMng_cnvAFStrq_Offset_C "#SSD Offset for calculation of ST_TORQ_AVL & TORQ_TAR_AFS" VALUE 0xD52A4 Kw_Ws16 6553.500 Trq -3276.800 3276.700 FORMAT "%8.3" /end CHARACTERISTIC
/begin CHARACTERISTIC FrmMng_cnvAFStrq_Slope_C "#SSD Slope for calculation of ST_TORQ_AVL & TORQ_TAR_AFS" VALUE 0xD52A6 Kw_Ws16 65.53500 SlopeRes1000 -32.76800 32.76700 FORMAT "%8.5" /end CHARACTERISTIC
/begin CHARACTERISTIC FrmMng_cnvAipEng_Offset_C "#SSD Offset fuer Umwandlung von AIP_ENG" VALUE 0xD52A8 Kw_Ws16 65535.00 Pres_hPa -32768.00 32767.00 FORMAT "%8.2" /end CHARACTERISTIC
/begin CHARACTERISTIC FrmMng_cnvAipEng_Slope_C "#SSD Steigung fuer Umwandlung von AIP_ENG" VALUE 0xD52AA Kw_Ws16 65.53500 SlopeRes1000 -32.76800 32.76700 FORMAT "%8.5" /end CHARACTERISTIC
/begin CHARACTERISTIC FrmMng_cnvAngAcpd_Offset_C "#SSD Offset fuer Umwandlung von ANG_ACPD" VALUE 0xD52AC Kw_Ws16 799.9878 Prc -400.0000 399.9878 FORMAT "%8.4" /end CHARACTERISTIC
/begin CHARACTERISTIC FrmMng_cnvAngAcpd_Slope_C "#SSD Steigung fuer Umwandlung von ANG_ACPD" VALUE 0xD52AE Kw_Ws16 65.53500 SlopeRes1000 -32.76800 32.76700 FORMAT "%8.5" /end CHARACTERISTIC
/begin CHARACTERISTIC FrmMng_cnvAPP_Offset_C "Offset fuer ANG_ACPD_REAL und ANG_ACPD_TAR signale" VALUE 0xD52B0 Kw_Ws16 799.9878 Prc -400.0000 399.9878 FORMAT "%8.4" /end CHARACTERISTIC
/begin CHARACTERISTIC FrmMng_cnvAPP_Slope_C "Slope fuer ANG_ACPD_REAL und ANG_ACPD_TAR signale" VALUE 0xD52B2 Kw_Ws16 65.53500 SlopeRes1000 -32.76800 32.76700 FORMAT "%8.5" /end CHARACTERISTIC
/begin CHARACTERISTIC FrmMng_cnvARStrq_Offset_C "#SSD offset for conversion of ARS-torque" VALUE 0xD52B4 Kw_Ws16 13107.00 TrqPrp -6553.600 6553.400 FORMAT "%8.3" /end CHARACTERISTIC
/begin CHARACTERISTIC FrmMng_cnvARStrq_Slope_C "#SSD slope for conversion of ARS-torque" VALUE 0xD52B6 Kw_Ws16 65.53500 SlopeRes1000 -32.76800 32.76700 FORMAT "%8.5" /end CHARACTERISTIC
/begin CHARACTERISTIC FrmMng_cnvDCCtrq_Offset_C "Offset für Umrechnung von WMOM_PT_TAR in FrmMng_trqDCC_TrqDes" VALUE 0xD52B8 Kw_Ws16 65535.00 TrqPrpHigh -32768.00 32767.00 FORMAT "%8.2" /end CHARACTERISTIC
/begin CHARACTERISTIC FrmMng_cnvDCCtrq_Slope_C "Stiegung für Umrechnung von WMOM_PT_TAR in FrmMng_trqDCC_TrqDes" VALUE 0xD52BA Kw_Ws16 65.53500 SlopeRes1000 -32.76800 32.76700 FORMAT "%8.5" /end CHARACTERISTIC
/begin CHARACTERISTIC FrmMng_cnvdLRADWINKStrg_Offset_C "Offset for calculation dphiStrg from CAN" VALUE 0xD52BC Kw_Ws16 2880.263 AngleGradPerSec -1440.154 1440.110 FORMAT "%8.3" /end CHARACTERISTIC
/begin CHARACTERISTIC FrmMng_cnvdLRADWINKStrg_Slope_C "Slope for calculation  dphiStrg from CAN" VALUE 0xD52BE Kw_Ws16 65.53500 SlopeRes1000 -32.76800 32.76700 FORMAT "%8.5" /end CHARACTERISTIC
/begin CHARACTERISTIC FrmMng_cnvDSCtrq_Offset_C "#SSD offset for conversion of DSC-torque" VALUE 0xD52C0 Kw_Ws16 6553.500 Trq -3276.800 3276.700 FORMAT "%8.3" /end CHARACTERISTIC
/begin CHARACTERISTIC FrmMng_cnvDSCtrq_Slope_C "#SSD slope for conversion of DSC-torque" VALUE 0xD52C2 Kw_Ws16 65.53500 SlopeRes1000 -32.76800 32.76700 FORMAT "%8.5" /end CHARACTERISTIC
/begin CHARACTERISTIC FrmMng_cnvIjvFu_Offset_C "#SSD Offset fuer Umwandlung von IJV_FU" VALUE 0xD52C4 Kw_Ws16 65535.00 FlConsum_ul -32768.00 32767.00 FORMAT "%8.2" /end CHARACTERISTIC
/begin CHARACTERISTIC FrmMng_cnvIjvFu_Slope_C "#SSD Steigung fuer Umwandlung von IJV_FU" VALUE 0xD52C6 Kw_Ws16 65.53500 SlopeRes1000 -32.76800 32.76700 FORMAT "%8.5" /end CHARACTERISTIC
/begin CHARACTERISTIC FrmMng_cnvKOMBIv_Offset_C "#SSD Conversion V_VEH_SPDM -> FrmMng_vDisp" VALUE 0xD52C8 Kw_Ws16 655.3500 Vel -327.6800 327.6700 FORMAT "%8.4" /end CHARACTERISTIC
/begin CHARACTERISTIC FrmMng_cnvKOMBIv_Slope_C "#SSD Conversion V_VEH_SPDM -> FrmMng_vDisp" VALUE 0xD52CA Kw_Ws16 65.53500 SlopeRes1000 -32.76800 32.76700 FORMAT "%8.5" /end CHARACTERISTIC
/begin CHARACTERISTIC FrmMng_cnvLimRpmEng_Offset_C "Offset for conversion of LIM_RPM_ENG" VALUE 0xD52CC Kw_Ws16 65535.00 EngN -32768.00 32767.00 FORMAT "%8.2" /end CHARACTERISTIC
/begin CHARACTERISTIC FrmMng_cnvLimRpmEng_Slope_C "Slope for the conversion of LIM_RPM_ENG" VALUE 0xD52CE Kw_Ws16 65.53500 SlopeRes1000 -32.76800 32.76700 FORMAT "%8.5" /end CHARACTERISTIC
/begin CHARACTERISTIC FrmMng_cnvLRADWINKStrg_Offset_C "Offset for calculation of LRADWINK signal" VALUE 0xD52D0 Kw_Ws16 2880.263 AngleGrad -1440.154 1440.110 FORMAT "%8.3" /end CHARACTERISTIC
/begin CHARACTERISTIC FrmMng_cnvLRADWINKStrg_Slope_C "Slope for calculation of LRADWINK signal" VALUE 0xD52D2 Kw_Ws16 65.53500 SlopeRes1000 -32.76800 32.76700 FORMAT "%8.5" /end CHARACTERISTIC
/begin CHARACTERISTIC FrmMng_cnvnEngRpm_Offset_C "Offset for the calculation of RPM_TEMP_DOM_1 and RPM_TEMP_DOM_2" VALUE 0xD52D4 Kw_Ws16 65535.00 EngN -32768.00 32767.00 FORMAT "%8.2" /end CHARACTERISTIC
/begin CHARACTERISTIC FrmMng_cnvnEngRpm_Slope_C "Slope for the calculation of RPM_TEMP_DOM_1 &  RPM_TEMP_DOM_2 signals" VALUE 0xD52D6 Kw_Ws16 655.3500 SlopeRes100 -327.6800 327.6700 FORMAT "%8.4" /end CHARACTERISTIC
/begin CHARACTERISTIC FrmMng_cnvnSetpoint_Offset_C "Offset Wert für Byte 7 der ENGINE1 CAN Botschaft" VALUE 0xD52D8 Kw_Ws16 65535.00 EngN -32768.00 32767.00 FORMAT "%8.2" /end CHARACTERISTIC
/begin CHARACTERISTIC FrmMng_cnvnSetpoint_Slope_C "Steigungs Wert für Byte 7 der ENGINE1 CAN Botschaft" VALUE 0xD52DA Kw_Ws16 65.53500 SlopeRes1000 -32.76800 32.76700 FORMAT "%8.5" /end CHARACTERISTIC
/begin CHARACTERISTIC FrmMng_cnvpBrkSys_Offset_C "Offset für Umrechnung von BRP in FrmMng_pBrkSys" VALUE 0xD52DC Kw_Ws16 65535.00 Pres_bar -32768.00 32767.00 FORMAT "%8.2" /end CHARACTERISTIC
/begin CHARACTERISTIC FrmMng_cnvpBrkSys_Slope_C "Steigung für Umrechnung von BRP in FrmMng_pBrkSys" VALUE 0xD52DE Kw_Ws16 65.53500 SlopeRes1000 -32.76800 32.76700 FORMAT "%8.5" /end CHARACTERISTIC
/begin CHARACTERISTIC FrmMng_cnvrHtFlow_Offset_C "Conversion HTFL_RQ_AIC -> FrmMng_rHtFlowReq" VALUE 0xD52E0 Kw_Ws16 799.9878 Prc -400.0000 399.9878 FORMAT "%8.4" /end CHARACTERISTIC
/begin CHARACTERISTIC FrmMng_cnvrHtFlow_Slope_C "Conversion HTFL_RQ_AIC -> FrmMng_rHtFlowReq" VALUE 0xD52E2 Kw_Ws16 655.3500 SlopeRes100 -327.6800 327.6700 FORMAT "%8.4" /end CHARACTERISTIC
/begin CHARACTERISTIC FrmMng_cnvRpmEng_Offset_C "#SSD Offset fuer Umwandlung von RPM_ENG" VALUE 0xD52E4 Kw_Ws16 65535.00 EngN -32768.00 32767.00 FORMAT "%8.2" /end CHARACTERISTIC
/begin CHARACTERISTIC FrmMng_cnvRpmEng_Slope_C "#SSD Steigung fuer Umwandlung von RPM_ENG" VALUE 0xD52E6 Kw_Ws16 65.53500 SlopeRes1000 -32.76800 32.76700 FORMAT "%8.5" /end CHARACTERISTIC
/begin CHARACTERISTIC FrmMng_cnvRPM_GRB_TURB_Offset_C "" VALUE 0xD52E8 Kw_Ws16 65535.00 EngN -32768.00 32767.00 FORMAT "%8.2" /end CHARACTERISTIC
/begin CHARACTERISTIC FrmMng_cnvRPM_GRB_TURB_Slope_C "" VALUE 0xD52EA Kw_Ws16 65.53500 SlopeRes1000 -32.76800 32.76700 FORMAT "%8.5" /end CHARACTERISTIC
/begin CHARACTERISTIC FrmMng_cnvRqamFu_Offset_C "#SSD required-amount fuel Offset" VALUE 0xD52EC Kw_Ws16 655.3500 FlConsum_l_h -327.6800 327.6700 FORMAT "%8.4" /end CHARACTERISTIC
/begin CHARACTERISTIC FrmMng_cnvRqamFu_Slope_C "#SSD required-amount fuel Slope" VALUE 0xD52EE Kw_Ws16 655.3500 SlopeRes100 -327.6800 327.6700 FORMAT "%8.4" /end CHARACTERISTIC
/begin CHARACTERISTIC FrmMng_cnvrTransDT_Offset_C "Offset für Umrechnung von Getriebsstrang Verstärkung (GRDT_REIN) in FrmMng_rTransDT" VALUE 0xD52F0 Kw_Ws16 655.3500 TransR -327.6800 327.6700 FORMAT "%8.4" /end CHARACTERISTIC
/begin CHARACTERISTIC FrmMng_cnvrTransDT_Slope_C "Stiegung für Umrechnung von Getriebsstrang Verstärkung (GRDT_REIN) in FrmMng_rTransDT" VALUE 0xD52F2 Kw_Ws16 65.53500 SlopeRes1000 -32.76800 32.76700 FORMAT "%8.5" /end CHARACTERISTIC
/begin CHARACTERISTIC FrmMng_cnvrWaterVlv_Offset_C "Offset value for CTR_APE_WV" VALUE 0xD52F4 Kw_Ws16 799.9878 Prc -400.0000 399.9878 FORMAT "%8.4" /end CHARACTERISTIC
/begin CHARACTERISTIC FrmMng_cnvrWaterVlv_Slope_C "Slope value for CTR_APE_WV" VALUE 0xD52F6 Kw_Ws16 6553.500 SlopeRes10 -3276.800 3276.700 FORMAT "%8.3" /end CHARACTERISTIC
/begin CHARACTERISTIC FrmMng_cnvTempEng_Offset_C "#SSD Offset fuer Umwandlung von TEMP_ENG" VALUE 0xD52F8 Kw_Ws16 950.000 Temp_Cels -50.140 899.860 FORMAT "%8.3" EXTENDED_LIMITS -3549.940 3003.560 /end CHARACTERISTIC
/begin CHARACTERISTIC FrmMng_cnvTempEng_Slope_C "#SSD Steigung fuer Umwandlung von TEMP_ENG" VALUE 0xD52FA Kw_Ws16 65.53500 SlopeRes1000 -32.76800 32.76700 FORMAT "%8.5" /end CHARACTERISTIC
/begin CHARACTERISTIC FrmMng_cnvtOil_Offset_C "#SSD Conversion TEMP_GRB -> FrmMng_tOil" VALUE 0xD52FC Kw_Ws16 950.000 Temp_Cels -50.140 899.860 FORMAT "%8.3" EXTENDED_LIMITS -3549.940 3003.560 /end CHARACTERISTIC
/begin CHARACTERISTIC FrmMng_cnvtOil_Slope_C "#SSD Conversion TEMP_GRB -> FrmMng_tOil" VALUE 0xD52FE Kw_Ws16 65.53500 SlopeRes1000 -32.76800 32.76700 FORMAT "%8.5" /end CHARACTERISTIC
/begin CHARACTERISTIC FrmMng_cnvTrqAvl_Offset_C "#SSD Offset fuer Umwandlung von TORQ_AVL" VALUE 0xD5300 Kw_Ws16 6553.500 Trq -3276.800 3276.700 FORMAT "%8.3" /end CHARACTERISTIC
/begin CHARACTERISTIC FrmMng_cnvTrqAvl_Slope_C "#SSD Steigung fuer Umwandlung von TORQ_AVL" VALUE 0xD5302 Kw_Ws16 65.53500 SlopeRes1000 -32.76800 32.76700 FORMAT "%8.5" /end CHARACTERISTIC
/begin CHARACTERISTIC FrmMng_cnvTrqDvch_Offset_C "#SSD Offset fuer Umwandlung von TORQ_DVCH" VALUE 0xD5304 Kw_Ws16 6553.500 Trq -3276.800 3276.700 FORMAT "%8.3" /end CHARACTERISTIC
/begin CHARACTERISTIC FrmMng_cnvTrqDvch_Slope_C "#SSD Steigung fuer Umwandlung von TORQ_DVCH" VALUE 0xD5306 Kw_Ws16 65.53500 SlopeRes1000 -32.76800 32.76700 FORMAT "%8.5" /end CHARACTERISTIC
/begin CHARACTERISTIC FrmMng_cnvtrqWheel_Offset_C "Offset Umrechnung TORQ_AVL" VALUE 0xD5308 Kw_Ws16 65535.00 TrqPrpHigh -32768.00 32767.00 FORMAT "%8.2" /end CHARACTERISTIC
/begin CHARACTERISTIC FrmMng_cnvtrqWheel_Slope_C "Slope fuer WMOM_PT_AVL ,WMOM_PT_MIN_LOW und WMOM_PT_MAX signale" VALUE 0xD530A Kw_Ws16 65.53500 SlopeRes1000 -32.76800 32.76700 FORMAT "%8.5" /end CHARACTERISTIC
/begin CHARACTERISTIC FrmMng_cnvtrq_Offset_C "#SSD offset for message FrmMng_trqGearbxFrc" VALUE 0xD530C Kw_Ws16 6553.500 Trq -3276.800 3276.700 FORMAT "%8.3" /end CHARACTERISTIC
/begin CHARACTERISTIC FrmMng_cnvtrq_Slope_C "#SSD Slope for the message FrmMng_trqGearbxFrc" VALUE 0xD530E Kw_Ws16 65.53500 SlopeRes1000 -32.76800 32.76700 FORMAT "%8.5" /end CHARACTERISTIC
/begin CHARACTERISTIC FrmMng_cnvvMrk_Offset_C "#SSD SPEED_CLCTR" VALUE 0xD5310 Kw_Ws16 655.3500 Vel -327.6800 327.6700 FORMAT "%8.4" /end CHARACTERISTIC
/begin CHARACTERISTIC FrmMng_cnvvMrk_Slope_C "#SSD SPEED_CLCTR" VALUE 0xD5312 Kw_Ws16 65.53500 SlopeRes1000 -32.76800 32.76700 FORMAT "%8.5" /end CHARACTERISTIC
/begin CHARACTERISTIC FrmMng_cnvV_VEH_Offset_C "#SSD Offset für Fahrgeschwindigkeitsumrechnung" VALUE 0xD5314 Kw_Ws16 655.3500 Vel -327.6800 327.6700 FORMAT "%8.4" /end CHARACTERISTIC
/begin CHARACTERISTIC FrmMng_cnvV_VEH_Slope_C "#SSD Steigung für Geschwindigkeitsumrechnung" VALUE 0xD5316 Kw_Ws16 65.53500 SlopeRes1000 -32.76800 32.76700 FORMAT "%8.5" /end CHARACTERISTIC
/begin CHARACTERISTIC FrmMng_cnv_BattCls_Offset_C "#SSD Offsetwert für FrmMng_nBattCls" VALUE 0xD5318 Kw_Ws16 65535.00 DEZ -32768.00 32767.00 FORMAT "%8.2" /end CHARACTERISTIC
/begin CHARACTERISTIC FrmMng_cnv_BattCls_Slope_C "#SSD Steigungswert für FrmMng_nBattCls" VALUE 0xD531A Kw_Ws16 65.53500 SlopeRes1000 -32.76800 32.76700 FORMAT "%8.5" /end CHARACTERISTIC
/begin CHARACTERISTIC FrmMng_cnv_HiLimCurr_Offset_C "#SSD Offsetwert für FrmMng_iHiLimCurr" VALUE 0xD531C Kw_Ws16 655350. i_ub_q10p0 -327680. 327670. FORMAT "%5.0" /end CHARACTERISTIC
/begin CHARACTERISTIC FrmMng_cnv_HiLimCurr_Slope_C "#SSD Steigungswert für FrmMng_iHiLimCurr" VALUE 0xD531E Kw_Ws16 65.53500 SlopeRes1000 -32.76800 32.76700 FORMAT "%8.5" /end CHARACTERISTIC
/begin CHARACTERISTIC FrmMng_cnv_LoLimCurr_Offset_C "#SSD Offsetwert für FrmMng_iLoLimCurr" VALUE 0xD5320 Kw_Ws16 655350. i_ub_q10p0 -327680. 327670. FORMAT "%5.0" /end CHARACTERISTIC
/begin CHARACTERISTIC FrmMng_cnv_LoLimCurr_Slope_C "#SSD Steigungswert für FrmMng_iLoLimCurr" VALUE 0xD5322 Kw_Ws16 65.53500 SlopeRes1000 -32.76800 32.76700 FORMAT "%8.5" /end CHARACTERISTIC
/begin CHARACTERISTIC FrmMng_cnv_ZrCurrLim_Offset_C "#SSD Offsetwert für FrmMng_iZrCurrLim" VALUE 0xD5324 Kw_Ws16 65.53 i_ub_q0p001 -32.77 32.77 FORMAT "%5.2" /end CHARACTERISTIC
/begin CHARACTERISTIC FrmMng_cnv_ZrCurrLim_Slope_C "#SSD Steigungswert für FrmMng_iZrCurrLim" VALUE 0xD5326 Kw_Ws16 65.53500 SlopeRes1000 -32.76800 32.76700 FORMAT "%8.5" /end CHARACTERISTIC
/begin CHARACTERISTIC FrmMng_ctDebAlvDMANFAFSDef_C "#SSD Defect time for DREHMOMENT_ANF_AFS  message alive counter error" VALUE 0xD5328 Kw_Wu16 65535.00 OneToOne 0.00 65535.00 FORMAT "%8.2" /end CHARACTERISTIC
/begin CHARACTERISTIC FrmMng_ctDebAlvDMANFAFSOk_C "Healing time for DREHMOMENT_ANF_AFS  message alive counter error" VALUE 0xD532A Kw_Wu16 65535.00 OneToOne 0.00 65535.00 FORMAT "%8.2" /end CHARACTERISTIC
/begin CHARACTERISTIC FrmMng_ctDebAlvDRMANFSSGDef_C "measuring point for evluating ST_SW_WAUP signal" VALUE 0xD532C Kw_Wu16 65535.00 OneToOne 0.00 65535.00 FORMAT "%8.2" /end CHARACTERISTIC
/begin CHARACTERISTIC FrmMng_ctDebAlvDRMANFSSGOk_C "Healing time" VALUE 0xD532E Kw_Wu16 65535.00 OneToOne 0.00 65535.00 FORMAT "%8.2" /end CHARACTERISTIC
/begin CHARACTERISTIC FrmMng_ctDebCsDMANFAFSDef_C "#SSD Defect time for DREHMOMENT_ANF_AFS message check sum error" VALUE 0xD5330 Kw_Wu16 65535.00 OneToOne 0.00 65535.00 FORMAT "%8.2" /end CHARACTERISTIC
/begin CHARACTERISTIC FrmMng_ctDebCsDMANFAFSOk_C "Healing time for DREHMOMENT_ANF_AFS message check sum error" VALUE 0xD5332 Kw_Wu16 65535.00 OneToOne 0.00 65535.00 FORMAT "%8.2" /end CHARACTERISTIC
/begin CHARACTERISTIC FrmMng_ctDebCsDRMANFSSGDef_C " Defect time" VALUE 0xD5334 Kw_Wu16 65535.00 OneToOne 0.00 65535.00 FORMAT "%8.2" /end CHARACTERISTIC
/begin CHARACTERISTIC FrmMng_ctDebCsDRMANFSSGOk_C "Healing time" VALUE 0xD5336 Kw_Wu16 65535.00 OneToOne 0.00 65535.00 FORMAT "%8.2" /end CHARACTERISTIC
/begin CHARACTERISTIC FrmMng_ctDebSigDMANFAFSDef_C "#SSD Defect time for DREHMOMENT_ANF_AFS message signal error" VALUE 0xD5338 Kw_Wu16 65535.00 OneToOne 0.00 65535.00 FORMAT "%8.2" /end CHARACTERISTIC
/begin CHARACTERISTIC FrmMng_ctDebSigDMANFAFSOk_C "Healing time for DREHMOMENT_ANF_AFS message signal error" VALUE 0xD533A Kw_Wu16 65535.00 OneToOne 0.00 65535.00 FORMAT "%8.2" /end CHARACTERISTIC
/begin CHARACTERISTIC FrmMng_ctDebSigDRMANFSSGDef_C "Defect time for DREHMOMENT_ANF_SSG message signal error" VALUE 0xD533C Kw_Wu16 65535.00 OneToOne 0.00 65535.00 FORMAT "%8.2" /end CHARACTERISTIC
/begin CHARACTERISTIC FrmMng_ctDebSigDRMANFSSGOk_C "Healing time for DREHMOMENT_ANF_SSG messages signal error" VALUE 0xD533E Kw_Wu16 65535.00 OneToOne 0.00 65535.00 FORMAT "%8.2" /end CHARACTERISTIC
/begin CHARACTERISTIC FrmMng_ctDebSigLRADWINKDef_C "Defect time for LENKRADWINKEL messages signal error" VALUE 0xD5340 Kw_Wu16 65535.00 OneToOne 0.00 65535.00 FORMAT "%8.2" /end CHARACTERISTIC
/begin CHARACTERISTIC FrmMng_ctDebSigLRADWINKOk_C "Healing time for LENKRADWINKEL messages signal error" VALUE 0xD5342 Kw_Wu16 65535.00 OneToOne 0.00 65535.00 FORMAT "%8.2" /end CHARACTERISTIC
/begin CHARACTERISTIC FrmMng_ctDebSigstCurrDef_C "Defektentprellung für Signal Fehler von CODIERUNG_PM Botschaft" VALUE 0xD5344 Kw_Wu16 65535.00 OneToOne 0.00 65535.00 FORMAT "%8.2" /end CHARACTERISTIC
/begin CHARACTERISTIC FrmMng_ctDebSigstCurrOk_C "Heilentprellung für Signal Fehler von CODIERUNG_PM Botschaft" VALUE 0xD5346 Kw_Wu16 65535.00 OneToOne 0.00 65535.00 FORMAT "%8.2" /end CHARACTERISTIC
/begin CHARACTERISTIC FrmMng_ctDebSigswtPSPOffDef_C "Defektentprellung für Signal Fehler von  CTR_CRASH_SWO_EKP Botschaft" VALUE 0xD5348 Kw_Wu16 65535.00 OneToOne 0.00 65535.00 FORMAT "%8.2" /end CHARACTERISTIC
/begin CHARACTERISTIC FrmMng_ctDebSigswtPSPOffOk_C "Heilentprellung für Signal Fehler von  CTR_CRASH_SWO_EKP Botschaft" VALUE 0xD534A Kw_Wu16 65535.00 OneToOne 0.00 65535.00 FORMAT "%8.2" /end CHARACTERISTIC
/begin CHARACTERISTIC FrmMng_ctDebToDMANFAFSDef_C "#SSD Defect time for DREHMOMENT_ANF_AFS messages Timeout" VALUE 0xD534C Kw_Wu16 65535.00 OneToOne 0.00 65535.00 FORMAT "%8.2" /end CHARACTERISTIC
/begin CHARACTERISTIC FrmMng_ctDebToDMANFAFSOk_C "Healing time for DREHMOMENT_ANF_AFS messages Timeout" VALUE 0xD534E Kw_Wu16 65535.00 OneToOne 0.00 65535.00 FORMAT "%8.2" /end CHARACTERISTIC
/begin CHARACTERISTIC FrmMng_ctDebToDRMANFSSGDef_C "Defect time for DREHMOMENT_ANF_SSG messages Timeout" VALUE 0xD5350 Kw_Wu16 65535.00 OneToOne 0.00 65535.00 FORMAT "%8.2" /end CHARACTERISTIC
/begin CHARACTERISTIC FrmMng_ctDebToDRMANFSSGOk_C "Healing time for DREHMOMENT_ANF_SSG messages Timeout" VALUE 0xD5352 Kw_Wu16 65535.00 OneToOne 0.00 65535.00 FORMAT "%8.2" /end CHARACTERISTIC
/begin CHARACTERISTIC FrmMng_ctDebToLRADWINKDef_C "Defect time for LENKRADWINKEL messages time out error" VALUE 0xD5354 Kw_Wu16 65535.00 OneToOne 0.00 65535.00 FORMAT "%8.2" /end CHARACTERISTIC
/begin CHARACTERISTIC FrmMng_ctDebToLRADWINKOk_C "Healing  time for LENKRADWINKEL messages time out error" VALUE 0xD5356 Kw_Wu16 65535.00 OneToOne 0.00 65535.00 FORMAT "%8.2" /end CHARACTERISTIC
/begin CHARACTERISTIC FrmMng_ctDebTostCurrDef_C "Defektentprellung für Timeout-Fehler von  CODIERUNG_PM Botschaft" VALUE 0xD5358 Kw_Wu16 65535.00 OneToOne 0.00 65535.00 FORMAT "%8.2" /end CHARACTERISTIC
/begin CHARACTERISTIC FrmMng_ctDebTostCurrOk_C "Heilentprellung für Timeout-Fehler von  CODIERUNG_PM Botschaft" VALUE 0xD535A Kw_Wu16 65535.00 OneToOne 0.00 65535.00 FORMAT "%8.2" /end CHARACTERISTIC
/begin CHARACTERISTIC FrmMng_ctDebToswtPSPOffDef_C "Defect time for ASC2-messages Timeout" VALUE 0xD535C Kw_Wu16 65535.00 OneToOne 0.00 65535.00 FORMAT "%8.2" /end CHARACTERISTIC
/begin CHARACTERISTIC FrmMng_ctDebToswtPSPOffOk_C "Heilentprellung für Timeout-Fehler von  CTR_CRASH_SWO_EKP Botschaft" VALUE 0xD535E Kw_Wu16 65535.00 OneToOne 0.00 65535.00 FORMAT "%8.2" /end CHARACTERISTIC
/begin CHARACTERISTIC FrmMng_ctrRelDef_C "Defektwert für FrmMng_tRelDef_C Botschaft" VALUE 0xD5360 Kw_Wu32 4294967295.00 OneToOne 0.00 4294967295.00 FORMAT "%13.2" /end CHARACTERISTIC
/begin CHARACTERISTIC FrmMng_cnvCTR_GEN_U_TAR_Offset_C "" VALUE 0xD5364 Kw_Ws16 65535.00 OneToOne -32768.00 32767.00 FORMAT "%8.2" /end CHARACTERISTIC
/begin CHARACTERISTIC FrmMng_cnvCTR_GEN_U_TAR_Slope_C "" VALUE 0xD5366 Kw_Ws16 65.53500 SlopeRes1000 -32.76800 32.76700 FORMAT "%8.5" /end CHARACTERISTIC
/begin CHARACTERISTIC FrmMng_DebACTrqDef_C "#SSD debouncing of ACTrq for defect detection" VALUE 0xD5368 Kw_Wu16 65535.00 OneToOne 0.00 65535.00 FORMAT "%8.2" /end CHARACTERISTIC
/begin CHARACTERISTIC FrmMng_DebACTrqOk_C "debouncing of ACTrq for healing" VALUE 0xD536A Kw_Wu16 65535.00 OneToOne 0.00 65535.00 FORMAT "%8.2" /end CHARACTERISTIC
/begin CHARACTERISTIC FrmMng_DebAlvANFRADMOMPTDef_C "Defektentprellung für RADMOM_PT_1-messages Alive-Zähler" VALUE 0xD536C Kw_Wu16 65535.00 OneToOne 0.00 65535.00 FORMAT "%8.2" /end CHARACTERISTIC
/begin CHARACTERISTIC FrmMng_DebAlvANFRADMOMPTOk_C "Heilentprellung für RADMOM_PT_1-messages Alive-Zähler" VALUE 0xD536E Kw_Wu16 65535.00 OneToOne 0.00 65535.00 FORMAT "%8.2" /end CHARACTERISTIC
/begin CHARACTERISTIC FrmMng_DebAlvDMOMENT_ACCDef_C "#SSD Defect time of DMOMENT_ACC aliv" VALUE 0xD5370 Kw_Wu16 65535.00 OneToOne 0.00 65535.00 FORMAT "%8.2" /end CHARACTERISTIC
/begin CHARACTERISTIC FrmMng_DebAlvDMOMENT_ACCOk_C "Healing time  of  DMOMENT_ACC aliv" VALUE 0xD5372 Kw_Wu16 65535.00 OneToOne 0.00 65535.00 FORMAT "%8.2" /end CHARACTERISTIC
/begin CHARACTERISTIC FrmMng_DebAlvOPCRCTLACCDef_C "#SSD debouncing of alive-ctr.-error OPCRCTLACC (no.of events)" VALUE 0xD5374 Kw_Wu16 65535.00 OneToOne 0.00 65535.00 FORMAT "%8.2" /end CHARACTERISTIC
/begin CHARACTERISTIC FrmMng_DebAlvOPCRCTLACCOk_C "debouncing of alive-ctr.-error OPCRCTLACC (no.of events)" VALUE 0xD5376 Kw_Wu16 65535.00 OneToOne 0.00 65535.00 FORMAT "%8.2" /end CHARACTERISTIC
/begin CHARACTERISTIC FrmMng_DebAlvSTAT_ARSDef_C "#SSD debouncing of alive-ctr.-error STAT_ARS (no.of events)" VALUE 0xD5378 Kw_Wu16 65535.00 OneToOne 0.00 65535.00 FORMAT "%8.2" /end CHARACTERISTIC
/begin CHARACTERISTIC FrmMng_DebAlvSTAT_ARSOk_C "debouncing of alive-ctr.-error STAT_ARS (no.of events)" VALUE 0xD537A Kw_Wu16 65535.00 OneToOne 0.00 65535.00 FORMAT "%8.2" /end CHARACTERISTIC
/begin CHARACTERISTIC FrmMng_DebAlvSTAT_KOMBIDef_C "#SSD debouncing of alive-ctr.-error STAT_KOMBI (no.of events)" VALUE 0xD537C Kw_Wu16 65535.00 OneToOne 0.00 65535.00 FORMAT "%8.2" /end CHARACTERISTIC
/begin CHARACTERISTIC FrmMng_DebAlvSTAT_KOMBIOk_C "debouncing of alive-ctr.-error STAT_KOMBI (no.of events)" VALUE 0xD537E Kw_Wu16 65535.00 OneToOne 0.00 65535.00 FORMAT "%8.2" /end CHARACTERISTIC
/begin CHARACTERISTIC FrmMng_DebAlvTERMINALDef_C "debouncing of alive-ctr.-error TERMINAL (no.of events)" VALUE 0xD5380 Kw_Wu16 65535.00 OneToOne 0.00 65535.00 FORMAT "%8.2" /end CHARACTERISTIC
/begin CHARACTERISTIC FrmMng_DebAlvTERMINALOk_C "debouncing of alive-ctr.-error TERMINAL (no.of events)" VALUE 0xD5382 Kw_Wu16 65535.00 OneToOne 0.00 65535.00 FORMAT "%8.2" /end CHARACTERISTIC
/begin CHARACTERISTIC FrmMng_DebAlvTORQUE_DSCDef_C "#SSD debouncing of alive-ctr.-error TORQUE_DSC (no.of events)" VALUE 0xD5384 Kw_Wu16 65535.00 OneToOne 0.00 65535.00 FORMAT "%8.2" /end CHARACTERISTIC
/begin CHARACTERISTIC FrmMng_DebAlvTORQUE_DSCOk_C "debouncing of alive-ctr.-error TORQUE_DSC (no.of events)" VALUE 0xD5386 Kw_Wu16 65535.00 OneToOne 0.00 65535.00 FORMAT "%8.2" /end CHARACTERISTIC
/begin CHARACTERISTIC FrmMng_DebAlvTORQUE_GEARBXDef_C "#SSD debouncing of alive-ctr.-error TORQUE_GEARBX (no.of events)" VALUE 0xD5388 Kw_Wu16 65535.00 OneToOne 0.00 65535.00 FORMAT "%8.2" /end CHARACTERISTIC
/begin CHARACTERISTIC FrmMng_DebAlvTORQUE_GEARBXOk_C "debouncing of alive-ctr.-error TORQUE_GEARBX (no.of events)" VALUE 0xD538A Kw_Wu16 65535.00 OneToOne 0.00 65535.00 FORMAT "%8.2" /end CHARACTERISTIC
/begin CHARACTERISTIC FrmMng_DebAlvVEH_MODDef_C "Defect time for VEH_MOD signal" VALUE 0xD538C Kw_Wu16 65535.00 OneToOne 0.00 65535.00 FORMAT "%8.2" /end CHARACTERISTIC
/begin CHARACTERISTIC FrmMng_DebAlvVEH_MODOk_C "debounce OK time for alive counter for VEH_MOD signal" VALUE 0xD538E Kw_Wu16 65535.00 OneToOne 0.00 65535.00 FORMAT "%8.2" /end CHARACTERISTIC
/begin CHARACTERISTIC FrmMng_DebCsANFRADMOMPTDef_C "Defektentprellung für RADMOM_PT_1-messages Checksum" VALUE 0xD5390 Kw_Wu16 65535.00 OneToOne 0.00 65535.00 FORMAT "%8.2" /end CHARACTERISTIC
/begin CHARACTERISTIC FrmMng_DebCsANFRADMOMPTOk_C "Heilentprellung für RADMOM_PT_1-messages Checksum" VALUE 0xD5392 Kw_Wu16 65535.00 OneToOne 0.00 65535.00 FORMAT "%8.2" /end CHARACTERISTIC
/begin CHARACTERISTIC FrmMng_DebCsDMOMENT_ACCDef_C "#SSD Defect time of DMOMENT_ACC   check sum" VALUE 0xD5394 Kw_Wu16 65535.00 OneToOne 0.00 65535.00 FORMAT "%8.2" /end CHARACTERISTIC
/begin CHARACTERISTIC FrmMng_DebCsDMOMENT_ACCOk_C "Healing time  of  DMOMENT_ACC check sum" VALUE 0xD5396 Kw_Wu16 65535.00 OneToOne 0.00 65535.00 FORMAT "%8.2" /end CHARACTERISTIC
/begin CHARACTERISTIC FrmMng_DebCsOPCRCTLACCDef_C "#SSD debouncing of checksum-error OPCRCTLACC (no.of events)" VALUE 0xD5398 Kw_Wu16 65535.00 OneToOne 0.00 65535.00 FORMAT "%8.2" /end CHARACTERISTIC
/begin CHARACTERISTIC FrmMng_DebCsOPCRCTLACCOk_C "debouncing of checksum-error OPCRCTLACC (no.of events)" VALUE 0xD539A Kw_Wu16 65535.00 OneToOne 0.00 65535.00 FORMAT "%8.2" /end CHARACTERISTIC
/begin CHARACTERISTIC FrmMng_DebCsTERMINALDef_C "debouncing of checksum-error TERMINAL (no.of events)" VALUE 0xD539C Kw_Wu16 65535.00 OneToOne 0.00 65535.00 FORMAT "%8.2" /end CHARACTERISTIC
/begin CHARACTERISTIC FrmMng_DebCsTERMINALOk_C "debouncing of checksum-error TERMINAL (no.of events)" VALUE 0xD539E Kw_Wu16 65535.00 OneToOne 0.00 65535.00 FORMAT "%8.2" /end CHARACTERISTIC
/begin CHARACTERISTIC FrmMng_DebCsTORQUE_DSCDef_C "#SSD debouncing of checksum-error TORQUE_DSC (no.of events)" VALUE 0xD53A0 Kw_Wu16 65535.00 OneToOne 0.00 65535.00 FORMAT "%8.2" /end CHARACTERISTIC
/begin CHARACTERISTIC FrmMng_DebCsTORQUE_DSCOk_C "debouncing of checksum-error TORQUE_DSC (no.of events)" VALUE 0xD53A2 Kw_Wu16 65535.00 OneToOne 0.00 65535.00 FORMAT "%8.2" /end CHARACTERISTIC
/begin CHARACTERISTIC FrmMng_DebCsTORQUE_GEARBXDef_C "#SSD debouncing of checksum-error TORQUE_GEARBX (no.of events)" VALUE 0xD53A4 Kw_Wu16 65535.00 OneToOne 0.00 65535.00 FORMAT "%8.2" /end CHARACTERISTIC
/begin CHARACTERISTIC FrmMng_DebCsTORQUE_GEARBXOk_C "debouncing of checksum-error TORQUE_GEARBX (no.of events)" VALUE 0xD53A6 Kw_Wu16 65535.00 OneToOne 0.00 65535.00 FORMAT "%8.2" /end CHARACTERISTIC
/begin CHARACTERISTIC FrmMng_DebCsVEH_MODDef_C "defect time for VEH_MOD" VALUE 0xD53A8 Kw_Wu16 65535.00 OneToOne 0.00 65535.00 FORMAT "%8.2" /end CHARACTERISTIC
/begin CHARACTERISTIC FrmMng_DebCsVEH_MODOk_C "Defect debouncing for check sum for VEH_MOD signal" VALUE 0xD53AA Kw_Wu16 65535.00 OneToOne 0.00 65535.00 FORMAT "%8.2" /end CHARACTERISTIC
/begin CHARACTERISTIC FrmMng_DebSigANFRADMOMPTDef_C "Defektentprellung für RADMOM_PT_1-messages Signalfehler" VALUE 0xD53AC Kw_Wu16 65535.00 OneToOne 0.00 65535.00 FORMAT "%8.2" /end CHARACTERISTIC
/begin CHARACTERISTIC FrmMng_DebSigANFRADMOMPTOk_C "Heilentprellung für RADMOM_PT_1-messages Signalfehler" VALUE 0xD53AE Kw_Wu16 65535.00 OneToOne 0.00 65535.00 FORMAT "%8.2" /end CHARACTERISTIC
/begin CHARACTERISTIC FrmMng_DebSigBOS_RESET_2Def_C "" VALUE 0xD53B0 Kw_Wu16 65535.00 OneToOne 0.00 65535.00 FORMAT "%8.2" /end CHARACTERISTIC
/begin CHARACTERISTIC FrmMng_DebSigBOS_RESET_2Ok_C "" VALUE 0xD53B2 Kw_Wu16 65535.00 OneToOne 0.00 65535.00 FORMAT "%8.2" /end CHARACTERISTIC
/begin CHARACTERISTIC FrmMng_DebSigBOS_RESETDef_C "debouncing of signal-error BOS_RESET (no.of events)" VALUE 0xD53B4 Kw_Wu16 65535.00 OneToOne 0.00 65535.00 FORMAT "%8.2" /end CHARACTERISTIC
/begin CHARACTERISTIC FrmMng_DebSigBOS_RESETOk_C "debouncing of signal-error BOS_RESET (no.of events)" VALUE 0xD53B6 Kw_Wu16 65535.00 OneToOne 0.00 65535.00 FORMAT "%8.2" /end CHARACTERISTIC
/begin CHARACTERISTIC FrmMng_DebSigDMOMENT_ACCDef_C "#SSD Defect time of DMOMENT_ACC sig" VALUE 0xD53B8 Kw_Wu16 65535.00 OneToOne 0.00 65535.00 FORMAT "%8.2" /end CHARACTERISTIC
/begin CHARACTERISTIC FrmMng_DebSigDMOMENT_ACCOk_C "Healing time of  DMOMENT_ACC sig" VALUE 0xD53BA Kw_Wu16 65535.00 OneToOne 0.00 65535.00 FORMAT "%8.2" /end CHARACTERISTIC
/begin CHARACTERISTIC FrmMng_DebSigGEARBX_DATA2Def_C "debouncing of signal-error GEARBX_DATA2 (no.of events)" VALUE 0xD53BC Kw_Wu16 65535.00 OneToOne 0.00 65535.00 FORMAT "%8.2" /end CHARACTERISTIC
/begin CHARACTERISTIC FrmMng_DebSigGEARBX_DATA2Ok_C "debouncing of signal-error GEARBX_DATA (no.of events)" VALUE 0xD53BE Kw_Wu16 65535.00 OneToOne 0.00 65535.00 FORMAT "%8.2" /end CHARACTERISTIC
/begin CHARACTERISTIC FrmMng_DebSigGEARBX_DATADef_C "debouncing of signal-error GEARBX_DATA (no.of events)" VALUE 0xD53C0 Kw_Wu16 65535.00 OneToOne 0.00 65535.00 FORMAT "%8.2" /end CHARACTERISTIC
/begin CHARACTERISTIC FrmMng_DebSigGEARBX_DATAOk_C "debouncing of signal-error GEARBX_DATA (no.of events)" VALUE 0xD53C2 Kw_Wu16 65535.00 OneToOne 0.00 65535.00 FORMAT "%8.2" /end CHARACTERISTIC
/begin CHARACTERISTIC FrmMng_DebSigHEAT_ACDef_C "debouncing of signal-error HEAT_AC (no.of events)" VALUE 0xD53C4 Kw_Wu16 65535.00 OneToOne 0.00 65535.00 FORMAT "%8.2" /end CHARACTERISTIC
/begin CHARACTERISTIC FrmMng_DebSigHEAT_ACOk_C "debouncing of signal-error HEAT_AC (no.of events)" VALUE 0xD53C6 Kw_Wu16 65535.00 OneToOne 0.00 65535.00 FORMAT "%8.2" /end CHARACTERISTIC
/begin CHARACTERISTIC FrmMng_DebSigMILEAGE_RANGEDef_C "#SSD debouncing of signal-error MILEAGE_RANGE ( no of events )" VALUE 0xD53C8 Kw_Wu16 65535.00 OneToOne 0.00 65535.00 FORMAT "%8.2" /end CHARACTERISTIC
/begin CHARACTERISTIC FrmMng_DebSigMILEAGE_RANGEOk_C "debounce of signal - error MILEAGE_RANGE( no of events)" VALUE 0xD53CA Kw_Wu16 65535.00 OneToOne 0.00 65535.00 FORMAT "%8.2" /end CHARACTERISTIC
/begin CHARACTERISTIC FrmMng_DebSigOPCRCTLACCDef_C "#SSD debouncing of signal OPCRCTLACC (no.of events)" VALUE 0xD53CC Kw_Wu16 65535.00 OneToOne 0.00 65535.00 FORMAT "%8.2" /end CHARACTERISTIC
/begin CHARACTERISTIC FrmMng_DebSigOPCRCTLACCOk_C "debouncing of signal OPCRCTLACC (no.of events)" VALUE 0xD53CE Kw_Wu16 65535.00 OneToOne 0.00 65535.00 FORMAT "%8.2" /end CHARACTERISTIC
/begin CHARACTERISTIC FrmMng_DebSigParkConsumerDef_C "Defektentprellzeit des Signalfehlers der CAN-Botschaft PWMG_STANDVERBR" VALUE 0xD53D0 Kw_Wu16 65535.00 OneToOne 0.00 65535.00 FORMAT "%8.2" /end CHARACTERISTIC
/begin CHARACTERISTIC FrmMng_DebSigParkConsumerOk_C "Heilungsentprellzeit des Signalfehlers der CAN-Botschaft PWMG_STANDVERBR" VALUE 0xD53D2 Kw_Wu16 65535.00 OneToOne 0.00 65535.00 FORMAT "%8.2" /end CHARACTERISTIC
/begin CHARACTERISTIC FrmMng_DebSigPRGG_CCTRDef_C "Defect time for PRGG_CCTR-signalerror" VALUE 0xD53D4 Kw_Wu16 65535.00 OneToOne 0.00 65535.00 FORMAT "%8.2" /end CHARACTERISTIC
/begin CHARACTERISTIC FrmMng_DebSigPRGG_CCTROk_C "Healing time for PRGG_CCTR-signalerror" VALUE 0xD53D6 Kw_Wu16 65535.00 OneToOne 0.00 65535.00 FORMAT "%8.2" /end CHARACTERISTIC
/begin CHARACTERISTIC FrmMng_DebSigPWRMNG_LOADVDef_C "" VALUE 0xD53D8 Kw_Wu16 65535.00 OneToOne 0.00 65535.00 FORMAT "%8.2" /end CHARACTERISTIC
/begin CHARACTERISTIC FrmMng_DebSigPWRMNG_LOADVOk_C "" VALUE 0xD53DA Kw_Wu16 65535.00 OneToOne 0.00 65535.00 FORMAT "%8.2" /end CHARACTERISTIC
/begin CHARACTERISTIC FrmMng_DebSigRQ_STG_EFANDef_C "Defektentprellung für RQ_STG_EFAN-messages Signalfehler" VALUE 0xD53DC Kw_Wu16 65535.00 OneToOne 0.00 65535.00 FORMAT "%8.2" /end CHARACTERISTIC
/begin CHARACTERISTIC FrmMng_DebSigRQ_STG_EFANOk_C "Heilentprellung für RQ_STG_EFAN messages Signalfehler" VALUE 0xD53DE Kw_Wu16 65535.00 OneToOne 0.00 65535.00 FORMAT "%8.2" /end CHARACTERISTIC
/begin CHARACTERISTIC FrmMng_ctDebSigSITZGURTDef_C "STAT_SITZBELEGUNG_GURT rohes messagebyte 0" VALUE 0xD53E0 Kw_Wu16 65535.00 OneToOne 0.00 65535.00 FORMAT "%8.2" /end CHARACTERISTIC
/begin CHARACTERISTIC FrmMng_ctDebSigSITZGURTOk_C "Heilentprellung für STAT_SITZBELEGUNG_GURT-messages Signalfehler" VALUE 0xD53E2 Kw_Wu16 65535.00 OneToOne 0.00 65535.00 FORMAT "%8.2" /end CHARACTERISTIC
/begin CHARACTERISTIC FrmMng_DebSigSTAT_ANHDef_C "" VALUE 0xD53E4 Kw_Wu16 65535.00 OneToOne 0.00 65535.00 FORMAT "%8.2" /end CHARACTERISTIC
/begin CHARACTERISTIC FrmMng_DebSigSTAT_ANHOk_C "" VALUE 0xD53E6 Kw_Wu16 65535.00 OneToOne 0.00 65535.00 FORMAT "%8.2" /end CHARACTERISTIC
/begin CHARACTERISTIC FrmMng_DebSigSTAT_ARSDef_C "#SSD debouncing of signal-error STAT_ARS (no.of events)" VALUE 0xD53E8 Kw_Wu16 65535.00 OneToOne 0.00 65535.00 FORMAT "%8.2" /end CHARACTERISTIC
/begin CHARACTERISTIC FrmMng_DebSigSTAT_ARSOk_C "debouncing of signal-error STAT_ARS (no.of events)" VALUE 0xD53EA Kw_Wu16 65535.00 OneToOne 0.00 65535.00 FORMAT "%8.2" /end CHARACTERISTIC
/begin CHARACTERISTIC FrmMng_DebSigSTAT_DSCDef_C "#SSD debouncing of signal-error STAT_DSC (no.of events)" VALUE 0xD53EC Kw_Wu16 65535.00 OneToOne 0.00 65535.00 FORMAT "%8.2" /end CHARACTERISTIC
/begin CHARACTERISTIC FrmMng_DebSigSTAT_DSCOk_C "debouncing of signal-error STAT_DSC (no.of events)" VALUE 0xD53EE Kw_Wu16 65535.00 OneToOne 0.00 65535.00 FORMAT "%8.2" /end CHARACTERISTIC
/begin CHARACTERISTIC FrmMng_DebSigSTAT_EKPDef_C "Defektentprellung für STAT_EKP-messages Signalfehler" VALUE 0xD53F0 Kw_Wu16 65535.00 OneToOne 0.00 65535.00 FORMAT "%8.2" /end CHARACTERISTIC
/begin CHARACTERISTIC FrmMng_DebSigSTAT_EKPOk_C "Heilentprellung für STAT_EKP messages Signalfehler" VALUE 0xD53F2 Kw_Wu16 65535.00 OneToOne 0.00 65535.00 FORMAT "%8.2" /end CHARACTERISTIC
/begin CHARACTERISTIC FrmMng_DebSigSTAT_KOMBIDef_C "#SSD debouncing of signal-error STAT_KOMBI (no.of events)" VALUE 0xD53F4 Kw_Wu16 65535.00 OneToOne 0.00 65535.00 FORMAT "%8.2" /end CHARACTERISTIC
/begin CHARACTERISTIC FrmMng_DebSigSTAT_KOMBIOk_C "debouncing of signal-error STAT_KOMBI (no.of events)" VALUE 0xD53F6 Kw_Wu16 65535.00 OneToOne 0.00 65535.00 FORMAT "%8.2" /end CHARACTERISTIC
/begin CHARACTERISTIC FrmMng_ctDebOBDGbxMilOfDef_C "Defektl-Entprellzähler für MilOf" VALUE 0xD53F8 Kw_Wu16 655350.0 Time_ms 0.00 655350.0 FORMAT "%8.1" /end CHARACTERISTIC
/begin CHARACTERISTIC FrmMng_ctDebSigStOBDGbxMilOfOk_C "Healing time for MIL off" VALUE 0xD53FA Kw_Wu16 655350.0 Time_ms 0.00 655350.0 FORMAT "%8.1" /end CHARACTERISTIC
/begin CHARACTERISTIC FrmMng_ctDebOBDGbxMilOnDef_C "Defekt-Entprellzähler für MilOn" VALUE 0xD53FC Kw_Wu16 655350.0 Time_ms 0.00 655350.0 FORMAT "%8.1" /end CHARACTERISTIC
/begin CHARACTERISTIC FrmMng_ctDebSigStOBDGbxMilOnOk_C "Healing time for MIL on" VALUE 0xD53FE Kw_Wu16 655350.0 Time_ms 0.00 655350.0 FORMAT "%8.1" /end CHARACTERISTIC
/begin CHARACTERISTIC FrmMng_DebSigTEMPRELTIMEDef_C "debouncing of signal-error PWRMNGLOADV (no.of events)" VALUE 0xD5400 Kw_Wu16 65535.00 OneToOne 0.00 65535.00 FORMAT "%8.2" /end CHARACTERISTIC
/begin CHARACTERISTIC FrmMng_DebSigTEMPRELTIMEOk_C "debouncing of signal-error PWRMNGLOADV (no.of events)" VALUE 0xD5402 Kw_Wu16 65535.00 OneToOne 0.00 65535.00 FORMAT "%8.2" /end CHARACTERISTIC
/begin CHARACTERISTIC FrmMng_DebSigTERMINALDef_C "debouncing of signal-error TERMINAL(no.of events)" VALUE 0xD5404 Kw_Wu16 65535.00 OneToOne 0.00 65535.00 FORMAT "%8.2" /end CHARACTERISTIC
/begin CHARACTERISTIC FrmMng_DebSigTERMINALOk_C "debouncing of signal-error TERMINAL(no.of events)" VALUE 0xD5406 Kw_Wu16 65535.00 OneToOne 0.00 65535.00 FORMAT "%8.2" /end CHARACTERISTIC
/begin CHARACTERISTIC FrmMng_DebSigTIME_DATEDef_C "" VALUE 0xD5408 Kw_Wu16 65535.00 OneToOne 0.00 65535.00 FORMAT "%8.2" /end CHARACTERISTIC
/begin CHARACTERISTIC FrmMng_DebSigTIME_DATEOk_C "" VALUE 0xD540A Kw_Wu16 65535.00 OneToOne 0.00 65535.00 FORMAT "%8.2" /end CHARACTERISTIC
/begin CHARACTERISTIC FrmMng_DebSigTORQUE_DSCDef_C "#SSD debouncing of signal-error TORQUE_DSC (no.of events)" VALUE 0xD540C Kw_Wu16 65535.00 OneToOne 0.00 65535.00 FORMAT "%8.2" /end CHARACTERISTIC
/begin CHARACTERISTIC FrmMng_DebSigTORQUE_DSCOk_C "debouncing of signal-error TORQUE_DSC (no.of events)" VALUE 0xD540E Kw_Wu16 65535.00 OneToOne 0.00 65535.00 FORMAT "%8.2" /end CHARACTERISTIC
/begin CHARACTERISTIC FrmMng_DebSigTORQUE_GEARBXDef_C "#SSD debouncing of signal-error TORQUE_GEARBX (no.of events)" VALUE 0xD5410 Kw_Wu16 65535.00 OneToOne 0.00 65535.00 FORMAT "%8.2" /end CHARACTERISTIC
/begin CHARACTERISTIC FrmMng_DebSigTORQUE_GEARBXOk_C "debouncing of signal-error TORQUE_GEARBX (no.of events)" VALUE 0xD5412 Kw_Wu16 65535.00 OneToOne 0.00 65535.00 FORMAT "%8.2" /end CHARACTERISTIC
/begin CHARACTERISTIC FrmMng_DebSigVEH_MODDef_C "defect debouncing time for signal error for VEH_MOD signal" VALUE 0xD5414 Kw_Wu16 65535.00 OneToOne 0.00 65535.00 FORMAT "%8.2" /end CHARACTERISTIC
/begin CHARACTERISTIC FrmMng_DebSigVEH_MODOk_C "Debouncing time for sig error for VEH_MOD signal" VALUE 0xD5416 Kw_Wu16 65535.00 OneToOne 0.00 65535.00 FORMAT "%8.2" /end CHARACTERISTIC
/begin CHARACTERISTIC FrmMng_DebSigVELOCITYDef_C "debouncing of signal-error VELOCITY (no.of events)" VALUE 0xD5418 Kw_Wu16 65535.00 OneToOne 0.00 65535.00 FORMAT "%8.2" /end CHARACTERISTIC
/begin CHARACTERISTIC FrmMng_DebSigVELOCITYOk_C "debouncing of signal-error VELOCITY (no.of events)" VALUE 0xD541A Kw_Wu16 65535.00 OneToOne 0.00 65535.00 FORMAT "%8.2" /end CHARACTERISTIC
/begin CHARACTERISTIC FrmMng_ctDebSigWHEEL_SPEEDDef_C "Fehlerentprellzeit für CAN message Wheel Speed (Signalfehler)" VALUE 0xD541C Kw_Wu16 65535.00 OneToOne 0.00 65535.00 FORMAT "%8.2" /end CHARACTERISTIC
/begin CHARACTERISTIC FrmMng_ctDebSigWHEEL_SPEEDOk_C "Heilungsentprellzeit für CAN message Wheel Speed (Signalfehler)" VALUE 0xD541E Kw_Wu16 65535.00 OneToOne 0.00 65535.00 FORMAT "%8.2" /end CHARACTERISTIC
/begin CHARACTERISTIC FrmMng_DebTGearbxDef_C "debouncing of TGearbx for defect detection" VALUE 0xD5420 Kw_Wu16 65535.00 OneToOne 0.00 65535.00 FORMAT "%8.2" /end CHARACTERISTIC
/begin CHARACTERISTIC FrmMng_DebTGearbxOk_C "debouncing of TGearbx for healing" VALUE 0xD5422 Kw_Wu16 65535.00 OneToOne 0.00 65535.00 FORMAT "%8.2" /end CHARACTERISTIC
/begin CHARACTERISTIC FrmMng_DebToANFRADMOMPTDef_C "Defektentprellung für RADMOM_PT_1-messages Timeout" VALUE 0xD5424 Kw_Wu16 65535.00 OneToOne 0.00 65535.00 FORMAT "%8.2" /end CHARACTERISTIC
/begin CHARACTERISTIC FrmMng_DebToANFRADMOMPTOk_C "Heilentprellung für RADMOM_PT_1-messages Timeout" VALUE 0xD5426 Kw_Wu16 65535.00 OneToOne 0.00 65535.00 FORMAT "%8.2" /end CHARACTERISTIC
/begin CHARACTERISTIC FrmMng_DebToBOS_RESET_2Def_C "" VALUE 0xD5428 Kw_Wu16 65535.00 OneToOne 0.00 65535.00 FORMAT "%8.2" /end CHARACTERISTIC
/begin CHARACTERISTIC FrmMng_DebToBOS_RESET_2Ok_C "" VALUE 0xD542A Kw_Wu16 65535.00 OneToOne 0.00 65535.00 FORMAT "%8.2" /end CHARACTERISTIC
/begin CHARACTERISTIC FrmMng_DebToBOS_RESETDef_C "debouncing of timeout-error BOS_RESET (no.of events)" VALUE 0xD542C Kw_Wu16 65535.00 OneToOne 0.00 65535.00 FORMAT "%8.2" /end CHARACTERISTIC
/begin CHARACTERISTIC FrmMng_DebToBOS_RESETOk_C "debouncing of timeout-error BOS_RESET (no.of events)" VALUE 0xD542E Kw_Wu16 65535.00 OneToOne 0.00 65535.00 FORMAT "%8.2" /end CHARACTERISTIC
/begin CHARACTERISTIC FrmMng_DebToDMOMENT_ACCDef_C "#SSD Defect time of DMOMENT_ACC time out" VALUE 0xD5430 Kw_Wu16 65535.00 OneToOne 0.00 65535.00 FORMAT "%8.2" /end CHARACTERISTIC
/begin CHARACTERISTIC FrmMng_DebToDMOMENT_ACCOk_C "Healing time  of  DMOMENT_ACC  time out" VALUE 0xD5432 Kw_Wu16 65535.00 OneToOne 0.00 65535.00 FORMAT "%8.2" /end CHARACTERISTIC
/begin CHARACTERISTIC FrmMng_DebToGEARBX_DATA2Def_C "debouncing of timeout-error GEARBX_DATA2 (no.of events)" VALUE 0xD5434 Kw_Wu16 65535.00 OneToOne 0.00 65535.00 FORMAT "%8.2" /end CHARACTERISTIC
/begin CHARACTERISTIC FrmMng_DebToGEARBX_DATA2Ok_C "Healing time for GEARBX_DATA2-messages Timeout" VALUE 0xD5436 Kw_Wu16 65535.00 OneToOne 0.00 65535.00 FORMAT "%8.2" /end CHARACTERISTIC
/begin CHARACTERISTIC FrmMng_DebToGEARBX_DATADef_C "debouncing of timeout-error GEARBX_DATA (no.of events)" VALUE 0xD5438 Kw_Wu16 65535.00 OneToOne 0.00 65535.00 FORMAT "%8.2" /end CHARACTERISTIC
/begin CHARACTERISTIC FrmMng_DebToGEARBX_DATAOk_C "debouncing of timeout-error GEARBX_DATA (no.of events)" VALUE 0xD543A Kw_Wu16 65535.00 OneToOne 0.00 65535.00 FORMAT "%8.2" /end CHARACTERISTIC
/begin CHARACTERISTIC FrmMng_DebToHEAT_ACDef_C "debouncing of timeout-error HEAT_AC (no.of events)" VALUE 0xD543C Kw_Wu16 65535.00 OneToOne 0.00 65535.00 FORMAT "%8.2" /end CHARACTERISTIC
/begin CHARACTERISTIC FrmMng_DebToHEAT_ACOk_C "debouncing of timeout-error HEAT_AC (no.of events)" VALUE 0xD543E Kw_Wu16 65535.00 OneToOne 0.00 65535.00 FORMAT "%8.2" /end CHARACTERISTIC
/begin CHARACTERISTIC FrmMng_DebToMILEAGE_RANGEDef_C "#SSD debouncing of timeout - error MILEAGE_RANGE(no of events)" VALUE 0xD5440 Kw_Wu16 65535.00 OneToOne 0.00 65535.00 FORMAT "%8.2" /end CHARACTERISTIC
/begin CHARACTERISTIC FrmMng_DebToMILEAGE_RANGEOk_C "debouncing of timeout - error MILEAGE_RANGE (no of events)" VALUE 0xD5442 Kw_Wu16 65535.00 OneToOne 0.00 65535.00 FORMAT "%8.2" /end CHARACTERISTIC
/begin CHARACTERISTIC FrmMng_DebToOPCRCTLACCDef_C "#SSD debouncing of timeout-error OPCRCTLACC (no.of events)" VALUE 0xD5444 Kw_Wu16 65535.00 OneToOne 0.00 65535.00 FORMAT "%8.2" /end CHARACTERISTIC
/begin CHARACTERISTIC FrmMng_DebToOPCRCTLACCOk_C "debouncing of timeout-error OPCRCTLACC (no.of events)" VALUE 0xD5446 Kw_Wu16 65535.00 OneToOne 0.00 65535.00 FORMAT "%8.2" /end CHARACTERISTIC
/begin CHARACTERISTIC FrmMng_DebToParkConsumerDef_C "Defektentprellzeit Botschaftsausfall PWMG_STANDVERBR" VALUE 0xD5448 Kw_Wu16 65535.00 OneToOne 0.00 65535.00 FORMAT "%8.2" /end CHARACTERISTIC
/begin CHARACTERISTIC FrmMng_DebToParkConsumerOk_C "Heilentprellzeit Botschaftsausfall PWMG_STANDVERBR" VALUE 0xD544A Kw_Wu16 65535.00 OneToOne 0.00 65535.00 FORMAT "%8.2" /end CHARACTERISTIC
/begin CHARACTERISTIC FrmMng_DebToPRGG_CCTRDef_C "Defect time for PRGG_CCTR-messages Timeout" VALUE 0xD544C Kw_Wu16 65535.00 OneToOne 0.00 65535.00 FORMAT "%8.2" /end CHARACTERISTIC
/begin CHARACTERISTIC FrmMng_DebToPRGG_CCTROk_C "Healing time for PRGG_CCTR-messages Timeout" VALUE 0xD544E Kw_Wu16 65535.00 OneToOne 0.00 65535.00 FORMAT "%8.2" /end CHARACTERISTIC
/begin CHARACTERISTIC FrmMng_DebToPWRMNG_LOADVDef_C "" VALUE 0xD5450 Kw_Wu16 65535.00 OneToOne 0.00 65535.00 FORMAT "%8.2" /end CHARACTERISTIC
/begin CHARACTERISTIC FrmMng_DebToPWRMNG_LOADVOk_C "" VALUE 0xD5452 Kw_Wu16 65535.00 OneToOne 0.00 65535.00 FORMAT "%8.2" /end CHARACTERISTIC
/begin CHARACTERISTIC FrmMng_DebToRQ_STG_EFANDef_C "Defektentprellung für RQ_STG_EFAN - messages timeout" VALUE 0xD5454 Kw_Wu16 65535.00 OneToOne 0.00 65535.00 FORMAT "%8.2" /end CHARACTERISTIC
/begin CHARACTERISTIC FrmMng_DebToRQ_STG_EFANOk_C "Heilentprellung für RQ_STG_EFAN - messages timeout" VALUE 0xD5456 Kw_Wu16 65535.00 OneToOne 0.00 65535.00 FORMAT "%8.2" /end CHARACTERISTIC
/begin CHARACTERISTIC FrmMng_ctDebToSITZGURTDef_C "Defektentprellung für STAT_SITZBELEGUNG_GURT-messages Timeout" VALUE 0xD5458 Kw_Wu16 65535.00 OneToOne 0.00 65535.00 FORMAT "%8.2" /end CHARACTERISTIC
/begin CHARACTERISTIC FrmMng_ctDebToSITZGURTOk_C "Heilentprellung für STAT_SITZBELEGUNG_GURT-messages Timeout" VALUE 0xD545A Kw_Wu16 65535.00 OneToOne 0.00 65535.00 FORMAT "%8.2" /end CHARACTERISTIC
/begin CHARACTERISTIC FrmMng_DebToSTAT_ANHDef_C "" VALUE 0xD545C Kw_Wu16 65535.00 OneToOne 0.00 65535.00 FORMAT "%8.2" /end CHARACTERISTIC
/begin CHARACTERISTIC FrmMng_DebToSTAT_ANHOk_C "" VALUE 0xD545E Kw_Wu16 65535.00 OneToOne 0.00 65535.00 FORMAT "%8.2" /end CHARACTERISTIC
/begin CHARACTERISTIC FrmMng_DebToSTAT_ARSDef_C "#SSD debouncing of timeout-error STAT_ARS (no.of events)" VALUE 0xD5460 Kw_Wu16 65535.00 OneToOne 0.00 65535.00 FORMAT "%8.2" /end CHARACTERISTIC
/begin CHARACTERISTIC FrmMng_DebToSTAT_ARSOk_C "debouncing of timeout-error STAT_ARS (no.of events)" VALUE 0xD5462 Kw_Wu16 65535.00 OneToOne 0.00 65535.00 FORMAT "%8.2" /end CHARACTERISTIC
/begin CHARACTERISTIC FrmMng_DebToSTAT_DSCDef_C "#SSD debouncing of timeout-error STAT_DSC (no.of events)" VALUE 0xD5464 Kw_Wu16 65535.00 OneToOne 0.00 65535.00 FORMAT "%8.2" /end CHARACTERISTIC
/begin CHARACTERISTIC FrmMng_DebToSTAT_DSCOk_C "debouncing of timeout-error STAT_DSC (no.of events)" VALUE 0xD5466 Kw_Wu16 65535.00 OneToOne 0.00 65535.00 FORMAT "%8.2" /end CHARACTERISTIC
/begin CHARACTERISTIC FrmMng_DebToSTAT_EKPDef_C "Defektentprellung für STAT_EKPmessages  Timeout fehler" VALUE 0xD5468 Kw_Wu16 65535.00 OneToOne 0.00 65535.00 FORMAT "%8.2" /end CHARACTERISTIC
/begin CHARACTERISTIC FrmMng_DebToSTAT_EKPOk_C "Heilentprellung  für STAT_EKP-messages Timeout lfehler" VALUE 0xD546A Kw_Wu16 65535.00 OneToOne 0.00 65535.00 FORMAT "%8.2" /end CHARACTERISTIC
/begin CHARACTERISTIC FrmMng_DebToSTAT_KOMBIDef_C "#SSD debouncing of timeout - error STAT_KOMBI (no of events)" VALUE 0xD546C Kw_Wu16 65535.00 OneToOne 0.00 65535.00 FORMAT "%8.2" /end CHARACTERISTIC
/begin CHARACTERISTIC FrmMng_DebToSTAT_KOMBIOk_C "debouncing of timeout - error STAT_KOMBI (no of events)" VALUE 0xD546E Kw_Wu16 65535.00 OneToOne 0.00 65535.00 FORMAT "%8.2" /end CHARACTERISTIC
/begin CHARACTERISTIC FrmMng_DebToTEMPRELTIMEDef_C "debouncing of timeout-error TEMPRELTIME (no.of events)" VALUE 0xD5470 Kw_Wu16 65535.00 OneToOne 0.00 65535.00 FORMAT "%8.2" /end CHARACTERISTIC
/begin CHARACTERISTIC FrmMng_DebToTEMPRELTIMEOk_C "debouncing of timeout-error TEMPRELTIME (no.of events)" VALUE 0xD5472 Kw_Wu16 65535.00 OneToOne 0.00 65535.00 FORMAT "%8.2" /end CHARACTERISTIC
/begin CHARACTERISTIC FrmMng_DebToTERMINALDef_C "debouncing of timeout-error TERMINAL (no.of events)" VALUE 0xD5474 Kw_Wu16 65535.00 OneToOne 0.00 65535.00 FORMAT "%8.2" /end CHARACTERISTIC
/begin CHARACTERISTIC FrmMng_DebToTERMINALOk_C "debouncing of timeout-error TERMINAL (no.of events)" VALUE 0xD5476 Kw_Wu16 65535.00 OneToOne 0.00 65535.00 FORMAT "%8.2" /end CHARACTERISTIC
/begin CHARACTERISTIC FrmMng_DebToTIME_DATEDef_C "" VALUE 0xD5478 Kw_Wu16 65535.00 OneToOne 0.00 65535.00 FORMAT "%8.2" /end CHARACTERISTIC
/begin CHARACTERISTIC FrmMng_DebToTIME_DATEOk_C "" VALUE 0xD547A Kw_Wu16 65535.00 OneToOne 0.00 65535.00 FORMAT "%8.2" /end CHARACTERISTIC
/begin CHARACTERISTIC FrmMng_DebToTORQUE_DSCDef_C "#SSD debouncing of timeout-error TORQUE_DSC (no.of events)" VALUE 0xD547C Kw_Wu16 65535.00 OneToOne 0.00 65535.00 FORMAT "%8.2" /end CHARACTERISTIC
/begin CHARACTERISTIC FrmMng_DebToTORQUE_DSCOk_C "debouncing of timeout-error TORQUE_DSC (no.of events)" VALUE 0xD547E Kw_Wu16 65535.00 OneToOne 0.00 65535.00 FORMAT "%8.2" /end CHARACTERISTIC
/begin CHARACTERISTIC FrmMng_DebToTORQUE_GEARBXDef_C "#SSD debouncing of timeout-error TORQUE_GEARBX (no.of events)" VALUE 0xD5480 Kw_Wu16 65535.00 OneToOne 0.00 65535.00 FORMAT "%8.2" /end CHARACTERISTIC
/begin CHARACTERISTIC FrmMng_DebToTORQUE_GEARBXOk_C "debouncing of timeout-error TORQUE_GEARBX (no.of events)" VALUE 0xD5482 Kw_Wu16 65535.00 OneToOne 0.00 65535.00 FORMAT "%8.2" /end CHARACTERISTIC
/begin CHARACTERISTIC FrmMng_DebToVEH_MODDef_C "Defect debouncing time VEH_MOD" VALUE 0xD5484 Kw_Wu16 65535.00 OneToOne 0.00 65535.00 FORMAT "%8.2" /end CHARACTERISTIC
/begin CHARACTERISTIC FrmMng_DebToVEH_MODOk_C "Debouncing OK time for VEH_MOD signal" VALUE 0xD5486 Kw_Wu16 65535.00 OneToOne 0.00 65535.00 FORMAT "%8.2" /end CHARACTERISTIC
/begin CHARACTERISTIC FrmMng_DebToVELOCITYDef_C "debouncing of timeout-error VELOCITY (no.of events)" VALUE 0xD5488 Kw_Wu16 65535.00 OneToOne 0.00 65535.00 FORMAT "%8.2" /end CHARACTERISTIC
/begin CHARACTERISTIC FrmMng_DebToVELOCITYOk_C "debouncing of timeout-error VELOCITY (no.of events)" VALUE 0xD548A Kw_Wu16 65535.00 OneToOne 0.00 65535.00 FORMAT "%8.2" /end CHARACTERISTIC
/begin CHARACTERISTIC FrmMng_ctDebToWHEEL_SPEEDDef_C "#SSD Fehlerentprellzeit für CAN message Wheel Speed (timeout)" VALUE 0xD548C Kw_Wu16 65535.00 OneToOne 0.00 65535.00 FORMAT "%8.2" /end CHARACTERISTIC
/begin CHARACTERISTIC FrmMng_ctDebToWHEEL_SPEEDOk_C "Fehlerheilungszeit für CAN message Wheel Speed (timeout)" VALUE 0xD548E Kw_Wu16 65535.00 OneToOne 0.00 65535.00 FORMAT "%8.2" /end CHARACTERISTIC
/begin CHARACTERISTIC FrmMng_drAPP1Min_C "threshold for accelerator padel 1 value" VALUE 0xD5490 Kw_Ws16 5000.000 PrcPerSec 0.00 5000.000 FORMAT "%8.3" EXTENDED_LIMITS -20000.00 19999.39 /end CHARACTERISTIC
/begin CHARACTERISTIC FrmMng_dstGear_C "#SSD translationtable ST_GR_GRB to FrmMng_stGear" VAL_BLK 0xD5492 Kwb_Wu8 14.00 OneToOne 0.00 14.00 FORMAT "%5.2" EXTENDED_LIMITS 0.00 255.0 NUMBER 15 /end CHARACTERISTIC
/begin CHARACTERISTIC FrmMng_dTrqWheelRmpUp_C "Negative Radmoment Rampensteigung" VALUE 0xD54A4 Kw_Wu32 13107199.9969 RmpTrqPrp 0.00 13107199.9969 FORMAT "%13.4" /end CHARACTERISTIC
/begin CHARACTERISTIC FrmMng_dTrqWheelRmpDwn_C "Positive Radmoment Rampensteigung" VALUE 0xD54A8 Kw_Wu32 13107199.9969 RmpTrqPrp 0.00 13107199.9969 FORMAT "%13.4" /end CHARACTERISTIC
/begin CHARACTERISTIC FrmMng_factrqInrStrt_C "Faktor zur Minimierung des inneren Moments im Startfall" VALUE 0xD54AC Kw_Wu16 7.999878 Fact 0.00 7.999878 FORMAT "%8.6" /end CHARACTERISTIC
/begin CHARACTERISTIC FrmMng_FDCSelfRec_C "Schalter zur Auswahl des FDC Selbstanerkennung" VALUE 0xD54AE Kw_Wu8 1.000 OneToOne 0.00 1.000 FORMAT "%5.3" EXTENDED_LIMITS 0.00 255.0 /end CHARACTERISTIC
/begin CHARACTERISTIC FrmMng_FGRSelfRec_C "Switch to disable/enable FGR self recognition" VALUE 0xD54AF Kw_Wu8 1.000 OneToOne 0.00 1.000 FORMAT "%5.3" EXTENDED_LIMITS 0.00 255.0 /end CHARACTERISTIC
/begin CHARACTERISTIC FrmMng_cnvFLLV_FUTA_Offset_C "#SSD Offset to calculate FST from CAN" VALUE 0xD54B0 Kw_Ws16 65535.00 OneToOne -32768.00 32767.00 FORMAT "%8.2" /end CHARACTERISTIC
/begin CHARACTERISTIC FrmMng_cnvFLLV_FUTA_Slope_C "#SSD Slope to calculate FST from CAN" VALUE 0xD54B2 Kw_Ws16 65.53500 SlopeRes1000 -32.76800 32.76700 FORMAT "%8.5" /end CHARACTERISTIC
/begin CHARACTERISTIC FrmMng_mskDM_ANF_ACC_0x800_C "" VALUE 0xD54B4 Kw_Wu8 255.0 OneToOne 0.00 255.0 FORMAT "%5.1" /end CHARACTERISTIC
/begin CHARACTERISTIC FrmMng_mskDM_ANF_AFS_C "mask for the status bits to supress unwanted errors" VALUE 0xD54B5 Kw_Wu8 255.0 OneToOne 0.00 255.0 FORMAT "%5.1" /end CHARACTERISTIC
/begin CHARACTERISTIC FrmMng_mskDM_ANF_SSG_C "Maske um mittels Status Bits div. Fehler auszublenden" VALUE 0xD54B6 Kw_Wu8 255.0 OneToOne 0.00 255.0 FORMAT "%5.1" /end CHARACTERISTIC
/begin CHARACTERISTIC FrmMng_mskSTAT_ARS_C "mask signalerrors" VALUE 0xD54B7 Kw_Wu8 255.0 OneToOne 0.00 255.0 FORMAT "%5.1" /end CHARACTERISTIC
/begin CHARACTERISTIC FrmMng_mskTORQUE_DSC_C "mask signal errors" VALUE 0xD54B8 Kw_Wu8 255.0 OneToOne 0.00 255.0 FORMAT "%5.1" /end CHARACTERISTIC
/begin CHARACTERISTIC FrmMng_mskTORQUE_GEARBX_C " mask signalerrors" VALUE 0xD54B9 Kw_Wu8 255.0 OneToOne 0.00 255.0 FORMAT "%5.1" /end CHARACTERISTIC
/begin CHARACTERISTIC FrmMng_nEngOFF_C "Engine speed threshold for engine state" VALUE 0xD54BA Kw_Ws16 8000.000 EngN 0.00 8000.000 FORMAT "%8.3" EXTENDED_LIMITS -32768.00 32767.00 /end CHARACTERISTIC
/begin CHARACTERISTIC FrmMng_nEngRpm1_CUR "Curve for calculating the engine speed threshold 1" CURVE 0xD54BC Kl_Xs16_Ws16 5960.000 EngN 40.00000 6000.000 FORMAT "%8.3" EXTENDED_LIMITS -32768.00 32767.00
 /begin AXIS_DESCR STD_AXIS FrmMng_tEngRpm_mp Temp_Cels 6 -50.14000 199.8600 FORMAT "%8.4" EXTENDED_LIMITS -3549.940 3003.560 DEPOSIT ABSOLUTE /end AXIS_DESCR
/end CHARACTERISTIC
/begin CHARACTERISTIC FrmMng_nEngRpm2_CUR "Curve for calculating the engine speed threshold 2" CURVE 0xD54D6 Kl_Xs16_Ws16 5960.000 EngN 40.00000 6000.000 FORMAT "%8.3" EXTENDED_LIMITS -32768.00 32767.00
 /begin AXIS_DESCR STD_AXIS FrmMng_tEngRpm_mp Temp_Cels 6 -50.14000 199.8600 FORMAT "%8.4" EXTENDED_LIMITS -3549.940 3003.560 DEPOSIT ABSOLUTE /end AXIS_DESCR
/end CHARACTERISTIC
/begin CHARACTERISTIC FrmMng_nFanDflt_C "Unterlassungs-Fan eilt" VALUE 0xD54F0 Kw_Wu16 3000.000 FanSpd 0.00 3000.000 FORMAT "%8.3" EXTENDED_LIMITS 0.00 6000.092 /end CHARACTERISTIC
/begin CHARACTERISTIC FrmMng_nFan_CUR "Umsetzungstabelle Lüfterstufe --> Lüfterdrehzahl" CURVE 0xD54F2 Kl_Xs16_Ws16 3000.000 FanSpd 0.00 3000.000 FORMAT "%8.3" EXTENDED_LIMITS -3000.092 3000.000
 /begin AXIS_DESCR STD_AXIS FrmMng_numACFanDes OneToOne 4 0.00 15.00 FORMAT "%5.2" EXTENDED_LIMITS 0.00 255.0 DEPOSIT ABSOLUTE /end AXIS_DESCR
/end CHARACTERISTIC
/begin CHARACTERISTIC FrmMng_nHtgUpActMax_C "speed threshold for evaluating ST_SW_WAUP signal" VALUE 0xD5504 Kw_Ws16 5960.000 EngN 40.00000 6000.000 FORMAT "%8.3" EXTENDED_LIMITS -32768.00 32767.00 /end CHARACTERISTIC
/begin CHARACTERISTIC FrmMng_nHtgUpCrCtlMax_C "max cruise control speed switch" VALUE 0xD5506 Kw_Ws16 5960.000 EngN 40.00000 6000.000 FORMAT "%8.3" EXTENDED_LIMITS -32768.00 32767.00 /end CHARACTERISTIC
/begin CHARACTERISTIC FrmMng_nLIGovOffs_C "ST_SW_LEV_RPM - status switch level RPM" VALUE 0xD5508 Kw_Ws16 5960.000 EngN 40.00000 6000.000 FORMAT "%8.3" EXTENDED_LIMITS -32768.00 32767.00 /end CHARACTERISTIC
/begin CHARACTERISTIC FrmMng_nLimSSGErr_C "Error value for Maximum engine speed in phase 2 of the switching process" VALUE 0xD550A Kw_Ws16 5960.000 EngN 40.00000 6000.000 FORMAT "%8.3" EXTENDED_LIMITS -32768.00 32767.00 /end CHARACTERISTIC
/begin CHARACTERISTIC FrmMng_cnvnPSPSpd_Offset_C "Offset for the calculation of RPM_FU_PP_EL signal" VALUE 0xD550C Kw_Ws16 65535.00 PSP_Spd -32768.00 32767.00 FORMAT "%8.2" /end CHARACTERISTIC
/begin CHARACTERISTIC FrmMng_cnvnPSPSpd_Slope_C "Slope for the calculation of RPM_FU_PP_EL signal" VALUE 0xD550E Kw_Ws16 655.3500 SlopeRes100 -327.6800 327.6700 FORMAT "%8.4" /end CHARACTERISTIC
/begin CHARACTERISTIC FrmMng_nRqStgEFan_CUR "Kennlinie zur Berechnung der Lüfterdrehzal aus der Lüfterstufe" CURVE 0xD5510 Kl_Xs16_Ws16 3000.000 FanSpd 0.00 3000.000 FORMAT "%8.3" EXTENDED_LIMITS -3000.092 3000.000
 /begin AXIS_DESCR STD_AXIS FrmMng_numRqStgEFan OneToOne 4 0.00 15.00 FORMAT "%5.2" EXTENDED_LIMITS 0.00 255.0 DEPOSIT ABSOLUTE /end AXIS_DESCR
/end CHARACTERISTIC
/begin CHARACTERISTIC FrmMng_numACFanDesDef_C "Defektwert für FrmMng_numACFanDesDef_C Botschaft" VALUE 0xD5522 Kw_Wu8 255.0 OneToOne 0.00 255.0 FORMAT "%5.1" /end CHARACTERISTIC
/begin CHARACTERISTIC FrmMng_numCCAddLevlFlsh_C "State flash cycle for Checkcontroll message 11" VALUE 0xD5523 Kw_Wu8 3.000 OneToOne 0.00 3.000 FORMAT "%5.3" EXTENDED_LIMITS 0.00 255.0 /end CHARACTERISTIC
/begin CHARACTERISTIC FrmMng_numCCAddLevlNum_C "#SSD Number Checkcontroll message 11" VALUE 0xD5524 Kw_Wu16 65535.00 OneToOne 0.00 65535.00 FORMAT "%8.2" /end CHARACTERISTIC
/begin CHARACTERISTIC FrmMng_numCCBrkDefFlsh_C "Status Blinken Takt CC-Meldung Bremslichtschalter defekt" VALUE 0xD5526 Kw_Wu8 3.000 OneToOne 0.00 3.000 FORMAT "%5.3" EXTENDED_LIMITS 0.00 255.0 /end CHARACTERISTIC
/begin CHARACTERISTIC FrmMng_numCCBrkDefNum_C "Nummer CC-Meldung Bremslichtschalter defekt" VALUE 0xD5528 Kw_Wu16 65535.00 OneToOne 0.00 65535.00 FORMAT "%8.2" /end CHARACTERISTIC
/begin CHARACTERISTIC FrmMng_numCCbtnachFlsh_C "State flash cycle for Checkcontroll message 17" VALUE 0xD552A Kw_Wu8 3.000 OneToOne 0.00 3.000 FORMAT "%5.3" EXTENDED_LIMITS 0.00 255.0 /end CHARACTERISTIC
/begin CHARACTERISTIC FrmMng_numCCbtnachNum_C "#SSD Number Checkcontroll message 17" VALUE 0xD552C Kw_Wu16 65535.00 OneToOne 0.00 65535.00 FORMAT "%8.2" /end CHARACTERISTIC
/begin CHARACTERISTIC FrmMng_numCCbttdfkFlsh_C "State flash cycle for Checkcontroll message 19" VALUE 0xD552E Kw_Wu8 3.000 OneToOne 0.00 3.000 FORMAT "%5.3" EXTENDED_LIMITS 0.00 255.0 /end CHARACTERISTIC
/begin CHARACTERISTIC FrmMng_numCCbttdfkNum_C "#SSD Number Checkcontroll message 19" VALUE 0xD5530 Kw_Wu16 65535.00 OneToOne 0.00 65535.00 FORMAT "%8.2" /end CHARACTERISTIC
/begin CHARACTERISTIC FrmMng_numCCbttkntFlsh_C "State flash cycle for Checkcontroll message 20" VALUE 0xD5532 Kw_Wu8 3.000 OneToOne 0.00 3.000 FORMAT "%5.3" EXTENDED_LIMITS 0.00 255.0 /end CHARACTERISTIC
/begin CHARACTERISTIC FrmMng_numCCbttkntNum_C "#SSD Number Checkcontroll message 20" VALUE 0xD5534 Kw_Wu16 65535.00 OneToOne 0.00 65535.00 FORMAT "%8.2" /end CHARACTERISTIC
/begin CHARACTERISTIC FrmMng_numCCGenDef2Flsh_C "State flash cycle for Checkcontroll message 14" VALUE 0xD5536 Kw_Wu8 3.000 OneToOne 0.00 3.000 FORMAT "%5.3" EXTENDED_LIMITS 0.00 255.0 /end CHARACTERISTIC
/begin CHARACTERISTIC FrmMng_numCCGenDef2Num_C "#SSD Number Checkcontroll message 14" VALUE 0xD5538 Kw_Wu16 65535.00 OneToOne 0.00 65535.00 FORMAT "%8.2" /end CHARACTERISTIC
/begin CHARACTERISTIC FrmMng_numCCNoCrCtlFlsh_C "Status Blinken Takt der Checkcontrol Meldung Geschwindigkeitsregelung ohne Funktion" VALUE 0xD553A Kw_Wu8 3.000 OneToOne 0.00 3.000 FORMAT "%5.3" EXTENDED_LIMITS 0.00 255.0 /end CHARACTERISTIC
/begin CHARACTERISTIC FrmMng_numCCNoCrCtlNum_C "#SSD Nummer der Checkcontrol Meldung Geschwindigkeitsregelung ohne Funktion" VALUE 0xD553C Kw_Wu16 65535.00 OneToOne 0.00 65535.00 FORMAT "%8.2" /end CHARACTERISTIC
/begin CHARACTERISTIC FrmMng_numCCOelLevlFlsh_C "State flash cycle for Checkcontroll message 10" VALUE 0xD553E Kw_Wu8 3.000 OneToOne 0.00 3.000 FORMAT "%5.3" EXTENDED_LIMITS 0.00 255.0 /end CHARACTERISTIC
/begin CHARACTERISTIC FrmMng_numCCOelLevlNum_C "#SSD Number Checkcontroll message 10" VALUE 0xD5540 Kw_Wu16 65535.00 OneToOne 0.00 65535.00 FORMAT "%8.2" /end CHARACTERISTIC
/begin CHARACTERISTIC FrmMng_numCCOelVerbFlsh_C "State flash cycle for Checkcontroll message 8" VALUE 0xD5542 Kw_Wu8 3.000 OneToOne 0.00 3.000 FORMAT "%5.3" EXTENDED_LIMITS 0.00 255.0 /end CHARACTERISTIC
/begin CHARACTERISTIC FrmMng_numCCOelVerbNum_C "#SSD Number Checkcontroll message 8" VALUE 0xD5544 Kw_Wu16 65535.00 OneToOne 0.00 65535.00 FORMAT "%8.2" /end CHARACTERISTIC
/begin CHARACTERISTIC FrmMng_numCCOelVerlFlsh_C "State flash cycle for Checkcontroll message 9" VALUE 0xD5546 Kw_Wu8 3.000 OneToOne 0.00 3.000 FORMAT "%5.3" EXTENDED_LIMITS 0.00 255.0 /end CHARACTERISTIC
/begin CHARACTERISTIC FrmMng_numCCOelVerlNum_C "#SSD Number Checkcontroll message 9" VALUE 0xD5548 Kw_Wu16 65535.00 OneToOne 0.00 65535.00 FORMAT "%8.2" /end CHARACTERISTIC
/begin CHARACTERISTIC FrmMng_numCCOilPresFlsh_C "State flash cycle for Checkcontroll message 4" VALUE 0xD554A Kw_Wu8 3.000 OneToOne 0.00 3.000 FORMAT "%5.3" EXTENDED_LIMITS 0.00 255.0 /end CHARACTERISTIC
/begin CHARACTERISTIC FrmMng_numCCOilPresNum_C "#SSD Number Checkcontroll message 4" VALUE 0xD554C Kw_Wu16 65535.00 OneToOne 0.00 65535.00 FORMAT "%8.2" /end CHARACTERISTIC
/begin CHARACTERISTIC FrmMng_numCCOvrTem2Flsh_C "State flash cycle for Checkcontroll message 6" VALUE 0xD554E Kw_Wu8 3.000 OneToOne 0.00 3.000 FORMAT "%5.3" EXTENDED_LIMITS 0.00 255.0 /end CHARACTERISTIC
/begin CHARACTERISTIC FrmMng_numCCOvrTem2Num_C "#SSD Number Checkcontroll message 6" VALUE 0xD5550 Kw_Wu16 65535.00 OneToOne 0.00 65535.00 FORMAT "%8.2" /end CHARACTERISTIC
/begin CHARACTERISTIC FrmMng_numCCOvrTempFlsh_C "State flash cycle for Checkcontroll message 5" VALUE 0xD5552 Kw_Wu8 3.000 OneToOne 0.00 3.000 FORMAT "%5.3" EXTENDED_LIMITS 0.00 255.0 /end CHARACTERISTIC
/begin CHARACTERISTIC FrmMng_numCCOvrTempNum_C "#SSD Number Checkcontroll message 5" VALUE 0xD5554 Kw_Wu16 65535.00 OneToOne 0.00 65535.00 FORMAT "%8.2" /end CHARACTERISTIC
/begin CHARACTERISTIC FrmMng_numCCPFltDefFlsh_C "State flash cycle for Checkcontroll message 12" VALUE 0xD5556 Kw_Wu8 3.000 OneToOne 0.00 3.000 FORMAT "%5.3" EXTENDED_LIMITS 0.00 255.0 /end CHARACTERISTIC
/begin CHARACTERISTIC FrmMng_numCCPFltDefNum_C "#SSD Number Checkcontroll message 12" VALUE 0xD5558 Kw_Wu16 65535.00 OneToOne 0.00 65535.00 FORMAT "%8.2" /end CHARACTERISTIC
/begin CHARACTERISTIC FrmMng_numCCpmerrFlsh_C "State flash cycle for Checkcontroll message 18" VALUE 0xD555A Kw_Wu8 3.000 OneToOne 0.00 3.000 FORMAT "%5.3" EXTENDED_LIMITS 0.00 255.0 /end CHARACTERISTIC
/begin CHARACTERISTIC FrmMng_numCCpmerrNum_C "#SSD Number Checkcontroll message 18" VALUE 0xD555C Kw_Wu16 65535.00 OneToOne 0.00 65535.00 FORMAT "%8.2" /end CHARACTERISTIC
/begin CHARACTERISTIC FrmMng_numCCPreGlowFlsh_C "Status Blinken Takt der Checkcontrol Meldung Vorglühen" VALUE 0xD555E Kw_Wu8 3.000 OneToOne 0.00 3.000 FORMAT "%5.3" EXTENDED_LIMITS 0.00 255.0 /end CHARACTERISTIC
/begin CHARACTERISTIC FrmMng_numCCPreGlowNum_C "#SSD Nummer der Checkcontrol Meldung Vorglühen" VALUE 0xD5560 Kw_Wu16 65535.00 OneToOne 0.00 65535.00 FORMAT "%8.2" /end CHARACTERISTIC
/begin CHARACTERISTIC FrmMng_numCCprioFlsh_C "State flash cycle for Checkcontroll message 21" VALUE 0xD5562 Kw_Wu8 3.000 OneToOne 0.00 3.000 FORMAT "%5.3" EXTENDED_LIMITS 0.00 255.0 /end CHARACTERISTIC
/begin CHARACTERISTIC FrmMng_numCCprioNum_C "#SSD Number Checkcontroll message 21" VALUE 0xD5564 Kw_Wu16 65535.00 OneToOne 0.00 65535.00 FORMAT "%8.2" /end CHARACTERISTIC
/begin CHARACTERISTIC FrmMng_numCCruhverFlsh_C "State flash cycle for Checkcontroll message 16" VALUE 0xD5566 Kw_Wu8 3.000 OneToOne 0.00 3.000 FORMAT "%5.3" EXTENDED_LIMITS 0.00 255.0 /end CHARACTERISTIC
/begin CHARACTERISTIC FrmMng_numCCruhverNum_C "#SSD Number Checkcontroll message 16" VALUE 0xD5568 Kw_Wu16 65535.00 OneToOne 0.00 65535.00 FORMAT "%8.2" /end CHARACTERISTIC
/begin CHARACTERISTIC FrmMng_numCCStatMilFlsh_C "State flash cycle for Checkcontroll message 7" VALUE 0xD556A Kw_Wu8 3.000 OneToOne 0.00 3.000 FORMAT "%5.3" EXTENDED_LIMITS 0.00 255.0 /end CHARACTERISTIC
/begin CHARACTERISTIC FrmMng_numCCStatMilLmpTstFlsh_C "State flash cycle for Checkcontroll message 34" VALUE 0xD556B Kw_Wu8 3.000 OneToOne 0.00 3.000 FORMAT "%5.3" EXTENDED_LIMITS 0.00 255.0 /end CHARACTERISTIC
/begin CHARACTERISTIC FrmMng_numCCStatMilLmpTstNum_C "#SSD Number Checkcontroll message 34" VALUE 0xD556C Kw_Wu16 65535.00 OneToOne 0.00 65535.00 FORMAT "%8.2" /end CHARACTERISTIC
/begin CHARACTERISTIC FrmMng_numCCStatMilNum_C "Number Checkcontroll message 7" VALUE 0xD556E Kw_Wu16 65535.00 OneToOne 0.00 65535.00 FORMAT "%8.2" /end CHARACTERISTIC
/begin CHARACTERISTIC FrmMng_numCCSysLampFlsh_C "Status Blinken Takt der Checkcontrol Meldung Motornotprogramm" VALUE 0xD5570 Kw_Wu8 3.000 OneToOne 0.00 3.000 FORMAT "%5.3" EXTENDED_LIMITS 0.00 255.0 /end CHARACTERISTIC
/begin CHARACTERISTIC FrmMng_numCCSysLampNum_C "#SSD Nummer der Checkcontrolmessage Motornotprogramm" VALUE 0xD5572 Kw_Wu16 65535.00 OneToOne 0.00 65535.00 FORMAT "%8.2" /end CHARACTERISTIC
/begin CHARACTERISTIC FrmMng_numInqyID_C "#SSD Number Inquiry message 1" VALUE 0xD5574 Kw_Wu16 65535.00 OneToOne 0.00 65535.00 FORMAT "%8.2" /end CHARACTERISTIC
/begin CHARACTERISTIC FrmMng_numRecACCMax_C "Number of allowed errors for ACC recognition" VALUE 0xD5576 Kw_Wu8 119.0 OneToOne 1.000 120.0 FORMAT "%5.1" EXTENDED_LIMITS 0.00 255.0 /end CHARACTERISTIC
/begin CHARACTERISTIC FrmMng_numRecACMax_C "" VALUE 0xD5577 Kw_Wu8 119.0 OneToOne 1.000 120.0 FORMAT "%5.1" EXTENDED_LIMITS 0.00 255.0 /end CHARACTERISTIC
/begin CHARACTERISTIC FrmMng_numRecAFSMax_C "Maximum number of messages received" VALUE 0xD5578 Kw_Wu8 119.0 OneToOne 1.000 120.0 FORMAT "%5.1" EXTENDED_LIMITS 0.00 255.0 /end CHARACTERISTIC
/begin CHARACTERISTIC FrmMng_numRecARSMax_C "No of errors for ARS detection" VALUE 0xD5579 Kw_Wu8 119.0 OneToOne 1.000 120.0 FORMAT "%5.1" EXTENDED_LIMITS 0.00 255.0 /end CHARACTERISTIC
/begin CHARACTERISTIC FrmMng_numRecDCCMax_C "Anzahl Botschaften für Erkennung Empfang Radmomentanforderung-Botschaft" VALUE 0xD557A Kw_Wu8 119.0 OneToOne 1.000 120.0 FORMAT "%5.1" EXTENDED_LIMITS 0.00 255.0 /end CHARACTERISTIC
/begin CHARACTERISTIC FrmMng_numRecFDCMax_C "Z" VALUE 0xD557B Kw_Wu8 119.0 OneToOne 1.000 120.0 FORMAT "%5.1" EXTENDED_LIMITS 0.00 255.0 /end CHARACTERISTIC
/begin CHARACTERISTIC FrmMng_numRecFGRMax_C "Number of allowed errors for FGR recognition" VALUE 0xD557C Kw_Wu8 119.0 OneToOne 1.000 120.0 FORMAT "%5.1" EXTENDED_LIMITS 0.00 255.0 /end CHARACTERISTIC
/begin CHARACTERISTIC FrmMng_dtrqOvrRunRmpUp_C "parameter for overrun shut off ramp up  slope" VALUE 0xD5580 Kw_Wu32 6553584.99908 RmpTrq 14.9993896484 6553599.99847 FORMAT "%13.5" EXTENDED_LIMITS 0.00 6553599.99847 READ_ONLY /end CHARACTERISTIC
/begin CHARACTERISTIC FrmMng_dtrqOvrRunRmpDwn_C "#SSD parameter for overrun shut off ramp down  slope" VALUE 0xD5584 Kw_Wu32 6553584.99908 RmpTrq 14.9993896484 6553599.99847 FORMAT "%13.5" EXTENDED_LIMITS 0.00 6553599.99847 /end CHARACTERISTIC
/begin CHARACTERISTIC FrmMng_qOvrRun_C "ST_INFS - status over-run-fuel-shutoff" VALUE 0xD5588 Kw_Ws16 327.6700 InjMass 0.00 327.6700 FORMAT "%8.4" EXTENDED_LIMITS -327.6800 327.6700 /end CHARACTERISTIC
/begin CHARACTERISTIC FrmMng_cnvrPSPSetPoint_Offset_C "Offset Wert für die SETQ_FU_PP_EL signale" VALUE 0xD558A Kw_Ws16 799.9878 Prc -400.0000 399.9878 FORMAT "%8.4" /end CHARACTERISTIC
/begin CHARACTERISTIC FrmMng_cnvrPSPSetPoint_Slope_C "Steigungs Wert für SETQ_FU_PP_EL der STAT_EKP  CAN Botschaft" VALUE 0xD558C Kw_Ws16 655.3500 SlopeRes100 -327.6800 327.6700 FORMAT "%8.4" /end CHARACTERISTIC
/begin CHARACTERISTIC FrmMng_rWaterVlvClose_C "value for water valve fully closed" VALUE 0xD558E Kw_Wu16 100.0000 Prc 0.00 100.0000 FORMAT "%8.4" EXTENDED_LIMITS 0.00 799.9878 /end CHARACTERISTIC
/begin CHARACTERISTIC FrmMng_rWaterVlvCtl_C "Control value for water valve" VALUE 0xD5590 Kw_Wu16 100.0000 Prc 0.00 100.0000 FORMAT "%8.4" EXTENDED_LIMITS 0.00 799.9878 /end CHARACTERISTIC
/begin CHARACTERISTIC FrmMng_rWaterVlvOpen_C "value for water valve fully open" VALUE 0xD5592 Kw_Wu16 100.0000 Prc 0.00 100.0000 FORMAT "%8.4" EXTENDED_LIMITS 0.00 799.9878 /end CHARACTERISTIC
/begin CHARACTERISTIC FrmMng_stBltbDrDef_C "Ersatzwert" VALUE 0xD5594 Kw_Wu8 255.0 OneToOne 0.00 255.0 FORMAT "%5.1" /end CHARACTERISTIC
/begin CHARACTERISTIC FrmMng_stClCtrDEF_C "#SSD defekt value for FrmMng_stClCtr (CAN message ST_CLCTR)" VALUE 0xD5595 Kw_Wu8 255.0 OneToOne 0.00 255.0 FORMAT "%5.1" /end CHARACTERISTIC
/begin CHARACTERISTIC FrmMng_stConvErr_C "#SSD Status der Wandlerkupplung, Wert im Fehlerfall" VALUE 0xD5596 Kw_Wu8 15.00 OneToOne 0.00 15.00 FORMAT "%5.2" EXTENDED_LIMITS 0.00 255.0 /end CHARACTERISTIC
/begin CHARACTERISTIC FrmMng_stFDC_C "application parameter for FrmMng_stFDC value" VALUE 0xD5597 Kw_Wu8 2.000 OneToOne 0.00 2.000 FORMAT "%5.3" EXTENDED_LIMITS 0.00 255.0 /end CHARACTERISTIC
/begin CHARACTERISTIC FrmMng_stGbxErr_C "Schaltung aktiv, Vorgabewert im Fehlerfall" VALUE 0xD5598 Kw_Wu8 15.00 OneToOne 0.00 15.00 FORMAT "%5.2" EXTENDED_LIMITS 0.00 255.0 /end CHARACTERISTIC
/begin CHARACTERISTIC Frmmng_stGearbxHtgUpActMsk_C "Masking value for measuring point  Frmmng_stGearbxHtgUpAct_mp" VALUE 0xD5599 Kw_Wu8 255.0 OneToOne 0.00 255.0 FORMAT "%5.1" /end CHARACTERISTIC
/begin CHARACTERISTIC Frmmng_stGearHtgUpAct_C "velocity threshold for evaluating ST_SW_WAUP signal" VALUE 0xD559A Kw_Wu8 6.000 OneToOne 0.00 6.000 FORMAT "%5.3" EXTENDED_LIMITS 0.00 255.0 /end CHARACTERISTIC
/begin CHARACTERISTIC FrmMng_stKeyVldDef_C "Ersatzwert" VALUE 0xD559B Kw_Wu8 255.0 OneToOne 0.00 255.0 FORMAT "%5.1" /end CHARACTERISTIC
/begin CHARACTERISTIC FrmMng_stRgnHtgUp_C "Masking for EGT_CmpSt function" VALUE 0xD559C Kw_Wu32 2147483647.00 OneToOne 0.00 2147483647.00 FORMAT "%13.2" EXTENDED_LIMITS 0.00 4294967295.00 /end CHARACTERISTIC
/begin CHARACTERISTIC FrmMng_stT15Def_C "Intern Fehlerwert für T15" VALUE 0xD55A0 Kw_Wu8 255.0 OneToOne 0.00 255.0 FORMAT "%5.1" /end CHARACTERISTIC
/begin CHARACTERISTIC FrmMng_stT50Def_C "#SSD Defektwert für FrmMng_numACFanDesDef_C Botschaft" VALUE 0xD55A1 Kw_Wu8 255.0 OneToOne 0.00 255.0 FORMAT "%5.1" /end CHARACTERISTIC
/begin CHARACTERISTIC FrmMng_Sttorqavl_Errval_C "Error value for status torque actual-value" VALUE 0xD55A2 Kw_Wu8 10.00 OneToOne 0.00 10.00 FORMAT "%5.2" EXTENDED_LIMITS 0.00 255.0 /end CHARACTERISTIC
/begin CHARACTERISTIC FrmMng_stTRadioDef_C "defekt value for FrmMng_stTRadio" VALUE 0xD55A3 Kw_Wu8 255.0 OneToOne 0.00 255.0 FORMAT "%5.1" /end CHARACTERISTIC
/begin CHARACTERISTIC FrmMng_stWghSeatDrDef_C "Ersatzwert" VALUE 0xD55A4 Kw_Wu8 255.0 OneToOne 0.00 255.0 FORMAT "%5.1" /end CHARACTERISTIC
/begin CHARACTERISTIC FrmMng_swtANFRADMOMPT_C "Aktivierung der Botschaft ANF_RADMOM_PT" VALUE 0xD55A5 Kw_Wu8 1.000 OneToOne 0.00 1.000 FORMAT "%5.3" EXTENDED_LIMITS 0.00 255.0 /end CHARACTERISTIC
/begin CHARACTERISTIC FrmMng_swtANFRAGE_C "Schalter, um die Verarbeitung der Message zu deaktivieren (1: aktiviert, 0: deaktiviert)" VALUE 0xD55A6 Kw_Wu8 1.000 OneToOne 0.00 1.000 FORMAT "%5.3" EXTENDED_LIMITS 0.00 255.0 /end CHARACTERISTIC
/begin CHARACTERISTIC FrmMng_swtASDdc_C "Schalter um die ASDdc message zu deaktivieren (1...enabled, 0...disabled)" VALUE 0xD55A7 Kw_Wu8 1.000 OneToOne 0.00 1.000 FORMAT "%5.3" EXTENDED_LIMITS 0.00 255.0 /end CHARACTERISTIC
/begin CHARACTERISTIC FrmMng_swtBOS_Oil_2_C "Aktivieren der CAN-Botschaft BOS Meldung Oil 2 (1...aktiev, 0...inaktiev)" VALUE 0xD55A8 Kw_Wu8 1.000 OneToOne 0.00 1.000 FORMAT "%5.3" EXTENDED_LIMITS 0.00 255.0 /end CHARACTERISTIC
/begin CHARACTERISTIC FrmMng_swtBOS_Oil_C "Schalter zum deaktivieren der Message (0: aktiev, 1: inaktiev)" VALUE 0xD55A9 Kw_Wu8 1.000 OneToOne 0.00 1.000 FORMAT "%5.3" EXTENDED_LIMITS 0.00 255.0 /end CHARACTERISTIC
/begin CHARACTERISTIC FrmMng_swtBOS_PFlt_C "Schalter, um die Message BOS_MELDUNG_PFLT zu aktivieren (1...enabled,. 0...disabled)" VALUE 0xD55AA Kw_Wu8 1.000 OneToOne 0.00 1.000 FORMAT "%5.3" EXTENDED_LIMITS 0.00 255.0 /end CHARACTERISTIC
/begin CHARACTERISTIC FrmMng_swtBOS_RESET_2_C "Schalter zum deaktivieren der Auswertung der Message (1: aktiev, 0: inaktiev)" VALUE 0xD55AB Kw_Wu8 1.000 OneToOne 0.00 1.000 FORMAT "%5.3" EXTENDED_LIMITS 0.00 255.0 /end CHARACTERISTIC
/begin CHARACTERISTIC FrmMng_swtBOS_RESET_C "Schalter zum deaktivieren der auswertung von BOS_RESET (1: aktiev, 0: deaktiev)" VALUE 0xD55AC Kw_Wu8 1.000 OneToOne 0.00 1.000 FORMAT "%5.3" EXTENDED_LIMITS 0.00 255.0 /end CHARACTERISTIC
/begin CHARACTERISTIC FrmMng_swtCalcV_C "Radgeschwindigkeiten zur Mitelwertsbildung herangezogen (0...nicht, 1...herangezogen)  Bit0: LV, Bit1: RV, Bit2: LH, Bit3: RH" VALUE 0xD55AD Kw_Wu8 15.00 OneToOne 0.00 15.00 FORMAT "%5.2" EXTENDED_LIMITS 0.00 255.0 /end CHARACTERISTIC
/begin CHARACTERISTIC FrmMng_swtCarType_C "Schaltet CAN zwischen 0: E60, 1: E65 und 2: E90" VALUE 0xD55AE Kw_Wu8 2.00000000000 CarType 0.00 2.00000000000 FORMAT "%13.11" EXTENDED_LIMITS 0.00 4.00000000000 /end CHARACTERISTIC
/begin CHARACTERISTIC FrmMng_swtCCMsg_C "Unterdrücken aller Checkcontrol Meldungen (0=AUS, 1...EIN)" VALUE 0xD55AF Kw_Wu8 1.000 OneToOne 0.00 1.000 FORMAT "%5.3" EXTENDED_LIMITS 0.00 255.0 /end CHARACTERISTIC
/begin CHARACTERISTIC FrmMng_swtCCNoCrCtl_C "Setzten/Löschen der Checkcontrol Meldung Geschwindigkeitsregelung ohne Funktion (1...setzen,. 0...löschen)" VALUE 0xD55B0 Kw_Wu8 1.000 OneToOne 0.00 1.000 FORMAT "%5.3" EXTENDED_LIMITS 0.00 255.0 /end CHARACTERISTIC
/begin CHARACTERISTIC FrmMng_swtCorTrqACC_C "Schalter zur Korrektur von FrmMng_trqACC_TrqDes mit Gearbx_trqFrc (1...Korrektur, 0...keine Korrektur)" VALUE 0xD55B1 Kw_Wu8 1.000 OneToOne 0.00 1.000 FORMAT "%5.3" EXTENDED_LIMITS 0.00 255.0 /end CHARACTERISTIC
/begin CHARACTERISTIC FrmMng_swtCorTrqDSC_C "Schalter zur Korrektur des DSC-Moment durch Gearbx_trqFrc (1...Korrektur, 0...keine Korrektur)" VALUE 0xD55B2 Kw_Wu8 1.000 OneToOne 0.00 1.000 FORMAT "%5.3" EXTENDED_LIMITS 0.00 255.0 /end CHARACTERISTIC
/begin CHARACTERISTIC FrmMng_swtDCCSelfRec_C "Status Aktivierung Erkennung Empfang Radmomentanforderung Botschaft" VALUE 0xD55B3 Kw_Wu8 1.000 OneToOne 0.00 1.000 FORMAT "%5.3" EXTENDED_LIMITS 0.00 255.0 /end CHARACTERISTIC
/begin CHARACTERISTIC FrmMng_swtDMOMENT_ACC_C "#SSD Schalter zum deaktivieren der Message DREHMOMENT_ANF_ACC (1...enabled, 0...disabled)" VALUE 0xD55B4 Kw_Wu8 1.000 OneToOne 0.00 1.000 FORMAT "%5.3" EXTENDED_LIMITS 0.00 255.0 /end CHARACTERISTIC
/begin CHARACTERISTIC FrmMng_swtDM_ANF_AFS_C "Schalter zum aktivieren der Message DREHMOMENT_ANF_AFS (1...enabled, 0...disabled)" VALUE 0xD55B5 Kw_Wu8 1.000 OneToOne 0.00 1.000 FORMAT "%5.3" EXTENDED_LIMITS 0.00 255.0 /end CHARACTERISTIC
/begin CHARACTERISTIC FrmMng_swtDRMANFSSG_C "#SSD SChalter zum aktivieren der Message DREHMOMENT_ANF_SSG  (1...enabled, 0...disabled)" VALUE 0xD55B6 Kw_Wu8 1.000 OneToOne 0.00 1.000 FORMAT "%5.3" EXTENDED_LIMITS 0.00 255.0 /end CHARACTERISTIC
/begin CHARACTERISTIC FrmMng_swtENGINE1_C "Schalter zur Abschaltung der Berechnung von ENGINE1 (1...enabled, 0...disabled)" VALUE 0xD55B7 Kw_Wu8 1.000 OneToOne 0.00 1.000 FORMAT "%5.3" EXTENDED_LIMITS 0.00 255.0 /end CHARACTERISTIC
/begin CHARACTERISTIC FrmMng_swtENGINE_RPM_C "Aktivierung Botschaft ENGINE_RPM (1...enabled, 0...disableb)" VALUE 0xD55B8 Kw_Wu8 1.000 OneToOne 0.00 1.000 FORMAT "%5.3" EXTENDED_LIMITS 0.00 255.0 /end CHARACTERISTIC
/begin CHARACTERISTIC FrmMng_swtEngRpmTempSel_C "Schalter, um die Kuehler- oder die Motor Oel Temperatur auszuwaehlen (1...oel, 0...Kuehler)" VALUE 0xD55B9 Kw_Wu8 1.000 OneToOne 0.00 1.000 FORMAT "%5.3" EXTENDED_LIMITS 0.00 255.0 /end CHARACTERISTIC
/begin CHARACTERISTIC FrmMng_swtFDC_C "Schalter, um den FrmMng_stFDC- Wert auszuwählen (1...Applikationswert, 0...lokaler Wert)" VALUE 0xD55BA Kw_Wu8 1.000 OneToOne 0.00 1.000 FORMAT "%5.3" EXTENDED_LIMITS 0.00 255.0 /end CHARACTERISTIC
/begin CHARACTERISTIC FrmMng_swtGEARBX_DATA2_C "Schalter, um die Message GEARBX_DATA2 zu aktivieren (1...enabled,. 0...disabled)" VALUE 0xD55BB Kw_Wu8 1.000 OneToOne 0.00 1.000 FORMAT "%5.3" EXTENDED_LIMITS 0.00 255.0 /end CHARACTERISTIC
/begin CHARACTERISTIC FrmMng_swtGEARBX_DATA_C "Schalter um die Message  GEARBX_DATA zu aktivieren (1...enabled,. 0...disabled)" VALUE 0xD55BC Kw_Wu8 1.000 OneToOne 0.00 1.000 FORMAT "%5.3" EXTENDED_LIMITS 0.00 255.0 /end CHARACTERISTIC
/begin CHARACTERISTIC FrmMng_swtHEATINGCURRENT_C "Aktivierung und deaktivierung der Message HEATING_CURRENT (1...enabled,. 0...disabled)" VALUE 0xD55BD Kw_Wu8 1.000 OneToOne 0.00 1.000 FORMAT "%5.3" EXTENDED_LIMITS 0.00 255.0 /end CHARACTERISTIC
/begin CHARACTERISTIC FrmMng_swtHEAT_AC_C "Schalter, um die Message HEAT_AC zu aktivieren (1...enabled,. 0...disabled)" VALUE 0xD55BE Kw_Wu8 1.000 OneToOne 0.00 1.000 FORMAT "%5.3" EXTENDED_LIMITS 0.00 255.0 /end CHARACTERISTIC
/begin CHARACTERISTIC FrmMng_swtLENKRADWINKEL_C "Schalter, um die Message LENKRADWINKEL zu aktivieren (1...enabled,. 0...disabled)" VALUE 0xD55BF Kw_Wu8 1.000 OneToOne 0.00 1.000 FORMAT "%5.3" EXTENDED_LIMITS 0.00 255.0 /end CHARACTERISTIC
/begin CHARACTERISTIC FrmMng_swtMILEAGE_RANGE_C "Schalter, um die Message MILEAGE_RANGE zu aktivieren (1...enabled,. 0...disabled)" VALUE 0xD55C0 Kw_Wu8 1.000 OneToOne 0.00 1.000 FORMAT "%5.3" EXTENDED_LIMITS 0.00 255.0 /end CHARACTERISTIC
/begin CHARACTERISTIC FrmMng_swtOEL_MESS_C "" VALUE 0xD55C1 Kw_Wu8 1.000 OneToOne 0.00 1.000 FORMAT "%5.3" EXTENDED_LIMITS 0.00 255.0 /end CHARACTERISTIC
/begin CHARACTERISTIC FrmMng_swtOPCRCTLACC_C "Schalter, um die Message OP_CRCTLACC zu aktivieren (1...enabled,. 0...disabled)" VALUE 0xD55C2 Kw_Wu8 1.000 OneToOne 0.00 1.000 FORMAT "%5.3" EXTENDED_LIMITS 0.00 255.0 /end CHARACTERISTIC
/begin CHARACTERISTIC FrmMng_swtParkConsumer_C "Schalter, um die Message PWRMNG_STANDVBR zu aktivieren (1...enabled,. 0...disabled)" VALUE 0xD55C3 Kw_Wu8 1.000 OneToOne 0.00 1.000 FORMAT "%5.3" EXTENDED_LIMITS 0.00 255.0 /end CHARACTERISTIC
/begin CHARACTERISTIC FrmMng_swtPlausOn_C "Schalter, um die Momenteneingriffsmessage zu aktivieren (1...enabled,. 0...disabled)" VALUE 0xD55C4 Kw_Wu8 1.000 OneToOne 0.00 1.000 FORMAT "%5.3" EXTENDED_LIMITS 0.00 255.0 /end CHARACTERISTIC
/begin CHARACTERISTIC FrmMng_swtPOWERMGMTBATTSP_C "Schalter, um die Message POWERMGMT_BATTERIESPANNUNG zu aktivieren (1...enabled,. 0...disabled)" VALUE 0xD55C5 Kw_Wu8 1.000 OneToOne 0.00 1.000 FORMAT "%5.3" EXTENDED_LIMITS 0.00 255.0 /end CHARACTERISTIC
/begin CHARACTERISTIC FrmMng_swtPRGG_CCTR_C "Schalter, um die Message PRGG_CCTR zu aktivieren (1...enabled,. 0...disabled)" VALUE 0xD55C6 Kw_Wu8 1.000 OneToOne 0.00 1.000 FORMAT "%5.3" EXTENDED_LIMITS 0.00 255.0 /end CHARACTERISTIC
/begin CHARACTERISTIC FrmMng_swtPSPOffErr_C "Schalter, um die Message CTR_CR_SWO_EKP zu aktivieren (1...enabled,. 0...disabled)" VALUE 0xD55C7 Kw_Wu8 255.0 OneToOne 0.00 255.0 FORMAT "%5.1" /end CHARACTERISTIC
/begin CHARACTERISTIC FrmMng_swtPSPOff_C "Schalter, um die Message CTR_CRASH_SWO_EKP zu aktivieren (1...enabled,. 0...disabled)" VALUE 0xD55C8 Kw_Wu8 1.000 OneToOne 0.00 1.000 FORMAT "%5.3" EXTENDED_LIMITS 0.00 255.0 /end CHARACTERISTIC
/begin CHARACTERISTIC FrmMng_swtPWRMNG_CTR_COS_C "Schalter, um die Message PWRMNG_CTR_COS zu aktivieren (1...enabled,. 0...disabled)" VALUE 0xD55C9 Kw_Wu8 1.000 OneToOne 0.00 1.000 FORMAT "%5.3" EXTENDED_LIMITS 0.00 255.0 /end CHARACTERISTIC
/begin CHARACTERISTIC FrmMng_swtPWRMNG_LOADV_C "Schalter, um die Message PWRMNG_LOADV zu aktivieren (1...enabled,. 0...disabled)" VALUE 0xD55CA Kw_Wu8 1.000 OneToOne 0.00 1.000 FORMAT "%5.3" EXTENDED_LIMITS 0.00 255.0 /end CHARACTERISTIC
/begin CHARACTERISTIC FrmMng_swtRADMOM_PT1_C "Aktivierung der Botschaft RADMOM_PT_1" VALUE 0xD55CB Kw_Wu8 1.000 OneToOne 0.00 1.000 FORMAT "%5.3" EXTENDED_LIMITS 0.00 255.0 /end CHARACTERISTIC
/begin CHARACTERISTIC FrmMng_swtRADMOM_PT2_C "Aktivierung der Botschaft RADMOM_PT_2" VALUE 0xD55CC Kw_Wu8 1.000 OneToOne 0.00 1.000 FORMAT "%5.3" EXTENDED_LIMITS 0.00 255.0 /end CHARACTERISTIC
/begin CHARACTERISTIC FrmMng_swtRPM_STA_C "Schalter, um die Message RPM_STA zu aktivieren (1...enabled,. 0...disabled)" VALUE 0xD55CD Kw_Wu8 1.000 OneToOne 0.00 1.000 FORMAT "%5.3" EXTENDED_LIMITS 0.00 255.0 /end CHARACTERISTIC
/begin CHARACTERISTIC FrmMng_swtRQ_STG_EFAN_C "Schalter, um die Message PRQ_STG_EFAN zu aktivieren (1...enabled,. 0...disabled)" VALUE 0xD55CE Kw_Wu8 1.000 OneToOne 0.00 1.000 FORMAT "%5.3" EXTENDED_LIMITS 0.00 255.0 /end CHARACTERISTIC
/begin CHARACTERISTIC FrmMng_swtSITZGURT_C "Schalter, um die Message STAT_SITZBELEGUNG_GURT zu aktivieren (1...enabled,. 0...disabled)" VALUE 0xD55CF Kw_Wu8 1.000 OneToOne 0.00 1.000 FORMAT "%5.3" EXTENDED_LIMITS 0.00 255.0 /end CHARACTERISTIC
/begin CHARACTERISTIC FrmMng_swtSPEED_CLCTR_C "Schalter, um die cruise control Message zu aktivieren (1...enabled,. 0...disabled)" VALUE 0xD55D0 Kw_Wu8 1.000 OneToOne 0.00 1.000 FORMAT "%5.3" EXTENDED_LIMITS 0.00 255.0 /end CHARACTERISTIC
/begin CHARACTERISTIC FrmMng_swtSTAT_ANH_C "Schalter, um die Message STAT_ANH zu aktivieren (1...enabled,. 0...disabled)" VALUE 0xD55D1 Kw_Wu8 1.000 OneToOne 0.00 1.000 FORMAT "%5.3" EXTENDED_LIMITS 0.00 255.0 /end CHARACTERISTIC
/begin CHARACTERISTIC FrmMng_swtSTAT_ARS_C "Schalter, um die Message STAT_ARS zu aktivieren (1...enabled,. 0...disabled)" VALUE 0xD55D2 Kw_Wu8 1.000 OneToOne 0.00 1.000 FORMAT "%5.3" EXTENDED_LIMITS 0.00 255.0 /end CHARACTERISTIC
/begin CHARACTERISTIC FrmMng_swtSTAT_DSC_C "Schalter, um die Message STAT_DSC zu aktivieren (1...enabled,. 0...disabled)" VALUE 0xD55D3 Kw_Wu8 1.000 OneToOne 0.00 1.000 FORMAT "%5.3" EXTENDED_LIMITS 0.00 255.0 /end CHARACTERISTIC
/begin CHARACTERISTIC FrmMng_swtSTAT_EKP_C "Schalter, um die Message STAT_EKP zu aktivieren (1...enabled,. 0...disabled)" VALUE 0xD55D4 Kw_Wu8 1.000 OneToOne 0.00 1.000 FORMAT "%5.3" EXTENDED_LIMITS 0.00 255.0 /end CHARACTERISTIC
/begin CHARACTERISTIC FrmMng_swtSTAT_KOMBI_C "Schalter, um die Message STAT_KOMBI zu aktivieren (1...enabled,. 0...disabled)" VALUE 0xD55D5 Kw_Wu8 1.000 OneToOne 0.00 1.000 FORMAT "%5.3" EXTENDED_LIMITS 0.00 255.0 /end CHARACTERISTIC
/begin CHARACTERISTIC FrmMng_swtstCurr_C "Schalter, um die Message CODIERUNG_PM zu aktivieren (1...enabled,. 0...disabled)" VALUE 0xD55D6 Kw_Wu8 1.000 OneToOne 0.00 1.000 FORMAT "%5.3" EXTENDED_LIMITS 0.00 255.0 /end CHARACTERISTIC
/begin CHARACTERISTIC FrmMng_swtTEMPRELTIME_C "Schalter, um die Message A_TEMP_RELATIVZEIT zu aktivieren (1...enabled,. 0...disabled)" VALUE 0xD55D7 Kw_Wu8 1.000 OneToOne 0.00 1.000 FORMAT "%5.3" EXTENDED_LIMITS 0.00 255.0 /end CHARACTERISTIC
/begin CHARACTERISTIC FrmMng_swtTERMINAL_C "Schalter, um die Message TERMINAL zu aktivieren (1...enabled,. 0...disabled)" VALUE 0xD55D8 Kw_Wu8 1.000 OneToOne 0.00 1.000 FORMAT "%5.3" EXTENDED_LIMITS 0.00 255.0 /end CHARACTERISTIC
/begin CHARACTERISTIC FrmMng_swtTIME_DATE_C "Schalter, um die Message TIME_DATE zu aktivieren (1...enabled,. 0...disabled)" VALUE 0xD55D9 Kw_Wu8 1.000 OneToOne 0.00 1.000 FORMAT "%5.3" EXTENDED_LIMITS 0.00 255.0 /end CHARACTERISTIC
/begin CHARACTERISTIC FrmMng_swtTORQUE1_C "Schalter, um die Message TORQUE1 zu aktivieren (1...enabled,. 0...disabled)" VALUE 0xD55DA Kw_Wu8 1.000 OneToOne 0.00 1.000 FORMAT "%5.3" EXTENDED_LIMITS 0.00 255.0 /end CHARACTERISTIC
/begin CHARACTERISTIC FrmMng_swtTORQUE2_C "Schalter, um die Message TORQUE2 zu aktivieren (1...enabled,. 0...disabled)" VALUE 0xD55DB Kw_Wu8 1.000 OneToOne 0.00 1.000 FORMAT "%5.3" EXTENDED_LIMITS 0.00 255.0 /end CHARACTERISTIC
/begin CHARACTERISTIC FrmMng_swtTORQUE3_C "Schalter, um die Message TORQUE3 zu aktivieren (1...enabled,. 0...disabled)" VALUE 0xD55DC Kw_Wu8 1.000 OneToOne 0.00 1.000 FORMAT "%5.3" EXTENDED_LIMITS 0.00 255.0 /end CHARACTERISTIC
/begin CHARACTERISTIC FrmMng_swtTORQUE_DSC_C "Schalter, um die Message TORQUE_DSC zu aktivieren (1...enabled,. 0...disabled)" VALUE 0xD55DD Kw_Wu8 1.000 OneToOne 0.00 1.000 FORMAT "%5.3" EXTENDED_LIMITS 0.00 255.0 /end CHARACTERISTIC
/begin CHARACTERISTIC FrmMng_swtTORQUE_GEARBX_C "Schalter, um die Message TORQUE_GEARBX zu aktivieren (1...enabled,. 0...disabled)" VALUE 0xD55DE Kw_Wu8 1.000 OneToOne 0.00 1.000 FORMAT "%5.3" EXTENDED_LIMITS 0.00 255.0 /end CHARACTERISTIC
/begin CHARACTERISTIC FrmMng_swtVEH_MOD_C "Schalter, um die Message VEH_MOD zu aktivieren (1...enabled,. 0...disabled)" VALUE 0xD55DF Kw_Wu8 1.000 OneToOne 0.00 1.000 FORMAT "%5.3" EXTENDED_LIMITS 0.00 255.0 /end CHARACTERISTIC
/begin CHARACTERISTIC FrmMng_swtVELOCITY_C "Schalter, um die Message VELOCITY zu aktivieren (1...enabled,. 0...disabled)" VALUE 0xD55E0 Kw_Wu8 1.000 OneToOne 0.00 1.000 FORMAT "%5.3" EXTENDED_LIMITS 0.00 255.0 /end CHARACTERISTIC
/begin CHARACTERISTIC FrmMng_swtWHEEL_SPEED_C "Schalter, um die Wheel Speed Message zu aktivieren (1...enabled,. 0...disabled)" VALUE 0xD55E1 Kw_Wu8 1.000 OneToOne 0.00 1.000 FORMAT "%5.3" EXTENDED_LIMITS 0.00 255.0 /end CHARACTERISTIC
/begin CHARACTERISTIC FrmMng_cnvTEMP_EX_Offset_C "#SSD Offset to calculate TEMP_EX from CAN" VALUE 0xD55E2 Kw_Ws16 65535.00 OneToOne -32768.00 32767.00 FORMAT "%8.2" /end CHARACTERISTIC
/begin CHARACTERISTIC FrmMng_cnvTEMP_EX_Slope_C "#SSD Slope to calculate TEMP_EX from CAN" VALUE 0xD55E4 Kw_Ws16 655.3500 SlopeRes100 -327.6800 327.6700 FORMAT "%8.4" /end CHARACTERISTIC
/begin CHARACTERISTIC FrmMng_tEngLimHi_C "obere Temperaturschwelle für Motortemperatur" VALUE 0xD55E6 Kw_Ws16 250.0000 Temp_Cels -50.14000 199.8600 FORMAT "%8.4" EXTENDED_LIMITS -3549.940 3003.560 /end CHARACTERISTIC
/begin CHARACTERISTIC FrmMng_tEngLimLo_C "Untere Temperaturschwelle für Motortemperatur" VALUE 0xD55E8 Kw_Ws16 250.0000 Temp_Cels -50.14000 199.8600 FORMAT "%8.4" EXTENDED_LIMITS -3549.940 3003.560 /end CHARACTERISTIC
/begin CHARACTERISTIC FrmMng_tEnvDef_C "Defektwert für FrmMng_tEnvDef_C Botschaft" VALUE 0xD55EA Kw_Ws16 950.000 Temp_Cels -50.140 899.860 FORMAT "%8.3" EXTENDED_LIMITS -3549.940 3003.560 /end CHARACTERISTIC
/begin CHARACTERISTIC FrmMng_tiCCAddLevlCycle_C "#SSD Transmit cycle time in s for Checkcontroll message 11" VALUE 0xD55EC Kw_Wu8 13.00 Time_fulls 1.000 14.00 FORMAT "%5.2" EXTENDED_LIMITS 0.00 255.0 /end CHARACTERISTIC
/begin CHARACTERISTIC FrmMng_tiCCBrkDefCycle_C "Sendeart CC-Meldung Bremslichtschalter defekt" VALUE 0xD55ED Kw_Wu8 13.00 Time_fulls 1.000 14.00 FORMAT "%5.2" EXTENDED_LIMITS 0.00 255.0 /end CHARACTERISTIC
/begin CHARACTERISTIC FrmMng_tiCCbtnachCycle_C "#SSD Transmit cycle time in s for Checkcontroll message 17" VALUE 0xD55EE Kw_Wu8 13.00 Time_fulls 1.000 14.00 FORMAT "%5.2" EXTENDED_LIMITS 0.00 255.0 /end CHARACTERISTIC
/begin CHARACTERISTIC FrmMng_tiCCbttdfkCycle_C "#SSD Transmit cycle time in s for Checkcontroll message 19" VALUE 0xD55EF Kw_Wu8 13.00 Time_fulls 1.000 14.00 FORMAT "%5.2" EXTENDED_LIMITS 0.00 255.0 /end CHARACTERISTIC
/begin CHARACTERISTIC FrmMng_tiCCbttkntCycle_C "#SSD Transmit cycle time in s for Checkcontroll message 20" VALUE 0xD55F0 Kw_Wu8 13.00 Time_fulls 1.000 14.00 FORMAT "%5.2" EXTENDED_LIMITS 0.00 255.0 /end CHARACTERISTIC
/begin CHARACTERISTIC FrmMng_tiCCGenDef2Cycle_C "#SSD Transmit cycle time in s for Checkcontroll message 14" VALUE 0xD55F1 Kw_Wu8 13.00 Time_fulls 1.000 14.00 FORMAT "%5.2" EXTENDED_LIMITS 0.00 255.0 /end CHARACTERISTIC
/begin CHARACTERISTIC FrmMng_tiCCNoCrCtlCycle_C "#SSD Sendeart der Checkcontrol Meldung Geschwindigkeitsregelung ohne Funktion" VALUE 0xD55F2 Kw_Wu8 13.00 Time_fulls 1.000 14.00 FORMAT "%5.2" EXTENDED_LIMITS 0.00 255.0 /end CHARACTERISTIC
/begin CHARACTERISTIC FrmMng_tiCCOelLevlCycle_C "#SSD Transmit cycle time in s for Checkcontroll message 10" VALUE 0xD55F3 Kw_Wu8 13.00 Time_fulls 1.000 14.00 FORMAT "%5.2" EXTENDED_LIMITS 0.00 255.0 /end CHARACTERISTIC
/begin CHARACTERISTIC FrmMng_tiCCOelVerbCycle_C "#SSD Transmit cycle time in s for Checkcontroll message 8" VALUE 0xD55F4 Kw_Wu8 13.00 Time_fulls 1.000 14.00 FORMAT "%5.2" EXTENDED_LIMITS 0.00 255.0 /end CHARACTERISTIC
/begin CHARACTERISTIC FrmMng_tiCCOelVerlCycle_C "#SSD Transmit cycle time in s for Checkcontroll message 9" VALUE 0xD55F5 Kw_Wu8 13.00 Time_fulls 1.000 14.00 FORMAT "%5.2" EXTENDED_LIMITS 0.00 255.0 /end CHARACTERISTIC
/begin CHARACTERISTIC FrmMng_tiCCOilPresCycle_C "#SSD Transmit cycle time in s for Checkcontroll message 4" VALUE 0xD55F6 Kw_Wu8 13.00 Time_fulls 1.000 14.00 FORMAT "%5.2" EXTENDED_LIMITS 0.00 255.0 /end CHARACTERISTIC
/begin CHARACTERISTIC FrmMng_tiCCOvrTem2Cycle_C "#SSD Transmit cycle time in s for Checkcontroll message 6" VALUE 0xD55F7 Kw_Wu8 13.00 Time_fulls 1.000 14.00 FORMAT "%5.2" EXTENDED_LIMITS 0.00 255.0 /end CHARACTERISTIC
/begin CHARACTERISTIC FrmMng_tiCCOvrTempCycle_C "#SSD Transmit cycle time in s for Checkcontroll message 5" VALUE 0xD55F8 Kw_Wu8 13.00 Time_fulls 1.000 14.00 FORMAT "%5.2" EXTENDED_LIMITS 0.00 255.0 /end CHARACTERISTIC
/begin CHARACTERISTIC FrmMng_tiCCPFltDefCycle_C "#SSD Transmit cycle time in s for Checkcontroll message 12" VALUE 0xD55F9 Kw_Wu8 13.00 Time_fulls 1.000 14.00 FORMAT "%5.2" EXTENDED_LIMITS 0.00 255.0 /end CHARACTERISTIC
/begin CHARACTERISTIC FrmMng_tiCCpmerrCycle_C "#SSD Transmit cycle time in s for Checkcontroll message 18" VALUE 0xD55FA Kw_Wu8 13.00 Time_fulls 1.000 14.00 FORMAT "%5.2" EXTENDED_LIMITS 0.00 255.0 /end CHARACTERISTIC
/begin CHARACTERISTIC FrmMng_tiCCPreGlowCycle_C "#SSD Sendeart der Checkcontrol Meldung Vorglühen" VALUE 0xD55FB Kw_Wu8 13.00 Time_fulls 1.000 14.00 FORMAT "%5.2" EXTENDED_LIMITS 0.00 255.0 /end CHARACTERISTIC
/begin CHARACTERISTIC FrmMng_tiCCprioCycle_C "#SSD Transmit cycle time in s for Checkcontroll message 21" VALUE 0xD55FC Kw_Wu8 13.00 Time_fulls 1.000 14.00 FORMAT "%5.2" EXTENDED_LIMITS 0.00 255.0 /end CHARACTERISTIC
/begin CHARACTERISTIC FrmMng_tiCCruhverCycle_C "#SSD Transmit cycle time in s for Checkcontroll message 16" VALUE 0xD55FD Kw_Wu8 13.00 Time_fulls 1.000 14.00 FORMAT "%5.2" EXTENDED_LIMITS 0.00 255.0 /end CHARACTERISTIC
/begin CHARACTERISTIC FrmMng_tiCCStatMilCycle_C "#SSD Transmit cycle time in s for Checkcontroll message 7" VALUE 0xD55FE Kw_Wu8 13.00 Time_fulls 1.000 14.00 FORMAT "%5.2" EXTENDED_LIMITS 0.00 255.0 /end CHARACTERISTIC
/begin CHARACTERISTIC FrmMng_tiCCStatMilLmpTstCycle_C "#SSD Transmit cycle time in s for Checkcontroll message 34" VALUE 0xD55FF Kw_Wu8 13.00 Time_fulls 1.000 14.00 FORMAT "%5.2" EXTENDED_LIMITS 0.00 255.0 /end CHARACTERISTIC
/begin CHARACTERISTIC FrmMng_tiCCSysLampCycle_C "#SSD Sendeart der Checkcontrol Meldung Motornotprogramm" VALUE 0xD5600 Kw_Wu8 13.00 Time_fulls 1.000 14.00 FORMAT "%5.2" EXTENDED_LIMITS 0.00 255.0 /end CHARACTERISTIC
/begin CHARACTERISTIC FrmMng_tiCCTxDeb_C "#SSD Mindestentprelldauer zwischen zwei aufeinanderfolgende Checkcontrol Meldungen" VALUE 0xD5602 Kw_Wu16 1000.000 Time_ms 0.00 1000.000 FORMAT "%8.3" EXTENDED_LIMITS 0.00 655350.0 /end CHARACTERISTIC
/begin CHARACTERISTIC FrmMng_tiDebARS_C "Delay time for debouncing ASCquit" VALUE 0xD5604 Kw_Wu16 655350.0 Time_ms 0.00 655350.0 FORMAT "%8.1" /end CHARACTERISTIC
/begin CHARACTERISTIC FrmMng_tiDebDSC_C "Delay time for debouncing ASCquit" VALUE 0xD5606 Kw_Wu16 655350.0 Time_ms 0.00 655350.0 FORMAT "%8.1" /end CHARACTERISTIC
/begin CHARACTERISTIC FrmMng_tiDebEGS_C "Delay time for debouncing ASCquit" VALUE 0xD5608 Kw_Wu16 655350.0 Time_ms 0.00 655350.0 FORMAT "%8.1" /end CHARACTERISTIC
/begin CHARACTERISTIC FrmMng_tiDebHtgUpShutOff_C "Zeit Debounce für Heizungsabsperrvorrichtung" VALUE 0xD560A Kw_Wu16 655350.0 Time_ms 0.00 655350.0 FORMAT "%8.1" /end CHARACTERISTIC
/begin CHARACTERISTIC FrmMng_tiDebHtgUpShutOn_C "Zeit Debounce für Heizungsabsperrvorrichtung" VALUE 0xD560C Kw_Wu16 655350.0 Time_ms 0.00 655350.0 FORMAT "%8.1" /end CHARACTERISTIC
/begin CHARACTERISTIC FrmMng_tiDebSSGDebCltTO_C "Time duration for transmit debouncing" VALUE 0xD560E Kw_Wu16 1000.000 Time_ms 0.00 1000.000 FORMAT "%8.3" EXTENDED_LIMITS 0.00 655350.0 /end CHARACTERISTIC
/begin CHARACTERISTIC FrmMng_tiDebSSGErrDef_C "defect time for SSG signals plausibility error" VALUE 0xD5610 Kw_Wu16 655350.0 Time_ms 0.00 655350.0 FORMAT "%8.1" /end CHARACTERISTIC
/begin CHARACTERISTIC FrmMng_tiDebSSGErrOk_C "Healing time for SSG signals plausibility error" VALUE 0xD5612 Kw_Wu16 655350.0 Time_ms 0.00 655350.0 FORMAT "%8.1" /end CHARACTERISTIC
/begin CHARACTERISTIC FrmMng_tiDebSSGShftPla_C "Time duration for transmit debouncing" VALUE 0xD5614 Kw_Wu16 1000.000 Time_ms 0.00 1000.000 FORMAT "%8.3" EXTENDED_LIMITS 0.00 655350.0 /end CHARACTERISTIC
/begin CHARACTERISTIC FrmMng_tiDebSSGShOffDef_C "Defect time for SSG signals plausibility error" VALUE 0xD5616 Kw_Wu16 655350.0 Time_ms 0.00 655350.0 FORMAT "%8.1" /end CHARACTERISTIC
/begin CHARACTERISTIC FrmMng_tiDebSSGShOffOk_C "Healing time for SSG signals plausibility error" VALUE 0xD5618 Kw_Wu16 655350.0 Time_ms 0.00 655350.0 FORMAT "%8.1" /end CHARACTERISTIC
/begin CHARACTERISTIC FrmMng_tiDebSSGTrqIncPla_C "Time duration for transmit debouncing" VALUE 0xD561A Kw_Wu16 1000.000 Time_ms 0.00 1000.000 FORMAT "%8.3" EXTENDED_LIMITS 0.00 655350.0 /end CHARACTERISTIC
/begin CHARACTERISTIC FrmMng_tiRecACCMax_C "Time 10 ms quantum" VALUE 0xD561C Kw_Wu16 9980.000 Time_ms 20.00000 10000.00 FORMAT "%8.2" EXTENDED_LIMITS 0.00 655350.0 /end CHARACTERISTIC
/begin CHARACTERISTIC FrmMng_tiRecACMax_C "" VALUE 0xD561E Kw_Wu16 9980.000 Time_ms 20.00000 10000.00 FORMAT "%8.2" EXTENDED_LIMITS 0.00 655350.0 /end CHARACTERISTIC
/begin CHARACTERISTIC FrmMng_tiRecAFSMax_C "Time 10 ms quantum" VALUE 0xD5620 Kw_Wu16 9980.000 Time_ms 20.00000 10000.00 FORMAT "%8.2" EXTENDED_LIMITS 0.00 655350.0 /end CHARACTERISTIC
/begin CHARACTERISTIC FrmMng_tiRecARSMax_C "Time 10 ms quantum - ARS" VALUE 0xD5622 Kw_Wu16 9980.000 Time_ms 20.00000 10000.00 FORMAT "%8.2" EXTENDED_LIMITS 0.00 655350.0 /end CHARACTERISTIC
/begin CHARACTERISTIC FrmMng_tiRecDCCMax_C "Zeitfenster für Erkennung Empfang Radmomentanforderung-Botschaft" VALUE 0xD5624 Kw_Wu8 2380. Time_ms 20.00 2400. FORMAT "%5.0" EXTENDED_LIMITS 0.00 2550. /end CHARACTERISTIC
/begin CHARACTERISTIC FrmMng_tiRecFDCMax_C "Zeitfenster für Erkennug Empfang Fahrzeugmodus Botschaft" VALUE 0xD5626 Kw_Wu16 9980.000 Time_ms 20.00000 10000.00 FORMAT "%8.2" EXTENDED_LIMITS 0.00 655350.0 /end CHARACTERISTIC
/begin CHARACTERISTIC FrmMng_tiRecFGRMax_C "Maximum time for FGR recognition" VALUE 0xD5628 Kw_Wu16 9980.000 Time_ms 20.00000 10000.00 FORMAT "%8.2" EXTENDED_LIMITS 0.00 655350.0 /end CHARACTERISTIC
/begin CHARACTERISTIC FrmMng_tiStartDelay_C "Verzögerungszeit des Start Systems" VALUE 0xD562A Kw_Wu16 655350.0 Time_ms 0.00 655350.0 FORMAT "%8.1" /end CHARACTERISTIC
/begin CHARACTERISTIC FrmMng_trqARSCurDef_C "Error value for FrmMng_trqARSCur" VALUE 0xD562C Kw_Ws16 11000.00 TrqPrp -5000.000 6000.000 FORMAT "%8.3" EXTENDED_LIMITS -6553.600 6553.400 /end CHARACTERISTIC
/begin CHARACTERISTIC FrmMng_trqARSDesDef_C "applicationvalue for desired torque ARS in case of message error" VALUE 0xD562E Kw_Ws16 11000.00 TrqPrp -5000.000 6000.000 FORMAT "%8.3" EXTENDED_LIMITS -6553.600 6553.400 /end CHARACTERISTIC
/begin CHARACTERISTIC FrmMng_trqGearbxFrc_C "" VALUE 0xD5630 Kw_Ws16 1500.000 Trq -500.0000 1000.000 FORMAT "%8.3" EXTENDED_LIMITS -3276.800 3276.700 /end CHARACTERISTIC
/begin CHARACTERISTIC FrmMng_trqGearbxMaxSubs_C "#SSD Ersatzwert für maximales Getriebemoment im heat modus bei ausgefallenen CAN" VALUE 0xD5632 Kw_Ws16 1500.000 Trq -500.0000 1000.000 FORMAT "%8.3" EXTENDED_LIMITS -3276.800 3276.700 /end CHARACTERISTIC
/begin CHARACTERISTIC FrmMng_trqLiGovMin_C "tarque switch for evaluating ST_SW_WAUP signal" VALUE 0xD5634 Kw_Ws16 1500.000 Trq -500.0000 1000.000 FORMAT "%8.3" EXTENDED_LIMITS -3276.800 3276.700 /end CHARACTERISTIC
/begin CHARACTERISTIC FrmMng_trqSSGPlaThres_C "torque threhold" VALUE 0xD5636 Kw_Ws16 1500.000 Trq -500.0000 1000.000 FORMAT "%8.3" EXTENDED_LIMITS -3276.800 3276.700 /end CHARACTERISTIC
/begin CHARACTERISTIC FrmMng_tWaterVlv_C "" VALUE 0xD5638 Kw_Ws16 950.0000 Temp_Cels -50.1400 899.8600 FORMAT "%8.4" EXTENDED_LIMITS -3549.940 3003.560 /end CHARACTERISTIC
/begin CHARACTERISTIC FrmMng_ubtMin_C "minimale Batteriespannungsänderung um POWERMGMT_BATTERIESPANNUNG zu versenden" VALUE 0xD563A Kw_Wu8 3.8250000 spg_uw_q0p015 0.00 3.8250000 FORMAT "%9.7" /end CHARACTERISTIC
/begin CHARACTERISTIC FrmMng_vHtgUpActMax_C "velocity threshold for evaluating ST_SW_WAUP signal" VALUE 0xD563C Kw_Ws16 300.0000 Vel 0.00 300.0000 FORMAT "%8.4" EXTENDED_LIMITS -327.6800 327.6700 /end CHARACTERISTIC
/begin CHARACTERISTIC FrmMng_cnvvPrgNo_Offset_C "#SSD Offset for calculation V_PRGG_CCTR_IDX_NO_X from CAN" VALUE 0xD563E Kw_Ws16 65535.00 OneToOne -32768.00 32767.00 FORMAT "%8.2" /end CHARACTERISTIC
/begin CHARACTERISTIC FrmMng_cnvvPrgNo_Slope_C "#SSD Slope for calculation V_PRGG_CCTR_IDX_NO_X from CAN" VALUE 0xD5640 Kw_Ws16 655.3500 SlopeRes100 -327.6800 327.6700 FORMAT "%8.4" /end CHARACTERISTIC
/begin CHARACTERISTIC FrmMng_vSSGPlaThres_C "vehicle speed threhold" VALUE 0xD5642 Kw_Wu16 300.0000 Vel 0.00 300.0000 FORMAT "%8.4" EXTENDED_LIMITS 0.00 655.3500 /end CHARACTERISTIC
/begin MEASUREMENT FBC_AALOut_mp "Ausgang des Antialiasingfiler" FLOAT32_IEEE OneToOne 1 100 -150000000. 150000000. FORMAT "%10.0" ECU_ADDRESS 0x8FEF1C /end MEASUREMENT
/begin MEASUREMENT FBC_DXadpt_mp "aktuelle Adaptionsgüte" SWORD Dxs 1 100 -0.8192000 0.8191750 FORMAT "%9.7" ECU_ADDRESS 0x8FEF20 /end MEASUREMENT
/begin MEASUREMENT FBC_DXSfn_mp "Ausgang des negativen Bewertungsfilter" SWORD Dxs 1 100 -0.8192000 0.8191750 FORMAT "%9.7" ARRAY_SIZE 12 ECU_ADDRESS 0x8FEF22 /end MEASUREMENT
/begin MEASUREMENT FBC_DXSfp_mp "Ausgang des positiven Bewertungsfilter" SWORD Dxs 1 100 -0.8192000 0.8191750 FORMAT "%9.7" ARRAY_SIZE 12 ECU_ADDRESS 0x8FEF3A /end MEASUREMENT
/begin MEASUREMENT FBC_DXSf_mp "relative,aktuelle und gefilterte Zahnteilungsfehler (Adaptionsfilter)" SWORD Dxs 1 100 -0.8192000 0.8191750 FORMAT "%9.7" ARRAY_SIZE 12 ECU_ADDRESS 0x8FEF52 /end MEASUREMENT
/begin MEASUREMENT FBC_DXSl_mp "relative, gefilterte Zahnteilungsfehler (Adaptionsfilter, eingelernte Werte)" SWORD Dxs 1 100 -0.8192000 0.8191750 FORMAT "%9.7" ARRAY_SIZE 12 ECU_ADDRESS 0x6F80C4 /end MEASUREMENT
/begin MEASUREMENT FBC_DXS_mp "relative Zahnteilungsfehler (ungefiltert)" SWORD Dxs 1 100 -0.8192000 0.8191750 FORMAT "%9.7" ARRAY_SIZE 12 ECU_ADDRESS 0x8FEF6A /end MEASUREMENT
/begin MEASUREMENT FBC_Region_mp "Drehzahl-/Mengenbereich für ""regeln - steuern - inaktiv""" UBYTE OneToOne 1 100 0.00 255.0 FORMAT "%5.1" ECU_ADDRESS 0x8FEF82 /end MEASUREMENT
/begin MEASUREMENT FBC_stState_mp "Status des Zustandsautomates der Adaption" UBYTE FBC_LrnState 1 100 1.00000000000 5.00000000000 FORMAT "%13.11" ECU_ADDRESS 0x8FEF83 /end MEASUREMENT
/begin MEASUREMENT FlFCD_stFlFltDebVal "Entprellter Zustand des Kraftstofffilters" UBYTE OneToOne 1 100 0.00 255.0 FORMAT "%5.1" ECU_ADDRESS 0x7F8888 /end MEASUREMENT
/begin MEASUREMENT FlFCD_stFlFltRawVal "Unentprellter Zustand des Kraftstofffilters" UBYTE OneToOne 1 100 0.00 255.0 FORMAT "%5.1" ECU_ADDRESS 0x7F8889 /end MEASUREMENT
/begin MEASUREMENT FlMng_mAirPerCylFltSmk_mp "PT1 filtered air mass per cylinder" SWORD AirMassPerCyl 1 100 -3276.800 3276.700 FORMAT "%8.3" ECU_ADDRESS 0x8FEF8E /end MEASUREMENT
/begin MEASUREMENT FlMng_mAirPerCylLim_mp "begrenzte Luftmasse" SWORD AirMassPerCyl 1 100 -3276.800 3276.700 FORMAT "%8.3" ECU_ADDRESS 0x8FEF90 /end MEASUREMENT
/begin MEASUREMENT FlMng_qFullLdRgl "Korrekturmenge der Volllastregelung" SWORD InjMass 1 100 -327.6800 327.6700 FORMAT "%8.4" ECU_ADDRESS 0x7F8CC6 /end MEASUREMENT
/begin MEASUREMENT FlMng_qFullLdRglI_mp "I-Anteil der Vollastregelung" SLONG InjMass 1 100 -21474836.4800 21474836.4700 FORMAT "%13.4" ECU_ADDRESS 0x8FEF84 /end MEASUREMENT
/begin MEASUREMENT FlMng_qFullLdRglP_mp "P-Anteil der Vollastregelung" SWORD InjMass 1 100 -327.6800 327.6700 FORMAT "%8.4" ECU_ADDRESS 0x8FEF88 /end MEASUREMENT
/begin MEASUREMENT FlMng_qLimSmk "Begrenzungsmenge zur Rauchbegrenzung" SWORD InjMass 1 100 -327.6800 327.6700 FORMAT "%8.4" ECU_ADDRESS 0x7F8CC8 /end MEASUREMENT
/begin MEASUREMENT FlMng_qLimSmkDefect_mp "Quantity to detect and in the case of an detached charge air tube" SWORD InjMass 1 100 -327.6800 327.6700 FORMAT "%8.4" ECU_ADDRESS 0x8FEF92 /end MEASUREMENT
/begin MEASUREMENT FlMng_qLimSmk_mp "rauchabhängige Mengenbegrenzung" SWORD InjMass 1 100 -327.6800 327.6700 FORMAT "%8.4" ECU_ADDRESS 0x8FEF94 /end MEASUREMENT
/begin MEASUREMENT FlMng_rLmbdAPSCor_mp "Lambda-Korrekturwertes in Abhängigkeit des Umgebungsdrucks für die Rauchbegrenzung" SWORD lambda 1 100 -32.76800 32.76700 FORMAT "%8.5" ECU_ADDRESS 0x8FEF96 /end MEASUREMENT
/begin MEASUREMENT FlMng_rLmbdRecDvt_mp "Kehrwert der Lambdaabweichung bei Volllastregelung" SWORD lambdaRec 1 100 -3.276800 3.276700 FORMAT "%8.6" ECU_ADDRESS 0x8FEF8A /end MEASUREMENT
/begin MEASUREMENT FlMng_rLmbdSet "Stellgröße für Lambda-Regler" SWORD lambda 1 100 -32.76800 32.76700 FORMAT "%8.5" ECU_ADDRESS 0x7F8CCA /end MEASUREMENT
/begin MEASUREMENT FlMng_rLmbdSmk_mp "Lambda-Wert der Rauchbegrenzung" SWORD lambda 1 100 -32.76800 32.76700 FORMAT "%8.5" ECU_ADDRESS 0x8FEF98 /end MEASUREMENT
/begin MEASUREMENT FlMng_stCurrInp_mp "Status, welcher Eingang von EGT_RgnSwtE3 momentan berechnet werden muss" UBYTE OneToOne 1 100 0.00 255.0 FORMAT "%5.1" ECU_ADDRESS 0x8FEF9A /end MEASUREMENT
/begin MEASUREMENT FlMng_stDefect_mp "Current defect stat" UBYTE OneToOne 1 100 0.00 255.0 FORMAT "%5.1" ECU_ADDRESS 0x8FEF9B /end MEASUREMENT
/begin MEASUREMENT FlMng_stGearGroup_mp "Gear group status" SWORD OneToOne 1 100 -32768.00 32767.00 FORMAT "%8.2" ECU_ADDRESS 0x8FEF9C /end MEASUREMENT
/begin MEASUREMENT FlMng_stMon_mp "Status der Einschaltlogik und Überwachung der VOllastregellung" UBYTE OneToOne 1 100 0.00 255.0 FORMAT "%5.1" ECU_ADDRESS 0x8FEF8C /end MEASUREMENT
/begin MEASUREMENT FlMng_stSmkLim_mp "status of smoke limitation map switching" UBYTE OneToOne 1 100 0.00 255.0 FORMAT "%5.1" ECU_ADDRESS 0x8FEF9E /end MEASUREMENT
/begin MEASUREMENT FlMng_swtFullLdRgl "Schalter zur (de)aktivierung der Vollastregelung" UBYTE OneToOne 1 100 0.00 255.0 FORMAT "%5.1" ECU_ADDRESS 0x7F888A /end MEASUREMENT
/begin MEASUREMENT FlMng_tiAirPerCylPT1_mp "Time constant for PT1 filtering of air mass per cylinder" ULONG TimeDelay_s 1 100 0.0000010000000 4294.9673 FORMAT "%9.4" ECU_ADDRESS 0x8FEFA0 /end MEASUREMENT
/begin MEASUREMENT FlSys_rhoFl "Koeffizient Kraftstoffdichte" SWORD RhoFuel 1 100 -3276.800 3276.700 FORMAT "%8.3" ECU_ADDRESS 0x7F8CCE /end MEASUREMENT
/begin MEASUREMENT FlSys_stDeflate_mp "Aktivierung der Niederdruckentlueftung" UBYTE OneToOne 1 100 0.00 255.0 FORMAT "%5.1" ECU_ADDRESS 0x8FEFA4 /end MEASUREMENT
/begin MEASUREMENT FlSys_stTemp_mp "Statusbits zur Erfassung der Kraftstoffsystemtemperatur" UBYTE OneToOne 1 100 0.00 255.0 FORMAT "%5.1" ECU_ADDRESS 0x8FEFA5 /end MEASUREMENT
/begin MEASUREMENT FlSys_swtTempSensCfg "Schalter, ob Kraftstofftemperaturfühler vorhanden" UBYTE OneToOne 1 100 0.00 255.0 FORMAT "%5.1" ECU_ADDRESS 0x7F888B /end MEASUREMENT
/begin MEASUREMENT FlSys_t "aktuelle Systemtemperatur" SWORD Temp_Cels 1 100 -50.140 899.860 FORMAT "%8.3" ECU_ADDRESS 0x7F8CD0 /end MEASUREMENT
/begin MEASUREMENT FMA_dqAbs_mp "Absolutwert der Einspritzmengenänderung für FMA" SWORD InjMassSec 1 100 -327.6800 327.6700 FORMAT "%8.4" ECU_ADDRESS 0x8FEFB8 /end MEASUREMENT
/begin MEASUREMENT FMA_drLmbdAbs_mp "Absolutwert der Lambdaänderung für FMA" SWORD lambdaSec 1 100 -32.76800 32.76700 FORMAT "%8.5" ECU_ADDRESS 0x8FEFBA /end MEASUREMENT
/begin MEASUREMENT FMA_facAirSwtOff_mp "Ansauglufttemperaturabhängiger Abschaltfaktor der FMA" SWORD Fact 1 100 -4.000000 3.999878 FORMAT "%8.6" ECU_ADDRESS 0x8FEFBC /end MEASUREMENT
/begin MEASUREMENT FMA_facAPSwtOff_mp "Atmosphärendruckabhängiger Abschaltfaktor der FMA" SWORD Fact 1 100 -4.000000 3.999878 FORMAT "%8.6" ECU_ADDRESS 0x8FEFBE /end MEASUREMENT
/begin MEASUREMENT FMA_facEngSwtOff_mp "Motortemperaturabhängiger Abschaltfaktor der FMA" SWORD Fact 1 100 -4.000000 3.999878 FORMAT "%8.6" ECU_ADDRESS 0x8FEFC0 /end MEASUREMENT
/begin MEASUREMENT FMA_facFaultSwtOff_mp "Faktor für langsame FMA-Abschaltung bei schweren Systemfehlern" SWORD Fact 1 100 -4.000000 3.999878 FORMAT "%8.6" ECU_ADDRESS 0x8FEFC2 /end MEASUREMENT
/begin MEASUREMENT FMA_facFlSwtOff_mp "Kraftstofftemperaturabhängiger Abschaltfaktor der FMA" SWORD Fact 1 100 -4.000000 3.999878 FORMAT "%8.6" ECU_ADDRESS 0x8FEFC4 /end MEASUREMENT
/begin MEASUREMENT FMA_facNQSwtOff_mp "Drehzahl-/einspritzmengenabhängiger Abschaltfaktor der FMA für betriebsbereichsabhängige Abschaltung" SWORD Fact 1 100 -4.000000 3.999878 FORMAT "%8.6" ECU_ADDRESS 0x8FEFAC /end MEASUREMENT
/begin MEASUREMENT FMA_facRgnSwtOff_mp "Regenerations-/ Applikationsabhängiger Abschaltfaktor der FMA" SWORD Fact 1 100 -4.000000 3.999878 FORMAT "%8.6" ECU_ADDRESS 0x8FEFC6 /end MEASUREMENT
/begin MEASUREMENT FMA_facSlpSwtOff_mp "Abschaltfaktor der FMA, gebildet aus den 4 oberen Abschaltfaktoren" SWORD Fact 1 100 -4.000000 3.999878 FORMAT "%8.6" ECU_ADDRESS 0x8FEFC8 /end MEASUREMENT
/begin MEASUREMENT FMA_facSwtOff "Abschaltfaktor zum langsamen Aus- und Einschalten der FMA" SWORD Fact 1 100 -4.000000 3.999878 FORMAT "%8.6" ECU_ADDRESS 0x7F8C9E /end MEASUREMENT
/begin MEASUREMENT FMA_facSwtOffTot_mp "Gesamtabschaltfaktor zum langsamen Aus- und Einschalten der FMA" SWORD Fact 1 100 -4.000000 3.999878 FORMAT "%8.6" ECU_ADDRESS 0x8FEFAE /end MEASUREMENT
/begin MEASUREMENT FMA_qAct_mp "Aus Lambda- und Luftmassenmessung ermittelte Einspritzmenge. ""Wirkliche"" Einspritzmenge der FMA" SWORD InjMass 1 100 -327.6800 327.6700 FORMAT "%8.4" ECU_ADDRESS 0x8FEFA6 /end MEASUREMENT
/begin MEASUREMENT FMA_qCtl_mp "Für Bestimmung des Mengenfehlers verwendetes Mengensignal" SWORD InjMass 1 100 -327.6800 327.6700 FORMAT "%8.4" ECU_ADDRESS 0x8FEFAA /end MEASUREMENT
/begin MEASUREMENT FMA_qDC "Von FMA ermittelter Einspritzmengenfehler bzw. -korrekturwert für Betriebsart Direct Control (Modellfehler)" SWORD InjMass 1 100 -327.6800 327.6700 FORMAT "%8.4" ECU_ADDRESS 0x7F8CA0 /end MEASUREMENT
/begin MEASUREMENT FMA_qDev_mp "Abweichung der ""wirklichen"" Einspritzmenge von der gewünschten Einspritzmenge in der FMA" SWORD InjMass 1 100 -327.6800 327.6700 FORMAT "%8.4" ECU_ADDRESS 0x8FEFA8 /end MEASUREMENT
/begin MEASUREMENT FMA_qDiff_mp "Differenz aus Einspritzmengenfehler und aktuellem Kennfeldwert" SWORD InjMass 1 100 -327.6800 327.6700 FORMAT "%8.4" ECU_ADDRESS 0x8FEFB0 /end MEASUREMENT
/begin MEASUREMENT FMA_qErrMod_mp "Aus Fehlermodell ermittelter Rohwert des Einspritzmengenfehlers" SWORD InjMass 1 100 -327.6800 327.6700 FORMAT "%8.4" ECU_ADDRESS 0x8FEFB2 /end MEASUREMENT
/begin MEASUREMENT FMA_qIC "Von FMA ermittelter Einspritzmengenfehler bzw. -korrekturwert für Betriebsart Indirect Control (Modellfehler)" SWORD InjMass 1 100 -327.6800 327.6700 FORMAT "%8.4" ECU_ADDRESS 0x7F8CA2 /end MEASUREMENT
/begin MEASUREMENT FMA_qMapRow0_mp "Kennfeldwerte für erste Mengenstützstelle (erste zeile von adaptive Kennfeld)" SWORD InjMass 1 100 -327.6800 327.6700 FORMAT "%8.4" ARRAY_SIZE 8 ECU_ADDRESS 0x6F80DE /end MEASUREMENT
/begin MEASUREMENT FMA_qMapRow1_mp "Kennfeldwerte für zweite Mengenstützstelle (zweite zeile von adaptive Kennfeld)" SWORD InjMass 1 100 -327.6800 327.6700 FORMAT "%8.4" ARRAY_SIZE 8 ECU_ADDRESS 0x6F80EE /end MEASUREMENT
/begin MEASUREMENT FMA_qMapRow2_mp "Kennfeldwerte für dritte Mengenstützstelle (dritte zeile von adaptive Kennfeld)" SWORD InjMass 1 100 -327.6800 327.6700 FORMAT "%8.4" ARRAY_SIZE 8 ECU_ADDRESS 0x6F80FE /end MEASUREMENT
/begin MEASUREMENT FMA_qMapRow3_mp "Kennfeldwerte für vierte Mengenstützstelle (vierte zeile von adaptive Kennfeld)" SWORD InjMass 1 100 -327.6800 327.6700 FORMAT "%8.4" ARRAY_SIZE 8 ECU_ADDRESS 0x6F810E /end MEASUREMENT
/begin MEASUREMENT FMA_qMapRow4_mp "Kennfeldwerte für fünfte Mengenstützstelle (fünfte zeile von adaptive Kennfeld)" SWORD InjMass 1 100 -327.6800 327.6700 FORMAT "%8.4" ARRAY_SIZE 8 ECU_ADDRESS 0x6F811E /end MEASUREMENT
/begin MEASUREMENT FMA_qMapRow5_mp "Kennfeldwerte für sechste Mengenstützstelle (sechste zeile von adaptive Kennfeld)" SWORD InjMass 1 100 -327.6800 327.6700 FORMAT "%8.4" ARRAY_SIZE 8 ECU_ADDRESS 0x6F812E /end MEASUREMENT
/begin MEASUREMENT FMA_qMapRow6_mp "Kennfeldwerte für siebte Mengenstützstelle (siebte zeile von adaptive Kennfeld)" SWORD InjMass 1 100 -327.6800 327.6700 FORMAT "%8.4" ARRAY_SIZE 8 ECU_ADDRESS 0x6F813E /end MEASUREMENT
/begin MEASUREMENT FMA_qMapRow7_mp "Kennfeldwerte für achte Mengenstützstelle (achte zeile von adaptive Kennfeld)" SWORD InjMass 1 100 -327.6800 327.6700 FORMAT "%8.4" ARRAY_SIZE 8 ECU_ADDRESS 0x6F814E /end MEASUREMENT
/begin MEASUREMENT FMA_qReg_mp "Einspritzmengenfehler im aktuellen Lernbereich" SWORD InjMass 1 100 -327.6800 327.6700 FORMAT "%8.4" ECU_ADDRESS 0x8FEFB4 /end MEASUREMENT
/begin MEASUREMENT FMA_qSetFil_mp "Initialisierungswert für Integrierer bzw. PT1-Filter" SWORD InjMass 1 100 -327.6800 327.6700 FORMAT "%8.4" ECU_ADDRESS 0x8FEFB6 /end MEASUREMENT
/begin MEASUREMENT FMA_q_mp "Mit abshaltfactor multiplizierter Mengenfehler des Fehlermodells" SWORD InjMass 1 100 -327.6800 327.6700 FORMAT "%8.4" ECU_ADDRESS 0x6F80DC /end MEASUREMENT
/begin MEASUREMENT FMA_stDynDlyd_mp "FMA-Status: Aktuell oder vor kurzem starke Änderung der Einspritzmenge (verzögerte Einspritzmengendynamik)" UBYTE OneToOne 1 100 0.00 255.0 FORMAT "%5.1" ECU_ADDRESS 0x8FEFCA /end MEASUREMENT
/begin MEASUREMENT FMA_stDynLmbd_mp "FMA- Status: Aktuell oder bis vor kurzem starke Lambdaänderung" UBYTE OneToOne 1 100 0.00 255.0 FORMAT "%5.1" ECU_ADDRESS 0x8FEFCB /end MEASUREMENT
/begin MEASUREMENT FMA_stNoAdapt_mp "Status: Adaption des FMA-Fehlermodells angehalten" UWORD OneToOne 1 100 0.00 65535.00 FORMAT "%8.2" ECU_ADDRESS 0x8FEFCC /end MEASUREMENT
/begin MEASUREMENT FMA_stOvrRunDlyd_mp "FMA-Status: Aktuell oder bis vor kurzem Schubbetrieb (verzögerter Schubbetrieb)" UBYTE OneToOne 1 100 0.00 255.0 FORMAT "%5.1" ECU_ADDRESS 0x8FEFCE /end MEASUREMENT
/begin MEASUREMENT FMA_stReset_mp "Status: FMA-Fehlermodell wird zurückgesetzt" UBYTE OneToOne 1 100 0.00 255.0 FORMAT "%5.1" ECU_ADDRESS 0x8FEFCF /end MEASUREMENT
/begin MEASUREMENT FMA_stRngLmbd_mp "FMA_ Status: Lambda aktuell oder bis vor kurzem außerhalb" UBYTE OneToOne 1 100 0.00 255.0 FORMAT "%5.1" ECU_ADDRESS 0x8FEFD0 /end MEASUREMENT
/begin MEASUREMENT FMA_stSwtOff "Abschaltzustand der FMA" UWORD OneToOne 1 100 0.00 65535.00 FORMAT "%8.2" ECU_ADDRESS 0x7F8CA4 /end MEASUREMENT
/begin MEASUREMENT FMA_tiFuncOp_mp "Betriebszeit des Fehlermodells seit der letzten Initialisierung der Lernwerte" SLONG Time_s 1 100 -21474836.4800 21474836.4700 FORMAT "%13.4" ECU_ADDRESS 0x6F8160 /end MEASUREMENT
/begin MEASUREMENT FMTC_etaCurr "aktueller Wirkunggsgrad (korrigiert)" SWORD Eta 1 100 -256.0000 255.9922 FORMAT "%8.4" ECU_ADDRESS 0x7F8CA6 /end MEASUREMENT
/begin MEASUREMENT FMTC_etaCurrStd "aktueller Standard-Wirkungsgradfaktor (ohne Regenerationsmaßnahmen)" SWORD Eta 1 100 -256.0000 255.9922 FORMAT "%8.4" ECU_ADDRESS 0x7F8CA8 /end MEASUREMENT
/begin MEASUREMENT FMTC_facAirCor_mp "Eta-Korrekturfaktor für die Frischluft pro Zylinder" SWORD Fact 1 100 -4.000000 3.999878 FORMAT "%8.6" ECU_ADDRESS 0x8FEFD2 /end MEASUREMENT
/begin MEASUREMENT FMTC_facEtaCor "aktueller Wirkungsgradkorrekturwert" SWORD Fact 1 100 -4.000000 3.999878 FORMAT "%8.6" ECU_ADDRESS 0x7F8CAA /end MEASUREMENT
/begin MEASUREMENT FMTC_facStrtInjCor_mp "Eta-Korrekturfaktor für den Spritzbeginn" SWORD Fact 1 100 -4.000000 3.999878 FORMAT "%8.6" ECU_ADDRESS 0x8FEFD4 /end MEASUREMENT
/begin MEASUREMENT FMTC_mAirDiff_mp "Differenz Luftmasse optimal-aktueller Wert" SWORD AirMassPerCyl 1 100 -3276.800 3276.700 FORMAT "%8.3" ECU_ADDRESS 0x8FEFD6 /end MEASUREMENT
/begin MEASUREMENT FMTC_mAirOpt_mp "Eta-Korrektur, Referenzwert für die Luft pro Zylinder" SWORD AirMassPerCyl 1 100 -3276.800 3276.700 FORMAT "%8.3" ECU_ADDRESS 0x8FEFD8 /end MEASUREMENT
/begin MEASUREMENT FMTC_phiStrtInjDiff_mp "Differenz Spritzbeginn optimal-aktueller Wert" SWORD AngleCrS 1 100 -768.0000 767.9766 FORMAT "%8.4" ECU_ADDRESS 0x8FEFDA /end MEASUREMENT
/begin MEASUREMENT FMTC_phiStrtInjOpt_mp "aktueller Seferenzwert für Spritzbeginnkorrektur" SWORD AngleCrS 1 100 -768.0000 767.9766 FORMAT "%8.4" ECU_ADDRESS 0x8FEFDC /end MEASUREMENT
/begin MEASUREMENT FMTC_qCurr "Einspritzmenge aktueller Wert" SWORD InjMass 1 100 -327.6800 327.6700 FORMAT "%8.4" ECU_ADDRESS 0x7F8CAC /end MEASUREMENT
/begin MEASUREMENT FMTC_qDes "Einspritzmenge Wunschwert" SWORD InjMass 1 100 -327.6800 327.6700 FORMAT "%8.4" ECU_ADDRESS 0x7F8CAE /end MEASUREMENT
/begin MEASUREMENT FMTC_qRaw "Einspritzmenge Rohwert (>Luftsystem)" SWORD InjMass 1 100 -327.6800 327.6700 FORMAT "%8.4" ECU_ADDRESS 0x7F8CB0 /end MEASUREMENT
/begin MEASUREMENT FMTC_qSet "Einspritzmenge Sollwert (>Einspritzung)" SWORD InjMass 1 100 -327.6800 327.6700 FORMAT "%8.4" ECU_ADDRESS 0x7F8CB2 /end MEASUREMENT
/begin MEASUREMENT FMTC_qSetOptStd_mp "optimale Standardsollmenge ohne Korrekturen" SWORD InjMass 1 100 -327.6800 327.6700 FORMAT "%8.4" ECU_ADDRESS 0x8FEFDE /end MEASUREMENT
/begin MEASUREMENT FMTC_qSetRgn1_mp "Regenerationseinspritzmenge Sollwert mit Berücksichtigung einer Regenerationsanforderung 1 der Abgasnachbehandlung" SWORD InjMass 1 100 -327.6800 327.6700 FORMAT "%8.4" ECU_ADDRESS 0x8FEFE0 /end MEASUREMENT
/begin MEASUREMENT FMTC_qSetRgn2_mp "Regenerationseinspritzmenge Sollwert mit Berücksichtigung einer Regenerationsanforderung 2 der Abgasnachbehandlung" SWORD InjMass 1 100 -327.6800 327.6700 FORMAT "%8.4" ECU_ADDRESS 0x8FEFE2 /end MEASUREMENT
/begin MEASUREMENT FMTC_qSetStd_mp "Standardeinspritzmenge Sollwert ohne Berücksichtigung der Regenerationsanforderung der Abgasnachbehandlung" SWORD InjMass 1 100 -327.6800 327.6700 FORMAT "%8.4" ECU_ADDRESS 0x8FEFE4 /end MEASUREMENT
/begin MEASUREMENT FMTC_qStrt "Einspritzmenge Startwert" SWORD InjMass 1 100 -327.6800 327.6700 FORMAT "%8.4" ECU_ADDRESS 0x7F8CB4 /end MEASUREMENT
/begin MEASUREMENT FMTC_trqInr "aktuelles rückgerechnetes inneres Motormoment" SWORD Trq 1 100 -3276.800 3276.700 FORMAT "%8.3" ECU_ADDRESS 0x7F8CB6 /end MEASUREMENT
/begin MEASUREMENT FMTC_trqInrLimSmk "Begrenzungsmoment Rauchgrenze" SWORD Trq 1 100 -3276.800 3276.700 FORMAT "%8.3" ECU_ADDRESS 0x7F8CB8 /end MEASUREMENT
/begin FUNCTION fbc_wheellrn "Antialiasingfilter und Geberradadaption"
 /begin DEF_CHARACTERISTIC FBC_AACoeff_C FBC_AAOrd_C FBC_Act_C FBC_DXadptl_C FBC_DXadptu_C FBC_DXalf0_C FBC_nLrnThres_C FBC_nThresFbc_C FBC_TFlrn_C FBC_TF_C FBC_ThresDyn_C FBC_TSm_C /end DEF_CHARACTERISTIC
 /begin OUT_MEASUREMENT FBC_AALOut_mp FBC_DXadpt_mp FBC_DXSfn_mp FBC_DXSfp_mp FBC_DXSf_mp FBC_DXSl_mp FBC_DXS_mp FBC_Region_mp FBC_stState_mp /end OUT_MEASUREMENT
/end FUNCTION
/begin FUNCTION fbc_wheellrn_uic "" /begin DEF_CHARACTERISTIC FBC_lrn_Vector FBC_lrn_Channel /end DEF_CHARACTERISTIC /end FUNCTION
/begin FUNCTION flfcd "Kraftstoffilter Komponententreiber"
 /begin DEF_CHARACTERISTIC FlFCD_numDioIn_C FlFCD_swtFlFltInv_C FlFCD_swtFlFltSens_C FlFCD_tiDebFlFltDef_C FlFCD_tiDebFlFltOk_C FlFCD_tiFlFltDebNeg_C FlFCD_tiFlFltDebPos_C /end DEF_CHARACTERISTIC
/end FUNCTION
/begin FUNCTION flfcd_msg "" /begin OUT_MEASUREMENT FlFCD_stFlFltDebVal FlFCD_stFlFltRawVal /end OUT_MEASUREMENT /end FUNCTION
/begin FUNCTION flfcd_uic "" /end FUNCTION
/begin FUNCTION flmng "Gemischbildung"
 /begin DEF_CHARACTERISTIC FlMng_tiDebSmkDefectDef_C FlMng_tiDebSmkDefectOk_C FlMng_dqLimUp_C FlMng_dqLimDwn_C FlMng_dSmkLimUp_C FlMng_dSmkLimDwn_C FlMng_facAPSCorNeg_CUR FlMng_facAPSCorPos_CUR FlMng_facLmbdAPSCor_CUR FlMng_facLmbdATSCor_CUR FlMng_facLmbdETSCor_CUR FlMng_mAirPerCylMin_C FlMng_numRevEng_C FlMng_pThresLmbd0_C FlMng_pThresLmbd1_C FlMng_pThresLmbd2_C FlMng_qDefectMin_MAP FlMng_qDefectOfs_C FlMng_qEngTemp_CUR FlMng_rLmbdAPSCor_MAP FlMng_rLmbdATSCor_MAP FlMng_rLmbdETSCor_MAP FlMng_rLmbdSmk2FDC_MAP FlMng_rLmbdSmk2UpperGbxFDC_MAP FlMng_rLmbdSmk2UpperGbx_MAP FlMng_rLmbdSmk2_MAP FlMng_rLmbdSmkFDC_MAP FlMng_rLmbdSmkRgn1_MAP FlMng_rLmbdSmkRgn2_MAP FlMng_rLmbdSmkUpperGbxFDC_MAP FlMng_rLmbdSmkUpperGbx_MAP FlMng_rLmbdSmk_MAP FlMng_stGearGroupSwitch_C FlMng_stRgnMsk1_C FlMng_stRgnMsk2_C FlMng_tiAirPerCylPT1_MAP FlMng_tiDefectDead_C FlMng_tiPT1Neg_MAP FlMng_tiPT1Pos_MAP FlMng_tiRmpSlp_C FlMng_trqThresInrDes0_C FlMng_trqThresInrDes1_C FlMng_trqThresInrDes2_C FlMng_trqThresInr_C FlMng_tThresLmbdHigh_C FlMng_tThresLmbdLow_C /end DEF_CHARACTERISTIC
 /begin IN_MEASUREMENT APSCD_pVal ASMod_mAirPerCylCorr Eng_nAvrg Eng_tEng FlMng_mAirPerCylFltSmk_mp IATSCD_tAir PCR_pBGDev /end IN_MEASUREMENT
/end FUNCTION
/begin FUNCTION flmng_fullldrgl "Volllastreglung"
 /begin DEF_CHARACTERISTIC FlMng_FullLdRglIKi_CUR FlMng_qFullLdRglMax_C FlMng_qFullLdRglMin_C FlMng_FullLdRglPKp_CUR FlMng_rLmbdRecDvtMax_C FlMng_rLmbdRecDvtMin_C FlMng_dqSlpPos_C FlMng_dqSlpNeg_C FlMng_stEGTRglOff_C FlMng_swtFullLdRglVal_C FlMng_swtFullLdRglType_C FlMng_tiFullLdRglDel_CUR FlMng_trqEpsLim_C FlMng_trqEps_C /end DEF_CHARACTERISTIC
 /begin IN_MEASUREMENT Eng_nAvrg /end IN_MEASUREMENT
/end FUNCTION
/begin FUNCTION flmng_fullldrgl_msg "" /begin OUT_MEASUREMENT FlMng_qFullLdRgl FlMng_swtFullLdRgl /end OUT_MEASUREMENT /end FUNCTION
/begin FUNCTION flmng_fullldrgl_uic ""
 /begin OUT_MEASUREMENT FlMng_qFullLdRglI_mp FlMng_qFullLdRglP_mp FlMng_rLmbdRecDvt_mp FlMng_stMon_mp /end OUT_MEASUREMENT
/end FUNCTION
/begin FUNCTION flmng_fullldrgl_var "" /end FUNCTION
/begin FUNCTION flmng_fullldrgl_var_uic "" /end FUNCTION
/begin FUNCTION flmng_msg "" /begin OUT_MEASUREMENT FlMng_qLimSmk FlMng_rLmbdSet /end OUT_MEASUREMENT /end FUNCTION
/begin FUNCTION flmng_uic ""
 /begin OUT_MEASUREMENT FlMng_mAirPerCylFltSmk_mp FlMng_mAirPerCylLim_mp FlMng_qLimSmkDefect_mp FlMng_qLimSmk_mp FlMng_rLmbdAPSCor_mp FlMng_rLmbdSmk_mp FlMng_stCurrInp_mp FlMng_stDefect_mp FlMng_stGearGroup_mp FlMng_stSmkLim_mp FlMng_tiAirPerCylPT1_mp /end OUT_MEASUREMENT
/end FUNCTION
/begin FUNCTION flmng_var "" /end FUNCTION
/begin FUNCTION flmng_var_uic "" /end FUNCTION
/begin FUNCTION flsys_calccnvfac "Berechnung Umwandlungsfaktor von Einspritzmenge nach Einspritzvolumen" /begin DEF_CHARACTERISTIC FlSys_rhoFl_C FlSys_rhoFl_CUR /end DEF_CHARACTERISTIC /begin IN_MEASUREMENT FTSCD_tFuel /end IN_MEASUREMENT /end FUNCTION
/begin FUNCTION flsys_calccnvfac_msg "" /begin OUT_MEASUREMENT FlSys_rhoFl /end OUT_MEASUREMENT /end FUNCTION
/begin FUNCTION flsys_calccnvfac_uic "" /end FUNCTION
/begin FUNCTION flsys_deflate "Entlueftung des Niederdruckkreislaufs"
 /begin DEF_CHARACTERISTIC FlSys_nDeflateMax_C FlSys_nDeflateMin_C FlSys_pDeflate_C FlSys_tiDeflateDel_C /end DEF_CHARACTERISTIC
/end FUNCTION
/begin FUNCTION flsys_deflate_uic "" /begin OUT_MEASUREMENT FlSys_stDeflate_mp /end OUT_MEASUREMENT /end FUNCTION
/begin FUNCTION flsys_shofftst "Test des niederdruckseitigen Abstellpfades" /end FUNCTION
/begin FUNCTION flsys_shofftst_uic "" /end FUNCTION
/begin FUNCTION flsys_temp "Kraftstoffsystem-Temperatur"
 /begin DEF_CHARACTERISTIC FlSys_swtTempSel_C FlSys_swtTempSensCfgVal_C FlSys_swtTempSensCfgType_C FlSys_tDfl_C /end DEF_CHARACTERISTIC
/end FUNCTION
/begin FUNCTION flsys_temp_msg "" /begin OUT_MEASUREMENT FlSys_swtTempSensCfg FlSys_t /end OUT_MEASUREMENT /end FUNCTION
/begin FUNCTION flsys_temp_uic "" /begin OUT_MEASUREMENT FlSys_stTemp_mp /end OUT_MEASUREMENT /end FUNCTION
/begin FUNCTION fma_adapt "Mengenmittelwertadaption - Adaption des Einspritzmengen-Fehlermodells" /begin DEF_CHARACTERISTIC FMA_facDensCor_C /end DEF_CHARACTERISTIC /end FUNCTION
/begin FUNCTION fma_adapt_uic "" /begin OUT_MEASUREMENT FMA_qAct_mp FMA_qDev_mp /end OUT_MEASUREMENT /end FUNCTION
/begin FUNCTION fma_ctlcalc "Mengenmittelwertadaption - Berechnung des Einspritzmengenfehlers mittels adaptiver Steuerung" /begin DEF_CHARACTERISTIC FMA_swtIC_C /end DEF_CHARACTERISTIC /end FUNCTION
/begin FUNCTION fma_ctlcalc_msg "" /begin OUT_MEASUREMENT FMA_qDC FMA_qIC /end OUT_MEASUREMENT /end FUNCTION
/begin FUNCTION fma_ctlcalc_uic "" /begin OUT_MEASUREMENT FMA_qCtl_mp FMA_q_mp /end OUT_MEASUREMENT /end FUNCTION
/begin FUNCTION fma_errmod "Mengenmittelwertadaption - Algoithmen für Adaption und Auswertung des Fehlermodells für FMA_Adapt und FMA_CtlCalc"
 /begin DEF_CHARACTERISTIC FMA_facNQSwtOff_MAP FMA_IKiFst_C FMA_IKiPosFst_C FMA_IKiNegFst_C FMA_qIWinPosFst_C FMA_qIWinNegFst_C FMA_IKiSlw_C FMA_IKiPosSlw_C FMA_IKiNegSlw_C FMA_qIWinPosSlw_C FMA_qIWinNegSlw_C FMA_nGrid_C FMA_numNGrid_C FMA_numQGrid_C FMA_tiPT1Fst_C FMA_tiPT1Slw_C FMA_qGrid_C FMA_qIntMax_C FMA_qIntMin_C FMA_qMax_C FMA_qMin_C FMA_swtRst_C FMA_tiSwtPar_C /end DEF_CHARACTERISTIC
 /begin IN_MEASUREMENT Eng_nAvrg FMA_qCtl_mp /end IN_MEASUREMENT
 /begin OUT_MEASUREMENT FMA_qMapRow0_mp FMA_qMapRow1_mp FMA_qMapRow2_mp FMA_qMapRow3_mp FMA_qMapRow4_mp FMA_qMapRow5_mp FMA_qMapRow6_mp FMA_qMapRow7_mp /end OUT_MEASUREMENT
/end FUNCTION
/begin FUNCTION fma_errmod_uic ""
 /begin OUT_MEASUREMENT FMA_facNQSwtOff_mp FMA_facSwtOffTot_mp FMA_qDiff_mp FMA_qErrMod_mp FMA_qReg_mp FMA_qSetFil_mp FMA_tiFuncOp_mp /end OUT_MEASUREMENT
/end FUNCTION
/begin FUNCTION fma_monitor "Mengenmittelwertadaption - Überwachung und Abschaltung"
 /begin DEF_CHARACTERISTIC FMA_dfacSwtOffMax_C FMA_dqThrs_C FMA_drLmbdThrs_C FMA_facAirSwtOff_CUR FMA_facAPSwtOff_CUR FMA_facEngSwtOff_CUR FMA_facFlSwtOff_CUR FMA_nThrs_C FMA_qThrs_C FMA_rLmbdThrsMax_C FMA_rLmbdThrsMin_C FMA_stRgnMsk_C FMA_swtOnFMA_C FMA_tiDLmbdThrs_C FMA_tiDynThrs_C FMA_tiFaultRmp_C FMA_tiLmbdDT1_C FMA_tiLmbdThrs_C FMA_tiOvrRun_C FMA_tiQDT1_C FMA_tiQLmbd_C /end DEF_CHARACTERISTIC
 /begin IN_MEASUREMENT APSCD_pVal Eng_tEng FTSCD_tFuel IATSCD_tAir /end IN_MEASUREMENT
/end FUNCTION
/begin FUNCTION fma_monitor_msg "" /begin OUT_MEASUREMENT FMA_facSwtOff FMA_stSwtOff /end OUT_MEASUREMENT /end FUNCTION
/begin FUNCTION fma_monitor_uic ""
 /begin OUT_MEASUREMENT FMA_dqAbs_mp FMA_drLmbdAbs_mp FMA_facAirSwtOff_mp FMA_facAPSwtOff_mp FMA_facEngSwtOff_mp FMA_facFaultSwtOff_mp FMA_facFlSwtOff_mp FMA_facRgnSwtOff_mp FMA_facSlpSwtOff_mp FMA_stDynDlyd_mp FMA_stDynLmbd_mp FMA_stNoAdapt_mp FMA_stOvrRunDlyd_mp FMA_stReset_mp FMA_stRngLmbd_mp /end OUT_MEASUREMENT
/end FUNCTION
/begin FUNCTION fmtc "Masse/Momenten-Wandler"
 /begin DEF_CHARACTERISTIC FMTC_dqtrq2qBasRmpUp_C FMTC_dqtrq2qBasRmpDwn_C FMTC_eta0_C FMTC_stRgnMsk1_C FMTC_stRgnMsk2_C FMTC_tiRmpSlp_C FMTC_trq2qBasCBOpn_MAP FMTC_trq2qBas_MAP FMTC_trq2qRgn1_MAP FMTC_trq2qRgn2_MAP /end DEF_CHARACTERISTIC
 /begin IN_MEASUREMENT CoEng_trqInrSet Eng_nAvrg /end IN_MEASUREMENT
/end FUNCTION
/begin FUNCTION fmtc_calccorr "Berchnung des Wirkungsgrad Korrekturfaktors"
 /begin DEF_CHARACTERISTIC FMTC_facAirCorr_CUR FMTC_facAirCorr_MAP FMTC_facStrtInjCorr_CUR FMTC_facStrtInjCorr_MAP FMTC_mAirOpt_MAP FMTC_phiStrtInjOpt_MAP FMTC_swtCorr_C /end DEF_CHARACTERISTIC
 /begin IN_MEASUREMENT CoEng_trqInrSet Eng_nAvrg FMTC_mAirDiff_mp FMTC_phiStrtInjDiff_mp /end IN_MEASUREMENT
/end FUNCTION
/begin FUNCTION fmtc_calccorr_msg "" /begin OUT_MEASUREMENT FMTC_facEtaCor /end OUT_MEASUREMENT /end FUNCTION
/begin FUNCTION fmtc_calccorr_uic ""
 /begin OUT_MEASUREMENT FMTC_facAirCor_mp FMTC_facStrtInjCor_mp FMTC_mAirDiff_mp FMTC_mAirOpt_mp FMTC_phiStrtInjDiff_mp FMTC_phiStrtInjOpt_mp /end OUT_MEASUREMENT
/end FUNCTION
/begin FUNCTION fmtc_msg ""
 /begin OUT_MEASUREMENT FMTC_etaCurr FMTC_etaCurrStd FMTC_qCurr FMTC_qDes FMTC_qRaw FMTC_qSet FMTC_qStrt FMTC_trqInr FMTC_trqInrLimSmk /end OUT_MEASUREMENT
/end FUNCTION
/begin FUNCTION fmtc_uic ""
 /begin OUT_MEASUREMENT FMTC_qSetOptStd_mp FMTC_qSetRgn1_mp FMTC_qSetRgn2_mp FMTC_qSetStd_mp /end OUT_MEASUREMENT
/end FUNCTION
/begin FUNCTION frmmng "CAN Message Frames für Übertragung und Empfang"
 /begin DEF_CHARACTERISTIC FrmMng_ACCSelfRec_C FrmMng_ACSelfRec_C FrmMng_aDirectDef_C FrmMng_AFSSelfRec_C FrmMng_ARSSelfRec_C FrmMng_aSideDef_C FrmMng_cnvAccmLimTrq_Offset_C FrmMng_cnvAccmLimTrq_Slope_C FrmMng_cnvACCtrq_Offset_C FrmMng_cnvACCtrq_Slope_C FrmMng_cnvAVA_DSC_Offset_C FrmMng_cnvAVA_DSC_Slope_C FrmMng_cnvLN_DSC_Offset_C FrmMng_cnvLN_DSC_Slope_C FrmMng_cnvAFStrq_Offset_C FrmMng_cnvAFStrq_Slope_C FrmMng_cnvAipEng_Offset_C FrmMng_cnvAipEng_Slope_C FrmMng_cnvAngAcpd_Offset_C FrmMng_cnvAngAcpd_Slope_C FrmMng_cnvAPP_Offset_C FrmMng_cnvAPP_Slope_C FrmMng_cnvARStrq_Offset_C FrmMng_cnvARStrq_Slope_C FrmMng_cnvDCCtrq_Offset_C FrmMng_cnvDCCtrq_Slope_C FrmMng_cnvdLRADWINKStrg_Offset_C FrmMng_cnvdLRADWINKStrg_Slope_C FrmMng_cnvDSCtrq_Offset_C FrmMng_cnvDSCtrq_Slope_C FrmMng_cnvIjvFu_Offset_C FrmMng_cnvIjvFu_Slope_C FrmMng_cnvKOMBIv_Offset_C FrmMng_cnvKOMBIv_Slope_C FrmMng_cnvLimRpmEng_Offset_C FrmMng_cnvLimRpmEng_Slope_C FrmMng_cnvLRADWINKStrg_Offset_C FrmMng_cnvLRADWINKStrg_Slope_C FrmMng_cnvnEngRpm_Offset_C FrmMng_cnvnEngRpm_Slope_C FrmMng_cnvnSetpoint_Offset_C FrmMng_cnvnSetpoint_Slope_C FrmMng_cnvpBrkSys_Offset_C FrmMng_cnvpBrkSys_Slope_C FrmMng_cnvrHtFlow_Offset_C FrmMng_cnvrHtFlow_Slope_C FrmMng_cnvRpmEng_Offset_C FrmMng_cnvRpmEng_Slope_C FrmMng_cnvRPM_GRB_TURB_Offset_C FrmMng_cnvRPM_GRB_TURB_Slope_C FrmMng_cnvRqamFu_Offset_C FrmMng_cnvRqamFu_Slope_C FrmMng_cnvrTransDT_Offset_C FrmMng_cnvrTransDT_Slope_C FrmMng_cnvrWaterVlv_Offset_C FrmMng_cnvrWaterVlv_Slope_C FrmMng_cnvTempEng_Offset_C FrmMng_cnvTempEng_Slope_C FrmMng_cnvtOil_Offset_C FrmMng_cnvtOil_Slope_C FrmMng_cnvTrqAvl_Offset_C FrmMng_cnvTrqAvl_Slope_C FrmMng_cnvTrqDvch_Offset_C FrmMng_cnvTrqDvch_Slope_C FrmMng_cnvtrqWheel_Offset_C FrmMng_cnvtrqWheel_Slope_C FrmMng_cnvtrq_Offset_C FrmMng_cnvtrq_Slope_C FrmMng_cnvvMrk_Offset_C FrmMng_cnvvMrk_Slope_C FrmMng_cnvV_VEH_Offset_C FrmMng_cnvV_VEH_Slope_C FrmMng_cnv_BattCls_Offset_C FrmMng_cnv_BattCls_Slope_C FrmMng_cnv_HiLimCurr_Offset_C FrmMng_cnv_HiLimCurr_Slope_C FrmMng_cnv_LoLimCurr_Offset_C FrmMng_cnv_LoLimCurr_Slope_C FrmMng_cnv_ZrCurrLim_Offset_C FrmMng_cnv_ZrCurrLim_Slope_C FrmMng_ctDebAlvDMANFAFSDef_C FrmMng_ctDebAlvDMANFAFSOk_C FrmMng_ctDebAlvDRMANFSSGDef_C FrmMng_ctDebAlvDRMANFSSGOk_C FrmMng_ctDebCsDMANFAFSDef_C FrmMng_ctDebCsDMANFAFSOk_C FrmMng_ctDebCsDRMANFSSGDef_C FrmMng_ctDebCsDRMANFSSGOk_C FrmMng_ctDebSigDMANFAFSDef_C FrmMng_ctDebSigDMANFAFSOk_C FrmMng_ctDebSigDRMANFSSGDef_C FrmMng_ctDebSigDRMANFSSGOk_C FrmMng_ctDebSigLRADWINKDef_C FrmMng_ctDebSigLRADWINKOk_C FrmMng_ctDebSigstCurrDef_C FrmMng_ctDebSigstCurrOk_C FrmMng_ctDebSigswtPSPOffDef_C FrmMng_ctDebSigswtPSPOffOk_C FrmMng_ctDebToDMANFAFSDef_C FrmMng_ctDebToDMANFAFSOk_C FrmMng_ctDebToDRMANFSSGDef_C FrmMng_ctDebToDRMANFSSGOk_C FrmMng_ctDebToLRADWINKDef_C FrmMng_ctDebToLRADWINKOk_C FrmMng_ctDebTostCurrDef_C FrmMng_ctDebTostCurrOk_C FrmMng_ctDebToswtPSPOffDef_C FrmMng_ctDebToswtPSPOffOk_C FrmMng_ctrRelDef_C FrmMng_cnvCTR_GEN_U_TAR_Offset_C FrmMng_cnvCTR_GEN_U_TAR_Slope_C FrmMng_DebACTrqDef_C FrmMng_DebACTrqOk_C FrmMng_DebAlvANFRADMOMPTDef_C FrmMng_DebAlvANFRADMOMPTOk_C FrmMng_DebAlvDMOMENT_ACCDef_C FrmMng_DebAlvDMOMENT_ACCOk_C FrmMng_DebAlvOPCRCTLACCDef_C FrmMng_DebAlvOPCRCTLACCOk_C FrmMng_DebAlvSTAT_ARSDef_C FrmMng_DebAlvSTAT_ARSOk_C FrmMng_DebAlvSTAT_KOMBIDef_C FrmMng_DebAlvSTAT_KOMBIOk_C FrmMng_DebAlvTERMINALDef_C FrmMng_DebAlvTERMINALOk_C FrmMng_DebAlvTORQUE_DSCDef_C FrmMng_DebAlvTORQUE_DSCOk_C FrmMng_DebAlvTORQUE_GEARBXDef_C FrmMng_DebAlvTORQUE_GEARBXOk_C FrmMng_DebAlvVEH_MODDef_C FrmMng_DebAlvVEH_MODOk_C FrmMng_DebCsANFRADMOMPTDef_C FrmMng_DebCsANFRADMOMPTOk_C FrmMng_DebCsDMOMENT_ACCDef_C FrmMng_DebCsDMOMENT_ACCOk_C FrmMng_DebCsOPCRCTLACCDef_C FrmMng_DebCsOPCRCTLACCOk_C FrmMng_DebCsTERMINALDef_C FrmMng_DebCsTERMINALOk_C FrmMng_DebCsTORQUE_DSCDef_C FrmMng_DebCsTORQUE_DSCOk_C FrmMng_DebCsTORQUE_GEARBXDef_C FrmMng_DebCsTORQUE_GEARBXOk_C FrmMng_DebCsVEH_MODDef_C FrmMng_DebCsVEH_MODOk_C FrmMng_DebSigANFRADMOMPTDef_C FrmMng_DebSigANFRADMOMPTOk_C FrmMng_DebSigBOS_RESET_2Def_C FrmMng_DebSigBOS_RESET_2Ok_C FrmMng_DebSigBOS_RESETDef_C FrmMng_DebSigBOS_RESETOk_C FrmMng_DebSigDMOMENT_ACCDef_C FrmMng_DebSigDMOMENT_ACCOk_C FrmMng_DebSigGEARBX_DATA2Def_C FrmMng_DebSigGEARBX_DATA2Ok_C FrmMng_DebSigGEARBX_DATADef_C FrmMng_DebSigGEARBX_DATAOk_C FrmMng_DebSigHEAT_ACDef_C FrmMng_DebSigHEAT_ACOk_C FrmMng_DebSigMILEAGE_RANGEDef_C FrmMng_DebSigMILEAGE_RANGEOk_C FrmMng_DebSigOPCRCTLACCDef_C FrmMng_DebSigOPCRCTLACCOk_C FrmMng_DebSigParkConsumerDef_C FrmMng_DebSigParkConsumerOk_C FrmMng_DebSigPRGG_CCTRDef_C FrmMng_DebSigPRGG_CCTROk_C FrmMng_DebSigPWRMNG_LOADVDef_C FrmMng_DebSigPWRMNG_LOADVOk_C FrmMng_DebSigRQ_STG_EFANDef_C FrmMng_DebSigRQ_STG_EFANOk_C FrmMng_ctDebSigSITZGURTDef_C FrmMng_ctDebSigSITZGURTOk_C FrmMng_DebSigSTAT_ANHDef_C FrmMng_DebSigSTAT_ANHOk_C FrmMng_DebSigSTAT_ARSDef_C FrmMng_DebSigSTAT_ARSOk_C FrmMng_DebSigSTAT_DSCDef_C FrmMng_DebSigSTAT_DSCOk_C FrmMng_DebSigSTAT_EKPDef_C FrmMng_DebSigSTAT_EKPOk_C FrmMng_DebSigSTAT_KOMBIDef_C FrmMng_DebSigSTAT_KOMBIOk_C FrmMng_ctDebOBDGbxMilOfDef_C FrmMng_ctDebSigStOBDGbxMilOfOk_C FrmMng_ctDebOBDGbxMilOnDef_C FrmMng_ctDebSigStOBDGbxMilOnOk_C FrmMng_DebSigTEMPRELTIMEDef_C FrmMng_DebSigTEMPRELTIMEOk_C FrmMng_DebSigTERMINALDef_C FrmMng_DebSigTERMINALOk_C FrmMng_DebSigTIME_DATEDef_C FrmMng_DebSigTIME_DATEOk_C FrmMng_DebSigTORQUE_DSCDef_C FrmMng_DebSigTORQUE_DSCOk_C FrmMng_DebSigTORQUE_GEARBXDef_C FrmMng_DebSigTORQUE_GEARBXOk_C FrmMng_DebSigVEH_MODDef_C FrmMng_DebSigVEH_MODOk_C FrmMng_DebSigVELOCITYDef_C FrmMng_DebSigVELOCITYOk_C FrmMng_ctDebSigWHEEL_SPEEDDef_C FrmMng_ctDebSigWHEEL_SPEEDOk_C FrmMng_DebTGearbxDef_C FrmMng_DebTGearbxOk_C FrmMng_DebToANFRADMOMPTDef_C FrmMng_DebToANFRADMOMPTOk_C FrmMng_DebToBOS_RESET_2Def_C FrmMng_DebToBOS_RESET_2Ok_C FrmMng_DebToBOS_RESETDef_C FrmMng_DebToBOS_RESETOk_C FrmMng_DebToDMOMENT_ACCDef_C FrmMng_DebToDMOMENT_ACCOk_C FrmMng_DebToGEARBX_DATA2Def_C FrmMng_DebToGEARBX_DATA2Ok_C FrmMng_DebToGEARBX_DATADef_C FrmMng_DebToGEARBX_DATAOk_C FrmMng_DebToHEAT_ACDef_C FrmMng_DebToHEAT_ACOk_C FrmMng_DebToMILEAGE_RANGEDef_C FrmMng_DebToMILEAGE_RANGEOk_C FrmMng_DebToOPCRCTLACCDef_C FrmMng_DebToOPCRCTLACCOk_C FrmMng_DebToParkConsumerDef_C FrmMng_DebToParkConsumerOk_C FrmMng_DebToPRGG_CCTRDef_C FrmMng_DebToPRGG_CCTROk_C FrmMng_DebToPWRMNG_LOADVDef_C FrmMng_DebToPWRMNG_LOADVOk_C FrmMng_DebToRQ_STG_EFANDef_C FrmMng_DebToRQ_STG_EFANOk_C FrmMng_ctDebToSITZGURTDef_C FrmMng_ctDebToSITZGURTOk_C FrmMng_DebToSTAT_ANHDef_C FrmMng_DebToSTAT_ANHOk_C FrmMng_DebToSTAT_ARSDef_C FrmMng_DebToSTAT_ARSOk_C FrmMng_DebToSTAT_DSCDef_C FrmMng_DebToSTAT_DSCOk_C FrmMng_DebToSTAT_EKPDef_C FrmMng_DebToSTAT_EKPOk_C FrmMng_DebToSTAT_KOMBIDef_C FrmMng_DebToSTAT_KOMBIOk_C FrmMng_DebToTEMPRELTIMEDef_C FrmMng_DebToTEMPRELTIMEOk_C FrmMng_DebToTERMINALDef_C FrmMng_DebToTERMINALOk_C FrmMng_DebToTIME_DATEDef_C FrmMng_DebToTIME_DATEOk_C FrmMng_DebToTORQUE_DSCDef_C FrmMng_DebToTORQUE_DSCOk_C FrmMng_DebToTORQUE_GEARBXDef_C FrmMng_DebToTORQUE_GEARBXOk_C FrmMng_DebToVEH_MODDef_C FrmMng_DebToVEH_MODOk_C FrmMng_DebToVELOCITYDef_C FrmMng_DebToVELOCITYOk_C FrmMng_ctDebToWHEEL_SPEEDDef_C FrmMng_ctDebToWHEEL_SPEEDOk_C FrmMng_drAPP1Min_C FrmMng_dstGear_C FrmMng_dTrqWheelRmpUp_C FrmMng_dTrqWheelRmpDwn_C FrmMng_factrqInrStrt_C FrmMng_FDCSelfRec_C FrmMng_FGRSelfRec_C FrmMng_cnvFLLV_FUTA_Offset_C FrmMng_cnvFLLV_FUTA_Slope_C FrmMng_mskDM_ANF_ACC_0x800_C FrmMng_mskDM_ANF_AFS_C FrmMng_mskDM_ANF_SSG_C FrmMng_mskSTAT_ARS_C FrmMng_mskTORQUE_DSC_C FrmMng_mskTORQUE_GEARBX_C FrmMng_nEngOFF_C FrmMng_nEngRpm1_CUR FrmMng_nEngRpm2_CUR FrmMng_nFanDflt_C FrmMng_nFan_CUR FrmMng_nHtgUpActMax_C FrmMng_nHtgUpCrCtlMax_C FrmMng_nLIGovOffs_C FrmMng_nLimSSGErr_C FrmMng_cnvnPSPSpd_Offset_C FrmMng_cnvnPSPSpd_Slope_C FrmMng_nRqStgEFan_CUR FrmMng_numACFanDesDef_C FrmMng_numCCAddLevlFlsh_C FrmMng_numCCAddLevlNum_C FrmMng_numCCBrkDefFlsh_C FrmMng_numCCBrkDefNum_C FrmMng_numCCbtnachFlsh_C FrmMng_numCCbtnachNum_C FrmMng_numCCbttdfkFlsh_C FrmMng_numCCbttdfkNum_C FrmMng_numCCbttkntFlsh_C FrmMng_numCCbttkntNum_C FrmMng_numCCGenDef2Flsh_C FrmMng_numCCGenDef2Num_C FrmMng_numCCNoCrCtlFlsh_C FrmMng_numCCNoCrCtlNum_C FrmMng_numCCOelLevlFlsh_C FrmMng_numCCOelLevlNum_C FrmMng_numCCOelVerbFlsh_C FrmMng_numCCOelVerbNum_C FrmMng_numCCOelVerlFlsh_C FrmMng_numCCOelVerlNum_C FrmMng_numCCOilPresFlsh_C FrmMng_numCCOilPresNum_C FrmMng_numCCOvrTem2Flsh_C FrmMng_numCCOvrTem2Num_C FrmMng_numCCOvrTempFlsh_C FrmMng_numCCOvrTempNum_C FrmMng_numCCPFltDefFlsh_C FrmMng_numCCPFltDefNum_C FrmMng_numCCpmerrFlsh_C FrmMng_numCCpmerrNum_C FrmMng_numCCPreGlowFlsh_C FrmMng_numCCPreGlowNum_C FrmMng_numCCprioFlsh_C FrmMng_numCCprioNum_C FrmMng_numCCruhverFlsh_C FrmMng_numCCruhverNum_C FrmMng_numCCStatMilFlsh_C FrmMng_numCCStatMilLmpTstFlsh_C FrmMng_numCCStatMilLmpTstNum_C FrmMng_numCCStatMilNum_C FrmMng_numCCSysLampFlsh_C FrmMng_numCCSysLampNum_C FrmMng_numInqyID_C FrmMng_numRecACCMax_C FrmMng_numRecACMax_C FrmMng_numRecAFSMax_C FrmMng_numRecARSMax_C FrmMng_numRecDCCMax_C FrmMng_numRecFDCMax_C FrmMng_numRecFGRMax_C FrmMng_dtrqOvrRunRmpUp_C FrmMng_dtrqOvrRunRmpDwn_C FrmMng_qOvrRun_C FrmMng_cnvrPSPSetPoint_Offset_C FrmMng_cnvrPSPSetPoint_Slope_C FrmMng_rWaterVlvClose_C FrmMng_rWaterVlvCtl_C FrmMng_rWaterVlvOpen_C FrmMng_stBltbDrDef_C FrmMng_stClCtrDEF_C FrmMng_stConvErr_C FrmMng_stFDC_C FrmMng_stGbxErr_C Frmmng_stGearbxHtgUpActMsk_C Frmmng_stGearHtgUpAct_C FrmMng_stKeyVldDef_C FrmMng_stRgnHtgUp_C FrmMng_stT15Def_C FrmMng_stT50Def_C FrmMng_Sttorqavl_Errval_C FrmMng_stTRadioDef_C FrmMng_stWghSeatDrDef_C FrmMng_swtANFRADMOMPT_C FrmMng_swtANFRAGE_C FrmMng_swtASDdc_C FrmMng_swtBOS_Oil_2_C FrmMng_swtBOS_Oil_C FrmMng_swtBOS_PFlt_C FrmMng_swtBOS_RESET_2_C FrmMng_swtBOS_RESET_C FrmMng_swtCalcV_C FrmMng_swtCarType_C FrmMng_swtCCMsg_C FrmMng_swtCCNoCrCtl_C FrmMng_swtCorTrqACC_C FrmMng_swtCorTrqDSC_C FrmMng_swtDCCSelfRec_C FrmMng_swtDMOMENT_ACC_C FrmMng_swtDM_ANF_AFS_C FrmMng_swtDRMANFSSG_C FrmMng_swtENGINE1_C FrmMng_swtENGINE_RPM_C FrmMng_swtEngRpmTempSel_C FrmMng_swtFDC_C FrmMng_swtGEARBX_DATA2_C FrmMng_swtGEARBX_DATA_C FrmMng_swtHEATINGCURRENT_C FrmMng_swtHEAT_AC_C FrmMng_swtLENKRADWINKEL_C FrmMng_swtMILEAGE_RANGE_C FrmMng_swtOEL_MESS_C FrmMng_swtOPCRCTLACC_C FrmMng_swtParkConsumer_C FrmMng_swtPlausOn_C FrmMng_swtPOWERMGMTBATTSP_C FrmMng_swtPRGG_CCTR_C FrmMng_swtPSPOffErr_C FrmMng_swtPSPOff_C FrmMng_swtPWRMNG_CTR_COS_C FrmMng_swtPWRMNG_LOADV_C FrmMng_swtRADMOM_PT1_C FrmMng_swtRADMOM_PT2_C FrmMng_swtRPM_STA_C FrmMng_swtRQ_STG_EFAN_C FrmMng_swtSITZGURT_C FrmMng_swtSPEED_CLCTR_C FrmMng_swtSTAT_ANH_C FrmMng_swtSTAT_ARS_C FrmMng_swtSTAT_DSC_C FrmMng_swtSTAT_EKP_C FrmMng_swtSTAT_KOMBI_C FrmMng_swtstCurr_C FrmMng_swtTEMPRELTIME_C FrmMng_swtTERMINAL_C FrmMng_swtTIME_DATE_C FrmMng_swtTORQUE1_C FrmMng_swtTORQUE2_C FrmMng_swtTORQUE3_C FrmMng_swtTORQUE_DSC_C FrmMng_swtTORQUE_GEARBX_C FrmMng_swtVEH_MOD_C FrmMng_swtVELOCITY_C FrmMng_swtWHEEL_SPEED_C FrmMng_cnvTEMP_EX_Offset_C FrmMng_cnvTEMP_EX_Slope_C FrmMng_tEngLimHi_C FrmMng_tEngLimLo_C FrmMng_tEnvDef_C FrmMng_tiCCAddLevlCycle_C FrmMng_tiCCBrkDefCycle_C FrmMng_tiCCbtnachCycle_C FrmMng_tiCCbttdfkCycle_C FrmMng_tiCCbttkntCycle_C FrmMng_tiCCGenDef2Cycle_C FrmMng_tiCCNoCrCtlCycle_C FrmMng_tiCCOelLevlCycle_C FrmMng_tiCCOelVerbCycle_C FrmMng_tiCCOelVerlCycle_C FrmMng_tiCCOilPresCycle_C FrmMng_tiCCOvrTem2Cycle_C FrmMng_tiCCOvrTempCycle_C FrmMng_tiCCPFltDefCycle_C FrmMng_tiCCpmerrCycle_C FrmMng_tiCCPreGlowCycle_C FrmMng_tiCCprioCycle_C FrmMng_tiCCruhverCycle_C FrmMng_tiCCStatMilCycle_C FrmMng_tiCCStatMilLmpTstCycle_C FrmMng_tiCCSysLampCycle_C FrmMng_tiCCTxDeb_C FrmMng_tiDebARS_C FrmMng_tiDebDSC_C FrmMng_tiDebEGS_C FrmMng_tiDebHtgUpShutOff_C FrmMng_tiDebHtgUpShutOn_C FrmMng_tiDebSSGDebCltTO_C FrmMng_tiDebSSGErrDef_C FrmMng_tiDebSSGErrOk_C FrmMng_tiDebSSGShftPla_C FrmMng_tiDebSSGShOffDef_C FrmMng_tiDebSSGShOffOk_C FrmMng_tiDebSSGTrqIncPla_C FrmMng_tiRecACCMax_C FrmMng_tiRecACMax_C FrmMng_tiRecAFSMax_C FrmMng_tiRecARSMax_C FrmMng_tiRecDCCMax_C FrmMng_tiRecFDCMax_C FrmMng_tiRecFGRMax_C FrmMng_tiStartDelay_C FrmMng_trqARSCurDef_C FrmMng_trqARSDesDef_C FrmMng_trqGearbxFrc_C FrmMng_trqGearbxMaxSubs_C FrmMng_trqLiGovMin_C FrmMng_trqSSGPlaThres_C FrmMng_tWaterVlv_C FrmMng_ubtMin_C FrmMng_vHtgUpActMax_C FrmMng_cnvvPrgNo_Offset_C FrmMng_cnvvPrgNo_Slope_C FrmMng_vSSGPlaThres_C /end DEF_CHARACTERISTIC
 /begin IN_MEASUREMENT FrmMng_numACFanDes FrmMng_numRqStgEFan FrmMng_tEngRpm_mp /end IN_MEASUREMENT
/end FUNCTION
/begin COMPU_METHOD Acc "Fahrzeugbeschleunigung" RAT_FUNC "%6.5" "m/s^2" COEFFS 0 1000 0 0 0 1 /end COMPU_METHOD
/begin COMPU_METHOD AirMassPerCyl "Luftmasse pro Zylinder" RAT_FUNC "%6.3" "mg/Hub" COEFFS 0 10 0 0 0 1 /end COMPU_METHOD
/begin COMPU_METHOD AngleCrS "Winkel Kurbelwelle" RAT_FUNC "%6.4" "deg CrS" COEFFS 0 42.6666666666667 0 0 0 1 /end COMPU_METHOD
/begin COMPU_METHOD AngleGrad "Winkelanzeige in Grad" RAT_FUNC "%6.4" "Grad" COEFFS 0 22.7531285551763 0 0 0 1 /end COMPU_METHOD
/begin COMPU_METHOD AngleGradPerSec "Winkelanzeige in Grad pro Sekunde" RAT_FUNC "%6.4" "Grad/s" COEFFS 0 22.7531285551763 0 0 0 1 /end COMPU_METHOD
/begin COMPU_METHOD CarType "" TAB_VERB "%6.3" "-" COMPU_TAB_REF CarType /end COMPU_METHOD
/begin COMPU_VTAB CarType "" TAB_VERB 5 0 "E60" 1 "E65" 2 "E90" 3 "E83" 4 "E87" /end COMPU_VTAB
/begin COMPU_METHOD DEZ "K3 Umwandlungen" RAT_FUNC "%6.2" "-" COEFFS 0 1 0 0 0 1 /end COMPU_METHOD
/begin COMPU_METHOD Dxs "Prozentsatz fuer DXs (-100% ... 100%)" RAT_FUNC "%7.6" "%" COEFFS 0 40000 0 0 0 1 /end COMPU_METHOD
/begin COMPU_METHOD EngN "Motordrehzahl" RAT_FUNC "%6.2" "rpm" COEFFS 0 1 0 0 0 1 /end COMPU_METHOD
/begin COMPU_METHOD Eta "Umrechnugsformel für Wirkungsgradfaktor eta" RAT_FUNC "%6.4" "Nm/(mg/cyc)" COEFFS 0 128 0 0 0 1 /end COMPU_METHOD
/begin COMPU_METHOD Fact "Faktor mit Auflösung 1 / 8192, hauptsächlich für einen Faktorenbereich 0...1 verwendet" RAT_FUNC "%6.5" "-" COEFFS 0 8192 0 0 0 1 /end COMPU_METHOD
/begin COMPU_METHOD FanSpd "(MAXSINT16 / FANSPD_MAX) * phys" RAT_FUNC "%6.3" "1/min" COEFFS 0 10.9223333333333 0 0 0 1 /end COMPU_METHOD
/begin COMPU_METHOD FBC_LrnState "Zustände des FBC Zustandsautomaten" TAB_VERB "%6.3" "-" COMPU_TAB_REF FBC_LrnState /end COMPU_METHOD
/begin COMPU_VTAB FBC_LrnState "Zustände des FBC Zustandsautomaten" TAB_VERB 5 1 "INIT   " 2 "DX_WAIT" 3 "LEARN  " 4 "APPLY  " 5 "DELAY  " /end COMPU_VTAB
/begin COMPU_METHOD FlConsum_l_h "Kraftstoffverbrauch" RAT_FUNC "%6.4" "l/h" COEFFS 0 100 0 0 0 1 /end COMPU_METHOD
/begin COMPU_METHOD FlConsum_ul "Verbrauchsintegral (in Mikroliter)" RAT_FUNC "%6.2" "ul" COEFFS 0 1 0 0 0 1 /end COMPU_METHOD
/begin COMPU_METHOD InjMass "Einspritzmenge" RAT_FUNC "%6.4" "mg/hub" COEFFS 0 100 0 0 0 1 /end COMPU_METHOD
/begin COMPU_METHOD InjMassCyc "Einspritzmenge pro Zyklus (mg/Zyklus)" RAT_FUNC "%6.4" "mg/cyc" COEFFS 0 100 0 0 0 1 /end COMPU_METHOD
/begin COMPU_METHOD InjMassInj "Einspritzmenge pro Einspritzung (mg/Einspritzung)" RAT_FUNC "%6.4" "mg/inj" COEFFS 0 100 0 0 0 1 /end COMPU_METHOD
/begin COMPU_METHOD InjMassSec "Einspritzmenge pro Sekunde" RAT_FUNC "%6.4" "mg/hub/s" COEFFS 0 100 0 0 0 1 /end COMPU_METHOD
/begin COMPU_METHOD i_ub_q0p001 "K3 Umwandlungen" RAT_FUNC "%5.4" "A" COEFFS 0 1 0 0 0 0.001 /end COMPU_METHOD
/begin COMPU_METHOD i_ub_q10p0 "K3 Umwandlungen" RAT_FUNC "%5.1" "A" COEFFS 0 1 0 0 0 10 /end COMPU_METHOD
/begin COMPU_METHOD Kd_rpm2Nm_1 "Diferenzieller Verstärkungsfaktor (Umdrehungen nach Moment), Umrechnung für sint16 Werte." RAT_FUNC "%6.4" "Nm/rpm" COEFFS 0 320 0 0 0 1 /end COMPU_METHOD
/begin COMPU_METHOD Ki "Integrale Verstärkung Ki (gleiche Einheit/Umrechnungsregel an Ein- und Ausgang)" RAT_FUNC "%6.5" "1/s" COEFFS 0 4294.967296 0 0 0 1 /end COMPU_METHOD
/begin COMPU_METHOD Ki_LmbdRec2InjMass "Integrationsverstärkung (reziprokes Lambda zu Einspritzmenge)" RAT_FUNC "%6.4" "mg/stroke/s" COEFFS 0 42.94967296 0 0 0 1 /end COMPU_METHOD
/begin COMPU_METHOD Kp_LmbdRec2InjMass_1 "Proportionale Verstärkung Kp (reziprokes Lambda zu Einspritzmenge)" RAT_FUNC "%6.4" "mg/stroke" COEFFS 0 81.92 0 0 0 1 /end COMPU_METHOD
/begin COMPU_METHOD lambda "Lambda" RAT_FUNC "%6.5" "-" COEFFS 0 1000 0 0 0 1 /end COMPU_METHOD
/begin COMPU_METHOD lambdaRec "Kehrwert von Lambda" RAT_FUNC "%7.6" "-" COEFFS 0 10000 0 0 0 1 /end COMPU_METHOD
/begin COMPU_METHOD lambdaSec "Lambda Aenderungsrate" RAT_FUNC "%6.5" "-/s" COEFFS 0 1000 0 0 0 1 /end COMPU_METHOD
/begin COMPU_METHOD NumPinDioIn "Verbale Umrechnung für Digitaleingang Signale" TAB_VERB "%6.3" "-" COMPU_TAB_REF NumPinDioIn /end COMPU_METHOD
/begin COMPU_VTAB NumPinDioIn "Verbale Umrechnung für Digitaleingang Signale" TAB_VERB 15 0 "Terminal_15_207" 1 "Main_Brake_Switch_236" 2 "Redundant_Brake_Switch_223" 3 "Clutch_Switch" 4 "Terminal_50_224" 5 "ECU_selection_Switch_251" 6 "FlFlt_Switch_211" 7 "Coolant-heater_212" 8 "Redundant_Terminal_15_209(118)" 9 "AC-compressor_overboost_213" 10 "Additive_tank_level_switch_235" 11 "Terminal_61_113" 12 "Lambda_Regeneration" 13 "Oil_Level_sensor_138" 14 "DIO_IN_DUMMY_NOT_USED" /end COMPU_VTAB
/begin COMPU_METHOD OneToOne "eins zu eins (physikalischer Wert ist gleich dem internen Wert)" RAT_FUNC "%6.2" "-" COEFFS 0 1 0 0 0 1 /end COMPU_METHOD
/begin COMPU_METHOD Prc "Prozent, gleiche interne Auflösung wie Fact, aber Darstellung in Prozent (0...100%)" RAT_FUNC "%6.4" "%" COEFFS 0 81.92 0 0 0 1 /end COMPU_METHOD
/begin COMPU_METHOD PrcPerSec "Prozentänderung pro Sekunde für 20ms-Tasks" RAT_FUNC "%6.3" "%/s" COEFFS 0 1.6384 0 0 0 1 /end COMPU_METHOD
/begin COMPU_METHOD Prc_float "Prozent Umrechnung für float" RAT_FUNC "%6.0" "%" COEFFS 0 0.01 0 0 0 1 /end COMPU_METHOD
/begin COMPU_METHOD Pres_bar "Druck (angezeigt in bar)" RAT_FUNC "%6.2" "bar" COEFFS 0 1 0 0 0 1 /end COMPU_METHOD
/begin COMPU_METHOD Pres_hPa "Druck (angezeigt in [hPa])" RAT_FUNC "%6.2" "hPa" COEFFS 0 1 0 0 0 1 /end COMPU_METHOD
/begin COMPU_METHOD Pres_Rail "Raildruck in hPa" RAT_FUNC "%4.3" "bar" COEFFS 0 10.000000 0 0 0 1 /end COMPU_METHOD
/begin COMPU_METHOD PSP_Spd "PSP speed in rpm" RAT_FUNC "%6.2" "rpm" COEFFS 0 1 0 0 0 1 /end COMPU_METHOD
/begin COMPU_METHOD RhoFuel "Kraftstoffdichte" RAT_FUNC "%6.3" "kg/m^3" COEFFS 0 10 0 0 0 1 /end COMPU_METHOD
/begin COMPU_METHOD RmpInjMass "Rampengradient für Einspritzmenge" RAT_FUNC "%6.5" "(mg/stroke)/s" COEFFS 0 6553.6 0 0 0 1 /end COMPU_METHOD
/begin COMPU_METHOD RmpTrq "Rampengradient für Motormoment" RAT_FUNC "%6.4" "Nm/s" COEFFS 0 655.36 0 0 0 1 /end COMPU_METHOD
/begin COMPU_METHOD RmpTrqPrp "Rampenanstieg für Vortriebsmoment [Nm/s]" RAT_FUNC "%6.4" "Nm/s" COEFFS 0 327.68 0 0 0 1 /end COMPU_METHOD
/begin COMPU_METHOD Rmp_Fact "Rampenfaktorgradient" RAT_FUNC "%8.7" "1/s" COEFFS 0 536870.912 0 0 0 1 /end COMPU_METHOD
/begin COMPU_METHOD SlopeRes10 "Umrechnung für Slope: Slopewert mit Verhältnis 0,1" RAT_FUNC "%6.3" "-" COEFFS 0 10 0 0 0 1 /end COMPU_METHOD
/begin COMPU_METHOD SlopeRes100 "Umrechnung für Slope: Slopewert mit Verhältnis 0,01" RAT_FUNC "%6.4" "-" COEFFS 0 100 0 0 0 1 /end COMPU_METHOD
/begin COMPU_METHOD SlopeRes1000 "Umrechnung für Slope: Slopewert mit Verhältnis 0,001" RAT_FUNC "%6.5" "-" COEFFS 0 1000 0 0 0 1 /end COMPU_METHOD
/begin COMPU_METHOD spg_uw_q0p015 "K3 Umwandlungen" RAT_FUNC "%9.5" "V" COEFFS 0 1 0 0 0 0.015 /end COMPU_METHOD
/begin COMPU_METHOD Temp_Cels "Temperatur dargestellt in °C (gleiche interne Darstellung wie Temp_Kelv)" RAT_FUNC "%6.1" "deg C" COEFFS 0 10 2731.4 0 0 1 /end COMPU_METHOD
/begin COMPU_METHOD TimeDeb "Entprellzeit in Millisekunden für Libraryfunktion Debounce" RAT_FUNC "%6.1" "ms" COEFFS 0 0.1 0 0 0 1 /end COMPU_METHOD
/begin COMPU_METHOD TimeDelay_s "Zeitkonstante T1 (in s) für PT1, DT1, etc." RAT_FUNC "%9.3" "s" COEFFS 0 0 1 0 0.00023283064365387 0 /end COMPU_METHOD
/begin COMPU_METHOD TimeDelay_s_2 "Zeitkonstante T1 (in s) für PT1, DT1, etc. normiert auf 16 bit" RAT_FUNC "%9.4" "s" COEFFS 0 0 1 0 0.0596046447753906 0 /end COMPU_METHOD
/begin COMPU_METHOD TimeEGTRmp "Umrechnung  Zeit in Rampensteigung,  Verwendet in EGT-Bibliothek" RAT_FUNC "%6.3" "s" COEFFS 0 0 1 0 0.0152587890625 0 /end COMPU_METHOD
/begin COMPU_METHOD Time_fulls "for application labels only in full seconds" RAT_FUNC "%6.2" "s" COEFFS 0 1 0 0 0 1 /end COMPU_METHOD
/begin COMPU_METHOD Time_ms "Zeit in ms für Fehlerentprellung (DSM) und SW-Timer" RAT_FUNC "%6.1" "ms" COEFFS 0 0.1 0 0 0 1 /end COMPU_METHOD
/begin COMPU_METHOD Time_s "Zeit in s für Fehlerentprellung (DSM) und SW-Timer" RAT_FUNC "%6.4" "s" COEFFS 0 100 0 0 0 1 /end COMPU_METHOD
/begin COMPU_METHOD TransR "Übersetzungsverhältnis (Getriebe etc.)" RAT_FUNC "%6.4" "-" COEFFS 0 100 0 0 0 1 /end COMPU_METHOD
/begin COMPU_METHOD Trq "Motormoment" RAT_FUNC "%6.3" "Nm" COEFFS 0 10 0 0 0 1 /end COMPU_METHOD
/begin COMPU_METHOD TrqPrp "Vortriebsmoment" RAT_FUNC "%6.3" "Nm" COEFFS 0 5 0 0 0 1 /end COMPU_METHOD
/begin COMPU_METHOD TrqPrpHigh "vortriebsmoment" RAT_FUNC "%6.2" "Nm" COEFFS 0 1 0 0 0 1 /end COMPU_METHOD
/begin COMPU_METHOD Vel "Fahrzeuggeschwindigkeit, gleiche interne Auflösung wie Vel_SI" RAT_FUNC "%6.4" "km/h" COEFFS 0 100 0 0 0 1 /end COMPU_METHOD
/begin RECORD_LAYOUT Kf_Xs16_Ys16_Ws16 NO_AXIS_PTS_X 1 SWORD NO_AXIS_PTS_Y 2 SWORD AXIS_PTS_X 3 SWORD INDEX_INCR DIRECT AXIS_PTS_Y 4 SWORD INDEX_INCR DIRECT FNC_VALUES 5 SWORD COLUMN_DIR DIRECT /end RECORD_LAYOUT
/begin RECORD_LAYOUT Kl_Xs16_Ws16 NO_AXIS_PTS_X 1 SWORD AXIS_PTS_X 2 SWORD INDEX_INCR DIRECT FNC_VALUES 3 SWORD COLUMN_DIR DIRECT /end RECORD_LAYOUT
/begin RECORD_LAYOUT Kwb_Wr32 FNC_VALUES 1 FLOAT32_IEEE COLUMN_DIR DIRECT /end RECORD_LAYOUT
/begin RECORD_LAYOUT Kwb_Ws16 FNC_VALUES 1 SWORD COLUMN_DIR DIRECT /end RECORD_LAYOUT
/begin RECORD_LAYOUT Kwb_Wu8 FNC_VALUES 1 UBYTE COLUMN_DIR DIRECT /end RECORD_LAYOUT
/begin RECORD_LAYOUT Kw_Wr32 FNC_VALUES 1 FLOAT32_IEEE COLUMN_DIR DIRECT /end RECORD_LAYOUT
/begin RECORD_LAYOUT Kw_Ws16 FNC_VALUES 1 SWORD COLUMN_DIR DIRECT /end RECORD_LAYOUT
/begin RECORD_LAYOUT Kw_Ws32 FNC_VALUES 1 SLONG COLUMN_DIR DIRECT /end RECORD_LAYOUT
/begin RECORD_LAYOUT Kw_Wu16 FNC_VALUES 1 UWORD COLUMN_DIR DIRECT /end RECORD_LAYOUT
/begin RECORD_LAYOUT Kw_Wu32 FNC_VALUES 1 ULONG COLUMN_DIR DIRECT /end RECORD_LAYOUT
/begin RECORD_LAYOUT Kw_Wu8 FNC_VALUES 1 UBYTE COLUMN_DIR DIRECT /end RECORD_LAYOUT
/end MODULE
/end PROJECT
