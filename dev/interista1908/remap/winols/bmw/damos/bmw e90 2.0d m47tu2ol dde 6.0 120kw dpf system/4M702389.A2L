ASAP2_VERSION 1 3
/begin PROJECT P389 "BMW DDE6.0 4-Zylinder V70.2 30.03.2004"
/begin HEADER "" VERSION "V70.2_4Z" PROJECT_NO P389 /end HEADER
/begin MODULE DIM ""
/begin MOD_COMMON "" BYTE_ORDER MSB_FIRST ALIGNMENT_BYTE 1 ALIGNMENT_WORD 2 ALIGNMENT_LONG 4 ALIGNMENT_FLOAT32_IEEE 4 /end MOD_COMMON
/begin CHARACTERISTIC FrmMng_ctASCDef_C "Defektentprellzähler, ASC-Plausibilisierung" VALUE 0xD5644 Kw_Wu8 255.0 OneToOne 0.00 255.0 FORMAT "%5.1" /end CHARACTERISTIC
/begin CHARACTERISTIC FrmMng_ctMulDDE2_C "Anzahl  der zu multiplexenden  - DDE2 Messages" VALUE 0xD5646 Kw_Wu16 4.000000 OneToOne 0.00 4.000000 FORMAT "%8.6" EXTENDED_LIMITS 0.00 65535.00 /end CHARACTERISTIC
/begin CHARACTERISTIC FrmMng_dCanState_C "Multiplexinfo für MUL_COD = 0" VALUE 0xD5648 Kw_Wu8 63.00 OneToOne 0.00 63.00 FORMAT "%5.2" EXTENDED_LIMITS 0.00 255.0 /end CHARACTERISTIC
/begin CHARACTERISTIC FrmMng_ctDebSigASC1Def_C "Entprellung von Signalfehler bei ASC1" VALUE 0xD564A Kw_Wu16 65535.00 OneToOne 0.00 65535.00 FORMAT "%8.2" /end CHARACTERISTIC
/begin CHARACTERISTIC FrmMng_ctDebSigASC1Ok_C "Entprellung von Signalfehler bei ASC1" VALUE 0xD564C Kw_Wu16 65535.00 OneToOne 0.00 65535.00 FORMAT "%8.2" /end CHARACTERISTIC
/begin CHARACTERISTIC FrmMng_ctDebSigASC2Def_C "Entprellung von Signalfehler bei ASC2" VALUE 0xD564E Kw_Wu16 65535.00 OneToOne 0.00 65535.00 FORMAT "%8.2" /end CHARACTERISTIC
/begin CHARACTERISTIC FrmMng_ctDebSigASC2Ok_C "Entprellung von Signalfehler bei ASC2" VALUE 0xD5650 Kw_Wu16 65535.00 OneToOne 0.00 65535.00 FORMAT "%8.2" /end CHARACTERISTIC
/begin CHARACTERISTIC FrmMng_ctDebSigASC3Def_C "Entprellung von Signalfehler bei ASC3" VALUE 0xD5652 Kw_Wu16 65535.00 OneToOne 0.00 65535.00 FORMAT "%8.2" /end CHARACTERISTIC
/begin CHARACTERISTIC FrmMng_ctDebSigASC3Ok_C "Entprellung von Signalfehler bei ASC3" VALUE 0xD5654 Kw_Wu16 65535.00 OneToOne 0.00 65535.00 FORMAT "%8.2" /end CHARACTERISTIC
/begin CHARACTERISTIC FrmMng_ctDebSigASC4Def_C "Debounce für signal Fehler defekt im Botschaft ASC4" VALUE 0xD5656 Kw_Wu16 65535.00 OneToOne 0.00 65535.00 FORMAT "%8.2" /end CHARACTERISTIC
/begin CHARACTERISTIC FrmMng_ctDebSigASC4Ok_C "Entprellung von Signalfehler bei ASC4" VALUE 0xD5658 Kw_Wu16 65535.00 OneToOne 0.00 65535.00 FORMAT "%8.2" /end CHARACTERISTIC
/begin CHARACTERISTIC FrmMng_ctDebSigEGS1Def_C "Entprellung von Signalfehler bei EGS1" VALUE 0xD565A Kw_Wu16 65535.00 OneToOne 0.00 65535.00 FORMAT "%8.2" /end CHARACTERISTIC
/begin CHARACTERISTIC FrmMng_ctDebSigEGS1Ok_C "Entprellung von Signalfehler bei EGS1" VALUE 0xD565C Kw_Wu16 65535.00 OneToOne 0.00 65535.00 FORMAT "%8.2" /end CHARACTERISTIC
/begin CHARACTERISTIC FrmMng_ctDebSigEGS2Def_C "Entprellung von Signalfehler bei EGS2" VALUE 0xD565E Kw_Wu16 65535.00 OneToOne 0.00 65535.00 FORMAT "%8.2" /end CHARACTERISTIC
/begin CHARACTERISTIC FrmMng_ctDebSigEGS2Ok_C "Entprellung von Signalfehler bei EGS2" VALUE 0xD5660 Kw_Wu16 65535.00 OneToOne 0.00 65535.00 FORMAT "%8.2" /end CHARACTERISTIC
/begin CHARACTERISTIC FrmMng_ctDebSigINSTR2Def_C "Defekterkennung von Signalfehlern der INSTR2-Botschaft" VALUE 0xD5662 Kw_Wu16 65535.00 OneToOne 0.00 65535.00 FORMAT "%8.2" /end CHARACTERISTIC
/begin CHARACTERISTIC FrmMng_ctDebSigINSTR2Ok_C "Heilerkennung von Signalfehlern der INSTR2-Botschaft" VALUE 0xD5664 Kw_Wu16 65535.00 OneToOne 0.00 65535.00 FORMAT "%8.2" /end CHARACTERISTIC
/begin CHARACTERISTIC FrmMng_ctDebSigINSTR3Def_C "Defekterkennung Signalfehler der INSTR3-Botschaft" VALUE 0xD5666 Kw_Wu16 65535.00 OneToOne 0.00 65535.00 FORMAT "%8.2" /end CHARACTERISTIC
/begin CHARACTERISTIC FrmMng_ctDebSigINSTR3Ok_C "Heilerkennung Signalfehler der INSTR3-Botschaft" VALUE 0xD5668 Kw_Wu16 65535.00 OneToOne 0.00 65535.00 FORMAT "%8.2" /end CHARACTERISTIC
/begin CHARACTERISTIC FrmMng_ctDebToASC1Def_C "Entprellung von Signal-Timeout bei ASC1" VALUE 0xD566A Kw_Wu16 65535.00 OneToOne 0.00 65535.00 FORMAT "%8.2" /end CHARACTERISTIC
/begin CHARACTERISTIC FrmMng_ctDebToASC1Ok_C "Entprellzähler, Heilung ASC1 Signal-Timeout" VALUE 0xD566C Kw_Wu16 65535.00 OneToOne 0.00 65535.00 FORMAT "%8.2" /end CHARACTERISTIC
/begin CHARACTERISTIC FrmMng_ctDebToASC2Def_C "Entprellung des timeout - Error ASC2" VALUE 0xD566E Kw_Wu16 65535.00 OneToOne 0.00 65535.00 FORMAT "%8.2" /end CHARACTERISTIC
/begin CHARACTERISTIC FrmMng_ctDebToASC2Ok_C "Entprellung des timeout - Error ASC2" VALUE 0xD5670 Kw_Wu16 65535.00 OneToOne 0.00 65535.00 FORMAT "%8.2" /end CHARACTERISTIC
/begin CHARACTERISTIC FrmMng_ctDebToASC3Def_C "Entprellung des timeout - Error ASC3" VALUE 0xD5672 Kw_Wu16 65535.00 OneToOne 0.00 65535.00 FORMAT "%8.2" /end CHARACTERISTIC
/begin CHARACTERISTIC FrmMng_ctDebToASC3Ok_C "Entprellung des timeout - Error ACS3" VALUE 0xD5674 Kw_Wu16 65535.00 OneToOne 0.00 65535.00 FORMAT "%8.2" /end CHARACTERISTIC
/begin CHARACTERISTIC FrmMng_ctDebToASC4Def_C "Debounce für Timeout Fehler von Botschaft ASC4" VALUE 0xD5676 Kw_Wu16 65535.00 OneToOne 0.00 65535.00 FORMAT "%8.2" /end CHARACTERISTIC
/begin CHARACTERISTIC FrmMng_ctDebToASC4Ok_C "Heilentprellung für ASC4-Botschaft Timeout" VALUE 0xD5678 Kw_Wu16 65535.00 OneToOne 0.00 65535.00 FORMAT "%8.2" /end CHARACTERISTIC
/begin CHARACTERISTIC FrmMng_ctDebToEGS1Def_C "Entprellung des timeout - Error EGS1" VALUE 0xD567A Kw_Wu16 65535.00 OneToOne 0.00 65535.00 FORMAT "%8.2" /end CHARACTERISTIC
/begin CHARACTERISTIC FrmMng_ctDebToEGS1Ok_C "Entprellung des Timeout - Error" VALUE 0xD567C Kw_Wu16 65535.00 OneToOne 0.00 65535.00 FORMAT "%8.2" /end CHARACTERISTIC
/begin CHARACTERISTIC FrmMng_ctDebToEGS2Def_C "Entprellung des timeout - Error EGS2" VALUE 0xD567E Kw_Wu16 65535.00 OneToOne 0.00 65535.00 FORMAT "%8.2" /end CHARACTERISTIC
/begin CHARACTERISTIC FrmMng_ctDebToEGS2Ok_C "Entprellung des timeout - Error EGS2" VALUE 0xD5680 Kw_Wu16 65535.00 OneToOne 0.00 65535.00 FORMAT "%8.2" /end CHARACTERISTIC
/begin CHARACTERISTIC FrmMng_ctDebToINSTR2Def_C "Defekterkennung Timeout INSTR2-Botschaft" VALUE 0xD5682 Kw_Wu16 65535.00 OneToOne 0.00 65535.00 FORMAT "%8.2" /end CHARACTERISTIC
/begin CHARACTERISTIC FrmMng_ctDebToINSTR2Ok_C "Heilerkennung Timeout INSTR2-Botschaft" VALUE 0xD5684 Kw_Wu16 65535.00 OneToOne 0.00 65535.00 FORMAT "%8.2" /end CHARACTERISTIC
/begin CHARACTERISTIC FrmMng_ctDebToINSTR3Def_C "Defekterkennung Timeout INSTR3-Botschaft" VALUE 0xD5686 Kw_Wu16 65535.00 OneToOne 0.00 65535.00 FORMAT "%8.2" /end CHARACTERISTIC
/begin CHARACTERISTIC FrmMng_ctDebToINSTR3Ok_C "Heilerkennung Timeout INSTR3-Botschaft" VALUE 0xD5688 Kw_Wu16 65535.00 OneToOne 0.00 65535.00 FORMAT "%8.2" /end CHARACTERISTIC
/begin CHARACTERISTIC FrmMng_dEngGearbox_C "gearboxcode for multiplexinfo[1]" VALUE 0xD568A Kw_Wu8 63.00 OneToOne 0.00 63.00 FORMAT "%5.2" EXTENDED_LIMITS 0.00 255.0 /end CHARACTERISTIC
/begin CHARACTERISTIC FrmMng_dOBDCtrl_C "mulinfo[3] of DDE2" VALUE 0xD568B Kw_Wu8 63.00 OneToOne 0.00 63.00 FORMAT "%5.2" EXTENDED_LIMITS 0.00 255.0 /end CHARACTERISTIC
/begin CHARACTERISTIC FrmMng_dstGearbx_C "Umrechnung fuer GANG_INF" VAL_BLK 0xD568C Kwb_Wu8 16.00 OneToOne 0.00 16.00 FORMAT "%5.2" EXTENDED_LIMITS 0.00 255.0 NUMBER 8 /end CHARACTERISTIC
/begin CHARACTERISTIC FrmMng_fst_Offset_C "Umrechnung Füllstand CAN-->intern Offset" VALUE 0xD5694 Kw_Ws16 65535.00 OneToOne -32768.00 32767.00 FORMAT "%8.2" /end CHARACTERISTIC
/begin CHARACTERISTIC FrmMng_fst_Slope_C "Umrechnung Füllstand CAN-->intern Steigung" VALUE 0xD5696 Kw_Ws16 65.53500 SlopeRes1000 -32.76800 32.76700 FORMAT "%8.5" /end CHARACTERISTIC
/begin CHARACTERISTIC FrmMng_kmst_Offset_C "Offset für Kilometerstandsumrechnung" VALUE 0xD5698 Kw_Ws16 65535.00 OneToOne -32768.00 32767.00 FORMAT "%8.2" /end CHARACTERISTIC
/begin CHARACTERISTIC FrmMng_kmst_Slope_C "Slope für Kilometerstandsumrechnung" VALUE 0xD569A Kw_Ws16 65.53500 SlopeRes1000 -32.76800 32.76700 FORMAT "%8.5" /end CHARACTERISTIC
/begin CHARACTERISTIC FrmMng_nAvrg_Def_C "Fehlerwert für nAvrg" VALUE 0xD569C Kw_Wu16 10240.00 EngN 0.00 10240.00 FORMAT "%8.2" EXTENDED_LIMITS 0.00 65535.00 /end CHARACTERISTIC
/begin CHARACTERISTIC FrmMng_nAvrg_Slope_C "Slope für nAvrg" VALUE 0xD569E Kw_Wu16 32767.00 OneToOne 0.00 32767.00 FORMAT "%8.2" EXTENDED_LIMITS 0.00 65535.00 /end CHARACTERISTIC
/begin CHARACTERISTIC FrmMng_nDiv_Fac_C "Divisionsfaktor für nAvrg Slope" VALUE 0xD56A0 Kw_Wu16 32767.00 OneToOne 0.00 32767.00 FORMAT "%8.2" EXTENDED_LIMITS 0.00 65535.00 /end CHARACTERISTIC
/begin CHARACTERISTIC FrmMng_nFanErr_C "Fehlerwert für Lüfterdrehzahl" VALUE 0xD56A2 Kw_Ws16 6000.092 FanSpd -3000.092 3000.000 FORMAT "%8.3" /end CHARACTERISTIC
/begin CHARACTERISTIC FrmMng_nFan_C "Umsetzungstabelle Lüfterstufe --> Lüfterdrehzahl" VAL_BLK 0xD56A4 Kwb_Ws16 3000.000 FanSpd 0.00 3000.000 FORMAT "%8.3" EXTENDED_LIMITS -3000.092 3000.000 NUMBER 16 /end CHARACTERISTIC
/begin CHARACTERISTIC FrmMng_nLISetPoint_Offset_C "Low idle speed offset value for normalisation" VALUE 0xD56C4 Kw_Ws16 65535.00 EngN -32768.00 32767.00 FORMAT "%8.2" /end CHARACTERISTIC
/begin CHARACTERISTIC FrmMng_nLISetPoint_Slope_C "Low idle speed slope value for normalisation" VALUE 0xD56C6 Kw_Ws16 65.53500 SlopeRes1000 -32.76800 32.76700 FORMAT "%8.5" /end CHARACTERISTIC
/begin CHARACTERISTIC FrmMng_nML_C "Applikationswert zur Begrezung der Motorlaufzustand über CAN" VALUE 0xD56C8 Kw_Ws16 5960.000 EngN 40.00000 6000.000 FORMAT "%8.3" EXTENDED_LIMITS -32768.00 32767.00 /end CHARACTERISTIC
/begin CHARACTERISTIC FrmMng_nTSCErr_C "Fehlerwert für Eingangsturbinendrehzahl" VALUE 0xD56CA Kw_Wu16 65535.00 EngN 0.00 65535.00 FORMAT "%8.2" /end CHARACTERISTIC
/begin CHARACTERISTIC FrmMng_nTSC_Offset_C "Offset für Eingangsturbinendrehzahl" VALUE 0xD56CC Kw_Ws16 65535.00 EngN -32768.00 32767.00 FORMAT "%8.2" /end CHARACTERISTIC
/begin CHARACTERISTIC FrmMng_nTSC_Slope_C "Steigung für Eingangsturbinendrehzahl" VALUE 0xD56CE Kw_Ws16 65.53500 SlopeRes1000 -32.76800 32.76700 FORMAT "%8.5" /end CHARACTERISTIC
/begin CHARACTERISTIC FrmMng_pVal_Offset_C "Offset für pVal" VALUE 0xD56D0 Kw_Ws16 65535.00 OneToOne -32768.00 32767.00 FORMAT "%8.2" /end CHARACTERISTIC
/begin CHARACTERISTIC FrmMng_pVal_Slope_C "Offset für pVal" VALUE 0xD56D2 Kw_Ws16 65.53500 SlopeRes1000 -32.76800 32.76700 FORMAT "%8.5" /end CHARACTERISTIC
/begin CHARACTERISTIC FrmMng_rFlt_Offset_C "Offset für rFlt" VALUE 0xD56D4 Kw_Ws16 65535.00 OneToOne -32768.00 32767.00 FORMAT "%8.2" /end CHARACTERISTIC
/begin CHARACTERISTIC FrmMng_rFlt_Slope_C "Steigung für rFlt" VALUE 0xD56D6 Kw_Ws16 65.53500 SlopeRes1000 -32.76800 32.76700 FORMAT "%8.5" /end CHARACTERISTIC
/begin CHARACTERISTIC FrmMng_stGearErr_C "Vorgabewert bei EGS1 Botschaftsausfall" VALUE 0xD56D8 Kw_Wu8 255.0 OneToOne 0.00 255.0 FORMAT "%5.1" /end CHARACTERISTIC
/begin CHARACTERISTIC FrmMng_swtASC1_C "ASC1 Botschaft aktivieren bzw. deaktivieren (1: aktiviert, 0: deaktiviert)" VALUE 0xD56D9 Kw_Wu8 1.000 OneToOne 0.00 1.000 FORMAT "%5.3" EXTENDED_LIMITS 0.00 255.0 /end CHARACTERISTIC
/begin CHARACTERISTIC FrmMng_swtASC2_C "ASC2 Botschaft aktivieren bzw.  deaktivieren (1: aktiviert, 0: deaktiviert)" VALUE 0xD56DA Kw_Wu8 1.000 OneToOne 0.00 1.000 FORMAT "%5.3" EXTENDED_LIMITS 0.00 255.0 /end CHARACTERISTIC
/begin CHARACTERISTIC FrmMng_swtASC3_C "ASC3 Botschaft aktivieren bzw. deaktivieren (1: aktiviert, 0: deaktiviert)" VALUE 0xD56DB Kw_Wu8 1.000 OneToOne 0.00 1.000 FORMAT "%5.3" EXTENDED_LIMITS 0.00 255.0 /end CHARACTERISTIC
/begin CHARACTERISTIC FrmMng_swtASC4_C "ASC4 Botschaft aktivieren bzw. deaktivieren (1: aktiviert, 0: deaktiviert)" VALUE 0xD56DC Kw_Wu8 1.000 OneToOne 0.00 1.000 FORMAT "%5.3" EXTENDED_LIMITS 0.00 255.0 /end CHARACTERISTIC
/begin CHARACTERISTIC FrmMng_swtCANA_C "Schalter zum Deaktivieren der Kommunikation des CAN A, 1=AUS" VALUE 0xD56DD Kw_Wu8 1.000 OneToOne 0.00 1.000 FORMAT "%5.3" EXTENDED_LIMITS 0.00 255.0 /end CHARACTERISTIC
/begin CHARACTERISTIC FrmMng_swtDDE1_C "DDE1 Botschaft aktivieren/deaktivieren (1...enabled, 0...disabled)" VALUE 0xD56DE Kw_Wu8 1.000 OneToOne 0.00 1.000 FORMAT "%5.3" EXTENDED_LIMITS 0.00 255.0 /end CHARACTERISTIC
/begin CHARACTERISTIC FrmMng_swtDDE2_C "DDE2 Botschaft aktivieren / deaktivieren (1...enabled, 0...disabled)" VALUE 0xD56DF Kw_Wu8 1.000 OneToOne 0.00 1.000 FORMAT "%5.3" EXTENDED_LIMITS 0.00 255.0 /end CHARACTERISTIC
/begin CHARACTERISTIC FrmMng_swtDDE4_C "DDE4 Botschaft aktivieren / deaktivieren (1...enabled, 0...disabled)" VALUE 0xD56E0 Kw_Wu8 1.000 OneToOne 0.00 1.000 FORMAT "%5.3" EXTENDED_LIMITS 0.00 255.0 /end CHARACTERISTIC
/begin CHARACTERISTIC FrmMng_swtDSCBrkAct_C "Auswahl zwischen 0: DSC-brake intervention, 1: DSC control and 2: ASC control" VALUE 0xD56E1 Kw_Wu8 7.000 OneToOne 0.00 7.000 FORMAT "%5.3" EXTENDED_LIMITS 0.00 255.0 /end CHARACTERISTIC
/begin CHARACTERISTIC FrmMng_swtEGS1_C "EGS1 Botschaft aktivieren oder deaktivieren (1...enabled, 0...disabled)" VALUE 0xD56E2 Kw_Wu8 1.000 OneToOne 0.00 1.000 FORMAT "%5.3" EXTENDED_LIMITS 0.00 255.0 /end CHARACTERISTIC
/begin CHARACTERISTIC FrmMng_swtEGS2_C "EGS2 Botschaft aktivieren bzw. deaktivieren (1...enabled, 0...disabled)" VALUE 0xD56E3 Kw_Wu8 1.000 OneToOne 0.00 1.000 FORMAT "%5.3" EXTENDED_LIMITS 0.00 255.0 /end CHARACTERISTIC
/begin CHARACTERISTIC FrmMng_swtEKP_C "Schalter für EKP-Botschaft (1...on, 0...off)" VALUE 0xD56E4 Kw_Wu8 1.000 OneToOne 0.00 1.000 FORMAT "%5.3" EXTENDED_LIMITS 0.00 255.0 /end CHARACTERISTIC
/begin CHARACTERISTIC FrmMng_swtINSTR2_C "Schalter, um die Message INSTR2 zu aktivieren (1...enabled,. 0...disabled)" VALUE 0xD56E5 Kw_Wu8 1.000 OneToOne 0.00 1.000 FORMAT "%5.3" EXTENDED_LIMITS 0.00 255.0 /end CHARACTERISTIC
/begin CHARACTERISTIC FrmMng_swtINSTR3_C "Schalter, um die Message INSTR3 zu aktivieren (1...enabled,. 0...disabled)" VALUE 0xD56E6 Kw_Wu8 1.000 OneToOne 0.00 1.000 FORMAT "%5.3" EXTENDED_LIMITS 0.00 255.0 /end CHARACTERISTIC
/begin CHARACTERISTIC FrmMng_tEng_Offset_C "Offset für Motortemperatur" VALUE 0xD56E8 Kw_Ws16 65535.00 OneToOne -32768.00 32767.00 FORMAT "%8.2" /end CHARACTERISTIC
/begin CHARACTERISTIC FrmMng_tEng_Slope_C "Steigung für Motortemperatur" VALUE 0xD56EA Kw_Ws16 65.53500 SlopeRes1000 -32.76800 32.76700 FORMAT "%8.5" /end CHARACTERISTIC
/begin CHARACTERISTIC FrmMng_tEnvErr_C "Fehlerwert für Umgebungstemperatur" VALUE 0xD56EC Kw_Ws16 250.0000 Temp_Cels -50.1400 199.8600 FORMAT "%8.4" EXTENDED_LIMITS -3549.940 3003.560 /end CHARACTERISTIC
/begin CHARACTERISTIC FrmMng_tiDSCDelay1_C "Totzeit für DSC Eingriff" VALUE 0xD56EE Kw_Wu16 655350.0 Time_ms 0.00 655350.0 FORMAT "%8.1" /end CHARACTERISTIC
/begin CHARACTERISTIC FrmMng_tiDSCDelay2_C "Totzeit für DSC Regelung" VALUE 0xD56F0 Kw_Wu16 655350.0 Time_ms 0.00 655350.0 FORMAT "%8.1" /end CHARACTERISTIC
/begin CHARACTERISTIC FrmMng_tiDSCDelay3_C "Totzeit für ASC Regelung" VALUE 0xD56F2 Kw_Wu16 655350.0 Time_ms 0.00 655350.0 FORMAT "%8.1" /end CHARACTERISTIC
/begin CHARACTERISTIC FrmMng_trqACErr_C "Klimakompressor Lastmoment im Fehlerfall" VALUE 0xD56F4 Kw_Ws16 31.00000 Trq 0.00 31.00000 FORMAT "%8.5" EXTENDED_LIMITS -3276.800 3276.700 /end CHARACTERISTIC
/begin CHARACTERISTIC FrmMng_trqLim_CUR "torque limit at system error" CURVE 0xD56F6 Kl_Xs16_Ws16 11000.00 TrqPrp -5000.000 6000.000 FORMAT "%8.3" EXTENDED_LIMITS -6553.600 6553.400
 /begin AXIS_DESCR STD_AXIS Eng_nAvrg EngN 10 -32768.00 6000.000 FORMAT "%8.2" EXTENDED_LIMITS -32768.00 32767.00 DEPOSIT ABSOLUTE /end AXIS_DESCR
/end CHARACTERISTIC
/begin CHARACTERISTIC FrmMng_trqNorm_C "Normwert für Momente" VALUE 0xD5720 Kw_Wu16 1008.000 Trq 0.00 1008.000 FORMAT "%8.3" EXTENDED_LIMITS 0.00 6553.500 /end CHARACTERISTIC
/begin CHARACTERISTIC FrmMng_trq_Offset_C "Offset Umrechung SG->CAN für Momente" VALUE 0xD5722 Kw_Ws16 799.9878 Prc -400.0000 399.9878 FORMAT "%8.4" /end CHARACTERISTIC
/begin CHARACTERISTIC FrmMng_trq_Slope_C "Steigung Umrechung SG->CAN für Momente" VALUE 0xD5724 Kw_Ws16 65.53500 SlopeRes1000 -32.76800 32.76700 FORMAT "%8.5" /end CHARACTERISTIC
/begin CHARACTERISTIC FTSCD_uSRCMin_C "SRC Minimum (Kraftstoffstemperatur)" VALUE 0xD5728 Kw_Ws16 5200.391 Volt 0.00 5200.391 FORMAT "%8.3" EXTENDED_LIMITS -160156.4 160151.5 /end CHARACTERISTIC
/begin CHARACTERISTIC FTSCD_uSRCMax_C "SRC Maximum (Kraftstoffstemperatur)" VALUE 0xD572A Kw_Ws16 5200.391 Volt 0.00 5200.391 FORMAT "%8.3" EXTENDED_LIMITS -160156.4 160151.5 /end CHARACTERISTIC
/begin CHARACTERISTIC FTSCD_tLin_CUR "Linearisierungskennlinie der Kraftstoffstemperatur" CURVE 0xD572C Kl_Xs16_Ws16 950.0000 Temp_Cels -50.1400 899.8600 FORMAT "%8.4" EXTENDED_LIMITS -3549.940 3003.560
 /begin AXIS_DESCR STD_AXIS FTSCD_uRaw Volt 20 0.00 5200.391 FORMAT "%8.3" EXTENDED_LIMITS -160156.4 160151.5 DEPOSIT ABSOLUTE /end AXIS_DESCR
/end CHARACTERISTIC
/begin CHARACTERISTIC FTSCD_DebSRCHighDef_C "FTS Fehlerentprellungszeit fuer SRC-High" VALUE 0xD577E Kw_Wu16 655350.0 Time_ms 0.00 655350.0 FORMAT "%8.1" /end CHARACTERISTIC
/begin CHARACTERISTIC FTSCD_DebSRCHighOk_C "FTS Heilungsentprellzeit fuer SRC-High" VALUE 0xD5780 Kw_Wu16 655350.0 Time_ms 0.00 655350.0 FORMAT "%8.1" /end CHARACTERISTIC
/begin CHARACTERISTIC FTSCD_DebSRCLowDef_C "FTS Fehlerentprellungszeit fuer SRC-Low" VALUE 0xD5782 Kw_Wu16 655350.0 Time_ms 0.00 655350.0 FORMAT "%8.1" /end CHARACTERISTIC
/begin CHARACTERISTIC FTSCD_DebSRCLowOk_C "FTS Heilungsentprellzeit fuer SRC-Low" VALUE 0xD5784 Kw_Wu16 655350.0 Time_ms 0.00 655350.0 FORMAT "%8.1" /end CHARACTERISTIC
/begin CHARACTERISTIC FTSCD_numAdc_C "#SSD Applikationsparameter fuer zweite Kraftstofftemperaturfuehler" VALUE 0xD5786 Kw_Wu8 26.0000000000 NumPinAdc 0.00 26.0000000000 FORMAT "%13.10" /end CHARACTERISTIC
/begin CHARACTERISTIC FTSCD_dtRmpSlpUp_C "Aufwärts-Schritt für Rampe" VALUE 0xD5788 Kw_Wu32 6553598.99749 RmpTemp 1.00097656250 6553599.99847 FORMAT "%13.5" EXTENDED_LIMITS 0.00 6553599.99847 /end CHARACTERISTIC
/begin CHARACTERISTIC FTSCD_dtRmpSlpDwn_C "Abwärts-Schritt für Rampe" VALUE 0xD578C Kw_Wu32 6553598.99749 RmpTemp 1.00097656250 6553599.99847 FORMAT "%13.5" EXTENDED_LIMITS 0.00 6553599.99847 /end CHARACTERISTIC
/begin CHARACTERISTIC FTSCD_stSensIDWord_C "Geberkennwort Kraftstoffstemperatur" VALUE 0xD5790 Kw_Wu16 65535.00 OneToOne 0.00 65535.00 FORMAT "%8.2" /end CHARACTERISTIC
/begin CHARACTERISTIC FTSCD_tDfl_C "Vorgabewert Kraftstoffstemperatur" VALUE 0xD5792 Kw_Ws16 950.0000 Temp_Cels -50.1400 899.8600 FORMAT "%8.4" EXTENDED_LIMITS -3549.940 3003.560 /end CHARACTERISTIC
/begin CHARACTERISTIC Gearbx_amMax_C "#SSD Maximaler Drehimpuls" VALUE 0xD58A0 Kw_Wu16 32767.00 TrqDT 0.00 32767.00 FORMAT "%8.2" EXTENDED_LIMITS 0.00 65535.00 /end CHARACTERISTIC
/begin CHARACTERISTIC Gearbx_dnNMinRmpUp_C "Low Idel speed up ramping  value" VALUE 0xD57E0 Kw_Wu32 65535999.9847 RmpEngN 0.00 65535999.9847 FORMAT "%13.4" /end CHARACTERISTIC
/begin CHARACTERISTIC Gearbx_dnNMinRmpDwn_C "Low Idel speed down ramping value" VALUE 0xD57E4 Kw_Wu32 65535999.9847 RmpEngN 0.00 65535999.9847 FORMAT "%13.4" /end CHARACTERISTIC
/begin CHARACTERISTIC Gearbx_dtrqLimUp_C "Rampensteigung fuer Anfahrmomentbegrenzung" VALUE 0xD5904 Kw_Wu32 6553599.99847 RmpTrq 0.00 6553599.99847 FORMAT "%13.5" /end CHARACTERISTIC
/begin CHARACTERISTIC Gearbx_dtrqRmpUp_C "Rampensteigung für Getriebemomentbegrenzung bei Gangwechsel" VALUE 0xD5908 Kw_Wu32 6553599.99847 RmpTrq 0.00 6553599.99847 FORMAT "%13.5" /end CHARACTERISTIC
/begin CHARACTERISTIC Gearbx_dtrqRmpDwn_C "Abwärts Steigung der Rampe für Getriebemomentbegrenzung mit Kurs" VALUE 0xD590C Kw_Wu32 6553599.99847 RmpTrq 0.00 6553599.99847 FORMAT "%13.5" /end CHARACTERISTIC
/begin CHARACTERISTIC Gearbx_facLimUp_CUR "Faktor fuer die Berechnung der Rampensteigung" CURVE 0xD5910 Kl_Xs16_Ws16 7.999878 Fact -4.000000 3.999878 FORMAT "%8.6"
 /begin AXIS_DESCR STD_AXIS VSSCD_v Vel 8 0.00 300.0000 FORMAT "%8.4" EXTENDED_LIMITS -327.6800 327.6700 DEPOSIT ABSOLUTE /end AXIS_DESCR
/end CHARACTERISTIC
/begin CHARACTERISTIC Gearbx_nMinFDC_MAP "Anpassung der niedrig-untätigen setpointgeschwindigkeitsnachfrage" MAP 0xD57E8 Kf_Xs16_Ys16_Ws16 3000.000 EngN 0.00 3000.000 FORMAT "%8.3" EXTENDED_LIMITS -32768.00 32767.00
 /begin AXIS_DESCR STD_AXIS FrmMng_nTSC EngN 4 0.00 10000.00 FORMAT "%8.2" EXTENDED_LIMITS -32768.00 32767.00 DEPOSIT ABSOLUTE /end AXIS_DESCR
 /begin AXIS_DESCR STD_AXIS Gearbx_stGear OneToOne 8 -1.000 6.000 FORMAT "%5.3" EXTENDED_LIMITS -128.0 127.0 DEPOSIT ABSOLUTE /end AXIS_DESCR
/end CHARACTERISTIC
/begin CHARACTERISTIC Gearbx_nMin_MAP "#SSD Leerlaufanhebung bei Automatikgetriebe, abhängig von Abtriebsdrehzahl des Getriebes und Gang." MAP 0xD5844 Kf_Xs16_Ys16_Ws16 3000.000 EngN 0.00 3000.000 FORMAT "%8.3" EXTENDED_LIMITS -32768.00 32767.00
 /begin AXIS_DESCR STD_AXIS FrmMng_nTSC EngN 4 0.00 10000.00 FORMAT "%8.2" EXTENDED_LIMITS -32768.00 32767.00 DEPOSIT ABSOLUTE /end AXIS_DESCR
 /begin AXIS_DESCR STD_AXIS Gearbx_stGear OneToOne 8 -1.000 6.000 FORMAT "%5.3" EXTENDED_LIMITS -128.0 127.0 DEPOSIT ABSOLUTE /end AXIS_DESCR
/end CHARACTERISTIC
/begin CHARACTERISTIC Gearbx_numGearDfl_C "Ersatzwert der Ganginformation" VALUE 0xD5796 Kw_Ws16 7.000000 OneToOne -1.000000 6.000000 FORMAT "%8.6" EXTENDED_LIMITS -32768.00 32767.00 /end CHARACTERISTIC
/begin CHARACTERISTIC Gearbx_numWinG0_C "Gang unterhalb des untersten v/n-Schnellgangbandes" VALUE 0xD5798 Kw_Ws8 7.000 OneToOne -1.000 6.000 FORMAT "%5.3" EXTENDED_LIMITS -128.0 127.0 /end CHARACTERISTIC
/begin CHARACTERISTIC Gearbx_numWinG1_C "Gang im 1. v/n-Schnellgangbandes" VALUE 0xD5799 Kw_Ws8 7.000 OneToOne -1.000 6.000 FORMAT "%5.3" EXTENDED_LIMITS -128.0 127.0 /end CHARACTERISTIC
/begin CHARACTERISTIC Gearbx_numWinG2_C "Gang im 2. v/n-Schnellgangbandes" VALUE 0xD579A Kw_Ws8 7.000 OneToOne -1.000 6.000 FORMAT "%5.3" EXTENDED_LIMITS -128.0 127.0 /end CHARACTERISTIC
/begin CHARACTERISTIC Gearbx_numWinG3_C "Gang im 3. v/n-Schnellgangbandes" VALUE 0xD579B Kw_Ws8 7.000 OneToOne -1.000 6.000 FORMAT "%5.3" EXTENDED_LIMITS -128.0 127.0 /end CHARACTERISTIC
/begin CHARACTERISTIC Gearbx_numWinG4_C "Gang im 4. v/n-Schnellgangbandes" VALUE 0xD579C Kw_Ws8 7.000 OneToOne -1.000 6.000 FORMAT "%5.3" EXTENDED_LIMITS -128.0 127.0 /end CHARACTERISTIC
/begin CHARACTERISTIC Gearbx_numWinG5_C "Gang im 5. v/n-Schnellgangbandes" VALUE 0xD579D Kw_Ws8 7.000 OneToOne -1.000 6.000 FORMAT "%5.3" EXTENDED_LIMITS -128.0 127.0 /end CHARACTERISTIC
/begin CHARACTERISTIC Gearbx_numWinG6_C "Gang im 6. v/n-Schnellgangbandes" VALUE 0xD579E Kw_Ws8 7.000 OneToOne -1.000 6.000 FORMAT "%5.3" EXTENDED_LIMITS -128.0 127.0 /end CHARACTERISTIC
/begin CHARACTERISTIC Gearbx_numWinG7_C "Gang oberhalb des 6. v/n-Schnellgangbandes" VALUE 0xD579F Kw_Ws8 7.000 OneToOne -1.000 6.000 FORMAT "%5.3" EXTENDED_LIMITS -128.0 127.0 /end CHARACTERISTIC
/begin CHARACTERISTIC Gearbx_numWinGR_C "Gang im Rückwärts v/n-Schnellgangbandes" VALUE 0xD57A0 Kw_Ws8 7.000 OneToOne -1.000 6.000 FORMAT "%5.3" EXTENDED_LIMITS -128.0 127.0 /end CHARACTERISTIC
/begin CHARACTERISTIC Gearbx_rTrans1_C "#SSD Getriebeübersetzung 1. Gang" VALUE 0xD57A2 Kw_Ws16 327.6700 TransR 0.00 327.6700 FORMAT "%8.4" EXTENDED_LIMITS -327.6800 327.6700 /end CHARACTERISTIC
/begin CHARACTERISTIC Gearbx_rTrans2_C "#SSD Getriebeübersetzung 2. Gang" VALUE 0xD57A4 Kw_Ws16 327.6700 TransR 0.00 327.6700 FORMAT "%8.4" EXTENDED_LIMITS -327.6800 327.6700 /end CHARACTERISTIC
/begin CHARACTERISTIC Gearbx_rTrans3_C "#SSD Getriebeübersetzung 3. Gang" VALUE 0xD57A6 Kw_Ws16 327.6700 TransR 0.00 327.6700 FORMAT "%8.4" EXTENDED_LIMITS -327.6800 327.6700 /end CHARACTERISTIC
/begin CHARACTERISTIC Gearbx_rTrans4_C "#SSD Getriebeübersetzung 4. Gang" VALUE 0xD57A8 Kw_Ws16 327.6700 TransR 0.00 327.6700 FORMAT "%8.4" EXTENDED_LIMITS -327.6800 327.6700 /end CHARACTERISTIC
/begin CHARACTERISTIC Gearbx_rTrans5_C "#SSD Getriebeübersetzung 5. Gang" VALUE 0xD57AA Kw_Ws16 327.6700 TransR 0.00 327.6700 FORMAT "%8.4" EXTENDED_LIMITS -327.6800 327.6700 /end CHARACTERISTIC
/begin CHARACTERISTIC Gearbx_rTrans6_C "#SSD Getriebeübersetzung 6. Gang" VALUE 0xD57AC Kw_Ws16 327.6700 TransR 0.00 327.6700 FORMAT "%8.4" EXTENDED_LIMITS -327.6800 327.6700 /end CHARACTERISTIC
/begin CHARACTERISTIC Gearbx_rTransR_C "#SSD Getriebeübersetzung Rückwärtsgang" VALUE 0xD57AE Kw_Ws16 327.6700 TransR 0.00 327.6700 FORMAT "%8.4" EXTENDED_LIMITS -327.6800 327.6700 /end CHARACTERISTIC
/begin CHARACTERISTIC Gearbx_rVn0ToR_C "v/n-Toleranzbandegrenze für Schnellgang N und R" VALUE 0xD57B0 Kw_Ws16 0.3276700 VelToN 0.00 0.3276700 FORMAT "%9.7" EXTENDED_LIMITS -0.3276800 0.3276700 /end CHARACTERISTIC
/begin CHARACTERISTIC Gearbx_rVn1H_C "obere Grenze des v/n-Toleranzbandes 1. Gang" VALUE 0xD57B2 Kw_Ws16 0.3276700 VelToN 0.00 0.3276700 FORMAT "%9.7" EXTENDED_LIMITS -0.3276800 0.3276700 /end CHARACTERISTIC
/begin CHARACTERISTIC Gearbx_rVn1L_C "untere Grenze des v/n-Toleranzbandes 1. Gang" VALUE 0xD57B4 Kw_Ws16 0.3276700 VelToN 0.00 0.3276700 FORMAT "%9.7" EXTENDED_LIMITS -0.3276800 0.3276700 /end CHARACTERISTIC
/begin CHARACTERISTIC Gearbx_rVn1To2_C "v/n-Toleranzbandegrenze für Schnellgang 1. und 2. Gang" VALUE 0xD57B6 Kw_Ws16 0.3276700 VelToN 0.00 0.3276700 FORMAT "%9.7" EXTENDED_LIMITS -0.3276800 0.3276700 /end CHARACTERISTIC
/begin CHARACTERISTIC Gearbx_rVn2H_C "obere Grenze des v/n-Toleranzbandes 2. Gang" VALUE 0xD57B8 Kw_Ws16 0.3276700 VelToN 0.00 0.3276700 FORMAT "%9.7" EXTENDED_LIMITS -0.3276800 0.3276700 /end CHARACTERISTIC
/begin CHARACTERISTIC Gearbx_rVn2L_C "untere Grenze des v/n-Toleranzbandes 2. Gang" VALUE 0xD57BA Kw_Ws16 0.3276700 VelToN 0.00 0.3276700 FORMAT "%9.7" EXTENDED_LIMITS -0.3276800 0.3276700 /end CHARACTERISTIC
/begin CHARACTERISTIC Gearbx_rVn2To3_C "v/n-Toleranzbandegrenze für Schnellgang 2. und 3. Gang" VALUE 0xD57BC Kw_Ws16 0.3276700 VelToN 0.00 0.3276700 FORMAT "%9.7" EXTENDED_LIMITS -0.3276800 0.3276700 /end CHARACTERISTIC
/begin CHARACTERISTIC Gearbx_rVn3H_C "obere Grenze des v/n-Toleranzbandes 3. Gang" VALUE 0xD57BE Kw_Ws16 0.3276700 VelToN 0.00 0.3276700 FORMAT "%9.7" EXTENDED_LIMITS -0.3276800 0.3276700 /end CHARACTERISTIC
/begin CHARACTERISTIC Gearbx_rVn3L_C "untere Grenze des v/n-Toleranzbandes 3. Gang" VALUE 0xD57C0 Kw_Ws16 0.3276700 VelToN 0.00 0.3276700 FORMAT "%9.7" EXTENDED_LIMITS -0.3276800 0.3276700 /end CHARACTERISTIC
/begin CHARACTERISTIC Gearbx_rVn3To4_C "v/n-Toleranzbandegrenze für Schnellgang 3. und 4. Gang" VALUE 0xD57C2 Kw_Ws16 0.3276700 VelToN 0.00 0.3276700 FORMAT "%9.7" EXTENDED_LIMITS -0.3276800 0.3276700 /end CHARACTERISTIC
/begin CHARACTERISTIC Gearbx_rVn4H_C "obere Grenze des v/n-Toleranzbandes 4. Gang" VALUE 0xD57C4 Kw_Ws16 0.3276700 VelToN 0.00 0.3276700 FORMAT "%9.7" EXTENDED_LIMITS -0.3276800 0.3276700 /end CHARACTERISTIC
/begin CHARACTERISTIC Gearbx_rVn4L_C "untere Grenze des v/n-Toleranzbandes 4. Gang" VALUE 0xD57C6 Kw_Ws16 0.3276700 VelToN 0.00 0.3276700 FORMAT "%9.7" EXTENDED_LIMITS -0.3276800 0.3276700 /end CHARACTERISTIC
/begin CHARACTERISTIC Gearbx_rVn4To5_C "v/n-Toleranzbandegrenze für Schnellgang 4. und 5. Gang" VALUE 0xD57C8 Kw_Ws16 0.3276700 VelToN 0.00 0.3276700 FORMAT "%9.7" EXTENDED_LIMITS -0.3276800 0.3276700 /end CHARACTERISTIC
/begin CHARACTERISTIC Gearbx_rVn5H_C "obere Grenze des v/n-Toleranzbandes 5. Gang" VALUE 0xD57CA Kw_Ws16 0.3276700 VelToN 0.00 0.3276700 FORMAT "%9.7" EXTENDED_LIMITS -0.3276800 0.3276700 /end CHARACTERISTIC
/begin CHARACTERISTIC Gearbx_rVn5L_C "untere Grenze des v/n-Toleranzbandes 5. Gang" VALUE 0xD57CC Kw_Ws16 0.3276700 VelToN 0.00 0.3276700 FORMAT "%9.7" EXTENDED_LIMITS -0.3276800 0.3276700 /end CHARACTERISTIC
/begin CHARACTERISTIC Gearbx_rVn5To6_C "v/n-Toleranzbandegrenze für Schnellgang 5. und 6. Gang" VALUE 0xD57CE Kw_Ws16 0.3276700 VelToN 0.00 0.3276700 FORMAT "%9.7" EXTENDED_LIMITS -0.3276800 0.3276700 /end CHARACTERISTIC
/begin CHARACTERISTIC Gearbx_rVn6H_C "obere Grenze des v/n-Toleranzbandes 6. Gang" VALUE 0xD57D0 Kw_Ws16 0.3276700 VelToN 0.00 0.3276700 FORMAT "%9.7" EXTENDED_LIMITS -0.3276800 0.3276700 /end CHARACTERISTIC
/begin CHARACTERISTIC Gearbx_rVn6L_C "untere Grenze des v/n-Toleranzbandes 6. Gang" VALUE 0xD57D2 Kw_Ws16 0.3276700 VelToN 0.00 0.3276700 FORMAT "%9.7" EXTENDED_LIMITS -0.3276800 0.3276700 /end CHARACTERISTIC
/begin CHARACTERISTIC Gearbx_rVn6To7_C "v/n-Toleranzbandegrenze für Schnellgang größer 6. Gang" VALUE 0xD57D4 Kw_Ws16 0.3276700 VelToN 0.00 0.3276700 FORMAT "%9.7" EXTENDED_LIMITS -0.3276800 0.3276700 /end CHARACTERISTIC
/begin CHARACTERISTIC Gearbx_rVnRH_C "obere Grenze des v/n-Toleranzbandes Rückwärtsgang" VALUE 0xD57D6 Kw_Ws16 0.3276700 VelToN 0.00 0.3276700 FORMAT "%9.7" EXTENDED_LIMITS -0.3276800 0.3276700 /end CHARACTERISTIC
/begin CHARACTERISTIC Gearbx_rVnRL_C "untere Grenze des v/n-Toleranzbandes Rückwärtsgang" VALUE 0xD57D8 Kw_Ws16 0.3276700 VelToN 0.00 0.3276700 FORMAT "%9.7" EXTENDED_LIMITS -0.3276800 0.3276700 /end CHARACTERISTIC
/begin CHARACTERISTIC Gearbx_rVnRTo1_C "v/n-Toleranzbandegrenze für Schnellgang R und 1. Gang" VALUE 0xD57DA Kw_Ws16 0.3276700 VelToN 0.00 0.3276700 FORMAT "%9.7" EXTENDED_LIMITS -0.3276800 0.3276700 /end CHARACTERISTIC
/begin CHARACTERISTIC Gearbx_stTypeSelCAN_C "Zuordnung Getriebetyp und Ganginformation über CAN" VALUE 0xD57DC Kw_Ws16 8.000000 OneToOne 0.00 8.000000 FORMAT "%8.6" EXTENDED_LIMITS -32768.00 32767.00 /end CHARACTERISTIC
/begin CHARACTERISTIC Gearbx_swtDrvAway_C "Abschaltbedingung für Anfahrmomentbegrenzung (1: Begrenzung möglich, 0 keine Begrenzung)" VALUE 0xD5932 Kw_Wu8 1.000 OneToOne 0.00 1.000 FORMAT "%5.3" EXTENDED_LIMITS 0.00 255.0 /end CHARACTERISTIC
/begin CHARACTERISTIC Gearbx_swtErrRea_C "Ersatzreaktion bei fehlerhafter CAN-Übertragung (1: v/n ratio, 0: default value)" VALUE 0xD57DE Kw_Ws16 1.000000 OneToOne 0.00 1.000000 FORMAT "%8.6" EXTENDED_LIMITS -32768.00 32767.00 /end CHARACTERISTIC
/begin CHARACTERISTIC Gearbx_swtTypeVal_C "Getriebetyp (0:manual; 1:automatisch; 2: automatisch shift; 3: continous variable; 4:automatisch manual/nur Z-Car)" VALUE 0xD5794 Kw_Wu8 3.000 OneToOne 0.00 3.000 FORMAT "%5.3" EXTENDED_LIMITS 0.00 255.0 /end CHARACTERISTIC
/begin CHARACTERISTIC Gearbx_swtTypeType_C "Getriebetyp-Ablageart" VALUE 0xD5795 Kw_Wu8 1.000 OneToOne 1.000 2.000 FORMAT "%5.3" EXTENDED_LIMITS 0.00 255.0 /end CHARACTERISTIC
/begin CHARACTERISTIC Gearbx_swtUnplausChk_C "#SSD Schalter für Momentenüberschussintegral (1...ein, 0...aus)." VALUE 0xD58A2 Kw_Wu8 1.000 OneToOne 0.00 1.000 FORMAT "%5.3" EXTENDED_LIMITS 0.00 255.0 /end CHARACTERISTIC
/begin CHARACTERISTIC Gearbx_tiDebMaxOk_C "Heilungsentprellzeit der physikalischen Unplausibilität" VALUE 0xD58A4 Kw_Wu16 655350.0 TimeDeb 0.00 655350.0 FORMAT "%8.1" /end CHARACTERISTIC
/begin CHARACTERISTIC Gearbx_tiDebMaxDef_C "Fehlerentprellzeit der physikalischen Unplausibilität" VALUE 0xD58A6 Kw_Wu16 655350.0 TimeDeb 0.00 655350.0 FORMAT "%8.1" /end CHARACTERISTIC
/begin CHARACTERISTIC Gearbx_trqDecMax_C "#SSD Decreasing torque intervention" VALUE 0xD58A8 Kw_Ws16 1500.000 Trq -500.0000 1000.000 FORMAT "%8.3" EXTENDED_LIMITS -3276.800 3276.700 /end CHARACTERISTIC
/begin CHARACTERISTIC Gearbx_trqDecMax_CUR "#SSD Calculates the maximum torque that can be decremented depending on the engine speed" CURVE 0xD58AA Kl_Xs16_Ws16 1500.000 Trq -500.0000 1000.000 FORMAT "%8.3" EXTENDED_LIMITS -3276.800 3276.700
 /begin AXIS_DESCR STD_AXIS Eng_nAvrg EngN 16 0.00 6000.000 FORMAT "%8.3" EXTENDED_LIMITS -32768.00 32767.00 DEPOSIT ABSOLUTE /end AXIS_DESCR
/end CHARACTERISTIC
/begin CHARACTERISTIC Gearbx_dtrqLimUptrqDec_C "Ramp up slope for decrease in torque" VALUE 0xD58EC Kw_Wu32 6553599.99847 RmpTrq 0.00 6553599.99847 FORMAT "%13.5" /end CHARACTERISTIC
/begin CHARACTERISTIC Gearbx_dtrqLimDwntrqDec_C "Ramp down slope for decrease in torque" VALUE 0xD58F0 Kw_Wu32 6553599.99847 RmpTrq 0.00 6553599.99847 FORMAT "%13.5" /end CHARACTERISTIC
/begin CHARACTERISTIC Gearbx_trqIncMax_C "Maximum Gearbox Increasing torque" VALUE 0xD58F4 Kw_Ws16 1500.000 Trq -500.0000 1000.000 FORMAT "%8.3" EXTENDED_LIMITS -3276.800 3276.700 /end CHARACTERISTIC
/begin CHARACTERISTIC Gearbx_trqIncMin_C "Increasing torque intervention" VALUE 0xD58F6 Kw_Ws16 1500.000 Trq -500.0000 1000.000 FORMAT "%8.3" EXTENDED_LIMITS -3276.800 3276.700 /end CHARACTERISTIC
/begin CHARACTERISTIC Gearbx_dtrqLimUptrqInc_C "Torque ramp up slope for increase in torque" VALUE 0xD58F8 Kw_Wu32 6553599.99847 RmpTrq 0.00 6553599.99847 FORMAT "%13.5" /end CHARACTERISTIC
/begin CHARACTERISTIC Gearbx_dtrqLimDwntrqInc_C "Torque ramp down slope for increase in torque" VALUE 0xD58FC Kw_Wu32 6553599.99847 RmpTrq 0.00 6553599.99847 FORMAT "%13.5" /end CHARACTERISTIC
/begin CHARACTERISTIC Gearbx_trqInMax_CUR "Kurve für maximales Getriebeeingangsmoment bei Leerlauf" CURVE 0xD5934 Kl_Xs16_Ws16 1000.000 Trq 0.00 1000.000 FORMAT "%8.3" EXTENDED_LIMITS -3276.800 3276.700
 /begin AXIS_DESCR STD_AXIS Eng_nAvrg EngN 10 0.00 6000.000 FORMAT "%8.3" EXTENDED_LIMITS -32768.00 32767.00 DEPOSIT ABSOLUTE /end AXIS_DESCR
/end CHARACTERISTIC
/begin CHARACTERISTIC Gearbx_trqInMax_Vector "#SSD Bypass Label, nicht ändern!" VALUE 0xC30F0 Kw_Wu8 255.0 OneToOne 0.00 255.0 FORMAT "%5.1" /end CHARACTERISTIC
/begin CHARACTERISTIC Gearbx_trqInMax_Channel "#SSD Bypass Label, nicht ändern!" VALUE 0xC30F1 Kw_Wu8 255.0 OneToOne 0.00 255.0 FORMAT "%5.1" /end CHARACTERISTIC
/begin CHARACTERISTIC Gearbx_trqMaxErr2_CUR "Curve for calculation of maximum input torque of gearbox (error2 value)" CURVE 0xD595E Kl_Xs16_Ws16 1000.000 Trq 0.00 1000.000 FORMAT "%8.3" EXTENDED_LIMITS -3276.800 3276.700
 /begin AXIS_DESCR STD_AXIS Eng_nAvrg EngN 25 0.00 6000.000 FORMAT "%8.3" EXTENDED_LIMITS -32768.00 32767.00 DEPOSIT ABSOLUTE /end AXIS_DESCR
/end CHARACTERISTIC
/begin CHARACTERISTIC Gearbx_trqMaxErr_CUR "Curve for calculation of maximum input torque of gearbox (error value)" CURVE 0xD59C4 Kl_Xs16_Ws16 1000.000 Trq 0.00 1000.000 FORMAT "%8.3" EXTENDED_LIMITS -3276.800 3276.700
 /begin AXIS_DESCR STD_AXIS Eng_nAvrg EngN 10 0.00 6000.000 FORMAT "%8.3" EXTENDED_LIMITS -32768.00 32767.00 DEPOSIT ABSOLUTE /end AXIS_DESCR
/end CHARACTERISTIC
/begin CHARACTERISTIC Gearbx_trqMaxGear1_CUR "Begrenzungsmoment für ersten Gang" CURVE 0xD59EE Kl_Xs16_Ws16 1000.000 Trq 0.00 1000.000 FORMAT "%8.3" EXTENDED_LIMITS -3276.800 3276.700
 /begin AXIS_DESCR STD_AXIS Eng_nAvrg EngN 10 0.00 6000.000 FORMAT "%8.3" EXTENDED_LIMITS -32768.00 32767.00 DEPOSIT ABSOLUTE /end AXIS_DESCR
/end CHARACTERISTIC
/begin CHARACTERISTIC Gearbx_trqMaxGear2_CUR "Begrenzungsmoment für zweiten Gang" CURVE 0xD5A18 Kl_Xs16_Ws16 1000.000 Trq 0.00 1000.000 FORMAT "%8.3" EXTENDED_LIMITS -3276.800 3276.700
 /begin AXIS_DESCR STD_AXIS Eng_nAvrg EngN 10 0.00 6000.000 FORMAT "%8.3" EXTENDED_LIMITS -32768.00 32767.00 DEPOSIT ABSOLUTE /end AXIS_DESCR
/end CHARACTERISTIC
/begin CHARACTERISTIC Gearbx_trqMaxGear3_CUR "Begrenzungsmoment für dritten Gang" CURVE 0xD5A42 Kl_Xs16_Ws16 1000.000 Trq 0.00 1000.000 FORMAT "%8.3" EXTENDED_LIMITS -3276.800 3276.700
 /begin AXIS_DESCR STD_AXIS Eng_nAvrg EngN 10 0.00 6000.000 FORMAT "%8.3" EXTENDED_LIMITS -32768.00 32767.00 DEPOSIT ABSOLUTE /end AXIS_DESCR
/end CHARACTERISTIC
/begin CHARACTERISTIC Gearbx_trqMaxGear4_CUR "Begrenzungsmoment für vierten Gang" CURVE 0xD5A6C Kl_Xs16_Ws16 1000.000 Trq 0.00 1000.000 FORMAT "%8.3" EXTENDED_LIMITS -3276.800 3276.700
 /begin AXIS_DESCR STD_AXIS Eng_nAvrg EngN 10 0.00 6000.000 FORMAT "%8.3" EXTENDED_LIMITS -32768.00 32767.00 DEPOSIT ABSOLUTE /end AXIS_DESCR
/end CHARACTERISTIC
/begin CHARACTERISTIC Gearbx_trqMaxGear5_CUR "Begrenzungsmoment für fünften Gang" CURVE 0xD5A96 Kl_Xs16_Ws16 1000.000 Trq 0.00 1000.000 FORMAT "%8.3" EXTENDED_LIMITS -3276.800 3276.700
 /begin AXIS_DESCR STD_AXIS Eng_nAvrg EngN 10 0.00 6000.000 FORMAT "%8.3" EXTENDED_LIMITS -32768.00 32767.00 DEPOSIT ABSOLUTE /end AXIS_DESCR
/end CHARACTERISTIC
/begin CHARACTERISTIC Gearbx_trqMaxGear6_CUR "Begrenzungsmoment für sechsten Gang" CURVE 0xD5AC0 Kl_Xs16_Ws16 1000.000 Trq 0.00 1000.000 FORMAT "%8.3" EXTENDED_LIMITS -3276.800 3276.700
 /begin AXIS_DESCR STD_AXIS Eng_nAvrg EngN 10 0.00 6000.000 FORMAT "%8.3" EXTENDED_LIMITS -32768.00 32767.00 DEPOSIT ABSOLUTE /end AXIS_DESCR
/end CHARACTERISTIC
/begin CHARACTERISTIC Gearbx_trqMaxGearR_CUR "Begrenzungsmoment für Rückwärtsgang" CURVE 0xD5AEA Kl_Xs16_Ws16 1000.000 Trq 0.00 1000.000 FORMAT "%8.3" EXTENDED_LIMITS -3276.800 3276.700
 /begin AXIS_DESCR STD_AXIS Eng_nAvrg EngN 10 0.00 6000.000 FORMAT "%8.3" EXTENDED_LIMITS -32768.00 32767.00 DEPOSIT ABSOLUTE /end AXIS_DESCR
/end CHARACTERISTIC
/begin CHARACTERISTIC Gearbx_vTrqIntvVSSCDlim_C "VSSCD  torque intervention limit" VALUE 0xD5900 Kw_Wu16 655.3500 Vel 0.00 655.3500 FORMAT "%8.4" /end CHARACTERISTIC
/begin CHARACTERISTIC Gearbx_vTrqLim_C "Vehicle speed limit for gearbox torque limitation" VALUE 0xD5B14 Kw_Ws16 300.0000 Vel 0.00 300.0000 FORMAT "%8.4" EXTENDED_LIMITS -327.6800 327.6700 /end CHARACTERISTIC
/begin MEASUREMENT FrmMng_aDirect "" SWORD Acc 1 100 -32.76800 32.76700 FORMAT "%8.5" ECU_ADDRESS 0x7F8CD2 /end MEASUREMENT
/begin MEASUREMENT FrmMng_aSide "acceleration vehicle across DSC" SWORD Acc 1 100 -32.76800 32.76700 FORMAT "%8.5" ECU_ADDRESS 0x7F8CD4 /end MEASUREMENT
/begin MEASUREMENT FrmMng_ctACC_TrqAlv "Alive Counter-message DREHMOMENT_ANF_ACC" UBYTE OneToOne 1 100 0.00 255.0 FORMAT "%5.1" ECU_ADDRESS 0x7F888D /end MEASUREMENT
/begin MEASUREMENT FrmMng_ctAnfRadMomPtalv_mp "Alive-Zähler für Botschaft ANF_RADMOM_PT" UBYTE OneToOne 1 100 0.00 255.0 FORMAT "%5.1" ECU_ADDRESS 0x8FF080 /end MEASUREMENT
/begin MEASUREMENT FrmMng_ctBOS_RESETalv_mp "alive-counter BOS_RESET" UWORD OneToOne 1 100 0.00 65535.00 FORMAT "%8.2" ECU_ADDRESS 0x8FF082 /end MEASUREMENT
/begin MEASUREMENT FrmMng_ctDM_ANF_AFSalv_mp "alive-counter DMANFAFS" UBYTE OneToOne 1 100 0.00 255.0 FORMAT "%5.1" ECU_ADDRESS 0x8FF084 /end MEASUREMENT
/begin MEASUREMENT FrmMng_ctDRMANFSSGalv_mp "alive-counter DRMANFSSG" UBYTE OneToOne 1 100 0.00 255.0 FORMAT "%5.1" ECU_ADDRESS 0x8FF085 /end MEASUREMENT
/begin MEASUREMENT FrmMng_ctENGINE1alv_mp "Lebenszeichen-Zähler fuer CAN-Botschaft ENGINE1" UBYTE OneToOne 1 100 0.00 255.0 FORMAT "%5.1" ECU_ADDRESS 0x8FF086 /end MEASUREMENT
/begin MEASUREMENT FrmMng_ctOPCRCTLACCalv_mp "alive-counter OP_CRCTLACC" UBYTE OneToOne 1 100 0.00 255.0 FORMAT "%5.1" ECU_ADDRESS 0x8FF087 /end MEASUREMENT
/begin MEASUREMENT FrmMng_ctRadMom1alv_mp "Alive Zähler Botschaft RADMOM_PT_1" UWORD OneToOne 1 100 0.00 65535.00 FORMAT "%8.2" ECU_ADDRESS 0x8FF088 /end MEASUREMENT
/begin MEASUREMENT FrmMng_ctRadMom2alv_mp "Alive Zähler Botschaft RADMOM_PT_2" UWORD OneToOne 1 100 0.00 65535.00 FORMAT "%8.2" ECU_ADDRESS 0x8FF08A /end MEASUREMENT
/begin MEASUREMENT FrmMng_ctrIdxNo "index counter for velocities" UBYTE OneToOne 1 100 0.00 255.0 FORMAT "%5.1" ECU_ADDRESS 0x7F888F /end MEASUREMENT
/begin MEASUREMENT FrmMng_ctrRel "relativ counter" ULONG OneToOne 1 100 0.00 4294967295.00 FORMAT "%13.2" ECU_ADDRESS 0x7F91A4 /end MEASUREMENT
/begin MEASUREMENT FrmMng_ctSTAT_ARSalv_mp "STAT_ARS alivecounter" UBYTE OneToOne 1 100 0.00 255.0 FORMAT "%5.1" ECU_ADDRESS 0x8FF08C /end MEASUREMENT
/begin MEASUREMENT FrmMng_ctSTAT_KOMBIalv "Alive Zähler Kombi" UBYTE OneToOne 1 100 0.00 255.0 FORMAT "%5.1" ECU_ADDRESS 0x7F888E /end MEASUREMENT
/begin MEASUREMENT FrmMng_ctTERMINALalv_mp "alive-counter TERMINAL" UBYTE OneToOne 1 100 0.00 255.0 FORMAT "%5.1" ECU_ADDRESS 0x8FF08D /end MEASUREMENT
/begin MEASUREMENT FrmMng_ctTORQUE1alv_mp "Lebenszeichen-Zähler fuer CAN-Botschaft TORQUE1" UWORD OneToOne 1 100 0.00 65535.00 FORMAT "%8.2" ECU_ADDRESS 0x8FF08E /end MEASUREMENT
/begin MEASUREMENT FrmMng_ctTORQUE2alv_mp "Lebenszeichen-Zähler fuer CAN-Botschaft TORQUE2" UWORD OneToOne 1 100 0.00 65535.00 FORMAT "%8.2" ECU_ADDRESS 0x8FF090 /end MEASUREMENT
/begin MEASUREMENT FrmMng_ctTORQUE3alv_mp "Lebenszeichen-Zähler fuer CAN-Botschaft TORQUE3" UWORD OneToOne 1 100 0.00 65535.00 FORMAT "%8.2" ECU_ADDRESS 0x8FF092 /end MEASUREMENT
/begin MEASUREMENT FrmMng_ctTORQUE_DSCalv_mp "TORQUE_DSC alivecounter" UBYTE OneToOne 1 100 0.00 255.0 FORMAT "%5.1" ECU_ADDRESS 0x8FF094 /end MEASUREMENT
/begin MEASUREMENT FrmMng_ctTORQUE_GEARBXalv_mp "TORQUE_GEARBX alivecounter" UBYTE OneToOne 1 100 0.00 255.0 FORMAT "%5.1" ECU_ADDRESS 0x8FF095 /end MEASUREMENT
/begin MEASUREMENT FrmMng_ctVEH_MODalv_mp "alive-counter for VEH_MOD signal" UBYTE OneToOne 1 100 0.00 255.0 FORMAT "%5.1" ECU_ADDRESS 0x8FF096 /end MEASUREMENT
/begin MEASUREMENT FrmMng_dACC_CkSTrq "Checksumm-message DREHMOMENT_ANF_ACC" UBYTE OneToOne 1 100 0.00 255.0 FORMAT "%5.1" ECU_ADDRESS 0x7F8890 /end MEASUREMENT
/begin MEASUREMENT FrmMng_dAnfRadMomPtcs_mp "Checksum für ANF_RADMOM_PT" UWORD OneToOne 1 100 0.00 65535.00 FORMAT "%8.2" ECU_ADDRESS 0x8FF098 /end MEASUREMENT
/begin MEASUREMENT FrmMng_dDM_ANF_AFScs_mp "calculated checksum DMANFAFS" UBYTE OneToOne 1 100 0.00 255.0 FORMAT "%5.1" ECU_ADDRESS 0x8FF09A /end MEASUREMENT
/begin MEASUREMENT FrmMng_dDRMANFSSGcs_mp "checksum DRMANFSSG" UBYTE OneToOne 1 100 0.00 255.0 FORMAT "%5.1" ECU_ADDRESS 0x8FF09B /end MEASUREMENT
/begin MEASUREMENT FrmMng_dOBDCtl_mp "Measuring Point for OBD status" UBYTE OneToOne 1 100 0.00 255.0 FORMAT "%5.1" ECU_ADDRESS 0x8FEFE6 /end MEASUREMENT
/begin MEASUREMENT FrmMng_dOPCRCTLACCcs_mp "checksum OP_CRCTLACC" UBYTE OneToOne 1 100 0.00 255.0 FORMAT "%5.1" ECU_ADDRESS 0x8FF09C /end MEASUREMENT
/begin MEASUREMENT FrmMng_dphiStrg "Rate of change of steering angle recieved over CAN" SWORD AngleGradPerSec 1 100 -1440.154 1440.110 FORMAT "%8.3" ECU_ADDRESS 0x7F8CD8 /end MEASUREMENT
/begin MEASUREMENT FrmMng_dRadMom1cs_mp "Checksumme Botschaft RADMOM_PT_1" UBYTE OneToOne 1 100 0.00 255.0 FORMAT "%5.1" ECU_ADDRESS 0x8FF09D /end MEASUREMENT
/begin MEASUREMENT FrmMng_dRadMom2cs_mp "Checksumme Botschaft RADMOM_PT_2" UBYTE OneToOne 1 100 0.00 255.0 FORMAT "%5.1" ECU_ADDRESS 0x8FF09E /end MEASUREMENT
/begin MEASUREMENT FrmMng_dSlopeACP "slope of frmmng accelerator pedal value" SWORD SlopeRes1000 1 100 -32.76800 32.76700 FORMAT "%8.5" ECU_ADDRESS 0x7F8CD6 /end MEASUREMENT
/begin MEASUREMENT FrmMng_dTERMINALcs_mp "checksum TERMINAL" UBYTE OneToOne 1 100 0.00 255.0 FORMAT "%5.1" ECU_ADDRESS 0x8FF09F /end MEASUREMENT
/begin MEASUREMENT FrmMng_dTORQUE1cs_mp "Checksumme der CAN-Botschaft TORQUE1" UWORD OneToOne 1 100 0.00 65535.00 FORMAT "%8.2" ECU_ADDRESS 0x8FF0A0 /end MEASUREMENT
/begin MEASUREMENT FrmMng_dTORQUE2cs_mp "Checksumme der CAN-Botschaft TORQUE2" UWORD OneToOne 1 100 0.00 65535.00 FORMAT "%8.2" ECU_ADDRESS 0x8FF0A2 /end MEASUREMENT
/begin MEASUREMENT FrmMng_dTORQUE3cs_mp "Checksumme der CAN-Botschaft TORQUE3" UWORD OneToOne 1 100 0.00 65535.00 FORMAT "%8.2" ECU_ADDRESS 0x8FF0A4 /end MEASUREMENT
/begin MEASUREMENT FrmMng_dTORQUE_DSCcs_mp "TORQUE_DSC checksum" UBYTE OneToOne 1 100 0.00 255.0 FORMAT "%5.1" ECU_ADDRESS 0x8FF0A6 /end MEASUREMENT
/begin MEASUREMENT FrmMng_dTORQUE_GEARBXcs_mp "TORQUE_GEARBX checksum" UBYTE OneToOne 1 100 0.00 255.0 FORMAT "%5.1" ECU_ADDRESS 0x8FF0A7 /end MEASUREMENT
/begin MEASUREMENT FrmMng_dVEH_MODcs_mp "checksum for VEH_MOD signal" UBYTE OneToOne 1 100 0.00 255.0 FORMAT "%5.1" ECU_ADDRESS 0x8FF0A8 /end MEASUREMENT
/begin MEASUREMENT FrmMng_iHiLimCurr "Botschaft für I_SC_MAX_VEH CAN signal" UBYTE i_ub_q10p0 1 100 0.00 2550. FORMAT "%5.0" ECU_ADDRESS 0x7F8891 /end MEASUREMENT
/begin MEASUREMENT FrmMng_iLoLimCurr "Botschaft für I_SC_MIN_VEH CAN signal" UBYTE i_ub_q10p0 1 100 0.00 2550. FORMAT "%5.0" ECU_ADDRESS 0x7F8892 /end MEASUREMENT
/begin MEASUREMENT FrmMng_iZrCurrLim "Botschaft für QC_VEH CAN signal" UBYTE i_ub_q0p001 1 100 0.00 0.2550 FORMAT "%6.4" ECU_ADDRESS 0x7F8893 /end MEASUREMENT
/begin MEASUREMENT FrmMng_lSum "Kilometerstand des Fahrzeugs" ULONG LengthKm 1 100 0.00 4294967295.00 FORMAT "%13.2" ECU_ADDRESS 0x7F91A8 /end MEASUREMENT
/begin MEASUREMENT FrmMng_nBattCls "Botschaft für MAG_BT CAN signal" UBYTE DEZ 1 100 0.00 255.0 FORMAT "%5.1" ECU_ADDRESS 0x7F8894 /end MEASUREMENT
/begin MEASUREMENT FrmMng_nEngRpm1 "Engine rpm threshold 1 to be given to the drag indicator on kombi" UWORD EngN 1 100 0.00 65535.00 FORMAT "%8.2" ECU_ADDRESS 0x7F8CDA /end MEASUREMENT
/begin MEASUREMENT FrmMng_nEngRpm2 "Engine rpm threshold 2 to be given to the drag indicator on kombi" UWORD EngN 1 100 0.00 65535.00 FORMAT "%8.2" ECU_ADDRESS 0x7F8CDC /end MEASUREMENT
/begin MEASUREMENT FrmMng_nFan "Lüfterdrehzahl" SWORD FanSpd 1 100 -3000.092 3000.000 FORMAT "%8.3" ECU_ADDRESS 0x7F8CDE /end MEASUREMENT
/begin MEASUREMENT FrmMng_nLimSSG "Maximum engine speed in phase 2 of the switching process" SWORD EngN 1 100 -32768.00 32767.00 FORMAT "%8.2" ECU_ADDRESS 0x7F8CE0 /end MEASUREMENT
/begin MEASUREMENT FrmMng_nPSP "Ist-Drehzahl EKP" SWORD PSP_Spd 1 100 -32768.00 32767.00 FORMAT "%8.2" ECU_ADDRESS 0x7F8CE2 /end MEASUREMENT
/begin MEASUREMENT FrmMng_nRqStgEFan "Anforderung LüfterDrehzahl" UWORD FanSpd 1 100 0.00 6000.092 FORMAT "%8.3" ECU_ADDRESS 0x7F8CE4 /end MEASUREMENT
/begin MEASUREMENT FrmMng_nTSC "take off engine speed" SWORD EngN 1 100 -32768.00 32767.00 FORMAT "%8.2" ECU_ADDRESS 0x7F8CE8 /end MEASUREMENT
/begin MEASUREMENT FrmMng_numACFanDes "fanspeed desired by AC" UBYTE OneToOne 1 100 0.00 255.0 FORMAT "%5.1" ECU_ADDRESS 0x7F8895 /end MEASUREMENT
/begin MEASUREMENT FrmMng_numANFRADMOMPTbyte0_mp "Botschaft ANF_RADMOM_PT byteweise" UBYTE OneToOne 1 100 0.00 255.0 FORMAT "%5.1" ECU_ADDRESS 0x8FF0A9 /end MEASUREMENT
/begin MEASUREMENT FrmMng_numANFRADMOMPTbyte1_mp "Botschaft ANF_RADMOM_PT byteweise" UBYTE OneToOne 1 100 0.00 255.0 FORMAT "%5.1" ECU_ADDRESS 0x8FF0AA /end MEASUREMENT
/begin MEASUREMENT FrmMng_numANFRADMOMPTbyte2_mp "Botschaft ANF_RADMOM_PT byteweise" UBYTE OneToOne 1 100 0.00 255.0 FORMAT "%5.1" ECU_ADDRESS 0x8FF0AB /end MEASUREMENT
/begin MEASUREMENT FrmMng_numANFRADMOMPTbyte3_mp "Botschaft ANF_RADMOM_PT byteweise" UBYTE OneToOne 1 100 0.00 255.0 FORMAT "%5.1" ECU_ADDRESS 0x8FF0AC /end MEASUREMENT
/begin MEASUREMENT FrmMng_numANFRADMOMPTbyte4_mp "Botschaft ANF_RADMOM_PT byteweise" UBYTE OneToOne 1 100 0.00 255.0 FORMAT "%5.1" ECU_ADDRESS 0x8FF0AD /end MEASUREMENT
/begin MEASUREMENT FrmMng_numAnfrageByte0_mp "" UBYTE OneToOne 1 100 0.00 255.0 FORMAT "%5.1" ECU_ADDRESS 0x8FF0AE /end MEASUREMENT
/begin MEASUREMENT FrmMng_numAnfrageByte1_mp "" UBYTE OneToOne 1 100 0.00 255.0 FORMAT "%5.1" ECU_ADDRESS 0x8FF0AF /end MEASUREMENT
/begin MEASUREMENT FrmMng_numAnfrageByte2_mp "" UBYTE OneToOne 1 100 0.00 255.0 FORMAT "%5.1" ECU_ADDRESS 0x8FF0B0 /end MEASUREMENT
/begin MEASUREMENT FrmMng_numASC1byte0_mp "Rohwerte von der CAN-Botschaft ASC1" UBYTE OneToOne 1 100 0.00 255.0 FORMAT "%5.1" ECU_ADDRESS 0x8FEFE7 /end MEASUREMENT
/begin MEASUREMENT FrmMng_numASC1byte1_mp "Rohwerte von der CAN-Botschaft ASC1" UBYTE OneToOne 1 100 0.00 255.0 FORMAT "%5.1" ECU_ADDRESS 0x8FEFE8 /end MEASUREMENT
/begin MEASUREMENT FrmMng_numASC1byte2_mp "Rohwerte von der CAN-Botschaft ASC1" UBYTE OneToOne 1 100 0.00 255.0 FORMAT "%5.1" ECU_ADDRESS 0x8FEFE9 /end MEASUREMENT
/begin MEASUREMENT FrmMng_numASC1byte3_mp "Rohwerte von der CAN-Botschaft ASC1" UBYTE OneToOne 1 100 0.00 255.0 FORMAT "%5.1" ECU_ADDRESS 0x8FEFEA /end MEASUREMENT
/begin MEASUREMENT FrmMng_numASC1byte4_mp "Rohwerte von der CAN-Botschaft ASC1" UBYTE OneToOne 1 100 0.00 255.0 FORMAT "%5.1" ECU_ADDRESS 0x8FEFEB /end MEASUREMENT
/begin MEASUREMENT FrmMng_numASC1byte5_mp "Rohwerte von der CAN-Botschaft ASC1" UBYTE OneToOne 1 100 0.00 255.0 FORMAT "%5.1" ECU_ADDRESS 0x8FEFEC /end MEASUREMENT
/begin MEASUREMENT FrmMng_numASC1byte6_mp "Rohwerte von der CAN-Botschaft ASC1" UBYTE OneToOne 1 100 0.00 255.0 FORMAT "%5.1" ECU_ADDRESS 0x8FEFED /end MEASUREMENT
/begin MEASUREMENT FrmMng_numASC1byte7_mp "Rohwerte von der CAN-Botschaft ASC1" UBYTE OneToOne 1 100 0.00 255.0 FORMAT "%5.1" ECU_ADDRESS 0x8FEFEE /end MEASUREMENT
/begin MEASUREMENT FrmMng_numASC2byte0_mp "Rohwerte von der CAN-Botschaft ASC2" UBYTE OneToOne 1 100 0.00 255.0 FORMAT "%5.1" ECU_ADDRESS 0x8FEFEF /end MEASUREMENT
/begin MEASUREMENT FrmMng_numASC2byte1_mp "Rohwerte von der CAN-Botschaft ASC2" UBYTE OneToOne 1 100 0.00 255.0 FORMAT "%5.1" ECU_ADDRESS 0x8FEFF0 /end MEASUREMENT
/begin MEASUREMENT FrmMng_numASC2byte2_mp "Rohwerte von der CAN-Botschaft ASC2" UBYTE OneToOne 1 100 0.00 255.0 FORMAT "%5.1" ECU_ADDRESS 0x8FEFF1 /end MEASUREMENT
/begin MEASUREMENT FrmMng_numASC2byte3_mp "Rohwerte von der CAN-Botschaft ASC2" UBYTE OneToOne 1 100 0.00 255.0 FORMAT "%5.1" ECU_ADDRESS 0x8FEFF2 /end MEASUREMENT
/begin MEASUREMENT FrmMng_numASC2byte4_mp "Rohwerte von der CAN-Botschaft ASC2" UBYTE OneToOne 1 100 0.00 255.0 FORMAT "%5.1" ECU_ADDRESS 0x8FEFF3 /end MEASUREMENT
/begin MEASUREMENT FrmMng_numASC2byte5_mp "Rohwerte von der CAN-Botschaft ASC2" UBYTE OneToOne 1 100 0.00 255.0 FORMAT "%5.1" ECU_ADDRESS 0x8FEFF4 /end MEASUREMENT
/begin MEASUREMENT FrmMng_numASC2byte6_mp "Rohwerte von der CAN-Botschaft ASC2" UBYTE OneToOne 1 100 0.00 255.0 FORMAT "%5.1" ECU_ADDRESS 0x8FEFF5 /end MEASUREMENT
/begin MEASUREMENT FrmMng_numASC2byte7_mp "Rohwerte von der CAN-Botschaft ASC2" UBYTE OneToOne 1 100 0.00 255.0 FORMAT "%5.1" ECU_ADDRESS 0x8FEFF6 /end MEASUREMENT
/begin MEASUREMENT FrmMng_numASC3byte0_mp "Rohwerte von der CAN-Botschaft ASC3" UBYTE OneToOne 1 100 0.00 255.0 FORMAT "%5.1" ECU_ADDRESS 0x8FEFF7 /end MEASUREMENT
/begin MEASUREMENT FrmMng_numASC3byte1_mp "Rohwerte von der CAN-Botschaft ASC3" UBYTE OneToOne 1 100 0.00 255.0 FORMAT "%5.1" ECU_ADDRESS 0x8FEFF8 /end MEASUREMENT
/begin MEASUREMENT FrmMng_numASC3byte2_mp "Rohwerte von der CAN-Botschaft ASC3" UBYTE OneToOne 1 100 0.00 255.0 FORMAT "%5.1" ECU_ADDRESS 0x8FEFF9 /end MEASUREMENT
/begin MEASUREMENT FrmMng_numASC3byte3_mp "Rohwerte von der CAN-Botschaft ASC3" UBYTE OneToOne 1 100 0.00 255.0 FORMAT "%5.1" ECU_ADDRESS 0x8FEFFA /end MEASUREMENT
/begin MEASUREMENT FrmMng_numASC3byte4_mp "Rohwerte von der CAN-Botschaft ASC3" UBYTE OneToOne 1 100 0.00 255.0 FORMAT "%5.1" ECU_ADDRESS 0x8FEFFB /end MEASUREMENT
/begin MEASUREMENT FrmMng_numASC3byte5_mp "Rohwerte von der CAN-Botschaft ASC3" UBYTE OneToOne 1 100 0.00 255.0 FORMAT "%5.1" ECU_ADDRESS 0x8FEFFC /end MEASUREMENT
/begin MEASUREMENT FrmMng_numASC3byte6_mp "Rohwerte von der CAN-Botschaft ASC3" UBYTE OneToOne 1 100 0.00 255.0 FORMAT "%5.1" ECU_ADDRESS 0x8FEFFD /end MEASUREMENT
/begin MEASUREMENT FrmMng_numASC3byte7_mp "Rohwerte von der CAN-Botschaft ASC3" UBYTE OneToOne 1 100 0.00 255.0 FORMAT "%5.1" ECU_ADDRESS 0x8FEFFE /end MEASUREMENT
/begin MEASUREMENT FrmMng_numASC4byte0_mp "Rohwerte von der CAN-Botschaft ASC4" UBYTE OneToOne 1 100 0.00 255.0 FORMAT "%5.1" ECU_ADDRESS 0x8FEFFF /end MEASUREMENT
/begin MEASUREMENT FrmMng_numASC4byte1_mp "Rohwerte von der CAN-Botschaft ASC4" UBYTE OneToOne 1 100 0.00 255.0 FORMAT "%5.1" ECU_ADDRESS 0x8FF000 /end MEASUREMENT
/begin MEASUREMENT FrmMng_numASC4byte2_mp "Rohwerte von der CAN-Botschaft ASC4" UBYTE OneToOne 1 100 0.00 255.0 FORMAT "%5.1" ECU_ADDRESS 0x8FF001 /end MEASUREMENT
/begin MEASUREMENT FrmMng_numASC4byte3_mp "Rohwerte von der CAN-Botschaft ASC4" UBYTE OneToOne 1 100 0.00 255.0 FORMAT "%5.1" ECU_ADDRESS 0x8FF002 /end MEASUREMENT
/begin MEASUREMENT FrmMng_numASC4byte4_mp "Rohwerte von der CAN-Botschaft ASC4" UBYTE OneToOne 1 100 0.00 255.0 FORMAT "%5.1" ECU_ADDRESS 0x8FF003 /end MEASUREMENT
/begin MEASUREMENT FrmMng_numASC4byte5_mp "Rohwerte von der CAN-Botschaft ASC4" UBYTE OneToOne 1 100 0.00 255.0 FORMAT "%5.1" ECU_ADDRESS 0x8FF004 /end MEASUREMENT
/begin MEASUREMENT FrmMng_numASC4byte6_mp "Rohwerte von der CAN-Botschaft ASC4" UBYTE OneToOne 1 100 0.00 255.0 FORMAT "%5.1" ECU_ADDRESS 0x8FF005 /end MEASUREMENT
/begin MEASUREMENT FrmMng_numASC4byte7_mp "Rohwerte von der CAN-Botschaft ASC4" UBYTE OneToOne 1 100 0.00 255.0 FORMAT "%5.1" ECU_ADDRESS 0x8FF006 /end MEASUREMENT
/begin MEASUREMENT FrmMng_numBOS_MELDUNG2_OILbyte0_mp "" UBYTE OneToOne 1 100 0.00 255.0 FORMAT "%5.1" ECU_ADDRESS 0x8FF0B1 /end MEASUREMENT
/begin MEASUREMENT FrmMng_numBOS_MELDUNG2_OILbyte1_mp "" UBYTE OneToOne 1 100 0.00 255.0 FORMAT "%5.1" ECU_ADDRESS 0x8FF0B2 /end MEASUREMENT
/begin MEASUREMENT FrmMng_numBOS_MELDUNG2_OILbyte2_mp "" UBYTE OneToOne 1 100 0.00 255.0 FORMAT "%5.1" ECU_ADDRESS 0x8FF0B3 /end MEASUREMENT
/begin MEASUREMENT FrmMng_numBOS_MELDUNG2_OILbyte3_mp "" UBYTE OneToOne 1 100 0.00 255.0 FORMAT "%5.1" ECU_ADDRESS 0x8FF0B4 /end MEASUREMENT
/begin MEASUREMENT FrmMng_numBOS_MELDUNG2_OILbyte4_mp "" UBYTE OneToOne 1 100 0.00 255.0 FORMAT "%5.1" ECU_ADDRESS 0x8FF0B5 /end MEASUREMENT
/begin MEASUREMENT FrmMng_numBOS_MELDUNG2_OILbyte5_mp "" UBYTE OneToOne 1 100 0.00 255.0 FORMAT "%5.1" ECU_ADDRESS 0x8FF0B6 /end MEASUREMENT
/begin MEASUREMENT FrmMng_numBOS_MELDUNG2_OILbyte6_mp "" UBYTE OneToOne 1 100 0.00 255.0 FORMAT "%5.1" ECU_ADDRESS 0x8FF0B7 /end MEASUREMENT
/begin MEASUREMENT FrmMng_numBOS_MELDUNG_OILbyte0_mp "" UBYTE OneToOne 1 100 0.00 255.0 FORMAT "%5.1" ECU_ADDRESS 0x8FF0B8 /end MEASUREMENT
/begin MEASUREMENT FrmMng_numBOS_MELDUNG_OILbyte1_mp "" UBYTE OneToOne 1 100 0.00 255.0 FORMAT "%5.1" ECU_ADDRESS 0x8FF0B9 /end MEASUREMENT
/begin MEASUREMENT FrmMng_numBOS_MELDUNG_OILbyte2_mp "" UBYTE OneToOne 1 100 0.00 255.0 FORMAT "%5.1" ECU_ADDRESS 0x8FF0BA /end MEASUREMENT
/begin MEASUREMENT FrmMng_numBOS_MELDUNG_OILbyte3_mp "" UBYTE OneToOne 1 100 0.00 255.0 FORMAT "%5.1" ECU_ADDRESS 0x8FF0BB /end MEASUREMENT
/begin MEASUREMENT FrmMng_numBOS_MELDUNG_OILbyte4_mp "" UBYTE OneToOne 1 100 0.00 255.0 FORMAT "%5.1" ECU_ADDRESS 0x8FF0BC /end MEASUREMENT
/begin MEASUREMENT FrmMng_numBOS_MELDUNG_OILbyte5_mp "" UBYTE OneToOne 1 100 0.00 255.0 FORMAT "%5.1" ECU_ADDRESS 0x8FF0BD /end MEASUREMENT
/begin MEASUREMENT FrmMng_numBOS_MELDUNG_OILbyte6_mp "" UBYTE OneToOne 1 100 0.00 255.0 FORMAT "%5.1" ECU_ADDRESS 0x8FF0BE /end MEASUREMENT
/begin MEASUREMENT FrmMng_numBOS_MELDUNG_OILbyte7_mp "" UBYTE OneToOne 1 100 0.00 255.0 FORMAT "%5.1" ECU_ADDRESS 0x8FF0BF /end MEASUREMENT
/begin MEASUREMENT FrmMng_numBOS_PFLTbyte0_mp "" UBYTE OneToOne 1 100 0.00 255.0 FORMAT "%5.1" ECU_ADDRESS 0x8FF0C0 /end MEASUREMENT
/begin MEASUREMENT FrmMng_numBOS_PFLTbyte1_mp "" UBYTE OneToOne 1 100 0.00 255.0 FORMAT "%5.1" ECU_ADDRESS 0x8FF0C1 /end MEASUREMENT
/begin MEASUREMENT FrmMng_numBOS_PFLTbyte2_mp "" UBYTE OneToOne 1 100 0.00 255.0 FORMAT "%5.1" ECU_ADDRESS 0x8FF0C2 /end MEASUREMENT
/begin MEASUREMENT FrmMng_numBOS_PFLTbyte3_mp "" UBYTE OneToOne 1 100 0.00 255.0 FORMAT "%5.1" ECU_ADDRESS 0x8FF0C3 /end MEASUREMENT
/begin MEASUREMENT FrmMng_numBOS_PFLTbyte4_mp "" UBYTE OneToOne 1 100 0.00 255.0 FORMAT "%5.1" ECU_ADDRESS 0x8FF0C4 /end MEASUREMENT
/begin MEASUREMENT FrmMng_numBOS_PFLTbyte5_mp "" UBYTE OneToOne 1 100 0.00 255.0 FORMAT "%5.1" ECU_ADDRESS 0x8FF0C5 /end MEASUREMENT
/begin MEASUREMENT FrmMng_numBOS_PFLTbyte6_mp "" UBYTE OneToOne 1 100 0.00 255.0 FORMAT "%5.1" ECU_ADDRESS 0x8FF0C6 /end MEASUREMENT
/begin MEASUREMENT FrmMng_numBOS_PFLTbyte7_mp "" UBYTE OneToOne 1 100 0.00 255.0 FORMAT "%5.1" ECU_ADDRESS 0x8FF0C7 /end MEASUREMENT
/begin MEASUREMENT FrmMng_numBOS_RESETbyte0_mp "BOS_RESET Byte0" UBYTE OneToOne 1 100 0.00 255.0 FORMAT "%5.1" ECU_ADDRESS 0x8FF0C8 /end MEASUREMENT
/begin MEASUREMENT FrmMng_numBOS_RESETbyte1_mp "BOS_RESET Byte1" UBYTE OneToOne 1 100 0.00 255.0 FORMAT "%5.1" ECU_ADDRESS 0x8FF0C9 /end MEASUREMENT
/begin MEASUREMENT FrmMng_numBOS_RESETbyte2_mp "BOS_RESET Byte2" UBYTE OneToOne 1 100 0.00 255.0 FORMAT "%5.1" ECU_ADDRESS 0x8FF0CA /end MEASUREMENT
/begin MEASUREMENT FrmMng_numBOS_RESETbyte3_mp "BOS_RESET Byte3" UBYTE OneToOne 1 100 0.00 255.0 FORMAT "%5.1" ECU_ADDRESS 0x8FF0CB /end MEASUREMENT
/begin MEASUREMENT FrmMng_numBOS_RESETbyte4_mp "BOS_RESET Byte4" UBYTE OneToOne 1 100 0.00 255.0 FORMAT "%5.1" ECU_ADDRESS 0x8FF0CC /end MEASUREMENT
/begin MEASUREMENT FrmMng_numBOS_RESETbyte5_mp "BOS_RESET Byte5" UBYTE OneToOne 1 100 0.00 255.0 FORMAT "%5.1" ECU_ADDRESS 0x8FF0CD /end MEASUREMENT
/begin MEASUREMENT FrmMng_numBOS_RESETbyte6_mp "BOS_RESET Byte6" UBYTE OneToOne 1 100 0.00 255.0 FORMAT "%5.1" ECU_ADDRESS 0x8FF0CE /end MEASUREMENT
/begin MEASUREMENT FrmMng_numBOS_RESETbyte7_mp "BOS_RESET Byte7" UBYTE OneToOne 1 100 0.00 255.0 FORMAT "%5.1" ECU_ADDRESS 0x8FF0CF /end MEASUREMENT
/begin MEASUREMENT FrmMng_numBOS_RESET_2byte0_mp "" UBYTE OneToOne 1 100 0.00 255.0 FORMAT "%5.1" ECU_ADDRESS 0x8FF0D0 /end MEASUREMENT
/begin MEASUREMENT FrmMng_numBOS_RESET_2byte1_mp "" UBYTE OneToOne 1 100 0.00 255.0 FORMAT "%5.1" ECU_ADDRESS 0x8FF0D1 /end MEASUREMENT
/begin MEASUREMENT FrmMng_numBOS_RESET_2byte2_mp "" UBYTE OneToOne 1 100 0.00 255.0 FORMAT "%5.1" ECU_ADDRESS 0x8FF0D2 /end MEASUREMENT
/begin MEASUREMENT FrmMng_numBOS_RESET_2byte3_mp "" UBYTE OneToOne 1 100 0.00 255.0 FORMAT "%5.1" ECU_ADDRESS 0x8FF0D3 /end MEASUREMENT
/begin MEASUREMENT FrmMng_numBOS_RESET_2byte4_mp "" UBYTE OneToOne 1 100 0.00 255.0 FORMAT "%5.1" ECU_ADDRESS 0x8FF0D4 /end MEASUREMENT
/begin MEASUREMENT FrmMng_numBOS_RESET_2byte5_mp "" UBYTE OneToOne 1 100 0.00 255.0 FORMAT "%5.1" ECU_ADDRESS 0x8FF0D5 /end MEASUREMENT
/begin MEASUREMENT FrmMng_numBOS_RESET_2byte6_mp "" UBYTE OneToOne 1 100 0.00 255.0 FORMAT "%5.1" ECU_ADDRESS 0x8FF0D6 /end MEASUREMENT
/begin MEASUREMENT FrmMng_numCCMsgbyte0_mp "Byte 0 Rohwert in der Can Nachricht  der letzten gesendeten Checkcontrol Meldung" UBYTE OneToOne 1 100 0.00 255.0 FORMAT "%5.1" ECU_ADDRESS 0x8FF0D7 /end MEASUREMENT
/begin MEASUREMENT FrmMng_numCCMsgbyte1_mp "Byte 1 Rohwert in der Can Nachricht  der letzten gesendeten Checkcontrol Meldung" UBYTE OneToOne 1 100 0.00 255.0 FORMAT "%5.1" ECU_ADDRESS 0x8FF0D8 /end MEASUREMENT
/begin MEASUREMENT FrmMng_numCCMsgbyte2_mp "Byte 2 Rohwert in der Can Nachricht  der letzten gesendeten Checkcontrol Meldung" UBYTE OneToOne 1 100 0.00 255.0 FORMAT "%5.1" ECU_ADDRESS 0x8FF0D9 /end MEASUREMENT
/begin MEASUREMENT FrmMng_numCCMsgbyte3_mp "Byte 3 Rohwert in der Can Nachricht  der letzten gesendeten Checkcontrol Meldung" UBYTE OneToOne 1 100 0.00 255.0 FORMAT "%5.1" ECU_ADDRESS 0x8FF0DA /end MEASUREMENT
/begin MEASUREMENT FrmMng_numCCMsgbyte4_mp "Byte 4 Rohwert in der Can Nachricht  der letzten gesendeten Checkcontrol Meldung" UBYTE OneToOne 1 100 0.00 255.0 FORMAT "%5.1" ECU_ADDRESS 0x8FF0DB /end MEASUREMENT
/begin MEASUREMENT FrmMng_numCCMsgbyte5_mp "Byte 5 Rohwert in der Can Nachricht  der letzten gesendeten Checkcontrol Meldung" UBYTE OneToOne 1 100 0.00 255.0 FORMAT "%5.1" ECU_ADDRESS 0x8FF0DC /end MEASUREMENT
/begin MEASUREMENT FrmMng_numCCMsgbyte6_mp "Byte 6 Rohwert in der Can Nachricht  der letzten gesendeten Checkcontrol Meldung" UBYTE OneToOne 1 100 0.00 255.0 FORMAT "%5.1" ECU_ADDRESS 0x8FF0DD /end MEASUREMENT
/begin MEASUREMENT FrmMng_numCCMsgbyte7_mp "Byte 7 Rohwert in der Can Nachricht  der letzten gesendeten Checkcontrol Meldung" UBYTE OneToOne 1 100 0.00 255.0 FORMAT "%5.1" ECU_ADDRESS 0x8FF0DE /end MEASUREMENT
/begin MEASUREMENT FrmMng_numDDE1byte0_mp "Rohwerte für DDE1" UBYTE OneToOne 1 100 0.00 255.0 FORMAT "%5.1" ECU_ADDRESS 0x8FF007 /end MEASUREMENT
/begin MEASUREMENT FrmMng_numDDE1byte1_mp "Rohwete für DDE1" UBYTE OneToOne 1 100 0.00 255.0 FORMAT "%5.1" ECU_ADDRESS 0x8FF008 /end MEASUREMENT
/begin MEASUREMENT FrmMng_numDDE1byte2_mp "Rohwerte für DDE1" UBYTE OneToOne 1 100 0.00 255.0 FORMAT "%5.1" ECU_ADDRESS 0x8FF009 /end MEASUREMENT
/begin MEASUREMENT FrmMng_numDDE1byte3_mp "Rohwerte für DDE1" UBYTE OneToOne 1 100 0.00 255.0 FORMAT "%5.1" ECU_ADDRESS 0x8FF00A /end MEASUREMENT
/begin MEASUREMENT FrmMng_numDDE1byte4_mp "Rohwerte für DDE1" UBYTE OneToOne 1 100 0.00 255.0 FORMAT "%5.1" ECU_ADDRESS 0x8FF00B /end MEASUREMENT
/begin MEASUREMENT FrmMng_numDDE1byte5_mp "Rohwerte für DDE1" UBYTE OneToOne 1 100 0.00 255.0 FORMAT "%5.1" ECU_ADDRESS 0x8FF00C /end MEASUREMENT
/begin MEASUREMENT FrmMng_numDDE1byte6_mp "Rohwerte für DDE1" UBYTE OneToOne 1 100 0.00 255.0 FORMAT "%5.1" ECU_ADDRESS 0x8FF00D /end MEASUREMENT
/begin MEASUREMENT FrmMng_numDDE1byte7_mp "Rohwerte für DDE1" UBYTE OneToOne 1 100 0.00 255.0 FORMAT "%5.1" ECU_ADDRESS 0x8FF00E /end MEASUREMENT
/begin MEASUREMENT FrmMng_numDDE2byte0_mp "Rohwerte für DDE2" UBYTE OneToOne 1 100 0.00 255.0 FORMAT "%5.1" ECU_ADDRESS 0x8FF00F /end MEASUREMENT
/begin MEASUREMENT FrmMng_numDDE2byte1_mp "Rohwerte für DDE2" UBYTE OneToOne 1 100 0.00 255.0 FORMAT "%5.1" ECU_ADDRESS 0x8FF010 /end MEASUREMENT
/begin MEASUREMENT FrmMng_numDDE2byte2_mp "Rohwerte für DDE2" UBYTE OneToOne 1 100 0.00 255.0 FORMAT "%5.1" ECU_ADDRESS 0x8FF011 /end MEASUREMENT
/begin MEASUREMENT FrmMng_numDDE2byte3_mp "Rohwerte für DDE2" UBYTE OneToOne 1 100 0.00 255.0 FORMAT "%5.1" ECU_ADDRESS 0x8FF012 /end MEASUREMENT
/begin MEASUREMENT FrmMng_numDDE2byte4_mp "Rohwerte für DDE2" UBYTE OneToOne 1 100 0.00 255.0 FORMAT "%5.1" ECU_ADDRESS 0x8FF013 /end MEASUREMENT
/begin MEASUREMENT FrmMng_numDDE2byte5_mp "Rohwerte für DDE2" UBYTE OneToOne 1 100 0.00 255.0 FORMAT "%5.1" ECU_ADDRESS 0x8FF014 /end MEASUREMENT
/begin MEASUREMENT FrmMng_numDDE2byte6_mp "Rohwerte für DDE2" UBYTE OneToOne 1 100 0.00 255.0 FORMAT "%5.1" ECU_ADDRESS 0x8FF015 /end MEASUREMENT
/begin MEASUREMENT FrmMng_numDDE2byte7_mp "Rohwerte für DDE2" UBYTE OneToOne 1 100 0.00 255.0 FORMAT "%5.1" ECU_ADDRESS 0x8FF016 /end MEASUREMENT
/begin MEASUREMENT FrmMng_numDDE4byte0_mp "Rohwerte für DDE4" UBYTE OneToOne 1 100 0.00 255.0 FORMAT "%5.1" ECU_ADDRESS 0x8FF017 /end MEASUREMENT
/begin MEASUREMENT FrmMng_numDDE4byte1_mp "Rohwerte für DDE4" UBYTE OneToOne 1 100 0.00 255.0 FORMAT "%5.1" ECU_ADDRESS 0x8FF018 /end MEASUREMENT
/begin MEASUREMENT FrmMng_numDDE4byte2_mp "Rohwerte für DDE4" UBYTE OneToOne 1 100 0.00 255.0 FORMAT "%5.1" ECU_ADDRESS 0x8FF019 /end MEASUREMENT
/begin MEASUREMENT FrmMng_numDDE4byte3_mp "Rohwerte für DDE4" UBYTE OneToOne 1 100 0.00 255.0 FORMAT "%5.1" ECU_ADDRESS 0x8FF01A /end MEASUREMENT
/begin MEASUREMENT FrmMng_numDDE4byte4_mp "Rohwerte für DDE4" UBYTE OneToOne 1 100 0.00 255.0 FORMAT "%5.1" ECU_ADDRESS 0x8FF01B /end MEASUREMENT
/begin MEASUREMENT FrmMng_numDDE4byte5_mp "Rohwerte für DDE4" UBYTE OneToOne 1 100 0.00 255.0 FORMAT "%5.1" ECU_ADDRESS 0x8FF01C /end MEASUREMENT
/begin MEASUREMENT FrmMng_numDDE4byte6_mp "Rohwerte für DDE4" UBYTE OneToOne 1 100 0.00 255.0 FORMAT "%5.1" ECU_ADDRESS 0x8FF01D /end MEASUREMENT
/begin MEASUREMENT FrmMng_numDDE4byte7_mp "Rohwerte für DDE4" UBYTE OneToOne 1 100 0.00 255.0 FORMAT "%5.1" ECU_ADDRESS 0x8FF01E /end MEASUREMENT
/begin MEASUREMENT FrmMng_numDMANFAFSbyte0_mp "Byte0 of raw messagebyte of DMANFAFS" UBYTE OneToOne 1 100 0.00 255.0 FORMAT "%5.1" ECU_ADDRESS 0x8FF0DF /end MEASUREMENT
/begin MEASUREMENT FrmMng_numDMANFAFSbyte1_mp "Byte1 of raw messagebyte of DMANFAFS" UBYTE OneToOne 1 100 0.00 255.0 FORMAT "%5.1" ECU_ADDRESS 0x8FF0E0 /end MEASUREMENT
/begin MEASUREMENT FrmMng_numDMANFAFSbyte2_mp "Byte2 of raw messagebyte of DMANFAFS" UBYTE OneToOne 1 100 0.00 255.0 FORMAT "%5.1" ECU_ADDRESS 0x8FF0E1 /end MEASUREMENT
/begin MEASUREMENT FrmMng_numDMANFAFSbyte3_mp "Byte3 of raw messagebyte of DMANFAFS" UBYTE OneToOne 1 100 0.00 255.0 FORMAT "%5.1" ECU_ADDRESS 0x8FF0E2 /end MEASUREMENT
/begin MEASUREMENT FrmMng_numDMANFAFSbyte4_mp "Byte4 of raw messagebyte of DMANFAFS" UBYTE OneToOne 1 100 0.00 255.0 FORMAT "%5.1" ECU_ADDRESS 0x8FF0E3 /end MEASUREMENT
/begin MEASUREMENT FrmMng_numDMANFAFSbyte5_mp "Byte5 of raw messagebyte of DMANFAFS" UBYTE OneToOne 1 100 0.00 255.0 FORMAT "%5.1" ECU_ADDRESS 0x8FF0E4 /end MEASUREMENT
/begin MEASUREMENT FrmMng_numDM_ANF_ACCbyte0_mp "Byte0 of raw messagebyte of DREHMOMENT_ANF_ACC" UBYTE OneToOne 1 100 0.00 255.0 FORMAT "%5.1" ECU_ADDRESS 0x8FF0E5 /end MEASUREMENT
/begin MEASUREMENT FrmMng_numDM_ANF_ACCbyte1_mp "Byte1 of raw messagebyte of DREHMOMENT_ANF_ACC" UBYTE OneToOne 1 100 0.00 255.0 FORMAT "%5.1" ECU_ADDRESS 0x8FF0E6 /end MEASUREMENT
/begin MEASUREMENT FrmMng_numDM_ANF_ACCbyte2_mp "Byte2 of raw messagebyte of DREHMOMENT_ANF_ACC" UBYTE OneToOne 1 100 0.00 255.0 FORMAT "%5.1" ECU_ADDRESS 0x8FF0E7 /end MEASUREMENT
/begin MEASUREMENT FrmMng_numDM_ANF_ACCbyte3_mp "Byte3 of raw messagebyte of DREHMOMENT_ANF_ACC" UBYTE OneToOne 1 100 0.00 255.0 FORMAT "%5.1" ECU_ADDRESS 0x8FF0E8 /end MEASUREMENT
/begin MEASUREMENT FrmMng_numDM_ANF_ACCbyte4_mp "Byte4 of raw messagebyte of DREHMOMENT_ANF_ACC" UBYTE OneToOne 1 100 0.00 255.0 FORMAT "%5.1" ECU_ADDRESS 0x8FF0E9 /end MEASUREMENT
/begin MEASUREMENT FrmMng_numDM_ANF_ACCbyte5_mp "Byte5 of raw messagebyte of DREHMOMENT_ANF_ACC" UBYTE OneToOne 1 100 0.00 255.0 FORMAT "%5.1" ECU_ADDRESS 0x8FF0EA /end MEASUREMENT
/begin MEASUREMENT FrmMng_numDM_ANF_ACCbyte6_mp "Byte6 of raw messagebyte of DREHMOMENT_ANF_ACC" UBYTE OneToOne 1 100 0.00 255.0 FORMAT "%5.1" ECU_ADDRESS 0x8FF0EB /end MEASUREMENT
/begin MEASUREMENT FrmMng_numDM_ANF_ACCbyte7_mp "Byte7 of raw messagebyte of DREHMOMENT_ANF_ACC" UBYTE OneToOne 1 100 0.00 255.0 FORMAT "%5.1" ECU_ADDRESS 0x8FF0EC /end MEASUREMENT
/begin MEASUREMENT FrmMng_numDRMANFSSGbyte0_mp "Byte0 of raw messagebyte of DRMANFSSG" UBYTE OneToOne 1 100 0.00 255.0 FORMAT "%5.1" ECU_ADDRESS 0x8FF0ED /end MEASUREMENT
/begin MEASUREMENT FrmMng_numDRMANFSSGbyte1_mp "Byte1 of raw messagebyte of DRMANFSSG" UBYTE OneToOne 1 100 0.00 255.0 FORMAT "%5.1" ECU_ADDRESS 0x8FF0EE /end MEASUREMENT
/begin MEASUREMENT FrmMng_numDRMANFSSGbyte2_mp "Byte2 of raw messagebyte of DRMANFSSG" UBYTE OneToOne 1 100 0.00 255.0 FORMAT "%5.1" ECU_ADDRESS 0x8FF0EF /end MEASUREMENT
/begin MEASUREMENT FrmMng_numDRMANFSSGbyte3_mp "Byte3 of raw messagebyte of DRMANFSSG" UBYTE OneToOne 1 100 0.00 255.0 FORMAT "%5.1" ECU_ADDRESS 0x8FF0F0 /end MEASUREMENT
/begin MEASUREMENT FrmMng_numDRMANFSSGbyte4_mp "Byte4 of raw messagebyte of DRMANFSSG" UBYTE OneToOne 1 100 0.00 255.0 FORMAT "%5.1" ECU_ADDRESS 0x8FF0F1 /end MEASUREMENT
/begin MEASUREMENT FrmMng_numDRMANFSSGbyte5_mp "Byte5 of raw messagebyte of DRMANFSSG" UBYTE OneToOne 1 100 0.00 255.0 FORMAT "%5.1" ECU_ADDRESS 0x8FF0F2 /end MEASUREMENT
/begin MEASUREMENT FrmMng_numDRMANFSSGbyte6_mp "Byte6 of raw messagebyte of DRMANFSSG" UBYTE OneToOne 1 100 0.00 255.0 FORMAT "%5.1" ECU_ADDRESS 0x8FF0F3 /end MEASUREMENT
/begin MEASUREMENT FrmMng_numDRMANFSSGbyte7_mp "Byte7 of raw messagebyte of DRMANFSSG" UBYTE OneToOne 1 100 0.00 255.0 FORMAT "%5.1" ECU_ADDRESS 0x8FF0F4 /end MEASUREMENT
/begin MEASUREMENT FrmMng_numEGS1byte0_mp "Rohwerte von der Can-Botschaft EGS1" UBYTE OneToOne 1 100 0.00 255.0 FORMAT "%5.1" ECU_ADDRESS 0x8FF01F /end MEASUREMENT
/begin MEASUREMENT FrmMng_numEGS1byte1_mp "Rohwerte von der Can-Botschaft EGS1" UBYTE OneToOne 1 100 0.00 255.0 FORMAT "%5.1" ECU_ADDRESS 0x8FF020 /end MEASUREMENT
/begin MEASUREMENT FrmMng_numEGS1byte2_mp "Rohwerte von der Can-Botschaft EGS1" UBYTE OneToOne 1 100 0.00 255.0 FORMAT "%5.1" ECU_ADDRESS 0x8FF021 /end MEASUREMENT
/begin MEASUREMENT FrmMng_numEGS1byte3_mp "Rohwerte von der Can-Botschaft EGS1" UBYTE OneToOne 1 100 0.00 255.0 FORMAT "%5.1" ECU_ADDRESS 0x8FF022 /end MEASUREMENT
/begin MEASUREMENT FrmMng_numEGS1byte4_mp "Rohwerte von der Can - Botschaft EGS1" UBYTE OneToOne 1 100 0.00 255.0 FORMAT "%5.1" ECU_ADDRESS 0x8FF023 /end MEASUREMENT
/begin MEASUREMENT FrmMng_numEGS1byte5_mp "Rohwerte von der Can - Botschaft EGS1" UBYTE OneToOne 1 100 0.00 255.0 FORMAT "%5.1" ECU_ADDRESS 0x8FF024 /end MEASUREMENT
/begin MEASUREMENT FrmMng_numEGS1byte6_mp "Rohwerte von der Canbotschaft EGS1" UBYTE OneToOne 1 100 0.00 255.0 FORMAT "%5.1" ECU_ADDRESS 0x8FF025 /end MEASUREMENT
/begin MEASUREMENT FrmMng_numEGS1byte7_mp "Rohwerte von der Canbotschaft EGS1" UBYTE OneToOne 1 100 0.00 255.0 FORMAT "%5.1" ECU_ADDRESS 0x8FF026 /end MEASUREMENT
/begin MEASUREMENT FrmMng_numEGS2byte0_mp "Rohwerte von der CAN-Botschaft EGS2" UBYTE OneToOne 1 100 0.00 255.0 FORMAT "%5.1" ECU_ADDRESS 0x8FF027 /end MEASUREMENT
/begin MEASUREMENT FrmMng_numEGS2byte1_mp "Rohwerte von der CAN-Botschaft EGS2" UBYTE OneToOne 1 100 0.00 255.0 FORMAT "%5.1" ECU_ADDRESS 0x8FF028 /end MEASUREMENT
/begin MEASUREMENT FrmMng_numEGS2byte2_mp "Rohwerte von der CAN-Botschaft EGS2" UBYTE OneToOne 1 100 0.00 255.0 FORMAT "%5.1" ECU_ADDRESS 0x8FF029 /end MEASUREMENT
/begin MEASUREMENT FrmMng_numEGS2byte3_mp "Rohwerte von der CAN-Botschaft EGS2" UBYTE OneToOne 1 100 0.00 255.0 FORMAT "%5.1" ECU_ADDRESS 0x8FF02A /end MEASUREMENT
/begin MEASUREMENT FrmMng_numEGS2byte4_mp "Rohwerte von der CAN-Botschaft EGS2" UBYTE OneToOne 1 100 0.00 255.0 FORMAT "%5.1" ECU_ADDRESS 0x8FF02B /end MEASUREMENT
/begin MEASUREMENT FrmMng_numEGS2byte5_mp "Rohwerte von der CAN-Botschaft EGS2" UBYTE OneToOne 1 100 0.00 255.0 FORMAT "%5.1" ECU_ADDRESS 0x8FF02C /end MEASUREMENT
/begin MEASUREMENT FrmMng_numEGS2byte6_mp "Rohwerte von der CAN-Botschaft EGS2" UBYTE OneToOne 1 100 0.00 255.0 FORMAT "%5.1" ECU_ADDRESS 0x8FF02D /end MEASUREMENT
/begin MEASUREMENT FrmMng_numEGS2byte7_mp "Rohwerte von der CAN-Botschaft EGS2" UBYTE OneToOne 1 100 0.00 255.0 FORMAT "%5.1" ECU_ADDRESS 0x8FF02E /end MEASUREMENT
/begin MEASUREMENT FrmMng_numEKPbyte0_mp "Byte 1 von EKP-CAN-Botschaft" UBYTE OneToOne 1 100 0.00 255.0 FORMAT "%5.1" ECU_ADDRESS 0x8FF02F /end MEASUREMENT
/begin MEASUREMENT FrmMng_numEKPbyte1_mp "Byte 2 von EKP-CAN-Botschaft" UBYTE OneToOne 1 100 0.00 255.0 FORMAT "%5.1" ECU_ADDRESS 0x8FF030 /end MEASUREMENT
/begin MEASUREMENT FrmMng_numEKPbyte2_mp "Byte 3 von EKP-CAN-Botschaft" UBYTE OneToOne 1 100 0.00 255.0 FORMAT "%5.1" ECU_ADDRESS 0x8FF031 /end MEASUREMENT
/begin MEASUREMENT FrmMng_numEKPbyte3_mp "Byte 4 von EKP-CAN-Botschaft" UBYTE OneToOne 1 100 0.00 255.0 FORMAT "%5.1" ECU_ADDRESS 0x8FF032 /end MEASUREMENT
/begin MEASUREMENT FrmMng_numELKTR_M_OEL_MESSbyte0_mp "" UBYTE OneToOne 1 100 0.00 255.0 FORMAT "%5.1" ECU_ADDRESS 0x8FF0F5 /end MEASUREMENT
/begin MEASUREMENT FrmMng_numELKTR_M_OEL_MESSbyte1_mp "" UBYTE OneToOne 1 100 0.00 255.0 FORMAT "%5.1" ECU_ADDRESS 0x8FF0F6 /end MEASUREMENT
/begin MEASUREMENT FrmMng_numENGINE1byte0_mp "Byte_0 Rohwerte in CAN-Botschaft ENGINE1" UBYTE OneToOne 1 100 0.00 255.0 FORMAT "%5.1" ECU_ADDRESS 0x8FF0F7 /end MEASUREMENT
/begin MEASUREMENT FrmMng_numENGINE1byte1_mp "Byte_1 Rohwerte in CAN-Botschaft ENGINE1" UBYTE OneToOne 1 100 0.00 255.0 FORMAT "%5.1" ECU_ADDRESS 0x8FF0F8 /end MEASUREMENT
/begin MEASUREMENT FrmMng_numENGINE1byte2_mp "Byte_2 Rohwerte in CAN-Botschaft ENGINE1" UBYTE OneToOne 1 100 0.00 255.0 FORMAT "%5.1" ECU_ADDRESS 0x8FF0F9 /end MEASUREMENT
/begin MEASUREMENT FrmMng_numENGINE1byte3_mp "Byte_3 Rohwerte in CAN-Botschaft ENGINE1" UBYTE OneToOne 1 100 0.00 255.0 FORMAT "%5.1" ECU_ADDRESS 0x8FF0FA /end MEASUREMENT
/begin MEASUREMENT FrmMng_numENGINE1byte4_mp "Byte_4 Rohwerte in CAN-Botschaft ENGINE1" UBYTE OneToOne 1 100 0.00 255.0 FORMAT "%5.1" ECU_ADDRESS 0x8FF0FB /end MEASUREMENT
/begin MEASUREMENT FrmMng_numENGINE1byte5_mp "Byte_5 Rohwerte in CAN-Botschaft ENGINE1" UBYTE OneToOne 1 100 0.00 255.0 FORMAT "%5.1" ECU_ADDRESS 0x8FF0FC /end MEASUREMENT
/begin MEASUREMENT FrmMng_numENGINE1byte6_mp "Byte_6 Rohwerte in CAN-Botschaft ENGINE1" UBYTE OneToOne 1 100 0.00 255.0 FORMAT "%5.1" ECU_ADDRESS 0x8FF0FD /end MEASUREMENT
/begin MEASUREMENT FrmMng_numENGINE1byte7_mp "Byte_7 Rohwerte in CAN-Botschaft ENGINE1" UBYTE OneToOne 1 100 0.00 255.0 FORMAT "%5.1" ECU_ADDRESS 0x8FF0FE /end MEASUREMENT
/begin MEASUREMENT FrmMng_numEngRpmbyte0_mp "Rohwerte von der CAN-Botschaft ENGINE_RPM - Byte0" UBYTE OneToOne 1 100 0.00 255.0 FORMAT "%5.1" ECU_ADDRESS 0x8FF0FF /end MEASUREMENT
/begin MEASUREMENT FrmMng_numEngRpmbyte1_mp "Rohwerte von der CAN-Botschaft ENGINE_RPM - Byte1" UBYTE OneToOne 1 100 0.00 255.0 FORMAT "%5.1" ECU_ADDRESS 0x8FF100 /end MEASUREMENT
/begin MEASUREMENT FrmMng_numGEARBX_DATA2byte0_mp "GEARBX_DATA2 Byte0" UBYTE OneToOne 1 100 0.00 255.0 FORMAT "%5.1" ECU_ADDRESS 0x8FF101 /end MEASUREMENT
/begin MEASUREMENT FrmMng_numGEARBX_DATA2byte1_mp "GEARBX_DATA2 Byte1" UBYTE OneToOne 1 100 0.00 255.0 FORMAT "%5.1" ECU_ADDRESS 0x8FF102 /end MEASUREMENT
/begin MEASUREMENT FrmMng_numGEARBX_DATAbyte0_mp "Byte_x raw data in CAN-message" UBYTE OneToOne 1 100 0.00 255.0 FORMAT "%5.1" ECU_ADDRESS 0x8FF103 /end MEASUREMENT
/begin MEASUREMENT FrmMng_numGEARBX_DATAbyte1_mp "Byte_x raw data in CAN-message" UBYTE OneToOne 1 100 0.00 255.0 FORMAT "%5.1" ECU_ADDRESS 0x8FF104 /end MEASUREMENT
/begin MEASUREMENT FrmMng_numGEARBX_DATAbyte2_mp "Byte_x raw data in CAN-message" UBYTE OneToOne 1 100 0.00 255.0 FORMAT "%5.1" ECU_ADDRESS 0x8FF105 /end MEASUREMENT
/begin MEASUREMENT FrmMng_numGEARBX_DATAbyte3_mp "Byte_x raw data in CAN-message" UBYTE OneToOne 1 100 0.00 255.0 FORMAT "%5.1" ECU_ADDRESS 0x8FF106 /end MEASUREMENT
/begin MEASUREMENT FrmMng_numGEARBX_DATAbyte4_mp "Byte_x raw data in CAN-message" UBYTE OneToOne 1 100 0.00 255.0 FORMAT "%5.1" ECU_ADDRESS 0x8FF107 /end MEASUREMENT
/begin MEASUREMENT FrmMng_numGEARBX_DATAbyte5_mp "Byte_x raw data in CAN-message" UBYTE OneToOne 1 100 0.00 255.0 FORMAT "%5.1" ECU_ADDRESS 0x8FF108 /end MEASUREMENT
/begin MEASUREMENT FrmMng_numGEARBX_DATAbyte6_mp "Byte_x raw data in CAN-message" UBYTE OneToOne 1 100 0.00 255.0 FORMAT "%5.1" ECU_ADDRESS 0x8FF109 /end MEASUREMENT
/begin MEASUREMENT FrmMng_numGEARBX_DATAbyte7_mp "Byte_x raw data in CAN-message" UBYTE OneToOne 1 100 0.00 255.0 FORMAT "%5.1" ECU_ADDRESS 0x8FF10A /end MEASUREMENT
/begin MEASUREMENT FrmMng_numHEATCURbyte0_mp "HEATING_CURRENT Byte0" UBYTE OneToOne 1 100 0.00 255.0 FORMAT "%5.1" ECU_ADDRESS 0x8FF10B /end MEASUREMENT
/begin MEASUREMENT FrmMng_numHEATCURbyte1_mp "HEATING_CURRENT Byte1" UBYTE OneToOne 1 100 0.00 255.0 FORMAT "%5.1" ECU_ADDRESS 0x8FF10C /end MEASUREMENT
/begin MEASUREMENT FrmMng_numHEATCURbyte2_mp "HEATING_CURRENT Byte2" UBYTE OneToOne 1 100 0.00 255.0 FORMAT "%5.1" ECU_ADDRESS 0x8FF10D /end MEASUREMENT
/begin MEASUREMENT FrmMng_numHEATCURbyte3_mp "HEATING_CURRENT Byte3" UBYTE OneToOne 1 100 0.00 255.0 FORMAT "%5.1" ECU_ADDRESS 0x8FF10E /end MEASUREMENT
/begin MEASUREMENT FrmMng_numHEATCURbyte4_mp "HEATING_CURRENT Byte3" UBYTE OneToOne 1 100 0.00 255.0 FORMAT "%5.1" ECU_ADDRESS 0x8FF10F /end MEASUREMENT
/begin MEASUREMENT FrmMng_numHEATCURbyte5_mp "HEATING_CURRENT Byte5" UBYTE OneToOne 1 100 0.00 255.0 FORMAT "%5.1" ECU_ADDRESS 0x8FF110 /end MEASUREMENT
/begin MEASUREMENT FrmMng_numHEATCURbyte6_mp "HEATING_CURRENT Byte6" UBYTE OneToOne 1 100 0.00 255.0 FORMAT "%5.1" ECU_ADDRESS 0x8FF111 /end MEASUREMENT
/begin MEASUREMENT FrmMng_numHEAT_ACbyte0_mp "Byte_x raw data in CAN-message" UBYTE OneToOne 1 100 0.00 255.0 FORMAT "%5.1" ECU_ADDRESS 0x8FF112 /end MEASUREMENT
/begin MEASUREMENT FrmMng_numHEAT_ACbyte1_mp "Byte_x raw data in CAN-message" UBYTE OneToOne 1 100 0.00 255.0 FORMAT "%5.1" ECU_ADDRESS 0x8FF113 /end MEASUREMENT
/begin MEASUREMENT FrmMng_numHEAT_ACbyte2_mp "Byte_x raw data in CAN-message" UBYTE OneToOne 1 100 0.00 255.0 FORMAT "%5.1" ECU_ADDRESS 0x8FF114 /end MEASUREMENT
/begin MEASUREMENT FrmMng_numHEAT_ACbyte3_mp "Byte_x raw data in CAN-message" UBYTE OneToOne 1 100 0.00 255.0 FORMAT "%5.1" ECU_ADDRESS 0x8FF115 /end MEASUREMENT
/begin MEASUREMENT FrmMng_numHEAT_ACbyte4_mp "Byte_x raw data in CAN-message" UBYTE OneToOne 1 100 0.00 255.0 FORMAT "%5.1" ECU_ADDRESS 0x8FF116 /end MEASUREMENT
/begin MEASUREMENT FrmMng_numINSTR2byte0_mp "Rohwert INSTR2-Byte0" UBYTE OneToOne 1 100 0.00 255.0 FORMAT "%5.1" ECU_ADDRESS 0x8FF033 /end MEASUREMENT
/begin MEASUREMENT FrmMng_numINSTR2byte1_mp "Rohwert INSTR2-Byte1" UBYTE OneToOne 1 100 0.00 255.0 FORMAT "%5.1" ECU_ADDRESS 0x8FF034 /end MEASUREMENT
/begin MEASUREMENT FrmMng_numINSTR2byte2_mp "Rohwert INSTR2-Byte2" UBYTE OneToOne 1 100 0.00 255.0 FORMAT "%5.1" ECU_ADDRESS 0x8FF035 /end MEASUREMENT
/begin MEASUREMENT FrmMng_numINSTR2byte3_mp "Rohwert INSTR2-Byte3" UBYTE OneToOne 1 100 0.00 255.0 FORMAT "%5.1" ECU_ADDRESS 0x8FF036 /end MEASUREMENT
/begin MEASUREMENT FrmMng_numINSTR2byte4_mp "Rohwert INSTR2-Byte4" UBYTE OneToOne 1 100 0.00 255.0 FORMAT "%5.1" ECU_ADDRESS 0x8FF037 /end MEASUREMENT
/begin MEASUREMENT FrmMng_numINSTR2byte5_mp "Rohwert INSTR2-Byte5" UBYTE OneToOne 1 100 0.00 255.0 FORMAT "%5.1" ECU_ADDRESS 0x8FF038 /end MEASUREMENT
/begin MEASUREMENT FrmMng_numINSTR2byte6_mp "Rohwert INSTR2-Byte6" UBYTE OneToOne 1 100 0.00 255.0 FORMAT "%5.1" ECU_ADDRESS 0x8FF039 /end MEASUREMENT
/begin MEASUREMENT FrmMng_numINSTR2byte7_mp "Rohwert INSTR2-Byte7" UBYTE OneToOne 1 100 0.00 255.0 FORMAT "%5.1" ECU_ADDRESS 0x8FF03A /end MEASUREMENT
/begin MEASUREMENT FrmMng_numINSTR3byte0_mp "Rohwert INSTR3-Byte0" UBYTE OneToOne 1 100 0.00 255.0 FORMAT "%5.1" ECU_ADDRESS 0x8FF03B /end MEASUREMENT
/begin MEASUREMENT FrmMng_numINSTR3byte1_mp "Rohwert INSTR3-Byte1" UBYTE OneToOne 1 100 0.00 255.0 FORMAT "%5.1" ECU_ADDRESS 0x8FF03C /end MEASUREMENT
/begin MEASUREMENT FrmMng_numINSTR3byte2_mp "Rohwert INSTR3-Byte2" UBYTE OneToOne 1 100 0.00 255.0 FORMAT "%5.1" ECU_ADDRESS 0x8FF03D /end MEASUREMENT
/begin MEASUREMENT FrmMng_numINSTR3byte3_mp "Rohwert INSTR3-Byte3" UBYTE OneToOne 1 100 0.00 255.0 FORMAT "%5.1" ECU_ADDRESS 0x8FF03E /end MEASUREMENT
/begin MEASUREMENT FrmMng_numINSTR3byte4_mp "Rohwert INSTR3-Byte4" UBYTE OneToOne 1 100 0.00 255.0 FORMAT "%5.1" ECU_ADDRESS 0x8FF03F /end MEASUREMENT
/begin MEASUREMENT FrmMng_numINSTR3byte5_mp "Rohwert INSTR3-Byte5" UBYTE OneToOne 1 100 0.00 255.0 FORMAT "%5.1" ECU_ADDRESS 0x8FF040 /end MEASUREMENT
/begin MEASUREMENT FrmMng_numINSTR3byte6_mp "Rohwert INSTR3-Byte6" UBYTE OneToOne 1 100 0.00 255.0 FORMAT "%5.1" ECU_ADDRESS 0x8FF041 /end MEASUREMENT
/begin MEASUREMENT FrmMng_numINSTR3byte7_mp "Rohwert INSTR3-Byte7" UBYTE OneToOne 1 100 0.00 255.0 FORMAT "%5.1" ECU_ADDRESS 0x8FF042 /end MEASUREMENT
/begin MEASUREMENT FrmMng_numLRADWINKbyte0_mp "Byte0 of raw messagebyte of LRADWINK" UBYTE OneToOne 1 100 0.00 255.0 FORMAT "%5.1" ECU_ADDRESS 0x8FF117 /end MEASUREMENT
/begin MEASUREMENT FrmMng_numLRADWINKbyte1_mp "Byte1 of raw messagebyte of LRADWINK" UBYTE OneToOne 1 100 0.00 255.0 FORMAT "%5.1" ECU_ADDRESS 0x8FF118 /end MEASUREMENT
/begin MEASUREMENT FrmMng_numLRADWINKbyte2_mp "Byte2 of raw messagebyte of LRADWINK" UBYTE OneToOne 1 100 0.00 255.0 FORMAT "%5.1" ECU_ADDRESS 0x8FF119 /end MEASUREMENT
/begin MEASUREMENT FrmMng_numLRADWINKbyte3_mp "Byte3 of raw messagebyte of LRADWINK" UBYTE OneToOne 1 100 0.00 255.0 FORMAT "%5.1" ECU_ADDRESS 0x8FF11A /end MEASUREMENT
/begin MEASUREMENT FrmMng_numLRADWINKbyte4_mp "Byte4 of raw messagebyte of LRADWINK" UBYTE OneToOne 1 100 0.00 255.0 FORMAT "%5.1" ECU_ADDRESS 0x8FF11B /end MEASUREMENT
/begin MEASUREMENT FrmMng_numLRADWINKbyte5_mp "Byte5 of raw messagebyte of LRADWINK" UBYTE OneToOne 1 100 0.00 255.0 FORMAT "%5.1" ECU_ADDRESS 0x8FF11C /end MEASUREMENT
/begin MEASUREMENT FrmMng_numLRADWINKbyte6_mp "Byte6 of raw messagebyte of LRADWINK" UBYTE OneToOne 1 100 0.00 255.0 FORMAT "%5.1" ECU_ADDRESS 0x8FF11D /end MEASUREMENT
/begin MEASUREMENT FrmMng_numMILEAGE_RANGEbyte0_mp "MILEAGE_RANGE Byte0" UBYTE OneToOne 1 100 0.00 255.0 FORMAT "%5.1" ECU_ADDRESS 0x8FF11E /end MEASUREMENT
/begin MEASUREMENT FrmMng_numMILEAGE_RANGEbyte1_mp "MILEAGE_RANGE Byte1" UBYTE OneToOne 1 100 0.00 255.0 FORMAT "%5.1" ECU_ADDRESS 0x8FF11F /end MEASUREMENT
/begin MEASUREMENT FrmMng_numMILEAGE_RANGEbyte2_mp "MILEAGE_RANGE Byte2" UBYTE OneToOne 1 100 0.00 255.0 FORMAT "%5.1" ECU_ADDRESS 0x8FF120 /end MEASUREMENT
/begin MEASUREMENT FrmMng_numMILEAGE_RANGEbyte3_mp "MILEAGE_RANGE Byte3" UBYTE OneToOne 1 100 0.00 255.0 FORMAT "%5.1" ECU_ADDRESS 0x8FF121 /end MEASUREMENT
/begin MEASUREMENT FrmMng_numMILEAGE_RANGEbyte4_mp "MILEAGE_RANGE Byte4" UBYTE OneToOne 1 100 0.00 255.0 FORMAT "%5.1" ECU_ADDRESS 0x8FF122 /end MEASUREMENT
/begin MEASUREMENT FrmMng_numMILEAGE_RANGEbyte5_mp "MILEAGE_RANGE Byte5" UBYTE OneToOne 1 100 0.00 255.0 FORMAT "%5.1" ECU_ADDRESS 0x8FF123 /end MEASUREMENT
/begin MEASUREMENT FrmMng_numMILEAGE_RANGEbyte6_mp "MILEAGE_RANGE Byte6" UBYTE OneToOne 1 100 0.00 255.0 FORMAT "%5.1" ECU_ADDRESS 0x8FF124 /end MEASUREMENT
/begin MEASUREMENT FrmMng_numMILEAGE_RANGEbyte7_mp "MILEAGE_RANGE Byte7" UBYTE OneToOne 1 100 0.00 255.0 FORMAT "%5.1" ECU_ADDRESS 0x8FF125 /end MEASUREMENT
/begin MEASUREMENT FrmMng_numMsgACC_mp "counter for self recognition of ACC" UBYTE OneToOne 1 100 0.00 255.0 FORMAT "%5.1" ECU_ADDRESS 0x8FF126 /end MEASUREMENT
/begin MEASUREMENT FrmMng_numMsgAC_mp "" UBYTE OneToOne 1 100 0.00 255.0 FORMAT "%5.1" ECU_ADDRESS 0x8FF127 /end MEASUREMENT
/begin MEASUREMENT FrmMng_numMsgAFS_mp "Counter for self recognition of AFS" UBYTE OneToOne 1 100 0.00 255.0 FORMAT "%5.1" ECU_ADDRESS 0x8FF128 /end MEASUREMENT
/begin MEASUREMENT FrmMng_numMsgARS_mp "Counter for ARS recognition" UBYTE OneToOne 1 100 0.00 255.0 FORMAT "%5.1" ECU_ADDRESS 0x8FF129 /end MEASUREMENT
/begin MEASUREMENT FrmMng_numMsgDCC_mp "Anzahl Botschaften für Erkennung Empfang DCC-Botschaft" UBYTE OneToOne 1 100 0.00 255.0 FORMAT "%5.1" ECU_ADDRESS 0x8FF12A /end MEASUREMENT
/begin MEASUREMENT FrmMng_numMsgFGR_mp "Counter for self recognition of FGR" UBYTE OneToOne 1 100 0.00 255.0 FORMAT "%5.1" ECU_ADDRESS 0x8FF12B /end MEASUREMENT
/begin MEASUREMENT FrmMng_numOPCRCTLACCbyte0_mp "OP_CRCTLACC Byte0" UBYTE OneToOne 1 100 0.00 255.0 FORMAT "%5.1" ECU_ADDRESS 0x8FF12C /end MEASUREMENT
/begin MEASUREMENT FrmMng_numOPCRCTLACCbyte1_mp "OP_CRCTLACC Byte1" UBYTE OneToOne 1 100 0.00 255.0 FORMAT "%5.1" ECU_ADDRESS 0x8FF12D /end MEASUREMENT
/begin MEASUREMENT FrmMng_numOPCRCTLACCbyte2_mp "OP_CRCTLACC Byte2" UBYTE OneToOne 1 100 0.00 255.0 FORMAT "%5.1" ECU_ADDRESS 0x8FF12E /end MEASUREMENT
/begin MEASUREMENT FrmMng_numOPCRCTLACCbyte3_mp "OP_CRCTLACC Byte3" UBYTE OneToOne 1 100 0.00 255.0 FORMAT "%5.1" ECU_ADDRESS 0x8FF12F /end MEASUREMENT
/begin MEASUREMENT FrmMng_numParkConsumerByte0_mp "ParkConsumer Byte0" UBYTE OneToOne 1 100 0.00 255.0 FORMAT "%5.1" ECU_ADDRESS 0x8FF130 /end MEASUREMENT
/begin MEASUREMENT FrmMng_numParkConsumerByte1_mp "ParkConsumer Byte1" UBYTE OneToOne 1 100 0.00 255.0 FORMAT "%5.1" ECU_ADDRESS 0x8FF131 /end MEASUREMENT
/begin MEASUREMENT FrmMng_numParkConsumerByte2_mp "ParkConsumer Byte2" UBYTE OneToOne 1 100 0.00 255.0 FORMAT "%5.1" ECU_ADDRESS 0x8FF132 /end MEASUREMENT
/begin MEASUREMENT FrmMng_numParkConsumerByte3_mp "ParkConsumer Byte3" UBYTE OneToOne 1 100 0.00 255.0 FORMAT "%5.1" ECU_ADDRESS 0x8FF133 /end MEASUREMENT
/begin MEASUREMENT FrmMng_numPMCTRCOSbyte0_mp "POWERMGMT_CTR_COS Byte0" UBYTE OneToOne 1 100 0.00 255.0 FORMAT "%5.1" ECU_ADDRESS 0x8FF134 /end MEASUREMENT
/begin MEASUREMENT FrmMng_numPMCTRCOSbyte1_mp "POWERMGMT_CTR_COS Byte1" UBYTE OneToOne 1 100 0.00 255.0 FORMAT "%5.1" ECU_ADDRESS 0x8FF135 /end MEASUREMENT
/begin MEASUREMENT FrmMng_numPMCTRCOSbyte2_mp "POWERMGMT_CTR_COS Byte2" UBYTE OneToOne 1 100 0.00 255.0 FORMAT "%5.1" ECU_ADDRESS 0x8FF136 /end MEASUREMENT
/begin MEASUREMENT FrmMng_numPMCTRCOSbyte3_mp "POWERMGMT_CTR_COS Byte3" UBYTE OneToOne 1 100 0.00 255.0 FORMAT "%5.1" ECU_ADDRESS 0x8FF137 /end MEASUREMENT
/begin MEASUREMENT FrmMng_numPMCTRCOSbyte4_mp "POWERMGMT_CTR_COS Byte4" UBYTE OneToOne 1 100 0.00 255.0 FORMAT "%5.1" ECU_ADDRESS 0x8FF138 /end MEASUREMENT
/begin MEASUREMENT FrmMng_numPMCTRCOSbyte5_mp "POWERMGMT_CTR_COS Byte5" UBYTE OneToOne 1 100 0.00 255.0 FORMAT "%5.1" ECU_ADDRESS 0x8FF139 /end MEASUREMENT
/begin MEASUREMENT FrmMng_numPMUBattbyte0_mp "POWERMGNT_BATTERIESPANNUNG Byte0" UBYTE OneToOne 1 100 0.00 255.0 FORMAT "%5.1" ECU_ADDRESS 0x8FF13A /end MEASUREMENT
/begin MEASUREMENT FrmMng_numPMUBattbyte1_mp "POWERMGNT_BATTERIESPANNUNG Byte1" UBYTE OneToOne 1 100 0.00 255.0 FORMAT "%5.1" ECU_ADDRESS 0x8FF13B /end MEASUREMENT
/begin MEASUREMENT FrmMng_numPMUBattbyte2_mp "POWERMGNT_BATTERIESPANNUNG Byte2" UBYTE OneToOne 1 100 0.00 255.0 FORMAT "%5.1" ECU_ADDRESS 0x8FF13C /end MEASUREMENT
/begin MEASUREMENT FrmMng_numPMUBattbyte3_mp "POWERMGNT_BATTERIESPANNUNG Byte3" UBYTE OneToOne 1 100 0.00 255.0 FORMAT "%5.1" ECU_ADDRESS 0x8FF13D /end MEASUREMENT
/begin MEASUREMENT FrmMng_numPMUBattbyte4_mp "POWERMGNT_BATTERIESPANNUNG Byte4" UBYTE OneToOne 1 100 0.00 255.0 FORMAT "%5.1" ECU_ADDRESS 0x8FF13E /end MEASUREMENT
/begin MEASUREMENT FrmMng_numPMUBattbyte5_mp "POWERMGNT_BATTERIESPANNUNG Byte5" UBYTE OneToOne 1 100 0.00 255.0 FORMAT "%5.1" ECU_ADDRESS 0x8FF13F /end MEASUREMENT
/begin MEASUREMENT FrmMng_numPMUBattbyte6_mp "POWERMGNT_BATTERIESPANNUNG Byte6" UBYTE OneToOne 1 100 0.00 255.0 FORMAT "%5.1" ECU_ADDRESS 0x8FF140 /end MEASUREMENT
/begin MEASUREMENT FrmMng_numPMUBattbyte7_mp "POWERMGNT_BATTERIESPANNUNG Byte7" UBYTE OneToOne 1 100 0.00 255.0 FORMAT "%5.1" ECU_ADDRESS 0x8FF141 /end MEASUREMENT
/begin MEASUREMENT FrmMng_numPRGG_CCTRbyte0_mp "Byte0 of raw messagebyte of PRGG_CCTR" UBYTE OneToOne 1 100 0.00 255.0 FORMAT "%5.1" ECU_ADDRESS 0x8FF142 /end MEASUREMENT
/begin MEASUREMENT FrmMng_numPRGG_CCTRbyte1_mp "Byte1 of raw messagebyte of PRGG_CCTR" UBYTE OneToOne 1 100 0.00 255.0 FORMAT "%5.1" ECU_ADDRESS 0x8FF143 /end MEASUREMENT
/begin MEASUREMENT FrmMng_numPRGG_CCTRbyte2_mp "Byte2 of raw messagebyte of PRGG_CCTR" UBYTE OneToOne 1 100 0.00 255.0 FORMAT "%5.1" ECU_ADDRESS 0x8FF144 /end MEASUREMENT
/begin MEASUREMENT FrmMng_numPRGG_CCTRbyte3_mp "Byte3 of raw messagebyte of PRGG_CCTR" UBYTE OneToOne 1 100 0.00 255.0 FORMAT "%5.1" ECU_ADDRESS 0x8FF145 /end MEASUREMENT
/begin MEASUREMENT FrmMng_numPRGG_CCTRbyte4_mp "Byte4 of raw messagebyte of PRGG_CCTR" UBYTE OneToOne 1 100 0.00 255.0 FORMAT "%5.1" ECU_ADDRESS 0x8FF146 /end MEASUREMENT
/begin MEASUREMENT FrmMng_numPWRMNG_LOADVbyte0_mp "" UBYTE OneToOne 1 100 0.00 255.0 FORMAT "%5.1" ECU_ADDRESS 0x8FF147 /end MEASUREMENT
/begin MEASUREMENT FrmMng_numPWRMNG_LOADVbyte1_mp "" UBYTE OneToOne 1 100 0.00 255.0 FORMAT "%5.1" ECU_ADDRESS 0x8FF148 /end MEASUREMENT
/begin MEASUREMENT FrmMng_numPWRMNG_LOADVbyte2_mp "" UBYTE OneToOne 1 100 0.00 255.0 FORMAT "%5.1" ECU_ADDRESS 0x8FF149 /end MEASUREMENT
/begin MEASUREMENT FrmMng_numPWRMNG_LOADVbyte3_mp "" UBYTE OneToOne 1 100 0.00 255.0 FORMAT "%5.1" ECU_ADDRESS 0x8FF14A /end MEASUREMENT
/begin MEASUREMENT FrmMng_numPWRMNG_LOADVbyte4_mp "" UBYTE OneToOne 1 100 0.00 255.0 FORMAT "%5.1" ECU_ADDRESS 0x8FF14B /end MEASUREMENT
/begin MEASUREMENT FrmMng_numPWRMNG_LOADVbyte5_mp "" UBYTE OneToOne 1 100 0.00 255.0 FORMAT "%5.1" ECU_ADDRESS 0x8FF14C /end MEASUREMENT
/begin MEASUREMENT FrmMng_numPWRMNG_LOADVbyte6_mp "" UBYTE OneToOne 1 100 0.00 255.0 FORMAT "%5.1" ECU_ADDRESS 0x8FF14D /end MEASUREMENT
/begin MEASUREMENT FrmMng_numPWRMNG_LOADVbyte7_mp "" UBYTE OneToOne 1 100 0.00 255.0 FORMAT "%5.1" ECU_ADDRESS 0x8FF14E /end MEASUREMENT
/begin MEASUREMENT FrmMng_numRADMOMPT1byte0_mp "Botschaft RADMOM_PT_1 byteweise" UBYTE OneToOne 1 100 0.00 255.0 FORMAT "%5.1" ECU_ADDRESS 0x8FF14F /end MEASUREMENT
/begin MEASUREMENT FrmMng_numRADMOMPT1byte1_mp "Botschaft RADMOM_PT_1 byteweise" UBYTE OneToOne 1 100 0.00 255.0 FORMAT "%5.1" ECU_ADDRESS 0x8FF150 /end MEASUREMENT
/begin MEASUREMENT FrmMng_numRADMOMPT1byte2_mp "Botschaft RADMOM_PT_1 byteweise" UBYTE OneToOne 1 100 0.00 255.0 FORMAT "%5.1" ECU_ADDRESS 0x8FF151 /end MEASUREMENT
/begin MEASUREMENT FrmMng_numRADMOMPT1byte3_mp "Botschaft RADMOM_PT_1 byteweise" UBYTE OneToOne 1 100 0.00 255.0 FORMAT "%5.1" ECU_ADDRESS 0x8FF152 /end MEASUREMENT
/begin MEASUREMENT FrmMng_numRADMOMPT1byte4_mp "Botschaft RADMOM_PT_1 byteweise" UBYTE OneToOne 1 100 0.00 255.0 FORMAT "%5.1" ECU_ADDRESS 0x8FF153 /end MEASUREMENT
/begin MEASUREMENT FrmMng_numRADMOMPT1byte5_mp "Botschaft RADMOM_PT_1 byteweise" UBYTE OneToOne 1 100 0.00 255.0 FORMAT "%5.1" ECU_ADDRESS 0x8FF154 /end MEASUREMENT
/begin MEASUREMENT FrmMng_numRADMOMPT1byte6_mp "Botschaft RADMOM_PT_1 byteweise" UBYTE OneToOne 1 100 0.00 255.0 FORMAT "%5.1" ECU_ADDRESS 0x8FF155 /end MEASUREMENT
/begin MEASUREMENT FrmMng_numRADMOMPT1byte7_mp "Botschaft RADMOM_PT_1 byteweise" UBYTE OneToOne 1 100 0.00 255.0 FORMAT "%5.1" ECU_ADDRESS 0x8FF156 /end MEASUREMENT
/begin MEASUREMENT FrmMng_numRADMOMPT2byte0_mp "Botschaft RADMOM_PT_2 byteweise" UBYTE OneToOne 1 100 0.00 255.0 FORMAT "%5.1" ECU_ADDRESS 0x8FF157 /end MEASUREMENT
/begin MEASUREMENT FrmMng_numRADMOMPT2byte1_mp "Botschaft RADMOM_PT_2 byteweise" UBYTE OneToOne 1 100 0.00 255.0 FORMAT "%5.1" ECU_ADDRESS 0x8FF158 /end MEASUREMENT
/begin MEASUREMENT FrmMng_numRADMOMPT2byte2_mp "Botschaft RADMOM_PT_2 byteweise" UBYTE OneToOne 1 100 0.00 255.0 FORMAT "%5.1" ECU_ADDRESS 0x8FF159 /end MEASUREMENT
/begin MEASUREMENT FrmMng_numRADMOMPT2byte3_mp "Botschaft RADMOM_PT_2 byteweise" UBYTE OneToOne 1 100 0.00 255.0 FORMAT "%5.1" ECU_ADDRESS 0x8FF15A /end MEASUREMENT
/begin MEASUREMENT FrmMng_numRADMOMPT2byte4_mp "Botschaft RADMOM_PT_2 byteweise" UBYTE OneToOne 1 100 0.00 255.0 FORMAT "%5.1" ECU_ADDRESS 0x8FF15B /end MEASUREMENT
/begin MEASUREMENT FrmMng_numRADMOMPT2byte5_mp "Botschaft RADMOM_PT_2 byteweise" UBYTE OneToOne 1 100 0.00 255.0 FORMAT "%5.1" ECU_ADDRESS 0x8FF15C /end MEASUREMENT
/begin MEASUREMENT FrmMng_numRADMOMPT2byte6_mp "Botschaft RADMOM_PT_2 byteweise" UBYTE OneToOne 1 100 0.00 255.0 FORMAT "%5.1" ECU_ADDRESS 0x8FF15D /end MEASUREMENT
/begin MEASUREMENT FrmMng_numRADMOMPT2byte7_mp "Botschaft RADMOM_PT_2 byteweise" UBYTE OneToOne 1 100 0.00 255.0 FORMAT "%5.1" ECU_ADDRESS 0x8FF15E /end MEASUREMENT
/begin MEASUREMENT FrmMng_numRPM_STAByte0_mp "" UBYTE OneToOne 1 100 0.00 255.0 FORMAT "%5.1" ECU_ADDRESS 0x8FF15F /end MEASUREMENT
/begin MEASUREMENT FrmMng_numRPM_STAByte1_mp "" UBYTE OneToOne 1 100 0.00 255.0 FORMAT "%5.1" ECU_ADDRESS 0x8FF160 /end MEASUREMENT
/begin MEASUREMENT FrmMng_numRqStgEFan "Mit Diesem Signal können Steuergeräte eine E-Lüfterstufe anfordern" UBYTE OneToOne 1 100 0.00 255.0 FORMAT "%5.1" ECU_ADDRESS 0x7F8896 /end MEASUREMENT
/begin MEASUREMENT FrmMng_numRQ_STG_EFANbyte0_mp "RQ_STG_EFAN Raw wert byte 0" UBYTE OneToOne 1 100 0.00 255.0 FORMAT "%5.1" ECU_ADDRESS 0x8FF161 /end MEASUREMENT
/begin MEASUREMENT FrmMng_numRQ_STG_EFANbyte1_mp "RQ_STG_EFAN Raw wert byte 1" UBYTE OneToOne 1 100 0.00 255.0 FORMAT "%5.1" ECU_ADDRESS 0x8FF162 /end MEASUREMENT
/begin MEASUREMENT FrmMng_numRQ_STG_EFANbyte2_mp "RQ_STG_EFAN Raw wert byte 2" UBYTE OneToOne 1 100 0.00 255.0 FORMAT "%5.1" ECU_ADDRESS 0x8FF163 /end MEASUREMENT
/begin MEASUREMENT FrmMng_numSITZGURTbyte0_mp "STAT_SITZBELEGUNG_GURT rohes messagebyte 0" UBYTE OneToOne 1 100 0.00 255.0 FORMAT "%5.1" ECU_ADDRESS 0x8FF164 /end MEASUREMENT
/begin MEASUREMENT FrmMng_numSITZGURTbyte1_mp "STAT_SITZBELEGUNG_GURT  rohes messagebyte 1" UBYTE OneToOne 1 100 0.00 255.0 FORMAT "%5.1" ECU_ADDRESS 0x8FF165 /end MEASUREMENT
/begin MEASUREMENT FrmMng_numSITZGURTbyte2_mp "STAT_SITZBELEGUNG_GURT  rohes messagebyte 2" UBYTE OneToOne 1 100 0.00 255.0 FORMAT "%5.1" ECU_ADDRESS 0x8FF166 /end MEASUREMENT
/begin MEASUREMENT FrmMng_numSITZGURTbyte3_mp "STAT_SITZBELEGUNG_GURT  rohes messagebyte 3" UBYTE OneToOne 1 100 0.00 255.0 FORMAT "%5.1" ECU_ADDRESS 0x8FF167 /end MEASUREMENT
/begin MEASUREMENT FrmMng_numSITZGURTbyte4_mp "STAT_SITZBELEGUNG_GURT  rohes messagebyte 4" UBYTE OneToOne 1 100 0.00 255.0 FORMAT "%5.1" ECU_ADDRESS 0x8FF168 /end MEASUREMENT
/begin MEASUREMENT FrmMng_numSPEED_CLCTRbyte0_mp "SPEED_CLCTR Byte0" UBYTE OneToOne 1 100 0.00 255.0 FORMAT "%5.1" ECU_ADDRESS 0x8FF169 /end MEASUREMENT
/begin MEASUREMENT FrmMng_numSPEED_CLCTRbyte1_mp "SPEED_CLCTR Byte1" UBYTE OneToOne 1 100 0.00 255.0 FORMAT "%5.1" ECU_ADDRESS 0x8FF16A /end MEASUREMENT
/begin MEASUREMENT FrmMng_numSPEED_CLCTRbyte2_mp "SPEED_CLCTR Byte2" UBYTE OneToOne 1 100 0.00 255.0 FORMAT "%5.1" ECU_ADDRESS 0x8FF16B /end MEASUREMENT
/begin MEASUREMENT FrmMng_numSPEED_CLCTRbyte3_mp "SPEED_CLCTR Byte2" UBYTE OneToOne 1 100 0.00 255.0 FORMAT "%5.1" ECU_ADDRESS 0x8FF16C /end MEASUREMENT
/begin MEASUREMENT FrmMng_numSPEED_CLCTRbyte4_mp " SPEED_CLCTR Byte4" UBYTE OneToOne 1 100 0.00 255.0 FORMAT "%5.1" ECU_ADDRESS 0x8FF16D /end MEASUREMENT
/begin MEASUREMENT FrmMng_numSPEED_CLCTRbyte5_mp "SPEED_CLCTR Byte5" UBYTE OneToOne 1 100 0.00 255.0 FORMAT "%5.1" ECU_ADDRESS 0x8FF16E /end MEASUREMENT
/begin MEASUREMENT FrmMng_numSPEED_CLCTRbyte6_mp "SPEED_CLCTR Byte6" UBYTE OneToOne 1 100 0.00 255.0 FORMAT "%5.1" ECU_ADDRESS 0x8FF16F /end MEASUREMENT
/begin MEASUREMENT FrmMng_numSPEED_CLCTRbyte7_mp "SPEED_CLCTR Byte7" UBYTE OneToOne 1 100 0.00 255.0 FORMAT "%5.1" ECU_ADDRESS 0x8FF170 /end MEASUREMENT
/begin MEASUREMENT FrmMng_numSTAT_ANHbyte0_mp "" UBYTE OneToOne 1 100 0.00 255.0 FORMAT "%5.1" ECU_ADDRESS 0x8FF171 /end MEASUREMENT
/begin MEASUREMENT FrmMng_numSTAT_ARSbyte0_mp "Byte_x raw data in CAN-message" UBYTE OneToOne 1 100 0.00 255.0 FORMAT "%5.1" ECU_ADDRESS 0x8FF172 /end MEASUREMENT
/begin MEASUREMENT FrmMng_numSTAT_ARSbyte1_mp "Byte_x raw data in CAN-message" UBYTE OneToOne 1 100 0.00 255.0 FORMAT "%5.1" ECU_ADDRESS 0x8FF173 /end MEASUREMENT
/begin MEASUREMENT FrmMng_numSTAT_ARSbyte2_mp "Byte_x raw data in CAN-message" UBYTE OneToOne 1 100 0.00 255.0 FORMAT "%5.1" ECU_ADDRESS 0x8FF174 /end MEASUREMENT
/begin MEASUREMENT FrmMng_numSTAT_ARSbyte3_mp "Byte_x raw data in CAN-message" UBYTE OneToOne 1 100 0.00 255.0 FORMAT "%5.1" ECU_ADDRESS 0x8FF175 /end MEASUREMENT
/begin MEASUREMENT FrmMng_numSTAT_ARSbyte4_mp "Byte_x raw data in CAN-message" UBYTE OneToOne 1 100 0.00 255.0 FORMAT "%5.1" ECU_ADDRESS 0x8FF176 /end MEASUREMENT
/begin MEASUREMENT FrmMng_numSTAT_ARSbyte5_mp "Byte_x raw data in CAN-message" UBYTE OneToOne 1 100 0.00 255.0 FORMAT "%5.1" ECU_ADDRESS 0x8FF177 /end MEASUREMENT
/begin MEASUREMENT FrmMng_numSTAT_ARSbyte6_mp "Byte_x raw data in CAN-message" UBYTE OneToOne 1 100 0.00 255.0 FORMAT "%5.1" ECU_ADDRESS 0x8FF178 /end MEASUREMENT
/begin MEASUREMENT FrmMng_numSTAT_ARSbyte7_mp "Byte_x raw data in CAN-message" UBYTE OneToOne 1 100 0.00 255.0 FORMAT "%5.1" ECU_ADDRESS 0x8FF179 /end MEASUREMENT
/begin MEASUREMENT FrmMng_numSTAT_DSCbyte0_mp "Byte_x raw data in CAN-message" UBYTE OneToOne 1 100 0.00 255.0 FORMAT "%5.1" ECU_ADDRESS 0x8FF17A /end MEASUREMENT
/begin MEASUREMENT FrmMng_numSTAT_DSCbyte1_mp "Byte_x raw data in CAN-message" UBYTE OneToOne 1 100 0.00 255.0 FORMAT "%5.1" ECU_ADDRESS 0x8FF17B /end MEASUREMENT
/begin MEASUREMENT FrmMng_numSTAT_DSCbyte2_mp "Byte_x raw data in CAN-message" UBYTE OneToOne 1 100 0.00 255.0 FORMAT "%5.1" ECU_ADDRESS 0x8FF17C /end MEASUREMENT
/begin MEASUREMENT FrmMng_numSTAT_DSCbyte3_mp "Byte_x raw data in CAN-message" UBYTE OneToOne 1 100 0.00 255.0 FORMAT "%5.1" ECU_ADDRESS 0x8FF17D /end MEASUREMENT
/begin MEASUREMENT FrmMng_numSTAT_DSCbyte4_mp "Byte_x raw data in CAN-message" UBYTE OneToOne 1 100 0.00 255.0 FORMAT "%5.1" ECU_ADDRESS 0x8FF17E /end MEASUREMENT
/begin MEASUREMENT FrmMng_numSTAT_DSCbyte5_mp "Byte_x raw data in CAN-message" UBYTE OneToOne 1 100 0.00 255.0 FORMAT "%5.1" ECU_ADDRESS 0x8FF17F /end MEASUREMENT
/begin MEASUREMENT FrmMng_numSTAT_DSCbyte6_mp "Byte_x raw data in CAN-message" UBYTE OneToOne 1 100 0.00 255.0 FORMAT "%5.1" ECU_ADDRESS 0x8FF180 /end MEASUREMENT
/begin MEASUREMENT FrmMng_numSTAT_DSCbyte7_mp "Byte_x raw data in CAN-message" UBYTE OneToOne 1 100 0.00 255.0 FORMAT "%5.1" ECU_ADDRESS 0x8FF181 /end MEASUREMENT
/begin MEASUREMENT FrmMng_numSTAT_EKPbyte0_mp "STAT_EKP  Byte0" UBYTE OneToOne 1 100 0.00 255.0 FORMAT "%5.1" ECU_ADDRESS 0x8FF182 /end MEASUREMENT
/begin MEASUREMENT FrmMng_numSTAT_EKPbyte1_mp "STAT_EKP  Byte1" UBYTE OneToOne 1 100 0.00 255.0 FORMAT "%5.1" ECU_ADDRESS 0x8FF183 /end MEASUREMENT
/begin MEASUREMENT FrmMng_numSTAT_EKPbyte2_mp "STAT_EKP  Byte2" UBYTE OneToOne 1 100 0.00 255.0 FORMAT "%5.1" ECU_ADDRESS 0x8FF184 /end MEASUREMENT
/begin MEASUREMENT FrmMng_numSTAT_EKPbyte3_mp "STAT_EKP  Byte3" UBYTE OneToOne 1 100 0.00 255.0 FORMAT "%5.1" ECU_ADDRESS 0x8FF185 /end MEASUREMENT
/begin MEASUREMENT FrmMng_numSTAT_EKPbyte4_mp "STAT_EKP  Byte4" UBYTE OneToOne 1 100 0.00 255.0 FORMAT "%5.1" ECU_ADDRESS 0x8FF186 /end MEASUREMENT
/begin MEASUREMENT FrmMng_numSTAT_EKPbyte5_mp "STAT_EKP  Byte5" UBYTE OneToOne 1 100 0.00 255.0 FORMAT "%5.1" ECU_ADDRESS 0x8FF187 /end MEASUREMENT
/begin MEASUREMENT FrmMng_numSTAT_EKPbyte6_mp "STAT_EKP  Byte6" UBYTE OneToOne 1 100 0.00 255.0 FORMAT "%5.1" ECU_ADDRESS 0x8FF188 /end MEASUREMENT
/begin MEASUREMENT FrmMng_numSTAT_EKPbyte7_mp "STAT_EKP  Byte7" UBYTE OneToOne 1 100 0.00 255.0 FORMAT "%5.1" ECU_ADDRESS 0x8FF189 /end MEASUREMENT
/begin MEASUREMENT FrmMng_numSTAT_KOMBIbyte0_mp "STAT_KOMBI Byte0" UBYTE OneToOne 1 100 0.00 255.0 FORMAT "%5.1" ECU_ADDRESS 0x8FF18A /end MEASUREMENT
/begin MEASUREMENT FrmMng_numSTAT_KOMBIbyte1_mp "STAT_KOMBI Byte1" UBYTE OneToOne 1 100 0.00 255.0 FORMAT "%5.1" ECU_ADDRESS 0x8FF18B /end MEASUREMENT
/begin MEASUREMENT FrmMng_numSTAT_KOMBIbyte2_mp "STAT_KOMBI Byte2" UBYTE OneToOne 1 100 0.00 255.0 FORMAT "%5.1" ECU_ADDRESS 0x8FF18C /end MEASUREMENT
/begin MEASUREMENT FrmMng_numSTAT_KOMBIbyte3_mp "STAT_KOMBI Byte3" UBYTE OneToOne 1 100 0.00 255.0 FORMAT "%5.1" ECU_ADDRESS 0x8FF18D /end MEASUREMENT
/begin MEASUREMENT FrmMng_numSTAT_KOMBIbyte4_mp "STAT_KOMBI Byte4" UBYTE OneToOne 1 100 0.00 255.0 FORMAT "%5.1" ECU_ADDRESS 0x8FF18E /end MEASUREMENT
/begin MEASUREMENT FrmMng_numSTAT_KOMBIbyte5_mp "STAT_KOMBI Byte5" UBYTE OneToOne 1 100 0.00 255.0 FORMAT "%5.1" ECU_ADDRESS 0x8FF18F /end MEASUREMENT
/begin MEASUREMENT FrmMng_numSTAT_KOMBIbyte6_mp "STAT_KOMBI Byte6" UBYTE OneToOne 1 100 0.00 255.0 FORMAT "%5.1" ECU_ADDRESS 0x8FF190 /end MEASUREMENT
/begin MEASUREMENT FrmMng_numSTAT_KOMBIbyte7_mp "STAT_KOMBI Byte7" UBYTE OneToOne 1 100 0.00 255.0 FORMAT "%5.1" ECU_ADDRESS 0x8FF191 /end MEASUREMENT
/begin MEASUREMENT FrmMng_numTEMPRELTIMEbyte0_mp "TEMPRELTIME Byte0" UBYTE OneToOne 1 100 0.00 255.0 FORMAT "%5.1" ECU_ADDRESS 0x8FF192 /end MEASUREMENT
/begin MEASUREMENT FrmMng_numTEMPRELTIMEbyte1_mp "TEMPRELTIME Byte1" UBYTE OneToOne 1 100 0.00 255.0 FORMAT "%5.1" ECU_ADDRESS 0x8FF193 /end MEASUREMENT
/begin MEASUREMENT FrmMng_numTEMPRELTIMEbyte2_mp "TEMPRELTIME Byte2" UBYTE OneToOne 1 100 0.00 255.0 FORMAT "%5.1" ECU_ADDRESS 0x8FF194 /end MEASUREMENT
/begin MEASUREMENT FrmMng_numTEMPRELTIMEbyte3_mp "TEMPRELTIME Byte3" UBYTE OneToOne 1 100 0.00 255.0 FORMAT "%5.1" ECU_ADDRESS 0x8FF195 /end MEASUREMENT
/begin MEASUREMENT FrmMng_numTEMPRELTIMEbyte4_mp "TEMPRELTIME Byte4" UBYTE OneToOne 1 100 0.00 255.0 FORMAT "%5.1" ECU_ADDRESS 0x8FF196 /end MEASUREMENT
/begin MEASUREMENT FrmMng_numTEMPRELTIMEbyte5_mp "TEMPRELTIME Byte5" UBYTE OneToOne 1 100 0.00 255.0 FORMAT "%5.1" ECU_ADDRESS 0x8FF197 /end MEASUREMENT
/begin MEASUREMENT FrmMng_numTEMPRELTIMEbyte6_mp "TEMPRELTIME Byte6" UBYTE OneToOne 1 100 0.00 255.0 FORMAT "%5.1" ECU_ADDRESS 0x8FF198 /end MEASUREMENT
/begin MEASUREMENT FrmMng_numTERMINALbyte0_mp "Byte_x raw data in CAN-message" UBYTE OneToOne 1 100 0.00 255.0 FORMAT "%5.1" ECU_ADDRESS 0x8FF199 /end MEASUREMENT
/begin MEASUREMENT FrmMng_numTERMINALbyte1_mp "Byte_x raw data in CAN-message" UBYTE OneToOne 1 100 0.00 255.0 FORMAT "%5.1" ECU_ADDRESS 0x8FF19A /end MEASUREMENT
/begin MEASUREMENT FrmMng_numTERMINALbyte2_mp "Byte_x raw data in CAN-message" UBYTE OneToOne 1 100 0.00 255.0 FORMAT "%5.1" ECU_ADDRESS 0x8FF19B /end MEASUREMENT
/begin MEASUREMENT FrmMng_numTERMINALbyte3_mp "Byte_x raw data in CAN-message" UBYTE OneToOne 1 100 0.00 255.0 FORMAT "%5.1" ECU_ADDRESS 0x8FF19C /end MEASUREMENT
/begin MEASUREMENT FrmMng_numTERMINALbyte4_mp "Byte_x raw data in CAN-message" UBYTE OneToOne 1 100 0.00 255.0 FORMAT "%5.1" ECU_ADDRESS 0x8FF19D /end MEASUREMENT
/begin MEASUREMENT FrmMng_numTIME_DATEbyte0_mp "" UBYTE OneToOne 1 100 0.00 255.0 FORMAT "%5.1" ECU_ADDRESS 0x8FF19E /end MEASUREMENT
/begin MEASUREMENT FrmMng_numTIME_DATEbyte1_mp "" UBYTE OneToOne 1 100 0.00 255.0 FORMAT "%5.1" ECU_ADDRESS 0x8FF19F /end MEASUREMENT
/begin MEASUREMENT FrmMng_numTIME_DATEbyte2_mp "" UBYTE OneToOne 1 100 0.00 255.0 FORMAT "%5.1" ECU_ADDRESS 0x8FF1A0 /end MEASUREMENT
/begin MEASUREMENT FrmMng_numTIME_DATEbyte3_mp "" UBYTE OneToOne 1 100 0.00 255.0 FORMAT "%5.1" ECU_ADDRESS 0x8FF1A1 /end MEASUREMENT
/begin MEASUREMENT FrmMng_numTIME_DATEbyte4_mp "" UBYTE OneToOne 1 100 0.00 255.0 FORMAT "%5.1" ECU_ADDRESS 0x8FF1A2 /end MEASUREMENT
/begin MEASUREMENT FrmMng_numTIME_DATEbyte5_mp "" UBYTE OneToOne 1 100 0.00 255.0 FORMAT "%5.1" ECU_ADDRESS 0x8FF1A3 /end MEASUREMENT
/begin MEASUREMENT FrmMng_numTIME_DATEbyte6_mp "" UBYTE OneToOne 1 100 0.00 255.0 FORMAT "%5.1" ECU_ADDRESS 0x8FF1A4 /end MEASUREMENT
/begin MEASUREMENT FrmMng_numTORQUE1byte0_mp "Byte_0 Rohwerte in CAN-message TORQUE1" UBYTE OneToOne 1 100 0.00 255.0 FORMAT "%5.1" ECU_ADDRESS 0x8FF1A5 /end MEASUREMENT
/begin MEASUREMENT FrmMng_numTORQUE1byte1_mp "Byte_1 Rohwerte in CAN-Botschaft TORQUE1" UBYTE OneToOne 1 100 0.00 255.0 FORMAT "%5.1" ECU_ADDRESS 0x8FF1A6 /end MEASUREMENT
/begin MEASUREMENT FrmMng_numTORQUE1byte2_mp "Byte_2 Rohwerte in CAN-Botschaft TORQUE1" UBYTE OneToOne 1 100 0.00 255.0 FORMAT "%5.1" ECU_ADDRESS 0x8FF1A7 /end MEASUREMENT
/begin MEASUREMENT FrmMng_numTORQUE1byte3_mp "Byte_3 Rohwerte in CAN-Botschaft TORQUE1" UBYTE OneToOne 1 100 0.00 255.0 FORMAT "%5.1" ECU_ADDRESS 0x8FF1A8 /end MEASUREMENT
/begin MEASUREMENT FrmMng_numTORQUE1byte4_mp "Byte_4 Rohwerte in CAN-Botschaft TORQUE1" UBYTE OneToOne 1 100 0.00 255.0 FORMAT "%5.1" ECU_ADDRESS 0x8FF1A9 /end MEASUREMENT
/begin MEASUREMENT FrmMng_numTORQUE1byte5_mp "Byte_5 Rohwerte in CAN-Botschaft TORQUE1" UBYTE OneToOne 1 100 0.00 255.0 FORMAT "%5.1" ECU_ADDRESS 0x8FF1AA /end MEASUREMENT
/begin MEASUREMENT FrmMng_numTORQUE1byte6_mp "Byte_6 Rohwerte in CAN-Botschaft TORQUE1" UBYTE OneToOne 1 100 0.00 255.0 FORMAT "%5.1" ECU_ADDRESS 0x8FF1AB /end MEASUREMENT
/begin MEASUREMENT FrmMng_numTORQUE1byte7_mp "Byte_7 Rohwerte in CAN-Botschaft TORQUE1" UBYTE OneToOne 1 100 0.00 255.0 FORMAT "%5.1" ECU_ADDRESS 0x8FF1AC /end MEASUREMENT
/begin MEASUREMENT FrmMng_numTORQUE2byte0_mp "Byte_0 Rohwerte in CAN-Botschaft TORQUE2" UBYTE OneToOne 1 100 0.00 255.0 FORMAT "%5.1" ECU_ADDRESS 0x8FF1AD /end MEASUREMENT
/begin MEASUREMENT FrmMng_numTORQUE2byte1_mp "Byte_1 Rohwerte in CAN-Botschaft TORQUE2" UBYTE OneToOne 1 100 0.00 255.0 FORMAT "%5.1" ECU_ADDRESS 0x8FF1AE /end MEASUREMENT
/begin MEASUREMENT FrmMng_numTORQUE2byte2_mp "Byte_2 Rohwerte in CAN-Botschaft TORQUE2" UBYTE OneToOne 1 100 0.00 255.0 FORMAT "%5.1" ECU_ADDRESS 0x8FF1AF /end MEASUREMENT
/begin MEASUREMENT FrmMng_numTORQUE2byte3_mp "Byte_3 Rohwerte in CAN-Botschaft TORQUE2" UBYTE OneToOne 1 100 0.00 255.0 FORMAT "%5.1" ECU_ADDRESS 0x8FF1B0 /end MEASUREMENT
/begin MEASUREMENT FrmMng_numTORQUE2byte4_mp "Byte_4 Rohwerte in CAN-Botschaft TORQUE2" UBYTE OneToOne 1 100 0.00 255.0 FORMAT "%5.1" ECU_ADDRESS 0x8FF1B1 /end MEASUREMENT
/begin MEASUREMENT FrmMng_numTORQUE2byte5_mp "Byte_5 Rohwerte in CAN-Botschaft TORQUE2" UBYTE OneToOne 1 100 0.00 255.0 FORMAT "%5.1" ECU_ADDRESS 0x8FF1B2 /end MEASUREMENT
/begin MEASUREMENT FrmMng_numTORQUE2byte6_mp "Byte_6 Rohwerte in CAN-Botschaft TORQUE2" UBYTE OneToOne 1 100 0.00 255.0 FORMAT "%5.1" ECU_ADDRESS 0x8FF1B3 /end MEASUREMENT
/begin MEASUREMENT FrmMng_numTORQUE2byte7_mp "Byte_7 Rohwerte in CAN-Botschaft TORQUE2" UBYTE OneToOne 1 100 0.00 255.0 FORMAT "%5.1" ECU_ADDRESS 0x8FF1B4 /end MEASUREMENT
/begin MEASUREMENT FrmMng_numTORQUE3byte0_mp "Byte_0 Rohwerte in CAN-message TORQUE3" UBYTE OneToOne 1 100 0.00 255.0 FORMAT "%5.1" ECU_ADDRESS 0x8FF1B5 /end MEASUREMENT
/begin MEASUREMENT FrmMng_numTORQUE3byte1_mp "Byte_1 Rohwerte in CAN-Botschaft TORQUE3" UBYTE OneToOne 1 100 0.00 255.0 FORMAT "%5.1" ECU_ADDRESS 0x8FF1B6 /end MEASUREMENT
/begin MEASUREMENT FrmMng_numTORQUE3byte2_mp "Byte_2 Rohwerte in CAN-Botschaft TORQUE3" UBYTE OneToOne 1 100 0.00 255.0 FORMAT "%5.1" ECU_ADDRESS 0x8FF1B7 /end MEASUREMENT
/begin MEASUREMENT FrmMng_numTORQUE3byte3_mp "Byte_3 Rohwerte in CAN-Botschaft TORQUE3" UBYTE OneToOne 1 100 0.00 255.0 FORMAT "%5.1" ECU_ADDRESS 0x8FF1B8 /end MEASUREMENT
/begin MEASUREMENT FrmMng_numTORQUE3byte4_mp "Byte_4 Rohwerte in CAN-Botschaft TORQUE3" UBYTE OneToOne 1 100 0.00 255.0 FORMAT "%5.1" ECU_ADDRESS 0x8FF1B9 /end MEASUREMENT
/begin MEASUREMENT FrmMng_numTORQUE3byte5_mp "Byte_5 Rohwerte in CAN-Botschaft TORQUE3" UBYTE OneToOne 1 100 0.00 255.0 FORMAT "%5.1" ECU_ADDRESS 0x8FF1BA /end MEASUREMENT
/begin MEASUREMENT FrmMng_numTORQUE3byte6_mp "Byte_6 Rohwerte in CAN-Botschaft TORQUE3" UBYTE OneToOne 1 100 0.00 255.0 FORMAT "%5.1" ECU_ADDRESS 0x8FF1BB /end MEASUREMENT
/begin MEASUREMENT FrmMng_numTORQUE3byte7_mp "Byte_7 Rohwerte in CAN-Botschaft TORQUE3" UBYTE OneToOne 1 100 0.00 255.0 FORMAT "%5.1" ECU_ADDRESS 0x8FF1BC /end MEASUREMENT
/begin MEASUREMENT FrmMng_numTORQUE_DSCbyte0_mp "Byte_x raw data in CAN-message" UBYTE OneToOne 1 100 0.00 255.0 FORMAT "%5.1" ECU_ADDRESS 0x8FF1BD /end MEASUREMENT
/begin MEASUREMENT FrmMng_numTORQUE_DSCbyte1_mp "Byte_x raw data in CAN-message" UBYTE OneToOne 1 100 0.00 255.0 FORMAT "%5.1" ECU_ADDRESS 0x8FF1BE /end MEASUREMENT
/begin MEASUREMENT FrmMng_numTORQUE_DSCbyte2_mp "Byte_x raw data in CAN-message" UBYTE OneToOne 1 100 0.00 255.0 FORMAT "%5.1" ECU_ADDRESS 0x8FF1BF /end MEASUREMENT
/begin MEASUREMENT FrmMng_numTORQUE_DSCbyte3_mp "Byte_x raw data in CAN-message" UBYTE OneToOne 1 100 0.00 255.0 FORMAT "%5.1" ECU_ADDRESS 0x8FF1C0 /end MEASUREMENT
/begin MEASUREMENT FrmMng_numTORQUE_DSCbyte4_mp "Byte_x raw data in CAN-message" UBYTE OneToOne 1 100 0.00 255.0 FORMAT "%5.1" ECU_ADDRESS 0x8FF1C1 /end MEASUREMENT
/begin MEASUREMENT FrmMng_numTORQUE_DSCbyte5_mp "Byte_x raw data in CAN-message" UBYTE OneToOne 1 100 0.00 255.0 FORMAT "%5.1" ECU_ADDRESS 0x8FF1C2 /end MEASUREMENT
/begin MEASUREMENT FrmMng_numTORQUE_DSCbyte6_mp "Byte_x raw data in CAN-message" UBYTE OneToOne 1 100 0.00 255.0 FORMAT "%5.1" ECU_ADDRESS 0x8FF1C3 /end MEASUREMENT
/begin MEASUREMENT FrmMng_numTORQUE_DSCbyte7_mp "Byte_x raw data in CAN-message" UBYTE OneToOne 1 100 0.00 255.0 FORMAT "%5.1" ECU_ADDRESS 0x8FF1C4 /end MEASUREMENT
/begin MEASUREMENT FrmMng_numTORQUE_GEARBXbyte0_mp "Byte_x raw data in CAN-message" UBYTE OneToOne 1 100 0.00 255.0 FORMAT "%5.1" ECU_ADDRESS 0x8FF1C5 /end MEASUREMENT
/begin MEASUREMENT FrmMng_numTORQUE_GEARBXbyte1_mp "Byte_x raw data in CAN-message" UBYTE OneToOne 1 100 0.00 255.0 FORMAT "%5.1" ECU_ADDRESS 0x8FF1C6 /end MEASUREMENT
/begin MEASUREMENT FrmMng_numTORQUE_GEARBXbyte2_mp "Byte_x raw data in CAN-message" UBYTE OneToOne 1 100 0.00 255.0 FORMAT "%5.1" ECU_ADDRESS 0x8FF1C7 /end MEASUREMENT
/begin MEASUREMENT FrmMng_numTORQUE_GEARBXbyte3_mp "Byte_x raw data in CAN-message" UBYTE OneToOne 1 100 0.00 255.0 FORMAT "%5.1" ECU_ADDRESS 0x8FF1C8 /end MEASUREMENT
/begin MEASUREMENT FrmMng_numTORQUE_GEARBXbyte4_mp "Byte_x raw data in CAN-message" UBYTE OneToOne 1 100 0.00 255.0 FORMAT "%5.1" ECU_ADDRESS 0x8FF1C9 /end MEASUREMENT
/begin MEASUREMENT FrmMng_numTORQUE_GEARBXbyte5_mp "Byte_x raw data in CAN-message" UBYTE OneToOne 1 100 0.00 255.0 FORMAT "%5.1" ECU_ADDRESS 0x8FF1CA /end MEASUREMENT
/begin MEASUREMENT FrmMng_numTORQUE_GEARBXbyte6_mp "Byte_x raw data in CAN-message" UBYTE OneToOne 1 100 0.00 255.0 FORMAT "%5.1" ECU_ADDRESS 0x8FF1CB /end MEASUREMENT
/begin MEASUREMENT FrmMng_numTORQUE_GEARBXbyte7_mp "Byte_x raw data in CAN-message" UBYTE OneToOne 1 100 0.00 255.0 FORMAT "%5.1" ECU_ADDRESS 0x8FF1CC /end MEASUREMENT
/begin MEASUREMENT FrmMng_numVEH_MODbyte0_mp "VEH_MOD Byte0" UBYTE OneToOne 1 100 0.00 255.0 FORMAT "%5.1" ECU_ADDRESS 0x8FF1CD /end MEASUREMENT
/begin MEASUREMENT FrmMng_numVEH_MODbyte1_mp "VEH_MOD Byte1" UBYTE OneToOne 1 100 0.00 255.0 FORMAT "%5.1" ECU_ADDRESS 0x8FF1CE /end MEASUREMENT
/begin MEASUREMENT FrmMng_numVELOCITYbyte0_mp "Byte_x raw data in CAN-message" UBYTE OneToOne 1 100 0.00 255.0 FORMAT "%5.1" ECU_ADDRESS 0x8FF1CF /end MEASUREMENT
/begin MEASUREMENT FrmMng_numVELOCITYbyte1_mp "Byte_x raw data in CAN-message" UBYTE OneToOne 1 100 0.00 255.0 FORMAT "%5.1" ECU_ADDRESS 0x8FF1D0 /end MEASUREMENT
/begin MEASUREMENT FrmMng_numVELOCITYbyte2_mp "Byte_x raw data in CAN-message" UBYTE OneToOne 1 100 0.00 255.0 FORMAT "%5.1" ECU_ADDRESS 0x8FF1D1 /end MEASUREMENT
/begin MEASUREMENT FrmMng_numVELOCITYbyte3_mp "Byte_x raw data in CAN-message" UBYTE OneToOne 1 100 0.00 255.0 FORMAT "%5.1" ECU_ADDRESS 0x8FF1D2 /end MEASUREMENT
/begin MEASUREMENT FrmMng_numVELOCITYbyte4_mp "Byte_x raw data in CAN-message" UBYTE OneToOne 1 100 0.00 255.0 FORMAT "%5.1" ECU_ADDRESS 0x8FF1D3 /end MEASUREMENT
/begin MEASUREMENT FrmMng_numVELOCITYbyte5_mp "Byte_x raw data in CAN-message" UBYTE OneToOne 1 100 0.00 255.0 FORMAT "%5.1" ECU_ADDRESS 0x8FF1D4 /end MEASUREMENT
/begin MEASUREMENT FrmMng_numVELOCITYbyte6_mp "Byte_x raw data in CAN-message" UBYTE OneToOne 1 100 0.00 255.0 FORMAT "%5.1" ECU_ADDRESS 0x8FF1D5 /end MEASUREMENT
/begin MEASUREMENT FrmMng_numVELOCITYbyte7_mp "Byte_x raw data in CAN-message" UBYTE OneToOne 1 100 0.00 255.0 FORMAT "%5.1" ECU_ADDRESS 0x8FF1D6 /end MEASUREMENT
/begin MEASUREMENT FrmMng_numWHEEL_SPEEDbyte0_mp "Wheel Speed Rohwerte" UBYTE OneToOne 1 100 0.00 255.0 FORMAT "%5.1" ECU_ADDRESS 0x8FF1D7 /end MEASUREMENT
/begin MEASUREMENT FrmMng_numWHEEL_SPEEDbyte1_mp "Wheel Speed Rohwerte" UBYTE OneToOne 1 100 0.00 255.0 FORMAT "%5.1" ECU_ADDRESS 0x8FF1D8 /end MEASUREMENT
/begin MEASUREMENT FrmMng_numWHEEL_SPEEDbyte2_mp "Wheel Speed Rohwerte" UBYTE OneToOne 1 100 0.00 255.0 FORMAT "%5.1" ECU_ADDRESS 0x8FF1D9 /end MEASUREMENT
/begin MEASUREMENT FrmMng_numWHEEL_SPEEDbyte3_mp "Wheel Speed Rohwerte" UBYTE OneToOne 1 100 0.00 255.0 FORMAT "%5.1" ECU_ADDRESS 0x8FF1DA /end MEASUREMENT
/begin MEASUREMENT FrmMng_numWHEEL_SPEEDbyte4_mp "Wheel Speed Rohwerte" UBYTE OneToOne 1 100 0.00 255.0 FORMAT "%5.1" ECU_ADDRESS 0x8FF1DB /end MEASUREMENT
/begin MEASUREMENT FrmMng_numWHEEL_SPEEDbyte5_mp "Wheel Speed Rohwerte" UBYTE OneToOne 1 100 0.00 255.0 FORMAT "%5.1" ECU_ADDRESS 0x8FF1DC /end MEASUREMENT
/begin MEASUREMENT FrmMng_numWHEEL_SPEEDbyte6_mp "Wheel Speed Rohwerte" UBYTE OneToOne 1 100 0.00 255.0 FORMAT "%5.1" ECU_ADDRESS 0x8FF1DD /end MEASUREMENT
/begin MEASUREMENT FrmMng_numWHEEL_SPEEDbyte7_mp "Wheel Speed Rohwerte" UBYTE OneToOne 1 100 0.00 255.0 FORMAT "%5.1" ECU_ADDRESS 0x8FF1DE /end MEASUREMENT
/begin MEASUREMENT FrmMng_pAir "Atmosphärendruck über CAN" SWORD Pres_hPa 1 100 -32768.00 32767.00 FORMAT "%8.2" ECU_ADDRESS 0x7F8CEC /end MEASUREMENT
/begin MEASUREMENT FrmMng_parkConsumerFunctionID "ID function park consumer" UWORD OneToOne 1 100 0.00 65535.00 FORMAT "%8.2" ECU_ADDRESS 0x7F8CF2 /end MEASUREMENT
/begin MEASUREMENT FrmMng_parkConsumerID2 "ID function park consumer" UBYTE OneToOne 1 100 0.00 255.0 FORMAT "%5.1" ECU_ADDRESS 0x7F8897 /end MEASUREMENT
/begin MEASUREMENT FrmMng_pBrkSys "Bremsdruck" UWORD Pres_bar 1 100 0.00 65535.00 FORMAT "%8.2" ECU_ADDRESS 0x7F8CF0 /end MEASUREMENT
/begin MEASUREMENT FrmMng_phiStrg "Steering angle recieved over CAN" SWORD AngleGrad 1 100 -1440.154 1440.110 FORMAT "%8.3" ECU_ADDRESS 0x7F8CF4 /end MEASUREMENT
/begin MEASUREMENT FrmMng_RadmomPT1RetVal_mp "actvation status of the message RADMOM_PT_1" UBYTE OneToOne 1 100 0.00 255.0 FORMAT "%5.1" ECU_ADDRESS 0x8FF1DF /end MEASUREMENT
/begin MEASUREMENT FrmMng_RadmomPT2RetVal_mp "Activation status of the frame RADMOM_PT_2" UBYTE OneToOne 1 100 0.00 255.0 FORMAT "%5.1" ECU_ADDRESS 0x8FF1E0 /end MEASUREMENT
/begin MEASUREMENT FrmMng_rHtFlowReq "heat flow request" UWORD Prc 1 100 0.00 799.9878 FORMAT "%8.4" ECU_ADDRESS 0x7F8CF6 /end MEASUREMENT
/begin MEASUREMENT FrmMng_rPSPSetPoint "Aktuelle Stellgröße der EKP-Regelung" SWORD Prc 1 100 -400.0000 399.9878 FORMAT "%8.4" ECU_ADDRESS 0x7F8CF8 /end MEASUREMENT
/begin MEASUREMENT FrmMng_rTransDT "Triebstrangsübersetzungsverhältnis von CAN" SWORD TransR 1 100 -327.6800 327.6700 FORMAT "%8.4" ECU_ADDRESS 0x7F8CFA /end MEASUREMENT
/begin MEASUREMENT FrmMng_rTrqDCS_mp "Meßpunkt für Verhältnis MSR-Anforderungsmoment / Maximalmoment" SWORD Prc 1 100 -400.0000 399.9878 FORMAT "%8.4" ECU_ADDRESS 0x8FF044 /end MEASUREMENT
/begin MEASUREMENT FrmMng_rTrqGearbxFrc_mp "MD_GETRIEBE nach Normalisation" SWORD Prc 1 100 -400.0000 399.9878 FORMAT "%8.4" ECU_ADDRESS 0x8FF046 /end MEASUREMENT
/begin MEASUREMENT FrmMng_rTrqGearbx_mp "MD_IND_GS nach Normalisation" SWORD Prc 1 100 -400.0000 399.9878 FORMAT "%8.4" ECU_ADDRESS 0x8FF048 /end MEASUREMENT
/begin MEASUREMENT FrmMng_rTrqTCS_mp "Meßpunkt für Verhältnis ASR-Anforderungsmoment / Maximalmoment" SWORD Prc 1 100 -400.0000 399.9878 FORMAT "%8.4" ECU_ADDRESS 0x8FF04A /end MEASUREMENT
/begin MEASUREMENT FrmMng_rWaterVlv_mp "measuring point fot CTR_APE_WV" UWORD Prc 1 100 0.00 799.9878 FORMAT "%8.4" ECU_ADDRESS 0x8FF1E2 /end MEASUREMENT
/begin MEASUREMENT FrmMng_service_index_Byte0_mp "Byte0 of raw messagebyte of logon and logout message" UBYTE OneToOne 1 100 0.00 255.0 FORMAT "%5.1" ECU_ADDRESS 0x8FF1E4 /end MEASUREMENT
/begin MEASUREMENT FrmMng_service_index_Byte10_mp "Byte10 of raw messagebyte of logon and logout message" UBYTE OneToOne 1 100 0.00 255.0 FORMAT "%5.1" ECU_ADDRESS 0x8FF1E5 /end MEASUREMENT
/begin MEASUREMENT FrmMng_service_index_Byte11_mp "Byte11 of raw messagebyte of logon and logout message" UBYTE OneToOne 1 100 0.00 255.0 FORMAT "%5.1" ECU_ADDRESS 0x8FF1E6 /end MEASUREMENT
/begin MEASUREMENT FrmMng_service_index_Byte12_mp "Byte12 of raw messagebyte of logon and logout message" UBYTE OneToOne 1 100 0.00 255.0 FORMAT "%5.1" ECU_ADDRESS 0x8FF1E7 /end MEASUREMENT
/begin MEASUREMENT FrmMng_service_index_Byte13_mp "Byte13 of raw messagebyte of logon and logout message" UBYTE OneToOne 1 100 0.00 255.0 FORMAT "%5.1" ECU_ADDRESS 0x8FF1E8 /end MEASUREMENT
/begin MEASUREMENT FrmMng_service_index_Byte14_mp "Byte14 of raw messagebyte of logon and logout message" UBYTE OneToOne 1 100 0.00 255.0 FORMAT "%5.1" ECU_ADDRESS 0x8FF1E9 /end MEASUREMENT
/begin MEASUREMENT FrmMng_service_index_Byte1_mp "Byte1 of raw messagebyte of logon and logout message" UBYTE OneToOne 1 100 0.00 255.0 FORMAT "%5.1" ECU_ADDRESS 0x8FF1EA /end MEASUREMENT
/begin MEASUREMENT FrmMng_service_index_Byte2_mp "Byte2 of raw messagebyte of logon and logout message" UBYTE OneToOne 1 100 0.00 255.0 FORMAT "%5.1" ECU_ADDRESS 0x8FF1EB /end MEASUREMENT
/begin MEASUREMENT FrmMng_service_index_Byte3_mp "Byte3 of raw messagebyte of logon and logout message" UBYTE OneToOne 1 100 0.00 255.0 FORMAT "%5.1" ECU_ADDRESS 0x8FF1EC /end MEASUREMENT
/begin MEASUREMENT FrmMng_service_index_Byte4_mp "Byte4 of raw messagebyte of logon and logout message" UBYTE OneToOne 1 100 0.00 255.0 FORMAT "%5.1" ECU_ADDRESS 0x8FF1ED /end MEASUREMENT
/begin MEASUREMENT FrmMng_service_index_Byte5_mp "Byte5 of raw messagebyte of logon and logout message" UBYTE OneToOne 1 100 0.00 255.0 FORMAT "%5.1" ECU_ADDRESS 0x8FF1EE /end MEASUREMENT
/begin MEASUREMENT FrmMng_service_index_Byte6_mp "Byte6 of raw messagebyte of logon and logout message" UBYTE OneToOne 1 100 0.00 255.0 FORMAT "%5.1" ECU_ADDRESS 0x8FF1EF /end MEASUREMENT
/begin MEASUREMENT FrmMng_service_index_Byte7_mp "Byte7 of raw messagebyte of logon and logout message" UBYTE OneToOne 1 100 0.00 255.0 FORMAT "%5.1" ECU_ADDRESS 0x8FF1F0 /end MEASUREMENT
/begin MEASUREMENT FrmMng_service_index_Byte8_mp "Byte8 of raw messagebyte of logon and logout message" UBYTE OneToOne 1 100 0.00 255.0 FORMAT "%5.1" ECU_ADDRESS 0x8FF1F1 /end MEASUREMENT
/begin MEASUREMENT FrmMng_service_index_Byte9_mp "Byte9 of raw messagebyte of logon and logout message" UBYTE OneToOne 1 100 0.00 255.0 FORMAT "%5.1" ECU_ADDRESS 0x8FF1F2 /end MEASUREMENT
/begin MEASUREMENT FrmMng_stAC "Klimaanlagenzustand über CAN" UWORD OneToOne 1 100 0.00 65535.00 FORMAT "%8.2" ECU_ADDRESS 0x7F8CFC /end MEASUREMENT
/begin MEASUREMENT FrmMng_stACCTrqCtl "Message to indicate the torque reduction for ACC" UBYTE OneToOne 1 100 0.00 255.0 FORMAT "%5.1" ECU_ADDRESS 0x7F8898 /end MEASUREMENT
/begin MEASUREMENT FrmMng_stACC_ModDME "Status ACC mode DME-message" UBYTE OneToOne 1 100 0.00 255.0 FORMAT "%5.1" ECU_ADDRESS 0x7F8899 /end MEASUREMENT
/begin MEASUREMENT FrmMng_stACC_PrevOvrRunSwtDem "request prevention over run fuel shutoff-message" UBYTE OneToOne 1 100 0.00 255.0 FORMAT "%5.1" ECU_ADDRESS 0x7F889A /end MEASUREMENT
/begin MEASUREMENT FrmMng_stACC_ShtDwnDME "Status ACC Switch-off system-message" UBYTE OneToOne 1 100 0.00 255.0 FORMAT "%5.1" ECU_ADDRESS 0x7F889B /end MEASUREMENT
/begin MEASUREMENT FrmMng_stACC_TrqDes "Torque target status-message DREHMOMENT_ANF_ACC" UBYTE OneToOne 1 100 0.00 255.0 FORMAT "%5.1" ECU_ADDRESS 0x7F889C /end MEASUREMENT
/begin MEASUREMENT FrmMng_stACmainSwt "Hauptschalter Klimakompressor" UBYTE OneToOne 1 100 0.00 255.0 FORMAT "%5.1" ECU_ADDRESS 0x7F889E /end MEASUREMENT
/begin MEASUREMENT FrmMng_stACnMin "Drehzahlanhebungsanforderung vom Klimakompressor" UBYTE OneToOne 1 100 0.00 255.0 FORMAT "%5.1" ECU_ADDRESS 0x7F889F /end MEASUREMENT
/begin MEASUREMENT FrmMng_stANFRADMOMPTSig "Spiegel ungültiger Signale von ANF_RADMOM_PT" UWORD OneToOne 1 100 0.00 65535.00 FORMAT "%8.2" ECU_ADDRESS 0x7F8CFE /end MEASUREMENT
/begin MEASUREMENT FrmMng_stARS "type of ARS torque-intervention" UBYTE OneToOne 1 100 0.00 255.0 FORMAT "%5.1" ECU_ADDRESS 0x7F88A0 /end MEASUREMENT
/begin MEASUREMENT FrmMng_stARSquit_mp "Bestaetigung ARS-Momenteneingriff" UBYTE OneToOne 1 100 0.00 255.0 FORMAT "%5.1" ECU_ADDRESS 0x8FF1F3 /end MEASUREMENT
/begin MEASUREMENT FrmMng_stASC1Sig_mp "Signal-Error-Status ASC1" UWORD OneToOne 1 100 0.00 65535.00 FORMAT "%8.2" ECU_ADDRESS 0x8FF04C /end MEASUREMENT
/begin MEASUREMENT FrmMng_stASC2Sig_mp "Signal-Error-Status ASC2" UWORD OneToOne 1 100 0.00 65535.00 FORMAT "%8.2" ECU_ADDRESS 0x8FF04E /end MEASUREMENT
/begin MEASUREMENT FrmMng_stASC3Sig_mp "Signal-Error-Status ASC3" UWORD OneToOne 1 100 0.00 65535.00 FORMAT "%8.2" ECU_ADDRESS 0x8FF050 /end MEASUREMENT
/begin MEASUREMENT FrmMng_stASC4Sig_mp "Signalerrorstate ASC4" UWORD OneToOne 1 100 0.00 65535.00 FORMAT "%8.2" ECU_ADDRESS 0x8FF052 /end MEASUREMENT
/begin MEASUREMENT FrmMng_stASCok "status ASC Eingriff" UBYTE OneToOne 1 100 0.00 255.0 FORMAT "%5.1" ECU_ADDRESS 0x7F88A1 /end MEASUREMENT
/begin MEASUREMENT FrmMng_stAVAI_BOS_RSTG "unit for availability of removing parts" UBYTE OneToOne 1 100 0.00 255.0 FORMAT "%5.1" ECU_ADDRESS 0x7F88A3 /end MEASUREMENT
/begin MEASUREMENT FrmMng_stBltbDr "Status Gurtschloßkontakt" UBYTE OneToOne 1 100 0.00 255.0 FORMAT "%5.1" ECU_ADDRESS 0x7F88A4 /end MEASUREMENT
/begin MEASUREMENT FrmMng_stBOS_RESETSig "signalerrorstatus-message BOS_RESET" UWORD OneToOne 1 100 0.00 65535.00 FORMAT "%8.2" ECU_ADDRESS 0x7F8D00 /end MEASUREMENT
/begin MEASUREMENT FrmMng_stBOS_RESET_2Sig "" UWORD OneToOne 1 100 0.00 65535.00 FORMAT "%8.2" ECU_ADDRESS 0x7F8D02 /end MEASUREMENT
/begin MEASUREMENT FrmMng_stBrkTCS_mp "Bremsstatus TCS" UBYTE OneToOne 1 100 0.00 255.0 FORMAT "%5.1" ECU_ADDRESS 0x8FF054 /end MEASUREMENT
/begin MEASUREMENT FrmMng_stBrk_mp "Status Bremslicht-Schalter" UBYTE OneToOne 1 100 0.00 255.0 FORMAT "%5.1" ECU_ADDRESS 0x8FF1F4 /end MEASUREMENT
/begin MEASUREMENT FrmMng_stClCtr "control-status" UBYTE OneToOne 1 100 0.00 255.0 FORMAT "%5.1" ECU_ADDRESS 0x7F88A9 /end MEASUREMENT
/begin MEASUREMENT FrmMng_stCltSSG "Status of Clutch" UBYTE OneToOne 1 100 0.00 255.0 FORMAT "%5.1" ECU_ADDRESS 0x7F88AA /end MEASUREMENT
/begin MEASUREMENT FrmMng_stConv "Kupplungszustand über CAN" UBYTE OneToOne 1 100 0.00 255.0 FORMAT "%5.1" ECU_ADDRESS 0x7F88AB /end MEASUREMENT
/begin MEASUREMENT FrmMng_stCOU_RSTG_BOS_RSTG "counter for removing parts" UBYTE OneToOne 1 100 0.00 255.0 FORMAT "%5.1" ECU_ADDRESS 0x7F88A8 /end MEASUREMENT
/begin MEASUREMENT FrmMng_stCrCCDKey_mp "Bediensignal FGR" UBYTE OneToOne 1 100 0.00 255.0 FORMAT "%5.1" ECU_ADDRESS 0x8FF055 /end MEASUREMENT
/begin MEASUREMENT FrmMng_stCrCtlOff_mp "FGR Abschaltung von DSC" UBYTE OneToOne 1 100 0.00 255.0 FORMAT "%5.1" ECU_ADDRESS 0x8FF056 /end MEASUREMENT
/begin MEASUREMENT FrmMng_stCrCtlRaw "state CrCtlRaw" UBYTE OneToOne 1 100 0.00 255.0 FORMAT "%5.1" ECU_ADDRESS 0x7F88AD /end MEASUREMENT
/begin MEASUREMENT FrmMng_stCrCtl_mp "Status FGR" UBYTE OneToOne 1 100 0.00 255.0 FORMAT "%5.1" ECU_ADDRESS 0x8FF1F5 /end MEASUREMENT
/begin MEASUREMENT FrmMng_stCurrSig_mp "Botschaftsstatus für CODIERUNG_PM Botschaft" UWORD OneToOne 1 100 0.00 65535.00 FORMAT "%8.2" ECU_ADDRESS 0x8FF1F6 /end MEASUREMENT
/begin MEASUREMENT FrmMng_stCurr_byte0_mp "Rohwert von MAG_BT signal" UBYTE OneToOne 1 100 0.00 255.0 FORMAT "%5.1" ECU_ADDRESS 0x8FF1F8 /end MEASUREMENT
/begin MEASUREMENT FrmMng_stCurr_byte1_mp "Rohwert von QC_VEH CAN signal" UBYTE OneToOne 1 100 0.00 255.0 FORMAT "%5.1" ECU_ADDRESS 0x8FF1F9 /end MEASUREMENT
/begin MEASUREMENT FrmMng_stCurr_byte2_mp "Rohwert von I_SC_MAX_VEH signal" UBYTE OneToOne 1 100 0.00 255.0 FORMAT "%5.1" ECU_ADDRESS 0x8FF1FA /end MEASUREMENT
/begin MEASUREMENT FrmMng_stCurr_byte3_mp "Rohwert von I_SC_MAX_VEH signal" UBYTE OneToOne 1 100 0.00 255.0 FORMAT "%5.1" ECU_ADDRESS 0x8FF1FB /end MEASUREMENT
/begin MEASUREMENT FrmMng_stDateDay "" UBYTE OneToOne 1 100 0.00 255.0 FORMAT "%5.1" ECU_ADDRESS 0x7F88B1 /end MEASUREMENT
/begin MEASUREMENT FrmMng_stDateMon "" UBYTE OneToOne 1 100 0.00 255.0 FORMAT "%5.1" ECU_ADDRESS 0x7F88B2 /end MEASUREMENT
/begin MEASUREMENT FrmMng_stDateSeason "" UBYTE OneToOne 1 100 0.00 255.0 FORMAT "%5.1" ECU_ADDRESS 0x7F88B3 /end MEASUREMENT
/begin MEASUREMENT FrmMng_stDateYr "" UWORD OneToOne 1 100 0.00 65535.00 FORMAT "%8.2" ECU_ADDRESS 0x7F8D0A /end MEASUREMENT
/begin MEASUREMENT FrmMng_stDCC_TrqDes "Radmoment Antriebsstrang Freischaltung" UBYTE OneToOne 1 100 0.00 255.0 FORMAT "%5.1" ECU_ADDRESS 0x7F88AE /end MEASUREMENT
/begin MEASUREMENT FrmMng_stDCSActive_mp "Signal B_MSR von CAN, MSR Eingriff aktiv" UBYTE OneToOne 1 100 0.00 255.0 FORMAT "%5.1" ECU_ADDRESS 0x8FF057 /end MEASUREMENT
/begin MEASUREMENT FrmMng_stDebValT15CDold_mp "" UBYTE OneToOne 1 100 0.00 255.0 FORMAT "%5.1" ECU_ADDRESS 0x8FF1FC /end MEASUREMENT
/begin MEASUREMENT FrmMng_stDecellDSC "state delay DSC" UBYTE OneToOne 1 100 0.00 255.0 FORMAT "%5.1" ECU_ADDRESS 0x7F88B4 /end MEASUREMENT
/begin MEASUREMENT FrmMng_stDM_ANF_AFSSig "signal error status for DREHMOMENT_ANF_AFS" UWORD OneToOne 1 100 0.00 65535.00 FORMAT "%8.2" ECU_ADDRESS 0x7F8D04 /end MEASUREMENT
/begin MEASUREMENT FrmMng_stDREHMOMENT_ANF_ACCSig "signalerrorstatus-message" UWORD OneToOne 1 100 0.00 65535.00 FORMAT "%8.2" ECU_ADDRESS 0x7F8D06 /end MEASUREMENT
/begin MEASUREMENT FrmMng_stDRMANFSSGSig "Status of error signal DREHMOMENT_ANF_SSG" UWORD OneToOne 1 100 0.00 65535.00 FORMAT "%8.2" ECU_ADDRESS 0x7F8D08 /end MEASUREMENT
/begin MEASUREMENT FrmMng_stDrvAssist_mp "Status Fahrerassistenz Antriebsstrang" UBYTE OneToOne 1 100 0.00 255.0 FORMAT "%5.1" ECU_ADDRESS 0x8FF1FD /end MEASUREMENT
/begin MEASUREMENT FrmMng_stDSCCtrl_mp "DSC Eingriff" UBYTE OneToOne 1 100 0.00 255.0 FORMAT "%5.1" ECU_ADDRESS 0x8FF058 /end MEASUREMENT
/begin MEASUREMENT FrmMng_stDSCDef "Status DSC" UBYTE OneToOne 1 100 0.00 255.0 FORMAT "%5.1" ECU_ADDRESS 0x7F88B0 /end MEASUREMENT
/begin MEASUREMENT FrmMng_stDSCDelay_mp "Status für DSC delay" UBYTE OneToOne 1 100 0.00 255.0 FORMAT "%5.1" ECU_ADDRESS 0x8FF059 /end MEASUREMENT
/begin MEASUREMENT FrmMng_stDSCquit_mp "Bestaetigung DSC-Momenteneingriff" UBYTE OneToOne 1 100 0.00 255.0 FORMAT "%5.1" ECU_ADDRESS 0x8FF1FE /end MEASUREMENT
/begin MEASUREMENT FrmMng_stEGS1Sig_mp "Zustand des Getriebes" UWORD OneToOne 1 100 0.00 65535.00 FORMAT "%8.2" ECU_ADDRESS 0x8FF05A /end MEASUREMENT
/begin MEASUREMENT FrmMng_stEGS2Sig_mp "Signal-Error-Status EGS2" UWORD OneToOne 1 100 0.00 65535.00 FORMAT "%8.2" ECU_ADDRESS 0x8FF05C /end MEASUREMENT
/begin MEASUREMENT FrmMng_stEngRun_mp "Motorlaufzustand über CAN" UBYTE OneToOne 1 100 0.00 255.0 FORMAT "%5.1" ECU_ADDRESS 0x8FF05E /end MEASUREMENT
/begin MEASUREMENT FrmMng_stEng_mp "Status Motorlauf" UBYTE OneToOne 1 100 0.00 255.0 FORMAT "%5.1" ECU_ADDRESS 0x8FF1FF /end MEASUREMENT
/begin MEASUREMENT FrmMng_stErrAFS "Error status of AFS received over CAN" UBYTE OneToOne 1 100 0.00 255.0 FORMAT "%5.1" ECU_ADDRESS 0x7F88B5 /end MEASUREMENT
/begin MEASUREMENT FrmMng_stErrStrg "Error status of Steering received over CAN" UBYTE OneToOne 1 100 0.00 255.0 FORMAT "%5.1" ECU_ADDRESS 0x7F88B6 /end MEASUREMENT
/begin MEASUREMENT FrmMng_stExcStateCan_mp "" ULONG OneToOne 1 100 0.00 4294967295.00 FORMAT "%13.2" ECU_ADDRESS 0x8FF200 /end MEASUREMENT
/begin MEASUREMENT FrmMng_stExc_ANFRADMOMPT_mp "Exception State für ANF_RADMOM_PT" UWORD OneToOne 1 100 0.00 65535.00 FORMAT "%8.2" ECU_ADDRESS 0x8FF204 /end MEASUREMENT
/begin MEASUREMENT FrmMng_stExc_ASC1_mp "Exceptionstate von CAN-Botschaft (errors, freeze, ...)" UWORD OneToOne 1 100 0.00 65535.00 FORMAT "%8.2" ECU_ADDRESS 0x8FF060 /end MEASUREMENT
/begin MEASUREMENT FrmMng_stExc_ASC2_mp "Exceptionstate von CAN-Botschaft (errors, freeze, ...)" UWORD OneToOne 1 100 0.00 65535.00 FORMAT "%8.2" ECU_ADDRESS 0x8FF062 /end MEASUREMENT
/begin MEASUREMENT FrmMng_stExc_ASC3_mp "Exceptionstate von CAN-Botschaft (errors, freeze, ...)" UWORD OneToOne 1 100 0.00 65535.00 FORMAT "%8.2" ECU_ADDRESS 0x8FF064 /end MEASUREMENT
/begin MEASUREMENT FrmMng_stExc_ASC4_mp "" UWORD OneToOne 1 100 0.00 65535.00 FORMAT "%8.2" ECU_ADDRESS 0x8FF066 /end MEASUREMENT
/begin MEASUREMENT FrmMng_stExc_BOS_RESET_2_mp "" UWORD OneToOne 1 100 0.00 65535.00 FORMAT "%8.2" ECU_ADDRESS 0x8FF206 /end MEASUREMENT
/begin MEASUREMENT FrmMng_stExc_BOS_RESET_mp "exceptionstate BOS_RESET" UWORD OneToOne 1 100 0.00 65535.00 FORMAT "%8.2" ECU_ADDRESS 0x8FF208 /end MEASUREMENT
/begin MEASUREMENT FrmMng_stExc_DM_ANF_ACC_mp "Exception state von CAN Botschaft (error & freeze)" UWORD OneToOne 1 100 0.00 65535.00 FORMAT "%8.2" ECU_ADDRESS 0x8FF20A /end MEASUREMENT
/begin MEASUREMENT FrmMng_stExc_DM_ANF_AFS_mp "Exception state von CAN Botschaft (error & freeze)" UWORD OneToOne 1 100 0.00 65535.00 FORMAT "%8.2" ECU_ADDRESS 0x8FF20C /end MEASUREMENT
/begin MEASUREMENT FrmMng_stExc_DRMANFSSG_mp "exceptionstate DRMANFSSG" UWORD OneToOne 1 100 0.00 65535.00 FORMAT "%8.2" ECU_ADDRESS 0x8FF20E /end MEASUREMENT
/begin MEASUREMENT FrmMng_stExc_EGS1_mp "Exceptionstate von CAN-Botschaft ( errors, freeze, ... )" UWORD OneToOne 1 100 0.00 65535.00 FORMAT "%8.2" ECU_ADDRESS 0x8FF068 /end MEASUREMENT
/begin MEASUREMENT FrmMng_stExc_EGS2_mp "Exceptionstate von CAN-Botschaft (errors, freeze, ...)" UWORD OneToOne 1 100 0.00 65535.00 FORMAT "%8.2" ECU_ADDRESS 0x8FF06A /end MEASUREMENT
/begin MEASUREMENT FrmMng_stExc_GEARBX_DATA2_mp "exceptionstate GEARBX_DATA2" UWORD OneToOne 1 100 0.00 65535.00 FORMAT "%8.2" ECU_ADDRESS 0x8FF210 /end MEASUREMENT
/begin MEASUREMENT FrmMng_stExc_GEARBX_DATA_mp "exceptionstate of CAN-message ( errors, freeze, ... )" UWORD OneToOne 1 100 0.00 65535.00 FORMAT "%8.2" ECU_ADDRESS 0x8FF212 /end MEASUREMENT
/begin MEASUREMENT FrmMng_stExc_HEAT_AC_mp "exceptionstate of CAN-message ( errors, freeze, ... )" UWORD OneToOne 1 100 0.00 65535.00 FORMAT "%8.2" ECU_ADDRESS 0x8FF214 /end MEASUREMENT
/begin MEASUREMENT FrmMng_stExc_INSTR2_mp "Exception-State INSTR2" UWORD OneToOne 1 100 0.00 65535.00 FORMAT "%8.2" ECU_ADDRESS 0x8FF06C /end MEASUREMENT
/begin MEASUREMENT FrmMng_stExc_INSTR3_mp "Exception-State INSTR3" UWORD OneToOne 1 100 0.00 65535.00 FORMAT "%8.2" ECU_ADDRESS 0x8FF06E /end MEASUREMENT
/begin MEASUREMENT FrmMng_stExc_LRADWINK_mp "exceptionstate LENKRADWINKEL" UWORD OneToOne 1 100 0.00 65535.00 FORMAT "%8.2" ECU_ADDRESS 0x8FF216 /end MEASUREMENT
/begin MEASUREMENT FrmMng_stExc_MILEAGE_RANGE_mp "exceptionstate MILEAGE_RANGE" UWORD OneToOne 1 100 0.00 65535.00 FORMAT "%8.2" ECU_ADDRESS 0x8FF218 /end MEASUREMENT
/begin MEASUREMENT FrmMng_stExc_OPCRCTLACC_mp "exceptionstate OP_CRCTLACC" UWORD OneToOne 1 100 0.00 65535.00 FORMAT "%8.2" ECU_ADDRESS 0x8FF21A /end MEASUREMENT
/begin MEASUREMENT FrmMng_stExc_ParkConsumer_mp "exceptionstate ParkConsumer" UWORD OneToOne 1 100 0.00 65535.00 FORMAT "%8.2" ECU_ADDRESS 0x8FF21C /end MEASUREMENT
/begin MEASUREMENT FrmMng_stExc_PRGG_CCTR_mp "exceptionstate PRGG_CCTR" UWORD OneToOne 1 100 0.00 65535.00 FORMAT "%8.2" ECU_ADDRESS 0x8FF21E /end MEASUREMENT
/begin MEASUREMENT FrmMng_stExc_PWRMNG_LOADV_mp "" UWORD OneToOne 1 100 0.00 65535.00 FORMAT "%8.2" ECU_ADDRESS 0x8FF220 /end MEASUREMENT
/begin MEASUREMENT FrmMng_stExc_RQ_STG_EFAN_mp "Exception state von CAN Botschaft (error & freeze)" UWORD OneToOne 1 100 0.00 65535.00 FORMAT "%8.2" ECU_ADDRESS 0x8FF222 /end MEASUREMENT
/begin MEASUREMENT FrmMng_stExc_SERVICE_mp "exceptionstate SERVICE" UWORD OneToOne 1 100 0.00 65535.00 FORMAT "%8.2" ECU_ADDRESS 0x8FF224 /end MEASUREMENT
/begin MEASUREMENT FrmMng_stExc_SITZGURT_mp "Exception State für STAT_SITZBELEGUNG_GURT" UWORD OneToOne 1 100 0.00 65535.00 FORMAT "%8.2" ECU_ADDRESS 0x8FF226 /end MEASUREMENT
/begin MEASUREMENT FrmMng_stExc_STAT_ANH_mp "" UWORD OneToOne 1 100 0.00 65535.00 FORMAT "%8.2" ECU_ADDRESS 0x8FF228 /end MEASUREMENT
/begin MEASUREMENT FrmMng_stExc_STAT_ARS_mp "exceptionstate of CAN-message ( errors, freeze, ... )" UWORD OneToOne 1 100 0.00 65535.00 FORMAT "%8.2" ECU_ADDRESS 0x8FF22A /end MEASUREMENT
/begin MEASUREMENT FrmMng_stExc_STAT_DSC_mp "exceptionstate of CAN-message ( errors, freeze, ... )" UWORD OneToOne 1 100 0.00 65535.00 FORMAT "%8.2" ECU_ADDRESS 0x8FF22C /end MEASUREMENT
/begin MEASUREMENT FrmMng_stExc_STAT_EKP_mp "exceptionstate STAT_EKP" UWORD OneToOne 1 100 0.00 65535.00 FORMAT "%8.2" ECU_ADDRESS 0x8FF22E /end MEASUREMENT
/begin MEASUREMENT FrmMng_stExc_STAT_KOMBI_mp "exceptionstate STAT_KOMB" UWORD OneToOne 1 100 0.00 65535.00 FORMAT "%8.2" ECU_ADDRESS 0x8FF230 /end MEASUREMENT
/begin MEASUREMENT FrmMng_stExc_stCurr_mp "Exception Status von CODIERUNG_PM message" UWORD OneToOne 1 100 0.00 65535.00 FORMAT "%8.2" ECU_ADDRESS 0x8FF232 /end MEASUREMENT
/begin MEASUREMENT FrmMng_stExc_swtPSPOff_mp "Exception Status von CTR_CRASH_SWO_EKP message" UWORD OneToOne 1 100 0.00 65535.00 FORMAT "%8.2" ECU_ADDRESS 0x8FF234 /end MEASUREMENT
/begin MEASUREMENT FrmMng_stExc_TEMPRELTIME_mp "exceptionstate TEMPRELTIME" UWORD OneToOne 1 100 0.00 65535.00 FORMAT "%8.2" ECU_ADDRESS 0x8FF236 /end MEASUREMENT
/begin MEASUREMENT FrmMng_stExc_TERMINAL_mp "exceptionstate of CAN-message ( errors, freeze, ... )" UWORD OneToOne 1 100 0.00 65535.00 FORMAT "%8.2" ECU_ADDRESS 0x8FF238 /end MEASUREMENT
/begin MEASUREMENT FrmMng_stExc_TIME_DATE_mp "" UWORD OneToOne 1 100 0.00 65535.00 FORMAT "%8.2" ECU_ADDRESS 0x8FF23A /end MEASUREMENT
/begin MEASUREMENT FrmMng_stExc_TORQUE_DSC_mp "exceptionstate of CAN-message ( errors, freeze, ... )" UWORD OneToOne 1 100 0.00 65535.00 FORMAT "%8.2" ECU_ADDRESS 0x8FF23C /end MEASUREMENT
/begin MEASUREMENT FrmMng_stExc_TORQUE_GEARBX_mp "exceptionstate of CAN-message ( errors, freeze, ... )" UWORD OneToOne 1 100 0.00 65535.00 FORMAT "%8.2" ECU_ADDRESS 0x8FF23E /end MEASUREMENT
/begin MEASUREMENT FrmMng_stExc_VEH_MOD_mp "exception state for  VEH_MOD" UWORD OneToOne 1 100 0.00 65535.00 FORMAT "%8.2" ECU_ADDRESS 0x8FF240 /end MEASUREMENT
/begin MEASUREMENT FrmMng_stExc_VELOCITY_mp "exceptionstate of CAN-message ( errors, freeze, ... )" UWORD OneToOne 1 100 0.00 65535.00 FORMAT "%8.2" ECU_ADDRESS 0x8FF242 /end MEASUREMENT
/begin MEASUREMENT FrmMng_stExc_WHEEL_SPEED_mp "exceptionstate WHEEL_SPEED" UWORD OneToOne 1 100 0.00 65535.00 FORMAT "%8.2" ECU_ADDRESS 0x8FF244 /end MEASUREMENT
/begin MEASUREMENT FrmMng_stFDC "status of VEH_MOD" UBYTE OneToOne 1 100 0.00 255.0 FORMAT "%5.1" ECU_ADDRESS 0x7F88B7 /end MEASUREMENT
/begin MEASUREMENT FrmMng_stFDC_mp "Measuring point for state of vehicle mode" UBYTE OneToOne 1 100 0.00 255.0 FORMAT "%5.1" ECU_ADDRESS 0x8FF246 /end MEASUREMENT
/begin MEASUREMENT FrmMng_stGbx "Getriebezustand (Schaltung aktiv/inaktiv) über CAN" UBYTE OneToOne 1 100 0.00 255.0 FORMAT "%5.1" ECU_ADDRESS 0x7F88B8 /end MEASUREMENT
/begin MEASUREMENT FrmMng_stGear "Istganginformation vom CAN" UBYTE OneToOne 1 100 0.00 255.0 FORMAT "%5.1" ECU_ADDRESS 0x7F88B9 /end MEASUREMENT
/begin MEASUREMENT FrmMng_stGearbxHtgUpAct_mp "measuring point for evluating ST_SW_WAUP signal" UBYTE OneToOne 1 100 0.00 255.0 FORMAT "%5.1" ECU_ADDRESS 0x8FF247 /end MEASUREMENT
/begin MEASUREMENT FrmMng_stGearbxquit_mp "Bestaetigung EGS-Momenteneingriff" UBYTE OneToOne 1 100 0.00 255.0 FORMAT "%5.1" ECU_ADDRESS 0x8FF248 /end MEASUREMENT
/begin MEASUREMENT FrmMng_stGEARBX_DATA2Sig "signalerrorstatus-message GEARBX_DATA2" UWORD OneToOne 1 100 0.00 65535.00 FORMAT "%8.2" ECU_ADDRESS 0x7F8D0C /end MEASUREMENT
/begin MEASUREMENT FrmMng_stGEARBX_DATASig "state of single signals in CAN-message" UWORD OneToOne 1 100 0.00 65535.00 FORMAT "%8.2" ECU_ADDRESS 0x7F8D0E /end MEASUREMENT
/begin MEASUREMENT FrmMng_stHEAT_ACSig "state of single signals in CAN-message" UWORD OneToOne 1 100 0.00 65535.00 FORMAT "%8.2" ECU_ADDRESS 0x7F8D10 /end MEASUREMENT
/begin MEASUREMENT FrmMng_stHtgUp_mp "status for heating up" UBYTE OneToOne 1 100 0.00 255.0 FORMAT "%5.1" ECU_ADDRESS 0x8FF249 /end MEASUREMENT
/begin MEASUREMENT FrmMng_stId2BosRst "" UBYTE OneToOne 1 100 0.00 255.0 FORMAT "%5.1" ECU_ADDRESS 0x7F88BC /end MEASUREMENT
/begin MEASUREMENT FrmMng_stId2RqStgEFan "dienstenachricht um die Anforderung einer elektrolüfterstufe handelt" UBYTE OneToOne 1 100 0.00 255.0 FORMAT "%5.1" ECU_ADDRESS 0x7F88BD /end MEASUREMENT
/begin MEASUREMENT FrmMng_stID2_BOS_RSTG "unit BOS_RESET" UBYTE OneToOne 1 100 0.00 255.0 FORMAT "%5.1" ECU_ADDRESS 0x7F88BB /end MEASUREMENT
/begin MEASUREMENT FrmMng_stIdFktBosRst "" UWORD OneToOne 1 100 0.00 65535.00 FORMAT "%8.2" ECU_ADDRESS 0x7F8D16 /end MEASUREMENT
/begin MEASUREMENT FrmMng_stIdFnRqStgEFan "Das signal gibt den Anforderer der gewünschten Elektrolüfterstufe an" UBYTE OneToOne 1 100 0.00 255.0 FORMAT "%5.1" ECU_ADDRESS 0x7F88BE /end MEASUREMENT
/begin MEASUREMENT FrmMng_stIdlingSpec "increase idling speed" UBYTE OneToOne 1 100 0.00 255.0 FORMAT "%5.1" ECU_ADDRESS 0x7F88BF /end MEASUREMENT
/begin MEASUREMENT FrmMng_stID_FN_BOS_RSTG "unit for witch part is removed" UWORD OneToOne 1 100 0.00 65535.00 FORMAT "%8.2" ECU_ADDRESS 0x7F8D14 /end MEASUREMENT
/begin MEASUREMENT FrmMng_stInjDu "Status of Drehungleichförmigkeit" UBYTE OneToOne 1 100 0.00 255.0 FORMAT "%5.1" ECU_ADDRESS 0x7F88C0 /end MEASUREMENT
/begin MEASUREMENT FrmMng_stINSTR2Sig_mp "Signalerrorstatus INSTR2" UWORD OneToOne 1 100 0.00 65535.00 FORMAT "%8.2" ECU_ADDRESS 0x8FF070 /end MEASUREMENT
/begin MEASUREMENT FrmMng_stINSTR3Sig_mp "Signalerrorstatus INSTR3" UWORD OneToOne 1 100 0.00 65535.00 FORMAT "%8.2" ECU_ADDRESS 0x8FF072 /end MEASUREMENT
/begin MEASUREMENT FrmMng_stKeyVld "Status Schlüssel gültig" UBYTE OneToOne 1 100 0.00 255.0 FORMAT "%5.1" ECU_ADDRESS 0x7F88C1 /end MEASUREMENT
/begin MEASUREMENT FrmMng_stLENKRADWINKELSig "signal error status for LENKRADWINKEL" UWORD OneToOne 1 100 0.00 65535.00 FORMAT "%8.2" ECU_ADDRESS 0x7F8D18 /end MEASUREMENT
/begin MEASUREMENT FrmMng_stLIGov_mp "Status Low idle speed" UBYTE OneToOne 1 100 0.00 255.0 FORMAT "%5.1" ECU_ADDRESS 0x8FF24A /end MEASUREMENT
/begin MEASUREMENT FrmMng_stMILEAGE_RANGESig "signalerrorstatus-message MILEAGE_RANGE" UWORD OneToOne 1 100 0.00 65535.00 FORMAT "%8.2" ECU_ADDRESS 0x7F8D1A /end MEASUREMENT
/begin MEASUREMENT FrmMng_stnErr_mp "Motordrehzahl-Fehler" UBYTE OneToOne 1 100 0.00 255.0 FORMAT "%5.1" ECU_ADDRESS 0x8FF24B /end MEASUREMENT
/begin MEASUREMENT FrmMng_stOBDGbx_mp "Measuring point for Gear Box status" UBYTE OneToOne 1 100 0.00 255.0 FORMAT "%5.1" ECU_ADDRESS 0x8FF24C /end MEASUREMENT
/begin MEASUREMENT FrmMng_stOldstStart "vorheriger Start-Status" UBYTE OneToOne 1 100 0.00 255.0 FORMAT "%5.1" ECU_ADDRESS 0x7F88C3 /end MEASUREMENT
/begin MEASUREMENT FrmMng_stOPCRCTLACCSig "signalerrorstatus-message OP_CRCTLACC" UWORD OneToOne 1 100 0.00 65535.00 FORMAT "%8.2" ECU_ADDRESS 0x7F8D1C /end MEASUREMENT
/begin MEASUREMENT FrmMng_stOpPubuCctrAcc_mp "state operation push-button cruise-control ACC" UBYTE OneToOne 1 100 0.00 255.0 FORMAT "%5.1" ECU_ADDRESS 0x8FF24D /end MEASUREMENT
/begin MEASUREMENT FrmMng_stOvrRun_mp "Status over-run-fuel-shutoff ST_INFS" UBYTE OneToOne 1 100 0.00 255.0 FORMAT "%5.1" ECU_ADDRESS 0x8FF24E /end MEASUREMENT
/begin MEASUREMENT FrmMng_stParkConsumer "status park consumer power managment" UBYTE OneToOne 1 100 0.00 255.0 FORMAT "%5.1" ECU_ADDRESS 0x7F88C7 /end MEASUREMENT
/begin MEASUREMENT FrmMng_stParkConsumerSig "signalerrorstatus-message Park Consumer" UWORD OneToOne 1 100 0.00 65535.00 FORMAT "%8.2" ECU_ADDRESS 0x7F8D22 /end MEASUREMENT
/begin MEASUREMENT FrmMng_stPHtr "status of Heater Temperature" UBYTE OneToOne 1 100 0.00 255.0 FORMAT "%5.1" ECU_ADDRESS 0x7F88C4 /end MEASUREMENT
/begin MEASUREMENT FrmMng_stpmsv_mp "status pmsv" UBYTE OneToOne 1 100 0.00 255.0 FORMAT "%5.1" ECU_ADDRESS 0x8FF24F /end MEASUREMENT
/begin MEASUREMENT FrmMng_stpmsv_old_mp "status pmsv" UBYTE OneToOne 1 100 0.00 255.0 FORMAT "%5.1" ECU_ADDRESS 0x8FF250 /end MEASUREMENT
/begin MEASUREMENT FrmMng_stPRGG_CCTRSig "signalerrorstatus-message PRGG_CCTR" UWORD OneToOne 1 100 0.00 65535.00 FORMAT "%8.2" ECU_ADDRESS 0x7F8D1E /end MEASUREMENT
/begin MEASUREMENT FrmMng_stPrgIntTimeBosRst "" UBYTE OneToOne 1 100 0.00 255.0 FORMAT "%5.1" ECU_ADDRESS 0x7F88C8 /end MEASUREMENT
/begin MEASUREMENT FrmMng_stPrgIntWayBosRst "" UBYTE OneToOne 1 100 0.00 255.0 FORMAT "%5.1" ECU_ADDRESS 0x7F88C9 /end MEASUREMENT
/begin MEASUREMENT FrmMng_stPSP "status der Diagnose der geregelten elektronischen Kraftstoffpumpe" UBYTE OneToOne 1 100 0.00 255.0 FORMAT "%5.1" ECU_ADDRESS 0x7F88C5 /end MEASUREMENT
/begin MEASUREMENT FrmMng_stPWRMNG_LOADVSig "signalerrorstatus-message PWRMNG_LOADV" UWORD OneToOne 1 100 0.00 65535.00 FORMAT "%8.2" ECU_ADDRESS 0x7F8D20 /end MEASUREMENT
/begin MEASUREMENT FrmMng_stRecACC "Status ACC Reconigtion" UBYTE OneToOne 1 100 0.00 255.0 FORMAT "%5.1" ECU_ADDRESS 0x7F88CA /end MEASUREMENT
/begin MEASUREMENT FrmMng_stRecAFS "message on CAN used for self recognition of AFS" UBYTE OneToOne 1 100 0.00 255.0 FORMAT "%5.1" ECU_ADDRESS 0x7F88CB /end MEASUREMENT
/begin MEASUREMENT FrmMng_stRecARS "Status of ARS Recognition received over CAN" UBYTE OneToOne 1 100 0.00 255.0 FORMAT "%5.1" ECU_ADDRESS 0x7F88CC /end MEASUREMENT
/begin MEASUREMENT FrmMng_stRecDCC "Status Erkennung Empfang Radmomentanforderung-Botschaft" UBYTE OneToOne 1 100 0.00 255.0 FORMAT "%5.1" ECU_ADDRESS 0x7F88CD /end MEASUREMENT
/begin MEASUREMENT FrmMng_stRecFDC "automatische Erkennung des CAN-Frame VEH_MOD" UBYTE OneToOne 1 100 0.00 255.0 FORMAT "%5.1" ECU_ADDRESS 0x7F88CE /end MEASUREMENT
/begin MEASUREMENT FrmMng_stRecFGR "Status FGR Reconigtion" UBYTE OneToOne 1 100 0.00 255.0 FORMAT "%5.1" ECU_ADDRESS 0x7F88CF /end MEASUREMENT
/begin MEASUREMENT FrmMng_stRMMI_BOS_RSTG "" SWORD OneToOne 1 100 -32768.00 32767.00 FORMAT "%8.2" ECU_ADDRESS 0x7F8D26 /end MEASUREMENT
/begin MEASUREMENT FrmMng_stRmp_mp "current ramp state overrun shutoff" UBYTE OneToOne 1 100 0.00 255.0 FORMAT "%5.1" ECU_ADDRESS 0x8FF251 /end MEASUREMENT
/begin MEASUREMENT FrmMng_stRQ_STG_EFANSig "signalerrorstatus-message RQ_STG_EFAN" UWORD OneToOne 1 100 0.00 65535.00 FORMAT "%8.2" ECU_ADDRESS 0x7F8D28 /end MEASUREMENT
/begin MEASUREMENT FrmMng_stShpsSSG "Status of SSG selection" UBYTE OneToOne 1 100 0.00 255.0 FORMAT "%5.1" ECU_ADDRESS 0x7F88D2 /end MEASUREMENT
/begin MEASUREMENT FrmMng_stShpsSSGOld "Last value of Status of SSG selection" UBYTE OneToOne 1 100 0.00 255.0 FORMAT "%5.1" ECU_ADDRESS 0x7F88D3 /end MEASUREMENT
/begin MEASUREMENT FrmMng_stShutOffHtgUp_mp "Status der Heizung abgestellt" UBYTE OneToOne 1 100 0.00 255.0 FORMAT "%5.1" ECU_ADDRESS 0x8FF252 /end MEASUREMENT
/begin MEASUREMENT FrmMng_stShutOffSSG "Demand for engine stop in case of error" UBYTE OneToOne 1 100 0.00 255.0 FORMAT "%5.1" ECU_ADDRESS 0x7F88D4 /end MEASUREMENT
/begin MEASUREMENT FrmMng_stSITZGURTSig "Signalstatus der STAT_SITZBELEGUNG_GURT-Botschaft" UWORD OneToOne 1 100 0.00 65535.00 FORMAT "%8.2" ECU_ADDRESS 0x7F8D2A /end MEASUREMENT
/begin MEASUREMENT FrmMng_stSLckAdjVal_mp "Adjustment value for status of steering lock" UBYTE OneToOne 1 100 0.00 255.0 FORMAT "%5.1" ECU_ADDRESS 0x8FF253 /end MEASUREMENT
/begin MEASUREMENT FrmMng_stSLck_mp "Status of steering lock" UBYTE OneToOne 1 100 0.00 255.0 FORMAT "%5.1" ECU_ADDRESS 0x8FF254 /end MEASUREMENT
/begin MEASUREMENT FrmMng_stSTAT_ANHSig "" UWORD OneToOne 1 100 0.00 65535.00 FORMAT "%8.2" ECU_ADDRESS 0x7F8D2C /end MEASUREMENT
/begin MEASUREMENT FrmMng_stSTAT_ARSSig "state of single signals in CAN-message" UWORD OneToOne 1 100 0.00 65535.00 FORMAT "%8.2" ECU_ADDRESS 0x7F8D2E /end MEASUREMENT
/begin MEASUREMENT FrmMng_stSTAT_DSCSig "state of single signals in CAN-message" UWORD OneToOne 1 100 0.00 65535.00 FORMAT "%8.2" ECU_ADDRESS 0x7F8D30 /end MEASUREMENT
/begin MEASUREMENT FrmMng_stSTAT_EKPSig "signalerrorstatus-message STAT_EKP" UWORD OneToOne 1 100 0.00 65535.00 FORMAT "%8.2" ECU_ADDRESS 0x7F8D32 /end MEASUREMENT
/begin MEASUREMENT FrmMng_stSTAT_HDC "Zustand CAN-Botschaft S_HDC" UBYTE OneToOne 1 100 0.00 255.0 FORMAT "%5.1" ECU_ADDRESS 0x7F88D0 /end MEASUREMENT
/begin MEASUREMENT FrmMng_stSTAT_KOMBISig "signalerrorstatus-message STAT_KOMBI" UWORD OneToOne 1 100 0.00 65535.00 FORMAT "%8.2" ECU_ADDRESS 0x7F8D34 /end MEASUREMENT
/begin MEASUREMENT FrmMng_stStiffParameter "Ansprechdynamik Radmoment Antriebsstrang" UBYTE OneToOne 1 100 0.00 255.0 FORMAT "%5.1" ECU_ADDRESS 0x7F88D5 /end MEASUREMENT
/begin MEASUREMENT FrmMng_stSwClt_mp "status of clutch" UBYTE OneToOne 1 100 0.00 255.0 FORMAT "%5.1" ECU_ADDRESS 0x8FF255 /end MEASUREMENT
/begin MEASUREMENT FrmMng_stSwLevRpm_mp "Status switch level RPM ST_SW_LEV_RPM" UBYTE OneToOne 1 100 0.00 255.0 FORMAT "%5.1" ECU_ADDRESS 0x8FF256 /end MEASUREMENT
/begin MEASUREMENT FrmMng_stT15 "Zustand der Klemme 15 über CAN" UBYTE OneToOne 1 100 0.00 255.0 FORMAT "%5.1" ECU_ADDRESS 0x7F88D6 /end MEASUREMENT
/begin MEASUREMENT FrmMng_stT50 "Zustand Klemme 50 vom CAN" UBYTE OneToOne 1 100 0.00 255.0 FORMAT "%5.1" ECU_ADDRESS 0x7F88D7 /end MEASUREMENT
/begin MEASUREMENT FrmMng_stTCSActive_mp "CAN-Signal B_ASC, ASC Eingriff aktiv" UBYTE OneToOne 1 100 0.00 255.0 FORMAT "%5.1" ECU_ADDRESS 0x8FF074 /end MEASUREMENT
/begin MEASUREMENT FrmMng_stTCSCtrl_mp "ASC Eingriff" UBYTE OneToOne 1 100 0.00 255.0 FORMAT "%5.1" ECU_ADDRESS 0x8FF075 /end MEASUREMENT
/begin MEASUREMENT FrmMng_stTEMPRELTIMESig "signalerrorstatus-message TEMPRELTIME" UWORD OneToOne 1 100 0.00 65535.00 FORMAT "%8.2" ECU_ADDRESS 0x7F8D36 /end MEASUREMENT
/begin MEASUREMENT FrmMng_stTERMINALSig "state of single signals in CAN-message" UWORD OneToOne 1 100 0.00 65535.00 FORMAT "%8.2" ECU_ADDRESS 0x7F8D38 /end MEASUREMENT
/begin MEASUREMENT FrmMng_stTgMonthBosRst "" UBYTE OneToOne 1 100 0.00 255.0 FORMAT "%5.1" ECU_ADDRESS 0x7F88DA /end MEASUREMENT
/begin MEASUREMENT FrmMng_stTgYearBosRst "" UBYTE OneToOne 1 100 0.00 255.0 FORMAT "%5.1" ECU_ADDRESS 0x7F88DB /end MEASUREMENT
/begin MEASUREMENT FrmMng_stTIME_DATESig "" UWORD OneToOne 1 100 0.00 65535.00 FORMAT "%8.2" ECU_ADDRESS 0x7F8D3A /end MEASUREMENT
/begin MEASUREMENT FrmMng_stTorqTarAFS "status of required torque from AFS" UBYTE OneToOne 1 100 0.00 255.0 FORMAT "%5.1" ECU_ADDRESS 0x7F88DC /end MEASUREMENT
/begin MEASUREMENT FrmMng_stTORQUE_DSCSig "state of single signals in CAN-message" UWORD OneToOne 1 100 0.00 65535.00 FORMAT "%8.2" ECU_ADDRESS 0x7F8D3C /end MEASUREMENT
/begin MEASUREMENT FrmMng_stTORQUE_GEARBXSig "state of single signals in CAN-message" UWORD OneToOne 1 100 0.00 65535.00 FORMAT "%8.2" ECU_ADDRESS 0x7F8D3E /end MEASUREMENT
/begin MEASUREMENT FrmMng_stTRadio "state TRadio" UBYTE OneToOne 1 100 0.00 255.0 FORMAT "%5.1" ECU_ADDRESS 0x7F88D9 /end MEASUREMENT
/begin MEASUREMENT FrmMng_stTrailer "Anhänger Status" UBYTE OneToOne 1 100 0.00 255.0 FORMAT "%5.1" ECU_ADDRESS 0x7F88DD /end MEASUREMENT
/begin MEASUREMENT FrmMng_stTrqDCSOk_mp "Status Freigabe MSR Eingriff" UBYTE OneToOne 1 100 0.00 255.0 FORMAT "%5.1" ECU_ADDRESS 0x8FF076 /end MEASUREMENT
/begin MEASUREMENT FrmMng_stTrqDesDSC "type of DSC torque-intervention" UBYTE OneToOne 1 100 0.00 255.0 FORMAT "%5.1" ECU_ADDRESS 0x7F88DE /end MEASUREMENT
/begin MEASUREMENT FrmMng_stTrqDesGearbx "type of gearbox torque-intervention" UBYTE OneToOne 1 100 0.00 255.0 FORMAT "%5.1" ECU_ADDRESS 0x7F88DF /end MEASUREMENT
/begin MEASUREMENT FrmMng_stTrqDisable_mp "state overrun shut off" SBYTE OneToOne 1 100 -128.0 127.0 FORMAT "%5.1" ECU_ADDRESS 0x8FF257 /end MEASUREMENT
/begin MEASUREMENT FrmMng_stTrqInr_mp "Status Drehmoment aktueller Wert" UBYTE OneToOne 1 100 0.00 255.0 FORMAT "%5.1" ECU_ADDRESS 0x8FF258 /end MEASUREMENT
/begin MEASUREMENT FrmMng_stTrqLimGearbx "state of torquelimitation for acceleration from standstill" UBYTE OneToOne 1 100 0.00 255.0 FORMAT "%5.1" ECU_ADDRESS 0x7F88E1 /end MEASUREMENT
/begin MEASUREMENT FrmMng_stTrqTCSOk_mp "Status Freigabe ASC Eingriff" UBYTE OneToOne 1 100 0.00 255.0 FORMAT "%5.1" ECU_ADDRESS 0x8FF077 /end MEASUREMENT
/begin MEASUREMENT FrmMng_stTSCDec "Status der reduzierenden Getriebeeingriffsanforderung vom Getriebesteuergerät (EGS)" UWORD OneToOne 1 100 0.00 65535.00 FORMAT "%8.2" ECU_ADDRESS 0x7F8D40 /end MEASUREMENT
/begin MEASUREMENT FrmMng_stTSCInc "Status der erhöhenden Getriebeeingriffsanforderung vom Getriebesteuergerät (EGS)" UWORD OneToOne 1 100 0.00 65535.00 FORMAT "%8.2" ECU_ADDRESS 0x7F8D42 /end MEASUREMENT
/begin MEASUREMENT FrmMng_stTxRequest "" UWORD OneToOne 1 100 0.00 65535.00 FORMAT "%8.2" ECU_ADDRESS 0x7F8D44 /end MEASUREMENT
/begin MEASUREMENT FrmMng_stUnitV "Einheit der angez. Geschwindigkeit" UBYTE OneToOne 1 100 0.00 255.0 FORMAT "%5.1" ECU_ADDRESS 0x7F88E2 /end MEASUREMENT
/begin MEASUREMENT FrmMng_stVCom "status der geschwindigkeitsanzeige combi" UBYTE OneToOne 1 100 0.00 255.0 FORMAT "%5.1" ECU_ADDRESS 0x7F88E3 /end MEASUREMENT
/begin MEASUREMENT FrmMng_stVEH_MODSig "signalerrorstatus-message VEH_MOD" UWORD OneToOne 1 100 0.00 65535.00 FORMAT "%8.2" ECU_ADDRESS 0x7F8D46 /end MEASUREMENT
/begin MEASUREMENT FrmMng_stVELOCITYSig "state of single signals in CAN-message" UWORD OneToOne 1 100 0.00 65535.00 FORMAT "%8.2" ECU_ADDRESS 0x7F8D48 /end MEASUREMENT
/begin MEASUREMENT FrmMng_stWghSeatDr "Klasse Gewicht Sitz Fahrer" UBYTE OneToOne 1 100 0.00 255.0 FORMAT "%5.1" ECU_ADDRESS 0x7F88E4 /end MEASUREMENT
/begin MEASUREMENT FrmMng_stWHEEL_SPEEDSig_mp "Signalfehler der Can Botschaft Wheel Speed" UWORD OneToOne 1 100 0.00 65535.00 FORMAT "%8.2" ECU_ADDRESS 0x8FF25A /end MEASUREMENT
/begin MEASUREMENT FrmMng_swtAC_mp "Schalter Klimakompressor" UBYTE OneToOne 1 100 0.00 255.0 FORMAT "%5.1" ECU_ADDRESS 0x6F8164 /end MEASUREMENT
/begin MEASUREMENT FrmMng_swtCarType "" UBYTE CarType 1 100 0.00 4.00000000000 FORMAT "%13.11" ECU_ADDRESS 0x7F88E5 /end MEASUREMENT
/begin MEASUREMENT FrmMng_swtPSPOff "Botschaft für CTR_CRASH_SWO_EKP CAN signal" UBYTE OneToOne 1 100 0.00 255.0 FORMAT "%5.1" ECU_ADDRESS 0x7F88E6 /end MEASUREMENT
/begin MEASUREMENT FrmMng_swtPSPOffSig_mp "Botschaftsstatus für CTR_CRASH_SWO_EKP Botschaft" UWORD OneToOne 1 100 0.00 65535.00 FORMAT "%8.2" ECU_ADDRESS 0x8FF25C /end MEASUREMENT
/begin MEASUREMENT FrmMng_swtPSPOff_byte0_mp "Rohwert von CTR_CRASH_SWO_EKP signal" UBYTE OneToOne 1 100 0.00 255.0 FORMAT "%5.1" ECU_ADDRESS 0x8FF25E /end MEASUREMENT
/begin MEASUREMENT FrmMng_tEngRpm_mp "temperature adjusted to a resolution of  approx. 1 deg C  for engine rpm calculation" SWORD Temp_Cels 1 100 -50.140 899.860 FORMAT "%8.3" ECU_ADDRESS 0x8FF260 /end MEASUREMENT
/begin MEASUREMENT FrmMng_tEnv "Umgebungstemperatur" SWORD Temp_Cels 1 100 -50.140 899.860 FORMAT "%8.3" ECU_ADDRESS 0x7F8D50 /end MEASUREMENT
/begin MEASUREMENT FrmMng_tiDayCouAbsl "day counter" UWORD OneToOne 1 100 0.00 65535.00 FORMAT "%8.2" ECU_ADDRESS 0x7F8D54 /end MEASUREMENT
/begin MEASUREMENT FrmMng_tiRecACC_mp "Time elapsed for the self recognition of ACC" UWORD Time_ms 1 100 0.00 655350.0 FORMAT "%8.1" ECU_ADDRESS 0x8FF262 /end MEASUREMENT
/begin MEASUREMENT FrmMng_tiRecAC_mp "" UWORD Time_ms 1 100 0.00 655350.0 FORMAT "%8.1" ECU_ADDRESS 0x8FF264 /end MEASUREMENT
/begin MEASUREMENT FrmMng_tiRecAFS_mp "Time elapsed for the self recognition of AFS" UWORD Time_ms 1 100 0.00 655350.0 FORMAT "%8.1" ECU_ADDRESS 0x8FF266 /end MEASUREMENT
/begin MEASUREMENT FrmMng_tiRecARS_mp "Error Counter for ARS recognition" UBYTE Time_ms 1 100 0.00 2550. FORMAT "%5.0" ECU_ADDRESS 0x8FF268 /end MEASUREMENT
/begin MEASUREMENT FrmMng_tiRecDCC_mp "Zeitfenster für Erkennung Empfang Radmomentanforderung-Botschaft" UWORD Time_ms 1 100 0.00 655350.0 FORMAT "%8.1" ECU_ADDRESS 0x8FF26A /end MEASUREMENT
/begin MEASUREMENT FrmMng_tiRecFGR_mp "Time elapsed for the self recognition of FGR" UWORD Time_ms 1 100 0.00 655350.0 FORMAT "%8.1" ECU_ADDRESS 0x8FF26C /end MEASUREMENT
/begin MEASUREMENT FrmMng_tmrDSMFadeoutANFRADMOMPT_mp "" UWORD OneToOne 1 100 0.00 65535.00 FORMAT "%8.2" ECU_ADDRESS 0x8FF26E /end MEASUREMENT
/begin MEASUREMENT FrmMng_tmrDSMFadeoutTERMINAL_mp "Timer for measuring Fadeout of TERMINAL frame" UWORD OneToOne 1 100 0.00 65535.00 FORMAT "%8.2" ECU_ADDRESS 0x8FF270 /end MEASUREMENT
/begin MEASUREMENT FrmMng_tmrDSMToTERMINAL_mp "Timer for measuring Timeout of TERMINAL frame" UWORD OneToOne 1 100 0.00 65535.00 FORMAT "%8.2" ECU_ADDRESS 0x8FF272 /end MEASUREMENT
/begin MEASUREMENT FrmMng_tOil "Öltemperatur" SWORD Temp_Cels 1 100 -50.140 899.860 FORMAT "%8.3" ECU_ADDRESS 0x7F8D52 /end MEASUREMENT
/begin MEASUREMENT FrmMng_torque1RetVal_mp "" UBYTE OneToOne 1 100 0.00 255.0 FORMAT "%5.1" ECU_ADDRESS 0x8FF274 /end MEASUREMENT
/begin MEASUREMENT FrmMng_torque2RetVal_mp "" UBYTE OneToOne 1 100 0.00 255.0 FORMAT "%5.1" ECU_ADDRESS 0x8FF275 /end MEASUREMENT
/begin MEASUREMENT FrmMng_torque3RetVal_mp "" UBYTE OneToOne 1 100 0.00 255.0 FORMAT "%5.1" ECU_ADDRESS 0x8FF276 /end MEASUREMENT
/begin MEASUREMENT FrmMng_trqAC "Aktuelles Klimakompressormoment" SWORD Trq 1 100 -3276.800 3276.700 FORMAT "%8.3" ECU_ADDRESS 0x7F8D56 /end MEASUREMENT
/begin MEASUREMENT FrmMng_trqACC_TrqDes "Torque request-message DREHMOMENT_ANF_ACC" SWORD Trq 1 100 -3276.800 3276.700 FORMAT "%8.3" ECU_ADDRESS 0x7F8D58 /end MEASUREMENT
/begin MEASUREMENT FrmMng_trqACC_TrqDes_mp "Angefordertes ACC-Moment vor Hinzufügung von Gearbx_trqFrc" SWORD Trq 1 100 -3276.800 3276.700 FORMAT "%8.3" ECU_ADDRESS 0x8FF278 /end MEASUREMENT
/begin MEASUREMENT FrmMng_trqARSCur "current torque ARS" SWORD TrqPrp 1 100 -6553.600 6553.400 FORMAT "%8.3" ECU_ADDRESS 0x7F8D5A /end MEASUREMENT
/begin MEASUREMENT FrmMng_trqARSDes "desired torque ARS" SWORD TrqPrp 1 100 -6553.600 6553.400 FORMAT "%8.3" ECU_ADDRESS 0x7F8D5C /end MEASUREMENT
/begin MEASUREMENT FrmMng_trqARSInc "Momentenerhöhender Eingriff, Schaltung" SWORD TrqPrp 1 100 -6553.600 6553.400 FORMAT "%8.3" ECU_ADDRESS 0x7F8D5E /end MEASUREMENT
/begin MEASUREMENT FrmMng_trqAvlAFS "Required torque from AFS" SWORD Trq 1 100 -3276.800 3276.700 FORMAT "%8.3" ECU_ADDRESS 0x7F8D60 /end MEASUREMENT
/begin MEASUREMENT FrmMng_trqBefRmp_mp "current inner set torque before overrun shut off" SWORD Trq 1 100 -3276.800 3276.700 FORMAT "%8.3" ECU_ADDRESS 0x8FF27A /end MEASUREMENT
/begin MEASUREMENT FrmMng_trqDCS "vom MSR gefordertes Getriebeausgangsmoment" SWORD Trq 1 100 -3276.800 3276.700 FORMAT "%8.3" ECU_ADDRESS 0x7F8D62 /end MEASUREMENT
/begin MEASUREMENT FrmMng_trqDCSRaw_mp "MSR Eingriff über CAN, Momentenrohwert" SWORD Trq 1 100 -3276.800 3276.700 FORMAT "%8.3" ECU_ADDRESS 0x8FF078 /end MEASUREMENT
/begin MEASUREMENT FrmMng_trqDesDCC "Radmoment Antriebsstrang Soll" SWORD TrqPrp 1 100 -6553.600 6553.400 FORMAT "%8.3" ECU_ADDRESS 0x7F8D6A /end MEASUREMENT
/begin MEASUREMENT FrmMng_trqDes_mp "Driver request torque for CAN [Nm] <SBYTE>" SWORD Trq 1 100 -3276.800 3276.700 FORMAT "%8.3" ECU_ADDRESS 0x8FF27C /end MEASUREMENT
/begin MEASUREMENT FrmMng_trqDSCDec "verringernder Momenteneingriff, DSC" SWORD Trq 1 100 -3276.800 3276.700 FORMAT "%8.3" ECU_ADDRESS 0x7F8D64 /end MEASUREMENT
/begin MEASUREMENT FrmMng_trqDSCDes "desired torque DSC" SWORD Trq 1 100 -3276.800 3276.700 FORMAT "%8.3" ECU_ADDRESS 0x7F8D66 /end MEASUREMENT
/begin MEASUREMENT FrmMng_trqDSCDes_mp "Drehmoment Soll DSC vor Hinzufügung von Gearbx_trqFrc" SWORD Trq 1 100 -3276.800 3276.700 FORMAT "%8.3" ECU_ADDRESS 0x8FF27E /end MEASUREMENT
/begin MEASUREMENT FrmMng_trqDSCInc "erhöhender Momenteneingriff, DSC" SWORD Trq 1 100 -3276.800 3276.700 FORMAT "%8.3" ECU_ADDRESS 0x7F8D68 /end MEASUREMENT
/begin MEASUREMENT FrmMng_trqFMTCInr_mp "Incremental torque" SWORD Trq 1 100 -3276.800 3276.700 FORMAT "%8.3" ECU_ADDRESS 0x8FF280 /end MEASUREMENT
/begin MEASUREMENT FrmMng_trqFrc "Reibmoment" SWORD Trq 1 100 -3276.800 3276.700 FORMAT "%8.3" ECU_ADDRESS 0x7F8D6C /end MEASUREMENT
/begin MEASUREMENT FrmMng_trqGbx "Torque set value from Gearbox" SWORD Trq 1 100 -3276.800 3276.700 FORMAT "%8.3" ECU_ADDRESS 0x7F8D6E /end MEASUREMENT
/begin MEASUREMENT FrmMng_trqGbx_mp "Engine torque without MMT" SWORD Trq 1 100 -3276.800 3276.700 FORMAT "%8.3" ECU_ADDRESS 0x8FF282 /end MEASUREMENT
/begin MEASUREMENT FrmMng_trqGearbxDec "reduzierender Momenteneingriff des Getriebes aus Can" SWORD Trq 1 100 -3276.800 3276.700 FORMAT "%8.3" ECU_ADDRESS 0x7F8D70 /end MEASUREMENT
/begin MEASUREMENT FrmMng_trqGearbxDes "desired torque by gearbox" SWORD Trq 1 100 -3276.800 3276.700 FORMAT "%8.3" ECU_ADDRESS 0x7F8D72 /end MEASUREMENT
/begin MEASUREMENT FrmMng_trqGearbxDes_mp "Meßpunkt fuer Getriebe-Sollmoment" SWORD Trq 1 100 -3276.800 3276.700 FORMAT "%8.3" ECU_ADDRESS 0x8FF07A /end MEASUREMENT
/begin MEASUREMENT FrmMng_trqGearbxFrc "Momentenaufnahme des Getriebe" SWORD Trq 1 100 -3276.800 3276.700 FORMAT "%8.3" ECU_ADDRESS 0x7F8D74 /end MEASUREMENT
/begin MEASUREMENT FrmMng_trqGearbxInc "erhöhender Momenteneingriff des Getriebes aus CAN" SWORD Trq 1 100 -3276.800 3276.700 FORMAT "%8.3" ECU_ADDRESS 0x7F8D76 /end MEASUREMENT
/begin MEASUREMENT FrmMng_trqGearbxMax "maximum torque Gearbox" SWORD Trq 1 100 -3276.800 3276.700 FORMAT "%8.3" ECU_ADDRESS 0x7F8D78 /end MEASUREMENT
/begin MEASUREMENT FrmMng_trqGearbxMax_mp "maximum Gear Box torque" SWORD Trq 1 100 -3276.800 3276.700 FORMAT "%8.3" ECU_ADDRESS 0x8FF284 /end MEASUREMENT
/begin MEASUREMENT FrmMng_trqGearbxRaw_mp "= FrmMng_trqGearbxDec - EngM_trqFrc" SWORD Trq 1 100 -3276.800 3276.700 FORMAT "%8.3" ECU_ADDRESS 0x8FF07C /end MEASUREMENT
/begin MEASUREMENT FrmMng_trqInr "Increased torque demand though Frame Manager" SWORD Trq 1 100 -3276.800 3276.700 FORMAT "%8.3" ECU_ADDRESS 0x7F8D7A /end MEASUREMENT
/begin MEASUREMENT FrmMng_trqInrGearbxOut_mp "Kurbelwellen-Drehmoment ohne EGS-Engriff" SWORD Trq 1 100 -3276.800 3276.700 FORMAT "%8.3" ECU_ADDRESS 0x8FF286 /end MEASUREMENT
/begin MEASUREMENT FrmMng_trqInrSet_mp "output torque value" SWORD Trq 1 100 -3276.800 3276.700 FORMAT "%8.3" ECU_ADDRESS 0x8FF288 /end MEASUREMENT
/begin MEASUREMENT FrmMng_trqMax_mp "Normiertes und begrenztes maximales Motormoment" SWORD Trq 1 100 -3276.800 3276.700 FORMAT "%8.3" ECU_ADDRESS 0x8FF28A /end MEASUREMENT
/begin MEASUREMENT FrmMng_trqMin_mp "Normiertes und begrenztes minimales Motormoment" SWORD Trq 1 100 -3276.800 3276.700 FORMAT "%8.3" ECU_ADDRESS 0x8FF28C /end MEASUREMENT
/begin MEASUREMENT FrmMng_trqResPos_mp "torque actual-value spare positive" SWORD Trq 1 100 -3276.800 3276.700 FORMAT "%8.3" ECU_ADDRESS 0x8FF28E /end MEASUREMENT
/begin MEASUREMENT FrmMng_trqRmp_mp "current ramp output torque" SWORD Trq 1 100 -3276.800 3276.700 FORMAT "%8.3" ECU_ADDRESS 0x8FF290 /end MEASUREMENT
/begin MEASUREMENT FrmMng_trqSet_mp "Torque setpoint value" SWORD Trq 1 100 -3276.800 3276.700 FORMAT "%8.3" ECU_ADDRESS 0x8FF292 /end MEASUREMENT
/begin MEASUREMENT FrmMng_trqTarAFS "Requested torque from AFS" SWORD Trq 1 100 -3276.800 3276.700 FORMAT "%8.3" ECU_ADDRESS 0x7F8D82 /end MEASUREMENT
/begin MEASUREMENT FrmMng_trqTCS "vom ASR gefordertes Getriebeausgangsmoment" SWORD Trq 1 100 -3276.800 3276.700 FORMAT "%8.3" ECU_ADDRESS 0x7F8D7C /end MEASUREMENT
/begin MEASUREMENT FrmMng_trqTCSRaw_mp "ASC Eingriff über CAN, Momentenrohwert" SWORD Trq 1 100 -3276.800 3276.700 FORMAT "%8.3" ECU_ADDRESS 0x8FF07E /end MEASUREMENT
/begin MEASUREMENT FrmMng_trqTSCDec "Gefordertes reduzierende Kupplungsmoment vom Getriebesteuergerät (EGS)" SWORD Trq 1 100 -3276.800 3276.700 FORMAT "%8.3" ECU_ADDRESS 0x7F8D7E /end MEASUREMENT
/begin MEASUREMENT FrmMng_trqTSCInc "Gefordertes erhöhende Kupplungsmoment vom Getriebesteuergerät (EGS)" SWORD Trq 1 100 -3276.800 3276.700 FORMAT "%8.3" ECU_ADDRESS 0x7F8D80 /end MEASUREMENT
/begin MEASUREMENT FrmMng_trqWheelMax_mp "Radmoment Antriebsstrang Maximal" SWORD TrqPrp 1 100 -6553.600 6553.400 FORMAT "%8.3" ECU_ADDRESS 0x8FF294 /end MEASUREMENT
/begin MEASUREMENT FrmMng_trqWheelMin_mp "Radmoment Antriebsstrang Minimal" SWORD TrqPrp 1 100 -6553.600 6553.400 FORMAT "%8.3" ECU_ADDRESS 0x8FF296 /end MEASUREMENT
/begin MEASUREMENT FrmMng_trqWheelRmp_mp "Aktuelles Radmoment vor Grip Rampenschalter" SWORD TrqPrp 1 100 -6553.600 6553.400 FORMAT "%8.3" ECU_ADDRESS 0x8FF298 /end MEASUREMENT
/begin MEASUREMENT FrmMng_trqWheel_mp "Meßpunkt für Radmoment" SWORD TrqPrp 1 100 -6553.600 6553.400 FORMAT "%8.3" ECU_ADDRESS 0x8FF29A /end MEASUREMENT
/begin MEASUREMENT FrmMng_uAltTarget "target voltage alternator" UWORD UC_Volt 1 100 0.00 6553.500 FORMAT "%8.3" ECU_ADDRESS 0x7F8D84 /end MEASUREMENT
/begin MEASUREMENT FrmMng_v "Fahrzeuggeschwindigkeit über CAN" SWORD Vel 1 100 -327.6800 327.6700 FORMAT "%8.4" ECU_ADDRESS 0x7F8D86 /end MEASUREMENT
/begin MEASUREMENT FrmMng_vDirection "" SWORD Vel 1 100 -327.6800 327.6700 FORMAT "%8.4" ECU_ADDRESS 0x7F8D88 /end MEASUREMENT
/begin MEASUREMENT FrmMng_vDisp "angez. Geschwindigkeit" SWORD Vel 1 100 -327.6800 327.6700 FORMAT "%8.4" ECU_ADDRESS 0x7F8D8A /end MEASUREMENT
/begin MEASUREMENT FrmMng_volFuelFil "Tankfüllstand" UWORD Fl_Half_L 1 100 0.00 3276.750 FORMAT "%8.3" ECU_ADDRESS 0x7F8D9A /end MEASUREMENT
/begin MEASUREMENT FrmMng_vPrgNo1 "velocity No. 0,3,6,9,12" UWORD vfzg_uw_b512 1 100 0.00 511.9922 FORMAT "%8.4" ECU_ADDRESS 0x7F8D8C /end MEASUREMENT
/begin MEASUREMENT FrmMng_vPrgNo2 "velocity No. 1,4,7,10,13" UWORD vfzg_uw_b512 1 100 0.00 511.9922 FORMAT "%8.4" ECU_ADDRESS 0x7F8D8E /end MEASUREMENT
/begin MEASUREMENT FrmMng_vPrgNo3 "velocity No. 2,5,8,11,14" UWORD vfzg_uw_b512 1 100 0.00 511.9922 FORMAT "%8.4" ECU_ADDRESS 0x7F8D90 /end MEASUREMENT
/begin MEASUREMENT FrmMng_vWheelLB "Geschwindigkeit des linken hinteren Rades" SWORD Vel 1 100 -327.6800 327.6700 FORMAT "%8.4" ECU_ADDRESS 0x7F8D92 /end MEASUREMENT
/begin MEASUREMENT FrmMng_vWheelLF "Meßpunkt Radgeschwindigkeit links vorne" SWORD Vel 1 100 -327.6800 327.6700 FORMAT "%8.4" ECU_ADDRESS 0x7F8D94 /end MEASUREMENT
/begin MEASUREMENT FrmMng_vWheelRB "Geschwindigkeit des rechten hintern Rades" SWORD Vel 1 100 -327.6800 327.6700 FORMAT "%8.4" ECU_ADDRESS 0x7F8D96 /end MEASUREMENT
/begin MEASUREMENT FrmMng_vWheelRF "Meßpunkt Radgeschwindigkeit rechts vorne" SWORD Vel 1 100 -327.6800 327.6700 FORMAT "%8.4" ECU_ADDRESS 0x7F8D98 /end MEASUREMENT
/begin MEASUREMENT FTSCD_tFuel "Kraftstofftemperatur" SWORD Temp_Cels 1 100 -50.140 899.860 FORMAT "%8.3" ECU_ADDRESS 0x7F8CBA /end MEASUREMENT
/begin MEASUREMENT FTSCD_tFuelLin "linearisierter Wert der Kraftstoffstemperatur" SWORD Temp_Cels 1 100 -50.140 899.860 FORMAT "%8.3" ECU_ADDRESS 0x7F8CBC /end MEASUREMENT
/begin MEASUREMENT FTSCD_uRaw "Spannungsrohwert der Kraftstoffstemperatur" SWORD Volt 1 100 -160156.4 160151.5 FORMAT "%8.1" ECU_ADDRESS 0x7F8CBE /end MEASUREMENT
/begin MEASUREMENT Gearbx_amAct_mp "Aktueller Integrationswert des Momentenüberschußintegrals" SWORD TrqDT 1 100 -32768.00 32767.00 FORMAT "%8.2" ECU_ADDRESS 0x8FF29E /end MEASUREMENT
/begin MEASUREMENT Gearbx_dtrqLimUp_mp "DrehkraftRampe Herauf Steigung" ULONG RmpTrq 1 100 0.00 6553599.99847 FORMAT "%13.5" ECU_ADDRESS 0x8FF2AC /end MEASUREMENT
/begin MEASUREMENT Gearbx_nMin "LL_Solldrehzahlanforderung durch Getriebe2 Botschaft" SWORD EngN 1 100 -32768.00 32767.00 FORMAT "%8.2" ECU_ADDRESS 0x7F8D9C /end MEASUREMENT
/begin MEASUREMENT Gearbx_nMinRaw_mp "Low Idel speed Raw value depending on Gear state and FrmMng_nTSC" SWORD EngN 1 100 -32768.00 32767.00 FORMAT "%8.2" ECU_ADDRESS 0x8FF29C /end MEASUREMENT
/begin MEASUREMENT Gearbx_numGearDes "erkannter Zielgang" SBYTE OneToOne 1 100 -128.0 127.0 FORMAT "%5.1" ECU_ADDRESS 0x7F88EA /end MEASUREMENT
/begin MEASUREMENT Gearbx_numGearFast "erkannter schneller Getriebegang" SBYTE OneToOne 1 100 -128.0 127.0 FORMAT "%5.1" ECU_ADDRESS 0x7F88EB /end MEASUREMENT
/begin MEASUREMENT Gearbx_rTrans "Getriebeübersetzung" SWORD TransR 1 100 -327.6800 327.6700 FORMAT "%8.4" ECU_ADDRESS 0x7F8D9E /end MEASUREMENT
/begin MEASUREMENT Gearbx_rTrans1 "gearbxübergangsverhältnis" SWORD TransR 1 100 -327.6800 327.6700 FORMAT "%8.4" ECU_ADDRESS 0x7F8DA0 /end MEASUREMENT
/begin MEASUREMENT Gearbx_rTrans2 "gearbxübergangsverhältnis2" SWORD TransR 1 100 -327.6800 327.6700 FORMAT "%8.4" ECU_ADDRESS 0x7F8DA2 /end MEASUREMENT
/begin MEASUREMENT Gearbx_rTrans3 "gearbxübergangsverhältnis3" SWORD TransR 1 100 -327.6800 327.6700 FORMAT "%8.4" ECU_ADDRESS 0x7F8DA4 /end MEASUREMENT
/begin MEASUREMENT Gearbx_rTrans4 "gearbxübergangsverhältnis 4" SWORD TransR 1 100 -327.6800 327.6700 FORMAT "%8.4" ECU_ADDRESS 0x7F8DA6 /end MEASUREMENT
/begin MEASUREMENT Gearbx_rTrans5 "gearbxübergangsverhältnis 5" SWORD TransR 1 100 -327.6800 327.6700 FORMAT "%8.4" ECU_ADDRESS 0x7F8DA8 /end MEASUREMENT
/begin MEASUREMENT Gearbx_rTrans6 "" SWORD TransR 1 100 -327.6800 327.6700 FORMAT "%8.4" ECU_ADDRESS 0x7F8DAA /end MEASUREMENT
/begin MEASUREMENT Gearbx_stDemUnplaus "Entprellter Status des Momentenüberschußintegrals" UBYTE OneToOne 1 100 0.00 255.0 FORMAT "%5.1" ECU_ADDRESS 0x7F88EC /end MEASUREMENT
/begin MEASUREMENT Gearbx_stDrvAway_mp "Status der Anfahrmomentbegrenzung" UBYTE OneToOne 1 100 0.00 255.0 FORMAT "%5.1" ECU_ADDRESS 0x8FF2B0 /end MEASUREMENT
/begin MEASUREMENT Gearbx_stGbxIncMax_mp "Status des Momentenüberschußintegrals" UBYTE OneToOne 1 100 0.00 255.0 FORMAT "%5.1" ECU_ADDRESS 0x8FF2A0 /end MEASUREMENT
/begin MEASUREMENT Gearbx_stGear "Ganginformation" SBYTE OneToOne 1 100 -128.0 127.0 FORMAT "%5.1" ECU_ADDRESS 0x7F88ED /end MEASUREMENT
/begin MEASUREMENT Gearbx_stGearBit "" UBYTE OneToOne 1 100 0.00 255.0 FORMAT "%5.1" ECU_ADDRESS 0x7F88EE /end MEASUREMENT
/begin MEASUREMENT Gearbx_stIntv_mp "Status der Defekt- und Heilungsrampe vom Getriebewunschmoment" UBYTE OneToOne 1 100 0.00 255.0 FORMAT "%5.1" ECU_ADDRESS 0x8FF2A4 /end MEASUREMENT
/begin MEASUREMENT Gearbx_stStrtMotRls "Anlasserfreigabezustand vom Getriebe" UBYTE OneToOne 1 100 0.00 255.0 FORMAT "%5.1" ECU_ADDRESS 0x7F88EF /end MEASUREMENT
/begin MEASUREMENT Gearbx_swtType "Getriebetyp (0: manuell(MT); 1: automatisch(AT); 2: Schaltautomatisch(AST); 3: StufenlosesGetriebe (CVT); 4:automatic Z-Car)" UBYTE OneToOne 1 100 0.00 3.000 FORMAT "%5.3" ECU_ADDRESS 0x7F88F0 /end MEASUREMENT
/begin MEASUREMENT Gearbx_tOil "Gearbox oil temperature" SWORD Temp_Cels 1 100 -50.140 899.860 FORMAT "%8.3" ECU_ADDRESS 0x7F8DAC /end MEASUREMENT
/begin MEASUREMENT Gearbx_trqDec "erniedrigender Momenteneingriff vom Getriebe" SWORD Trq 1 100 -500.0000 1000.000 FORMAT "%8.3" ECU_ADDRESS 0x7F8DAE /end MEASUREMENT
/begin MEASUREMENT Gearbx_trqDecRaw_mp "Ersatzwert für das reduzierende Getriebemoment" SWORD Trq 1 100 -3276.800 3276.700 FORMAT "%8.3" ECU_ADDRESS 0x8FF2A6 /end MEASUREMENT
/begin MEASUREMENT Gearbx_trqFrc "aktuelles Verlustmoment Getriebe" SWORD Trq 1 100 -500.0000 1000.000 FORMAT "%8.3" ECU_ADDRESS 0x7F8DB0 /end MEASUREMENT
/begin MEASUREMENT Gearbx_trqInc "erhöhender Momenteneingriff vom Getriebe" SWORD Trq 1 100 -500.0000 1000.000 FORMAT "%8.3" ECU_ADDRESS 0x7F8DB4 /end MEASUREMENT
/begin MEASUREMENT Gearbx_trqIncRaw_mp "Ersatzwert für das erhöhende Getriebemoment" SWORD Trq 1 100 -3276.800 3276.700 FORMAT "%8.3" ECU_ADDRESS 0x8FF2A8 /end MEASUREMENT
/begin MEASUREMENT Gearbx_trqInMax "maximales Getriebeeingangsmoment" SWORD Trq 1 100 -500.0000 1000.000 FORMAT "%8.3" ECU_ADDRESS 0x7F8DB2 /end MEASUREMENT
/begin MEASUREMENT Gearbx_trqInt_mp "Aktuelles  Integrationsmoment des Momentenüberschußintegrals" SWORD Trq 1 100 -3276.800 3276.700 FORMAT "%8.3" ECU_ADDRESS 0x8FF2A2 /end MEASUREMENT
/begin MEASUREMENT Gearbx_trqLimDrvAway_mp "Begrenztes Anfahrmoment" SWORD Trq 1 100 -3276.800 3276.700 FORMAT "%8.3" ECU_ADDRESS 0x8FF2B2 /end MEASUREMENT
/begin MEASUREMENT Gearbx_trqMaxCur_mp "maximales Getriebeeingangsmoment aus Kennlinie" SWORD Trq 1 100 -3276.800 3276.700 FORMAT "%8.3" ECU_ADDRESS 0x8FF2B4 /end MEASUREMENT
/begin FUNCTION frmmng_11hex ""
 /begin DEF_CHARACTERISTIC FrmMng_ctASCDef_C FrmMng_ctMulDDE2_C FrmMng_dCanState_C FrmMng_ctDebSigASC1Def_C FrmMng_ctDebSigASC1Ok_C FrmMng_ctDebSigASC2Def_C FrmMng_ctDebSigASC2Ok_C FrmMng_ctDebSigASC3Def_C FrmMng_ctDebSigASC3Ok_C FrmMng_ctDebSigASC4Def_C FrmMng_ctDebSigASC4Ok_C FrmMng_ctDebSigEGS1Def_C FrmMng_ctDebSigEGS1Ok_C FrmMng_ctDebSigEGS2Def_C FrmMng_ctDebSigEGS2Ok_C FrmMng_ctDebSigINSTR2Def_C FrmMng_ctDebSigINSTR2Ok_C FrmMng_ctDebSigINSTR3Def_C FrmMng_ctDebSigINSTR3Ok_C FrmMng_ctDebToASC1Def_C FrmMng_ctDebToASC1Ok_C FrmMng_ctDebToASC2Def_C FrmMng_ctDebToASC2Ok_C FrmMng_ctDebToASC3Def_C FrmMng_ctDebToASC3Ok_C FrmMng_ctDebToASC4Def_C FrmMng_ctDebToASC4Ok_C FrmMng_ctDebToEGS1Def_C FrmMng_ctDebToEGS1Ok_C FrmMng_ctDebToEGS2Def_C FrmMng_ctDebToEGS2Ok_C FrmMng_ctDebToINSTR2Def_C FrmMng_ctDebToINSTR2Ok_C FrmMng_ctDebToINSTR3Def_C FrmMng_ctDebToINSTR3Ok_C FrmMng_dEngGearbox_C FrmMng_dOBDCtrl_C FrmMng_dstGearbx_C FrmMng_fst_Offset_C FrmMng_fst_Slope_C FrmMng_kmst_Offset_C FrmMng_kmst_Slope_C FrmMng_nAvrg_Def_C FrmMng_nAvrg_Slope_C FrmMng_nDiv_Fac_C FrmMng_nFanErr_C FrmMng_nFan_C FrmMng_nLISetPoint_Offset_C FrmMng_nLISetPoint_Slope_C FrmMng_nML_C FrmMng_nTSCErr_C FrmMng_nTSC_Offset_C FrmMng_nTSC_Slope_C FrmMng_pVal_Offset_C FrmMng_pVal_Slope_C FrmMng_rFlt_Offset_C FrmMng_rFlt_Slope_C FrmMng_stGearErr_C FrmMng_swtASC1_C FrmMng_swtASC2_C FrmMng_swtASC3_C FrmMng_swtASC4_C FrmMng_swtCANA_C FrmMng_swtDDE1_C FrmMng_swtDDE2_C FrmMng_swtDDE4_C FrmMng_swtDSCBrkAct_C FrmMng_swtEGS1_C FrmMng_swtEGS2_C FrmMng_swtEKP_C FrmMng_swtINSTR2_C FrmMng_swtINSTR3_C FrmMng_tEng_Offset_C FrmMng_tEng_Slope_C FrmMng_tEnvErr_C FrmMng_tiDSCDelay1_C FrmMng_tiDSCDelay2_C FrmMng_tiDSCDelay3_C FrmMng_trqACErr_C FrmMng_trqLim_CUR FrmMng_trqNorm_C FrmMng_trq_Offset_C FrmMng_trq_Slope_C /end DEF_CHARACTERISTIC
 /begin IN_MEASUREMENT Eng_nAvrg /end IN_MEASUREMENT
/end FUNCTION
/begin FUNCTION frmmng_11hex_rx100ms_msg ""
 /begin OUT_MEASUREMENT FrmMng_stAC FrmMng_stSTAT_HDC FrmMng_stTSCDec FrmMng_stTSCInc FrmMng_trqTSCDec FrmMng_trqTSCInc /end OUT_MEASUREMENT
/end FUNCTION
/begin FUNCTION frmmng_11hex_uic ""
 /begin OUT_MEASUREMENT FrmMng_dOBDCtl_mp FrmMng_numASC1byte0_mp FrmMng_numASC1byte1_mp FrmMng_numASC1byte2_mp FrmMng_numASC1byte3_mp FrmMng_numASC1byte4_mp FrmMng_numASC1byte5_mp FrmMng_numASC1byte6_mp FrmMng_numASC1byte7_mp FrmMng_numASC2byte0_mp FrmMng_numASC2byte1_mp FrmMng_numASC2byte2_mp FrmMng_numASC2byte3_mp FrmMng_numASC2byte4_mp FrmMng_numASC2byte5_mp FrmMng_numASC2byte6_mp FrmMng_numASC2byte7_mp FrmMng_numASC3byte0_mp FrmMng_numASC3byte1_mp FrmMng_numASC3byte2_mp FrmMng_numASC3byte3_mp FrmMng_numASC3byte4_mp FrmMng_numASC3byte5_mp FrmMng_numASC3byte6_mp FrmMng_numASC3byte7_mp FrmMng_numASC4byte0_mp FrmMng_numASC4byte1_mp FrmMng_numASC4byte2_mp FrmMng_numASC4byte3_mp FrmMng_numASC4byte4_mp FrmMng_numASC4byte5_mp FrmMng_numASC4byte6_mp FrmMng_numASC4byte7_mp FrmMng_numDDE1byte0_mp FrmMng_numDDE1byte1_mp FrmMng_numDDE1byte2_mp FrmMng_numDDE1byte3_mp FrmMng_numDDE1byte4_mp FrmMng_numDDE1byte5_mp FrmMng_numDDE1byte6_mp FrmMng_numDDE1byte7_mp FrmMng_numDDE2byte0_mp FrmMng_numDDE2byte1_mp FrmMng_numDDE2byte2_mp FrmMng_numDDE2byte3_mp FrmMng_numDDE2byte4_mp FrmMng_numDDE2byte5_mp FrmMng_numDDE2byte6_mp FrmMng_numDDE2byte7_mp FrmMng_numDDE4byte0_mp FrmMng_numDDE4byte1_mp FrmMng_numDDE4byte2_mp FrmMng_numDDE4byte3_mp FrmMng_numDDE4byte4_mp FrmMng_numDDE4byte5_mp FrmMng_numDDE4byte6_mp FrmMng_numDDE4byte7_mp FrmMng_numEGS1byte0_mp FrmMng_numEGS1byte1_mp FrmMng_numEGS1byte2_mp FrmMng_numEGS1byte3_mp FrmMng_numEGS1byte4_mp FrmMng_numEGS1byte5_mp FrmMng_numEGS1byte6_mp FrmMng_numEGS1byte7_mp FrmMng_numEGS2byte0_mp FrmMng_numEGS2byte1_mp FrmMng_numEGS2byte2_mp FrmMng_numEGS2byte3_mp FrmMng_numEGS2byte4_mp FrmMng_numEGS2byte5_mp FrmMng_numEGS2byte6_mp FrmMng_numEGS2byte7_mp FrmMng_numEKPbyte0_mp FrmMng_numEKPbyte1_mp FrmMng_numEKPbyte2_mp FrmMng_numEKPbyte3_mp FrmMng_numINSTR2byte0_mp FrmMng_numINSTR2byte1_mp FrmMng_numINSTR2byte2_mp FrmMng_numINSTR2byte3_mp FrmMng_numINSTR2byte4_mp FrmMng_numINSTR2byte5_mp FrmMng_numINSTR2byte6_mp FrmMng_numINSTR2byte7_mp FrmMng_numINSTR3byte0_mp FrmMng_numINSTR3byte1_mp FrmMng_numINSTR3byte2_mp FrmMng_numINSTR3byte3_mp FrmMng_numINSTR3byte4_mp FrmMng_numINSTR3byte5_mp FrmMng_numINSTR3byte6_mp FrmMng_numINSTR3byte7_mp FrmMng_rTrqDCS_mp FrmMng_rTrqGearbxFrc_mp FrmMng_rTrqGearbx_mp FrmMng_rTrqTCS_mp FrmMng_stASC1Sig_mp FrmMng_stASC2Sig_mp FrmMng_stASC3Sig_mp FrmMng_stASC4Sig_mp FrmMng_stBrkTCS_mp FrmMng_stCrCCDKey_mp FrmMng_stCrCtlOff_mp FrmMng_stDCSActive_mp FrmMng_stDSCCtrl_mp FrmMng_stDSCDelay_mp FrmMng_stEGS1Sig_mp FrmMng_stEGS2Sig_mp FrmMng_stEngRun_mp FrmMng_stExc_ASC1_mp FrmMng_stExc_ASC2_mp FrmMng_stExc_ASC3_mp FrmMng_stExc_ASC4_mp FrmMng_stExc_EGS1_mp FrmMng_stExc_EGS2_mp FrmMng_stExc_INSTR2_mp FrmMng_stExc_INSTR3_mp FrmMng_stINSTR2Sig_mp FrmMng_stINSTR3Sig_mp FrmMng_stTCSActive_mp FrmMng_stTCSCtrl_mp FrmMng_stTrqDCSOk_mp FrmMng_stTrqTCSOk_mp FrmMng_trqDCSRaw_mp FrmMng_trqGearbxDes_mp FrmMng_trqGearbxRaw_mp FrmMng_trqTCSRaw_mp /end OUT_MEASUREMENT
/end FUNCTION
/begin FUNCTION frmmng_11hex_var_msg "" /begin OUT_MEASUREMENT FrmMng_stASCok FrmMng_stOldstStart FrmMng_trqFrc /end OUT_MEASUREMENT /end FUNCTION
/begin FUNCTION frmmng_conv "" /end FUNCTION
/begin FUNCTION frmmng_rx100ms_msg ""
 /begin OUT_MEASUREMENT FrmMng_ctrIdxNo FrmMng_nPSP FrmMng_pAir FrmMng_rPSPSetPoint FrmMng_stPRGG_CCTRSig FrmMng_stPSP FrmMng_tEnv FrmMng_tiDayCouAbsl FrmMng_trqDCS FrmMng_trqGbx FrmMng_trqTCS FrmMng_vPrgNo1 FrmMng_vPrgNo2 FrmMng_vPrgNo3 /end OUT_MEASUREMENT
/end FUNCTION
/begin FUNCTION frmmng_uic ""
 /begin OUT_MEASUREMENT FrmMng_ctAnfRadMomPtalv_mp FrmMng_ctBOS_RESETalv_mp FrmMng_ctDM_ANF_AFSalv_mp FrmMng_ctDRMANFSSGalv_mp FrmMng_ctENGINE1alv_mp FrmMng_ctOPCRCTLACCalv_mp FrmMng_ctRadMom1alv_mp FrmMng_ctRadMom2alv_mp FrmMng_ctSTAT_ARSalv_mp FrmMng_ctTERMINALalv_mp FrmMng_ctTORQUE1alv_mp FrmMng_ctTORQUE2alv_mp FrmMng_ctTORQUE3alv_mp FrmMng_ctTORQUE_DSCalv_mp FrmMng_ctTORQUE_GEARBXalv_mp FrmMng_ctVEH_MODalv_mp FrmMng_dAnfRadMomPtcs_mp FrmMng_dDM_ANF_AFScs_mp FrmMng_dDRMANFSSGcs_mp FrmMng_dOPCRCTLACCcs_mp FrmMng_dRadMom1cs_mp FrmMng_dRadMom2cs_mp FrmMng_dTERMINALcs_mp FrmMng_dTORQUE1cs_mp FrmMng_dTORQUE2cs_mp FrmMng_dTORQUE3cs_mp FrmMng_dTORQUE_DSCcs_mp FrmMng_dTORQUE_GEARBXcs_mp FrmMng_dVEH_MODcs_mp FrmMng_numANFRADMOMPTbyte0_mp FrmMng_numANFRADMOMPTbyte1_mp FrmMng_numANFRADMOMPTbyte2_mp FrmMng_numANFRADMOMPTbyte3_mp FrmMng_numANFRADMOMPTbyte4_mp FrmMng_numAnfrageByte0_mp FrmMng_numAnfrageByte1_mp FrmMng_numAnfrageByte2_mp FrmMng_numBOS_MELDUNG2_OILbyte0_mp FrmMng_numBOS_MELDUNG2_OILbyte1_mp FrmMng_numBOS_MELDUNG2_OILbyte2_mp FrmMng_numBOS_MELDUNG2_OILbyte3_mp FrmMng_numBOS_MELDUNG2_OILbyte4_mp FrmMng_numBOS_MELDUNG2_OILbyte5_mp FrmMng_numBOS_MELDUNG2_OILbyte6_mp FrmMng_numBOS_MELDUNG_OILbyte0_mp FrmMng_numBOS_MELDUNG_OILbyte1_mp FrmMng_numBOS_MELDUNG_OILbyte2_mp FrmMng_numBOS_MELDUNG_OILbyte3_mp FrmMng_numBOS_MELDUNG_OILbyte4_mp FrmMng_numBOS_MELDUNG_OILbyte5_mp FrmMng_numBOS_MELDUNG_OILbyte6_mp FrmMng_numBOS_MELDUNG_OILbyte7_mp FrmMng_numBOS_PFLTbyte0_mp FrmMng_numBOS_PFLTbyte1_mp FrmMng_numBOS_PFLTbyte2_mp FrmMng_numBOS_PFLTbyte3_mp FrmMng_numBOS_PFLTbyte4_mp FrmMng_numBOS_PFLTbyte5_mp FrmMng_numBOS_PFLTbyte6_mp FrmMng_numBOS_PFLTbyte7_mp FrmMng_numBOS_RESETbyte0_mp FrmMng_numBOS_RESETbyte1_mp FrmMng_numBOS_RESETbyte2_mp FrmMng_numBOS_RESETbyte3_mp FrmMng_numBOS_RESETbyte4_mp FrmMng_numBOS_RESETbyte5_mp FrmMng_numBOS_RESETbyte6_mp FrmMng_numBOS_RESETbyte7_mp FrmMng_numBOS_RESET_2byte0_mp FrmMng_numBOS_RESET_2byte1_mp FrmMng_numBOS_RESET_2byte2_mp FrmMng_numBOS_RESET_2byte3_mp FrmMng_numBOS_RESET_2byte4_mp FrmMng_numBOS_RESET_2byte5_mp FrmMng_numBOS_RESET_2byte6_mp FrmMng_numCCMsgbyte0_mp FrmMng_numCCMsgbyte1_mp FrmMng_numCCMsgbyte2_mp FrmMng_numCCMsgbyte3_mp FrmMng_numCCMsgbyte4_mp FrmMng_numCCMsgbyte5_mp FrmMng_numCCMsgbyte6_mp FrmMng_numCCMsgbyte7_mp FrmMng_numDMANFAFSbyte0_mp FrmMng_numDMANFAFSbyte1_mp FrmMng_numDMANFAFSbyte2_mp FrmMng_numDMANFAFSbyte3_mp FrmMng_numDMANFAFSbyte4_mp FrmMng_numDMANFAFSbyte5_mp FrmMng_numDM_ANF_ACCbyte0_mp FrmMng_numDM_ANF_ACCbyte1_mp FrmMng_numDM_ANF_ACCbyte2_mp FrmMng_numDM_ANF_ACCbyte3_mp FrmMng_numDM_ANF_ACCbyte4_mp FrmMng_numDM_ANF_ACCbyte5_mp FrmMng_numDM_ANF_ACCbyte6_mp FrmMng_numDM_ANF_ACCbyte7_mp FrmMng_numDRMANFSSGbyte0_mp FrmMng_numDRMANFSSGbyte1_mp FrmMng_numDRMANFSSGbyte2_mp FrmMng_numDRMANFSSGbyte3_mp FrmMng_numDRMANFSSGbyte4_mp FrmMng_numDRMANFSSGbyte5_mp FrmMng_numDRMANFSSGbyte6_mp FrmMng_numDRMANFSSGbyte7_mp FrmMng_numELKTR_M_OEL_MESSbyte0_mp FrmMng_numELKTR_M_OEL_MESSbyte1_mp FrmMng_numENGINE1byte0_mp FrmMng_numENGINE1byte1_mp FrmMng_numENGINE1byte2_mp FrmMng_numENGINE1byte3_mp FrmMng_numENGINE1byte4_mp FrmMng_numENGINE1byte5_mp FrmMng_numENGINE1byte6_mp FrmMng_numENGINE1byte7_mp FrmMng_numEngRpmbyte0_mp FrmMng_numEngRpmbyte1_mp FrmMng_numGEARBX_DATA2byte0_mp FrmMng_numGEARBX_DATA2byte1_mp FrmMng_numGEARBX_DATAbyte0_mp FrmMng_numGEARBX_DATAbyte1_mp FrmMng_numGEARBX_DATAbyte2_mp FrmMng_numGEARBX_DATAbyte3_mp FrmMng_numGEARBX_DATAbyte4_mp FrmMng_numGEARBX_DATAbyte5_mp FrmMng_numGEARBX_DATAbyte6_mp FrmMng_numGEARBX_DATAbyte7_mp FrmMng_numHEATCURbyte0_mp FrmMng_numHEATCURbyte1_mp FrmMng_numHEATCURbyte2_mp FrmMng_numHEATCURbyte3_mp FrmMng_numHEATCURbyte4_mp FrmMng_numHEATCURbyte5_mp FrmMng_numHEATCURbyte6_mp FrmMng_numHEAT_ACbyte0_mp FrmMng_numHEAT_ACbyte1_mp FrmMng_numHEAT_ACbyte2_mp FrmMng_numHEAT_ACbyte3_mp FrmMng_numHEAT_ACbyte4_mp FrmMng_numLRADWINKbyte0_mp FrmMng_numLRADWINKbyte1_mp FrmMng_numLRADWINKbyte2_mp FrmMng_numLRADWINKbyte3_mp FrmMng_numLRADWINKbyte4_mp FrmMng_numLRADWINKbyte5_mp FrmMng_numLRADWINKbyte6_mp FrmMng_numMILEAGE_RANGEbyte0_mp FrmMng_numMILEAGE_RANGEbyte1_mp FrmMng_numMILEAGE_RANGEbyte2_mp FrmMng_numMILEAGE_RANGEbyte3_mp FrmMng_numMILEAGE_RANGEbyte4_mp FrmMng_numMILEAGE_RANGEbyte5_mp FrmMng_numMILEAGE_RANGEbyte6_mp FrmMng_numMILEAGE_RANGEbyte7_mp FrmMng_numMsgACC_mp FrmMng_numMsgAC_mp FrmMng_numMsgAFS_mp FrmMng_numMsgARS_mp FrmMng_numMsgDCC_mp FrmMng_numMsgFGR_mp FrmMng_numOPCRCTLACCbyte0_mp FrmMng_numOPCRCTLACCbyte1_mp FrmMng_numOPCRCTLACCbyte2_mp FrmMng_numOPCRCTLACCbyte3_mp FrmMng_numParkConsumerByte0_mp FrmMng_numParkConsumerByte1_mp FrmMng_numParkConsumerByte2_mp FrmMng_numParkConsumerByte3_mp FrmMng_numPMCTRCOSbyte0_mp FrmMng_numPMCTRCOSbyte1_mp FrmMng_numPMCTRCOSbyte2_mp FrmMng_numPMCTRCOSbyte3_mp FrmMng_numPMCTRCOSbyte4_mp FrmMng_numPMCTRCOSbyte5_mp FrmMng_numPMUBattbyte0_mp FrmMng_numPMUBattbyte1_mp FrmMng_numPMUBattbyte2_mp FrmMng_numPMUBattbyte3_mp FrmMng_numPMUBattbyte4_mp FrmMng_numPMUBattbyte5_mp FrmMng_numPMUBattbyte6_mp FrmMng_numPMUBattbyte7_mp FrmMng_numPRGG_CCTRbyte0_mp FrmMng_numPRGG_CCTRbyte1_mp FrmMng_numPRGG_CCTRbyte2_mp FrmMng_numPRGG_CCTRbyte3_mp FrmMng_numPRGG_CCTRbyte4_mp FrmMng_numPWRMNG_LOADVbyte0_mp FrmMng_numPWRMNG_LOADVbyte1_mp FrmMng_numPWRMNG_LOADVbyte2_mp FrmMng_numPWRMNG_LOADVbyte3_mp FrmMng_numPWRMNG_LOADVbyte4_mp FrmMng_numPWRMNG_LOADVbyte5_mp FrmMng_numPWRMNG_LOADVbyte6_mp FrmMng_numPWRMNG_LOADVbyte7_mp FrmMng_numRADMOMPT1byte0_mp FrmMng_numRADMOMPT1byte1_mp FrmMng_numRADMOMPT1byte2_mp FrmMng_numRADMOMPT1byte3_mp FrmMng_numRADMOMPT1byte4_mp FrmMng_numRADMOMPT1byte5_mp FrmMng_numRADMOMPT1byte6_mp FrmMng_numRADMOMPT1byte7_mp FrmMng_numRADMOMPT2byte0_mp FrmMng_numRADMOMPT2byte1_mp FrmMng_numRADMOMPT2byte2_mp FrmMng_numRADMOMPT2byte3_mp FrmMng_numRADMOMPT2byte4_mp FrmMng_numRADMOMPT2byte5_mp FrmMng_numRADMOMPT2byte6_mp FrmMng_numRADMOMPT2byte7_mp FrmMng_numRPM_STAByte0_mp FrmMng_numRPM_STAByte1_mp FrmMng_numRQ_STG_EFANbyte0_mp FrmMng_numRQ_STG_EFANbyte1_mp FrmMng_numRQ_STG_EFANbyte2_mp FrmMng_numSITZGURTbyte0_mp FrmMng_numSITZGURTbyte1_mp FrmMng_numSITZGURTbyte2_mp FrmMng_numSITZGURTbyte3_mp FrmMng_numSITZGURTbyte4_mp FrmMng_numSPEED_CLCTRbyte0_mp FrmMng_numSPEED_CLCTRbyte1_mp FrmMng_numSPEED_CLCTRbyte2_mp FrmMng_numSPEED_CLCTRbyte3_mp FrmMng_numSPEED_CLCTRbyte4_mp FrmMng_numSPEED_CLCTRbyte5_mp FrmMng_numSPEED_CLCTRbyte6_mp FrmMng_numSPEED_CLCTRbyte7_mp FrmMng_numSTAT_ANHbyte0_mp FrmMng_numSTAT_ARSbyte0_mp FrmMng_numSTAT_ARSbyte1_mp FrmMng_numSTAT_ARSbyte2_mp FrmMng_numSTAT_ARSbyte3_mp FrmMng_numSTAT_ARSbyte4_mp FrmMng_numSTAT_ARSbyte5_mp FrmMng_numSTAT_ARSbyte6_mp FrmMng_numSTAT_ARSbyte7_mp FrmMng_numSTAT_DSCbyte0_mp FrmMng_numSTAT_DSCbyte1_mp FrmMng_numSTAT_DSCbyte2_mp FrmMng_numSTAT_DSCbyte3_mp FrmMng_numSTAT_DSCbyte4_mp FrmMng_numSTAT_DSCbyte5_mp FrmMng_numSTAT_DSCbyte6_mp FrmMng_numSTAT_DSCbyte7_mp FrmMng_numSTAT_EKPbyte0_mp FrmMng_numSTAT_EKPbyte1_mp FrmMng_numSTAT_EKPbyte2_mp FrmMng_numSTAT_EKPbyte3_mp FrmMng_numSTAT_EKPbyte4_mp FrmMng_numSTAT_EKPbyte5_mp FrmMng_numSTAT_EKPbyte6_mp FrmMng_numSTAT_EKPbyte7_mp FrmMng_numSTAT_KOMBIbyte0_mp FrmMng_numSTAT_KOMBIbyte1_mp FrmMng_numSTAT_KOMBIbyte2_mp FrmMng_numSTAT_KOMBIbyte3_mp FrmMng_numSTAT_KOMBIbyte4_mp FrmMng_numSTAT_KOMBIbyte5_mp FrmMng_numSTAT_KOMBIbyte6_mp FrmMng_numSTAT_KOMBIbyte7_mp FrmMng_numTEMPRELTIMEbyte0_mp FrmMng_numTEMPRELTIMEbyte1_mp FrmMng_numTEMPRELTIMEbyte2_mp FrmMng_numTEMPRELTIMEbyte3_mp FrmMng_numTEMPRELTIMEbyte4_mp FrmMng_numTEMPRELTIMEbyte5_mp FrmMng_numTEMPRELTIMEbyte6_mp FrmMng_numTERMINALbyte0_mp FrmMng_numTERMINALbyte1_mp FrmMng_numTERMINALbyte2_mp FrmMng_numTERMINALbyte3_mp FrmMng_numTERMINALbyte4_mp FrmMng_numTIME_DATEbyte0_mp FrmMng_numTIME_DATEbyte1_mp FrmMng_numTIME_DATEbyte2_mp FrmMng_numTIME_DATEbyte3_mp FrmMng_numTIME_DATEbyte4_mp FrmMng_numTIME_DATEbyte5_mp FrmMng_numTIME_DATEbyte6_mp FrmMng_numTORQUE1byte0_mp FrmMng_numTORQUE1byte1_mp FrmMng_numTORQUE1byte2_mp FrmMng_numTORQUE1byte3_mp FrmMng_numTORQUE1byte4_mp FrmMng_numTORQUE1byte5_mp FrmMng_numTORQUE1byte6_mp FrmMng_numTORQUE1byte7_mp FrmMng_numTORQUE2byte0_mp FrmMng_numTORQUE2byte1_mp FrmMng_numTORQUE2byte2_mp FrmMng_numTORQUE2byte3_mp FrmMng_numTORQUE2byte4_mp FrmMng_numTORQUE2byte5_mp FrmMng_numTORQUE2byte6_mp FrmMng_numTORQUE2byte7_mp FrmMng_numTORQUE3byte0_mp FrmMng_numTORQUE3byte1_mp FrmMng_numTORQUE3byte2_mp FrmMng_numTORQUE3byte3_mp FrmMng_numTORQUE3byte4_mp FrmMng_numTORQUE3byte5_mp FrmMng_numTORQUE3byte6_mp FrmMng_numTORQUE3byte7_mp FrmMng_numTORQUE_DSCbyte0_mp FrmMng_numTORQUE_DSCbyte1_mp FrmMng_numTORQUE_DSCbyte2_mp FrmMng_numTORQUE_DSCbyte3_mp FrmMng_numTORQUE_DSCbyte4_mp FrmMng_numTORQUE_DSCbyte5_mp FrmMng_numTORQUE_DSCbyte6_mp FrmMng_numTORQUE_DSCbyte7_mp FrmMng_numTORQUE_GEARBXbyte0_mp FrmMng_numTORQUE_GEARBXbyte1_mp FrmMng_numTORQUE_GEARBXbyte2_mp FrmMng_numTORQUE_GEARBXbyte3_mp FrmMng_numTORQUE_GEARBXbyte4_mp FrmMng_numTORQUE_GEARBXbyte5_mp FrmMng_numTORQUE_GEARBXbyte6_mp FrmMng_numTORQUE_GEARBXbyte7_mp FrmMng_numVEH_MODbyte0_mp FrmMng_numVEH_MODbyte1_mp FrmMng_numVELOCITYbyte0_mp FrmMng_numVELOCITYbyte1_mp FrmMng_numVELOCITYbyte2_mp FrmMng_numVELOCITYbyte3_mp FrmMng_numVELOCITYbyte4_mp FrmMng_numVELOCITYbyte5_mp FrmMng_numVELOCITYbyte6_mp FrmMng_numVELOCITYbyte7_mp FrmMng_numWHEEL_SPEEDbyte0_mp FrmMng_numWHEEL_SPEEDbyte1_mp FrmMng_numWHEEL_SPEEDbyte2_mp FrmMng_numWHEEL_SPEEDbyte3_mp FrmMng_numWHEEL_SPEEDbyte4_mp FrmMng_numWHEEL_SPEEDbyte5_mp FrmMng_numWHEEL_SPEEDbyte6_mp FrmMng_numWHEEL_SPEEDbyte7_mp FrmMng_RadmomPT1RetVal_mp FrmMng_RadmomPT2RetVal_mp FrmMng_rWaterVlv_mp FrmMng_service_index_Byte0_mp FrmMng_service_index_Byte10_mp FrmMng_service_index_Byte11_mp FrmMng_service_index_Byte12_mp FrmMng_service_index_Byte13_mp FrmMng_service_index_Byte14_mp FrmMng_service_index_Byte1_mp FrmMng_service_index_Byte2_mp FrmMng_service_index_Byte3_mp FrmMng_service_index_Byte4_mp FrmMng_service_index_Byte5_mp FrmMng_service_index_Byte6_mp FrmMng_service_index_Byte7_mp FrmMng_service_index_Byte8_mp FrmMng_service_index_Byte9_mp FrmMng_stARSquit_mp FrmMng_stBrk_mp FrmMng_stCrCtl_mp FrmMng_stCurrSig_mp FrmMng_stCurr_byte0_mp FrmMng_stCurr_byte1_mp FrmMng_stCurr_byte2_mp FrmMng_stCurr_byte3_mp FrmMng_stDebValT15CDold_mp FrmMng_stDrvAssist_mp FrmMng_stDSCquit_mp FrmMng_stEng_mp FrmMng_stExcStateCan_mp FrmMng_stExc_ANFRADMOMPT_mp FrmMng_stExc_BOS_RESET_2_mp FrmMng_stExc_BOS_RESET_mp FrmMng_stExc_DM_ANF_ACC_mp FrmMng_stExc_DM_ANF_AFS_mp FrmMng_stExc_DRMANFSSG_mp FrmMng_stExc_GEARBX_DATA2_mp FrmMng_stExc_GEARBX_DATA_mp FrmMng_stExc_HEAT_AC_mp FrmMng_stExc_LRADWINK_mp FrmMng_stExc_MILEAGE_RANGE_mp FrmMng_stExc_OPCRCTLACC_mp FrmMng_stExc_ParkConsumer_mp FrmMng_stExc_PRGG_CCTR_mp FrmMng_stExc_PWRMNG_LOADV_mp FrmMng_stExc_RQ_STG_EFAN_mp FrmMng_stExc_SERVICE_mp FrmMng_stExc_SITZGURT_mp FrmMng_stExc_STAT_ANH_mp FrmMng_stExc_STAT_ARS_mp FrmMng_stExc_STAT_DSC_mp FrmMng_stExc_STAT_EKP_mp FrmMng_stExc_STAT_KOMBI_mp FrmMng_stExc_stCurr_mp FrmMng_stExc_swtPSPOff_mp FrmMng_stExc_TEMPRELTIME_mp FrmMng_stExc_TERMINAL_mp FrmMng_stExc_TIME_DATE_mp FrmMng_stExc_TORQUE_DSC_mp FrmMng_stExc_TORQUE_GEARBX_mp FrmMng_stExc_VEH_MOD_mp FrmMng_stExc_VELOCITY_mp FrmMng_stExc_WHEEL_SPEED_mp FrmMng_stFDC_mp FrmMng_stGearbxHtgUpAct_mp FrmMng_stGearbxquit_mp FrmMng_stHtgUp_mp FrmMng_stLIGov_mp FrmMng_stnErr_mp FrmMng_stOBDGbx_mp FrmMng_stOpPubuCctrAcc_mp FrmMng_stOvrRun_mp FrmMng_stpmsv_mp FrmMng_stpmsv_old_mp FrmMng_stRmp_mp FrmMng_stShutOffHtgUp_mp FrmMng_stSLckAdjVal_mp FrmMng_stSLck_mp FrmMng_stSwClt_mp FrmMng_stSwLevRpm_mp FrmMng_stTrqDisable_mp FrmMng_stTrqInr_mp FrmMng_stWHEEL_SPEEDSig_mp FrmMng_swtAC_mp FrmMng_swtPSPOffSig_mp FrmMng_swtPSPOff_byte0_mp FrmMng_tEngRpm_mp FrmMng_tiRecACC_mp FrmMng_tiRecAC_mp FrmMng_tiRecAFS_mp FrmMng_tiRecARS_mp FrmMng_tiRecDCC_mp FrmMng_tiRecFGR_mp FrmMng_tmrDSMFadeoutANFRADMOMPT_mp FrmMng_tmrDSMFadeoutTERMINAL_mp FrmMng_tmrDSMToTERMINAL_mp FrmMng_torque1RetVal_mp FrmMng_torque2RetVal_mp FrmMng_torque3RetVal_mp FrmMng_trqACC_TrqDes_mp FrmMng_trqBefRmp_mp FrmMng_trqDes_mp FrmMng_trqDSCDes_mp FrmMng_trqFMTCInr_mp FrmMng_trqGbx_mp FrmMng_trqGearbxMax_mp FrmMng_trqInrGearbxOut_mp FrmMng_trqInrSet_mp FrmMng_trqMax_mp FrmMng_trqMin_mp FrmMng_trqResPos_mp FrmMng_trqRmp_mp FrmMng_trqSet_mp FrmMng_trqWheelMax_mp FrmMng_trqWheelMin_mp FrmMng_trqWheelRmp_mp FrmMng_trqWheel_mp /end OUT_MEASUREMENT
/end FUNCTION
/begin FUNCTION frmmng_var_msg ""
 /begin OUT_MEASUREMENT FrmMng_aDirect FrmMng_aSide FrmMng_ctACC_TrqAlv FrmMng_ctrRel FrmMng_ctSTAT_KOMBIalv FrmMng_dACC_CkSTrq FrmMng_dphiStrg FrmMng_dSlopeACP FrmMng_iHiLimCurr FrmMng_iLoLimCurr FrmMng_iZrCurrLim FrmMng_lSum FrmMng_nBattCls FrmMng_nEngRpm1 FrmMng_nEngRpm2 FrmMng_nFan FrmMng_nLimSSG FrmMng_nRqStgEFan FrmMng_nTSC FrmMng_numACFanDes FrmMng_numRqStgEFan FrmMng_parkConsumerFunctionID FrmMng_parkConsumerID2 FrmMng_pBrkSys FrmMng_phiStrg FrmMng_rHtFlowReq FrmMng_rTransDT FrmMng_stACCTrqCtl FrmMng_stACC_ModDME FrmMng_stACC_PrevOvrRunSwtDem FrmMng_stACC_ShtDwnDME FrmMng_stACC_TrqDes FrmMng_stACmainSwt FrmMng_stACnMin FrmMng_stANFRADMOMPTSig FrmMng_stARS FrmMng_stAVAI_BOS_RSTG FrmMng_stBltbDr FrmMng_stBOS_RESETSig FrmMng_stBOS_RESET_2Sig FrmMng_stClCtr FrmMng_stCltSSG FrmMng_stConv FrmMng_stCOU_RSTG_BOS_RSTG FrmMng_stCrCtlRaw FrmMng_stDateDay FrmMng_stDateMon FrmMng_stDateSeason FrmMng_stDateYr FrmMng_stDCC_TrqDes FrmMng_stDecellDSC FrmMng_stDM_ANF_AFSSig FrmMng_stDREHMOMENT_ANF_ACCSig FrmMng_stDRMANFSSGSig FrmMng_stDSCDef FrmMng_stErrAFS FrmMng_stErrStrg FrmMng_stFDC FrmMng_stGbx FrmMng_stGear FrmMng_stGEARBX_DATA2Sig FrmMng_stGEARBX_DATASig FrmMng_stHEAT_ACSig FrmMng_stId2BosRst FrmMng_stId2RqStgEFan FrmMng_stID2_BOS_RSTG FrmMng_stIdFktBosRst FrmMng_stIdFnRqStgEFan FrmMng_stIdlingSpec FrmMng_stID_FN_BOS_RSTG FrmMng_stInjDu FrmMng_stKeyVld FrmMng_stLENKRADWINKELSig FrmMng_stMILEAGE_RANGESig FrmMng_stOPCRCTLACCSig FrmMng_stParkConsumer FrmMng_stParkConsumerSig FrmMng_stPHtr FrmMng_stPrgIntTimeBosRst FrmMng_stPrgIntWayBosRst FrmMng_stPWRMNG_LOADVSig FrmMng_stRecACC FrmMng_stRecAFS FrmMng_stRecARS FrmMng_stRecDCC FrmMng_stRecFDC FrmMng_stRecFGR FrmMng_stRMMI_BOS_RSTG FrmMng_stRQ_STG_EFANSig FrmMng_stShpsSSG FrmMng_stShpsSSGOld FrmMng_stShutOffSSG FrmMng_stSITZGURTSig FrmMng_stSTAT_ANHSig FrmMng_stSTAT_ARSSig FrmMng_stSTAT_DSCSig FrmMng_stSTAT_EKPSig FrmMng_stSTAT_KOMBISig FrmMng_stStiffParameter FrmMng_stT15 FrmMng_stT50 FrmMng_stTEMPRELTIMESig FrmMng_stTERMINALSig FrmMng_stTgMonthBosRst FrmMng_stTgYearBosRst FrmMng_stTIME_DATESig FrmMng_stTorqTarAFS FrmMng_stTORQUE_DSCSig FrmMng_stTORQUE_GEARBXSig FrmMng_stTRadio FrmMng_stTrailer FrmMng_stTrqDesDSC FrmMng_stTrqDesGearbx FrmMng_stTrqLimGearbx FrmMng_stTxRequest FrmMng_stUnitV FrmMng_stVCom FrmMng_stVEH_MODSig FrmMng_stVELOCITYSig FrmMng_stWghSeatDr FrmMng_swtCarType FrmMng_swtPSPOff FrmMng_tOil FrmMng_trqAC FrmMng_trqACC_TrqDes FrmMng_trqARSCur FrmMng_trqARSDes FrmMng_trqARSInc FrmMng_trqAvlAFS FrmMng_trqDesDCC FrmMng_trqDSCDec FrmMng_trqDSCDes FrmMng_trqDSCInc FrmMng_trqGearbxDec FrmMng_trqGearbxDes FrmMng_trqGearbxFrc FrmMng_trqGearbxInc FrmMng_trqGearbxMax FrmMng_trqInr FrmMng_trqTarAFS FrmMng_uAltTarget FrmMng_v FrmMng_vDirection FrmMng_vDisp FrmMng_volFuelFil FrmMng_vWheelLB FrmMng_vWheelLF FrmMng_vWheelRB FrmMng_vWheelRF /end OUT_MEASUREMENT
/end FUNCTION
/begin FUNCTION ftscd "Kraftstofftemperatur Komponententreiber"
 /begin DEF_CHARACTERISTIC FTSCD_uSRCMin_C FTSCD_uSRCMax_C FTSCD_tLin_CUR FTSCD_DebSRCHighDef_C FTSCD_DebSRCHighOk_C FTSCD_DebSRCLowDef_C FTSCD_DebSRCLowOk_C FTSCD_numAdc_C FTSCD_dtRmpSlpUp_C FTSCD_dtRmpSlpDwn_C FTSCD_stSensIDWord_C FTSCD_tDfl_C /end DEF_CHARACTERISTIC
 /begin IN_MEASUREMENT FTSCD_uRaw /end IN_MEASUREMENT
/end FUNCTION
/begin FUNCTION ftscd_msg "" /begin OUT_MEASUREMENT FTSCD_tFuel FTSCD_tFuelLin FTSCD_uRaw /end OUT_MEASUREMENT /end FUNCTION
/begin FUNCTION gearbx_data "Getriebeinformation" /begin DEF_CHARACTERISTIC Gearbx_swtTypeVal_C Gearbx_swtTypeType_C /end DEF_CHARACTERISTIC /end FUNCTION
/begin FUNCTION gearbx_data_msg "" /begin OUT_MEASUREMENT Gearbx_tOil /end OUT_MEASUREMENT /end FUNCTION
/begin FUNCTION gearbx_data_uic "" /end FUNCTION
/begin FUNCTION gearbx_geardet "Gangerkennung"
 /begin DEF_CHARACTERISTIC Gearbx_numGearDfl_C Gearbx_numWinG0_C Gearbx_numWinG1_C Gearbx_numWinG2_C Gearbx_numWinG3_C Gearbx_numWinG4_C Gearbx_numWinG5_C Gearbx_numWinG6_C Gearbx_numWinG7_C Gearbx_numWinGR_C Gearbx_rTrans1_C Gearbx_rTrans2_C Gearbx_rTrans3_C Gearbx_rTrans4_C Gearbx_rTrans5_C Gearbx_rTrans6_C Gearbx_rTransR_C Gearbx_rVn0ToR_C Gearbx_rVn1H_C Gearbx_rVn1L_C Gearbx_rVn1To2_C Gearbx_rVn2H_C Gearbx_rVn2L_C Gearbx_rVn2To3_C Gearbx_rVn3H_C Gearbx_rVn3L_C Gearbx_rVn3To4_C Gearbx_rVn4H_C Gearbx_rVn4L_C Gearbx_rVn4To5_C Gearbx_rVn5H_C Gearbx_rVn5L_C Gearbx_rVn5To6_C Gearbx_rVn6H_C Gearbx_rVn6L_C Gearbx_rVn6To7_C Gearbx_rVnRH_C Gearbx_rVnRL_C Gearbx_rVnRTo1_C Gearbx_stTypeSelCAN_C Gearbx_swtErrRea_C /end DEF_CHARACTERISTIC
/end FUNCTION
/begin FUNCTION gearbx_geardet_uic "" /end FUNCTION
/begin FUNCTION gearbx_getnmin "Berechnung der Leerlaufsolldrehzahlanforderung vom Getriebe"
 /begin DEF_CHARACTERISTIC Gearbx_dnNMinRmpUp_C Gearbx_dnNMinRmpDwn_C Gearbx_nMinFDC_MAP Gearbx_nMin_MAP /end DEF_CHARACTERISTIC
 /begin IN_MEASUREMENT FrmMng_nTSC Gearbx_stGear /end IN_MEASUREMENT
/end FUNCTION
/begin FUNCTION gearbx_getnmin_uic "" /begin OUT_MEASUREMENT Gearbx_nMinRaw_mp /end OUT_MEASUREMENT /end FUNCTION
/begin FUNCTION gearbx_intvplauschk "Momentenüberschussintegral"
 /begin DEF_CHARACTERISTIC Gearbx_amMax_C Gearbx_swtUnplausChk_C Gearbx_tiDebMaxOk_C Gearbx_tiDebMaxDef_C /end DEF_CHARACTERISTIC
/end FUNCTION
/begin FUNCTION gearbx_intvplauschk_msg "" /begin OUT_MEASUREMENT Gearbx_stDemUnplaus /end OUT_MEASUREMENT /end FUNCTION
/begin FUNCTION gearbx_intvplauschk_uic "" /begin OUT_MEASUREMENT Gearbx_amAct_mp Gearbx_stGbxIncMax_mp Gearbx_trqInt_mp /end OUT_MEASUREMENT /end FUNCTION
/begin FUNCTION gearbx_msg ""
 /begin OUT_MEASUREMENT Gearbx_nMin Gearbx_numGearDes Gearbx_numGearFast Gearbx_rTrans Gearbx_rTrans1 Gearbx_rTrans2 Gearbx_rTrans3 Gearbx_rTrans4 Gearbx_rTrans5 Gearbx_rTrans6 Gearbx_stGear Gearbx_stGearBit Gearbx_swtType Gearbx_trqDec Gearbx_trqFrc Gearbx_trqInc Gearbx_trqInMax /end OUT_MEASUREMENT
/end FUNCTION
/begin FUNCTION gearbx_strtmotrls "" /end FUNCTION
/begin FUNCTION gearbx_strtmotrls_msg "" /begin OUT_MEASUREMENT Gearbx_stStrtMotRls /end OUT_MEASUREMENT /end FUNCTION
/begin FUNCTION gearbx_strtmotrls_uic "" /end FUNCTION
/begin FUNCTION gearbx_trqfrc "aktuelles Verlustmoment Getriebe" /end FUNCTION
/begin FUNCTION gearbx_trqfrc_uic "" /end FUNCTION
/begin FUNCTION gearbx_trqintv "Getriebeeingriff auf Motormoment"
 /begin DEF_CHARACTERISTIC Gearbx_trqDecMax_C Gearbx_trqDecMax_CUR Gearbx_dtrqLimUptrqDec_C Gearbx_dtrqLimDwntrqDec_C Gearbx_trqIncMax_C Gearbx_trqIncMin_C Gearbx_dtrqLimUptrqInc_C Gearbx_dtrqLimDwntrqInc_C Gearbx_vTrqIntvVSSCDlim_C /end DEF_CHARACTERISTIC
 /begin IN_MEASUREMENT Eng_nAvrg /end IN_MEASUREMENT
/end FUNCTION
/begin FUNCTION gearbx_trqintv_uic "" /begin OUT_MEASUREMENT Gearbx_stIntv_mp Gearbx_trqDecRaw_mp Gearbx_trqIncRaw_mp /end OUT_MEASUREMENT /end FUNCTION
/begin FUNCTION gearbx_trqlim "Getriebeschutz"
 /begin DEF_CHARACTERISTIC Gearbx_dtrqLimUp_C Gearbx_dtrqRmpUp_C Gearbx_dtrqRmpDwn_C Gearbx_facLimUp_CUR Gearbx_swtDrvAway_C Gearbx_trqInMax_CUR Gearbx_trqMaxErr2_CUR Gearbx_trqMaxErr_CUR Gearbx_trqMaxGear1_CUR Gearbx_trqMaxGear2_CUR Gearbx_trqMaxGear3_CUR Gearbx_trqMaxGear4_CUR Gearbx_trqMaxGear5_CUR Gearbx_trqMaxGear6_CUR Gearbx_trqMaxGearR_CUR Gearbx_vTrqLim_C /end DEF_CHARACTERISTIC
 /begin IN_MEASUREMENT Eng_nAvrg VSSCD_v /end IN_MEASUREMENT
/end FUNCTION
/begin FUNCTION gearbx_trqlim_uic "" /begin DEF_CHARACTERISTIC Gearbx_trqInMax_Vector Gearbx_trqInMax_Channel /end DEF_CHARACTERISTIC
 /begin OUT_MEASUREMENT Gearbx_dtrqLimUp_mp Gearbx_stDrvAway_mp Gearbx_trqLimDrvAway_mp Gearbx_trqMaxCur_mp /end OUT_MEASUREMENT
/end FUNCTION
/begin COMPU_METHOD Acc "Fahrzeugbeschleunigung" RAT_FUNC "%6.5" "m/s^2" COEFFS 0 1000 0 0 0 1 /end COMPU_METHOD
/begin COMPU_METHOD AngleGrad "Winkelanzeige in Grad" RAT_FUNC "%6.4" "Grad" COEFFS 0 22.7531285551763 0 0 0 1 /end COMPU_METHOD
/begin COMPU_METHOD AngleGradPerSec "Winkelanzeige in Grad pro Sekunde" RAT_FUNC "%6.4" "Grad/s" COEFFS 0 22.7531285551763 0 0 0 1 /end COMPU_METHOD
/begin COMPU_METHOD CarType "" TAB_VERB "%6.3" "-" COMPU_TAB_REF CarType /end COMPU_METHOD
/begin COMPU_VTAB CarType "" TAB_VERB 5 0 "E60" 1 "E65" 2 "E90" 3 "E83" 4 "E87" /end COMPU_VTAB
/begin COMPU_METHOD DEZ "K3 Umwandlungen" RAT_FUNC "%6.2" "-" COEFFS 0 1 0 0 0 1 /end COMPU_METHOD
/begin COMPU_METHOD EngN "Motordrehzahl" RAT_FUNC "%6.2" "rpm" COEFFS 0 1 0 0 0 1 /end COMPU_METHOD
/begin COMPU_METHOD Fact "Faktor mit Auflösung 1 / 8192, hauptsächlich für einen Faktorenbereich 0...1 verwendet" RAT_FUNC "%6.5" "-" COEFFS 0 8192 0 0 0 1 /end COMPU_METHOD
/begin COMPU_METHOD FanSpd "(MAXSINT16 / FANSPD_MAX) * phys" RAT_FUNC "%6.3" "1/min" COEFFS 0 10.9223333333333 0 0 0 1 /end COMPU_METHOD
/begin COMPU_METHOD Fl_Half_L "Kraftstoffverbrauchsintegral" RAT_FUNC "%6.4" "l" COEFFS 0 20 0 0 0 1 /end COMPU_METHOD
/begin COMPU_METHOD i_ub_q0p001 "K3 Umwandlungen" RAT_FUNC "%5.4" "A" COEFFS 0 1 0 0 0 0.001 /end COMPU_METHOD
/begin COMPU_METHOD i_ub_q10p0 "K3 Umwandlungen" RAT_FUNC "%5.1" "A" COEFFS 0 1 0 0 0 10 /end COMPU_METHOD
/begin COMPU_METHOD LengthKm "Länge in Kilometer" RAT_FUNC "%6.2" "km" COEFFS 0 1 0 0 0 1 /end COMPU_METHOD
/begin COMPU_METHOD NumPinAdc "verbale Umrechnung für ADC Signale" TAB_VERB "%6.3" "-" COMPU_TAB_REF NumPinAdc /end COMPU_METHOD
/begin COMPU_VTAB NumPinAdc "verbale Umrechnung für ADC Signale" TAB_VERB 27 0 "Water_Temperature_Sensor_182" 1 "Intake_Air_Temperature_Sensor_157" 2 "Charge_Air_Temperature_Sensor_183" 3 "Exhaust_Temperature_Sensor_2_134" 4 "Exhaust_Temperature_Sensor_1_158" 5 "1st_APP_Sensor_252" 6 "2nd_APP_Sensor_239" 7 "ADC_REF" 8 "Boost_Pressure_Sensor_154" 9 "Atmospheric_Pressure_Sensor" 10 "Battery_Voltage_Sensor" 11 "Rail_Pressure_Sensor_156" 12 "Rail_Pressure_Peak_Value_156" 13 "Booster_Voltage_Sensor" 14 "Current_MeUn_Sensor" 15 "Current_PCV_Sensor" 16 "Voltage_Bank_1" 17 "Voltage_Bank_2" 18 "Pressure_Upstream_Particle_Filter_159" 19 "Engine_Oil_Pressure_110" 20 "Temperature_ECU_PCB" 21 "Voltage_Lambda_Ua" 22 "Voltage_Lambda_Ri" 23 "EMCCD_Current_Governor1_124" 24 "EMCCD_Current_Governor2_121" 25 "ADC_DUMMY_NOT_USED" 26 "ADC_DUMMY_A_NOT_USED" /end COMPU_VTAB
/begin COMPU_METHOD OneToOne "eins zu eins (physikalischer Wert ist gleich dem internen Wert)" RAT_FUNC "%6.2" "-" COEFFS 0 1 0 0 0 1 /end COMPU_METHOD
/begin COMPU_METHOD Prc "Prozent, gleiche interne Auflösung wie Fact, aber Darstellung in Prozent (0...100%)" RAT_FUNC "%6.4" "%" COEFFS 0 81.92 0 0 0 1 /end COMPU_METHOD
/begin COMPU_METHOD Pres_bar "Druck (angezeigt in bar)" RAT_FUNC "%6.2" "bar" COEFFS 0 1 0 0 0 1 /end COMPU_METHOD
/begin COMPU_METHOD Pres_hPa "Druck (angezeigt in [hPa])" RAT_FUNC "%6.2" "hPa" COEFFS 0 1 0 0 0 1 /end COMPU_METHOD
/begin COMPU_METHOD PSP_Spd "PSP speed in rpm" RAT_FUNC "%6.2" "rpm" COEFFS 0 1 0 0 0 1 /end COMPU_METHOD
/begin COMPU_METHOD RmpEngN "Rampengradient für Motordrehzahl" RAT_FUNC "%6.4" "rpm/s" COEFFS 0 65.536 0 0 0 1 /end COMPU_METHOD
/begin COMPU_METHOD RmpTemp "Rampengradient für Temperatur" RAT_FUNC "%6.4" "deg C/s" COEFFS 0 655.36 0 0 0 1 /end COMPU_METHOD
/begin COMPU_METHOD RmpTrq "Rampengradient für Motormoment" RAT_FUNC "%6.4" "Nm/s" COEFFS 0 655.36 0 0 0 1 /end COMPU_METHOD
/begin COMPU_METHOD SlopeRes1000 "Umrechnung für Slope: Slopewert mit Verhältnis 0,001" RAT_FUNC "%6.5" "-" COEFFS 0 1000 0 0 0 1 /end COMPU_METHOD
/begin COMPU_METHOD Temp_Cels "Temperatur dargestellt in °C (gleiche interne Darstellung wie Temp_Kelv)" RAT_FUNC "%6.1" "deg C" COEFFS 0 10 2731.4 0 0 1 /end COMPU_METHOD
/begin COMPU_METHOD TimeDeb "Entprellzeit in Millisekunden für Libraryfunktion Debounce" RAT_FUNC "%6.1" "ms" COEFFS 0 0.1 0 0 0 1 /end COMPU_METHOD
/begin COMPU_METHOD Time_ms "Zeit in ms für Fehlerentprellung (DSM) und SW-Timer" RAT_FUNC "%6.1" "ms" COEFFS 0 0.1 0 0 0 1 /end COMPU_METHOD
/begin COMPU_METHOD TransR "Übersetzungsverhältnis (Getriebe etc.)" RAT_FUNC "%6.4" "-" COEFFS 0 100 0 0 0 1 /end COMPU_METHOD
/begin COMPU_METHOD Trq "Motormoment" RAT_FUNC "%6.3" "Nm" COEFFS 0 10 0 0 0 1 /end COMPU_METHOD
/begin COMPU_METHOD TrqDT "zeitlich aufintegriertes Kupplungsmoment" RAT_FUNC "%6.2" "Nm*s" COEFFS 0 1 0 0 0 1 /end COMPU_METHOD
/begin COMPU_METHOD TrqPrp "Vortriebsmoment" RAT_FUNC "%6.3" "Nm" COEFFS 0 5 0 0 0 1 /end COMPU_METHOD
/begin COMPU_METHOD UC_Volt "Hardwarekapselung: Kondensatorspannung fuer MCy330" RAT_FUNC "%6.3" "V" COEFFS 0 10 0 0 0 1 /end COMPU_METHOD
/begin COMPU_METHOD Vel "Fahrzeuggeschwindigkeit, gleiche interne Auflösung wie Vel_SI" RAT_FUNC "%6.4" "km/h" COEFFS 0 100 0 0 0 1 /end COMPU_METHOD
/begin COMPU_METHOD VelToN "Verhältnis Fahrzeuggeschwindigkeit zu Motordrehzahl v/n" RAT_FUNC "%8.7" "(km/h)/rpm" COEFFS 0 100000 0 0 0 1 /end COMPU_METHOD
/begin COMPU_METHOD vfzg_uw_b512 "ME9 Umwandlungen" RAT_FUNC "%6.4" "km/h" COEFFS 0 65536 0 0 0 512 /end COMPU_METHOD
/begin COMPU_METHOD Volt "Spannung in V (von ADC)" RAT_FUNC "%6.2" "mV" COEFFS 0 0.2046 0 0 0 1 /end COMPU_METHOD
/begin RECORD_LAYOUT Kf_Xs16_Ys16_Ws16 NO_AXIS_PTS_X 1 SWORD NO_AXIS_PTS_Y 2 SWORD AXIS_PTS_X 3 SWORD INDEX_INCR DIRECT AXIS_PTS_Y 4 SWORD INDEX_INCR DIRECT FNC_VALUES 5 SWORD COLUMN_DIR DIRECT /end RECORD_LAYOUT
/begin RECORD_LAYOUT Kl_Xs16_Ws16 NO_AXIS_PTS_X 1 SWORD AXIS_PTS_X 2 SWORD INDEX_INCR DIRECT FNC_VALUES 3 SWORD COLUMN_DIR DIRECT /end RECORD_LAYOUT
/begin RECORD_LAYOUT Kwb_Ws16 FNC_VALUES 1 SWORD COLUMN_DIR DIRECT /end RECORD_LAYOUT
/begin RECORD_LAYOUT Kwb_Wu8 FNC_VALUES 1 UBYTE COLUMN_DIR DIRECT /end RECORD_LAYOUT
/begin RECORD_LAYOUT Kw_Ws16 FNC_VALUES 1 SWORD COLUMN_DIR DIRECT /end RECORD_LAYOUT
/begin RECORD_LAYOUT Kw_Ws8 FNC_VALUES 1 SBYTE COLUMN_DIR DIRECT /end RECORD_LAYOUT
/begin RECORD_LAYOUT Kw_Wu16 FNC_VALUES 1 UWORD COLUMN_DIR DIRECT /end RECORD_LAYOUT
/begin RECORD_LAYOUT Kw_Wu32 FNC_VALUES 1 ULONG COLUMN_DIR DIRECT /end RECORD_LAYOUT
/begin RECORD_LAYOUT Kw_Wu8 FNC_VALUES 1 UBYTE COLUMN_DIR DIRECT /end RECORD_LAYOUT
/end MODULE
/end PROJECT
