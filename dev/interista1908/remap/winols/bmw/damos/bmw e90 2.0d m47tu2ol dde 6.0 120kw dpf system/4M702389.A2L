ASAP2_VERSION 1 3
/begin PROJECT P389 "BMW DDE6.0 4-Zylinder V70.2 30.03.2004"
/begin HEADER "" VERSION "V70.2_4Z" PROJECT_NO P389 /end HEADER
/begin MODULE DIM ""
/begin MOD_COMMON "" BYTE_ORDER MSB_FIRST ALIGNMENT_BYTE 1 ALIGNMENT_WORD 2 ALIGNMENT_LONG 4 ALIGNMENT_FLOAT32_IEEE 4 /end MOD_COMMON
/begin CHARACTERISTIC AirCtl_mMaxDvtRgn_MAP "Kennfeld der oberen Grenzen für Erkennung bleibender Regelabweichung" MAP 0xC723C Kf_Xs16_Ys16_Ws16 200.0000 AirMassPerCyl 0.00 200.0000 FORMAT "%8.4" EXTENDED_LIMITS -3276.800 3276.700
 /begin AXIS_DESCR STD_AXIS Eng_nAvrg EngN 8 0.00 6000.000 FORMAT "%8.3" EXTENDED_LIMITS -32768.00 32767.00 DEPOSIT ABSOLUTE /end AXIS_DESCR
 /begin AXIS_DESCR STD_AXIS InjCtl_qCurrCor InjMassCyc 4 0.00 200.0000 FORMAT "%8.4" EXTENDED_LIMITS -327.6800 327.6700 DEPOSIT ABSOLUTE /end AXIS_DESCR
/end CHARACTERISTIC
/begin CHARACTERISTIC AirCtl_mMinDvtRgn_MAP "Kennfeld der unteren Grenzen für Erkennung bleibender Re-gelabweichung" MAP 0xC7298 Kf_Xs16_Ys16_Ws16 200.0000 AirMassPerCyl -200.0000 0.00 FORMAT "%8.4" EXTENDED_LIMITS -3276.800 3276.700
 /begin AXIS_DESCR STD_AXIS Eng_nAvrg EngN 8 0.00 6000.000 FORMAT "%8.3" EXTENDED_LIMITS -32768.00 32767.00 DEPOSIT ABSOLUTE /end AXIS_DESCR
 /begin AXIS_DESCR STD_AXIS InjCtl_qCurrCor InjMassCyc 4 0.00 200.0000 FORMAT "%8.4" EXTENDED_LIMITS -327.6800 327.6700 DEPOSIT ABSOLUTE /end AXIS_DESCR
/end CHARACTERISTIC
/begin CHARACTERISTIC AirCtl_qHiRgn_CUR "Kennlinie fuer obere Hysteresegrenze fuer Abschaltung bei grosser Einspritzmenge Regenerationsbetrieb" CURVE 0xC72F4 Kl_Xs16_Ws16 327.6700 InjMass 0.00 327.6700 FORMAT "%8.4" EXTENDED_LIMITS -327.6800 327.6700
 /begin AXIS_DESCR STD_AXIS Eng_nAvrg EngN 6 0.00 6000.000 FORMAT "%8.3" EXTENDED_LIMITS -32768.00 32767.00 DEPOSIT ABSOLUTE /end AXIS_DESCR
/end CHARACTERISTIC
/begin CHARACTERISTIC AirCtl_qLoRgn_CUR "Kennlinie fuer Hysteresegrenze fuer Abschaltung bei grosser Einspritzmenge Regenerationsbetrieb" CURVE 0xC730E Kl_Xs16_Ws16 327.6700 InjMass 0.00 327.6700 FORMAT "%8.4" EXTENDED_LIMITS -327.6800 327.6700
 /begin AXIS_DESCR STD_AXIS Eng_nAvrg EngN 6 0.00 6000.000 FORMAT "%8.3" EXTENDED_LIMITS -32768.00 32767.00 DEPOSIT ABSOLUTE /end AXIS_DESCR
/end CHARACTERISTIC
/begin CHARACTERISTIC AirCtl_rEGRAdd_Vector "#SSD Bypass-Label für additiven Bypass von AirCtl_rEGR (Nicht verstellen!)" VALUE 0xC30C0 Kw_Wu8 255.0 OneToOne 0.00 255.0 FORMAT "%5.1" /end CHARACTERISTIC
/begin CHARACTERISTIC AirCtl_rEGRAdd_Channel "#SSD Bypass-Label für additiven Bypass von AirCtl_rEGR (Nicht verstellen!)" VALUE 0xC30C1 Kw_Wu8 255.0 OneToOne 0.00 255.0 FORMAT "%5.1" /end CHARACTERISTIC
/begin CHARACTERISTIC AirCtl_rEGR_Vector "#SSD Bypass-Label für AirCtl_rEGR (Nicht verstellen!)" VALUE 0xC30C2 Kw_Wu8 255.0 OneToOne 0.00 255.0 FORMAT "%5.1" /end CHARACTERISTIC
/begin CHARACTERISTIC AirCtl_rEGR_Channel "#SSD Bypass-Label für AirCtl_rEGR (Nicht verstellen!)" VALUE 0xC30C3 Kw_Wu8 255.0 OneToOne 0.00 255.0 FORMAT "%5.1" /end CHARACTERISTIC
/begin CHARACTERISTIC AirCtl_rTVAAdd_Vector "#SSD Bypass-Label für additiven Bypass von AirCtl_rTVA (Nicht verstellen!)" VALUE 0xC30C4 Kw_Wu8 255.0 OneToOne 0.00 255.0 FORMAT "%5.1" /end CHARACTERISTIC
/begin CHARACTERISTIC AirCtl_rTVAAdd_Channel "#SSD Bypass-Label für additiven Bypass von AirCtl_rTVA (Nicht verstellen!)" VALUE 0xC30C5 Kw_Wu8 255.0 OneToOne 0.00 255.0 FORMAT "%5.1" /end CHARACTERISTIC
/begin CHARACTERISTIC AirCtl_rTVADflVal7_C "Vorgabewert 7 fuer Stellgroesse der Drosselklappe (Regeneration)" VALUE 0xC7328 Kw_Ws16 300.0000 Prc -100.0000 200.0000 FORMAT "%8.4" EXTENDED_LIMITS -400.0000 399.9878 /end CHARACTERISTIC
/begin CHARACTERISTIC AirCtl_rTVADflVal8B_C "Vorgabewert 8B wenn TVACD Fehler gesetzt" VALUE 0xC732A Kw_Ws16 300.0000 Prc -100.0000 200.0000 FORMAT "%8.4" EXTENDED_LIMITS -400.0000 399.9878 /end CHARACTERISTIC
/begin CHARACTERISTIC AirCtl_rTVA_Vector "#SSD Bypass-Label für AirCtl_rTVA (Nicht verstellen!)" VALUE 0xC30C6 Kw_Wu8 255.0 OneToOne 0.00 255.0 FORMAT "%5.1" /end CHARACTERISTIC
/begin CHARACTERISTIC AirCtl_rTVA_Channel "#SSD Bypass-Label für AirCtl_rTVA (Nicht verstellen!)" VALUE 0xC30C7 Kw_Wu8 255.0 OneToOne 0.00 255.0 FORMAT "%5.1" /end CHARACTERISTIC
/begin CHARACTERISTIC AirCtl_stMskLoIdl_C "Maskierung zur Verhinderung der Abschaltung der Luftmassenregelung im Leerlauf bei Regenerationsbetrieb" VALUE 0xC732C Kw_Wu32 4294967295.00 OneToOne 0.00 4294967295.00 FORMAT "%13.2" /end CHARACTERISTIC
/begin CHARACTERISTIC AirCtl_stMskOvrRun_C "Maskierung zur Verhinderung der Abschaltung der Luftmassenregelung im Regenerationsbetrieb" VALUE 0xC7330 Kw_Wu32 4294967295.00 OneToOne 0.00 4294967295.00 FORMAT "%13.2" /end CHARACTERISTIC
/begin CHARACTERISTIC AirCtl_stMskQCurRgn_C "Maske für EGT_st zur Umschaltung auf zweite Mengenkurve bei Regeneration" VALUE 0xC7334 Kw_Wu32 4294967295.00 OneToOne 0.00 4294967295.00 FORMAT "%13.2" /end CHARACTERISTIC
/begin CHARACTERISTIC AirCtl_stMskShOffRgn_C "Maske für EGT_st zur Reglerabschaltung bei Regeneration" VALUE 0xC7338 Kw_Wu32 4294967295.00 OneToOne 0.00 4294967295.00 FORMAT "%13.2" /end CHARACTERISTIC
/begin CHARACTERISTIC AirCtl_DebGvnrDvtRgnMaxDef2_C "Entprellwert für Defektwert2 maximale regelabweichung bei Regeneration" VALUE 0xC733C Kw_Wu16 65540.00 TimeDeb 0.00 65540.00 FORMAT "%8.2" EXTENDED_LIMITS 0.00 655350.0 /end CHARACTERISTIC
/begin CHARACTERISTIC AirCtl_DebGvnrDvtRgnMaxOk2_C "Entprellwert für Heilung maximale regelabweichung bei Regeneration2" VALUE 0xC733E Kw_Wu16 65540.00 TimeDeb 0.00 65540.00 FORMAT "%8.2" EXTENDED_LIMITS 0.00 655350.0 /end CHARACTERISTIC
/begin CHARACTERISTIC AirCtl_DebGvnrDvtRgnMaxDef_C "Vorentprellzeit für Erkennung positiver bleibender Regelabweichung in Regeneration" VALUE 0xC7340 Kw_Wu16 65540.00 TimeDeb 0.00 65540.00 FORMAT "%8.2" EXTENDED_LIMITS 0.00 655350.0 /end CHARACTERISTIC
/begin CHARACTERISTIC AirCtl_DebGvnrDvtRgnMaxOk_C "Vorentprellzeit für Heilung bei positiver bleibender Regelabw." VALUE 0xC7342 Kw_Wu16 65540.00 TimeDeb 0.00 65540.00 FORMAT "%8.2" EXTENDED_LIMITS 0.00 655350.0 /end CHARACTERISTIC
/begin CHARACTERISTIC AirCtl_DebGvnrDvtRgnMinDef2_C "Entprellwert für Defektwert2 minimale regelabweichung bei Regeneration" VALUE 0xC7344 Kw_Wu16 65540.00 TimeDeb 0.00 65540.00 FORMAT "%8.2" EXTENDED_LIMITS 0.00 655350.0 /end CHARACTERISTIC
/begin CHARACTERISTIC AirCtl_DebGvnrDvtRgnMinOk2_C "Entprellwert für Heilung minimale regelabweichung bei Regeneration2" VALUE 0xC7346 Kw_Wu16 65540.00 TimeDeb 0.00 65540.00 FORMAT "%8.2" EXTENDED_LIMITS 0.00 655350.0 /end CHARACTERISTIC
/begin CHARACTERISTIC AirCtl_DebGvnrDvtRgnMinDef_C "Vorentprellzeit für Erkennung negativer bleibender Regelabw." VALUE 0xC7348 Kw_Wu16 65540.00 TimeDeb 0.00 65540.00 FORMAT "%8.2" EXTENDED_LIMITS 0.00 655350.0 /end CHARACTERISTIC
/begin CHARACTERISTIC AirCtl_DebGvnrDvtRgnMinOk_C "Vorentprellzeit für Heilung bei negativer bleibender Regelabw." VALUE 0xC734A Kw_Wu16 65540.00 TimeDeb 0.00 65540.00 FORMAT "%8.2" EXTENDED_LIMITS 0.00 655350.0 /end CHARACTERISTIC
/begin CHARACTERISTIC AltCD_dcycLoadPwmInMin_C "SRC-low des gemessenen TV des Generatorsignals" VALUE 0xC7360 Kw_Ws16 100.0000 DtyCyc 0.00 100.0000 FORMAT "%8.4" EXTENDED_LIMITS -327.6800 327.6700 /end CHARACTERISTIC
/begin CHARACTERISTIC AltCD_tiDebErrSigNeg_C "Entprellzeit für die negative Flanke des Generatorlastsignals (Klemme 61)" VALUE 0xC7362 Kw_Wu16 2000.000 TimeDeb 0.00 2000.000 FORMAT "%8.3" EXTENDED_LIMITS 0.00 655350.0 /end CHARACTERISTIC
/begin CHARACTERISTIC AltCD_tiDebErrSigPos_C "Entprellzeit für die positive Flanke des Generatorlastsignals (Klemme 61)" VALUE 0xC7364 Kw_Wu16 2000.000 TimeDeb 0.00 2000.000 FORMAT "%8.3" EXTENDED_LIMITS 0.00 655350.0 /end CHARACTERISTIC
/begin CHARACTERISTIC AltCD_tiDebErrSigDef_C "Defektentprellzeit für Generatorfehler Signal (Klemme 61 -> Dfp_AltCD.MAX)" VALUE 0xC7366 Kw_Wu16 655350.0 Time_ms 0.00 655350.0 FORMAT "%8.1" /end CHARACTERISTIC
/begin CHARACTERISTIC AltCD_tiDebErrSigOk_C "Heilungsentprellzeit für Generatorfehler Signal (Klemme 61 -> Dfp_AltCD.MAX)" VALUE 0xC7368 Kw_Wu16 655350.0 Time_ms 0.00 655350.0 FORMAT "%8.1" /end CHARACTERISTIC
/begin CHARACTERISTIC AltCD_tiDebDtyCycMinDef_C "Fehlerentprellzeit bei SRC-LOW des gemessenen TV" VALUE 0xC736A Kw_Wu16 65540.00 Time_ms 0.00 65540.00 FORMAT "%8.2" EXTENDED_LIMITS 0.00 655350.0 /end CHARACTERISTIC
/begin CHARACTERISTIC AltCD_tiDebDtyCycMinOk_C "Heilungsentprellzeit bei SRC-LOW des gemessenen TV" VALUE 0xC736C Kw_Wu16 65540.00 Time_ms 0.00 65540.00 FORMAT "%8.2" EXTENDED_LIMITS 0.00 655350.0 /end CHARACTERISTIC
/begin CHARACTERISTIC AltCD_nDisMonThres_C "threshold engine speed for fading out of error reporting" VALUE 0xC736E Kw_Wu16 6000.000 EngN 0.00 6000.000 FORMAT "%8.3" EXTENDED_LIMITS 0.00 65535.00 /end CHARACTERISTIC
/begin CHARACTERISTIC AltCD_rAltLoadDfl_C "Vorgabewert im Fehlerfall" VALUE 0xC7370 Kw_Ws16 100.0000 Prc 0.00 100.0000 FORMAT "%8.4" EXTENDED_LIMITS -400.0000 399.9878 /end CHARACTERISTIC
/begin CHARACTERISTIC AltCD_rLoadLin_CUR "Kennlinie zur Umrechnung von % TV in % Last" CURVE 0xC7372 Kl_Xs16_Ws16 100.0000 Prc 0.00 100.0000 FORMAT "%8.4" EXTENDED_LIMITS -400.0000 399.9878
 /begin AXIS_DESCR STD_AXIS AltCD_dcycAltLdPT1_mp DtyCyc 25 0.00 100.0000 FORMAT "%8.4" EXTENDED_LIMITS 0.00 655.3500 DEPOSIT ABSOLUTE /end AXIS_DESCR
/end CHARACTERISTIC
/begin CHARACTERISTIC AltCD_uSRCdisXLow_C "Hystereses Batt_u low level" VALUE 0xC73D8 Kw_Ws16 13998.04 Volt_Batt 0.00 13998.04 FORMAT "%8.2" EXTENDED_LIMITS -640625.6 640606.1 /end CHARACTERISTIC
/begin CHARACTERISTIC AltCD_uSRCdisXHigh_C "Hystereses Batt_u high level" VALUE 0xC73DA Kw_Ws16 13998.04 Volt_Batt 0.00 13998.04 FORMAT "%8.2" EXTENDED_LIMITS -640625.6 640606.1 /end CHARACTERISTIC
/begin CHARACTERISTIC AltCD_uSRCdisYLow_C "Hystereses status" VALUE 0xC73DC Kw_Ws16 0.00 OneToOne 0.00 0.00 FORMAT "%8.2" EXTENDED_LIMITS -32768.00 32767.00 READ_ONLY /end CHARACTERISTIC
/begin CHARACTERISTIC AltCD_uSRCdisYHigh_C "Hystereses status" VALUE 0xC73DE Kw_Ws16 0.00 OneToOne 1.000000 1.000000 FORMAT "%8.6" EXTENDED_LIMITS -32768.00 32767.00 READ_ONLY /end CHARACTERISTIC
/begin CHARACTERISTIC AltCD_stDisLmpTst_C "enable/disable lamp test (0... lamp test, 1...real signal)" VALUE 0xC73E0 Kw_Wu8 1.000 OneToOne 0.00 1.000 FORMAT "%5.3" EXTENDED_LIMITS 0.00 255.0 /end CHARACTERISTIC
/begin CHARACTERISTIC AltCD_stLoadPwmInInv_C "Schalter zur Signalinvertierung" VALUE 0xC73E1 Kw_Wu8 1.000 OneToOne 0.00 1.000 FORMAT "%5.3" EXTENDED_LIMITS 0.00 255.0 /end CHARACTERISTIC
/begin CHARACTERISTIC AltCD_stSRCdis_C "Ausblendlabel für Generatorlastsignal" VALUE 0xC73E2 Kw_Wu8 255.0 OneToOne 0.00 255.0 FORMAT "%5.1" /end CHARACTERISTIC
/begin CHARACTERISTIC AltCD_swtErrSigInv_C "Invertierungsparameter, Generatorfehlersignal (Klemme 61) (1: invertiert, 0 nicht invertiert)" VALUE 0xC73E3 Kw_Wu8 1.000 OneToOne 0.00 1.000 FORMAT "%5.3" EXTENDED_LIMITS 0.00 255.0 /end CHARACTERISTIC
/begin CHARACTERISTIC AltCD_swtGenTyp_C "1: Liest Generatortyp und Hersteller vom BSS-Client ein, 0: setzt Generatortyp und Hersteller auf einen Vorgabewert" VALUE 0xC73E4 Kw_Wu8 1.000 dez 0.00 1.000 FORMAT "%5.3" EXTENDED_LIMITS 0.00 255.0 /end CHARACTERISTIC
/begin CHARACTERISTIC AltCD_swtLROff_C "Maximale Load Response Time ins Generatorsteuergerät schreiben (Schalter: 1-->Load Response Ausschaltstatus = 1, 0-->0)" VALUE 0xC73E5 Kw_Wu8 1.000 OneToOne 0.00 1.000 FORMAT "%5.3" EXTENDED_LIMITS 0.00 255.0 /end CHARACTERISTIC
/begin CHARACTERISTIC AltCD_tiAltDead_C "time for alternator control lamp - lamp test" VALUE 0xC73E6 Kw_Wu16 655.3500 Time_s 0.00 655.3500 FORMAT "%8.4" /end CHARACTERISTIC
/begin CHARACTERISTIC AltCD_tiDebDefect_C "Fehlerentprellzeit, Kommunikationsfehler - BSD Schnittstelle" VALUE 0xC73E8 Kw_Wu16 655350.0 Time_ms 0.00 655350.0 FORMAT "%8.1" /end CHARACTERISTIC
/begin CHARACTERISTIC AltCD_tiDebOk_C "Heilungsentprellzeit, Kommunikationsfehler - BSD Schnittstelle" VALUE 0xC73EA Kw_Wu16 655350.0 Time_ms 0.00 655350.0 FORMAT "%8.1" /end CHARACTERISTIC
/begin CHARACTERISTIC AltCD_tiDisErrMon_C "time for fading out the error monitoring of terminal 61 (alternator error)" VALUE 0xC73EC Kw_Wu16 655.3500 Time_s 0.00 655.3500 FORMAT "%8.4" /end CHARACTERISTIC
/begin CHARACTERISTIC AltCD_tiLRMax_C "Load Response Time, Maximumwert für SRC" VALUE 0xC73EE Kw_Wu16 9.000000 Time_s 0.00 9.000000 FORMAT "%8.6" EXTENDED_LIMITS 0.00 655.3500 /end CHARACTERISTIC
/begin CHARACTERISTIC AltCD_tiLRMin_C "Load Response Time, Mimimumwert für SRC" VALUE 0xC73F0 Kw_Wu16 9.000000 Time_s 0.00 9.000000 FORMAT "%8.6" EXTENDED_LIMITS 0.00 655.3500 /end CHARACTERISTIC
/begin CHARACTERISTIC AltCD_tiOutput_C "Zeit zwischen 2 Ausgaben zum Generator mit BSD Schnittstelle" VALUE 0xC73F2 Kw_Wu16 480.0000 Time_ms 20.00000 500.0000 FORMAT "%8.4" EXTENDED_LIMITS 0.00 655350.0 /end CHARACTERISTIC
/begin CHARACTERISTIC AltCD_tiPT1_C "Filter des gemessenen TV" VALUE 0xC73F4 Kw_Wu32 4294967.3 TimeDelay_ms 0.0010000000 4294967.3 FORMAT "%9.1" /end CHARACTERISTIC
/begin CHARACTERISTIC AltCD_tiReset_C "Regenerierzeit der BSD Schnittstelle nach einem Kommunikationsfehler mit dem Generator" VALUE 0xC73F8 Kw_Wu16 1980.000 Time_ms 20.00000 2000.000 FORMAT "%8.3" EXTENDED_LIMITS 0.00 655350.0 /end CHARACTERISTIC
/begin CHARACTERISTIC AltCD_uAltMax_C "Maximalwert für Generatorspannungs-Sollwerts" VALUE 0xC73FA Kw_Ws16 6197.458 Volt_Batt 10694.04 16891.50 FORMAT "%8.2" EXTENDED_LIMITS -640625.6 640606.1 /end CHARACTERISTIC
/begin CHARACTERISTIC AltCD_uAltMin_C "Minimalwert für Generatorspannungs-Sollwerts" VALUE 0xC73FC Kw_Ws16 6197.458 Volt_Batt 10694.04 16891.50 FORMAT "%8.2" EXTENDED_LIMITS -640625.6 640606.1 /end CHARACTERISTIC
/begin CHARACTERISTIC Alt_facTrans_C "Faktor fuer Kennlinieneingang Berechnung Leistungsbedarf" VALUE 0xC734C Kw_Ws16 65.53500 SlopeRes1000 -32.76800 32.76700 FORMAT "%8.5" /end CHARACTERISTIC
/begin CHARACTERISTIC Alt_pwrBas_CUR "Kennlinie Leistungsbedarfberechnung" CURVE 0xC734E Kl_Xs16_Ws16 300000.1 Pwr 0.00 300000.1 FORMAT "%8.1" EXTENDED_LIMITS -308831.1 308821.7
 /begin AXIS_DESCR STD_AXIS Alt_n_mp EngN 2 0.00 32767.00 FORMAT "%8.2" EXTENDED_LIMITS -32768.00 32767.00 DEPOSIT ABSOLUTE /end AXIS_DESCR
/end CHARACTERISTIC
/begin CHARACTERISTIC Alt_pwrDes_Vector "#SSD Bypass Label, nicht ändern!" VALUE 0xC30C8 Kw_Wu8 255.0 OneToOne 0.00 255.0 FORMAT "%5.1" /end CHARACTERISTIC
/begin CHARACTERISTIC Alt_pwrDes_Channel "#SSD Bypass Label, nicht ändern!" VALUE 0xC30C9 Kw_Wu8 255.0 OneToOne 0.00 255.0 FORMAT "%5.1" /end CHARACTERISTIC
/begin CHARACTERISTIC Alt_pwrOffs_C "Offset fuer Leistungsbedarf Generator" VALUE 0xC7358 Kw_Ws16 300000.1 Pwr 0.00 300000.1 FORMAT "%8.1" EXTENDED_LIMITS -308831.1 308821.7 /end CHARACTERISTIC
/begin CHARACTERISTIC Alt_rAdjValDef_C "Standardwert für Abgleich Leistungsanforderung Generator" VALUE 0xC735A Kw_Ws16 0.00 Fact 1.000000 1.000000 FORMAT "%8.6" EXTENDED_LIMITS -4.000000 3.999878 /end CHARACTERISTIC
/begin CHARACTERISTIC Alt_rAdjValMax_C "Maximalwert für Abgleich Leistungsanforderung Generator" VALUE 0xC735C Kw_Ws16 3.199951 Fact 0.00 3.199951 FORMAT "%8.6" EXTENDED_LIMITS -4.000000 3.999878 /end CHARACTERISTIC
/begin CHARACTERISTIC Alt_rAdjValMin_C "Minimalwert für Abgleich Leistungsanforderung Generator" VALUE 0xC735E Kw_Ws16 3.199951 Fact 0.00 3.199951 FORMAT "%8.6" EXTENDED_LIMITS -4.000000 3.999878 /end CHARACTERISTIC
/begin CHARACTERISTIC AOHtCD_ctPwrStgOnMax_C "Maximaler Zähler für Powerstage On im Fehlerfall" VALUE 0xC74A4 Kw_Wu16 65535.00 OneToOne 0.00 65535.00 FORMAT "%8.2" /end CHARACTERISTIC
/begin CHARACTERISTIC AOHtCD_tiDebAOHtDia1Def_C "Fehlerentprellzeit für Kühlwasserheizungs Diagnose erstes Zeitfenster" VALUE 0xC74A6 Kw_Wu16 655350.0 Time_ms 0.00 655350.0 FORMAT "%8.1" /end CHARACTERISTIC
/begin CHARACTERISTIC AOHtCD_tiDebAOHtDia1Ok_C "Fehlerheilzeit für Kühlwasserheizungs Diagnose erstes Zeitfenster" VALUE 0xC74A8 Kw_Wu16 655350.0 Time_ms 0.00 655350.0 FORMAT "%8.1" /end CHARACTERISTIC
/begin CHARACTERISTIC AOHtCD_tiDebAOHtDia2Def_C "Fehlerentprellzeit für Kühlwasserheizungs Diagnose zweites Zeitfenster" VALUE 0xC74AA Kw_Wu16 655350.0 Time_ms 0.00 655350.0 FORMAT "%8.1" /end CHARACTERISTIC
/begin CHARACTERISTIC AOHtCD_tiDebAOHtDia2Ok_C "Fehlerheilzeit für Kühlwasserheizungs Diagnose zweites Zeitfenster" VALUE 0xC74AC Kw_Wu16 655350.0 Time_ms 0.00 655350.0 FORMAT "%8.1" /end CHARACTERISTIC
/begin CHARACTERISTIC AOHtCD_tiDebAOHtDia3Def_C "Fehlerentprellzeit für Kühlwasserheizungs Diagnose drittes Zeitfenster" VALUE 0xC74AE Kw_Wu16 655350.0 Time_ms 0.00 655350.0 FORMAT "%8.1" /end CHARACTERISTIC
/begin CHARACTERISTIC AOHtCD_tiDebAOHtDia3Ok_C "Fehlerheilzeit für Kühlwasserheizungs Diagnose drittes Zeitfenster" VALUE 0xC74B0 Kw_Wu16 655350.0 Time_ms 0.00 655350.0 FORMAT "%8.1" /end CHARACTERISTIC
/begin CHARACTERISTIC AOHtCD_tiDebExcTempDef_C "Fehlerentprellzeit, Übertemperaturfehler" VALUE 0xC74B2 Kw_Wu16 655350.0 Time_ms 0.00 655350.0 FORMAT "%8.1" /end CHARACTERISTIC
/begin CHARACTERISTIC AOHtCD_tiDebExcTempOk_C "Heilungsentprellzeit, Übertemperaturfehler" VALUE 0xC74B4 Kw_Wu16 655350.0 Time_ms 0.00 655350.0 FORMAT "%8.1" /end CHARACTERISTIC
/begin CHARACTERISTIC AOHtCD_tiDebNoLoadDef_C "Fehlerentprellzeit, Lastabfall" VALUE 0xC74B6 Kw_Wu16 655350.0 Time_ms 0.00 655350.0 FORMAT "%8.1" /end CHARACTERISTIC
/begin CHARACTERISTIC AOHtCD_tiDebNoLoadOk_C "Heilungsentprellzeit, Lastabfall" VALUE 0xC74B8 Kw_Wu16 655350.0 Time_ms 0.00 655350.0 FORMAT "%8.1" /end CHARACTERISTIC
/begin CHARACTERISTIC AOHtCD_tiDebPos_C "Entprellzeit für positive Flanke Eingangssignal 'Zuheizer Aus'" VALUE 0xC74BA Kw_Wu16 2000.000 TimeDeb 0.00 2000.000 FORMAT "%8.3" EXTENDED_LIMITS 0.00 655350.0 /end CHARACTERISTIC
/begin CHARACTERISTIC AOHtCD_tiDebNeg_C "Entprellzeit für negative Flanke Eingangssignal 'Zuheizer Aus'" VALUE 0xC74BC Kw_Wu16 2000.000 TimeDeb 0.00 2000.000 FORMAT "%8.3" EXTENDED_LIMITS 0.00 655350.0 /end CHARACTERISTIC
/begin CHARACTERISTIC AOHtCD_tiDebShortCircBatDef_C "Fehlerentprellzeit, Kurzschluß Batterie" VALUE 0xC74BE Kw_Wu16 655350.0 Time_ms 0.00 655350.0 FORMAT "%8.1" /end CHARACTERISTIC
/begin CHARACTERISTIC AOHtCD_tiDebShortCircBatOk_C "Heilungsentprellzeit, Kurzschluß Batterie" VALUE 0xC74C0 Kw_Wu16 655350.0 Time_ms 0.00 655350.0 FORMAT "%8.1" /end CHARACTERISTIC
/begin CHARACTERISTIC AOHtCD_tiDebShortCircGndDef_C "Fehlerentprellzeit, Kurzschluß nach Masse" VALUE 0xC74C2 Kw_Wu16 655350.0 Time_ms 0.00 655350.0 FORMAT "%8.1" /end CHARACTERISTIC
/begin CHARACTERISTIC AOHtCD_tiDebShortCircGndOk_C "Heilungsentprellzeit, Kurzschluß nach Masse" VALUE 0xC74C4 Kw_Wu16 655350.0 Time_ms 0.00 655350.0 FORMAT "%8.1" /end CHARACTERISTIC
/begin CHARACTERISTIC AOHtCD_numDia_C "#SSD Parameter für Hardware Diagnose-Pin Auswahl" VALUE 0xC74C6 Kw_Wu8 27.0000000000 NumPinDia 0.00 27.0000000000 FORMAT "%13.10" /end CHARACTERISTIC
/begin CHARACTERISTIC AOHtCD_numDioIn_C "#SSD Applikationsparameter fuer hardware-Pin Auswahl Eingangssignal 'Zuheizer Aus'" VALUE 0xC74C7 Kw_Wu8 14.0000000000 NumPinDioIn 0.00 14.0000000000 FORMAT "%13.10" /end CHARACTERISTIC
/begin CHARACTERISTIC AOHtCD_numPwmOut_C "#SSD Parameter für Hardware Endstufen-Pin Auswahl" VALUE 0xC74C8 Kw_Wu8 13.0000000000 NumPinPwmOut 0.00 13.0000000000 FORMAT "%13.10" /end CHARACTERISTIC
/begin CHARACTERISTIC AOHtCD_stInvOut_C "Invertierungsparameter der PWM-Endstufe" VALUE 0xC74CA Kw_Wu8 1.000 OneToOne 0.00 1.000 FORMAT "%5.3" EXTENDED_LIMITS 0.00 255.0 /end CHARACTERISTIC
/begin CHARACTERISTIC AOHtCD_tiPer_C "Periodendauer der PWM-Endstufe" VALUE 0xC74CC Kw_Ws16 6553.500 Period -3276.800 3276.700 FORMAT "%8.3" /end CHARACTERISTIC
/begin CHARACTERISTIC AOHtCD_rOutMax_C "Maximum-Wert, Ausgangstastverhältnis" VALUE 0xC74CE Kw_Ws16 655.3500 DtyCyc -327.6800 327.6700 FORMAT "%8.4" /end CHARACTERISTIC
/begin CHARACTERISTIC AOHtCD_rOutMin_C "Minimumwert des Ausgangstastverhältnisses" VALUE 0xC74D0 Kw_Ws16 655.3500 DtyCyc -327.6800 327.6700 FORMAT "%8.4" /end CHARACTERISTIC
/begin CHARACTERISTIC AOHtCD_stPwrStgActv_C "Statuswort zur Aktivierung der Abschaltbedingung für die Zuheizer Endstufe" VALUE 0xC74D2 Kw_Wu8 255.0 OneToOne 0.00 255.0 FORMAT "%5.1" /end CHARACTERISTIC
/begin CHARACTERISTIC AOHtCD_stPwrStgDia_C "Statuswort zur Aktivierung der Abschaltbedingung der Endstufendiagnose für Zuheizer1" VALUE 0xC74D3 Kw_Wu8 255.0 OneToOne 0.00 255.0 FORMAT "%5.1" /end CHARACTERISTIC
/begin CHARACTERISTIC AOHtCD_stSPICtl_C "Schalter ob Endstufe SPI kontrollierbar = 1 oder nicht SPI kontrollierbar = 0" VALUE 0xC74D4 Kw_Wu8 1.000 OneToOne 0.00 1.000 FORMAT "%5.3" EXTENDED_LIMITS 0.00 255.0 /end CHARACTERISTIC
/begin CHARACTERISTIC AOHtCD_swtBattCorr_C "Zuschaltung der Batteriespannungskorrektur (1: zugeschaltet, 0: abgeschaltet)" VALUE 0xC74D5 Kw_Wu8 255.0 OneToOne 0.00 255.0 FORMAT "%5.1" /end CHARACTERISTIC
/begin CHARACTERISTIC AOHtCD_swtInv_C "Invertierungsparamter des Digitaleingangs (Heizleistungsanforderung) (1: invertieren, 0 : nicht invertieren)" VALUE 0xC74D6 Kw_Wu8 1.000 OneToOne 0.00 1.000 FORMAT "%5.3" EXTENDED_LIMITS 0.00 255.0 /end CHARACTERISTIC
/begin CHARACTERISTIC AOHtCD_tiBtwTst_C "Zeitabstand, in dem die Endstufe im Fehlerfall getestet wird" VALUE 0xC74D8 Kw_Wu16 29980.00 Time_ms 20.00000 30000.00 FORMAT "%8.2" EXTENDED_LIMITS 0.00 655350.0 /end CHARACTERISTIC
/begin CHARACTERISTIC AOHtCD_tiDiag1Max_C "Maximum des ersten Signalfensters für Fehlersignale des Kühlwasserheizung-SG" VALUE 0xC74DA Kw_Wu16 655350.0 Time_ms 0.00 655350.0 FORMAT "%8.1" /end CHARACTERISTIC
/begin CHARACTERISTIC AOHtCD_tiDiag1Min_C "Minimum des ersten Signalfensters für Fehlersignale des Kühlwasserheizung-SG" VALUE 0xC74DC Kw_Wu16 655350.0 Time_ms 0.00 655350.0 FORMAT "%8.1" /end CHARACTERISTIC
/begin CHARACTERISTIC AOHtCD_tiDiag2Max_C "Maximum des zweiten Signalfensters für Fehlersignale des Kühlwasserheizung-SG" VALUE 0xC74DE Kw_Wu16 655350.0 Time_ms 0.00 655350.0 FORMAT "%8.1" /end CHARACTERISTIC
/begin CHARACTERISTIC AOHtCD_tiDiag2Min_C "Minimum des zweiten Signalfensters für Fehlersignale des Kühlwasserheizung-SG" VALUE 0xC74E0 Kw_Wu16 655350.0 Time_ms 0.00 655350.0 FORMAT "%8.1" /end CHARACTERISTIC
/begin CHARACTERISTIC AOHtCD_tiDiag3Max_C "Maximum des dritten Signalfensters für Fehlersignale des Kühlwasserheizung-SG" VALUE 0xC74E2 Kw_Wu16 655350.0 Time_ms 0.00 655350.0 FORMAT "%8.1" /end CHARACTERISTIC
/begin CHARACTERISTIC AOHtCD_tiDiag3Min_C "Minimum des dritten Signalfensters für Fehlersignale des Kühlwasserheizung-SG" VALUE 0xC74E4 Kw_Wu16 655350.0 Time_ms 0.00 655350.0 FORMAT "%8.1" /end CHARACTERISTIC
/begin CHARACTERISTIC AOHtCD_tiPwrStgOn_C "Zeit für welche die Endstufe im Fehlerfall eingeschalten wird (nur nicht SPI kontrolliert)" VALUE 0xC74E6 Kw_Wu16 655140.0 Time_ms 0.00 655140.0 FORMAT "%8.1" EXTENDED_LIMITS 0.00 655350.0 /end CHARACTERISTIC
/begin CHARACTERISTIC AOHt_IKi_C "I-Parameter wenn Reglerabweichung innerhalb der Kleinsignalgrenzen" VALUE 0xC7400 Kw_Wu32 5.00003807247 Ki 0.00 5.00003807247 FORMAT "%13.11" EXTENDED_LIMITS 0.00 999999.999767 /end CHARACTERISTIC
/begin CHARACTERISTIC AOHt_IKiPos_C "I-Parameter wenn die Regelabweichung über den Kleinsignalgrenzen liegt" VALUE 0xC7404 Kw_Wu32 5.00003807247 Ki 0.00 5.00003807247 FORMAT "%13.11" EXTENDED_LIMITS 0.00 999999.999767 /end CHARACTERISTIC
/begin CHARACTERISTIC AOHt_IKiNeg_C "I-Parameter wenn die Regelabweichung unter den Kleinsignalgrenzen liegt" VALUE 0xC7408 Kw_Wu32 5.00003807247 Ki 0.00 5.00003807247 FORMAT "%13.11" EXTENDED_LIMITS 0.00 999999.999767 /end CHARACTERISTIC
/begin CHARACTERISTIC AOHt_rIWinPos_C "positive Fenstergrenze des PI-Reglers" VALUE 0xC740C Kw_Ws16 100.0000 DtyCyc 0.00 100.0000 FORMAT "%8.4" EXTENDED_LIMITS -327.6800 327.6700 /end CHARACTERISTIC
/begin CHARACTERISTIC AOHt_rIWinNeg_C "negative Fenstergrenze des PI-Reglers" VALUE 0xC740E Kw_Ws16 0.00 DtyCyc 0.00 0.00 FORMAT "%8.2" EXTENDED_LIMITS -327.6800 327.6700 /end CHARACTERISTIC
/begin CHARACTERISTIC AOHt_nACEngXHigh_C "oberer Grenzwert für Motordrehzahl" VALUE 0xC7410 Kw_Ws16 6000.000 EngN 0.00 6000.000 FORMAT "%8.3" EXTENDED_LIMITS -32768.00 32767.00 /end CHARACTERISTIC
/begin CHARACTERISTIC AOHt_nACEngXLow_C "unterer Grenzwert für Motordrehzahl" VALUE 0xC7412 Kw_Ws16 6000.000 EngN 0.00 6000.000 FORMAT "%8.3" EXTENDED_LIMITS -32768.00 32767.00 /end CHARACTERISTIC
/begin CHARACTERISTIC AOHt_nAvrgHysMin_C "untere Hysterese-Schwelle für Motordrehzahlhysterese" VALUE 0xC7414 Kw_Ws16 5960.000 EngN 40.00000 6000.000 FORMAT "%8.3" EXTENDED_LIMITS -32768.00 32767.00 /end CHARACTERISTIC
/begin CHARACTERISTIC AOHt_nAvrgHysMax_C "oberere Hysterese-Schwelle für Motordrehzahlhysterese" VALUE 0xC7416 Kw_Ws16 5960.000 EngN 40.00000 6000.000 FORMAT "%8.3" EXTENDED_LIMITS -32768.00 32767.00 /end CHARACTERISTIC
/begin CHARACTERISTIC AOHt_stNAvrgShutOffEn_C "Abschaltbedingung wenn untere Drehzahlschwelle unterschritten" VALUE 0xC7418 Kw_Ws16 65535.00 OneToOne -32768.00 32767.00 FORMAT "%8.2" READ_ONLY /end CHARACTERISTIC
/begin CHARACTERISTIC AOHt_stNAvrgShutOffDis_C "Abschaltbedingung nicht erfuellt" VALUE 0xC741A Kw_Ws16 65535.00 OneToOne -32768.00 32767.00 FORMAT "%8.2" READ_ONLY /end CHARACTERISTIC
/begin CHARACTERISTIC AOHt_nDAEng_C "Engine speed threshold for drive away condition" VALUE 0xC741C Kw_Ws16 6000.000 EngN 0.00 6000.000 FORMAT "%8.3" EXTENDED_LIMITS -32768.00 32767.00 /end CHARACTERISTIC
/begin CHARACTERISTIC AOHt_nMin_C "#SSD Leerlaufanhebung bei Zuheizung" VALUE 0xC741E Kw_Ws16 500.0000 EngN 0.00 500.0000 FORMAT "%8.4" EXTENDED_LIMITS -32768.00 32767.00 /end CHARACTERISTIC
/begin CHARACTERISTIC AOHt_PKp_C "P-Parameter wenn die Regelabweichung innerhalb der Kleinsignalgrenzen liegt" VALUE 0xC7420 Kw_Wu32 10.0000000000 Kp 0.00 10.0000000000 FORMAT "%13.10" EXTENDED_LIMITS 0.00 65535.9999847 /end CHARACTERISTIC
/begin CHARACTERISTIC AOHt_PKpPos_C "I-Parameter wenn die Regelabweichung über den Kleinsignalgrenzen liegt" VALUE 0xC7424 Kw_Wu32 10.0000000000 Kp 0.00 10.0000000000 FORMAT "%13.10" EXTENDED_LIMITS 0.00 65535.9999847 /end CHARACTERISTIC
/begin CHARACTERISTIC AOHt_PKpNeg_C "P-Parameter wenn die Regelabweichung unter den Kleinsignalgrenzen liegt" VALUE 0xC7428 Kw_Wu32 10.0000000000 Kp 0.00 10.0000000000 FORMAT "%13.10" EXTENDED_LIMITS 0.00 65535.9999847 /end CHARACTERISTIC
/begin CHARACTERISTIC AOHt_rPWinPos_C "positive Fenstergrenzen des PI-Reglers für P-Parameterauswahl" VALUE 0xC742C Kw_Ws16 100.0000 DtyCyc 0.00 100.0000 FORMAT "%8.4" EXTENDED_LIMITS -327.6800 327.6700 /end CHARACTERISTIC
/begin CHARACTERISTIC AOHt_rPWinNeg_C "negative Fenstergrenze des PI-Reglers für P-Parameterauswahl" VALUE 0xC742E Kw_Ws16 0.00 DtyCyc 0.00 0.00 FORMAT "%8.2" EXTENDED_LIMITS -327.6800 327.6700 /end CHARACTERISTIC
/begin CHARACTERISTIC AOHt_rHtgOutMax_C "Maximal-Tastverhältnis am PI-Regler Ausgang" VALUE 0xC7430 Kw_Ws16 100.0000 DtyCyc 0.00 100.0000 FORMAT "%8.4" EXTENDED_LIMITS -327.6800 327.6700 /end CHARACTERISTIC
/begin CHARACTERISTIC AOHt_rHtgOutMin_C "Maximal-Tastverhältnis am PI-Regler Ausgang" VALUE 0xC7432 Kw_Ws16 100.0000 DtyCyc 0.00 100.0000 FORMAT "%8.4" EXTENDED_LIMITS -327.6800 327.6700 /end CHARACTERISTIC
/begin CHARACTERISTIC AOHt_rHtgOut_Vector "#SSD Bypass label for additive bypass of AOHt_rHtgOut" VALUE 0xC30CA Kw_Wu8 255.0 OneToOne 0.00 255.0 FORMAT "%5.1" /end CHARACTERISTIC
/begin CHARACTERISTIC AOHt_rHtgOut_Channel "#SSD Bypass label for additive bypass of AOHt_rHtgOut" VALUE 0xC30CB Kw_Wu8 255.0 OneToOne 0.00 255.0 FORMAT "%5.1" /end CHARACTERISTIC
/begin CHARACTERISTIC AOHt_rIDef_C "Vorgabewert des I-Anteils im Abschaltfall" VALUE 0xC7434 Kw_Ws16 100.0000 DtyCyc 0.00 100.0000 FORMAT "%8.4" EXTENDED_LIMITS -327.6800 327.6700 /end CHARACTERISTIC
/begin CHARACTERISTIC AOHt_rNAvrg_CUR "Motordrehzahl Umrechungskennlinie" CURVE 0xC7436 Kl_Xs16_Ws16 100.0000 DtyCyc 0.00 100.0000 FORMAT "%8.4" EXTENDED_LIMITS -327.6800 327.6700
 /begin AXIS_DESCR STD_AXIS Eng_nAvrg EngN 2 0.00 6000.000 FORMAT "%8.3" EXTENDED_LIMITS -32768.00 32767.00 DEPOSIT ABSOLUTE /end AXIS_DESCR
/end CHARACTERISTIC
/begin CHARACTERISTIC AOHt_stACAccPedXLow_C "Unterer Grenzwert für   APPCD_drAPP1UnFlt-hysterese" VALUE 0xC7440 Kw_Ws16 39997.56 PrcPerSec -19998.78 19998.78 FORMAT "%8.2" EXTENDED_LIMITS -20000.00 19999.39 /end CHARACTERISTIC
/begin CHARACTERISTIC AOHt_stACAccPedXHigh_C "Oberer Grenzwert für  APPCD_drAPP1UnFlt-Hysterese" VALUE 0xC7442 Kw_Ws16 39997.56 PrcPerSec -19998.78 19998.78 FORMAT "%8.2" EXTENDED_LIMITS -20000.00 19999.39 /end CHARACTERISTIC
/begin CHARACTERISTIC AOHt_stACAccPedYLow_C "Ausgangswert der Hysterese für kleine Werte von  APPCD_drAPP1UnFlt (0 oder 1)" VALUE 0xC7444 Kw_Ws16 1.000000 OneToOne 0.00 1.000000 FORMAT "%8.6" EXTENDED_LIMITS -32768.00 32767.00 /end CHARACTERISTIC
/begin CHARACTERISTIC AOHt_stACAccPedYHigh_C "Ausganswert der Hysterese für große Werte von  APPCD_drAPP1UnFlt (0 oder 1)" VALUE 0xC7446 Kw_Ws16 1.000000 OneToOne 0.00 1.000000 FORMAT "%8.6" EXTENDED_LIMITS -32768.00 32767.00 /end CHARACTERISTIC
/begin CHARACTERISTIC AOHt_stACEngXLow_C "Unterer Grenzwert für Eng_nAvrg - Hysterese" VALUE 0xC7448 Kw_Ws16 20000.00 EngN -10000.00 10000.00 FORMAT "%8.2" EXTENDED_LIMITS -32768.00 32767.00 /end CHARACTERISTIC
/begin CHARACTERISTIC AOHt_stACEngXHigh_C "Oberer Grenzwert für Eng_nAvrg - Hysterese" VALUE 0xC744A Kw_Ws16 20000.00 EngN -10000.00 10000.00 FORMAT "%8.2" EXTENDED_LIMITS -32768.00 32767.00 /end CHARACTERISTIC
/begin CHARACTERISTIC AOHt_stACEngYLow_C "Ausgangswert der Hysterese für kleine Werte von Eng_nAvrg" VALUE 0xC744C Kw_Ws16 1.000000 OneToOne 0.00 1.000000 FORMAT "%8.6" EXTENDED_LIMITS -32768.00 32767.00 /end CHARACTERISTIC
/begin CHARACTERISTIC AOHt_stACEngYHigh_C "Ausgangswert der Hysterese für große Werte von Eng_nAvrg (0 oder 1)" VALUE 0xC744E Kw_Ws16 1.000000 OneToOne 0.00 1.000000 FORMAT "%8.6" EXTENDED_LIMITS -32768.00 32767.00 /end CHARACTERISTIC
/begin CHARACTERISTIC AOHt_stACVehXLow_C "unterer Grenzwert für VSSCD_v - Hysterese" VALUE 0xC7450 Kw_Ws16 600.0000 Vel -300.0000 300.0000 FORMAT "%8.4" EXTENDED_LIMITS -327.6800 327.6700 /end CHARACTERISTIC
/begin CHARACTERISTIC AOHt_stACVehXHigh_C "Oberer Grenzwert für VSSCD_v - Hysterese" VALUE 0xC7452 Kw_Ws16 600.0000 Vel -300.0000 300.0000 FORMAT "%8.4" EXTENDED_LIMITS -327.6800 327.6700 /end CHARACTERISTIC
/begin CHARACTERISTIC AOHt_stACVehYLow_C "Ausgangswert der Hysterese für kleine Werte von VSSCD_v (0 oder 1)" VALUE 0xC7454 Kw_Ws16 1.000000 OneToOne 0.00 1.000000 FORMAT "%8.6" EXTENDED_LIMITS -32768.00 32767.00 /end CHARACTERISTIC
/begin CHARACTERISTIC AOHt_stACVehYHigh_C "Ausgangswert der Hysterese für große Werte von VSSCD_v (0 oder 1)" VALUE 0xC7456 Kw_Ws16 1.000000 OneToOne 0.00 1.000000 FORMAT "%8.6" EXTENDED_LIMITS -32768.00 32767.00 /end CHARACTERISTIC
/begin CHARACTERISTIC AOHt_stDAAccPedXLow_C "Unterer Grenzwert für APPCD_rFlt - Hysterese" VALUE 0xC7458 Kw_Ws16 100.0000 Prc 0.00 100.0000 FORMAT "%8.4" EXTENDED_LIMITS -400.0000 399.9878 /end CHARACTERISTIC
/begin CHARACTERISTIC AOHt_stDAAccPedXHigh_C "Oberer Grenzwert für APPCD_rFlt - Hysterese" VALUE 0xC745A Kw_Ws16 100.0000 Prc 0.00 100.0000 FORMAT "%8.4" EXTENDED_LIMITS -400.0000 399.9878 /end CHARACTERISTIC
/begin CHARACTERISTIC AOHt_stDAAccPedYLow_C "Ausgangswert der Hysterese für kleine Werte von APPCD_rFlt (0 oder 1)" VALUE 0xC745C Kw_Ws16 1.000000 OneToOne 0.00 1.000000 FORMAT "%8.6" EXTENDED_LIMITS -32768.00 32767.00 /end CHARACTERISTIC
/begin CHARACTERISTIC AOHt_stDAAccPedYHigh_C "Ausgangswert der Hysterese für große Werte von APPCD_rFlt (0 oder 1)" VALUE 0xC745E Kw_Ws16 1.000000 OneToOne 0.00 1.000000 FORMAT "%8.6" EXTENDED_LIMITS -32768.00 32767.00 /end CHARACTERISTIC
/begin CHARACTERISTIC AOHt_stDAEngXLow_C "Unterer Grenzwert für Eng_nAvrg - Hysterese" VALUE 0xC7460 Kw_Ws16 20000.00 EngN -10000.00 10000.00 FORMAT "%8.2" EXTENDED_LIMITS -32768.00 32767.00 /end CHARACTERISTIC
/begin CHARACTERISTIC AOHt_stDAEngXHigh_C "Oberer Grenzwert für Eng_nAvrg - Hysterese" VALUE 0xC7462 Kw_Ws16 20000.00 EngN -10000.00 10000.00 FORMAT "%8.2" EXTENDED_LIMITS -32768.00 32767.00 /end CHARACTERISTIC
/begin CHARACTERISTIC AOHt_stDAEngYLow_C "Ausgangswert der Hysterese für kleine Werte von Eng_nAvrg (0 oder 1)" VALUE 0xC7464 Kw_Ws16 1.000000 OneToOne 0.00 1.000000 FORMAT "%8.6" EXTENDED_LIMITS -32768.00 32767.00 /end CHARACTERISTIC
/begin CHARACTERISTIC AOHt_stDAEngYHigh_C "Ausgangswert der Hysterese für große Werte von Eng_nAvrg (0 oder 1)" VALUE 0xC7466 Kw_Ws16 1.000000 OneToOne 0.00 1.000000 FORMAT "%8.6" EXTENDED_LIMITS -32768.00 32767.00 /end CHARACTERISTIC
/begin CHARACTERISTIC AOHt_stDAGearXLow_C "Unterer Grenzwert für Gearbx_stGear - Hysterese" VALUE 0xC7468 Kw_Ws16 7.000000 OneToOne -1.000000 6.000000 FORMAT "%8.6" EXTENDED_LIMITS -32768.00 32767.00 /end CHARACTERISTIC
/begin CHARACTERISTIC AOHt_stDAGearXHigh_C "Oberer Grenzwert für Gearbx_stGear - Hysterese" VALUE 0xC746A Kw_Ws16 7.000000 OneToOne -1.000000 6.000000 FORMAT "%8.6" EXTENDED_LIMITS -32768.00 32767.00 /end CHARACTERISTIC
/begin CHARACTERISTIC AOHt_stDAGearYLow_C "Ausgangswert der Hysterese für kleine Werte von Gearbx_stGear (0 oder 1)" VALUE 0xC746C Kw_Ws16 1.000000 OneToOne 0.00 1.000000 FORMAT "%8.6" EXTENDED_LIMITS -32768.00 32767.00 /end CHARACTERISTIC
/begin CHARACTERISTIC AOHt_stDAGearYHigh_C "Ausgangswert der Hysterese für große Werte von Gearbx_stGear (0 oder 1)" VALUE 0xC746E Kw_Ws16 1.000000 OneToOne 0.00 1.000000 FORMAT "%8.6" EXTENDED_LIMITS -32768.00 32767.00 /end CHARACTERISTIC
/begin CHARACTERISTIC AOHt_stDAVehXLow_C "Unterer Grenzwert für VSSCD_v - Hysterese" VALUE 0xC7470 Kw_Ws16 600.0000 Vel -300.0000 300.0000 FORMAT "%8.4" EXTENDED_LIMITS -327.6800 327.6700 /end CHARACTERISTIC
/begin CHARACTERISTIC AOHt_stDAVehXHigh_C "Oberer Grenzwert für VSSCD_v - Hysterese" VALUE 0xC7472 Kw_Ws16 600.0000 Vel -300.0000 300.0000 FORMAT "%8.4" EXTENDED_LIMITS -327.6800 327.6700 /end CHARACTERISTIC
/begin CHARACTERISTIC AOHt_stDAVehYLow_C "Ausgang der Hysterese für kleine Werte von VSSCD_v (0 oder 1)" VALUE 0xC7474 Kw_Ws16 1.000000 OneToOne 0.00 1.000000 FORMAT "%8.6" EXTENDED_LIMITS -32768.00 32767.00 /end CHARACTERISTIC
/begin CHARACTERISTIC AOHt_stDAVehYHigh_C "Ausgangswert der Hysterese für große Werte von VSSCD_v (0 oder 1)" VALUE 0xC7476 Kw_Ws16 1.000000 OneToOne 0.00 1.000000 FORMAT "%8.6" EXTENDED_LIMITS -32768.00 32767.00 /end CHARACTERISTIC
/begin CHARACTERISTIC AOHt_swtHtgActive_C "Schalter zum aktivieren/deaktivieren des Zuheizers (1: Zuheizer aktiv, 0: Zuheizer inaktiv)" VALUE 0xC7478 Kw_Wu8 1.000 OneToOne 0.00 1.000 FORMAT "%5.3" EXTENDED_LIMITS 0.00 255.0 /end CHARACTERISTIC
/begin CHARACTERISTIC AOHt_swtHtgUp_C "Schalter um den Aufheizstatus des Motors zu ändern (0: berechnen, 1: rücksetzen, 2: setzen des Aufheizstatus)" VALUE 0xC7479 Kw_Wu8 2.000 OneToOne 0.00 2.000 FORMAT "%5.3" EXTENDED_LIMITS 0.00 255.0 /end CHARACTERISTIC
/begin CHARACTERISTIC AOHt_tEnvHysDelta_C "Delta-Wert für Kühlmitteltemperaturhysterese" VALUE 0xC747A Kw_Ws16 100.0000 TempDiff_Cels 0.00 100.0000 FORMAT "%8.4" EXTENDED_LIMITS -3276.800 3276.700 /end CHARACTERISTIC
/begin CHARACTERISTIC AOHt_tEnv_CUR "Umgebungstemperatur Umrechnungskennlinie" CURVE 0xC747C Kl_Xs16_Ws16 250.0000 Temp_Cels -50.1400 199.8600 FORMAT "%8.4" EXTENDED_LIMITS -3549.940 3003.560
 /begin AXIS_DESCR STD_AXIS FrmMng_tEnv Temp_Cels 2 -50.1400 199.8600 FORMAT "%8.4" EXTENDED_LIMITS -3549.940 3003.560 DEPOSIT ABSOLUTE /end AXIS_DESCR
/end CHARACTERISTIC
/begin CHARACTERISTIC AOHt_tiACMin_C "Timer für den Beschleunigungs-Fall" VALUE 0xC7486 Kw_Wu16 60000.00 Time_ms 0.00 60000.00 FORMAT "%8.2" EXTENDED_LIMITS 0.00 655350.0 /end CHARACTERISTIC
/begin CHARACTERISTIC AOHt_tiAltPT1_C "PT1 Zeitkonstante für die Generatorlastfilterung" VALUE 0xC7488 Kw_Wu32 4294.9673 TimeDelay_s 0.0000010000000 4294.9673 FORMAT "%9.4" /end CHARACTERISTIC
/begin CHARACTERISTIC AOHt_tiDAMin_C "Timer im Wegfahr-Fall" VALUE 0xC748C Kw_Wu16 60000.00 Time_ms 0.00 60000.00 FORMAT "%8.2" EXTENDED_LIMITS 0.00 655350.0 /end CHARACTERISTIC
/begin CHARACTERISTIC AOHt_tiNAvrgPT1_C "PT1 Zeitkonstante für Motordrehzahlfilterung" VALUE 0xC7490 Kw_Wu32 4294.9673 TimeDelay_s 0.0000010000000 4294.9673 FORMAT "%9.4" /end CHARACTERISTIC
/begin CHARACTERISTIC AOHt_tiStrt_C "Startverzoegerung fuer die Heizleistungssteigerung" VALUE 0xC7494 Kw_Wu16 2000.000 Time_ms 0.00 2000.000 FORMAT "%8.3" EXTENDED_LIMITS 0.00 655350.0 /end CHARACTERISTIC
/begin CHARACTERISTIC AOHt_trqInrLimDelta_C "Delta Torque" VALUE 0xC7496 Kw_Ws16 1500.000 Trq -500.0000 1000.000 FORMAT "%8.3" EXTENDED_LIMITS -3276.800 3276.700 /end CHARACTERISTIC
/begin CHARACTERISTIC AOHt_uBattHysMin_C "untere Hysterese-Schwelle für zu niedrige Batteriespannung" VALUE 0xC7498 Kw_Ws16 28602.15 Volt_Batt 0.00 28602.15 FORMAT "%8.2" EXTENDED_LIMITS -640625.6 640606.1 /end CHARACTERISTIC
/begin CHARACTERISTIC AOHt_uBattHysMax_C "obere Hysterese-Schwelle für zu niedrige Batteriespannung" VALUE 0xC749A Kw_Ws16 28602.15 Volt_Batt 0.00 28602.15 FORMAT "%8.2" EXTENDED_LIMITS -640625.6 640606.1 /end CHARACTERISTIC
/begin CHARACTERISTIC AOHt_stBattShutOffEn_C "Abschaltbedingung erfuellt" VALUE 0xC749C Kw_Ws16 65535.00 OneToOne -32768.00 32767.00 FORMAT "%8.2" READ_ONLY /end CHARACTERISTIC
/begin CHARACTERISTIC AOHt_stBattShutOffDis_C "Abschaltbedingung nicht erfuellt" VALUE 0xC749E Kw_Ws16 65535.00 OneToOne -32768.00 32767.00 FORMAT "%8.2" READ_ONLY /end CHARACTERISTIC
/begin CHARACTERISTIC AOHt_vDAVeh_C "Vehicle speed threshold for drive away condition" VALUE 0xC74A0 Kw_Ws16 300.0000 Vel 0.00 300.0000 FORMAT "%8.4" EXTENDED_LIMITS -327.6800 327.6700 /end CHARACTERISTIC
/begin CHARACTERISTIC APPCD_uAPP1_SRCMin_C "#SSD Spannung SRC-low" VALUE 0xC74E8 Kw_Ws16 5200.391 Volt 0.00 5200.391 FORMAT "%8.3" EXTENDED_LIMITS -160156.4 160151.5 /end CHARACTERISTIC
/begin CHARACTERISTIC APPCD_uAPP1_SRCMax_C "#SSD Spannung SRC-high" VALUE 0xC74EA Kw_Ws16 5200.391 Volt 0.00 5200.391 FORMAT "%8.3" EXTENDED_LIMITS -160156.4 160151.5 /end CHARACTERISTIC
/begin CHARACTERISTIC APPCD_uAPP2_SRCMin_C "#SSD Spannung SRC-low" VALUE 0xC74EC Kw_Ws16 5200.391 Volt 0.00 5200.391 FORMAT "%8.3" EXTENDED_LIMITS -160156.4 160151.5 /end CHARACTERISTIC
/begin CHARACTERISTIC APPCD_uAPP2_SRCMax_C "#SSD Spannung SRC-high" VALUE 0xC74EE Kw_Ws16 5200.391 Volt 0.00 5200.391 FORMAT "%8.3" EXTENDED_LIMITS -160156.4 160151.5 /end CHARACTERISTIC
/begin CHARACTERISTIC APPCD_DebSRCHighDef_C "#SSD Defektzeit SRC-high" VALUE 0xC74F0 Kw_Wu16 655350.0 Time_ms 0.00 655350.0 FORMAT "%8.1" /end CHARACTERISTIC
/begin CHARACTERISTIC APPCD_DebSRCHighOk_C "#SSD Heilungszeit SRC-high" VALUE 0xC74F2 Kw_Wu16 655350.0 Time_ms 0.00 655350.0 FORMAT "%8.1" /end CHARACTERISTIC
/begin CHARACTERISTIC APPCD_DebSRCLowDef_C "#SSD Defektzeit SRC-low" VALUE 0xC74F4 Kw_Wu16 655350.0 Time_ms 0.00 655350.0 FORMAT "%8.1" /end CHARACTERISTIC
/begin CHARACTERISTIC APPCD_DebSRCLowOk_C "#SSD Heilungszeit SRC-low" VALUE 0xC74F6 Kw_Wu16 655350.0 Time_ms 0.00 655350.0 FORMAT "%8.1" /end CHARACTERISTIC
/begin CHARACTERISTIC APPCD_DebSyncDef_C "Entprellzeit Gleichlauffehler APP1/APP2" VALUE 0xC74F8 Kw_Wu16 655350.0 Time_ms 0.00 655350.0 FORMAT "%8.1" /end CHARACTERISTIC
/begin CHARACTERISTIC APPCD_DebSyncOk_C "Heilzeit Gleichlauffehler APP1/APP2" VALUE 0xC74FA Kw_Wu16 655350.0 Time_ms 0.00 655350.0 FORMAT "%8.1" /end CHARACTERISTIC
/begin CHARACTERISTIC APPCD_duAPPJit_C "Groesse des Jitters der APP-Rohspannung der unterdrueckt wird" VALUE 0xC74FC Kw_Ws16 5200.391 Volt 0.00 5200.391 FORMAT "%8.3" EXTENDED_LIMITS -160156.4 160151.5 /end CHARACTERISTIC
/begin CHARACTERISTIC APPCD_facrAPP1APP2_C "Faktor zwischen den Rohspannungen APP1/APP2" VALUE 0xC74FE Kw_Ws16 7.999878 Fact -4.000000 3.999878 FORMAT "%8.6" /end CHARACTERISTIC
/begin CHARACTERISTIC APPCD_rThrFltFDCLowPos_C "upper threshold for filter parameter ""low_pos""" VALUE 0xC7500 Kw_Ws16 100.0000 Prc 0.00 100.0000 FORMAT "%8.4" EXTENDED_LIMITS -400.0000 399.9878 /end CHARACTERISTIC
/begin CHARACTERISTIC APPCD_rThrFltFDCMidPos_C "upper threshold for filter parameter ""mid_neg""" VALUE 0xC7502 Kw_Ws16 100.0000 Prc 0.00 100.0000 FORMAT "%8.4" EXTENDED_LIMITS -400.0000 399.9878 /end CHARACTERISTIC
/begin CHARACTERISTIC APPCD_rThrFltFDCLowNeg_C "upper threshold for filter parameter ""low_neg""" VALUE 0xC7504 Kw_Ws16 100.0000 Prc 0.00 100.0000 FORMAT "%8.4" EXTENDED_LIMITS -400.0000 399.9878 /end CHARACTERISTIC
/begin CHARACTERISTIC APPCD_rThrFltFDCMidNeg_C "upper threshold for filter parameter ""mid_neg""" VALUE 0xC7506 Kw_Ws16 100.0000 Prc 0.00 100.0000 FORMAT "%8.4" EXTENDED_LIMITS -400.0000 399.9878 /end CHARACTERISTIC
/begin CHARACTERISTIC APPCD_tiLowNegFDCPT1_C "APP filter time constant neg. slope low range" VALUE 0xC7508 Kw_Wu32 4294.9673 TimeDelay_s 0.0000010000000 4294.9673 FORMAT "%9.4" /end CHARACTERISTIC
/begin CHARACTERISTIC APPCD_tiLowNegPT1_C "Filterzeit low position, neg. Steig" VALUE 0xC750C Kw_Wu32 4294.9673 TimeDelay_s 0.0000010000000 4294.9673 FORMAT "%9.4" /end CHARACTERISTIC
/begin CHARACTERISTIC APPCD_tiLowPosFDCPT1_C "APP filter time constant pos. slope low range" VALUE 0xC7510 Kw_Wu32 4294.9673 TimeDelay_s 0.0000010000000 4294.9673 FORMAT "%9.4" /end CHARACTERISTIC
/begin CHARACTERISTIC APPCD_tiLowPosPT1_C "Filterzeit low position, pos. Steig." VALUE 0xC7514 Kw_Wu32 4294.9673 TimeDelay_s 0.0000010000000 4294.9673 FORMAT "%9.4" /end CHARACTERISTIC
/begin CHARACTERISTIC APPCD_tiMidNegFDCPT1_C "APP filter time constant neg. slope mid. range" VALUE 0xC7518 Kw_Wu32 4294.9673 TimeDelay_s 0.0000010000000 4294.9673 FORMAT "%9.4" /end CHARACTERISTIC
/begin CHARACTERISTIC APPCD_tiMidNegPT1_C "Filterzeit mid. position, neg. Steig." VALUE 0xC751C Kw_Wu32 4294.9673 TimeDelay_s 0.0000010000000 4294.9673 FORMAT "%9.4" /end CHARACTERISTIC
/begin CHARACTERISTIC APPCD_tiMidPosFDCPT1_C "APP filter time constant pos. slope mid. range" VALUE 0xC7520 Kw_Wu32 4294.9673 TimeDelay_s 0.0000010000000 4294.9673 FORMAT "%9.4" /end CHARACTERISTIC
/begin CHARACTERISTIC APPCD_tiMidPosPT1_C "Filterzeit mid. position, pos. Steig." VALUE 0xC7524 Kw_Wu32 4294.9673 TimeDelay_s 0.0000010000000 4294.9673 FORMAT "%9.4" /end CHARACTERISTIC
/begin CHARACTERISTIC APPCD_tiUppNegFDCPT1_C "APP filter time constant neg. slope upp. range" VALUE 0xC7528 Kw_Wu32 4294.9673 TimeDelay_s 0.0000010000000 4294.9673 FORMAT "%9.4" /end CHARACTERISTIC
/begin CHARACTERISTIC APPCD_tiUppNegPT1_C "Filterzeit upper position, neg. Steig." VALUE 0xC752C Kw_Wu32 4294.9673 TimeDelay_s 0.0000010000000 4294.9673 FORMAT "%9.4" /end CHARACTERISTIC
/begin CHARACTERISTIC APPCD_tiUppPosFDCPT1_C "APP filter time constant pos. slope upp. range" VALUE 0xC7530 Kw_Wu32 4294.9673 TimeDelay_s 0.0000010000000 4294.9673 FORMAT "%9.4" /end CHARACTERISTIC
/begin CHARACTERISTIC APPCD_tiUppPosPT1_C "Filterzeit upper position, pos. Steig.:" VALUE 0xC7534 Kw_Wu32 4294.9673 TimeDelay_s 0.0000010000000 4294.9673 FORMAT "%9.4" /end CHARACTERISTIC
/begin CHARACTERISTIC APPCD_swtNoFlt_C "#SSD Schalter für Filter AUS bei betätigter Kupplung (0 = Filter ein bei betätigter Kupplung, 1 = Filter aus bei betätigter Kupplung)" VALUE 0xC7538 Kw_Wu8 1.000 OneToOne 0.00 1.000 FORMAT "%5.3" EXTENDED_LIMITS 0.00 255.0 /end CHARACTERISTIC
/begin CHARACTERISTIC APPCD_rThrFltLowPos_C "Schwelle Filterzeit low position, pos. Steig." VALUE 0xC753A Kw_Ws16 100.0000 Prc 0.00 100.0000 FORMAT "%8.4" EXTENDED_LIMITS -400.0000 399.9878 /end CHARACTERISTIC
/begin CHARACTERISTIC APPCD_rThrFltMidPos_C "APPSchwelle Filterzeit mid. position, pos. Steig." VALUE 0xC753C Kw_Ws16 100.0000 Prc 0.00 100.0000 FORMAT "%8.4" EXTENDED_LIMITS -400.0000 399.9878 /end CHARACTERISTIC
/begin CHARACTERISTIC APPCD_rThrFltLowNeg_C "Schwelle Filterzeit low position, neg. Steig." VALUE 0xC753E Kw_Ws16 100.0000 Prc 0.00 100.0000 FORMAT "%8.4" EXTENDED_LIMITS -400.0000 399.9878 /end CHARACTERISTIC
/begin CHARACTERISTIC APPCD_rThrFltMidNeg_C "Schwelle Filterzeit mid position, neg. Steig." VALUE 0xC7540 Kw_Ws16 100.0000 Prc 0.00 100.0000 FORMAT "%8.4" EXTENDED_LIMITS -400.0000 399.9878 /end CHARACTERISTIC
/begin CHARACTERISTIC APPCD_numAdcAPP1_C "#SSD Applikationsparameter  fuer den Fahrpedal 1 position -Fuehler" VALUE 0xC7542 Kw_Wu8 26.0000000000 NumPinAdc 0.00 26.0000000000 FORMAT "%13.10" /end CHARACTERISTIC
/begin CHARACTERISTIC APPCD_numAdcAPP2_C "#SSD Applikationsparameter  fuer den Fahrpedal 2 position -Fuehler" VALUE 0xC7543 Kw_Wu8 26.0000000000 NumPinAdc 0.00 26.0000000000 FORMAT "%13.10" /end CHARACTERISTIC
/begin CHARACTERISTIC APPCD_duLimErrPos_C "Rampensteigung der Rohspannung PWG" VALUE 0xC7544 Kw_Wu32 320312805.400 RmpVolt 0.00 320312805.400 FORMAT "%13.3" /end CHARACTERISTIC
/begin CHARACTERISTIC APPCD_duLimErrNeg_C "Rampensteigung der Rohspannung PWG" VALUE 0xC7548 Kw_Wu32 320312805.400 RmpVolt 0.00 320312805.400 FORMAT "%13.3" /end CHARACTERISTIC
/begin CHARACTERISTIC APPCD_rLinAPP_CUR "Linearisierungskennline für APP" CURVE 0xC754C Kl_Xs16_Ws16 100.0000 Prc 0.00 100.0000 FORMAT "%8.4" EXTENDED_LIMITS -400.0000 399.9878
 /begin AXIS_DESCR STD_AXIS APPCD_uRaw_mp Volt 2 0.00 5200.391 FORMAT "%8.3" EXTENDED_LIMITS -160156.4 160151.5 DEPOSIT ABSOLUTE /end AXIS_DESCR
/end CHARACTERISTIC
/begin CHARACTERISTIC APPCD_SSpMonAPP1_C "#SSD Auswahl der Sensor-Versorgungs-Spannung für APP1" VALUE 0xC7556 Kw_Wu8 2.000 OneToOne 1.000 3.000 FORMAT "%5.3" EXTENDED_LIMITS 0.00 255.0 /end CHARACTERISTIC
/begin CHARACTERISTIC APPCD_SSpMonAPP2_C "#SSD Auswahl der Sensor-Versorgungs-Spannung für APP2" VALUE 0xC7557 Kw_Wu8 2.000 OneToOne 1.000 3.000 FORMAT "%5.3" EXTENDED_LIMITS 0.00 255.0 /end CHARACTERISTIC
/begin CHARACTERISTIC APPCD_swtEnaUnJit_C "Schalter zur Aktivierung der Entjitterung (1: Entjitterung aktiviert, Entjitterung deaktiviert)" VALUE 0xC7558 Kw_Wu8 1.000 OneToOne 0.00 1.000 FORMAT "%5.3" EXTENDED_LIMITS 0.00 255.0 /end CHARACTERISTIC
/begin CHARACTERISTIC APPCD_swtStepLim_C "Schalter um die Schrittbegrentzungsfunktion zu aktivieren (1: aktieviert, 0: deaktiviert)" VALUE 0xC7559 Kw_Wu8 1.000 OneToOne 0.00 1.000 FORMAT "%5.3" EXTENDED_LIMITS 0.00 255.0 /end CHARACTERISTIC
/begin CHARACTERISTIC APPCD_uAPPMin_C "Ersatzwert für APP-Rohspannung bei Defekt beider Geber" VALUE 0xC755A Kw_Ws16 5200.391 Volt 0.00 5200.391 FORMAT "%8.3" EXTENDED_LIMITS -160156.4 160151.5 /end CHARACTERISTIC
/begin CHARACTERISTIC APPCD_uKickDownHighAPP_C "obere Hys.-Kick-Down-Spg.-Schwelle für APP" VALUE 0xC755C Kw_Ws16 5200.391 Volt 0.00 5200.391 FORMAT "%8.3" EXTENDED_LIMITS -160156.4 160151.5 /end CHARACTERISTIC
/begin CHARACTERISTIC APPCD_uKickDownLowAPP_C "untere Hys.-Kick-Down-Spg.-Schwelle für APP" VALUE 0xC755E Kw_Ws16 5200.391 Volt 0.00 5200.391 FORMAT "%8.3" EXTENDED_LIMITS -160156.4 160151.5 /end CHARACTERISTIC
/begin CHARACTERISTIC APPCD_uMinSync_C "Minimale Rohspannung zur Freigabe der Gleichlaufprüfung" VALUE 0xC7560 Kw_Ws16 5200.391 Volt 0.00 5200.391 FORMAT "%8.3" EXTENDED_LIMITS -160156.4 160151.5 /end CHARACTERISTIC
/begin CHARACTERISTIC APPCD_uRawAPP2dOff_C "Offset für APP2-Rohspannung" VALUE 0xC7562 Kw_Ws16 498.5337 Volt 0.00 498.5337 FORMAT "%8.4" EXTENDED_LIMITS -160156.4 160151.5 /end CHARACTERISTIC
/begin CHARACTERISTIC APPCD_uSync_CUR "Kennlinie zur Bestimmung der maximal zulaessigen Abweichung APP1/APP2" CURVE 0xC7564 Kl_Xs16_Ws16 5200.391 Volt 0.00 5200.391 FORMAT "%8.3" EXTENDED_LIMITS -160156.4 160151.5
 /begin AXIS_DESCR STD_AXIS APPCD_uRawAPP1 Volt 2 0.00 5200.391 FORMAT "%8.3" EXTENDED_LIMITS -160156.4 160151.5 DEPOSIT ABSOLUTE /end AXIS_DESCR
/end CHARACTERISTIC
/begin CHARACTERISTIC APSCD_uSRCMin_C "#SSD Atmosphaerendruckfuehler SRC-Min Fehlerschwelle" VALUE 0xC7570 Kw_Ws16 5200.391 Volt 0.00 5200.391 FORMAT "%8.3" EXTENDED_LIMITS -160156.4 160151.5 /end CHARACTERISTIC
/begin CHARACTERISTIC APSCD_uSRCMax_C "#SSD Atmosphaerendruckfuehler SRC-Max Fehlerschwelle" VALUE 0xC7572 Kw_Ws16 5200.391 Volt 0.00 5200.391 FORMAT "%8.3" EXTENDED_LIMITS -160156.4 160151.5 /end CHARACTERISTIC
/begin CHARACTERISTIC APSCD_pLin_CUR "#SSD Atmosphaerendruck Liniarisierungskennlinie" CURVE 0xC7574 Kl_Xs16_Ws16 3500.000 Pres_hPa 0.00 3500.000 FORMAT "%8.3" EXTENDED_LIMITS -32768.00 32767.00
 /begin AXIS_DESCR STD_AXIS APSCD_uRaw Volt 2 0.00 5000.000 FORMAT "%8.3" EXTENDED_LIMITS -160156.4 160151.5 DEPOSIT ABSOLUTE /end AXIS_DESCR
/end CHARACTERISTIC
/begin CHARACTERISTIC APSCD_DebNplDef_C "Defektentprellung zur Plausibilitaetsfehler Erkennung ( zur Zeit nicht applizierbar )" VALUE 0xC757E Kw_Wu16 65535.00 OneToOne 0.00 65535.00 FORMAT "%8.2" /end CHARACTERISTIC
/begin CHARACTERISTIC APSCD_DebNplOk_C "Heilungsentprellung fuer Plausibilitaetsfehler ( zur Zeit nicht applizierbar )" VALUE 0xC7580 Kw_Wu16 65535.00 OneToOne 0.00 65535.00 FORMAT "%8.2" /end CHARACTERISTIC
/begin CHARACTERISTIC APSCD_DebSigDef_C "Entprellzeit defekt für ungültiges CAN-Signal für Atmosphärendruck" VALUE 0xC7582 Kw_Wu16 655350.0 Time_ms 0.00 655350.0 FORMAT "%8.1" /end CHARACTERISTIC
/begin CHARACTERISTIC APSCD_DebSigOk_C "Heilungsentprellzeit für ungültiges CAN-Signal Atmosphärendruck" VALUE 0xC7584 Kw_Wu16 655350.0 Time_ms 0.00 655350.0 FORMAT "%8.1" /end CHARACTERISTIC
/begin CHARACTERISTIC APSCD_DebSRCDef_C "Entprellzeit fuer SRC Defektzeit" VALUE 0xC7586 Kw_Wu16 655350.0 Time_ms 0.00 655350.0 FORMAT "%8.1" /end CHARACTERISTIC
/begin CHARACTERISTIC APSCD_DebSRCOk_C "Entprellzeit fuer SRC-Heilzeit" VALUE 0xC7588 Kw_Wu16 655350.0 Time_ms 0.00 655350.0 FORMAT "%8.1" /end CHARACTERISTIC
/begin CHARACTERISTIC APSCD_nLimHigh_C "obere Drehzahlgrenze zur Berechnung des Luftdrucks aus dem Ladedruck" VALUE 0xC758A Kw_Ws16 6000.000 EngN 0.00 6000.000 FORMAT "%8.3" EXTENDED_LIMITS -32768.00 32767.00 /end CHARACTERISTIC
/begin CHARACTERISTIC APSCD_numAdc_C "#SSD Applikationsparameter fuer Atmosphaerdruck-Fuehler" VALUE 0xC758C Kw_Wu8 26.0000000000 NumPinAdc 0.00 26.0000000000 FORMAT "%13.10" /end CHARACTERISTIC
/begin CHARACTERISTIC APSCD_pCor_MAP "Atmosphaerendruck Korrekturkennfeld (Drehzahlabhaengig)" MAP 0xC758E Kf_Xs16_Ys16_Ws16 3850.000 Pres_hPa -350.0000 3500.000 FORMAT "%8.3" EXTENDED_LIMITS -32768.00 32767.00
 /begin AXIS_DESCR STD_AXIS Eng_nAvrg EngN 1 0.00 6000.000 FORMAT "%8.3" EXTENDED_LIMITS -32768.00 32767.00 DEPOSIT ABSOLUTE /end AXIS_DESCR
 /begin AXIS_DESCR STD_AXIS Eng_dnAvrg dn_dZ20 1 -6000.000 6000.000 FORMAT "%8.3" EXTENDED_LIMITS -327680.0 327670.0 DEPOSIT ABSOLUTE /end AXIS_DESCR
/end CHARACTERISTIC
/begin CHARACTERISTIC APSCD_dpRmpSlpUp_C "positive Atmosphaerendruck - Rampensteigung" VALUE 0xC7598 Kw_Wu32 65535949.9817 RmpPres_hPa 50.0030517578 65535999.9847 FORMAT "%13.4" EXTENDED_LIMITS 0.00 65535999.9847 /end CHARACTERISTIC
/begin CHARACTERISTIC APSCD_dpRmpSlpDwn_C "negative Atmosphaerendruck - Rampensteigung" VALUE 0xC759C Kw_Wu32 65535949.9817 RmpPres_hPa 50.0030517578 65535999.9847 FORMAT "%13.4" EXTENDED_LIMITS 0.00 65535999.9847 /end CHARACTERISTIC
/begin CHARACTERISTIC APSCD_swtInst_C "Atmosphaerendruck Funktionsschalter (1: verbaut, 0: nicht verbaut)" VALUE 0xC75A0 Kw_Wu8 1.000 OneToOne 0.00 1.000 FORMAT "%5.3" EXTENDED_LIMITS 0.00 255.0 /end CHARACTERISTIC
/begin CHARACTERISTIC APSCD_swtSigVal_C "Schalter zur Umschaltung der Signalquelle ADC/CAN (0 = ADC, 1 = CAN)" VALUE 0xC75A1 Kw_Wu8 1.000 OneToOne 0.00 1.000 FORMAT "%5.3" EXTENDED_LIMITS 0.00 255.0 /end CHARACTERISTIC
/begin CHARACTERISTIC APSCD_swtSrcpVal_C "Schalter ob APSCD_pVal aus Ladedruck berechnet wird (1) oder nicht (0)" VALUE 0xC75A2 Kw_Wu8 1.000 OneToOne 0.00 1.000 FORMAT "%5.3" EXTENDED_LIMITS 0.00 255.0 /end CHARACTERISTIC
/begin CHARACTERISTIC APSCD_tiDel_C "Atmosphaerendruck Verzögerungszeit bis Berechnung von Ladedruck beginnt" VALUE 0xC75A4 Kw_Wu16 655350.0 Time_ms 0.00 655350.0 FORMAT "%8.1" /end CHARACTERISTIC
/begin CHARACTERISTIC APSCD_stSensIDWord_C "Atmosphaerendruck Geberkennwort" VALUE 0xC75A6 Kw_Wu16 65535.00 OneToOne 0.00 65535.00 FORMAT "%8.2" /end CHARACTERISTIC
/begin CHARACTERISTIC APSCD_pDfl_C "#SSD Atmosphaerendruck Vorgabewert" VALUE 0xC75A8 Kw_Ws16 3500.000 Pres_hPa 0.00 3500.000 FORMAT "%8.3" EXTENDED_LIMITS -32768.00 32767.00 /end CHARACTERISTIC
/begin CHARACTERISTIC ARS_tiDebSigDef_C "Defect time for declaring an error" VALUE 0xC75AC Kw_Wu16 655350.0 Time_ms 0.00 655350.0 FORMAT "%8.1" /end CHARACTERISTIC
/begin CHARACTERISTIC ARS_tiDebSigOk_C "Time for declaring an error healed" VALUE 0xC75AE Kw_Wu16 655350.0 Time_ms 0.00 655350.0 FORMAT "%8.1" /end CHARACTERISTIC
/begin CHARACTERISTIC ARS_facDesCor_C "Correction factor for torque correction over setpoint torque" VALUE 0xC75B0 Kw_Ws16 20.00000 Fact1 0.00 20.00000 FORMAT "%8.5" EXTENDED_LIMITS -256.0000 255.9922 /end CHARACTERISTIC
/begin CHARACTERISTIC ARS_facDesOldCor_C "Correction factor for the torque correction over setpoint torque change" VALUE 0xC75B2 Kw_Ws16 20.00000 Fact1 0.00 20.00000 FORMAT "%8.5" EXTENDED_LIMITS -256.0000 255.9922 /end CHARACTERISTIC
/begin CHARACTERISTIC ARS_nDia_C "Engine speed threshold for detecting diagnostic operation" VALUE 0xC75B4 Kw_Ws16 4950.000 EngN 50.00000 5000.000 FORMAT "%8.3" EXTENDED_LIMITS -32768.00 32767.00 /end CHARACTERISTIC
/begin CHARACTERISTIC ARS_rTrans_C "Translation ratio of ARS" VALUE 0xC75B6 Kw_Ws16 200.0000 TransR 0.00 200.0000 FORMAT "%8.4" EXTENDED_LIMITS -327.6800 327.6700 /end CHARACTERISTIC
/begin CHARACTERISTIC ARS_trqCurMax_MAP "Maximum actual torque for plausability monitoring" MAP 0xC75B8 Kf_Xs16_Ys16_Ws16 900.0000 Trq 100.0000 1000.000 FORMAT "%8.3" EXTENDED_LIMITS -3276.800 3276.700
 /begin AXIS_DESCR STD_AXIS VSSCD_v Vel 7 0.00 300.0000 FORMAT "%8.4" EXTENDED_LIMITS -327.6800 327.6700 DEPOSIT ABSOLUTE /end AXIS_DESCR
 /begin AXIS_DESCR STD_AXIS FrmMng_aSide Acc 7 0.00 10.00000 FORMAT "%8.5" EXTENDED_LIMITS -32.76800 32.76700 DEPOSIT ABSOLUTE /end AXIS_DESCR
/end CHARACTERISTIC
/begin CHARACTERISTIC ARS_trqDesMax_MAP "Maximum setpoint torque for plausibility monitoring" MAP 0xC763A Kf_Xs16_Ys16_Ws16 900.0000 Trq 100.0000 1000.000 FORMAT "%8.3" EXTENDED_LIMITS -3276.800 3276.700
 /begin AXIS_DESCR STD_AXIS VSSCD_v Vel 7 0.00 300.0000 FORMAT "%8.4" EXTENDED_LIMITS -327.6800 327.6700 DEPOSIT ABSOLUTE /end AXIS_DESCR
 /begin AXIS_DESCR STD_AXIS FrmMng_aSide Acc 7 0.00 10.00000 FORMAT "%8.5" EXTENDED_LIMITS -32.76800 32.76700 DEPOSIT ABSOLUTE /end AXIS_DESCR
/end CHARACTERISTIC
/begin CHARACTERISTIC ARS_trqDiaMaxOfs_C "Diagnostic offset of the maximum value limits" VALUE 0xC76BC Kw_Ws16 200.0000 Trq -100.0000 100.0000 FORMAT "%8.4" EXTENDED_LIMITS -3276.800 3276.700 /end CHARACTERISTIC
/begin CHARACTERISTIC ARS_trqDiaMax_C "Limitation of maximum values on diagnostics" VALUE 0xC76BE Kw_Ws16 200.0000 Trq -100.0000 100.0000 FORMAT "%8.4" EXTENDED_LIMITS -3276.800 3276.700 /end CHARACTERISTIC
/begin CHARACTERISTIC ARS_vDia_C "Speed threshold for detection of diagnostic operation" VALUE 0xC76C0 Kw_Ws16 300.0000 Vel 0.00 300.0000 FORMAT "%8.4" EXTENDED_LIMITS -327.6800 327.6700 /end CHARACTERISTIC
/begin CHARACTERISTIC ASDdc_T1Clu_C "ARD Störungsregler T1, ausgekuppelt" VALUE 0xC76C4 Kw_Wr32 1.50000000 ASD_GvrnDT1T1_float 0.00 1.50000000 FORMAT "%10.8" EXTENDED_LIMITS -1.00000000E+37 1.00000000E+37 /end CHARACTERISTIC
/begin CHARACTERISTIC ASDdc_KdClu_C "ARD Störungsregler Kd=sqrt(Td)/T1, ausgekuppelt" VALUE 0xC76C8 Kw_Wr32 5.00000000 ASD_GvrnDT1Kd_float 0.00 5.00000000 FORMAT "%10.8" EXTENDED_LIMITS -1.00000000E+37 1.00000000E+37 /end CHARACTERISTIC
/begin CHARACTERISTIC ASDdc_T1ExtInt_C "ARD Störungsregler T1, externer Eingriff" VALUE 0xC76CC Kw_Wr32 1.50000000 ASD_GvrnDT1T1_float 0.00 1.50000000 FORMAT "%10.8" EXTENDED_LIMITS -1.00000000E+37 1.00000000E+37 /end CHARACTERISTIC
/begin CHARACTERISTIC ASDdc_KdExtInt_C "ARD Störungsregler Kd=sqrt(Td)/T1, externer Eingriff" VALUE 0xC76D0 Kw_Wr32 5.00000000 ASD_GvrnDT1Kd_float 0.00 5.00000000 FORMAT "%10.8" EXTENDED_LIMITS -1.00000000E+37 1.00000000E+37 /end CHARACTERISTIC
/begin CHARACTERISTIC ASDdc_KdFDC_MAP "Map for r, n dependent time constant for ASDdc for sport mode" MAP 0xC77B8 Kf_Xs16_Ys16_Ws16 1.500000 Kd16_sqr_rpm2Nm 0.00 1.500000 FORMAT "%8.6" EXTENDED_LIMITS -32.00000 31.99902
 /begin AXIS_DESCR STD_AXIS DrvTrn_rTransDT TransR 6 0.00 100.0000 FORMAT "%8.4" EXTENDED_LIMITS -327.6800 327.6700 DEPOSIT ABSOLUTE /end AXIS_DESCR
 /begin AXIS_DESCR STD_AXIS ASDdc_nAvrg_mp EngN 5 -32768.00 32767.00 FORMAT "%8.2" DEPOSIT ABSOLUTE /end AXIS_DESCR
/end CHARACTERISTIC
/begin CHARACTERISTIC ASDdc_KdGrip_MAP "Zeitkonstante Kd des ARD-SR (ASDdc) für den Zustand Kraftschluss" MAP 0xC76D4 Kf_Xs16_Ys16_Ws16 1.500000 Kd16_sqr_rpm2Nm 0.00 1.500000 FORMAT "%8.6" EXTENDED_LIMITS -32.00000 31.99902
 /begin AXIS_DESCR STD_AXIS DrvTrn_rTransDT TransR 6 0.00 100.0000 FORMAT "%8.4" EXTENDED_LIMITS -327.6800 327.6700 DEPOSIT ABSOLUTE /end AXIS_DESCR
 /begin AXIS_DESCR STD_AXIS ASDdc_nAvrg_mp EngN 5 -32768.00 32767.00 FORMAT "%8.2" DEPOSIT ABSOLUTE /end AXIS_DESCR
/end CHARACTERISTIC
/begin CHARACTERISTIC ASDdc_KdSlip_MAP "Map for r, n dependent gain for ASDdc" MAP 0xC780E Kf_Xs16_Ys16_Ws16 1.500000 Kd16_sqr_rpm2Nm 0.00 1.500000 FORMAT "%8.6" EXTENDED_LIMITS -32.00000 31.99902
 /begin AXIS_DESCR STD_AXIS DrvTrn_rTransDT TransR 6 0.00 100.0000 FORMAT "%8.4" EXTENDED_LIMITS -327.6800 327.6700 DEPOSIT ABSOLUTE /end AXIS_DESCR
 /begin AXIS_DESCR STD_AXIS ASDdc_nAvrg_mp EngN 5 -32768.00 32767.00 FORMAT "%8.2" DEPOSIT ABSOLUTE /end AXIS_DESCR
/end CHARACTERISTIC
/begin CHARACTERISTIC ASDdc_numDefaultState_C "Nummer des Default-Primärzustandes" VALUE 0xC772A Kw_Wu16 6.000000 OneToOne 0.00 6.000000 FORMAT "%8.6" EXTENDED_LIMITS 0.00 65535.00 /end CHARACTERISTIC
/begin CHARACTERISTIC ASDdc_numPrio_C "Prioritäten der Primärzustände" VAL_BLK 0xC7864 Kwb_Wu8 255.0 OneToOne 0.00 255.0 FORMAT "%5.1" NUMBER 7 /end CHARACTERISTIC
/begin CHARACTERISTIC ASDdc_T1State3_C "ARD Störungsregler T1, Primärzustand 3" VALUE 0xC772C Kw_Wr32 1.50000000 ASD_GvrnDT1T1_float 0.00 1.50000000 FORMAT "%10.8" EXTENDED_LIMITS -1.00000000E+37 1.00000000E+37 /end CHARACTERISTIC
/begin CHARACTERISTIC ASDdc_KdState3_C "ARD Störungsregler Kd, Primärzustand 3" VALUE 0xC7730 Kw_Wr32 5.00000000 ASD_GvrnDT1Kd_float 0.00 5.00000000 FORMAT "%10.8" EXTENDED_LIMITS -1.00000000E+37 1.00000000E+37 /end CHARACTERISTIC
/begin CHARACTERISTIC ASDdc_T1State4_C "ARD Störungsregler T1, Primärzustand 4" VALUE 0xC7734 Kw_Wr32 1.50000000 ASD_GvrnDT1T1_float 0.00 1.50000000 FORMAT "%10.8" EXTENDED_LIMITS -1.00000000E+37 1.00000000E+37 /end CHARACTERISTIC
/begin CHARACTERISTIC ASDdc_KdState4_C "ARD Störungsregler Kd=sqrt(Td)/T1, Primärzustand 4" VALUE 0xC7738 Kw_Wr32 5.00000000 ASD_GvrnDT1Kd_float 0.00 5.00000000 FORMAT "%10.8" EXTENDED_LIMITS -1.00000000E+37 1.00000000E+37 /end CHARACTERISTIC
/begin CHARACTERISTIC ASDdc_stConfCluEng_C "Angeforderte Zustände der Eingangsbedingung geschlossene Wandlerkupplung" VALUE 0xC773C Kw_Wu16 65535.00 OneToOne 0.00 65535.00 FORMAT "%8.2" /end CHARACTERISTIC
/begin CHARACTERISTIC ASDdc_stConfCluOff_C "Angeforderte Zustände der Eingangsbedingung offener Wandlerkupplung" VALUE 0xC773E Kw_Wu16 65535.00 OneToOne 0.00 65535.00 FORMAT "%8.2" /end CHARACTERISTIC
/begin CHARACTERISTIC ASDdc_stConfCluSlip_C "Angeforderte Zustände der Eingangsbedingung geregelter Wandlerkupplung" VALUE 0xC7740 Kw_Wu16 65535.00 OneToOne 0.00 65535.00 FORMAT "%8.2" /end CHARACTERISTIC
/begin CHARACTERISTIC ASDdc_stConv1_C "Die Eingangsbedingung ist erfüllt, wenn FrmMng_stConv == ASDdc_stConv1_C" VALUE 0xC7742 Kw_Wu8 255.0 OneToOne 0.00 255.0 FORMAT "%5.1" /end CHARACTERISTIC
/begin CHARACTERISTIC ASDdc_stConv2_C "Die Eingangsbedingung ist erfüllt, wenn FrmMng_stConv == ASDdc_stConv2_C" VALUE 0xC7743 Kw_Wu8 255.0 OneToOne 0.00 255.0 FORMAT "%5.1" /end CHARACTERISTIC
/begin CHARACTERISTIC ASDdc_stConv3_C "Die Eingangsbedingung ist erfüllt, wenn FrmMng_stConv == ASDdc_stConv3_C" VALUE 0xC7744 Kw_Wu8 255.0 OneToOne 0.00 255.0 FORMAT "%5.1" /end CHARACTERISTIC
/begin CHARACTERISTIC ASDdc_stExtInt_C "Angeforderte Zustände der Eingangsbedingung ""Externer Eingriff""" VALUE 0xC7746 Kw_Wu16 65535.00 OneToOne 0.00 65535.00 FORMAT "%8.2" /end CHARACTERISTIC
/begin CHARACTERISTIC ASDdc_stFDC_C "Vehicle mode switch" VALUE 0xC7748 Kw_Wu16 65535.00 OneToOne 0.00 65535.00 FORMAT "%8.2" /end CHARACTERISTIC
/begin CHARACTERISTIC ASDdc_stGearswitch_C "Angeforderte Zustände der Eingangangsbedingung Gangumschaltung aktiv" VALUE 0xC774A Kw_Wu16 65535.00 OneToOne 0.00 65535.00 FORMAT "%8.2" /end CHARACTERISTIC
/begin CHARACTERISTIC ASDdc_stGripRaw_C "Angeforderte Zustände der Eingangsbedingung ""Kraftschluss""" VALUE 0xC774C Kw_Wu16 65535.00 OneToOne 0.00 65535.00 FORMAT "%8.2" /end CHARACTERISTIC
/begin CHARACTERISTIC ASDdc_stGrip_C "Angeforderte Zustände der Eingangsbedingung ""Kraftschluss und Nulldurchgang des Störungsreglers""" VALUE 0xC774E Kw_Wu16 65535.00 OneToOne 0.00 65535.00 FORMAT "%8.2" /end CHARACTERISTIC
/begin CHARACTERISTIC ASDdc_swtCalcN_C "Wählt Motorgeschwindigkeit für Parameter- Map. 1: ASDdc_nAvrg_mp = Eng_nAvrg;   0: ASDdc_nAvrg_mp = Eng_nAvrg - LIGov_nSetpoint" VALUE 0xC7750 Kw_Wu8 255.0 OneToOne 0.00 255.0 FORMAT "%5.1" /end CHARACTERISTIC
/begin CHARACTERISTIC ASDdc_swtInitPS_C "Schalter zur 1: Aktivierung, 0: Deaktivierung der kontinuierlichen Initialisierung aufgrund Parametersatzwechsels" VALUE 0xC7751 Kw_Wu8 255.0 OneToOne 0.00 255.0 FORMAT "%5.1" /end CHARACTERISTIC
/begin CHARACTERISTIC ASDdc_swtOpr_C "Schalter des Verknüpfungsoperators  (00=OR : 01=AND : 10=NAND : 11=NOR)" VALUE 0xC7752 Kw_Wu16 65535.00 OneToOne 0.00 65535.00 FORMAT "%8.2" /end CHARACTERISTIC
/begin CHARACTERISTIC ASDdc_swtStiffParameter_C "Schalter zur Berücksichtigung der Parameterumschaltung durch DCC" VALUE 0xC7754 Kw_Wu8 1.000 OneToOne 0.00 1.000 FORMAT "%5.3" EXTENDED_LIMITS 0.00 255.0 /end CHARACTERISTIC
/begin CHARACTERISTIC ASDdc_T1FDC_MAP "Map for r, n dependent time constant for ASDdc for sport mode" MAP 0xC786C Kf_Xs16_Ys16_Ws16 1.498917 TimeDelay_s_Lin_16 0.001068148 1.499985 FORMAT "%8.6" EXTENDED_LIMITS -5.000153 5.000000
 /begin AXIS_DESCR STD_AXIS DrvTrn_rTransDT TransR 6 0.00 100.0000 FORMAT "%8.4" EXTENDED_LIMITS -327.6800 327.6700 DEPOSIT ABSOLUTE /end AXIS_DESCR
 /begin AXIS_DESCR STD_AXIS ASDdc_nAvrg_mp EngN 5 -32768.00 32767.00 FORMAT "%8.2" DEPOSIT ABSOLUTE /end AXIS_DESCR
/end CHARACTERISTIC
/begin CHARACTERISTIC ASDdc_T1Grip_MAP "Zeitkonstante T1 des ARD-SR (ASDdc) für den Zustand Kraftschluss" MAP 0xC7756 Kf_Xs16_Ys16_Ws16 1.498917 TimeDelay_s_Lin_16 0.001068148 1.499985 FORMAT "%8.6" EXTENDED_LIMITS -5.000153 5.000000
 /begin AXIS_DESCR STD_AXIS DrvTrn_rTransDT TransR 6 0.00 100.0000 FORMAT "%8.4" EXTENDED_LIMITS -327.6800 327.6700 DEPOSIT ABSOLUTE /end AXIS_DESCR
 /begin AXIS_DESCR STD_AXIS ASDdc_nAvrg_mp EngN 5 -32768.00 32767.00 FORMAT "%8.2" DEPOSIT ABSOLUTE /end AXIS_DESCR
/end CHARACTERISTIC
/begin CHARACTERISTIC ASDdc_T1Slip_MAP "Map for r, n dependent time constant for ASDdc" MAP 0xC78C2 Kf_Xs16_Ys16_Ws16 1.498917 TimeDelay_s_Lin_16 0.001068148 1.499985 FORMAT "%8.6" EXTENDED_LIMITS -5.000153 5.000000
 /begin AXIS_DESCR STD_AXIS DrvTrn_rTransDT TransR 6 0.00 100.0000 FORMAT "%8.4" EXTENDED_LIMITS -327.6800 327.6700 DEPOSIT ABSOLUTE /end AXIS_DESCR
 /begin AXIS_DESCR STD_AXIS ASDdc_nAvrg_mp EngN 5 -32768.00 32767.00 FORMAT "%8.2" DEPOSIT ABSOLUTE /end AXIS_DESCR
/end CHARACTERISTIC
/begin CHARACTERISTIC ASDdc_trqLimMax_C "ARD Begrenzung Ausgang Störregler MAX" VALUE 0xC77AC Kw_Wr32 1500.00000 Trq_float -500.000000 1000.00000 FORMAT "%10.5" EXTENDED_LIMITS -1.00000000E+37 1.00000000E+37 /end CHARACTERISTIC
/begin CHARACTERISTIC ASDdc_trqLimMin_C "ARD Begrenzung Ausgang Störregler MIN" VALUE 0xC77B0 Kw_Wr32 1500.00000 Trq_float -500.000000 1000.00000 FORMAT "%10.5" EXTENDED_LIMITS -1.00000000E+37 1.00000000E+37 /end CHARACTERISTIC
/begin CHARACTERISTIC ASDdc_trq_Vector "#SSD Bypass Label, nicht ändern!" VALUE 0xC30CC Kw_Wu8 255.0 OneToOne 0.00 255.0 FORMAT "%5.1" /end CHARACTERISTIC
/begin CHARACTERISTIC ASDdc_trq_Channel "#SSD Bypass Label, nicht ändern!" VALUE 0xC30CD Kw_Wu8 255.0 OneToOne 0.00 255.0 FORMAT "%5.1" /end CHARACTERISTIC
/begin CHARACTERISTIC ASDdc_vLimIni_C "ARD Geschwindigkeitsschwelle f. Initialisierung Störregler" VALUE 0xC77B4 Kw_Ws16 655.3500 Vel -327.6800 327.6700 FORMAT "%8.4" /end CHARACTERISTIC
/begin CHARACTERISTIC ASDrf_T1CluNeg_C "ARD Führungsformer T1 Kupplung neg. Gradient" VALUE 0xC7960 Kw_Wu32 4294.9673 TimeDelay_s 0.0000010000000 4294.9673 FORMAT "%9.4" /end CHARACTERISTIC
/begin CHARACTERISTIC ASDrf_KdCluNeg_C "ARD Führungsformer Kd=Td/T1 Kupplung neg. Gradient" VALUE 0xC7964 Kw_Ws32 32769.0000000 Kd -32768.0000000 1.00000000000 FORMAT "%13.7" EXTENDED_LIMITS -32768.0000000 32767.9999847 /end CHARACTERISTIC
/begin CHARACTERISTIC ASDrf_T1CluPos_C "ARD Führungsformer T1 Kupplung pos. Gradient" VALUE 0xC7968 Kw_Wu32 4294.9673 TimeDelay_s 0.0000010000000 4294.9673 FORMAT "%9.4" /end CHARACTERISTIC
/begin CHARACTERISTIC ASDrf_KdCluPos_C "ARD Führungsformer Kd=Td/T1 Kupplung Ganggruppe pos. Gradient" VALUE 0xC796C Kw_Ws32 32769.0000000 Kd -32768.0000000 1.00000000000 FORMAT "%13.7" EXTENDED_LIMITS -32768.0000000 32767.9999847 /end CHARACTERISTIC
/begin CHARACTERISTIC ASDrf_CoeffADecLim_C "Koeffitient A der Parabel y = a*x^2 + b der Steigungsbegrenzung für Drehmomentabsenkung." VALUE 0xC7918 Kw_Ws16 159.9951 CoeffA 0.00 159.9951 FORMAT "%8.4" EXTENDED_LIMITS -160.0000 159.9951 /end CHARACTERISTIC
/begin CHARACTERISTIC ASDrf_CoeffAFDCLossNeg_CUR "Curve for 2nd order parable coeffitient for lad for sport mode" CURVE 0xC7A2C Kl_Xs16_Ws16 319.9951 CoeffA -160.0000 159.9951 FORMAT "%8.4"
 /begin AXIS_DESCR STD_AXIS DrvTrn_rTransDT TransR 8 0.00 100.0000 FORMAT "%8.4" EXTENDED_LIMITS -327.6800 327.6700 DEPOSIT ABSOLUTE /end AXIS_DESCR
/end CHARACTERISTIC
/begin CHARACTERISTIC ASDrf_CoeffAFDCLossPos_CUR "Curve for 2nd order parable coeffitient for lad" CURVE 0xC7A4E Kl_Xs16_Ws16 319.9951 CoeffA -160.0000 159.9951 FORMAT "%8.4"
 /begin AXIS_DESCR STD_AXIS DrvTrn_rTransDT TransR 8 0.00 100.0000 FORMAT "%8.4" EXTENDED_LIMITS -327.6800 327.6700 DEPOSIT ABSOLUTE /end AXIS_DESCR
/end CHARACTERISTIC
/begin CHARACTERISTIC ASDrf_CoeffAGripLossNeg_CUR "Kennlinie für den Koeffitienten zweiter Ordnung der LSD Steigungsbegrenzung." CURVE 0xC7A70 Kl_Xs16_Ws16 319.9951 CoeffA -160.0000 159.9951 FORMAT "%8.4"
 /begin AXIS_DESCR STD_AXIS DrvTrn_rTransDT TransR 6 0.00 100.0000 FORMAT "%8.4" EXTENDED_LIMITS -327.6800 327.6700 DEPOSIT ABSOLUTE /end AXIS_DESCR
/end CHARACTERISTIC
/begin CHARACTERISTIC ASDrf_CoeffAGripLossPos_CUR "Kennlinie für den Koeffitienten zweiter Ordnung der LSD Steigungsbegrenzung." CURVE 0xC7A8A Kl_Xs16_Ws16 319.9951 CoeffA -160.0000 159.9951 FORMAT "%8.4"
 /begin AXIS_DESCR STD_AXIS DrvTrn_rTransDT TransR 6 0.00 100.0000 FORMAT "%8.4" EXTENDED_LIMITS -327.6800 327.6700 DEPOSIT ABSOLUTE /end AXIS_DESCR
/end CHARACTERISTIC
/begin CHARACTERISTIC ASDrf_CoeffBDecLim_C "Koeffitient B der Parabel y = a*x^2 + b der Steigungsbegrenzung für Drehmomentabsenkung." VALUE 0xC791A Kw_Ws16 3276.700 dTrq 0.00 3276.700 FORMAT "%8.3" EXTENDED_LIMITS -3276.800 3276.700 /end CHARACTERISTIC
/begin CHARACTERISTIC ASDrf_CoeffBFDCLossNeg_CUR "Curve for 0th order parable coeffitient for lad" CURVE 0xC7AA4 Kl_Xs16_Ws16 6553.500 dTrq -3276.800 3276.700 FORMAT "%8.3"
 /begin AXIS_DESCR STD_AXIS DrvTrn_rTransDT TransR 8 0.00 100.0000 FORMAT "%8.4" EXTENDED_LIMITS -327.6800 327.6700 DEPOSIT ABSOLUTE /end AXIS_DESCR
/end CHARACTERISTIC
/begin CHARACTERISTIC ASDrf_CoeffBFDCLossPos_CUR "Curve for 0th order parable coeffitient for lad" CURVE 0xC7AC6 Kl_Xs16_Ws16 6553.500 dTrq -3276.800 3276.700 FORMAT "%8.3"
 /begin AXIS_DESCR STD_AXIS DrvTrn_rTransDT TransR 8 0.00 100.0000 FORMAT "%8.4" EXTENDED_LIMITS -327.6800 327.6700 DEPOSIT ABSOLUTE /end AXIS_DESCR
/end CHARACTERISTIC
/begin CHARACTERISTIC ASDrf_CoeffBGripLossNeg_CUR "Kennlinie für den Koeffitienten nullter Ordnung der LSD Steigungsbegrenzung." CURVE 0xC7AE8 Kl_Xs16_Ws16 6553.500 dTrq -3276.800 3276.700 FORMAT "%8.3"
 /begin AXIS_DESCR STD_AXIS DrvTrn_rTransDT TransR 6 0.00 100.0000 FORMAT "%8.4" EXTENDED_LIMITS -327.6800 327.6700 DEPOSIT ABSOLUTE /end AXIS_DESCR
/end CHARACTERISTIC
/begin CHARACTERISTIC ASDrf_CoeffBGripLossPos_CUR "Kennlinie für den Koeffitienten nullter Ordnung der LSD Steigungsbegrenzung." CURVE 0xC7B02 Kl_Xs16_Ws16 6553.500 dTrq -3276.800 3276.700 FORMAT "%8.3"
 /begin AXIS_DESCR STD_AXIS DrvTrn_rTransDT TransR 6 0.00 100.0000 FORMAT "%8.4" EXTENDED_LIMITS -327.6800 327.6700 DEPOSIT ABSOLUTE /end AXIS_DESCR
/end CHARACTERISTIC
/begin CHARACTERISTIC ASDrf_dtrqIncLimLow_C "Hystereseschwelle unten zur Erkennung von nicht steilen Drehmoment Gradienten." VALUE 0xC791C Kw_Ws16 3276.700 dTrq 0.00 3276.700 FORMAT "%8.3" EXTENDED_LIMITS -3276.800 3276.700 /end CHARACTERISTIC
/begin CHARACTERISTIC ASDrf_dtrqIncLimHigh_C "Hysterese Schwelle oben für steile Drehmomentanstiege." VALUE 0xC791E Kw_Ws16 3276.700 dTrq 0.00 3276.700 FORMAT "%8.3" EXTENDED_LIMITS -3276.800 3276.700 /end CHARACTERISTIC
/begin CHARACTERISTIC ASDrf_stIncLimLow_C "Hysteresewert für flachen Drehmomentenanstieg." VALUE 0xC7920 Kw_Ws16 65535.00 OneToOne -32768.00 32767.00 FORMAT "%8.2" READ_ONLY /end CHARACTERISTIC
/begin CHARACTERISTIC ASDrf_stIncLimHigh_C "Hysteresewert für steilen Drehmomentenanstieg." VALUE 0xC7922 Kw_Ws16 65535.00 OneToOne -32768.00 32767.00 FORMAT "%8.2" READ_ONLY /end CHARACTERISTIC
/begin CHARACTERISTIC ASDrf_dtrqIncLim_C "Momentensteigung zur deaktivierung der Steigungsbegrenzung bei steigendem Eingangssignal." VALUE 0xC7924 Kw_Ws16 3276.700 dTrq 0.00 3276.700 FORMAT "%8.3" EXTENDED_LIMITS -3276.800 3276.700 /end CHARACTERISTIC
/begin CHARACTERISTIC ASDrf_dtrqInrLtdLim_CUR "Kurve zur Begrenzung der zeitl. Ableitung von CoEng_trqInrLtd" CURVE 0xC7926 Kl_Xs16_Ws16 4000.000 dTrq -2000.000 2000.000 FORMAT "%8.3" EXTENDED_LIMITS -3276.800 3276.700
 /begin AXIS_DESCR STD_AXIS ASDrf_dtrqInrLtd_mp dTrq 7 -2000.000 2000.000 FORMAT "%8.3" EXTENDED_LIMITS -3276.800 3276.700 DEPOSIT ABSOLUTE /end AXIS_DESCR
/end CHARACTERISTIC
/begin CHARACTERISTIC ASDrf_dtrqSteepNeg_C "Obergrenze für Initialisierung bei steilen Eingangssignalgradienten" VALUE 0xC7944 Kw_Ws16 2000.000 dTrq -2000.000 0.00 FORMAT "%8.3" EXTENDED_LIMITS -3276.800 3276.700 /end CHARACTERISTIC
/begin CHARACTERISTIC ASDrf_dtrqSteepPos_C "Untergrenze für Initialisierung bei steilen Eingangssignalgradienten" VALUE 0xC7946 Kw_Ws16 2000.000 dTrq 0.00 2000.000 FORMAT "%8.3" EXTENDED_LIMITS -3276.800 3276.700 /end CHARACTERISTIC
/begin CHARACTERISTIC ASDrf_T1ExtInt_C "ARD Führungsformer T1, externer Eingriff" VALUE 0xC7970 Kw_Wu32 4294.9673 TimeDelay_s 0.0000010000000 4294.9673 FORMAT "%9.4" /end CHARACTERISTIC
/begin CHARACTERISTIC ASDrf_KdExtInt_C "ARD Führungsformer Kd=Td/T1, externer Eingriff" VALUE 0xC7974 Kw_Ws32 32769.0000000 Kd -32768.0000000 1.00000000000 FORMAT "%13.7" EXTENDED_LIMITS -32768.0000000 32767.9999847 /end CHARACTERISTIC
/begin CHARACTERISTIC ASDrf_T1Flt_C "Zeitkonstante PT1 Glied zur Filterung von CoEng_trqInrLtd vor der Ableitung." VALUE 0xC7948 Kw_Wu32 4294.9673 TimeDelay_s 0.0000010000000 4294.9673 FORMAT "%9.4" /end CHARACTERISTIC
/begin CHARACTERISTIC ASDrf_KdFDCNeg_CUR "Curve for n dependent gain for PDT1 filtering for negative i/p gradient" CURVE 0xC7B1C Kl_Xs16_Ws16 1.000000 Kd_Lin_16 0.00 1.000000 FORMAT "%8.6" EXTENDED_LIMITS -1.000031 1.000000
 /begin AXIS_DESCR STD_AXIS DrvTrn_rTransDT TransR 8 0.00 100.0000 FORMAT "%8.4" EXTENDED_LIMITS -327.6800 327.6700 DEPOSIT ABSOLUTE /end AXIS_DESCR
/end CHARACTERISTIC
/begin CHARACTERISTIC ASDrf_KdFDCPos_CUR "Curve for n dependent gain for PDT1 filtering for positive i/p gradient" CURVE 0xC7B3E Kl_Xs16_Ws16 1.000000 Kd_Lin_16 0.00 1.000000 FORMAT "%8.6" EXTENDED_LIMITS -1.000031 1.000000
 /begin AXIS_DESCR STD_AXIS DrvTrn_rTransDT TransR 8 0.00 100.0000 FORMAT "%8.4" EXTENDED_LIMITS -327.6800 327.6700 DEPOSIT ABSOLUTE /end AXIS_DESCR
/end CHARACTERISTIC
/begin CHARACTERISTIC ASDrf_KdGripNeg_CUR "Kd bei geschlosenem Antreibsstrang und negativem Gradienten" CURVE 0xC7B60 Kl_Xs16_Ws16 1.000000 Kd_Lin_16 0.00 1.000000 FORMAT "%8.6" EXTENDED_LIMITS -1.000031 1.000000
 /begin AXIS_DESCR STD_AXIS DrvTrn_rTransDT TransR 6 0.00 100.0000 FORMAT "%8.4" EXTENDED_LIMITS -327.6800 327.6700 DEPOSIT ABSOLUTE /end AXIS_DESCR
/end CHARACTERISTIC
/begin CHARACTERISTIC ASDrf_KdGripPos_CUR "Kd bei geschlosenem Antreibsstrang und positivem Gradienten" CURVE 0xC7B7A Kl_Xs16_Ws16 1.000000 Kd_Lin_16 0.00 1.000000 FORMAT "%8.6" EXTENDED_LIMITS -1.000031 1.000000
 /begin AXIS_DESCR STD_AXIS DrvTrn_rTransDT TransR 6 0.00 100.0000 FORMAT "%8.4" EXTENDED_LIMITS -327.6800 327.6700 DEPOSIT ABSOLUTE /end AXIS_DESCR
/end CHARACTERISTIC
/begin CHARACTERISTIC ASDrf_numDefaultState_C "Vorgabestatus" VALUE 0xC7978 Kw_Wu16 5.00000000000 ASDrf_numDefaultState 0.00 5.00000000000 FORMAT "%13.11" /end CHARACTERISTIC
/begin CHARACTERISTIC ASDrf_numPrio_C "Statuspriorität" VAL_BLK 0xC7B94 Kwb_Wu8 255.0 OneToOne 0.00 255.0 FORMAT "%5.1" NUMBER 6 /end CHARACTERISTIC
/begin CHARACTERISTIC ASDrf_CoeffACluLossNeg_C "Kennwert für den Koeffitienten zweiter Ordnung der LSD Steigungsbegrenzung." VALUE 0xC797A Kw_Ws16 159.9951 CoeffA 0.00 159.9951 FORMAT "%8.4" EXTENDED_LIMITS -160.0000 159.9951 /end CHARACTERISTIC
/begin CHARACTERISTIC ASDrf_CoeffBCluLossNeg_C "Kennlinie für den Koeffitienten nullter Ordnung der LSD Steigungsbegrenzung." VALUE 0xC797C Kw_Ws16 3276.700 dTrq 0.00 3276.700 FORMAT "%8.3" EXTENDED_LIMITS -3276.800 3276.700 /end CHARACTERISTIC
/begin CHARACTERISTIC ASDrf_CoeffACluLossPos_C "Kennwert für den Koeffitienten zweiter Ordnung der LSD Steigungsbegrenzung." VALUE 0xC797E Kw_Ws16 159.9951 CoeffA 0.00 159.9951 FORMAT "%8.4" EXTENDED_LIMITS -160.0000 159.9951 /end CHARACTERISTIC
/begin CHARACTERISTIC ASDrf_CoeffBCluLossPos_C "Kennwert für den Koeffitienten nullter Ordnung der LSD Steigungsbegrenzung." VALUE 0xC7980 Kw_Ws16 3276.700 dTrq 0.00 3276.700 FORMAT "%8.3" EXTENDED_LIMITS -3276.800 3276.700 /end CHARACTERISTIC
/begin CHARACTERISTIC ASDrf_CoeffAExtIntLoss_C "Kennwert für den Koeffitienten zweiter Ordnung der LSD Steigungsbegrenzung." VALUE 0xC7982 Kw_Ws16 159.9951 CoeffA 0.00 159.9951 FORMAT "%8.4" EXTENDED_LIMITS -160.0000 159.9951 /end CHARACTERISTIC
/begin CHARACTERISTIC ASDrf_CoeffBExtIntLoss_C "Kennwert für den Koeffitienten nullter Ordnung der LSD Steigungsbegrenzung." VALUE 0xC7984 Kw_Ws16 3276.700 dTrq 0.00 3276.700 FORMAT "%8.3" EXTENDED_LIMITS -3276.800 3276.700 /end CHARACTERISTIC
/begin CHARACTERISTIC ASDrf_CoeffAState3LossNeg_C "Kennwert für den Koeffitienten zweiter Ordnung der LSD Steigungsbegrenzung." VALUE 0xC7986 Kw_Ws16 159.9951 CoeffA 0.00 159.9951 FORMAT "%8.4" EXTENDED_LIMITS -160.0000 159.9951 /end CHARACTERISTIC
/begin CHARACTERISTIC ASDrf_CoeffBState3LossNeg_C "Kennwert für den Koeffitienten nullter Ordnung der LSD Steigungsbegrenzung." VALUE 0xC7988 Kw_Ws16 3276.700 dTrq 0.00 3276.700 FORMAT "%8.3" EXTENDED_LIMITS -3276.800 3276.700 /end CHARACTERISTIC
/begin CHARACTERISTIC ASDrf_CoeffAState3LossPos_C "Kennwert für den Koeffitienten zweiter Ordnung der LSD Steigungsbegrenzung." VALUE 0xC798A Kw_Ws16 159.9951 CoeffA 0.00 159.9951 FORMAT "%8.4" EXTENDED_LIMITS -160.0000 159.9951 /end CHARACTERISTIC
/begin CHARACTERISTIC ASDrf_CoeffBState3LossPos_C "Kennwert für den Koeffitienten nullter Ordnung der LSD Steigungsbegrenzung." VALUE 0xC798C Kw_Ws16 3276.700 dTrq 0.00 3276.700 FORMAT "%8.3" EXTENDED_LIMITS -3276.800 3276.700 /end CHARACTERISTIC
/begin CHARACTERISTIC ASDrf_CoeffAState4LossNeg_C "Kennwert für den Koeffitienten zweiter Ordnung der LSD Steigungsbegrenzung." VALUE 0xC798E Kw_Ws16 159.9951 CoeffA 0.00 159.9951 FORMAT "%8.4" EXTENDED_LIMITS -160.0000 159.9951 /end CHARACTERISTIC
/begin CHARACTERISTIC ASDrf_CoeffBState4LossNeg_C "Kennwert für den Koeffitienten nullter Ordnung der LSD Steigungsbegrenzung." VALUE 0xC7990 Kw_Ws16 3276.700 dTrq 0.00 3276.700 FORMAT "%8.3" EXTENDED_LIMITS -3276.800 3276.700 /end CHARACTERISTIC
/begin CHARACTERISTIC ASDrf_CoeffAState4LossPos_C "Kennwert für den Koeffitienten zweiter Ordnung der LSD Steigungsbegrenzung." VALUE 0xC7992 Kw_Ws16 159.9951 CoeffA 0.00 159.9951 FORMAT "%8.4" EXTENDED_LIMITS -160.0000 159.9951 /end CHARACTERISTIC
/begin CHARACTERISTIC ASDrf_CoeffBState4LossPos_C "Kennwert für den Koeffitienten nullter Ordnung der LSD Steigungsbegrenzung." VALUE 0xC7994 Kw_Ws16 3276.700 dTrq 0.00 3276.700 FORMAT "%8.3" EXTENDED_LIMITS -3276.800 3276.700 /end CHARACTERISTIC
/begin CHARACTERISTIC ASDrf_T1State3Neg_C "ARD Führungsformer T1 frei wählbarer Zustand 3 neg. Gradient" VALUE 0xC7998 Kw_Wu32 4294.9673 TimeDelay_s 0.0000010000000 4294.9673 FORMAT "%9.4" /end CHARACTERISTIC
/begin CHARACTERISTIC ASDrf_KdState3Neg_C "ARD Führungsformer Kd=Td/T1 frei wählbarer Zustand 3 neg. Gradient" VALUE 0xC799C Kw_Ws32 32769.0000000 Kd -32768.0000000 1.00000000000 FORMAT "%13.7" EXTENDED_LIMITS -32768.0000000 32767.9999847 /end CHARACTERISTIC
/begin CHARACTERISTIC ASDrf_T1State3Pos_C "ARD Führungsformer T1 frei wählbarer Zustand 3 pos. Gradient" VALUE 0xC79A0 Kw_Wu32 4294.9673 TimeDelay_s 0.0000010000000 4294.9673 FORMAT "%9.4" /end CHARACTERISTIC
/begin CHARACTERISTIC ASDrf_KdState3Pos_C "ARD Führungsformer Kd=Td/T1 frei wählbarer Zustand 3 pos. Gradient" VALUE 0xC79A4 Kw_Ws32 32769.0000000 Kd -32768.0000000 1.00000000000 FORMAT "%13.7" EXTENDED_LIMITS -32768.0000000 32767.9999847 /end CHARACTERISTIC
/begin CHARACTERISTIC ASDrf_T1State4Neg_C "ARD Führungsformer T1 frei wählbarer Zustand 4 neg. Gradient" VALUE 0xC79A8 Kw_Wu32 4294.9673 TimeDelay_s 0.0000010000000 4294.9673 FORMAT "%9.4" /end CHARACTERISTIC
/begin CHARACTERISTIC ASDrf_KdState4Neg_C "ARD Führungsformer Kd=Td/T1 frei wählbarer Zustand 4 neg. Gradient" VALUE 0xC79AC Kw_Ws32 32769.0000000 Kd -32768.0000000 1.00000000000 FORMAT "%13.7" EXTENDED_LIMITS -32768.0000000 32767.9999847 /end CHARACTERISTIC
/begin CHARACTERISTIC ASDrf_T1State4Pos_C "ARD Führungsformer T1 frei wählbarer Zustand 4 pos. Gradient" VALUE 0xC79B0 Kw_Wu32 4294.9673 TimeDelay_s 0.0000010000000 4294.9673 FORMAT "%9.4" /end CHARACTERISTIC
/begin CHARACTERISTIC ASDrf_KdState4Pos_C "ARD Führungsformer Kd=Td/T1 frei wählbarer Zustand 4 pos. Gradient" VALUE 0xC79B4 Kw_Ws32 32769.0000000 Kd -32768.0000000 1.00000000000 FORMAT "%13.7" EXTENDED_LIMITS -32768.0000000 32767.9999847 /end CHARACTERISTIC
/begin CHARACTERISTIC ASDrf_stConv1_C "Eingangsbedingung ""Wandlerkupplung geschlossen""" VALUE 0xC79B8 Kw_Wu8 255.0 OneToOne 0.00 255.0 FORMAT "%5.1" /end CHARACTERISTIC
/begin CHARACTERISTIC ASDrf_stConv2_C "Eingangsbedingung ""Wandlerkupplung geöffnet""" VALUE 0xC79B9 Kw_Wu8 255.0 OneToOne 0.00 255.0 FORMAT "%5.1" /end CHARACTERISTIC
/begin CHARACTERISTIC ASDrf_stConv3_C "Eingangsbedingung ""Wandlerkupplung geregelt""" VALUE 0xC79BA Kw_Wu8 255.0 OneToOne 0.00 255.0 FORMAT "%5.1" /end CHARACTERISTIC
/begin CHARACTERISTIC ASDrf_stConvCluEng_C "Bitmuster der Eingangsbedingung für ""geschlossene"" Wandlerkupplung." VALUE 0xC79BC Kw_Wu16 65535.00 OneToOne 0.00 65535.00 FORMAT "%8.2" /end CHARACTERISTIC
/begin CHARACTERISTIC ASDrf_stConvCluOff_C "Bitmuster der Eingangsbedingung für ""geöffnete"" Wandlerkupplung." VALUE 0xC79BE Kw_Wu16 65535.00 OneToOne 0.00 65535.00 FORMAT "%8.2" /end CHARACTERISTIC
/begin CHARACTERISTIC ASDrf_stConvCluSlip_C "Bitmuster der Eingangsbedingung für ""geregelte"" Wandlerkupplung." VALUE 0xC79C0 Kw_Wu16 65535.00 OneToOne 0.00 65535.00 FORMAT "%8.2" /end CHARACTERISTIC
/begin CHARACTERISTIC ASDrf_stEntcClu_C "Initialisierungsanforderung beim Eintritt in den Zustand ""offener Antriebsstrang""" VALUE 0xC79C2 Kw_Wu8 3.000 OneToOne 0.00 3.000 FORMAT "%5.3" EXTENDED_LIMITS 0.00 255.0 /end CHARACTERISTIC
/begin CHARACTERISTIC ASDrf_stEntcExtInt_C "Initialisierungsanforderung beim Eintritt in den Zustand ""externer Momenteneingriff""" VALUE 0xC79C3 Kw_Wu8 3.000 OneToOne 0.00 3.000 FORMAT "%5.3" EXTENDED_LIMITS 0.00 255.0 /end CHARACTERISTIC
/begin CHARACTERISTIC ASDrf_stEntcFDC_C "status of Vehicle mode" VALUE 0xC79C4 Kw_Wu8 3.000 OneToOne 0.00 3.000 FORMAT "%5.3" EXTENDED_LIMITS 0.00 255.0 /end CHARACTERISTIC
/begin CHARACTERISTIC ASDrf_stEntcGrip_C "Initialisierungsanforderung beim Eintritt in den Zustand ""Vortrieb""" VALUE 0xC79C5 Kw_Wu8 3.000 OneToOne 0.00 3.000 FORMAT "%5.3" EXTENDED_LIMITS 0.00 255.0 /end CHARACTERISTIC
/begin CHARACTERISTIC ASDrf_stEntcState3_C "Initialisierungsanforderung beim Eintritt in den Zustand 3" VALUE 0xC79C6 Kw_Wu8 3.000 OneToOne 0.00 3.000 FORMAT "%5.3" EXTENDED_LIMITS 0.00 255.0 /end CHARACTERISTIC
/begin CHARACTERISTIC ASDrf_stEntcState4_C "Initialisierungsanforderung beim Eintritt in den Zustand 4" VALUE 0xC79C7 Kw_Wu8 3.000 OneToOne 0.00 3.000 FORMAT "%5.3" EXTENDED_LIMITS 0.00 255.0 /end CHARACTERISTIC
/begin CHARACTERISTIC ASDrf_stExClu_C "Initialisierungsanforderung beim Verlassen des Zustands ""offener Antriebsstrang""" VALUE 0xC79C8 Kw_Wu8 3.000 OneToOne 0.00 3.000 FORMAT "%5.3" EXTENDED_LIMITS 0.00 255.0 /end CHARACTERISTIC
/begin CHARACTERISTIC ASDrf_stExExtInt_C "Initialisierungsanforderung beim Verlassen des Zustands ""externer Momenteneingriff""" VALUE 0xC79C9 Kw_Wu8 3.000 OneToOne 0.00 3.000 FORMAT "%5.3" EXTENDED_LIMITS 0.00 255.0 /end CHARACTERISTIC
/begin CHARACTERISTIC ASDrf_stExFDC_C "status of exit init flag" VALUE 0xC79CA Kw_Wu8 3.000 OneToOne 0.00 3.000 FORMAT "%5.3" EXTENDED_LIMITS 0.00 255.0 /end CHARACTERISTIC
/begin CHARACTERISTIC ASDrf_stExGrip_C "Initialisierungsanforderung beim Verlasssen des Zustands ""Vortrieb""" VALUE 0xC79CB Kw_Wu8 3.000 OneToOne 0.00 3.000 FORMAT "%5.3" EXTENDED_LIMITS 0.00 255.0 /end CHARACTERISTIC
/begin CHARACTERISTIC ASDrf_stExState3_C "Initialisierungsanforderung beim Verlassen des Zustands 3" VALUE 0xC79CC Kw_Wu8 3.000 OneToOne 0.00 3.000 FORMAT "%5.3" EXTENDED_LIMITS 0.00 255.0 /end CHARACTERISTIC
/begin CHARACTERISTIC ASDrf_stExState4_C "Initialisierungsanforderung beim Verlassen des Zustands 4" VALUE 0xC79CD Kw_Wu8 3.000 OneToOne 0.00 3.000 FORMAT "%5.3" EXTENDED_LIMITS 0.00 255.0 /end CHARACTERISTIC
/begin CHARACTERISTIC ASDrf_stExtInt_C "Konfiguration der Eingangsbedingung ""externer Momenteneingriff""" VALUE 0xC79CE Kw_Wu16 65535.00 OneToOne 0.00 65535.00 FORMAT "%8.2" /end CHARACTERISTIC
/begin CHARACTERISTIC ASDrf_stFDC_C "modulation on i/p condition for sport vehicle mode" VALUE 0xC79D0 Kw_Wu16 65535.00 OneToOne 0.00 65535.00 FORMAT "%8.2" /end CHARACTERISTIC
/begin CHARACTERISTIC ASDrf_stGrip_C "Konfiguration der Eingangsbedingung ""offener Antriebsstrang""" VALUE 0xC79D2 Kw_Wu16 65535.00 OneToOne 0.00 65535.00 FORMAT "%8.2" /end CHARACTERISTIC
/begin CHARACTERISTIC ASDrf_stReliablAdpt_C "Flags zur Bestimmung einer vertrauenswürdigen Verlustmomentadaption." VALUE 0xC79D4 Kw_Wu8 255.0 OneToOne 0.00 255.0 FORMAT "%5.1" /end CHARACTERISTIC
/begin CHARACTERISTIC ASDrf_swtCalcTrq_C "Schalter für die Berechnung des aktuellen ASD Moments (1: berücksichtigt ASDdc Moment, 0: ASDdc Moment nicht berücksichtigt)" VALUE 0xC794C Kw_Wu8 1.000 OneToOne 0.00 1.000 FORMAT "%5.3" EXTENDED_LIMITS 0.00 255.0 /end CHARACTERISTIC
/begin CHARACTERISTIC ASDrf_swtFlt_C "Schalter zur Auswahl des Filters für CoEng_trqInrLtd (0  Filterung / >0 keine Filterung)." VALUE 0xC794D Kw_Wu8 255.0 OneToOne 0.00 255.0 FORMAT "%5.1" /end CHARACTERISTIC
/begin CHARACTERISTIC ASDrf_swtFrzLoss_C "Schalter für die Berechnung des Verlustmoments bei aktiver Steigungsbegrenzung (1=eingefroren)" VALUE 0xC794E Kw_Wu8 1.000 OneToOne 0.00 1.000 FORMAT "%5.3" EXTENDED_LIMITS 0.00 255.0 /end CHARACTERISTIC
/begin CHARACTERISTIC ASDrf_swtInitPS_C "Schalter zur Aktivierung/Deaktivierung der kontinuierlichen Initialisierung aufgrund Parametersatzwechsels (>128: keine init.)" VALUE 0xC794F Kw_Wu8 255.0 OneToOne 0.00 255.0 FORMAT "%5.1" /end CHARACTERISTIC
/begin CHARACTERISTIC ASDrf_swtLim_C "Schalter zur Begrenzung von ASDrf_trqIn. (Bit0 gesetzt: verhindere <0, Bit1 gesetzt: verhindere >CoEng_trqInrLim)" VALUE 0xC7950 Kw_Wu8 3.000 OneToOne 0.00 3.000 FORMAT "%5.3" EXTENDED_LIMITS 0.00 255.0 /end CHARACTERISTIC
/begin CHARACTERISTIC ASDrf_swtLossClcNoRel_C "Verlustmoment wenn keine Verlustmomentadaption. Applikationsdaten als 0: absolut, 1: offset, 2: offset zum angepassten Moment" VALUE 0xC79D5 Kw_Wu8 2.000 OneToOne 0.00 2.000 FORMAT "%5.3" EXTENDED_LIMITS 0.00 255.0 /end CHARACTERISTIC
/begin CHARACTERISTIC ASDrf_swtLossClcRel_C " Verlustmoment bei Verlustmomentadaption. Verw. Applikationsdaten als 0: absolut, 1: offset, 2: offset zum angepassten Moment" VALUE 0xC79D6 Kw_Wu8 2.000 OneToOne 0.00 2.000 FORMAT "%5.3" EXTENDED_LIMITS 0.00 255.0 /end CHARACTERISTIC
/begin CHARACTERISTIC ASDrf_swtOpr_C "Auswahl des Operators für die Primärzustände. (00=OR, 01=AND, 10=NAND, 11=NOR)" VALUE 0xC79D8 Kw_Wu16 65535.00 OneToOne 0.00 65535.00 FORMAT "%8.2" /end CHARACTERISTIC
/begin CHARACTERISTIC ASDrf_swtStiffParameter_C "Schalter zur Berücksichtigung der Parameterumschaltung durch DCC" VALUE 0xC79DA Kw_Wu8 1.000 OneToOne 0.00 1.000 FORMAT "%5.3" EXTENDED_LIMITS 0.00 255.0 /end CHARACTERISTIC
/begin CHARACTERISTIC ASDrf_T1FDCNeg_CUR "Curve for n dependent time constant for PDT1 filtering for negative i/p" CURVE 0xC7B9A Kl_Xs16_Ws16 1.499985 TimeDelay_s_Lin_16 0.00 1.499985 FORMAT "%8.6" EXTENDED_LIMITS -5.000153 5.000000
 /begin AXIS_DESCR STD_AXIS DrvTrn_rTransDT TransR 8 0.00 100.0000 FORMAT "%8.4" EXTENDED_LIMITS -327.6800 327.6700 DEPOSIT ABSOLUTE /end AXIS_DESCR
/end CHARACTERISTIC
/begin CHARACTERISTIC ASDrf_T1FDCPos_CUR "Curve for n dependent time constant for PDT1 filtering for positive i/p" CURVE 0xC7BBC Kl_Xs16_Ws16 1.499985 TimeDelay_s_Lin_16 0.00 1.499985 FORMAT "%8.6" EXTENDED_LIMITS -5.000153 5.000000
 /begin AXIS_DESCR STD_AXIS DrvTrn_rTransDT TransR 8 0.00 100.0000 FORMAT "%8.4" EXTENDED_LIMITS -327.6800 327.6700 DEPOSIT ABSOLUTE /end AXIS_DESCR
/end CHARACTERISTIC
/begin CHARACTERISTIC ASDrf_T1GripNeg_CUR "T1 bei geshchlosenem Antreibsstrang und negativem Gradienten" CURVE 0xC7BDE Kl_Xs16_Ws16 1.499985 TimeDelay_s_Lin_16 0.00 1.499985 FORMAT "%8.6" EXTENDED_LIMITS -5.000153 5.000000
 /begin AXIS_DESCR STD_AXIS DrvTrn_rTransDT TransR 6 0.00 100.0000 FORMAT "%8.4" EXTENDED_LIMITS -327.6800 327.6700 DEPOSIT ABSOLUTE /end AXIS_DESCR
/end CHARACTERISTIC
/begin CHARACTERISTIC ASDrf_T1GripPos_CUR "T1 bei geschlosenem Antriebstrang und positivem Gradienten" CURVE 0xC7BF8 Kl_Xs16_Ws16 1.499985 TimeDelay_s_Lin_16 0.00 1.499985 FORMAT "%8.6" EXTENDED_LIMITS -5.000153 5.000000
 /begin AXIS_DESCR STD_AXIS DrvTrn_rTransDT TransR 6 0.00 100.0000 FORMAT "%8.4" EXTENDED_LIMITS -327.6800 327.6700 DEPOSIT ABSOLUTE /end AXIS_DESCR
/end CHARACTERISTIC
/begin CHARACTERISTIC ASDrf_tiTrqSty_C "Zeit für die Erkennung des stationären Zustands, wenn das Moment innerhalb des Intervalls liegt." VALUE 0xC7952 Kw_Wu16 655350.0 Time_ms 0.00 655350.0 FORMAT "%8.1" /end CHARACTERISTIC
/begin CHARACTERISTIC ASDrf_trqDecHigh_C "Offset der oberen Intervallgrenze zur Bestimmung des stationären Zustands." VALUE 0xC7954 Kw_Ws16 1500.000 Trq -500.0000 1000.000 FORMAT "%8.3" EXTENDED_LIMITS -3276.800 3276.700 /end CHARACTERISTIC
/begin CHARACTERISTIC ASDrf_trqDecLow_C "Offset der unteren Intervallgrenze zur Bestimmung des stationären Zustands." VALUE 0xC7956 Kw_Ws16 1500.000 Trq -500.0000 1000.000 FORMAT "%8.3" EXTENDED_LIMITS -3276.800 3276.700 /end CHARACTERISTIC
/begin CHARACTERISTIC ASDrf_trqInr_Vector "#SSD Bypass Label, nicht ändern!" VALUE 0xC30CE Kw_Wu8 255.0 OneToOne 0.00 255.0 FORMAT "%5.1" /end CHARACTERISTIC
/begin CHARACTERISTIC ASDrf_trqInr_Channel "#SSD Bypass Label, nicht ändern!" VALUE 0xC30CF Kw_Wu8 255.0 OneToOne 0.00 255.0 FORMAT "%5.1" /end CHARACTERISTIC
/begin CHARACTERISTIC ASDrf_trqLossNeg_CUR "Drehzahlabhängige Kennlinie der Verlustmomente für negative Eingangsänderungen." CURVE 0xC79DC Kl_Xs16_Ws16 1500.000 Trq -500.0000 1000.000 FORMAT "%8.3" EXTENDED_LIMITS -3276.800 3276.700
 /begin AXIS_DESCR STD_AXIS Eng_nAvrg EngN 8 0.00 6000.000 FORMAT "%8.3" EXTENDED_LIMITS -32768.00 32767.00 DEPOSIT ABSOLUTE /end AXIS_DESCR
/end CHARACTERISTIC
/begin CHARACTERISTIC ASDrf_trqLossPos_CUR "Drehzahlabhängige Kennlinie der Verlustmomente für positive Eingangsänderungen." CURVE 0xC79FE Kl_Xs16_Ws16 1500.000 Trq -500.0000 1000.000 FORMAT "%8.3" EXTENDED_LIMITS -3276.800 3276.700
 /begin AXIS_DESCR STD_AXIS Eng_nAvrg EngN 8 0.00 6000.000 FORMAT "%8.3" EXTENDED_LIMITS -32768.00 32767.00 DEPOSIT ABSOLUTE /end AXIS_DESCR
/end CHARACTERISTIC
/begin CHARACTERISTIC ASDrf_trqOfsNegHigh_C "Annäherungsschwelle zum Verlustmoment." VALUE 0xC7A20 Kw_Ws16 1500.000 Trq -500.0000 1000.000 FORMAT "%8.3" EXTENDED_LIMITS -3276.800 3276.700 /end CHARACTERISTIC
/begin CHARACTERISTIC ASDrf_trqOfsNegLow_C "Offset zum Verlustmoment für die Beendigung des Zustands ""Steigungsbegrenzung""." VALUE 0xC7A22 Kw_Ws16 1500.000 Trq -500.0000 1000.000 FORMAT "%8.3" EXTENDED_LIMITS -3276.800 3276.700 /end CHARACTERISTIC
/begin CHARACTERISTIC ASDrf_trqOfsNegMid_C "Offset zum Verslustmoment für die Annäherungserkennung und Aktivierung des Zustands ""Steigungsbegrenzung""" VALUE 0xC7A24 Kw_Ws16 1500.000 Trq -500.0000 1000.000 FORMAT "%8.3" EXTENDED_LIMITS -3276.800 3276.700 /end CHARACTERISTIC
/begin CHARACTERISTIC ASDrf_trqOfsPosHigh_C "Offset zum Verlustmoment für die Beendigung des Zustands ""Steigungsbegrenzung""." VALUE 0xC7A26 Kw_Ws16 1500.000 Trq -500.0000 1000.000 FORMAT "%8.3" EXTENDED_LIMITS -3276.800 3276.700 /end CHARACTERISTIC
/begin CHARACTERISTIC ASDrf_trqOfsPosLow_C "Annäherungsschwelle zum Verlustmoment." VALUE 0xC7A28 Kw_Ws16 1500.000 Trq -500.0000 1000.000 FORMAT "%8.3" EXTENDED_LIMITS -3276.800 3276.700 /end CHARACTERISTIC
/begin CHARACTERISTIC ASDrf_trqOfsPosMid_C "Offset zum Verslustmoment für die Annäherungserkennung und Aktivierung des Zustands ""Steigungsbegrenzung""" VALUE 0xC7A2A Kw_Ws16 1500.000 Trq -500.0000 1000.000 FORMAT "%8.3" EXTENDED_LIMITS -3276.800 3276.700 /end CHARACTERISTIC
/begin CHARACTERISTIC ASDrf_trqThresDecLim_C "Abstand zum Startpunt zur Deaktivierung der Steigungsbegrenzung durch Drehmomentabsenkung." VALUE 0xC7958 Kw_Ws16 1500.000 Trq -500.0000 1000.000 FORMAT "%8.3" EXTENDED_LIMITS -3276.800 3276.700 /end CHARACTERISTIC
/begin CHARACTERISTIC ASDrf_trqThresNeg_C "ARD Führungsformer Hystereseschwelle Wunschmomentgradient 'neg' alle Ganggrp." VALUE 0xC795A Kw_Ws16 1500.000 Trq -500.0000 1000.000 FORMAT "%8.3" EXTENDED_LIMITS -3276.800 3276.700 /end CHARACTERISTIC
/begin CHARACTERISTIC ASDrf_trqThresPos_C "ARD Führungsformer Hystereseschwelle Wunschmomentgradient 'pos' alle Ganggrp." VALUE 0xC795C Kw_Ws16 1500.000 Trq -500.0000 1000.000 FORMAT "%8.3" EXTENDED_LIMITS -3276.800 3276.700 /end CHARACTERISTIC
/begin CHARACTERISTIC ASMod_dmIndAirRef_MAP "Referenz des Gasmassenstroms als Funktion der Drehzahl und der verbrannten Kraftstoffmasse" MAP 0xC7C12 Kf_Xs16_Ys16_Ws16 1400.000 AirMassPerTime 0.00 1400.000 FORMAT "%8.3" EXTENDED_LIMITS -3276.800 3276.700
 /begin AXIS_DESCR STD_AXIS Eng_nAvrg EngN 8 0.00 6000.000 FORMAT "%8.3" EXTENDED_LIMITS -32768.00 32767.00 DEPOSIT ABSOLUTE /end AXIS_DESCR
 /begin AXIS_DESCR STD_AXIS ASMod_qLmbdCtlCorr_mp InjMass 8 0.00 150.0000 FORMAT "%8.4" EXTENDED_LIMITS -327.6800 327.6700 DEPOSIT ABSOLUTE /end AXIS_DESCR
/end CHARACTERISTIC
/begin CHARACTERISTIC ASMod_facDdTm_C "Faktor zur Berechnung der Gaslaufzeit durch den Motor" VALUE 0xC7CB6 Kw_Ws16 7.000000 Fact1 1.000000 8.000000 FORMAT "%8.6" EXTENDED_LIMITS -256.0000 255.9922 /end CHARACTERISTIC
/begin CHARACTERISTIC ASMod_facDMCorTDiff_CUR "Korrekturfaktor der Temperaturerhöhung aufgrund des aktuellen Gasmassenstroms" CURVE 0xC7CB8 Kl_Xs16_Ws16 2.000000 Fact 0.00 2.000000 FORMAT "%8.6" EXTENDED_LIMITS -4.000000 3.999878
 /begin AXIS_DESCR STD_AXIS ASMod_rDMIndAir_mp RatAirMass 8 -1.000000 1.000000 FORMAT "%8.6" EXTENDED_LIMITS -32.76800 32.76700 DEPOSIT ABSOLUTE /end AXIS_DESCR
/end CHARACTERISTIC
/begin CHARACTERISTIC ASMod_facSOICorTDiff_CUR "Korrekturfaktor der Temperaturerhöhung aufgrund des aktuellen Spritzbeginns" CURVE 0xC7CDA Kl_Xs16_Ws16 2.000000 Fact 0.00 2.000000 FORMAT "%8.6" EXTENDED_LIMITS -4.000000 3.999878
 /begin AXIS_DESCR STD_AXIS InjCrv_phiMI1Des AngleCrS 8 -19.99219 19.99219 FORMAT "%8.5" EXTENDED_LIMITS -768.0000 767.9766 DEPOSIT ABSOLUTE /end AXIS_DESCR
/end CHARACTERISTIC
/begin CHARACTERISTIC ASMod_facTCorVolEff_C "Korrekturfaktor zur Kompensation der Abhängigkeit des Luftaufwands von der Gastemperatur vor Einlass" VALUE 0xC7E70 Kw_Ws16 2.000000 RatAirMass 0.00 2.000000 FORMAT "%8.6" EXTENDED_LIMITS -32.76800 32.76700 /end CHARACTERISTIC
/begin CHARACTERISTIC ASMod_facVolEff_MAP "Luftaufwand des Motors als Funktion von Drehzahl und aktueller Einspritzmenge" MAP 0xC7E72 Kf_Xs16_Ys16_Ws16 1.000000 RatAirMass 0.00 1.000000 FORMAT "%8.6" EXTENDED_LIMITS -32.76800 32.76700
 /begin AXIS_DESCR STD_AXIS Eng_nAvrg EngN 10 0.00 6000.000 FORMAT "%8.3" EXTENDED_LIMITS -32768.00 32767.00 DEPOSIT ABSOLUTE /end AXIS_DESCR
 /begin AXIS_DESCR STD_AXIS InjCtl_qCurr InjMassCyc 15 0.00 327.6700 FORMAT "%8.4" EXTENDED_LIMITS -327.6800 327.6700 DEPOSIT ABSOLUTE /end AXIS_DESCR
/end CHARACTERISTIC
/begin CHARACTERISTIC ASMod_facVSACorVolEff_MAP "Korrekturfaktor für Luftaufwand als Funktion von Drehzahl und relativer Drallklappenposition" MAP 0xC7FD4 Kf_Xs16_Ys16_Ws16 2.000000 RatAirMass 0.00 2.000000 FORMAT "%8.6" EXTENDED_LIMITS -32.76800 32.76700
 /begin AXIS_DESCR STD_AXIS Eng_nAvrg EngN 10 0.00 6000.000 FORMAT "%8.3" EXTENDED_LIMITS -32768.00 32767.00 DEPOSIT ABSOLUTE /end AXIS_DESCR
 /begin AXIS_DESCR STD_AXIS ASMod_rRelPosVSA Prc 10 0.00 100.0000 FORMAT "%8.4" EXTENDED_LIMITS -400.0000 399.9878 DEPOSIT ABSOLUTE /end AXIS_DESCR
/end CHARACTERISTIC
/begin CHARACTERISTIC ASMod_phiSOIRef_MAP "Referenz des Spritzbeginns der MI1 als Funktion der Dehzahl und der verbrannten Kraftstoffmenge" MAP 0xC7CFC Kf_Xs16_Ys16_Ws16 60.00000 AngleCrS -19.99219 40.00781 FORMAT "%8.5" EXTENDED_LIMITS -768.0000 767.9766
 /begin AXIS_DESCR STD_AXIS Eng_nAvrg EngN 8 0.00 6000.000 FORMAT "%8.3" EXTENDED_LIMITS -32768.00 32767.00 DEPOSIT ABSOLUTE /end AXIS_DESCR
 /begin AXIS_DESCR STD_AXIS ASMod_qLmbdCtlCorr_mp InjMass 8 0.00 150.0000 FORMAT "%8.4" EXTENDED_LIMITS -327.6800 327.6700 DEPOSIT ABSOLUTE /end AXIS_DESCR
/end CHARACTERISTIC
/begin CHARACTERISTIC ASMod_swtT_C "Schalter für Lufttemperatursenor (0 = Aufnahme der Lufttemperatur vom HFM6 Sensor, 1 = Lufttemperatur nach Kühler)" VALUE 0xC80C8 Kw_Wu8 1.000 OneToOne 0.00 1.000 FORMAT "%5.3" EXTENDED_LIMITS 0.00 255.0 /end CHARACTERISTIC
/begin CHARACTERISTIC ASMod_tDiffEng_MAP "Grundkennfeld der Temperaturerhöhung als Funktion der Drehzahl und der verbrannten Kraftstoffmenge" MAP 0xC7DA0 Kf_Xs16_Ys16_Ws16 1200.000 TempDiff_Cels -600.0000 600.0000 FORMAT "%8.4" EXTENDED_LIMITS -3276.800 3276.700
 /begin AXIS_DESCR STD_AXIS Eng_nAvrg EngN 8 0.00 6000.000 FORMAT "%8.3" EXTENDED_LIMITS -32768.00 32767.00 DEPOSIT ABSOLUTE /end AXIS_DESCR
 /begin AXIS_DESCR STD_AXIS ASMod_qBurned_mp InjMass 8 0.00 150.0000 FORMAT "%8.4" EXTENDED_LIMITS -327.6800 327.6700 DEPOSIT ABSOLUTE /end AXIS_DESCR
/end CHARACTERISTIC
/begin CHARACTERISTIC ASMod_tEngCorTDiff_CUR "Korrektur der Temperaturerhöhung aufgrund der Motortemperatur" CURVE 0xC7E44 Kl_Xs16_Ws16 950.0000 Temp_Cels -50.1400 899.8600 FORMAT "%8.4" EXTENDED_LIMITS -3549.8000 3003.7000
 /begin AXIS_DESCR STD_AXIS ASMod_tEngCorTDiff_mp TempDiff_Cels 8 -20.00000 120.0000 FORMAT "%8.4" EXTENDED_LIMITS -3276.800 3276.700 DEPOSIT ABSOLUTE /end AXIS_DESCR
/end CHARACTERISTIC
/begin CHARACTERISTIC ASMod_tEngRef_C "Referenz der Motoretemperatur" VALUE 0xC7E66 Kw_Ws16 950.0000 Temp_Cels -50.1400 899.8600 FORMAT "%8.4" EXTENDED_LIMITS -3549.940 3003.560 /end CHARACTERISTIC
/begin CHARACTERISTIC ASMod_tiDT1_C "Zeitkonstante des DT1-Glieds in der Funktion Einlaßvolumen (induction volume)" VALUE 0xC7E68 Kw_Wu32 4.9499617 TimeDelay_s 0.050000201 4.9999619 FORMAT "%9.7" EXTENDED_LIMITS 0.0000010000000 4294.9673 /end CHARACTERISTIC
/begin CHARACTERISTIC ASMod_tIndAirRef_MAP "Referenz der Gastemperatur vor Einlass als Funktion von Drehzahl und aktueller Einspritzmenge" MAP 0xC80CA Kf_Xs16_Ys16_Ws16 250.0000 Temp_Cels -50.1400 199.8600 FORMAT "%8.4" EXTENDED_LIMITS -3549.940 3003.560
 /begin AXIS_DESCR STD_AXIS Eng_nAvrg EngN 10 0.00 6000.000 FORMAT "%8.3" EXTENDED_LIMITS -32768.00 32767.00 DEPOSIT ABSOLUTE /end AXIS_DESCR
 /begin AXIS_DESCR STD_AXIS InjCtl_qCurr InjMassCyc 10 0.00 327.6700 FORMAT "%8.4" EXTENDED_LIMITS -327.6800 327.6700 DEPOSIT ABSOLUTE /end AXIS_DESCR
/end CHARACTERISTIC
/begin CHARACTERISTIC ASMod_volEng_C "Hubvolumen des Motors" VALUE 0xC81BE Kw_Ws16 20.00000 Vol 0.00 20.00000 FORMAT "%8.5" EXTENDED_LIMITS -327.6800 327.6700 /end CHARACTERISTIC
/begin CHARACTERISTIC ASMod_volIndVol_C "Einlaßvolumen (effektives Volumen zwischen Turbolader und Mischstelle)" VALUE 0xC7E6C Kw_Ws16 50.00000 Vol 0.00 50.00000 FORMAT "%8.5" EXTENDED_LIMITS -327.6800 327.6700 /end CHARACTERISTIC
/begin CHARACTERISTIC BattCD_uSRCMin_C "SRC-Min der Batteriespannung" VALUE 0xC81C4 Kw_Ws16 5200.391 Volt 0.00 5200.391 FORMAT "%8.3" EXTENDED_LIMITS -160156.4 160151.5 /end CHARACTERISTIC
/begin CHARACTERISTIC BattCD_uSRCMax_C "SRC-Max der Batteriespannung" VALUE 0xC81C6 Kw_Ws16 5200.391 Volt 0.00 5200.391 FORMAT "%8.3" EXTENDED_LIMITS -160156.4 160151.5 /end CHARACTERISTIC
/begin CHARACTERISTIC BattCD_uLin_CUR "Linearisierungskennlinie" CURVE 0xC81C8 Kl_Xs16_Ws16 28602.15 Volt_Batt 0.00 28602.15 FORMAT "%8.2" EXTENDED_LIMITS -640625.6 640606.1
 /begin AXIS_DESCR STD_AXIS BattCD_uRaw Volt 25 0.00 5200.391 FORMAT "%8.3" EXTENDED_LIMITS -160156.4 160151.5 DEPOSIT ABSOLUTE /end AXIS_DESCR
/end CHARACTERISTIC
/begin CHARACTERISTIC BattCD_DebSRCHighDef_C "Entprellzeit für Fehlererkennung des SRC-High-Fehlers der Batteriespannung" VALUE 0xC822E Kw_Wu16 655350.0 Time_ms 0.00 655350.0 FORMAT "%8.1" /end CHARACTERISTIC
/begin CHARACTERISTIC BattCD_DebSRCHighOk_C "Entprellzeit für Heilung des SRC-High-Fehlers der Batteriespannung" VALUE 0xC8230 Kw_Wu16 655350.0 Time_ms 0.00 655350.0 FORMAT "%8.1" /end CHARACTERISTIC
/begin CHARACTERISTIC BattCD_DebSRCLowDef_C "Entprellzeit für Fehlererkennung des SRC-Low-Fehlers der Batteriespannung" VALUE 0xC8232 Kw_Wu16 655350.0 Time_ms 0.00 655350.0 FORMAT "%8.1" /end CHARACTERISTIC
/begin CHARACTERISTIC BattCD_DebSRCLowOk_C "Entprellzeit für Heilung des SRC-Low-Fehlers der Batteriespannung" VALUE 0xC8234 Kw_Wu16 655350.0 Time_ms 0.00 655350.0 FORMAT "%8.1" /end CHARACTERISTIC
/begin CHARACTERISTIC BattCD_numAdc_C "#SSD Applikationsparameter" VALUE 0xC8236 Kw_Wu8 26.0000000000 NumPinAdc 0.00 26.0000000000 FORMAT "%13.10" /end CHARACTERISTIC
/begin CHARACTERISTIC BattCD_duRmpSlpUp_C "Rampe Zunahme Batteriespannung negative Steigung" VALUE 0xC8238 Kw_Wu32 1281250244.02 RmpVoltBatt 977.576769459 1281251221.60 FORMAT "%13.2" EXTENDED_LIMITS 0.00 1281251221.60 /end CHARACTERISTIC
/begin CHARACTERISTIC BattCD_duRmpSlpDwn_C "Rampe Zunahme Batteriespannung positive Steigung" VALUE 0xC823C Kw_Wu32 1281250244.02 RmpVoltBatt 977.576769459 1281251221.60 FORMAT "%13.2" EXTENDED_LIMITS 0.00 1281251221.60 /end CHARACTERISTIC
/begin CHARACTERISTIC BattCD_stSensIDWord_C "Kennung Batteriespannungserfassung" VALUE 0xC8240 Kw_Wu16 65535.00 OneToOne 0.00 65535.00 FORMAT "%8.2" /end CHARACTERISTIC
/begin CHARACTERISTIC BattCD_uDfl_C "Vorgabewert Batteriespannung" VALUE 0xC8242 Kw_Ws16 28602.15 Volt_Batt 0.00 28602.15 FORMAT "%8.2" EXTENDED_LIMITS -640625.6 640606.1 /end CHARACTERISTIC
/begin CHARACTERISTIC Batt_uNrm_C "#SSD Normierte Batteriespannung" VALUE 0xC81C0 Kw_Ws16 1281232. Volt_Batt -640625.6 640606.1 FORMAT "%8.1" /end CHARACTERISTIC
/begin CHARACTERISTIC BPACD_ctPwrStgOnMax_C "Maximum der Endstufen aktivierungen im Fahrzyklus bei SCB oder Übertemperatur Fehler" VALUE 0xC8244 Kw_Wu16 65535.00 OneToOne 0.00 65535.00 FORMAT "%8.2" /end CHARACTERISTIC
/begin CHARACTERISTIC BPACD_tiDebBPADia1Def_C "debounce duration for boost pressure actor diagnosis error detection" VALUE 0xC8246 Kw_Wu16 655350.0 Time_ms 0.00 655350.0 FORMAT "%8.1" /end CHARACTERISTIC
/begin CHARACTERISTIC BPACD_tiDebBPADia1Ok_C "debounce duration for boost pressure actor diagnosis error healing" VALUE 0xC8248 Kw_Wu16 655350.0 Time_ms 0.00 655350.0 FORMAT "%8.1" /end CHARACTERISTIC
/begin CHARACTERISTIC BPACD_tiDebBPADia2Def_C "debounce duration for boost pressure actor diagnosis error detection" VALUE 0xC824A Kw_Wu16 655350.0 Time_ms 0.00 655350.0 FORMAT "%8.1" /end CHARACTERISTIC
/begin CHARACTERISTIC BPACD_tiDebBPADia2Ok_C "debounce duration for boost pressure actor diagnosis error healing" VALUE 0xC824C Kw_Wu16 655350.0 Time_ms 0.00 655350.0 FORMAT "%8.1" /end CHARACTERISTIC
/begin CHARACTERISTIC BPACD_tiDebBPADia3Def_C "debounce duration for boost pressure actor diagnosis error detection" VALUE 0xC824E Kw_Wu16 655350.0 Time_ms 0.00 655350.0 FORMAT "%8.1" /end CHARACTERISTIC
/begin CHARACTERISTIC BPACD_tiDebBPADia3Ok_C "debounce duration for boost pressure actor diagnosis error healing" VALUE 0xC8250 Kw_Wu16 655350.0 Time_ms 0.00 655350.0 FORMAT "%8.1" /end CHARACTERISTIC
/begin CHARACTERISTIC BPACD_DebExcTempDef_C "#SSD Fehlerentprellzeit für Übertemperatur" VALUE 0xC8252 Kw_Wu16 655350.0 Time_ms 0.00 655350.0 FORMAT "%8.1" /end CHARACTERISTIC
/begin CHARACTERISTIC BPACD_DebExcTempOk_C "Heilungsentprellzeit für Übertemperatur" VALUE 0xC8254 Kw_Wu16 655350.0 Time_ms 0.00 655350.0 FORMAT "%8.1" /end CHARACTERISTIC
/begin CHARACTERISTIC BPACD_DebNoLoadDef_C "#SSD Fehlerentprellzeit für Lastabfall" VALUE 0xC8256 Kw_Wu16 655350.0 Time_ms 0.00 655350.0 FORMAT "%8.1" /end CHARACTERISTIC
/begin CHARACTERISTIC BPACD_DebNoLoadOk_C "Heilungsentprellzeit für Lastabfall" VALUE 0xC8258 Kw_Wu16 655350.0 Time_ms 0.00 655350.0 FORMAT "%8.1" /end CHARACTERISTIC
/begin CHARACTERISTIC BPACD_DebShortCircBatDef_C "#SSD Fehlerentprellzeitzeit für Kurzschluß nach Batteriespannung" VALUE 0xC825A Kw_Wu16 655350.0 Time_ms 0.00 655350.0 FORMAT "%8.1" /end CHARACTERISTIC
/begin CHARACTERISTIC BPACD_DebShortCircBatOk_C "Heilungsentprellzeit für Kurzschluß nach Batteriespannung" VALUE 0xC825C Kw_Wu16 655350.0 Time_ms 0.00 655350.0 FORMAT "%8.1" /end CHARACTERISTIC
/begin CHARACTERISTIC BPACD_DebShortCircGndDef_C "#SSD Fehlerentprellzeit für Kurzschluß nach Masse" VALUE 0xC825E Kw_Wu16 655350.0 Time_ms 0.00 655350.0 FORMAT "%8.1" /end CHARACTERISTIC
/begin CHARACTERISTIC BPACD_DebShortCircGndOk_C "Heilungsentprellzeit für Kurzschluß nach Masse" VALUE 0xC8260 Kw_Wu16 655350.0 Time_ms 0.00 655350.0 FORMAT "%8.1" /end CHARACTERISTIC
/begin CHARACTERISTIC BPACD_numDia_C "#SSD Applikationsparameter fuer Diagnose Signal :BP-Steller" VALUE 0xC8262 Kw_Wu8 27.0000000000 NumPinDia 0.00 27.0000000000 FORMAT "%13.10" /end CHARACTERISTIC
/begin CHARACTERISTIC BPACD_numPwmOut_C "#SSD Applikationsparameter fuer Ladedruck-Steller" VALUE 0xC8263 Kw_Wu8 13.0000000000 NumPinPwmOut 0.00 13.0000000000 FORMAT "%13.10" /end CHARACTERISTIC
/begin CHARACTERISTIC BPACD_stInvOut_C "Invertierungsparameter für das Signal der Ladedruckstellerendstufe" VALUE 0xC8264 Kw_Wu8 1.000 OneToOne 0.00 1.000 FORMAT "%5.3" EXTENDED_LIMITS 0.00 255.0 /end CHARACTERISTIC
/begin CHARACTERISTIC BPACD_tiPer_C "Periodendauer Ladedrucksteller." VALUE 0xC8266 Kw_Ws16 6553.500 Period -3276.800 3276.700 FORMAT "%8.3" /end CHARACTERISTIC
/begin CHARACTERISTIC BPACD_rCnv_CUR "Kennlinie zur konvertierung von Öffnungsgrad in Tastverhältnis" CURVE 0xC8268 Kl_Xs16_Ws16 100.0000 DtyCyc 0.00 100.0000 FORMAT "%8.4" EXTENDED_LIMITS -327.6800 327.6700
 /begin AXIS_DESCR STD_AXIS BPA_rBPACD Prc 25 -100.0000 200.0000 FORMAT "%8.4" EXTENDED_LIMITS -400.0000 399.9878 DEPOSIT ABSOLUTE /end AXIS_DESCR
/end CHARACTERISTIC
/begin CHARACTERISTIC BPACD_rOutMax_C "Maximal auszugebendes Tastverhältnis" VALUE 0xC82CE Kw_Ws16 655.3500 DtyCyc -327.6800 327.6700 FORMAT "%8.4" /end CHARACTERISTIC
/begin CHARACTERISTIC BPACD_rOutMin_C "Minimal auszugebendes Tastverhältnis" VALUE 0xC82D0 Kw_Ws16 655.3500 DtyCyc -327.6800 327.6700 FORMAT "%8.4" /end CHARACTERISTIC
/begin CHARACTERISTIC BPACD_stPwrStgActv_C "Aktivierung der Abschaltbedingungen der Endstufe" VALUE 0xC82D2 Kw_Wu8 255.0 OneToOne 0.00 255.0 FORMAT "%5.1" /end CHARACTERISTIC
/begin CHARACTERISTIC BPACD_stPwrStgDia_C "#SSD Aktivierung der Abschaltbedingungen der Endstufediagnose" VALUE 0xC82D3 Kw_Wu8 255.0 OneToOne 0.00 255.0 FORMAT "%5.1" /end CHARACTERISTIC
/begin CHARACTERISTIC BPACD_stSPICtl_C "Parameter zur Auswahl des Endstufentypes  ( 1 = SPI Endstufe, 0 = Nicht SPI Endstufe )" VALUE 0xC82D4 Kw_Wu8 1.000 OneToOne 0.00 1.000 FORMAT "%5.3" EXTENDED_LIMITS 0.00 255.0 /end CHARACTERISTIC
/begin CHARACTERISTIC BPACD_swt_C "Schalter für Batteriespannungskorrektur (0 = AUS, 1 = EIN)" VALUE 0xC82D5 Kw_Wu8 255.0 OneToOne 0.00 255.0 FORMAT "%5.1" /end CHARACTERISTIC
/begin CHARACTERISTIC BPACD_tiBtwTst_C "#SSD Zeitabstand, in dem im Fehlerfall die Endstufe getestet wird" VALUE 0xC82D6 Kw_Wu16 29980.00 Time_ms 20.00000 30000.00 FORMAT "%8.2" EXTENDED_LIMITS 0.00 655350.0 /end CHARACTERISTIC
/begin CHARACTERISTIC BPACD_tiDiag1Max_C "window 1 max. time" VALUE 0xC82D8 Kw_Wu16 655350.0 Time_ms 0.00 655350.0 FORMAT "%8.1" /end CHARACTERISTIC
/begin CHARACTERISTIC BPACD_tiDiag1Min_C "window 1 min. time" VALUE 0xC82DA Kw_Wu16 655350.0 Time_ms 0.00 655350.0 FORMAT "%8.1" /end CHARACTERISTIC
/begin CHARACTERISTIC BPACD_tiDiag2Max_C "window 2 max. time" VALUE 0xC82DC Kw_Wu16 655350.0 Time_ms 0.00 655350.0 FORMAT "%8.1" /end CHARACTERISTIC
/begin CHARACTERISTIC BPACD_tiDiag2Min_C "window 2 min. time" VALUE 0xC82DE Kw_Wu16 655350.0 Time_ms 0.00 655350.0 FORMAT "%8.1" /end CHARACTERISTIC
/begin CHARACTERISTIC BPACD_tiDiag3Max_C "window 3 max. time" VALUE 0xC82E0 Kw_Wu16 655350.0 Time_ms 0.00 655350.0 FORMAT "%8.1" /end CHARACTERISTIC
/begin CHARACTERISTIC BPACD_tiDiag3Min_C "window 3 min. time" VALUE 0xC82E2 Kw_Wu16 655350.0 Time_ms 0.00 655350.0 FORMAT "%8.1" /end CHARACTERISTIC
/begin CHARACTERISTIC BPACD_tiPwrStgOn_C "Zeit für die die Endstufe eingeschalten wird bei nicht SPI Endstufen" VALUE 0xC82E4 Kw_Wu16 655140.0 Time_ms 0.00 655140.0 FORMAT "%8.1" EXTENDED_LIMITS 0.00 655350.0 /end CHARACTERISTIC
/begin CHARACTERISTIC BPA_rBPACD_Vector "#SSD Bypass-Label für BPA_rBPA" VALUE 0xC30D0 Kw_Wu8 255.0 OneToOne 0.00 255.0 FORMAT "%5.1" /end CHARACTERISTIC
/begin CHARACTERISTIC BPA_rBPACD_Channel "#SSD Bypass-Label für BPA_rBPA" VALUE 0xC30D1 Kw_Wu8 255.0 OneToOne 0.00 255.0 FORMAT "%5.1" /end CHARACTERISTIC
/begin CHARACTERISTIC BPA_rLPACD_Vector "Konfigurationslabel für Bypass Freischnitt" VALUE 0xC30D2 Kw_Wu8 255.0 OneToOne 0.00 255.0 FORMAT "%5.1" /end CHARACTERISTIC
/begin CHARACTERISTIC BPA_rLPACD_Channel "Konfigurationslabel für Bypass Freischnitt" VALUE 0xC30D3 Kw_Wu8 255.0 OneToOne 0.00 255.0 FORMAT "%5.1" /end CHARACTERISTIC
/begin CHARACTERISTIC BPSCD_uSRCMin_C "#SSD SRC-Min-Wert für Ladedruck." VALUE 0xC82E8 Kw_Ws16 5200.391 Volt 0.00 5200.391 FORMAT "%8.3" EXTENDED_LIMITS -160156.4 160151.5 /end CHARACTERISTIC
/begin CHARACTERISTIC BPSCD_uSRCMax_C "#SSD SRC-Max-Wert für Ladedruck." VALUE 0xC82EA Kw_Ws16 5200.391 Volt 0.00 5200.391 FORMAT "%8.3" EXTENDED_LIMITS -160156.4 160151.5 /end CHARACTERISTIC
/begin CHARACTERISTIC BPSCD_pLin_CUR "Linearisierungskennlinie" CURVE 0xC82EC Kl_Xs16_Ws16 5000.000 Pres_hPa 0.00 5000.000 FORMAT "%8.3" EXTENDED_LIMITS -32768.00 32767.00
 /begin AXIS_DESCR STD_AXIS BPSCD_uRawVal Volt 25 0.00 5000.000 FORMAT "%8.3" EXTENDED_LIMITS -160156.4 160151.5 DEPOSIT ABSOLUTE /end AXIS_DESCR
/end CHARACTERISTIC
/begin CHARACTERISTIC BPSCD_DebNplDef_C "#SSD Fehlerentprellung Plausbilitätsfehler" VALUE 0xC8352 Kw_Wu16 655350.0 Time_ms 0.00 655350.0 FORMAT "%8.1" /end CHARACTERISTIC
/begin CHARACTERISTIC BPSCD_DebNplOK_C "Heilungsentprellung Plausbilitätsfehler" VALUE 0xC8354 Kw_Wu16 655350.0 Time_ms 0.00 655350.0 FORMAT "%8.1" /end CHARACTERISTIC
/begin CHARACTERISTIC BPSCD_DebSigDef_C "#SSD Defektentprellzeit fuer CAN Signal defekt" VALUE 0xC8356 Kw_Wu16 655350.0 Time_ms 0.00 655350.0 FORMAT "%8.1" /end CHARACTERISTIC
/begin CHARACTERISTIC BPSCD_DebSigOK_C "Heilungsentprellzeit fuer CAN Signal defekt" VALUE 0xC8358 Kw_Wu16 655350.0 Time_ms 0.00 655350.0 FORMAT "%8.1" /end CHARACTERISTIC
/begin CHARACTERISTIC BPSCD_DebSRCHighDef_C "#SSD Fehlerentprellzeit fuer SRC-High Fehler" VALUE 0xC835A Kw_Wu16 655350.0 Time_ms 0.00 655350.0 FORMAT "%8.1" /end CHARACTERISTIC
/begin CHARACTERISTIC BPSCD_DebSRCHighOK_C "Heilungsentprellzeit fuer SRC-High Fehler" VALUE 0xC835C Kw_Wu16 655350.0 Time_ms 0.00 655350.0 FORMAT "%8.1" /end CHARACTERISTIC
/begin CHARACTERISTIC BPSCD_DebSRCLowDef_C "#SSD Fehlerentprellzeit fuer SRC-Low Fehler" VALUE 0xC835E Kw_Wu16 655350.0 Time_ms 0.00 655350.0 FORMAT "%8.1" /end CHARACTERISTIC
/begin CHARACTERISTIC BPSCD_DebSRCLowOK_C "Heilungsentprellzeit fuer SRC-Low Fehler" VALUE 0xC8360 Kw_Wu16 655350.0 Time_ms 0.00 655350.0 FORMAT "%8.1" /end CHARACTERISTIC
/begin CHARACTERISTIC BPSCD_tiDT1_C "Reciprocal of time delay" VALUE 0xC8364 Kw_Wu32 4294.9663 TimeDelay_s 0.0010000001 4294.9673 FORMAT "%9.4" EXTENDED_LIMITS 0.0000010000000 4294.9673 /end CHARACTERISTIC
/begin CHARACTERISTIC BPSCD_dDT1Kd_C "Reciprocal of time delay" VALUE 0xC8368 Kw_Ws32 10.0000000000 Kd 0.00 10.0000000000 FORMAT "%13.10" EXTENDED_LIMITS -32768.0000000 32767.9999847 /end CHARACTERISTIC
/begin CHARACTERISTIC BPSCD_tiLPFiltPT1_C "Zeitkonstante Tiefpass fuer Ladedruck_Fuehler" VALUE 0xC0494 Kw_Wu32 4294.9673 TimeDelay_s 0.0000010000000 4294.9673 FORMAT "%9.4" /end CHARACTERISTIC
/begin CHARACTERISTIC BPSCD_nLim_C "Obere Grenze Motordrehzahl." VALUE 0xC836C Kw_Ws16 6000.000 EngN 0.00 6000.000 FORMAT "%8.3" EXTENDED_LIMITS -32768.00 32767.00 /end CHARACTERISTIC
/begin CHARACTERISTIC BPSCD_numAdc_C "#SSD Applikationsparameter fuer Ladedruck-Steller" VALUE 0xC836E Kw_Wu8 26.0000000000 NumPinAdc 0.00 26.0000000000 FORMAT "%13.10" /end CHARACTERISTIC
/begin CHARACTERISTIC BPSCD_pDiffLim_C "Grenzwert für absolute Differenz zwischen LD und AD" VALUE 0xC8370 Kw_Ws16 3500.000 Pres_hPa 0.00 3500.000 FORMAT "%8.3" EXTENDED_LIMITS -32768.00 32767.00 /end CHARACTERISTIC
/begin CHARACTERISTIC BPSCD_tiOutValDT1_C "Totzeit für  Ladedruck DT1 filter" VALUE 0xC8374 Kw_Wu32 4294.9673 TimeDelay_s 0.0000010000000 4294.9673 FORMAT "%9.4" /end CHARACTERISTIC
/begin CHARACTERISTIC BPSCD_dDT1KdOutVal_C "Verstärkungskonstante des DT1 filters für  Ladedrucksignal" VALUE 0xC8378 Kw_Ws32 32767.9999847 Kd 0.00 32767.9999847 FORMAT "%13.7" EXTENDED_LIMITS -32768.0000000 32767.9999847 /end CHARACTERISTIC
/begin CHARACTERISTIC BPSCD_tiPT1_C "Verzugszeit. (für PT1 Filter )" VALUE 0xC837C Kw_Wu32 4294.9673 TimeDelay_s 0.0000010000000 4294.9673 FORMAT "%9.4" /end CHARACTERISTIC
/begin CHARACTERISTIC BPSCD_dpRmpSlpUp_C "Rampensteigung bei Heilung/Vorgabewert für LDF" VALUE 0xC8380 Kw_Wu32 65535899.9786 RmpPres_hPa 100.006103516 65535999.9847 FORMAT "%13.4" EXTENDED_LIMITS 0.00 65535999.9847 /end CHARACTERISTIC
/begin CHARACTERISTIC BPSCD_dpRmpSlpDwn_C "Rampensteigung bei Heilung/Vorgabewert für LDF" VALUE 0xC8384 Kw_Wu32 65535899.9786 RmpPres_hPa 100.006103516 65535999.9847 FORMAT "%13.4" EXTENDED_LIMITS 0.00 65535999.9847 /end CHARACTERISTIC
/begin CHARACTERISTIC BPSCD_swtSigVal_C "#SSD Schalter ob Signal ueber CAN/ADC (0 = ADC, 1 = CAN)" VALUE 0xC8388 Kw_Wu8 1.000 OneToOne 0.00 1.000 FORMAT "%5.3" EXTENDED_LIMITS 0.00 255.0 /end CHARACTERISTIC
/begin CHARACTERISTIC BPSCD_stSensIDWord_C "Geberkennwort LDF" VALUE 0xC838A Kw_Wu16 65535.00 OneToOne 0.00 65535.00 FORMAT "%8.2" /end CHARACTERISTIC
/begin CHARACTERISTIC BPSCD_pDfl_C "Ladedruck Vorgabewert" VALUE 0xC838C Kw_Ws16 65535.00 Pres_hPa -32768.00 32767.00 FORMAT "%8.2" /end CHARACTERISTIC
/begin CHARACTERISTIC BrkCD_ctUnPlausDef_C "Defektschwelle dese Unplausibilitätszählers" VALUE 0xC8390 Kw_Wu8 255.0 OneToOne 0.00 255.0 FORMAT "%5.1" /end CHARACTERISTIC
/begin CHARACTERISTIC BrkCD_DebPlaDef_C "#SSD Fehlerentprellzeit Plausibilitätsfehler" VALUE 0xC8392 Kw_Wu16 655350.0 Time_ms 0.00 655350.0 FORMAT "%8.1" /end CHARACTERISTIC
/begin CHARACTERISTIC BrkCD_DebPlaOk_C "#SSD Heilzeit Plausibilitätsfehler" VALUE 0xC8394 Kw_Wu16 655350.0 Time_ms 0.00 655350.0 FORMAT "%8.1" /end CHARACTERISTIC
/begin CHARACTERISTIC BrkCD_DebSigDef_C "Entprellzeit für CAN-Signal Defekterkennung" VALUE 0xC8396 Kw_Wu16 655350.0 Time_ms 0.00 655350.0 FORMAT "%8.1" /end CHARACTERISTIC
/begin CHARACTERISTIC BrkCD_DebSigOk_C "Entprellzeit für Heilung des CAN-Signalfehler" VALUE 0xC8398 Kw_Wu16 655350.0 Time_ms 0.00 655350.0 FORMAT "%8.1" /end CHARACTERISTIC
/begin CHARACTERISTIC BrkCD_tiMnSwtDebNeg_C "#SSD Entprellzeit Bremskontakt - abfallende Flanke" VALUE 0xC839A Kw_Wu16 655350.0 TimeDeb 0.00 655350.0 FORMAT "%8.1" /end CHARACTERISTIC
/begin CHARACTERISTIC BrkCD_tiMnSwtDebPos_C "#SSD Entprellzeit Bremskontakt - aufsteigende Flanke" VALUE 0xC839C Kw_Wu16 655350.0 TimeDeb 0.00 655350.0 FORMAT "%8.1" /end CHARACTERISTIC
/begin CHARACTERISTIC BrkCD_numDioInMn_C "#SSD Applikationsparameter fuer Bremspedal" VALUE 0xC839E Kw_Wu8 14.0000000000 NumPinDioIn 0.00 14.0000000000 FORMAT "%13.10" /end CHARACTERISTIC
/begin CHARACTERISTIC BrkCD_numDioInRed_C "#SSD Apllikationsparameter fuer redundante Bremssignal" VALUE 0xC839F Kw_Wu8 14.0000000000 NumPinDioIn 0.00 14.0000000000 FORMAT "%13.10" /end CHARACTERISTIC
/begin CHARACTERISTIC BrkCD_tiRedSwtDebNeg_C "#SSD Entprellzeit redundanter Bremskontakt - abfallende Flanke" VALUE 0xC83A0 Kw_Wu16 655350.0 TimeDeb 0.00 655350.0 FORMAT "%8.1" /end CHARACTERISTIC
/begin CHARACTERISTIC BrkCD_tiRedSwtDebPos_C "#SSD Entprellzeit redundanter Bremskontakt - aufsteigende Flanke" VALUE 0xC83A2 Kw_Wu16 655350.0 TimeDeb 0.00 655350.0 FORMAT "%8.1" /end CHARACTERISTIC
/begin CHARACTERISTIC BrkCD_stDflVal_C "Redundanter Bremskontakt-Vorgabewert" VALUE 0xC83A4 Kw_Wu8 3.000 OneToOne 0.00 3.000 FORMAT "%5.3" EXTENDED_LIMITS 0.00 255.0 /end CHARACTERISTIC
/begin CHARACTERISTIC BrkCD_stMnSwtInvIn_C "#SSD Signal Bremskontakt invertiert" VALUE 0xC83A5 Kw_Wu8 1.000 OneToOne 0.00 1.000 FORMAT "%5.3" EXTENDED_LIMITS 0.00 255.0 /end CHARACTERISTIC
/begin CHARACTERISTIC BrkCD_stRedSwtInvIn_C "#SSD Signal redundanter Bremskontakt invertiert" VALUE 0xC83A6 Kw_Wu8 1.000 OneToOne 0.00 1.000 FORMAT "%5.3" EXTENDED_LIMITS 0.00 255.0 /end CHARACTERISTIC
/begin CHARACTERISTIC BrkCD_swtRedSwtPresent_C "#SSD Schalter redundanter Bremskontakt vorhanden (1 = vorhanden, 0 = nicht vorhanden)" VALUE 0xC83A7 Kw_Wu8 1.000 OneToOne 0.00 1.000 FORMAT "%5.3" EXTENDED_LIMITS 0.00 255.0 /end CHARACTERISTIC
/begin CHARACTERISTIC BrkCD_swtSigVal_C "Schalterwert, Signal von HW DIO/CAN (1=CAN, 0=DIO)" VALUE 0xC83A8 Kw_Wu8 3.000 OneToOne 0.00 3.000 FORMAT "%5.3" EXTENDED_LIMITS 0.00 255.0 /end CHARACTERISTIC
/begin CHARACTERISTIC BrkCD_tiDebResUnPlaus_C "Entprellzeit zur Erkennung auf Plausibilität" VALUE 0xC83AA Kw_Wu16 655350.0 Time_ms 0.00 655350.0 FORMAT "%8.1" /end CHARACTERISTIC
/begin CHARACTERISTIC BrkCD_tiDebUnPlausStat_C "Entprellzeit zur Erkennung auf statische Unplausibilität" VALUE 0xC83AC Kw_Wu16 655350.0 Time_ms 0.00 655350.0 FORMAT "%8.1" /end CHARACTERISTIC
/begin CHARACTERISTIC BrkCD_tiDebUnPlaus_C "Entprellzeit zur Erkennung auf Unplausibilität" VALUE 0xC83AE Kw_Wu16 655350.0 Time_ms 0.00 655350.0 FORMAT "%8.1" /end CHARACTERISTIC
/begin MEASUREMENT AirCtl_dnAvrg_mp "Drehzahlgradient der gefilterten Drehzahlbeschleunigung gegen Laderpumpen" SWORD dn_dZ20 1 100 -327680.0 327670.0 FORMAT "%8.1" ECU_ADDRESS 0x8FE376 /end MEASUREMENT
/begin MEASUREMENT AirCtl_dnSurgeHigh_mp "Aktuelle obere Grenze für Drehzahlgradienten Hysterese" SWORD dn_dZ20 1 100 -327680.0 327670.0 FORMAT "%8.1" ECU_ADDRESS 0x8FE378 /end MEASUREMENT
/begin MEASUREMENT AirCtl_dnSurgeLow_mp "aktuelle untere Grenze für Drehzahlgradienten Hysterese gegen Laderpumpen" SWORD dn_dZ20 1 100 -327680.0 327670.0 FORMAT "%8.1" ECU_ADDRESS 0x8FE37A /end MEASUREMENT
/begin MEASUREMENT AirCtl_dqRaw_mp "Value after getting filtered(DT1 Filter) for message InjCtl_qRaw" SWORD InjMassPerSec_20ms 1 100 -16384.00 16383.50 FORMAT "%8.2" ECU_ADDRESS 0x8FE37C /end MEASUREMENT
/begin MEASUREMENT AirCtl_mDesMax_mp "Kalkulierte Luftmassenstrom bei geschlossener ARF" SWORD AirMassPerCyl 1 100 -3276.800 3276.700 FORMAT "%8.3" ECU_ADDRESS 0x8FE37E /end MEASUREMENT
/begin MEASUREMENT AirCtl_mMaxDvtRgn_mp "Obergrenze für Erkennung einer bleibenden Regelabweichung" SWORD AirMassPerCyl 1 100 -3276.800 3276.700 FORMAT "%8.3" ECU_ADDRESS 0x8FE398 /end MEASUREMENT
/begin MEASUREMENT AirCtl_mMinDvtRgn_mp "Untergrenze für Erkennung einer bleibenden Regelabwei-chung" SWORD AirMassPerCyl 1 100 -3276.800 3276.700 FORMAT "%8.3" ECU_ADDRESS 0x8FE39A /end MEASUREMENT
/begin MEASUREMENT AirCtl_qCurrRmp_mp "Meßpunkt nach Rampung der ungefilterten Einspritzmenge" SWORD InjMass 1 100 -327.6800 327.6700 FORMAT "%8.4" ECU_ADDRESS 0x8FE380 /end MEASUREMENT
/begin MEASUREMENT AirCtl_qSurgeHigh_mp "aktuelle obere Grenze für Mengen Hysterese gegen Laderpumpen" SWORD InjMass 1 100 -327.6800 327.6700 FORMAT "%8.4" ECU_ADDRESS 0x8FE382 /end MEASUREMENT
/begin MEASUREMENT AirCtl_qSurgeLow_mp "aktuelle untere Grenze für Mengen Hysterese gegen Laderpumpen" SWORD InjMass 1 100 -327.6800 327.6700 FORMAT "%8.4" ECU_ADDRESS 0x8FE384 /end MEASUREMENT
/begin MEASUREMENT AirCtl_rBrkRmp_mp "Rampen Ausgang bei Bremssignal Auswertung" SWORD Prc 1 100 -400.0000 399.9878 FORMAT "%8.4" ECU_ADDRESS 0x8FE386 /end MEASUREMENT
/begin MEASUREMENT AirCtl_rEGRByp_mp "Bypass-Label, Kopie von AirCtl_rEGR" SWORD Prc 1 100 -400.0000 399.9878 FORMAT "%8.4" ECU_ADDRESS 0x8FE388 /end MEASUREMENT
/begin MEASUREMENT AirCtl_rTVAByp_mp "Bypass-Label, Kopie von AirCtl_rTVA" SWORD Prc 1 100 -400.0000 399.9878 FORMAT "%8.4" ECU_ADDRESS 0x8FE38A /end MEASUREMENT
/begin MEASUREMENT AirCtl_stAirCtlBits1_mp "AirCtl_stAirCtlBits_mp LowByte (->Signals)" UWORD OneToOne 1 100 0.00 65535.00 FORMAT "%8.2" ECU_ADDRESS 0x6F8002 /end MEASUREMENT
/begin MEASUREMENT AirCtl_stAirCtlBits2_mp "AirCtl_stAirCtlBits_mp HighByte (->Signals)" UWORD OneToOne 1 100 0.00 65535.00 FORMAT "%8.2" ECU_ADDRESS 0x6F8004 /end MEASUREMENT
/begin MEASUREMENT AirCtl_stAirCtlBits_mp "Anzeige der Abschaltursache in der ARF-Überwachung (bitorientiert)" ULONG OneToOne 1 100 0.00 4294967295.00 FORMAT "%13.2" ECU_ADDRESS 0x8FE38C /end MEASUREMENT
/begin MEASUREMENT AirCtl_stDebBrkpressed_mp "Deaktivierung der Überwachung der negativen Regelabweichung bei mehrmals betätigter Bremse" UBYTE OneToOne 1 100 0.00 255.0 FORMAT "%5.1" ECU_ADDRESS 0x8FE390 /end MEASUREMENT
/begin MEASUREMENT AirCtl_stDebDefNrm_mp "Status, ob Regelabweichung im Normalbetrieb überwacht" UBYTE OneToOne 1 100 0.00 255.0 FORMAT "%5.1" ECU_ADDRESS 0x8FE39C /end MEASUREMENT
/begin MEASUREMENT AirCtl_stDebDefRgn_mp "Status, ob Regelabweichung Regenerationsbetrieb überwacht" UBYTE OneToOne 1 100 0.00 255.0 FORMAT "%5.1" ECU_ADDRESS 0x8FE39D /end MEASUREMENT
/begin MEASUREMENT AirCtl_stDebDef_mp "Statusangabe, ob Regelabweichung überwacht wird" UBYTE OneToOne 1 100 0.00 255.0 FORMAT "%5.1" ECU_ADDRESS 0x8FE391 /end MEASUREMENT
/begin MEASUREMENT AirCtl_stDesChk_mp "Status ob AirCtl_mDesVal Maximum überschreitet" UBYTE OneToOne 1 100 0.00 255.0 FORMAT "%5.1" ECU_ADDRESS 0x8FE392 /end MEASUREMENT
/begin MEASUREMENT AirCtl_stGearShiftHighLoad_mp "status of gear control" UBYTE OneToOne 1 100 0.00 255.0 FORMAT "%5.1" ECU_ADDRESS 0x8FE393 /end MEASUREMENT
/begin MEASUREMENT AirCtl_stHealDef_mp "Status, ob Heilung von erkannter bleibender Regelabweichung zulässig" UBYTE OneToOne 1 100 0.00 255.0 FORMAT "%5.1" ECU_ADDRESS 0x8FE394 /end MEASUREMENT
/begin MEASUREMENT AirCtl_stPlateBreak_mp "State for plate break" UBYTE OneToOne 1 100 0.00 255.0 FORMAT "%5.1" ECU_ADDRESS 0x8FE395 /end MEASUREMENT
/begin MEASUREMENT AirCtl_tiStrtDel_mp "Zeit, in der die Regelung nach Startabwurf abgeschaltet bleibt" UWORD Time_ms 1 100 0.00 655350.0 FORMAT "%8.1" ECU_ADDRESS 0x8FE396 /end MEASUREMENT
/begin MEASUREMENT AirSys_stCmpntActv "Statusvariable für Endstufenabschaltung" UWORD OneToOne 1 100 0.00 65535.00 FORMAT "%8.2" ECU_ADDRESS 0x7F8AAC /end MEASUREMENT
/begin MEASUREMENT AirSys_stTstDem "Statusvariable für Stellertest bei Diagnoseeingriff" UWORD OneToOne 1 100 0.00 65535.00 FORMAT "%8.2" ECU_ADDRESS 0x7F8AAE /end MEASUREMENT
/begin MEASUREMENT AltCD_ctPosPins "Highbyte: Zähler für Funktionsaufrufe; Lowbyte: Zähler für positve Pins" SWORD OneToOne 1 100 -32768.00 32767.00 FORMAT "%8.2" ECU_ADDRESS 0x7F8AB0 /end MEASUREMENT
/begin MEASUREMENT AltCD_dcycAltLdPT1_mp "Generatorlast nach PT1-Filterung" UWORD DtyCyc 1 100 0.00 655.3500 FORMAT "%8.4" ECU_ADDRESS 0x8FE3A4 /end MEASUREMENT
/begin MEASUREMENT AltCD_dcycAltLoad "gemessenes Tastverhältnis des Generatorlastsignals" SWORD DtyCyc 1 100 -327.6800 327.6700 FORMAT "%8.4" ECU_ADDRESS 0x7F8AB2 /end MEASUREMENT
/begin MEASUREMENT AltCD_rAltLoad "Linearisiertes und fehlerentprelltes Generatorlastsignals" SWORD Prc 1 100 -400.0000 399.9878 FORMAT "%8.4" ECU_ADDRESS 0x7F8AB4 /end MEASUREMENT
/begin MEASUREMENT AltCD_stAltCtl_mp "Spannungsregelung - Status" UBYTE OneToOne 1 100 0.00 255.0 FORMAT "%5.1" ECU_ADDRESS 0x8FE3A6 /end MEASUREMENT
/begin MEASUREMENT AltCD_stErrAlt "Generator Fehlerbits" UBYTE OneToOne 1 100 0.00 255.0 FORMAT "%5.1" ECU_ADDRESS 0x7F87CD /end MEASUREMENT
/begin MEASUREMENT AltCD_stErrSig "entprelltes Generatorfehler Signal (Klemme 61)" UBYTE OneToOne 1 100 0.00 255.0 FORMAT "%5.1" ECU_ADDRESS 0x7F87CE /end MEASUREMENT
/begin MEASUREMENT AltCD_stErrSigDeb_mp "debounced value of terminal 61 signal" UBYTE OneToOne 1 100 0.00 255.0 FORMAT "%5.1" ECU_ADDRESS 0x8FE3A7 /end MEASUREMENT
/begin MEASUREMENT AltCD_stGenManuFak "message manufacturer of alternator" UBYTE OneToOne 1 100 0.00 255.0 FORMAT "%5.1" ECU_ADDRESS 0x7F87CF /end MEASUREMENT
/begin MEASUREMENT AltCD_stGenTypKenn "message alternator type" UBYTE OneToOne 1 100 0.00 255.0 FORMAT "%5.1" ECU_ADDRESS 0x7F87D0 /end MEASUREMENT
/begin MEASUREMENT AltCD_stLROff_mp "status of load response switch off" UBYTE OneToOne 1 100 0.00 255.0 FORMAT "%5.1" ECU_ADDRESS 0x8FE3A8 /end MEASUREMENT
/begin MEASUREMENT AltCD_stSRCdis_mp "Ausblendmaske für Generatorlastsignal" UBYTE OneToOne 1 100 0.00 255.0 FORMAT "%5.1" ECU_ADDRESS 0x8FE3A9 /end MEASUREMENT
/begin MEASUREMENT AltCD_tiLR_mp "Load Response Time, vom Generator zurückgelesener Wert" UWORD Time_s 1 100 0.00 655.3500 FORMAT "%8.4" ECU_ADDRESS 0x8FE3AA /end MEASUREMENT
/begin MEASUREMENT AltCD_uAlt "Generatorspannungs-Sollwert, vom Generator zurückgelesener Wert" SWORD Volt_Batt 1 100 -640625.6 640606.1 FORMAT "%8.1" ECU_ADDRESS 0x7F8AB6 /end MEASUREMENT
/begin MEASUREMENT AltCD_uAlt_mp "Generatorspannungs-Sollwert, vom Generator zurückgelesener Wert" SWORD Volt_Batt 1 100 -640625.6 640606.1 FORMAT "%8.1" ECU_ADDRESS 0x8FE3AC /end MEASUREMENT
/begin MEASUREMENT Alt_n_mp "Drehzahl für Leistungsbedarfberechnung Generator" SWORD EngN 1 100 -32768.00 32767.00 FORMAT "%8.2" ECU_ADDRESS 0x8FE39E /end MEASUREMENT
/begin MEASUREMENT Alt_pwrDes "mechanischer Leistungsbedarf des Generators" SWORD Pwr 1 100 -308831.1 308821.7 FORMAT "%8.1" ECU_ADDRESS 0x7F8AB8 /end MEASUREMENT
/begin MEASUREMENT Alt_pwrLead "Vorhaltleistung des Generators" SWORD Pwr 1 100 -308831.1 308821.7 FORMAT "%8.1" ECU_ADDRESS 0x7F8ABA /end MEASUREMENT
/begin MEASUREMENT Alt_pwrUnCor_mp "Generator Leistungsbedarf vor Korrektur" SWORD Pwr 1 100 -308831.1 308821.7 FORMAT "%8.1" ECU_ADDRESS 0x8FE3A0 /end MEASUREMENT
/begin MEASUREMENT Alt_rAdjVal_mp "Abgleichwert" SWORD Fact 1 100 -4.000000 3.999878 FORMAT "%8.6" ECU_ADDRESS 0x8FE3A2 /end MEASUREMENT
/begin MEASUREMENT AOHtCD_rOut_mp "Meßpunkt fuer korrigiertes Tastverhaeltnis der Zuheizeransteuerung" SWORD DtyCyc 1 100 -327.6800 327.6700 FORMAT "%8.4" ECU_ADDRESS 0x6F8008 /end MEASUREMENT
/begin MEASUREMENT AOHtCD_stHtgReq "Heizleistungsanforderung von Hardware-Pin (Heizungssteuerung)" UBYTE OneToOne 1 100 0.00 255.0 FORMAT "%5.1" ECU_ADDRESS 0x7F87B5 /end MEASUREMENT
/begin MEASUREMENT AOHt_nMin "Minimum Leerlaufsolldrehzahlanforderung durch Zuheizer" SWORD EngN 1 100 -32768.00 32767.00 FORMAT "%8.2" ECU_ADDRESS 0x7F8A28 /end MEASUREMENT
/begin MEASUREMENT AOHt_rAltLd_mp "Ausgang - Generatorlastkennlinie" SWORD DtyCyc 1 100 -327.6800 327.6700 FORMAT "%8.4" ECU_ADDRESS 0x8FE3AE /end MEASUREMENT
/begin MEASUREMENT AOHt_rHtgOut "Heizleitungsanforderung, Zuheizer (Tastverhältnis)" SWORD DtyCyc 1 100 -327.6800 327.6700 FORMAT "%8.4" ECU_ADDRESS 0x7F8A2A /end MEASUREMENT
/begin MEASUREMENT AOHt_rIGov_mp "I-Anteil des PI-Reglers" SWORD DtyCyc 1 100 -327.6800 327.6700 FORMAT "%8.4" ECU_ADDRESS 0x8FE3B0 /end MEASUREMENT
/begin MEASUREMENT AOHt_rNAvrgDeb_mp "PT1 gefilterter Motordrehzahl-TV-Wert" SWORD DtyCyc 1 100 -327.6800 327.6700 FORMAT "%8.4" ECU_ADDRESS 0x8FE3B2 /end MEASUREMENT
/begin MEASUREMENT AOHt_rNAvrg_mp "umgerechnete Motordrehzahl (in %-TV) - nach Kennlinie" SWORD DtyCyc 1 100 -327.6800 327.6700 FORMAT "%8.4" ECU_ADDRESS 0x8FE3B4 /end MEASUREMENT
/begin MEASUREMENT AOHt_rPGov_mp "P-Anteil des PI-Reglers" SWORD DtyCyc 1 100 -327.6800 327.6700 FORMAT "%8.4" ECU_ADDRESS 0x8FE3B6 /end MEASUREMENT
/begin MEASUREMENT AOHt_rPI_mp "Eingangsgroesse des PI-Reglers (Regelabweichung)" SWORD DtyCyc 1 100 -327.6800 327.6700 FORMAT "%8.4" ECU_ADDRESS 0x8FE3B8 /end MEASUREMENT
/begin MEASUREMENT AOHt_stAC_mp "States of ACceleration logic" UBYTE OneToOne 1 100 0.00 255.0 FORMAT "%5.1" ECU_ADDRESS 0x8FE3BA /end MEASUREMENT
/begin MEASUREMENT AOHt_stDA_mp "States of Drive Away logic" UBYTE OneToOne 1 100 0.00 255.0 FORMAT "%5.1" ECU_ADDRESS 0x8FE3BB /end MEASUREMENT
/begin MEASUREMENT AOHt_stHtgUp "Warmlaufzustand des Motors" UBYTE OneToOne 1 100 0.00 255.0 FORMAT "%5.1" ECU_ADDRESS 0x7F87B6 /end MEASUREMENT
/begin MEASUREMENT AOHt_stShutOff_mp "Überblick auf alle Abschaltbedingungen" UWORD OneToOne 1 100 0.00 65535.00 FORMAT "%8.2" ECU_ADDRESS 0x6F8006 /end MEASUREMENT
/begin MEASUREMENT AOHt_tEnvLin_mp "Umgebungstemperatur nach Kennlinie" SWORD Temp_Cels 1 100 -50.140 899.860 FORMAT "%8.3" ECU_ADDRESS 0x8FE3BC /end MEASUREMENT
/begin MEASUREMENT APPCD_drAPP1UnFlt "Differenz der Fahrpedal 1 Position ungefilterter Wert" SWORD PrcPerSec 1 100 -20000.00 19999.39 FORMAT "%8.2" ECU_ADDRESS 0x7F8A2C /end MEASUREMENT
/begin MEASUREMENT APPCD_rAPP1UnFlt "Fahrpedal 1 position ungefilterter Rohwert" SWORD Prc 1 100 -400.0000 399.9878 FORMAT "%8.4" ECU_ADDRESS 0x7F8A2E /end MEASUREMENT
/begin MEASUREMENT APPCD_rFlt "gefiltertes Pedalwertgebersignal" SWORD Prc 1 100 -400.0000 399.9878 FORMAT "%8.4" ECU_ADDRESS 0x7F8A30 /end MEASUREMENT
/begin MEASUREMENT APPCD_rFlt_mp "gefilterter PWG Positions Wert ohne PTO Eingriff" SWORD Prc 1 100 -400.0000 399.9878 FORMAT "%8.4" ECU_ADDRESS 0x8FE3BE /end MEASUREMENT
/begin MEASUREMENT APPCD_rNextThr "Berechneter Wert des nächsten Schwellwertes" SWORD Prc 1 100 -400.0000 399.9878 FORMAT "%8.4" ECU_ADDRESS 0x7F8A32 /end MEASUREMENT
/begin MEASUREMENT APPCD_rStepLim_mp "Limitierter Stufen-Wert" SWORD Prc 1 100 -400.0000 399.9878 FORMAT "%8.4" ECU_ADDRESS 0x8FE3C0 /end MEASUREMENT
/begin MEASUREMENT APPCD_stAPP12def_mp "Messpunkt für unentprellten Gleichlauffehler APP1/APP2" UBYTE OneToOne 1 100 0.00 255.0 FORMAT "%5.1" ECU_ADDRESS 0x8FE3C2 /end MEASUREMENT
/begin MEASUREMENT APPCD_stErr1_mp "Fehlerzustand von APP1/2 Signal" UWORD OneToOne 1 100 0.00 65535.00 FORMAT "%8.2" ECU_ADDRESS 0x8FE3C4 /end MEASUREMENT
/begin MEASUREMENT APPCD_stKickDown "Kick Down Zustand des Fahrpedals" UBYTE OneToOne 1 100 0.00 255.0 FORMAT "%5.1" ECU_ADDRESS 0x7F87B7 /end MEASUREMENT
/begin MEASUREMENT APPCD_stLimp "Status Notfahrbetrieb APP" UBYTE OneToOne 1 100 0.00 255.0 FORMAT "%5.1" ECU_ADDRESS 0x7F87B8 /end MEASUREMENT
/begin MEASUREMENT APPCD_stPos "Status der PWG Position" UBYTE OneToOne 1 100 0.00 255.0 FORMAT "%5.1" ECU_ADDRESS 0x7F87B9 /end MEASUREMENT
/begin MEASUREMENT APPCD_stSigSrc "Status der ausgewaehlten Signalquelle APP" UBYTE OneToOne 1 100 0.00 255.0 FORMAT "%5.1" ECU_ADDRESS 0x7F87BA /end MEASUREMENT
/begin MEASUREMENT APPCD_stTempErr_mp "Messpunkt für vorläufigen APP-Fehler" UBYTE OneToOne 1 100 0.00 255.0 FORMAT "%5.1" ECU_ADDRESS 0x8FE3C6 /end MEASUREMENT
/begin MEASUREMENT APPCD_stTempHeal_mp "Messpunkt für die vorläufig geheilten APP1/APP2 Fehler" UBYTE OneToOne 1 100 0.00 255.0 FORMAT "%5.1" ECU_ADDRESS 0x8FE3C7 /end MEASUREMENT
/begin MEASUREMENT APPCD_uAPPunJit_mp "Messpunkt der  APP Rohspannung vor Entjitterung" SWORD Volt 1 100 -160156.4 160151.5 FORMAT "%8.1" ECU_ADDRESS 0x8FE3C8 /end MEASUREMENT
/begin MEASUREMENT APPCD_uDiffMax_mp "Maximal zulässige Differenz der Rohspannungen" SWORD Volt 1 100 -160156.4 160151.5 FORMAT "%8.1" ECU_ADDRESS 0x8FE3CA /end MEASUREMENT
/begin MEASUREMENT APPCD_uRawAPP1 "Fahrpedal 1 Position Rohwert" SWORD Volt 1 100 -160156.4 160151.5 FORMAT "%8.1" ECU_ADDRESS 0x7F8A34 /end MEASUREMENT
/begin MEASUREMENT APPCD_uRawAPP1half_mp "Halbierte APP1 Rohspannung" SWORD Volt 1 100 -160156.4 160151.5 FORMAT "%8.1" ECU_ADDRESS 0x8FE3CC /end MEASUREMENT
/begin MEASUREMENT APPCD_uRawAPP2 "Fahrpedal 2 Position Rohwert" SWORD Volt 1 100 -160156.4 160151.5 FORMAT "%8.1" ECU_ADDRESS 0x7F8A36 /end MEASUREMENT
/begin MEASUREMENT APPCD_uRawAPP2dbl_mp "Verdoppelte APP2 Rohspannung" SWORD Volt 1 100 -160156.4 160151.5 FORMAT "%8.1" ECU_ADDRESS 0x8FE3CE /end MEASUREMENT
/begin MEASUREMENT APPCD_uRawDiff_mp "Betrag der Differenz der Rohspannungen von APP1 und APP2" SWORD Volt 1 100 -160156.4 160151.5 FORMAT "%8.1" ECU_ADDRESS 0x8FE3D0 /end MEASUREMENT
/begin MEASUREMENT APPCD_uRaw_mp "Messpunkt der ausgewaehlten APP Rohspannung" SWORD Volt 1 100 -160156.4 160151.5 FORMAT "%8.1" ECU_ADDRESS 0x8FE3D2 /end MEASUREMENT
/begin MEASUREMENT APSCD_BpsAllowed_mp "Wahlschalter - Atmosphaerendruck gemessen (wenn verbaut) od. gerechnet von Ladedrucksensor" UWORD OneToOne 1 100 0.00 65535.00 FORMAT "%8.2" ECU_ADDRESS 0x8FE3D4 /end MEASUREMENT
/begin MEASUREMENT APSCD_pCorVal_mp "Korrekturwert fuer Atmosphaerendruck von Ladedrucksensor" SWORD Pres_hPa 1 100 -32768.00 32767.00 FORMAT "%8.2" ECU_ADDRESS 0x8FE3D6 /end MEASUREMENT
/begin MEASUREMENT APSCD_pLinVal "Rohwert Atmosphärendruck über ADC" SWORD Pres_hPa 1 100 -32768.00 32767.00 FORMAT "%8.2" ECU_ADDRESS 0x7F8A38 /end MEASUREMENT
/begin MEASUREMENT APSCD_pPhyVal_mp "Rohwert Atmosphärendruck über ADC" SWORD Pres_hPa 1 100 -32768.00 32767.00 FORMAT "%8.2" ECU_ADDRESS 0x8FE3D8 /end MEASUREMENT
/begin MEASUREMENT APSCD_pSensorVal "Atmosphaerendruck Sensorwert" SWORD Pres_hPa 1 100 -32768.00 32767.00 FORMAT "%8.2" ECU_ADDRESS 0x7F8A3A /end MEASUREMENT
/begin MEASUREMENT APSCD_pVal "Atmosphärendruck" SWORD Pres_hPa 1 100 -32768.00 32767.00 FORMAT "%8.2" ECU_ADDRESS 0x7F8A3C /end MEASUREMENT
/begin MEASUREMENT APSCD_stSensorInst "Status, ob Atmosphärendrucksensor eingebaut ist (0 == nicht eingebaut)" UBYTE OneToOne 1 100 0.00 255.0 FORMAT "%5.1" ECU_ADDRESS 0x7F87BB /end MEASUREMENT
/begin MEASUREMENT APSCD_swtSig "Atmosphaerendruck Funktionsschalter - Signalwert von CAN od. ADC" UBYTE OneToOne 1 100 0.00 255.0 FORMAT "%5.1" ECU_ADDRESS 0x7F87BC /end MEASUREMENT
/begin MEASUREMENT APSCD_uRaw "Rohspannung ADC-Signal Atmosphärendruck" SWORD Volt 1 100 -160156.4 160151.5 FORMAT "%8.1" ECU_ADDRESS 0x7F8A3E /end MEASUREMENT
/begin MEASUREMENT ARS_pwrDes "Current power requirement of ARS module" SWORD Pwr 1 100 -308831.1 308821.7 FORMAT "%8.1" ECU_ADDRESS 0x7F8A40 /end MEASUREMENT
/begin MEASUREMENT ARS_pwrLead "Current power requirement of ARS module for monitoring" SWORD Pwr 1 100 -308831.1 308821.7 FORMAT "%8.1" ECU_ADDRESS 0x7F8A42 /end MEASUREMENT
/begin MEASUREMENT ARS_st "Status of power requirement of ARS" UBYTE OneToOne 1 100 0.00 255.0 FORMAT "%5.1" ECU_ADDRESS 0x7F87BD /end MEASUREMENT
/begin MEASUREMENT ARS_stRecARS "Status of ARS detection" UBYTE OneToOne 1 100 0.00 255.0 FORMAT "%5.1" ECU_ADDRESS 0x7F87BE /end MEASUREMENT
/begin MEASUREMENT ARS_trqCor_mp "Corrected current torque" SWORD Trq 1 100 -3276.800 3276.700 FORMAT "%8.3" ECU_ADDRESS 0x8FE3DA /end MEASUREMENT
/begin MEASUREMENT ARS_trqCurMax_mp "corrected maximum torque" SWORD Trq 1 100 -3276.800 3276.700 FORMAT "%8.3" ECU_ADDRESS 0x8FE3DC /end MEASUREMENT
/begin MEASUREMENT ARS_trqDesMax_mp "Maximum desired torque" SWORD Trq 1 100 -3276.800 3276.700 FORMAT "%8.3" ECU_ADDRESS 0x8FE3DE /end MEASUREMENT
/begin MEASUREMENT ARS_trqDesOld_mp "Desired torque of previous cycle" SWORD Trq 1 100 -3276.800 3276.700 FORMAT "%8.3" ECU_ADDRESS 0x8FE3E0 /end MEASUREMENT
/begin MEASUREMENT ARS_trqDes_mp "Desired torque after correction" SWORD Trq 1 100 -3276.800 3276.700 FORMAT "%8.3" ECU_ADDRESS 0x8FE3E2 /end MEASUREMENT
/begin MEASUREMENT ASDdc_KdCurr_mp "Aktueller Parameter Kd des Störungsreglers" FLOAT32_IEEE ASD_GvrnDT1Kd_float 1 100 -1.00000000 100.000000 FORMAT "%10.6" ECU_ADDRESS 0x8FE3E4 /end MEASUREMENT
/begin MEASUREMENT ASDdc_nAvrg_mp "Motordrehzahl für die Parametersatzauswahl beim ASDdc" SWORD EngN 1 100 -32768.00 32767.00 FORMAT "%8.2" ECU_ADDRESS 0x8FE3EC /end MEASUREMENT
/begin MEASUREMENT ASDdc_stCluPS_mp "Kupplungs PS aktiv/nicht aktiv" UBYTE OneToOne 1 100 0.00 255.0 FORMAT "%5.1" ECU_ADDRESS 0x8FE3EE /end MEASUREMENT
/begin MEASUREMENT ASDdc_stCond_mp "Zustand der Eingangsbedingungen" UWORD OneToOne 1 100 0.00 65535.00 FORMAT "%8.2" ECU_ADDRESS 0x8FE3F0 /end MEASUREMENT
/begin MEASUREMENT ASDdc_stPrioState_mp "Primärzustand mit der höchsten Priorität" UWORD OneToOne 1 100 0.00 65535.00 FORMAT "%8.2" ECU_ADDRESS 0x8FE3F2 /end MEASUREMENT
/begin MEASUREMENT ASDdc_stREinit_mp "Zustand Reinit (deaktivieren)" UBYTE OneToOne 1 100 0.00 255.0 FORMAT "%5.1" ECU_ADDRESS 0x8FE3F4 /end MEASUREMENT
/begin MEASUREMENT ASDdc_stSelectState_mp "Ausgewählter Primärzustand" UWORD ASDdcState 1 100 0.00 65535.00 FORMAT "%8.2" ECU_ADDRESS 0x8FE3F6 /end MEASUREMENT
/begin MEASUREMENT ASDdc_stStates_mp "Zustand der Primärzustände" UWORD OneToOne 1 100 0.00 65535.00 FORMAT "%8.2" ECU_ADDRESS 0x8FE3F8 /end MEASUREMENT
/begin MEASUREMENT ASDdc_T1Curr_mp "Aktueller Parameter T1 des Störungsreglers" FLOAT32_IEEE ASD_GvrnDT1T1_float 1 100 -1.00000000 100.000000 FORMAT "%10.6" ECU_ADDRESS 0x8FE3E8 /end MEASUREMENT
/begin MEASUREMENT ASDdc_trq "Momentforderung Aktiver Ruckeldämpfer (Störungsregler)" SWORD Trq 1 100 -3276.800 3276.700 FORMAT "%8.3" ECU_ADDRESS 0x7F8A44 /end MEASUREMENT
/begin MEASUREMENT ASDrf_CoeffALossCurr_mp "Aktueller Kennwert für den Koeffitienten zweiter Ordnung der LSD Steigungsbegrenzung." SWORD CoeffA 1 100 -160.0000 159.9951 FORMAT "%8.4" ECU_ADDRESS 0x8FE3FA /end MEASUREMENT
/begin MEASUREMENT ASDrf_CoeffBLossCurr_mp "Aktueller Kennwert für den Koeffitienten nullter Ordnung der LSD Steigungsbegrenzung." SWORD dTrq 1 100 -3276.800 3276.700 FORMAT "%8.3" ECU_ADDRESS 0x8FE3FC /end MEASUREMENT
/begin MEASUREMENT ASDrf_dtrqDecMax_mp "Max. Drehmomentsteigung aufgrund der Gradientenbegrenzung bei Momentenabsenkung." SWORD dTrq 1 100 -3276.800 3276.700 FORMAT "%8.3" ECU_ADDRESS 0x8FE3FE /end MEASUREMENT
/begin MEASUREMENT ASDrf_dtrqDecMin_mp "Min. Drehmomentsteigung aufgrund der Gradientenbegrenzung bei Momentenabsenkung." SWORD dTrq 1 100 -3276.800 3276.700 FORMAT "%8.3" ECU_ADDRESS 0x8FE400 /end MEASUREMENT
/begin MEASUREMENT ASDrf_dtrqInrLtd_mp "zeitliche Ableitung von CoEng_trqInrLtd" SWORD dTrq 1 100 -3276.800 3276.700 FORMAT "%8.3" ECU_ADDRESS 0x8FE402 /end MEASUREMENT
/begin MEASUREMENT ASDrf_dtrqLim_mp "durch ASDrf_dtrqInrLtdLim_CUR begrenzte zeitliche Ableitung von CoEng_trqInrLtd" SLONG dTrq 1 100 -214748364.800 214748364.700 FORMAT "%13.3" ECU_ADDRESS 0x8FE404 /end MEASUREMENT
/begin MEASUREMENT ASDrf_dtrqLossMax_mp "Maximale Drehmomentsteigung der Steigungsbegrenzung um das Verlustmoment." SWORD dTrq 1 100 -3276.800 3276.700 FORMAT "%8.3" ECU_ADDRESS 0x8FE408 /end MEASUREMENT
/begin MEASUREMENT ASDrf_dtrqLossMin_mp "Maximale Drehmomentsteigung der Steigungsbegrenzung um das Verlustmoment." SWORD dTrq 1 100 -3276.800 3276.700 FORMAT "%8.3" ECU_ADDRESS 0x8FE40A /end MEASUREMENT
/begin MEASUREMENT ASDrf_dtrqMax_mp "Max. Drehmomentsteigung in der Umgebung des Verlustmoments oder durch die Begrenzung bei Drehmomentabsenkung." SWORD dTrq 1 100 -3276.800 3276.700 FORMAT "%8.3" ECU_ADDRESS 0x8FE40C /end MEASUREMENT
/begin MEASUREMENT ASDrf_dtrqMin_mp "Min. Drehmomentsteigung in der Umgebung des Verlustmoments oder durch die Begrenzung bei Drehmomentabsenkung." SWORD dTrq 1 100 -3276.800 3276.700 FORMAT "%8.3" ECU_ADDRESS 0x8FE40E /end MEASUREMENT
/begin MEASUREMENT ASDrf_KdCurr_mp "Aktueller Parameter Kd des ARD-FF (ASDrf)" SLONG Kd 1 100 -32768.0000000 32767.9999847 FORMAT "%13.7" ECU_ADDRESS 0x8FE410 /end MEASUREMENT
/begin MEASUREMENT ASDrf_stCond_mp "Status der Eingangsbedingungen" UWORD OneToOne 1 100 0.00 65535.00 FORMAT "%8.2" ECU_ADDRESS 0x8FE452 /end MEASUREMENT
/begin MEASUREMENT ASDrf_stDecLimState_mp "Status des Zustandsautomaten für Steigungsbegrenzung bei Momentenabsenkung." UBYTE OneToOne 1 100 0.00 255.0 FORMAT "%5.1" ECU_ADDRESS 0x8FE414 /end MEASUREMENT
/begin MEASUREMENT ASDrf_stIncLim_mp "Aktueller Zustand für flachen(=1) / steilen(=0) Drehmoment Anstieg." SWORD OneToOne 1 100 -32768.00 32767.00 FORMAT "%8.2" ECU_ADDRESS 0x8FE416 /end MEASUREMENT
/begin MEASUREMENT ASDrf_stInit "Initialisierungsanforderungen/Quittierungen an PT1, PDT1-Glieder" UBYTE OneToOne 1 100 0.00 255.0 FORMAT "%5.1" ECU_ADDRESS 0x6F800A /end MEASUREMENT
/begin MEASUREMENT ASDrf_stInitdtrqSteep_mp "Reinitialisierung bei Parametersatzänderung aktiv/inaktiv" UBYTE OneToOne 1 100 0.00 255.0 FORMAT "%5.1" ECU_ADDRESS 0x8FE418 /end MEASUREMENT
/begin MEASUREMENT ASDrf_stLAD "Zustandsvariable für den Automaten zur LSD Steuerung." UBYTE OneToOne 1 100 0.00 255.0 FORMAT "%5.1" ECU_ADDRESS 0x7F87BF /end MEASUREMENT
/begin MEASUREMENT ASDrf_stPosNeg_mp "aktueller pos/neg Zustand" UBYTE OneToOne 1 100 0.00 255.0 FORMAT "%5.1" ECU_ADDRESS 0x8FE419 /end MEASUREMENT
/begin MEASUREMENT ASDrf_stPrioState_mp "Aktiver Zustand nach der Priorisierung" UWORD OneToOne 1 100 0.00 65535.00 FORMAT "%8.2" ECU_ADDRESS 0x8FE454 /end MEASUREMENT
/begin MEASUREMENT ASDrf_stSelectState_mp "Aktiver Zustand, genau ein Primärzustand ist aktive" UWORD ASDrf_stPrimState 1 100 0.00 32.0000000000 FORMAT "%13.10" ECU_ADDRESS 0x8FE456 /end MEASUREMENT
/begin MEASUREMENT ASDrf_stStates_mp "Auswertung der Primärzustände (konkurrierende Zustände möglich)" UWORD OneToOne 1 100 0.00 65535.00 FORMAT "%8.2" ECU_ADDRESS 0x8FE458 /end MEASUREMENT
/begin MEASUREMENT ASDrf_stTrqLim_mp "Zustand der Drehmoment Gradientenbegrenzung (0=inaktiv, 1=aktiv)" UBYTE OneToOne 1 100 0.00 255.0 FORMAT "%5.1" ECU_ADDRESS 0x8FE41A /end MEASUREMENT
/begin MEASUREMENT ASDrf_T1Curr_mp "Aktueller Parameter T1 des ARD-FF (ASDrf)" ULONG TimeDelay_s 1 100 0.0000010000000 4294.9673 FORMAT "%9.4" ECU_ADDRESS 0x8FE41C /end MEASUREMENT
/begin MEASUREMENT ASDrf_trqASDSum_mp "Aktuelles ASD Moment (Berechnung abhängig von ASDrf_swtCalcTrq_C)" SWORD Trq 1 100 -3276.800 3276.700 FORMAT "%8.3" ECU_ADDRESS 0x8FE420 /end MEASUREMENT
/begin MEASUREMENT ASDrf_trqCompOfs_mp "Offset auf den PT1 Eingang zur Polkompensation." SLONG Trq 1 100 -214748364.800 214748364.700 FORMAT "%13.3" ECU_ADDRESS 0x8FE424 /end MEASUREMENT
/begin MEASUREMENT ASDrf_trqDecLimStrt_mp "Startpunkt / Scheitelpunkt für die Steigungsbegrenzung bei Drehmomentabsenkung" SWORD Trq 1 100 -3276.800 3276.700 FORMAT "%8.3" ECU_ADDRESS 0x8FE428 /end MEASUREMENT
/begin MEASUREMENT ASDrf_trqInit_mp "berechneter Initialisierungswert für PT1 Zustandsvariable" SWORD Trq 1 100 -3276.800 3276.700 FORMAT "%8.3" ECU_ADDRESS 0x8FE42A /end MEASUREMENT
/begin MEASUREMENT ASDrf_trqInr "ARD Führungsformer Momentausgang (inneres Moment)" SWORD Trq 1 100 -3276.800 3276.700 FORMAT "%8.3" ECU_ADDRESS 0x7F8A46 /end MEASUREMENT
/begin MEASUREMENT ASDrf_trqInrLtdFlt_mp "Gefiltertes Eingangssignal CoEng_trqInrLtd" SWORD Trq 1 100 -3276.800 3276.700 FORMAT "%8.3" ECU_ADDRESS 0x8FE42C /end MEASUREMENT
/begin MEASUREMENT ASDrf_trqInrMaxUnLim_mp "Aktuelle Obergrenze für ASDrf_trqInr vor der Begrenzung mit CoEng_trqInrLim (abhängig von ASDrf_swtLim_C)." SLONG Trq32 1 100 -3276.80000000 3276.79999847 FORMAT "%13.8" ECU_ADDRESS 0x8FE430 /end MEASUREMENT
/begin MEASUREMENT ASDrf_trqInrMax_mp "Max. zulässiges Moment durch Steigungsbegrenzung." SLONG Trq32 1 100 -3276.80000000 3276.79999847 FORMAT "%13.8" ECU_ADDRESS 0x8FE434 /end MEASUREMENT
/begin MEASUREMENT ASDrf_trqInrMinUnLim_mp "Aktuelle Untergrenze für ASDrf_trqInr vor der Begrenzung mit 0 (abhängig von ASDrf_swtLim_C)." SLONG Trq32 1 100 -3276.80000000 3276.79999847 FORMAT "%13.8" ECU_ADDRESS 0x8FE438 /end MEASUREMENT
/begin MEASUREMENT ASDrf_trqInrMin_mp "Min. zulässiges Moment durch Steigungsbegrenzung." SLONG Trq32 1 100 -3276.80000000 3276.79999847 FORMAT "%13.8" ECU_ADDRESS 0x8FE43C /end MEASUREMENT
/begin MEASUREMENT ASDrf_trqInrUnLim_mp "Ausgang des PDT1-Glieds, vor der Steigungsbegrenzung des Führungsformers." SWORD Trq 1 100 -3276.800 3276.700 FORMAT "%8.3" ECU_ADDRESS 0x8FE440 /end MEASUREMENT
/begin MEASUREMENT ASDrf_trqLossNeg "Verlustmoment bei negativem Zustand von ASDrf_stPosNeg." SWORD Trq 1 100 -3276.800 3276.700 FORMAT "%8.3" ECU_ADDRESS 0x7F8A48 /end MEASUREMENT
/begin MEASUREMENT ASDrf_trqLossPos "Verlustmoment bei positivem Zustand von ASDrf_stPosNeg." SWORD Trq 1 100 -3276.800 3276.700 FORMAT "%8.3" ECU_ADDRESS 0x7F8A4A /end MEASUREMENT
/begin MEASUREMENT ASDrf_trqLoss_mp "Reibmoment inc. Nebenaggregate" SWORD Trq 1 100 -3276.800 3276.700 FORMAT "%8.3" ECU_ADDRESS 0x8FE442 /end MEASUREMENT
/begin MEASUREMENT ASDrf_trqPT1In_mp "aktueller PT1 Eingangswert" SLONG Trq 1 100 -214748364.800 214748364.700 FORMAT "%13.3" ECU_ADDRESS 0x8FE444 /end MEASUREMENT
/begin MEASUREMENT ASDrf_trqPT1Out_mp "aktueller PT1 Ausgangswert" SWORD Trq 1 100 -3276.800 3276.700 FORMAT "%8.3" ECU_ADDRESS 0x8FE448 /end MEASUREMENT
/begin MEASUREMENT ASDrf_trqPT1P_mp "Ausgang P-Anteil in PT1 gefiltertem Signal" SWORD Trq 1 100 -3276.800 3276.700 FORMAT "%8.3" ECU_ADDRESS 0x8FE44A /end MEASUREMENT
/begin MEASUREMENT ASDrf_trqP_mp "Ausgang ASDrf P-Anteil" SWORD Trq 1 100 -3276.800 3276.700 FORMAT "%8.3" ECU_ADDRESS 0x8FE44C /end MEASUREMENT
/begin MEASUREMENT ASDrf_trqStyHigh_mp "Obere Grenze des Momentenintervalls für die Erkennung eines stationären Zustands." SWORD Trq 1 100 -3276.800 3276.700 FORMAT "%8.3" ECU_ADDRESS 0x8FE44E /end MEASUREMENT
/begin MEASUREMENT ASDrf_trqStyLow_mp "Untere Grenze des Momentenintervalls für die Erkennung eines stationären Zustands." SWORD Trq 1 100 -3276.800 3276.700 FORMAT "%8.3" ECU_ADDRESS 0x8FE450 /end MEASUREMENT
/begin MEASUREMENT ASMod_dmAirPerTimeCorr "dynamisch korrigierter Frischluftmassenstrom vor Mischstelle" SWORD AirMassPerTime 1 100 -3276.800 3276.700 FORMAT "%8.3" ECU_ADDRESS 0x7F8A4C /end MEASUREMENT
/begin MEASUREMENT ASMod_dmEGR_mp "rückgeführter Abgasmassenstrom" SWORD AirMassPerTime 1 100 -3276.800 3276.700 FORMAT "%8.3" ECU_ADDRESS 0x8FE45A /end MEASUREMENT
/begin MEASUREMENT ASMod_dmEG_mp "Abgasmassenstrom nach Verbrennung" SWORD AirMassPerTime 1 100 -3276.800 3276.700 FORMAT "%8.3" ECU_ADDRESS 0x8FE464 /end MEASUREMENT
/begin MEASUREMENT ASMod_dmExhMnfPre "Abgasmassenstrom am Eintritt des Abgaskrümmers" SWORD AirMassPerTime 1 100 -3276.800 3276.700 FORMAT "%8.3" ECU_ADDRESS 0x7F8A4E /end MEASUREMENT
/begin MEASUREMENT ASMod_dmExhMnfPst "Abgasmassenstrom am Austritt des Abgaskrümmers" SWORD AirMassPerTime 1 100 -3276.800 3276.700 FORMAT "%8.3" ECU_ADDRESS 0x7F8A50 /end MEASUREMENT
/begin MEASUREMENT ASMod_dmFlBurned_mp "Massenstrom des verbrannten Kraftstoffs" SWORD InjMassPerTime 1 100 -327.6800 327.6700 FORMAT "%8.4" ECU_ADDRESS 0x8FE466 /end MEASUREMENT
/begin MEASUREMENT ASMod_dmFlPerTime_mp "eingespritzter Kraftstoffmassenstrom" SWORD InjMassPerTime 1 100 -327.6800 327.6700 FORMAT "%8.4" ECU_ADDRESS 0x8FE468 /end MEASUREMENT
/begin MEASUREMENT ASMod_dmIndAir "Gasmassenstrom in den Motor" SWORD AirMassPerTime 1 100 -3276.800 3276.700 FORMAT "%8.3" ECU_ADDRESS 0x7F8A52 /end MEASUREMENT
/begin MEASUREMENT ASMod_dmIndAirRef "Referenz des Gasmassenstroms in den Motor während geschlossener Abgasrückführung" SWORD AirMassPerTime 1 100 -3276.800 3276.700 FORMAT "%8.3" ECU_ADDRESS 0x7F8A54 /end MEASUREMENT
/begin MEASUREMENT ASMod_dmIndAirRef_mp "Referenz des Gasmassenstroms in den Motor" SWORD AirMassPerTime 1 100 -3276.800 3276.700 FORMAT "%8.3" ECU_ADDRESS 0x8FE46A /end MEASUREMENT
/begin MEASUREMENT ASMod_dmIndAir_mp "Gasmassenstrom in den Motor" SWORD AirMassPerTime 1 100 -3276.800 3276.700 FORMAT "%8.3" ECU_ADDRESS 0x8FE45C /end MEASUREMENT
/begin MEASUREMENT ASMod_dmIndVol_mp "zeitliche Änderung der Gasmasse im Ansaugvolumen" SWORD AirMassPerTime 1 100 -3276.800 3276.700 FORMAT "%8.3" ECU_ADDRESS 0x8FE488 /end MEASUREMENT
/begin MEASUREMENT ASMod_dmO2EG_mp "Sauerstoffmassenstrom nach Verbrennung" SWORD O2MassPerTime 1 100 -327.6800 327.6700 FORMAT "%8.4" ECU_ADDRESS 0x8FE46C /end MEASUREMENT
/begin MEASUREMENT ASMod_dmO2IndAir "Sauerstoffmassenstrom in den Motor" SWORD O2MassPerTime 1 100 -327.6800 327.6700 FORMAT "%8.4" ECU_ADDRESS 0x7F8A56 /end MEASUREMENT
/begin MEASUREMENT ASMod_dvolIndAirRef "Referenz des Gasvolumenstroms in den Motor" SWORD AirVolPerTime 1 100 -3276.800 3276.700 FORMAT "%8.3" ECU_ADDRESS 0x7F8A58 /end MEASUREMENT
/begin MEASUREMENT ASMod_facAMCor "Korrekturfaktor für Luftmassensignal" SWORD Fact 1 100 -4.000000 3.999878 FORMAT "%8.6" ECU_ADDRESS 0x7F8A5A /end MEASUREMENT
/begin MEASUREMENT ASMod_facDMCorTDiff_mp "Korrekturfaktor der Temperaturerhöhung aufgrund des aktuellen Gasmassenstroms" SWORD Fact 1 100 -4.000000 3.999878 FORMAT "%8.6" ECU_ADDRESS 0x8FE46E /end MEASUREMENT
/begin MEASUREMENT ASMod_facSOICorTDiff_mp "Korrekturfaktor der Temperaturerhöhung aufgrund des aktuellen Spritzbeginns" SWORD Fact 1 100 -4.000000 3.999878 FORMAT "%8.6" ECU_ADDRESS 0x8FE470 /end MEASUREMENT
/begin MEASUREMENT ASMod_facTIndAirCor_mp "Korrekturfaktor für Luftaufwand" SWORD RatAirMass 1 100 -32.76800 32.76700 FORMAT "%8.5" ECU_ADDRESS 0x8FE48C /end MEASUREMENT
/begin MEASUREMENT ASMod_facVolEff_mp "Luftaufwand aus Grundkennfeld" SWORD RatAirMass 1 100 -32.76800 32.76700 FORMAT "%8.5" ECU_ADDRESS 0x8FE48E /end MEASUREMENT
/begin MEASUREMENT ASMod_facVSACorVolEff_mp "Korrekturfaktor für Luftaufwand aufgrund aktueller Drallklappenposition" SWORD RatAirMass 1 100 -32.76800 32.76700 FORMAT "%8.5" ECU_ADDRESS 0x8FE490 /end MEASUREMENT
/begin MEASUREMENT ASMod_mAirPerCylCorr "dynamisch korrigierte Luftmasse pro Zylinder vor Mischstelle" SWORD AirMassPerCyl 1 100 -3276.800 3276.700 FORMAT "%8.3" ECU_ADDRESS 0x7F8A5C /end MEASUREMENT
/begin MEASUREMENT ASMod_mIndVol_mp "Gasmasse im Einlassvolumen" SWORD AirMass 1 100 -327.6800 327.6700 FORMAT "%8.4" ECU_ADDRESS 0x8FE48A /end MEASUREMENT
/begin MEASUREMENT ASMod_phiSOIRef_mp "Referenz des Spritzbeginns der MI1" SWORD AngleCrS 1 100 -768.0000 767.9766 FORMAT "%8.4" ECU_ADDRESS 0x8FE472 /end MEASUREMENT
/begin MEASUREMENT ASMod_qBurned_mp "Menge des verbrannten Kraftstoffes" SWORD InjMass 1 100 -327.6800 327.6700 FORMAT "%8.4" ECU_ADDRESS 0x8FE474 /end MEASUREMENT
/begin MEASUREMENT ASMod_qCor "Korrekturmenge für Mengensignal" SWORD InjMass 1 100 -327.6800 327.6700 FORMAT "%8.4" ECU_ADDRESS 0x7F8A5E /end MEASUREMENT
/begin MEASUREMENT ASMod_qLmbdCtlCorr_mp "korrigierte Lambdakontrollmenge" SWORD InjMass 1 100 -327.6800 327.6700 FORMAT "%8.4" ECU_ADDRESS 0x8FE476 /end MEASUREMENT
/begin MEASUREMENT ASMod_rDMIndAir_mp "relative Abweichung von der Referenz des Gasmassenstroms" SWORD RatAirMass 1 100 -32.76800 32.76700 FORMAT "%8.5" ECU_ADDRESS 0x8FE478 /end MEASUREMENT
/begin MEASUREMENT ASMod_rFlBurned_mp "Verhältnis der verbrannten zur eingespritzten Kraftstoffmasse" SWORD RatFuelMass 1 100 -327.6800 327.6700 FORMAT "%8.4" ECU_ADDRESS 0x8FE47A /end MEASUREMENT
/begin MEASUREMENT ASMod_rLmbdRecEG "schnelles reziprokes Lambda-Signal nach Verbrennung" SWORD lambdaRecVal 1 100 -32.76800 32.76700 FORMAT "%8.5" ECU_ADDRESS 0x7F8A60 /end MEASUREMENT
/begin MEASUREMENT ASMod_rLmbdRecExhMnfPst "reziprokes Lambdasignal am Ausgang des Abgaskrümmers" SWORD lambdaRecVal 1 100 -32.76800 32.76700 FORMAT "%8.5" ECU_ADDRESS 0x7F8A62 /end MEASUREMENT
/begin MEASUREMENT ASMod_rO2EG_mp "Sauerstoffmassenanteil des Abgases nach Verbrennung" SWORD O2 1 100 -0.3276800 0.3276700 FORMAT "%9.7" ECU_ADDRESS 0x8FE47C /end MEASUREMENT
/begin MEASUREMENT ASMod_rO2ExhMnfPre "Sauerstoffmassenanteil des Abgases am Eintritt des Abgaskrümmers" SWORD O2 1 100 -0.3276800 0.3276700 FORMAT "%9.7" ECU_ADDRESS 0x7F8A64 /end MEASUREMENT
/begin MEASUREMENT ASMod_rO2ExhMnfPst_mp "Sauerstoffmassenanteil des Abgases am Austritt des Abgaskrümmers" SWORD O2 1 100 -0.3276800 0.3276700 FORMAT "%9.7" ECU_ADDRESS 0x8FE45E /end MEASUREMENT
/begin MEASUREMENT ASMod_rO2IndAir_mp "Sauerstoffmassenanteil des Massenstroms in den Motor" SWORD O2 1 100 -0.3276800 0.3276700 FORMAT "%9.7" ECU_ADDRESS 0x8FE460 /end MEASUREMENT
/begin MEASUREMENT ASMod_rRelPosVSA "relative Position der Drallklappe" SWORD Prc 1 100 -400.0000 399.9878 FORMAT "%8.4" ECU_ADDRESS 0x7F8A66 /end MEASUREMENT
/begin MEASUREMENT ASMod_tDiffEG_mp "Temperaturerhöhung des Gasmassenstroms durch Verbrennung" SWORD TempDiff_Cels 1 100 -3276.800 3276.700 FORMAT "%8.3" ECU_ADDRESS 0x8FE47E /end MEASUREMENT
/begin MEASUREMENT ASMod_tDiffEng_mp "Temperaturerhöhung des Gasmassenstroms aus dem Grundkennfeld" SWORD TempDiff_Cels 1 100 -3276.800 3276.700 FORMAT "%8.3" ECU_ADDRESS 0x8FE480 /end MEASUREMENT
/begin MEASUREMENT ASMod_tEG_mp "Temperatur des Abgases nach Verbrennung" SWORD Temp_Cels 1 100 -50.140 899.860 FORMAT "%8.3" ECU_ADDRESS 0x8FE482 /end MEASUREMENT
/begin MEASUREMENT ASMod_tEngCorTDiff_mp "Korrektur der Temperaturerhöhung aufgrund der Motortemperatur" SWORD TempDiff_Cels 1 100 -3276.800 3276.700 FORMAT "%8.3" ECU_ADDRESS 0x8FE484 /end MEASUREMENT
/begin MEASUREMENT ASMod_tExhMnfPre "Abgastemperatur am Eintritt des Abgaskrümmers" SWORD Temp_Cels 1 100 -50.140 899.860 FORMAT "%8.3" ECU_ADDRESS 0x7F8A68 /end MEASUREMENT
/begin MEASUREMENT ASMod_tExhMnfPst_mp "Temperatur des Gasmassenstroms am Austritt des Abgaskrümmers" SWORD Temp_Cels 1 100 -50.140 899.860 FORMAT "%8.3" ECU_ADDRESS 0x8FE462 /end MEASUREMENT
/begin MEASUREMENT ASMod_tiDdTm_mp "Gaslaufzeit durch den Motor" SWORD TimeDeb 1 100 -327680.0 327670.0 FORMAT "%8.1" ECU_ADDRESS 0x8FE486 /end MEASUREMENT
/begin MEASUREMENT ASMod_tIndAir "Temperatur des Gasmassenstroms in den Motor" SWORD Temp_Cels 1 100 -50.140 899.860 FORMAT "%8.3" ECU_ADDRESS 0x7F8A6A /end MEASUREMENT
/begin MEASUREMENT ASMod_tIndAirRef "Referenz der Gastemperatur vor Einlass" SWORD Temp_Cels 1 100 -50.140 899.860 FORMAT "%8.3" ECU_ADDRESS 0x7F8A6C /end MEASUREMENT
/begin MEASUREMENT ASMod_tIntakeAir_mp "Ansauglufttemperatur" SWORD Temp_Cels 1 100 -50.140 899.860 FORMAT "%8.3" ECU_ADDRESS 0x8FE492 /end MEASUREMENT
/begin MEASUREMENT BattCD_u "Batteriespannung" SWORD Volt_Batt 1 100 -640625.6 640606.1 FORMAT "%8.1" ECU_ADDRESS 0x7F8AD6 /end MEASUREMENT
/begin MEASUREMENT BattCD_uLin "Linearisierter Wert der Batteriespannung" SWORD Volt_Batt 1 100 -640625.6 640606.1 FORMAT "%8.1" ECU_ADDRESS 0x7F8AD8 /end MEASUREMENT
/begin MEASUREMENT BattCD_uRaw "Rohwert ADC-Signalspannung für Batteriespannung" SWORD Volt 1 100 -160156.4 160151.5 FORMAT "%8.1" ECU_ADDRESS 0x7F8ADA /end MEASUREMENT
/begin MEASUREMENT Batt_facCor "Faktor für Batteriespannungskorrektur" SWORD Fact 1 100 -4.000000 3.999878 FORMAT "%8.6" ECU_ADDRESS 0x7F8ADC /end MEASUREMENT
/begin MEASUREMENT BdInt_nMax "Schutzdrehzahl für Karosserie und Innenraum" SWORD EngN 1 100 -32768.00 32767.00 FORMAT "%8.2" ECU_ADDRESS 0x7F8ADE /end MEASUREMENT
/begin MEASUREMENT BdInt_nMin "Anforderung Leerlaufdrehzahl durch Karosserie & Innenraum" SWORD EngN 1 100 -32768.00 32767.00 FORMAT "%8.2" ECU_ADDRESS 0x7F8AE0 /end MEASUREMENT
/begin MEASUREMENT BdInt_pwrDes "Leistungsanforderung Wunsch Karosserie & Innenraum" SWORD Pwr 1 100 -308831.1 308821.7 FORMAT "%8.1" ECU_ADDRESS 0x7F8AE2 /end MEASUREMENT
/begin MEASUREMENT BdInt_pwrLead "Leistungsanforderung Vorhalt Karosserie & Innenraum" SWORD Pwr 1 100 -308831.1 308821.7 FORMAT "%8.1" ECU_ADDRESS 0x7F8AE4 /end MEASUREMENT
/begin MEASUREMENT BPACD_rCnv_mp "Tastverhältnis basierend auf dem Ausgang des Ladedrucksreglers" SWORD DtyCyc 1 100 -327.6800 327.6700 FORMAT "%8.4" ECU_ADDRESS 0x8FE498 /end MEASUREMENT
/begin MEASUREMENT BPACD_rOut "Tastverhältnis zür Endstufenansteuerung" SWORD DtyCyc 1 100 -327.6800 327.6700 FORMAT "%8.4" ECU_ADDRESS 0x7F8ABE /end MEASUREMENT
/begin MEASUREMENT BPA_rBPAByp_mp "Bypass-Label, Kopie von BPA_rBPA" SWORD Prc 1 100 -400.0000 399.9878 FORMAT "%8.4" ECU_ADDRESS 0x8FE494 /end MEASUREMENT
/begin MEASUREMENT BPA_rBPACD "Stellgröße für Ladedrucksteller (Stellerkoordinatorausgang)" SWORD Prc 1 100 -400.0000 399.9878 FORMAT "%8.4" ECU_ADDRESS 0x7F8AC2 /end MEASUREMENT
/begin MEASUREMENT BPA_rLPAByp_mp "LPACD TV rohwert vor ASCET bypass" SWORD Prc 1 100 -400.0000 399.9878 FORMAT "%8.4" ECU_ADDRESS 0x8FE496 /end MEASUREMENT
/begin MEASUREMENT BPA_rLPACD "Sollwert Ladedrucksteller Koordinator Niederdruckstufe" SWORD Prc 1 100 -400.0000 399.9878 FORMAT "%8.4" ECU_ADDRESS 0x7F8AC4 /end MEASUREMENT
/begin MEASUREMENT BPSCD_dFltValDT1 "differentiated value of Filtered value of Boost pressure" SWORD dp_dZ10 1 100 -327680.0 327670.0 FORMAT "%8.1" ECU_ADDRESS 0x7F8AC6 /end MEASUREMENT
/begin MEASUREMENT BPSCD_dpOutVal "Ladedruckgradient" SWORD dp_dZ10 1 100 -327680.0 327670.0 FORMAT "%8.1" ECU_ADDRESS 0x7F8AC8 /end MEASUREMENT
/begin MEASUREMENT BPSCD_pFltVal "gefilterter Wert des Ladedrucks" SWORD Pres_hPa 1 100 -32768.00 32767.00 FORMAT "%8.2" ECU_ADDRESS 0x7F8ACA /end MEASUREMENT
/begin MEASUREMENT BPSCD_pIntVal "aktueller Ladedruck" SWORD Pres_hPa 1 100 -32768.00 32767.00 FORMAT "%8.2" ECU_ADDRESS 0x7F8ACC /end MEASUREMENT
/begin MEASUREMENT BPSCD_pLin "Mittelere Ladedruck-Wert (liniarisiert)" SWORD Pres_hPa 1 100 -32768.00 32767.00 FORMAT "%8.2" ECU_ADDRESS 0x7F8ACE /end MEASUREMENT
/begin MEASUREMENT BPSCD_pOutVal "Ladedruckwert" SWORD Pres_hPa 1 100 -32768.00 32767.00 FORMAT "%8.2" ECU_ADDRESS 0x7F8AD0 /end MEASUREMENT
/begin MEASUREMENT BPSCD_pPhyVal "Ladedruck in diesem Zyklus" SWORD Pres_hPa 1 100 -32768.00 32767.00 FORMAT "%8.2" ECU_ADDRESS 0x7F8AD2 /end MEASUREMENT
/begin MEASUREMENT BPSCD_stErr "Fehlererkennung (falls einer auftritt) des Ladedrucksensors in einem Zyklus" UBYTE OneToOne 1 100 0.00 255.0 FORMAT "%5.1" ECU_ADDRESS 0x7F87D1 /end MEASUREMENT
/begin MEASUREMENT BPSCD_stPlausErr "Plausibilitaetsfehler Status ( zwischen BPSCD und APSCD )" UBYTE OneToOne 1 100 0.00 255.0 FORMAT "%5.1" ECU_ADDRESS 0x7F87D2 /end MEASUREMENT
/begin MEASUREMENT BPSCD_uRawVal "Spannungsrohwert des Ladedrucksensors" SWORD Volt 1 100 -160156.4 160151.5 FORMAT "%8.1" ECU_ADDRESS 0x7F8AD4 /end MEASUREMENT
/begin MEASUREMENT BrkCD_ctUnPlaus_mp "Unplausibilitätszähler" UWORD OneToOne 1 100 0.00 65535.00 FORMAT "%8.2" ECU_ADDRESS 0x6F800C /end MEASUREMENT
/begin MEASUREMENT BrkCD_stDeb_mp "Bremskontaktschalter - Status Fehlerentprellung Plausibilitaetspruefung" UBYTE OneToOne 1 100 0.00 255.0 FORMAT "%5.1" ECU_ADDRESS 0x8FE49A /end MEASUREMENT
/begin MEASUREMENT BrkCD_stMnSwtDebVal "Digitalsignal Bremskontakt entprellt" UBYTE OneToOne 1 100 0.00 255.0 FORMAT "%5.1" ECU_ADDRESS 0x7F87F2 /end MEASUREMENT
/begin MEASUREMENT BrkCD_stMnSwtLastDebVal "Letzter logischer Entprellwert vom Bremspedal" UBYTE OneToOne 1 100 0.00 255.0 FORMAT "%5.1" ECU_ADDRESS 0x7F87F3 /end MEASUREMENT
/begin MEASUREMENT BrkCD_stMnSwtLogVal_mp "Digitalsignal redundanter Bremskontakt nicht entprellt" UBYTE OneToOne 1 100 0.00 255.0 FORMAT "%5.1" ECU_ADDRESS 0x8FE49B /end MEASUREMENT
/begin MEASUREMENT BrkCD_stMnSwtRawVal "Rohwert Bremskontakt nicht entprellt" UBYTE OneToOne 1 100 0.00 255.0 FORMAT "%5.1" ECU_ADDRESS 0x7F87F4 /end MEASUREMENT
/begin MEASUREMENT BrkCD_stPressed "Meldung Bremse betätigt" UBYTE OneToOne 1 100 0.00 255.0 FORMAT "%5.1" ECU_ADDRESS 0x7F87F5 /end MEASUREMENT
/begin MEASUREMENT BrkCD_stRedSwtDebVal "Digitalsignal redundanter Bremskontakt entprellt" UBYTE OneToOne 1 100 0.00 255.0 FORMAT "%5.1" ECU_ADDRESS 0x7F87F6 /end MEASUREMENT
/begin MEASUREMENT BrkCD_stRedSwtLastDebVal "Letzter logischer Entprellwert vom redundanten Bremspedal" UBYTE OneToOne 1 100 0.00 255.0 FORMAT "%5.1" ECU_ADDRESS 0x7F87F7 /end MEASUREMENT
/begin MEASUREMENT BrkCD_stRedSwtLogVal_mp "Digitalsignal redundanter Bremskontakt nicht entprellt" UBYTE OneToOne 1 100 0.00 255.0 FORMAT "%5.1" ECU_ADDRESS 0x8FE49C /end MEASUREMENT
/begin MEASUREMENT BrkCD_stRedSwtPresent "Redundanter Bremskontakt Aktivinformation" UBYTE OneToOne 1 100 0.00 255.0 FORMAT "%5.1" ECU_ADDRESS 0x7F87F8 /end MEASUREMENT
/begin MEASUREMENT BrkCD_stRedSwtRawVal "Rohwert redundanter Bremskontakt nicht entprellt" UBYTE OneToOne 1 100 0.00 255.0 FORMAT "%5.1" ECU_ADDRESS 0x7F87F9 /end MEASUREMENT
/begin MEASUREMENT BrkCD_stResUnPlaus_mp "Zustandsbits zum Rücksetzen der Unplausibilität" UBYTE OneToOne 1 100 0.00 255.0 FORMAT "%5.1" ECU_ADDRESS 0x8FE49D /end MEASUREMENT
/begin MEASUREMENT BrkCD_stRun_mp "Laufzeitmesspunkt" UWORD OneToOne 1 100 0.00 65535.00 FORMAT "%8.2" ECU_ADDRESS 0x8FE49E /end MEASUREMENT
/begin MEASUREMENT BrkCD_swtSig "Signalquelle Schalter - DIO/CAN" UBYTE OneToOne 1 100 0.00 255.0 FORMAT "%5.1" ECU_ADDRESS 0x7F87FA /end MEASUREMENT
/begin FUNCTION airctl_monitor_uic ""
 /begin DEF_CHARACTERISTIC AirCtl_rEGRAdd_Vector AirCtl_rEGRAdd_Channel AirCtl_rEGR_Vector AirCtl_rEGR_Channel AirCtl_rTVAAdd_Vector AirCtl_rTVAAdd_Channel AirCtl_rTVA_Vector AirCtl_rTVA_Channel /end DEF_CHARACTERISTIC
 /begin OUT_MEASUREMENT AirCtl_dnAvrg_mp AirCtl_dnSurgeHigh_mp AirCtl_dnSurgeLow_mp AirCtl_dqRaw_mp AirCtl_mDesMax_mp AirCtl_qCurrRmp_mp AirCtl_qSurgeHigh_mp AirCtl_qSurgeLow_mp AirCtl_rBrkRmp_mp AirCtl_rEGRByp_mp AirCtl_rTVAByp_mp AirCtl_stAirCtlBits1_mp AirCtl_stAirCtlBits2_mp AirCtl_stAirCtlBits_mp AirCtl_stDebBrkpressed_mp AirCtl_stDebDef_mp AirCtl_stDesChk_mp AirCtl_stGearShiftHighLoad_mp AirCtl_stHealDef_mp AirCtl_stPlateBreak_mp AirCtl_tiStrtDel_mp /end OUT_MEASUREMENT
/end FUNCTION
/begin FUNCTION airctl_monitor_var ""
 /begin DEF_CHARACTERISTIC AirCtl_mMaxDvtRgn_MAP AirCtl_mMinDvtRgn_MAP AirCtl_qHiRgn_CUR AirCtl_qLoRgn_CUR AirCtl_rTVADflVal7_C AirCtl_rTVADflVal8B_C AirCtl_stMskLoIdl_C AirCtl_stMskOvrRun_C AirCtl_stMskQCurRgn_C AirCtl_stMskShOffRgn_C AirCtl_DebGvnrDvtRgnMaxDef2_C AirCtl_DebGvnrDvtRgnMaxOk2_C AirCtl_DebGvnrDvtRgnMaxDef_C AirCtl_DebGvnrDvtRgnMaxOk_C AirCtl_DebGvnrDvtRgnMinDef2_C AirCtl_DebGvnrDvtRgnMinOk2_C AirCtl_DebGvnrDvtRgnMinDef_C AirCtl_DebGvnrDvtRgnMinOk_C /end DEF_CHARACTERISTIC
 /begin IN_MEASUREMENT Eng_nAvrg InjCtl_qCurrCor /end IN_MEASUREMENT
/end FUNCTION
/begin FUNCTION airctl_monitor_var_msg "" /end FUNCTION
/begin FUNCTION airctl_monitor_var_uic ""
 /begin OUT_MEASUREMENT AirCtl_mMaxDvtRgn_mp AirCtl_mMinDvtRgn_mp AirCtl_stDebDefNrm_mp AirCtl_stDebDefRgn_mp /end OUT_MEASUREMENT
/end FUNCTION
/begin FUNCTION airsys_cocmpntactv "Endstufenabschaltungskoordinator Luftsystem" /end FUNCTION
/begin FUNCTION airsys_cocmpntactv_msg "" /begin OUT_MEASUREMENT AirSys_stCmpntActv /end OUT_MEASUREMENT /end FUNCTION
/begin FUNCTION airsys_cocmpntactv_uic "" /end FUNCTION
/begin FUNCTION airsys_cotstdem_msg "" /begin OUT_MEASUREMENT AirSys_stTstDem /end OUT_MEASUREMENT /end FUNCTION
/begin FUNCTION alt "Generator"
 /begin DEF_CHARACTERISTIC Alt_facTrans_C Alt_pwrBas_CUR Alt_pwrOffs_C Alt_rAdjValDef_C Alt_rAdjValMax_C Alt_rAdjValMin_C /end DEF_CHARACTERISTIC
 /begin IN_MEASUREMENT Alt_n_mp /end IN_MEASUREMENT
/end FUNCTION
/begin FUNCTION altcd "Komponententreiber Generator"
 /begin DEF_CHARACTERISTIC AltCD_dcycLoadPwmInMin_C AltCD_tiDebErrSigNeg_C AltCD_tiDebErrSigPos_C AltCD_tiDebErrSigDef_C AltCD_tiDebErrSigOk_C AltCD_tiDebDtyCycMinDef_C AltCD_tiDebDtyCycMinOk_C AltCD_nDisMonThres_C AltCD_rAltLoadDfl_C AltCD_rLoadLin_CUR AltCD_uSRCdisXLow_C AltCD_uSRCdisXHigh_C AltCD_uSRCdisYLow_C AltCD_uSRCdisYHigh_C AltCD_stDisLmpTst_C AltCD_stLoadPwmInInv_C AltCD_stSRCdis_C AltCD_swtErrSigInv_C AltCD_swtGenTyp_C AltCD_swtLROff_C AltCD_tiAltDead_C AltCD_tiDebDefect_C AltCD_tiDebOk_C AltCD_tiDisErrMon_C AltCD_tiLRMax_C AltCD_tiLRMin_C AltCD_tiOutput_C AltCD_tiPT1_C AltCD_tiReset_C AltCD_uAltMax_C AltCD_uAltMin_C /end DEF_CHARACTERISTIC
 /begin IN_MEASUREMENT AltCD_dcycAltLdPT1_mp /end IN_MEASUREMENT
/end FUNCTION
/begin FUNCTION altcd_msg ""
 /begin OUT_MEASUREMENT AltCD_ctPosPins AltCD_dcycAltLoad AltCD_rAltLoad AltCD_stErrAlt AltCD_stErrSig AltCD_stGenManuFak AltCD_stGenTypKenn AltCD_uAlt /end OUT_MEASUREMENT
/end FUNCTION
/begin FUNCTION altcd_uic ""
 /begin OUT_MEASUREMENT AltCD_dcycAltLdPT1_mp AltCD_stAltCtl_mp AltCD_stErrSigDeb_mp AltCD_stLROff_mp AltCD_stSRCdis_mp AltCD_tiLR_mp AltCD_uAlt_mp /end OUT_MEASUREMENT
/end FUNCTION
/begin FUNCTION alt_msg "" /begin OUT_MEASUREMENT Alt_pwrDes Alt_pwrLead /end OUT_MEASUREMENT /end FUNCTION
/begin FUNCTION alt_uic "" /begin DEF_CHARACTERISTIC Alt_pwrDes_Vector Alt_pwrDes_Channel /end DEF_CHARACTERISTIC /begin OUT_MEASUREMENT Alt_n_mp Alt_pwrUnCor_mp Alt_rAdjVal_mp /end OUT_MEASUREMENT /end FUNCTION
/begin FUNCTION alt_var "" /end FUNCTION
/begin FUNCTION alt_var_uic "" /end FUNCTION
/begin FUNCTION aoht "Zuheizer"
 /begin DEF_CHARACTERISTIC AOHt_IKi_C AOHt_IKiPos_C AOHt_IKiNeg_C AOHt_rIWinPos_C AOHt_rIWinNeg_C AOHt_nACEngXHigh_C AOHt_nACEngXLow_C AOHt_nAvrgHysMin_C AOHt_nAvrgHysMax_C AOHt_stNAvrgShutOffEn_C AOHt_stNAvrgShutOffDis_C AOHt_nDAEng_C AOHt_nMin_C AOHt_PKp_C AOHt_PKpPos_C AOHt_PKpNeg_C AOHt_rPWinPos_C AOHt_rPWinNeg_C AOHt_rHtgOutMax_C AOHt_rHtgOutMin_C AOHt_rIDef_C AOHt_rNAvrg_CUR AOHt_stACAccPedXLow_C AOHt_stACAccPedXHigh_C AOHt_stACAccPedYLow_C AOHt_stACAccPedYHigh_C AOHt_stACEngXLow_C AOHt_stACEngXHigh_C AOHt_stACEngYLow_C AOHt_stACEngYHigh_C AOHt_stACVehXLow_C AOHt_stACVehXHigh_C AOHt_stACVehYLow_C AOHt_stACVehYHigh_C AOHt_stDAAccPedXLow_C AOHt_stDAAccPedXHigh_C AOHt_stDAAccPedYLow_C AOHt_stDAAccPedYHigh_C AOHt_stDAEngXLow_C AOHt_stDAEngXHigh_C AOHt_stDAEngYLow_C AOHt_stDAEngYHigh_C AOHt_stDAGearXLow_C AOHt_stDAGearXHigh_C AOHt_stDAGearYLow_C AOHt_stDAGearYHigh_C AOHt_stDAVehXLow_C AOHt_stDAVehXHigh_C AOHt_stDAVehYLow_C AOHt_stDAVehYHigh_C AOHt_swtHtgActive_C AOHt_swtHtgUp_C AOHt_tEnvHysDelta_C AOHt_tEnv_CUR AOHt_tiACMin_C AOHt_tiAltPT1_C AOHt_tiDAMin_C AOHt_tiNAvrgPT1_C AOHt_tiStrt_C AOHt_trqInrLimDelta_C AOHt_uBattHysMin_C AOHt_uBattHysMax_C AOHt_stBattShutOffEn_C AOHt_stBattShutOffDis_C AOHt_vDAVeh_C /end DEF_CHARACTERISTIC
 /begin IN_MEASUREMENT Eng_nAvrg FrmMng_tEnv /end IN_MEASUREMENT
/end FUNCTION
/begin FUNCTION aohtcd "Zuheizer Komponententreiber"
 /begin DEF_CHARACTERISTIC AOHtCD_ctPwrStgOnMax_C AOHtCD_tiDebAOHtDia1Def_C AOHtCD_tiDebAOHtDia1Ok_C AOHtCD_tiDebAOHtDia2Def_C AOHtCD_tiDebAOHtDia2Ok_C AOHtCD_tiDebAOHtDia3Def_C AOHtCD_tiDebAOHtDia3Ok_C AOHtCD_tiDebExcTempDef_C AOHtCD_tiDebExcTempOk_C AOHtCD_tiDebNoLoadDef_C AOHtCD_tiDebNoLoadOk_C AOHtCD_tiDebPos_C AOHtCD_tiDebNeg_C AOHtCD_tiDebShortCircBatDef_C AOHtCD_tiDebShortCircBatOk_C AOHtCD_tiDebShortCircGndDef_C AOHtCD_tiDebShortCircGndOk_C AOHtCD_numDia_C AOHtCD_numDioIn_C AOHtCD_numPwmOut_C AOHtCD_stInvOut_C AOHtCD_tiPer_C AOHtCD_rOutMax_C AOHtCD_rOutMin_C AOHtCD_stPwrStgActv_C AOHtCD_stPwrStgDia_C AOHtCD_stSPICtl_C AOHtCD_swtBattCorr_C AOHtCD_swtInv_C AOHtCD_tiBtwTst_C AOHtCD_tiDiag1Max_C AOHtCD_tiDiag1Min_C AOHtCD_tiDiag2Max_C AOHtCD_tiDiag2Min_C AOHtCD_tiDiag3Max_C AOHtCD_tiDiag3Min_C AOHtCD_tiPwrStgOn_C /end DEF_CHARACTERISTIC
/end FUNCTION
/begin FUNCTION aohtcd_msg "" /begin OUT_MEASUREMENT AOHtCD_stHtgReq /end OUT_MEASUREMENT /end FUNCTION
/begin FUNCTION aohtcd_uic "" /begin OUT_MEASUREMENT AOHtCD_rOut_mp /end OUT_MEASUREMENT /end FUNCTION
/begin FUNCTION aoht_msg "" /begin OUT_MEASUREMENT AOHt_nMin AOHt_rHtgOut AOHt_stHtgUp /end OUT_MEASUREMENT /end FUNCTION
/begin FUNCTION aoht_uic "" /begin DEF_CHARACTERISTIC AOHt_rHtgOut_Vector AOHt_rHtgOut_Channel /end DEF_CHARACTERISTIC
 /begin OUT_MEASUREMENT AOHt_rAltLd_mp AOHt_rIGov_mp AOHt_rNAvrgDeb_mp AOHt_rNAvrg_mp AOHt_rPGov_mp AOHt_rPI_mp AOHt_stAC_mp AOHt_stDA_mp AOHt_stShutOff_mp AOHt_tEnvLin_mp /end OUT_MEASUREMENT
/end FUNCTION
/begin FUNCTION appcd "Fahrpedal Komponententreiber"
 /begin DEF_CHARACTERISTIC APPCD_uAPP1_SRCMin_C APPCD_uAPP1_SRCMax_C APPCD_uAPP2_SRCMin_C APPCD_uAPP2_SRCMax_C APPCD_DebSRCHighDef_C APPCD_DebSRCHighOk_C APPCD_DebSRCLowDef_C APPCD_DebSRCLowOk_C APPCD_DebSyncDef_C APPCD_DebSyncOk_C APPCD_duAPPJit_C APPCD_facrAPP1APP2_C APPCD_rThrFltFDCLowPos_C APPCD_rThrFltFDCMidPos_C APPCD_rThrFltFDCLowNeg_C APPCD_rThrFltFDCMidNeg_C APPCD_tiLowNegFDCPT1_C APPCD_tiLowNegPT1_C APPCD_tiLowPosFDCPT1_C APPCD_tiLowPosPT1_C APPCD_tiMidNegFDCPT1_C APPCD_tiMidNegPT1_C APPCD_tiMidPosFDCPT1_C APPCD_tiMidPosPT1_C APPCD_tiUppNegFDCPT1_C APPCD_tiUppNegPT1_C APPCD_tiUppPosFDCPT1_C APPCD_tiUppPosPT1_C APPCD_swtNoFlt_C APPCD_rThrFltLowPos_C APPCD_rThrFltMidPos_C APPCD_rThrFltLowNeg_C APPCD_rThrFltMidNeg_C APPCD_numAdcAPP1_C APPCD_numAdcAPP2_C APPCD_duLimErrPos_C APPCD_duLimErrNeg_C APPCD_rLinAPP_CUR APPCD_SSpMonAPP1_C APPCD_SSpMonAPP2_C APPCD_swtEnaUnJit_C APPCD_swtStepLim_C APPCD_uAPPMin_C APPCD_uKickDownHighAPP_C APPCD_uKickDownLowAPP_C APPCD_uMinSync_C APPCD_uRawAPP2dOff_C APPCD_uSync_CUR /end DEF_CHARACTERISTIC
 /begin IN_MEASUREMENT APPCD_uRawAPP1 APPCD_uRaw_mp /end IN_MEASUREMENT
/end FUNCTION
/begin FUNCTION appcd_msg ""
 /begin OUT_MEASUREMENT APPCD_drAPP1UnFlt APPCD_rAPP1UnFlt APPCD_rFlt APPCD_rNextThr APPCD_stKickDown APPCD_stLimp APPCD_stPos APPCD_stSigSrc APPCD_uRawAPP1 APPCD_uRawAPP2 /end OUT_MEASUREMENT
/end FUNCTION
/begin FUNCTION appcd_uic ""
 /begin OUT_MEASUREMENT APPCD_rFlt_mp APPCD_rStepLim_mp APPCD_stAPP12def_mp APPCD_stErr1_mp APPCD_stTempErr_mp APPCD_stTempHeal_mp APPCD_uAPPunJit_mp APPCD_uDiffMax_mp APPCD_uRawAPP1half_mp APPCD_uRawAPP2dbl_mp APPCD_uRawDiff_mp APPCD_uRaw_mp /end OUT_MEASUREMENT
/end FUNCTION
/begin FUNCTION applib "" /end FUNCTION
/begin FUNCTION apscd "Atmosphärendruckfühler Komponententreiber"
 /begin DEF_CHARACTERISTIC APSCD_uSRCMin_C APSCD_uSRCMax_C APSCD_pLin_CUR APSCD_DebNplDef_C APSCD_DebNplOk_C APSCD_DebSigDef_C APSCD_DebSigOk_C APSCD_DebSRCDef_C APSCD_DebSRCOk_C APSCD_nLimHigh_C APSCD_numAdc_C APSCD_pCor_MAP APSCD_dpRmpSlpUp_C APSCD_dpRmpSlpDwn_C APSCD_swtInst_C APSCD_swtSigVal_C APSCD_swtSrcpVal_C APSCD_tiDel_C APSCD_stSensIDWord_C APSCD_pDfl_C /end DEF_CHARACTERISTIC
 /begin IN_MEASUREMENT APSCD_uRaw Eng_dnAvrg Eng_nAvrg /end IN_MEASUREMENT
/end FUNCTION
/begin FUNCTION apscd_msg ""
 /begin OUT_MEASUREMENT APSCD_pLinVal APSCD_pSensorVal APSCD_pVal APSCD_stSensorInst APSCD_swtSig APSCD_uRaw /end OUT_MEASUREMENT
/end FUNCTION
/begin FUNCTION apscd_uic "" /begin OUT_MEASUREMENT APSCD_BpsAllowed_mp APSCD_pCorVal_mp APSCD_pPhyVal_mp /end OUT_MEASUREMENT /end FUNCTION
/begin FUNCTION apscd_variant "" /end FUNCTION
/begin FUNCTION ars_detarspwr "Calculation of desired and the lead power of ARS"
 /begin DEF_CHARACTERISTIC ARS_tiDebSigDef_C ARS_tiDebSigOk_C ARS_facDesCor_C ARS_facDesOldCor_C ARS_nDia_C ARS_rTrans_C ARS_trqCurMax_MAP ARS_trqDesMax_MAP ARS_trqDiaMaxOfs_C ARS_trqDiaMax_C ARS_vDia_C /end DEF_CHARACTERISTIC
 /begin IN_MEASUREMENT FrmMng_aSide VSSCD_v /end IN_MEASUREMENT
/end FUNCTION
/begin FUNCTION ars_detarspwr_msg "" /begin OUT_MEASUREMENT ARS_pwrDes ARS_pwrLead ARS_st ARS_stRecARS /end OUT_MEASUREMENT /end FUNCTION
/begin FUNCTION ars_detarspwr_uic ""
 /begin OUT_MEASUREMENT ARS_trqCor_mp ARS_trqCurMax_mp ARS_trqDesMax_mp ARS_trqDesOld_mp ARS_trqDes_mp /end OUT_MEASUREMENT
/end FUNCTION
/begin FUNCTION asddc "Aktive Ruckeldämpfung Störgrößenregler (ARD)"
 /begin DEF_CHARACTERISTIC ASDdc_T1Clu_C ASDdc_KdClu_C ASDdc_T1ExtInt_C ASDdc_KdExtInt_C ASDdc_KdGrip_MAP ASDdc_numDefaultState_C ASDdc_T1State3_C ASDdc_KdState3_C ASDdc_T1State4_C ASDdc_KdState4_C ASDdc_stConfCluEng_C ASDdc_stConfCluOff_C ASDdc_stConfCluSlip_C ASDdc_stConv1_C ASDdc_stConv2_C ASDdc_stConv3_C ASDdc_stExtInt_C ASDdc_stFDC_C ASDdc_stGearswitch_C ASDdc_stGripRaw_C ASDdc_stGrip_C ASDdc_swtCalcN_C ASDdc_swtInitPS_C ASDdc_swtOpr_C ASDdc_swtStiffParameter_C ASDdc_T1Grip_MAP ASDdc_trqLimMax_C ASDdc_trqLimMin_C ASDdc_vLimIni_C /end DEF_CHARACTERISTIC
 /begin IN_MEASUREMENT ASDdc_nAvrg_mp DrvTrn_rTransDT /end IN_MEASUREMENT
 /begin OUT_MEASUREMENT ASDdc_KdCurr_mp ASDdc_T1Curr_mp /end OUT_MEASUREMENT
/end FUNCTION
/begin FUNCTION asddc_msg "" /begin OUT_MEASUREMENT ASDdc_trq /end OUT_MEASUREMENT /end FUNCTION
/begin FUNCTION asddc_uic "" /begin DEF_CHARACTERISTIC ASDdc_trq_Vector ASDdc_trq_Channel /end DEF_CHARACTERISTIC
 /begin OUT_MEASUREMENT ASDdc_nAvrg_mp ASDdc_stCluPS_mp ASDdc_stCond_mp ASDdc_stPrioState_mp ASDdc_stREinit_mp ASDdc_stSelectState_mp ASDdc_stStates_mp /end OUT_MEASUREMENT
/end FUNCTION
/begin FUNCTION asddc_var ""
 /begin DEF_CHARACTERISTIC ASDdc_KdFDC_MAP ASDdc_KdSlip_MAP ASDdc_numPrio_C ASDdc_T1FDC_MAP ASDdc_T1Slip_MAP /end DEF_CHARACTERISTIC
 /begin IN_MEASUREMENT ASDdc_nAvrg_mp DrvTrn_rTransDT /end IN_MEASUREMENT
/end FUNCTION
/begin FUNCTION asddc_var_uic "" /end FUNCTION
/begin FUNCTION asdrf_governor "ARD-Regelalgoithmus, Führungsformer"
 /begin DEF_CHARACTERISTIC ASDrf_CoeffADecLim_C ASDrf_CoeffBDecLim_C ASDrf_dtrqIncLimLow_C ASDrf_dtrqIncLimHigh_C ASDrf_stIncLimLow_C ASDrf_stIncLimHigh_C ASDrf_dtrqIncLim_C ASDrf_dtrqInrLtdLim_CUR ASDrf_dtrqSteepNeg_C ASDrf_dtrqSteepPos_C ASDrf_T1Flt_C ASDrf_swtCalcTrq_C ASDrf_swtFlt_C ASDrf_swtFrzLoss_C ASDrf_swtInitPS_C ASDrf_swtLim_C ASDrf_tiTrqSty_C ASDrf_trqDecHigh_C ASDrf_trqDecLow_C ASDrf_trqThresDecLim_C ASDrf_trqThresNeg_C ASDrf_trqThresPos_C /end DEF_CHARACTERISTIC
 /begin IN_MEASUREMENT ASDrf_dtrqInrLtd_mp /end IN_MEASUREMENT
/end FUNCTION
/begin FUNCTION asdrf_governor_msg "" /begin OUT_MEASUREMENT ASDrf_stLAD ASDrf_trqInr /end OUT_MEASUREMENT /end FUNCTION
/begin FUNCTION asdrf_governor_uic "" /begin DEF_CHARACTERISTIC ASDrf_trqInr_Vector ASDrf_trqInr_Channel /end DEF_CHARACTERISTIC
 /begin OUT_MEASUREMENT ASDrf_CoeffALossCurr_mp ASDrf_CoeffBLossCurr_mp ASDrf_dtrqDecMax_mp ASDrf_dtrqDecMin_mp ASDrf_dtrqInrLtd_mp ASDrf_dtrqLim_mp ASDrf_dtrqLossMax_mp ASDrf_dtrqLossMin_mp ASDrf_dtrqMax_mp ASDrf_dtrqMin_mp ASDrf_KdCurr_mp ASDrf_stDecLimState_mp ASDrf_stIncLim_mp ASDrf_stInitdtrqSteep_mp ASDrf_stPosNeg_mp ASDrf_stTrqLim_mp ASDrf_T1Curr_mp ASDrf_trqASDSum_mp ASDrf_trqCompOfs_mp ASDrf_trqDecLimStrt_mp ASDrf_trqInit_mp ASDrf_trqInrLtdFlt_mp ASDrf_trqInrMaxUnLim_mp ASDrf_trqInrMax_mp ASDrf_trqInrMinUnLim_mp ASDrf_trqInrMin_mp ASDrf_trqInrUnLim_mp ASDrf_trqLoss_mp ASDrf_trqPT1In_mp ASDrf_trqPT1Out_mp ASDrf_trqPT1P_mp ASDrf_trqP_mp ASDrf_trqStyHigh_mp ASDrf_trqStyLow_mp /end OUT_MEASUREMENT
/end FUNCTION
/begin FUNCTION asdrf_selectparameter "Parametersatzauswahl ARD Führungsformer"
 /begin DEF_CHARACTERISTIC ASDrf_T1CluNeg_C ASDrf_KdCluNeg_C ASDrf_T1CluPos_C ASDrf_KdCluPos_C ASDrf_T1ExtInt_C ASDrf_KdExtInt_C ASDrf_numDefaultState_C ASDrf_CoeffACluLossNeg_C ASDrf_CoeffBCluLossNeg_C ASDrf_CoeffACluLossPos_C ASDrf_CoeffBCluLossPos_C ASDrf_CoeffAExtIntLoss_C ASDrf_CoeffBExtIntLoss_C ASDrf_CoeffAState3LossNeg_C ASDrf_CoeffBState3LossNeg_C ASDrf_CoeffAState3LossPos_C ASDrf_CoeffBState3LossPos_C ASDrf_CoeffAState4LossNeg_C ASDrf_CoeffBState4LossNeg_C ASDrf_CoeffAState4LossPos_C ASDrf_CoeffBState4LossPos_C ASDrf_T1State3Neg_C ASDrf_KdState3Neg_C ASDrf_T1State3Pos_C ASDrf_KdState3Pos_C ASDrf_T1State4Neg_C ASDrf_KdState4Neg_C ASDrf_T1State4Pos_C ASDrf_KdState4Pos_C ASDrf_stConv1_C ASDrf_stConv2_C ASDrf_stConv3_C ASDrf_stConvCluEng_C ASDrf_stConvCluOff_C ASDrf_stConvCluSlip_C ASDrf_stEntcClu_C ASDrf_stEntcExtInt_C ASDrf_stEntcFDC_C ASDrf_stEntcGrip_C ASDrf_stEntcState3_C ASDrf_stEntcState4_C ASDrf_stExClu_C ASDrf_stExExtInt_C ASDrf_stExFDC_C ASDrf_stExGrip_C ASDrf_stExState3_C ASDrf_stExState4_C ASDrf_stExtInt_C ASDrf_stFDC_C ASDrf_stGrip_C ASDrf_stReliablAdpt_C ASDrf_swtLossClcNoRel_C ASDrf_swtLossClcRel_C ASDrf_swtOpr_C ASDrf_swtStiffParameter_C ASDrf_trqLossNeg_CUR ASDrf_trqLossPos_CUR ASDrf_trqOfsNegHigh_C ASDrf_trqOfsNegLow_C ASDrf_trqOfsNegMid_C ASDrf_trqOfsPosHigh_C ASDrf_trqOfsPosLow_C ASDrf_trqOfsPosMid_C /end DEF_CHARACTERISTIC
 /begin IN_MEASUREMENT Eng_nAvrg /end IN_MEASUREMENT
 /begin OUT_MEASUREMENT ASDrf_stInit /end OUT_MEASUREMENT
/end FUNCTION
/begin FUNCTION asdrf_selectparameter_msg "" /begin OUT_MEASUREMENT ASDrf_trqLossNeg ASDrf_trqLossPos /end OUT_MEASUREMENT /end FUNCTION
/begin FUNCTION asdrf_selectparameter_uic ""
 /begin OUT_MEASUREMENT ASDrf_stCond_mp ASDrf_stPrioState_mp ASDrf_stSelectState_mp ASDrf_stStates_mp /end OUT_MEASUREMENT
/end FUNCTION
/begin FUNCTION asdrf_selectparameter_var ""
 /begin DEF_CHARACTERISTIC ASDrf_CoeffAFDCLossNeg_CUR ASDrf_CoeffAFDCLossPos_CUR ASDrf_CoeffAGripLossNeg_CUR ASDrf_CoeffAGripLossPos_CUR ASDrf_CoeffBFDCLossNeg_CUR ASDrf_CoeffBFDCLossPos_CUR ASDrf_CoeffBGripLossNeg_CUR ASDrf_CoeffBGripLossPos_CUR ASDrf_KdFDCNeg_CUR ASDrf_KdFDCPos_CUR ASDrf_KdGripNeg_CUR ASDrf_KdGripPos_CUR ASDrf_numPrio_C ASDrf_T1FDCNeg_CUR ASDrf_T1FDCPos_CUR ASDrf_T1GripNeg_CUR ASDrf_T1GripPos_CUR /end DEF_CHARACTERISTIC
 /begin IN_MEASUREMENT DrvTrn_rTransDT /end IN_MEASUREMENT
/end FUNCTION
/begin FUNCTION asmod_co "interface coordinator" /end FUNCTION
/begin FUNCTION asmod_co_msg "" /begin OUT_MEASUREMENT ASMod_facAMCor ASMod_qCor ASMod_rRelPosVSA /end OUT_MEASUREMENT /end FUNCTION
/begin FUNCTION asmod_co_uic "" /end FUNCTION
/begin FUNCTION asmod_detcylch "Füllungserfassung" /end FUNCTION
/begin FUNCTION asmod_detcylch_msg ""
 /begin OUT_MEASUREMENT ASMod_dmExhMnfPst ASMod_dmIndAir ASMod_dmO2IndAir ASMod_rLmbdRecExhMnfPst ASMod_tIndAir /end OUT_MEASUREMENT
/end FUNCTION
/begin FUNCTION asmod_detcylch_uic ""
 /begin OUT_MEASUREMENT ASMod_dmEGR_mp ASMod_dmIndAir_mp ASMod_rO2ExhMnfPst_mp ASMod_rO2IndAir_mp ASMod_tExhMnfPst_mp /end OUT_MEASUREMENT
/end FUNCTION
/begin FUNCTION asmod_eng "Motor"
 /begin DEF_CHARACTERISTIC ASMod_dmIndAirRef_MAP ASMod_facDdTm_C ASMod_facDMCorTDiff_CUR ASMod_facSOICorTDiff_CUR ASMod_phiSOIRef_MAP ASMod_tDiffEng_MAP ASMod_tEngCorTDiff_CUR ASMod_tEngRef_C /end DEF_CHARACTERISTIC
 /begin IN_MEASUREMENT ASMod_qBurned_mp ASMod_qLmbdCtlCorr_mp ASMod_rDMIndAir_mp ASMod_tEngCorTDiff_mp Eng_nAvrg InjCrv_phiMI1Des /end IN_MEASUREMENT
/end FUNCTION
/begin FUNCTION asmod_eng_msg ""
 /begin OUT_MEASUREMENT ASMod_dmExhMnfPre ASMod_rLmbdRecEG ASMod_rO2ExhMnfPre ASMod_tExhMnfPre /end OUT_MEASUREMENT
/end FUNCTION
/begin FUNCTION asmod_eng_uic ""
 /begin OUT_MEASUREMENT ASMod_dmEG_mp ASMod_dmFlBurned_mp ASMod_dmFlPerTime_mp ASMod_dmIndAirRef_mp ASMod_dmO2EG_mp ASMod_facDMCorTDiff_mp ASMod_facSOICorTDiff_mp ASMod_phiSOIRef_mp ASMod_qBurned_mp ASMod_qLmbdCtlCorr_mp ASMod_rDMIndAir_mp ASMod_rFlBurned_mp ASMod_rO2EG_mp ASMod_tDiffEG_mp ASMod_tDiffEng_mp ASMod_tEG_mp ASMod_tEngCorTDiff_mp ASMod_tiDdTm_mp /end OUT_MEASUREMENT
/end FUNCTION
/begin FUNCTION asmod_indvol "Modell des Einlaßvolumens" /begin DEF_CHARACTERISTIC ASMod_tiDT1_C ASMod_volIndVol_C /end DEF_CHARACTERISTIC /end FUNCTION
/begin FUNCTION asmod_indvol_msg "" /begin OUT_MEASUREMENT ASMod_dmAirPerTimeCorr ASMod_mAirPerCylCorr /end OUT_MEASUREMENT /end FUNCTION
/begin FUNCTION asmod_indvol_uic "" /begin OUT_MEASUREMENT ASMod_dmIndVol_mp ASMod_mIndVol_mp /end OUT_MEASUREMENT /end FUNCTION
/begin FUNCTION asmod_voleff "Luftaufwand"
 /begin DEF_CHARACTERISTIC ASMod_facTCorVolEff_C ASMod_facVolEff_MAP ASMod_facVSACorVolEff_MAP ASMod_swtT_C ASMod_tIndAirRef_MAP ASMod_volEng_C /end DEF_CHARACTERISTIC
 /begin IN_MEASUREMENT ASMod_rRelPosVSA Eng_nAvrg InjCtl_qCurr /end IN_MEASUREMENT
/end FUNCTION
/begin FUNCTION asmod_voleff_msg "" /begin OUT_MEASUREMENT ASMod_dmIndAirRef ASMod_dvolIndAirRef ASMod_tIndAirRef /end OUT_MEASUREMENT /end FUNCTION
/begin FUNCTION asmod_voleff_uic ""
 /begin OUT_MEASUREMENT ASMod_facTIndAirCor_mp ASMod_facVolEff_mp ASMod_facVSACorVolEff_mp ASMod_tIntakeAir_mp /end OUT_MEASUREMENT
/end FUNCTION
/begin FUNCTION battcd "Komponententreiber Batteriespannung"
 /begin DEF_CHARACTERISTIC BattCD_uSRCMin_C BattCD_uSRCMax_C BattCD_uLin_CUR BattCD_DebSRCHighDef_C BattCD_DebSRCHighOk_C BattCD_DebSRCLowDef_C BattCD_DebSRCLowOk_C BattCD_numAdc_C BattCD_duRmpSlpUp_C BattCD_duRmpSlpDwn_C BattCD_stSensIDWord_C BattCD_uDfl_C /end DEF_CHARACTERISTIC
 /begin IN_MEASUREMENT BattCD_uRaw /end IN_MEASUREMENT
/end FUNCTION
/begin FUNCTION battcd_msg "" /begin OUT_MEASUREMENT BattCD_u BattCD_uLin BattCD_uRaw /end OUT_MEASUREMENT /end FUNCTION
/begin FUNCTION battcd_uic "" /end FUNCTION
/begin FUNCTION batt_corfac "" /begin DEF_CHARACTERISTIC Batt_uNrm_C /end DEF_CHARACTERISTIC /end FUNCTION
/begin FUNCTION batt_corfac_msg "" /begin OUT_MEASUREMENT Batt_facCor /end OUT_MEASUREMENT /end FUNCTION
/begin FUNCTION bdint "Karosserie und Innenraum" /end FUNCTION
/begin FUNCTION bdint_msg "" /begin OUT_MEASUREMENT BdInt_nMax BdInt_nMin BdInt_pwrDes BdInt_pwrLead /end OUT_MEASUREMENT /end FUNCTION
/begin FUNCTION bpacd "Komponententreiber des Ladedruckstellers"
 /begin DEF_CHARACTERISTIC BPACD_ctPwrStgOnMax_C BPACD_tiDebBPADia1Def_C BPACD_tiDebBPADia1Ok_C BPACD_tiDebBPADia2Def_C BPACD_tiDebBPADia2Ok_C BPACD_tiDebBPADia3Def_C BPACD_tiDebBPADia3Ok_C BPACD_DebExcTempDef_C BPACD_DebExcTempOk_C BPACD_DebNoLoadDef_C BPACD_DebNoLoadOk_C BPACD_DebShortCircBatDef_C BPACD_DebShortCircBatOk_C BPACD_DebShortCircGndDef_C BPACD_DebShortCircGndOk_C BPACD_numDia_C BPACD_numPwmOut_C BPACD_stInvOut_C BPACD_tiPer_C BPACD_rCnv_CUR BPACD_rOutMax_C BPACD_rOutMin_C BPACD_stPwrStgActv_C BPACD_stPwrStgDia_C BPACD_stSPICtl_C BPACD_swt_C BPACD_tiBtwTst_C BPACD_tiDiag1Max_C BPACD_tiDiag1Min_C BPACD_tiDiag2Max_C BPACD_tiDiag2Min_C BPACD_tiDiag3Max_C BPACD_tiDiag3Min_C BPACD_tiPwrStgOn_C /end DEF_CHARACTERISTIC
 /begin IN_MEASUREMENT BPA_rBPACD /end IN_MEASUREMENT
/end FUNCTION
/begin FUNCTION bpacd_msg "" /begin OUT_MEASUREMENT BPACD_rOut /end OUT_MEASUREMENT /end FUNCTION
/begin FUNCTION bpacd_uic "" /begin OUT_MEASUREMENT BPACD_rCnv_mp /end OUT_MEASUREMENT /end FUNCTION
/begin FUNCTION bpa_co "Stellerkoordinator für Ladedrucksteller" /end FUNCTION
/begin FUNCTION bpa_co_msg "" /begin OUT_MEASUREMENT BPA_rBPACD /end OUT_MEASUREMENT /end FUNCTION
/begin FUNCTION bpa_co_uic "" /begin DEF_CHARACTERISTIC BPA_rBPACD_Vector BPA_rBPACD_Channel /end DEF_CHARACTERISTIC /begin OUT_MEASUREMENT BPA_rBPAByp_mp /end OUT_MEASUREMENT /end FUNCTION
/begin FUNCTION bpa_lpco "" /end FUNCTION
/begin FUNCTION bpa_lpco_msg "" /begin OUT_MEASUREMENT BPA_rLPACD /end OUT_MEASUREMENT /end FUNCTION
/begin FUNCTION bpa_lpco_uic "" /begin DEF_CHARACTERISTIC BPA_rLPACD_Vector BPA_rLPACD_Channel /end DEF_CHARACTERISTIC /begin OUT_MEASUREMENT BPA_rLPAByp_mp /end OUT_MEASUREMENT /end FUNCTION
/begin FUNCTION bpscd "Komponententreiber des Ladedruckfühlers"
 /begin DEF_CHARACTERISTIC BPSCD_uSRCMin_C BPSCD_uSRCMax_C BPSCD_pLin_CUR BPSCD_DebNplDef_C BPSCD_DebNplOK_C BPSCD_DebSigDef_C BPSCD_DebSigOK_C BPSCD_DebSRCHighDef_C BPSCD_DebSRCHighOK_C BPSCD_DebSRCLowDef_C BPSCD_DebSRCLowOK_C BPSCD_tiDT1_C BPSCD_dDT1Kd_C BPSCD_tiLPFiltPT1_C BPSCD_nLim_C BPSCD_numAdc_C BPSCD_pDiffLim_C BPSCD_tiOutValDT1_C BPSCD_dDT1KdOutVal_C BPSCD_tiPT1_C BPSCD_dpRmpSlpUp_C BPSCD_dpRmpSlpDwn_C BPSCD_swtSigVal_C BPSCD_stSensIDWord_C BPSCD_pDfl_C /end DEF_CHARACTERISTIC
 /begin IN_MEASUREMENT BPSCD_uRawVal /end IN_MEASUREMENT
/end FUNCTION
/begin FUNCTION bpscd_msg ""
 /begin OUT_MEASUREMENT BPSCD_dFltValDT1 BPSCD_dpOutVal BPSCD_pFltVal BPSCD_pIntVal BPSCD_pLin BPSCD_pOutVal BPSCD_pPhyVal BPSCD_stErr BPSCD_stPlausErr BPSCD_uRawVal /end OUT_MEASUREMENT
/end FUNCTION
/begin FUNCTION bpscd_uic "" /end FUNCTION
/begin FUNCTION brkcd "Komponententreiber zur Erfassung aller Bremssignale"
 /begin DEF_CHARACTERISTIC BrkCD_ctUnPlausDef_C BrkCD_DebPlaDef_C BrkCD_DebPlaOk_C BrkCD_DebSigDef_C BrkCD_DebSigOk_C BrkCD_tiMnSwtDebNeg_C BrkCD_tiMnSwtDebPos_C BrkCD_numDioInMn_C BrkCD_numDioInRed_C BrkCD_tiRedSwtDebNeg_C BrkCD_tiRedSwtDebPos_C BrkCD_stDflVal_C BrkCD_stMnSwtInvIn_C BrkCD_stRedSwtInvIn_C BrkCD_swtRedSwtPresent_C BrkCD_swtSigVal_C BrkCD_tiDebResUnPlaus_C BrkCD_tiDebUnPlausStat_C BrkCD_tiDebUnPlaus_C /end DEF_CHARACTERISTIC
/end FUNCTION
/begin FUNCTION brkcd_msg ""
 /begin OUT_MEASUREMENT BrkCD_stMnSwtDebVal BrkCD_stMnSwtLastDebVal BrkCD_stMnSwtRawVal BrkCD_stPressed BrkCD_stRedSwtDebVal BrkCD_stRedSwtLastDebVal BrkCD_stRedSwtPresent BrkCD_stRedSwtRawVal BrkCD_swtSig /end OUT_MEASUREMENT
/end FUNCTION
/begin FUNCTION brkcd_uic ""
 /begin OUT_MEASUREMENT BrkCD_ctUnPlaus_mp BrkCD_stDeb_mp BrkCD_stMnSwtLogVal_mp BrkCD_stRedSwtLogVal_mp BrkCD_stResUnPlaus_mp BrkCD_stRun_mp /end OUT_MEASUREMENT
/end FUNCTION
/begin COMPU_METHOD Acc "Fahrzeugbeschleunigung" RAT_FUNC "%6.5" "m/s^2" COEFFS 0 1000 0 0 0 1 /end COMPU_METHOD
/begin COMPU_METHOD AirMass "Luftmasse" RAT_FUNC "%6.4" "g" COEFFS 0 100 0 0 0 1 /end COMPU_METHOD
/begin COMPU_METHOD AirMassPerCyl "Luftmasse pro Zylinder" RAT_FUNC "%6.3" "mg/Hub" COEFFS 0 10 0 0 0 1 /end COMPU_METHOD
/begin COMPU_METHOD AirMassPerTime "Luftmasse pro Zeit" RAT_FUNC "%6.3" "Kg/h" COEFFS 0 10 0 0 0 1 /end COMPU_METHOD
/begin COMPU_METHOD AirVolPerTime "Umrechnungsformel für Luftvolumenstrom" RAT_FUNC "%6.3" "m^3/h" COEFFS 0 10 0 0 0 1 /end COMPU_METHOD
/begin COMPU_METHOD AngleCrS "Winkel Kurbelwelle" RAT_FUNC "%6.4" "deg CrS" COEFFS 0 42.6666666666667 0 0 0 1 /end COMPU_METHOD
/begin COMPU_METHOD ASDrf_numDefaultState "Nummer des Default-Primärzustandes" TAB_VERB "%6.3" "-" COMPU_TAB_REF ASDrf_numDefaultState /end COMPU_METHOD
/begin COMPU_VTAB ASDrf_numDefaultState "Nummer des Default-Primärzustandes" TAB_VERB 6 0 "ExtInt" 1 "Clutch" 2 "Grip" 3 "State3" 4 "State4" 5 "Sport mode" /end COMPU_VTAB
/begin COMPU_METHOD ASDrf_stPrimState "Auswahl des Primärstatus in der Statusvariabel sollte übereinstimmedn mit der in der Definition asdrf_selectparemeter.col sein" TAB_VERB "%6.3" "-" COMPU_TAB_REF ASDrf_stPrimState /end COMPU_METHOD
/begin COMPU_VTAB ASDrf_stPrimState "Auswahl des Primärstatus in der Statusvariabel sollte übereinstimmedn mit der in der Definition asdrf_selectparemeter.col sein" TAB_VERB 7 0 "Void" 1 "ExtInt" 2 "Clutch" 4 "Grip" 8 "State3" 16 "State4" 32 "Sport mode" /end COMPU_VTAB
/begin COMPU_METHOD ASDdcState "Verbale Umrechnung für ADSdc-Parametersatzwahl" TAB_VERB "%6.3" "-" COMPU_TAB_REF dcState /end COMPU_METHOD
/begin COMPU_VTAB dcState "Verbale Umrechnung für ADSdc-Parametersatzwahl" TAB_VERB 7 1 "GripMAP" 2 "Clutch " 4 "ExtInt " 8 "State3 " 16 "State4 " 32 "SlipMAP" 64 "SportMAP" /end COMPU_VTAB
/begin COMPU_METHOD ASD_GvrnDT1Kd_float "Differentialverstärkung Kd (Motordrehzahl EngN zu Motormoment Trq)" RAT_FUNC "%6.2" "(Nm/rpm)^0.5" COEFFS 0 1 0 0 0 1 /end COMPU_METHOD
/begin COMPU_METHOD ASD_GvrnDT1T1_float "Zeitkonstante T1 (in s) für PT1, DT1 beim ARD" RAT_FUNC "%6.2" "s" COEFFS 0 1 0 0 0 1 /end COMPU_METHOD
/begin COMPU_METHOD Can1 "Umsetzungsfaktor fuer CAN verwandte Groeßen" RAT_FUNC "%7.6" "-" COEFFS 0 10000 0 0 0 1 /end COMPU_METHOD
/begin COMPU_METHOD CoeffA "Koeffizient A in der Parabel dTrq = A * Trq^2 + Trq" RAT_FUNC "%6.4" "1/(s*Nm)" COEFFS 0 204.8 0 0 0 1 /end COMPU_METHOD
/begin COMPU_METHOD Curr_10mA "Spannung in mA" RAT_FUNC "%6.1" "mA" COEFFS 0 0.1 0 0 0 1 /end COMPU_METHOD
/begin COMPU_METHOD dez "K3 Umwandlungen" RAT_FUNC "%6.2" "-" COEFFS 0 1 0 0 0 1 /end COMPU_METHOD
/begin COMPU_METHOD dn_dZ20 "Motorbeschleunigung pro Zeit (dn/dt) (im 20 ms Raster)" RAT_FUNC "%6.1" "rmp/s" COEFFS 0 0.1 0 0 0 1 /end COMPU_METHOD
/begin COMPU_METHOD dp_dZ10 "boost pressure per time (dp/dt) every 10ms" RAT_FUNC "%6.1" "hPa/s" COEFFS 0 0.1 0 0 0 1 /end COMPU_METHOD
/begin COMPU_METHOD dTrq "Umrtechnungsformel dTrq/dTime" RAT_FUNC "%6.3" "Nm/s" COEFFS 0 10 0 0 0 1 /end COMPU_METHOD
/begin COMPU_METHOD DtyCyc "Tastverhaeltnis" RAT_FUNC "%6.4" "%" COEFFS 0 100 0 0 0 1 /end COMPU_METHOD
/begin COMPU_METHOD EngN "Motordrehzahl" RAT_FUNC "%6.2" "rpm" COEFFS 0 1 0 0 0 1 /end COMPU_METHOD
/begin COMPU_METHOD Fact "Faktor mit Auflösung 1 / 8192, hauptsächlich für einen Faktorenbereich 0...1 verwendet" RAT_FUNC "%6.5" "-" COEFFS 0 8192 0 0 0 1 /end COMPU_METHOD
/begin COMPU_METHOD Fact1 "Faktor mit Auflösung 0,01 (100 mal höherer Bereich als Fact)" RAT_FUNC "%6.4" "-" COEFFS 0 128 0 0 0 1 /end COMPU_METHOD
/begin COMPU_METHOD InjMass "Einspritzmenge" RAT_FUNC "%6.4" "mg/hub" COEFFS 0 100 0 0 0 1 /end COMPU_METHOD
/begin COMPU_METHOD InjMassCyc "Einspritzmenge pro Zyklus (mg/Zyklus)" RAT_FUNC "%6.4" "mg/cyc" COEFFS 0 100 0 0 0 1 /end COMPU_METHOD
/begin COMPU_METHOD InjMassPerSec_20ms "Einspritzmengenänderung pro Sekunde für 20ms-Tasks" RAT_FUNC "%6.3" "mg/hub/s" COEFFS 0 2 0 0 0 1 /end COMPU_METHOD
/begin COMPU_METHOD InjMassPerTime "Kraftstoffmassenstrom" RAT_FUNC "%6.4" "kg/h" COEFFS 0 100 0 0 0 1 /end COMPU_METHOD
/begin COMPU_METHOD Kd "Differentialverstärkung Kd (gleiche Einheit/Umrechnungsformel an Ein- und Ausgang)" RAT_FUNC "%7.6" "1/1" COEFFS 0 65536 0 0 0 1 /end COMPU_METHOD
/begin COMPU_METHOD Kd16_sqr_rpm2Nm "Wurzeldifferentialverstärkung Kd^0,5 für D2T2 (zweifach DT1), Motordrehzahl EngN zu Motormoment Trq" RAT_FUNC "%6.5" "(Nm/rpm)^0.5" COEFFS 0 1024 0 0 0 1 /end COMPU_METHOD
/begin COMPU_METHOD Kd_Lin_16 "Kd Verstärkung von linearen Kennlinien/-feldern" RAT_FUNC "%7.6" "1/1" COEFFS 0 32767 0 0 0 1 /end COMPU_METHOD
/begin COMPU_METHOD Ki "Integrale Verstärkung Ki (gleiche Einheit/Umrechnungsregel an Ein- und Ausgang)" RAT_FUNC "%6.5" "1/s" COEFFS 0 4294.967296 0 0 0 1 /end COMPU_METHOD
/begin COMPU_METHOD Kp "proportionale Verstärkung Kp (gleiche Einheit/Umrechnungsregel an Ein- und Ausgang)" RAT_FUNC "%7.6" "1/1" COEFFS 0 65536 0 0 0 1 /end COMPU_METHOD
/begin COMPU_METHOD lambdaRecVal "Reziproker Lambda Wert" RAT_FUNC "%6.5" "-" COEFFS 0 1000 0 0 0 1 /end COMPU_METHOD
/begin COMPU_METHOD NumPinAdc "verbale Umrechnung für ADC Signale" TAB_VERB "%6.3" "-" COMPU_TAB_REF NumPinAdc /end COMPU_METHOD
/begin COMPU_VTAB NumPinAdc "verbale Umrechnung für ADC Signale" TAB_VERB 27 0 "Water_Temperature_Sensor_182" 1 "Intake_Air_Temperature_Sensor_157" 2 "Charge_Air_Temperature_Sensor_183" 3 "Exhaust_Temperature_Sensor_2_134" 4 "Exhaust_Temperature_Sensor_1_158" 5 "1st_APP_Sensor_252" 6 "2nd_APP_Sensor_239" 7 "ADC_REF" 8 "Boost_Pressure_Sensor_154" 9 "Atmospheric_Pressure_Sensor" 10 "Battery_Voltage_Sensor" 11 "Rail_Pressure_Sensor_156" 12 "Rail_Pressure_Peak_Value_156" 13 "Booster_Voltage_Sensor" 14 "Current_MeUn_Sensor" 15 "Current_PCV_Sensor" 16 "Voltage_Bank_1" 17 "Voltage_Bank_2" 18 "Pressure_Upstream_Particle_Filter_159" 19 "Engine_Oil_Pressure_110" 20 "Temperature_ECU_PCB" 21 "Voltage_Lambda_Ua" 22 "Voltage_Lambda_Ri" 23 "EMCCD_Current_Governor1_124" 24 "EMCCD_Current_Governor2_121" 25 "ADC_DUMMY_NOT_USED" 26 "ADC_DUMMY_A_NOT_USED" /end COMPU_VTAB
/begin COMPU_METHOD NumPinDia "Verbale Umrechnung für Diagnose Signale" TAB_VERB "%6.3" "-" COMPU_TAB_REF NumPinDia /end COMPU_METHOD
/begin COMPU_VTAB NumPinDia "Verbale Umrechnung für Diagnose Signale" TAB_VERB 28 0 "CJ945_Diagnostic_Signal" 1 "AC_Compressor_DiaSig" 2 "Fuel_Pump_Diagnostic_Signal_232" 3 "Starter_234" 4 "Oil_Pressure_Lamp_Switch_245" 5 "Engine_Bay_Air_Flaps_123" 6 "Ebox_Fan_Actuator_Diagnostic_Signal_219" 7 "Shuttr_Actuator_Diagnostic_Signal_231" 8 "Twostage_TurboLoading_SW_DiaSig" 9 "DIO_OUT_DIAGNOSTIC_DUMMY_NOT_USED" 10 "Alternator" 11 "Boost_Pressure_Actuator_Diagnostic_Signal_193" 12 "EGR_Actuator_Diagnostic_Signal_194" 13 "1st_Pressure_Control_Valve_Diagnostic_Signal_172" 14 "2nd_Pressure_Control_Valve_Diagnostic_Signal_172" 15 "1st_Metering_Unit_Diagnostic_Signal_171" 16 "2nd_Metering_Unit_Diagnostic_Signal_171" 17 "Variable_Swirl_Actuator_Diagnostic_Signal_195" 18 "FAN_240" 19 "Add_On_Heater_244" 20 "EngM_Bearing_Actuator_Diagnostic_Signal_124" 21 "EngM_Bearing_Actuator_Diagnostic_Signal_121" 22 "Throttle_Valve_Diagnostic_Signal_196" 23 "Low pressure stage BPA_Diagnostic_Signal_117" 24 "PWM_DIAGNOSTIC_DUMMY_NOT_USED" 25 "1st_Sensor_Supply_Voltage_DiaSig" 26 "2nd_Sensor_Supply_Voltage_DiaSig" 27 "3rd_Sensor_Supply_Voltage_DiaSig" /end COMPU_VTAB
/begin COMPU_METHOD NumPinDioIn "Verbale Umrechnung für Digitaleingang Signale" TAB_VERB "%6.3" "-" COMPU_TAB_REF NumPinDioIn /end COMPU_METHOD
/begin COMPU_VTAB NumPinDioIn "Verbale Umrechnung für Digitaleingang Signale" TAB_VERB 15 0 "Terminal_15_207" 1 "Main_Brake_Switch_236" 2 "Redundant_Brake_Switch_223" 3 "Clutch_Switch" 4 "Terminal_50_224" 5 "ECU_selection_Switch_251" 6 "FlFlt_Switch_211" 7 "Coolant-heater_212" 8 "Redundant_Terminal_15_209(118)" 9 "AC-compressor_overboost_213" 10 "Additive_tank_level_switch_235" 11 "Terminal_61_113" 12 "Lambda_Regeneration" 13 "Oil_Level_sensor_138" 14 "DIO_IN_DUMMY_NOT_USED" /end COMPU_VTAB
/begin COMPU_METHOD NumPinPwmOut "Verbale Umrechnung für PWM-Ausgang Signale" TAB_VERB "%6.3" "-" COMPU_TAB_REF NumPinPwmOut /end COMPU_METHOD
/begin COMPU_VTAB NumPinPwmOut "Verbale Umrechnung für PWM-Ausgang Signale" TAB_VERB 14 0 "Boost_Pressure_Actuator_193" 1 "EGR_Actuator_194" 2 "PCV_Actuator_172" 3 "MeUn_Actuator_171" 4 "Variable_Swirl_Actuator_195" 5 "Fan_Actuator_240" 6 "Add_On_Heater_244" 7 "EngM_Bearing_Actuator_124" 8 "EngM_Bearing_Actuator_121" 9 "Throttle_Valve_196" 10 "LSU_Heater_PWMOutput" 11 "Low pressure stage BPA_117" 12 "Shuttr_Actuator_PWM_231" 13 "PWM_DUMMY_NOT_USED" /end COMPU_VTAB
/begin COMPU_METHOD O2 "Sauerstoffkonzentration" RAT_FUNC "%8.7" "-" COEFFS 0 100000 0 0 0 1 /end COMPU_METHOD
/begin COMPU_METHOD O2MassPerTime "Sauerstoffmassenstrom" RAT_FUNC "%6.4" "kg/h" COEFFS 0 100 0 0 0 1 /end COMPU_METHOD
/begin COMPU_METHOD OneToOne "eins zu eins (physikalischer Wert ist gleich dem internen Wert)" RAT_FUNC "%6.2" "-" COEFFS 0 1 0 0 0 1 /end COMPU_METHOD
/begin COMPU_METHOD Period "Periodendauer" RAT_FUNC "%6.3" "ms" COEFFS 0 10 0 0 0 1 /end COMPU_METHOD
/begin COMPU_METHOD Prc "Prozent, gleiche interne Auflösung wie Fact, aber Darstellung in Prozent (0...100%)" RAT_FUNC "%6.4" "%" COEFFS 0 81.92 0 0 0 1 /end COMPU_METHOD
/begin COMPU_METHOD PrcPerSec "Prozentänderung pro Sekunde für 20ms-Tasks" RAT_FUNC "%6.3" "%/s" COEFFS 0 1.6384 0 0 0 1 /end COMPU_METHOD
/begin COMPU_METHOD Pres_hPa "Druck (angezeigt in [hPa])" RAT_FUNC "%6.2" "hPa" COEFFS 0 1 0 0 0 1 /end COMPU_METHOD
/begin COMPU_METHOD Pwr "Leistung" RAT_FUNC "%6.2" "W" COEFFS 0 0.10610329539459 0 0 0 1 /end COMPU_METHOD
/begin COMPU_METHOD RatAirMass "Luftmassenverhältnis" RAT_FUNC "%6.5" "-" COEFFS 0 1000 0 0 0 1 /end COMPU_METHOD
/begin COMPU_METHOD RatFuelMass "Kraftstoffmassenverhältnis" RAT_FUNC "%6.4" "-" COEFFS 0 100 0 0 0 1 /end COMPU_METHOD
/begin COMPU_METHOD RmpPres_hPa "Rampengradient für Druck angezeigt in [hPa/s]" RAT_FUNC "%6.4" "hPa/s" COEFFS 0 65.536 0 0 0 1 /end COMPU_METHOD
/begin COMPU_METHOD RmpVolt "ADC Spannungsrampengradient" RAT_FUNC "%6.4" "mV/s" COEFFS 0 13.4086656 0 0 0 1 /end COMPU_METHOD
/begin COMPU_METHOD RmpVoltBatt "Rampengradient für Batteriespannung" RAT_FUNC "%6.3" "mV/s" COEFFS 0 3.3521664 0 0 0 1 /end COMPU_METHOD
/begin COMPU_METHOD SlopeRes1000 "Umrechnung für Slope: Slopewert mit Verhältnis 0,001" RAT_FUNC "%6.5" "-" COEFFS 0 1000 0 0 0 1 /end COMPU_METHOD
/begin COMPU_METHOD TempDiff_Cels "difference/offset temperature displayed in degree celcius" RAT_FUNC "%6.3" "deg C" COEFFS 0 10 0 0 0 1 /end COMPU_METHOD
/begin COMPU_METHOD Temp_Cels "Temperatur dargestellt in °C (gleiche interne Darstellung wie Temp_Kelv)" RAT_FUNC "%6.1" "deg C" COEFFS 0 10 2731.4 0 0 1 /end COMPU_METHOD
/begin COMPU_METHOD TimeDeb "Entprellzeit in Millisekunden für Libraryfunktion Debounce" RAT_FUNC "%6.1" "ms" COEFFS 0 0.1 0 0 0 1 /end COMPU_METHOD
/begin COMPU_METHOD TimeDelay_ms "Zeitkonstante T1 fuer die Bibliotheksfunktionen PT1, DT1, etc.,  in ms angegeben" RAT_FUNC "%9.0" "ms" COEFFS 0 0 1 0 2.3283064365387e-07 0 /end COMPU_METHOD
/begin COMPU_METHOD TimeDelay_s "Zeitkonstante T1 (in s) für PT1, DT1, etc." RAT_FUNC "%9.3" "s" COEFFS 0 0 1 0 0.00023283064365387 0 /end COMPU_METHOD
/begin COMPU_METHOD TimeDelay_s_Lin_16 "Zeitkonstante T1 (in s) für PT1, DT1, etc. für SINT16, kein Kehrwert" RAT_FUNC "%6.5" "s" COEFFS 0 6553.4 0 0 0 1 /end COMPU_METHOD
/begin COMPU_METHOD Time_ms "Zeit in ms für Fehlerentprellung (DSM) und SW-Timer" RAT_FUNC "%6.1" "ms" COEFFS 0 0.1 0 0 0 1 /end COMPU_METHOD
/begin COMPU_METHOD Time_s "Zeit in s für Fehlerentprellung (DSM) und SW-Timer" RAT_FUNC "%6.4" "s" COEFFS 0 100 0 0 0 1 /end COMPU_METHOD
/begin COMPU_METHOD TransR "Übersetzungsverhältnis (Getriebe etc.)" RAT_FUNC "%6.4" "-" COEFFS 0 100 0 0 0 1 /end COMPU_METHOD
/begin COMPU_METHOD Trq "Motormoment" RAT_FUNC "%6.3" "Nm" COEFFS 0 10 0 0 0 1 /end COMPU_METHOD
/begin COMPU_METHOD Trq32 "Umrechungsformel für inneres Moment in 32bit Zahlendarstellung" RAT_FUNC "%8.7" "Nm" COEFFS 0 655360 0 0 0 1 /end COMPU_METHOD
/begin COMPU_METHOD Trq_float "Motormoment" RAT_FUNC "%6.2" "Nm" COEFFS 0 1 0 0 0 1 /end COMPU_METHOD
/begin COMPU_METHOD Vel "Fahrzeuggeschwindigkeit, gleiche interne Auflösung wie Vel_SI" RAT_FUNC "%6.4" "km/h" COEFFS 0 100 0 0 0 1 /end COMPU_METHOD
/begin COMPU_METHOD Vol "Volumen" RAT_FUNC "%6.4" "l" COEFFS 0 100 0 0 0 1 /end COMPU_METHOD
/begin COMPU_METHOD Volt "Spannung in V (von ADC)" RAT_FUNC "%6.2" "mV" COEFFS 0 0.2046 0 0 0 1 /end COMPU_METHOD
/begin COMPU_METHOD Volt_Batt "Batteriespannung" RAT_FUNC "%6.1" "mV" COEFFS 0 0.05115 0 0 0 1 /end COMPU_METHOD
/begin RECORD_LAYOUT Kf_Xs16_Ys16_Ws16 NO_AXIS_PTS_X 1 SWORD NO_AXIS_PTS_Y 2 SWORD AXIS_PTS_X 3 SWORD INDEX_INCR DIRECT AXIS_PTS_Y 4 SWORD INDEX_INCR DIRECT FNC_VALUES 5 SWORD COLUMN_DIR DIRECT /end RECORD_LAYOUT
/begin RECORD_LAYOUT Kl_Xs16_Ws16 NO_AXIS_PTS_X 1 SWORD AXIS_PTS_X 2 SWORD INDEX_INCR DIRECT FNC_VALUES 3 SWORD COLUMN_DIR DIRECT /end RECORD_LAYOUT
/begin RECORD_LAYOUT Kwb_Wu8 FNC_VALUES 1 UBYTE COLUMN_DIR DIRECT /end RECORD_LAYOUT
/begin RECORD_LAYOUT Kw_Wr32 FNC_VALUES 1 FLOAT32_IEEE COLUMN_DIR DIRECT /end RECORD_LAYOUT
/begin RECORD_LAYOUT Kw_Ws16 FNC_VALUES 1 SWORD COLUMN_DIR DIRECT /end RECORD_LAYOUT
/begin RECORD_LAYOUT Kw_Ws32 FNC_VALUES 1 SLONG COLUMN_DIR DIRECT /end RECORD_LAYOUT
/begin RECORD_LAYOUT Kw_Wu16 FNC_VALUES 1 UWORD COLUMN_DIR DIRECT /end RECORD_LAYOUT
/begin RECORD_LAYOUT Kw_Wu32 FNC_VALUES 1 ULONG COLUMN_DIR DIRECT /end RECORD_LAYOUT
/begin RECORD_LAYOUT Kw_Wu8 FNC_VALUES 1 UBYTE COLUMN_DIR DIRECT /end RECORD_LAYOUT
/end MODULE
/end PROJECT
