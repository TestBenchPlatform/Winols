ASAP2_VERSION 1 3
/begin PROJECT P389 "BMW DDE6.0 4-Zylinder V70.2 30.03.2004"
/begin HEADER "" VERSION "V70.2_4Z" PROJECT_NO P389 /end HEADER
/begin MODULE DIM ""
/begin MOD_COMMON "" BYTE_ORDER MSB_FIRST ALIGNMENT_BYTE 1 ALIGNMENT_WORD 2 ALIGNMENT_LONG 4 ALIGNMENT_FLOAT32_IEEE 4 /end MOD_COMMON
/begin CHARACTERISTIC DSM_RdyABForceMsk_C "Maske zur Erzwingung von Readiness durch bitweises AND mit Message DSM_stRdyAB" VALUE 0xCD7A0 Kw_Wu16 65535.00 OneToOne 0.00 65535.00 FORMAT "%8.2" /end CHARACTERISTIC
/begin CHARACTERISTIC DSM_RdyCDForceMsk_C "Maske zur Erzwingung von Readiness durch bitweises AND mit Message DSM_stRdyCD" VALUE 0xCD7A2 Kw_Wu16 65535.00 OneToOne 0.00 65535.00 FORMAT "%8.2" /end CHARACTERISTIC
/begin CHARACTERISTIC DSM_RdyOnMilEnable_C "Verhalten Readiness bei angesteuerter MIL" VALUE 0xCD7A4 Kw_Wu8 1.00000000000 RdyOnMilEnable 0.00 1.00000000000 FORMAT "%13.11" /end CHARACTERISTIC
/begin CHARACTERISTIC DSM_TsfDfp_Layer_TANS_C "Schwerezaehlergrenze fuer Fehlerpfad Dfp_Layer_TANS" VALUE 0xCD64C Kw_Wu8 51000. TimeDsmTsf 0.00 51000. FORMAT "%5.0" /end CHARACTERISTIC
/begin CHARACTERISTIC DSM_TsfDfp_ACCDCmpr_C "Schwerezaehlergrenze fuer Fehlerpfad Dfp_ACCDCmpr" VALUE 0xCD64D Kw_Wu8 51000. TimeDsmTsf 0.00 51000. FORMAT "%5.0" /end CHARACTERISTIC
/begin CHARACTERISTIC DSM_TsfDfp_ACCDPres_C "Schwerezaehlergrenze fuer Fehlerpfad Dfp_ACCDPres" VALUE 0xCD64E Kw_Wu8 51000. TimeDsmTsf 0.00 51000. FORMAT "%5.0" /end CHARACTERISTIC
/begin CHARACTERISTIC DSM_TsfDfp_ACCDPres1_C "Schwerezaehlergrenze fuer Fehlerpfad Dfp_ACCDPres1" VALUE 0xCD64F Kw_Wu8 51000. TimeDsmTsf 0.00 51000. FORMAT "%5.0" /end CHARACTERISTIC
/begin CHARACTERISTIC DSM_TsfDfp_ACCDPresAna_C "Schwerezaehlergrenze fuer Fehlerpfad Dfp_ACCDPresAna" VALUE 0xCD650 Kw_Wu8 51000. TimeDsmTsf 0.00 51000. FORMAT "%5.0" /end CHARACTERISTIC
/begin CHARACTERISTIC DSM_TsfDfp_ACCDSwtin_C "Schwerezaehlergrenze fuer Fehlerpfad Dfp_ACCDSwtin" VALUE 0xCD651 Kw_Wu8 51000. TimeDsmTsf 0.00 51000. FORMAT "%5.0" /end CHARACTERISTIC
/begin CHARACTERISTIC DSM_TsfDfp_ACC_PlausTrqDes_C "Schwerezaehlergrenze fuer Fehlerpfad Dfp_ACC_PlausTrqDes" VALUE 0xCD652 Kw_Wu8 51000. TimeDsmTsf 0.00 51000. FORMAT "%5.0" /end CHARACTERISTIC
/begin CHARACTERISTIC DSM_TsfDfp_ACC_trqInr_C "Schwerezaehlergrenze fuer Fehlerpfad Dfp_ACC_trqInr" VALUE 0xCD653 Kw_Wu8 51000. TimeDsmTsf 0.00 51000. FORMAT "%5.0" /end CHARACTERISTIC
/begin CHARACTERISTIC DSM_TsfDfp_ACTrq_C "Schwerezaehlergrenze fuer Fehlerpfad Dfp_ACTrq" VALUE 0xCD654 Kw_Wu8 51000. TimeDsmTsf 0.00 51000. FORMAT "%5.0" /end CHARACTERISTIC
/begin CHARACTERISTIC DSM_TsfDfp_ADCMon_C "Schwerezaehlergrenze fuer Fehlerpfad Dfp_ADCMon" VALUE 0xCD655 Kw_Wu8 51000. TimeDsmTsf 0.00 51000. FORMAT "%5.0" /end CHARACTERISTIC
/begin CHARACTERISTIC DSM_TsfDfp_AFSCDIdlAdjVal_C "Schwerezaehlergrenze fuer Fehlerpfad Dfp_AFSCDIdlAdjVal" VALUE 0xCD656 Kw_Wu8 51000. TimeDsmTsf 0.00 51000. FORMAT "%5.0" /end CHARACTERISTIC
/begin CHARACTERISTIC DSM_TsfDfp_AFSCDLdAdjVal_C "Schwerezaehlergrenze fuer Fehlerpfad Dfp_AFSCDLdAdjVal" VALUE 0xCD657 Kw_Wu8 51000. TimeDsmTsf 0.00 51000. FORMAT "%5.0" /end CHARACTERISTIC
/begin CHARACTERISTIC DSM_TsfDfp_AFSCD_AirTempDcyc_C "Schwerezaehlergrenze fuer Fehlerpfad Dfp_AFSCD_AirTempDcyc" VALUE 0xCD658 Kw_Wu8 51000. TimeDsmTsf 0.00 51000. FORMAT "%5.0" /end CHARACTERISTIC
/begin CHARACTERISTIC DSM_TsfDfp_AFSCD_PlOffsDrft_C "Schwerezaehlergrenze fuer Fehlerpfad Dfp_AFSCD_PlOffsDrft" VALUE 0xCD659 Kw_Wu8 51000. TimeDsmTsf 0.00 51000. FORMAT "%5.0" /end CHARACTERISTIC
/begin CHARACTERISTIC DSM_TsfDfp_AFSCD_PlSetyDrft_C "Schwerezaehlergrenze fuer Fehlerpfad Dfp_AFSCD_PlSetyDrft" VALUE 0xCD65A Kw_Wu8 51000. TimeDsmTsf 0.00 51000. FORMAT "%5.0" /end CHARACTERISTIC
/begin CHARACTERISTIC DSM_TsfDfp_AFSCD_SRCAirTemp_C "Schwerezaehlergrenze fuer Fehlerpfad Dfp_AFSCD_SRCAirTemp" VALUE 0xCD65B Kw_Wu8 51000. TimeDsmTsf 0.00 51000. FORMAT "%5.0" /end CHARACTERISTIC
/begin CHARACTERISTIC DSM_TsfDfp_AFSCD_SRCBatt_C "Schwerezaehlergrenze fuer Fehlerpfad Dfp_AFSCD_SRCBatt" VALUE 0xCD65C Kw_Wu8 51000. TimeDsmTsf 0.00 51000. FORMAT "%5.0" /end CHARACTERISTIC
/begin CHARACTERISTIC DSM_TsfDfp_AFSCD_SRCCorrAirm_C "Schwerezaehlergrenze fuer Fehlerpfad Dfp_AFSCD_SRCCorrAirm" VALUE 0xCD65D Kw_Wu8 51000. TimeDsmTsf 0.00 51000. FORMAT "%5.0" /end CHARACTERISTIC
/begin CHARACTERISTIC DSM_TsfDfp_AFSCD_SRCRawAirm_C "Schwerezaehlergrenze fuer Fehlerpfad Dfp_AFSCD_SRCRawAirm" VALUE 0xCD65E Kw_Wu8 51000. TimeDsmTsf 0.00 51000. FORMAT "%5.0" /end CHARACTERISTIC
/begin CHARACTERISTIC DSM_TsfDfp_Layer_TUMG_C "Schwerezaehlergrenze fuer Fehlerpfad Dfp_Layer_TUMG" VALUE 0xCD65F Kw_Wu8 51000. TimeDsmTsf 0.00 51000. FORMAT "%5.0" /end CHARACTERISTIC
/begin CHARACTERISTIC DSM_TsfDfp_AFSCD_SRCRefSigPer_C "Schwerezaehlergrenze fuer Fehlerpfad Dfp_AFSCD_SRCRefSigPer" VALUE 0xCD660 Kw_Wu8 51000. TimeDsmTsf 0.00 51000. FORMAT "%5.0" /end CHARACTERISTIC
/begin CHARACTERISTIC DSM_TsfDfp_AOHtCD_C "Schwerezaehlergrenze fuer Fehlerpfad Dfp_AOHtCD" VALUE 0xCD661 Kw_Wu8 51000. TimeDsmTsf 0.00 51000. FORMAT "%5.0" /end CHARACTERISTIC
/begin CHARACTERISTIC DSM_TsfDfp_Layer_GEN_C "Schwerezaehlergrenze fuer Fehlerpfad Dfp_Layer_GEN" VALUE 0xCD662 Kw_Wu8 51000. TimeDsmTsf 0.00 51000. FORMAT "%5.0" /end CHARACTERISTIC
/begin CHARACTERISTIC DSM_TsfDfp_Layer_BSD_C "Schwerezaehlergrenze fuer Fehlerpfad Dfp_Layer_BSD" VALUE 0xCD663 Kw_Wu8 51000. TimeDsmTsf 0.00 51000. FORMAT "%5.0" /end CHARACTERISTIC
/begin CHARACTERISTIC DSM_TsfDfp_AOHtCD_AOHtDia1_C "Schwerezaehlergrenze fuer Fehlerpfad Dfp_AOHtCD_AOHtDia1" VALUE 0xCD664 Kw_Wu8 51000. TimeDsmTsf 0.00 51000. FORMAT "%5.0" /end CHARACTERISTIC
/begin CHARACTERISTIC DSM_TsfDfp_AOHtCD_AOHtDia2_C "Schwerezaehlergrenze fuer Fehlerpfad Dfp_AOHtCD_AOHtDia2" VALUE 0xCD665 Kw_Wu8 51000. TimeDsmTsf 0.00 51000. FORMAT "%5.0" /end CHARACTERISTIC
/begin CHARACTERISTIC DSM_TsfDfp_AOHtCD_AOHtDia3_C "Schwerezaehlergrenze fuer Fehlerpfad Dfp_AOHtCD_AOHtDia3" VALUE 0xCD666 Kw_Wu8 51000. TimeDsmTsf 0.00 51000. FORMAT "%5.0" /end CHARACTERISTIC
/begin CHARACTERISTIC DSM_TsfDfp_APP1_C "Schwerezaehlergrenze fuer Fehlerpfad Dfp_APP1" VALUE 0xCD667 Kw_Wu8 51000. TimeDsmTsf 0.00 51000. FORMAT "%5.0" /end CHARACTERISTIC
/begin CHARACTERISTIC DSM_TsfDfp_APP2_C "Schwerezaehlergrenze fuer Fehlerpfad Dfp_APP2" VALUE 0xCD668 Kw_Wu8 51000. TimeDsmTsf 0.00 51000. FORMAT "%5.0" /end CHARACTERISTIC
/begin CHARACTERISTIC DSM_TsfDfp_APPSync_C "Schwerezaehlergrenze fuer Fehlerpfad Dfp_APPSync" VALUE 0xCD669 Kw_Wu8 51000. TimeDsmTsf 0.00 51000. FORMAT "%5.0" /end CHARACTERISTIC
/begin CHARACTERISTIC DSM_TsfDfp_APSCD_C "Schwerezaehlergrenze fuer Fehlerpfad Dfp_APSCD" VALUE 0xCD66A Kw_Wu8 51000. TimeDsmTsf 0.00 51000. FORMAT "%5.0" /end CHARACTERISTIC
/begin CHARACTERISTIC DSM_TsfDfp_ARS_C "Schwerezaehlergrenze fuer Fehlerpfad Dfp_ARS" VALUE 0xCD66B Kw_Wu8 51000. TimeDsmTsf 0.00 51000. FORMAT "%5.0" /end CHARACTERISTIC
/begin CHARACTERISTIC DSM_TsfDfp_AccPedPlausBrk_C "Schwerezaehlergrenze fuer Fehlerpfad Dfp_AccPedPlausBrk" VALUE 0xCD66C Kw_Wu8 51000. TimeDsmTsf 0.00 51000. FORMAT "%5.0" /end CHARACTERISTIC
/begin CHARACTERISTIC DSM_TsfDfp_AirCtlGvnrDvtRgnMax_C "Schwerezaehlergrenze fuer Fehlerpfad Dfp_AirCtlGvnrDvtRgnMax" VALUE 0xCD66D Kw_Wu8 51000. TimeDsmTsf 0.00 51000. FORMAT "%5.0" /end CHARACTERISTIC
/begin CHARACTERISTIC DSM_TsfDfp_Layer_QLT_C "Schwerezaehlergrenze fuer Fehlerpfad Dfp_Layer_QLT" VALUE 0xCD66E Kw_Wu8 51000. TimeDsmTsf 0.00 51000. FORMAT "%5.0" /end CHARACTERISTIC
/begin CHARACTERISTIC DSM_TsfDfp_AirCtlGvnrDvtRgnMax2_C "" VALUE 0xCD66F Kw_Wu8 51000. TimeDsmTsf 0.00 51000. FORMAT "%5.0" /end CHARACTERISTIC
/begin CHARACTERISTIC DSM_TsfDfp_Layer_IBS1_C "Schwerezaehlergrenze fuer Fehlerpfad Dfp_Layer_IBS1" VALUE 0xCD670 Kw_Wu8 51000. TimeDsmTsf 0.00 51000. FORMAT "%5.0" /end CHARACTERISTIC
/begin CHARACTERISTIC DSM_TsfDfp_Layer_IBS2_C "Schwerezaehlergrenze fuer Fehlerpfad Dfp_Layer_IBS2" VALUE 0xCD671 Kw_Wu8 51000. TimeDsmTsf 0.00 51000. FORMAT "%5.0" /end CHARACTERISTIC
/begin CHARACTERISTIC DSM_TsfDfp_Layer_IBS3_C "Schwerezaehlergrenze fuer Fehlerpfad Dfp_Layer_IBS3" VALUE 0xCD672 Kw_Wu8 51000. TimeDsmTsf 0.00 51000. FORMAT "%5.0" /end CHARACTERISTIC
/begin CHARACTERISTIC DSM_TsfDfp_Layer_PMBN_C "Schwerezaehlergrenze fuer Fehlerpfad Dfp_Layer_PMBN" VALUE 0xCD673 Kw_Wu8 51000. TimeDsmTsf 0.00 51000. FORMAT "%5.0" /end CHARACTERISTIC
/begin CHARACTERISTIC DSM_TsfDfp_Layer_PMBATT_C "Schwerezaehlergrenze fuer Fehlerpfad Dfp_Layer_PMBATT" VALUE 0xCD674 Kw_Wu8 51000. TimeDsmTsf 0.00 51000. FORMAT "%5.0" /end CHARACTERISTIC
/begin CHARACTERISTIC DSM_TsfDfp_AirCtlGvnrDvtRgnMin_C "Schwerezaehlergrenze fuer Fehlerpfad Dfp_AirCtlGvnrDvtRgnMin" VALUE 0xCD675 Kw_Wu8 51000. TimeDsmTsf 0.00 51000. FORMAT "%5.0" /end CHARACTERISTIC
/begin CHARACTERISTIC DSM_TsfDfp_AirCtlGvnrDvtRgnMin2_C "" VALUE 0xCD676 Kw_Wu8 51000. TimeDsmTsf 0.00 51000. FORMAT "%5.0" /end CHARACTERISTIC
/begin CHARACTERISTIC DSM_TsfDfp_AirCtlPlateBreak_C "DSM variable for Dfp_AirCtlPlateBreak_mp" VALUE 0xCD677 Kw_Wu8 51000. TimeDsmTsf 0.00 51000. FORMAT "%5.0" /end CHARACTERISTIC
/begin CHARACTERISTIC DSM_TsfDfp_AirCtlRmpTO_C "Schwerezaehlergrenze fuer Fehlerpfad Dfp_AirCtlRmpTO" VALUE 0xCD678 Kw_Wu8 51000. TimeDsmTsf 0.00 51000. FORMAT "%5.0" /end CHARACTERISTIC
/begin CHARACTERISTIC DSM_TsfDfp_AirCtl_GovNegDev_C "Schwerezaehlergrenze fuer Fehlerpfad Dfp_AirCtl_GovNegDev" VALUE 0xCD679 Kw_Wu8 51000. TimeDsmTsf 0.00 51000. FORMAT "%5.0" /end CHARACTERISTIC
/begin CHARACTERISTIC DSM_TsfDfp_AirCtl_GovNegDev2_C "Schwerezaehlergrenze fuer Fehlerpfad Dfp_AirCtl_GovNegDev2" VALUE 0xCD67A Kw_Wu8 51000. TimeDsmTsf 0.00 51000. FORMAT "%5.0" /end CHARACTERISTIC
/begin CHARACTERISTIC DSM_TsfDfp_AirCtl_GovPosDev_C "Schwerezaehlergrenze fuer Fehlerpfad Dfp_AirCtl_GovPosDev" VALUE 0xCD67B Kw_Wu8 51000. TimeDsmTsf 0.00 51000. FORMAT "%5.0" /end CHARACTERISTIC
/begin CHARACTERISTIC DSM_TsfDfp_AirCtl_GovPosDev2_C "Schwerezaehlergrenze fuer Fehlerpfad Dfp_AirCtl_GovPosDev2" VALUE 0xCD67C Kw_Wu8 51000. TimeDsmTsf 0.00 51000. FORMAT "%5.0" /end CHARACTERISTIC
/begin CHARACTERISTIC DSM_TsfDfp_AltCD_C "Schwerezaehlergrenze fuer Fehlerpfad Dfp_AltCD" VALUE 0xCD67D Kw_Wu8 51000. TimeDsmTsf 0.00 51000. FORMAT "%5.0" /end CHARACTERISTIC
/begin CHARACTERISTIC DSM_TsfDfp_AltCD_Load_C "Schwerezaehlergrenze fuer Fehlerpfad Dfp_AltCD_Load" VALUE 0xCD67E Kw_Wu8 51000. TimeDsmTsf 0.00 51000. FORMAT "%5.0" /end CHARACTERISTIC
/begin CHARACTERISTIC DSM_TsfDfp_BPACD_BPADia1_C "Schwerezaehlergrenze fuer Fehlerpfad Dfp_BPACD_BPADia1" VALUE 0xCD67F Kw_Wu8 51000. TimeDsmTsf 0.00 51000. FORMAT "%5.0" /end CHARACTERISTIC
/begin CHARACTERISTIC DSM_TsfDfp_BPACD_BPADia2_C "Schwerezaehlergrenze fuer Fehlerpfad Dfp_BPACD_BPADia2" VALUE 0xCD680 Kw_Wu8 51000. TimeDsmTsf 0.00 51000. FORMAT "%5.0" /end CHARACTERISTIC
/begin CHARACTERISTIC DSM_TsfDfp_BPACD_BPADia3_C "Schwerezaehlergrenze fuer Fehlerpfad Dfp_BPACD_BPADia3" VALUE 0xCD681 Kw_Wu8 51000. TimeDsmTsf 0.00 51000. FORMAT "%5.0" /end CHARACTERISTIC
/begin CHARACTERISTIC DSM_TsfDfp_BPACD_Max_C "Schwerezaehlergrenze fuer Fehlerpfad Dfp_BPACD_Max" VALUE 0xCD682 Kw_Wu8 51000. TimeDsmTsf 0.00 51000. FORMAT "%5.0" /end CHARACTERISTIC
/begin CHARACTERISTIC DSM_TsfDfp_BPACD_Min_C "Schwerezaehlergrenze fuer Fehlerpfad Dfp_BPACD_Min" VALUE 0xCD683 Kw_Wu8 51000. TimeDsmTsf 0.00 51000. FORMAT "%5.0" /end CHARACTERISTIC
/begin CHARACTERISTIC DSM_TsfDfp_BPACD_SigNpl_C "Schwerezaehlergrenze fuer Fehlerpfad Dfp_BPACD_SigNpl" VALUE 0xCD684 Kw_Wu8 51000. TimeDsmTsf 0.00 51000. FORMAT "%5.0" /end CHARACTERISTIC
/begin CHARACTERISTIC DSM_TsfDfp_BPSCD_C "Schwerezaehlergrenze fuer Fehlerpfad Dfp_BPSCD" VALUE 0xCD685 Kw_Wu8 51000. TimeDsmTsf 0.00 51000. FORMAT "%5.0" /end CHARACTERISTIC
/begin CHARACTERISTIC DSM_TsfDfp_BattCD_C "Schwerezaehlergrenze fuer Fehlerpfad Dfp_BattCD" VALUE 0xCD686 Kw_Wu8 51000. TimeDsmTsf 0.00 51000. FORMAT "%5.0" /end CHARACTERISTIC
/begin CHARACTERISTIC DSM_TsfDfp_BrkCD_C "Schwerezaehlergrenze fuer Fehlerpfad Dfp_BrkCD" VALUE 0xCD687 Kw_Wu8 51000. TimeDsmTsf 0.00 51000. FORMAT "%5.0" /end CHARACTERISTIC
/begin CHARACTERISTIC DSM_TsfDfp_Bss_C "Schwerezaehlergrenze fuer Fehlerpfad Dfp_Bss" VALUE 0xCD688 Kw_Wu8 51000. TimeDsmTsf 0.00 51000. FORMAT "%5.0" /end CHARACTERISTIC
/begin CHARACTERISTIC DSM_TsfDfp_CBACD_C "Schwerezaehlergrenze fuer Fehlerpfad Dfp_CBACD" VALUE 0xCD689 Kw_Wu8 51000. TimeDsmTsf 0.00 51000. FORMAT "%5.0" /end CHARACTERISTIC
/begin CHARACTERISTIC DSM_TsfDfp_CTSCD_C "Schwerezaehlergrenze fuer Fehlerpfad Dfp_CTSCD" VALUE 0xCD68A Kw_Wu8 51000. TimeDsmTsf 0.00 51000. FORMAT "%5.0" /end CHARACTERISTIC
/begin CHARACTERISTIC DSM_TsfDfp_Clg_DynTst_C "Schwerezaehlergrenze fuer Fehlerpfad Dfp_Clg_DynTst" VALUE 0xCD68B Kw_Wu8 51000. TimeDsmTsf 0.00 51000. FORMAT "%5.0" /end CHARACTERISTIC
/begin CHARACTERISTIC DSM_TsfDfp_CmbChbMisfire1_C "Schwerezaehlergrenze fuer Fehlerpfad Dfp_CmbChbMisfire1" VALUE 0xCD68C Kw_Wu8 51000. TimeDsmTsf 0.00 51000. FORMAT "%5.0" /end CHARACTERISTIC
/begin CHARACTERISTIC DSM_TsfDfp_CmbChbMisfire2_C "Schwerezaehlergrenze fuer Fehlerpfad Dfp_CmbChbMisfire2" VALUE 0xCD68D Kw_Wu8 51000. TimeDsmTsf 0.00 51000. FORMAT "%5.0" /end CHARACTERISTIC
/begin CHARACTERISTIC DSM_TsfDfp_CmbChbMisfire3_C "Schwerezaehlergrenze fuer Fehlerpfad Dfp_CmbChbMisfire3" VALUE 0xCD68E Kw_Wu8 51000. TimeDsmTsf 0.00 51000. FORMAT "%5.0" /end CHARACTERISTIC
/begin CHARACTERISTIC DSM_TsfDfp_CmbChbMisfire4_C "Schwerezaehlergrenze fuer Fehlerpfad Dfp_CmbChbMisfire4" VALUE 0xCD68F Kw_Wu8 51000. TimeDsmTsf 0.00 51000. FORMAT "%5.0" /end CHARACTERISTIC
/begin CHARACTERISTIC DSM_TsfDfp_CmbChbMisfire5_C "Schwerezaehlergrenze fuer Fehlerpfad Dfp_CmbChbMisfire5" VALUE 0xCD690 Kw_Wu8 51000. TimeDsmTsf 0.00 51000. FORMAT "%5.0" /end CHARACTERISTIC
/begin CHARACTERISTIC DSM_TsfDfp_CmbChbMisfire6_C "Schwerezaehlergrenze fuer Fehlerpfad Dfp_CmbChbMisfire6" VALUE 0xCD691 Kw_Wu8 51000. TimeDsmTsf 0.00 51000. FORMAT "%5.0" /end CHARACTERISTIC
/begin CHARACTERISTIC DSM_TsfDfp_CmbChbMisfireMul_C "Schwerezaehlergrenze fuer Fehlerpfad Dfp_CmbChbMisfireMul" VALUE 0xCD692 Kw_Wu8 51000. TimeDsmTsf 0.00 51000. FORMAT "%5.0" /end CHARACTERISTIC
/begin CHARACTERISTIC DSM_TsfDfp_CoVMDCSh_C "Schwerezaehlergrenze fuer Fehlerpfad Dfp_CoVMDCSh" VALUE 0xCD693 Kw_Wu8 51000. TimeDsmTsf 0.00 51000. FORMAT "%5.0" /end CHARACTERISTIC
/begin CHARACTERISTIC DSM_TsfDfp_ConvCD_C "Schwerezaehlergrenze fuer Fehlerpfad Dfp_ConvCD" VALUE 0xCD694 Kw_Wu8 51000. TimeDsmTsf 0.00 51000. FORMAT "%5.0" /end CHARACTERISTIC
/begin CHARACTERISTIC DSM_TsfDfp_Layer_PMRUHVERL_C "Schwerezaehlergrenze fuer Fehlerpfad Dfp_Layer_PMRUHVERL" VALUE 0xCD695 Kw_Wu8 51000. TimeDsmTsf 0.00 51000. FORMAT "%5.0" /end CHARACTERISTIC
/begin CHARACTERISTIC DSM_TsfDfp_CrCCDMFL_C "Schwerezaehlergrenze fuer Fehlerpfad Dfp_CrCCDMFL" VALUE 0xCD696 Kw_Wu8 51000. TimeDsmTsf 0.00 51000. FORMAT "%5.0" /end CHARACTERISTIC
/begin CHARACTERISTIC DSM_TsfDfp_CrCtl_vCrCtl_C "Schwerezaehlergrenze fuer Fehlerpfad Dfp_CrCtl_vCrCtl" VALUE 0xCD697 Kw_Wu8 51000. TimeDsmTsf 0.00 51000. FORMAT "%5.0" /end CHARACTERISTIC
/begin CHARACTERISTIC DSM_TsfDfp_DCC_PlausTrqDes_C "Schwerezaehlergrenze fuer Fehlerpfad Dfp_DCC_PlausTrqDes" VALUE 0xCD698 Kw_Wu8 51000. TimeDsmTsf 0.00 51000. FORMAT "%5.0" /end CHARACTERISTIC
/begin CHARACTERISTIC DSM_TsfDfp_Dummy1_C "Schwerezaehlergrenze fuer Fehlerpfad Dfp_Dummy1" VALUE 0xCD699 Kw_Wu8 51000. TimeDsmTsf 0.00 51000. FORMAT "%5.0" /end CHARACTERISTIC
/begin CHARACTERISTIC DSM_TsfDfp_Layer_TOENS_C "Schwerezaehlergrenze fuer Fehlerpfad Dfp_Layer_TOENS" VALUE 0xCD69A Kw_Wu8 51000. TimeDsmTsf 0.00 51000. FORMAT "%5.0" /end CHARACTERISTIC
/begin CHARACTERISTIC DSM_TsfDfp_Layer_MANHYDR_C "Schwerezaehlergrenze fuer Fehlerpfad Dfp_Layer_MANHYDR" VALUE 0xCD69B Kw_Wu8 51000. TimeDsmTsf 0.00 51000. FORMAT "%5.0" /end CHARACTERISTIC
/begin CHARACTERISTIC DSM_TsfDfp_Layer_MANLUFT_C "Schwerezaehlergrenze fuer Fehlerpfad Dfp_Layer_MANLUFT" VALUE 0xCD69C Kw_Wu8 51000. TimeDsmTsf 0.00 51000. FORMAT "%5.0" /end CHARACTERISTIC
/begin CHARACTERISTIC DSM_TsfDfp_EATSCD_C "Schwerezaehlergrenze fuer Fehlerpfad Dfp_EATSCD" VALUE 0xCD69D Kw_Wu8 51000. TimeDsmTsf 0.00 51000. FORMAT "%5.0" /end CHARACTERISTIC
/begin CHARACTERISTIC DSM_TsfDfp_EBAFCD_C "Schwerezaehlergrenze fuer Fehlerpfad Dfp_EBAFCD" VALUE 0xCD69E Kw_Wu8 51000. TimeDsmTsf 0.00 51000. FORMAT "%5.0" /end CHARACTERISTIC
/begin CHARACTERISTIC DSM_TsfDfp_EBFCD_C "Schwerezaehlergrenze fuer Fehlerpfad Dfp_EBFCD" VALUE 0xCD69F Kw_Wu8 51000. TimeDsmTsf 0.00 51000. FORMAT "%5.0" /end CHARACTERISTIC
/begin CHARACTERISTIC DSM_TsfDfp_EBTSCD_C "Schwerezaehlergrenze fuer Fehlerpfad Dfp_EBTSCD" VALUE 0xCD6A0 Kw_Wu8 51000. TimeDsmTsf 0.00 51000. FORMAT "%5.0" /end CHARACTERISTIC
/begin CHARACTERISTIC DSM_TsfDfp_EBTSCD_OvrTemp_C "Schwerezaehlergrenze fuer Fehlerpfad Dfp_EBTSCD_OvrTemp" VALUE 0xCD6A1 Kw_Wu8 51000. TimeDsmTsf 0.00 51000. FORMAT "%5.0" /end CHARACTERISTIC
/begin CHARACTERISTIC DSM_TsfDfp_EEPCDVarMng_C "Schwerezaehlergrenze fuer Fehlerpfad Dfp_EEPCDVarMng" VALUE 0xCD6A2 Kw_Wu8 51000. TimeDsmTsf 0.00 51000. FORMAT "%5.0" /end CHARACTERISTIC
/begin CHARACTERISTIC DSM_TsfDfp_EGPpCD_C "Schwerezaehlergrenze fuer Fehlerpfad Dfp_EGPpCD" VALUE 0xCD6A3 Kw_Wu8 51000. TimeDsmTsf 0.00 51000. FORMAT "%5.0" /end CHARACTERISTIC
/begin CHARACTERISTIC DSM_TsfDfp_EGPpCDTPreTrbn_C "Schwerezaehlergrenze fuer Fehlerpfad Dfp_EgPpCDTPreTrbn" VALUE 0xCD6A4 Kw_Wu8 51000. TimeDsmTsf 0.00 51000. FORMAT "%5.0" /end CHARACTERISTIC
/begin CHARACTERISTIC DSM_TsfDfp_EGRCD_Max_C "Schwerezaehlergrenze fuer Fehlerpfad Dfp_EGRCD_Max" VALUE 0xCD6A5 Kw_Wu8 51000. TimeDsmTsf 0.00 51000. FORMAT "%5.0" /end CHARACTERISTIC
/begin CHARACTERISTIC DSM_TsfDfp_EGRCD_Min_C "Schwerezaehlergrenze fuer Fehlerpfad Dfp_EGRCD_Min" VALUE 0xCD6A6 Kw_Wu8 51000. TimeDsmTsf 0.00 51000. FORMAT "%5.0" /end CHARACTERISTIC
/begin CHARACTERISTIC DSM_TsfDfp_EGRCD_SigNpl_C "Schwerezaehlergrenze fuer Fehlerpfad Dfp_EGRCD_SigNpl" VALUE 0xCD6A7 Kw_Wu8 51000. TimeDsmTsf 0.00 51000. FORMAT "%5.0" /end CHARACTERISTIC
/begin CHARACTERISTIC DSM_TsfDfp_EGTRgnOilDil_C "Schwerezaehlergrenze fuer Fehlerpfad Dfp_EGTRgnOilDil" VALUE 0xCD6A8 Kw_Wu8 51000. TimeDsmTsf 0.00 51000. FORMAT "%5.0" /end CHARACTERISTIC
/begin CHARACTERISTIC DSM_TsfDfp_EMCCDNoLoad1_C "Schwerezaehlergrenze fuer Fehlerpfad Dfp_EMCCDNoLoad1" VALUE 0xCD6A9 Kw_Wu8 51000. TimeDsmTsf 0.00 51000. FORMAT "%5.0" /end CHARACTERISTIC
/begin CHARACTERISTIC DSM_TsfDfp_EMCCDNoLoad2_C "Schwerezaehlergrenze fuer Fehlerpfad Dfp_EMCCDNoLoad2" VALUE 0xCD6AA Kw_Wu8 51000. TimeDsmTsf 0.00 51000. FORMAT "%5.0" /end CHARACTERISTIC
/begin CHARACTERISTIC DSM_TsfDfp_EMCCDSCBat1_C "Schwerezaehlergrenze fuer Fehlerpfad Dfp_EMCCDSCBat1" VALUE 0xCD6AB Kw_Wu8 51000. TimeDsmTsf 0.00 51000. FORMAT "%5.0" /end CHARACTERISTIC
/begin CHARACTERISTIC DSM_TsfDfp_EMCCDSCBat2_C "Schwerezaehlergrenze fuer Fehlerpfad Dfp_EMCCDSCBat2" VALUE 0xCD6AC Kw_Wu8 51000. TimeDsmTsf 0.00 51000. FORMAT "%5.0" /end CHARACTERISTIC
/begin CHARACTERISTIC DSM_TsfDfp_EMCCDSCGnd1_C "Schwerezaehlergrenze fuer Fehlerpfad Dfp_EMCCDSCGnd1" VALUE 0xCD6AD Kw_Wu8 51000. TimeDsmTsf 0.00 51000. FORMAT "%5.0" /end CHARACTERISTIC
/begin CHARACTERISTIC DSM_TsfDfp_EMCCDSCGnd2_C "Schwerezaehlergrenze fuer Fehlerpfad Dfp_EMCCDSCGnd2" VALUE 0xCD6AE Kw_Wu8 51000. TimeDsmTsf 0.00 51000. FORMAT "%5.0" /end CHARACTERISTIC
/begin CHARACTERISTIC DSM_TsfDfp_EMCCD_ADC1_C "Schwerezaehlergrenze fuer Fehlerpfad Dfp_EMCCD_ADC1" VALUE 0xCD6AF Kw_Wu8 51000. TimeDsmTsf 0.00 51000. FORMAT "%5.0" /end CHARACTERISTIC
/begin CHARACTERISTIC DSM_TsfDfp_EMCCD_ADC2_C "Schwerezaehlergrenze fuer Fehlerpfad Dfp_EMCCD_ADC2" VALUE 0xCD6B0 Kw_Wu8 51000. TimeDsmTsf 0.00 51000. FORMAT "%5.0" /end CHARACTERISTIC
/begin CHARACTERISTIC DSM_TsfDfp_ETClbETFltInj1_C "Schwerezaehlergrenze fuer Fehlerpfad Dfp_ETClbETFltInj1" VALUE 0xCD6B1 Kw_Wu8 51000. TimeDsmTsf 0.00 51000. FORMAT "%5.0" /end CHARACTERISTIC
/begin CHARACTERISTIC DSM_TsfDfp_ETClbETFltInj2_C "Schwerezaehlergrenze fuer Fehlerpfad Dfp_ETClbETFltInj2" VALUE 0xCD6B2 Kw_Wu8 51000. TimeDsmTsf 0.00 51000. FORMAT "%5.0" /end CHARACTERISTIC
/begin CHARACTERISTIC DSM_TsfDfp_ETClbETFltInj3_C "Schwerezaehlergrenze fuer Fehlerpfad Dfp_ETClbETFltInj3" VALUE 0xCD6B3 Kw_Wu8 51000. TimeDsmTsf 0.00 51000. FORMAT "%5.0" /end CHARACTERISTIC
/begin CHARACTERISTIC DSM_TsfDfp_ETClbETFltInj4_C "Schwerezaehlergrenze fuer Fehlerpfad Dfp_ETClbETFltInj4" VALUE 0xCD6B4 Kw_Wu8 51000. TimeDsmTsf 0.00 51000. FORMAT "%5.0" /end CHARACTERISTIC
/begin CHARACTERISTIC DSM_TsfDfp_ETClbETFltInj5_C "Schwerezaehlergrenze fuer Fehlerpfad Dfp_ETClbETFltInj5" VALUE 0xCD6B5 Kw_Wu8 51000. TimeDsmTsf 0.00 51000. FORMAT "%5.0" /end CHARACTERISTIC
/begin CHARACTERISTIC DSM_TsfDfp_ETClbETFltInj6_C "Schwerezaehlergrenze fuer Fehlerpfad Dfp_ETClbETFltInj6" VALUE 0xCD6B6 Kw_Wu8 51000. TimeDsmTsf 0.00 51000. FORMAT "%5.0" /end CHARACTERISTIC
/begin CHARACTERISTIC DSM_TsfDfp_ETClbInj1_C "Schwerezaehlergrenze fuer Fehlerpfad Dfp_ETClbInj1" VALUE 0xCD6B7 Kw_Wu8 51000. TimeDsmTsf 0.00 51000. FORMAT "%5.0" /end CHARACTERISTIC
/begin CHARACTERISTIC DSM_TsfDfp_ETClbInj2_C "Schwerezaehlergrenze fuer Fehlerpfad Dfp_ETClbInj2" VALUE 0xCD6B8 Kw_Wu8 51000. TimeDsmTsf 0.00 51000. FORMAT "%5.0" /end CHARACTERISTIC
/begin CHARACTERISTIC DSM_TsfDfp_ETClbInj3_C "Schwerezaehlergrenze fuer Fehlerpfad Dfp_ETClbInj3" VALUE 0xCD6B9 Kw_Wu8 51000. TimeDsmTsf 0.00 51000. FORMAT "%5.0" /end CHARACTERISTIC
/begin CHARACTERISTIC DSM_TsfDfp_ETClbInj4_C "Schwerezaehlergrenze fuer Fehlerpfad Dfp_ETClbInj4" VALUE 0xCD6BA Kw_Wu8 51000. TimeDsmTsf 0.00 51000. FORMAT "%5.0" /end CHARACTERISTIC
/begin CHARACTERISTIC DSM_TsfDfp_ETClbInj5_C "Schwerezaehlergrenze fuer Fehlerpfad Dfp_ETClbInj5" VALUE 0xCD6BB Kw_Wu8 51000. TimeDsmTsf 0.00 51000. FORMAT "%5.0" /end CHARACTERISTIC
/begin CHARACTERISTIC DSM_TsfDfp_ETClbInj6_C "Schwerezaehlergrenze fuer Fehlerpfad Dfp_ETClbInj6" VALUE 0xCD6BC Kw_Wu8 51000. TimeDsmTsf 0.00 51000. FORMAT "%5.0" /end CHARACTERISTIC
/begin CHARACTERISTIC DSM_TsfDfp_EngMCaS1_C "Schwerezaehlergrenze fuer Fehlerpfad Dfp_EngMCaS1" VALUE 0xCD6BD Kw_Wu8 51000. TimeDsmTsf 0.00 51000. FORMAT "%5.0" /end CHARACTERISTIC
/begin CHARACTERISTIC DSM_TsfDfp_EngMCrS1_C "Schwerezaehlergrenze fuer Fehlerpfad Dfp_EngMCrS1" VALUE 0xCD6BE Kw_Wu8 51000. TimeDsmTsf 0.00 51000. FORMAT "%5.0" /end CHARACTERISTIC
/begin CHARACTERISTIC DSM_TsfDfp_EngMOfsCaSCrS_C "Schwerezaehlergrenze fuer Fehlerpfad Dfp_EngMOfsCaSCrS" VALUE 0xCD6BF Kw_Wu8 51000. TimeDsmTsf 0.00 51000. FORMAT "%5.0" /end CHARACTERISTIC
/begin CHARACTERISTIC DSM_TsfDfp_EngPrtFWODet_C "Schwerezaehlergrenze fuer Fehlerpfad Dfp_EngPrtFWODet" VALUE 0xCD6C0 Kw_Wu8 51000. TimeDsmTsf 0.00 51000. FORMAT "%5.0" /end CHARACTERISTIC
/begin CHARACTERISTIC DSM_TsfDfp_FBCqDvt_C "Schwerezaehlergrenze fuer Fehlerpfad Dfp_FBCqDvt" VALUE 0xCD6C1 Kw_Wu8 51000. TimeDsmTsf 0.00 51000. FORMAT "%5.0" /end CHARACTERISTIC
/begin CHARACTERISTIC DSM_TsfDfp_FMTC_NonMonotonMap_C "Schwerezaehlergrenze fuer Fehlerpfad Dfp_FMTC_NonMonotonMap" VALUE 0xCD6C2 Kw_Wu8 51000. TimeDsmTsf 0.00 51000. FORMAT "%5.0" /end CHARACTERISTIC
/begin CHARACTERISTIC DSM_TsfDfp_FTSCD_C "Schwerezaehlergrenze fuer Fehlerpfad Dfp_FTSCD" VALUE 0xCD6C3 Kw_Wu8 51000. TimeDsmTsf 0.00 51000. FORMAT "%5.0" /end CHARACTERISTIC
/begin CHARACTERISTIC DSM_TsfDfp_FanCD_C "Schwerezaehlergrenze fuer Fehlerpfad Dfp_FanCD" VALUE 0xCD6C4 Kw_Wu8 51000. TimeDsmTsf 0.00 51000. FORMAT "%5.0" /end CHARACTERISTIC
/begin CHARACTERISTIC DSM_TsfDfp_FanCD_FanCtlr1_C "Schwerezaehlergrenze fuer Fehlerpfad Dfp_FanCD_FanCtlr1" VALUE 0xCD6C5 Kw_Wu8 51000. TimeDsmTsf 0.00 51000. FORMAT "%5.0" /end CHARACTERISTIC
/begin CHARACTERISTIC DSM_TsfDfp_FanCD_FanCtlr2_C "Schwerezaehlergrenze fuer Fehlerpfad Dfp_FanCD_FanCtlr2" VALUE 0xCD6C6 Kw_Wu8 51000. TimeDsmTsf 0.00 51000. FORMAT "%5.0" /end CHARACTERISTIC
/begin CHARACTERISTIC DSM_TsfDfp_FanCD_FanCtlr3_C "Schwerezaehlergrenze fuer Fehlerpfad Dfp_FanCD_FanCtlr3" VALUE 0xCD6C7 Kw_Wu8 51000. TimeDsmTsf 0.00 51000. FORMAT "%5.0" /end CHARACTERISTIC
/begin CHARACTERISTIC DSM_TsfDfp_FlFCD_C "Schwerezaehlergrenze fuer Fehlerpfad Dfp_FlFCD" VALUE 0xCD6C8 Kw_Wu8 51000. TimeDsmTsf 0.00 51000. FORMAT "%5.0" /end CHARACTERISTIC
/begin CHARACTERISTIC DSM_TsfDfp_FlMngSmkDefect_C "Schwerezaehlergrenze fuer Fehlerpfad Dfp_FlMngSmkDefect" VALUE 0xCD6C9 Kw_Wu8 51000. TimeDsmTsf 0.00 51000. FORMAT "%5.0" /end CHARACTERISTIC
/begin CHARACTERISTIC DSM_TsfDfp_FrmMngANFRADMOMPT_C "Schwerezaehlergrenze fuer Fehlerpfad Dfp_FrmMngANFRADMOMPT" VALUE 0xCD6CA Kw_Wu8 51000. TimeDsmTsf 0.00 51000. FORMAT "%5.0" /end CHARACTERISTIC
/begin CHARACTERISTIC DSM_TsfDfp_FrmMngASC1_C "Schwerezaehlergrenze fuer Fehlerpfad Dfp_FrmMngASC1" VALUE 0xCD6CB Kw_Wu8 51000. TimeDsmTsf 0.00 51000. FORMAT "%5.0" /end CHARACTERISTIC
/begin CHARACTERISTIC DSM_TsfDfp_FrmMngASC2_C "Schwerezaehlergrenze fuer Fehlerpfad Dfp_FrmMngASC2" VALUE 0xCD6CC Kw_Wu8 51000. TimeDsmTsf 0.00 51000. FORMAT "%5.0" /end CHARACTERISTIC
/begin CHARACTERISTIC DSM_TsfDfp_FrmMngASC3_C "Schwerezaehlergrenze fuer Fehlerpfad Dfp_FrmMngASC3" VALUE 0xCD6CD Kw_Wu8 51000. TimeDsmTsf 0.00 51000. FORMAT "%5.0" /end CHARACTERISTIC
/begin CHARACTERISTIC DSM_TsfDfp_FrmMngASC4_C "Schwerezaehlergrenze fuer Fehlerpfad Dfp_FrmMngASC4" VALUE 0xCD6CE Kw_Wu8 51000. TimeDsmTsf 0.00 51000. FORMAT "%5.0" /end CHARACTERISTIC
/begin CHARACTERISTIC DSM_TsfDfp_FrmMngBOS_RESET_C "Schwerezaehlergrenze fuer Fehlerpfad Dfp_FrmMngBOS_RESET" VALUE 0xCD6CF Kw_Wu8 51000. TimeDsmTsf 0.00 51000. FORMAT "%5.0" /end CHARACTERISTIC
/begin CHARACTERISTIC DSM_TsfDfp_FrmMngBOS_RESET_2_C "" VALUE 0xCD6D0 Kw_Wu8 51000. TimeDsmTsf 0.00 51000. FORMAT "%5.0" /end CHARACTERISTIC
/begin CHARACTERISTIC DSM_TsfDfp_FrmMngDMANFAFS_C "Schwerezaehlergrenze fuer Fehlerpfad Dfp_FrmMngDMANFAFS" VALUE 0xCD6D1 Kw_Wu8 51000. TimeDsmTsf 0.00 51000. FORMAT "%5.0" /end CHARACTERISTIC
/begin CHARACTERISTIC DSM_TsfDfp_FrmMngDRMANFSSG_C "Schwerezaehlergrenze fuer Fehlerpfad Dfp_FrmMngDRMANFSSG" VALUE 0xCD6D2 Kw_Wu8 51000. TimeDsmTsf 0.00 51000. FORMAT "%5.0" /end CHARACTERISTIC
/begin CHARACTERISTIC DSM_TsfDfp_FrmMngEGS1_C "Schwerezaehlergrenze fuer Fehlerpfad Dfp_FrmMngEGS1" VALUE 0xCD6D3 Kw_Wu8 51000. TimeDsmTsf 0.00 51000. FORMAT "%5.0" /end CHARACTERISTIC
/begin CHARACTERISTIC DSM_TsfDfp_FrmMngEGS2_C "Schwerezaehlergrenze fuer Fehlerpfad Dfp_FrmMngEGS2" VALUE 0xCD6D4 Kw_Wu8 51000. TimeDsmTsf 0.00 51000. FORMAT "%5.0" /end CHARACTERISTIC
/begin CHARACTERISTIC DSM_TsfDfp_FrmMngGEARBX_DATA_C "severity-counter for path" VALUE 0xCD6D5 Kw_Wu8 51000. TimeDsmTsf 0.00 51000. FORMAT "%5.0" /end CHARACTERISTIC
/begin CHARACTERISTIC DSM_TsfDfp_FrmMngGEARBX_DATA2_C "Schwerezaehlergrenze fuer Fehlerpfad Dfp_FrmMngGEARBX_DATA2" VALUE 0xCD6D6 Kw_Wu8 51000. TimeDsmTsf 0.00 51000. FORMAT "%5.0" /end CHARACTERISTIC
/begin CHARACTERISTIC DSM_TsfDfp_FrmMngHEAT_AC_C "severity-counter for path" VALUE 0xCD6D7 Kw_Wu8 51000. TimeDsmTsf 0.00 51000. FORMAT "%5.0" /end CHARACTERISTIC
/begin CHARACTERISTIC DSM_TsfDfp_FrmMngINSTR2_C "Schwerezaehlergrenze fuer Fehlerpfad Dfp_FrmMngINSTR2" VALUE 0xCD6D8 Kw_Wu8 51000. TimeDsmTsf 0.00 51000. FORMAT "%5.0" /end CHARACTERISTIC
/begin CHARACTERISTIC DSM_TsfDfp_FrmMngINSTR3_C "Schwerezaehlergrenze fuer Fehlerpfad Dfp_FrmMngINSTR3" VALUE 0xCD6D9 Kw_Wu8 51000. TimeDsmTsf 0.00 51000. FORMAT "%5.0" /end CHARACTERISTIC
/begin CHARACTERISTIC DSM_TsfDfp_FrmMngLENKRADWINKEL_C "Schwerezaehlergrenze fuer Fehlerpfad Dfp_FrmMngLENKRADWINKEL" VALUE 0xCD6DA Kw_Wu8 51000. TimeDsmTsf 0.00 51000. FORMAT "%5.0" /end CHARACTERISTIC
/begin CHARACTERISTIC DSM_TsfDfp_FrmMngMILEAGE_RANGE_C "Schwerezaehlergrenze fuer Fehlerpfad Dfp_FrmMngMILEAGE_RANGE" VALUE 0xCD6DB Kw_Wu8 51000. TimeDsmTsf 0.00 51000. FORMAT "%5.0" /end CHARACTERISTIC
/begin CHARACTERISTIC DSM_TsfDfp_FrmMngOPCRCTLACC_C "Schwerezaehlergrenze fuer Fehlerpfad Dfp_FrmMngOPCRCTLACC" VALUE 0xCD6DC Kw_Wu8 51000. TimeDsmTsf 0.00 51000. FORMAT "%5.0" /end CHARACTERISTIC
/begin CHARACTERISTIC DSM_TsfDfp_FrmMngPRGG_CCTR_C "Schwerezaehlergrenze fuer Fehlerpfad Dfp_FrmMngPRGG_CCTR" VALUE 0xCD6DD Kw_Wu8 51000. TimeDsmTsf 0.00 51000. FORMAT "%5.0" /end CHARACTERISTIC
/begin CHARACTERISTIC DSM_TsfDfp_FrmMngPWRMNG_LOADV_C "Schwerezaehlergrenze fuer Fehlerpfad Dfp_FrmMngPWRMNG_LOADV" VALUE 0xCD6DE Kw_Wu8 51000. TimeDsmTsf 0.00 51000. FORMAT "%5.0" /end CHARACTERISTIC
/begin CHARACTERISTIC DSM_TsfDfp_FrmMngParkConsumer_C "Schwerezaehlgrenze fuer Fehlerpfad Dfp_FrmMngParkConsumer" VALUE 0xCD6DF Kw_Wu8 51000. TimeDsmTsf 0.00 51000. FORMAT "%5.0" /end CHARACTERISTIC
/begin CHARACTERISTIC DSM_TsfDfp_FrmMngRQSTGEFAN_C "RQ_STG_EFAN - CAN-message related errors" VALUE 0xCD6E0 Kw_Wu8 51000. TimeDsmTsf 0.00 51000. FORMAT "%5.0" /end CHARACTERISTIC
/begin CHARACTERISTIC DSM_TsfDfp_FrmMngSSGErr_C "Schwerezaehlergrenze fuer Fehlerpfad Dfp_FrmMngSSGErr" VALUE 0xCD6E1 Kw_Wu8 51000. TimeDsmTsf 0.00 51000. FORMAT "%5.0" /end CHARACTERISTIC
/begin CHARACTERISTIC DSM_TsfDfp_FrmMngSSGShOff_C "Schwerezaehlergrenze fuer Fehlerpfad Dfp_FrmMngSSGShOff" VALUE 0xCD6E2 Kw_Wu8 51000. TimeDsmTsf 0.00 51000. FORMAT "%5.0" /end CHARACTERISTIC
/begin CHARACTERISTIC DSM_TsfDfp_FrmMngSTAT_ANH_C "Schwerezaehlergrenze fuer Fehlerpfad Dfp_FrmMngSTAT_ANH" VALUE 0xCD6E3 Kw_Wu8 51000. TimeDsmTsf 0.00 51000. FORMAT "%5.0" /end CHARACTERISTIC
/begin CHARACTERISTIC DSM_TsfDfp_FrmMngSTAT_ARS_C "severity-counter for path" VALUE 0xCD6E4 Kw_Wu8 51000. TimeDsmTsf 0.00 51000. FORMAT "%5.0" /end CHARACTERISTIC
/begin CHARACTERISTIC DSM_TsfDfp_FrmMngSTAT_DSC_C "severity-counter for path" VALUE 0xCD6E5 Kw_Wu8 51000. TimeDsmTsf 0.00 51000. FORMAT "%5.0" /end CHARACTERISTIC
/begin CHARACTERISTIC DSM_TsfDfp_FrmMngSTAT_EKP_C "Schwerezaehlergrenze fuer Fehlerpfad Dfp_FrmMngSTAT_EKP" VALUE 0xCD6E6 Kw_Wu8 51000. TimeDsmTsf 0.00 51000. FORMAT "%5.0" /end CHARACTERISTIC
/begin CHARACTERISTIC DSM_TsfDfp_FrmMngSTAT_KOMBI_C "Schwerezaehlergrenze fuer Fehlerpfad Dfp_FrmMngSTAT_KOMBI" VALUE 0xCD6E7 Kw_Wu8 51000. TimeDsmTsf 0.00 51000. FORMAT "%5.0" /end CHARACTERISTIC
/begin CHARACTERISTIC DSM_TsfDfp_FrmMngSTAT_SITZ_C "Schwerezaehlergrenze fuer Fehlerpfad Dfp_FrmMngSTAT_SITZ" VALUE 0xCD6E8 Kw_Wu8 51000. TimeDsmTsf 0.00 51000. FORMAT "%5.0" /end CHARACTERISTIC
/begin CHARACTERISTIC DSM_TsfDfp_FrmMngStOBDGbxMilOf_C "Schwerezaehlergrenze fuer Fehlerpfad Dfp_FrmMngStOBDGbxMilOf" VALUE 0xCD6E9 Kw_Wu8 51000. TimeDsmTsf 0.00 51000. FORMAT "%5.0" /end CHARACTERISTIC
/begin CHARACTERISTIC DSM_TsfDfp_FrmMngStOBDGbxMilOn_C "Schwerezaehlergrenze fuer Fehlerpfad Dfp_FrmMngStOBDGbxMilOn" VALUE 0xCD6EA Kw_Wu8 51000. TimeDsmTsf 0.00 51000. FORMAT "%5.0" /end CHARACTERISTIC
/begin CHARACTERISTIC DSM_TsfDfp_FrmMngTEMPRELTIME_C "Schwerezaehlergrenze fuer Fehlerpfad Dfp_FrmMngTEMPRELTIME" VALUE 0xCD6EB Kw_Wu8 51000. TimeDsmTsf 0.00 51000. FORMAT "%5.0" /end CHARACTERISTIC
/begin CHARACTERISTIC DSM_TsfDfp_FrmMngTERMINAL_C "severity-counter for path" VALUE 0xCD6EC Kw_Wu8 51000. TimeDsmTsf 0.00 51000. FORMAT "%5.0" /end CHARACTERISTIC
/begin CHARACTERISTIC DSM_TsfDfp_FrmMngTIME_DATE_C "Schwerezaehlergrenze fuer Fehlerpfad Dfp_FrmMngTIME_DATE" VALUE 0xCD6ED Kw_Wu8 51000. TimeDsmTsf 0.00 51000. FORMAT "%5.0" /end CHARACTERISTIC
/begin CHARACTERISTIC DSM_TsfDfp_FrmMngTORQUE_DSC_C "severity-counter for path" VALUE 0xCD6EE Kw_Wu8 51000. TimeDsmTsf 0.00 51000. FORMAT "%5.0" /end CHARACTERISTIC
/begin CHARACTERISTIC DSM_TsfDfp_FrmMngTORQUE_GEARBX_C "severity-counter for path" VALUE 0xCD6EF Kw_Wu8 51000. TimeDsmTsf 0.00 51000. FORMAT "%5.0" /end CHARACTERISTIC
/begin CHARACTERISTIC DSM_TsfDfp_FrmMngTrq_ReqACC_C "Schwerezaehlergrenze fuer Fehlerpfad Dfp_FrmMngTrq_ReqACC" VALUE 0xCD6F0 Kw_Wu8 51000. TimeDsmTsf 0.00 51000. FORMAT "%5.0" /end CHARACTERISTIC
/begin CHARACTERISTIC DSM_TsfDfp_FrmMngVEH_MOD_C "VEH_MOD - CAN-message related errors" VALUE 0xCD6F1 Kw_Wu8 51000. TimeDsmTsf 0.00 51000. FORMAT "%5.0" /end CHARACTERISTIC
/begin CHARACTERISTIC DSM_TsfDfp_FrmMngVELOCITY_C "severity-counter for path" VALUE 0xCD6F2 Kw_Wu8 51000. TimeDsmTsf 0.00 51000. FORMAT "%5.0" /end CHARACTERISTIC
/begin CHARACTERISTIC DSM_TsfDfp_FrmMngWHEEL_SPEED_C "Schwerezaehlergrenze fuer Fehlerpfad Dfp_FrmMngWHEEL_SPEED" VALUE 0xCD6F3 Kw_Wu8 51000. TimeDsmTsf 0.00 51000. FORMAT "%5.0" /end CHARACTERISTIC
/begin CHARACTERISTIC DSM_TsfDfp_FrmMngstCurr_C "Schwerezählergrenze für Dfp_FrmMngstCurr" VALUE 0xCD6F4 Kw_Wu8 51000. TimeDsmTsf 0.00 51000. FORMAT "%5.0" /end CHARACTERISTIC
/begin CHARACTERISTIC DSM_TsfDfp_FrmMngswtPSPOff_C "Schwerezählergrenze für Dfp_FrmMngswtPSPOff" VALUE 0xCD6F5 Kw_Wu8 51000. TimeDsmTsf 0.00 51000. FORMAT "%5.0" /end CHARACTERISTIC
/begin CHARACTERISTIC DSM_TsfDfp_GearbxIncMax_C "Schwerezaehlergrenze fuer Fehlerpfad Dfp_GearbxIncMax" VALUE 0xCD6F6 Kw_Wu8 51000. TimeDsmTsf 0.00 51000. FORMAT "%5.0" /end CHARACTERISTIC
/begin CHARACTERISTIC DSM_TsfDfp_GlwCD_C "Schwerezaehlergrenze fuer Fehlerpfad Dfp_GlwCD" VALUE 0xCD6F7 Kw_Wu8 51000. TimeDsmTsf 0.00 51000. FORMAT "%5.0" /end CHARACTERISTIC
/begin CHARACTERISTIC DSM_TsfDfp_GlwCDGlwCirc1_C "Schwerezaehlergrenze fuer Fehlerpfad Dfp_GlwCDGlwCirc1" VALUE 0xCD6F8 Kw_Wu8 51000. TimeDsmTsf 0.00 51000. FORMAT "%5.0" /end CHARACTERISTIC
/begin CHARACTERISTIC DSM_TsfDfp_GlwCDGlwCirc2_C "Schwerezaehlergrenze fuer Fehlerpfad Dfp_GlwCDGlwCirc2" VALUE 0xCD6F9 Kw_Wu8 51000. TimeDsmTsf 0.00 51000. FORMAT "%5.0" /end CHARACTERISTIC
/begin CHARACTERISTIC DSM_TsfDfp_GlwCDGlwCirc3_C "Schwerezaehlergrenze fuer Fehlerpfad Dfp_GlwCDGlwCirc3" VALUE 0xCD6FA Kw_Wu8 51000. TimeDsmTsf 0.00 51000. FORMAT "%5.0" /end CHARACTERISTIC
/begin CHARACTERISTIC DSM_TsfDfp_GlwCDGlwCirc4_C "Schwerezaehlergrenze fuer Fehlerpfad Dfp_GlwCDGlwCirc4" VALUE 0xCD6FB Kw_Wu8 51000. TimeDsmTsf 0.00 51000. FORMAT "%5.0" /end CHARACTERISTIC
/begin CHARACTERISTIC DSM_TsfDfp_GlwCDGlwCirc5_C "Schwerezaehlergrenze fuer Fehlerpfad Dfp_GlwCDGlwCirc5" VALUE 0xCD6FC Kw_Wu8 51000. TimeDsmTsf 0.00 51000. FORMAT "%5.0" /end CHARACTERISTIC
/begin CHARACTERISTIC DSM_TsfDfp_GlwCDGlwCirc6_C "Schwerezaehlergrenze fuer Fehlerpfad Dfp_GlwCDGlwCirc6" VALUE 0xCD6FD Kw_Wu8 51000. TimeDsmTsf 0.00 51000. FORMAT "%5.0" /end CHARACTERISTIC
/begin CHARACTERISTIC DSM_TsfDfp_GlwCDGlwCirc7_C "Schwerezaehlergrenze fuer Fehlerpfad Dfp_GlwCDGlwCirc7" VALUE 0xCD6FE Kw_Wu8 51000. TimeDsmTsf 0.00 51000. FORMAT "%5.0" /end CHARACTERISTIC
/begin CHARACTERISTIC DSM_TsfDfp_GlwCDGlwCirc8_C "Schwerezaehlergrenze fuer Fehlerpfad Dfp_GlwCDGlwCirc8" VALUE 0xCD6FF Kw_Wu8 51000. TimeDsmTsf 0.00 51000. FORMAT "%5.0" /end CHARACTERISTIC
/begin CHARACTERISTIC DSM_TsfDfp_GlwCtl_C "Schwerezaehlergrenze fuer Fehlerpfad Dfp_GlwCtl" VALUE 0xCD700 Kw_Wu8 51000. TimeDsmTsf 0.00 51000. FORMAT "%5.0" /end CHARACTERISTIC
/begin CHARACTERISTIC DSM_TsfDfp_HWEMonCom_C "Schwerezaehlergrenze fuer Fehlerpfad Dfp_HWEMonCom" VALUE 0xCD701 Kw_Wu8 51000. TimeDsmTsf 0.00 51000. FORMAT "%5.0" /end CHARACTERISTIC
/begin CHARACTERISTIC DSM_TsfDfp_HWEMonEEPROM_C "Schwerezaehlergrenze fuer Fehlerpfad Dfp_HWEMonEEPROM" VALUE 0xCD702 Kw_Wu8 51000. TimeDsmTsf 0.00 51000. FORMAT "%5.0" /end CHARACTERISTIC
/begin CHARACTERISTIC DSM_TsfDfp_HWEMonRcyLocked_C "Schwerezaehlergrenze fuer Fehlerpfad Dfp_HWEMonRcyLocked" VALUE 0xCD703 Kw_Wu8 51000. TimeDsmTsf 0.00 51000. FORMAT "%5.0" /end CHARACTERISTIC
/begin CHARACTERISTIC DSM_TsfDfp_HWEMonRcySuppressed_C "Schwerezaehlergrenze fuer Fehlerpfad Dfp_HWEMonRcySuppressed" VALUE 0xCD704 Kw_Wu8 51000. TimeDsmTsf 0.00 51000. FORMAT "%5.0" /end CHARACTERISTIC
/begin CHARACTERISTIC DSM_TsfDfp_HWEMonRcyVisible_C "Schwerezaehlergrenze fuer Fehlerpfad Dfp_HWEMonRcyVisible" VALUE 0xCD705 Kw_Wu8 51000. TimeDsmTsf 0.00 51000. FORMAT "%5.0" /end CHARACTERISTIC
/begin CHARACTERISTIC DSM_TsfDfp_HWEMonUMaxSupply_C "Schwerezaehlergrenze fuer Fehlerpfad Dfp_HWEMonUMaxSupply" VALUE 0xCD706 Kw_Wu8 51000. TimeDsmTsf 0.00 51000. FORMAT "%5.0" /end CHARACTERISTIC
/begin CHARACTERISTIC DSM_TsfDfp_HWEMonUMinSupply_C "Schwerezaehlergrenze fuer Fehlerpfad Dfp_HWEMonUMinSupply" VALUE 0xCD707 Kw_Wu8 51000. TimeDsmTsf 0.00 51000. FORMAT "%5.0" /end CHARACTERISTIC
/begin CHARACTERISTIC DSM_TsfDfp_IATSCD_C "Schwerezaehlergrenze fuer Fehlerpfad Dfp_IATSCD" VALUE 0xCD708 Kw_Wu8 51000. TimeDsmTsf 0.00 51000. FORMAT "%5.0" /end CHARACTERISTIC
/begin CHARACTERISTIC DSM_TsfDfp_IATSCD_CATS_C "Schwerezaehlergrenze fuer Fehlerpfad Dfp_IATSCD_CATS" VALUE 0xCD709 Kw_Wu8 51000. TimeDsmTsf 0.00 51000. FORMAT "%5.0" /end CHARACTERISTIC
/begin CHARACTERISTIC DSM_TsfDfp_ImmCtlImmCD_C "Schwerezaehlergrenze fuer Fehlerpfad Dfp_ImmCtlImmCD" VALUE 0xCD70A Kw_Wu8 51000. TimeDsmTsf 0.00 51000. FORMAT "%5.0" /end CHARACTERISTIC
/begin CHARACTERISTIC DSM_TsfDfp_ImmCtlImmEep_C "Schwerezaehlergrenze fuer Fehlerpfad Dfp_ImmCtlImmEep" VALUE 0xCD70B Kw_Wu8 51000. TimeDsmTsf 0.00 51000. FORMAT "%5.0" /end CHARACTERISTIC
/begin CHARACTERISTIC DSM_TsfDfp_ImmCtlMpl_C "Schwerezaehlergrenze fuer Fehlerpfad Dfp_ImmCtlMpl" VALUE 0xCD70C Kw_Wu8 51000. TimeDsmTsf 0.00 51000. FORMAT "%5.0" /end CHARACTERISTIC
/begin CHARACTERISTIC DSM_TsfDfp_IndSys1_C "Schwerezaehlergrenze fuer Fehlerpfad Dfp_IndSys1" VALUE 0xCD70D Kw_Wu8 51000. TimeDsmTsf 0.00 51000. FORMAT "%5.0" /end CHARACTERISTIC
/begin CHARACTERISTIC DSM_TsfDfp_IndSys2_C "Schwerezaehlergrenze fuer Fehlerpfad Dfp_IndSys2" VALUE 0xCD70E Kw_Wu8 51000. TimeDsmTsf 0.00 51000. FORMAT "%5.0" /end CHARACTERISTIC
/begin CHARACTERISTIC DSM_TsfDfp_InjCrv_InjLim_C "Schwerezaehlergrenze fuer Fehlerpfad Dfp_InjCrv_InjLim" VALUE 0xCD70F Kw_Wu8 51000. TimeDsmTsf 0.00 51000. FORMAT "%5.0" /end CHARACTERISTIC
/begin CHARACTERISTIC DSM_TsfDfp_InjCtlAdjQnt_C "Schwerezaehlergrenze fuer Fehlerpfad Dfp_InjCtlAdjQnt" VALUE 0xCD710 Kw_Wu8 51000. TimeDsmTsf 0.00 51000. FORMAT "%5.0" /end CHARACTERISTIC
/begin CHARACTERISTIC DSM_TsfDfp_InjCtlDrift_C "Schwerezaehlergrenze fuer Fehlerpfad Dfp_InjCtlDrift" VALUE 0xCD711 Kw_Wu8 51000. TimeDsmTsf 0.00 51000. FORMAT "%5.0" /end CHARACTERISTIC
/begin CHARACTERISTIC DSM_TsfDfp_InjVlvBnk1A_C "Schwerezaehlergrenze fuer Fehlerpfad Dfp_InjVlvBnk1A" VALUE 0xCD712 Kw_Wu8 51000. TimeDsmTsf 0.00 51000. FORMAT "%5.0" /end CHARACTERISTIC
/begin CHARACTERISTIC DSM_TsfDfp_InjVlvBnk1B_C "Schwerezaehlergrenze fuer Fehlerpfad Dfp_InjVlvBnk1B" VALUE 0xCD713 Kw_Wu8 51000. TimeDsmTsf 0.00 51000. FORMAT "%5.0" /end CHARACTERISTIC
/begin CHARACTERISTIC DSM_TsfDfp_InjVlvBnk2A_C "Schwerezaehlergrenze fuer Fehlerpfad Dfp_InjVlvBnk2A" VALUE 0xCD714 Kw_Wu8 51000. TimeDsmTsf 0.00 51000. FORMAT "%5.0" /end CHARACTERISTIC
/begin CHARACTERISTIC DSM_TsfDfp_InjVlvBnk2B_C "Schwerezaehlergrenze fuer Fehlerpfad Dfp_InjVlvBnk2B" VALUE 0xCD715 Kw_Wu8 51000. TimeDsmTsf 0.00 51000. FORMAT "%5.0" /end CHARACTERISTIC
/begin CHARACTERISTIC DSM_TsfDfp_InjVlvChipA_C "Schwerezaehlergrenze fuer Fehlerpfad Dfp_InjVlvChipA" VALUE 0xCD716 Kw_Wu8 51000. TimeDsmTsf 0.00 51000. FORMAT "%5.0" /end CHARACTERISTIC
/begin CHARACTERISTIC DSM_TsfDfp_InjVlvChipB_C "Schwerezaehlergrenze fuer Fehlerpfad Dfp_InjVlvChipB" VALUE 0xCD717 Kw_Wu8 51000. TimeDsmTsf 0.00 51000. FORMAT "%5.0" /end CHARACTERISTIC
/begin CHARACTERISTIC DSM_TsfDfp_InjVlvCyl1A_C "Schwerezaehlergrenze fuer Fehlerpfad Dfp_InjVlvCyl1A" VALUE 0xCD718 Kw_Wu8 51000. TimeDsmTsf 0.00 51000. FORMAT "%5.0" /end CHARACTERISTIC
/begin CHARACTERISTIC DSM_TsfDfp_InjVlvCyl1B_C "Schwerezaehlergrenze fuer Fehlerpfad Dfp_InjVlvCyl1B" VALUE 0xCD719 Kw_Wu8 51000. TimeDsmTsf 0.00 51000. FORMAT "%5.0" /end CHARACTERISTIC
/begin CHARACTERISTIC DSM_TsfDfp_InjVlvCyl2A_C "Schwerezaehlergrenze fuer Fehlerpfad Dfp_InjVlvCyl2A" VALUE 0xCD71A Kw_Wu8 51000. TimeDsmTsf 0.00 51000. FORMAT "%5.0" /end CHARACTERISTIC
/begin CHARACTERISTIC DSM_TsfDfp_InjVlvCyl2B_C "Schwerezaehlergrenze fuer Fehlerpfad Dfp_InjVlvCyl2B" VALUE 0xCD71B Kw_Wu8 51000. TimeDsmTsf 0.00 51000. FORMAT "%5.0" /end CHARACTERISTIC
/begin CHARACTERISTIC DSM_TsfDfp_InjVlvCyl3A_C "Schwerezaehlergrenze fuer Fehlerpfad Dfp_InjVlvCyl3A" VALUE 0xCD71C Kw_Wu8 51000. TimeDsmTsf 0.00 51000. FORMAT "%5.0" /end CHARACTERISTIC
/begin CHARACTERISTIC DSM_TsfDfp_InjVlvCyl3B_C "Schwerezaehlergrenze fuer Fehlerpfad Dfp_InjVlvCyl3B" VALUE 0xCD71D Kw_Wu8 51000. TimeDsmTsf 0.00 51000. FORMAT "%5.0" /end CHARACTERISTIC
/begin CHARACTERISTIC DSM_TsfDfp_InjVlvCyl4A_C "Schwerezaehlergrenze fuer Fehlerpfad Dfp_InjVlvCyl4A" VALUE 0xCD71E Kw_Wu8 51000. TimeDsmTsf 0.00 51000. FORMAT "%5.0" /end CHARACTERISTIC
/begin CHARACTERISTIC DSM_TsfDfp_InjVlvCyl4B_C "Schwerezaehlergrenze fuer Fehlerpfad Dfp_InjVlvCyl4B" VALUE 0xCD71F Kw_Wu8 51000. TimeDsmTsf 0.00 51000. FORMAT "%5.0" /end CHARACTERISTIC
/begin CHARACTERISTIC DSM_TsfDfp_InjVlvCyl5A_C "Schwerezaehlergrenze fuer Fehlerpfad Dfp_InjVlvCyl5A" VALUE 0xCD720 Kw_Wu8 51000. TimeDsmTsf 0.00 51000. FORMAT "%5.0" /end CHARACTERISTIC
/begin CHARACTERISTIC DSM_TsfDfp_InjVlvCyl5B_C "Schwerezaehlergrenze fuer Fehlerpfad Dfp_InjVlvCyl5B" VALUE 0xCD721 Kw_Wu8 51000. TimeDsmTsf 0.00 51000. FORMAT "%5.0" /end CHARACTERISTIC
/begin CHARACTERISTIC DSM_TsfDfp_InjVlvCyl6A_C "Schwerezaehlergrenze fuer Fehlerpfad Dfp_InjVlvCyl6A" VALUE 0xCD722 Kw_Wu8 51000. TimeDsmTsf 0.00 51000. FORMAT "%5.0" /end CHARACTERISTIC
/begin CHARACTERISTIC DSM_TsfDfp_InjVlvCyl6B_C "Schwerezaehlergrenze fuer Fehlerpfad Dfp_InjVlvCyl6B" VALUE 0xCD723 Kw_Wu8 51000. TimeDsmTsf 0.00 51000. FORMAT "%5.0" /end CHARACTERISTIC
/begin CHARACTERISTIC DSM_TsfDfp_LPACD_Max_C "Schwerezaehlergrenze fuer Fehlerpfad Dfp_LPACD_Max" VALUE 0xCD724 Kw_Wu8 51000. TimeDsmTsf 0.00 51000. FORMAT "%5.0" /end CHARACTERISTIC
/begin CHARACTERISTIC DSM_TsfDfp_LPACD_Min_C "Schwerezaehlergrenze fuer Fehlerpfad Dfp_LPACD_Min" VALUE 0xCD725 Kw_Wu8 51000. TimeDsmTsf 0.00 51000. FORMAT "%5.0" /end CHARACTERISTIC
/begin CHARACTERISTIC DSM_TsfDfp_LPACD_SigNpl_C "Schwerezaehlergrenze fuer Fehlerpfad Dfp_LPACD_SigNpl" VALUE 0xCD726 Kw_Wu8 51000. TimeDsmTsf 0.00 51000. FORMAT "%5.0" /end CHARACTERISTIC
/begin CHARACTERISTIC DSM_TsfDfp_LSUCDCircNernst0_C "Schwerezaehlergrenze fuer Fehlerpfad Dfp_LSUCDCircNernst0" VALUE 0xCD727 Kw_Wu8 51000. TimeDsmTsf 0.00 51000. FORMAT "%5.0" /end CHARACTERISTIC
/begin CHARACTERISTIC DSM_TsfDfp_LSUCDCircPumpCur0_C "Schwerezaehlergrenze fuer Fehlerpfad Dfp_LSUCDCircPumpCur0" VALUE 0xCD728 Kw_Wu8 51000. TimeDsmTsf 0.00 51000. FORMAT "%5.0" /end CHARACTERISTIC
/begin CHARACTERISTIC DSM_TsfDfp_LSUCDCircVirtGnd0_C "Schwerezaehlergrenze fuer Fehlerpfad Dfp_LSUCDCircVirtGnd0" VALUE 0xCD729 Kw_Wu8 51000. TimeDsmTsf 0.00 51000. FORMAT "%5.0" /end CHARACTERISTIC
/begin CHARACTERISTIC DSM_TsfDfp_LSUCDHeater0_C "Schwerezaehlergrenze fuer Fehlerpfad Dfp_LSUCDHeater0" VALUE 0xCD72A Kw_Wu8 51000. TimeDsmTsf 0.00 51000. FORMAT "%5.0" /end CHARACTERISTIC
/begin CHARACTERISTIC DSM_TsfDfp_LSUCDHtCoup0_C "Schwerezaehlergrenze fuer Fehlerpfad Dfp_LSUCDHtCoup0" VALUE 0xCD72B Kw_Wu8 51000. TimeDsmTsf 0.00 51000. FORMAT "%5.0" /end CHARACTERISTIC
/begin CHARACTERISTIC DSM_TsfDfp_LSUCDO20_C "Schwerezaehlergrenze fuer Fehlerpfad Dfp_LSUCDO20" VALUE 0xCD72C Kw_Wu8 51000. TimeDsmTsf 0.00 51000. FORMAT "%5.0" /end CHARACTERISTIC
/begin CHARACTERISTIC DSM_TsfDfp_LSUCDO2Clb0_C "Schwerezaehlergrenze fuer Fehlerpfad Dfp_LSUCDO2Clb0" VALUE 0xCD72D Kw_Wu8 51000. TimeDsmTsf 0.00 51000. FORMAT "%5.0" /end CHARACTERISTIC
/begin CHARACTERISTIC DSM_TsfDfp_LSUCDRiClb0_C "Schwerezaehlergrenze fuer Fehlerpfad Dfp_LSUCDRiClb0" VALUE 0xCD72E Kw_Wu8 51000. TimeDsmTsf 0.00 51000. FORMAT "%5.0" /end CHARACTERISTIC
/begin CHARACTERISTIC DSM_TsfDfp_LSUCDSPI0_C "Schwerezaehlergrenze fuer Fehlerpfad Dfp_LSUCDSPI0" VALUE 0xCD72F Kw_Wu8 51000. TimeDsmTsf 0.00 51000. FORMAT "%5.0" /end CHARACTERISTIC
/begin CHARACTERISTIC DSM_TsfDfp_LSUCDSPIBattLow0_C "Schwerezaehlergrenze fuer Fehlerpfad Dfp_LSUCDSPIBattLow0" VALUE 0xCD730 Kw_Wu8 51000. TimeDsmTsf 0.00 51000. FORMAT "%5.0" /end CHARACTERISTIC
/begin CHARACTERISTIC DSM_TsfDfp_LSUCDWireIP0_C "Schwerezaehlergrenze fuer Fehlerpfad Dfp_LSUCDWireIP0" VALUE 0xCD731 Kw_Wu8 51000. TimeDsmTsf 0.00 51000. FORMAT "%5.0" /end CHARACTERISTIC
/begin CHARACTERISTIC DSM_TsfDfp_LSUCtlRiExc0_C "Schwerezaehlergrenze fuer Fehlerpfad Dfp_LSUCtlRiExc0" VALUE 0xCD732 Kw_Wu8 51000. TimeDsmTsf 0.00 51000. FORMAT "%5.0" /end CHARACTERISTIC
/begin CHARACTERISTIC DSM_TsfDfp_LSUMon1Sens_C "Schwerezaehlergrenze fuer Fehlerpfad Dfp_LSUMon1Sens" VALUE 0xCD733 Kw_Wu8 51000. TimeDsmTsf 0.00 51000. FORMAT "%5.0" /end CHARACTERISTIC
/begin CHARACTERISTIC DSM_TsfDfp_LSUMon2Sens_C "Schwerezaehlergrenze fuer Fehlerpfad Dfp_LSUMon2Sens" VALUE 0xCD734 Kw_Wu8 51000. TimeDsmTsf 0.00 51000. FORMAT "%5.0" /end CHARACTERISTIC
/begin CHARACTERISTIC DSM_TsfDfp_MIL_C "Schwerezaehlergrenze fuer Fehlerpfad Dfp_MIL" VALUE 0xCD735 Kw_Wu8 51000. TimeDsmTsf 0.00 51000. FORMAT "%5.0" /end CHARACTERISTIC
/begin CHARACTERISTIC DSM_TsfDfp_MRlyCD_C "Schwerezaehlergrenze fuer Fehlerpfad Dfp_MRlyCD" VALUE 0xCD736 Kw_Wu8 51000. TimeDsmTsf 0.00 51000. FORMAT "%5.0" /end CHARACTERISTIC
/begin CHARACTERISTIC DSM_TsfDfp_MSidCD_Comm_C "Schwerezaehlergrenze fuer Fehlerpfad Dfp_MSidCD_Comm" VALUE 0xCD737 Kw_Wu8 51000. TimeDsmTsf 0.00 51000. FORMAT "%5.0" /end CHARACTERISTIC
/begin CHARACTERISTIC DSM_TsfDfp_MSidCD_Pin_C "Schwerezaehlergrenze fuer Fehlerpfad Dfp_MSidCD_Pin" VALUE 0xCD738 Kw_Wu8 51000. TimeDsmTsf 0.00 51000. FORMAT "%5.0" /end CHARACTERISTIC
/begin CHARACTERISTIC DSM_TsfDfp_MSidCD_Sel_INI_C "Schwerezaehlergrenze fuer Fehlerpfad Dfp_MSidCD_Sel_INI" VALUE 0xCD739 Kw_Wu8 51000. TimeDsmTsf 0.00 51000. FORMAT "%5.0" /end CHARACTERISTIC
/begin CHARACTERISTIC DSM_TsfDfp_MSidCD_Select_C "Schwerezaehlergrenze fuer Fehlerpfad Dfp_MSidCD_Select" VALUE 0xCD73A Kw_Wu8 51000. TimeDsmTsf 0.00 51000. FORMAT "%5.0" /end CHARACTERISTIC
/begin CHARACTERISTIC DSM_TsfDfp_MeUnCDNoLoad_C "Schwerezaehlergrenze fuer Fehlerpfad Dfp_MeUnCDNoLoad" VALUE 0xCD73B Kw_Wu8 51000. TimeDsmTsf 0.00 51000. FORMAT "%5.0" /end CHARACTERISTIC
/begin CHARACTERISTIC DSM_TsfDfp_MeUnCDSCBat_C "Schwerezaehlergrenze fuer Fehlerpfad Dfp_MeUnCDSCBat" VALUE 0xCD73C Kw_Wu8 51000. TimeDsmTsf 0.00 51000. FORMAT "%5.0" /end CHARACTERISTIC
/begin CHARACTERISTIC DSM_TsfDfp_MeUnCDSCGnd_C "Schwerezaehlergrenze fuer Fehlerpfad Dfp_MeUnCDSCGnd" VALUE 0xCD73D Kw_Wu8 51000. TimeDsmTsf 0.00 51000. FORMAT "%5.0" /end CHARACTERISTIC
/begin CHARACTERISTIC DSM_TsfDfp_MeUnCD_ADC_C "Schwerezaehlergrenze fuer Fehlerpfad Dfp_MeUnCD_ADC" VALUE 0xCD73E Kw_Wu8 51000. TimeDsmTsf 0.00 51000. FORMAT "%5.0" /end CHARACTERISTIC
/begin CHARACTERISTIC DSM_TsfDfp_MeUnCD_SigTst_C "Schwerezaehlergrenze fuer Fehlerpfad Dfp_MeUnCD_SigTst" VALUE 0xCD73F Kw_Wu8 51000. TimeDsmTsf 0.00 51000. FORMAT "%5.0" /end CHARACTERISTIC
/begin CHARACTERISTIC DSM_TsfDfp_Montr_C "Schwerezaehlergrenze fuer Fehlerpfad Dfp_Montr" VALUE 0xCD740 Kw_Wu8 51000. TimeDsmTsf 0.00 51000. FORMAT "%5.0" /end CHARACTERISTIC
/begin CHARACTERISTIC DSM_TsfDfp_NetMngDeviceA_C "Schwerezaehlergrenze fuer Fehlerpfad Dfp_NetMngDeviceA" VALUE 0xCD741 Kw_Wu8 51000. TimeDsmTsf 0.00 51000. FORMAT "%5.0" /end CHARACTERISTIC
/begin CHARACTERISTIC DSM_TsfDfp_NetMngDeviceB_C "Schwerezaehlergrenze fuer Fehlerpfad Dfp_NetMngDeviceB" VALUE 0xCD742 Kw_Wu8 51000. TimeDsmTsf 0.00 51000. FORMAT "%5.0" /end CHARACTERISTIC
/begin CHARACTERISTIC DSM_TsfDfp_NetMngDeviceC_C "Schwerezaehlergrenze fuer Fehlerpfad Dfp_NetMngDeviceC" VALUE 0xCD743 Kw_Wu8 51000. TimeDsmTsf 0.00 51000. FORMAT "%5.0" /end CHARACTERISTIC
/begin CHARACTERISTIC DSM_TsfDfp_OPSCD_Lamp_C "Schwerezaehlergrenze fuer Fehlerpfad Dfp_OPSCD_Lamp" VALUE 0xCD744 Kw_Wu8 51000. TimeDsmTsf 0.00 51000. FORMAT "%5.0" /end CHARACTERISTIC
/begin CHARACTERISTIC DSM_TsfDfp_OPSCD_anain_C "Schwerezaehlergrenze fuer Fehlerpfad Dfp_OPSCD_anain" VALUE 0xCD745 Kw_Wu8 51000. TimeDsmTsf 0.00 51000. FORMAT "%5.0" /end CHARACTERISTIC
/begin CHARACTERISTIC DSM_TsfDfp_OTSCD_C "Schwerezaehlergrenze fuer Fehlerpfad Dfp_OTSCD" VALUE 0xCD746 Kw_Wu8 51000. TimeDsmTsf 0.00 51000. FORMAT "%5.0" /end CHARACTERISTIC
/begin CHARACTERISTIC DSM_TsfDfp_OvRMon_C "Schwerezaehlergrenze fuer Fehlerpfad Dfp_OvRMon" VALUE 0xCD747 Kw_Wu8 51000. TimeDsmTsf 0.00 51000. FORMAT "%5.0" /end CHARACTERISTIC
/begin CHARACTERISTIC DSM_TsfDfp_OvRMonBrk_C "Schwerezaehlergrenze fuer Fehlerpfad Dfp_OvRMonBrk" VALUE 0xCD748 Kw_Wu8 51000. TimeDsmTsf 0.00 51000. FORMAT "%5.0" /end CHARACTERISTIC
/begin CHARACTERISTIC DSM_TsfDfp_OvRMonSigA_C "Schwerezaehlergrenze fuer Fehlerpfad Dfp_OvRMonSigA" VALUE 0xCD749 Kw_Wu8 51000. TimeDsmTsf 0.00 51000. FORMAT "%5.0" /end CHARACTERISTIC
/begin CHARACTERISTIC DSM_TsfDfp_OxiCCDTPre_C "Schwerezaehlergrenze fuer Fehlerpfad Dfp_OxiCCDTPre" VALUE 0xCD74A Kw_Wu8 51000. TimeDsmTsf 0.00 51000. FORMAT "%5.0" /end CHARACTERISTIC
/begin CHARACTERISTIC DSM_TsfDfp_PCR_GovDevNeg_C "Schwerezaehlergrenze fuer Fehlerpfad Dfp_PCR_GovDevNeg" VALUE 0xCD74B Kw_Wu8 51000. TimeDsmTsf 0.00 51000. FORMAT "%5.0" /end CHARACTERISTIC
/begin CHARACTERISTIC DSM_TsfDfp_PCR_GovDevPos_C "Schwerezaehlergrenze fuer Fehlerpfad Dfp_PCR_GovDevPos" VALUE 0xCD74C Kw_Wu8 51000. TimeDsmTsf 0.00 51000. FORMAT "%5.0" /end CHARACTERISTIC
/begin CHARACTERISTIC DSM_TsfDfp_PCR_LPGvnrDvtNeg_C "Schwerezaehlergrenze fuer Fehlerpfad Dfp_PCR_LPGvnrDvtNeg" VALUE 0xCD74D Kw_Wu8 51000. TimeDsmTsf 0.00 51000. FORMAT "%5.0" /end CHARACTERISTIC
/begin CHARACTERISTIC DSM_TsfDfp_PCR_LPGvnrDvtPos_C "Schwerezaehlergrenze fuer Fehlerpfad Dfp_PCR_LPGvnrDvtPos" VALUE 0xCD74E Kw_Wu8 51000. TimeDsmTsf 0.00 51000. FORMAT "%5.0" /end CHARACTERISTIC
/begin CHARACTERISTIC DSM_TsfDfp_PCVCDNoLoad_C "Schwerezaehlergrenze fuer Fehlerpfad Dfp_PCVCDNoLoad" VALUE 0xCD74F Kw_Wu8 51000. TimeDsmTsf 0.00 51000. FORMAT "%5.0" /end CHARACTERISTIC
/begin CHARACTERISTIC DSM_TsfDfp_PCVCDSCBat_C "Schwerezaehlergrenze fuer Fehlerpfad Dfp_PCVCDSCBat" VALUE 0xCD750 Kw_Wu8 51000. TimeDsmTsf 0.00 51000. FORMAT "%5.0" /end CHARACTERISTIC
/begin CHARACTERISTIC DSM_TsfDfp_PCVCDSCGnd_C "Schwerezaehlergrenze fuer Fehlerpfad Dfp_PCVCDSCGnd" VALUE 0xCD751 Kw_Wu8 51000. TimeDsmTsf 0.00 51000. FORMAT "%5.0" /end CHARACTERISTIC
/begin CHARACTERISTIC DSM_TsfDfp_PCVCD_ADC_C "Schwerezaehlergrenze fuer Fehlerpfad Dfp_PCVCD_ADC" VALUE 0xCD752 Kw_Wu8 51000. TimeDsmTsf 0.00 51000. FORMAT "%5.0" /end CHARACTERISTIC
/begin CHARACTERISTIC DSM_TsfDfp_PCVCD_SigTst_C "Schwerezaehlergrenze fuer Fehlerpfad Dfp_PCVCD_SigTst" VALUE 0xCD753 Kw_Wu8 51000. TimeDsmTsf 0.00 51000. FORMAT "%5.0" /end CHARACTERISTIC
/begin CHARACTERISTIC DSM_TsfDfp_PFltAPSPlaus_C "Schwerezaehlergrenze fuer Fehlerpfad Dfp_PFltAPSPlaus" VALUE 0xCD754 Kw_Wu8 51000. TimeDsmTsf 0.00 51000. FORMAT "%5.0" /end CHARACTERISTIC
/begin CHARACTERISTIC DSM_TsfDfp_PFltAPSens_C "Schwerezaehlergrenze fuer Fehlerpfad Dfp_PFltAPSens" VALUE 0xCD755 Kw_Wu8 51000. TimeDsmTsf 0.00 51000. FORMAT "%5.0" /end CHARACTERISTIC
/begin CHARACTERISTIC DSM_TsfDfp_PFltBPSPlaus_C "Schwerezaehlergrenze fuer Fehlerpfad Dfp_PFltBPSPlaus" VALUE 0xCD756 Kw_Wu8 51000. TimeDsmTsf 0.00 51000. FORMAT "%5.0" /end CHARACTERISTIC
/begin CHARACTERISTIC DSM_TsfDfp_PFltCDPPre_C "Schwerezaehlergrenze fuer Fehlerpfad Dfp_PFltCDPPre" VALUE 0xCD757 Kw_Wu8 51000. TimeDsmTsf 0.00 51000. FORMAT "%5.0" /end CHARACTERISTIC
/begin CHARACTERISTIC DSM_TsfDfp_PFltCDTempPre_C "Schwerezaehlergrenze fuer Fehlerpfad Dfp_PFltCDTempPre" VALUE 0xCD758 Kw_Wu8 51000. TimeDsmTsf 0.00 51000. FORMAT "%5.0" /end CHARACTERISTIC
/begin CHARACTERISTIC DSM_TsfDfp_PFltChar_C "Schwerezaehlergrenze fuer Fehlerpfad Dfp_PFltChar" VALUE 0xCD759 Kw_Wu8 51000. TimeDsmTsf 0.00 51000. FORMAT "%5.0" /end CHARACTERISTIC
/begin CHARACTERISTIC DSM_TsfDfp_PFltEngPrt_C "Schwerezaehlergrenze fuer Fehlerpfad Dfp_PFltEngPrt" VALUE 0xCD75A Kw_Wu8 51000. TimeDsmTsf 0.00 51000. FORMAT "%5.0" /end CHARACTERISTIC
/begin CHARACTERISTIC DSM_TsfDfp_PFltPresDynPlaus_C "Schwerezaehlergrenze fuer Fehlerpfad Dfp_PFltPresDynPlaus" VALUE 0xCD75B Kw_Wu8 51000. TimeDsmTsf 0.00 51000. FORMAT "%5.0" /end CHARACTERISTIC
/begin CHARACTERISTIC DSM_TsfDfp_PFltPresPlaus_C "Schwerezaehlergrenze fuer Fehlerpfad Dfp_PFltPresPlaus" VALUE 0xCD75C Kw_Wu8 51000. TimeDsmTsf 0.00 51000. FORMAT "%5.0" /end CHARACTERISTIC
/begin CHARACTERISTIC DSM_TsfDfp_PFltPresSens_C "Schwerezaehlergrenze fuer Fehlerpfad Dfp_PFltPresSens" VALUE 0xCD75D Kw_Wu8 51000. TimeDsmTsf 0.00 51000. FORMAT "%5.0" /end CHARACTERISTIC
/begin CHARACTERISTIC DSM_TsfDfp_PFltPresSensFrz_C "Schwerezaehlergrenze fuer Fehlerpfad Dfp_PFltPresSensFrz" VALUE 0xCD75E Kw_Wu8 51000. TimeDsmTsf 0.00 51000. FORMAT "%5.0" /end CHARACTERISTIC
/begin CHARACTERISTIC DSM_TsfDfp_PFltPresSensHsLn_C "Schwerezaehlergrenze fuer Fehlerpfad Dfp_PFltPresSensHsLn" VALUE 0xCD75F Kw_Wu8 51000. TimeDsmTsf 0.00 51000. FORMAT "%5.0" /end CHARACTERISTIC
/begin CHARACTERISTIC DSM_TsfDfp_PFltPresSensSot_C "Schwerezaehlergrenze fuer Fehlerpfad Dfp_PFltPresSensSot" VALUE 0xCD760 Kw_Wu8 51000. TimeDsmTsf 0.00 51000. FORMAT "%5.0" /end CHARACTERISTIC
/begin CHARACTERISTIC DSM_TsfDfp_PFltRgnPerm_C "Schwerezaehlergrenze fuer Fehlerpfad Dfp_PFltRgnPerm" VALUE 0xCD761 Kw_Wu8 51000. TimeDsmTsf 0.00 51000. FORMAT "%5.0" /end CHARACTERISTIC
/begin CHARACTERISTIC DSM_TsfDfp_PFltTempDwnStrm_C "Schwerezaehlergrenze fuer Fehlerpfad Dfp_PFltTempDwnStrm" VALUE 0xCD762 Kw_Wu8 51000. TimeDsmTsf 0.00 51000. FORMAT "%5.0" /end CHARACTERISTIC
/begin CHARACTERISTIC DSM_TsfDfp_PFltTempSens_C "Schwerezaehlergrenze fuer Fehlerpfad Dfp_PFltTempSens" VALUE 0xCD763 Kw_Wu8 51000. TimeDsmTsf 0.00 51000. FORMAT "%5.0" /end CHARACTERISTIC
/begin CHARACTERISTIC DSM_TsfDfp_PFltTempUpStrm_C "Schwerezaehlergrenze fuer Fehlerpfad Dfp_PFltTempUpStrm" VALUE 0xCD764 Kw_Wu8 51000. TimeDsmTsf 0.00 51000. FORMAT "%5.0" /end CHARACTERISTIC
/begin CHARACTERISTIC DSM_TsfDfp_PFltmSotDiffMax_C "Schwerezaehlergrenze fuer Fehlerpfad Dfp_PFltmSotDiffMax" VALUE 0xCD765 Kw_Wu8 51000. TimeDsmTsf 0.00 51000. FORMAT "%5.0" /end CHARACTERISTIC
/begin CHARACTERISTIC DSM_TsfDfp_PSPCD_Actr_C "Schwerezaehlergrenze fuer Fehlerpfad Dfp_PSPCD_Actr" VALUE 0xCD766 Kw_Wu8 51000. TimeDsmTsf 0.00 51000. FORMAT "%5.0" /end CHARACTERISTIC
/begin CHARACTERISTIC DSM_TsfDfp_PresPlausDblDef_C "Schwerezaehlergrenze fuer Fehlerpfad Dfp_PresPlausDblDef" VALUE 0xCD767 Kw_Wu8 51000. TimeDsmTsf 0.00 51000. FORMAT "%5.0" /end CHARACTERISTIC
/begin CHARACTERISTIC DSM_TsfDfp_QLTCD_C "Schwerezaehlergrenze fuer Fehlerpfad Dfp_QLTCD" VALUE 0xCD768 Kw_Wu8 51000. TimeDsmTsf 0.00 51000. FORMAT "%5.0" /end CHARACTERISTIC
/begin CHARACTERISTIC DSM_TsfDfp_RailCD_C "Schwerezaehlergrenze fuer Fehlerpfad Dfp_RailCD" VALUE 0xCD769 Kw_Wu8 51000. TimeDsmTsf 0.00 51000. FORMAT "%5.0" /end CHARACTERISTIC
/begin CHARACTERISTIC DSM_TsfDfp_RailCDOfsTst_C "Schwerezaehlergrenze fuer Fehlerpfad Dfp_RailCDOfsTst" VALUE 0xCD76A Kw_Wu8 51000. TimeDsmTsf 0.00 51000. FORMAT "%5.0" /end CHARACTERISTIC
/begin CHARACTERISTIC DSM_TsfDfp_RailCD_PMonStrt_C "Schwerezaehlergrenze fuer Fehlerpfad Dfp_RailCD_PMonStrt" VALUE 0xCD76B Kw_Wu8 51000. TimeDsmTsf 0.00 51000. FORMAT "%5.0" /end CHARACTERISTIC
/begin CHARACTERISTIC DSM_TsfDfp_RailCtlModeMeUnDiag_C "Schwerezaehlergrenze fuer Fehlerpfad Dfp_RailCtlModeMeUnDiag" VALUE 0xCD76C Kw_Wu8 51000. TimeDsmTsf 0.00 51000. FORMAT "%5.0" /end CHARACTERISTIC
/begin CHARACTERISTIC DSM_TsfDfp_RailCtlModePCVDiag_C "Schwerezaehlergrenze fuer Fehlerpfad Dfp_RailCtlModePCVDiag" VALUE 0xCD76D Kw_Wu8 51000. TimeDsmTsf 0.00 51000. FORMAT "%5.0" /end CHARACTERISTIC
/begin CHARACTERISTIC DSM_TsfDfp_RailMeUn0_C "Schwerezaehlergrenze fuer Fehlerpfad Dfp_RailMeUn0" VALUE 0xCD76E Kw_Wu8 51000. TimeDsmTsf 0.00 51000. FORMAT "%5.0" /end CHARACTERISTIC
/begin CHARACTERISTIC DSM_TsfDfp_RailMeUn1_C "Schwerezaehlergrenze fuer Fehlerpfad Dfp_RailMeUn1" VALUE 0xCD76F Kw_Wu8 51000. TimeDsmTsf 0.00 51000. FORMAT "%5.0" /end CHARACTERISTIC
/begin CHARACTERISTIC DSM_TsfDfp_RailMeUn2_C "Schwerezaehlergrenze fuer Fehlerpfad Dfp_RailMeUn2" VALUE 0xCD770 Kw_Wu8 51000. TimeDsmTsf 0.00 51000. FORMAT "%5.0" /end CHARACTERISTIC
/begin CHARACTERISTIC DSM_TsfDfp_RailMeUn3_C "Schwerezaehlergrenze fuer Fehlerpfad Dfp_RailMeUn3" VALUE 0xCD771 Kw_Wu8 51000. TimeDsmTsf 0.00 51000. FORMAT "%5.0" /end CHARACTERISTIC
/begin CHARACTERISTIC DSM_TsfDfp_RailMeUn4_C "Schwerezaehlergrenze fuer Fehlerpfad Dfp_RailMeUn4" VALUE 0xCD772 Kw_Wu8 51000. TimeDsmTsf 0.00 51000. FORMAT "%5.0" /end CHARACTERISTIC
/begin CHARACTERISTIC DSM_TsfDfp_RailPCV0_C "Schwerezaehlergrenze fuer Fehlerpfad Dfp_RailPCV0" VALUE 0xCD773 Kw_Wu8 51000. TimeDsmTsf 0.00 51000. FORMAT "%5.0" /end CHARACTERISTIC
/begin CHARACTERISTIC DSM_TsfDfp_RailPCV1_C "Schwerezaehlergrenze fuer Fehlerpfad Dfp_RailPCV1" VALUE 0xCD774 Kw_Wu8 51000. TimeDsmTsf 0.00 51000. FORMAT "%5.0" /end CHARACTERISTIC
/begin CHARACTERISTIC DSM_TsfDfp_RailPCV2_C "Schwerezaehlergrenze fuer Fehlerpfad Dfp_RailPCV2" VALUE 0xCD775 Kw_Wu8 51000. TimeDsmTsf 0.00 51000. FORMAT "%5.0" /end CHARACTERISTIC
/begin CHARACTERISTIC DSM_TsfDfp_RailPCV3_C "Schwerezaehlergrenze fuer Fehlerpfad Dfp_RailPCV3" VALUE 0xCD776 Kw_Wu8 51000. TimeDsmTsf 0.00 51000. FORMAT "%5.0" /end CHARACTERISTIC
/begin CHARACTERISTIC DSM_TsfDfp_RailPCV4_C "Schwerezaehlergrenze fuer Fehlerpfad Dfp_RailPCV4" VALUE 0xCD777 Kw_Wu8 51000. TimeDsmTsf 0.00 51000. FORMAT "%5.0" /end CHARACTERISTIC
/begin CHARACTERISTIC DSM_TsfDfp_RailPCV5_C "Schwerezaehlergrenze fuer Fehlerpfad Dfp_RailPCV5" VALUE 0xCD778 Kw_Wu8 51000. TimeDsmTsf 0.00 51000. FORMAT "%5.0" /end CHARACTERISTIC
/begin CHARACTERISTIC DSM_TsfDfp_SOPTst_C "Schwerezaehlergrenze fuer Fehlerpfad Dfp_SOPTst" VALUE 0xCD779 Kw_Wu8 51000. TimeDsmTsf 0.00 51000. FORMAT "%5.0" /end CHARACTERISTIC
/begin CHARACTERISTIC DSM_TsfDfp_SSpMon1_C "Schwerezaehlergrenze fuer Fehlerpfad Dfp_SSpMon1" VALUE 0xCD77A Kw_Wu8 51000. TimeDsmTsf 0.00 51000. FORMAT "%5.0" /end CHARACTERISTIC
/begin CHARACTERISTIC DSM_TsfDfp_SSpMon2_C "Schwerezaehlergrenze fuer Fehlerpfad Dfp_SSpMon2" VALUE 0xCD77B Kw_Wu8 51000. TimeDsmTsf 0.00 51000. FORMAT "%5.0" /end CHARACTERISTIC
/begin CHARACTERISTIC DSM_TsfDfp_SSpMon3_C "Schwerezaehlergrenze fuer Fehlerpfad Dfp_SSpMon3" VALUE 0xCD77C Kw_Wu8 51000. TimeDsmTsf 0.00 51000. FORMAT "%5.0" /end CHARACTERISTIC
/begin CHARACTERISTIC DSM_TsfDfp_SWChk_CycSigChkDat_C "Schwerezaehlergrenze fuer Fehlerpfad Dfp_SWChk_CycSigChkDat" VALUE 0xCD77D Kw_Wu8 51000. TimeDsmTsf 0.00 51000. FORMAT "%5.0" /end CHARACTERISTIC
/begin CHARACTERISTIC DSM_TsfDfp_SWChk_CycSigChkPrg_C "Schwerezaehlergrenze fuer Fehlerpfad Dfp_SWChk_CycSigChkPrg" VALUE 0xCD77E Kw_Wu8 51000. TimeDsmTsf 0.00 51000. FORMAT "%5.0" /end CHARACTERISTIC
/begin CHARACTERISTIC DSM_TsfDfp_ShutCD_C "Schwerezaehlergrenze fuer Fehlerpfad Dfp_ShutCD" VALUE 0xCD77F Kw_Wu8 51000. TimeDsmTsf 0.00 51000. FORMAT "%5.0" /end CHARACTERISTIC
/begin CHARACTERISTIC DSM_TsfDfp_ShutCDMax_C "Schwerezaehlergrenze fuer Fehlerpfad Dfp_ShutCDMax" VALUE 0xCD780 Kw_Wu8 51000. TimeDsmTsf 0.00 51000. FORMAT "%5.0" /end CHARACTERISTIC
/begin CHARACTERISTIC DSM_TsfDfp_ShutCDMin_C "Schwerezaehlergrenze fuer Fehlerpfad Dfp_ShutCDMin" VALUE 0xCD781 Kw_Wu8 51000. TimeDsmTsf 0.00 51000. FORMAT "%5.0" /end CHARACTERISTIC
/begin CHARACTERISTIC DSM_TsfDfp_ShutCDSigNpl_C "Schwerezaehlergrenze fuer Fehlerpfad Dfp_ShutCDSigNpl" VALUE 0xCD782 Kw_Wu8 51000. TimeDsmTsf 0.00 51000. FORMAT "%5.0" /end CHARACTERISTIC
/begin CHARACTERISTIC DSM_TsfDfp_StSysTrqShutOff_C "Schwerezaehlergrenze fuer Fehlerpfad Dfp_StSysTrqShutOff" VALUE 0xCD783 Kw_Wu8 51000. TimeDsmTsf 0.00 51000. FORMAT "%5.0" /end CHARACTERISTIC
/begin CHARACTERISTIC DSM_TsfDfp_StrtCD_Actr_C "Schwerezaehlergrenze fuer Fehlerpfad Dfp_StrtCD_Actr" VALUE 0xCD784 Kw_Wu8 51000. TimeDsmTsf 0.00 51000. FORMAT "%5.0" /end CHARACTERISTIC
/begin CHARACTERISTIC DSM_TsfDfp_SysLamp_C "Schwerezaehlergrenze fuer Fehlerpfad Dfp_SysLamp" VALUE 0xCD785 Kw_Wu8 51000. TimeDsmTsf 0.00 51000. FORMAT "%5.0" /end CHARACTERISTIC
/begin CHARACTERISTIC DSM_TsfDfp_T15CD_C "Schwerezaehlergrenze fuer Fehlerpfad Dfp_T15CD" VALUE 0xCD786 Kw_Wu8 51000. TimeDsmTsf 0.00 51000. FORMAT "%5.0" /end CHARACTERISTIC
/begin CHARACTERISTIC DSM_TsfDfp_TGearbx_C "Schwerezaehlergrenze fuer Fehlerpfad Dfp_TGearbx" VALUE 0xCD787 Kw_Wu8 51000. TimeDsmTsf 0.00 51000. FORMAT "%5.0" /end CHARACTERISTIC
/begin CHARACTERISTIC DSM_TsfDfp_TPUMon_C "Schwerezaehlergrenze fuer Fehlerpfad Dfp_TPUMon" VALUE 0xCD788 Kw_Wu8 51000. TimeDsmTsf 0.00 51000. FORMAT "%5.0" /end CHARACTERISTIC
/begin CHARACTERISTIC DSM_TsfDfp_TVACD_Max_C "Schwerezaehlergrenze fuer Fehlerpfad Dfp_TVACD_Max" VALUE 0xCD789 Kw_Wu8 51000. TimeDsmTsf 0.00 51000. FORMAT "%5.0" /end CHARACTERISTIC
/begin CHARACTERISTIC DSM_TsfDfp_TVACD_Min_C "Schwerezaehlergrenze fuer Fehlerpfad Dfp_TVACD_Min" VALUE 0xCD78A Kw_Wu8 51000. TimeDsmTsf 0.00 51000. FORMAT "%5.0" /end CHARACTERISTIC
/begin CHARACTERISTIC DSM_TsfDfp_TVACD_SigNpl_C "Schwerezaehlergrenze fuer Fehlerpfad Dfp_TVACD_SigNpl" VALUE 0xCD78B Kw_Wu8 51000. TimeDsmTsf 0.00 51000. FORMAT "%5.0" /end CHARACTERISTIC
/begin CHARACTERISTIC DSM_TsfDfp_TVACD_TVADia1_C "Schwerezaehlergrenze fuer Fehlerpfad Dfp_TVACD_TVADia1" VALUE 0xCD78C Kw_Wu8 51000. TimeDsmTsf 0.00 51000. FORMAT "%5.0" /end CHARACTERISTIC
/begin CHARACTERISTIC DSM_TsfDfp_TVACD_TVADia2_C "Schwerezaehlergrenze fuer Fehlerpfad Dfp_TVACD_TVADia2" VALUE 0xCD78D Kw_Wu8 51000. TimeDsmTsf 0.00 51000. FORMAT "%5.0" /end CHARACTERISTIC
/begin CHARACTERISTIC DSM_TsfDfp_TVACD_TVADia3_C "Schwerezaehlergrenze fuer Fehlerpfad Dfp_TVACD_TVADia3" VALUE 0xCD78E Kw_Wu8 51000. TimeDsmTsf 0.00 51000. FORMAT "%5.0" /end CHARACTERISTIC
/begin CHARACTERISTIC DSM_TsfDfp_TVACD_TVADia4_C "Schwerezaehlergrenze fuer Fehlerpfad Dfp_TVACD_TVADia4" VALUE 0xCD78F Kw_Wu8 51000. TimeDsmTsf 0.00 51000. FORMAT "%5.0" /end CHARACTERISTIC
/begin CHARACTERISTIC DSM_TsfDfp_VSACD_DioInDia1_C "Schwerezaehlergrenze fuer Fehlerpfad Dfp_VSACD_DioInDia1" VALUE 0xCD790 Kw_Wu8 51000. TimeDsmTsf 0.00 51000. FORMAT "%5.0" /end CHARACTERISTIC
/begin CHARACTERISTIC DSM_TsfDfp_VSACD_DioInDia2_C "Schwerezaehlergrenze fuer Fehlerpfad Dfp_VSACD_DioInDia2" VALUE 0xCD791 Kw_Wu8 51000. TimeDsmTsf 0.00 51000. FORMAT "%5.0" /end CHARACTERISTIC
/begin CHARACTERISTIC DSM_TsfDfp_VSACD_DioInDia3_C "Schwerezaehlergrenze fuer Fehlerpfad Dfp_VSACD_DioInDia3" VALUE 0xCD792 Kw_Wu8 51000. TimeDsmTsf 0.00 51000. FORMAT "%5.0" /end CHARACTERISTIC
/begin CHARACTERISTIC DSM_TsfDfp_VSACD_DioInDia4_C "Schwerezaehlergrenze fuer Fehlerpfad Dfp_VSACD_DioInDia4" VALUE 0xCD793 Kw_Wu8 51000. TimeDsmTsf 0.00 51000. FORMAT "%5.0" /end CHARACTERISTIC
/begin CHARACTERISTIC DSM_TsfDfp_VSACD_DioInMin_C "Schwerezaehlergrenze fuer Fehlerpfad Dfp_VSACD_DioInMin" VALUE 0xCD794 Kw_Wu8 51000. TimeDsmTsf 0.00 51000. FORMAT "%5.0" /end CHARACTERISTIC
/begin CHARACTERISTIC DSM_TsfDfp_VSACD_Max_C "Schwerezaehlergrenze fuer Fehlerpfad Dfp_VSACD_Max" VALUE 0xCD795 Kw_Wu8 51000. TimeDsmTsf 0.00 51000. FORMAT "%5.0" /end CHARACTERISTIC
/begin CHARACTERISTIC DSM_TsfDfp_VSACD_Min_C "Schwerezaehlergrenze fuer Fehlerpfad Dfp_VSACD_Min" VALUE 0xCD796 Kw_Wu8 51000. TimeDsmTsf 0.00 51000. FORMAT "%5.0" /end CHARACTERISTIC
/begin CHARACTERISTIC DSM_TsfDfp_VSACD_SigNpl_C "Schwerezaehlergrenze fuer Fehlerpfad Dfp_VSACD_SigNpl" VALUE 0xCD797 Kw_Wu8 51000. TimeDsmTsf 0.00 51000. FORMAT "%5.0" /end CHARACTERISTIC
/begin CHARACTERISTIC DSM_TsfDfp_VSACD_VSADia1_C "Schwerezaehlergrenze fuer Fehlerpfad Dfp_VSACD_VSADia1" VALUE 0xCD798 Kw_Wu8 51000. TimeDsmTsf 0.00 51000. FORMAT "%5.0" /end CHARACTERISTIC
/begin CHARACTERISTIC DSM_TsfDfp_VSACD_VSADia2_C "Schwerezaehlergrenze fuer Fehlerpfad Dfp_VSACD_VSADia2" VALUE 0xCD799 Kw_Wu8 51000. TimeDsmTsf 0.00 51000. FORMAT "%5.0" /end CHARACTERISTIC
/begin CHARACTERISTIC DSM_TsfDfp_VSACD_VSADia3_C "Schwerezaehlergrenze fuer Fehlerpfad Dfp_VSACD_VSADia3" VALUE 0xCD79A Kw_Wu8 51000. TimeDsmTsf 0.00 51000. FORMAT "%5.0" /end CHARACTERISTIC
/begin CHARACTERISTIC DSM_TsfDfp_VSACD_VSADia4_C "Schwerezaehlergrenze fuer Fehlerpfad Dfp_VSACD_VSADia4" VALUE 0xCD79B Kw_Wu8 51000. TimeDsmTsf 0.00 51000. FORMAT "%5.0" /end CHARACTERISTIC
/begin CHARACTERISTIC DSM_TsfDfp_VSSCD1_C "Schwerezaehlergrenze fuer Fehlerpfad Dfp_VSSCD1" VALUE 0xCD79C Kw_Wu8 51000. TimeDsmTsf 0.00 51000. FORMAT "%5.0" /end CHARACTERISTIC
/begin CHARACTERISTIC DSM_TsfDfp_VSSCD2_C "Schwerezaehlergrenze fuer Fehlerpfad Dfp_VSSCD2" VALUE 0xCD79D Kw_Wu8 51000. TimeDsmTsf 0.00 51000. FORMAT "%5.0" /end CHARACTERISTIC
/begin CHARACTERISTIC DSM_TsfDfp_WdCom_C "Schwerezaehlergrenze fuer Fehlerpfad Dfp_WdCom" VALUE 0xCD79E Kw_Wu8 51000. TimeDsmTsf 0.00 51000. FORMAT "%5.0" /end CHARACTERISTIC
/begin CHARACTERISTIC EATSCD_uSRCMin_C "SRC Minimum Umgebungstemperatur" VALUE 0xCD7AC Kw_Ws16 5200.391 Volt 0.00 5200.391 FORMAT "%8.3" EXTENDED_LIMITS -160156.4 160151.5 /end CHARACTERISTIC
/begin CHARACTERISTIC EATSCD_uSRCMax_C "SRC Maximum Umgebungstemperatur" VALUE 0xCD7AE Kw_Ws16 5200.391 Volt 0.00 5200.391 FORMAT "%8.3" EXTENDED_LIMITS -160156.4 160151.5 /end CHARACTERISTIC
/begin CHARACTERISTIC EATSCD_tLin_CUR "Linearisierungskennlinie der Umgebungstemperatur" CURVE 0xCD7B0 Kl_Xs16_Ws16 950.0000 Temp_Cels -50.1400 899.8600 FORMAT "%8.4" EXTENDED_LIMITS -3549.940 3003.560
 /begin AXIS_DESCR STD_AXIS EATSCD_uRaw Volt 25 0.00 5200.391 FORMAT "%8.3" EXTENDED_LIMITS -160156.4 160151.5 DEPOSIT ABSOLUTE /end AXIS_DESCR
/end CHARACTERISTIC
/begin CHARACTERISTIC EATSCD_DebSigDef_C "Entprellzeit defekt CAN Signal Fehler Umgebungstemperatur" VALUE 0xCD816 Kw_Wu16 655350.0 Time_ms 0.00 655350.0 FORMAT "%8.1" /end CHARACTERISTIC
/begin CHARACTERISTIC EATSCD_DebSigOk_C "Heilungsentprellzeit CAN Signalfehler Umgebungstemperatur" VALUE 0xCD818 Kw_Wu16 655350.0 Time_ms 0.00 655350.0 FORMAT "%8.1" /end CHARACTERISTIC
/begin CHARACTERISTIC EATSCD_DebSRCHighDef_C "EATS Fehlerentprellungszeit fuer SRC-High" VALUE 0xCD81A Kw_Wu16 655350.0 Time_ms 0.00 655350.0 FORMAT "%8.1" /end CHARACTERISTIC
/begin CHARACTERISTIC EATSCD_DebSRCHighOk_C "EATS Heilungsentprellzeit fuer SRC-High" VALUE 0xCD81C Kw_Wu16 655350.0 Time_ms 0.00 655350.0 FORMAT "%8.1" /end CHARACTERISTIC
/begin CHARACTERISTIC EATSCD_DebSRCLowDef_C "EATS Fehlerentprellungszeit fuer SRC-Low" VALUE 0xCD81E Kw_Wu16 655350.0 Time_ms 0.00 655350.0 FORMAT "%8.1" /end CHARACTERISTIC
/begin CHARACTERISTIC EATSCD_DebSRCLowOk_C "EATS Heilungsentprellzeit fuer SRC-Low" VALUE 0xCD820 Kw_Wu16 655350.0 Time_ms 0.00 655350.0 FORMAT "%8.1" /end CHARACTERISTIC
/begin CHARACTERISTIC EATSCD_dtRmpSubs_C "Rampensteigung für Umgebungstemperatur" VALUE 0xCD824 Kw_Wu32 6553.59899750 RmpTempCels 0.00100097656250 6553.59999847 FORMAT "%13.8" EXTENDED_LIMITS 0.00 6553.59999847 /end CHARACTERISTIC
/begin CHARACTERISTIC EATSCD_dtRmpSubsUp_C "Rampensteigung für Umschaltung der Umgebungstemperatur" VALUE 0xCD828 Kw_Wu32 6553.59899750 RmpTempCels 0.00100097656250 6553.59999847 FORMAT "%13.8" EXTENDED_LIMITS 0.00 6553.59999847 /end CHARACTERISTIC
/begin CHARACTERISTIC EATSCD_dtRmpSubsDwn_C "Rampensteigung für Umschaltung der Umgebungstemperatur" VALUE 0xCD82C Kw_Wu32 6553.59899750 RmpTempCels 0.00100097656250 6553.59999847 FORMAT "%13.8" EXTENDED_LIMITS 0.00 6553.59999847 /end CHARACTERISTIC
/begin CHARACTERISTIC EATSCD_numAdc_C "#SSD Applikationsparameter fuer Umgebungslufttemperatur-Fuhehler" VALUE 0xCD830 Kw_Wu8 26.0000000000 NumPinAdc 0.00 26.0000000000 FORMAT "%13.10" /end CHARACTERISTIC
/begin CHARACTERISTIC EATSCD_dtRmpSlpUp_C "popsitive Rampensteigung" VALUE 0xCD834 Kw_Wu32 6553598.99749 RmpTemp 1.00097656250 6553599.99847 FORMAT "%13.5" EXTENDED_LIMITS 0.00 6553599.99847 /end CHARACTERISTIC
/begin CHARACTERISTIC EATSCD_dtRmpSlpDwn_C "negative Rampensteigung" VALUE 0xCD838 Kw_Wu32 6553598.99749 RmpTemp 1.00097656250 6553599.99847 FORMAT "%13.5" EXTENDED_LIMITS 0.00 6553599.99847 /end CHARACTERISTIC
/begin CHARACTERISTIC EATSCD_swtSensImpl_C "Schalter zur Auswahl der Umgebungstemperatur (0: Umgebungsluft- Sensor, 1: Ersatztemperatur, default: Ansauglufttemperatur)" VALUE 0xCD83C Kw_Wu8 2.000 OneToOne 0.00 2.000 FORMAT "%5.3" EXTENDED_LIMITS 0.00 255.0 /end CHARACTERISTIC
/begin CHARACTERISTIC EATSCD_swtSigVal_C "Datensatzwert Signalquelle Umgebungsluftemperatur (0 = ADC, 1 = CAN)" VALUE 0xCD83D Kw_Wu8 1.000 OneToOne 0.00 1.000 FORMAT "%5.3" EXTENDED_LIMITS 0.00 255.0 /end CHARACTERISTIC
/begin CHARACTERISTIC EATSCD_tAirSubs_C "Ersatzwert für Umgebungstemperatur" VALUE 0xCD83E Kw_Ws16 250.0000 Temp_Cels -50.14000 199.8600 FORMAT "%8.4" EXTENDED_LIMITS -3549.940 3003.560 /end CHARACTERISTIC
/begin CHARACTERISTIC EATSCD_stSensIDWord_C "Geberkennwort Umgebungstemperatur" VALUE 0xCD840 Kw_Wu16 65535.00 OneToOne 0.00 65535.00 FORMAT "%8.2" /end CHARACTERISTIC
/begin CHARACTERISTIC EATSCD_tDfl_C "Vorgabewert Umgebungstemperatur" VALUE 0xCD842 Kw_Ws16 950.0000 Temp_Cels -50.1400 899.8600 FORMAT "%8.4" EXTENDED_LIMITS -3549.940 3003.560 /end CHARACTERISTIC
/begin CHARACTERISTIC EBAFCD_ctPwrStgOnMax_C "Maximaler Zähler für Powerstage On im Fehlerfall" VALUE 0xCD844 Kw_Wu16 65535.00 OneToOne 0.00 65535.00 FORMAT "%8.2" /end CHARACTERISTIC
/begin CHARACTERISTIC EBAFCD_DebExcTempDef_C "Defect time for EXC_TEMP error" VALUE 0xCD846 Kw_Wu16 655350.0 Time_ms 0.00 655350.0 FORMAT "%8.1" /end CHARACTERISTIC
/begin CHARACTERISTIC EBAFCD_DebExcTempOk_C "Healing time for EXC_TEMP error" VALUE 0xCD848 Kw_Wu16 655350.0 Time_ms 0.00 655350.0 FORMAT "%8.1" /end CHARACTERISTIC
/begin CHARACTERISTIC EBAFCD_DebNoLoadDef_C "Defect time for NO_LOAD error" VALUE 0xCD84A Kw_Wu16 655350.0 Time_ms 0.00 655350.0 FORMAT "%8.1" /end CHARACTERISTIC
/begin CHARACTERISTIC EBAFCD_DebNoLoadOk_C "Healing time for NO_LOAD error" VALUE 0xCD84C Kw_Wu16 655350.0 Time_ms 0.00 655350.0 FORMAT "%8.1" /end CHARACTERISTIC
/begin CHARACTERISTIC EBAFCD_DebShortCircBatDef_C "Defect time for SHORT_CIRC_BAT error" VALUE 0xCD84E Kw_Wu16 655350.0 Time_ms 0.00 655350.0 FORMAT "%8.1" /end CHARACTERISTIC
/begin CHARACTERISTIC EBAFCD_DebShortCircBatOk_C "Healing time for SHORT_CIRC_BAT error" VALUE 0xCD850 Kw_Wu16 655350.0 Time_ms 0.00 655350.0 FORMAT "%8.1" /end CHARACTERISTIC
/begin CHARACTERISTIC EBAFCD_DebShortCircGndDef_C "Defect time for SHORT_CIRC_GND error" VALUE 0xCD852 Kw_Wu16 655350.0 Time_ms 0.00 655350.0 FORMAT "%8.1" /end CHARACTERISTIC
/begin CHARACTERISTIC EBAFCD_DebShortCircGndOk_C "Healing time for SHORT_CIRC_GND error" VALUE 0xCD854 Kw_Wu16 655350.0 Time_ms 0.00 655350.0 FORMAT "%8.1" /end CHARACTERISTIC
/begin CHARACTERISTIC EBAFCD_InvSigOut_C "status word for (non)/inverting output EBAFCD_stSigOut" VALUE 0xCD856 Kw_Wu8 255.0 OneToOne 0.00 255.0 FORMAT "%5.1" /end CHARACTERISTIC
/begin CHARACTERISTIC EBAFCD_nFan_C "minimum rpm of fan to disable outout" VALUE 0xCD858 Kw_Ws16 6000.092 FanSpd -3000.092 3000.000 FORMAT "%8.3" /end CHARACTERISTIC
/begin CHARACTERISTIC EBAFCD_numDiaOut_C "#SSD Request of test of power stage from tester" VALUE 0xCD85A Kw_Wu8 27.0000000000 NumPinDia 0.00 27.0000000000 FORMAT "%13.10" /end CHARACTERISTIC
/begin CHARACTERISTIC EBAFCD_numDioOut_C "#SSD Selection of power stage" VALUE 0xCD85B Kw_Wu8 11.0000000000 NumPinDioOut 0.00 11.0000000000 FORMAT "%13.10" /end CHARACTERISTIC
/begin CHARACTERISTIC EBAFCD_stSPICtl_C "Schalter ob Endstufe SPI kontrollierbar = 1 oder nicht SPI kontrollierbar = 0" VALUE 0xCD85C Kw_Wu8 1.000 OneToOne 0.00 1.000 FORMAT "%5.3" EXTENDED_LIMITS 0.00 255.0 /end CHARACTERISTIC
/begin CHARACTERISTIC EBAFCD_tClntTrMin_C "threshold low engine protection pressure hysteresis" VALUE 0xCD85E Kw_Ws16 950.000 Temp_Cels -50.140 899.860 FORMAT "%8.3" EXTENDED_LIMITS -3549.940 3003.560 /end CHARACTERISTIC
/begin CHARACTERISTIC EBAFCD_tClntTrMax_C "threshold high engine protection pressure hysteresis" VALUE 0xCD860 Kw_Ws16 950.000 Temp_Cels -50.140 899.860 FORMAT "%8.3" EXTENDED_LIMITS -3549.940 3003.560 /end CHARACTERISTIC
/begin CHARACTERISTIC EBAFCD_sttClntTrOff_C "engine protection off" VALUE 0xCD862 Kw_Ws16 65535.00 OneToOne -32768.00 32767.00 FORMAT "%8.2" READ_ONLY /end CHARACTERISTIC
/begin CHARACTERISTIC EBAFCD_sttClntTrOn_C "engine protection on" VALUE 0xCD864 Kw_Ws16 65535.00 OneToOne -32768.00 32767.00 FORMAT "%8.2" READ_ONLY /end CHARACTERISTIC
/begin CHARACTERISTIC EBAFCD_tClntMin_C "threshold low engine protection pressure hysteresis" VALUE 0xCD866 Kw_Ws16 950.000 Temp_Cels -50.140 899.860 FORMAT "%8.3" EXTENDED_LIMITS -3549.940 3003.560 /end CHARACTERISTIC
/begin CHARACTERISTIC EBAFCD_tClntMax_C "threshold high engine protection pressure hysteresis" VALUE 0xCD868 Kw_Ws16 950.000 Temp_Cels -50.140 899.860 FORMAT "%8.3" EXTENDED_LIMITS -3549.940 3003.560 /end CHARACTERISTIC
/begin CHARACTERISTIC EBAFCD_sttClntOff_C "engine protection off" VALUE 0xCD86A Kw_Ws16 65535.00 OneToOne -32768.00 32767.00 FORMAT "%8.2" READ_ONLY /end CHARACTERISTIC
/begin CHARACTERISTIC EBAFCD_sttClntOn_C "engine protection on" VALUE 0xCD86C Kw_Ws16 65535.00 OneToOne -32768.00 32767.00 FORMAT "%8.2" READ_ONLY /end CHARACTERISTIC
/begin CHARACTERISTIC EBAFCD_tiBtwTst_C "Zeitabstand, in dem die Endstufe im Fehlerfall getestet wird" VALUE 0xCD86E Kw_Wu16 29980.00 Time_ms 20.00000 30000.00 FORMAT "%8.2" EXTENDED_LIMITS 0.00 655350.0 /end CHARACTERISTIC
/begin CHARACTERISTIC EBAFCD_tiPwrStgOn_C "Zeit für welche die Endstufe im Fehlerfall eingeschalten wird (nur nicht SPI kontrolliert)" VALUE 0xCD870 Kw_Wu16 655140.0 Time_ms 0.00 655140.0 FORMAT "%8.1" EXTENDED_LIMITS 0.00 655350.0 /end CHARACTERISTIC
/begin CHARACTERISTIC EBFCD_ctPwrStgOnMax_C "Maximaler Zähler für Powerstage On im Fehlerfall" VALUE 0xCD872 Kw_Wu16 65535.00 OneToOne 0.00 65535.00 FORMAT "%8.2" /end CHARACTERISTIC
/begin CHARACTERISTIC EBFCD_DebExcTempDef_C "time for final defect of excess temperature defect" VALUE 0xCD874 Kw_Wu16 655350.0 Time_ms 0.00 655350.0 FORMAT "%8.1" /end CHARACTERISTIC
/begin CHARACTERISTIC EBFCD_DebExcTempOk_C "time for healing of excess temperature defect" VALUE 0xCD876 Kw_Wu16 655350.0 Time_ms 0.00 655350.0 FORMAT "%8.1" /end CHARACTERISTIC
/begin CHARACTERISTIC EBFCD_DebNoLoadDef_C "time for final defect of no load" VALUE 0xCD878 Kw_Wu16 655350.0 Time_ms 0.00 655350.0 FORMAT "%8.1" /end CHARACTERISTIC
/begin CHARACTERISTIC EBFCD_DebNoLoadOk_C "time for healing of no load defect" VALUE 0xCD87A Kw_Wu16 655350.0 Time_ms 0.00 655350.0 FORMAT "%8.1" /end CHARACTERISTIC
/begin CHARACTERISTIC EBFCD_DebShortCircBatDef_C "time for final defect for short circuit to battery" VALUE 0xCD87C Kw_Wu16 655350.0 Time_ms 0.00 655350.0 FORMAT "%8.1" /end CHARACTERISTIC
/begin CHARACTERISTIC EBFCD_DebShortCircBatOk_C "time for healing of short circuit to battery" VALUE 0xCD87E Kw_Wu16 655350.0 Time_ms 0.00 655350.0 FORMAT "%8.1" /end CHARACTERISTIC
/begin CHARACTERISTIC EBFCD_DebShortCircGndDef_C "time for final defect of short circuit to ground" VALUE 0xCD880 Kw_Wu16 655350.0 Time_ms 0.00 655350.0 FORMAT "%8.1" /end CHARACTERISTIC
/begin CHARACTERISTIC EBFCD_DebShortCircGndOk_C "time for final defect of short circuit to ground" VALUE 0xCD882 Kw_Wu16 655350.0 Time_ms 0.00 655350.0 FORMAT "%8.1" /end CHARACTERISTIC
/begin CHARACTERISTIC EBFCD_numDiaOut_C "#SSD application parameter for EBFCD diagnostic signal" VALUE 0xCD884 Kw_Wu8 27.0000000000 NumPinDia 0.00 27.0000000000 FORMAT "%13.10" /end CHARACTERISTIC
/begin CHARACTERISTIC EBFCD_numDioOut_C "#SSD application parameter for fan output signal" VALUE 0xCD885 Kw_Wu8 11.0000000000 NumPinDioOut 0.00 11.0000000000 FORMAT "%13.10" /end CHARACTERISTIC
/begin CHARACTERISTIC EBFCD_stDigInvOut_C "Digital output signal invert information" VALUE 0xCD886 Kw_Wu8 1.000 OneToOne 0.00 1.000 FORMAT "%5.3" EXTENDED_LIMITS 0.00 255.0 /end CHARACTERISTIC
/begin CHARACTERISTIC EBFCD_stSigOutErr_C "Default value if error occurs" VALUE 0xCD887 Kw_Wu8 1.000 OneToOne 0.00 1.000 FORMAT "%5.3" EXTENDED_LIMITS 0.00 255.0 /end CHARACTERISTIC
/begin CHARACTERISTIC EBFCD_stSPICtl_C "Schalter ob Endstufe SPI kontrollierbar = 1 oder nicht SPI kontrollierbar = 0" VALUE 0xCD888 Kw_Wu8 1.000 OneToOne 0.00 1.000 FORMAT "%5.3" EXTENDED_LIMITS 0.00 255.0 /end CHARACTERISTIC
/begin CHARACTERISTIC EBFCD_swtOnOff_C "Switch for switching the functionality ON/OFF (1 = ON, 0 = OFF)" VALUE 0xCD889 Kw_Wu8 1.000 OneToOne 0.00 1.000 FORMAT "%5.3" EXTENDED_LIMITS 0.00 255.0 /end CHARACTERISTIC
/begin CHARACTERISTIC EBFCD_tECUXLow_C "Minimum value for the input of the hysteresis" VALUE 0xCD88A Kw_Ws16 250.0000 Temp_Cels -50.1400 199.8600 FORMAT "%8.4" EXTENDED_LIMITS -3549.940 3003.560 /end CHARACTERISTIC
/begin CHARACTERISTIC EBFCD_tECUXHigh_C "Maximum value for the input of the hysteresis" VALUE 0xCD88C Kw_Ws16 250.0000 Temp_Cels -50.1400 199.8600 FORMAT "%8.4" EXTENDED_LIMITS -3549.940 3003.560 /end CHARACTERISTIC
/begin CHARACTERISTIC EBFCD_stECUYLow_C "Minimum value for the output of the hysteresis" VALUE 0xCD88E Kw_Ws16 1.000000 OneToOne 0.00 1.000000 FORMAT "%8.6" EXTENDED_LIMITS -32768.00 32767.00 /end CHARACTERISTIC
/begin CHARACTERISTIC EBFCD_stECUYHigh_C "Maximum value for the output of the hysteresis" VALUE 0xCD890 Kw_Ws16 1.000000 OneToOne 0.00 1.000000 FORMAT "%8.6" EXTENDED_LIMITS -32768.00 32767.00 /end CHARACTERISTIC
/begin CHARACTERISTIC EBFCD_tiBtwTst_C "Zeitabstand, in dem die Endstufe im Fehlerfall getestet wird" VALUE 0xCD892 Kw_Wu16 29980.00 Time_ms 20.00000 30000.00 FORMAT "%8.2" EXTENDED_LIMITS 0.00 655350.0 /end CHARACTERISTIC
/begin CHARACTERISTIC EBFCD_tiPwrStgOn_C "Zeit für welche die Endstufe im Fehlerfall eingeschalten wird (nur nicht SPI kontrolliert)" VALUE 0xCD894 Kw_Wu16 655140.0 Time_ms 0.00 655140.0 FORMAT "%8.1" EXTENDED_LIMITS 0.00 655350.0 /end CHARACTERISTIC
/begin CHARACTERISTIC EBTSCD_uSRCMin_C "#SSD min. value of SRC" VALUE 0xCD898 Kw_Ws16 5200.391 Volt 0.00 5200.391 FORMAT "%8.3" EXTENDED_LIMITS -160156.4 160151.5 /end CHARACTERISTIC
/begin CHARACTERISTIC EBTSCD_uSRCMax_C "#SSD max. value of SRC" VALUE 0xCD89A Kw_Ws16 5200.391 Volt 0.00 5200.391 FORMAT "%8.3" EXTENDED_LIMITS -160156.4 160151.5 /end CHARACTERISTIC
/begin CHARACTERISTIC EBTSCD_tLin_CUR "#SSD curve for linearisation in EBTSCD" CURVE 0xCD89C Kl_Xs16_Ws16 250.0000 Temp_Cels -50.14000 199.8600 FORMAT "%8.4" EXTENDED_LIMITS -3549.940 3003.560
 /begin AXIS_DESCR STD_AXIS EBTSCD_uRawTECU_mp Volt 5 0.00 5200.391 FORMAT "%8.3" EXTENDED_LIMITS -160156.4 160151.5 DEPOSIT ABSOLUTE /end AXIS_DESCR
/end CHARACTERISTIC
/begin CHARACTERISTIC EBTSCD_OvrDebSRCHighDef_C "#SSD Error debounce time for Over temperature error" VALUE 0xCD8B2 Kw_Wu16 655350.0 Time_ms 0.00 655350.0 FORMAT "%8.1" /end CHARACTERISTIC
/begin CHARACTERISTIC EBTSCD_OvrDebSRCHighOk_C "Healing debounce time for over temperature  error" VALUE 0xCD8B4 Kw_Wu16 655350.0 Time_ms 0.00 655350.0 FORMAT "%8.1" /end CHARACTERISTIC
/begin CHARACTERISTIC EBTSCD_DebSRCHighDef_C "#SSD Error debounce time for SRC-High error" VALUE 0xCD8B6 Kw_Wu16 655350.0 Time_ms 0.00 655350.0 FORMAT "%8.1" /end CHARACTERISTIC
/begin CHARACTERISTIC EBTSCD_DebSRCHighOk_C "Healing debounce time for SRC-High error" VALUE 0xCD8B8 Kw_Wu16 655350.0 Time_ms 0.00 655350.0 FORMAT "%8.1" /end CHARACTERISTIC
/begin CHARACTERISTIC EBTSCD_DebSRCLowDef_C "#SSD Error debounce time for SRC-Low error" VALUE 0xCD8BA Kw_Wu16 655350.0 Time_ms 0.00 655350.0 FORMAT "%8.1" /end CHARACTERISTIC
/begin CHARACTERISTIC EBTSCD_DebSRCLowOk_C "Healing debounce time for SRC-Low error" VALUE 0xCD8BC Kw_Wu16 655350.0 Time_ms 0.00 655350.0 FORMAT "%8.1" /end CHARACTERISTIC
/begin CHARACTERISTIC EBTSCD_numAdc_C "#SSD application parameter for ECU temperature" VALUE 0xCD8BE Kw_Wu8 26.0000000000 NumPinAdc 0.00 26.0000000000 FORMAT "%13.10" /end CHARACTERISTIC
/begin CHARACTERISTIC EBTSCD_dtRmpSlpUp_C "#SSD ramp slope up" VALUE 0xCD8C0 Kw_Wu32 6553598.99749 RmpTemp 1.00097656250 6553599.99847 FORMAT "%13.5" EXTENDED_LIMITS 0.00 6553599.99847 /end CHARACTERISTIC
/begin CHARACTERISTIC EBTSCD_dtRmpSlpDwn_C "#SSD ramp slope down" VALUE 0xCD8C4 Kw_Wu32 6553598.99749 RmpTemp 1.00097656250 6553599.99847 FORMAT "%13.5" EXTENDED_LIMITS 0.00 6553599.99847 /end CHARACTERISTIC
/begin CHARACTERISTIC EBTSCD_tiTECUPT1_C "#SSD Time constant of PT1 delay element" VALUE 0xCD8C8 Kw_Wu32 4294.9663 TimeDelay_s 0.0010000001 4294.9673 FORMAT "%9.4" EXTENDED_LIMITS 0.0000010000000 4294.9673 /end CHARACTERISTIC
/begin CHARACTERISTIC EBTSCD_tOvrTemp_C "#SSD over temperature threshold" VALUE 0xCD8CC Kw_Ws16 250.0000 Temp_Cels -50.1400 199.8600 FORMAT "%8.4" EXTENDED_LIMITS -3549.940 3003.560 /end CHARACTERISTIC
/begin CHARACTERISTIC EBTSCD_stSensIDWord_C "#SSD ID-Word for transition stage" VALUE 0xCD8CE Kw_Wu16 65535.00 OneToOne 0.00 65535.00 FORMAT "%8.2" /end CHARACTERISTIC
/begin CHARACTERISTIC EBTSCD_tDfl_C "#SSD default value if error occurs" VALUE 0xCD8D0 Kw_Ws16 250.0000 Temp_Cels -50.14000 199.8600 FORMAT "%8.4" EXTENDED_LIMITS -3549.940 3003.560 /end CHARACTERISTIC
/begin CHARACTERISTIC ECU_vPrgThres_C "#SSD obere Geschwindigkeitsgrenze für die FLASH Programmierung" VALUE 0xCD8D4 Kw_Ws16 327.6700 Vel 0.00 327.6700 FORMAT "%8.4" EXTENDED_LIMITS -327.6800 327.6700 /end CHARACTERISTIC
/begin CHARACTERISTIC EEPCD_stMILDfl_C "Vorgabezewert für MIL von EEPCD defekt" VALUE 0xCD8D6 Kw_Wu8 1.000 OneToOne 0.00 1.000 FORMAT "%5.3" EXTENDED_LIMITS 0.00 255.0 /end CHARACTERISTIC
/begin CHARACTERISTIC EGPpCD_ctPwrStgOnMax_C "Maximaler Zähler für Powerstage On im Fehlerfall" VALUE 0xCD9FC Kw_Wu16 65535.00 OneToOne 0.00 65535.00 FORMAT "%8.2" /end CHARACTERISTIC
/begin CHARACTERISTIC EGPpCD_numDia_C "#SSD Application parameter for Exhaust gas pressure pump actuator diagnostic signal" VALUE 0xCD9FE Kw_Wu8 27.0000000000 NumPinDia 0.00 27.0000000000 FORMAT "%13.10" /end CHARACTERISTIC
/begin CHARACTERISTIC EGPpCD_numDioOut_C "#SSD Application parameter for Exhaust gas pressure pump actuator output pin" VALUE 0xCD9FF Kw_Wu8 11.0000000000 NumPinDioOut 0.00 11.0000000000 FORMAT "%13.10" /end CHARACTERISTIC
/begin CHARACTERISTIC EGPpCD_stInvOut_C "Digital output invert information for Exhaust gas pressure pump actuator" VALUE 0xCDA00 Kw_Wu8 1.000 OneToOne 0.00 1.000 FORMAT "%5.3" EXTENDED_LIMITS 0.00 255.0 /end CHARACTERISTIC
/begin CHARACTERISTIC EGPpCD_stPwrStgActv_C "Status word for deactivation of the powerstage diagnostics" VALUE 0xCDA01 Kw_Wu8 255.0 OneToOne 0.00 255.0 FORMAT "%5.1" /end CHARACTERISTIC
/begin CHARACTERISTIC EGPpCD_stSPICtl_C "Schalter ob Endstufe SPI kontrollierbar = 1 oder nicht SPI kontrollierbar = 0" VALUE 0xCDA02 Kw_Wu8 1.000 OneToOne 0.00 1.000 FORMAT "%5.3" EXTENDED_LIMITS 0.00 255.0 /end CHARACTERISTIC
/begin CHARACTERISTIC EGPpCD_tiBtwTst_C "Zeitabstand, in dem die Endstufe im Fehlerfall getestet wird" VALUE 0xCDA04 Kw_Wu16 655140.0 Time_ms 0.00 655140.0 FORMAT "%8.1" EXTENDED_LIMITS 0.00 655350.0 /end CHARACTERISTIC
/begin CHARACTERISTIC EGPpCD_tiDebExcTempDef_C "Debounce duration for excess temperature error detection" VALUE 0xCDA06 Kw_Wu16 655350.0 Time_ms 0.00 655350.0 FORMAT "%8.1" /end CHARACTERISTIC
/begin CHARACTERISTIC EGPpCD_tiDebExcTempOk_C "Debounce duration for excess temperature error healing" VALUE 0xCDA08 Kw_Wu16 655350.0 Time_ms 0.00 655350.0 FORMAT "%8.1" /end CHARACTERISTIC
/begin CHARACTERISTIC EGPpCD_tiDebNoLoadDef_C "Debounce duration for no load error detection" VALUE 0xCDA0A Kw_Wu16 655350.0 Time_ms 0.00 655350.0 FORMAT "%8.1" /end CHARACTERISTIC
/begin CHARACTERISTIC EGPpCD_tiDebNoLoadOk_C "Debounce duration for no load error healing" VALUE 0xCDA0C Kw_Wu16 655350.0 Time_ms 0.00 655350.0 FORMAT "%8.1" /end CHARACTERISTIC
/begin CHARACTERISTIC EGPpCD_tiDebShortCircBatDef_C "Debounce duration for short circuit to battery error detection" VALUE 0xCDA0E Kw_Wu16 655350.0 Time_ms 0.00 655350.0 FORMAT "%8.1" /end CHARACTERISTIC
/begin CHARACTERISTIC EGPpCD_tiDebShortCircBatOk_C "Debounce duration for short circuit to battery error healing" VALUE 0xCDA10 Kw_Wu16 655350.0 Time_ms 0.00 655350.0 FORMAT "%8.1" /end CHARACTERISTIC
/begin CHARACTERISTIC EGPpCD_tiDebShortCircGndDef_C "Debounce duration for short circuit to ground error detection" VALUE 0xCDA12 Kw_Wu16 655350.0 Time_ms 0.00 655350.0 FORMAT "%8.1" /end CHARACTERISTIC
/begin CHARACTERISTIC EGPpCD_tiDebShortCircGndOk_C "Debounce duration for short circuit to ground error healing" VALUE 0xCDA14 Kw_Wu16 655350.0 Time_ms 0.00 655350.0 FORMAT "%8.1" /end CHARACTERISTIC
/begin CHARACTERISTIC EGPpCD_tiPwrStgOn_C "Zeit für welche die Endstufe im Fehlerfall eingeschalten wird (nur nicht SPI kontrolliert)" VALUE 0xCDA16 Kw_Wu16 655140.0 Time_ms 0.00 655140.0 FORMAT "%8.1" EXTENDED_LIMITS 0.00 655350.0 /end CHARACTERISTIC
/begin CHARACTERISTIC EGPp_facGeoSil2_C "Geometric factor silencer" VALUE 0xCD8F8 Kw_Ws16 100.0000 Fact1 0.00 100.0000 FORMAT "%8.4" EXTENDED_LIMITS -256.0000 255.9922 /end CHARACTERISTIC
/begin CHARACTERISTIC EGPp_facGeoSil_C "geometrischer Faktor Schalldämpfer" VALUE 0xCD8FA Kw_Ws16 100.0000 Fact1 0.00 100.0000 FORMAT "%8.4" EXTENDED_LIMITS -256.0000 255.9922 /end CHARACTERISTIC
/begin CHARACTERISTIC EGPp_facPow_CUR "Potenzfunktion für Abgasvolumenstrom" CURVE 0xCD8FC Kl_Xs16_Ws16 250.0000 Fact1 0.00 250.0000 FORMAT "%8.4" EXTENDED_LIMITS -256.0000 255.9922 READ_ONLY
 /begin AXIS_DESCR STD_AXIS EGPp_dvolSil_mp CubMtrPerHr 11 0.00 3200.000 FORMAT "%8.3" EXTENDED_LIMITS -3276.800 3276.700 DEPOSIT ABSOLUTE /end AXIS_DESCR
/end CHARACTERISTIC
/begin CHARACTERISTIC EGPp_facRhoEta_CUR "temperaturabhängiger Dichte- und Viskositätsfaktor" CURVE 0xCD92A Kl_Xs16_Ws16 4.000000 Fact 0.00 4.000000 FORMAT "%8.6" EXTENDED_LIMITS -4.000000 3.999878 READ_ONLY
 /begin AXIS_DESCR STD_AXIS PFlt_tPstSim Temp_Cels 9 -50.140 899.860 FORMAT "%8.3" EXTENDED_LIMITS -3549.940 3003.560 DEPOSIT ABSOLUTE /end AXIS_DESCR
/end CHARACTERISTIC
/begin CHARACTERISTIC EGPp_pPstPFlt_MAP "Druckabfallkennfeld" MAP 0xCD950 Kf_Xs16_Ys16_Ws16 3500.0000 Pres_hPa 0.00 3500.0000 FORMAT "%8.4" EXTENDED_LIMITS -32768.00 32767.00
 /begin AXIS_DESCR STD_AXIS Eng_nAvrg EngN 8 0.00 8000.000 FORMAT "%8.3" EXTENDED_LIMITS -32768.00 32767.00 DEPOSIT ABSOLUTE /end AXIS_DESCR
 /begin AXIS_DESCR STD_AXIS InjCtl_qSetUnBal InjMassCyc 8 0.00 200.0000 FORMAT "%8.4" EXTENDED_LIMITS -327.6800 327.6700 DEPOSIT ABSOLUTE /end AXIS_DESCR
/end CHARACTERISTIC
/begin CHARACTERISTIC EGPp_tiPresFltPT1_C "PT1 Filterzeit für die Druckmodellierung im Abgasrohr" VALUE 0xCD9F4 Kw_Wu32 4294.9673 TimeDelay_s 0.0000010000000 4294.9673 FORMAT "%9.4" /end CHARACTERISTIC
/begin CHARACTERISTIC EGPp_stFlap_MAP "Exhaust Gas Pump status calculation map" MAP 0xCD8E0 Kf_Xs16_Ys16_Ws16 1.000000 OneToOne 0.00 1.000000 FORMAT "%8.6" EXTENDED_LIMITS -32768.00 32767.00
 /begin AXIS_DESCR STD_AXIS Eng_nAvrg EngN 2 40.00000 6000.000 FORMAT "%8.3" EXTENDED_LIMITS -32768.00 32767.00 DEPOSIT ABSOLUTE /end AXIS_DESCR
 /begin AXIS_DESCR STD_AXIS InjCtl_qCurr InjMassCyc 2 0.00 200.0000 FORMAT "%8.4" EXTENDED_LIMITS -327.6800 327.6700 DEPOSIT ABSOLUTE /end AXIS_DESCR
/end CHARACTERISTIC
/begin CHARACTERISTIC EGPp_swtPresCalc_C "Schalter für Druckberechnung (0-Kennfeld, 1- Simulation)" VALUE 0xCD9F8 Kw_Wu8 1.000 OneToOne 0.00 1.000 FORMAT "%5.3" EXTENDED_LIMITS 0.00 255.0 /end CHARACTERISTIC
/begin CHARACTERISTIC EGPp_tiStartDelay_C "Time threshold for engine start status" VALUE 0xCD8F4 Kw_Ws16 9000.000 Time_ms 1000.000 10000.00 FORMAT "%8.2" EXTENDED_LIMITS -327680.0 327670.0 /end CHARACTERISTIC
/begin CHARACTERISTIC EGRCD_ctPwrStgOnMax_C "Maximale Anzahl der aktivierung der Endstufe bei SCB und Übertemperatur Fehler" VALUE 0xCDA18 Kw_Wu16 65535.00 OneToOne 0.00 65535.00 FORMAT "%8.2" /end CHARACTERISTIC
/begin CHARACTERISTIC EGRCD_DebExcTempDef_C "#SSD Fehlerentprellzeit für Übertemperatur" VALUE 0xCDA1A Kw_Wu16 655350.0 Time_ms 0.00 655350.0 FORMAT "%8.1" /end CHARACTERISTIC
/begin CHARACTERISTIC EGRCD_DebExcTempOk_C "Heilungsentprellzeit für Übertemperatur" VALUE 0xCDA1C Kw_Wu16 655350.0 Time_ms 0.00 655350.0 FORMAT "%8.1" /end CHARACTERISTIC
/begin CHARACTERISTIC EGRCD_DebNoLoadDef_C "#SSD Fehlerentprellzeit für Lastabfall" VALUE 0xCDA1E Kw_Wu16 655350.0 Time_ms 0.00 655350.0 FORMAT "%8.1" /end CHARACTERISTIC
/begin CHARACTERISTIC EGRCD_DebNoLoadOk_C "Heilungsentprellzeit für Lastabfall" VALUE 0xCDA20 Kw_Wu16 655350.0 Time_ms 0.00 655350.0 FORMAT "%8.1" /end CHARACTERISTIC
/begin CHARACTERISTIC EGRCD_DebShortCircBatDef_C "#SSD Fehlerentprellzeit für Kurzschluß nach Batteriespannung" VALUE 0xCDA22 Kw_Wu16 655350.0 Time_ms 0.00 655350.0 FORMAT "%8.1" /end CHARACTERISTIC
/begin CHARACTERISTIC EGRCD_DebShortCircBatOk_C "Heilungsentprellzeit für Kurzschluß nach Batteriespannung" VALUE 0xCDA24 Kw_Wu16 655350.0 Time_ms 0.00 655350.0 FORMAT "%8.1" /end CHARACTERISTIC
/begin CHARACTERISTIC EGRCD_DebShortCircGndDef_C "#SSD Fehlerentprellzeit für Kurzschluß nach Masse" VALUE 0xCDA26 Kw_Wu16 655350.0 Time_ms 0.00 655350.0 FORMAT "%8.1" /end CHARACTERISTIC
/begin CHARACTERISTIC EGRCD_DebShortCircGndOk_C "Heilungsentprellzeit für Kurzschluß nach Masse" VALUE 0xCDA28 Kw_Wu16 655350.0 Time_ms 0.00 655350.0 FORMAT "%8.1" /end CHARACTERISTIC
/begin CHARACTERISTIC EGRCD_numDia_C "#SSD Applikationsparameter fuer Diagnose Signal :EGR-Steller" VALUE 0xCDA2A Kw_Wu8 27.0000000000 NumPinDia 0.00 27.0000000000 FORMAT "%13.10" /end CHARACTERISTIC
/begin CHARACTERISTIC EGRCD_numPwmOut_C "#SSD Applikationsparameter fuer EGR-Steller" VALUE 0xCDA2B Kw_Wu8 13.0000000000 NumPinPwmOut 0.00 13.0000000000 FORMAT "%13.10" /end CHARACTERISTIC
/begin CHARACTERISTIC EGRCD_stInvOut_C "Invertierungsparameter für das Signal der Abgasrückführstellerendstufe" VALUE 0xCDA2C Kw_Wu8 1.000 OneToOne 0.00 1.000 FORMAT "%5.3" EXTENDED_LIMITS 0.00 255.0 /end CHARACTERISTIC
/begin CHARACTERISTIC EGRCD_tiPer_C "Periodendauer Abgasrückführsteller" VALUE 0xCDA2E Kw_Ws16 6553.500 Period -3276.800 3276.700 FORMAT "%8.3" /end CHARACTERISTIC
/begin CHARACTERISTIC EGRCD_rCnv_MAP "Kennfeld zur konvertierung in Tastverhältnis" MAP 0xCDA30 Kf_Xs16_Ys16_Ws16 100.0000 DtyCyc 0.00 100.0000 FORMAT "%8.4" EXTENDED_LIMITS -327.6800 327.6700
 /begin AXIS_DESCR STD_AXIS Eng_nAvrg EngN 8 0.00 8000.000 FORMAT "%8.3" EXTENDED_LIMITS -32768.00 32767.00 DEPOSIT ABSOLUTE /end AXIS_DESCR
 /begin AXIS_DESCR STD_AXIS EGRVlv_rEGR Prc 8 -400.0000 399.9878 FORMAT "%8.4" DEPOSIT ABSOLUTE /end AXIS_DESCR
/end CHARACTERISTIC
/begin CHARACTERISTIC EGRCD_rOutMax_C "Maximal auszugebendes Tastverhältnis" VALUE 0xCDAD4 Kw_Ws16 655.3500 DtyCyc -327.6800 327.6700 FORMAT "%8.4" /end CHARACTERISTIC
/begin CHARACTERISTIC EGRCD_rOutMin_C "Minimal auszugebendes Tastverhältnis" VALUE 0xCDAD6 Kw_Ws16 655.3500 DtyCyc -327.6800 327.6700 FORMAT "%8.4" /end CHARACTERISTIC
/begin CHARACTERISTIC EGRCD_stPwrStgActv_C "Aktivierung der Abschaltbedingungen der Endstufe" VALUE 0xCDAD8 Kw_Wu8 255.0 OneToOne 0.00 255.0 FORMAT "%5.1" /end CHARACTERISTIC
/begin CHARACTERISTIC EGRCD_stPwrStgDia_C "#SSD Aktivierung der Abschaltbedingungen der Endstufendiagnose" VALUE 0xCDAD9 Kw_Wu8 255.0 OneToOne 0.00 255.0 FORMAT "%5.1" /end CHARACTERISTIC
/begin CHARACTERISTIC EGRCD_stSPICtl_C "0 = Non SPI powerstage )" VALUE 0xCDADA Kw_Wu8 1.000 OneToOne 0.00 1.000 FORMAT "%5.3" EXTENDED_LIMITS 0.00 255.0 /end CHARACTERISTIC
/begin CHARACTERISTIC EGRCD_swt_C "Schalter Batteriesspannungskorrektur (0 = AUS, 1 = EIN)" VALUE 0xCDADB Kw_Wu8 255.0 OneToOne 0.00 255.0 FORMAT "%5.1" /end CHARACTERISTIC
/begin CHARACTERISTIC EGRCD_tiBtwTst_C "Zeitabstand, in dem im Fehlerfall die Endstufe getestet wird" VALUE 0xCDADC Kw_Wu16 29980.00 Time_ms 20.00000 30000.00 FORMAT "%8.2" EXTENDED_LIMITS 0.00 655350.0 /end CHARACTERISTIC
/begin CHARACTERISTIC EGRCD_tiPwrStgOn_C "Zeit für welche die Endstufe im Fehlerfall eingeschalten wird (nur nicht SPI kontrolliert)" VALUE 0xCDADE Kw_Wu16 655140.0 Time_ms 0.00 655140.0 FORMAT "%8.1" EXTENDED_LIMITS 0.00 655350.0 /end CHARACTERISTIC
/begin CHARACTERISTIC EGRVlv_rEGR2_Vector "#SSD Bypass-Label for exhaust gas recirculation coordinator2" VALUE 0xC30DE Kw_Wu8 255.0 OneToOne 0.00 255.0 FORMAT "%5.1" /end CHARACTERISTIC
/begin CHARACTERISTIC EGRVlv_rEGR2_Channel "#SSD Bypass-Label for exhaust gas recirculation coordinator2" VALUE 0xC30DF Kw_Wu8 255.0 OneToOne 0.00 255.0 FORMAT "%5.1" /end CHARACTERISTIC
/begin CHARACTERISTIC EGRVlv_rEGR_Vector "#SSD Bypass-Label für EGRVlv_rEGR" VALUE 0xC30E0 Kw_Wu8 255.0 OneToOne 0.00 255.0 FORMAT "%5.1" /end CHARACTERISTIC
/begin CHARACTERISTIC EGRVlv_rEGR_Channel "#SSD Bypass-Label für EGRVlv_rEGR" VALUE 0xC30E1 Kw_Wu8 255.0 OneToOne 0.00 255.0 FORMAT "%5.1" /end CHARACTERISTIC
/begin CHARACTERISTIC EGSys_AlpFreeCnvtTube_C "Wärmeübertragungskoeffizient am Abgasrohr aufgrund freier Konvektion" VAL_BLK 0xCE3C8 Kwb_Ws16 999.9000 ThermalCoEff 0.1000000 1000.000 FORMAT "%8.3" EXTENDED_LIMITS -3276.800 3276.700 NUMBER 2 /end CHARACTERISTIC
/begin CHARACTERISTIC EGSys_CalValFl_C "Unterer Heizwert Kraftstoff" VALUE 0xCE1B8 Kw_Wu16 65535.00 Calory 0.00 65535.00 FORMAT "%8.2" /end CHARACTERISTIC
/begin CHARACTERISTIC EGSys_cndHtEG_CUR "Wärmeleitfähigkeit Abgas (nicht applizierbar)" CURVE 0xCDCEC Kl_Xs16_Ws16 1.000000 Fact 0.00 1.000000 FORMAT "%8.6" EXTENDED_LIMITS -4.000000 3.999878 READ_ONLY
 /begin AXIS_DESCR STD_AXIS EGSys_tEGLSUInpCrv0_mp Temp_Cels 8 -50.140 899.860 FORMAT "%8.3" EXTENDED_LIMITS -3549.940 3003.560 DEPOSIT ABSOLUTE /end AXIS_DESCR
/end CHARACTERISTIC
/begin CHARACTERISTIC EGSys_cpChrg_C "Wärmekapazität Turbolader" VALUE 0xCE2F4 Kw_Ws16 3000.000 HeatCapacity 0.00 3000.000 FORMAT "%8.3" EXTENDED_LIMITS -3276.800 3276.700 /end CHARACTERISTIC
/begin CHARACTERISTIC EGSys_cpEG_MAP "Wärmekapazität Abgas (nicht applizierbar)" MAP 0xCDD0E Kf_Xs16_Ys16_Ws16 2.000000 SpecificHeat 0.00 2.000000 FORMAT "%8.6" EXTENDED_LIMITS -3.276800 3.276700 READ_ONLY
 /begin AXIS_DESCR STD_AXIS EGSys_tEGLSUInpCrv0_mp Temp_Cels 6 -50.140 899.860 FORMAT "%8.3" EXTENDED_LIMITS -3549.940 3003.560 DEPOSIT ABSOLUTE /end AXIS_DESCR
 /begin AXIS_DESCR STD_AXIS EGSys_rLmbdAprx lambda 6 -30.00000 30.00000 FORMAT "%8.5" EXTENDED_LIMITS -32.76800 32.76700 DEPOSIT ABSOLUTE /end AXIS_DESCR
/end CHARACTERISTIC
/begin CHARACTERISTIC EGSys_cpNSC_C "Wärmekapazität NSC" VALUE 0xCE108 Kw_Ws16 2999.900 HeatCapacity 0.1000000 3000.000 FORMAT "%8.3" EXTENDED_LIMITS -3276.800 3276.700 /end CHARACTERISTIC
/begin CHARACTERISTIC EGSys_cpOxiCat_C "Wärmekapazität Oxidationskatalysator" VALUE 0xCE1BA Kw_Ws16 2999.900 HeatCapacity 0.1000000 3000.000 FORMAT "%8.3" EXTENDED_LIMITS -3276.800 3276.700 /end CHARACTERISTIC
/begin CHARACTERISTIC EGSys_cpTube_C "Wärmekapazität Abgasrohr" VAL_BLK 0xCE3CC Kwb_Ws16 2999.900 HeatCapacity 0.1000000 3000.000 FORMAT "%8.3" EXTENDED_LIMITS -3276.800 3276.700 NUMBER 2 /end CHARACTERISTIC
/begin CHARACTERISTIC EGSys_dmAir_MAP "Kennfeld zur Ermittlung Luftmassenstrom im Auslegungspunkt (zur Temperaturkorrektur)" MAP 0xCDDC8 Kf_Xs16_Ys16_Ws16 1000.000 AirMassPerTime 0.00 1000.000 FORMAT "%8.3" EXTENDED_LIMITS -3276.800 3276.700
 /begin AXIS_DESCR STD_AXIS Eng_nAvrg EngN 8 0.00 8000.000 FORMAT "%8.3" EXTENDED_LIMITS -32768.00 32767.00 DEPOSIT ABSOLUTE /end AXIS_DESCR
 /begin AXIS_DESCR STD_AXIS InjCtl_qCurr InjMassCyc 8 0.00 100.0000 FORMAT "%8.4" EXTENDED_LIMITS -327.6800 327.6700 DEPOSIT ABSOLUTE /end AXIS_DESCR
/end CHARACTERISTIC
/begin CHARACTERISTIC EGSys_dmEGMinVal_C "Kleinstwert Abgasmassenstrom für thermische Modellierung" VALUE 0xCDD72 Kw_Ws16 1000.000 AirMassPerTime 0.00 1000.000 FORMAT "%8.3" EXTENDED_LIMITS -3276.800 3276.700 /end CHARACTERISTIC
/begin CHARACTERISTIC EGSys_dmPlsThresLSU_C "Minimaler Massenstrom für gültigen Gasstoß" VAL_BLK 0xCDAE0 Kwb_Ws16 1000.000 AirMassPerTime 0.00 1000.000 FORMAT "%8.3" EXTENDED_LIMITS -3276.800 3276.700 NUMBER 1 /end CHARACTERISTIC
/begin CHARACTERISTIC EGSys_dpExhGas_MAP "Kennfeld für Abgasgegendruck" MAP 0xCDBF4 Kf_Xs16_Ys16_Ws16 65535.00 Pres_hPa -32768.00 32767.00 FORMAT "%8.2"
 /begin AXIS_DESCR STD_AXIS Eng_nAvrg EngN 10 -32768.00 32767.00 FORMAT "%8.2" DEPOSIT ABSOLUTE /end AXIS_DESCR
 /begin AXIS_DESCR STD_AXIS InjCtl_qSetUnBal InjMassCyc 10 -327.6800 327.6700 FORMAT "%8.4" DEPOSIT ABSOLUTE /end AXIS_DESCR
/end CHARACTERISTIC
/begin CHARACTERISTIC EGSys_etaChrg_MAP "Kennfeld Gesamtwirkungsgrad Turbolader" MAP 0xCE2F6 Kf_Xs16_Ys16_Ws16 0.9998779 Fact 0.0001220703 1.000000 FORMAT "%8.6" EXTENDED_LIMITS -4.000000 3.999878
 /begin AXIS_DESCR STD_AXIS AFSCD_dmAirPerTime AirMassPerTime 8 0.00 1000.000 FORMAT "%8.3" EXTENDED_LIMITS -3276.800 3276.700 DEPOSIT ABSOLUTE /end AXIS_DESCR
 /begin AXIS_DESCR STD_AXIS EGSys_rPresCmpr_mp Fact 8 0.00 8.000000 FORMAT "%8.6" EXTENDED_LIMITS -4.000000 3.999878 DEPOSIT ABSOLUTE /end AXIS_DESCR
/end CHARACTERISTIC
/begin CHARACTERISTIC EGSys_facAirMass_CUR "Kennlinie zur Luftmassenabhängigen Temperaturkorrektur" CURVE 0xCDE6C Kl_Xs16_Ws16 2.000000 Fact 0.00 2.000000 FORMAT "%8.6" EXTENDED_LIMITS -4.000000 3.999878
 /begin AXIS_DESCR STD_AXIS EGSys_rAirPerTime_mp Fact 8 0.00 8.000000 FORMAT "%8.6" EXTENDED_LIMITS -4.000000 3.999878 DEPOSIT ABSOLUTE /end AXIS_DESCR
/end CHARACTERISTIC
/begin CHARACTERISTIC EGSys_facCldStrtLSU_C "Faktor für Schwellwerterhöhung bei wiederholtem Kaltstart" VAL_BLK 0xCDAE2 Kwb_Ws16 1.000000 Fact 0.00 1.000000 FORMAT "%8.6" EXTENDED_LIMITS -4.000000 3.999878 NUMBER 1 /end CHARACTERISTIC
/begin CHARACTERISTIC EGSys_facCorrCldEng_CUR "Kennlinie zur Abgastemperatur-Korrektur beim kaltem Motor" CURVE 0xCDE8E Kl_Xs16_Ws16 2.000000 Fact 0.00 2.000000 FORMAT "%8.6" EXTENDED_LIMITS -4.000000 3.999878
 /begin AXIS_DESCR STD_AXIS EGSys_tDiffCldEng_mp TempDiff_Cels 8 -3276.800 3276.700 FORMAT "%8.3" DEPOSIT ABSOLUTE /end AXIS_DESCR
/end CHARACTERISTIC
/begin CHARACTERISTIC EGSys_facIAT_CUR "Kennlinie zur ansauglufttemperaturabhängigen Korrektur der Abgastemperatur" CURVE 0xCDEB0 Kl_Xs16_Ws16 2.000000 Fact 0.00 2.000000 FORMAT "%8.6" EXTENDED_LIMITS -4.000000 3.999878
 /begin AXIS_DESCR STD_AXIS EGSys_tDiffIAT_mp TempDiff_Cels 8 -3276.800 3276.700 FORMAT "%8.3" DEPOSIT ABSOLUTE /end AXIS_DESCR
/end CHARACTERISTIC
/begin CHARACTERISTIC EGSys_facPlsLSU_C "Faktor für Abnahme der Wärmeschwelle bei gültigem Gasstoß" VAL_BLK 0xCDAE4 Kwb_Ws16 1.000000 Fact 0.00 1.000000 FORMAT "%8.6" EXTENDED_LIMITS -4.000000 3.999878 NUMBER 1 /end CHARACTERISTIC
/begin CHARACTERISTIC EGSys_facPlsThresLSU_C "minimaler Wärmemengenschwellwert zur Aktivierung der Gasstoß-Erkennung" VAL_BLK 0xCDAE6 Kwb_Ws16 1.000000 Fact 0.00 1.000000 FORMAT "%8.6" EXTENDED_LIMITS -4.000000 3.999878 NUMBER 1 /end CHARACTERISTIC
/begin CHARACTERISTIC EGSys_facStrtDlv_CUR "Kennlinie zur Förderbeginnabhängigen Temperaturkorrektur" CURVE 0xCDED2 Kl_Xs16_Ws16 2.000000 Fact 0.00 2.000000 FORMAT "%8.6" EXTENDED_LIMITS -4.000000 3.999878
 /begin AXIS_DESCR STD_AXIS EGSys_phiDiffStrt_mp AngleCrS 8 -49.99219 49.99219 FORMAT "%8.5" EXTENDED_LIMITS -768.0000 767.9766 DEPOSIT ABSOLUTE /end AXIS_DESCR
/end CHARACTERISTIC
/begin CHARACTERISTIC EGSys_facTempClg_CUR "Abkühlkennlinie abgasführende Bauteile" CURVE 0xCE28C Kl_Xs16_Ws16 2.000000 Fact 0.00 2.000000 FORMAT "%8.6" EXTENDED_LIMITS -4.000000 3.999878
 /begin AXIS_DESCR STD_AXIS EGSys_rTimeTrb_mp Fact1 8 0.00 8.000000 FORMAT "%8.6" EXTENDED_LIMITS -256.0000 255.9922 DEPOSIT ABSOLUTE /end AXIS_DESCR
/end CHARACTERISTIC
/begin CHARACTERISTIC EGSys_facTempCmb_CUR "Temperaturabhängiger Faktor zur Korrektur der im Oxidationskatalysator abreagierenden Kraftstoffmasse" CURVE 0xCE1BC Kl_Xs16_Ws16 2.000000 Fact 0.00 2.000000 FORMAT "%8.6" EXTENDED_LIMITS -4.000000 3.999878
 /begin AXIS_DESCR STD_AXIS EGSys_tAvrgOxiCat_mp Temp_Cels 8 -50.140 899.860 FORMAT "%8.3" EXTENDED_LIMITS -3549.940 3003.560 DEPOSIT ABSOLUTE /end AXIS_DESCR
/end CHARACTERISTIC
/begin CHARACTERISTIC EGSys_facTimeClg_CUR "inverse Abkühlkennlinie Motor" CURVE 0xCE2AE Kl_Xs16_Ws16 255.0000 Fact1 0.00 255.0000 FORMAT "%8.4" EXTENDED_LIMITS -256.0000 255.9922
 /begin AXIS_DESCR STD_AXIS EGSys_rTempClnt_mp Fact 8 0.00 3.900024 FORMAT "%8.6" EXTENDED_LIMITS -4.000000 3.999878 DEPOSIT ABSOLUTE /end AXIS_DESCR
/end CHARACTERISTIC
/begin CHARACTERISTIC EGSys_lDiamTube_C "Durchmesser Abgasrohr" VAL_BLK 0xCE3D0 Kwb_Ws16 99.99219 Length1 0.007812500 100.0000 FORMAT "%8.4" EXTENDED_LIMITS -256.0000 255.9922 NUMBER 2 /end CHARACTERISTIC
/begin CHARACTERISTIC EGSys_lLngthTube_C "Länge Abgasrohr" VAL_BLK 0xCE3D4 Kwb_Ws16 99.99219 Length1 0.007812500 100.0000 FORMAT "%8.4" EXTENDED_LIMITS -256.0000 255.9922 NUMBER 2 /end CHARACTERISTIC
/begin CHARACTERISTIC EGSys_tiPT1NSC_C "Feste thermische Zeitkonstante zur NSC-Modellierung" VALUE 0xCE10C Kw_Wu32 4294.9663 TimeDelay_s 0.0010000001 4294.9673 FORMAT "%9.4" EXTENDED_LIMITS 0.0000010000000 4294.9673 /end CHARACTERISTIC
/begin CHARACTERISTIC EGSys_numECU_C "Anzahl der Steuergeräte" VALUE 0xCDD74 Kw_Wu8 254.0 OneToOne 1.000 255.0 FORMAT "%5.1" EXTENDED_LIMITS 0.00 255.0 /end CHARACTERISTIC
/begin CHARACTERISTIC EGSys_numMaxCldStrt_C "Maximale Anzahl der zu zählenden Kaltstarts" VAL_BLK 0xCDAE8 Kwb_Wu8 10.00 OneToOne 0.00 10.00 FORMAT "%5.2" EXTENDED_LIMITS 0.00 255.0 NUMBER 1 /end CHARACTERISTIC
/begin CHARACTERISTIC EGSys_numRdPosLSU2_C "Leseindex im Temperaturarray für Abgastemperatur(en) am Sensoreinbauort (im Fehlerfall)" VAL_BLK 0xCDD75 Kwb_Wu8 12.00 OneToOne 0.00 12.00 FORMAT "%5.2" EXTENDED_LIMITS 0.00 255.0 NUMBER 1 /end CHARACTERISTIC
/begin CHARACTERISTIC EGSys_numRdPosLSUWall_C "Leseindex der Rohrwandtemperatur im Temperaturarray" VAL_BLK 0xCDD76 Kwb_Wu8 14.00 OneToOne 0.00 14.00 FORMAT "%5.2" EXTENDED_LIMITS 0.00 255.0 NUMBER 1 /end CHARACTERISTIC
/begin CHARACTERISTIC EGSys_numRdPosLSU_C "Leseindex im Temperaturarray für Abgastemperatur(en) am Sensoreinbauort" VAL_BLK 0xCDD77 Kwb_Wu8 12.00 OneToOne 0.00 12.00 FORMAT "%5.2" EXTENDED_LIMITS 0.00 255.0 NUMBER 1 /end CHARACTERISTIC
/begin CHARACTERISTIC EGSys_numRdPosNSC2_C "Leseindex im Temperaturarray für NSC Einlaßtemperatur (im Fehlerfall)" VALUE 0xCDD78 Kw_Wu8 12.00 OneToOne 0.00 12.00 FORMAT "%5.2" EXTENDED_LIMITS 0.00 255.0 /end CHARACTERISTIC
/begin CHARACTERISTIC EGSys_numRdPosNSC_C "Leseindex im Temperaturarray für NSC Einlaßtemperatur" VALUE 0xCDD79 Kw_Wu8 12.00 OneToOne 0.00 12.00 FORMAT "%5.2" EXTENDED_LIMITS 0.00 255.0 /end CHARACTERISTIC
/begin CHARACTERISTIC EGSys_numRdPosOxiCat2_C "Leseindex im Temperaturarray für Oxydations-Katalysator-Einlaßtemperatur (im Fehlerfall)" VALUE 0xCDD7A Kw_Wu8 12.00 OneToOne 0.00 12.00 FORMAT "%5.2" EXTENDED_LIMITS 0.00 255.0 /end CHARACTERISTIC
/begin CHARACTERISTIC EGSys_numRdPosOxiCat_C "Leseindex im Temperaturarray für Oxydations-Katalysator-Einlaßtemperatur" VALUE 0xCDD7B Kw_Wu8 12.00 OneToOne 0.00 12.00 FORMAT "%5.2" EXTENDED_LIMITS 0.00 255.0 /end CHARACTERISTIC
/begin CHARACTERISTIC EGSys_numRdPosTrbn2_C "Leseindex im Temperaturarray für Turbineneinlaßtemperatur (im Fehlerfall)" VALUE 0xCDD7C Kw_Wu8 12.00 OneToOne 0.00 12.00 FORMAT "%5.2" EXTENDED_LIMITS 0.00 255.0 /end CHARACTERISTIC
/begin CHARACTERISTIC EGSys_numRdPosTrbn_C "Leseindex im Temperaturarray für Turbineneinlaßtemperatur" VALUE 0xCDD7D Kw_Wu8 12.00 OneToOne 0.00 12.00 FORMAT "%5.2" EXTENDED_LIMITS 0.00 255.0 /end CHARACTERISTIC
/begin CHARACTERISTIC EGSys_numRdPosTube2_C "Leseindex im Temperaturarray für Rohr-Einlaßtemperaturen (im Fehlerfall)" VAL_BLK 0xCDD7E Kwb_Wu8 12.00 OneToOne 0.00 12.00 FORMAT "%5.2" EXTENDED_LIMITS 0.00 255.0 NUMBER 2 /end CHARACTERISTIC
/begin CHARACTERISTIC EGSys_numRdPosTube_C "Leseindex im Temperaturarray für Rohr-Einlaßtemperaturen" VAL_BLK 0xCDD80 Kwb_Wu8 12.00 OneToOne 0.00 12.00 FORMAT "%5.2" EXTENDED_LIMITS 0.00 255.0 NUMBER 2 /end CHARACTERISTIC
/begin CHARACTERISTIC EGSys_NuTubeEnv_CUR "Nusselt-Zahl Abgasrohr-Aussenumströmung (nicht applizierbar)" CURVE 0xCE3D8 Kl_Xs16_Ws16 5309.000 OneToOne 0.00 5309.000 FORMAT "%8.3" EXTENDED_LIMITS -32768.00 32767.00 READ_ONLY
 /begin AXIS_DESCR STD_AXIS EGSys_ReTubeEnvInpCrv_mp OneToOne 8 0.00 3750.000 FORMAT "%8.3" EXTENDED_LIMITS -32768.00 32767.00 DEPOSIT ABSOLUTE /end AXIS_DESCR
/end CHARACTERISTIC
/begin CHARACTERISTIC EGSys_NuTube_CUR "Nusselt-Zahl für Abgasrohrdurchströmung (nicht applizierbar)" CURVE 0xCE3FA Kl_Xs16_Ws16 1130.000 OneToOne 0.00 1130.000 FORMAT "%8.3" EXTENDED_LIMITS -32768.00 32767.00 READ_ONLY
 /begin AXIS_DESCR STD_AXIS EGSys_ReTubeInpCrv_mp ReynoldsNum 8 0.00 800000.0 FORMAT "%8.1" EXTENDED_LIMITS -3276800. 3276700. DEPOSIT ABSOLUTE /end AXIS_DESCR
/end CHARACTERISTIC
/begin CHARACTERISTIC EGSys_tiPT1OxiCat_C "Feste thermische Zeitkonstante zur Oxidationskatalysator-Modellierung" VALUE 0xCE1E0 Kw_Wu32 4294.9663 TimeDelay_s 0.0010000001 4294.9673 FORMAT "%9.4" EXTENDED_LIMITS 0.0000010000000 4294.9673 /end CHARACTERISTIC
/begin CHARACTERISTIC EGSys_pConstVal_C "Normdruck" VALUE 0xCDCE8 Kw_Ws16 65535.00 Pres_hPa -32768.00 32767.00 FORMAT "%8.2" READ_ONLY /end CHARACTERISTIC
/begin CHARACTERISTIC EGSys_phiStrtDlv_MAP "Kennfeld zur Ermittlung Förderbeginn MI1 im Auslegungspunkt (zur Temperaturkorrektur)" MAP 0xCDEF4 Kf_Xs16_Ys16_Ws16 99.98437 AngleCrS -49.99219 49.99219 FORMAT "%8.5" EXTENDED_LIMITS -768.0000 767.9766
 /begin AXIS_DESCR STD_AXIS Eng_nAvrg EngN 8 0.00 8000.000 FORMAT "%8.3" EXTENDED_LIMITS -32768.00 32767.00 DEPOSIT ABSOLUTE /end AXIS_DESCR
 /begin AXIS_DESCR STD_AXIS InjCtl_qCurr InjMassCyc 8 0.00 100.0000 FORMAT "%8.4" EXTENDED_LIMITS -327.6800 327.6700 DEPOSIT ABSOLUTE /end AXIS_DESCR
/end CHARACTERISTIC
/begin CHARACTERISTIC EGSys_tiChrgPT1_C "Feste thermische Zeitkonstante Turbolader" VALUE 0xCE39C Kw_Wu32 4294.9663 TimeDelay_s 0.0010000001 4294.9673 FORMAT "%9.4" EXTENDED_LIMITS 0.0000010000000 4294.9673 /end CHARACTERISTIC
/begin CHARACTERISTIC EGSys_pValDfl_C "Vorgabewert Umgebungsdruck für Turboladermodell" VALUE 0xCE3A0 Kw_Ws16 3000.000 Pres_hPa 500.0000 3500.000 FORMAT "%8.3" EXTENDED_LIMITS -32768.00 32767.00 /end CHARACTERISTIC
/begin CHARACTERISTIC EGSys_rSqTube_C "Anteil der vom Fahrtwind beaufschlagten Oberfläche Abgasrohr" VAL_BLK 0xCE41C Kwb_Ws16 3.800049 Fact 0.09997559 3.900024 FORMAT "%8.6" EXTENDED_LIMITS -4.000000 3.999878 NUMBER 2 /end CHARACTERISTIC
/begin CHARACTERISTIC EGSys_rTempAdbt_CUR "Kennlinie für die adiabatische Zustandänderung der Temperatur (nicht applizierbar)" CURVE 0xCE3A2 Kl_Xs16_Ws16 0.4000244 Fact 1.000000 1.400024 FORMAT "%8.6" EXTENDED_LIMITS -4.000000 3.999878 READ_ONLY
 /begin AXIS_DESCR STD_AXIS EGSys_rPresCmpr_mp Fact 8 1.000000 8.000000 FORMAT "%8.6" EXTENDED_LIMITS -4.000000 3.999878 DEPOSIT ABSOLUTE /end AXIS_DESCR
/end CHARACTERISTIC
/begin CHARACTERISTIC EGSys_swtDewDetShOff_C "Umschalter für Ersatzfunktion (Zeitapplikation) (1: Ersatzfunktion, 0: Taupunkterkennung)" VAL_BLK 0xCDAE9 Kwb_Wu8 10.00 OneToOne 0.00 10.00 FORMAT "%5.2" EXTENDED_LIMITS 0.00 255.0 NUMBER 1 /end CHARACTERISTIC
/begin CHARACTERISTIC EGSys_swtPresSel_C "#SSD Auswahl, ob Atmosphaerendruck (=1) oder Druck vor Partikelfilter (=0)" VALUE 0xCDCEA Kw_Wu8 1.000 OneToOne 0.00 1.000 FORMAT "%5.3" EXTENDED_LIMITS 0.00 255.0 /end CHARACTERISTIC
/begin CHARACTERISTIC EGSys_swtTAirSens_C "Umschalter für Umgebungstemperatursensor (1: Ladelufttemperatursensor, 0: Umgebungslufttemperatursensor)" VALUE 0xCE2D0 Kw_Wu8 1.000 OneToOne 0.00 1.000 FORMAT "%5.3" EXTENDED_LIMITS 0.00 255.0 /end CHARACTERISTIC
/begin CHARACTERISTIC EGSys_swtTimeChrg_C "Schalter zur Verwendung fester oder variabler thermischer Zeitkonstante für Turbolader (1 = fest, 0 = variabel)" VALUE 0xCE3C4 Kw_Wu8 1.000 OneToOne 0.00 1.000 FORMAT "%5.3" EXTENDED_LIMITS 0.00 255.0 /end CHARACTERISTIC
/begin CHARACTERISTIC EGSys_swtTimeNSC_C "Schalter zur Verwendung fester oder variabler thermischer Zeitkonstante für NSC (1 = fest, 0 = variabel)" VALUE 0xCE110 Kw_Wu8 1.000 OneToOne 0.00 1.000 FORMAT "%5.3" EXTENDED_LIMITS 0.00 255.0 /end CHARACTERISTIC
/begin CHARACTERISTIC EGSys_swtTimeOxiCat_C "Schalter zur Verwendung fester oder variabler thermischer Zeitkonstante für Oxidationskatalysator (1 = fest, 0 = variabel)" VALUE 0xCE1E4 Kw_Wu8 1.000 OneToOne 0.00 1.000 FORMAT "%5.3" EXTENDED_LIMITS 0.00 255.0 /end CHARACTERISTIC
/begin CHARACTERISTIC EGSys_tEGPstTrbnDfl_C "Ersatzwert Turbinentemperatur im Fehlerfall" VALUE 0xCE3C6 Kw_Ws16 950.000 Temp_Cels -50.140 899.860 FORMAT "%8.3" EXTENDED_LIMITS -3549.940 3003.560 /end CHARACTERISTIC
/begin CHARACTERISTIC EGSys_tEGTubeDfl_C "Ersatzwert Abgastemperatur im Abgasrohr" VAL_BLK 0xCE420 Kwb_Ws16 950.000 Temp_Cels -50.140 899.860 FORMAT "%8.3" EXTENDED_LIMITS -3549.940 3003.560 NUMBER 2 /end CHARACTERISTIC
/begin CHARACTERISTIC EGSys_tEngStat_C "Kühlmitteltemperatur (bzw Motortemperatur) betriebswarmer Motor unter normalen Bendingungen" VALUE 0xCDF98 Kw_Ws16 950.000 Temp_Cels -50.140 899.860 FORMAT "%8.3" EXTENDED_LIMITS -3549.940 3003.560 /end CHARACTERISTIC
/begin CHARACTERISTIC EGSys_tExcClntDfl_C "Ersatzwert für Motor-Übertemperatur" VALUE 0xCDDC6 Kw_Ws16 1095.000 TempDiff_Cels -45.00000 1050.000 FORMAT "%8.3" EXTENDED_LIMITS -3276.800 3276.700 /end CHARACTERISTIC
/begin CHARACTERISTIC EGSys_tIAT_MAP "Kennfeld Ansauglufttemperatur im Auslegungspunkt zur Korrektur der stationären Krümmeraustrittstemperatur" MAP 0xCDF9A Kf_Xs16_Ys16_Ws16 950.000 Temp_Cels -50.140 899.860 FORMAT "%8.3" EXTENDED_LIMITS -3549.940 3003.560
 /begin AXIS_DESCR STD_AXIS Eng_nAvrg EngN 8 0.00 8000.000 FORMAT "%8.3" EXTENDED_LIMITS -32768.00 32767.00 DEPOSIT ABSOLUTE /end AXIS_DESCR
 /begin AXIS_DESCR STD_AXIS InjCtl_qCurr InjMassCyc 8 0.00 100.0000 FORMAT "%8.4" EXTENDED_LIMITS -327.6800 327.6700 DEPOSIT ABSOLUTE /end AXIS_DESCR
/end CHARACTERISTIC
/begin CHARACTERISTIC EGSys_tiDebLSU0_C "Entprellzeit Heizungsfreigabe Lambdasonde 0" VAL_BLK 0xCDAEA Kwb_Wu16 20.00000 Time_s 0.00 20.00000 FORMAT "%8.5" EXTENDED_LIMITS 0.00 655.3500 NUMBER 1 /end CHARACTERISTIC
/begin CHARACTERISTIC EGSys_tiDebNrmTransOk_C "Entprellzeit zur Verzögerung der Berechnungen nach Start bis gültige Temperaturen anliegen" VALUE 0xCDAEC Kw_Ws16 1000.000 TimeDeb 0.00 1000.000 FORMAT "%8.3" EXTENDED_LIMITS -327680.0 327670.0 /end CHARACTERISTIC
/begin CHARACTERISTIC EGSys_tiHaValClnt_C "Abkühl-Halbwertszeit Motor" VALUE 0xCE2D4 Kw_Wu32 42949672.9500 Time_s 0.00 42949672.9500 FORMAT "%13.4" /end CHARACTERISTIC
/begin CHARACTERISTIC EGSys_tiHaValNSC_C "Abkühl-Halbwertszeit NSC" VALUE 0xCE2D8 Kw_Wu32 42949672.9500 Time_s 0.00 42949672.9500 FORMAT "%13.4" /end CHARACTERISTIC
/begin CHARACTERISTIC EGSys_tiHaValOxiCat_C "Abkühl-Halbwertszeit Oxidationskatalysator" VALUE 0xCE2DC Kw_Wu32 42949672.9500 Time_s 0.00 42949672.9500 FORMAT "%13.4" /end CHARACTERISTIC
/begin CHARACTERISTIC EGSys_tiHaValTrb_C "Abkühlen der Halbzeit-Periode turbocharge" VALUE 0xCE2E0 Kw_Wu32 42949672.9500 Time_s 0.00 42949672.9500 FORMAT "%13.4" /end CHARACTERISTIC
/begin CHARACTERISTIC EGSys_tiHaValTube_C "Abkühl-Halbwertszeit Abgasrohr" VAL_BLK 0xCE2E4 Kwb_Wu32 42949672.9500 Time_s 0.00 42949672.9500 FORMAT "%13.4" NUMBER 2 /end CHARACTERISTIC
/begin CHARACTERISTIC EGSys_tiHtgDelLSU_C "Verzögerung der Heizungsfreigabe im Fehlerfall" VAL_BLK 0xCDAF0 Kwb_Wu32 42949672.9500 Time_s 0.00 42949672.9500 FORMAT "%13.4" NUMBER 1 /end CHARACTERISTIC
/begin CHARACTERISTIC EGSys_tIntegIni_C "Temperaturschwellwert für die Aktivierung des Wärmemengenintegrators" VAL_BLK 0xCDAF4 Kwb_Ws16 250.0000 Temp_Cels -50.1400 199.8600 FORMAT "%8.4" EXTENDED_LIMITS -3549.940 3003.560 NUMBER 1 /end CHARACTERISTIC
/begin CHARACTERISTIC EGSys_tiOfsClg_C "Abkühlzeitkorrektur Motor wg. Stauwärmeeffekten" VALUE 0xCE2EC Kw_Wu32 42949672.9500 Time_s 0.00 42949672.9500 FORMAT "%13.4" /end CHARACTERISTIC
/begin CHARACTERISTIC EGSys_tiPlsLSU_C "Minimale Dauer für gültigen Gaspuls" VAL_BLK 0xCDAF6 Kwb_Wu16 20.00000 Time_s 0.00 20.00000 FORMAT "%8.5" EXTENDED_LIMITS 0.00 655.3500 NUMBER 1 /end CHARACTERISTIC
/begin CHARACTERISTIC EGSys_tManfDfl_C "Vorgabewert Abgaskrümmertemperatur im Fehlerfall" VALUE 0xCE03E Kw_Ws16 950.000 Temp_Cels -50.140 899.860 FORMAT "%8.3" EXTENDED_LIMITS -3549.940 3003.560 /end CHARACTERISTIC
/begin CHARACTERISTIC EGSys_tManfStat_MAP "Kennfeld zur Ermittlung der stationären Abgaskrümmertemperatur" MAP 0xCE040 Kf_Xs16_Ys16_Ws16 950.000 Temp_Cels -50.140 899.860 FORMAT "%8.3" EXTENDED_LIMITS -3549.940 3003.560
 /begin AXIS_DESCR STD_AXIS Eng_nAvrg EngN 10 0.00 8000.000 FORMAT "%8.3" EXTENDED_LIMITS -32768.00 32767.00 DEPOSIT ABSOLUTE /end AXIS_DESCR
 /begin AXIS_DESCR STD_AXIS InjCtl_qCurr InjMassCyc 8 0.00 100.0000 FORMAT "%8.4" EXTENDED_LIMITS -327.6800 327.6700 DEPOSIT ABSOLUTE /end AXIS_DESCR
/end CHARACTERISTIC
/begin CHARACTERISTIC EGSys_tNSCDfl_C "Ersatzwert für NSC Temperatur" VALUE 0xCE112 Kw_Ws16 950.000 Temp_Cels -50.140 899.860 FORMAT "%8.3" EXTENDED_LIMITS -3549.940 3003.560 /end CHARACTERISTIC
/begin CHARACTERISTIC EGSys_tNSCExoIncr_MAP "Kennfeld für Temperaturerhöhung im NSC aufgrund chemischer Reaktionen" MAP 0xCE114 Kf_Xs16_Ys16_Ws16 1095.000 TempDiff_Cels -45.00000 1050.000 FORMAT "%8.3" EXTENDED_LIMITS -3276.800 3276.700
 /begin AXIS_DESCR STD_AXIS EGSys_tAvrgNSC_mp Temp_Cels 8 -50.140 899.860 FORMAT "%8.3" EXTENDED_LIMITS -3549.940 3003.560 DEPOSIT ABSOLUTE /end AXIS_DESCR
 /begin AXIS_DESCR STD_AXIS EGSys_rLmbdAprx lambda 8 -30.00000 30.00000 FORMAT "%8.5" EXTENDED_LIMITS -32.76800 32.76700 DEPOSIT ABSOLUTE /end AXIS_DESCR
/end CHARACTERISTIC
/begin CHARACTERISTIC EGSys_tOxiCatDfl_C "Ersatzwert Oxidationskatalysatortemperatur" VALUE 0xCE1E6 Kw_Ws16 950.000 Temp_Cels -50.140 899.860 FORMAT "%8.3" EXTENDED_LIMITS -3549.940 3003.560 /end CHARACTERISTIC
/begin CHARACTERISTIC EGSys_tOxiCatExoIncr_MAP "Kennfeld für Tempertaturerhöhung im Oxidationskatalysator aufgrund chemischer Reaktionen" MAP 0xCE1E8 Kf_Xs16_Ys16_Ws16 1095.000 TempDiff_Cels -45.00000 1050.000 FORMAT "%8.3" EXTENDED_LIMITS -3276.800 3276.700
 /begin AXIS_DESCR STD_AXIS EGSys_tAvrgOxiCat_mp Temp_Cels 8 -50.140 899.860 FORMAT "%8.3" EXTENDED_LIMITS -3549.940 3003.560 DEPOSIT ABSOLUTE /end AXIS_DESCR
 /begin AXIS_DESCR STD_AXIS EGSys_rLmbdAprx lambda 8 -30.00000 30.00000 FORMAT "%8.5" EXTENDED_LIMITS -32.76800 32.76700 DEPOSIT ABSOLUTE /end AXIS_DESCR
/end CHARACTERISTIC
/begin CHARACTERISTIC EGSys_tStrtCsRepl_C "Ersatzwert für Initialisierungstemperaturen der abgasführen den Bauteile im Fehlerfall" VALUE 0xCE2F0 Kw_Ws16 950.000 Temp_Cels -50.140 899.860 FORMAT "%8.3" EXTENDED_LIMITS -3549.940 3003.560 /end CHARACTERISTIC
/begin CHARACTERISTIC EGSys_tThresLSUAct_C "Temperaturschwellwert für reversible TPE" VAL_BLK 0xCDAF8 Kwb_Ws16 250.0000 Temp_Cels -50.1400 199.8600 FORMAT "%8.4" EXTENDED_LIMITS -3549.940 3003.560 NUMBER 1 /end CHARACTERISTIC
/begin CHARACTERISTIC EGSys_tTubeDfl_C "Ersatzwert Abgasrohr-Temperatur" VAL_BLK 0xCE424 Kwb_Ws16 950.000 Temp_Cels -50.140 899.860 FORMAT "%8.3" EXTENDED_LIMITS -3549.940 3003.560 NUMBER 2 /end CHARACTERISTIC
/begin CHARACTERISTIC EGSys_tTubeIKi_C "I-Verstärkung Integrator zur Abgasrohr-Temperaturmodellierung" VALUE 0xCE428 Kw_Wu32 4.00003045797 Ki_Kelv_Sec 0.00 4.00003045797 FORMAT "%13.11" EXTENDED_LIMITS 0.00 9999999.99767 /end CHARACTERISTIC
/begin CHARACTERISTIC EGSys_tTubeIKiPos_C "I-Verstärkung Integrator Abgasrohr-Temperaturmodellierung für pos. Großsignalbereich" VALUE 0xCE42C Kw_Wu32 4.00003045797 Ki_Kelv_Sec 0.00 4.00003045797 FORMAT "%13.11" EXTENDED_LIMITS 0.00 9999999.99767 /end CHARACTERISTIC
/begin CHARACTERISTIC EGSys_tTubeIKiNeg_C "I-Verstärkung Integrator Abgasrohr-Temperaturmodellierung für neg. Großsignalbereich" VALUE 0xCE430 Kw_Wu32 4.00003045797 Ki_Kelv_Sec 0.00 4.00003045797 FORMAT "%13.11" EXTENDED_LIMITS 0.00 9999999.99767 /end CHARACTERISTIC
/begin CHARACTERISTIC EGSys_tTubeIWinPos_C "Obere Kleinstwertgrenze Integrator zur Abgasrohr-Temperaturmodellierung" VALUE 0xCE434 Kw_Ws16 65535.00 OneToOne -32768.00 32767.00 FORMAT "%8.2" READ_ONLY /end CHARACTERISTIC
/begin CHARACTERISTIC EGSys_tTubeIWinNeg_C "Untere Kleinstwertgrenze Integrator zur Abgasrohr-Temperaturmodellierung" VALUE 0xCE436 Kw_Ws16 65535.00 OneToOne -32768.00 32767.00 FORMAT "%8.2" READ_ONLY /end CHARACTERISTIC
/begin CHARACTERISTIC EGSys_tWtEquiv_C "äquivalente Wassertemperatur beim Verdampfen" VAL_BLK 0xCDAFA Kwb_Ws16 950.000 Temp_Cels -50.140 899.860 FORMAT "%8.3" EXTENDED_LIMITS -3549.940 3003.560 NUMBER 1 /end CHARACTERISTIC
/begin CHARACTERISTIC EGSys_vscDynEG_CUR "Dynamische Viskosität Abgas (nicht applizierbar)" CURVE 0xCDD82 Kl_Xs16_Ws16 0.9998779 Fact 0.0001220703 1.000000 FORMAT "%8.6" EXTENDED_LIMITS -4.000000 3.999878 READ_ONLY
 /begin AXIS_DESCR STD_AXIS EGSys_tEGLSUInpCrv0_mp Temp_Cels 8 -50.140 899.860 FORMAT "%8.3" EXTENDED_LIMITS -3549.940 3003.560 DEPOSIT ABSOLUTE /end AXIS_DESCR
/end CHARACTERISTIC
/begin CHARACTERISTIC EGSys_vscKinEG_CUR "Kinematische Viskosität Abgas (nicht applizierbar)" CURVE 0xCDDA4 Kl_Xs16_Ws16 0.9998779 Fact 0.0001220703 1.000000 FORMAT "%8.6" EXTENDED_LIMITS -4.000000 3.999878 READ_ONLY
 /begin AXIS_DESCR STD_AXIS EGSys_tEGLSUInpCrv0_mp Temp_Cels 8 -50.140 899.860 FORMAT "%8.3" EXTENDED_LIMITS -3549.940 3003.560 DEPOSIT ABSOLUTE /end AXIS_DESCR
/end CHARACTERISTIC
/begin CHARACTERISTIC EGSys_wLSUIKi_C "Verstärkung des Integrators" VAL_BLK 0xCDAFC Kwb_Ws16 5.000000 OneToOne 0.00 5.000000 FORMAT "%8.6" EXTENDED_LIMITS -32768.00 32767.00 NUMBER 1 /end CHARACTERISTIC
/begin CHARACTERISTIC EGSys_wThresLSU0_MAP "Wärmeschwellen Grundkennfeld Lambdasonde 0" MAP 0xCDAFE Kf_Xs16_Ys16_Ws16 6000.000 Energy 0.00 6000.000 FORMAT "%8.3" EXTENDED_LIMITS -32768.00 32767.00
 /begin AXIS_DESCR STD_AXIS EGSys_tEGLSUInpCrv0_mp Temp_Cels 10 -50.140 899.860 FORMAT "%8.3" EXTENDED_LIMITS -3549.940 3003.560 DEPOSIT ABSOLUTE /end AXIS_DESCR
 /begin AXIS_DESCR STD_AXIS Eng_tEng Temp_Cels 10 -50.140 899.860 FORMAT "%8.3" EXTENDED_LIMITS -3549.940 3003.560 DEPOSIT ABSOLUTE /end AXIS_DESCR
/end CHARACTERISTIC
/begin MEASUREMENT DfpErrCol_mp "Meßpunkt der für alle Fehlerpfade die Fehlerinformation gesammelt zur Verfügung stellt." UWORD OneToOne 1 100 0.00 65535.00 FORMAT "%8.2" ARRAY_SIZE 22 ECU_ADDRESS 0x6F802A /end MEASUREMENT
/begin MEASUREMENT DFPM_stFCMChkCause "Message für DSM internen gebrauch (unterstützung bei DSM problemen)" UBYTE FCMChkCause 1 100 1.00000000000 15.0000000000 FORMAT "%13.10" ECU_ADDRESS 0x7FA550 /end MEASUREMENT
/begin MEASUREMENT DfpZyfCol_mp "Meßpunkt der gesammelt für alle Fehlerpfade das Zyklus Bit (getested Info) zur Verfügung stellt." UWORD OneToOne 1 100 0.00 65535.00 FORMAT "%8.2" ARRAY_SIZE 22 ECU_ADDRESS 0x6F8056 /end MEASUREMENT
/begin MEASUREMENT DSCHED_numDefDfpArray_mp "Array von defekten DFPs welche einen ausgewählten FID verriegeln" UWORD DfpName 1 100 0.00 339.000000000 FORMAT "%13.9" ARRAY_SIZE 10 ECU_ADDRESS 0x8FEC68 /end MEASUREMENT
/begin MEASUREMENT DSCHED_numOkDfpArray_mp "Array von nicht defekten DFPs welche einen ausgewählten FID verriegeln" UWORD DfpName 1 100 0.00 339.000000000 FORMAT "%13.9" ARRAY_SIZE 20 ECU_ADDRESS 0x8FEC7C /end MEASUREMENT
/begin MEASUREMENT DSM_ctDfctPath "Anzahl der momentan defekten Fehlerpfade" UWORD OneToOne 1 100 0.00 65535.00 FORMAT "%8.2" ECU_ADDRESS 0x7F8BE0 /end MEASUREMENT
/begin MEASUREMENT DSM_ctFcmEntry "Anzahl der belegten Fehlerspeichereinträge" UBYTE OneToOne 1 100 0.00 255.0 FORMAT "%5.1" ECU_ADDRESS 0x7F884F /end MEASUREMENT
/begin MEASUREMENT DSM_ctFCMEntrySize_mp "Größe eines Fehlerspeichereintrages in Bytes (Inklusive Füllbyte falls vorhanden)" UBYTE OneToOne 1 100 0.00 255.0 FORMAT "%5.1" ECU_ADDRESS 0x8FECA4 /end MEASUREMENT
/begin MEASUREMENT DSM_ctOBDPath "Anzahl der momentanen OBD-fehler im Fehlerspeicher" UBYTE OneToOne 1 100 0.00 255.0 FORMAT "%5.1" ECU_ADDRESS 0x7F8850 /end MEASUREMENT
/begin MEASUREMENT DSM_ctOBDValidPath "Anzahl bestätigter OBD relevanter Fehlerspeicher Einträge." UBYTE OneToOne 1 100 0.00 255.0 FORMAT "%5.1" ECU_ADDRESS 0x7F8851 /end MEASUREMENT
/begin MEASUREMENT DSM_ctPath_mp "Anzahl der existierenden Fehlerpfade" UWORD OneToOne 1 100 0.00 65535.00 FORMAT "%8.2" ECU_ADDRESS 0x8FECA6 /end MEASUREMENT
/begin MEASUREMENT DSM_ctRdyActCyc_mp "Status für jedes Readinessbit aus dem aktuellen driving cycle" UBYTE OneToOne 1 100 0.00 255.0 FORMAT "%5.1" ECU_ADDRESS 0x6F8020 /end MEASUREMENT
/begin MEASUREMENT DSM_ctRdyCycCat_mp "Anzahl der für Readiness Bit Catalyst erreichten Zyklen." UBYTE OneToOne 1 100 0.00 255.0 FORMAT "%5.1" ECU_ADDRESS 0x8FEC4F /end MEASUREMENT
/begin MEASUREMENT DSM_ctRdyCycCompr_mp "Anzahl der für Readiness Bit Comprehensive Components erreichten Zyklen." UBYTE OneToOne 1 100 0.00 255.0 FORMAT "%5.1" ECU_ADDRESS 0x8FEC50 /end MEASUREMENT
/begin MEASUREMENT DSM_ctRdyCycEGR_mp "Anzahl der für Readiness Bit EGR erreichten Zyklen." UBYTE OneToOne 1 100 0.00 255.0 FORMAT "%5.1" ECU_ADDRESS 0x8FEC51 /end MEASUREMENT
/begin MEASUREMENT DSM_ctRdyCycFuel_mp "Anzahl der für Readiness Bit Fuel System erreichten Zyklen." UBYTE OneToOne 1 100 0.00 255.0 FORMAT "%5.1" ECU_ADDRESS 0x8FEC52 /end MEASUREMENT
/begin MEASUREMENT DSM_ctRdyCycMisf_mp "Anzahl der für Readiness Bit Misfire erreichten Zyklen." UBYTE OneToOne 1 100 0.00 255.0 FORMAT "%5.1" ECU_ADDRESS 0x8FEC53 /end MEASUREMENT
/begin MEASUREMENT DSM_ctRdyCycOxSenHt_mp "Anzahl erreichter Zyklen für Readiness Bit Oxygen Sensor Heater" UBYTE OneToOne 1 100 0.00 255.0 FORMAT "%5.1" ECU_ADDRESS 0x8FEC54 /end MEASUREMENT
/begin MEASUREMENT DSM_ctRdyCycOxSen_mp "Anzahl der erreichten Zyklen für Readiness Bit Oxygen Sensor" UBYTE OneToOne 1 100 0.00 255.0 FORMAT "%5.1" ECU_ADDRESS 0x8FEC55 /end MEASUREMENT
/begin MEASUREMENT DSM_ctRdyLimCat_mp "Notwendige Anzahl Zyklen für Readiness Bit Catalyst." UBYTE OneToOne 1 100 0.00 255.0 FORMAT "%5.1" ECU_ADDRESS 0x8FEC56 /end MEASUREMENT
/begin MEASUREMENT DSM_ctRdyLimCompr_mp "Notwendige Anzahl Zyklen für Readiness Bit Comprehensive Components." UBYTE OneToOne 1 100 0.00 255.0 FORMAT "%5.1" ECU_ADDRESS 0x8FEC57 /end MEASUREMENT
/begin MEASUREMENT DSM_ctRdyLimEGR_mp "Notwendige Anzahl Zyklen für Readiness Bit EGR." UBYTE OneToOne 1 100 0.00 255.0 FORMAT "%5.1" ECU_ADDRESS 0x8FEC58 /end MEASUREMENT
/begin MEASUREMENT DSM_ctRdyLimFuel_mp "Notwendige Anzahl Zyklen für Readiness Bit Fuel System." UBYTE OneToOne 1 100 0.00 255.0 FORMAT "%5.1" ECU_ADDRESS 0x8FEC59 /end MEASUREMENT
/begin MEASUREMENT DSM_ctRdyLimMisf_mp "Notwendige Anzahl Zyklen für Readiness Bit Misfire." UBYTE OneToOne 1 100 0.00 255.0 FORMAT "%5.1" ECU_ADDRESS 0x8FEC5A /end MEASUREMENT
/begin MEASUREMENT DSM_ctRdyLimOxSenHt_mp "Notwendige Anzahl von Zyklen für Readiness Bit Oxygen Sensor Heater" UBYTE OneToOne 1 100 0.00 255.0 FORMAT "%5.1" ECU_ADDRESS 0x8FEC5B /end MEASUREMENT
/begin MEASUREMENT DSM_ctRdyLimOxSen_mp "Notwendige Anzahl Zyklen für Readiness Bit Oxygen Sensor" UBYTE OneToOne 1 100 0.00 255.0 FORMAT "%5.1" ECU_ADDRESS 0x8FEC5C /end MEASUREMENT
/begin MEASUREMENT DSM_ctRdyPathsCat_mp "Anzahl von Fehlerpfaden die zum Readiness Bit Catalyst gehören." UBYTE OneToOne 1 100 0.00 255.0 FORMAT "%5.1" ECU_ADDRESS 0x8FEC5D /end MEASUREMENT
/begin MEASUREMENT DSM_ctRdyPathsCompr_mp "Anzahl von Fehlerpfaden die zum Readiness Bit Comprehensive Components gehören." UBYTE OneToOne 1 100 0.00 255.0 FORMAT "%5.1" ECU_ADDRESS 0x8FEC5E /end MEASUREMENT
/begin MEASUREMENT DSM_ctRdyPathsEGR_mp "Anzahl von Fehlerpfaden die zum Readiness Bit EGR gehören." UBYTE OneToOne 1 100 0.00 255.0 FORMAT "%5.1" ECU_ADDRESS 0x8FEC5F /end MEASUREMENT
/begin MEASUREMENT DSM_ctRdyPathsFuel_mp "Anzahl von Fehlerpfaden die zum Readiness Bit Fuel System gehören." UBYTE OneToOne 1 100 0.00 255.0 FORMAT "%5.1" ECU_ADDRESS 0x8FEC60 /end MEASUREMENT
/begin MEASUREMENT DSM_ctRdyPathsMisf_mp "Anzahl von Fehlerpfaden die zum Readiness Bit Misfire gehören." UBYTE OneToOne 1 100 0.00 255.0 FORMAT "%5.1" ECU_ADDRESS 0x8FEC61 /end MEASUREMENT
/begin MEASUREMENT DSM_ctRdyPathsOxSenHt_mp "Anzahl von Fehlerpfaden, die zum Readiness Bit Oxygen Sensor Heater gehören" UBYTE OneToOne 1 100 0.00 255.0 FORMAT "%5.1" ECU_ADDRESS 0x8FEC62 /end MEASUREMENT
/begin MEASUREMENT DSM_ctRdyPathsOxSen_mp "Anzahl der Fehlerpfade die zum Readiness Bit Oxygen Sensor gehören" UBYTE OneToOne 1 100 0.00 255.0 FORMAT "%5.1" ECU_ADDRESS 0x8FEC63 /end MEASUREMENT
/begin MEASUREMENT DSM_ctRdyTstCat_mp "Anzahl von in diesem Zyklus getesteten Fehlerpfaden die zum Readiness Bit Catalyst gehören." UBYTE OneToOne 1 100 0.00 255.0 FORMAT "%5.1" ECU_ADDRESS 0x8FEC64 /end MEASUREMENT
/begin MEASUREMENT DSM_ctRdyTstCompr_mp "Anzahl von in diesem Zyklus getesteten Fehlerpfaden die zum Readiness Bit Comprehensive Components  gehören." UBYTE OneToOne 1 100 0.00 255.0 FORMAT "%5.1" ECU_ADDRESS 0x6F8022 /end MEASUREMENT
/begin MEASUREMENT DSM_ctRdyTstEGR_mp "Anzahl von in diesem Zyklus getesteten Fehlerpfaden die zum Readiness Bit EGR gehören." UBYTE OneToOne 1 100 0.00 255.0 FORMAT "%5.1" ECU_ADDRESS 0x6F8024 /end MEASUREMENT
/begin MEASUREMENT DSM_ctRdyTstFuel_mp "Anzahl von in diesem Zyklus getesteten Fehlerpfaden die zum Readiness Bit Fuel System gehören." UBYTE OneToOne 1 100 0.00 255.0 FORMAT "%5.1" ECU_ADDRESS 0x6F8026 /end MEASUREMENT
/begin MEASUREMENT DSM_ctRdyTstMisf_mp "Anzahl von in diesem Zyklus getesteten Fehlerpfaden die zum Readiness Bit Misfire  gehören." UBYTE OneToOne 1 100 0.00 255.0 FORMAT "%5.1" ECU_ADDRESS 0x6F8028 /end MEASUREMENT
/begin MEASUREMENT DSM_ctRdyTstOxSenHt_mp "Anzahl von in diesem Zyklus getesteten Fehlerpfaden die zum Readiness Bit Oxygen Sensor Heater gehören." UBYTE OneToOne 1 100 0.00 255.0 FORMAT "%5.1" ECU_ADDRESS 0x8FEC65 /end MEASUREMENT
/begin MEASUREMENT DSM_ctRdyTstOxSen_mp "Anzahl von in diesem Zyklus getesteten Fehlerpfaden die zum Readiness Bit Oxygen Sensor Heater gehören." UBYTE OneToOne 1 100 0.00 255.0 FORMAT "%5.1" ECU_ADDRESS 0x8FEC66 /end MEASUREMENT
/begin MEASUREMENT DSM_ctTstPath "Anzahl der getesteten Fehlerpfade" UWORD OneToOne 1 100 0.00 65535.00 FORMAT "%8.2" ECU_ADDRESS 0x7F8BE2 /end MEASUREMENT
/begin MEASUREMENT DSM_ctWUC "Anzahl der Warm Up Cycle seit dem letzten Fehlerspeicherlöschen  (PID $30)" UBYTE OneToOne 1 100 0.00 255.0 FORMAT "%5.1" ECU_ADDRESS 0x7FEF30 /end MEASUREMENT
/begin MEASUREMENT DSM_lDist "Anzahl der gefahrenen Strecke seitdem letzten Fehlerspeicherlöschen (PID $31)" UWORD OneToOne 1 100 0.00 65535.00 FORMAT "%8.2" ECU_ADDRESS 0x7FEF32 /end MEASUREMENT
/begin MEASUREMENT DSM_stCycles "Status der DSM Trigger Zyklen (WUC, DC, ...)" UBYTE OneToOne 1 100 0.00 255.0 FORMAT "%5.1" ECU_ADDRESS 0x7F8852 /end MEASUREMENT
/begin MEASUREMENT DSM_stECUMasterSlave "Statusinformation ob das Steuergerät ein Master- oder ein Slave-Steuergerät ist" UBYTE OneToOne 1 100 0.00 255.0 FORMAT "%5.1" ECU_ADDRESS 0x7F8853 /end MEASUREMENT
/begin MEASUREMENT DSM_stInhDelay "Status Fehlerverriegelungs Verzögerung (1 wenn mindestens 1 Verzögerung aktiv)" UBYTE OneToOne 1 100 0.00 255.0 FORMAT "%5.1" ECU_ADDRESS 0x7F8854 /end MEASUREMENT
/begin MEASUREMENT DSM_stMIL "DSM Mil Anforderungsstatus (1 = kontinuierlich, 2 blinkend)" UBYTE OneToOne 1 100 0.00 255.0 FORMAT "%5.1" ECU_ADDRESS 0x7F8855 /end MEASUREMENT
/begin MEASUREMENT DSM_stPID41 "Readiness Status für Diagnoseschnittstelle gemäß ISO/DIS 15031-6.5, PID41" ULONG OneToOne 1 100 0.00 4294967295.00 FORMAT "%13.2" ECU_ADDRESS 0x7F9170 /end MEASUREMENT
/begin MEASUREMENT DSM_stRdyAB "Readiness Status für Diagnoseschnittstelle gemäß SAE J1979 PID1 Byte A + B" UWORD OneToOne 1 100 0.00 65535.00 FORMAT "%8.2" ECU_ADDRESS 0x7F8BE4 /end MEASUREMENT
/begin MEASUREMENT DSM_stRdyCD "Readiness Status für Diagnoseschnittstelle gemäß SAE J1979 PID1 Byte C * D" UWORD OneToOne 1 100 0.00 65535.00 FORMAT "%8.2" ECU_ADDRESS 0x7F8BE6 /end MEASUREMENT
/begin MEASUREMENT DSM_stRdyCheckEnable "veroderte ready-bits der dfps, die durch die Funktion DSM_SetDfpSleep ermittelt wurden" UBYTE OneToOne 1 100 0.00 255.0 FORMAT "%5.1" ECU_ADDRESS 0x7F8856 /end MEASUREMENT
/begin MEASUREMENT DSM_stSysLamp "DSM System Lampen Anforderungsstatus (1 = kontinuierlich)" UBYTE OneToOne 1 100 0.00 255.0 FORMAT "%5.1" ECU_ADDRESS 0x7F8857 /end MEASUREMENT
/begin MEASUREMENT DSM_tiDCDelay_mp "aktuelle Zeit für Driving cycle Verzögerungszeit" UWORD OneToOne 1 100 0.00 65535.00 FORMAT "%8.2" ECU_ADDRESS 0x6F8082 /end MEASUREMENT
/begin MEASUREMENT EATSCD_swtSig "Signalquelle Umgebungstemperatur (ADC oder CAN)" UBYTE OneToOne 1 100 0.00 255.0 FORMAT "%5.1" ECU_ADDRESS 0x7F8858 /end MEASUREMENT
/begin MEASUREMENT EATSCD_tAir "Umgebungstemperatur" SWORD Temp_Cels 1 100 -50.140 899.860 FORMAT "%8.3" ECU_ADDRESS 0x7F8BEC /end MEASUREMENT
/begin MEASUREMENT EATSCD_tAirLin "linearisierter Wert der Umgebungstemperatur" SWORD Temp_Cels 1 100 -50.140 899.860 FORMAT "%8.3" ECU_ADDRESS 0x7F8BEE /end MEASUREMENT
/begin MEASUREMENT EATSCD_uRaw "Spannungsrohwert der Umgebungstemperatur" SWORD Volt 1 100 0.00 5000.000 FORMAT "%8.3" ECU_ADDRESS 0x7F8BF0 /end MEASUREMENT
/begin MEASUREMENT EBAFCD_stSigOut "source of activation for electrical power stage of EBAFCD output" UBYTE OneToOne 1 100 0.00 255.0 FORMAT "%5.1" ECU_ADDRESS 0x7F8859 /end MEASUREMENT
/begin MEASUREMENT EBAFCD_st_mp "Status of Engine Bay Air Flap" UBYTE OneToOne 1 100 0.00 255.0 FORMAT "%5.1" ECU_ADDRESS 0x8FECD4 /end MEASUREMENT
/begin MEASUREMENT EBFCD_stOut "status output of EBFCD" UBYTE OneToOne 1 100 0.00 255.0 FORMAT "%5.1" ECU_ADDRESS 0x7F885A /end MEASUREMENT
/begin MEASUREMENT EBFCD_st_mp "Status of output of EBFCD" UBYTE OneToOne 1 100 0.00 255.0 FORMAT "%5.1" ECU_ADDRESS 0x8FECD5 /end MEASUREMENT
/begin MEASUREMENT EBTSCD_tCIntLin "ECU temperature linearized value" SWORD Temp_Cels 1 100 -50.140 899.860 FORMAT "%8.3" ECU_ADDRESS 0x7F8BF2 /end MEASUREMENT
/begin MEASUREMENT EBTSCD_tECU "ECU temperature current value" SWORD Temp_Cels 1 100 -50.140 899.860 FORMAT "%8.3" ECU_ADDRESS 0x7F8BF4 /end MEASUREMENT
/begin MEASUREMENT EBTSCD_uRawTECU_mp "Raw sensor voltage" SWORD Volt 1 100 -160156.4 160151.5 FORMAT "%8.1" ECU_ADDRESS 0x8FECD6 /end MEASUREMENT
/begin MEASUREMENT EEPCD_stErrSet "Allgemeiner Fehlerzustand bei der Aktivierung einer Konfiguration" UBYTE OneToOne 1 100 0.00 255.0 FORMAT "%5.1" ECU_ADDRESS 0x7F885B /end MEASUREMENT
/begin MEASUREMENT EEPCD_stMIL "Variant manager default status of MIL lamp" UBYTE OneToOne 1 100 0.00 255.0 FORMAT "%5.1" ECU_ADDRESS 0x7F885C /end MEASUREMENT
/begin MEASUREMENT EGPpCD_stActrOut "status of exhaust gas pressure pipe actuator" UBYTE OneToOne 1 100 0.00 255.0 FORMAT "%5.1" ECU_ADDRESS 0x7F885D /end MEASUREMENT
/begin MEASUREMENT EGPp_dvolSil_mp "Abgasvolumenstrom nach Partikelfilter" SWORD CubMtrPerHr 1 100 -3276.800 3276.700 FORMAT "%8.3" ECU_ADDRESS 0x8FECD8 /end MEASUREMENT
/begin MEASUREMENT EGPp_pPstPFlt "Druckabfall des Abgassystems nach Partikelfilter" SWORD Pres_hPa 1 100 -32768.00 32767.00 FORMAT "%8.2" ECU_ADDRESS 0x7F8BF8 /end MEASUREMENT
/begin MEASUREMENT EGPp_pPstPFltMap_mp "Druckabfall nach Partikelfilter aus Kennfeldberechnung" SWORD Pres_hPa 1 100 -32768.00 32767.00 FORMAT "%8.2" ECU_ADDRESS 0x8FECDA /end MEASUREMENT
/begin MEASUREMENT EGPp_pPstPFltSim_mp "Druckabfall nach Partikelfilter aus Simulation" SWORD Pres_hPa 1 100 -32768.00 32767.00 FORMAT "%8.2" ECU_ADDRESS 0x8FECDC /end MEASUREMENT
/begin MEASUREMENT EGPp_stLogicOut "Status of Exhaust gas pressure pump" UBYTE OneToOne 1 100 0.00 255.0 FORMAT "%5.1" ECU_ADDRESS 0x7F885E /end MEASUREMENT
/begin MEASUREMENT EGRCD_rCnv_mp "Tastverhältnis  basierend auf dem Ausgang des Abgasrückführreglers" SWORD DtyCyc 1 100 -327.6800 327.6700 FORMAT "%8.4" ECU_ADDRESS 0x8FECDE /end MEASUREMENT
/begin MEASUREMENT EGRCD_rOut "Tastverhältnis zür Endstufenansteuerung" SWORD DtyCyc 1 100 -327.6800 327.6700 FORMAT "%8.4" ECU_ADDRESS 0x7F8BFA /end MEASUREMENT
/begin MEASUREMENT EGRVlv_rEGR "Ansteuertastverhältnis für ARF-Ventil" SWORD Prc 1 100 -400.0000 399.9878 FORMAT "%8.4" ECU_ADDRESS 0x7F8BFC /end MEASUREMENT
/begin MEASUREMENT EGRVlv_rEGR2 "Sollwert für Abgasrückführung Coordinator 2" SWORD Prc 1 100 -400.0000 399.9878 FORMAT "%8.4" ECU_ADDRESS 0x7F8BFE /end MEASUREMENT
/begin MEASUREMENT EGRVlv_rEGR2Byp_mp "measuringpoint2 to be able to read value by ASCET before bypass" SWORD Prc 1 100 -400.0000 399.9878 FORMAT "%8.4" ECU_ADDRESS 0x8FECE0 /end MEASUREMENT
/begin MEASUREMENT EGRVlv_rEGRByp_mp "Bypass-Label, Kopie von EGRVlv_rEGR" SWORD Prc 1 100 -400.0000 399.9878 FORMAT "%8.4" ECU_ADDRESS 0x8FECE2 /end MEASUREMENT
/begin MEASUREMENT EGSys_AlpEGTube_mp "Wärmeübertragungskoeffizient zwischen Abgas und Abgasrohr" SWORD ThermalCoEff 1 100 -3276.800 3276.700 FORMAT "%8.3" ARRAY_SIZE 2 ECU_ADDRESS 0x8FED68 /end MEASUREMENT
/begin MEASUREMENT EGSys_AlpTubeEnv_mp "Wärmeübertragungskoeffizient zwischen Abgasrohr und Umgebung" SWORD ThermalCoEff 1 100 -3276.800 3276.700 FORMAT "%8.3" ARRAY_SIZE 2 ECU_ADDRESS 0x8FED6C /end MEASUREMENT
/begin MEASUREMENT EGSys_cndHtEGi_mp "Wärmeleitfähigkeit Abgas im Rohr" SWORD Fact 1 100 -4.000000 3.999878 FORMAT "%8.6" ARRAY_SIZE 2 ECU_ADDRESS 0x8FED70 /end MEASUREMENT
/begin MEASUREMENT EGSys_cndHtEGo_mp "Wärmeleitfähigkeit Luft ausserhalb des Rohres" SWORD Fact 1 100 -4.000000 3.999878 FORMAT "%8.6" ARRAY_SIZE 2 ECU_ADDRESS 0x8FED74 /end MEASUREMENT
/begin MEASUREMENT EGSys_cpEGLSU_mp "Spezifische Wärmekapazität des Abgases" SWORD SpecificHeat 1 100 -3.276800 3.276700 FORMAT "%8.6" ARRAY_SIZE 1 ECU_ADDRESS 0x8FECE4 /end MEASUREMENT
/begin MEASUREMENT EGSys_cpEGNSC_mp "Spezifische Wärmekapazität Abgas im NSC" SWORD SpecificHeat 1 100 -3.276800 3.276700 FORMAT "%8.6" ECU_ADDRESS 0x8FED2C /end MEASUREMENT
/begin MEASUREMENT EGSys_cpEGOxiCat_mp "Spezifische Wärmekapazität Abgas im Oxidationskatalysator" SWORD SpecificHeat 1 100 -3.276800 3.276700 FORMAT "%8.6" ECU_ADDRESS 0x8FED34 /end MEASUREMENT
/begin MEASUREMENT EGSys_cpEGTrbn_mp "Spezifische Wärmekapazität Abgas in Turbine" SWORD SpecificHeat 1 100 -3.276800 3.276700 FORMAT "%8.6" ECU_ADDRESS 0x8FED5C /end MEASUREMENT
/begin MEASUREMENT EGSys_cpEGTube_mp "Spezifsche Wärmekapazität Abgas im Abgasrohr" SWORD SpecificHeat 1 100 -3.276800 3.276700 FORMAT "%8.6" ARRAY_SIZE 2 ECU_ADDRESS 0x8FED78 /end MEASUREMENT
/begin MEASUREMENT EGSys_ctCldStrtLSU_mp "Zähler für wiederholte Kaltstarts" UBYTE OneToOne 1 100 0.00 255.0 FORMAT "%5.1" ARRAY_SIZE 1 ECU_ADDRESS 0x6F8085 /end MEASUREMENT
/begin MEASUREMENT EGSys_dmEG "näherungsweiser Abgasmassenstrom" SWORD AirMassPerTime 1 100 -3276.800 3276.700 FORMAT "%8.3" ECU_ADDRESS 0x7F8C00 /end MEASUREMENT
/begin MEASUREMENT EGSys_dtTube_mp "Temperaturänderung Abgasrohr" SWORD Temp_Kelv_Sec 1 100 -327.6800 327.6700 FORMAT "%8.4" ARRAY_SIZE 2 ECU_ADDRESS 0x8FED7C /end MEASUREMENT
/begin MEASUREMENT EGSys_dwFlCmb_mp "Wärmestrom durch spät nacheingespritzte Kraftstoffmenge" SLONG Pwr1 1 100 -214748364.800 214748364.700 FORMAT "%13.3" ECU_ADDRESS 0x8FED38 /end MEASUREMENT
/begin MEASUREMENT EGSys_dwLSU_mp "Abgaswärmestrom an Sondenposition" SWORD Pwr_kW_Sec 1 100 -327.6800 327.6700 FORMAT "%8.4" ARRAY_SIZE 1 ECU_ADDRESS 0x8FECE6 /end MEASUREMENT
/begin MEASUREMENT EGSys_dwTubeIn_mp "Eintretender Wärmestrom Abgasrohr" SLONG Pwr1 1 100 -214748364.800 214748364.700 FORMAT "%13.3" ARRAY_SIZE 2 ECU_ADDRESS 0x8FED80 /end MEASUREMENT
/begin MEASUREMENT EGSys_dwTubeOut_mp "Austretender Wärmestrom Abgasrohr" SLONG Pwr1 1 100 -214748364.800 214748364.700 FORMAT "%13.3" ARRAY_SIZE 2 ECU_ADDRESS 0x8FED88 /end MEASUREMENT
/begin MEASUREMENT EGSys_dwTube_mp "Wärmeänderung Abgasrohr" SLONG Pwr1 1 100 -214748364.800 214748364.700 FORMAT "%13.3" ARRAY_SIZE 2 ECU_ADDRESS 0x8FED90 /end MEASUREMENT
/begin MEASUREMENT EGSys_etaChrg_mp "Gesamtwirkungsgrad Turbolader" SWORD Fact 1 100 -4.000000 3.999878 FORMAT "%8.6" ECU_ADDRESS 0x8FED5E /end MEASUREMENT
/begin MEASUREMENT EGSys_facAirMass_mp "Luftmassen-Korrekturfaktor für stationäre Abgaskrümmertemperatur" SWORD Fact 1 100 -4.000000 3.999878 FORMAT "%8.6" ECU_ADDRESS 0x8FED1A /end MEASUREMENT
/begin MEASUREMENT EGSys_facPT1Chrg_mp "Variabler Faktor für thermische Zeitkonstante Lader" SWORD Fact_PT1 1 100 -256.0000 255.9922 FORMAT "%8.4" ECU_ADDRESS 0x8FED60 /end MEASUREMENT
/begin MEASUREMENT EGSys_facStrtDlv_mp "Förderbeginn-Korrekturfaktor für stationäre Abgaskrümmertemperatur" SWORD Fact 1 100 -4.000000 3.999878 FORMAT "%8.6" ECU_ADDRESS 0x8FED1C /end MEASUREMENT
/begin MEASUREMENT EGSys_NuTubeEnv_mp "Nusselt-Zahl Aussenumströmung Abgasrohr" SWORD OneToOne 1 100 -32768.00 32767.00 FORMAT "%8.2" ARRAY_SIZE 2 ECU_ADDRESS 0x8FED98 /end MEASUREMENT
/begin MEASUREMENT EGSys_NuTube_mp "Nusselt-Zahl im Abgasrohr" SWORD OneToOne 1 100 -32768.00 32767.00 FORMAT "%8.2" ARRAY_SIZE 2 ECU_ADDRESS 0x8FED9C /end MEASUREMENT
/begin MEASUREMENT EGSys_pExhGas "Abgasgegendruck" SWORD Pres_hPa 1 100 -32768.00 32767.00 FORMAT "%8.2" ARRAY_SIZE 1 ECU_ADDRESS 0x7F8C02 /end MEASUREMENT
/begin MEASUREMENT EGSys_phiDiffStrt_mp "Differenz zwischen Förderbeginn im Auslegungspunkt und aktuellem Wert" SWORD AngleCrS 1 100 -768.0000 767.9766 FORMAT "%8.4" ECU_ADDRESS 0x8FED1E /end MEASUREMENT
/begin MEASUREMENT EGSys_pwrCmpr_mp "Verdichterleistung" SWORD Pwr 1 100 -308831.1 308821.7 FORMAT "%8.1" ECU_ADDRESS 0x8FED62 /end MEASUREMENT
/begin MEASUREMENT EGSys_qMIStd "Vor- und haupteingespritzte Kraftstoffmenge (im Brennraum verbrannt)" SWORD InjMassCyc 1 100 -327.6800 327.6700 FORMAT "%8.4" ECU_ADDRESS 0x7F8C04 /end MEASUREMENT
/begin MEASUREMENT EGSys_qPoIRgn "Spät nacheingespritzte Kraftstoffmenge (nicht im Brennraum verbrannt)" SWORD InjMassInj 1 100 -327.6800 327.6700 FORMAT "%8.4" ECU_ADDRESS 0x7F8C06 /end MEASUREMENT
/begin MEASUREMENT EGSys_rAirPerTime_mp "Verhältnis Luftmassenstrom im Auslegungspunkt zu aktuellem Wert" SWORD Fact 1 100 -4.000000 3.999878 FORMAT "%8.6" ECU_ADDRESS 0x8FED20 /end MEASUREMENT
/begin MEASUREMENT EGSys_ReTubeEnvInpCrv_mp "Messpunkt Eingangswert Kurve EGSys_NuTubeEnv_CUR" SWORD OneToOne 1 100 -32768.00 32767.00 FORMAT "%8.2" ECU_ADDRESS 0x8FEDA0 /end MEASUREMENT
/begin MEASUREMENT EGSys_ReTubeEnv_mp "Reynolds-Zahl Aussenumströmung Abgasrohr" SWORD OneToOne 1 100 -32768.00 32767.00 FORMAT "%8.2" ARRAY_SIZE 2 ECU_ADDRESS 0x8FEDA2 /end MEASUREMENT
/begin MEASUREMENT EGSys_ReTubeInpCrv_mp "Messpunkt Eingang Kurve EGSys_NuTube_CUR" SWORD ReynoldsNum 1 100 -3276800. 3276700. FORMAT "%8.0" ECU_ADDRESS 0x8FEDA6 /end MEASUREMENT
/begin MEASUREMENT EGSys_ReTube_mp "Reynolds-Zahl im Abgasrohr" SWORD ReynoldsNum 1 100 -3276800. 3276700. FORMAT "%8.0" ARRAY_SIZE 2 ECU_ADDRESS 0x8FEDA8 /end MEASUREMENT
/begin MEASUREMENT EGSys_rLmbdAprx "näherungsweiser Lambda-Wert" SWORD lambda 1 100 -32.76800 32.76700 FORMAT "%8.5" ECU_ADDRESS 0x7F8C08 /end MEASUREMENT
/begin MEASUREMENT EGSys_rPresCmpr_mp "Verdichterdruckverhältnis" SWORD Fact 1 100 -4.000000 3.999878 FORMAT "%8.6" ECU_ADDRESS 0x8FED64 /end MEASUREMENT
/begin MEASUREMENT EGSys_rTempClnt_mp "Verhältnis Motorübertemperatur Motorstart / -stop" SWORD Fact 1 100 -4.000000 3.999878 FORMAT "%8.6" ECU_ADDRESS 0x8FED48 /end MEASUREMENT
/begin MEASUREMENT EGSys_rTimeNSC_mp "Verhältnis Standzeit zu Halbwertszeit NSC" SWORD Fact1 1 100 -256.0000 255.9922 FORMAT "%8.4" ECU_ADDRESS 0x8FED4A /end MEASUREMENT
/begin MEASUREMENT EGSys_rTimeOxiCat_mp "Verhältnis Standzeit zu Halbwertszeit Oxidationskatalysator" SWORD Fact1 1 100 -256.0000 255.9922 FORMAT "%8.4" ECU_ADDRESS 0x8FED4C /end MEASUREMENT
/begin MEASUREMENT EGSys_rTimeTrb_mp "Verhältnis-Stillstand-Zeit / Halbzeit-Periode turbocharger" SWORD Fact1 1 100 -256.0000 255.9922 FORMAT "%8.4" ECU_ADDRESS 0x8FED4E /end MEASUREMENT
/begin MEASUREMENT EGSys_rTimeTube_mp "Verhältnis Standzeit zu Halbwertszeit Abgasrohr" SWORD Fact1 1 100 -256.0000 255.9922 FORMAT "%8.4" ARRAY_SIZE 2 ECU_ADDRESS 0x8FED44 /end MEASUREMENT
/begin MEASUREMENT EGSys_sqTube_mp "Oberfläche Abgasrohr" SWORD Area 1 100 -4.000000 3.999878 FORMAT "%8.6" ARRAY_SIZE 2 ECU_ADDRESS 0x8FEDAC /end MEASUREMENT
/begin MEASUREMENT EGSys_stHtgLSU "Statusbit Freigabe Sensor-Heizung" UBYTE OneToOne 1 100 0.00 255.0 FORMAT "%5.1" ARRAY_SIZE 1 ECU_ADDRESS 0x7F885F /end MEASUREMENT
/begin MEASUREMENT EGSys_stHtgLSULstTrp_mp "Status der Taupunktfreigabe des letzten Fahrzyklus" UBYTE OneToOne 1 100 0.00 255.0 FORMAT "%5.1" ARRAY_SIZE 1 ECU_ADDRESS 0x8FECE8 /end MEASUREMENT
/begin MEASUREMENT EGSys_stHtgThresLSUHit_mp "Statusmessage für Überschreiten des Wärmemengenschwellwertes" UBYTE OneToOne 1 100 0.00 255.0 FORMAT "%5.1" ARRAY_SIZE 1 ECU_ADDRESS 0x8FECE9 /end MEASUREMENT
/begin MEASUREMENT EGSys_stIntegIni_mp "Status Integrator Initialisierung" UBYTE OneToOne 1 100 0.00 255.0 FORMAT "%5.1" ARRAY_SIZE 1 ECU_ADDRESS 0x8FECEA /end MEASUREMENT
/begin MEASUREMENT EGSys_stPlsLSU_mp "Status-Bit gültiger Gaspuls" UBYTE OneToOne 1 100 0.00 255.0 FORMAT "%5.1" ARRAY_SIZE 1 ECU_ADDRESS 0x8FECEB /end MEASUREMENT
/begin MEASUREMENT EGSys_tAvrgEGTrbn_mp "Mittlere Abgastemperatur in Turbine" SWORD Temp_Cels 1 100 -50.140 899.860 FORMAT "%8.3" ECU_ADDRESS 0x8FED66 /end MEASUREMENT
/begin MEASUREMENT EGSys_tAvrgEGTube_mp "Mittlere Abgastemperatur im Abgasrohr" SWORD Temp_Cels 1 100 -50.140 899.860 FORMAT "%8.3" ARRAY_SIZE 2 ECU_ADDRESS 0x8FEDB0 /end MEASUREMENT
/begin MEASUREMENT EGSys_tAvrgNSC_mp "Mittlere Temperatur NSC" SWORD Temp_Cels 1 100 -50.140 899.860 FORMAT "%8.3" ECU_ADDRESS 0x8FED2E /end MEASUREMENT
/begin MEASUREMENT EGSys_tAvrgOxiCat_mp "Mittlere Temperatur Oxidationskatalysator" SWORD Temp_Cels 1 100 -50.140 899.860 FORMAT "%8.3" ECU_ADDRESS 0x8FED3C /end MEASUREMENT
/begin MEASUREMENT EGSys_tCorrIAT_mp "Temperaturoffset aufgrund Schwankungen der Ansauglufttemperatur" SWORD TempDiff_Cels 1 100 -3276.800 3276.700 FORMAT "%8.3" ECU_ADDRESS 0x8FED22 /end MEASUREMENT
/begin MEASUREMENT EGSys_tCorrManf_mp "Temperaturoffset Krümmer bei kaltem Motor" SWORD TempDiff_Cels 1 100 -3276.800 3276.700 FORMAT "%8.3" ECU_ADDRESS 0x8FED24 /end MEASUREMENT
/begin MEASUREMENT EGSys_tDiffCldEng_mp "Abweichung aktuelle Motortemperatur von stationärem Wert" SWORD TempDiff_Cels 1 100 -3276.800 3276.700 FORMAT "%8.3" ECU_ADDRESS 0x8FED26 /end MEASUREMENT
/begin MEASUREMENT EGSys_tDiffEGTube_mp "Temperaturdifferenz Abgas / Abgasrohr" SWORD TempDiff_Cels 1 100 -3276.800 3276.700 FORMAT "%8.3" ARRAY_SIZE 2 ECU_ADDRESS 0x8FEDB4 /end MEASUREMENT
/begin MEASUREMENT EGSys_tDiffIAT_mp "Differenz zwischen Ansaulglufttemperatur im Auslegungspunkt und aktuellem Wert" SWORD TempDiff_Cels 1 100 -3276.800 3276.700 FORMAT "%8.3" ECU_ADDRESS 0x8FED28 /end MEASUREMENT
/begin MEASUREMENT EGSys_tDiffTubeEnv_mp "Temperaturdifferenz Abgasrohr / Umgebung" SWORD TempDiff_Cels 1 100 -3276.800 3276.700 FORMAT "%8.3" ARRAY_SIZE 2 ECU_ADDRESS 0x8FEDB8 /end MEASUREMENT
/begin MEASUREMENT EGSys_tEGLSU "Abgas-Temperatur an Sensor-Position" SWORD Temp_Cels 1 100 -50.140 899.860 FORMAT "%8.3" ARRAY_SIZE 1 ECU_ADDRESS 0x7F8C0A /end MEASUREMENT
/begin MEASUREMENT EGSys_tEGLSUInpCrv0_mp "Messpunkt Eingang der Kennlinien" SWORD Temp_Cels 1 100 -50.140 899.860 FORMAT "%8.3" ECU_ADDRESS 0x8FECF4 /end MEASUREMENT
/begin MEASUREMENT EGSys_tEGLSUInpCrv1_mp "Messpunkt Eingang des Kennfeldes EGSys_wTresLSU1_MAP" SWORD Temp_Cels 1 100 -50.140 899.860 FORMAT "%8.3" ECU_ADDRESS 0x8FECF6 /end MEASUREMENT
/begin MEASUREMENT EGSys_tEGLSUInpCrv2_mp "Messpunkt Eingang des Kennfeldes EGSys_wTresLSU2_MAP" SWORD Temp_Cels 1 100 -50.140 899.860 FORMAT "%8.3" ECU_ADDRESS 0x8FECF8 /end MEASUREMENT
/begin MEASUREMENT EGSys_tEGLSUInpCrv3_mp "Messpunkt Eingang des Kennfeldes EGSys_wTresLSU3_MAP" SWORD Temp_Cels 1 100 -50.140 899.860 FORMAT "%8.3" ECU_ADDRESS 0x8FECFA /end MEASUREMENT
/begin MEASUREMENT EGSys_tEGPreNSC "Abgastemperatur am NSC-Eintritt" SWORD Temp_Cels 1 100 -50.140 899.860 FORMAT "%8.3" ECU_ADDRESS 0x7F8C0C /end MEASUREMENT
/begin MEASUREMENT EGSys_tEGPreOxiCat "Abgastemperatur am Oxidationskatalysator-Eintritt" SWORD Temp_Cels 1 100 -50.140 899.860 FORMAT "%8.3" ECU_ADDRESS 0x7F8C0E /end MEASUREMENT
/begin MEASUREMENT EGSys_tEGPreTrbn "Abgas-Temperatur vor Turbine" SWORD Temp_Cels 1 100 -50.140 899.860 FORMAT "%8.3" ECU_ADDRESS 0x7F8C10 /end MEASUREMENT
/begin MEASUREMENT EGSys_tEGPreTube "Abgastemperatur am Abgasrohr-Eintritt" SWORD Temp_Cels 1 100 -50.140 899.860 FORMAT "%8.3" ARRAY_SIZE 2 ECU_ADDRESS 0x7F9174 /end MEASUREMENT
/begin MEASUREMENT EGSys_tEGPstTrbn "Abgas-Temperatur nach Turbolader" SWORD Temp_Cels 1 100 -50.140 899.860 FORMAT "%8.3" ECU_ADDRESS 0x7F8C12 /end MEASUREMENT
/begin MEASUREMENT EGSys_tEGPstTube "Abgastemperatur am Abgasrohr-Auslass" SWORD Temp_Cels 1 100 -50.140 899.860 FORMAT "%8.3" ARRAY_SIZE 2 ECU_ADDRESS 0x7F9178 /end MEASUREMENT
/begin MEASUREMENT EGSys_tExcClntStrtCs_mp "Motorübertemperatur bei Motorstart" SWORD TempDiff_Cels 1 100 -3276.800 3276.700 FORMAT "%8.3" ECU_ADDRESS 0x8FED50 /end MEASUREMENT
/begin MEASUREMENT EGSys_tiClg_mp "Abkühlzeit" ULONG Time_s 1 100 0.00 42949672.9500 FORMAT "%13.4" ECU_ADDRESS 0x8FED54 /end MEASUREMENT
/begin MEASUREMENT EGSys_tIncrPoI_mp "Temperaturerhöhung im Oxidationskatalysator aufgrund später Nacheinspritzung" SWORD TempDiff_Cels 1 100 -3276.800 3276.700 FORMAT "%8.3" ECU_ADDRESS 0x8FED3E /end MEASUREMENT
/begin MEASUREMENT EGSys_tiRefClg_mp "Referenz-Abkühlzeit aus Motor-Abkühlung" ULONG Time_s 1 100 0.00 42949672.9500 FORMAT "%13.4" ECU_ADDRESS 0x8FED58 /end MEASUREMENT
/begin MEASUREMENT EGSys_tManfStat "stationäre Abgastemperatur im Abgaskrümmer" SWORD Temp_Cels 1 100 -50.140 899.860 FORMAT "%8.3" ECU_ADDRESS 0x7F8C14 /end MEASUREMENT
/begin MEASUREMENT EGSys_tManfStat_mp "stationäre Abgastemperatur im Abgaskrümmer ohne Korrekturen" SWORD Temp_Cels 1 100 -50.140 899.860 FORMAT "%8.3" ECU_ADDRESS 0x8FED2A /end MEASUREMENT
/begin MEASUREMENT EGSys_tMem_mp "Zwischenspeicher für Temperaturen" SWORD Temp_Cels 1 100 -50.140 899.860 FORMAT "%8.3" ARRAY_SIZE 14 ECU_ADDRESS 0x8FECFC /end MEASUREMENT
/begin MEASUREMENT EGSys_tMidEGTube_mp "Mittlere Temperatur zwischen Abgas und Abgasrohrwand" SWORD Temp_Cels 1 100 -50.140 899.860 FORMAT "%8.3" ARRAY_SIZE 2 ECU_ADDRESS 0x8FEDBC /end MEASUREMENT
/begin MEASUREMENT EGSys_tMidTubeEnv_mp "Mittlere Temperatur zwischen Abgasrohr und Umgebung" SWORD Temp_Cels 1 100 -50.140 899.860 FORMAT "%8.3" ARRAY_SIZE 2 ECU_ADDRESS 0x8FEDC0 /end MEASUREMENT
/begin MEASUREMENT EGSys_tNSC "Temperatur NSC (Austritt)" SWORD Temp_Cels 1 100 -50.140 899.860 FORMAT "%8.3" ECU_ADDRESS 0x7F8C16 /end MEASUREMENT
/begin MEASUREMENT EGSys_tNSCExoIncr_mp "Temperaturerhöhung im NSC durch chemische Reaktionen" SWORD TempDiff_Cels 1 100 -3276.800 3276.700 FORMAT "%8.3" ECU_ADDRESS 0x8FED30 /end MEASUREMENT
/begin MEASUREMENT EGSys_tNSCStat_mp "Stationäre Temperatur NSC" SWORD Temp_Cels 1 100 -50.140 899.860 FORMAT "%8.3" ECU_ADDRESS 0x8FED32 /end MEASUREMENT
/begin MEASUREMENT EGSys_tNSCStrtCs "Temperatur NSC bei Motorstart" SWORD Temp_Cels 1 100 -50.140 899.860 FORMAT "%8.3" ECU_ADDRESS 0x7F8C18 /end MEASUREMENT
/begin MEASUREMENT EGSys_tOxiCat "Temperatur Oxidationskatalysator (Austritt)" SWORD Temp_Cels 1 100 -50.140 899.860 FORMAT "%8.3" ECU_ADDRESS 0x7F8C1A /end MEASUREMENT
/begin MEASUREMENT EGSys_tOxiCatExoIncr_mp "Temperaturerhöhung im Oxidationskatalysator durch chemische Reaktionen" SWORD TempDiff_Cels 1 100 -3276.800 3276.700 FORMAT "%8.3" ECU_ADDRESS 0x8FED40 /end MEASUREMENT
/begin MEASUREMENT EGSys_tOxiCatStat_mp "Stationäre Temperatur Oxidationskatalysator" SWORD Temp_Cels 1 100 -50.140 899.860 FORMAT "%8.3" ECU_ADDRESS 0x8FED42 /end MEASUREMENT
/begin MEASUREMENT EGSys_tOxiCatStrtCs "Temperatur Oxidationskatalysator bei Motorstart" SWORD Temp_Cels 1 100 -50.140 899.860 FORMAT "%8.3" ECU_ADDRESS 0x7F8C1C /end MEASUREMENT
/begin MEASUREMENT EGSys_tShOffTExcClnt_mp "Motorübertemperature bei Motorstop" SWORD TempDiff_Cels 1 100 -3276.800 3276.700 FORMAT "%8.3" ECU_ADDRESS 0x8FED18 /end MEASUREMENT
/begin MEASUREMENT EGSys_tTrbStrtCs "Turbocharger Temperatur an Maschinenanfang" SWORD Temp_Cels 1 100 -50.140 899.860 FORMAT "%8.3" ECU_ADDRESS 0x7F8C1E /end MEASUREMENT
/begin MEASUREMENT EGSys_tTube "Wandtemperatur Abgasrohr" SWORD Temp_Cels 1 100 -50.140 899.860 FORMAT "%8.3" ARRAY_SIZE 2 ECU_ADDRESS 0x7F917C /end MEASUREMENT
/begin MEASUREMENT EGSys_tTubeStrtCs "Temperatur Abgasrohr bei Motorstart" SWORD Temp_Cels 1 100 -50.140 899.860 FORMAT "%8.3" ARRAY_SIZE 2 ECU_ADDRESS 0x7F9180 /end MEASUREMENT
/begin MEASUREMENT EGSys_tWallLSU "Wandtemperatur am Sondeneinbauort" SWORD Temp_Cels 1 100 -50.140 899.860 FORMAT "%8.3" ARRAY_SIZE 1 ECU_ADDRESS 0x7F8C20 /end MEASUREMENT
/begin MEASUREMENT EGSys_wLSU_mp " integrierte Wärmemenge an Sensor-Position." SWORD Energy 1 100 -32768.00 32767.00 FORMAT "%8.2" ARRAY_SIZE 1 ECU_ADDRESS 0x6F8086 /end MEASUREMENT
/begin MEASUREMENT EGSys_wThresLSUAct_mp "aktueller Wärmeschwellwert an Sensorposition." SWORD Energy 1 100 -32768.00 32767.00 FORMAT "%8.2" ARRAY_SIZE 1 ECU_ADDRESS 0x8FECEC /end MEASUREMENT
/begin MEASUREMENT EGSys_wThresLSUNoPls_mp "Hitzeschwelle ohne gültigen Gaspuls." SWORD Energy 1 100 -32768.00 32767.00 FORMAT "%8.2" ARRAY_SIZE 1 ECU_ADDRESS 0x8FECEE /end MEASUREMENT
/begin MEASUREMENT EGSys_wThresLSUPls_mp "Hitzeschwelle für gültigen Gaspuls" SWORD Energy 1 100 -32768.00 32767.00 FORMAT "%8.2" ARRAY_SIZE 1 ECU_ADDRESS 0x8FECF0 /end MEASUREMENT
/begin MEASUREMENT EGSys_wThresLSU_mp "Grundlegender Wert-Hitzeschwelle-Sensor" SWORD Energy 1 100 -32768.00 32767.00 FORMAT "%8.2" ARRAY_SIZE 1 ECU_ADDRESS 0x8FECF2 /end MEASUREMENT
/begin MEASUREMENT EGT_tInrBiTrb "Temperatur des inneren Reglers für Bi-Turbo Motoren." SWORD Temp_Cels 1 100 -50.140 899.860 FORMAT "%8.3" ECU_ADDRESS 0x7F8C36 /end MEASUREMENT
/begin MEASUREMENT EGT_tInrDesCorBiTrb "Vorgabe Korrekturwert des inneren Reglers für Bi_Turbo Motoren" SWORD Temp_Cels 1 100 -50.140 899.860 FORMAT "%8.3" ECU_ADDRESS 0x7F8C38 /end MEASUREMENT
/begin MEASUREMENT EGT_tInrDesInTempGvnr "Kundenspezifischer Temperaturvorgabewert des inneren Reglers." SWORD Temp_Cels 1 100 -50.140 899.860 FORMAT "%8.3" ECU_ADDRESS 0x7F8C3C /end MEASUREMENT
/begin MEASUREMENT EGT_tOutrDesInTempGvnr "Kundenspezifischer Temperaturvorgabewert des äußeren Reglers." SWORD Temp_Cels 1 100 -50.140 899.860 FORMAT "%8.3" ECU_ADDRESS 0x7F8C42 /end MEASUREMENT
/begin MEASUREMENT FidCol_mp "Meßpunkt der gesammelt den Zustand aller Funktionsidentifier (Fid) zur Verfügung stellt." UWORD OneToOne 1 100 0.00 65535.00 FORMAT "%8.2" ARRAY_SIZE 19 ECU_ADDRESS 0x8FECA8 /end MEASUREMENT
/begin MEASUREMENT FrmMng_stACHtgReq "Heizleistungsanforderung über CAN" UBYTE OneToOne 1 100 0.00 255.0 FORMAT "%5.1" ECU_ADDRESS 0x7F889D /end MEASUREMENT
/begin MEASUREMENT PCR_rGvnrLP2 "" SWORD Prc 1 100 -400.0000 399.9878 FORMAT "%8.4" ECU_ADDRESS 0x7F8FD6 /end MEASUREMENT
/begin MEASUREMENT PFlt_tOxiPst "Temperatur nach dem Oxidations Katalysator" SWORD Temp_Cels 1 100 -50.140 899.860 FORMAT "%8.3" ECU_ADDRESS 0x7F902E /end MEASUREMENT
/begin MEASUREMENT PFlt_tTurbPre "Temperatur vor dem Turbolader" SWORD Temp_Cels 1 100 -50.140 899.860 FORMAT "%8.3" ECU_ADDRESS 0x7F9038 /end MEASUREMENT
/begin MEASUREMENT TVACD_stAirMon "Status des TVACD" UBYTE OneToOne 1 100 0.00 255.0 FORMAT "%5.1" ECU_ADDRESS 0x7F89C4 /end MEASUREMENT
/begin MEASUREMENT Uhwe_ctAtomicLvl_mp "Interrupt Lock Level" ULONG OneToOne 1 100 0.00 4294967295.00 FORMAT "%13.2" ECU_ADDRESS 0x8FECD0 /end MEASUREMENT
/begin FUNCTION dsm_auto_tsf ""
 /begin DEF_CHARACTERISTIC DSM_TsfDfp_Layer_TANS_C DSM_TsfDfp_ACCDCmpr_C DSM_TsfDfp_ACCDPres_C DSM_TsfDfp_ACCDPres1_C DSM_TsfDfp_ACCDPresAna_C DSM_TsfDfp_ACCDSwtin_C DSM_TsfDfp_ACC_PlausTrqDes_C DSM_TsfDfp_ACC_trqInr_C DSM_TsfDfp_ACTrq_C DSM_TsfDfp_ADCMon_C DSM_TsfDfp_AFSCDIdlAdjVal_C DSM_TsfDfp_AFSCDLdAdjVal_C DSM_TsfDfp_AFSCD_AirTempDcyc_C DSM_TsfDfp_AFSCD_PlOffsDrft_C DSM_TsfDfp_AFSCD_PlSetyDrft_C DSM_TsfDfp_AFSCD_SRCAirTemp_C DSM_TsfDfp_AFSCD_SRCBatt_C DSM_TsfDfp_AFSCD_SRCCorrAirm_C DSM_TsfDfp_AFSCD_SRCRawAirm_C DSM_TsfDfp_Layer_TUMG_C DSM_TsfDfp_AFSCD_SRCRefSigPer_C DSM_TsfDfp_AOHtCD_C DSM_TsfDfp_Layer_GEN_C DSM_TsfDfp_Layer_BSD_C DSM_TsfDfp_AOHtCD_AOHtDia1_C DSM_TsfDfp_AOHtCD_AOHtDia2_C DSM_TsfDfp_AOHtCD_AOHtDia3_C DSM_TsfDfp_APP1_C DSM_TsfDfp_APP2_C DSM_TsfDfp_APPSync_C DSM_TsfDfp_APSCD_C DSM_TsfDfp_ARS_C DSM_TsfDfp_AccPedPlausBrk_C DSM_TsfDfp_AirCtlGvnrDvtRgnMax_C DSM_TsfDfp_Layer_QLT_C DSM_TsfDfp_AirCtlGvnrDvtRgnMax2_C DSM_TsfDfp_Layer_IBS1_C DSM_TsfDfp_Layer_IBS2_C DSM_TsfDfp_Layer_IBS3_C DSM_TsfDfp_Layer_PMBN_C DSM_TsfDfp_Layer_PMBATT_C DSM_TsfDfp_AirCtlGvnrDvtRgnMin_C DSM_TsfDfp_AirCtlGvnrDvtRgnMin2_C DSM_TsfDfp_AirCtlPlateBreak_C DSM_TsfDfp_AirCtlRmpTO_C DSM_TsfDfp_AirCtl_GovNegDev_C DSM_TsfDfp_AirCtl_GovNegDev2_C DSM_TsfDfp_AirCtl_GovPosDev_C DSM_TsfDfp_AirCtl_GovPosDev2_C DSM_TsfDfp_AltCD_C DSM_TsfDfp_AltCD_Load_C DSM_TsfDfp_BPACD_BPADia1_C DSM_TsfDfp_BPACD_BPADia2_C DSM_TsfDfp_BPACD_BPADia3_C DSM_TsfDfp_BPACD_Max_C DSM_TsfDfp_BPACD_Min_C DSM_TsfDfp_BPACD_SigNpl_C DSM_TsfDfp_BPSCD_C DSM_TsfDfp_BattCD_C DSM_TsfDfp_BrkCD_C DSM_TsfDfp_Bss_C DSM_TsfDfp_CBACD_C DSM_TsfDfp_CTSCD_C DSM_TsfDfp_Clg_DynTst_C DSM_TsfDfp_CmbChbMisfire1_C DSM_TsfDfp_CmbChbMisfire2_C DSM_TsfDfp_CmbChbMisfire3_C DSM_TsfDfp_CmbChbMisfire4_C DSM_TsfDfp_CmbChbMisfire5_C DSM_TsfDfp_CmbChbMisfire6_C DSM_TsfDfp_CmbChbMisfireMul_C DSM_TsfDfp_CoVMDCSh_C DSM_TsfDfp_ConvCD_C DSM_TsfDfp_Layer_PMRUHVERL_C DSM_TsfDfp_CrCCDMFL_C DSM_TsfDfp_CrCtl_vCrCtl_C DSM_TsfDfp_DCC_PlausTrqDes_C DSM_TsfDfp_Dummy1_C DSM_TsfDfp_Layer_TOENS_C DSM_TsfDfp_Layer_MANHYDR_C DSM_TsfDfp_Layer_MANLUFT_C DSM_TsfDfp_EATSCD_C DSM_TsfDfp_EBAFCD_C DSM_TsfDfp_EBFCD_C DSM_TsfDfp_EBTSCD_C DSM_TsfDfp_EBTSCD_OvrTemp_C DSM_TsfDfp_EEPCDVarMng_C DSM_TsfDfp_EGPpCD_C DSM_TsfDfp_EGPpCDTPreTrbn_C DSM_TsfDfp_EGRCD_Max_C DSM_TsfDfp_EGRCD_Min_C DSM_TsfDfp_EGRCD_SigNpl_C DSM_TsfDfp_EGTRgnOilDil_C DSM_TsfDfp_EMCCDNoLoad1_C DSM_TsfDfp_EMCCDNoLoad2_C DSM_TsfDfp_EMCCDSCBat1_C DSM_TsfDfp_EMCCDSCBat2_C DSM_TsfDfp_EMCCDSCGnd1_C DSM_TsfDfp_EMCCDSCGnd2_C DSM_TsfDfp_EMCCD_ADC1_C DSM_TsfDfp_EMCCD_ADC2_C DSM_TsfDfp_ETClbETFltInj1_C DSM_TsfDfp_ETClbETFltInj2_C DSM_TsfDfp_ETClbETFltInj3_C DSM_TsfDfp_ETClbETFltInj4_C DSM_TsfDfp_ETClbETFltInj5_C DSM_TsfDfp_ETClbETFltInj6_C DSM_TsfDfp_ETClbInj1_C DSM_TsfDfp_ETClbInj2_C DSM_TsfDfp_ETClbInj3_C DSM_TsfDfp_ETClbInj4_C DSM_TsfDfp_ETClbInj5_C DSM_TsfDfp_ETClbInj6_C DSM_TsfDfp_EngMCaS1_C DSM_TsfDfp_EngMCrS1_C DSM_TsfDfp_EngMOfsCaSCrS_C DSM_TsfDfp_EngPrtFWODet_C DSM_TsfDfp_FBCqDvt_C DSM_TsfDfp_FMTC_NonMonotonMap_C DSM_TsfDfp_FTSCD_C DSM_TsfDfp_FanCD_C DSM_TsfDfp_FanCD_FanCtlr1_C DSM_TsfDfp_FanCD_FanCtlr2_C DSM_TsfDfp_FanCD_FanCtlr3_C DSM_TsfDfp_FlFCD_C DSM_TsfDfp_FlMngSmkDefect_C DSM_TsfDfp_FrmMngANFRADMOMPT_C DSM_TsfDfp_FrmMngASC1_C DSM_TsfDfp_FrmMngASC2_C DSM_TsfDfp_FrmMngASC3_C DSM_TsfDfp_FrmMngASC4_C DSM_TsfDfp_FrmMngBOS_RESET_C DSM_TsfDfp_FrmMngBOS_RESET_2_C DSM_TsfDfp_FrmMngDMANFAFS_C DSM_TsfDfp_FrmMngDRMANFSSG_C DSM_TsfDfp_FrmMngEGS1_C DSM_TsfDfp_FrmMngEGS2_C DSM_TsfDfp_FrmMngGEARBX_DATA_C DSM_TsfDfp_FrmMngGEARBX_DATA2_C DSM_TsfDfp_FrmMngHEAT_AC_C DSM_TsfDfp_FrmMngINSTR2_C DSM_TsfDfp_FrmMngINSTR3_C DSM_TsfDfp_FrmMngLENKRADWINKEL_C DSM_TsfDfp_FrmMngMILEAGE_RANGE_C DSM_TsfDfp_FrmMngOPCRCTLACC_C DSM_TsfDfp_FrmMngPRGG_CCTR_C DSM_TsfDfp_FrmMngPWRMNG_LOADV_C DSM_TsfDfp_FrmMngParkConsumer_C DSM_TsfDfp_FrmMngRQSTGEFAN_C DSM_TsfDfp_FrmMngSSGErr_C DSM_TsfDfp_FrmMngSSGShOff_C DSM_TsfDfp_FrmMngSTAT_ANH_C DSM_TsfDfp_FrmMngSTAT_ARS_C DSM_TsfDfp_FrmMngSTAT_DSC_C DSM_TsfDfp_FrmMngSTAT_EKP_C DSM_TsfDfp_FrmMngSTAT_KOMBI_C DSM_TsfDfp_FrmMngSTAT_SITZ_C DSM_TsfDfp_FrmMngStOBDGbxMilOf_C DSM_TsfDfp_FrmMngStOBDGbxMilOn_C DSM_TsfDfp_FrmMngTEMPRELTIME_C DSM_TsfDfp_FrmMngTERMINAL_C DSM_TsfDfp_FrmMngTIME_DATE_C DSM_TsfDfp_FrmMngTORQUE_DSC_C DSM_TsfDfp_FrmMngTORQUE_GEARBX_C DSM_TsfDfp_FrmMngTrq_ReqACC_C DSM_TsfDfp_FrmMngVEH_MOD_C DSM_TsfDfp_FrmMngVELOCITY_C DSM_TsfDfp_FrmMngWHEEL_SPEED_C DSM_TsfDfp_FrmMngstCurr_C DSM_TsfDfp_FrmMngswtPSPOff_C DSM_TsfDfp_GearbxIncMax_C DSM_TsfDfp_GlwCD_C DSM_TsfDfp_GlwCDGlwCirc1_C DSM_TsfDfp_GlwCDGlwCirc2_C DSM_TsfDfp_GlwCDGlwCirc3_C DSM_TsfDfp_GlwCDGlwCirc4_C DSM_TsfDfp_GlwCDGlwCirc5_C DSM_TsfDfp_GlwCDGlwCirc6_C DSM_TsfDfp_GlwCDGlwCirc7_C DSM_TsfDfp_GlwCDGlwCirc8_C DSM_TsfDfp_GlwCtl_C DSM_TsfDfp_HWEMonCom_C DSM_TsfDfp_HWEMonEEPROM_C DSM_TsfDfp_HWEMonRcyLocked_C DSM_TsfDfp_HWEMonRcySuppressed_C DSM_TsfDfp_HWEMonRcyVisible_C DSM_TsfDfp_HWEMonUMaxSupply_C DSM_TsfDfp_HWEMonUMinSupply_C DSM_TsfDfp_IATSCD_C DSM_TsfDfp_IATSCD_CATS_C DSM_TsfDfp_ImmCtlImmCD_C DSM_TsfDfp_ImmCtlImmEep_C DSM_TsfDfp_ImmCtlMpl_C DSM_TsfDfp_IndSys1_C DSM_TsfDfp_IndSys2_C DSM_TsfDfp_InjCrv_InjLim_C DSM_TsfDfp_InjCtlAdjQnt_C DSM_TsfDfp_InjCtlDrift_C DSM_TsfDfp_InjVlvBnk1A_C DSM_TsfDfp_InjVlvBnk1B_C DSM_TsfDfp_InjVlvBnk2A_C DSM_TsfDfp_InjVlvBnk2B_C DSM_TsfDfp_InjVlvChipA_C DSM_TsfDfp_InjVlvChipB_C DSM_TsfDfp_InjVlvCyl1A_C DSM_TsfDfp_InjVlvCyl1B_C DSM_TsfDfp_InjVlvCyl2A_C DSM_TsfDfp_InjVlvCyl2B_C DSM_TsfDfp_InjVlvCyl3A_C DSM_TsfDfp_InjVlvCyl3B_C DSM_TsfDfp_InjVlvCyl4A_C DSM_TsfDfp_InjVlvCyl4B_C DSM_TsfDfp_InjVlvCyl5A_C DSM_TsfDfp_InjVlvCyl5B_C DSM_TsfDfp_InjVlvCyl6A_C DSM_TsfDfp_InjVlvCyl6B_C DSM_TsfDfp_LPACD_Max_C DSM_TsfDfp_LPACD_Min_C DSM_TsfDfp_LPACD_SigNpl_C DSM_TsfDfp_LSUCDCircNernst0_C DSM_TsfDfp_LSUCDCircPumpCur0_C DSM_TsfDfp_LSUCDCircVirtGnd0_C DSM_TsfDfp_LSUCDHeater0_C DSM_TsfDfp_LSUCDHtCoup0_C DSM_TsfDfp_LSUCDO20_C DSM_TsfDfp_LSUCDO2Clb0_C DSM_TsfDfp_LSUCDRiClb0_C DSM_TsfDfp_LSUCDSPI0_C DSM_TsfDfp_LSUCDSPIBattLow0_C DSM_TsfDfp_LSUCDWireIP0_C DSM_TsfDfp_LSUCtlRiExc0_C DSM_TsfDfp_LSUMon1Sens_C DSM_TsfDfp_LSUMon2Sens_C DSM_TsfDfp_MIL_C DSM_TsfDfp_MRlyCD_C DSM_TsfDfp_MSidCD_Comm_C DSM_TsfDfp_MSidCD_Pin_C DSM_TsfDfp_MSidCD_Sel_INI_C DSM_TsfDfp_MSidCD_Select_C DSM_TsfDfp_MeUnCDNoLoad_C DSM_TsfDfp_MeUnCDSCBat_C DSM_TsfDfp_MeUnCDSCGnd_C DSM_TsfDfp_MeUnCD_ADC_C DSM_TsfDfp_MeUnCD_SigTst_C DSM_TsfDfp_Montr_C DSM_TsfDfp_NetMngDeviceA_C DSM_TsfDfp_NetMngDeviceB_C DSM_TsfDfp_NetMngDeviceC_C DSM_TsfDfp_OPSCD_Lamp_C DSM_TsfDfp_OPSCD_anain_C DSM_TsfDfp_OTSCD_C DSM_TsfDfp_OvRMon_C DSM_TsfDfp_OvRMonBrk_C DSM_TsfDfp_OvRMonSigA_C DSM_TsfDfp_OxiCCDTPre_C DSM_TsfDfp_PCR_GovDevNeg_C DSM_TsfDfp_PCR_GovDevPos_C DSM_TsfDfp_PCR_LPGvnrDvtNeg_C DSM_TsfDfp_PCR_LPGvnrDvtPos_C DSM_TsfDfp_PCVCDNoLoad_C DSM_TsfDfp_PCVCDSCBat_C DSM_TsfDfp_PCVCDSCGnd_C DSM_TsfDfp_PCVCD_ADC_C DSM_TsfDfp_PCVCD_SigTst_C DSM_TsfDfp_PFltAPSPlaus_C DSM_TsfDfp_PFltAPSens_C DSM_TsfDfp_PFltBPSPlaus_C DSM_TsfDfp_PFltCDPPre_C DSM_TsfDfp_PFltCDTempPre_C DSM_TsfDfp_PFltChar_C DSM_TsfDfp_PFltEngPrt_C DSM_TsfDfp_PFltPresDynPlaus_C DSM_TsfDfp_PFltPresPlaus_C DSM_TsfDfp_PFltPresSens_C DSM_TsfDfp_PFltPresSensFrz_C DSM_TsfDfp_PFltPresSensHsLn_C DSM_TsfDfp_PFltPresSensSot_C DSM_TsfDfp_PFltRgnPerm_C DSM_TsfDfp_PFltTempDwnStrm_C DSM_TsfDfp_PFltTempSens_C DSM_TsfDfp_PFltTempUpStrm_C DSM_TsfDfp_PFltmSotDiffMax_C DSM_TsfDfp_PSPCD_Actr_C DSM_TsfDfp_PresPlausDblDef_C DSM_TsfDfp_QLTCD_C DSM_TsfDfp_RailCD_C DSM_TsfDfp_RailCDOfsTst_C DSM_TsfDfp_RailCD_PMonStrt_C DSM_TsfDfp_RailCtlModeMeUnDiag_C DSM_TsfDfp_RailCtlModePCVDiag_C DSM_TsfDfp_RailMeUn0_C DSM_TsfDfp_RailMeUn1_C DSM_TsfDfp_RailMeUn2_C DSM_TsfDfp_RailMeUn3_C DSM_TsfDfp_RailMeUn4_C DSM_TsfDfp_RailPCV0_C DSM_TsfDfp_RailPCV1_C DSM_TsfDfp_RailPCV2_C DSM_TsfDfp_RailPCV3_C DSM_TsfDfp_RailPCV4_C DSM_TsfDfp_RailPCV5_C DSM_TsfDfp_SOPTst_C DSM_TsfDfp_SSpMon1_C DSM_TsfDfp_SSpMon2_C DSM_TsfDfp_SSpMon3_C DSM_TsfDfp_SWChk_CycSigChkDat_C DSM_TsfDfp_SWChk_CycSigChkPrg_C DSM_TsfDfp_ShutCD_C DSM_TsfDfp_ShutCDMax_C DSM_TsfDfp_ShutCDMin_C DSM_TsfDfp_ShutCDSigNpl_C DSM_TsfDfp_StSysTrqShutOff_C DSM_TsfDfp_StrtCD_Actr_C DSM_TsfDfp_SysLamp_C DSM_TsfDfp_T15CD_C DSM_TsfDfp_TGearbx_C DSM_TsfDfp_TPUMon_C DSM_TsfDfp_TVACD_Max_C DSM_TsfDfp_TVACD_Min_C DSM_TsfDfp_TVACD_SigNpl_C DSM_TsfDfp_TVACD_TVADia1_C DSM_TsfDfp_TVACD_TVADia2_C DSM_TsfDfp_TVACD_TVADia3_C DSM_TsfDfp_TVACD_TVADia4_C DSM_TsfDfp_VSACD_DioInDia1_C DSM_TsfDfp_VSACD_DioInDia2_C DSM_TsfDfp_VSACD_DioInDia3_C DSM_TsfDfp_VSACD_DioInDia4_C DSM_TsfDfp_VSACD_DioInMin_C DSM_TsfDfp_VSACD_Max_C DSM_TsfDfp_VSACD_Min_C DSM_TsfDfp_VSACD_SigNpl_C DSM_TsfDfp_VSACD_VSADia1_C DSM_TsfDfp_VSACD_VSADia2_C DSM_TsfDfp_VSACD_VSADia3_C DSM_TsfDfp_VSACD_VSADia4_C DSM_TsfDfp_VSSCD1_C DSM_TsfDfp_VSSCD2_C DSM_TsfDfp_WdCom_C /end DEF_CHARACTERISTIC
/end FUNCTION
/begin FUNCTION dsm_msg ""
 /begin OUT_MEASUREMENT DFPM_stFCMChkCause DSM_ctDfctPath DSM_ctFcmEntry DSM_ctOBDPath DSM_ctOBDValidPath DSM_ctTstPath DSM_ctWUC DSM_lDist DSM_stCycles DSM_stECUMasterSlave DSM_stInhDelay DSM_stMIL DSM_stPID41 DSM_stRdyAB DSM_stRdyCD DSM_stRdyCheckEnable DSM_stSysLamp /end OUT_MEASUREMENT
/end FUNCTION
/begin FUNCTION dsm_rdy ""
 /begin DEF_CHARACTERISTIC DSM_RdyABForceMsk_C DSM_RdyCDForceMsk_C DSM_RdyOnMilEnable_C /end DEF_CHARACTERISTIC
/end FUNCTION
/begin FUNCTION dsm_rdy_msg "" /end FUNCTION
/begin FUNCTION dsm_rdy_uic ""
 /begin OUT_MEASUREMENT DSM_ctRdyActCyc_mp DSM_ctRdyCycCat_mp DSM_ctRdyCycCompr_mp DSM_ctRdyCycEGR_mp DSM_ctRdyCycFuel_mp DSM_ctRdyCycMisf_mp DSM_ctRdyCycOxSenHt_mp DSM_ctRdyCycOxSen_mp DSM_ctRdyLimCat_mp DSM_ctRdyLimCompr_mp DSM_ctRdyLimEGR_mp DSM_ctRdyLimFuel_mp DSM_ctRdyLimMisf_mp DSM_ctRdyLimOxSenHt_mp DSM_ctRdyLimOxSen_mp DSM_ctRdyPathsCat_mp DSM_ctRdyPathsCompr_mp DSM_ctRdyPathsEGR_mp DSM_ctRdyPathsFuel_mp DSM_ctRdyPathsMisf_mp DSM_ctRdyPathsOxSenHt_mp DSM_ctRdyPathsOxSen_mp DSM_ctRdyTstCat_mp DSM_ctRdyTstCompr_mp DSM_ctRdyTstEGR_mp DSM_ctRdyTstFuel_mp DSM_ctRdyTstMisf_mp DSM_ctRdyTstOxSenHt_mp DSM_ctRdyTstOxSen_mp /end OUT_MEASUREMENT
/end FUNCTION
/begin FUNCTION dsm_sy_conf "" /end FUNCTION
/begin FUNCTION dsm_uic ""
 /begin OUT_MEASUREMENT DfpErrCol_mp DfpZyfCol_mp DSCHED_numDefDfpArray_mp DSCHED_numOkDfpArray_mp DSM_ctFCMEntrySize_mp DSM_ctPath_mp DSM_tiDCDelay_mp FidCol_mp /end OUT_MEASUREMENT
/end FUNCTION
/begin FUNCTION dummy "" /end FUNCTION
/begin FUNCTION dummy_proj_msg ""
 /begin OUT_MEASUREMENT EGT_tInrBiTrb EGT_tInrDesCorBiTrb EGT_tInrDesInTempGvnr EGT_tOutrDesInTempGvnr FrmMng_stACHtgReq PCR_rGvnrLP2 PFlt_tOxiPst PFlt_tTurbPre TVACD_stAirMon /end OUT_MEASUREMENT
/end FUNCTION
/begin FUNCTION dummy_uic "" /begin OUT_MEASUREMENT Uhwe_ctAtomicLvl_mp /end OUT_MEASUREMENT /end FUNCTION
/begin FUNCTION eatscd "Umgebungslufttemperaturerfassung"
 /begin DEF_CHARACTERISTIC EATSCD_uSRCMin_C EATSCD_uSRCMax_C EATSCD_tLin_CUR EATSCD_DebSigDef_C EATSCD_DebSigOk_C EATSCD_DebSRCHighDef_C EATSCD_DebSRCHighOk_C EATSCD_DebSRCLowDef_C EATSCD_DebSRCLowOk_C EATSCD_dtRmpSubs_C EATSCD_dtRmpSubsUp_C EATSCD_dtRmpSubsDwn_C EATSCD_numAdc_C EATSCD_dtRmpSlpUp_C EATSCD_dtRmpSlpDwn_C EATSCD_swtSensImpl_C EATSCD_swtSigVal_C EATSCD_tAirSubs_C EATSCD_stSensIDWord_C EATSCD_tDfl_C /end DEF_CHARACTERISTIC
 /begin IN_MEASUREMENT EATSCD_uRaw /end IN_MEASUREMENT
/end FUNCTION
/begin FUNCTION eatscd_msg "" /begin OUT_MEASUREMENT EATSCD_swtSig EATSCD_tAir EATSCD_tAirLin EATSCD_uRaw /end OUT_MEASUREMENT /end FUNCTION
/begin FUNCTION eatscd_uic "" /end FUNCTION
/begin FUNCTION ebafcd "Abluftklappensteuerung Komponententreiber"
 /begin DEF_CHARACTERISTIC EBAFCD_ctPwrStgOnMax_C EBAFCD_DebExcTempDef_C EBAFCD_DebExcTempOk_C EBAFCD_DebNoLoadDef_C EBAFCD_DebNoLoadOk_C EBAFCD_DebShortCircBatDef_C EBAFCD_DebShortCircBatOk_C EBAFCD_DebShortCircGndDef_C EBAFCD_DebShortCircGndOk_C EBAFCD_InvSigOut_C EBAFCD_nFan_C EBAFCD_numDiaOut_C EBAFCD_numDioOut_C EBAFCD_stSPICtl_C EBAFCD_tClntTrMin_C EBAFCD_tClntTrMax_C EBAFCD_sttClntTrOff_C EBAFCD_sttClntTrOn_C EBAFCD_tClntMin_C EBAFCD_tClntMax_C EBAFCD_sttClntOff_C EBAFCD_sttClntOn_C EBAFCD_tiBtwTst_C EBAFCD_tiPwrStgOn_C /end DEF_CHARACTERISTIC
/end FUNCTION
/begin FUNCTION ebafcd_msg "" /begin OUT_MEASUREMENT EBAFCD_stSigOut /end OUT_MEASUREMENT /end FUNCTION
/begin FUNCTION ebafcd_uic "" /begin OUT_MEASUREMENT EBAFCD_st_mp /end OUT_MEASUREMENT /end FUNCTION
/begin FUNCTION ebfcd_actoutebox "E-Box Cooler Fan component driver"
 /begin DEF_CHARACTERISTIC EBFCD_ctPwrStgOnMax_C EBFCD_DebExcTempDef_C EBFCD_DebExcTempOk_C EBFCD_DebNoLoadDef_C EBFCD_DebNoLoadOk_C EBFCD_DebShortCircBatDef_C EBFCD_DebShortCircBatOk_C EBFCD_DebShortCircGndDef_C EBFCD_DebShortCircGndOk_C EBFCD_numDiaOut_C EBFCD_numDioOut_C EBFCD_stDigInvOut_C EBFCD_stSigOutErr_C EBFCD_stSPICtl_C EBFCD_swtOnOff_C EBFCD_tECUXLow_C EBFCD_tECUXHigh_C EBFCD_stECUYLow_C EBFCD_stECUYHigh_C EBFCD_tiBtwTst_C EBFCD_tiPwrStgOn_C /end DEF_CHARACTERISTIC
/end FUNCTION
/begin FUNCTION ebfcd_actoutebox_msg "" /begin OUT_MEASUREMENT EBFCD_stOut /end OUT_MEASUREMENT /end FUNCTION
/begin FUNCTION ebfcd_actoutebox_uic "" /begin OUT_MEASUREMENT EBFCD_st_mp /end OUT_MEASUREMENT /end FUNCTION
/begin FUNCTION ebtscd_gettempebox "ECU Temperature sensor component driver"
 /begin DEF_CHARACTERISTIC EBTSCD_uSRCMin_C EBTSCD_uSRCMax_C EBTSCD_tLin_CUR EBTSCD_OvrDebSRCHighDef_C EBTSCD_OvrDebSRCHighOk_C EBTSCD_DebSRCHighDef_C EBTSCD_DebSRCHighOk_C EBTSCD_DebSRCLowDef_C EBTSCD_DebSRCLowOk_C EBTSCD_numAdc_C EBTSCD_dtRmpSlpUp_C EBTSCD_dtRmpSlpDwn_C EBTSCD_tiTECUPT1_C EBTSCD_tOvrTemp_C EBTSCD_stSensIDWord_C EBTSCD_tDfl_C /end DEF_CHARACTERISTIC
 /begin IN_MEASUREMENT EBTSCD_uRawTECU_mp /end IN_MEASUREMENT
/end FUNCTION
/begin FUNCTION ebtscd_gettempebox_msg "" /begin OUT_MEASUREMENT EBTSCD_tCIntLin EBTSCD_tECU /end OUT_MEASUREMENT /end FUNCTION
/begin FUNCTION ebtscd_gettempebox_uic "" /begin OUT_MEASUREMENT EBTSCD_uRawTECU_mp /end OUT_MEASUREMENT /end FUNCTION
/begin FUNCTION ecu "" /begin DEF_CHARACTERISTIC ECU_vPrgThres_C /end DEF_CHARACTERISTIC /end FUNCTION
/begin FUNCTION eepcd "Komponenten Treiber für EEPROM Zugriffe" /begin DEF_CHARACTERISTIC EEPCD_stMILDfl_C /end DEF_CHARACTERISTIC /end FUNCTION
/begin FUNCTION eepcd_msg "" /begin OUT_MEASUREMENT EEPCD_stErrSet EEPCD_stMIL /end OUT_MEASUREMENT /end FUNCTION
/begin FUNCTION eepinit "EEPROM Erstinitialisierung" /begin DEF_CHARACTERISTIC /end DEF_CHARACTERISTIC /end FUNCTION
/begin FUNCTION eepinit_develop "ließt Bloecke vom EEPROM und schreibt ein Byte an waelbare Positionen" /begin DEF_CHARACTERISTIC /end DEF_CHARACTERISTIC /begin OUT_MEASUREMENT /end OUT_MEASUREMENT /end FUNCTION
/begin FUNCTION egppcd_actrout "Exhaust Gas pressure Pump Component Driver"
 /begin DEF_CHARACTERISTIC EGPpCD_ctPwrStgOnMax_C EGPpCD_numDia_C EGPpCD_numDioOut_C EGPpCD_stInvOut_C EGPpCD_stPwrStgActv_C EGPpCD_stSPICtl_C EGPpCD_tiBtwTst_C EGPpCD_tiDebExcTempDef_C EGPpCD_tiDebExcTempOk_C EGPpCD_tiDebNoLoadDef_C EGPpCD_tiDebNoLoadOk_C EGPpCD_tiDebShortCircBatDef_C EGPpCD_tiDebShortCircBatOk_C EGPpCD_tiDebShortCircGndDef_C EGPpCD_tiDebShortCircGndOk_C EGPpCD_tiPwrStgOn_C /end DEF_CHARACTERISTIC
/end FUNCTION
/begin FUNCTION egppcd_actrout_msg "" /begin OUT_MEASUREMENT EGPpCD_stActrOut /end OUT_MEASUREMENT /end FUNCTION
/begin FUNCTION egppcd_actrout_uic "" /end FUNCTION
/begin FUNCTION egpp_logic "Calculates the status of the Exhaust gas pressure pump" /begin DEF_CHARACTERISTIC EGPp_stFlap_MAP EGPp_tiStartDelay_C /end DEF_CHARACTERISTIC /begin IN_MEASUREMENT Eng_nAvrg InjCtl_qCurr /end IN_MEASUREMENT /end FUNCTION
/begin FUNCTION egpp_logic_msg "" /begin OUT_MEASUREMENT EGPp_stLogicOut /end OUT_MEASUREMENT /end FUNCTION
/begin FUNCTION egpp_logic_uic "" /end FUNCTION
/begin FUNCTION egpp_prescalc "Berechnung des Abgasdruckes"
 /begin DEF_CHARACTERISTIC EGPp_facGeoSil2_C EGPp_facGeoSil_C EGPp_facPow_CUR EGPp_facRhoEta_CUR EGPp_pPstPFlt_MAP EGPp_tiPresFltPT1_C EGPp_swtPresCalc_C /end DEF_CHARACTERISTIC
 /begin IN_MEASUREMENT EGPp_dvolSil_mp Eng_nAvrg InjCtl_qSetUnBal PFlt_tPstSim /end IN_MEASUREMENT
/end FUNCTION
/begin FUNCTION egpp_prescalc_msg "" /begin OUT_MEASUREMENT EGPp_pPstPFlt /end OUT_MEASUREMENT /end FUNCTION
/begin FUNCTION egpp_prescalc_uic "" /begin OUT_MEASUREMENT EGPp_dvolSil_mp EGPp_pPstPFltMap_mp EGPp_pPstPFltSim_mp /end OUT_MEASUREMENT /end FUNCTION
/begin FUNCTION egrcd "Komponententreiber Abgasrückführsteller"
 /begin DEF_CHARACTERISTIC EGRCD_ctPwrStgOnMax_C EGRCD_DebExcTempDef_C EGRCD_DebExcTempOk_C EGRCD_DebNoLoadDef_C EGRCD_DebNoLoadOk_C EGRCD_DebShortCircBatDef_C EGRCD_DebShortCircBatOk_C EGRCD_DebShortCircGndDef_C EGRCD_DebShortCircGndOk_C EGRCD_numDia_C EGRCD_numPwmOut_C EGRCD_stInvOut_C EGRCD_tiPer_C EGRCD_rCnv_MAP EGRCD_rOutMax_C EGRCD_rOutMin_C EGRCD_stPwrStgActv_C EGRCD_stPwrStgDia_C EGRCD_stSPICtl_C EGRCD_swt_C EGRCD_tiBtwTst_C EGRCD_tiPwrStgOn_C /end DEF_CHARACTERISTIC
 /begin IN_MEASUREMENT EGRVlv_rEGR Eng_nAvrg /end IN_MEASUREMENT
/end FUNCTION
/begin FUNCTION egrcd_msg "" /begin OUT_MEASUREMENT EGRCD_rOut /end OUT_MEASUREMENT /end FUNCTION
/begin FUNCTION egrcd_uic "" /begin OUT_MEASUREMENT EGRCD_rCnv_mp /end OUT_MEASUREMENT /end FUNCTION
/begin FUNCTION egrvlv_co "Stellerkoordinator Abgasrückführung" /end FUNCTION
/begin FUNCTION egrvlv_co_msg "" /begin OUT_MEASUREMENT EGRVlv_rEGR EGRVlv_rEGR2 /end OUT_MEASUREMENT /end FUNCTION
/begin FUNCTION egrvlv_co_uic ""
 /begin DEF_CHARACTERISTIC EGRVlv_rEGR2_Vector EGRVlv_rEGR2_Channel EGRVlv_rEGR_Vector EGRVlv_rEGR_Channel /end DEF_CHARACTERISTIC
 /begin OUT_MEASUREMENT EGRVlv_rEGR2Byp_mp EGRVlv_rEGRByp_mp /end OUT_MEASUREMENT
/end FUNCTION
/begin FUNCTION egsys_dewdet "Taupunktbestimmungslogik"
 /begin DEF_CHARACTERISTIC EGSys_dmPlsThresLSU_C EGSys_facCldStrtLSU_C EGSys_facPlsLSU_C EGSys_facPlsThresLSU_C EGSys_numMaxCldStrt_C EGSys_swtDewDetShOff_C EGSys_tiDebLSU0_C EGSys_tiDebNrmTransOk_C EGSys_tiHtgDelLSU_C EGSys_tIntegIni_C EGSys_tiPlsLSU_C EGSys_tThresLSUAct_C EGSys_tWtEquiv_C EGSys_wLSUIKi_C EGSys_wThresLSU0_MAP /end DEF_CHARACTERISTIC
 /begin IN_MEASUREMENT EGSys_tEGLSUInpCrv0_mp Eng_tEng /end IN_MEASUREMENT
 /begin OUT_MEASUREMENT EGSys_cpEGLSU_mp EGSys_ctCldStrtLSU_mp EGSys_dwLSU_mp EGSys_stHtgLSULstTrp_mp EGSys_stHtgThresLSUHit_mp EGSys_stIntegIni_mp EGSys_stPlsLSU_mp EGSys_wLSU_mp EGSys_wThresLSUAct_mp EGSys_wThresLSUNoPls_mp EGSys_wThresLSUPls_mp EGSys_wThresLSU_mp /end OUT_MEASUREMENT
/end FUNCTION
/begin FUNCTION egsys_dewdet_msg "" /begin OUT_MEASUREMENT EGSys_stHtgLSU /end OUT_MEASUREMENT /end FUNCTION
/begin FUNCTION egsys_dewdet_uic "" /end FUNCTION
/begin FUNCTION egsys_mdlbackpres "Berechnung des Abgasgegendrucks" /begin DEF_CHARACTERISTIC EGSys_dpExhGas_MAP EGSys_pConstVal_C EGSys_swtPresSel_C /end DEF_CHARACTERISTIC /begin IN_MEASUREMENT Eng_nAvrg InjCtl_qSetUnBal /end IN_MEASUREMENT /end FUNCTION
/begin FUNCTION egsys_mdlbackpres_msg "" /begin OUT_MEASUREMENT EGSys_pExhGas /end OUT_MEASUREMENT /end FUNCTION
/begin FUNCTION egsys_mdlbackpres_uic "" /end FUNCTION
/begin FUNCTION egsys_tegco "Schnittstellenkoordinator für Abgastemperaturmodell"
 /begin DEF_CHARACTERISTIC EGSys_cndHtEG_CUR EGSys_cpEG_MAP EGSys_dmEGMinVal_C EGSys_numECU_C EGSys_numRdPosLSU2_C EGSys_numRdPosLSUWall_C EGSys_numRdPosLSU_C EGSys_numRdPosNSC2_C EGSys_numRdPosNSC_C EGSys_numRdPosOxiCat2_C EGSys_numRdPosOxiCat_C EGSys_numRdPosTrbn2_C EGSys_numRdPosTrbn_C EGSys_numRdPosTube2_C EGSys_numRdPosTube_C EGSys_vscDynEG_CUR EGSys_vscKinEG_CUR /end DEF_CHARACTERISTIC
 /begin IN_MEASUREMENT EGSys_rLmbdAprx /end IN_MEASUREMENT
 /begin OUT_MEASUREMENT EGSys_tEGLSUInpCrv0_mp EGSys_tEGLSUInpCrv1_mp EGSys_tEGLSUInpCrv2_mp EGSys_tEGLSUInpCrv3_mp EGSys_tMem_mp /end OUT_MEASUREMENT
/end FUNCTION
/begin FUNCTION egsys_tegco_msg ""
 /begin OUT_MEASUREMENT EGSys_dmEG EGSys_qMIStd EGSys_qPoIRgn EGSys_rLmbdAprx EGSys_tEGLSU EGSys_tEGPreNSC EGSys_tEGPreOxiCat EGSys_tEGPreTrbn EGSys_tEGPreTube EGSys_tWallLSU /end OUT_MEASUREMENT
/end FUNCTION
/begin FUNCTION egsys_tegco_uic "" /begin OUT_MEASUREMENT EGSys_tShOffTExcClnt_mp /end OUT_MEASUREMENT /end FUNCTION
/begin FUNCTION egsys_tegco_var "" /begin DEF_CHARACTERISTIC EGSys_tExcClntDfl_C /end DEF_CHARACTERISTIC /end FUNCTION
/begin FUNCTION egsys_tegmod "Abgastemperaturmodell"
 /begin DEF_CHARACTERISTIC EGSys_dmAir_MAP EGSys_facAirMass_CUR EGSys_facCorrCldEng_CUR EGSys_facIAT_CUR EGSys_facStrtDlv_CUR EGSys_phiStrtDlv_MAP EGSys_tEngStat_C EGSys_tIAT_MAP EGSys_tManfDfl_C EGSys_tManfStat_MAP /end DEF_CHARACTERISTIC
 /begin IN_MEASUREMENT EGSys_phiDiffStrt_mp EGSys_rAirPerTime_mp EGSys_tDiffCldEng_mp EGSys_tDiffIAT_mp Eng_nAvrg InjCtl_qCurr /end IN_MEASUREMENT
/end FUNCTION
/begin FUNCTION egsys_tegmod_msg "" /begin OUT_MEASUREMENT EGSys_tManfStat /end OUT_MEASUREMENT /end FUNCTION
/begin FUNCTION egsys_tegmod_uic ""
 /begin OUT_MEASUREMENT EGSys_facAirMass_mp EGSys_facStrtDlv_mp EGSys_phiDiffStrt_mp EGSys_rAirPerTime_mp EGSys_tCorrIAT_mp EGSys_tCorrManf_mp EGSys_tDiffCldEng_mp EGSys_tDiffIAT_mp EGSys_tManfStat_mp /end OUT_MEASUREMENT
/end FUNCTION
/begin FUNCTION egsys_tnscmod "Temperaturmodell für NOx-Speicherkatalysator"
 /begin DEF_CHARACTERISTIC EGSys_cpNSC_C EGSys_tiPT1NSC_C EGSys_swtTimeNSC_C EGSys_tNSCDfl_C EGSys_tNSCExoIncr_MAP /end DEF_CHARACTERISTIC
 /begin IN_MEASUREMENT EGSys_rLmbdAprx EGSys_tAvrgNSC_mp /end IN_MEASUREMENT
/end FUNCTION
/begin FUNCTION egsys_tnscmod_msg "" /begin OUT_MEASUREMENT EGSys_tNSC /end OUT_MEASUREMENT /end FUNCTION
/begin FUNCTION egsys_tnscmod_uic ""
 /begin OUT_MEASUREMENT EGSys_cpEGNSC_mp EGSys_tAvrgNSC_mp EGSys_tNSCExoIncr_mp EGSys_tNSCStat_mp /end OUT_MEASUREMENT
/end FUNCTION
/begin FUNCTION egsys_toxicatmod "Temperaturmodel für Oxidationskatalysator"
 /begin DEF_CHARACTERISTIC EGSys_CalValFl_C EGSys_cpOxiCat_C EGSys_facTempCmb_CUR EGSys_tiPT1OxiCat_C EGSys_swtTimeOxiCat_C EGSys_tOxiCatDfl_C EGSys_tOxiCatExoIncr_MAP /end DEF_CHARACTERISTIC
 /begin IN_MEASUREMENT EGSys_rLmbdAprx EGSys_tAvrgOxiCat_mp /end IN_MEASUREMENT
/end FUNCTION
/begin FUNCTION egsys_toxicatmod_msg "" /begin OUT_MEASUREMENT EGSys_tOxiCat /end OUT_MEASUREMENT /end FUNCTION
/begin FUNCTION egsys_toxicatmod_uic ""
 /begin OUT_MEASUREMENT EGSys_cpEGOxiCat_mp EGSys_dwFlCmb_mp EGSys_tAvrgOxiCat_mp EGSys_tIncrPoI_mp EGSys_tOxiCatExoIncr_mp EGSys_tOxiCatStat_mp /end OUT_MEASUREMENT
/end FUNCTION
/begin FUNCTION egsys_tstrtcalc "Temperaturmodell für Fahrzeugstillstand"
 /begin DEF_CHARACTERISTIC EGSys_facTempClg_CUR EGSys_facTimeClg_CUR EGSys_swtTAirSens_C EGSys_tiHaValClnt_C EGSys_tiHaValNSC_C EGSys_tiHaValOxiCat_C EGSys_tiHaValTrb_C EGSys_tiHaValTube_C EGSys_tiOfsClg_C EGSys_tStrtCsRepl_C /end DEF_CHARACTERISTIC
 /begin IN_MEASUREMENT EGSys_rTempClnt_mp EGSys_rTimeTrb_mp /end IN_MEASUREMENT
 /begin OUT_MEASUREMENT EGSys_rTimeTube_mp /end OUT_MEASUREMENT
/end FUNCTION
/begin FUNCTION egsys_tstrtcalc_msg ""
 /begin OUT_MEASUREMENT EGSys_tNSCStrtCs EGSys_tOxiCatStrtCs EGSys_tTrbStrtCs EGSys_tTubeStrtCs /end OUT_MEASUREMENT
/end FUNCTION
/begin FUNCTION egsys_tstrtcalc_uic ""
 /begin OUT_MEASUREMENT EGSys_rTempClnt_mp EGSys_rTimeNSC_mp EGSys_rTimeOxiCat_mp EGSys_rTimeTrb_mp EGSys_tExcClntStrtCs_mp EGSys_tiClg_mp EGSys_tiRefClg_mp /end OUT_MEASUREMENT
/end FUNCTION
/begin FUNCTION egsys_ttrbmod ""
 /begin DEF_CHARACTERISTIC EGSys_cpChrg_C EGSys_etaChrg_MAP EGSys_tiChrgPT1_C EGSys_pValDfl_C EGSys_rTempAdbt_CUR EGSys_swtTimeChrg_C EGSys_tEGPstTrbnDfl_C /end DEF_CHARACTERISTIC
 /begin IN_MEASUREMENT AFSCD_dmAirPerTime EGSys_rPresCmpr_mp /end IN_MEASUREMENT
/end FUNCTION
/begin FUNCTION egsys_ttrbmod_msg "" /begin OUT_MEASUREMENT EGSys_tEGPstTrbn /end OUT_MEASUREMENT /end FUNCTION
/begin FUNCTION egsys_ttrbmod_uic ""
 /begin OUT_MEASUREMENT EGSys_cpEGTrbn_mp EGSys_etaChrg_mp EGSys_facPT1Chrg_mp EGSys_pwrCmpr_mp EGSys_rPresCmpr_mp EGSys_tAvrgEGTrbn_mp /end OUT_MEASUREMENT
/end FUNCTION
/begin FUNCTION egsys_ttubemod "Temperaturmodell für Abgasrohr"
 /begin DEF_CHARACTERISTIC EGSys_AlpFreeCnvtTube_C EGSys_cpTube_C EGSys_lDiamTube_C EGSys_lLngthTube_C EGSys_NuTubeEnv_CUR EGSys_NuTube_CUR EGSys_rSqTube_C EGSys_tEGTubeDfl_C EGSys_tTubeDfl_C EGSys_tTubeIKi_C EGSys_tTubeIKiPos_C EGSys_tTubeIKiNeg_C EGSys_tTubeIWinPos_C EGSys_tTubeIWinNeg_C /end DEF_CHARACTERISTIC
 /begin OUT_MEASUREMENT EGSys_AlpEGTube_mp EGSys_AlpTubeEnv_mp EGSys_cndHtEGi_mp EGSys_cndHtEGo_mp EGSys_cpEGTube_mp EGSys_dtTube_mp EGSys_dwTubeIn_mp EGSys_dwTubeOut_mp EGSys_dwTube_mp EGSys_NuTubeEnv_mp EGSys_NuTube_mp EGSys_ReTubeEnvInpCrv_mp EGSys_ReTubeEnv_mp EGSys_ReTubeInpCrv_mp EGSys_ReTube_mp EGSys_sqTube_mp EGSys_tAvrgEGTube_mp EGSys_tDiffEGTube_mp EGSys_tDiffTubeEnv_mp EGSys_tMidEGTube_mp EGSys_tMidTubeEnv_mp /end OUT_MEASUREMENT
/end FUNCTION
/begin FUNCTION egsys_ttubemod_msg "" /begin OUT_MEASUREMENT EGSys_tEGPstTube EGSys_tTube /end OUT_MEASUREMENT /end FUNCTION
/begin FUNCTION egsys_ttubemod_uic "" /end FUNCTION
/begin COMPU_METHOD AirMassPerTime "Luftmasse pro Zeit" RAT_FUNC "%6.3" "Kg/h" COEFFS 0 10 0 0 0 1 /end COMPU_METHOD
/begin COMPU_METHOD AngleCrS "Winkel Kurbelwelle" RAT_FUNC "%6.4" "deg CrS" COEFFS 0 42.6666666666667 0 0 0 1 /end COMPU_METHOD
/begin COMPU_METHOD Area "Flaeche mit hoher Aufloesung" RAT_FUNC "%6.5" "m*m" COEFFS 0 8192 0 0 0 1 /end COMPU_METHOD
/begin COMPU_METHOD Calory "Heizwert" RAT_FUNC "%6.2" "J/g" COEFFS 0 1 0 0 0 1 /end COMPU_METHOD
/begin COMPU_METHOD CubMtrPerHr "Volumsstrom in m^3/h" RAT_FUNC "%6.3" "m^3/h" COEFFS 0 10 0 0 0 1 /end COMPU_METHOD
/begin COMPU_METHOD DfpName "Verbale Umrechnung für Fehlerpfadnamen" TAB_VERB "%6.3" "-" COMPU_TAB_REF DfpName /end COMPU_METHOD
/begin COMPU_VTAB DfpName "Verbale Umrechnung für Fehlerpfadnamen" TAB_VERB 340 0 "Dfp_unused" 1 "Dfp_Layer_TANS" 2 "Dfp_ACCDCmpr" 3 "Dfp_ACCDPres" 4 "Dfp_ACCDPres1" 5 "Dfp_ACCDPresAna" 6 "Dfp_ACCDSwtin" 7 "Dfp_ACC_PlausTrqDes" 8 "Dfp_ACC_trqInr" 9 "Dfp_ACTrq" 10 "Dfp_ADCMon" 11 "Dfp_AFSCDIdlAdjVal" 12 "Dfp_AFSCDLdAdjVal" 13 "Dfp_AFSCD_AirTempDcyc" 14 "Dfp_AFSCD_PlOffsDrft" 15 "Dfp_AFSCD_PlSetyDrft" 16 "Dfp_AFSCD_SRCAirTemp" 17 "Dfp_AFSCD_SRCBatt" 18 "Dfp_AFSCD_SRCCorrAirm" 19 "Dfp_AFSCD_SRCRawAirm" 20 "Dfp_Layer_TUMG" 21 "Dfp_AFSCD_SRCRefSigPer" 22 "Dfp_AOHtCD" 23 "Dfp_Layer_GEN" 24 "Dfp_Layer_BSD" 25 "Dfp_AOHtCD_AOHtDia1" 26 "Dfp_AOHtCD_AOHtDia2" 27 "Dfp_AOHtCD_AOHtDia3" 28 "Dfp_APP1" 29 "Dfp_APP2" 30 "Dfp_APPSync" 31 "Dfp_APSCD" 32 "Dfp_ARS" 33 "Dfp_AccPedPlausBrk" 34 "Dfp_AirCtlGvnrDvtRgnMax" 35 "Dfp_Layer_QLT" 36 "Dfp_AirCtlGvnrDvtRgnMax2" 37 "Dfp_Layer_IBS1" 38 "Dfp_Layer_IBS2" 39 "Dfp_Layer_IBS3" 40 "Dfp_Layer_PMBN" 41 "Dfp_Layer_PMBATT" 42 "Dfp_AirCtlGvnrDvtRgnMin" 43 "Dfp_AirCtlGvnrDvtRgnMin2" 44 "Dfp_AirCtlPlateBreak" 45 "Dfp_AirCtlRmpTO" 46 "Dfp_AirCtl_GovNegDev" 47 "Dfp_AirCtl_GovNegDev2" 48 "Dfp_AirCtl_GovPosDev" 49 "Dfp_AirCtl_GovPosDev2" 50 "Dfp_AltCD" 51 "Dfp_AltCD_Load" 52 "Dfp_BPACD_BPADia1" 53 "Dfp_BPACD_BPADia2" 54 "Dfp_BPACD_BPADia3" 55 "Dfp_BPACD_Max" 56 "Dfp_BPACD_Min" 57 "Dfp_BPACD_SigNpl" 58 "Dfp_BPSCD" 59 "Dfp_BattCD" 60 "Dfp_BrkCD" 61 "Dfp_Bss" 62 "Dfp_CBACD" 63 "Dfp_CTSCD" 64 "Dfp_Clg_DynTst" 65 "Dfp_CmbChbMisfire1" 66 "Dfp_CmbChbMisfire2" 67 "Dfp_CmbChbMisfire3" 68 "Dfp_CmbChbMisfire4" 69 "Dfp_CmbChbMisfire5" 70 "Dfp_CmbChbMisfire6" 71 "Dfp_CmbChbMisfireMul" 72 "Dfp_CoVMDCSh" 73 "Dfp_ConvCD" 74 "Dfp_Layer_PMRUHVERL" 75 "Dfp_CrCCDMFL" 76 "Dfp_CrCtl_vCrCtl" 77 "Dfp_DCC_PlausTrqDes" 78 "Dfp_Dummy1" 79 "Dfp_Layer_TOENS" 80 "Dfp_Layer_MANHYDR" 81 "Dfp_Layer_MANLUFT" 82 "Dfp_EATSCD" 83 "Dfp_EBAFCD" 84 "Dfp_EBFCD" 85 "Dfp_EBTSCD" 86 "Dfp_EBTSCD_OvrTemp" 87 "Dfp_EEPCDVarMng" 88 "Dfp_EGPpCD" 89 "Dfp_EGPpCDTPreTrbn" 90 "Dfp_EGRCD_Max" 91 "Dfp_EGRCD_Min" 92 "Dfp_EGRCD_SigNpl" 93 "Dfp_EGTRgnOilDil" 94 "Dfp_EMCCDNoLoad1" 95 "Dfp_EMCCDNoLoad2" 96 "Dfp_EMCCDSCBat1" 97 "Dfp_EMCCDSCBat2" 98 "Dfp_EMCCDSCGnd1" 99 "Dfp_EMCCDSCGnd2" 100 "Dfp_EMCCD_ADC1" 101 "Dfp_EMCCD_ADC2" 102 "Dfp_ETClbETFltInj1" 103 "Dfp_ETClbETFltInj2" 104 "Dfp_ETClbETFltInj3" 105 "Dfp_ETClbETFltInj4" 106 "Dfp_ETClbETFltInj5" 107 "Dfp_ETClbETFltInj6" 108 "Dfp_ETClbInj1" 109 "Dfp_ETClbInj2" 110 "Dfp_ETClbInj3" 111 "Dfp_ETClbInj4" 112 "Dfp_ETClbInj5" 113 "Dfp_ETClbInj6" 114 "Dfp_EngMCaS1" 115 "Dfp_EngMCrS1" 116 "Dfp_EngMOfsCaSCrS" 117 "Dfp_EngPrtFWODet" 118 "Dfp_FBCqDvt" 119 "Dfp_FMTC_NonMonotonMap" 120 "Dfp_FTSCD" 121 "Dfp_FanCD" 122 "Dfp_FanCD_FanCtlr1" 123 "Dfp_FanCD_FanCtlr2" 124 "Dfp_FanCD_FanCtlr3" 125 "Dfp_FlFCD" 126 "Dfp_FlMngSmkDefect" 127 "Dfp_FrmMngANFRADMOMPT" 128 "Dfp_FrmMngASC1" 129 "Dfp_FrmMngASC2" 130 "Dfp_FrmMngASC3" 131 "Dfp_FrmMngASC4" 132 "Dfp_FrmMngBOS_RESET" 133 "Dfp_FrmMngBOS_RESET_2" 134 "Dfp_FrmMngDMANFAFS" 135 "Dfp_FrmMngDRMANFSSG" 136 "Dfp_FrmMngEGS1" 137 "Dfp_FrmMngEGS2" 138 "Dfp_FrmMngGEARBX_DATA" 139 "Dfp_FrmMngGEARBX_DATA2" 140 "Dfp_FrmMngHEAT_AC" 141 "Dfp_FrmMngINSTR2" 142 "Dfp_FrmMngINSTR3" 143 "Dfp_FrmMngLENKRADWINKEL" 144 "Dfp_FrmMngMILEAGE_RANGE" 145 "Dfp_FrmMngOPCRCTLACC" 146 "Dfp_FrmMngPRGG_CCTR" 147 "Dfp_FrmMngPWRMNG_LOADV" 148 "Dfp_FrmMngParkConsumer" 149 "Dfp_FrmMngRQSTGEFAN" 150 "Dfp_FrmMngSSGErr" 151 "Dfp_FrmMngSSGShOff" 152 "Dfp_FrmMngSTAT_ANH" 153 "Dfp_FrmMngSTAT_ARS" 154 "Dfp_FrmMngSTAT_DSC" 155 "Dfp_FrmMngSTAT_EKP" 156 "Dfp_FrmMngSTAT_KOMBI" 157 "Dfp_FrmMngSTAT_SITZ" 158 "Dfp_FrmMngStOBDGbxMilOf" 159 "Dfp_FrmMngStOBDGbxMilOn" 160 "Dfp_FrmMngTEMPRELTIME" 161 "Dfp_FrmMngTERMINAL" 162 "Dfp_FrmMngTIME_DATE" 163 "Dfp_FrmMngTORQUE_DSC" 164 "Dfp_FrmMngTORQUE_GEARBX" 165 "Dfp_FrmMngTrq_ReqACC" 166 "Dfp_FrmMngVEH_MOD" 167 "Dfp_FrmMngVELOCITY" 168 "Dfp_FrmMngWHEEL_SPEED" 169 "Dfp_FrmMngstCurr" 170 "Dfp_FrmMngswtPSPOff" 171 "Dfp_GearbxIncMax" 172 "Dfp_GlwCD" 173 "Dfp_GlwCDGlwCirc1" 174 "Dfp_GlwCDGlwCirc2" 175 "Dfp_GlwCDGlwCirc3" 176 "Dfp_GlwCDGlwCirc4" 177 "Dfp_GlwCDGlwCirc5" 178 "Dfp_GlwCDGlwCirc6" 179 "Dfp_GlwCDGlwCirc7" 180 "Dfp_GlwCDGlwCirc8" 181 "Dfp_GlwCtl" 182 "Dfp_HWEMonCom" 183 "Dfp_HWEMonEEPROM" 184 "Dfp_HWEMonRcyLocked" 185 "Dfp_HWEMonRcySuppressed" 186 "Dfp_HWEMonRcyVisible" 187 "Dfp_HWEMonUMaxSupply" 188 "Dfp_HWEMonUMinSupply" 189 "Dfp_IATSCD" 190 "Dfp_IATSCD_CATS" 191 "Dfp_ImmCtlImmCD" 192 "Dfp_ImmCtlImmEep" 193 "Dfp_ImmCtlMpl" 194 "Dfp_IndSys1" 195 "Dfp_IndSys2" 196 "Dfp_InjCrv_InjLim" 197 "Dfp_InjCtlAdjQnt" 198 "Dfp_InjCtlDrift" 199 "Dfp_InjVlvBnk1A" 200 "Dfp_InjVlvBnk1B" 201 "Dfp_InjVlvBnk2A" 202 "Dfp_InjVlvBnk2B" 203 "Dfp_InjVlvChipA" 204 "Dfp_InjVlvChipB" 205 "Dfp_InjVlvCyl1A" 206 "Dfp_InjVlvCyl1B" 207 "Dfp_InjVlvCyl2A" 208 "Dfp_InjVlvCyl2B" 209 "Dfp_InjVlvCyl3A" 210 "Dfp_InjVlvCyl3B" 211 "Dfp_InjVlvCyl4A" 212 "Dfp_InjVlvCyl4B" 213 "Dfp_InjVlvCyl5A" 214 "Dfp_InjVlvCyl5B" 215 "Dfp_InjVlvCyl6A" 216 "Dfp_InjVlvCyl6B" 217 "Dfp_LPACD_Max" 218 "Dfp_LPACD_Min" 219 "Dfp_LPACD_SigNpl" 220 "Dfp_LSUCDCircNernst0" 221 "Dfp_LSUCDCircPumpCur0" 222 "Dfp_LSUCDCircVirtGnd0" 223 "Dfp_LSUCDHeater0" 224 "Dfp_LSUCDHtCoup0" 225 "Dfp_LSUCDO20" 226 "Dfp_LSUCDO2Clb0" 227 "Dfp_LSUCDRiClb0" 228 "Dfp_LSUCDSPI0" 229 "Dfp_LSUCDSPIBattLow0" 230 "Dfp_LSUCDWireIP0" 231 "Dfp_LSUCtlRiExc0" 232 "Dfp_LSUMon1Sens" 233 "Dfp_LSUMon2Sens" 234 "Dfp_MIL" 235 "Dfp_MRlyCD" 236 "Dfp_MSidCD_Comm" 237 "Dfp_MSidCD_Pin" 238 "Dfp_MSidCD_Sel_INI" 239 "Dfp_MSidCD_Select" 240 "Dfp_MeUnCDNoLoad" 241 "Dfp_MeUnCDSCBat" 242 "Dfp_MeUnCDSCGnd" 243 "Dfp_MeUnCD_ADC" 244 "Dfp_MeUnCD_SigTst" 245 "Dfp_Montr" 246 "Dfp_NetMngDeviceA" 247 "Dfp_NetMngDeviceB" 248 "Dfp_NetMngDeviceC" 249 "Dfp_OPSCD_Lamp" 250 "Dfp_OPSCD_anain" 251 "Dfp_OTSCD" 252 "Dfp_OvRMon" 253 "Dfp_OvRMonBrk" 254 "Dfp_OvRMonSigA" 255 "Dfp_OxiCCDTPre" 256 "Dfp_PCR_GovDevNeg" 257 "Dfp_PCR_GovDevPos" 258 "Dfp_PCR_LPGvnrDvtNeg" 259 "Dfp_PCR_LPGvnrDvtPos" 260 "Dfp_PCVCDNoLoad" 261 "Dfp_PCVCDSCBat" 262 "Dfp_PCVCDSCGnd" 263 "Dfp_PCVCD_ADC" 264 "Dfp_PCVCD_SigTst" 265 "Dfp_PFltAPSPlaus" 266 "Dfp_PFltAPSens" 267 "Dfp_PFltBPSPlaus" 268 "Dfp_PFltCDPPre" 269 "Dfp_PFltCDTempPre" 270 "Dfp_PFltChar" 271 "Dfp_PFltEngPrt" 272 "Dfp_PFltPresDynPlaus" 273 "Dfp_PFltPresPlaus" 274 "Dfp_PFltPresSens" 275 "Dfp_PFltPresSensFrz" 276 "Dfp_PFltPresSensHsLn" 277 "Dfp_PFltPresSensSot" 278 "Dfp_PFltRgnPerm" 279 "Dfp_PFltTempDwnStrm" 280 "Dfp_PFltTempSens" 281 "Dfp_PFltTempUpStrm" 282 "Dfp_PFltmSotDiffMax" 283 "Dfp_PSPCD_Actr" 284 "Dfp_PresPlausDblDef" 285 "Dfp_QLTCD" 286 "Dfp_RailCD" 287 "Dfp_RailCDOfsTst" 288 "Dfp_RailCD_PMonStrt" 289 "Dfp_RailCtlModeMeUnDiag" 290 "Dfp_RailCtlModePCVDiag" 291 "Dfp_RailMeUn0" 292 "Dfp_RailMeUn1" 293 "Dfp_RailMeUn2" 294 "Dfp_RailMeUn3" 295 "Dfp_RailMeUn4" 296 "Dfp_RailPCV0" 297 "Dfp_RailPCV1" 298 "Dfp_RailPCV2" 299 "Dfp_RailPCV3" 300 "Dfp_RailPCV4" 301 "Dfp_RailPCV5" 302 "Dfp_SOPTst" 303 "Dfp_SSpMon1" 304 "Dfp_SSpMon2" 305 "Dfp_SSpMon3" 306 "Dfp_SWChk_CycSigChkDat" 307 "Dfp_SWChk_CycSigChkPrg" 308 "Dfp_ShutCD" 309 "Dfp_ShutCDMax" 310 "Dfp_ShutCDMin" 311 "Dfp_ShutCDSigNpl" 312 "Dfp_StSysTrqShutOff" 313 "Dfp_StrtCD_Actr" 314 "Dfp_SysLamp" 315 "Dfp_T15CD" 316 "Dfp_TGearbx" 317 "Dfp_TPUMon" 318 "Dfp_TVACD_Max" 319 "Dfp_TVACD_Min" 320 "Dfp_TVACD_SigNpl" 321 "Dfp_TVACD_TVADia1" 322 "Dfp_TVACD_TVADia2" 323 "Dfp_TVACD_TVADia3" 324 "Dfp_TVACD_TVADia4" 325 "Dfp_VSACD_DioInDia1" 326 "Dfp_VSACD_DioInDia2" 327 "Dfp_VSACD_DioInDia3" 328 "Dfp_VSACD_DioInDia4" 329 "Dfp_VSACD_DioInMin" 330 "Dfp_VSACD_Max" 331 "Dfp_VSACD_Min" 332 "Dfp_VSACD_SigNpl" 333 "Dfp_VSACD_VSADia1" 334 "Dfp_VSACD_VSADia2" 335 "Dfp_VSACD_VSADia3" 336 "Dfp_VSACD_VSADia4" 337 "Dfp_VSSCD1" 338 "Dfp_VSSCD2" 339 "Dfp_WdCom" /end COMPU_VTAB
/begin COMPU_METHOD DtyCyc "Tastverhaeltnis" RAT_FUNC "%6.4" "%" COEFFS 0 100 0 0 0 1 /end COMPU_METHOD
/begin COMPU_METHOD Energy "Energie in Joule" RAT_FUNC "%6.2" "kJ" COEFFS 0 1 0 0 0 1 /end COMPU_METHOD
/begin COMPU_METHOD EngN "Motordrehzahl" RAT_FUNC "%6.2" "rpm" COEFFS 0 1 0 0 0 1 /end COMPU_METHOD
/begin COMPU_METHOD Fact "Faktor mit Auflösung 1 / 8192, hauptsächlich für einen Faktorenbereich 0...1 verwendet" RAT_FUNC "%6.5" "-" COEFFS 0 8192 0 0 0 1 /end COMPU_METHOD
/begin COMPU_METHOD Fact1 "Faktor mit Auflösung 0,01 (100 mal höherer Bereich als Fact)" RAT_FUNC "%6.4" "-" COEFFS 0 128 0 0 0 1 /end COMPU_METHOD
/begin COMPU_METHOD FactLow "Faktor mit Auflösung 1/1024, hauptsächlich für einen Faktorenbereich 1...50 verwendet" RAT_FUNC "%6.5" "-" COEFFS 0 8192 0 0 0 1 /end COMPU_METHOD
/begin COMPU_METHOD Fact_PT1 "Faktor um die Zeitkonstante eines PT1 filters festzulegen (Taupunktermittlung)" RAT_FUNC "%6.4" "W/K" COEFFS 0 128 0 0 0 1 /end COMPU_METHOD
/begin COMPU_METHOD FanSpd "(MAXSINT16 / FANSPD_MAX) * phys" RAT_FUNC "%6.3" "1/min" COEFFS 0 10.9223333333333 0 0 0 1 /end COMPU_METHOD
/begin COMPU_METHOD FCMChkCause "Verbale Umrechnung für Message für DSM internen gebrauch (unterstützung bei DSM problemen)" TAB_VERB "%6.3" "-" COMPU_TAB_REF FCMChkCause /end COMPU_METHOD
/begin COMPU_VTAB FCMChkCause "Verbale Umrechnung für Message für DSM internen gebrauch (unterstützung bei DSM problemen)" TAB_VERB 15 1 "fcmEnd npl: fcmEnd > FCM_TAB_SIZE" 2 "Erf and Typ npl" 3 "fcmEnd npl: line == fcmEnd" 4 "Mem set but no entry" 5 "No Mem set but entry" 6 "Mem npl class blocked" 7 "class npl" 8 "Mil npl 1" 9 "Mil npl 2" 10 "Scatt npl" 11 "Flc npl" 12 "Hlc npl" 13 "Fcm blocked" 14 "complement npl" 15 "dpfToClear are blocked" /end COMPU_VTAB
/begin COMPU_METHOD HeatCapacity "Waermekapazitaet einer Substanz" RAT_FUNC "%6.3" "J/K" COEFFS 0 10 0 0 0 1 /end COMPU_METHOD
/begin COMPU_METHOD InjMassCorr "Korrektureinspritzmenge" RAT_FUNC "%6.5" "mg/hub" COEFFS 0 1000 0 0 0 1 /end COMPU_METHOD
/begin COMPU_METHOD InjMassCyc "Einspritzmenge pro Zyklus (mg/Zyklus)" RAT_FUNC "%6.4" "mg/cyc" COEFFS 0 100 0 0 0 1 /end COMPU_METHOD
/begin COMPU_METHOD InjMassInj "Einspritzmenge pro Einspritzung (mg/Einspritzung)" RAT_FUNC "%6.4" "mg/inj" COEFFS 0 100 0 0 0 1 /end COMPU_METHOD
/begin COMPU_METHOD Ki_Kelv_Sec "Verstärkungskonstante für Integrator für zeitliche Ableitung der Temperatur" RAT_FUNC "%6.4" "1/s" COEFFS 0 429.4967296 0 0 0 1 /end COMPU_METHOD
/begin COMPU_METHOD lambda "Lambda" RAT_FUNC "%6.5" "-" COEFFS 0 1000 0 0 0 1 /end COMPU_METHOD
/begin COMPU_METHOD Length1 "Abstand in Meter" RAT_FUNC "%6.4" "m" COEFFS 0 128 0 0 0 1 /end COMPU_METHOD
/begin COMPU_METHOD NumPinAdc "verbale Umrechnung für ADC Signale" TAB_VERB "%6.3" "-" COMPU_TAB_REF NumPinAdc /end COMPU_METHOD
/begin COMPU_VTAB NumPinAdc "verbale Umrechnung für ADC Signale" TAB_VERB 27 0 "Water_Temperature_Sensor_182" 1 "Intake_Air_Temperature_Sensor_157" 2 "Charge_Air_Temperature_Sensor_183" 3 "Exhaust_Temperature_Sensor_2_134" 4 "Exhaust_Temperature_Sensor_1_158" 5 "1st_APP_Sensor_252" 6 "2nd_APP_Sensor_239" 7 "ADC_REF" 8 "Boost_Pressure_Sensor_154" 9 "Atmospheric_Pressure_Sensor" 10 "Battery_Voltage_Sensor" 11 "Rail_Pressure_Sensor_156" 12 "Rail_Pressure_Peak_Value_156" 13 "Booster_Voltage_Sensor" 14 "Current_MeUn_Sensor" 15 "Current_PCV_Sensor" 16 "Voltage_Bank_1" 17 "Voltage_Bank_2" 18 "Pressure_Upstream_Particle_Filter_159" 19 "Engine_Oil_Pressure_110" 20 "Temperature_ECU_PCB" 21 "Voltage_Lambda_Ua" 22 "Voltage_Lambda_Ri" 23 "EMCCD_Current_Governor1_124" 24 "EMCCD_Current_Governor2_121" 25 "ADC_DUMMY_NOT_USED" 26 "ADC_DUMMY_A_NOT_USED" /end COMPU_VTAB
/begin COMPU_METHOD NumPinDia "Verbale Umrechnung für Diagnose Signale" TAB_VERB "%6.3" "-" COMPU_TAB_REF NumPinDia /end COMPU_METHOD
/begin COMPU_VTAB NumPinDia "Verbale Umrechnung für Diagnose Signale" TAB_VERB 28 0 "CJ945_Diagnostic_Signal" 1 "AC_Compressor_DiaSig" 2 "Fuel_Pump_Diagnostic_Signal_232" 3 "Starter_234" 4 "Oil_Pressure_Lamp_Switch_245" 5 "Engine_Bay_Air_Flaps_123" 6 "Ebox_Fan_Actuator_Diagnostic_Signal_219" 7 "Shuttr_Actuator_Diagnostic_Signal_231" 8 "Twostage_TurboLoading_SW_DiaSig" 9 "DIO_OUT_DIAGNOSTIC_DUMMY_NOT_USED" 10 "Alternator" 11 "Boost_Pressure_Actuator_Diagnostic_Signal_193" 12 "EGR_Actuator_Diagnostic_Signal_194" 13 "1st_Pressure_Control_Valve_Diagnostic_Signal_172" 14 "2nd_Pressure_Control_Valve_Diagnostic_Signal_172" 15 "1st_Metering_Unit_Diagnostic_Signal_171" 16 "2nd_Metering_Unit_Diagnostic_Signal_171" 17 "Variable_Swirl_Actuator_Diagnostic_Signal_195" 18 "FAN_240" 19 "Add_On_Heater_244" 20 "EngM_Bearing_Actuator_Diagnostic_Signal_124" 21 "EngM_Bearing_Actuator_Diagnostic_Signal_121" 22 "Throttle_Valve_Diagnostic_Signal_196" 23 "Low pressure stage BPA_Diagnostic_Signal_117" 24 "PWM_DIAGNOSTIC_DUMMY_NOT_USED" 25 "1st_Sensor_Supply_Voltage_DiaSig" 26 "2nd_Sensor_Supply_Voltage_DiaSig" 27 "3rd_Sensor_Supply_Voltage_DiaSig" /end COMPU_VTAB
/begin COMPU_METHOD NumPinDioOut "Verbale Umrechnung für Digitalausgang Signale" TAB_VERB "%6.3" "-" COMPU_TAB_REF NumPinDioOut /end COMPU_METHOD
/begin COMPU_VTAB NumPinDioOut "Verbale Umrechnung für Digitalausgang Signale" TAB_VERB 12 0 "Main_Relay_220(144)" 1 "AC_Compressor" 2 "Fuel_Pump_232" 3 "Starter_234" 4 "OPS_Lamp_245" 5 "EBAF_123" 6 "Ebox_Fan_Actuator_219" 7 "Shuttr_Actuator_Digital_231" 8 "STATREG_PSOFF_Bit" 9 "Twostage_TurboLoading_120" 10 "TD_Signal_253" 11 "DIO_OUT_DUMMY_NOT_USED" /end COMPU_VTAB
/begin COMPU_METHOD NumPinPwmOut "Verbale Umrechnung für PWM-Ausgang Signale" TAB_VERB "%6.3" "-" COMPU_TAB_REF NumPinPwmOut /end COMPU_METHOD
/begin COMPU_VTAB NumPinPwmOut "Verbale Umrechnung für PWM-Ausgang Signale" TAB_VERB 14 0 "Boost_Pressure_Actuator_193" 1 "EGR_Actuator_194" 2 "PCV_Actuator_172" 3 "MeUn_Actuator_171" 4 "Variable_Swirl_Actuator_195" 5 "Fan_Actuator_240" 6 "Add_On_Heater_244" 7 "EngM_Bearing_Actuator_124" 8 "EngM_Bearing_Actuator_121" 9 "Throttle_Valve_196" 10 "LSU_Heater_PWMOutput" 11 "Low pressure stage BPA_117" 12 "Shuttr_Actuator_PWM_231" 13 "PWM_DUMMY_NOT_USED" /end COMPU_VTAB
/begin COMPU_METHOD OneToOne "eins zu eins (physikalischer Wert ist gleich dem internen Wert)" RAT_FUNC "%6.2" "-" COEFFS 0 1 0 0 0 1 /end COMPU_METHOD
/begin COMPU_METHOD Period "Periodendauer" RAT_FUNC "%6.3" "ms" COEFFS 0 10 0 0 0 1 /end COMPU_METHOD
/begin COMPU_METHOD Prc "Prozent, gleiche interne Auflösung wie Fact, aber Darstellung in Prozent (0...100%)" RAT_FUNC "%6.4" "%" COEFFS 0 81.92 0 0 0 1 /end COMPU_METHOD
/begin COMPU_METHOD Pres_hPa "Druck (angezeigt in [hPa])" RAT_FUNC "%6.2" "hPa" COEFFS 0 1 0 0 0 1 /end COMPU_METHOD
/begin COMPU_METHOD Pwr "Leistung" RAT_FUNC "%6.2" "W" COEFFS 0 0.10610329539459 0 0 0 1 /end COMPU_METHOD
/begin COMPU_METHOD Pwr1 "Leistung mit Hoher Aufloesung" RAT_FUNC "%6.3" "W" COEFFS 0 10 0 0 0 1 /end COMPU_METHOD
/begin COMPU_METHOD Pwr_kW_Sec "Leistungsaenderungsrate in kW/s" RAT_FUNC "%6.4" "kW/s" COEFFS 0 100 0 0 0 1 /end COMPU_METHOD
/begin COMPU_METHOD RdyOnMilEnable "Verbale Umrechnung für DSM_RdyOnMilEnable_C" TAB_VERB "%6.3" "-" COMPU_TAB_REF RdyOnMilEnable /end COMPU_METHOD
/begin COMPU_VTAB RdyOnMilEnable "Verbale Umrechnung für DSM_RdyOnMilEnable_C" TAB_VERB 2 0 "normal" 1 "set all Rdy bits on Mil ON" /end COMPU_VTAB
/begin COMPU_METHOD ReynoldsNum "Reynolds Nummer um den thermischen Koeffizienten zu bestimmen" RAT_FUNC "%6.0" "-" COEFFS 0 0.01 0 0 0 1 /end COMPU_METHOD
/begin COMPU_METHOD RmpTemp "Rampengradient für Temperatur" RAT_FUNC "%6.4" "deg C/s" COEFFS 0 655.36 0 0 0 1 /end COMPU_METHOD
/begin COMPU_METHOD RmpTempCels "temperature ramp gradient in Centigrade" RAT_FUNC "%8.7" "C/ms" COEFFS 0 655360 0 0 0 1 /end COMPU_METHOD
/begin COMPU_METHOD SpecificHeat "spezifische Waermekapazitaet einer Substanz" RAT_FUNC "%7.6" "J/g/K" COEFFS 0 10000 0 0 0 1 /end COMPU_METHOD
/begin COMPU_METHOD TempDiff_Cels "difference/offset temperature displayed in degree celcius" RAT_FUNC "%6.3" "deg C" COEFFS 0 10 0 0 0 1 /end COMPU_METHOD
/begin COMPU_METHOD Temp_Cels "Temperatur dargestellt in °C (gleiche interne Darstellung wie Temp_Kelv)" RAT_FUNC "%6.1" "deg C" COEFFS 0 10 2731.4 0 0 1 /end COMPU_METHOD
/begin COMPU_METHOD Temp_Kelv_Sec "Temperaturaenderungsrate" RAT_FUNC "%6.4" "K/s" COEFFS 0 100 0 0 0 1 /end COMPU_METHOD
/begin COMPU_METHOD ThermalCoEff "Waermekoeffiziens einer Substanz" RAT_FUNC "%6.3" "W/m/m/K" COEFFS 0 10 0 0 0 1 /end COMPU_METHOD
/begin COMPU_METHOD TimeDeb "Entprellzeit in Millisekunden für Libraryfunktion Debounce" RAT_FUNC "%6.1" "ms" COEFFS 0 0.1 0 0 0 1 /end COMPU_METHOD
/begin COMPU_METHOD TimeDelay_s "Zeitkonstante T1 (in s) für PT1, DT1, etc." RAT_FUNC "%9.3" "s" COEFFS 0 0 1 0 0.00023283064365387 0 /end COMPU_METHOD
/begin COMPU_METHOD TimeDsmTsf "Skalierung der DSM Schwerezähler Werte" RAT_FUNC "%6.0" "ms" COEFFS 0 0.005 0 0 0 1 /end COMPU_METHOD
/begin COMPU_METHOD Time_ms "Zeit in ms für Fehlerentprellung (DSM) und SW-Timer" RAT_FUNC "%6.1" "ms" COEFFS 0 0.1 0 0 0 1 /end COMPU_METHOD
/begin COMPU_METHOD Time_s "Zeit in s für Fehlerentprellung (DSM) und SW-Timer" RAT_FUNC "%6.4" "s" COEFFS 0 100 0 0 0 1 /end COMPU_METHOD
/begin COMPU_METHOD Vel "Fahrzeuggeschwindigkeit, gleiche interne Auflösung wie Vel_SI" RAT_FUNC "%6.4" "km/h" COEFFS 0 100 0 0 0 1 /end COMPU_METHOD
/begin COMPU_METHOD Volt "Spannung in V (von ADC)" RAT_FUNC "%6.2" "mV" COEFFS 0 0.2046 0 0 0 1 /end COMPU_METHOD
/begin RECORD_LAYOUT Kf_Xs16_Ys16_Ws16 NO_AXIS_PTS_X 1 SWORD NO_AXIS_PTS_Y 2 SWORD AXIS_PTS_X 3 SWORD INDEX_INCR DIRECT AXIS_PTS_Y 4 SWORD INDEX_INCR DIRECT FNC_VALUES 5 SWORD COLUMN_DIR DIRECT /end RECORD_LAYOUT
/begin RECORD_LAYOUT Kl_Xs16_Ws16 NO_AXIS_PTS_X 1 SWORD AXIS_PTS_X 2 SWORD INDEX_INCR DIRECT FNC_VALUES 3 SWORD COLUMN_DIR DIRECT /end RECORD_LAYOUT
/begin RECORD_LAYOUT Kwb_Ws16 FNC_VALUES 1 SWORD COLUMN_DIR DIRECT /end RECORD_LAYOUT
/begin RECORD_LAYOUT Kwb_Wu16 FNC_VALUES 1 UWORD COLUMN_DIR DIRECT /end RECORD_LAYOUT
/begin RECORD_LAYOUT Kwb_Wu32 FNC_VALUES 1 ULONG COLUMN_DIR DIRECT /end RECORD_LAYOUT
/begin RECORD_LAYOUT Kwb_Wu8 FNC_VALUES 1 UBYTE COLUMN_DIR DIRECT /end RECORD_LAYOUT
/begin RECORD_LAYOUT Kw_Ws16 FNC_VALUES 1 SWORD COLUMN_DIR DIRECT /end RECORD_LAYOUT
/begin RECORD_LAYOUT Kw_Wu16 FNC_VALUES 1 UWORD COLUMN_DIR DIRECT /end RECORD_LAYOUT
/begin RECORD_LAYOUT Kw_Wu32 FNC_VALUES 1 ULONG COLUMN_DIR DIRECT /end RECORD_LAYOUT
/begin RECORD_LAYOUT Kw_Wu8 FNC_VALUES 1 UBYTE COLUMN_DIR DIRECT /end RECORD_LAYOUT
/end MODULE
/end PROJECT
