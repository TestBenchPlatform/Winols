ASAP2_VERSION 1 3
/begin PROJECT P389 "BMW DDE6.0 4-Zylinder V70.2 30.03.2004"
/begin HEADER "" VERSION "V70.2_4Z" PROJECT_NO P389 /end HEADER
/begin MODULE DIM ""
/begin MOD_COMMON "" BYTE_ORDER MSB_FIRST ALIGNMENT_BYTE 1 ALIGNMENT_WORD 2 ALIGNMENT_LONG 4 ALIGNMENT_FLOAT32_IEEE 4 /end MOD_COMMON
/begin CHARACTERISTIC Signals_adFreeApplic1_C "adresse eines frei applizierbaren Signals" VALUE 0xC0710 Kw_Wu32 4294967295.00 OneToOne 0.00 4294967295.00 FORMAT "%13.2" /end CHARACTERISTIC
/begin CHARACTERISTIC Signals_numTypFreeApplic1_C "Datentyp eines frei applizierbaren Signals" VALUE 0xC0714 Kw_Wu8 5.00000000000 SigDatatyp 0.00 5.00000000000 FORMAT "%13.11" /end CHARACTERISTIC
/begin CHARACTERISTIC Signals_adFreeApplic2_C "adresse eines frei applizierbaren Signals" VALUE 0xC0718 Kw_Wu32 4294967295.00 OneToOne 0.00 4294967295.00 FORMAT "%13.2" /end CHARACTERISTIC
/begin CHARACTERISTIC Signals_numTypFreeApplic2_C "Datentyp eines frei applizierbaren Signals" VALUE 0xC071C Kw_Wu8 5.00000000000 SigDatatyp 0.00 5.00000000000 FORMAT "%13.11" /end CHARACTERISTIC
/begin CHARACTERISTIC Signals_adFreeApplic3_C "adresse eines frei applizierbaren Signals" VALUE 0xC0720 Kw_Wu32 4294967295.00 OneToOne 0.00 4294967295.00 FORMAT "%13.2" /end CHARACTERISTIC
/begin CHARACTERISTIC Signals_numTypFreeApplic3_C "Datentyp eines frei applizierbaren Signals" VALUE 0xC0724 Kw_Wu8 5.00000000000 SigDatatyp 0.00 5.00000000000 FORMAT "%13.11" /end CHARACTERISTIC
/begin CHARACTERISTIC Sig_LimLowDigital_C "Unterer Grenzwert für Stellertests mit digitaler Stellgröße" VALUE 0xC0B1A Kw_Ws16 65535.00 OneToOne -32768.00 32767.00 FORMAT "%8.2" /end CHARACTERISTIC
/begin CHARACTERISTIC Sig_LimUpDigital_C "Oberer Grenzwert für Stellertests mit digitaler Stellgröße" VALUE 0xC0B1C Kw_Ws16 65535.00 OneToOne -32768.00 32767.00 FORMAT "%8.2" /end CHARACTERISTIC
/begin CHARACTERISTIC Sig_LimLowFlCon_C "Unterer Grenzwert für Stellertests mit Kraftstoffverbrauch Stellgröße" VALUE 0xC0B1E Kw_Ws16 655.3500 FlConsum_l_h -327.6800 327.6700 FORMAT "%8.4" /end CHARACTERISTIC
/begin CHARACTERISTIC Sig_LimUpFlCon_C "Oberer Grenzwert für Stellertests mit Kraftstoffverbrauch Stellgröße" VALUE 0xC0B20 Kw_Ws16 655.3500 FlConsum_l_h -327.6800 327.6700 FORMAT "%8.4" /end CHARACTERISTIC
/begin CHARACTERISTIC Sig_LimLown_C "Unterer Grenzwert für Stellertests mit Drehzahl Stellgröße" VALUE 0xC0B22 Kw_Ws16 65535.00 EngN -32768.00 32767.00 FORMAT "%8.2" /end CHARACTERISTIC
/begin CHARACTERISTIC Sig_LimUpn_C "Oberer Grenzwert für Stellertests mit Drehzahl Stellgröße" VALUE 0xC0B24 Kw_Ws16 65535.00 EngN -32768.00 32767.00 FORMAT "%8.2" /end CHARACTERISTIC
/begin CHARACTERISTIC Sig_LimLowPwm_C "Unterer Grenzwert für Stellertests mit PWM Stellgröße" VALUE 0xC0B26 Kw_Ws16 655.3500 DtyCyc -327.6800 327.6700 FORMAT "%8.4" /end CHARACTERISTIC
/begin CHARACTERISTIC Sig_LimUpPwm_C "Oberer Grenzwert für Stellertests mit PWM Stellgröße" VALUE 0xC0B28 Kw_Ws16 655.3500 DtyCyc -327.6800 327.6700 FORMAT "%8.4" /end CHARACTERISTIC
/begin CHARACTERISTIC Sig_LimLowtrq_C "lower limit of  AC tester torque test input" VALUE 0xC0B2A Kw_Ws16 6553.500 Trq -3276.800 3276.700 FORMAT "%8.3" /end CHARACTERISTIC
/begin CHARACTERISTIC Sig_LimUptrq_C "upper limit of  AC tester torque test input" VALUE 0xC0B2C Kw_Ws16 6553.500 Trq -3276.800 3276.700 FORMAT "%8.3" /end CHARACTERISTIC
/begin CHARACTERISTIC signals_tiTstDemHeal_C "Minimale Zeit ohne Stellertestanforderung nach Verriegelung wegen Zeitüberschreitung." VALUE 0xEE790 Kw_Wu16 655350.0 Time_ms 0.00 655350.0 FORMAT "%8.1" /end CHARACTERISTIC
/begin CHARACTERISTIC signals_tiTstDemMax_C "Maximale zulässige Testzeit für Stellertest über Diagnosetester" VALUE 0xEE792 Kw_Wu16 655350.0 Time_ms 0.00 655350.0 FORMAT "%8.1" /end CHARACTERISTIC
/begin CHARACTERISTIC signals_TmrBehaviour_C "Verhalten der Zeitbegrenzung für Stellertest" VALUE 0xEE794 Kw_Wu8 255.0 OneToOne 0.00 255.0 FORMAT "%5.1" /end CHARACTERISTIC
/begin CHARACTERISTIC signals_TstDemMaxEngN_C "Maximale Drehzahl für Stellertest über Diagnosetester" VALUE 0xEE796 Kw_Ws16 65535.00 EngN -32768.00 32767.00 FORMAT "%8.2" /end CHARACTERISTIC
/begin CHARACTERISTIC signals_TstDemMaxVSSCDV_C "Maximale Geschwindigkeit für Stellertest über Diagnosetester" VALUE 0xEE798 Kw_Ws16 655.3500 Vel -327.6800 327.6700 FORMAT "%8.4" /end CHARACTERISTIC
/begin CHARACTERISTIC SigTst_ACEn_C "Stellertestüberwachung Freigabemaske für Klimaanlage Ausgang" VALUE 0xEE79A Kw_Wu8 7.000 OneToOne 0.00 7.000 FORMAT "%5.3" EXTENDED_LIMITS 0.00 255.0 /end CHARACTERISTIC
/begin CHARACTERISTIC SigTst_AOHtEn_C "Stellertestüberwachung Freigabemaske für Zusatzheizersteller" VALUE 0xEE79B Kw_Wu8 7.000 OneToOne 0.00 7.000 FORMAT "%5.3" EXTENDED_LIMITS 0.00 255.0 /end CHARACTERISTIC
/begin CHARACTERISTIC SigTst_BPAEn_C "Stellertestüberwachung Freigabemaske für Ladedrucksteller" VALUE 0xEE79C Kw_Wu8 7.000 OneToOne 0.00 7.000 FORMAT "%5.3" EXTENDED_LIMITS 0.00 255.0 /end CHARACTERISTIC
/begin CHARACTERISTIC SigTst_CpBVlvEn_C "Switch to enable tester" VALUE 0xEE79D Kw_Wu8 7.000 OneToOne 0.00 7.000 FORMAT "%5.3" EXTENDED_LIMITS 0.00 255.0 /end CHARACTERISTIC
/begin CHARACTERISTIC SigTst_EBAFEn_C "Stellertestüberwachung Freigabemaske für EBAfCD" VALUE 0xEE79E Kw_Wu8 7.000 OneToOne 0.00 7.000 FORMAT "%5.3" EXTENDED_LIMITS 0.00 255.0 /end CHARACTERISTIC
/begin CHARACTERISTIC SigTst_EBFEn_C "Freigabemaske für Stellertestüberwachung für E-Box Lüfter" VALUE 0xEE79F Kw_Wu8 7.000 OneToOne 0.00 7.000 FORMAT "%5.3" EXTENDED_LIMITS 0.00 255.0 /end CHARACTERISTIC
/begin CHARACTERISTIC SigTst_EGPpEn_C "Tester demand monitoring enable mask for EGPp" VALUE 0xEE7A0 Kw_Wu8 7.000 OneToOne 0.00 7.000 FORMAT "%5.3" EXTENDED_LIMITS 0.00 255.0 /end CHARACTERISTIC
/begin CHARACTERISTIC SigTst_EGREn_C "Stellertestüberwachung Freigabemaske für Abgasrückführpositionssteller" VALUE 0xEE7A1 Kw_Wu8 7.000 OneToOne 0.00 7.000 FORMAT "%5.3" EXTENDED_LIMITS 0.00 255.0 /end CHARACTERISTIC
/begin CHARACTERISTIC SigTst_ETClbCorOffEn_C "Tester Anforderung Überwachungsfreigabemaske für die Ansteuerdauerkorrektur der Nullmengenkalibrierung" VALUE 0xEE7A2 Kw_Wu8 7.000 OneToOne 0.00 7.000 FORMAT "%5.3" EXTENDED_LIMITS 0.00 255.0 /end CHARACTERISTIC
/begin CHARACTERISTIC SigTst_FANEn_C "Stellertest für Kühlerlüfter" VALUE 0xEE7A3 Kw_Wu8 7.000 OneToOne 0.00 7.000 FORMAT "%5.3" EXTENDED_LIMITS 0.00 255.0 /end CHARACTERISTIC
/begin CHARACTERISTIC SigTst_GLWRLYEn_C "Stellertestüberwachung Freigabemaske für Glüh Relay" VALUE 0xEE7A4 Kw_Wu8 7.000 OneToOne 0.00 7.000 FORMAT "%5.3" EXTENDED_LIMITS 0.00 255.0 /end CHARACTERISTIC
/begin CHARACTERISTIC SigTst_LPAEn_C "Switch to enable tester" VALUE 0xEE7A5 Kw_Wu8 7.000 OneToOne 0.00 7.000 FORMAT "%5.3" EXTENDED_LIMITS 0.00 255.0 /end CHARACTERISTIC
/begin CHARACTERISTIC SigTst_LSUCDHt0En_C "Auswahlmake für Überwachungsbedingungen des Lambda Sensor Stellertests" VALUE 0xEE7A6 Kw_Wu8 7.000 OneToOne 0.00 7.000 FORMAT "%5.3" EXTENDED_LIMITS 0.00 255.0 /end CHARACTERISTIC
/begin CHARACTERISTIC SigTst_MILLAMPEn_C "Stellertestüberwachung Freigabemaske für MIL (OBD-Lampe)" VALUE 0xEE7A7 Kw_Wu8 7.000 OneToOne 0.00 7.000 FORMAT "%5.3" EXTENDED_LIMITS 0.00 255.0 /end CHARACTERISTIC
/begin CHARACTERISTIC SigTst_MNTCTLEn_C "Tester demand monitoring enable mask for MNTCTL" VALUE 0xEE7A8 Kw_Wu8 7.000 OneToOne 0.00 7.000 FORMAT "%5.3" EXTENDED_LIMITS 0.00 255.0 /end CHARACTERISTIC
/begin CHARACTERISTIC SigTst_MeUnEn_C "Stellertestüberwachung Freigabemaske für Zumesseinheit" VALUE 0xEE7A9 Kw_Wu8 7.000 OneToOne 0.00 7.000 FORMAT "%5.3" EXTENDED_LIMITS 0.00 255.0 /end CHARACTERISTIC
/begin CHARACTERISTIC SigTst_PCVEn_C "Stellertestüberwachung Freigabemaske für Druckregelventil" VALUE 0xEE7AA Kw_Wu8 7.000 OneToOne 0.00 7.000 FORMAT "%5.3" EXTENDED_LIMITS 0.00 255.0 /end CHARACTERISTIC
/begin CHARACTERISTIC SigTst_PSPEn_C "Stellertestüberwachung Freigabemaske für Vorförderpumpen  Ausgang" VALUE 0xEE7AB Kw_Wu8 7.000 OneToOne 0.00 7.000 FORMAT "%5.3" EXTENDED_LIMITS 0.00 255.0 /end CHARACTERISTIC
/begin CHARACTERISTIC SigTst_PSPoverCANEn_C "Enabling the tester signal request." VALUE 0xEE7AC Kw_Wu8 7.000 OneToOne 0.00 7.000 FORMAT "%5.3" EXTENDED_LIMITS 0.00 255.0 /end CHARACTERISTIC
/begin CHARACTERISTIC SigTst_SYSLAMPEn_C "Stellertestüberwachung Freigabemaske für Systemlampe" VALUE 0xEE7AD Kw_Wu8 7.000 OneToOne 0.00 7.000 FORMAT "%5.3" EXTENDED_LIMITS 0.00 255.0 /end CHARACTERISTIC
/begin CHARACTERISTIC SigTst_ShuttrEn_C "Stellertestüberwachung Freigabemaske für Kühlerjalousie" VALUE 0xEE7AE Kw_Wu8 7.000 OneToOne 0.00 7.000 FORMAT "%5.3" EXTENDED_LIMITS 0.00 255.0 /end CHARACTERISTIC
/begin CHARACTERISTIC SigTst_TVAEn_C "Stellertestüberwachung Freigabemaske für Drosselklappensteller" VALUE 0xEE7AF Kw_Wu8 7.000 OneToOne 0.00 7.000 FORMAT "%5.3" EXTENDED_LIMITS 0.00 255.0 /end CHARACTERISTIC
/begin CHARACTERISTIC SigTst_VSAEn_C "Stellertestüberwachung Freigabemaske für Drallniveausteller" VALUE 0xEE7B0 Kw_Wu8 7.000 OneToOne 0.00 7.000 FORMAT "%5.3" EXTENDED_LIMITS 0.00 255.0 /end CHARACTERISTIC
/begin CHARACTERISTIC Sig_aiDSMOffset_C "Offset für Umrechnung ecu -> dsm" VALUE 0xC0728 Kw_Ws16 65535.00 OneToOne -32768.00 32767.00 FORMAT "%8.2" /end CHARACTERISTIC
/begin CHARACTERISTIC Sig_aiDSMScale_C "Skalierung für Umrechnung ecu -> dsm" VALUE 0xC072A Kw_Wu16 7.999878 Fact 0.00 7.999878 FORMAT "%8.6" /end CHARACTERISTIC
/begin CHARACTERISTIC Sig_aiCANOffset_C "Offset für Umrechnung ecu -> can" VALUE 0xC072C Kw_Ws16 65535.00 OneToOne -32768.00 32767.00 FORMAT "%8.2" /end CHARACTERISTIC
/begin CHARACTERISTIC Sig_aiCANScale_C "Skalierung für Umrechnung ecu -> can" VALUE 0xC072E Kw_Wu16 7.999878 Fact 0.00 7.999878 FORMAT "%8.6" /end CHARACTERISTIC
/begin CHARACTERISTIC Sig_aiDIAOffset_C "Offset für Umrechnung  ecu -> dia" VALUE 0xC0730 Kw_Ws16 65535.00 OneToOne -32768.00 32767.00 FORMAT "%8.2" /end CHARACTERISTIC
/begin CHARACTERISTIC Sig_aiDIAScale_C "Skalierung für Umrechnung ecu -> dia" VALUE 0xC0732 Kw_Wu16 7.999878 Fact 0.00 7.999878 FORMAT "%8.6" /end CHARACTERISTIC
/begin CHARACTERISTIC Sig_AngCrSDSMOffset_C "Umrechnung des Kurbelwellenwinkels: dsm offset" VALUE 0xC0734 Kw_Ws16 65535.00 OneToOne -32768.00 32767.00 FORMAT "%8.2" /end CHARACTERISTIC
/begin CHARACTERISTIC Sig_AngCrSDSMScale_C "Umrechnung des Kurbelwellenwinkels: dsm scale factor" VALUE 0xC0736 Kw_Wu16 7.999878 Fact 0.00 7.999878 FORMAT "%8.6" /end CHARACTERISTIC
/begin CHARACTERISTIC Sig_AngCrSCANOffset_C "Umrechnung des Kurbelwellenwinkels: can Offset" VALUE 0xC0738 Kw_Ws16 65535.00 OneToOne -32768.00 32767.00 FORMAT "%8.2" /end CHARACTERISTIC
/begin CHARACTERISTIC Sig_AngCrSCANScale_C "Umrechnung Kurbelwellenwinkels: can scale factor" VALUE 0xC073A Kw_Wu16 7.999878 Fact 0.00 7.999878 FORMAT "%8.6" /end CHARACTERISTIC
/begin CHARACTERISTIC Sig_AngCrSDIAOffset_C "Umrechnung des Kurbelwellenwinkels: dia offset" VALUE 0xC073C Kw_Ws16 65535.00 OneToOne -32768.00 32767.00 FORMAT "%8.2" /end CHARACTERISTIC
/begin CHARACTERISTIC Sig_AngCrSDIAScale_C "Umrechnung des Kurbelwellenwinkels: dia scale factor" VALUE 0xC073E Kw_Wu16 7.999878 Fact 0.00 7.999878 FORMAT "%8.6" /end CHARACTERISTIC
/begin CHARACTERISTIC Sig_aDSMOffset_C "Offset fuer Umrechung SG->DSM fuer Beschleunigung" VALUE 0xC0740 Kw_Ws16 65535.00 OneToOne -32768.00 32767.00 FORMAT "%8.2" /end CHARACTERISTIC
/begin CHARACTERISTIC Sig_aDSMScale_C "Skalierung Umrechungs Faktor SG->DSM fuer Beschleunigung" VALUE 0xC0742 Kw_Wu16 7.999878 Fact 0.00 7.999878 FORMAT "%8.6" /end CHARACTERISTIC
/begin CHARACTERISTIC Sig_aCANOffset_C "Offset fuer Umrechung SG->CAN fuer Beschleunigung" VALUE 0xC0744 Kw_Ws16 65535.00 OneToOne -32768.00 32767.00 FORMAT "%8.2" /end CHARACTERISTIC
/begin CHARACTERISTIC Sig_aCANScale_C "Skalierung Umrechungs Faktor SG->CAN fuer Beschleunigung" VALUE 0xC0746 Kw_Wu16 7.999878 Fact 0.00 7.999878 FORMAT "%8.6" /end CHARACTERISTIC
/begin CHARACTERISTIC Sig_aDIAOffset_C "Offset fuer Umrechung SG->DIA fuer Beschleunigung" VALUE 0xC0748 Kw_Ws16 65535.00 OneToOne -32768.00 32767.00 FORMAT "%8.2" /end CHARACTERISTIC
/begin CHARACTERISTIC Sig_aDIAScale_C "Skalierung Umrechungs Faktor SG->DIA fuer Beschleunigung" VALUE 0xC074A Kw_Wu16 7.999878 Fact 0.00 7.999878 FORMAT "%8.6" /end CHARACTERISTIC
/begin CHARACTERISTIC Sig_Carb_dtDSMOffset_C "Signals Offset für Umrechung  Temperaturdifferenz Intern nach DSM mit CARB Normierung" VALUE 0xC074C Kw_Ws16 65535.00 OneToOne -32768.00 32767.00 FORMAT "%8.2" /end CHARACTERISTIC
/begin CHARACTERISTIC Sig_Carb_dtDSMScale_C "Signals Skalierungsfaktor für Umrechung  Temperaturdifferenz Intern nach DSM mit CARB Normierung" VALUE 0xC074E Kw_Wu16 7.999878 Fact 0.00 7.999878 FORMAT "%8.6" /end CHARACTERISTIC
/begin CHARACTERISTIC Sig_Carb_dtCANOffset_C "Signals Offset für Umrechung  Temperaturdifferenz Intern nach CAN mit CARB Normierung" VALUE 0xC0750 Kw_Ws16 65535.00 OneToOne -32768.00 32767.00 FORMAT "%8.2" /end CHARACTERISTIC
/begin CHARACTERISTIC Sig_Carb_dtCANScale_C "Signals Skalierungsfaktor für Umrechung  Temperaturdifferenz Intern nach CAN mit CARB Normierung" VALUE 0xC0752 Kw_Wu16 7.999878 Fact 0.00 7.999878 FORMAT "%8.6" /end CHARACTERISTIC
/begin CHARACTERISTIC Sig_Carb_dtDIAOffset_C "Signals Offset für Umrechung  Temperaturdifferenz Intern nach Diagnose mit CARB Normierung" VALUE 0xC0754 Kw_Ws16 65535.00 OneToOne -32768.00 32767.00 FORMAT "%8.2" /end CHARACTERISTIC
/begin CHARACTERISTIC Sig_Carb_dtDIAScale_C "Signals Skalierungsfaktor für Umrechung  Temperaturdifferenz Intern nach Diagnose mit CARB Normierung" VALUE 0xC0756 Kw_Wu16 7.999878 Fact 0.00 7.999878 FORMAT "%8.6" /end CHARACTERISTIC
/begin CHARACTERISTIC Sig_Carb_lDSMOffset_C "Signals Offset für Umrechung  Fahrstrecke Intern nach DSM mit CARB Normierung" VALUE 0xC0758 Kw_Ws16 65535.00 OneToOne -32768.00 32767.00 FORMAT "%8.2" /end CHARACTERISTIC
/begin CHARACTERISTIC Sig_Carb_lDSMScale_C "Signals Skalierungsfaktor für Umrechung  Fahrstrecke Intern nach DSM mit CARB Normierung" VALUE 0xC075A Kw_Wu16 7.999878 Fact 0.00 7.999878 FORMAT "%8.6" /end CHARACTERISTIC
/begin CHARACTERISTIC Sig_Carb_lCANOffset_C "Signals Offset für Umrechung  Fahrstrecke Intern nach CAN mit CARB Normierung" VALUE 0xC075C Kw_Ws16 65535.00 OneToOne -32768.00 32767.00 FORMAT "%8.2" /end CHARACTERISTIC
/begin CHARACTERISTIC Sig_Carb_lCANScale_C "Signals Skalierungsfaktor für Umrechung  Fahrstrecke Intern nach CAN mit CARB Normierung" VALUE 0xC075E Kw_Wu16 7.999878 Fact 0.00 7.999878 FORMAT "%8.6" /end CHARACTERISTIC
/begin CHARACTERISTIC Sig_Carb_lDIAOffset_C "Signals Offset für Umrechung  Fahrstrecke Intern nach Diagnoseschnittstelle mit CARB Normierung" VALUE 0xC0760 Kw_Ws16 65535.00 OneToOne -32768.00 32767.00 FORMAT "%8.2" /end CHARACTERISTIC
/begin CHARACTERISTIC Sig_Carb_lDIAScale_C "Signals Skalierungsfaktor für Umrechung  Fahrstrecke Intern nach Diagnoseschnittstelle mit CARB Normierung" VALUE 0xC0762 Kw_Wu16 7.999878 Fact 0.00 7.999878 FORMAT "%8.6" /end CHARACTERISTIC
/begin CHARACTERISTIC Sig_Carb_mAirTimDSMOffset_C "Offset fuer Umrechung SG->DSM fuer Luftmasse pro Zeit (OBD)" VALUE 0xC0764 Kw_Ws16 65535.00 OneToOne -32768.00 32767.00 FORMAT "%8.2" /end CHARACTERISTIC
/begin CHARACTERISTIC Sig_Carb_mAirTimDSMScale_C "Skalierung Umrechungs Faktor SG->DSM fuer Luftmasse pro Zeit (OBD)" VALUE 0xC0766 Kw_Wu16 7.999878 Fact 0.00 7.999878 FORMAT "%8.6" /end CHARACTERISTIC
/begin CHARACTERISTIC Sig_Carb_mAirTimCANOffset_C "Offset fuer Umrechung SG->CAN fuer Luftmasse pro Zeit (OBD)" VALUE 0xC0768 Kw_Ws16 65535.00 OneToOne -32768.00 32767.00 FORMAT "%8.2" /end CHARACTERISTIC
/begin CHARACTERISTIC Sig_Carb_mAirTimCANScale_C "Skalierung Umrechungs Faktor SG->CAN fuer Luftmasse pro Zeit (OBD)" VALUE 0xC076A Kw_Wu16 7.999878 Fact 0.00 7.999878 FORMAT "%8.6" /end CHARACTERISTIC
/begin CHARACTERISTIC Sig_Carb_mAirTimDIAOffset_C "Offset fuer Umrechung SG->DIA fuer Luftmasse pro Zeit (OBD)" VALUE 0xC076C Kw_Ws16 65535.00 OneToOne -32768.00 32767.00 FORMAT "%8.2" /end CHARACTERISTIC
/begin CHARACTERISTIC Sig_Carb_mAirTimDIAScale_C "Skalierung Umrechungs Faktor SG->DIA fuer Luftmasse pro Zeit (OBD)" VALUE 0xC076E Kw_Wu16 7.999878 Fact 0.00 7.999878 FORMAT "%8.6" /end CHARACTERISTIC
/begin CHARACTERISTIC Sig_Carb_nDSMOffset_C "Offset fuer Umrechung SG->DSM fuer Drehzahl (OBD)" VALUE 0xC0770 Kw_Ws16 65535.00 OneToOne -32768.00 32767.00 FORMAT "%8.2" /end CHARACTERISTIC
/begin CHARACTERISTIC Sig_Carb_nDSMScale_C "Skalierung Umrechungs Faktor SG->DSM fuer Drehzahl (OBD)" VALUE 0xC0772 Kw_Wu16 7.999878 Fact 0.00 7.999878 FORMAT "%8.6" /end CHARACTERISTIC
/begin CHARACTERISTIC Sig_Carb_nCANOffset_C "Offset fuer Umrechung SG->CAN fuer Drehzahl (OBD)" VALUE 0xC0774 Kw_Ws16 65535.00 OneToOne -32768.00 32767.00 FORMAT "%8.2" /end CHARACTERISTIC
/begin CHARACTERISTIC Sig_Carb_nCANScale_C "Skalierung Umrechungs Faktor SG->CAN fuer Drehzahl (OBD)" VALUE 0xC0776 Kw_Wu16 7.999878 Fact 0.00 7.999878 FORMAT "%8.6" /end CHARACTERISTIC
/begin CHARACTERISTIC Sig_Carb_nDIAOffset_C "Offset fuer Umrechung SG->DIA fuer Drehzahl (OBD)" VALUE 0xC0778 Kw_Ws16 65535.00 OneToOne -32768.00 32767.00 FORMAT "%8.2" /end CHARACTERISTIC
/begin CHARACTERISTIC Sig_Carb_nDIAScale_C "Skalierung Umrechungs Faktor SG->DIA fuer Drehzahl (OBD)" VALUE 0xC077A Kw_Wu16 7.999878 Fact 0.00 7.999878 FORMAT "%8.6" /end CHARACTERISTIC
/begin CHARACTERISTIC Sig_Carb_pDSMOffset_C "Offset fuer Umrechung SG->DSM fuer Druck (OBD)" VALUE 0xC077C Kw_Ws16 65535.00 OneToOne -32768.00 32767.00 FORMAT "%8.2" /end CHARACTERISTIC
/begin CHARACTERISTIC Sig_Carb_pDSMScale_C "Skalierung Umrechungs Faktor SG->DSM fuer Druck (OBD)" VALUE 0xC077E Kw_Wu16 7.999878 Fact 0.00 7.999878 FORMAT "%8.6" /end CHARACTERISTIC
/begin CHARACTERISTIC Sig_Carb_pCANOffset_C "Offset fuer Umrechung SG->CAN fuer Druck (OBD)" VALUE 0xC0780 Kw_Ws16 65535.00 OneToOne -32768.00 32767.00 FORMAT "%8.2" /end CHARACTERISTIC
/begin CHARACTERISTIC Sig_Carb_pCANScale_C "Skalierung Umrechungs Faktor SG->CAN fuer Druck (OBD)" VALUE 0xC0782 Kw_Wu16 7.999878 Fact 0.00 7.999878 FORMAT "%8.6" /end CHARACTERISTIC
/begin CHARACTERISTIC Sig_Carb_pDIAOffset_C "Offset fuer Umrechung SG->DIA fuer Druck (OBD)" VALUE 0xC0784 Kw_Ws16 65535.00 OneToOne -32768.00 32767.00 FORMAT "%8.2" /end CHARACTERISTIC
/begin CHARACTERISTIC Sig_Carb_pDIAScale_C "Skalierung Umrechungs Faktor SG->DIA fuer Druck (OBD)" VALUE 0xC0786 Kw_Wu16 7.999878 Fact 0.00 7.999878 FORMAT "%8.6" /end CHARACTERISTIC
/begin CHARACTERISTIC Sig_Carb_rDSMOffset_C "Offset fuer Umrechung SG->DSM fuer Verhältnis (OBD)" VALUE 0xC0788 Kw_Ws16 65535.00 OneToOne -32768.00 32767.00 FORMAT "%8.2" /end CHARACTERISTIC
/begin CHARACTERISTIC Sig_Carb_rDSMScale_C "Skalierung Umrechungs Faktor SG->DSM fuer Verhältnis (OBD)" VALUE 0xC078A Kw_Wu16 7.999878 Fact 0.00 7.999878 FORMAT "%8.6" /end CHARACTERISTIC
/begin CHARACTERISTIC Sig_Carb_rCANOffset_C "Offset fuer Umrechung SG->CAN fuer Verhältnis (OBD)" VALUE 0xC078C Kw_Ws16 65535.00 OneToOne -32768.00 32767.00 FORMAT "%8.2" /end CHARACTERISTIC
/begin CHARACTERISTIC Sig_Carb_rCANScale_C "Skalierung Umrechungs Faktor SG->CAN fuer Verhältnis (OBD)" VALUE 0xC078E Kw_Wu16 7.999878 Fact 0.00 7.999878 FORMAT "%8.6" /end CHARACTERISTIC
/begin CHARACTERISTIC Sig_Carb_rDIAOffset_C "Offset fuer Umrechung SG->DIA fuer Verhältnis (OBD)" VALUE 0xC0790 Kw_Ws16 65535.00 OneToOne -32768.00 32767.00 FORMAT "%8.2" /end CHARACTERISTIC
/begin CHARACTERISTIC Sig_Carb_rDIAScale_C "Skalierung Umrechungs Faktor SG->DIA fuer Verhältnis (OBD)" VALUE 0xC0792 Kw_Wu16 7.999878 Fact 0.00 7.999878 FORMAT "%8.6" /end CHARACTERISTIC
/begin CHARACTERISTIC Sig_Carb_tiDSMOffset_C "Offset fuer Umrechung SG->DSM fuer Zeit (OBD)" VALUE 0xC0794 Kw_Ws16 65535.00 OneToOne -32768.00 32767.00 FORMAT "%8.2" /end CHARACTERISTIC
/begin CHARACTERISTIC Sig_Carb_tiDSMScale_C "Skalierung Umrechungs Faktor SG->DSM fuer Zeit (OBD)" VALUE 0xC0796 Kw_Wu16 7.999878 Fact 0.00 7.999878 FORMAT "%8.6" /end CHARACTERISTIC
/begin CHARACTERISTIC Sig_Carb_tiCANOffset_C "Offset fuer Umrechung SG->CAN fuer Zeit (OBD)" VALUE 0xC0798 Kw_Ws16 65535.00 OneToOne -32768.00 32767.00 FORMAT "%8.2" /end CHARACTERISTIC
/begin CHARACTERISTIC Sig_Carb_tiCANScale_C "Skalierung Umrechungs Faktor SG->CAN fuer Zeit (OBD)" VALUE 0xC079A Kw_Wu16 7.999878 Fact 0.00 7.999878 FORMAT "%8.6" /end CHARACTERISTIC
/begin CHARACTERISTIC Sig_Carb_tiDIAOffset_C "Offset fuer Umrechung SG->DIA fuer Zeit (OBD)" VALUE 0xC079C Kw_Ws16 65535.00 OneToOne -32768.00 32767.00 FORMAT "%8.2" /end CHARACTERISTIC
/begin CHARACTERISTIC Sig_Carb_tiDIAScale_C "Skalierung Umrechungs Faktor SG->DIA fuer Zeit (OBD)" VALUE 0xC079E Kw_Wu16 7.999878 Fact 0.00 7.999878 FORMAT "%8.6" /end CHARACTERISTIC
/begin CHARACTERISTIC Sig_Carb_tDSMOffset_C "Offset fuer Umrechung SG->DSM fuer Temperatur (OBD)" VALUE 0xC07A0 Kw_Ws16 65535.00 OneToOne -32768.00 32767.00 FORMAT "%8.2" /end CHARACTERISTIC
/begin CHARACTERISTIC Sig_Carb_tDSMScale_C "Skalierung Umrechungs Faktor SG->DSM fuer Temperatur (OBD)" VALUE 0xC07A2 Kw_Wu16 7.999878 Fact 0.00 7.999878 FORMAT "%8.6" /end CHARACTERISTIC
/begin CHARACTERISTIC Sig_Carb_tCANOffset_C "Offset fuer Umrechung SG->CAN fuer Temperatur (OBD)" VALUE 0xC07A4 Kw_Ws16 65535.00 OneToOne -32768.00 32767.00 FORMAT "%8.2" /end CHARACTERISTIC
/begin CHARACTERISTIC Sig_Carb_tCANScale_C "Skalierung Umrechungs Faktor SG->CAN fuer Temperatur (OBD)" VALUE 0xC07A6 Kw_Wu16 7.999878 Fact 0.00 7.999878 FORMAT "%8.6" /end CHARACTERISTIC
/begin CHARACTERISTIC Sig_Carb_tDIAOffset_C "Offset fuer Umrechung SG->DIA fuer Temperatur (OBD)" VALUE 0xC07A8 Kw_Ws16 65535.00 OneToOne -32768.00 32767.00 FORMAT "%8.2" /end CHARACTERISTIC
/begin CHARACTERISTIC Sig_Carb_tDIAScale_C "Skalierung Umrechungs Faktor SG->DIA fuer Temperatur (OBD)" VALUE 0xC07AA Kw_Wu16 7.999878 Fact 0.00 7.999878 FORMAT "%8.6" /end CHARACTERISTIC
/begin CHARACTERISTIC Sig_Carb_vDSMOffset_C "Offset fuer Umrechung SG->DSM fuer Geschwindigkeit (OBD)" VALUE 0xC07AC Kw_Ws16 65535.00 OneToOne -32768.00 32767.00 FORMAT "%8.2" /end CHARACTERISTIC
/begin CHARACTERISTIC Sig_Carb_vDSMScale_C "Skalierung Umrechungs Faktor SG->DSM fuer Geschwindigkeit (OBD)" VALUE 0xC07AE Kw_Wu16 7.999878 Fact 0.00 7.999878 FORMAT "%8.6" /end CHARACTERISTIC
/begin CHARACTERISTIC Sig_Carb_vCANOffset_C "Offset fuer Umrechung SG->CAN fuer Geschwindigkeit (OBD)" VALUE 0xC07B0 Kw_Ws16 65535.00 OneToOne -32768.00 32767.00 FORMAT "%8.2" /end CHARACTERISTIC
/begin CHARACTERISTIC Sig_Carb_vCANScale_C "Skalierung Umrechungs Faktor SG->CAN fuer Geschwindigkeit (OBD)" VALUE 0xC07B2 Kw_Wu16 7.999878 Fact 0.00 7.999878 FORMAT "%8.6" /end CHARACTERISTIC
/begin CHARACTERISTIC Sig_Carb_vDIAOffset_C "Offset fuer Umrechung SG->DIA fuer Geschwindigkeit (OBD)" VALUE 0xC07B4 Kw_Ws16 65535.00 OneToOne -32768.00 32767.00 FORMAT "%8.2" /end CHARACTERISTIC
/begin CHARACTERISTIC Sig_Carb_vDIAScale_C "Skalierung Umrechungs Faktor SG->DIA fuer Geschwindigkeit (OBD)" VALUE 0xC07B6 Kw_Wu16 7.999878 Fact 0.00 7.999878 FORMAT "%8.6" /end CHARACTERISTIC
/begin CHARACTERISTIC Sig_dcycDSMOffset_C "Offset Umrechung SG->DSM für Tastverhältnisse" VALUE 0xC07B8 Kw_Ws16 65535.00 OneToOne -32768.00 32767.00 FORMAT "%8.2" /end CHARACTERISTIC
/begin CHARACTERISTIC Sig_dcycDSMScale_C "Skalierung Umrechung SG->DSM für Tastverhältnisse" VALUE 0xC07BA Kw_Wu16 7.999878 Fact 0.00 7.999878 FORMAT "%8.6" /end CHARACTERISTIC
/begin CHARACTERISTIC Sig_dcycCANOffset_C "Offset Umrechung SG->CAN für Tastverhältnisse" VALUE 0xC07BC Kw_Ws16 65535.00 OneToOne -32768.00 32767.00 FORMAT "%8.2" /end CHARACTERISTIC
/begin CHARACTERISTIC Sig_dcycCANScale_C "Skalierung Umrechung SG->CAN für Tastverhältnisse" VALUE 0xC07BE Kw_Wu16 7.999878 Fact 0.00 7.999878 FORMAT "%8.6" /end CHARACTERISTIC
/begin CHARACTERISTIC Sig_dcycDIAOffset_C "Offset Umrechung SG->Diagnoseschnittstelle für Tastverhältnisse" VALUE 0xC07C0 Kw_Ws16 65535.00 OneToOne -32768.00 32767.00 FORMAT "%8.2" /end CHARACTERISTIC
/begin CHARACTERISTIC Sig_dcycDIAScale_C "Skalierung Umrechung SG->Diagnoseschnittstelle für Tastverhältnisse" VALUE 0xC07C2 Kw_Wu16 7.999878 Fact 0.00 7.999878 FORMAT "%8.6" /end CHARACTERISTIC
/begin CHARACTERISTIC Sig_Deffuwb100DSMOffset_C "offset for conversion ecu -> dsm for k3-Conversion: Def_f_uw_b100" VALUE 0xC07C4 Kw_Ws16 65535.00 OneToOne -32768.00 32767.00 FORMAT "%8.2" /end CHARACTERISTIC
/begin CHARACTERISTIC Sig_Deffuwb100DSMScale_C "scale factor for conversion ecu -> dsm for k3-Conversion: Def_f_uw_b100" VALUE 0xC07C6 Kw_Wu16 7.999878 Fact 0.00 7.999878 FORMAT "%8.6" /end CHARACTERISTIC
/begin CHARACTERISTIC Sig_Deffuwb100CANOffset_C "offset for conversion ecu -> can for k3-Conversion: Def_f_uw_b100" VALUE 0xC07C8 Kw_Ws16 65535.00 OneToOne -32768.00 32767.00 FORMAT "%8.2" /end CHARACTERISTIC
/begin CHARACTERISTIC Sig_Deffuwb100CANScale_C "scale factor for conversion ecu -> can for k3-Conversion: Def_f_uw_b100" VALUE 0xC07CA Kw_Wu16 7.999878 Fact 0.00 7.999878 FORMAT "%8.6" /end CHARACTERISTIC
/begin CHARACTERISTIC Sig_Deffuwb100DIAOffset_C "offset for conversion ecu -> dia for k3-Conversion: Def_f_uw_b100" VALUE 0xC07CC Kw_Ws16 65535.00 OneToOne -32768.00 32767.00 FORMAT "%8.2" /end CHARACTERISTIC
/begin CHARACTERISTIC Sig_Deffuwb100DIAScale_C "scale factor for conversion ecu -> dia for k3-Conversion: Def_f_uw_b100" VALUE 0xC07CE Kw_Wu16 7.999878 Fact 0.00 7.999878 FORMAT "%8.6" /end CHARACTERISTIC
/begin CHARACTERISTIC Sig_DezUbQ1DSMOffset_C "offset for conversion ecu -> dsm for k3-Conversion: Def_dez_ub_q1" VALUE 0xC07D0 Kw_Ws16 65535.00 OneToOne -32768.00 32767.00 FORMAT "%8.2" /end CHARACTERISTIC
/begin CHARACTERISTIC Sig_DezUbQ1DSMScale_C "scale factor for conversion ecu -> dsm for k3-Conversion: Def_dez_ub_q1" VALUE 0xC07D2 Kw_Wu16 7.999878 Fact 0.00 7.999878 FORMAT "%8.6" /end CHARACTERISTIC
/begin CHARACTERISTIC Sig_DezUbQ1CANOffset_C "offset for conversion ecu -> can for k3-Conversion: Def_dez_ub_q1" VALUE 0xC07D4 Kw_Ws16 65535.00 OneToOne -32768.00 32767.00 FORMAT "%8.2" /end CHARACTERISTIC
/begin CHARACTERISTIC Sig_DezUbQ1CANScale_C "scale factor for conversion ecu -> can for k3-Conversion: Def_dez_ub_q1" VALUE 0xC07D6 Kw_Wu16 7.999878 Fact 0.00 7.999878 FORMAT "%8.6" /end CHARACTERISTIC
/begin CHARACTERISTIC Sig_DezUbQ1DIAOffset_C "offset for conversion ecu -> dia for k3-Conversion: Def_dez_ub_q1" VALUE 0xC07D8 Kw_Ws16 65535.00 OneToOne -32768.00 32767.00 FORMAT "%8.2" /end CHARACTERISTIC
/begin CHARACTERISTIC Sig_DezUbQ1DIAScale_C "scale factor for conversion ecu -> dia for k3-Conversion: Def_dez_ub_q1" VALUE 0xC07DA Kw_Wu16 7.999878 Fact 0.00 7.999878 FORMAT "%8.6" /end CHARACTERISTIC
/begin CHARACTERISTIC Sig_DezUwQ1DSMOffset_C "offset for conversion ecu -> dsm for k3-Conversion: Def_dez_uw_q1" VALUE 0xC07DC Kw_Ws16 65535.00 OneToOne -32768.00 32767.00 FORMAT "%8.2" /end CHARACTERISTIC
/begin CHARACTERISTIC Sig_DezUwQ1DSMScale_C "scale factor for conversion ecu -> dsm for k3-Conversion: Def_dez_uw_q1" VALUE 0xC07DE Kw_Wu16 7.999878 Fact 0.00 7.999878 FORMAT "%8.6" /end CHARACTERISTIC
/begin CHARACTERISTIC Sig_DezUwQ1CANOffset_C "offset for conversion ecu -> can for k3-Conversion: Def_dez_uw_q1" VALUE 0xC07E0 Kw_Ws16 65535.00 OneToOne -32768.00 32767.00 FORMAT "%8.2" /end CHARACTERISTIC
/begin CHARACTERISTIC Sig_DezUwQ1CANScale_C "scale factor for conversion ecu -> can for k3-Conversion: Def_dez_uw_q1" VALUE 0xC07E2 Kw_Wu16 7.999878 Fact 0.00 7.999878 FORMAT "%8.6" /end CHARACTERISTIC
/begin CHARACTERISTIC Sig_DezUwQ1DIAOffset_C "offset for conversion ecu -> dia for k3-Conversion: Def_dez_uw_q1" VALUE 0xC07E4 Kw_Ws16 65535.00 OneToOne -32768.00 32767.00 FORMAT "%8.2" /end CHARACTERISTIC
/begin CHARACTERISTIC Sig_DezUwQ1DIAScale_C "scale factor for conversion ecu -> dia for k3-Conversion: Def_dez_uw_q1" VALUE 0xC07E6 Kw_Wu16 7.999878 Fact 0.00 7.999878 FORMAT "%8.6" /end CHARACTERISTIC
/begin CHARACTERISTIC Sig_dtDSMOffset_C "offset for conversion ecu -> dsm for temperature conversion: TempDiff_Cels" VALUE 0xC07E8 Kw_Ws16 65535.00 OneToOne -32768.00 32767.00 FORMAT "%8.2" /end CHARACTERISTIC
/begin CHARACTERISTIC Sig_dtDSMScale_C "scale factor for conversion ecu -> dsm for temperature conversion: TempDiff_Cels" VALUE 0xC07EA Kw_Wu16 7.999878 Fact 0.00 7.999878 FORMAT "%8.6" /end CHARACTERISTIC
/begin CHARACTERISTIC Sig_dtCANOffset_C "offset for conversion ecu -> can for temperature conversion: TempDiff_Cels" VALUE 0xC07EC Kw_Ws16 65535.00 OneToOne -32768.00 32767.00 FORMAT "%8.2" /end CHARACTERISTIC
/begin CHARACTERISTIC Sig_dtCANScale_C "scale factor for conversion ecu -> can for temperature conversion: TempDiff_Cels" VALUE 0xC07EE Kw_Wu16 7.999878 Fact 0.00 7.999878 FORMAT "%8.6" /end CHARACTERISTIC
/begin CHARACTERISTIC Sig_dtDIAOffset_C "offset for conversion ecu -> dia for temperature conversion: TempDiff_Cels" VALUE 0xC07F0 Kw_Ws16 65535.00 OneToOne -32768.00 32767.00 FORMAT "%8.2" /end CHARACTERISTIC
/begin CHARACTERISTIC Sig_dtDIAScale_C "scale factor for conversion ecu -> dia for temperature conversion: TempDiff_Cels" VALUE 0xC07F2 Kw_Wu16 7.999878 Fact 0.00 7.999878 FORMAT "%8.6" /end CHARACTERISTIC
/begin CHARACTERISTIC Sig_DxsDSMOffset_C "offset for conversion ecu -> dsm for conversion Dxs" VALUE 0xC07F4 Kw_Ws16 65535.00 OneToOne -32768.00 32767.00 FORMAT "%8.2" /end CHARACTERISTIC
/begin CHARACTERISTIC Sig_DxsDSMScale_C "scale factor for conversion ecu -> dsm for conversion Dxs" VALUE 0xC07F6 Kw_Wu16 7.999878 Fact 0.00 7.999878 FORMAT "%8.6" /end CHARACTERISTIC
/begin CHARACTERISTIC Sig_DxsCANOffset_C "offset for conversion ecu -> can for conversion Dxs" VALUE 0xC07F8 Kw_Ws16 65535.00 OneToOne -32768.00 32767.00 FORMAT "%8.2" /end CHARACTERISTIC
/begin CHARACTERISTIC Sig_DxsCANScale_C "scale factor for conversion ecu -> can for conversion Dxs" VALUE 0xC07FA Kw_Wu16 7.999878 Fact 0.00 7.999878 FORMAT "%8.6" /end CHARACTERISTIC
/begin CHARACTERISTIC Sig_DxsDIAOffset_C "offset for conversion ecu -> dia for conversion Dxs" VALUE 0xC07FC Kw_Ws16 65535.00 OneToOne -32768.00 32767.00 FORMAT "%8.2" /end CHARACTERISTIC
/begin CHARACTERISTIC Sig_DxsDIAScale_C "scale factor for conversion ecu -> dia for conversion Dxs" VALUE 0xC07FE Kw_Wu16 7.999878 Fact 0.00 7.999878 FORMAT "%8.6" /end CHARACTERISTIC
/begin CHARACTERISTIC Sig_EnergyDSMOffset_C "offset for conversion ecu -> dsm for conversion Energy" VALUE 0xC0800 Kw_Ws16 65535.00 OneToOne -32768.00 32767.00 FORMAT "%8.2" /end CHARACTERISTIC
/begin CHARACTERISTIC Sig_EnergyDSMScale_C "scale factor for conversion ecu -> can for conversion Energy" VALUE 0xC0802 Kw_Wu16 7.999878 Fact 0.00 7.999878 FORMAT "%8.6" /end CHARACTERISTIC
/begin CHARACTERISTIC Sig_EnergyCANOffset_C "offset for conversion ecu -> can for conversion Energy" VALUE 0xC0804 Kw_Ws16 65535.00 OneToOne -32768.00 32767.00 FORMAT "%8.2" /end CHARACTERISTIC
/begin CHARACTERISTIC Sig_EnergyCANScale_C "scale factor for conversion ecu -> can for conversion Energy" VALUE 0xC0806 Kw_Wu16 7.999878 Fact 0.00 7.999878 FORMAT "%8.6" /end CHARACTERISTIC
/begin CHARACTERISTIC Sig_EnergyDIAOffset_C "offset for conversion ecu -> dia for conversion Energy" VALUE 0xC0808 Kw_Ws16 65535.00 OneToOne -32768.00 32767.00 FORMAT "%8.2" /end CHARACTERISTIC
/begin CHARACTERISTIC Sig_EnergyDIAScale_C "scale factor for conversion ecu -> dia for conversion Energy" VALUE 0xC080A Kw_Wu16 7.999878 Fact 0.00 7.999878 FORMAT "%8.6" /end CHARACTERISTIC
/begin CHARACTERISTIC Sig_factDSMOffset_C "Offset Umrechnungsfaktor SG -> DSM fuer Faktoren" VALUE 0xC080C Kw_Ws16 65535.00 OneToOne -32768.00 32767.00 FORMAT "%8.2" /end CHARACTERISTIC
/begin CHARACTERISTIC Sig_factDSMScale_C "Skalierung Umrechnungsfaktor SG -> DSM fuer Faktoren" VALUE 0xC080E Kw_Wu16 7.999878 Fact 0.00 7.999878 FORMAT "%8.6" /end CHARACTERISTIC
/begin CHARACTERISTIC Sig_factCANOffset_C "Offset fuer Umrechnung SG -> CAN für Faktoren" VALUE 0xC0810 Kw_Ws16 65535.00 OneToOne -32768.00 32767.00 FORMAT "%8.2" /end CHARACTERISTIC
/begin CHARACTERISTIC Sig_factCANScale_C "Skalierung Umrechnungsfaktor SG -> CAN fuer Faktoren" VALUE 0xC0812 Kw_Wu16 7.999878 Fact 0.00 7.999878 FORMAT "%8.6" /end CHARACTERISTIC
/begin CHARACTERISTIC Sig_factDIAOffset_C "Offset Umrechnungsfaktor SG -> DIA für Faktoren" VALUE 0xC0814 Kw_Ws16 65535.00 OneToOne -32768.00 32767.00 FORMAT "%8.2" /end CHARACTERISTIC
/begin CHARACTERISTIC Sig_factDIAScale_C "Skalierung Umrechnungsfaktor SG -> DIA fuer Faktoren" VALUE 0xC0816 Kw_Wu16 7.999878 Fact 0.00 7.999878 FORMAT "%8.6" /end CHARACTERISTIC
/begin CHARACTERISTIC Sig_fas1DSMOffset_C "Offset fuer Umrechung SG->DSM fuer ein frei applizierbares Signal" VALUE 0xC0818 Kw_Ws16 65535.00 OneToOne -32768.00 32767.00 FORMAT "%8.2" /end CHARACTERISTIC
/begin CHARACTERISTIC Sig_fas1DSMScale_C "Skalierung Umrechungs Faktor SG->DSM fuer ein frei applizierbares Signal" VALUE 0xC081A Kw_Wu16 7.999878 Fact 0.00 7.999878 FORMAT "%8.6" /end CHARACTERISTIC
/begin CHARACTERISTIC Sig_fas1CANOffset_C "Offset fuer Umrechung SG->CAN fuer ein frei applizierbares Signal" VALUE 0xC081C Kw_Ws16 65535.00 OneToOne -32768.00 32767.00 FORMAT "%8.2" /end CHARACTERISTIC
/begin CHARACTERISTIC Sig_fas1CANScale_C "Skalierung Umrechungs Faktor SG->CAN fuer ein frei applizierbares Signal" VALUE 0xC081E Kw_Wu16 7.999878 Fact 0.00 7.999878 FORMAT "%8.6" /end CHARACTERISTIC
/begin CHARACTERISTIC Sig_fas1DIAOffset_C "Offset fuer Umrechung SG->DIA fuer ein frei applizierbares Signal" VALUE 0xC0820 Kw_Ws16 65535.00 OneToOne -32768.00 32767.00 FORMAT "%8.2" /end CHARACTERISTIC
/begin CHARACTERISTIC Sig_fas1DIAScale_C "Skalierung Umrechungs Faktor SG->DIA fuer ein frei applizierbares Signal" VALUE 0xC0822 Kw_Wu16 7.999878 Fact 0.00 7.999878 FORMAT "%8.6" /end CHARACTERISTIC
/begin CHARACTERISTIC Sig_fas2DSMOffset_C "Offset fuer Umrechung SG->DSM fuer ein frei applizierbares Signal" VALUE 0xC0824 Kw_Ws16 65535.00 OneToOne -32768.00 32767.00 FORMAT "%8.2" /end CHARACTERISTIC
/begin CHARACTERISTIC Sig_fas2DSMScale_C "Skalierung Umrechungs Faktor SG->DSM fuer ein frei applizierbares Signal" VALUE 0xC0826 Kw_Wu16 7.999878 Fact 0.00 7.999878 FORMAT "%8.6" /end CHARACTERISTIC
/begin CHARACTERISTIC Sig_fas2CANOffset_C "Offset fuer Umrechung SG->CAN fuer ein frei applizierbares Signal" VALUE 0xC0828 Kw_Ws16 65535.00 OneToOne -32768.00 32767.00 FORMAT "%8.2" /end CHARACTERISTIC
/begin CHARACTERISTIC Sig_fas2CANScale_C "Skalierung Umrechungs Faktor SG->CAN fuer ein frei applizierbares Signal" VALUE 0xC082A Kw_Wu16 7.999878 Fact 0.00 7.999878 FORMAT "%8.6" /end CHARACTERISTIC
/begin CHARACTERISTIC Sig_fas2DIAOffset_C "Offset fuer Umrechung SG->DIA fuer ein frei applizierbares Signal" VALUE 0xC082C Kw_Ws16 65535.00 OneToOne -32768.00 32767.00 FORMAT "%8.2" /end CHARACTERISTIC
/begin CHARACTERISTIC Sig_fas2DIAScale_C "Skalierung Umrechungs Faktor SG->DIA fuer ein frei applizierbares Signal" VALUE 0xC082E Kw_Wu16 7.999878 Fact 0.00 7.999878 FORMAT "%8.6" /end CHARACTERISTIC
/begin CHARACTERISTIC Sig_fas3DSMOffset_C "Offset fuer Umrechung SG->DSM fuer ein frei applizierbares Signal" VALUE 0xC0830 Kw_Ws16 65535.00 OneToOne -32768.00 32767.00 FORMAT "%8.2" /end CHARACTERISTIC
/begin CHARACTERISTIC Sig_fas3DSMScale_C "Skalierung Umrechungs Faktor SG->DSM fuer ein frei applizierbares Signal" VALUE 0xC0832 Kw_Wu16 7.999878 Fact 0.00 7.999878 FORMAT "%8.6" /end CHARACTERISTIC
/begin CHARACTERISTIC Sig_fas3CANOffset_C "Offset fuer Umrechung SG->CAN fuer ein frei applizierbares Signal" VALUE 0xC0834 Kw_Ws16 65535.00 OneToOne -32768.00 32767.00 FORMAT "%8.2" /end CHARACTERISTIC
/begin CHARACTERISTIC Sig_fas3CANScale_C "Skalierung Umrechungs Faktor SG->CAN fuer ein frei applizierbares Signal" VALUE 0xC0836 Kw_Wu16 7.999878 Fact 0.00 7.999878 FORMAT "%8.6" /end CHARACTERISTIC
/begin CHARACTERISTIC Sig_fas3DIAOffset_C "Offset fuer Umrechung SG->DIA fuer ein frei applizierbares Signal" VALUE 0xC0838 Kw_Ws16 65535.00 OneToOne -32768.00 32767.00 FORMAT "%8.2" /end CHARACTERISTIC
/begin CHARACTERISTIC Sig_fas3DIAScale_C "Skalierung Umrechungs Faktor SG->DIA fuer ein frei applizierbares Signal" VALUE 0xC083A Kw_Wu16 7.999878 Fact 0.00 7.999878 FORMAT "%8.6" /end CHARACTERISTIC
/begin CHARACTERISTIC Sig_FlConPFltDSMOffset_C "Offset für Umrechnung SG->DSM für Kraftstoffverbrauch (Partikelfilter)" VALUE 0xC083C Kw_Ws16 65535.00 OneToOne -32768.00 32767.00 FORMAT "%8.2" /end CHARACTERISTIC
/begin CHARACTERISTIC Sig_FlConPFltDSMScale_C "Skalierung Umrechung SG->DSM für Kraftstoffverbrauch (Partikelfilter)" VALUE 0xC083E Kw_Wu16 7.999878 Fact 0.00 7.999878 FORMAT "%8.6" /end CHARACTERISTIC
/begin CHARACTERISTIC Sig_FlConPFltCANOffset_C "Offset für Umrechnung SG->CAN für Kraftstoffverbrauch (Partikelfilter)" VALUE 0xC0840 Kw_Ws16 65535.00 OneToOne -32768.00 32767.00 FORMAT "%8.2" /end CHARACTERISTIC
/begin CHARACTERISTIC Sig_FlConPFltCANScale_C "Skalierung Umrechung SG->CAN für Kraftstoffverbrauch (Partikelfilter)" VALUE 0xC0842 Kw_Wu16 7.999878 Fact 0.00 7.999878 FORMAT "%8.6" /end CHARACTERISTIC
/begin CHARACTERISTIC Sig_FlConPFltDIAOffset_C "Offset für Umrechnung SG->Diagnoseschnittstelle für Kraftstoffverbrauch (Partikelfilter)" VALUE 0xC0844 Kw_Ws16 65535.00 OneToOne -32768.00 32767.00 FORMAT "%8.2" /end CHARACTERISTIC
/begin CHARACTERISTIC Sig_FlConPFltDIAScale_C "Skalierung Umrechung SG->Diagnoseschnittstelle für Kraftstoffverbrauch (Partikelfilter)" VALUE 0xC0846 Kw_Wu16 7.999878 Fact 0.00 7.999878 FORMAT "%8.6" /end CHARACTERISTIC
/begin CHARACTERISTIC Sig_FlConDSMOffset_C "Offset für Umrechnung ecu -> dsm" VALUE 0xC0848 Kw_Ws16 65535.00 OneToOne -32768.00 32767.00 FORMAT "%8.2" /end CHARACTERISTIC
/begin CHARACTERISTIC Sig_FlConDSMScale_C "Skalierung für Umrechnung ecu -> dsm" VALUE 0xC084A Kw_Wu16 7.999878 Fact 0.00 7.999878 FORMAT "%8.6" /end CHARACTERISTIC
/begin CHARACTERISTIC Sig_FlConCANOffset_C "Offset für Umrechnung ecu -> can" VALUE 0xC084C Kw_Ws16 65535.00 OneToOne -32768.00 32767.00 FORMAT "%8.2" /end CHARACTERISTIC
/begin CHARACTERISTIC Sig_FlConCANScale_C "Skalierung für Umrechnung ecu -> can" VALUE 0xC084E Kw_Wu16 7.999878 Fact 0.00 7.999878 FORMAT "%8.6" /end CHARACTERISTIC
/begin CHARACTERISTIC Sig_FlConDIAOffset_C "Offset für Umrechnung ecu -> dia" VALUE 0xC0850 Kw_Ws16 65535.00 OneToOne -32768.00 32767.00 FORMAT "%8.2" /end CHARACTERISTIC
/begin CHARACTERISTIC Sig_FlConDIAScale_C "Skalierung für Umrechnung ecu -> dia" VALUE 0xC0852 Kw_Wu16 7.999878 Fact 0.00 7.999878 FORMAT "%8.6" /end CHARACTERISTIC
/begin CHARACTERISTIC Sig_FlUlQ0p122DSMOffset_C "offset for conversion ecu -> dsm for k3-Conversion: Def_fuel_ul_q0p000122" VALUE 0xC0854 Kw_Ws16 65535.00 OneToOne -32768.00 32767.00 FORMAT "%8.2" /end CHARACTERISTIC
/begin CHARACTERISTIC Sig_FlUlQ0p122DSMScale_C "scale factor for conversion ecu -> dsm for k3-Conversion: Def_fuel_ul_q0p000122" VALUE 0xC0856 Kw_Wu16 7.999878 Fact 0.00 7.999878 FORMAT "%8.6" /end CHARACTERISTIC
/begin CHARACTERISTIC Sig_FlUlQ0p122CANOffset_C "offset for conversion ecu -> can for k3-Conversion: Def_fuel_ul_q0p000122" VALUE 0xC0858 Kw_Ws16 65535.00 OneToOne -32768.00 32767.00 FORMAT "%8.2" /end CHARACTERISTIC
/begin CHARACTERISTIC Sig_FlUlQ0p122CANScale_C "scale factor for conversion ecu -> can for k3-Conversion: Def_fuel_ul_q0p000122" VALUE 0xC085A Kw_Wu16 7.999878 Fact 0.00 7.999878 FORMAT "%8.6" /end CHARACTERISTIC
/begin CHARACTERISTIC Sig_FlUlQ0p122DIAOffset_C "offset for conversion ecu -> dia for k3-Conversion: Def_fuel_ul_q0p000122" VALUE 0xC085C Kw_Ws16 65535.00 OneToOne -32768.00 32767.00 FORMAT "%8.2" /end CHARACTERISTIC
/begin CHARACTERISTIC Sig_FlUlQ0p122DIAScale_C "scale factor for conversion ecu -> dia for k3-Conversion: Def_fuel_ul_q0p000122" VALUE 0xC085E Kw_Wu16 7.999878 Fact 0.00 7.999878 FORMAT "%8.6" /end CHARACTERISTIC
/begin CHARACTERISTIC Sig_FSwB100DSMOffset_C "offset for conversion ecu -> dsm for k3-Conversion: Def_f_sw_b100" VALUE 0xC0860 Kw_Ws16 65535.00 OneToOne -32768.00 32767.00 FORMAT "%8.2" /end CHARACTERISTIC
/begin CHARACTERISTIC Sig_FSwB100DSMScale_C "scale factor for conversion ecu -> dsm for k3-Conversion: Def_f_sw_b100" VALUE 0xC0862 Kw_Wu16 7.999878 Fact 0.00 7.999878 FORMAT "%8.6" /end CHARACTERISTIC
/begin CHARACTERISTIC Sig_FSwB100CANOffset_C "offset for conversion ecu -> can for k3-Conversion: Def_f_sw_b100" VALUE 0xC0864 Kw_Ws16 65535.00 OneToOne -32768.00 32767.00 FORMAT "%8.2" /end CHARACTERISTIC
/begin CHARACTERISTIC Sig_FSwB100CANScale_C "scale factor for conversion ecu -> can for k3-Conversion: Def_f_sw_b100" VALUE 0xC0866 Kw_Wu16 7.999878 Fact 0.00 7.999878 FORMAT "%8.6" /end CHARACTERISTIC
/begin CHARACTERISTIC Sig_FSwB100DIAOffset_C "offset for conversion ecu -> dia for k3-Conversion: Def_f_sw_b100" VALUE 0xC0868 Kw_Ws16 65535.00 OneToOne -32768.00 32767.00 FORMAT "%8.2" /end CHARACTERISTIC
/begin CHARACTERISTIC Sig_FSwB100DIAScale_C "scale factor for conversion ecu -> dia for k3-Conversion: Def_f_sw_b100" VALUE 0xC086A Kw_Wu16 7.999878 Fact 0.00 7.999878 FORMAT "%8.6" /end CHARACTERISTIC
/begin CHARACTERISTIC Sig_FSwQ0p00153DSMOffset_C "offset for conversion ecu -> dsm for k3-Conversion: Def_f_sw_q0p00153" VALUE 0xC086C Kw_Ws16 65535.00 OneToOne -32768.00 32767.00 FORMAT "%8.2" /end CHARACTERISTIC
/begin CHARACTERISTIC Sig_FSwQ0p00153DSMScale_C "scale factor for conversion ecu -> dsm for k3-Conversion: Def_f_sw_q0p00153" VALUE 0xC086E Kw_Wu16 7.999878 Fact 0.00 7.999878 FORMAT "%8.6" /end CHARACTERISTIC
/begin CHARACTERISTIC Sig_FSwQ0p00153CANOffset_C "offset for conversion ecu -> can for k3-Conversion: Def_f_sw_q0p00153" VALUE 0xC0870 Kw_Ws16 65535.00 OneToOne -32768.00 32767.00 FORMAT "%8.2" /end CHARACTERISTIC
/begin CHARACTERISTIC Sig_FSwQ0p00153CANScale_C "scale factor for conversion ecu -> can for k3-Conversion: Def_f_sw_q0p00153" VALUE 0xC0872 Kw_Wu16 7.999878 Fact 0.00 7.999878 FORMAT "%8.6" /end CHARACTERISTIC
/begin CHARACTERISTIC Sig_FSwQ0p00153DIAOffset_C "offset for conversion ecu -> dia for k3-Conversion: Def_f_sw_q0p00153" VALUE 0xC0874 Kw_Ws16 65535.00 OneToOne -32768.00 32767.00 FORMAT "%8.2" /end CHARACTERISTIC
/begin CHARACTERISTIC Sig_FSwQ0p00153DIAScale_C "scale factor for conversion ecu -> dia for k3-Conversion: Def_f_sw_q0p00153" VALUE 0xC0876 Kw_Wu16 7.999878 Fact 0.00 7.999878 FORMAT "%8.6" /end CHARACTERISTIC
/begin CHARACTERISTIC Sig_InjMassDSMOffset_C "offset for conversion ecu -> dsm" VALUE 0xC0878 Kw_Ws16 65535.00 OneToOne -32768.00 32767.00 FORMAT "%8.2" /end CHARACTERISTIC
/begin CHARACTERISTIC Sig_InjMassDSMScale_C "Scale for conversion ecu -> dsm" VALUE 0xC087A Kw_Wu16 7.999878 Fact 0.00 7.999878 FORMAT "%8.6" /end CHARACTERISTIC
/begin CHARACTERISTIC Sig_InjMassCANOffset_C "offset for conversion ecu -> can" VALUE 0xC087C Kw_Ws16 65535.00 OneToOne -32768.00 32767.00 FORMAT "%8.2" /end CHARACTERISTIC
/begin CHARACTERISTIC Sig_InjMassCANScale_C "Scale for conversion ecu -> can" VALUE 0xC087E Kw_Wu16 7.999878 Fact 0.00 7.999878 FORMAT "%8.6" /end CHARACTERISTIC
/begin CHARACTERISTIC Sig_InjMassDIAOffset_C "offset for conversion ecu -> dia" VALUE 0xC0880 Kw_Ws16 65535.00 OneToOne -32768.00 32767.00 FORMAT "%8.2" /end CHARACTERISTIC
/begin CHARACTERISTIC Sig_InjMassDIAScale_C "Scale for conversion ecu -> dia" VALUE 0xC0882 Kw_Wu16 7.999878 Fact 0.00 7.999878 FORMAT "%8.6" /end CHARACTERISTIC
/begin CHARACTERISTIC Sig_InjTimDSMOffset_C "Offset für Umrechnung -> dsm" VALUE 0xC0884 Kw_Ws16 65535.00 OneToOne -32768.00 32767.00 FORMAT "%8.2" /end CHARACTERISTIC
/begin CHARACTERISTIC Sig_InjTimDSMScale_C "Skalierung für Umrechnung ecu -> dsm" VALUE 0xC0886 Kw_Wu16 7.999878 Fact 0.00 7.999878 FORMAT "%8.6" /end CHARACTERISTIC
/begin CHARACTERISTIC Sig_InjTimCANOffset_C "Offset für Umrechnung ecu -> can" VALUE 0xC0888 Kw_Ws16 65535.00 OneToOne -32768.00 32767.00 FORMAT "%8.2" /end CHARACTERISTIC
/begin CHARACTERISTIC Sig_InjTimCANScale_C "Skalierung für Umrechnung ecu -> can" VALUE 0xC088A Kw_Wu16 7.999878 Fact 0.00 7.999878 FORMAT "%8.6" /end CHARACTERISTIC
/begin CHARACTERISTIC Sig_InjTimDIAOffset_C "Offset für Umrechnung ecu -> dia" VALUE 0xC088C Kw_Ws16 65535.00 OneToOne -32768.00 32767.00 FORMAT "%8.2" /end CHARACTERISTIC
/begin CHARACTERISTIC Sig_InjTimDIAScale_C "Skalierung für Umrechnung ecu -> dia" VALUE 0xC088E Kw_Wu16 7.999878 Fact 0.00 7.999878 FORMAT "%8.6" /end CHARACTERISTIC
/begin CHARACTERISTIC Sig_IUbQ1DSMOffset_C "offset for conversion ecu -> dsm for k3-Conversion: Def_i_ub_q1" VALUE 0xC0890 Kw_Ws16 65535.00 OneToOne -32768.00 32767.00 FORMAT "%8.2" /end CHARACTERISTIC
/begin CHARACTERISTIC Sig_IUbQ1DSMScale_C "scale factor for conversion ecu -> dsm for k3-Conversion: Def_i_ub_q1" VALUE 0xC0892 Kw_Wu16 7.999878 Fact 0.00 7.999878 FORMAT "%8.6" /end CHARACTERISTIC
/begin CHARACTERISTIC Sig_IUbQ1CANOffset_C "offset for conversion ecu -> can for k3-Conversion: Def_i_ub_q1" VALUE 0xC0894 Kw_Ws16 65535.00 OneToOne -32768.00 32767.00 FORMAT "%8.2" /end CHARACTERISTIC
/begin CHARACTERISTIC Sig_IUbQ1CANScale_C "scale factor for conversion ecu -> can for k3-Conversion: Def_i_ub_q1" VALUE 0xC0896 Kw_Wu16 7.999878 Fact 0.00 7.999878 FORMAT "%8.6" /end CHARACTERISTIC
/begin CHARACTERISTIC Sig_IUbQ1DIAOffset_C "offset for conversion ecu -> dia for k3-Conversion: Def_i_ub_q1" VALUE 0xC0898 Kw_Ws16 65535.00 OneToOne -32768.00 32767.00 FORMAT "%8.2" /end CHARACTERISTIC
/begin CHARACTERISTIC Sig_IUbQ1DIAScale_C "scale factor for conversion ecu -> dia for k3-Conversion: Def_i_ub_q1" VALUE 0xC089A Kw_Wu16 7.999878 Fact 0.00 7.999878 FORMAT "%8.6" /end CHARACTERISTIC
/begin CHARACTERISTIC Sig_IUwQ0p08O200DSMOffset_C "offset for conversion ecu -> dsm for k3-Conversion: Def_i_uw_q0p08_o200" VALUE 0xC089C Kw_Ws16 65535.00 OneToOne -32768.00 32767.00 FORMAT "%8.2" /end CHARACTERISTIC
/begin CHARACTERISTIC Sig_IUwQ0p08O200DSMScale_C "scale factor for conversion ecu -> dsm for k3-Conversion: Def_i_uw_q0p08_o200" VALUE 0xC089E Kw_Wu16 7.999878 Fact 0.00 7.999878 FORMAT "%8.6" /end CHARACTERISTIC
/begin CHARACTERISTIC Sig_IUwQ0p08O200CANOffset_C "offset for conversion ecu -> can for k3-Conversion: Def_i_uw_q0p08_o200" VALUE 0xC08A0 Kw_Ws16 65535.00 OneToOne -32768.00 32767.00 FORMAT "%8.2" /end CHARACTERISTIC
/begin CHARACTERISTIC Sig_IUwQ0p08O200CANScale_C "scale factor for conversion ecu -> can for k3-Conversion: Def_i_uw_q0p08_o200" VALUE 0xC08A2 Kw_Wu16 7.999878 Fact 0.00 7.999878 FORMAT "%8.6" /end CHARACTERISTIC
/begin CHARACTERISTIC Sig_IUwQ0p08O200DIAOffset_C "offset for conversion ecu -> dia for k3-Conversion: Def_i_uw_q0p08_o200" VALUE 0xC08A4 Kw_Ws16 65535.00 OneToOne -32768.00 32767.00 FORMAT "%8.2" /end CHARACTERISTIC
/begin CHARACTERISTIC Sig_IUwQ0p08O200DIAScale_C "scale factor for conversion ecu -> dia for k3-Conversion: Def_i_uw_q0p08_o200" VALUE 0xC08A6 Kw_Wu16 7.999878 Fact 0.00 7.999878 FORMAT "%8.6" /end CHARACTERISTIC
/begin CHARACTERISTIC Sig_KmSwQ10DSMOffset_C "offset for conversion ecu -> dsm for k3-Conversion: Def_km_sw_q10" VALUE 0xC08A8 Kw_Ws16 65535.00 OneToOne -32768.00 32767.00 FORMAT "%8.2" /end CHARACTERISTIC
/begin CHARACTERISTIC Sig_KmSwQ10DSMScale_C "scale factor for conversion ecu -> dsm for k3-Conversion: Def_km_sw_q10" VALUE 0xC08AA Kw_Wu16 7.999878 Fact 0.00 7.999878 FORMAT "%8.6" /end CHARACTERISTIC
/begin CHARACTERISTIC Sig_KmSwQ10CANOffset_C "offset for conversion ecu -> can for k3-Conversion: Def_km_sw_q10" VALUE 0xC08AC Kw_Ws16 65535.00 OneToOne -32768.00 32767.00 FORMAT "%8.2" /end CHARACTERISTIC
/begin CHARACTERISTIC Sig_KmSwQ10CANScale_C "scale factor for conversion ecu -> can for k3-Conversion: Def_km_sw_q10" VALUE 0xC08AE Kw_Wu16 7.999878 Fact 0.00 7.999878 FORMAT "%8.6" /end CHARACTERISTIC
/begin CHARACTERISTIC Sig_KmSwQ10DIAOffset_C "offset for conversion ecu -> dia for k3-Conversion: Def_km_sw_q10" VALUE 0xC08B0 Kw_Ws16 65535.00 OneToOne -32768.00 32767.00 FORMAT "%8.2" /end CHARACTERISTIC
/begin CHARACTERISTIC Sig_KmSwQ10DIAScale_C "scale factor for conversion ecu -> dia for k3-Conversion: Def_km_sw_q10" VALUE 0xC08B2 Kw_Wu16 7.999878 Fact 0.00 7.999878 FORMAT "%8.6" /end CHARACTERISTIC
/begin CHARACTERISTIC Sig_KmUwQ10DSMOffset_C "offset for conversion ecu -> dsm for k3-Conversion: Def_km_uw_q10" VALUE 0xC08B4 Kw_Ws16 65535.00 OneToOne -32768.00 32767.00 FORMAT "%8.2" /end CHARACTERISTIC
/begin CHARACTERISTIC Sig_KmUwQ10DSMScale_C "scale factor for conversion ecu -> dsm for k3-Conversion: Def_km_uw_q10" VALUE 0xC08B6 Kw_Wu16 7.999878 Fact 0.00 7.999878 FORMAT "%8.6" /end CHARACTERISTIC
/begin CHARACTERISTIC Sig_KmUwQ10CANOffset_C "offset for conversion ecu -> can for k3-Conversion: Def_km_uw_q10" VALUE 0xC08B8 Kw_Ws16 65535.00 OneToOne -32768.00 32767.00 FORMAT "%8.2" /end CHARACTERISTIC
/begin CHARACTERISTIC Sig_KmUwQ10CANScale_C "scale factor for conversion ecu -> can for k3-Conversion: Def_km_uw_q10" VALUE 0xC08BA Kw_Wu16 7.999878 Fact 0.00 7.999878 FORMAT "%8.6" /end CHARACTERISTIC
/begin CHARACTERISTIC Sig_KmUwQ10DIAOffset_C "offset for conversion ecu -> dia for k3-Conversion: Def_km_uw_q10" VALUE 0xC08BC Kw_Ws16 65535.00 OneToOne -32768.00 32767.00 FORMAT "%8.2" /end CHARACTERISTIC
/begin CHARACTERISTIC Sig_KmUwQ10DIAScale_C "scale factor for conversion ecu -> dia for k3-Conversion: Def_km_uw_q10" VALUE 0xC08BE Kw_Wu16 7.999878 Fact 0.00 7.999878 FORMAT "%8.6" /end CHARACTERISTIC
/begin CHARACTERISTIC Sig_LambdaDSMOffset_C "Offset Umrechnung SG -> DSM für Lambda Wert" VALUE 0xC08C0 Kw_Ws16 65535.00 OneToOne -32768.00 32767.00 FORMAT "%8.2" /end CHARACTERISTIC
/begin CHARACTERISTIC Sig_LambdaDSMScale_C "Skalierung Umrechnung SG -> DSM für Lambda Wert" VALUE 0xC08C2 Kw_Wu16 7.999878 Fact 0.00 7.999878 FORMAT "%8.6" /end CHARACTERISTIC
/begin CHARACTERISTIC Sig_LambdaCANOffset_C "Offset Umrechnung SG -> CAN für Lambda Wert" VALUE 0xC08C4 Kw_Ws16 65535.00 OneToOne -32768.00 32767.00 FORMAT "%8.2" /end CHARACTERISTIC
/begin CHARACTERISTIC Sig_LambdaCANScale_C "Skalierung Umrechnung SG -> CAN für Lambda Wert" VALUE 0xC08C6 Kw_Wu16 7.999878 Fact 0.00 7.999878 FORMAT "%8.6" /end CHARACTERISTIC
/begin CHARACTERISTIC Sig_LambdaDIAOffset_C "Offset Umrechnung SG -> DIA für Lambda Wert" VALUE 0xC08C8 Kw_Ws16 65535.00 OneToOne -32768.00 32767.00 FORMAT "%8.2" /end CHARACTERISTIC
/begin CHARACTERISTIC Sig_LambdaDIAScale_C "Skalierung Umrechnung SG -> DIA für Lambda Wert" VALUE 0xC08CA Kw_Wu16 7.999878 Fact 0.00 7.999878 FORMAT "%8.6" /end CHARACTERISTIC
/begin CHARACTERISTIC Sig_lenPFltDSMOffset_C "Offset für Umrechnung SG->DSM für km-Stand (Partikelfilter)" VALUE 0xC08CC Kw_Ws16 65535.00 OneToOne -32768.00 32767.00 FORMAT "%8.2" /end CHARACTERISTIC
/begin CHARACTERISTIC Sig_lenPFltDSMScale_C "Skalierung Umrechung SG->DSM für km-Stand (Partikelfilter)" VALUE 0xC08CE Kw_Wu16 7.999878 Fact 0.00 7.999878 FORMAT "%8.6" /end CHARACTERISTIC
/begin CHARACTERISTIC Sig_lenPFltCANOffset_C "Offset für Umrechnung SG->CAN für km-Stand (Partikelfilter)" VALUE 0xC08D0 Kw_Ws16 65535.00 OneToOne -32768.00 32767.00 FORMAT "%8.2" /end CHARACTERISTIC
/begin CHARACTERISTIC Sig_lenPFltCANScale_C "Skalierung Umrechung SG->CAN für km-Stand (Partikelfilter)" VALUE 0xC08D2 Kw_Wu16 7.999878 Fact 0.00 7.999878 FORMAT "%8.6" /end CHARACTERISTIC
/begin CHARACTERISTIC Sig_lenPFltDIAOffset_C "Offset für Umrechnung SG->Diagnoseschnittstelle für km-Stand (Partikelfilter)" VALUE 0xC08D4 Kw_Ws16 65535.00 OneToOne -32768.00 32767.00 FORMAT "%8.2" /end CHARACTERISTIC
/begin CHARACTERISTIC Sig_lenPFltDIAScale_C "Skalierung Umrechung SG->Diagnoseschnittstelle für km-Stand (Partikelfilter)" VALUE 0xC08D6 Kw_Wu16 7.999878 Fact 0.00 7.999878 FORMAT "%8.6" /end CHARACTERISTIC
/begin CHARACTERISTIC Sig_lenrgnu16PFltDSMOffset_C "Offset Umrechnumg SG->DSM" VALUE 0xC08D8 Kw_Ws16 65535.00 OneToOne -32768.00 32767.00 FORMAT "%8.2" /end CHARACTERISTIC
/begin CHARACTERISTIC Sig_lenrgnu16PFltDSMScale_C "Skalierung Umrechnung SG->DSM" VALUE 0xC08DA Kw_Wu16 7.999878 Fact 0.00 7.999878 FORMAT "%8.6" /end CHARACTERISTIC
/begin CHARACTERISTIC Sig_lenrgnu16PFltCANOffset_C "Offset Umrechnumg SG->CAN" VALUE 0xC08DC Kw_Ws16 65535.00 OneToOne -32768.00 32767.00 FORMAT "%8.2" /end CHARACTERISTIC
/begin CHARACTERISTIC Sig_lenrgnu16PFltCANScale_C "Skalierung Umrechnung SG->CAN" VALUE 0xC08DE Kw_Wu16 7.999878 Fact 0.00 7.999878 FORMAT "%8.6" /end CHARACTERISTIC
/begin CHARACTERISTIC Sig_lenrgnu16PFltDIAOffset_C "Offset Umrechnumg SG->DIA" VALUE 0xC08E0 Kw_Ws16 65535.00 OneToOne -32768.00 32767.00 FORMAT "%8.2" /end CHARACTERISTIC
/begin CHARACTERISTIC Sig_lenrgnu16PFltDIAScale_C "Skalierung Umrechnung SG->DIA" VALUE 0xC08E2 Kw_Wu16 7.999878 Fact 0.00 7.999878 FORMAT "%8.6" /end CHARACTERISTIC
/begin CHARACTERISTIC Sig_lenDSMOffset_C "Offset für Umrechnung ecu -> dsm" VALUE 0xC08E4 Kw_Ws16 65535.00 OneToOne -32768.00 32767.00 FORMAT "%8.2" /end CHARACTERISTIC
/begin CHARACTERISTIC Sig_lenDSMScale_C "Skalierung für Umrechnung -> dsm" VALUE 0xC08E6 Kw_Wu16 7.999878 Fact 0.00 7.999878 FORMAT "%8.6" /end CHARACTERISTIC
/begin CHARACTERISTIC Sig_lenCANOffset_C "Offset für Umrechnung ecu -> can" VALUE 0xC08E8 Kw_Ws16 65535.00 OneToOne -32768.00 32767.00 FORMAT "%8.2" /end CHARACTERISTIC
/begin CHARACTERISTIC Sig_lenCANScale_C "Skalierung für Umrechnung ecu -> can" VALUE 0xC08EA Kw_Wu16 7.999878 Fact 0.00 7.999878 FORMAT "%8.6" /end CHARACTERISTIC
/begin CHARACTERISTIC Sig_lenDIAOffset_C "Offset für Umrechnung ecu -> dia" VALUE 0xC08EC Kw_Ws16 65535.00 OneToOne -32768.00 32767.00 FORMAT "%8.2" /end CHARACTERISTIC
/begin CHARACTERISTIC Sig_lenDIAScale_C "Skalierung für Umrechnung ecu -> dia" VALUE 0xC08EE Kw_Wu16 7.999878 Fact 0.00 7.999878 FORMAT "%8.6" /end CHARACTERISTIC
/begin CHARACTERISTIC Sig_lDSMOffset_C "Offset Umrechnung SG -> DSM" VALUE 0xC08F0 Kw_Ws16 65535.00 OneToOne -32768.00 32767.00 FORMAT "%8.2" /end CHARACTERISTIC
/begin CHARACTERISTIC Sig_lDSMScale_C "Skalierung Umrechnung SG -> DSM" VALUE 0xC08F2 Kw_Wu16 7.999878 Fact 0.00 7.999878 FORMAT "%8.6" /end CHARACTERISTIC
/begin CHARACTERISTIC Sig_lCANOffset_C "Offset Umrechnung SG -> CAN" VALUE 0xC08F4 Kw_Ws16 65535.00 OneToOne -32768.00 32767.00 FORMAT "%8.2" /end CHARACTERISTIC
/begin CHARACTERISTIC Sig_lCANScale_C "Skalierung Umrechnung SG -> CAN" VALUE 0xC08F6 Kw_Wu16 7.999878 Fact 0.00 7.999878 FORMAT "%8.6" /end CHARACTERISTIC
/begin CHARACTERISTIC Sig_lDIAOffset_C "Offset Umrechnung SG -> DIA" VALUE 0xC08F8 Kw_Ws16 65535.00 OneToOne -32768.00 32767.00 FORMAT "%8.2" /end CHARACTERISTIC
/begin CHARACTERISTIC Sig_lDIAScale_C "Skalierung Umrechnung SG -> DIA" VALUE 0xC08FA Kw_Wu16 7.999878 Fact 0.00 7.999878 FORMAT "%8.6" /end CHARACTERISTIC
/begin CHARACTERISTIC Sig_mAirCylDSMOffset_C "Offset Umrechung SG->DSM für Luftmasse pro Zylinder" VALUE 0xC08FC Kw_Ws16 65535.00 OneToOne -32768.00 32767.00 FORMAT "%8.2" /end CHARACTERISTIC
/begin CHARACTERISTIC Sig_mAirCylDSMScale_C "Skalierung Umrechung SG->DSM für Luftmasse pro Zylinder" VALUE 0xC08FE Kw_Wu16 7.999878 Fact 0.00 7.999878 FORMAT "%8.6" /end CHARACTERISTIC
/begin CHARACTERISTIC Sig_mAirCylCANOffset_C "Offset Umrechung SG->CAN für Luftmasse pro Zylinder" VALUE 0xC0900 Kw_Ws16 65535.00 OneToOne -32768.00 32767.00 FORMAT "%8.2" /end CHARACTERISTIC
/begin CHARACTERISTIC Sig_mAirCylCANScale_C "Skalierung Umrechung SG->CAN für Luftmasse pro Zylinder" VALUE 0xC0902 Kw_Wu16 7.999878 Fact 0.00 7.999878 FORMAT "%8.6" /end CHARACTERISTIC
/begin CHARACTERISTIC Sig_mAirCylDIAOffset_C "Offset Umrechung SG->Diagnoseschnittstelle für Luftmasse pro Zylinder" VALUE 0xC0904 Kw_Ws16 65535.00 OneToOne -32768.00 32767.00 FORMAT "%8.2" /end CHARACTERISTIC
/begin CHARACTERISTIC Sig_mAirCylDIAScale_C "Skalierung Umrechung SG->Diagnoseschnittstelle für Luftmasse pro Zylinder" VALUE 0xC0906 Kw_Wu16 7.999878 Fact 0.00 7.999878 FORMAT "%8.6" /end CHARACTERISTIC
/begin CHARACTERISTIC Sig_mAirTimDSMOffset_C "Offset Umrechung SG->DSM für Luftmasse pro Zeiteinheit" VALUE 0xC0908 Kw_Ws16 65535.00 OneToOne -32768.00 32767.00 FORMAT "%8.2" /end CHARACTERISTIC
/begin CHARACTERISTIC Sig_mAirTimDSMScale_C "Skalierung Umrechung SG->DSM für Luftmasse pro Zeiteinheit" VALUE 0xC090A Kw_Wu16 7.999878 Fact 0.00 7.999878 FORMAT "%8.6" /end CHARACTERISTIC
/begin CHARACTERISTIC Sig_mAirTimCANOffset_C "Offset Umrechung SG->CAN für Luftmasse pro Zeiteinheit" VALUE 0xC090C Kw_Ws16 65535.00 OneToOne -32768.00 32767.00 FORMAT "%8.2" /end CHARACTERISTIC
/begin CHARACTERISTIC Sig_mAirTimCANScale_C "Skalierung Umrechung SG->CAN für Luftmasse pro Zeiteinheit" VALUE 0xC090E Kw_Wu16 7.999878 Fact 0.00 7.999878 FORMAT "%8.6" /end CHARACTERISTIC
/begin CHARACTERISTIC Sig_mAirTimDIAOffset_C "Offset Umrechung SG->Diagnoseschnittstelle für Luftmasse pro Zeiteinheit" VALUE 0xC0910 Kw_Ws16 65535.00 OneToOne -32768.00 32767.00 FORMAT "%8.2" /end CHARACTERISTIC
/begin CHARACTERISTIC Sig_mAirTimDIAScale_C "Skalierung Umrechung SG->Diagnoseschnittstelle für Luftmasse pro Zeiteinheit" VALUE 0xC0912 Kw_Wu16 7.999878 Fact 0.00 7.999878 FORMAT "%8.6" /end CHARACTERISTIC
/begin CHARACTERISTIC Sig_mSootTimDSMOffset_C "Offset Umrechnung SG -> DSM für Partikelmassenstrom" VALUE 0xC0914 Kw_Ws16 65535.00 OneToOne -32768.00 32767.00 FORMAT "%8.2" /end CHARACTERISTIC
/begin CHARACTERISTIC Sig_mSootTimDSMScale_C "Skalierung Umrechnung SG -> DSM für Partikelmassenstrom" VALUE 0xC0916 Kw_Wu16 7.999878 Fact 0.00 7.999878 FORMAT "%8.6" /end CHARACTERISTIC
/begin CHARACTERISTIC Sig_mSootTimCANOffset_C "Offset Umrechnung SG -> CAN für Partikelmassenstrom" VALUE 0xC0918 Kw_Ws16 65535.00 OneToOne -32768.00 32767.00 FORMAT "%8.2" /end CHARACTERISTIC
/begin CHARACTERISTIC Sig_mSootTimCANScale_C "Skalierung Umrechnung SG -> CAN für Partikelmassenstrom" VALUE 0xC091A Kw_Wu16 7.999878 Fact 0.00 7.999878 FORMAT "%8.6" /end CHARACTERISTIC
/begin CHARACTERISTIC Sig_mSootTimDIAOffset_C "Offset Umrechnung SG -> Diagnoseschnittstelle für Partikelmassenstrom" VALUE 0xC091C Kw_Ws16 65535.00 OneToOne -32768.00 32767.00 FORMAT "%8.2" /end CHARACTERISTIC
/begin CHARACTERISTIC Sig_mSootTimDIAScale_C "Skalierung Umrechnung SG -> Diagnoseschnittstelle für Partikelmassenstrom" VALUE 0xC091E Kw_Wu16 7.999878 Fact 0.00 7.999878 FORMAT "%8.6" /end CHARACTERISTIC
/begin CHARACTERISTIC Sig_mSootDSMOffset_C "Offset Umrechung SG->DSM für Masse (Partikelfilter)" VALUE 0xC0920 Kw_Ws16 65535.00 OneToOne -32768.00 32767.00 FORMAT "%8.2" /end CHARACTERISTIC
/begin CHARACTERISTIC Sig_mSootDSMScale_C "Skalierung Umrechung SG->DSM für Masse (Partikelfilter)" VALUE 0xC0922 Kw_Wu16 7.999878 Fact 0.00 7.999878 FORMAT "%8.6" /end CHARACTERISTIC
/begin CHARACTERISTIC Sig_mSootCANOffset_C "Offset Umrechung SG->CAN für Masse (Partikelfilter)" VALUE 0xC0924 Kw_Ws16 65535.00 OneToOne -32768.00 32767.00 FORMAT "%8.2" /end CHARACTERISTIC
/begin CHARACTERISTIC Sig_mSootCANScale_C "Skalierung Umrechung SG->CAN für Masse (Partikelfilter)" VALUE 0xC0926 Kw_Wu16 7.999878 Fact 0.00 7.999878 FORMAT "%8.6" /end CHARACTERISTIC
/begin CHARACTERISTIC Sig_mSootDIAOffset_C "Offset Umrechung SG->Diagnoseschnittstelle für Masse (Partikelfilter)" VALUE 0xC0928 Kw_Ws16 65535.00 OneToOne -32768.00 32767.00 FORMAT "%8.2" /end CHARACTERISTIC
/begin CHARACTERISTIC Sig_mSootDIAScale_C "Skalierung Umrechung SG->Diagnoseschnittstelle für Masse (Partikelfilter)" VALUE 0xC092A Kw_Wu16 7.999878 Fact 0.00 7.999878 FORMAT "%8.6" /end CHARACTERISTIC
/begin CHARACTERISTIC Sig_nFanSpdDSMOffset_C "offset for conversion ecu -> dsm for fan speed conversion: FanSpd" VALUE 0xC092C Kw_Ws16 65535.00 OneToOne -32768.00 32767.00 FORMAT "%8.2" /end CHARACTERISTIC
/begin CHARACTERISTIC Sig_nFanSpdDSMScale_C "scale factor for conversion ecu -> dsm for fan speed conversion: FanSpd" VALUE 0xC092E Kw_Wu16 7.999878 Fact 0.00 7.999878 FORMAT "%8.6" /end CHARACTERISTIC
/begin CHARACTERISTIC Sig_nFanSpdCANOffset_C "offset for conversion ecu -> can for fan speed conversion: FanSpd" VALUE 0xC0930 Kw_Ws16 65535.00 OneToOne -32768.00 32767.00 FORMAT "%8.2" /end CHARACTERISTIC
/begin CHARACTERISTIC Sig_nFanSpdCANScale_C "scale factor for conversion ecu -> can for fan speed conversion: FanSpd" VALUE 0xC0932 Kw_Wu16 7.999878 Fact 0.00 7.999878 FORMAT "%8.6" /end CHARACTERISTIC
/begin CHARACTERISTIC Sig_nFanSpdDIAOffset_C "offset for conversion ecu -> dia for fan speed conversion: FanSpd" VALUE 0xC0934 Kw_Ws16 65535.00 OneToOne -32768.00 32767.00 FORMAT "%8.2" /end CHARACTERISTIC
/begin CHARACTERISTIC Sig_nFanSpdDIAScale_C "scale factor for conversion ecu -> dia for fan speed conversion: FanSpd" VALUE 0xC0936 Kw_Wu16 7.999878 Fact 0.00 7.999878 FORMAT "%8.6" /end CHARACTERISTIC
/begin CHARACTERISTIC Sig_nPSPSpdDSMOffset_C "offset for conversion ecu -> dsm for psp speed cConversion: PSP_Spd" VALUE 0xC0938 Kw_Ws16 65535.00 OneToOne -32768.00 32767.00 FORMAT "%8.2" /end CHARACTERISTIC
/begin CHARACTERISTIC Sig_nPSPSpdDSMScale_C "scale factor for conversion ecu -> dsm for psp speed cConversion: PSP_Spd" VALUE 0xC093A Kw_Wu16 7.999878 Fact 0.00 7.999878 FORMAT "%8.6" /end CHARACTERISTIC
/begin CHARACTERISTIC Sig_nPSPSpdCANOffset_C "offset for conversion ecu -> can for psp speed cConversion: PSP_Spd" VALUE 0xC093C Kw_Ws16 65535.00 OneToOne -32768.00 32767.00 FORMAT "%8.2" /end CHARACTERISTIC
/begin CHARACTERISTIC Sig_nPSPSpdCANScale_C "scale factor for conversion ecu -> can for psp speed cConversion: PSP_Spd" VALUE 0xC093E Kw_Wu16 7.999878 Fact 0.00 7.999878 FORMAT "%8.6" /end CHARACTERISTIC
/begin CHARACTERISTIC Sig_nPSPSpdDIAOffset_C "offset for conversion ecu -> dia for psp speed cConversion: PSP_Spd" VALUE 0xC0940 Kw_Ws16 65535.00 OneToOne -32768.00 32767.00 FORMAT "%8.2" /end CHARACTERISTIC
/begin CHARACTERISTIC Sig_nPSPSpdDIAScale_C "scale factor for conversion ecu -> dia for psp speed cConversion: PSP_Spd" VALUE 0xC0942 Kw_Wu16 7.999878 Fact 0.00 7.999878 FORMAT "%8.6" /end CHARACTERISTIC
/begin CHARACTERISTIC Sig_nDSMOffset_C "Offset Umrechung SG->DSM für Drehzahlsignale" VALUE 0xC0944 Kw_Ws16 65535.00 OneToOne -32768.00 32767.00 FORMAT "%8.2" /end CHARACTERISTIC
/begin CHARACTERISTIC Sig_nDSMScale_C "Skalierung Umrechung SG->DSM für Drehzahlsignale" VALUE 0xC0946 Kw_Wu16 7.999878 Fact 0.00 7.999878 FORMAT "%8.6" /end CHARACTERISTIC
/begin CHARACTERISTIC Sig_nCANOffset_C "Offset Umrechung SG<->CAN für Drehzahlsignale" VALUE 0xC0948 Kw_Ws16 65535.00 OneToOne -32768.00 32767.00 FORMAT "%8.2" /end CHARACTERISTIC
/begin CHARACTERISTIC Sig_nCANScale_C "Skalierung Umrechung SG->CAN für Drehzahlsignale" VALUE 0xC094A Kw_Wu16 7.999878 Fact 0.00 7.999878 FORMAT "%8.6" /end CHARACTERISTIC
/begin CHARACTERISTIC Sig_nDIAOffset_C "Offset Umrechung SG->DIA für Drehzahlsignale" VALUE 0xC094C Kw_Ws16 65535.00 OneToOne -32768.00 32767.00 FORMAT "%8.2" /end CHARACTERISTIC
/begin CHARACTERISTIC Sig_nDIAScale_C "Skalierung Umrechung SG->DIA für Drehzahlsignale" VALUE 0xC094E Kw_Wu16 7.999878 Fact 0.00 7.999878 FORMAT "%8.6" /end CHARACTERISTIC
/begin CHARACTERISTIC Sig_O2DSMOffset_C "Offset Umrechnung SG -> DSM für Sauerstoffkonzentration" VALUE 0xC0950 Kw_Ws16 65535.00 OneToOne -32768.00 32767.00 FORMAT "%8.2" /end CHARACTERISTIC
/begin CHARACTERISTIC Sig_O2DSMScale_C "Skalierung Umrechnung SG -> DSM für Sauerstoffkonzentration" VALUE 0xC0952 Kw_Wu16 7.999878 Fact 0.00 7.999878 FORMAT "%8.6" /end CHARACTERISTIC
/begin CHARACTERISTIC Sig_O2CANOffset_C "Offset Umrechnung SG -> CAN für Sauerstoffkonzentration" VALUE 0xC0954 Kw_Ws16 65535.00 OneToOne -32768.00 32767.00 FORMAT "%8.2" /end CHARACTERISTIC
/begin CHARACTERISTIC Sig_O2CANScale_C "Skalierung Umrechnung SG -> CAN für Sauerstoffkonzentration" VALUE 0xC0956 Kw_Wu16 7.999878 Fact 0.00 7.999878 FORMAT "%8.6" /end CHARACTERISTIC
/begin CHARACTERISTIC Sig_O2DIAOffset_C "Offset Umrechnung SG -> Diagnoseschnittstelle für Sauerstoffkonzentration" VALUE 0xC0958 Kw_Ws16 65535.00 OneToOne -32768.00 32767.00 FORMAT "%8.2" /end CHARACTERISTIC
/begin CHARACTERISTIC Sig_O2DIAScale_C "Skalierung Umrechnung SG -> Diagnoseschnittstelle für Sauerstoffkonzentration" VALUE 0xC095A Kw_Wu16 7.999878 Fact 0.00 7.999878 FORMAT "%8.6" /end CHARACTERISTIC
/begin CHARACTERISTIC Sig_OneToOneZFCDSMOffset_C "offset for conversion ecu -> dsm, One to one for ZFC" VALUE 0xC095C Kw_Ws16 65535.00 OneToOne -32768.00 32767.00 FORMAT "%8.2" /end CHARACTERISTIC
/begin CHARACTERISTIC Sig_OneToOneZFCDSMScale_C "scale factor for conversion ecu -> dsm, One to one for ZFC" VALUE 0xC095E Kw_Wu16 7.999878 Fact 0.00 7.999878 FORMAT "%8.6" /end CHARACTERISTIC
/begin CHARACTERISTIC Sig_OneToOneZFCCANOffset_C "offset for conversion ecu -> can, One to one for ZFC" VALUE 0xC0960 Kw_Ws16 65535.00 OneToOne -32768.00 32767.00 FORMAT "%8.2" /end CHARACTERISTIC
/begin CHARACTERISTIC Sig_OneToOneZFCCANScale_C "scale factor for conversion ecu -> can, One to one for ZFC" VALUE 0xC0962 Kw_Wu16 7.999878 Fact 0.00 7.999878 FORMAT "%8.6" /end CHARACTERISTIC
/begin CHARACTERISTIC Sig_OneToOneZFCDIAOffset_C "offset for conversion ecu -> dia, One to one for ZFC" VALUE 0xC0964 Kw_Ws16 65535.00 OneToOne -32768.00 32767.00 FORMAT "%8.2" /end CHARACTERISTIC
/begin CHARACTERISTIC Sig_OneToOneZFCDIAScale_C "scale factor for conversion ecu -> dia, One to one for ZFC" VALUE 0xC0966 Kw_Wu16 7.999878 Fact 0.00 7.999878 FORMAT "%8.6" /end CHARACTERISTIC
/begin CHARACTERISTIC Sig_OneToOneDSMOffset_C "Offset Umrechung SG->DSM" VALUE 0xC0968 Kw_Ws16 65535.00 OneToOne -32768.00 32767.00 FORMAT "%8.2" /end CHARACTERISTIC
/begin CHARACTERISTIC Sig_OneToOneDSMScale_C "Skalierung Umrechung SG->DSM" VALUE 0xC096A Kw_Wu16 7.999878 Fact 0.00 7.999878 FORMAT "%8.6" /end CHARACTERISTIC
/begin CHARACTERISTIC Sig_OneToOneCANOffset_C "Offset Umrechung SG->CAN" VALUE 0xC096C Kw_Ws16 65535.00 OneToOne -32768.00 32767.00 FORMAT "%8.2" /end CHARACTERISTIC
/begin CHARACTERISTIC Sig_OneToOneCANScale_C "Skalierung Umrechung SG->CAN" VALUE 0xC096E Kw_Wu16 7.999878 Fact 0.00 7.999878 FORMAT "%8.6" /end CHARACTERISTIC
/begin CHARACTERISTIC Sig_OneToOneDIAOffset_C "Offset Umrechung SG->DIA" VALUE 0xC0970 Kw_Ws16 65535.00 OneToOne -32768.00 32767.00 FORMAT "%8.2" /end CHARACTERISTIC
/begin CHARACTERISTIC Sig_OneToOneDIAScale_C "Skalierung Umrechung SG->DIA" VALUE 0xC0972 Kw_Wu16 7.999878 Fact 0.00 7.999878 FORMAT "%8.6" /end CHARACTERISTIC
/begin CHARACTERISTIC Sig_OnOffDSMOffset_C "Offset Umrechung SG->DSM für Digitalsignale" VALUE 0xC0974 Kw_Ws16 65535.00 OneToOne -32768.00 32767.00 FORMAT "%8.2" /end CHARACTERISTIC
/begin CHARACTERISTIC Sig_OnOffDSMScale_C "Skalierung Umrechung SG->DSM für Digitalsignale" VALUE 0xC0976 Kw_Wu16 7.999878 Fact 0.00 7.999878 FORMAT "%8.6" /end CHARACTERISTIC
/begin CHARACTERISTIC Sig_OnOffCANOffset_C "Offset Umrechung SG->CAN für Digitalsignale" VALUE 0xC0978 Kw_Ws16 65535.00 OneToOne -32768.00 32767.00 FORMAT "%8.2" /end CHARACTERISTIC
/begin CHARACTERISTIC Sig_OnOffCANScale_C "Skalierung Umrechung SG->CAN für Digitalsignale" VALUE 0xC097A Kw_Wu16 7.999878 Fact 0.00 7.999878 FORMAT "%8.6" /end CHARACTERISTIC
/begin CHARACTERISTIC Sig_OnOffDIAOffset_C "Offset Umrechung SG->DIA für Digitalsignale" VALUE 0xC097C Kw_Ws16 65535.00 OneToOne -32768.00 32767.00 FORMAT "%8.2" /end CHARACTERISTIC
/begin CHARACTERISTIC Sig_OnOffDIAScale_C "Skalierung Umrechung SG->DIA für Digitalsignale" VALUE 0xC097E Kw_Wu16 7.999878 Fact 0.00 7.999878 FORMAT "%8.6" /end CHARACTERISTIC
/begin CHARACTERISTIC Sig_PermUwB6DSMOffset_C "offset for conversion ecu -> dsm for k3-Conversion: Def_perm_uw_b6" VALUE 0xC0980 Kw_Ws16 65535.00 OneToOne -32768.00 32767.00 FORMAT "%8.2" /end CHARACTERISTIC
/begin CHARACTERISTIC Sig_PermUwB6DSMScale_C "scale factor for conversion ecu -> dsm for k3-Conversion: Def_perm_uw_b6" VALUE 0xC0982 Kw_Wu16 7.999878 Fact 0.00 7.999878 FORMAT "%8.6" /end CHARACTERISTIC
/begin CHARACTERISTIC Sig_PermUwB6CANOffset_C "offset for conversion ecu -> can for k3-Conversion: Def_perm_uw_b6" VALUE 0xC0984 Kw_Ws16 65535.00 OneToOne -32768.00 32767.00 FORMAT "%8.2" /end CHARACTERISTIC
/begin CHARACTERISTIC Sig_PermUwB6CANScale_C "scale factor for conversion ecu -> can for k3-Conversion: Def_perm_uw_b6" VALUE 0xC0986 Kw_Wu16 7.999878 Fact 0.00 7.999878 FORMAT "%8.6" /end CHARACTERISTIC
/begin CHARACTERISTIC Sig_PermUwB6DIAOffset_C "offset for conversion ecu -> dia for k3-Conversion: Def_perm_uw_b6" VALUE 0xC0988 Kw_Ws16 65535.00 OneToOne -32768.00 32767.00 FORMAT "%8.2" /end CHARACTERISTIC
/begin CHARACTERISTIC Sig_PermUwB6DIAScale_C "scale factor for conversion ecu -> dia for k3-Conversion: Def_perm_uw_b6" VALUE 0xC098A Kw_Wu16 7.999878 Fact 0.00 7.999878 FORMAT "%8.6" /end CHARACTERISTIC
/begin CHARACTERISTIC Sig_pRailDSMOffset_C "offset für Umrechnung ecu -> dsm" VALUE 0xC098C Kw_Ws16 65535.00 OneToOne -32768.00 32767.00 FORMAT "%8.2" /end CHARACTERISTIC
/begin CHARACTERISTIC Sig_pRailDSMScale_C "Skalierung für Umrechnung ecu -> dsm" VALUE 0xC098E Kw_Wu16 7.999878 Fact 0.00 7.999878 FORMAT "%8.6" /end CHARACTERISTIC
/begin CHARACTERISTIC Sig_pRailCANOffset_C "Offset für Umrechnung ecu -> can" VALUE 0xC0990 Kw_Ws16 65535.00 OneToOne -32768.00 32767.00 FORMAT "%8.2" /end CHARACTERISTIC
/begin CHARACTERISTIC Sig_pRailCANScale_C "Skalierung für Umrechnung ecu -> can" VALUE 0xC0992 Kw_Wu16 7.999878 Fact 0.00 7.999878 FORMAT "%8.6" /end CHARACTERISTIC
/begin CHARACTERISTIC Sig_pRailDIAOffset_C "Offset für Umrechnung ecu -> dia" VALUE 0xC0994 Kw_Ws16 65535.00 OneToOne -32768.00 32767.00 FORMAT "%8.2" /end CHARACTERISTIC
/begin CHARACTERISTIC Sig_pRailDIAScale_C "Skalierung für Umrechnung ecu -> dia" VALUE 0xC0996 Kw_Wu16 7.999878 Fact 0.00 7.999878 FORMAT "%8.6" /end CHARACTERISTIC
/begin CHARACTERISTIC Sig_pDSMOffset_C "Offset Umrechung SG->DSM für Druck" VALUE 0xC0998 Kw_Ws16 65535.00 OneToOne -32768.00 32767.00 FORMAT "%8.2" /end CHARACTERISTIC
/begin CHARACTERISTIC Sig_pDSMScale_C "Skalierung Umrechung SG->DSM für Druck" VALUE 0xC099A Kw_Wu16 7.999878 Fact 0.00 7.999878 FORMAT "%8.6" /end CHARACTERISTIC
/begin CHARACTERISTIC Sig_pCANOffset_C "Offset Umrechung SG->CAN für Druck" VALUE 0xC099C Kw_Ws16 65535.00 OneToOne -32768.00 32767.00 FORMAT "%8.2" /end CHARACTERISTIC
/begin CHARACTERISTIC Sig_pCANScale_C "Skalierung Umrechung SG->CAN für Druck" VALUE 0xC099E Kw_Wu16 7.999878 Fact 0.00 7.999878 FORMAT "%8.6" /end CHARACTERISTIC
/begin CHARACTERISTIC Sig_pDIAOffset_C "Offset Umrechung SG->Diagnoseschnittstelle für Druck" VALUE 0xC09A0 Kw_Ws16 65535.00 OneToOne -32768.00 32767.00 FORMAT "%8.2" /end CHARACTERISTIC
/begin CHARACTERISTIC Sig_pDIAScale_C "Skalierung Umrechung SG->Diagnoseschnittstelle für Druck" VALUE 0xC09A2 Kw_Wu16 7.999878 Fact 0.00 7.999878 FORMAT "%8.6" /end CHARACTERISTIC
/begin CHARACTERISTIC Sig_qInjMassCycDSMOffset_C "offset for conversion ecu -> dsm for injection quantity per cycle, Conversion: InjMassCyc" VALUE 0xC09A4 Kw_Ws16 65535.00 OneToOne -32768.00 32767.00 FORMAT "%8.2" /end CHARACTERISTIC
/begin CHARACTERISTIC Sig_qInjMassCycDSMScale_C "scale factor for conversion ecu -> dsm for injection quantity per cycle, Conversion: InjMassCyc" VALUE 0xC09A6 Kw_Wu16 7.999878 Fact 0.00 7.999878 FORMAT "%8.6" /end CHARACTERISTIC
/begin CHARACTERISTIC Sig_qInjMassCycCANOffset_C "offset for conversion ecu -> can for injection quantity per cycle, Conversion: InjMassCyc" VALUE 0xC09A8 Kw_Ws16 65535.00 OneToOne -32768.00 32767.00 FORMAT "%8.2" /end CHARACTERISTIC
/begin CHARACTERISTIC Sig_qInjMassCycCANScale_C "scale factor for conversion ecu -> can for injection quantity per cycle, Conversion: InjMassCyc" VALUE 0xC09AA Kw_Wu16 7.999878 Fact 0.00 7.999878 FORMAT "%8.6" /end CHARACTERISTIC
/begin CHARACTERISTIC Sig_qInjMassCycDIAOffset_C "offset for conversion ecu -> dia for injection quantity per cycle, Conversion: InjMassCyc" VALUE 0xC09AC Kw_Ws16 65535.00 OneToOne -32768.00 32767.00 FORMAT "%8.2" /end CHARACTERISTIC
/begin CHARACTERISTIC Sig_qInjMassCycDIAScale_C "scale factor for conversion ecu -> dia for injection quantity per cycle, Conversion: InjMassCyc" VALUE 0xC09AE Kw_Wu16 7.999878 Fact 0.00 7.999878 FORMAT "%8.6" /end CHARACTERISTIC
/begin CHARACTERISTIC Sig_qInjMassDSMOffset_C "Offset für Umrechnung ecu -> dsm" VALUE 0xC09B0 Kw_Ws16 65535.00 OneToOne -32768.00 32767.00 FORMAT "%8.2" /end CHARACTERISTIC
/begin CHARACTERISTIC Sig_qInjMassDSMScale_C "Skalierung für Umrechnung ecu -> dsm" VALUE 0xC09B2 Kw_Wu16 7.999878 Fact 0.00 7.999878 FORMAT "%8.6" /end CHARACTERISTIC
/begin CHARACTERISTIC Sig_qInjMassCANOffset_C "Offset für Umrechnung ecu -> can" VALUE 0xC09B4 Kw_Ws16 65535.00 OneToOne -32768.00 32767.00 FORMAT "%8.2" /end CHARACTERISTIC
/begin CHARACTERISTIC Sig_qInjMassCANScale_C "Skalierung für Umrechnung ecu -> can" VALUE 0xC09B6 Kw_Wu16 7.999878 Fact 0.00 7.999878 FORMAT "%8.6" /end CHARACTERISTIC
/begin CHARACTERISTIC Sig_qInjMassDIAOffset_C "Offset für Umrechnung ecu -> dia" VALUE 0xC09B8 Kw_Ws16 65535.00 OneToOne -32768.00 32767.00 FORMAT "%8.2" /end CHARACTERISTIC
/begin CHARACTERISTIC Sig_qInjMassDIAScale_C "Skalierung für Umrechnung ecu -> dia" VALUE 0xC09BA Kw_Wu16 7.999878 Fact 0.00 7.999878 FORMAT "%8.6" /end CHARACTERISTIC
/begin CHARACTERISTIC Sig_qDSMOffset_C "Offset fuer Umrechung SG->DSM fuer Menge" VALUE 0xC09BC Kw_Ws16 65535.00 OneToOne -32768.00 32767.00 FORMAT "%8.2" /end CHARACTERISTIC
/begin CHARACTERISTIC Sig_qDSMScale_C "Skalierung Umrechungs Faktor SG->DSM fuer Menge" VALUE 0xC09BE Kw_Wu16 7.999878 Fact 0.00 7.999878 FORMAT "%8.6" /end CHARACTERISTIC
/begin CHARACTERISTIC Sig_qCANOffset_C "Offset fuer Umrechung SG->CAN fuer Menge" VALUE 0xC09C0 Kw_Ws16 65535.00 OneToOne -32768.00 32767.00 FORMAT "%8.2" /end CHARACTERISTIC
/begin CHARACTERISTIC Sig_qCANScale_C "Skalierung Umrechungs Faktor SG->CAN fuer Menge" VALUE 0xC09C2 Kw_Wu16 7.999878 Fact 0.00 7.999878 FORMAT "%8.6" /end CHARACTERISTIC
/begin CHARACTERISTIC Sig_qDIAOffset_C "Offset fuer Umrechung SG->DIA fuer Menge" VALUE 0xC09C4 Kw_Ws16 65535.00 OneToOne -32768.00 32767.00 FORMAT "%8.2" /end CHARACTERISTIC
/begin CHARACTERISTIC Sig_qDIAScale_C "Skalierung Umrechungs Faktor SG->DIA fuer Menge" VALUE 0xC09C6 Kw_Wu16 7.999878 Fact 0.00 7.999878 FORMAT "%8.6" /end CHARACTERISTIC
/begin CHARACTERISTIC Sig_resFlowDSMOffset_C "Offset Umrechung SG->DSM für Strömungswiderstand" VALUE 0xC09C8 Kw_Ws16 65535.00 OneToOne -32768.00 32767.00 FORMAT "%8.2" /end CHARACTERISTIC
/begin CHARACTERISTIC Sig_resFlowDSMScale_C "Skalierung Umrechung SG->DSM für Strömungswiderstand" VALUE 0xC09CA Kw_Wu16 7.999878 Fact 0.00 7.999878 FORMAT "%8.6" /end CHARACTERISTIC
/begin CHARACTERISTIC Sig_resFlowCANOffset_C "Offset Umrechung SG->CAN für Strömungswiderstand" VALUE 0xC09CC Kw_Ws16 65535.00 OneToOne -32768.00 32767.00 FORMAT "%8.2" /end CHARACTERISTIC
/begin CHARACTERISTIC Sig_resFlowCANScale_C "Skalierung Umrechung SG->CAN für Strömungswiderstand" VALUE 0xC09CE Kw_Wu16 7.999878 Fact 0.00 7.999878 FORMAT "%8.6" /end CHARACTERISTIC
/begin CHARACTERISTIC Sig_resFlowDIAOffset_C "Offset Umrechung SG->Diagnoseschnittstelle für Strömungswiderstand" VALUE 0xC09D0 Kw_Ws16 65535.00 OneToOne -32768.00 32767.00 FORMAT "%8.2" /end CHARACTERISTIC
/begin CHARACTERISTIC Sig_resFlowDIAScale_C "Skalierung Umrechung SG->Diagnoseschnittstelle für Strömungswiderstand" VALUE 0xC09D2 Kw_Wu16 7.999878 Fact 0.00 7.999878 FORMAT "%8.6" /end CHARACTERISTIC
/begin CHARACTERISTIC Sig_rVnDSMOffset_C "Offset für Umrechnung ecu -> dsm" VALUE 0xC09D4 Kw_Ws16 65535.00 OneToOne -32768.00 32767.00 FORMAT "%8.2" /end CHARACTERISTIC
/begin CHARACTERISTIC Sig_rVnDSMScale_C "Skalierung für Umrechnung ecu -> dsm" VALUE 0xC09D6 Kw_Wu16 7.999878 Fact 0.00 7.999878 FORMAT "%8.6" /end CHARACTERISTIC
/begin CHARACTERISTIC Sig_rVnCANOffset_C "Offset für Umrechnung ecu -> can" VALUE 0xC09D8 Kw_Ws16 65535.00 OneToOne -32768.00 32767.00 FORMAT "%8.2" /end CHARACTERISTIC
/begin CHARACTERISTIC Sig_rVnCANScale_C "Skalierung für Umrechnung ecu -> can" VALUE 0xC09DA Kw_Wu16 7.999878 Fact 0.00 7.999878 FORMAT "%8.6" /end CHARACTERISTIC
/begin CHARACTERISTIC Sig_rVnDIAOffset_C "Offset für Umrechnung ecu -> dia" VALUE 0xC09DC Kw_Ws16 65535.00 OneToOne -32768.00 32767.00 FORMAT "%8.2" /end CHARACTERISTIC
/begin CHARACTERISTIC Sig_rVnDIAScale_C "Skalierung für Umrechnung ecu -> dia" VALUE 0xC09DE Kw_Wu16 7.999878 Fact 0.00 7.999878 FORMAT "%8.6" /end CHARACTERISTIC
/begin CHARACTERISTIC Sig_rDSMOffset_C "Offset Umrechung SG->DSM für Verhältnisse" VALUE 0xC09E0 Kw_Ws16 65535.00 OneToOne -32768.00 32767.00 FORMAT "%8.2" /end CHARACTERISTIC
/begin CHARACTERISTIC Sig_rDSMScale_C "Skalierung Umrechung SG->DSM für Verhältnisse" VALUE 0xC09E2 Kw_Wu16 7.999878 Fact 0.00 7.999878 FORMAT "%8.6" /end CHARACTERISTIC
/begin CHARACTERISTIC Sig_rCANOffset_C "Offset Umrechung SG->CAN für Verhältnisse" VALUE 0xC09E4 Kw_Ws16 65535.00 OneToOne -32768.00 32767.00 FORMAT "%8.2" /end CHARACTERISTIC
/begin CHARACTERISTIC Sig_rCANScale_C "Skalierung Umrechung SG->CAN für Verhältnisse" VALUE 0xC09E6 Kw_Wu16 7.999878 Fact 0.00 7.999878 FORMAT "%8.6" /end CHARACTERISTIC
/begin CHARACTERISTIC Sig_rDIAOffset_C "Offset Umrechung SG->Diagnoseschnittstelle für Verhältnisse" VALUE 0xC09E8 Kw_Ws16 65535.00 OneToOne -32768.00 32767.00 FORMAT "%8.2" /end CHARACTERISTIC
/begin CHARACTERISTIC Sig_rDIAScale_C "Skalierung Umrechung SG->Diagnoseschnittstelle für Verhältnisse" VALUE 0xC09EA Kw_Wu16 7.999878 Fact 0.00 7.999878 FORMAT "%8.6" /end CHARACTERISTIC
/begin CHARACTERISTIC Sig_ShftRght0ByteDSMOffset_C "offset for conversion ecu -> dsm to shift right 0 byte of status value, Conversion: OneToOne" VALUE 0xC09EC Kw_Ws16 65535.00 OneToOne -32768.00 32767.00 FORMAT "%8.2" /end CHARACTERISTIC
/begin CHARACTERISTIC Sig_ShftRght0ByteDSMScale_C "scale factor for conversion ecu -> dsm to shift right 0 byte of status value, Conversion: OneToOne" VALUE 0xC09EE Kw_Wu16 7.999878 Fact 0.00 7.999878 FORMAT "%8.6" /end CHARACTERISTIC
/begin CHARACTERISTIC Sig_ShftRght0ByteCANOffset_C "offset for conversion ecu -> can to shift right 0 byte of status value, Conversion: OneToOne" VALUE 0xC09F0 Kw_Ws16 65535.00 OneToOne -32768.00 32767.00 FORMAT "%8.2" /end CHARACTERISTIC
/begin CHARACTERISTIC Sig_ShftRght0ByteCANScale_C "scale factor for conversion ecu -> can to shift right 0 byte of status value, Conversion: OneToOne" VALUE 0xC09F2 Kw_Wu16 7.999878 Fact 0.00 7.999878 FORMAT "%8.6" /end CHARACTERISTIC
/begin CHARACTERISTIC Sig_ShftRght0ByteDIAOffset_C "offset for conversion ecu -> dia to shift right 0 byte of status value, Conversion: OneToOne" VALUE 0xC09F4 Kw_Ws16 65535.00 OneToOne -32768.00 32767.00 FORMAT "%8.2" /end CHARACTERISTIC
/begin CHARACTERISTIC Sig_ShftRght0ByteDIAScale_C "scale factor for conversion ecu -> dia to shift right 0 byte of status value, Conversion: OneToOne" VALUE 0xC09F6 Kw_Wu16 7.999878 Fact 0.00 7.999878 FORMAT "%8.6" /end CHARACTERISTIC
/begin CHARACTERISTIC Sig_ShftRght1ByteDSMOffset_C "offset for conversion ecu -> dsm to shift right 1 byte of status value, Conversion: OneToOne" VALUE 0xC09F8 Kw_Ws16 65535.00 OneToOne -32768.00 32767.00 FORMAT "%8.2" /end CHARACTERISTIC
/begin CHARACTERISTIC Sig_ShftRght1ByteDSMScale_C "scale factor for conversion ecu -> dsm to shift right 1 byte of status value, Conversion: OneToOne" VALUE 0xC09FA Kw_Wu16 7.999878 Fact 0.00 7.999878 FORMAT "%8.6" /end CHARACTERISTIC
/begin CHARACTERISTIC Sig_ShftRght1ByteCANOffset_C "offset for conversion ecu -> can to shift right 1 byte of status value, Conversion: OneToOne" VALUE 0xC09FC Kw_Ws16 65535.00 OneToOne -32768.00 32767.00 FORMAT "%8.2" /end CHARACTERISTIC
/begin CHARACTERISTIC Sig_ShftRght1ByteCANScale_C "scale factor for conversion ecu -> can to shift right 1 byte of status value, Conversion: OneToOne" VALUE 0xC09FE Kw_Wu16 7.999878 Fact 0.00 7.999878 FORMAT "%8.6" /end CHARACTERISTIC
/begin CHARACTERISTIC Sig_ShftRght1ByteDIAOffset_C "offset for conversion ecu -> dia to shift right 1 byte of status value, Conversion: OneToOne" VALUE 0xC0A00 Kw_Ws16 65535.00 OneToOne -32768.00 32767.00 FORMAT "%8.2" /end CHARACTERISTIC
/begin CHARACTERISTIC Sig_ShftRght1ByteDIAScale_C "scale factor for conversion ecu -> dia to shift right 1 byte of status value, Conversion: OneToOne" VALUE 0xC0A02 Kw_Wu16 7.999878 Fact 0.00 7.999878 FORMAT "%8.6" /end CHARACTERISTIC
/begin CHARACTERISTIC Sig_ShftRght2ByteDSMOffset_C "offset for conversion ecu -> dsm to shift right 2 byte of status value, Conversion: OneToOne" VALUE 0xC0A04 Kw_Ws16 65535.00 OneToOne -32768.00 32767.00 FORMAT "%8.2" /end CHARACTERISTIC
/begin CHARACTERISTIC Sig_ShftRght2ByteDSMScale_C "scale factor for conversion ecu -> dsm to shift right 2 byte of status value, Conversion: OneToOne" VALUE 0xC0A06 Kw_Wu16 7.999878 Fact 0.00 7.999878 FORMAT "%8.6" /end CHARACTERISTIC
/begin CHARACTERISTIC Sig_ShftRght2ByteCANOffset_C "offset for conversion ecu -> can to shift right 2 byte of status value, Conversion: OneToOne" VALUE 0xC0A08 Kw_Ws16 65535.00 OneToOne -32768.00 32767.00 FORMAT "%8.2" /end CHARACTERISTIC
/begin CHARACTERISTIC Sig_ShftRght2ByteCANScale_C "scale factor for conversion ecu -> can to shift right 2 byte of status value, Conversion: OneToOne" VALUE 0xC0A0A Kw_Wu16 7.999878 Fact 0.00 7.999878 FORMAT "%8.6" /end CHARACTERISTIC
/begin CHARACTERISTIC Sig_ShftRght2ByteDIAOffset_C "offset for conversion ecu -> dia to shift right 2 byte of status value, Conversion: OneToOne" VALUE 0xC0A0C Kw_Ws16 65535.00 OneToOne -32768.00 32767.00 FORMAT "%8.2" /end CHARACTERISTIC
/begin CHARACTERISTIC Sig_ShftRght2ByteDIAScale_C "scale factor for conversion ecu -> dia to shift right 2 byte of status value, Conversion: OneToOne" VALUE 0xC0A0E Kw_Wu16 7.999878 Fact 0.00 7.999878 FORMAT "%8.6" /end CHARACTERISTIC
/begin CHARACTERISTIC Sig_ShftRght3ByteDSMOffset_C "offset for conversion ecu -> dsm to shift right 3 byte of status value, Conversion: OneToOne" VALUE 0xC0A10 Kw_Ws16 65535.00 OneToOne -32768.00 32767.00 FORMAT "%8.2" /end CHARACTERISTIC
/begin CHARACTERISTIC Sig_ShftRght3ByteDSMScale_C "scale factor for conversion ecu -> dsm to shift right 3 byte of status value, Conversion: OneToOne" VALUE 0xC0A12 Kw_Wu16 7.999878 Fact 0.00 7.999878 FORMAT "%8.6" /end CHARACTERISTIC
/begin CHARACTERISTIC Sig_ShftRght3ByteCANOffset_C "offset for conversion ecu -> can to shift right 3 byte of status value, Conversion: OneToOne" VALUE 0xC0A14 Kw_Ws16 65535.00 OneToOne -32768.00 32767.00 FORMAT "%8.2" /end CHARACTERISTIC
/begin CHARACTERISTIC Sig_ShftRght3ByteCANScale_C "scale factor for conversion ecu -> can to shift right 3 byte of status value, Conversion: OneToOne" VALUE 0xC0A16 Kw_Wu16 7.999878 Fact 0.00 7.999878 FORMAT "%8.6" /end CHARACTERISTIC
/begin CHARACTERISTIC Sig_ShftRght3ByteDIAOffset_C "offset for conversion ecu -> dia to shift right 3 byte of status value, Conversion: OneToOne" VALUE 0xC0A18 Kw_Ws16 65535.00 OneToOne -32768.00 32767.00 FORMAT "%8.2" /end CHARACTERISTIC
/begin CHARACTERISTIC Sig_ShftRght3ByteDIAScale_C "scale factor for conversion ecu -> dia to shift right 3 byte of status value, Conversion: OneToOne" VALUE 0xC0A1A Kw_Wu16 7.999878 Fact 0.00 7.999878 FORMAT "%8.6" /end CHARACTERISTIC
/begin CHARACTERISTIC Sig_TdUbQ0p5DSMOffset_C "offset for conversion ecu -> dsm for k3-Conversion: Def_td_ub_q0p5" VALUE 0xC0A1C Kw_Ws16 65535.00 OneToOne -32768.00 32767.00 FORMAT "%8.2" /end CHARACTERISTIC
/begin CHARACTERISTIC Sig_TdUbQ0p5DSMScale_C "scale factor for conversion ecu -> dsm for k3-Conversion: Def_td_ub_q0p5" VALUE 0xC0A1E Kw_Wu16 7.999878 Fact 0.00 7.999878 FORMAT "%8.6" /end CHARACTERISTIC
/begin CHARACTERISTIC Sig_TdUbQ0p5CANOffset_C "offset for conversion ecu -> can for k3-Conversion: Def_td_ub_q0p5" VALUE 0xC0A20 Kw_Ws16 65535.00 OneToOne -32768.00 32767.00 FORMAT "%8.2" /end CHARACTERISTIC
/begin CHARACTERISTIC Sig_TdUbQ0p5CANScale_C "scale factor for conversion ecu -> can for k3-Conversion: Def_td_ub_q0p5" VALUE 0xC0A22 Kw_Wu16 7.999878 Fact 0.00 7.999878 FORMAT "%8.6" /end CHARACTERISTIC
/begin CHARACTERISTIC Sig_TdUbQ0p5DIAOffset_C "offset for conversion ecu -> dia for k3-Conversion: Def_td_ub_q0p5" VALUE 0xC0A24 Kw_Ws16 65535.00 OneToOne -32768.00 32767.00 FORMAT "%8.2" /end CHARACTERISTIC
/begin CHARACTERISTIC Sig_TdUbQ0p5DIAScale_C "scale factor for conversion ecu -> dia for k3-Conversion: Def_td_ub_q0p5" VALUE 0xC0A26 Kw_Wu16 7.999878 Fact 0.00 7.999878 FORMAT "%8.6" /end CHARACTERISTIC
/begin CHARACTERISTIC Sig_TdUbQ14p9333DSMOffset_C "offset for conversion ecu -> dsm for k3-Conversion: Def_td_ub_q14p9333" VALUE 0xC0A28 Kw_Ws16 65535.00 OneToOne -32768.00 32767.00 FORMAT "%8.2" /end CHARACTERISTIC
/begin CHARACTERISTIC Sig_TdUbQ14p9333DSMScale_C "scale factor for conversion ecu -> dsm for k3-Conversion: Def_td_ub_q14p9333" VALUE 0xC0A2A Kw_Wu16 7.999878 Fact 0.00 7.999878 FORMAT "%8.6" /end CHARACTERISTIC
/begin CHARACTERISTIC Sig_TdUbQ14p9333CANOffset_C "offset for conversion ecu -> can for k3-Conversion: Def_td_ub_q14p9333" VALUE 0xC0A2C Kw_Ws16 65535.00 OneToOne -32768.00 32767.00 FORMAT "%8.2" /end CHARACTERISTIC
/begin CHARACTERISTIC Sig_TdUbQ14p9333CANScale_C "scale factor for conversion ecu -> can for k3-Conversion: Def_td_ub_q14p9333" VALUE 0xC0A2E Kw_Wu16 7.999878 Fact 0.00 7.999878 FORMAT "%8.6" /end CHARACTERISTIC
/begin CHARACTERISTIC Sig_TdUbQ14p9333DIAOffset_C "offset for conversion ecu -> dia for k3-Conversion: Def_td_ub_q14p9333" VALUE 0xC0A30 Kw_Ws16 65535.00 OneToOne -32768.00 32767.00 FORMAT "%8.2" /end CHARACTERISTIC
/begin CHARACTERISTIC Sig_TdUbQ14p9333DIAScale_C "scale factor for conversion ecu -> dia for k3-Conversion: Def_td_ub_q14p9333" VALUE 0xC0A32 Kw_Wu16 7.999878 Fact 0.00 7.999878 FORMAT "%8.6" /end CHARACTERISTIC
/begin CHARACTERISTIC Sig_tExhaustgasDSMOffset_C "offset for conversion ecu -> dsm for exhaust gas temperature, Conversion: Temp_Cels" VALUE 0xC0A34 Kw_Ws16 65535.00 OneToOne -32768.00 32767.00 FORMAT "%8.2" /end CHARACTERISTIC
/begin CHARACTERISTIC Sig_tExhaustgasDSMScale_C "scale factor for conversion ecu -> dsm for exhaust gas temperature, Conversion: Temp_Cels" VALUE 0xC0A36 Kw_Wu16 7.999878 Fact 0.00 7.999878 FORMAT "%8.6" /end CHARACTERISTIC
/begin CHARACTERISTIC Sig_tExhaustgasCANOffset_C "offset for conversion ecu -> can for exhaust gas temperature, Conversion: Temp_Cels" VALUE 0xC0A38 Kw_Ws16 65535.00 OneToOne -32768.00 32767.00 FORMAT "%8.2" /end CHARACTERISTIC
/begin CHARACTERISTIC Sig_tExhaustgasCANScale_C "scale factor for conversion ecu -> can for exhaust gas temperature, Conversion: Temp_Cels" VALUE 0xC0A3A Kw_Wu16 7.999878 Fact 0.00 7.999878 FORMAT "%8.6" /end CHARACTERISTIC
/begin CHARACTERISTIC Sig_tExhaustgasDIAOffset_C "offset for conversion ecu -> dia for exhaust gas temperature, Conversion: Temp_Cels" VALUE 0xC0A3C Kw_Ws16 65535.00 OneToOne -32768.00 32767.00 FORMAT "%8.2" /end CHARACTERISTIC
/begin CHARACTERISTIC Sig_tExhaustgasDIAScale_C "scale factor for conversion ecu -> dia for exhaust gas temperature, Conversion: Temp_Cels" VALUE 0xC0A3E Kw_Wu16 7.999878 Fact 0.00 7.999878 FORMAT "%8.6" /end CHARACTERISTIC
/begin CHARACTERISTIC Sig_timEngDSMOffset_C "Offset für Umrechnung ecu -> dsm" VALUE 0xC0A40 Kw_Ws16 65535.00 OneToOne -32768.00 32767.00 FORMAT "%8.2" /end CHARACTERISTIC
/begin CHARACTERISTIC Sig_timEngDSMScale_C "Skalierung für Umrechnung ecu -> dsm" VALUE 0xC0A42 Kw_Wu16 7.999878 Fact 0.00 7.999878 FORMAT "%8.6" /end CHARACTERISTIC
/begin CHARACTERISTIC Sig_timEngCANOffset_C "Offset für Umrechnung ecu -> can" VALUE 0xC0A44 Kw_Ws16 65535.00 OneToOne -32768.00 32767.00 FORMAT "%8.2" /end CHARACTERISTIC
/begin CHARACTERISTIC Sig_timEngCANScale_C "Skalierung für Umrechnung ecu -> can" VALUE 0xC0A46 Kw_Wu16 7.999878 Fact 0.00 7.999878 FORMAT "%8.6" /end CHARACTERISTIC
/begin CHARACTERISTIC Sig_timEngDIAOffset_C "Offset für Umrechnung ecu -> dia" VALUE 0xC0A48 Kw_Ws16 65535.00 OneToOne -32768.00 32767.00 FORMAT "%8.2" /end CHARACTERISTIC
/begin CHARACTERISTIC Sig_timEngDIAScale_C "Skalierung für Umrechnung ecu -> dia" VALUE 0xC0A4A Kw_Wu16 7.999878 Fact 0.00 7.999878 FORMAT "%8.6" /end CHARACTERISTIC
/begin CHARACTERISTIC Sig_Time_PwmHighDSMOffset_C "Offset für Umrechnung SG -> DSM" VALUE 0xC0A4C Kw_Ws16 65535.00 OneToOne -32768.00 32767.00 FORMAT "%8.2" /end CHARACTERISTIC
/begin CHARACTERISTIC Sig_Time_PwmHighDSMScale_C "Offset für Umrechnung SG -> DSM" VALUE 0xC0A4E Kw_Wu16 7.999878 Fact 0.00 7.999878 FORMAT "%8.6" /end CHARACTERISTIC
/begin CHARACTERISTIC Sig_Time_PwmHighCANOffset_C "Offset für Umrechnung SG -> CAN" VALUE 0xC0A50 Kw_Ws16 65535.00 OneToOne -32768.00 32767.00 FORMAT "%8.2" /end CHARACTERISTIC
/begin CHARACTERISTIC Sig_Time_PwmHighCANScale_C "Skalierung Umrechnungsfaktor SG -> CAN" VALUE 0xC0A52 Kw_Wu16 7.999878 Fact 0.00 7.999878 FORMAT "%8.6" /end CHARACTERISTIC
/begin CHARACTERISTIC Sig_Time_PwmHighDIAOffset_C "Offset für Umrechnung SG -> Diagnoseschnittstelle" VALUE 0xC0A54 Kw_Ws16 65535.00 OneToOne -32768.00 32767.00 FORMAT "%8.2" /end CHARACTERISTIC
/begin CHARACTERISTIC Sig_Time_PwmHighDIAScale_C "Skalierung Umrechnungsfaktor SG -> Diagnoseschnittstelle" VALUE 0xC0A56 Kw_Wu16 7.999878 Fact 0.00 7.999878 FORMAT "%8.6" /end CHARACTERISTIC
/begin CHARACTERISTIC Sig_timsDSMOffset_C "offset for conversion ecu -> dsm" VALUE 0xC0A58 Kw_Ws16 65535.00 OneToOne -32768.00 32767.00 FORMAT "%8.2" /end CHARACTERISTIC
/begin CHARACTERISTIC Sig_timsDSMScale_C "scale factor for conversion from ecu -> dsm" VALUE 0xC0A5A Kw_Wu16 7.999878 Fact 0.00 7.999878 FORMAT "%8.6" /end CHARACTERISTIC
/begin CHARACTERISTIC Sig_timsCANOffset_C "offset for conversion from ecu -> can" VALUE 0xC0A5C Kw_Ws16 65535.00 OneToOne -32768.00 32767.00 FORMAT "%8.2" /end CHARACTERISTIC
/begin CHARACTERISTIC Sig_timsCANScale_C "scale factor for conversion from ecu -> can" VALUE 0xC0A5E Kw_Wu16 7.999878 Fact 0.00 7.999878 FORMAT "%8.6" /end CHARACTERISTIC
/begin CHARACTERISTIC Sig_timsDIAOffset_C "offset for conversion from ecu -> dia" VALUE 0xC0A60 Kw_Ws16 65535.00 OneToOne -32768.00 32767.00 FORMAT "%8.2" /end CHARACTERISTIC
/begin CHARACTERISTIC Sig_timsDIAScale_C "scale factor for conversion from ecu -> dia" VALUE 0xC0A62 Kw_Wu16 7.999878 Fact 0.00 7.999878 FORMAT "%8.6" /end CHARACTERISTIC
/begin CHARACTERISTIC Sig_tiOprgnu16PFltDSMOffset_C "offset for conversion ecu -> dsm for engine operation time since last successful regeneration, Conversion: tiSncergnRes" VALUE 0xC0A64 Kw_Ws16 65535.00 OneToOne -32768.00 32767.00 FORMAT "%8.2" /end CHARACTERISTIC
/begin CHARACTERISTIC Sig_tiOprgnu16PFltDSMScale_C "Skalierung Umrechnung SG->DSM" VALUE 0xC0A66 Kw_Wu16 7.999878 Fact 0.00 7.999878 FORMAT "%8.6" /end CHARACTERISTIC
/begin CHARACTERISTIC Sig_tiOprgnu16PFltCANOffset_C "offset for conversion ecu -> can for engine operation time since last successful regeneration, Conversion: tiSncergnRes" VALUE 0xC0A68 Kw_Ws16 65535.00 OneToOne -32768.00 32767.00 FORMAT "%8.2" /end CHARACTERISTIC
/begin CHARACTERISTIC Sig_tiOprgnu16PFltCANScale_C "Skalierung Umrechnung SG->CAN" VALUE 0xC0A6A Kw_Wu16 7.999878 Fact 0.00 7.999878 FORMAT "%8.6" /end CHARACTERISTIC
/begin CHARACTERISTIC Sig_tiOprgnu16PFltDIAOffset_C "offset for conversion ecu -> dia for engine operation time since last successful regeneration, Conversion: tiSncergnRes" VALUE 0xC0A6C Kw_Ws16 65535.00 OneToOne -32768.00 32767.00 FORMAT "%8.2" /end CHARACTERISTIC
/begin CHARACTERISTIC Sig_tiOprgnu16PFltDIAScale_C "Skalierung Umrechnung SG->DIA" VALUE 0xC0A6E Kw_Wu16 7.999878 Fact 0.00 7.999878 FORMAT "%8.6" /end CHARACTERISTIC
/begin CHARACTERISTIC Sig_tisDcDSMOffset_C "offset for conversion ecu -> dsm for time in s for DSM (delay driving cycle), Conversion: OneToOne" VALUE 0xC0A70 Kw_Ws16 65535.00 OneToOne -32768.00 32767.00 FORMAT "%8.2" /end CHARACTERISTIC
/begin CHARACTERISTIC Sig_tisDcDSMScale_C "scale factor for conversion ecu -> dsm for time in s for DSM (delay driving cycle), Conversion: OneToOne" VALUE 0xC0A72 Kw_Wu16 7.999878 Fact 0.00 7.999878 FORMAT "%8.6" /end CHARACTERISTIC
/begin CHARACTERISTIC Sig_tisDcCANOffset_C "offset for conversion ecu -> can for time in s for DSM (delay driving cycle), Conversion: OneToOne" VALUE 0xC0A74 Kw_Ws16 65535.00 OneToOne -32768.00 32767.00 FORMAT "%8.2" /end CHARACTERISTIC
/begin CHARACTERISTIC Sig_tisDcCANScale_C "scale factor for conversion ecu -> can for time in s for DSM (delay driving cycle), Conversion: OneToOne" VALUE 0xC0A76 Kw_Wu16 7.999878 Fact 0.00 7.999878 FORMAT "%8.6" /end CHARACTERISTIC
/begin CHARACTERISTIC Sig_tisDcDIAOffset_C "offset for conversion ecu -> dia for time in s for DSM (delay driving cycle), Conversion: OneToOne" VALUE 0xC0A78 Kw_Ws16 65535.00 OneToOne -32768.00 32767.00 FORMAT "%8.2" /end CHARACTERISTIC
/begin CHARACTERISTIC Sig_tisDcDIAScale_C "scale factor for conversion ecu -> dia for time in s for DSM (delay driving cycle), Conversion: OneToOne" VALUE 0xC0A7A Kw_Wu16 7.999878 Fact 0.00 7.999878 FORMAT "%8.6" /end CHARACTERISTIC
/begin CHARACTERISTIC Sig_tisDSMOffset_C "offset for conversion from ecu -> dsm" VALUE 0xC0A7C Kw_Ws16 65535.00 OneToOne -32768.00 32767.00 FORMAT "%8.2" /end CHARACTERISTIC
/begin CHARACTERISTIC Sig_tisDSMScale_C " scale factor for conversion from ecu -> dsm" VALUE 0xC0A7E Kw_Wu16 7.999878 Fact 0.00 7.999878 FORMAT "%8.6" /end CHARACTERISTIC
/begin CHARACTERISTIC Sig_tisCANOffset_C "offset for conversion from ecu -> can" VALUE 0xC0A80 Kw_Ws16 65535.00 OneToOne -32768.00 32767.00 FORMAT "%8.2" /end CHARACTERISTIC
/begin CHARACTERISTIC Sig_tisCANScale_C "scale factor for conversion from ecu -> can" VALUE 0xC0A82 Kw_Wu16 7.999878 Fact 0.00 7.999878 FORMAT "%8.6" /end CHARACTERISTIC
/begin CHARACTERISTIC Sig_tisDIAOffset_C "offset for conversion from ecu -> dia" VALUE 0xC0A84 Kw_Ws16 65535.00 OneToOne -32768.00 32767.00 FORMAT "%8.2" /end CHARACTERISTIC
/begin CHARACTERISTIC Sig_tisDIAScale_C "scale factor for conversion from ecu -> dia" VALUE 0xC0A86 Kw_Wu16 7.999878 Fact 0.00 7.999878 FORMAT "%8.6" /end CHARACTERISTIC
/begin CHARACTERISTIC Sig_trqPrpDSMOffset_C "Offset für Umrechnung SG->DSM für Antriebsmoment" VALUE 0xC0A88 Kw_Ws16 65535.00 OneToOne -32768.00 32767.00 FORMAT "%8.2" /end CHARACTERISTIC
/begin CHARACTERISTIC Sig_trqPrpDSMScale_C "Skalierung für Umrechnung SG->DSM für Antriebsmoment" VALUE 0xC0A8A Kw_Wu16 7.999878 Fact 0.00 7.999878 FORMAT "%8.6" /end CHARACTERISTIC
/begin CHARACTERISTIC Sig_trqPrpCANOffset_C "Offset für Umrechnung SG->CAN für Antriebsmoment" VALUE 0xC0A8C Kw_Ws16 65535.00 OneToOne -32768.00 32767.00 FORMAT "%8.2" /end CHARACTERISTIC
/begin CHARACTERISTIC Sig_trqPrpCANScale_C "Skalierung für Umrechnung SG->CAN für Antriebsmoment" VALUE 0xC0A8E Kw_Wu16 7.999878 Fact 0.00 7.999878 FORMAT "%8.6" /end CHARACTERISTIC
/begin CHARACTERISTIC Sig_trqPrpDIAOffset_C "Offset für Umrechnung SG->DIA für Antriebsmoment" VALUE 0xC0A90 Kw_Ws16 65535.00 OneToOne -32768.00 32767.00 FORMAT "%8.2" /end CHARACTERISTIC
/begin CHARACTERISTIC Sig_trqPrpDIAScale_C "Skalierung für Umrechnung SG->DIA für Antriebsmoment" VALUE 0xC0A92 Kw_Wu16 7.999878 Fact 0.00 7.999878 FORMAT "%8.6" /end CHARACTERISTIC
/begin CHARACTERISTIC Sig_trqDSMOffset_C "Offset Umrechung SG->DSM für Drehmoment" VALUE 0xC0A94 Kw_Ws16 65535.00 OneToOne -32768.00 32767.00 FORMAT "%8.2" /end CHARACTERISTIC
/begin CHARACTERISTIC Sig_trqDSMScale_C "Skalierung Umrechung SG->DSM für Drehmoment" VALUE 0xC0A96 Kw_Wu16 7.999878 Fact 0.00 7.999878 FORMAT "%8.6" /end CHARACTERISTIC
/begin CHARACTERISTIC Sig_trqCANOffset_C "Offset Umrechung SG->CAN für Drehmoment" VALUE 0xC0A98 Kw_Ws16 65535.00 OneToOne -32768.00 32767.00 FORMAT "%8.2" /end CHARACTERISTIC
/begin CHARACTERISTIC Sig_trqCANScale_C "Skalierung Umrechung SG->CAN für Drehmoment" VALUE 0xC0A9A Kw_Wu16 7.999878 Fact 0.00 7.999878 FORMAT "%8.6" /end CHARACTERISTIC
/begin CHARACTERISTIC Sig_trqDIAOffset_C "Offset Umrechung SG->Diagnoseschnittstelle für Drehmoment" VALUE 0xC0A9C Kw_Ws16 65535.00 OneToOne -32768.00 32767.00 FORMAT "%8.2" /end CHARACTERISTIC
/begin CHARACTERISTIC Sig_trqDIAScale_C "Skalierung Umrechung SG->Diagnoseschnittstelle für Drehmoment" VALUE 0xC0A9E Kw_Wu16 7.999878 Fact 0.00 7.999878 FORMAT "%8.6" /end CHARACTERISTIC
/begin CHARACTERISTIC Sig_TSwQ0p1DSMOffset_C "offset for conversion ecu -> dsm for k3-Conversion: Def_t_sw_q0p1" VALUE 0xC0AA0 Kw_Ws16 65535.00 OneToOne -32768.00 32767.00 FORMAT "%8.2" /end CHARACTERISTIC
/begin CHARACTERISTIC Sig_TSwQ0p1DSMScale_C "scale factor for conversion ecu -> dsm for k3-Conversion: Def_t_sw_q0p1" VALUE 0xC0AA2 Kw_Wu16 7.999878 Fact 0.00 7.999878 FORMAT "%8.6" /end CHARACTERISTIC
/begin CHARACTERISTIC Sig_TSwQ0p1CANOffset_C "offset for conversion ecu -> can for k3-Conversion: Def_t_sw_q0p1" VALUE 0xC0AA4 Kw_Ws16 65535.00 OneToOne -32768.00 32767.00 FORMAT "%8.2" /end CHARACTERISTIC
/begin CHARACTERISTIC Sig_TSwQ0p1CANScale_C "scale factor for conversion ecu -> can for k3-Conversion: Def_t_sw_q0p1" VALUE 0xC0AA6 Kw_Wu16 7.999878 Fact 0.00 7.999878 FORMAT "%8.6" /end CHARACTERISTIC
/begin CHARACTERISTIC Sig_TSwQ0p1DIAOffset_C "offset for conversion ecu -> dia for k3-Conversion: Def_t_sw_q0p1" VALUE 0xC0AA8 Kw_Ws16 65535.00 OneToOne -32768.00 32767.00 FORMAT "%8.2" /end CHARACTERISTIC
/begin CHARACTERISTIC Sig_TSwQ0p1DIAScale_C "scale factor for conversion ecu -> dia for k3-Conversion: Def_t_sw_q0p1" VALUE 0xC0AAA Kw_Wu16 7.999878 Fact 0.00 7.999878 FORMAT "%8.6" /end CHARACTERISTIC
/begin CHARACTERISTIC Sig_tDSMOffset_C "Offset Umrechung SG->DSM für Temperatur" VALUE 0xC0AAC Kw_Ws16 65535.00 OneToOne -32768.00 32767.00 FORMAT "%8.2" /end CHARACTERISTIC
/begin CHARACTERISTIC Sig_tDSMScale_C "Skalierung Umrechung SG->DSM für Temperatur" VALUE 0xC0AAE Kw_Wu16 7.999878 Fact 0.00 7.999878 FORMAT "%8.6" /end CHARACTERISTIC
/begin CHARACTERISTIC Sig_tCANOffset_C "Offset Umrechung SG->CAN für Temperatur" VALUE 0xC0AB0 Kw_Ws16 65535.00 OneToOne -32768.00 32767.00 FORMAT "%8.2" /end CHARACTERISTIC
/begin CHARACTERISTIC Sig_tCANScale_C "Skalierung Umrechung SG->CAN für Temperatur" VALUE 0xC0AB2 Kw_Wu16 7.999878 Fact 0.00 7.999878 FORMAT "%8.6" /end CHARACTERISTIC
/begin CHARACTERISTIC Sig_tDIAOffset_C "Offset Umrechung SG->Diagnoseschnittstelle für Temperatur" VALUE 0xC0AB4 Kw_Ws16 65535.00 OneToOne -32768.00 32767.00 FORMAT "%8.2" /end CHARACTERISTIC
/begin CHARACTERISTIC Sig_tDIAScale_C "Skalierung Umrechung SG->Diagnoseschnittstelle für Temperatur" VALUE 0xC0AB6 Kw_Wu16 7.999878 Fact 0.00 7.999878 FORMAT "%8.6" /end CHARACTERISTIC
/begin CHARACTERISTIC Sig_uBattDSMOffset_C "Offset fuer Umrechung SG->DSM fuer Batteriespannung" VALUE 0xC0AB8 Kw_Ws16 65535.00 OneToOne -32768.00 32767.00 FORMAT "%8.2" /end CHARACTERISTIC
/begin CHARACTERISTIC Sig_uBattDSMScale_C "Skalierung Umrechungs Faktor SG->DSM fuer Batteriespannung" VALUE 0xC0ABA Kw_Wu16 7.999878 Fact 0.00 7.999878 FORMAT "%8.6" /end CHARACTERISTIC
/begin CHARACTERISTIC Sig_uBattCANOffset_C "Offset fuer Umrechung SG->CAN fuer Batteriespannung" VALUE 0xC0ABC Kw_Ws16 65535.00 OneToOne -32768.00 32767.00 FORMAT "%8.2" /end CHARACTERISTIC
/begin CHARACTERISTIC Sig_uBattCANScale_C "Skalierung Umrechungs Faktor SG->CAN fuer Batteriespannung" VALUE 0xC0ABE Kw_Wu16 7.999878 Fact 0.00 7.999878 FORMAT "%8.6" /end CHARACTERISTIC
/begin CHARACTERISTIC Sig_uBattDIAOffset_C "Offset fuer Umrechung SG->DIA fuer Batteriespannung" VALUE 0xC0AC0 Kw_Ws16 65535.00 OneToOne -32768.00 32767.00 FORMAT "%8.2" /end CHARACTERISTIC
/begin CHARACTERISTIC Sig_uBattDIAScale_C "Skalierung Umrechungs Faktor SG->DIA fuer Batteriespannung" VALUE 0xC0AC2 Kw_Wu16 7.999878 Fact 0.00 7.999878 FORMAT "%8.6" /end CHARACTERISTIC
/begin CHARACTERISTIC Sig_UUwQ0p1DSMOffset_C "offset for conversion ecu -> dsm for k3-Conversion Def_u_uw_q0p1" VALUE 0xC0AC4 Kw_Ws16 65535.00 OneToOne -32768.00 32767.00 FORMAT "%8.2" /end CHARACTERISTIC
/begin CHARACTERISTIC Sig_UUwQ0p1DSMScale_C "scale factor for conversion ecu -> dsm for k3-Conversion Def_u_uw_q0p1" VALUE 0xC0AC6 Kw_Wu16 7.999878 Fact 0.00 7.999878 FORMAT "%8.6" /end CHARACTERISTIC
/begin CHARACTERISTIC Sig_UUwQ0p1CANOffset_C "offset for conversion ecu -> can for k3-Conversion Def_u_uw_q0p1" VALUE 0xC0AC8 Kw_Ws16 65535.00 OneToOne -32768.00 32767.00 FORMAT "%8.2" /end CHARACTERISTIC
/begin CHARACTERISTIC Sig_UUwQ0p1CANScale_C "scale factor for conversion ecu -> can for k3-Conversion Def_u_uw_q0p1" VALUE 0xC0ACA Kw_Wu16 7.999878 Fact 0.00 7.999878 FORMAT "%8.6" /end CHARACTERISTIC
/begin CHARACTERISTIC Sig_UUwQ0p1DIAOffset_C "offset for conversion ecu -> dia for k3-Conversion Def_u_uw_q0p1" VALUE 0xC0ACC Kw_Ws16 65535.00 OneToOne -32768.00 32767.00 FORMAT "%8.2" /end CHARACTERISTIC
/begin CHARACTERISTIC Sig_UUwQ0p1DIAScale_C "scale factor for conversion ecu -> dia for k3-Conversion Def_u_uw_q0p1" VALUE 0xC0ACE Kw_Wu16 7.999878 Fact 0.00 7.999878 FORMAT "%8.6" /end CHARACTERISTIC
/begin CHARACTERISTIC Sig_UUwQ0p25em3DSMOffset_C "offset for conversion ecu -> dsm for k3-Conversion Def_u_uw_q0p25em3_o6" VALUE 0xC0AD0 Kw_Ws16 65535.00 OneToOne -32768.00 32767.00 FORMAT "%8.2" /end CHARACTERISTIC
/begin CHARACTERISTIC Sig_UUwQ0p25em3DSMScale_C "scale factor for conversion ecu -> dsm for k3-Conversion Def_u_uw_q0p25em3_o6" VALUE 0xC0AD2 Kw_Wu16 7.999878 Fact 0.00 7.999878 FORMAT "%8.6" /end CHARACTERISTIC
/begin CHARACTERISTIC Sig_UUwQ0p25em3CANOffset_C "offset for conversion ecu -> can for k3-Conversion Def_u_uw_q0p25em3_o6" VALUE 0xC0AD4 Kw_Ws16 65535.00 OneToOne -32768.00 32767.00 FORMAT "%8.2" /end CHARACTERISTIC
/begin CHARACTERISTIC Sig_UUwQ0p25em3CANScale_C "scale factor for conversion ecu -> can for k3-Conversion Def_u_uw_q0p25em3_o6" VALUE 0xC0AD6 Kw_Wu16 7.999878 Fact 0.00 7.999878 FORMAT "%8.6" /end CHARACTERISTIC
/begin CHARACTERISTIC Sig_UUwQ0p25em3DIAOffset_C "offset for conversion ecu -> dia for k3-Conversion Def_u_uw_q0p25em3_o6" VALUE 0xC0AD8 Kw_Ws16 65535.00 OneToOne -32768.00 32767.00 FORMAT "%8.2" /end CHARACTERISTIC
/begin CHARACTERISTIC Sig_UUwQ0p25em3DIAScale_C "scale factor for conversion ecu -> dia for k3-Conversion Def_u_uw_q0p25em3_o6" VALUE 0xC0ADA Kw_Wu16 7.999878 Fact 0.00 7.999878 FORMAT "%8.6" /end CHARACTERISTIC
/begin CHARACTERISTIC Sig_uDSMOffset_C "Offset Umrechung SG->DSM für Spannung" VALUE 0xC0ADC Kw_Ws16 65535.00 OneToOne -32768.00 32767.00 FORMAT "%8.2" /end CHARACTERISTIC
/begin CHARACTERISTIC Sig_uDSMScale_C "Skalierung Umrechung SG->DSM für Spannungen" VALUE 0xC0ADE Kw_Wu16 7.999878 Fact 0.00 7.999878 FORMAT "%8.6" /end CHARACTERISTIC
/begin CHARACTERISTIC Sig_uCANOffset_C "Offset Umrechung SG->CAN für Spannung" VALUE 0xC0AE0 Kw_Ws16 65535.00 OneToOne -32768.00 32767.00 FORMAT "%8.2" /end CHARACTERISTIC
/begin CHARACTERISTIC Sig_uCANScale_C "Skalierung Umrechung SG->CAN für Spannung" VALUE 0xC0AE2 Kw_Wu16 7.999878 Fact 0.00 7.999878 FORMAT "%8.6" /end CHARACTERISTIC
/begin CHARACTERISTIC Sig_uDIAOffset_C "Offset Umrechung SG->Diagnoseschnittstelle für Spannung" VALUE 0xC0AE4 Kw_Ws16 65535.00 OneToOne -32768.00 32767.00 FORMAT "%8.2" /end CHARACTERISTIC
/begin CHARACTERISTIC Sig_uDIAScale_C "Skalierung Umrechung SG->Diagnoseschnittstelle für Spannung" VALUE 0xC0AE6 Kw_Wu16 7.999878 Fact 0.00 7.999878 FORMAT "%8.6" /end CHARACTERISTIC
/begin CHARACTERISTIC Sig_volphDSMOffset_C "Offset für Umrechnung SG->DSM für Kubikmeter pro Stunde" VALUE 0xC0AE8 Kw_Ws16 65535.00 OneToOne -32768.00 32767.00 FORMAT "%8.2" /end CHARACTERISTIC
/begin CHARACTERISTIC Sig_volphDSMScale_C "Skalierung Umrechung SG->DSM für Kubikmeter pro Stunde" VALUE 0xC0AEA Kw_Wu16 7.999878 Fact 0.00 7.999878 FORMAT "%8.6" /end CHARACTERISTIC
/begin CHARACTERISTIC Sig_volphCANOffset_C "Offset für Umrechnung SG->CAN für Kubikmeter pro Stunde" VALUE 0xC0AEC Kw_Ws16 65535.00 OneToOne -32768.00 32767.00 FORMAT "%8.2" /end CHARACTERISTIC
/begin CHARACTERISTIC Sig_volphCANScale_C "Skalierung Umrechung SG->CAN für Kubikmeter pro Stunde" VALUE 0xC0AEE Kw_Wu16 7.999878 Fact 0.00 7.999878 FORMAT "%8.6" /end CHARACTERISTIC
/begin CHARACTERISTIC Sig_volphDIAOffset_C "Offset für Umrechnung SG->Diagnoseschnittstelle für Kubikmeter pro Stunde" VALUE 0xC0AF0 Kw_Ws16 65535.00 OneToOne -32768.00 32767.00 FORMAT "%8.2" /end CHARACTERISTIC
/begin CHARACTERISTIC Sig_volphDIAScale_C "Skalierung Umrechung SG->Diagnoseschnittstelle für Kubikmeter pro Stunde" VALUE 0xC0AF2 Kw_Wu16 7.999878 Fact 0.00 7.999878 FORMAT "%8.6" /end CHARACTERISTIC
/begin CHARACTERISTIC Sig_volRailDSMOffset_C "Offset für Umrechnung SG->DSM für Volumen (Rail)" VALUE 0xC0AF4 Kw_Ws16 65535.00 OneToOne -32768.00 32767.00 FORMAT "%8.2" /end CHARACTERISTIC
/begin CHARACTERISTIC Sig_volRailDSMScale_C "Skalierung Umrechung SG->DSM für Volumen (Rail)" VALUE 0xC0AF6 Kw_Wu16 7.999878 Fact 0.00 7.999878 FORMAT "%8.6" /end CHARACTERISTIC
/begin CHARACTERISTIC Sig_volRailCANOffset_C "Offset für Umrechnung SG->CAN für Volumen (Rail)" VALUE 0xC0AF8 Kw_Ws16 65535.00 OneToOne -32768.00 32767.00 FORMAT "%8.2" /end CHARACTERISTIC
/begin CHARACTERISTIC Sig_volRailCANScale_C "Skalierung Umrechung SG->CAN für Volumen (Rail)" VALUE 0xC0AFA Kw_Wu16 7.999878 Fact 0.00 7.999878 FORMAT "%8.6" /end CHARACTERISTIC
/begin CHARACTERISTIC Sig_volRailDIAOffset_C "Offset für Umrechnung SG->Diagnoseschnittstelle für Volumen (Rail)" VALUE 0xC0AFC Kw_Ws16 65535.00 OneToOne -32768.00 32767.00 FORMAT "%8.2" /end CHARACTERISTIC
/begin CHARACTERISTIC Sig_volRailDIAScale_C "Skalierung Umrechung SG->Diagnoseschnittstelle für Volumen (Rail)" VALUE 0xC0AFE Kw_Wu16 7.999878 Fact 0.00 7.999878 FORMAT "%8.6" /end CHARACTERISTIC
/begin CHARACTERISTIC Sig_volDSMOffset_C "Offset Umrechnung der Volumsmenge SG -> DSM" VALUE 0xC0B00 Kw_Ws16 65535.00 OneToOne -32768.00 32767.00 FORMAT "%8.2" /end CHARACTERISTIC
/begin CHARACTERISTIC Sig_volDSMScale_C "Skalierung Umrechnung der Volumsmenge SG -> DSM" VALUE 0xC0B02 Kw_Wu16 7.999878 Fact 0.00 7.999878 FORMAT "%8.6" /end CHARACTERISTIC
/begin CHARACTERISTIC Sig_volCANOffset_C "Offset Umrechnung der Volumsmenge SG -> CAN" VALUE 0xC0B04 Kw_Ws16 65535.00 OneToOne -32768.00 32767.00 FORMAT "%8.2" /end CHARACTERISTIC
/begin CHARACTERISTIC Sig_volCANScale_C "Skalierung Umrechnung der Volumsmenge SG -> CAN" VALUE 0xC0B06 Kw_Wu16 7.999878 Fact 0.00 7.999878 FORMAT "%8.6" /end CHARACTERISTIC
/begin CHARACTERISTIC Sig_volDIAOffset_C "Offset Umrechnung der Volumsmenge SG -> DIA" VALUE 0xC0B08 Kw_Ws16 65535.00 OneToOne -32768.00 32767.00 FORMAT "%8.2" /end CHARACTERISTIC
/begin CHARACTERISTIC Sig_volDIAScale_C "Skalierung Umrechnung der Volumsmenge SG -> DIA" VALUE 0xC0B0A Kw_Wu16 7.999878 Fact 0.00 7.999878 FORMAT "%8.6" /end CHARACTERISTIC
/begin CHARACTERISTIC Sig_vDSMOffset_C "Offset Umrechung SG->DSM für Fahrgeschwindigkeit" VALUE 0xC0B0C Kw_Ws16 65535.00 OneToOne -32768.00 32767.00 FORMAT "%8.2" /end CHARACTERISTIC
/begin CHARACTERISTIC Sig_vDSMScale_C "Skalierung Umrechung SG->DSM für Fahrgeschwindigkeit" VALUE 0xC0B0E Kw_Wu16 7.999878 Fact 0.00 7.999878 FORMAT "%8.6" /end CHARACTERISTIC
/begin CHARACTERISTIC Sig_vCANOffset_C "Offset Umrechung SG->CAN für Fahrgeschwindigkeit" VALUE 0xC0B10 Kw_Ws16 65535.00 OneToOne -32768.00 32767.00 FORMAT "%8.2" /end CHARACTERISTIC
/begin CHARACTERISTIC Sig_vCANScale_C "Skalierung Umrechung SG->CAN für Fahrgeschwindigkeit" VALUE 0xC0B12 Kw_Wu16 7.999878 Fact 0.00 7.999878 FORMAT "%8.6" /end CHARACTERISTIC
/begin CHARACTERISTIC Sig_vDIAOffset_C "Offset Umrechung SG->Diagnoseschnittstelle für Fahrgeschwindigkeit" VALUE 0xC0B14 Kw_Ws16 65535.00 OneToOne -32768.00 32767.00 FORMAT "%8.2" /end CHARACTERISTIC
/begin CHARACTERISTIC Sig_vDIAScale_C "Skalierung Umrechung SG->Diagnoseschnittstelle für Fahrgeschwindigkeit" VALUE 0xC0B16 Kw_Wu16 7.999878 Fact 0.00 7.999878 FORMAT "%8.6" /end CHARACTERISTIC
/begin CHARACTERISTIC SOPTst_stRcyDem_C "#SSD Applizierbares Label, ob Recovery bei fehlerhaftem Abschaltpfadtest ausgelöst werden soll" VALUE 0xEE7B1 Kw_Wu8 1.000 OneToOne 0.00 1.000 FORMAT "%5.3" EXTENDED_LIMITS 0.00 255.0 /end CHARACTERISTIC
/begin CHARACTERISTIC SOPTst_stShOffPathActv_C "#SSD aktive Abschaltpfade während der Initialisierung" VALUE 0xEE7B2 Kw_Wu8 255.0 OneToOne 0.00 255.0 FORMAT "%5.1" /end CHARACTERISTIC
/begin CHARACTERISTIC SPMon_swtRstStackMon_C "Schalter zum Rücksetzen der Überwachung des maximal benötigten Stacks (1: Stack Überwachung rückgesetzt, 0: nicht Rückgesetzt)" VALUE 0xEE7B3 Kw_Wu8 1.000 OneToOne 0.00 1.000 FORMAT "%5.3" EXTENDED_LIMITS 0.00 255.0 /end CHARACTERISTIC
/begin CHARACTERISTIC SrvPmp_facSTWAV_CUR "Korrekturkennlinie (Geschwindigkeit Lenkradwinkel) für den Momentenwunsch der Servopumpe" CURVE 0xEE7B4 Kl_Xs16_Ws16 10.00000 Fact 0.00 10.00000 FORMAT "%8.5" EXTENDED_LIMITS -4.000000 3.999878
 /begin AXIS_DESCR STD_AXIS SrvPmp_dphiStrg_mp AngleGradPerSec 7 -180.0192 180.0192 FORMAT "%8.4" EXTENDED_LIMITS -1440.154 1440.110 DEPOSIT ABSOLUTE /end AXIS_DESCR
/end CHARACTERISTIC
/begin CHARACTERISTIC SrvPmp_facVS_CUR "Korrekturkennlinie (Geschwindigkeit) für den Momentenwunsch der Servopumpe" CURVE 0xEE7D2 Kl_Xs16_Ws16 10.00000 Fact 0.00 10.00000 FORMAT "%8.5" EXTENDED_LIMITS -4.000000 3.999878
 /begin AXIS_DESCR STD_AXIS VSSCD_v Vel 7 0.00 300.0000 FORMAT "%8.4" EXTENDED_LIMITS -327.6800 327.6700 DEPOSIT ABSOLUTE /end AXIS_DESCR
/end CHARACTERISTIC
/begin CHARACTERISTIC SrvPmp_rTrans_C "Transmission ratio of SrvPmp" VALUE 0xEE7F0 Kw_Ws16 200.0000 TransR 0.00 200.0000 FORMAT "%8.4" EXTENDED_LIMITS -327.6800 327.6700 /end CHARACTERISTIC
/begin CHARACTERISTIC SrvPmp_trqSTWABase_CUR "Basiskennlinie für dem Momentenwunsch der Servopumpe" CURVE 0xEE7F2 Kl_Xs16_Ws16 1500.000 Trq -500.0000 1000.000 FORMAT "%8.3" EXTENDED_LIMITS -3276.800 3276.700
 /begin AXIS_DESCR STD_AXIS FrmMng_phiStrg AngleGrad 7 -180.0192 180.0192 FORMAT "%8.4" EXTENDED_LIMITS -1440.154 1440.110 DEPOSIT ABSOLUTE /end AXIS_DESCR
/end CHARACTERISTIC
/begin CHARACTERISTIC SSpMon_DebSRCHighSplyVltgDef1_C "#SSD Fehlerentprellung SRC High für Sensorversorgungsspannung 1" VALUE 0xEE810 Kw_Wu16 655350.0 Time_ms 0.00 655350.0 FORMAT "%8.1" /end CHARACTERISTIC
/begin CHARACTERISTIC SSpMon_DebSRCHighSplyVltgOk1_C "#SSD Heilungsentprellung SRC High für Sensorversorgungsspannung 1" VALUE 0xEE812 Kw_Wu16 655350.0 Time_ms 0.00 655350.0 FORMAT "%8.1" /end CHARACTERISTIC
/begin CHARACTERISTIC SSpMon_DebSRCHighSplyVltgDef2_C "#SSD Fehlerentprellung SRC High für Sensorversorgungsspannung 2" VALUE 0xEE814 Kw_Wu16 655350.0 Time_ms 0.00 655350.0 FORMAT "%8.1" /end CHARACTERISTIC
/begin CHARACTERISTIC SSpMon_DebSRCHighSplyVltgOk2_C "#SSD Heilungsentprellung SRC High für Sensorversorgungsspannung 2" VALUE 0xEE816 Kw_Wu16 655350.0 Time_ms 0.00 655350.0 FORMAT "%8.1" /end CHARACTERISTIC
/begin CHARACTERISTIC SSpMon_DebSRCHighSplyVltgDef3_C "#SSD Fehlerentprellung SRC High für Sensorversorgungsspannung 3" VALUE 0xEE818 Kw_Wu16 655350.0 Time_ms 0.00 655350.0 FORMAT "%8.1" /end CHARACTERISTIC
/begin CHARACTERISTIC SSpMon_DebSRCHighSplyVltgOk3_C "#SSD Heilungsentprellung SRC High für Sensorversorgungsspannung 3" VALUE 0xEE81A Kw_Wu16 655350.0 Time_ms 0.00 655350.0 FORMAT "%8.1" /end CHARACTERISTIC
/begin CHARACTERISTIC SSpMon_DebSRCLowSplyVltgDef1_C "#SSD Defektentprellung SRC Low für Sensorversorgungsspannung 1" VALUE 0xEE81C Kw_Wu16 655350.0 Time_ms 0.00 655350.0 FORMAT "%8.1" /end CHARACTERISTIC
/begin CHARACTERISTIC SSpMon_DebSRCLowSplyVltgOk1_C "#SSD Heilungsentprellung SRC Low für Sensorversorgungsspannung 1" VALUE 0xEE81E Kw_Wu16 655350.0 Time_ms 0.00 655350.0 FORMAT "%8.1" /end CHARACTERISTIC
/begin CHARACTERISTIC SSpMon_DebSRCLowSplyVltgDef2_C "#SSD Defektentprellung SRC Low für Sensorversorgungsspannung 2" VALUE 0xEE820 Kw_Wu16 655350.0 Time_ms 0.00 655350.0 FORMAT "%8.1" /end CHARACTERISTIC
/begin CHARACTERISTIC SSpMon_DebSRCLowSplyVltgOk2_C "#SSD Heilungsentprellung SRC Low für Sensorversorgungsspannung 2" VALUE 0xEE822 Kw_Wu16 655350.0 Time_ms 0.00 655350.0 FORMAT "%8.1" /end CHARACTERISTIC
/begin CHARACTERISTIC SSpMon_DebSRCLowSplyVltgDef3_C "#SSD Defektentprellung SRC Low für Sensorversorgungsspannung 3" VALUE 0xEE824 Kw_Wu16 655350.0 Time_ms 0.00 655350.0 FORMAT "%8.1" /end CHARACTERISTIC
/begin CHARACTERISTIC SSpMon_DebSRCLowSplyVltgOk3_C "#SSD Heilungsentprellung SRC Low für Sensorversorgungsspannung 3" VALUE 0xEE826 Kw_Wu16 655350.0 Time_ms 0.00 655350.0 FORMAT "%8.1" /end CHARACTERISTIC
/begin CHARACTERISTIC SSpMon_numDiaVltg1_C "#SSD Applikationsparameter für diagnose Signal von Sensorversorgungsspannung 1" VALUE 0xEE828 Kw_Wu8 27.0000000000 NumPinDia 0.00 27.0000000000 FORMAT "%13.10" /end CHARACTERISTIC
/begin CHARACTERISTIC SSpMon_numDiaVltg2_C "#SSD Applikationsparameter für diagnose Signal von Sensorversorgungsspannung 2" VALUE 0xEE829 Kw_Wu8 27.0000000000 NumPinDia 0.00 27.0000000000 FORMAT "%13.10" /end CHARACTERISTIC
/begin CHARACTERISTIC SSpMon_numDiaVltg3_C "#SSD Applikationsparameter für diagnose Signal von Sensorversorgungsspannung 3" VALUE 0xEE82A Kw_Wu8 27.0000000000 NumPinDia 0.00 27.0000000000 FORMAT "%13.10" /end CHARACTERISTIC
/begin CHARACTERISTIC StrtCD_ActrDebExcTempDef_C "Fehlerentprellzeit für Übertemperatur" VALUE 0xEE82C Kw_Wu16 655350.0 Time_ms 0.00 655350.0 FORMAT "%8.1" /end CHARACTERISTIC
/begin CHARACTERISTIC StrtCD_ActrDebExcTempOk_C "Fehlerheilzeit für Übertemperatur" VALUE 0xEE82E Kw_Wu16 655350.0 Time_ms 0.00 655350.0 FORMAT "%8.1" /end CHARACTERISTIC
/begin CHARACTERISTIC StrtCD_ActrDebNoLoadDef_C "Fehlerentprellzeit für Drahtbruch" VALUE 0xEE830 Kw_Wu16 655350.0 Time_ms 0.00 655350.0 FORMAT "%8.1" /end CHARACTERISTIC
/begin CHARACTERISTIC StrtCD_ActrDebNoLoadOk_C "Fehlerheilzeit für Drahtbruch" VALUE 0xEE832 Kw_Wu16 655350.0 Time_ms 0.00 655350.0 FORMAT "%8.1" /end CHARACTERISTIC
/begin CHARACTERISTIC StrtCD_ActrDebShrtCBatDef_C "Fehlerentprellzeit KS nach U_Batt" VALUE 0xEE834 Kw_Wu16 655350.0 Time_ms 0.00 655350.0 FORMAT "%8.1" /end CHARACTERISTIC
/begin CHARACTERISTIC StrtCD_ActrDebShrtCBatOk_C "Fehlerheilzeit KS nach U_Batt" VALUE 0xEE836 Kw_Wu16 655350.0 Time_ms 0.00 655350.0 FORMAT "%8.1" /end CHARACTERISTIC
/begin CHARACTERISTIC StrtCD_ActrDebShrtCGndDef_C "Fehlerentprellzeit KS nach Gnd" VALUE 0xEE838 Kw_Wu16 655350.0 Time_ms 0.00 655350.0 FORMAT "%8.1" /end CHARACTERISTIC
/begin CHARACTERISTIC StrtCD_ActrDebShrtCGndOk_C "Fehlerheilzeit KS nach Gnd" VALUE 0xEE83A Kw_Wu16 655350.0 Time_ms 0.00 655350.0 FORMAT "%8.1" /end CHARACTERISTIC
/begin CHARACTERISTIC StrtCD_ctPwrStgOnMax_C "Maximaler Zähler für Powerstage On im Fehlerfall" VALUE 0xEE83C Kw_Wu16 65535.00 OneToOne 0.00 65535.00 FORMAT "%8.2" /end CHARACTERISTIC
/begin CHARACTERISTIC StrtCD_numDia_C "#SSD Auswahl des Diagnosesignals der Startrelayendstufe" VALUE 0xEE83E Kw_Wu8 27.0000000000 NumPinDia 0.00 27.0000000000 FORMAT "%13.10" /end CHARACTERISTIC
/begin CHARACTERISTIC StrtCD_numDioOut_C "#SSD Auswahl des Digitalausgangspins für Starterrelay" VALUE 0xEE83F Kw_Wu8 11.0000000000 NumPinDioOut 0.00 11.0000000000 FORMAT "%13.10" /end CHARACTERISTIC
/begin CHARACTERISTIC StrtCD_stActrInvOut_C "invertiere Starter Relais Steller Ausgang" VALUE 0xEE840 Kw_Wu8 1.000 OneToOne 0.00 1.000 FORMAT "%5.3" EXTENDED_LIMITS 0.00 255.0 /end CHARACTERISTIC
/begin CHARACTERISTIC StrtCD_stPwrStgActrActv_C "Statuswort für Endstufenabschaltung durch den Motorkoordinator" VALUE 0xEE841 Kw_Wu8 255.0 OneToOne 0.00 255.0 FORMAT "%5.1" /end CHARACTERISTIC
/begin CHARACTERISTIC StrtCD_stPwrStgActrDia_C "Statuswort für Endstufendiagnoseabschaltung durch den Motorkoordinator" VALUE 0xEE842 Kw_Wu8 254.0 OneToOne 1.000 255.0 FORMAT "%5.1" EXTENDED_LIMITS 0.00 255.0 /end CHARACTERISTIC
/begin CHARACTERISTIC StrtCD_stSPICtl_C "Schalter ob Endstufe SPI kontrollierbar = 1 oder nicht SPI kontrollierbar = 0" VALUE 0xEE843 Kw_Wu8 1.000 OneToOne 0.00 1.000 FORMAT "%5.3" EXTENDED_LIMITS 0.00 255.0 /end CHARACTERISTIC
/begin CHARACTERISTIC StrtCD_tiBtwTst_C "Zeitabstand, in dem die Endstufe im Fehlerfall getestet wird" VALUE 0xEE844 Kw_Wu16 29980.00 Time_ms 20.00000 30000.00 FORMAT "%8.2" EXTENDED_LIMITS 0.00 655350.0 /end CHARACTERISTIC
/begin CHARACTERISTIC StrtCD_tiPwrStgOn_C "Zeit für welche die Endstufe im Fehlerfall eingeschalten wird (nur nicht SPI kontrolliert)" VALUE 0xEE846 Kw_Wu16 655140.0 Time_ms 0.00 655140.0 FORMAT "%8.1" EXTENDED_LIMITS 0.00 655350.0 /end CHARACTERISTIC
/begin CHARACTERISTIC StSys_DebTrqShutOffDef_C "Fehlerentprellzeit T50shutoff" VALUE 0xEEB68 Kw_Wu16 655350.0 Time_ms 0.00 655350.0 FORMAT "%8.1" /end CHARACTERISTIC
/begin CHARACTERISTIC StSys_DebTrqShutOffOk_C "Heilungsentprellzeit T50shutoff" VALUE 0xEEB6A Kw_Wu16 655350.0 Time_ms 0.00 655350.0 FORMAT "%8.1" /end CHARACTERISTIC
/begin CHARACTERISTIC StSys_facAPSCor_CUR "atmospheric pressure correction factor" CURVE 0xEE84C Kl_Xs16_Ws16 4.000000 Fact 0.00 4.000000 FORMAT "%8.6" EXTENDED_LIMITS -4.000000 3.999878
 /begin AXIS_DESCR STD_AXIS APSCD_pVal Pres_hPa 8 0.00 4000.000 FORMAT "%8.3" EXTENDED_LIMITS -32768.00 32767.00 DEPOSIT ABSOLUTE /end AXIS_DESCR
/end CHARACTERISTIC
/begin CHARACTERISTIC StSys_n2MsWhlLoLim_C "untere kritische Drehzahlgrenze (ZMS-Resonanz)" VALUE 0xEEB74 Kw_Ws16 1000.000 EngN 0.00 1000.000 FORMAT "%8.3" EXTENDED_LIMITS -32768.00 32767.00 /end CHARACTERISTIC
/begin CHARACTERISTIC StSys_n2MsWhlUpOfs_C "Offset for starting trq shutoff" VALUE 0xEEB76 Kw_Ws16 1000.000 EngN 0.00 1000.000 FORMAT "%8.3" EXTENDED_LIMITS -32768.00 32767.00 /end CHARACTERISTIC
/begin CHARACTERISTIC StSys_nAdjMax_C "#SSD Abgleichende-Drehzahl" VALUE 0xEE9BC Kw_Ws16 65535.00 EngN -32768.00 32767.00 FORMAT "%8.2" /end CHARACTERISTIC
/begin CHARACTERISTIC StSys_nDiseng_C "Anlasserabwurfdrehzahlschwelle" VALUE 0xEEA8A Kw_Ws16 6000.000 EngN 0.00 6000.000 FORMAT "%8.3" EXTENDED_LIMITS -32768.00 32767.00 /end CHARACTERISTIC
/begin CHARACTERISTIC StSys_nEngage_C "Anlassereinspurdrehzahlschwelle" VALUE 0xEEA8C Kw_Ws16 0.00 EngN 0.00 0.00 FORMAT "%8.2" EXTENDED_LIMITS -32768.00 32767.00 /end CHARACTERISTIC
/begin CHARACTERISTIC StSys_tinFltPT1_C "time constant for the engine speed low pass filter" VALUE 0xEEB78 Kw_Wu32 4294.9673 TimeDelay_s 0.0000010000000 4294.9673 FORMAT "%9.4" /end CHARACTERISTIC
/begin CHARACTERISTIC StSys_nFreezeTrqRmp_C "Rampenbegrenzungsdrehzahl" VALUE 0xEEA94 Kw_Ws16 65535.00 EngN -32768.00 32767.00 FORMAT "%8.2" /end CHARACTERISTIC
/begin CHARACTERISTIC StSys_nReleaseTrqRmp_C "Rampenfreigabedrehzahl" VALUE 0xEEA96 Kw_Ws16 65535.00 EngN -32768.00 32767.00 FORMAT "%8.2" /end CHARACTERISTIC
/begin CHARACTERISTIC StSys_nStarter_C "maximale Drehzahl für Start ohne Kl50" VALUE 0xEEB6C Kw_Ws16 6000.000 EngN 0.00 6000.000 FORMAT "%8.3" EXTENDED_LIMITS -32768.00 32767.00 /end CHARACTERISTIC
/begin CHARACTERISTIC StSys_nStrtCutOut_MAP "Kennfeld zur Bestimmung der Startabwurf-Drehzahl" MAP 0xEE914 Kf_Xs16_Ys16_Ws16 6000.000 EngN 0.00 6000.000 FORMAT "%8.3" EXTENDED_LIMITS -32768.00 32767.00
 /begin AXIS_DESCR STD_AXIS StSys_tStrt_mp Temp_Cels 8 -50.14000 899.8600 FORMAT "%8.4" EXTENDED_LIMITS -3549.940 3003.560 DEPOSIT ABSOLUTE /end AXIS_DESCR
 /begin AXIS_DESCR STD_AXIS APSCD_pVal Pres_hPa 8 0.00 3500.000 FORMAT "%8.3" EXTENDED_LIMITS -32768.00 32767.00 DEPOSIT ABSOLUTE /end AXIS_DESCR
/end CHARACTERISTIC
/begin CHARACTERISTIC StSys_nStrtTipMax_MAP "Kennfeld zur bestimmung der Maximalen Startabwurfsdrehzahl - abhängig von der Kühlmitteltemperatur und dem Luftdruck" MAP 0xEEAB8 Kf_Xs16_Ys16_Ws16 6000.000 EngN 0.00 6000.000 FORMAT "%8.3" EXTENDED_LIMITS -32768.00 32767.00
 /begin AXIS_DESCR STD_AXIS Eng_tEng Temp_Cels 8 -50.1400 899.8600 FORMAT "%8.4" EXTENDED_LIMITS -3549.940 3003.560 DEPOSIT ABSOLUTE /end AXIS_DESCR
 /begin AXIS_DESCR STD_AXIS APSCD_pVal Pres_hPa 8 0.00 3500.000 FORMAT "%8.3" EXTENDED_LIMITS -32768.00 32767.00 DEPOSIT ABSOLUTE /end AXIS_DESCR
/end CHARACTERISTIC
/begin CHARACTERISTIC StSys_nStrtTipProtCaS_C "Schwellenwert für Nockenwellensignal für Aktivierung des Blockierschutzes" VALUE 0xEEB5C Kw_Ws16 6000.000 EngN 0.00 6000.000 FORMAT "%8.3" EXTENDED_LIMITS -32768.00 32767.00 /end CHARACTERISTIC
/begin CHARACTERISTIC StSys_nStrtTipProt_C "Drehzahlschwelle für Blockierschutz" VALUE 0xEEB5E Kw_Ws16 6000.000 EngN 0.00 6000.000 FORMAT "%8.3" EXTENDED_LIMITS -32768.00 32767.00 /end CHARACTERISTIC
/begin CHARACTERISTIC StSys_numStrtAddCor_C "Selection of used engine temperature (e.g. CTSCD_tClnt, etc.)" VALUE 0xEE86E Kw_Wu8 2.00000000000 EngTempFldSel 0.00 2.00000000000 FORMAT "%13.11" /end CHARACTERISTIC
/begin CHARACTERISTIC StSys_numStrtRmp_C "Parameter um die gewünschte Motortemperatur aus dem Motortemperatur-Feld Eng_tFld  zu selektieren" VALUE 0xEEA98 Kw_Wu8 2.00000000000 EngTempFldSel 0.00 2.00000000000 FORMAT "%13.11" /end CHARACTERISTIC
/begin CHARACTERISTIC StSys_numStrt_C "Parameter um die Motortemperatur für den Startabwurf aus dem Motortemperatur-Feld Eng_tFld  zu selektieren" VALUE 0xEE9B8 Kw_Wu8 2.00000000000 EngTempFldSel 0.00 2.00000000000 FORMAT "%13.11" /end CHARACTERISTIC
/begin CHARACTERISTIC Stsys_swtGlwLamp_C "Schalter für Anlasserfreigabe T50 mit Status Glühanzeige (1...glow controll berücksichtigt, 0...Freigabe nur von T50 abhängig)" VALUE 0xEEA8E Kw_Wu8 1.000 OneToOne 0.00 1.000 FORMAT "%5.3" EXTENDED_LIMITS 0.00 255.0 /end CHARACTERISTIC
/begin CHARACTERISTIC StSys_swtShOffGearbxRec_C "Schalter für Aktivierung und Deaktivierung der P/N Erkennung (1: keine Erkennung --> Freigabe, 0: Erkennung)" VALUE 0xEEB60 Kw_Wu8 1.000 OneToOne 0.00 1.000 FORMAT "%5.3" EXTENDED_LIMITS 0.00 255.0 /end CHARACTERISTIC
/begin CHARACTERISTIC StSys_swtShutOff_C "Label zum Aktivieren des Tipstart-Pfades (1: aktiviert, 0: deaktiviert)" VALUE 0xEEB7C Kw_Wu8 1.000 OneToOne 0.00 1.000 FORMAT "%5.3" EXTENDED_LIMITS 0.00 255.0 /end CHARACTERISTIC
/begin CHARACTERISTIC StSys_swtStrtTipActv_C "Schalter für Tip-Start Funktion aktiviert (1...aktiviert, 0...deaktiviert)" VALUE 0xEEB61 Kw_Wu8 1.000 OneToOne 0.00 1.000 FORMAT "%5.3" EXTENDED_LIMITS 0.00 255.0 /end CHARACTERISTIC
/begin CHARACTERISTIC StSys_tClntHi_C "Temperaturschwelle Motor warm -> heiß" VALUE 0xEEA9A Kw_Ws16 950.000 Temp_Cels -50.14000 899.860 FORMAT "%8.3" EXTENDED_LIMITS -3549.940 3003.560 /end CHARACTERISTIC
/begin CHARACTERISTIC StSys_tClntLo_C "Temperaturschwelle Motor kalt -> warm" VALUE 0xEEA9C Kw_Ws16 950.000 Temp_Cels -50.14000 899.860 FORMAT "%8.3" EXTENDED_LIMITS -3549.940 3003.560 /end CHARACTERISTIC
/begin CHARACTERISTIC StSys_ti2MsWhlPrt_C "Verzögerungszeit Startmomentenabschaltung" VALUE 0xEEB7E Kw_Wu16 655350.0 Time_ms 0.00 655350.0 FORMAT "%8.1" /end CHARACTERISTIC
/begin CHARACTERISTIC StSys_tiEngageCutOut_C "Ausblendzeit nEng-ueberwachung bei Start" VALUE 0xEEB6E Kw_Wu16 655350.0 Time_ms 0.00 655350.0 FORMAT "%8.1" /end CHARACTERISTIC
/begin CHARACTERISTIC StSys_tiEngTempValid_C "Verzögerungszeit bis Motortemperatur gueltig" VALUE 0xEEA9E Kw_Wu16 655350.0 Time_ms 0.00 655350.0 FORMAT "%8.1" /end CHARACTERISTIC
/begin CHARACTERISTIC StSys_tiLckCutOut_C "ausblendzeit nEng ueberwachung bei start" VALUE 0xEEA90 Kw_Wu16 655350.0 Time_ms 0.00 655350.0 FORMAT "%8.1" /end CHARACTERISTIC
/begin CHARACTERISTIC StSys_tiStartOszilDef_C "Defect time for pulsation error" VALUE 0xEEB80 Kw_Wu16 655350.0 Time_ms 0.00 655350.0 FORMAT "%8.1" /end CHARACTERISTIC
/begin CHARACTERISTIC StSys_tiStartOszilOk_C "Healing time for pulsation error" VALUE 0xEEB82 Kw_Wu16 655350.0 Time_ms 0.00 655350.0 FORMAT "%8.1" /end CHARACTERISTIC
/begin CHARACTERISTIC StSys_tiStrtCutOut_C "Startabwurf-Sperrzeit" VALUE 0xEE9BA Kw_Wu16 655350.0 Time_ms 0.00 655350.0 FORMAT "%8.1" /end CHARACTERISTIC
/begin CHARACTERISTIC StSys_tiStrtLck_C "Anlassersperrzeit nach startabbruch" VALUE 0xEE848 Kw_Wu16 655350.0 Time_ms 0.00 655350.0 FORMAT "%8.1" /end CHARACTERISTIC
/begin CHARACTERISTIC StSys_tiStrtMax_C "max. Starterbetaetigungszeit" VALUE 0xEE84A Kw_Wu16 655350.0 Time_ms 0.00 655350.0 FORMAT "%8.1" /end CHARACTERISTIC
/begin CHARACTERISTIC StSys_tiStrtTipMin_C "min. Zeit für gedrueckten Startknopf" VALUE 0xEEB62 Kw_Wu16 655350.0 Time_ms 0.00 655350.0 FORMAT "%8.1" /end CHARACTERISTIC
/begin CHARACTERISTIC StSys_tiStrtTipNoMonitor_C "Zeitschwelle für nicht überwachte Drehzahl" VALUE 0xEEB64 Kw_Wu16 655350.0 Time_ms 0.00 655350.0 FORMAT "%8.1" /end CHARACTERISTIC
/begin CHARACTERISTIC StSys_tiStrtTipProt_C "Zeitschwelle für Drehzahl-Blockierschutz" VALUE 0xEEB66 Kw_Wu16 655350.0 Time_ms 0.00 655350.0 FORMAT "%8.1" /end CHARACTERISTIC
/begin CHARACTERISTIC StSys_trqAdjMax_C "maximales Moment fuer den Startabgleich" VALUE 0xEE9BE Kw_Ws16 6553.500 Trq -3276.800 3276.700 FORMAT "%8.3" /end CHARACTERISTIC
/begin CHARACTERISTIC StSys_trqAdjVal_C "Abgleichwert fuer das Startmoment" VALUE 0xEE9C0 Kw_Ws16 6553.500 Trq -3276.800 3276.700 FORMAT "%8.3" /end CHARACTERISTIC
/begin CHARACTERISTIC StSys_dtrqColdInc_C "Momentinkrement fuer kalten Motor" VALUE 0xEEAA0 Kw_Wu32 6553599.99847 RmpTrq 0.00 6553599.99847 FORMAT "%13.5" /end CHARACTERISTIC
/begin CHARACTERISTIC StSys_tiColdRmpLck_C "Rampensperrzeit fur kalten Motor" VALUE 0xEEAA4 Kw_Wu16 655350.0 Time_ms 0.00 655350.0 FORMAT "%8.1" /end CHARACTERISTIC
/begin CHARACTERISTIC StSys_trqColdLim_C "Grenzmoment fuer kalten Motor" VALUE 0xEEAA6 Kw_Ws16 3276.700 Trq 0.00 3276.700 FORMAT "%8.3" EXTENDED_LIMITS -3276.800 3276.700 /end CHARACTERISTIC
/begin CHARACTERISTIC StSys_dtrqHotInc_C "Momentinkrement fuer heißen Motor" VALUE 0xEEAA8 Kw_Wu32 6553599.99847 RmpTrq 0.00 6553599.99847 FORMAT "%13.5" /end CHARACTERISTIC
/begin CHARACTERISTIC StSys_tiHotRmpLck_C "Rampensperrzeit fur heißen Motor" VALUE 0xEEAAC Kw_Wu16 655350.0 Time_ms 0.00 655350.0 FORMAT "%8.1" /end CHARACTERISTIC
/begin CHARACTERISTIC StSys_trqHotLim_C "Grenzmoment fuer heißen Motor" VALUE 0xEEAAE Kw_Ws16 3276.700 Trq 0.00 3276.700 FORMAT "%8.3" EXTENDED_LIMITS -3276.800 3276.700 /end CHARACTERISTIC
/begin CHARACTERISTIC StSys_trqStrtAPSCor_MAP " Base map for correction for starting torque" MAP 0xEE870 Kf_Xs16_Ys16_Ws16 240.0000 Trq -40.10000 199.9000 FORMAT "%8.4" EXTENDED_LIMITS -3276.800 3276.700
 /begin AXIS_DESCR STD_AXIS Eng_nAvrg EngN 8 0.00 6000.000 FORMAT "%8.3" EXTENDED_LIMITS -32768.00 32767.00 DEPOSIT ABSOLUTE /end AXIS_DESCR
 /begin AXIS_DESCR STD_AXIS StSys_tStrtBas_mp Temp_Cels 8 -50.140 899.860 FORMAT "%8.3" EXTENDED_LIMITS -3549.940 3003.560 DEPOSIT ABSOLUTE /end AXIS_DESCR
/end CHARACTERISTIC
/begin CHARACTERISTIC StSys_trqStrtBas_MAP "Basismoment fuer den Start" MAP 0xEE9C2 Kf_Xs16_Ys16_Ws16 3276.700 Trq 0.00 3276.700 FORMAT "%8.3" EXTENDED_LIMITS -3276.800 3276.700
 /begin AXIS_DESCR STD_AXIS Eng_nAvrg EngN 8 0.00 6000.000 FORMAT "%8.3" EXTENDED_LIMITS -32768.00 32767.00 DEPOSIT ABSOLUTE /end AXIS_DESCR
 /begin AXIS_DESCR STD_AXIS StSys_tStrtBas_mp Temp_Cels 10 -50.14000 199.8600 FORMAT "%8.4" EXTENDED_LIMITS -3549.940 3003.560 DEPOSIT ABSOLUTE /end AXIS_DESCR
/end CHARACTERISTIC
/begin CHARACTERISTIC StSys_dtrqWarmInc_C "Momentinkrement fuer warmen Motor" VALUE 0xEEAB0 Kw_Wu32 6553599.99847 RmpTrq 0.00 6553599.99847 FORMAT "%13.5" /end CHARACTERISTIC
/begin CHARACTERISTIC StSys_tiWarmRmpLck_C "Rampensperrzeit fur warmen Motor" VALUE 0xEEAB4 Kw_Wu16 655350.0 Time_ms 0.00 655350.0 FORMAT "%8.1" /end CHARACTERISTIC
/begin CHARACTERISTIC StSys_trqWarmLim_C "Grenzmoment fuer warmen Motor" VALUE 0xEEAB6 Kw_Ws16 3276.700 Trq 0.00 3276.700 FORMAT "%8.3" EXTENDED_LIMITS -3276.800 3276.700 /end CHARACTERISTIC
/begin CHARACTERISTIC StSys_vThres_C "Geschw.grenze Fzg. wird angeschoben" VALUE 0xEEB70 Kw_Ws16 251.0000 Vel -1.000000 250.0000 FORMAT "%8.4" EXTENDED_LIMITS -327.6800 327.6700 /end CHARACTERISTIC
/begin CHARACTERISTIC T15CD_tiDebNeg_C "#SSD Filterzeitkonstante der Klemme 15 für fallende Flanken" VALUE 0xEEB84 Kw_Wu16 655350.0 TimeDeb 0.00 655350.0 FORMAT "%8.1" /end CHARACTERISTIC
/begin CHARACTERISTIC T15CD_tiDebPos_C "#SSD Filterzeitkonstante der Klemme 15 für steigende Flanken" VALUE 0xEEB86 Kw_Wu16 655350.0 TimeDeb 0.00 655350.0 FORMAT "%8.1" /end CHARACTERISTIC
/begin CHARACTERISTIC T15CD_DebNplDef_C "Fehlerentprellzeit für Plausibilitätsfehler" VALUE 0xEEB88 Kw_Wu16 655350.0 Time_ms 0.00 655350.0 FORMAT "%8.1" /end CHARACTERISTIC
/begin CHARACTERISTIC T15CD_DebNplOk_C "Heilungsentprellzeit für Plausibilitätsfehler" VALUE 0xEEB8A Kw_Wu16 655350.0 Time_ms 0.00 655350.0 FORMAT "%8.1" /end CHARACTERISTIC
/begin CHARACTERISTIC T15CD_numDioIn_C "#SSD Applikationsparameter fuer Klemme 15" VALUE 0xEEB8C Kw_Wu8 14.0000000000 NumPinDioIn 0.00 14.0000000000 FORMAT "%13.10" /end CHARACTERISTIC
/begin CHARACTERISTIC T15CD_stInvIn_C "Invertierungsparameter für Klemme 15 Eingangssignal" VALUE 0xEEB8D Kw_Wu8 1.000 OneToOne 0.00 1.000 FORMAT "%5.3" EXTENDED_LIMITS 0.00 255.0 READ_ONLY /end CHARACTERISTIC
/begin CHARACTERISTIC T15CD_tiDebWakeUp_C "Maximale Zeitverzögerung zwischen pos.Flankedesentprellen WakeUp Signals und Klemme15 über CAN" VALUE 0xEEB8E Kw_Wu16 655350.0 Time_ms 0.00 655350.0 FORMAT "%8.1" /end CHARACTERISTIC
/begin CHARACTERISTIC T50CD_tiDebNeg_C "Entprellzeit  fallende Flanke" VALUE 0xEEB90 Kw_Wu16 655350.0 TimeDeb 0.00 655350.0 FORMAT "%8.1" /end CHARACTERISTIC
/begin CHARACTERISTIC T50CD_tiDebPos_C "entprellzeit steigende Flanke" VALUE 0xEEB92 Kw_Wu16 655350.0 TimeDeb 0.00 655350.0 FORMAT "%8.1" /end CHARACTERISTIC
/begin CHARACTERISTIC T50CD_stDflVal_C "Vorgabewert Zustand T50" VALUE 0xEEB94 Kw_Wu8 1.000 OneToOne 0.00 1.000 FORMAT "%5.3" EXTENDED_LIMITS 0.00 255.0 /end CHARACTERISTIC
/begin CHARACTERISTIC T50CD_stInv_C "Invertierung Eingangssignal T50CD_stRawVal" VALUE 0xEEB95 Kw_Wu8 1.000 OneToOne 0.00 1.000 FORMAT "%5.3" EXTENDED_LIMITS 0.00 255.0 /end CHARACTERISTIC
/begin CHARACTERISTIC T50CD_swtSigVal_C "Signalschalter T50 (1=CAN 0=HW)" VALUE 0xEEB96 Kw_Wu8 1.000 OneToOne 0.00 1.000 FORMAT "%5.3" EXTENDED_LIMITS 0.00 255.0 /end CHARACTERISTIC
/begin CHARACTERISTIC ThrVlv_rTVA_Vector "#SSD Bypass-Label für ThrVlv_rTVA" VALUE 0xC31AC Kw_Wu8 255.0 OneToOne 0.00 255.0 FORMAT "%5.1" /end CHARACTERISTIC
/begin CHARACTERISTIC ThrVlv_rTVA_Channel "#SSD Bypass-Label für ThrVlv_rTVA" VALUE 0xC31AD Kw_Wu8 255.0 OneToOne 0.00 255.0 FORMAT "%5.1" /end CHARACTERISTIC
/begin CHARACTERISTIC TPUMon_ctDfctLim_C "#SSD Oberer Entprellzähler Grenzwert für Defekterkennung" VALUE 0xC3420 Kw_Wu16 65535.00 OneToOne 0.00 65535.00 FORMAT "%8.2" /end CHARACTERISTIC
/begin CHARACTERISTIC TPUMon_ctTPU_C "Index der auf den Messpunkten dargestellten TPU" VALUE 0xC3422 Kw_Wu8 255.0 OneToOne 0.00 255.0 FORMAT "%5.1" /end CHARACTERISTIC
/begin CHARACTERISTIC TPUMon_tiDiffMaxLimit_C "#SSD Maximal zulässige einzelne Timerdifferenz" VALUE 0xC3424 Kw_Ws32 2147483647.00 TimeUSResolution 0.00 2147483647.00 FORMAT "%13.2" EXTENDED_LIMITS -2147483648.00 2147483647.00 /end CHARACTERISTIC
/begin CHARACTERISTIC TPUMon_tiDiffMinLimit_C "#SSD Minimal zulässige einzelne Timerdifferenz (negativer Wert)" VALUE 0xC3428 Kw_Ws32 2147483648.00 TimeUSResolution -2147483648.00 0.00 FORMAT "%13.2" EXTENDED_LIMITS -2147483648.00 2147483647.00 /end CHARACTERISTIC
/begin CHARACTERISTIC TPUMon_tiDiffSumLimit_C "#SSD Maximal zulässige Betragsumme Timerdifferenz" VALUE 0xC342C Kw_Ws32 2147483647.00 TimeUSResolution 0.00 2147483647.00 FORMAT "%13.2" EXTENDED_LIMITS -2147483648.00 2147483647.00 /end CHARACTERISTIC
/begin CHARACTERISTIC TVACD_ctPwrStgOnMax_C "Maximaler Zähler für Powerstage On im Fehlerfall" VALUE 0xEEB98 Kw_Wu16 65535.00 OneToOne 0.00 65535.00 FORMAT "%8.2" /end CHARACTERISTIC
/begin CHARACTERISTIC TVACD_DebExcTempDef_C "Fehlerentprellzeit für Übertemperatur" VALUE 0xEEB9A Kw_Wu16 655350.0 Time_ms 0.00 655350.0 FORMAT "%8.1" /end CHARACTERISTIC
/begin CHARACTERISTIC TVACD_DebExcTempOk_C "Heilungsentprellzeit für Übertemperatur" VALUE 0xEEB9C Kw_Wu16 655350.0 Time_ms 0.00 655350.0 FORMAT "%8.1" /end CHARACTERISTIC
/begin CHARACTERISTIC TVACD_DebNoLoadDef_C "Fehlerentprellzeit für Lastabfall" VALUE 0xEEB9E Kw_Wu16 655350.0 Time_ms 0.00 655350.0 FORMAT "%8.1" /end CHARACTERISTIC
/begin CHARACTERISTIC TVACD_DebNoLoadOk_C "Heilungsentprellzeit für Lastabfall" VALUE 0xEEBA0 Kw_Wu16 655350.0 Time_ms 0.00 655350.0 FORMAT "%8.1" /end CHARACTERISTIC
/begin CHARACTERISTIC TVACD_DebShortCircBatDef_C "Fehlerentprellzeit für Kurzschluß nach Batterie" VALUE 0xEEBA2 Kw_Wu16 655350.0 Time_ms 0.00 655350.0 FORMAT "%8.1" /end CHARACTERISTIC
/begin CHARACTERISTIC TVACD_DebShortCircBatOk_C "Heilungsentprellzeit für Kurzschluß nach Batterie" VALUE 0xEEBA4 Kw_Wu16 655350.0 Time_ms 0.00 655350.0 FORMAT "%8.1" /end CHARACTERISTIC
/begin CHARACTERISTIC TVACD_DebShortCircGndDef_C "Fehlerentprellzeit für Kurzschluß nach Masse" VALUE 0xEEBA6 Kw_Wu16 655350.0 Time_ms 0.00 655350.0 FORMAT "%8.1" /end CHARACTERISTIC
/begin CHARACTERISTIC TVACD_DebShortCircGndOk_C "Heilungsentprellzeit für Kurzschluß nach Masse" VALUE 0xEEBA8 Kw_Wu16 655350.0 Time_ms 0.00 655350.0 FORMAT "%8.1" /end CHARACTERISTIC
/begin CHARACTERISTIC TVACD_tiDebTVADia1Def_C "Fehlerentprellzeit für Drosselklappenstellers Diagnose erstes Zeitfenster" VALUE 0xEEBAA Kw_Wu16 655350.0 Time_ms 0.00 655350.0 FORMAT "%8.1" /end CHARACTERISTIC
/begin CHARACTERISTIC TVACD_tiDebTVADia1Ok_C "Fehlerheilzeit für Drosselklappenstellers Diagnose erstes Zeitfenster" VALUE 0xEEBAC Kw_Wu16 655350.0 Time_ms 0.00 655350.0 FORMAT "%8.1" /end CHARACTERISTIC
/begin CHARACTERISTIC TVACD_tiDebTVADia2Def_C "Fehlerentprellzeit für Drosselklappenstellers Diagnose zweites Zeitfenster" VALUE 0xEEBAE Kw_Wu16 655350.0 Time_ms 0.00 655350.0 FORMAT "%8.1" /end CHARACTERISTIC
/begin CHARACTERISTIC TVACD_tiDebTVADia2Ok_C "Fehlerheilzeit für Drosselklappenstellers Diagnose zweites Zeitfenster" VALUE 0xEEBB0 Kw_Wu16 655350.0 Time_ms 0.00 655350.0 FORMAT "%8.1" /end CHARACTERISTIC
/begin CHARACTERISTIC TVACD_tiDebTVADia3Def_C "Fehlerentprellzeit für Drosselklappenstellers Diagnose drittes Zeitfenster" VALUE 0xEEBB2 Kw_Wu16 655350.0 Time_ms 0.00 655350.0 FORMAT "%8.1" /end CHARACTERISTIC
/begin CHARACTERISTIC TVACD_tiDebTVADia3Ok_C "Fehlerheilzeit für Drosselklappenstellers Diagnose drittes Zeitfenster" VALUE 0xEEBB4 Kw_Wu16 655350.0 Time_ms 0.00 655350.0 FORMAT "%8.1" /end CHARACTERISTIC
/begin CHARACTERISTIC TVACD_tiDebTVADia4Def_C "Fehlerentprellzeit für Drosselklappensteller Diagnose viertes Zeitfenster" VALUE 0xEEBB6 Kw_Wu16 655350.0 Time_ms 0.00 655350.0 FORMAT "%8.1" /end CHARACTERISTIC
/begin CHARACTERISTIC TVACD_tiDebTVADia4Ok_C "Heilentprellzeit  für Drosselklappensteller Diagnose viertes Zeitfenster" VALUE 0xEEBB8 Kw_Wu16 655350.0 Time_ms 0.00 655350.0 FORMAT "%8.1" /end CHARACTERISTIC
/begin CHARACTERISTIC TVACD_numDia_C "#SSD Applikationsparameter fuer Diagnose-Signal von Drossel-Steller" VALUE 0xEEBBA Kw_Wu8 27.0000000000 NumPinDia 0.00 27.0000000000 FORMAT "%13.10" /end CHARACTERISTIC
/begin CHARACTERISTIC TVACD_numPwmOut_C "#SSD Applikationsparameter fuer Drosselwert-Steller" VALUE 0xEEBBB Kw_Wu8 13.0000000000 NumPinPwmOut 0.00 13.0000000000 FORMAT "%13.10" /end CHARACTERISTIC
/begin CHARACTERISTIC TVACD_stInvOut_C "Invertierungsparameter für das Signal der Drosselklappenstellerendstufe" VALUE 0xEEBBC Kw_Wu8 1.000 OneToOne 0.00 1.000 FORMAT "%5.3" EXTENDED_LIMITS 0.00 255.0 /end CHARACTERISTIC
/begin CHARACTERISTIC TVACD_tiPer_C "Periodendauer Drosselklappensteller" VALUE 0xEEBBE Kw_Ws16 6553.500 Period -3276.800 3276.700 FORMAT "%8.3" /end CHARACTERISTIC
/begin CHARACTERISTIC TVACD_rCnv_CUR "Kennlinie zur konvertierung von Öffnungsgrad in Tastverhältnis" CURVE 0xEEBC0 Kl_Xs16_Ws16 100.0000 DtyCyc 0.00 100.0000 FORMAT "%8.4" EXTENDED_LIMITS -327.6800 327.6700
 /begin AXIS_DESCR STD_AXIS ThrVlv_rTVA Prc 25 -100.0000 200.0000 FORMAT "%8.4" EXTENDED_LIMITS -400.0000 399.9878 DEPOSIT ABSOLUTE /end AXIS_DESCR
/end CHARACTERISTIC
/begin CHARACTERISTIC TVACD_rOutMax_C "Maximal auszugebendes Tastverhältnis" VALUE 0xEEC26 Kw_Ws16 655.3500 DtyCyc -327.6800 327.6700 FORMAT "%8.4" /end CHARACTERISTIC
/begin CHARACTERISTIC TVACD_rOutMin_C "Minimal auszugebendes Tastverhältnis" VALUE 0xEEC28 Kw_Ws16 655.3500 DtyCyc -327.6800 327.6700 FORMAT "%8.4" /end CHARACTERISTIC
/begin CHARACTERISTIC TVACD_rTst_C "Tastverhältnis, dass im Fehlerfall zyklisch ausgegeben wird" VALUE 0xEEC2A Kw_Ws16 100.0000 DtyCyc 0.00 100.0000 FORMAT "%8.4" EXTENDED_LIMITS -327.6800 327.6700 /end CHARACTERISTIC
/begin CHARACTERISTIC TVACD_stPwrStgActv_C "Aktivierung der Abschaltbedingungen der Endstufe" VALUE 0xEEC2C Kw_Wu8 255.0 OneToOne 0.00 255.0 FORMAT "%5.1" /end CHARACTERISTIC
/begin CHARACTERISTIC TVACD_stPwrStgDia_C "Aktivierung der Abschaltbedingungen der Endstufendiagnose" VALUE 0xEEC2D Kw_Wu8 255.0 OneToOne 0.00 255.0 FORMAT "%5.1" /end CHARACTERISTIC
/begin CHARACTERISTIC TVACD_stSPICtl_C "0 = Non SPI powerstage )" VALUE 0xEEC2E Kw_Wu8 1.000 OneToOne 0.00 1.000 FORMAT "%5.3" EXTENDED_LIMITS 0.00 255.0 /end CHARACTERISTIC
/begin CHARACTERISTIC TVACD_swt_C "Schalter Batteriespannungskorrektur (0 = AUS, 1 = EIN)" VALUE 0xEEC2F Kw_Wu8 255.0 OneToOne 0.00 255.0 FORMAT "%5.1" /end CHARACTERISTIC
/begin CHARACTERISTIC TVACD_tiBtwTst_C "Zeitabstand, in dem im Fehlerfall die Endstufe getestet wird" VALUE 0xEEC30 Kw_Wu16 29980.00 Time_ms 20.00000 30000.00 FORMAT "%8.2" EXTENDED_LIMITS 0.00 655350.0 /end CHARACTERISTIC
/begin CHARACTERISTIC TVACD_tiDiag1Max_C "Maximum des ersten Signalfensters für Fehlersignale des Drosselklappensteller" VALUE 0xEEC32 Kw_Wu16 655350.0 Time_ms 0.00 655350.0 FORMAT "%8.1" /end CHARACTERISTIC
/begin CHARACTERISTIC TVACD_tiDiag1Min_C "Minimum des ersten Signalfensters für Fehlersignale des Drosselklappensteller" VALUE 0xEEC34 Kw_Wu16 655350.0 Time_ms 0.00 655350.0 FORMAT "%8.1" /end CHARACTERISTIC
/begin CHARACTERISTIC TVACD_tiDiag2Max_C "Maximum des zweiten Signalfensters für Fehlersignale des Drosselklappensteller" VALUE 0xEEC36 Kw_Wu16 655350.0 Time_ms 0.00 655350.0 FORMAT "%8.1" /end CHARACTERISTIC
/begin CHARACTERISTIC TVACD_tiDiag2Min_C "Minimum des zweiten Signalfensters für Fehlersignale des Drosselklappensteller" VALUE 0xEEC38 Kw_Wu16 655350.0 Time_ms 0.00 655350.0 FORMAT "%8.1" /end CHARACTERISTIC
/begin CHARACTERISTIC TVACD_tiDiag3Max_C "Maximum des dritten Signalfensters für Fehlersignale des Drosselklappensteller" VALUE 0xEEC3A Kw_Wu16 655350.0 Time_ms 0.00 655350.0 FORMAT "%8.1" /end CHARACTERISTIC
/begin CHARACTERISTIC TVACD_tiDiag3Min_C "Minimum des dritten Signalfensters für Fehlersignale des Drosselklappensteller" VALUE 0xEEC3C Kw_Wu16 655350.0 Time_ms 0.00 655350.0 FORMAT "%8.1" /end CHARACTERISTIC
/begin CHARACTERISTIC TVACD_tiDiag4Max_C "Maximum des vierten Signalfensters für Fehlersignale des Drosselklappenstellers" VALUE 0xEEC3E Kw_Wu16 655350.0 Time_ms 0.00 655350.0 FORMAT "%8.1" /end CHARACTERISTIC
/begin CHARACTERISTIC TVACD_tiDiag4Min_C "Minimum des vierten Signalfensters für Fehlersignale des Drosselklappenstellers" VALUE 0xEEC40 Kw_Wu16 655350.0 Time_ms 0.00 655350.0 FORMAT "%8.1" /end CHARACTERISTIC
/begin CHARACTERISTIC TVACD_tiPwrStgOn_C "Zeit für welche die Endstufe im Fehlerfall eingeschalten wird (nur nicht SPI kontrolliert)" VALUE 0xEEC42 Kw_Wu16 655140.0 Time_ms 0.00 655140.0 FORMAT "%8.1" EXTENDED_LIMITS 0.00 655350.0 /end CHARACTERISTIC
/begin CHARACTERISTIC UAddr_stCalibration_C "#SSD ECU Applikationszugriff (0 = unterbunden, 1 = erlaubt)" VALUE 0xC0B2E Kw_Wu8 1.000 OneToOne 0.00 1.000 FORMAT "%5.3" EXTENDED_LIMITS 0.00 255.0 /end CHARACTERISTIC
/begin CHARACTERISTIC Uaddr_stMeasurement_C "ECU Messzugriff (0 = unterbunden, 1 = erlaubt)" VALUE 0xC0B2F Kw_Wu8 1.000 OneToOne 0.00 1.000 FORMAT "%5.3" EXTENDED_LIMITS 0.00 255.0 /end CHARACTERISTIC
/begin CHARACTERISTIC USAp_dDataVariantIdInv_C "Identifier dieser Datensatzvariante (invertiert)" VALUE 0xEEC44 Kw_Wu32 4294967295.00 OneToOne 0.00 4294967295.00 FORMAT "%13.2" /end CHARACTERISTIC
/begin CHARACTERISTIC USAp_dDataVariantId_C "Identifier dieser Datensatzvariante" VALUE 0xEEC48 Kw_Wu32 4294967295.00 OneToOne 0.00 4294967295.00 FORMAT "%13.2" /end CHARACTERISTIC
/begin CHARACTERISTIC UsrDa_swtFDC_C "Schalter zur Auswahl des FDC-Sportmoduseingriffs" VALUE 0xEEC4C Kw_Wu8 255.0 OneToOne 0.00 255.0 FORMAT "%5.1" /end CHARACTERISTIC
/begin CHARACTERISTIC VehDa_lEepUpd_C "#SSD Streckenintervall zwischen zwei EEPROM Block Updates für Vehicle Data (VehDa_lSum, VehDa_tiEngOn)" VALUE 0xEEC78 Kw_Wu32 4294957295.00 Length 10000.0000000 4294967295.00 FORMAT "%13.2" EXTENDED_LIMITS 0.00 4294967295.00 /end CHARACTERISTIC
/begin CHARACTERISTIC VehDa_nLoadActv_C "Drehzahlschwelle zur Erfassung des Fahrzeugnutzungsprofils" VALUE 0xEEC5C Kw_Ws16 6000.000 EngN 0.00 6000.000 FORMAT "%8.3" EXTENDED_LIMITS -32768.00 32767.00 /end CHARACTERISTIC
/begin CHARACTERISTIC VehDa_nLoad_C "Stützstellen der x-Achse (Drehzahl) des Fahrzeugnutzungsprofils" VAL_BLK 0xEEC5E Kwb_Ws16 6000.000 EngN 0.00 6000.000 FORMAT "%8.3" EXTENDED_LIMITS -32768.00 32767.00 NUMBER 7 /end CHARACTERISTIC
/begin CHARACTERISTIC VehDa_nMaxEepUpd_C "Maximale Motordrehzahl für Update EEPROM Block (VehDa_lSum, VehDa_tiEngOn)" VALUE 0xEEC7C Kw_Ws16 6000.000 EngN 0.00 6000.000 FORMAT "%8.3" EXTENDED_LIMITS -32768.00 32767.00 /end CHARACTERISTIC
/begin CHARACTERISTIC VehDa_nMinEepUpd_C "Minimale Motordrehzahl für Update EEPROM Block (VehDa_lSum, VehDa_tiEngOn)" VALUE 0xEEC7E Kw_Ws16 5000.000 EngN 1000.000 6000.000 FORMAT "%8.3" EXTENDED_LIMITS -32768.00 32767.00 /end CHARACTERISTIC
/begin CHARACTERISTIC VehDa_rVnMax_C "maximales v/n-Verhältnis" VALUE 0xEEC50 Kw_Ws16 0.3276700 VelToN 0.00 0.3276700 FORMAT "%9.7" EXTENDED_LIMITS -0.3276800 0.3276700 /end CHARACTERISTIC
/begin CHARACTERISTIC VehDa_swtRst_C "Schalter zum Rücksetzen von VehDa_ctLoadSecRowX_mp[X], VehDa_tiLoadSec_mp und der entsprechenden EEPROM-Werte" VALUE 0xEEC6C Kw_Wu8 1.000 OneToOne 0.00 1.000 FORMAT "%5.3" EXTENDED_LIMITS 0.00 255.0 /end CHARACTERISTIC
/begin CHARACTERISTIC VehDa_tiNPT1_C "T1 Zeitkonstante zur Vorfilterung der Motordrehzahl für v/n-Verhältnis" VALUE 0xEEC54 Kw_Wu32 4294.9673 TimeDelay_s 0.0000010000000 4294.9673 FORMAT "%9.4" /end CHARACTERISTIC
/begin CHARACTERISTIC VehDa_tiVnPT1_C "T1 Zeitkonstante zur Filterung des v/n-Verhältnisses" VALUE 0xEEC58 Kw_Wu32 4294.9673 TimeDelay_s 0.0000010000000 4294.9673 FORMAT "%9.4" /end CHARACTERISTIC
/begin CHARACTERISTIC VehDa_trqLoad_C "Stützstellen der y-Achse (Drehmoment) des Fahrzeugnutzungsprofils" VAL_BLK 0xEEC6E Kwb_Ws16 1500.000 Trq -500.0000 1000.000 FORMAT "%8.3" EXTENDED_LIMITS -3276.800 3276.700 NUMBER 5 /end CHARACTERISTIC
/begin MEASUREMENT signals_stTestNLim_mp "Meßpunkt für Status Drehzahlbegrenzung von Stellertests" UBYTE OneToOne 1 100 0.00 255.0 FORMAT "%5.1" ECU_ADDRESS 0x8FFB55 /end MEASUREMENT
/begin MEASUREMENT signals_stTest_mp "Meßpunkt für Status Stellertest" ULONG OneToOne 1 100 0.00 4294967295.00 FORMAT "%13.2" ECU_ADDRESS 0x8FFB58 /end MEASUREMENT
/begin MEASUREMENT signals_tiTstRemain_mp "Meßpunkt für verbleibende Zeit bis zur Abschaltung Stellertest über Zeitgrenze" UWORD Time_ms 1 100 0.00 655350.0 FORMAT "%8.1" ECU_ADDRESS 0x8FFB5C /end MEASUREMENT
/begin MEASUREMENT SOPTst_stCyl "Endstufen die sich trotz redundanter Abschaltung aktivieren ließen" UBYTE OneToOne 1 100 0.00 255.0 FORMAT "%5.1" ECU_ADDRESS 0x7F89B3 /end MEASUREMENT
/begin MEASUREMENT SPMon_numFreeErcosekStack_mp "Freier Ercosek Stack (Schleppzeiger im eeprom)" UWORD OneToOne 1 100 0.00 65535.00 FORMAT "%8.2" ECU_ADDRESS 0x6F822A /end MEASUREMENT
/begin MEASUREMENT SPMon_numFreeUserStack_mp "Meßpunkt für freien Userstackbereich" UWORD OneToOne 1 100 0.00 65535.00 FORMAT "%8.2" ECU_ADDRESS 0x6F822C /end MEASUREMENT
/begin MEASUREMENT SrvPmp_dphiStrg_mp "Streeing Angle derivative" SWORD AngleGradPerSec 1 100 -1440.154 1440.110 FORMAT "%8.3" ECU_ADDRESS 0x8FFB5E /end MEASUREMENT
/begin MEASUREMENT SrvPmp_pwrDes "Leistungsbedarf der Servopumpe" SWORD Pwr 1 100 -308831.1 308821.7 FORMAT "%8.1" ECU_ADDRESS 0x7F90B8 /end MEASUREMENT
/begin MEASUREMENT SrvPmp_pwrLead "Leistungsvorhalt der Servopumpe" SWORD Pwr 1 100 -308831.1 308821.7 FORMAT "%8.1" ECU_ADDRESS 0x7F90BA /end MEASUREMENT
/begin MEASUREMENT SrvPmp_trqDes_mp "Momentenbedarf der Servopumpe" SWORD Trq 1 100 -3276.800 3276.700 FORMAT "%8.3" ECU_ADDRESS 0x8FFB60 /end MEASUREMENT
/begin MEASUREMENT SSpMon_stRaw_1_mp "Rohwert der Defekterkennung der Sensorversorgungsspannung 1" SWORD OneToOne 1 100 -32768.00 32767.00 FORMAT "%8.2" ECU_ADDRESS 0x8FFB62 /end MEASUREMENT
/begin MEASUREMENT SSpMon_stRaw_2_mp "Rohwert der Defekterkennung der Sensorversorgungsspannung 2" SWORD OneToOne 1 100 -32768.00 32767.00 FORMAT "%8.2" ECU_ADDRESS 0x8FFB64 /end MEASUREMENT
/begin MEASUREMENT SSpMon_stRaw_3_mp "Rohwert der Defekterkennung der Sensorversorgungsspannung 3" SWORD OneToOne 1 100 -32768.00 32767.00 FORMAT "%8.2" ECU_ADDRESS 0x8FFB66 /end MEASUREMENT
/begin MEASUREMENT SSpMon_stSSpErr "Fehlerstatus der Sensorversorgungsspannungen" UWORD OneToOne 1 100 0.00 65535.00 FORMAT "%8.2" ECU_ADDRESS 0x7F90B4 /end MEASUREMENT
/begin MEASUREMENT StrtCD_stHWE_mp "zu stellender Zustand an der Digitalendstufe nach der Fehlerbehandlung" UBYTE OneToOne 1 100 0.00 255.0 FORMAT "%5.1" ECU_ADDRESS 0x8FFB68 /end MEASUREMENT
/begin MEASUREMENT StSys_facAPSCor_mp "factor for starting torque correction value" SWORD Fact 1 100 -4.000000 3.999878 FORMAT "%8.6" ECU_ADDRESS 0x8FFB6A /end MEASUREMENT
/begin MEASUREMENT StSys_nAvrgFlt_mp "engine speed after PT1 filter" SWORD EngN 1 100 -32768.00 32767.00 FORMAT "%8.2" ECU_ADDRESS 0x8FFB84 /end MEASUREMENT
/begin MEASUREMENT StSys_nThresStrtCutOut_mp "Startabwurfdrehzahl" SWORD EngN 1 100 -32768.00 32767.00 FORMAT "%8.2" ECU_ADDRESS 0x8FFB72 /end MEASUREMENT
/begin MEASUREMENT StSys_stActrLck_mp "Statusregister Ausspurbedingungen" UWORD OneToOne 1 100 0.00 65535.00 FORMAT "%8.2" ECU_ADDRESS 0x8FFB7C /end MEASUREMENT
/begin MEASUREMENT StSys_stActrOut "Anlasserzustand" UBYTE OneToOne 1 100 0.00 255.0 FORMAT "%5.1" ECU_ADDRESS 0x7F89B6 /end MEASUREMENT
/begin MEASUREMENT StSys_stActrRls_mp "Statusregister Einspurbedingungen" UBYTE OneToOne 1 100 0.00 255.0 FORMAT "%5.1" ECU_ADDRESS 0x8FFB7E /end MEASUREMENT
/begin MEASUREMENT StSys_stNewStrt "Statusanzeige bei Neustart während eines aktiven Fahrzyklus" UBYTE OneToOne 1 100 0.00 255.0 FORMAT "%5.1" ECU_ADDRESS 0x7F89B7 /end MEASUREMENT
/begin MEASUREMENT StSys_stRmpMon "Zustand der Startmomenterhoehung" UBYTE OneToOne 1 100 0.00 255.0 FORMAT "%5.1" ECU_ADDRESS 0x7F89B8 /end MEASUREMENT
/begin MEASUREMENT StSys_stStrt "Startzustand" UBYTE OneToOne 1 100 0.00 255.0 FORMAT "%5.1" ECU_ADDRESS 0x7F89B9 /end MEASUREMENT
/begin MEASUREMENT StSys_stStrtCutOutMon "Zustand des Startabwurfs" UBYTE OneToOne 1 100 0.00 255.0 FORMAT "%5.1" ECU_ADDRESS 0x7F89BA /end MEASUREMENT
/begin MEASUREMENT StSys_stStrtTip "Zustände der Tip-Start Funktion" UWORD OneToOne 1 100 0.00 65535.00 FORMAT "%8.2" ECU_ADDRESS 0x7F90BE /end MEASUREMENT
/begin MEASUREMENT StSys_stStrtTipOFF "Zustände der Tip-Start Abschaltung" UBYTE OneToOne 1 100 0.00 255.0 FORMAT "%5.1" ECU_ADDRESS 0x7F89BB /end MEASUREMENT
/begin MEASUREMENT StSys_stStrtTipON "Zustände der Tip-Start Einschaltung" UBYTE OneToOne 1 100 0.00 255.0 FORMAT "%5.1" ECU_ADDRESS 0x7F89BC /end MEASUREMENT
/begin MEASUREMENT StSys_stTrqShutOff "globales Interface fuer die Startmomentabschaltung" UBYTE OneToOne 1 100 0.00 255.0 FORMAT "%5.1" ECU_ADDRESS 0x7F89BD /end MEASUREMENT
/begin MEASUREMENT StSys_stTrqShutOffCond_mp "bitcodierter Zustand der Abschaltbedingungen der Startmomentenabschaltung" UWORD OneToOne 1 100 0.00 65535.00 FORMAT "%8.2" ECU_ADDRESS 0x8FFB86 /end MEASUREMENT
/begin MEASUREMENT StSys_stTrqShutOffErr_mp "status Fehlerursachen Start o. Kl.50" UWORD OneToOne 1 100 0.00 65535.00 FORMAT "%8.2" ECU_ADDRESS 0x8FFB82 /end MEASUREMENT
/begin MEASUREMENT StSys_trqAddCor "zusaetzliches Korrekturmoment f. Startmoment" SWORD Trq 1 100 -3276.800 3276.700 FORMAT "%8.3" ECU_ADDRESS 0x7F90C0 /end MEASUREMENT
/begin MEASUREMENT StSys_trqAdj_mp "Startmomentkorrektur" SWORD Trq 1 100 -3276.800 3276.700 FORMAT "%8.3" ECU_ADDRESS 0x8FFB76 /end MEASUREMENT
/begin MEASUREMENT StSys_trqBas "Startbasismoment" SWORD Trq 1 100 -3276.800 3276.700 FORMAT "%8.3" ECU_ADDRESS 0x7F90C2 /end MEASUREMENT
/begin MEASUREMENT StSys_trqRmpState "Moment der Startrampe" SWORD Trq 1 100 -3276.800 3276.700 FORMAT "%8.3" ECU_ADDRESS 0x7F90C4 /end MEASUREMENT
/begin MEASUREMENT StSys_trqSetAdjVal_mp "EEPROM Abgleichwert Startmoment-Korrektur" SWORD Trq 1 100 -3276.800 3276.700 FORMAT "%8.3" ECU_ADDRESS 0x8FFB78 /end MEASUREMENT
/begin MEASUREMENT StSys_trqStrt "inneres Moment Startwert" SWORD Trq 1 100 -3276.800 3276.700 FORMAT "%8.3" ECU_ADDRESS 0x7F90C6 /end MEASUREMENT
/begin MEASUREMENT StSys_trqStrtAPSCor_mp " starting torque correction" SWORD Trq 1 100 -3276.800 3276.700 FORMAT "%8.3" ECU_ADDRESS 0x8FFB6C /end MEASUREMENT
/begin MEASUREMENT StSys_trqStrtAPS_mp "starting torque correction" SWORD Trq 1 100 -3276.800 3276.700 FORMAT "%8.3" ECU_ADDRESS 0x8FFB6E /end MEASUREMENT
/begin MEASUREMENT StSys_trqStrtBas_mp "Basismoment fuer Start" SWORD Trq 1 100 -3276.800 3276.700 FORMAT "%8.3" ECU_ADDRESS 0x8FFB7A /end MEASUREMENT
/begin MEASUREMENT StSys_tStrtBas_mp "Aus dem Motortemperaturfeld Eng_tFld ausgewählte Temperatur" SWORD Temp_Cels 1 100 -50.140 899.860 FORMAT "%8.3" ECU_ADDRESS 0x8FFB70 /end MEASUREMENT
/begin MEASUREMENT StSys_tStrtRmp_mp "Aus dem Motortemperaturfeld Eng_tFld ausgewählte Temperatur" SWORD Temp_Cels 1 100 -50.140 899.860 FORMAT "%8.3" ECU_ADDRESS 0x8FFB80 /end MEASUREMENT
/begin MEASUREMENT StSys_tStrt_mp "Aus dem Motortemperaturfeld Eng_tFld ausgewählte Temperatur für den Startabwurf" SWORD Temp_Cels 1 100 -50.140 899.860 FORMAT "%8.3" ECU_ADDRESS 0x8FFB74 /end MEASUREMENT
/begin MEASUREMENT SWTmr_tiTmr16 "16-Bit Referenzzeit für Timer" UWORD Time_ms 1 100 0.00 655350.0 FORMAT "%8.1" ECU_ADDRESS 0x7F879A /end MEASUREMENT
/begin MEASUREMENT SWTmr_tiTmr32 "32-Bit Referenzzeit für Timer" ULONG Time_ms 1 100 0.00 42949672950.0 FORMAT "%13.1" ECU_ADDRESS 0x7F879C /end MEASUREMENT
/begin MEASUREMENT T15CD_stCondDebVal_mp "Bedingungen (Bitleiste) für Auswertung T15CD_ stDebVal" UBYTE OneToOne 1 100 0.00 255.0 FORMAT "%5.1" ECU_ADDRESS 0x8FFB88 /end MEASUREMENT
/begin MEASUREMENT T15CD_stDebVal "entprellter Wert der Klemme 15" UBYTE OneToOne 1 100 0.00 255.0 FORMAT "%5.1" ECU_ADDRESS 0x7F89BE /end MEASUREMENT
/begin MEASUREMENT T15CD_stDebWakeUpVal "entprellter Wake Up Signaleingang" UBYTE OneToOne 1 100 0.00 255.0 FORMAT "%5.1" ECU_ADDRESS 0x7F89BF /end MEASUREMENT
/begin MEASUREMENT T15CD_stLogicT15_mp "Staatsmaschine für T15 in der neu ""Anpassung wakeup Konzept""" UBYTE OneToOne 1 100 0.00 255.0 FORMAT "%5.1" ECU_ADDRESS 0x8FFB89 /end MEASUREMENT
/begin MEASUREMENT T15CD_stWakeUp "Wake Up Zustand" UBYTE OneToOne 1 100 0.00 255.0 FORMAT "%5.1" ECU_ADDRESS 0x7F89C0 /end MEASUREMENT
/begin MEASUREMENT T15CD_stWakeUpRawVal_mp "Rohwert des Wake Up Signals aus der HWE" UBYTE OneToOne 1 100 0.00 255.0 FORMAT "%5.1" ECU_ADDRESS 0x6F822E /end MEASUREMENT
/begin MEASUREMENT T50CD_stDebVal "entprellter Statuswert der Klemme 50" UBYTE OneToOne 1 100 0.00 255.0 FORMAT "%5.1" ECU_ADDRESS 0x7F89C1 /end MEASUREMENT
/begin MEASUREMENT T50CD_stRawVal "unentprellter Wert des Eingangssignals für Klemme 50" UBYTE OneToOne 1 100 0.00 255.0 FORMAT "%5.1" ECU_ADDRESS 0x7F89C2 /end MEASUREMENT
/begin MEASUREMENT T50CD_swtSig "T50 von Hardware oder CAN" UBYTE OneToOne 1 100 0.00 255.0 FORMAT "%5.1" ECU_ADDRESS 0x7F89C3 /end MEASUREMENT
/begin MEASUREMENT ThrVlv_rTVA "Stellgröße für Regelklappe (Stellerkoordinatorausgang)" SWORD Prc 1 100 -400.0000 399.9878 FORMAT "%8.4" ECU_ADDRESS 0x7F90CA /end MEASUREMENT
/begin MEASUREMENT ThrVlv_rTVAByp_mp "Bypass-Label, Kopie von ThrVlv_rTVA" SWORD Prc 1 100 -400.0000 399.9878 FORMAT "%8.4" ECU_ADDRESS 0x8FFB8A /end MEASUREMENT
/begin MEASUREMENT TPUMon_ctUpDwnDeb_mp "Meßpunkt für den Entprellungszähler der TPUMon Zeitabweichung" UWORD OneToOne 1 100 0.00 65535.00 FORMAT "%8.2" ECU_ADDRESS 0x8FFB8C /end MEASUREMENT
/begin MEASUREMENT TPUMon_tiDiffMax_mp "Meßpunkt der maximalen Differenzen aus Timervergleich in den letzten 100 ms" SLONG TimeUSResolution 1 100 -2147483648.00 2147483647.00 FORMAT "%13.2" ECU_ADDRESS 0x8FFB90 /end MEASUREMENT
/begin MEASUREMENT TPUMon_tiDiffMin_mp "Meßpunkt der minimalen (negativer Wert) Differenzen aus Timervergleich in den letzten 100 ms" SLONG TimeUSResolution 1 100 -2147483648.00 2147483647.00 FORMAT "%13.2" ECU_ADDRESS 0x8FFB94 /end MEASUREMENT
/begin MEASUREMENT TPUMon_tiDiffSum_mp "Meßpunkt der Summe aller Differenzen aus Timervergleich in den letzten 100 ms" SLONG TimeUSResolution 1 100 -2147483648.00 2147483647.00 FORMAT "%13.2" ECU_ADDRESS 0x8FFB98 /end MEASUREMENT
/begin MEASUREMENT TVACD_rCnv_mp "Tastverhältnis basierend aus dem Ausgang des Abgasrückführreglers" SWORD DtyCyc 1 100 -327.6800 327.6700 FORMAT "%8.4" ECU_ADDRESS 0x8FFB9C /end MEASUREMENT
/begin MEASUREMENT TVACD_rOut "Tastverhältnis zür Endstufenansteuerung" SWORD DtyCyc 1 100 -327.6800 327.6700 FORMAT "%8.4" ECU_ADDRESS 0x7F90C8 /end MEASUREMENT
/begin MEASUREMENT TVACD_stErr_mp "Measurementpoint of actual error state of TVA H-Bridge" UBYTE OneToOne 1 100 0.00 255.0 FORMAT "%5.1" ECU_ADDRESS 0x8FFB9E /end MEASUREMENT
/begin MEASUREMENT USAp_dDataVariant_u8 "Nummer der aktiven Datensatzvariante" UBYTE OneToOne 1 100 0.00 255.0 FORMAT "%5.1" ECU_ADDRESS 0x7FE03A /end MEASUREMENT
/begin MEASUREMENT USAp_stDataVariant_u8 "Statusflags der aktiven Datensatzvariante" UBYTE OneToOne 1 100 0.00 255.0 FORMAT "%5.1" ECU_ADDRESS 0x7FE03B /end MEASUREMENT
/begin MEASUREMENT UsrDa_stFDC "Status von FDC" UBYTE OneToOne 1 100 0.00 255.0 FORMAT "%5.1" ECU_ADDRESS 0x7F89C5 /end MEASUREMENT
/begin MEASUREMENT UsrDa_stRecFDC "FDC im Fahrzeug vorhanden / nicht vorhanden" UBYTE OneToOne 1 100 0.00 255.0 FORMAT "%5.1" ECU_ADDRESS 0x7F89C6 /end MEASUREMENT
/begin MEASUREMENT VehDa_ctLoadPrimRow0_mp "Primärkennfeld Fahrzeugnutzungsprofil" UWORD OneToOne 1 100 0.00 65535.00 FORMAT "%8.2" ARRAY_SIZE 8 ECU_ADDRESS 0x6F8230 /end MEASUREMENT
/begin MEASUREMENT VehDa_ctLoadPrimRow1_mp "Primärkennfeld Fahrzeugnutzungsprofil" UWORD OneToOne 1 100 0.00 65535.00 FORMAT "%8.2" ARRAY_SIZE 8 ECU_ADDRESS 0x6F8240 /end MEASUREMENT
/begin MEASUREMENT VehDa_ctLoadPrimRow2_mp "Primärkennfeld Fahrzeugnutzungsprofil" UWORD OneToOne 1 100 0.00 65535.00 FORMAT "%8.2" ARRAY_SIZE 8 ECU_ADDRESS 0x6F8250 /end MEASUREMENT
/begin MEASUREMENT VehDa_ctLoadPrimRow3_mp "Primärkennfeld Fahrzeugnutzungsprofil" UWORD OneToOne 1 100 0.00 65535.00 FORMAT "%8.2" ARRAY_SIZE 8 ECU_ADDRESS 0x6F8260 /end MEASUREMENT
/begin MEASUREMENT VehDa_ctLoadPrimRow4_mp "Primärkennfeld Fahrzeugnutzungsprofil" UWORD OneToOne 1 100 0.00 65535.00 FORMAT "%8.2" ARRAY_SIZE 8 ECU_ADDRESS 0x6F8270 /end MEASUREMENT
/begin MEASUREMENT VehDa_ctLoadPrimRow5_mp "Primärkennfeld Fahrzeugnutzungsprofil" UWORD OneToOne 1 100 0.00 65535.00 FORMAT "%8.2" ARRAY_SIZE 8 ECU_ADDRESS 0x6F8280 /end MEASUREMENT
/begin MEASUREMENT VehDa_ctLoadSecRow0_mp "Sekundärkennfeld Fahrzeugnutzungsprofil" UBYTE OneToOne 1 100 0.00 255.0 FORMAT "%5.1" ARRAY_SIZE 8 ECU_ADDRESS 0x6F8290 /end MEASUREMENT
/begin MEASUREMENT VehDa_ctLoadSecRow1_mp "Sekundärkennfeld Fahrzeugnutzungsprofil" UBYTE OneToOne 1 100 0.00 255.0 FORMAT "%5.1" ARRAY_SIZE 8 ECU_ADDRESS 0x6F8298 /end MEASUREMENT
/begin MEASUREMENT VehDa_ctLoadSecRow2_mp "Sekundärkennfeld Fahrzeugnutzungsprofil" UBYTE OneToOne 1 100 0.00 255.0 FORMAT "%5.1" ARRAY_SIZE 8 ECU_ADDRESS 0x6F82A0 /end MEASUREMENT
/begin MEASUREMENT VehDa_ctLoadSecRow3_mp "Sekundärkennfeld Fahrzeugnutzungsprofil" UBYTE OneToOne 1 100 0.00 255.0 FORMAT "%5.1" ARRAY_SIZE 8 ECU_ADDRESS 0x6F82A8 /end MEASUREMENT
/begin MEASUREMENT VehDa_ctLoadSecRow4_mp "Sekundärkennfeld Fahrzeugnutzungsprofil" UBYTE OneToOne 1 100 0.00 255.0 FORMAT "%5.1" ARRAY_SIZE 8 ECU_ADDRESS 0x6F82B0 /end MEASUREMENT
/begin MEASUREMENT VehDa_ctLoadSecRow5_mp "Sekundärkennfeld Fahrzeugnutzungsprofil" UBYTE OneToOne 1 100 0.00 255.0 FORMAT "%5.1" ARRAY_SIZE 8 ECU_ADDRESS 0x6F82B8 /end MEASUREMENT
/begin MEASUREMENT VehDa_lInt_mp "Hilfszähler für Kilometerzähler VehDa_lSum über Integration Fahrgeschwindigkeit VSSCD_vRaw" SLONG Dist_20ms 1 100 -119304.647111 119304.647056 FORMAT "%13.6" ECU_ADDRESS 0x8FFBA0 /end MEASUREMENT
/begin MEASUREMENT VehDa_lSum "Erfassung gefahrene Strecke" ULONG Length 1 100 0.00 4294967295.00 FORMAT "%13.2" ECU_ADDRESS 0x7F924C /end MEASUREMENT
/begin MEASUREMENT VehDa_nEngFilt_mp "vorgefilterte Motordrehzahl für v/n Verhältnis" SWORD EngN 1 100 -32768.00 32767.00 FORMAT "%8.2" ECU_ADDRESS 0x8FFBA4 /end MEASUREMENT
/begin MEASUREMENT VehDa_rVn "Verhältnis von Fahrgeschwindigkeit zur Motordrehzahl" SWORD VelToN 1 100 0.00 0.1000000 FORMAT "%9.7" ECU_ADDRESS 0x7F90DE /end MEASUREMENT
/begin MEASUREMENT VehDa_stTrqDem "Status der aktuellen Momentenanforderungen" UWORD OneToOne 1 100 0.00 65535.00 FORMAT "%8.2" ECU_ADDRESS 0x7F90E0 /end MEASUREMENT
/begin MEASUREMENT VehDa_tiEngOn "Erfassung der aktuellen Betriebszeit" ULONG TimeEngOn 1 100 0.00 4294967295.00 FORMAT "%13.2" ECU_ADDRESS 0x7F9250 /end MEASUREMENT
/begin MEASUREMENT VehDa_tiLoadPrim_mp "Fahrzeugnutzungsprofil-Betriebsstundenzähler" UWORD OneToOne 1 100 0.00 65535.00 FORMAT "%8.2" ECU_ADDRESS 0x6F82C0 /end MEASUREMENT
/begin MEASUREMENT VehDa_tiLoadSec_mp "Fahrzeugnutzungsprofil-Betriebsstundenzähler" ULONG OneToOne 1 100 0.00 4294967295.00 FORMAT "%13.2" ECU_ADDRESS 0x6F82C4 /end MEASUREMENT
/begin MEASUREMENT VehMot_nMax "Grenzdrehzahl für Fahrzeugbewegung" SWORD EngN 1 100 -32768.00 32767.00 FORMAT "%8.2" ECU_ADDRESS 0x7F90E2 /end MEASUREMENT
/begin MEASUREMENT VehMot_nMin "Leerlaufdrehzahl für Fahrzeugbewegung" SWORD EngN 1 100 -32768.00 32767.00 FORMAT "%8.2" ECU_ADDRESS 0x7F90E4 /end MEASUREMENT
/begin MEASUREMENT VehMot_pwrAcsDes "Gesamtbedarf Leistung der Nebenaggregate in der Fahrzeugbewegung" SWORD Pwr 1 100 -308831.1 308821.7 FORMAT "%8.1" ECU_ADDRESS 0x7F90E6 /end MEASUREMENT
/begin MEASUREMENT VehMot_pwrAcsLead "Leistungsvorhalt der Nebenaggregate in der Fahrzeugbewegung" SWORD Pwr 1 100 -308831.1 308821.7 FORMAT "%8.1" ECU_ADDRESS 0x7F90E8 /end MEASUREMENT
/begin MEASUREMENT VESGov_trq "Momentenanforderung Arbeitsdrehzahlregler" SWORD Trq 1 100 -3276.800 3276.700 FORMAT "%8.3" ECU_ADDRESS 0x7F90CC /end MEASUREMENT
/begin FUNCTION signals_base ""
 /begin DEF_CHARACTERISTIC Signals_adFreeApplic1_C Signals_numTypFreeApplic1_C Signals_adFreeApplic2_C Signals_numTypFreeApplic2_C Signals_adFreeApplic3_C Signals_numTypFreeApplic3_C Sig_aiDSMOffset_C Sig_aiDSMScale_C Sig_aiCANOffset_C Sig_aiCANScale_C Sig_aiDIAOffset_C Sig_aiDIAScale_C Sig_AngCrSDSMOffset_C Sig_AngCrSDSMScale_C Sig_AngCrSCANOffset_C Sig_AngCrSCANScale_C Sig_AngCrSDIAOffset_C Sig_AngCrSDIAScale_C Sig_aDSMOffset_C Sig_aDSMScale_C Sig_aCANOffset_C Sig_aCANScale_C Sig_aDIAOffset_C Sig_aDIAScale_C Sig_Carb_dtDSMOffset_C Sig_Carb_dtDSMScale_C Sig_Carb_dtCANOffset_C Sig_Carb_dtCANScale_C Sig_Carb_dtDIAOffset_C Sig_Carb_dtDIAScale_C Sig_Carb_lDSMOffset_C Sig_Carb_lDSMScale_C Sig_Carb_lCANOffset_C Sig_Carb_lCANScale_C Sig_Carb_lDIAOffset_C Sig_Carb_lDIAScale_C Sig_Carb_mAirTimDSMOffset_C Sig_Carb_mAirTimDSMScale_C Sig_Carb_mAirTimCANOffset_C Sig_Carb_mAirTimCANScale_C Sig_Carb_mAirTimDIAOffset_C Sig_Carb_mAirTimDIAScale_C Sig_Carb_nDSMOffset_C Sig_Carb_nDSMScale_C Sig_Carb_nCANOffset_C Sig_Carb_nCANScale_C Sig_Carb_nDIAOffset_C Sig_Carb_nDIAScale_C Sig_Carb_pDSMOffset_C Sig_Carb_pDSMScale_C Sig_Carb_pCANOffset_C Sig_Carb_pCANScale_C Sig_Carb_pDIAOffset_C Sig_Carb_pDIAScale_C Sig_Carb_rDSMOffset_C Sig_Carb_rDSMScale_C Sig_Carb_rCANOffset_C Sig_Carb_rCANScale_C Sig_Carb_rDIAOffset_C Sig_Carb_rDIAScale_C Sig_Carb_tiDSMOffset_C Sig_Carb_tiDSMScale_C Sig_Carb_tiCANOffset_C Sig_Carb_tiCANScale_C Sig_Carb_tiDIAOffset_C Sig_Carb_tiDIAScale_C Sig_Carb_tDSMOffset_C Sig_Carb_tDSMScale_C Sig_Carb_tCANOffset_C Sig_Carb_tCANScale_C Sig_Carb_tDIAOffset_C Sig_Carb_tDIAScale_C Sig_Carb_vDSMOffset_C Sig_Carb_vDSMScale_C Sig_Carb_vCANOffset_C Sig_Carb_vCANScale_C Sig_Carb_vDIAOffset_C Sig_Carb_vDIAScale_C Sig_dcycDSMOffset_C Sig_dcycDSMScale_C Sig_dcycCANOffset_C Sig_dcycCANScale_C Sig_dcycDIAOffset_C Sig_dcycDIAScale_C Sig_Deffuwb100DSMOffset_C Sig_Deffuwb100DSMScale_C Sig_Deffuwb100CANOffset_C Sig_Deffuwb100CANScale_C Sig_Deffuwb100DIAOffset_C Sig_Deffuwb100DIAScale_C Sig_DezUbQ1DSMOffset_C Sig_DezUbQ1DSMScale_C Sig_DezUbQ1CANOffset_C Sig_DezUbQ1CANScale_C Sig_DezUbQ1DIAOffset_C Sig_DezUbQ1DIAScale_C Sig_DezUwQ1DSMOffset_C Sig_DezUwQ1DSMScale_C Sig_DezUwQ1CANOffset_C Sig_DezUwQ1CANScale_C Sig_DezUwQ1DIAOffset_C Sig_DezUwQ1DIAScale_C Sig_dtDSMOffset_C Sig_dtDSMScale_C Sig_dtCANOffset_C Sig_dtCANScale_C Sig_dtDIAOffset_C Sig_dtDIAScale_C Sig_DxsDSMOffset_C Sig_DxsDSMScale_C Sig_DxsCANOffset_C Sig_DxsCANScale_C Sig_DxsDIAOffset_C Sig_DxsDIAScale_C Sig_EnergyDSMOffset_C Sig_EnergyDSMScale_C Sig_EnergyCANOffset_C Sig_EnergyCANScale_C Sig_EnergyDIAOffset_C Sig_EnergyDIAScale_C Sig_factDSMOffset_C Sig_factDSMScale_C Sig_factCANOffset_C Sig_factCANScale_C Sig_factDIAOffset_C Sig_factDIAScale_C Sig_fas1DSMOffset_C Sig_fas1DSMScale_C Sig_fas1CANOffset_C Sig_fas1CANScale_C Sig_fas1DIAOffset_C Sig_fas1DIAScale_C Sig_fas2DSMOffset_C Sig_fas2DSMScale_C Sig_fas2CANOffset_C Sig_fas2CANScale_C Sig_fas2DIAOffset_C Sig_fas2DIAScale_C Sig_fas3DSMOffset_C Sig_fas3DSMScale_C Sig_fas3CANOffset_C Sig_fas3CANScale_C Sig_fas3DIAOffset_C Sig_fas3DIAScale_C Sig_FlConPFltDSMOffset_C Sig_FlConPFltDSMScale_C Sig_FlConPFltCANOffset_C Sig_FlConPFltCANScale_C Sig_FlConPFltDIAOffset_C Sig_FlConPFltDIAScale_C Sig_FlConDSMOffset_C Sig_FlConDSMScale_C Sig_FlConCANOffset_C Sig_FlConCANScale_C Sig_FlConDIAOffset_C Sig_FlConDIAScale_C Sig_FlUlQ0p122DSMOffset_C Sig_FlUlQ0p122DSMScale_C Sig_FlUlQ0p122CANOffset_C Sig_FlUlQ0p122CANScale_C Sig_FlUlQ0p122DIAOffset_C Sig_FlUlQ0p122DIAScale_C Sig_FSwB100DSMOffset_C Sig_FSwB100DSMScale_C Sig_FSwB100CANOffset_C Sig_FSwB100CANScale_C Sig_FSwB100DIAOffset_C Sig_FSwB100DIAScale_C Sig_FSwQ0p00153DSMOffset_C Sig_FSwQ0p00153DSMScale_C Sig_FSwQ0p00153CANOffset_C Sig_FSwQ0p00153CANScale_C Sig_FSwQ0p00153DIAOffset_C Sig_FSwQ0p00153DIAScale_C Sig_InjMassDSMOffset_C Sig_InjMassDSMScale_C Sig_InjMassCANOffset_C Sig_InjMassCANScale_C Sig_InjMassDIAOffset_C Sig_InjMassDIAScale_C Sig_InjTimDSMOffset_C Sig_InjTimDSMScale_C Sig_InjTimCANOffset_C Sig_InjTimCANScale_C Sig_InjTimDIAOffset_C Sig_InjTimDIAScale_C Sig_IUbQ1DSMOffset_C Sig_IUbQ1DSMScale_C Sig_IUbQ1CANOffset_C Sig_IUbQ1CANScale_C Sig_IUbQ1DIAOffset_C Sig_IUbQ1DIAScale_C Sig_IUwQ0p08O200DSMOffset_C Sig_IUwQ0p08O200DSMScale_C Sig_IUwQ0p08O200CANOffset_C Sig_IUwQ0p08O200CANScale_C Sig_IUwQ0p08O200DIAOffset_C Sig_IUwQ0p08O200DIAScale_C Sig_KmSwQ10DSMOffset_C Sig_KmSwQ10DSMScale_C Sig_KmSwQ10CANOffset_C Sig_KmSwQ10CANScale_C Sig_KmSwQ10DIAOffset_C Sig_KmSwQ10DIAScale_C Sig_KmUwQ10DSMOffset_C Sig_KmUwQ10DSMScale_C Sig_KmUwQ10CANOffset_C Sig_KmUwQ10CANScale_C Sig_KmUwQ10DIAOffset_C Sig_KmUwQ10DIAScale_C Sig_LambdaDSMOffset_C Sig_LambdaDSMScale_C Sig_LambdaCANOffset_C Sig_LambdaCANScale_C Sig_LambdaDIAOffset_C Sig_LambdaDIAScale_C Sig_lenPFltDSMOffset_C Sig_lenPFltDSMScale_C Sig_lenPFltCANOffset_C Sig_lenPFltCANScale_C Sig_lenPFltDIAOffset_C Sig_lenPFltDIAScale_C Sig_lenrgnu16PFltDSMOffset_C Sig_lenrgnu16PFltDSMScale_C Sig_lenrgnu16PFltCANOffset_C Sig_lenrgnu16PFltCANScale_C Sig_lenrgnu16PFltDIAOffset_C Sig_lenrgnu16PFltDIAScale_C Sig_lenDSMOffset_C Sig_lenDSMScale_C Sig_lenCANOffset_C Sig_lenCANScale_C Sig_lenDIAOffset_C Sig_lenDIAScale_C Sig_lDSMOffset_C Sig_lDSMScale_C Sig_lCANOffset_C Sig_lCANScale_C Sig_lDIAOffset_C Sig_lDIAScale_C Sig_mAirCylDSMOffset_C Sig_mAirCylDSMScale_C Sig_mAirCylCANOffset_C Sig_mAirCylCANScale_C Sig_mAirCylDIAOffset_C Sig_mAirCylDIAScale_C Sig_mAirTimDSMOffset_C Sig_mAirTimDSMScale_C Sig_mAirTimCANOffset_C Sig_mAirTimCANScale_C Sig_mAirTimDIAOffset_C Sig_mAirTimDIAScale_C Sig_mSootTimDSMOffset_C Sig_mSootTimDSMScale_C Sig_mSootTimCANOffset_C Sig_mSootTimCANScale_C Sig_mSootTimDIAOffset_C Sig_mSootTimDIAScale_C Sig_mSootDSMOffset_C Sig_mSootDSMScale_C Sig_mSootCANOffset_C Sig_mSootCANScale_C Sig_mSootDIAOffset_C Sig_mSootDIAScale_C Sig_nFanSpdDSMOffset_C Sig_nFanSpdDSMScale_C Sig_nFanSpdCANOffset_C Sig_nFanSpdCANScale_C Sig_nFanSpdDIAOffset_C Sig_nFanSpdDIAScale_C Sig_nPSPSpdDSMOffset_C Sig_nPSPSpdDSMScale_C Sig_nPSPSpdCANOffset_C Sig_nPSPSpdCANScale_C Sig_nPSPSpdDIAOffset_C Sig_nPSPSpdDIAScale_C Sig_nDSMOffset_C Sig_nDSMScale_C Sig_nCANOffset_C Sig_nCANScale_C Sig_nDIAOffset_C Sig_nDIAScale_C Sig_O2DSMOffset_C Sig_O2DSMScale_C Sig_O2CANOffset_C Sig_O2CANScale_C Sig_O2DIAOffset_C Sig_O2DIAScale_C Sig_OneToOneZFCDSMOffset_C Sig_OneToOneZFCDSMScale_C Sig_OneToOneZFCCANOffset_C Sig_OneToOneZFCCANScale_C Sig_OneToOneZFCDIAOffset_C Sig_OneToOneZFCDIAScale_C Sig_OneToOneDSMOffset_C Sig_OneToOneDSMScale_C Sig_OneToOneCANOffset_C Sig_OneToOneCANScale_C Sig_OneToOneDIAOffset_C Sig_OneToOneDIAScale_C Sig_OnOffDSMOffset_C Sig_OnOffDSMScale_C Sig_OnOffCANOffset_C Sig_OnOffCANScale_C Sig_OnOffDIAOffset_C Sig_OnOffDIAScale_C Sig_PermUwB6DSMOffset_C Sig_PermUwB6DSMScale_C Sig_PermUwB6CANOffset_C Sig_PermUwB6CANScale_C Sig_PermUwB6DIAOffset_C Sig_PermUwB6DIAScale_C Sig_pRailDSMOffset_C Sig_pRailDSMScale_C Sig_pRailCANOffset_C Sig_pRailCANScale_C Sig_pRailDIAOffset_C Sig_pRailDIAScale_C Sig_pDSMOffset_C Sig_pDSMScale_C Sig_pCANOffset_C Sig_pCANScale_C Sig_pDIAOffset_C Sig_pDIAScale_C Sig_qInjMassCycDSMOffset_C Sig_qInjMassCycDSMScale_C Sig_qInjMassCycCANOffset_C Sig_qInjMassCycCANScale_C Sig_qInjMassCycDIAOffset_C Sig_qInjMassCycDIAScale_C Sig_qInjMassDSMOffset_C Sig_qInjMassDSMScale_C Sig_qInjMassCANOffset_C Sig_qInjMassCANScale_C Sig_qInjMassDIAOffset_C Sig_qInjMassDIAScale_C Sig_qDSMOffset_C Sig_qDSMScale_C Sig_qCANOffset_C Sig_qCANScale_C Sig_qDIAOffset_C Sig_qDIAScale_C Sig_resFlowDSMOffset_C Sig_resFlowDSMScale_C Sig_resFlowCANOffset_C Sig_resFlowCANScale_C Sig_resFlowDIAOffset_C Sig_resFlowDIAScale_C Sig_rVnDSMOffset_C Sig_rVnDSMScale_C Sig_rVnCANOffset_C Sig_rVnCANScale_C Sig_rVnDIAOffset_C Sig_rVnDIAScale_C Sig_rDSMOffset_C Sig_rDSMScale_C Sig_rCANOffset_C Sig_rCANScale_C Sig_rDIAOffset_C Sig_rDIAScale_C Sig_ShftRght0ByteDSMOffset_C Sig_ShftRght0ByteDSMScale_C Sig_ShftRght0ByteCANOffset_C Sig_ShftRght0ByteCANScale_C Sig_ShftRght0ByteDIAOffset_C Sig_ShftRght0ByteDIAScale_C Sig_ShftRght1ByteDSMOffset_C Sig_ShftRght1ByteDSMScale_C Sig_ShftRght1ByteCANOffset_C Sig_ShftRght1ByteCANScale_C Sig_ShftRght1ByteDIAOffset_C Sig_ShftRght1ByteDIAScale_C Sig_ShftRght2ByteDSMOffset_C Sig_ShftRght2ByteDSMScale_C Sig_ShftRght2ByteCANOffset_C Sig_ShftRght2ByteCANScale_C Sig_ShftRght2ByteDIAOffset_C Sig_ShftRght2ByteDIAScale_C Sig_ShftRght3ByteDSMOffset_C Sig_ShftRght3ByteDSMScale_C Sig_ShftRght3ByteCANOffset_C Sig_ShftRght3ByteCANScale_C Sig_ShftRght3ByteDIAOffset_C Sig_ShftRght3ByteDIAScale_C Sig_TdUbQ0p5DSMOffset_C Sig_TdUbQ0p5DSMScale_C Sig_TdUbQ0p5CANOffset_C Sig_TdUbQ0p5CANScale_C Sig_TdUbQ0p5DIAOffset_C Sig_TdUbQ0p5DIAScale_C Sig_TdUbQ14p9333DSMOffset_C Sig_TdUbQ14p9333DSMScale_C Sig_TdUbQ14p9333CANOffset_C Sig_TdUbQ14p9333CANScale_C Sig_TdUbQ14p9333DIAOffset_C Sig_TdUbQ14p9333DIAScale_C Sig_tExhaustgasDSMOffset_C Sig_tExhaustgasDSMScale_C Sig_tExhaustgasCANOffset_C Sig_tExhaustgasCANScale_C Sig_tExhaustgasDIAOffset_C Sig_tExhaustgasDIAScale_C Sig_timEngDSMOffset_C Sig_timEngDSMScale_C Sig_timEngCANOffset_C Sig_timEngCANScale_C Sig_timEngDIAOffset_C Sig_timEngDIAScale_C Sig_Time_PwmHighDSMOffset_C Sig_Time_PwmHighDSMScale_C Sig_Time_PwmHighCANOffset_C Sig_Time_PwmHighCANScale_C Sig_Time_PwmHighDIAOffset_C Sig_Time_PwmHighDIAScale_C Sig_timsDSMOffset_C Sig_timsDSMScale_C Sig_timsCANOffset_C Sig_timsCANScale_C Sig_timsDIAOffset_C Sig_timsDIAScale_C Sig_tiOprgnu16PFltDSMOffset_C Sig_tiOprgnu16PFltDSMScale_C Sig_tiOprgnu16PFltCANOffset_C Sig_tiOprgnu16PFltCANScale_C Sig_tiOprgnu16PFltDIAOffset_C Sig_tiOprgnu16PFltDIAScale_C Sig_tisDcDSMOffset_C Sig_tisDcDSMScale_C Sig_tisDcCANOffset_C Sig_tisDcCANScale_C Sig_tisDcDIAOffset_C Sig_tisDcDIAScale_C Sig_tisDSMOffset_C Sig_tisDSMScale_C Sig_tisCANOffset_C Sig_tisCANScale_C Sig_tisDIAOffset_C Sig_tisDIAScale_C Sig_trqPrpDSMOffset_C Sig_trqPrpDSMScale_C Sig_trqPrpCANOffset_C Sig_trqPrpCANScale_C Sig_trqPrpDIAOffset_C Sig_trqPrpDIAScale_C Sig_trqDSMOffset_C Sig_trqDSMScale_C Sig_trqCANOffset_C Sig_trqCANScale_C Sig_trqDIAOffset_C Sig_trqDIAScale_C Sig_TSwQ0p1DSMOffset_C Sig_TSwQ0p1DSMScale_C Sig_TSwQ0p1CANOffset_C Sig_TSwQ0p1CANScale_C Sig_TSwQ0p1DIAOffset_C Sig_TSwQ0p1DIAScale_C Sig_tDSMOffset_C Sig_tDSMScale_C Sig_tCANOffset_C Sig_tCANScale_C Sig_tDIAOffset_C Sig_tDIAScale_C Sig_uBattDSMOffset_C Sig_uBattDSMScale_C Sig_uBattCANOffset_C Sig_uBattCANScale_C Sig_uBattDIAOffset_C Sig_uBattDIAScale_C Sig_UUwQ0p1DSMOffset_C Sig_UUwQ0p1DSMScale_C Sig_UUwQ0p1CANOffset_C Sig_UUwQ0p1CANScale_C Sig_UUwQ0p1DIAOffset_C Sig_UUwQ0p1DIAScale_C Sig_UUwQ0p25em3DSMOffset_C Sig_UUwQ0p25em3DSMScale_C Sig_UUwQ0p25em3CANOffset_C Sig_UUwQ0p25em3CANScale_C Sig_UUwQ0p25em3DIAOffset_C Sig_UUwQ0p25em3DIAScale_C Sig_uDSMOffset_C Sig_uDSMScale_C Sig_uCANOffset_C Sig_uCANScale_C Sig_uDIAOffset_C Sig_uDIAScale_C Sig_volphDSMOffset_C Sig_volphDSMScale_C Sig_volphCANOffset_C Sig_volphCANScale_C Sig_volphDIAOffset_C Sig_volphDIAScale_C Sig_volRailDSMOffset_C Sig_volRailDSMScale_C Sig_volRailCANOffset_C Sig_volRailCANScale_C Sig_volRailDIAOffset_C Sig_volRailDIAScale_C Sig_volDSMOffset_C Sig_volDSMScale_C Sig_volCANOffset_C Sig_volCANScale_C Sig_volDIAOffset_C Sig_volDIAScale_C Sig_vDSMOffset_C Sig_vDSMScale_C Sig_vCANOffset_C Sig_vCANScale_C Sig_vDIAOffset_C Sig_vDIAScale_C /end DEF_CHARACTERISTIC
/end FUNCTION
/begin FUNCTION signals_limits ""
 /begin DEF_CHARACTERISTIC Sig_LimLowDigital_C Sig_LimUpDigital_C Sig_LimLowFlCon_C Sig_LimUpFlCon_C Sig_LimLown_C Sig_LimUpn_C Sig_LimLowPwm_C Sig_LimUpPwm_C Sig_LimLowtrq_C Sig_LimUptrq_C /end DEF_CHARACTERISTIC
/end FUNCTION
/begin FUNCTION signals_model "" /end FUNCTION
/begin FUNCTION signals_mon ""
 /begin DEF_CHARACTERISTIC signals_tiTstDemHeal_C signals_tiTstDemMax_C signals_TmrBehaviour_C signals_TstDemMaxEngN_C signals_TstDemMaxVSSCDV_C /end DEF_CHARACTERISTIC
/end FUNCTION
/begin FUNCTION signals_project "" /end FUNCTION
/begin FUNCTION signals_uic ""
 /begin OUT_MEASUREMENT signals_stTestNLim_mp signals_stTest_mp signals_tiTstRemain_mp /end OUT_MEASUREMENT
/end FUNCTION
/begin FUNCTION sigtst_auto ""
 /begin DEF_CHARACTERISTIC SigTst_ACEn_C SigTst_AOHtEn_C SigTst_BPAEn_C SigTst_CpBVlvEn_C SigTst_EBAFEn_C SigTst_EBFEn_C SigTst_EGPpEn_C SigTst_EGREn_C SigTst_ETClbCorOffEn_C SigTst_FANEn_C SigTst_GLWRLYEn_C SigTst_LPAEn_C SigTst_LSUCDHt0En_C SigTst_MILLAMPEn_C SigTst_MNTCTLEn_C SigTst_MeUnEn_C SigTst_PCVEn_C SigTst_PSPEn_C SigTst_PSPoverCANEn_C SigTst_SYSLAMPEn_C SigTst_ShuttrEn_C SigTst_TVAEn_C SigTst_VSAEn_C /end DEF_CHARACTERISTIC
/end FUNCTION
/begin FUNCTION soptst "Power-Up-Function test of disabling security pathes" /begin DEF_CHARACTERISTIC SOPTst_stRcyDem_C SOPTst_stShOffPathActv_C /end DEF_CHARACTERISTIC /end FUNCTION
/begin FUNCTION soptst_msg "" /begin OUT_MEASUREMENT SOPTst_stCyl /end OUT_MEASUREMENT /end FUNCTION
/begin FUNCTION spmon "Stack pointer Überwachung" /begin DEF_CHARACTERISTIC SPMon_swtRstStackMon_C /end DEF_CHARACTERISTIC /begin OUT_MEASUREMENT SPMon_numFreeErcosekStack_mp SPMon_numFreeUserStack_mp /end OUT_MEASUREMENT /end FUNCTION
/begin FUNCTION srvpmp "Servopumpe"
 /begin DEF_CHARACTERISTIC SrvPmp_facSTWAV_CUR SrvPmp_facVS_CUR SrvPmp_rTrans_C SrvPmp_trqSTWABase_CUR /end DEF_CHARACTERISTIC
 /begin IN_MEASUREMENT FrmMng_phiStrg SrvPmp_dphiStrg_mp VSSCD_v /end IN_MEASUREMENT
/end FUNCTION
/begin FUNCTION srvpmp_msg "" /begin OUT_MEASUREMENT SrvPmp_pwrDes SrvPmp_pwrLead /end OUT_MEASUREMENT /end FUNCTION
/begin FUNCTION srvpmp_uic "" /begin OUT_MEASUREMENT SrvPmp_dphiStrg_mp SrvPmp_trqDes_mp /end OUT_MEASUREMENT /end FUNCTION
/begin FUNCTION sspmon "Versorgungsspannungsüberwachung"
 /begin DEF_CHARACTERISTIC SSpMon_DebSRCHighSplyVltgDef1_C SSpMon_DebSRCHighSplyVltgOk1_C SSpMon_DebSRCHighSplyVltgDef2_C SSpMon_DebSRCHighSplyVltgOk2_C SSpMon_DebSRCHighSplyVltgDef3_C SSpMon_DebSRCHighSplyVltgOk3_C SSpMon_DebSRCLowSplyVltgDef1_C SSpMon_DebSRCLowSplyVltgOk1_C SSpMon_DebSRCLowSplyVltgDef2_C SSpMon_DebSRCLowSplyVltgOk2_C SSpMon_DebSRCLowSplyVltgDef3_C SSpMon_DebSRCLowSplyVltgOk3_C SSpMon_numDiaVltg1_C SSpMon_numDiaVltg2_C SSpMon_numDiaVltg3_C /end DEF_CHARACTERISTIC
/end FUNCTION
/begin FUNCTION sspmon_msg "" /begin OUT_MEASUREMENT SSpMon_stSSpErr /end OUT_MEASUREMENT /end FUNCTION
/begin FUNCTION sspmon_uic "" /begin OUT_MEASUREMENT SSpMon_stRaw_1_mp SSpMon_stRaw_2_mp SSpMon_stRaw_3_mp /end OUT_MEASUREMENT /end FUNCTION
/begin FUNCTION stdpwm_pwrstg "" /end FUNCTION
/begin FUNCTION strtcd_actrout "Starterrelais Steller"
 /begin DEF_CHARACTERISTIC StrtCD_ActrDebExcTempDef_C StrtCD_ActrDebExcTempOk_C StrtCD_ActrDebNoLoadDef_C StrtCD_ActrDebNoLoadOk_C StrtCD_ActrDebShrtCBatDef_C StrtCD_ActrDebShrtCBatOk_C StrtCD_ActrDebShrtCGndDef_C StrtCD_ActrDebShrtCGndOk_C StrtCD_ctPwrStgOnMax_C StrtCD_numDia_C StrtCD_numDioOut_C StrtCD_stActrInvOut_C StrtCD_stPwrStgActrActv_C StrtCD_stPwrStgActrDia_C StrtCD_stSPICtl_C StrtCD_tiBtwTst_C StrtCD_tiPwrStgOn_C /end DEF_CHARACTERISTIC
/end FUNCTION
/begin FUNCTION strtcd_actrout_uic "" /begin OUT_MEASUREMENT StrtCD_stHWE_mp /end OUT_MEASUREMENT /end FUNCTION
/begin FUNCTION stsys "Startsystem" /begin DEF_CHARACTERISTIC StSys_tiStrtLck_C StSys_tiStrtMax_C /end DEF_CHARACTERISTIC /end FUNCTION
/begin FUNCTION stsys_addcor "Startmomentenkorrektur"
 /begin DEF_CHARACTERISTIC StSys_facAPSCor_CUR StSys_numStrtAddCor_C StSys_trqStrtAPSCor_MAP /end DEF_CHARACTERISTIC
 /begin IN_MEASUREMENT APSCD_pVal Eng_nAvrg StSys_tStrtBas_mp /end IN_MEASUREMENT
/end FUNCTION
/begin FUNCTION stsys_addcor_msg "" /begin OUT_MEASUREMENT StSys_trqAddCor /end OUT_MEASUREMENT /end FUNCTION
/begin FUNCTION stsys_addcor_uic ""
 /begin OUT_MEASUREMENT StSys_facAPSCor_mp StSys_trqStrtAPSCor_mp StSys_trqStrtAPS_mp StSys_tStrtBas_mp /end OUT_MEASUREMENT
/end FUNCTION
/begin FUNCTION stsys_strt "Startabwurf" /begin DEF_CHARACTERISTIC StSys_nStrtCutOut_MAP StSys_numStrt_C StSys_tiStrtCutOut_C /end DEF_CHARACTERISTIC /begin IN_MEASUREMENT APSCD_pVal StSys_tStrt_mp /end IN_MEASUREMENT /end FUNCTION
/begin FUNCTION stsys_strtbas "Startbasismoment"
 /begin DEF_CHARACTERISTIC StSys_nAdjMax_C StSys_trqAdjMax_C StSys_trqAdjVal_C StSys_trqStrtBas_MAP /end DEF_CHARACTERISTIC
 /begin IN_MEASUREMENT Eng_nAvrg StSys_tStrtBas_mp /end IN_MEASUREMENT
/end FUNCTION
/begin FUNCTION stsys_strtbas_msg "" /begin OUT_MEASUREMENT StSys_trqBas /end OUT_MEASUREMENT /end FUNCTION
/begin FUNCTION stsys_strtbas_uic "" /begin OUT_MEASUREMENT StSys_trqAdj_mp StSys_trqSetAdjVal_mp StSys_trqStrtBas_mp /end OUT_MEASUREMENT /end FUNCTION
/begin FUNCTION stsys_strtctl "Startsystem Anlassersteuerung"
 /begin DEF_CHARACTERISTIC StSys_nDiseng_C StSys_nEngage_C Stsys_swtGlwLamp_C StSys_tiLckCutOut_C /end DEF_CHARACTERISTIC
/end FUNCTION
/begin FUNCTION stsys_strtctl_msg "" /begin OUT_MEASUREMENT StSys_stActrOut /end OUT_MEASUREMENT /end FUNCTION
/begin FUNCTION stsys_strtctl_uic "" /begin OUT_MEASUREMENT StSys_stActrLck_mp StSys_stActrRls_mp /end OUT_MEASUREMENT /end FUNCTION
/begin FUNCTION stsys_strtrmp "Startrampe"
 /begin DEF_CHARACTERISTIC StSys_nFreezeTrqRmp_C StSys_nReleaseTrqRmp_C StSys_numStrtRmp_C StSys_tClntHi_C StSys_tClntLo_C StSys_tiEngTempValid_C StSys_dtrqColdInc_C StSys_tiColdRmpLck_C StSys_trqColdLim_C StSys_dtrqHotInc_C StSys_tiHotRmpLck_C StSys_trqHotLim_C StSys_dtrqWarmInc_C StSys_tiWarmRmpLck_C StSys_trqWarmLim_C /end DEF_CHARACTERISTIC
/end FUNCTION
/begin FUNCTION stsys_strtrmp_msg "" /begin OUT_MEASUREMENT StSys_stRmpMon StSys_trqRmpState StSys_trqStrt /end OUT_MEASUREMENT /end FUNCTION
/begin FUNCTION stsys_strtrmp_uic "" /begin OUT_MEASUREMENT StSys_tStrtRmp_mp /end OUT_MEASUREMENT /end FUNCTION
/begin FUNCTION stsys_strttip "Tip Start (Automatik Start)"
 /begin DEF_CHARACTERISTIC StSys_nStrtTipMax_MAP StSys_nStrtTipProtCaS_C StSys_nStrtTipProt_C StSys_swtShOffGearbxRec_C StSys_swtStrtTipActv_C StSys_tiStrtTipMin_C StSys_tiStrtTipNoMonitor_C StSys_tiStrtTipProt_C /end DEF_CHARACTERISTIC
 /begin IN_MEASUREMENT APSCD_pVal Eng_tEng /end IN_MEASUREMENT
/end FUNCTION
/begin FUNCTION stsys_strttip_msg "" /begin OUT_MEASUREMENT StSys_stStrtTip StSys_stStrtTipOFF StSys_stStrtTipON /end OUT_MEASUREMENT /end FUNCTION
/begin FUNCTION stsys_strttip_uic "" /end FUNCTION
/begin FUNCTION stsys_strt_msg "" /begin OUT_MEASUREMENT StSys_stNewStrt StSys_stStrt StSys_stStrtCutOutMon /end OUT_MEASUREMENT /end FUNCTION
/begin FUNCTION stsys_strt_uic "" /begin OUT_MEASUREMENT StSys_nThresStrtCutOut_mp StSys_tStrt_mp /end OUT_MEASUREMENT /end FUNCTION
/begin FUNCTION stsys_t50shutoff ""
 /begin DEF_CHARACTERISTIC StSys_DebTrqShutOffDef_C StSys_DebTrqShutOffOk_C StSys_nStarter_C StSys_tiEngageCutOut_C StSys_vThres_C /end DEF_CHARACTERISTIC
/end FUNCTION
/begin FUNCTION stsys_t50shutoff_uic "" /begin OUT_MEASUREMENT StSys_stTrqShutOffErr_mp /end OUT_MEASUREMENT /end FUNCTION
/begin FUNCTION stsys_trqshutoff "Startmomentabschaltung"
 /begin DEF_CHARACTERISTIC StSys_n2MsWhlLoLim_C StSys_n2MsWhlUpOfs_C StSys_tinFltPT1_C StSys_swtShutOff_C StSys_ti2MsWhlPrt_C StSys_tiStartOszilDef_C StSys_tiStartOszilOk_C /end DEF_CHARACTERISTIC
/end FUNCTION
/begin FUNCTION stsys_trqshutoff_msg "" /begin OUT_MEASUREMENT StSys_stTrqShutOff /end OUT_MEASUREMENT /end FUNCTION
/begin FUNCTION stsys_trqshutoff_uic "" /begin OUT_MEASUREMENT StSys_nAvrgFlt_mp StSys_stTrqShutOffCond_mp /end OUT_MEASUREMENT /end FUNCTION
/begin FUNCTION switches_base "" /end FUNCTION
/begin FUNCTION switches_proj "" /end FUNCTION
/begin FUNCTION switches_sys "" /end FUNCTION
/begin FUNCTION swtmr_inc10ms "" /end FUNCTION
/begin FUNCTION swtmr_inc10ms_uic "" /end FUNCTION
/begin FUNCTION swtmr_msg "" /begin OUT_MEASUREMENT SWTmr_tiTmr16 SWTmr_tiTmr32 /end OUT_MEASUREMENT /end FUNCTION
/begin FUNCTION system_const_base "" /end FUNCTION
/begin FUNCTION system_const_conf "" /end FUNCTION
/begin FUNCTION system_const_proj "" /end FUNCTION
/begin FUNCTION system_const_sys "" /end FUNCTION
/begin FUNCTION t15cd "Klemme 15 Komponententreiber"
 /begin DEF_CHARACTERISTIC T15CD_tiDebNeg_C T15CD_tiDebPos_C T15CD_DebNplDef_C T15CD_DebNplOk_C T15CD_numDioIn_C T15CD_stInvIn_C T15CD_tiDebWakeUp_C /end DEF_CHARACTERISTIC
/end FUNCTION
/begin FUNCTION t15cd_msg "" /begin OUT_MEASUREMENT T15CD_stDebVal T15CD_stDebWakeUpVal T15CD_stWakeUp /end OUT_MEASUREMENT /end FUNCTION
/begin FUNCTION t15cd_uic ""
 /begin OUT_MEASUREMENT T15CD_stCondDebVal_mp T15CD_stLogicT15_mp T15CD_stWakeUpRawVal_mp /end OUT_MEASUREMENT
/end FUNCTION
/begin FUNCTION t50cd "Komponententreiber Klemme 50"
 /begin DEF_CHARACTERISTIC T50CD_tiDebNeg_C T50CD_tiDebPos_C T50CD_stDflVal_C T50CD_stInv_C T50CD_swtSigVal_C /end DEF_CHARACTERISTIC
/end FUNCTION
/begin FUNCTION t50cd_msg "" /begin OUT_MEASUREMENT T50CD_stDebVal T50CD_stRawVal T50CD_swtSig /end OUT_MEASUREMENT /end FUNCTION
/begin FUNCTION t50cd_uic "" /end FUNCTION
/begin FUNCTION thrvlv_co "actuator coordinator for Throttle Valve" /end FUNCTION
/begin FUNCTION thrvlv_co_msg "" /begin OUT_MEASUREMENT ThrVlv_rTVA /end OUT_MEASUREMENT /end FUNCTION
/begin FUNCTION thrvlv_co_uic "" /begin DEF_CHARACTERISTIC ThrVlv_rTVA_Vector ThrVlv_rTVA_Channel /end DEF_CHARACTERISTIC /begin OUT_MEASUREMENT ThrVlv_rTVAByp_mp /end OUT_MEASUREMENT /end FUNCTION
/begin FUNCTION tpumon "Timer Überwachung"
 /begin DEF_CHARACTERISTIC TPUMon_ctDfctLim_C TPUMon_ctTPU_C TPUMon_tiDiffMaxLimit_C TPUMon_tiDiffMinLimit_C TPUMon_tiDiffSumLimit_C /end DEF_CHARACTERISTIC
/end FUNCTION
/begin FUNCTION tpumon_uic ""
 /begin OUT_MEASUREMENT TPUMon_ctUpDwnDeb_mp TPUMon_tiDiffMax_mp TPUMon_tiDiffMin_mp TPUMon_tiDiffSum_mp /end OUT_MEASUREMENT
/end FUNCTION
/begin FUNCTION tvacd "Drosselklappensteller Komponententreiber"
 /begin DEF_CHARACTERISTIC TVACD_ctPwrStgOnMax_C TVACD_DebExcTempDef_C TVACD_DebExcTempOk_C TVACD_DebNoLoadDef_C TVACD_DebNoLoadOk_C TVACD_DebShortCircBatDef_C TVACD_DebShortCircBatOk_C TVACD_DebShortCircGndDef_C TVACD_DebShortCircGndOk_C TVACD_tiDebTVADia1Def_C TVACD_tiDebTVADia1Ok_C TVACD_tiDebTVADia2Def_C TVACD_tiDebTVADia2Ok_C TVACD_tiDebTVADia3Def_C TVACD_tiDebTVADia3Ok_C TVACD_tiDebTVADia4Def_C TVACD_tiDebTVADia4Ok_C TVACD_numDia_C TVACD_numPwmOut_C TVACD_stInvOut_C TVACD_tiPer_C TVACD_rCnv_CUR TVACD_rOutMax_C TVACD_rOutMin_C TVACD_rTst_C TVACD_stPwrStgActv_C TVACD_stPwrStgDia_C TVACD_stSPICtl_C TVACD_swt_C TVACD_tiBtwTst_C TVACD_tiDiag1Max_C TVACD_tiDiag1Min_C TVACD_tiDiag2Max_C TVACD_tiDiag2Min_C TVACD_tiDiag3Max_C TVACD_tiDiag3Min_C TVACD_tiDiag4Max_C TVACD_tiDiag4Min_C TVACD_tiPwrStgOn_C /end DEF_CHARACTERISTIC
 /begin IN_MEASUREMENT ThrVlv_rTVA /end IN_MEASUREMENT
/end FUNCTION
/begin FUNCTION tvacd_msg "" /begin OUT_MEASUREMENT TVACD_rOut /end OUT_MEASUREMENT /end FUNCTION
/begin FUNCTION tvacd_uic "" /begin OUT_MEASUREMENT TVACD_rCnv_mp TVACD_stErr_mp /end OUT_MEASUREMENT /end FUNCTION
/begin FUNCTION uaddr "" /begin DEF_CHARACTERISTIC UAddr_stCalibration_C Uaddr_stMeasurement_C /end DEF_CHARACTERISTIC /end FUNCTION
/begin FUNCTION usap "Datensatzvarianten Bezeichner" /begin DEF_CHARACTERISTIC USAp_dDataVariantIdInv_C USAp_dDataVariantId_C /end DEF_CHARACTERISTIC /begin OUT_MEASUREMENT USAp_dDataVariant_u8 USAp_stDataVariant_u8 /end OUT_MEASUREMENT /end FUNCTION
/begin FUNCTION usrda "Benutzergrößen" /begin DEF_CHARACTERISTIC UsrDa_swtFDC_C /end DEF_CHARACTERISTIC /end FUNCTION
/begin FUNCTION usrda_msg "" /begin OUT_MEASUREMENT UsrDa_stFDC UsrDa_stRecFDC /end OUT_MEASUREMENT /end FUNCTION
/begin FUNCTION usrda_uic "" /end FUNCTION
/begin FUNCTION vehda "Fahrzeuggrößen" /begin DEF_CHARACTERISTIC VehDa_rVnMax_C VehDa_tiNPT1_C VehDa_tiVnPT1_C /end DEF_CHARACTERISTIC /end FUNCTION
/begin FUNCTION vehda_loadcalc "Ermittlung des Fahrzeugnutzungsprofil"
 /begin DEF_CHARACTERISTIC VehDa_nLoadActv_C VehDa_nLoad_C VehDa_swtRst_C VehDa_trqLoad_C /end DEF_CHARACTERISTIC
 /begin OUT_MEASUREMENT VehDa_ctLoadPrimRow0_mp VehDa_ctLoadPrimRow1_mp VehDa_ctLoadPrimRow2_mp VehDa_ctLoadPrimRow3_mp VehDa_ctLoadPrimRow4_mp VehDa_ctLoadPrimRow5_mp VehDa_ctLoadSecRow0_mp VehDa_ctLoadSecRow1_mp VehDa_ctLoadSecRow2_mp VehDa_ctLoadSecRow3_mp VehDa_ctLoadSecRow4_mp VehDa_ctLoadSecRow5_mp VehDa_tiLoadPrim_mp VehDa_tiLoadSec_mp /end OUT_MEASUREMENT
/end FUNCTION
/begin FUNCTION vehda_loadcalc_uic "" /end FUNCTION
/begin FUNCTION vehda_lsum "Erfassung gefahrene Strecke" /end FUNCTION
/begin FUNCTION vehda_lsum_msg "" /begin OUT_MEASUREMENT VehDa_lSum /end OUT_MEASUREMENT /end FUNCTION
/begin FUNCTION vehda_lsum_uic "" /begin OUT_MEASUREMENT VehDa_lInt_mp /end OUT_MEASUREMENT /end FUNCTION
/begin FUNCTION vehda_msg "" /begin OUT_MEASUREMENT VehDa_rVn VehDa_stTrqDem /end OUT_MEASUREMENT /end FUNCTION
/begin FUNCTION vehda_tiengon "Erfassung der aktuellen Betriebszeit" /begin DEF_CHARACTERISTIC VehDa_lEepUpd_C VehDa_nMaxEepUpd_C VehDa_nMinEepUpd_C /end DEF_CHARACTERISTIC /end FUNCTION
/begin FUNCTION vehda_tiengon_msg "" /begin OUT_MEASUREMENT VehDa_tiEngOn /end OUT_MEASUREMENT /end FUNCTION
/begin FUNCTION vehda_tiengon_uic "" /end FUNCTION
/begin FUNCTION vehda_uic "" /begin OUT_MEASUREMENT VehDa_nEngFilt_mp /end OUT_MEASUREMENT /end FUNCTION
/begin FUNCTION vehmot "Fahrzeugbewegung" /end FUNCTION
/begin FUNCTION vehmot_msg "" /begin OUT_MEASUREMENT VehMot_nMax VehMot_nMin VehMot_pwrAcsDes VehMot_pwrAcsLead /end OUT_MEASUREMENT /end FUNCTION
/begin FUNCTION vesgov_governor "Arbeitsdrehzahlregler" /end FUNCTION
/begin FUNCTION vesgov_governor_msg "" /begin OUT_MEASUREMENT VESGov_trq /end OUT_MEASUREMENT /end FUNCTION
/begin FUNCTION vesgov_governor_uic "" /end FUNCTION
/begin COMPU_METHOD AngleGrad "Winkelanzeige in Grad" RAT_FUNC "%6.4" "Grad" COEFFS 0 22.7531285551763 0 0 0 1 /end COMPU_METHOD
/begin COMPU_METHOD AngleGradPerSec "Winkelanzeige in Grad pro Sekunde" RAT_FUNC "%6.4" "Grad/s" COEFFS 0 22.7531285551763 0 0 0 1 /end COMPU_METHOD
/begin COMPU_METHOD Dist_20ms "Entfernung durch Aufsummierung Fahrgeschwindigkeit (Vel/VelSI) im 20 ms Raster" RAT_FUNC "%7.6" "m" COEFFS 0 18000 0 0 0 1 /end COMPU_METHOD
/begin COMPU_METHOD DtyCyc "Tastverhaeltnis" RAT_FUNC "%6.4" "%" COEFFS 0 100 0 0 0 1 /end COMPU_METHOD
/begin COMPU_METHOD EngN "Motordrehzahl" RAT_FUNC "%6.2" "rpm" COEFFS 0 1 0 0 0 1 /end COMPU_METHOD
/begin COMPU_METHOD EngTempFldSel "Verbale Umrechnung für Auswahl aus dem Motortemperatur-Feld Eng_tFld" TAB_VERB "%6.3" "-" COMPU_TAB_REF EngTempFldSel /end COMPU_METHOD
/begin COMPU_VTAB EngTempFldSel "Verbale Umrechnung für Auswahl aus dem Motortemperatur-Feld Eng_tFld" TAB_VERB 3 0 "Coolant_Temperature" 1 "Oil_Temperature" 2 "Eng_tEng" /end COMPU_VTAB
/begin COMPU_METHOD Fact "Faktor mit Auflösung 1 / 8192, hauptsächlich für einen Faktorenbereich 0...1 verwendet" RAT_FUNC "%6.5" "-" COEFFS 0 8192 0 0 0 1 /end COMPU_METHOD
/begin COMPU_METHOD FlConsum_l_h "Kraftstoffverbrauch" RAT_FUNC "%6.4" "l/h" COEFFS 0 100 0 0 0 1 /end COMPU_METHOD
/begin COMPU_METHOD Length "Länge in Meter" RAT_FUNC "%6.2" "m" COEFFS 0 1 0 0 0 1 /end COMPU_METHOD
/begin COMPU_METHOD NumPinDia "Verbale Umrechnung für Diagnose Signale" TAB_VERB "%6.3" "-" COMPU_TAB_REF NumPinDia /end COMPU_METHOD
/begin COMPU_VTAB NumPinDia "Verbale Umrechnung für Diagnose Signale" TAB_VERB 28 0 "CJ945_Diagnostic_Signal" 1 "AC_Compressor_DiaSig" 2 "Fuel_Pump_Diagnostic_Signal_232" 3 "Starter_234" 4 "Oil_Pressure_Lamp_Switch_245" 5 "Engine_Bay_Air_Flaps_123" 6 "Ebox_Fan_Actuator_Diagnostic_Signal_219" 7 "Shuttr_Actuator_Diagnostic_Signal_231" 8 "Twostage_TurboLoading_SW_DiaSig" 9 "DIO_OUT_DIAGNOSTIC_DUMMY_NOT_USED" 10 "Alternator" 11 "Boost_Pressure_Actuator_Diagnostic_Signal_193" 12 "EGR_Actuator_Diagnostic_Signal_194" 13 "1st_Pressure_Control_Valve_Diagnostic_Signal_172" 14 "2nd_Pressure_Control_Valve_Diagnostic_Signal_172" 15 "1st_Metering_Unit_Diagnostic_Signal_171" 16 "2nd_Metering_Unit_Diagnostic_Signal_171" 17 "Variable_Swirl_Actuator_Diagnostic_Signal_195" 18 "FAN_240" 19 "Add_On_Heater_244" 20 "EngM_Bearing_Actuator_Diagnostic_Signal_124" 21 "EngM_Bearing_Actuator_Diagnostic_Signal_121" 22 "Throttle_Valve_Diagnostic_Signal_196" 23 "Low pressure stage BPA_Diagnostic_Signal_117" 24 "PWM_DIAGNOSTIC_DUMMY_NOT_USED" 25 "1st_Sensor_Supply_Voltage_DiaSig" 26 "2nd_Sensor_Supply_Voltage_DiaSig" 27 "3rd_Sensor_Supply_Voltage_DiaSig" /end COMPU_VTAB
/begin COMPU_METHOD NumPinDioIn "Verbale Umrechnung für Digitaleingang Signale" TAB_VERB "%6.3" "-" COMPU_TAB_REF NumPinDioIn /end COMPU_METHOD
/begin COMPU_VTAB NumPinDioIn "Verbale Umrechnung für Digitaleingang Signale" TAB_VERB 15 0 "Terminal_15_207" 1 "Main_Brake_Switch_236" 2 "Redundant_Brake_Switch_223" 3 "Clutch_Switch" 4 "Terminal_50_224" 5 "ECU_selection_Switch_251" 6 "FlFlt_Switch_211" 7 "Coolant-heater_212" 8 "Redundant_Terminal_15_209(118)" 9 "AC-compressor_overboost_213" 10 "Additive_tank_level_switch_235" 11 "Terminal_61_113" 12 "Lambda_Regeneration" 13 "Oil_Level_sensor_138" 14 "DIO_IN_DUMMY_NOT_USED" /end COMPU_VTAB
/begin COMPU_METHOD NumPinDioOut "Verbale Umrechnung für Digitalausgang Signale" TAB_VERB "%6.3" "-" COMPU_TAB_REF NumPinDioOut /end COMPU_METHOD
/begin COMPU_VTAB NumPinDioOut "Verbale Umrechnung für Digitalausgang Signale" TAB_VERB 12 0 "Main_Relay_220(144)" 1 "AC_Compressor" 2 "Fuel_Pump_232" 3 "Starter_234" 4 "OPS_Lamp_245" 5 "EBAF_123" 6 "Ebox_Fan_Actuator_219" 7 "Shuttr_Actuator_Digital_231" 8 "STATREG_PSOFF_Bit" 9 "Twostage_TurboLoading_120" 10 "TD_Signal_253" 11 "DIO_OUT_DUMMY_NOT_USED" /end COMPU_VTAB
/begin COMPU_METHOD NumPinPwmOut "Verbale Umrechnung für PWM-Ausgang Signale" TAB_VERB "%6.3" "-" COMPU_TAB_REF NumPinPwmOut /end COMPU_METHOD
/begin COMPU_VTAB NumPinPwmOut "Verbale Umrechnung für PWM-Ausgang Signale" TAB_VERB 14 0 "Boost_Pressure_Actuator_193" 1 "EGR_Actuator_194" 2 "PCV_Actuator_172" 3 "MeUn_Actuator_171" 4 "Variable_Swirl_Actuator_195" 5 "Fan_Actuator_240" 6 "Add_On_Heater_244" 7 "EngM_Bearing_Actuator_124" 8 "EngM_Bearing_Actuator_121" 9 "Throttle_Valve_196" 10 "LSU_Heater_PWMOutput" 11 "Low pressure stage BPA_117" 12 "Shuttr_Actuator_PWM_231" 13 "PWM_DUMMY_NOT_USED" /end COMPU_VTAB
/begin COMPU_METHOD OneToOne "eins zu eins (physikalischer Wert ist gleich dem internen Wert)" RAT_FUNC "%6.2" "-" COEFFS 0 1 0 0 0 1 /end COMPU_METHOD
/begin COMPU_METHOD Period "Periodendauer" RAT_FUNC "%6.3" "ms" COEFFS 0 10 0 0 0 1 /end COMPU_METHOD
/begin COMPU_METHOD Prc "Prozent, gleiche interne Auflösung wie Fact, aber Darstellung in Prozent (0...100%)" RAT_FUNC "%6.4" "%" COEFFS 0 81.92 0 0 0 1 /end COMPU_METHOD
/begin COMPU_METHOD Pres_hPa "Druck (angezeigt in [hPa])" RAT_FUNC "%6.2" "hPa" COEFFS 0 1 0 0 0 1 /end COMPU_METHOD
/begin COMPU_METHOD Pwr "Leistung" RAT_FUNC "%6.2" "W" COEFFS 0 0.10610329539459 0 0 0 1 /end COMPU_METHOD
/begin COMPU_METHOD RmpTrq "Rampengradient für Motormoment" RAT_FUNC "%6.4" "Nm/s" COEFFS 0 655.36 0 0 0 1 /end COMPU_METHOD
/begin COMPU_METHOD SigDatatyp "verbale Umrechnung für die auswahl eines Datentyps eines frei applizierbaren Signals" TAB_VERB "%6.3" "-" COMPU_TAB_REF SigDatatyp /end COMPU_METHOD
/begin COMPU_VTAB SigDatatyp "verbale Umrechnung für die auswahl eines Datentyps eines frei applizierbaren Signals" TAB_VERB 6 0 "SIG_SINT16" 1 "SIG_UINT16" 2 "SIG_SINT8" 3 "SIG_UINT8 or SIG_BOOL" 4 "SIG_SINT32" 5 "SIG_UINT32" /end COMPU_VTAB
/begin COMPU_METHOD Temp_Cels "Temperatur dargestellt in °C (gleiche interne Darstellung wie Temp_Kelv)" RAT_FUNC "%6.1" "deg C" COEFFS 0 10 2731.4 0 0 1 /end COMPU_METHOD
/begin COMPU_METHOD TimeDeb "Entprellzeit in Millisekunden für Libraryfunktion Debounce" RAT_FUNC "%6.1" "ms" COEFFS 0 0.1 0 0 0 1 /end COMPU_METHOD
/begin COMPU_METHOD TimeDelay_s "Zeitkonstante T1 (in s) für PT1, DT1, etc." RAT_FUNC "%9.3" "s" COEFFS 0 0 1 0 0.00023283064365387 0 /end COMPU_METHOD
/begin COMPU_METHOD TimeEngOn "Motorbetriebszeit in Sekunden" RAT_FUNC "%6.2" "s" COEFFS 0 1 0 0 0 1 /end COMPU_METHOD
/begin COMPU_METHOD TimeUSResolution "Zeit in Mikrosekunden für TPU Zeiten, Auflösung 1 us" RAT_FUNC "%6.2" "us" COEFFS 0 1 0 0 0 1 /end COMPU_METHOD
/begin COMPU_METHOD Time_ms "Zeit in ms für Fehlerentprellung (DSM) und SW-Timer" RAT_FUNC "%6.1" "ms" COEFFS 0 0.1 0 0 0 1 /end COMPU_METHOD
/begin COMPU_METHOD TransR "Übersetzungsverhältnis (Getriebe etc.)" RAT_FUNC "%6.4" "-" COEFFS 0 100 0 0 0 1 /end COMPU_METHOD
/begin COMPU_METHOD Trq "Motormoment" RAT_FUNC "%6.3" "Nm" COEFFS 0 10 0 0 0 1 /end COMPU_METHOD
/begin COMPU_METHOD Vel "Fahrzeuggeschwindigkeit, gleiche interne Auflösung wie Vel_SI" RAT_FUNC "%6.4" "km/h" COEFFS 0 100 0 0 0 1 /end COMPU_METHOD
/begin COMPU_METHOD VelToN "Verhältnis Fahrzeuggeschwindigkeit zu Motordrehzahl v/n" RAT_FUNC "%8.7" "(km/h)/rpm" COEFFS 0 100000 0 0 0 1 /end COMPU_METHOD
/begin COMPU_METHOD Vel_SI "Fahrzeuggeschwindigkeit (in m/s)" RAT_FUNC "%6.4" "m/s" COEFFS 0 360 0 0 0 1 /end COMPU_METHOD
/begin COMPU_METHOD volAdd_ml "Additivvolumen [ml]" RAT_FUNC "%6.3" "ml" COEFFS 0 10 0 0 0 1 /end COMPU_METHOD
/begin RECORD_LAYOUT Kf_Xs16_Ys16_Ws16 NO_AXIS_PTS_X 1 SWORD NO_AXIS_PTS_Y 2 SWORD AXIS_PTS_X 3 SWORD INDEX_INCR DIRECT AXIS_PTS_Y 4 SWORD INDEX_INCR DIRECT FNC_VALUES 5 SWORD COLUMN_DIR DIRECT /end RECORD_LAYOUT
/begin RECORD_LAYOUT Kl_Xs16_Ws16 NO_AXIS_PTS_X 1 SWORD AXIS_PTS_X 2 SWORD INDEX_INCR DIRECT FNC_VALUES 3 SWORD COLUMN_DIR DIRECT /end RECORD_LAYOUT
/begin RECORD_LAYOUT Kwb_Ws16 FNC_VALUES 1 SWORD COLUMN_DIR DIRECT /end RECORD_LAYOUT
/begin RECORD_LAYOUT Kw_Ws16 FNC_VALUES 1 SWORD COLUMN_DIR DIRECT /end RECORD_LAYOUT
/begin RECORD_LAYOUT Kw_Ws32 FNC_VALUES 1 SLONG COLUMN_DIR DIRECT /end RECORD_LAYOUT
/begin RECORD_LAYOUT Kw_Wu16 FNC_VALUES 1 UWORD COLUMN_DIR DIRECT /end RECORD_LAYOUT
/begin RECORD_LAYOUT Kw_Wu32 FNC_VALUES 1 ULONG COLUMN_DIR DIRECT /end RECORD_LAYOUT
/begin RECORD_LAYOUT Kw_Wu8 FNC_VALUES 1 UBYTE COLUMN_DIR DIRECT /end RECORD_LAYOUT
/end MODULE
/end PROJECT
