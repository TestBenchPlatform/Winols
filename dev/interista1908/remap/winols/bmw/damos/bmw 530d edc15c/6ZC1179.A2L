ASAP2_VERSION 1 3
/begin PROJECT _ "  P079.VC4.VA02  B07902C4.DAM:  DAMPAR_03"
/begin HEADER "EDC15C" PROJECT_NO VAR02 VERSION "MAX_KLKF" /end HEADER
/begin MODULE DIM " "
/begin MOD_COMMON " " S_REC_LAYOUT MSA15 DEPOSIT ABSOLUTE BYTE_ORDER MSB_LAST /end MOD_COMMON
/begin RECORD_LAYOUT MSA15_FW4 FNC_VALUES 1 SWORD COLUMN_DIR DIRECT /end RECORD_LAYOUT
/begin RECORD_LAYOUT MSA15_FW3 FNC_VALUES 1 UWORD COLUMN_DIR DIRECT /end RECORD_LAYOUT
/begin RECORD_LAYOUT MSA15_KL117 SRC_ADDR_X 1 UWORD NO_AXIS_PTS_X 2 UWORD AXIS_PTS_X 3 SWORD INDEX_INCR DIRECT FNC_VALUES 4 UWORD COLUMN_DIR DIRECT /end RECORD_LAYOUT
/begin RECORD_LAYOUT MSA15_KL118 SRC_ADDR_X 1 UWORD NO_AXIS_PTS_X 2 UWORD AXIS_PTS_X 3 SWORD INDEX_INCR DIRECT FNC_VALUES 4 SWORD COLUMN_DIR DIRECT /end RECORD_LAYOUT
/begin RECORD_LAYOUT MSA15_KF358 SRC_ADDR_X 1 UWORD NO_AXIS_PTS_X 2 UWORD AXIS_PTS_X 3 SWORD INDEX_INCR DIRECT SRC_ADDR_Y 4 UWORD NO_AXIS_PTS_Y 5 UWORD AXIS_PTS_Y 6 UWORD INDEX_INCR DIRECT FNC_VALUES 7 SWORD COLUMN_DIR DIRECT /end RECORD_LAYOUT
/begin RECORD_LAYOUT MSA15_KL112 SRC_ADDR_X 1 UWORD NO_AXIS_PTS_X 2 UWORD AXIS_PTS_X 3 UWORD INDEX_INCR DIRECT FNC_VALUES 4 SWORD COLUMN_DIR DIRECT /end RECORD_LAYOUT
/begin RECORD_LAYOUT MSA15_KF382 SRC_ADDR_X 1 UWORD NO_AXIS_PTS_X 2 UWORD AXIS_PTS_X 3 SWORD INDEX_INCR DIRECT SRC_ADDR_Y 4 UWORD NO_AXIS_PTS_Y 5 UWORD AXIS_PTS_Y 6 SWORD INDEX_INCR DIRECT FNC_VALUES 7 SWORD COLUMN_DIR DIRECT /end RECORD_LAYOUT
/begin RECORD_LAYOUT MSA15_FW1 FNC_VALUES 1 UBYTE COLUMN_DIR DIRECT /end RECORD_LAYOUT
/begin CHARACTERISTIC fbwSKW2HLC "KWH Startwert Heilungszaehler" VALUE 0xF3035 MSA15_FW1 0 DEZ_DB_U 0.000000 255.000000 /end CHARACTERISTIC
/begin CHARACTERISTIC fbwSKW2PRI "KHW  Prioritaet" VALUE 0xF3032 MSA15_FW1 0 DEZ_DB_U 0.000000 3.000000 EXTENDED_LIMITS 0.000000 255.000000 /end CHARACTERISTIC
/begin CHARACTERISTIC fbwSKW2SPC "KHW Code fuer Fehlerspeicherung" VALUE 0xF3030 MSA15_FW3 0 DEZ_DW_U 0.000000 65535.000000 /end CHARACTERISTIC
/begin CHARACTERISTIC fbwSKW2UB1 "KWH Umweltbedingung 1 fuer Fehlerspeicherung" VALUE 0xF3048 MSA15_FW3 0 DEZ_DW_U 0.000000 65535.000000 /end CHARACTERISTIC
/begin CHARACTERISTIC fbwSKW2UB2 "KWH Umweltbedingung 2 fuer Fehlerspeicherung" VALUE 0xF304A MSA15_FW3 0 DEZ_DW_U 0.000000 65535.000000 /end CHARACTERISTIC
/begin CHARACTERISTIC fbwSKW2UB3 "KWH Umweltbedingung 3 fuer Fehlerspeicherung" VALUE 0xF304C MSA15_FW3 0 DEZ_DW_U 0.000000 65535.000000 /end CHARACTERISTIC
/begin CHARACTERISTIC fbwSKW2UB4 "KWH Umweltbedingung 4 fuer Fehlerspeicherung" VALUE 0xF304E MSA15_FW3 0 DEZ_DW_U 0.000000 65535.000000 /end CHARACTERISTIC
/begin CHARACTERISTIC fbwSKW2UB5 "KWH Umweltbedingung 5 fuer Fehlerspeicherung" VALUE 0xF3050 MSA15_FW3 0 DEZ_DW_U 0.000000 65535.000000 /end CHARACTERISTIC
/begin CHARACTERISTIC fbwSKWHBCO "KWH Blinkcode" VALUE 0xF305E MSA15_FW3 0 DEZ_DW_U 0.000000 65535.000000 /end CHARACTERISTIC
/begin CHARACTERISTIC fbwSKWHCC0 "KWH CARB Speichercode Bit 0" VALUE 0xF3060 MSA15_FW3 0 DEZ_DW_U 0.000000 65535.000000 /end CHARACTERISTIC
/begin CHARACTERISTIC fbwSKWHCC1 "KWH CARB Speichercode Bit 1" VALUE 0xF3062 MSA15_FW3 0 DEZ_DW_U 0.000000 65535.000000 /end CHARACTERISTIC
/begin CHARACTERISTIC fbwSKWHCC2 "KWH CARB Speichercode Bit 2" VALUE 0xF3064 MSA15_FW3 0 DEZ_DW_U 0.000000 65535.000000 /end CHARACTERISTIC
/begin CHARACTERISTIC fbwSKWHCC3 "KWH CARB Speichercode Bit 3" VALUE 0xF3066 MSA15_FW3 0 DEZ_DW_U 0.000000 65535.000000 /end CHARACTERISTIC
/begin CHARACTERISTIC fbwSKWHCC4 "KWH CARB Speichercode Bit 4" VALUE 0xF3068 MSA15_FW3 0 DEZ_DW_U 0.000000 65535.000000 /end CHARACTERISTIC
/begin CHARACTERISTIC fbwSKWHCC5 "KWH CARB Speichercode Bit 5" VALUE 0xF306A MSA15_FW3 0 DEZ_DW_U 0.000000 65535.000000 /end CHARACTERISTIC
/begin CHARACTERISTIC fbwSKWHCC6 "KWH CARB Speichercode Bit 6" VALUE 0xF306C MSA15_FW3 0 DEZ_DW_U 0.000000 65535.000000 /end CHARACTERISTIC
/begin CHARACTERISTIC fbwSKWHCC7 "KWH CARB Speichercode Bit 7" VALUE 0xF306E MSA15_FW3 0 DEZ_DW_U 0.000000 65535.000000 /end CHARACTERISTIC
/begin CHARACTERISTIC fbwSKWHENT "KWH  Entprellmodus" VALUE 0xF305B MSA15_FW1 0 DEZ_DB_U 0.000000 255.000000 /end CHARACTERISTIC
/begin CHARACTERISTIC fbwSKWHFLC "KWH Startwert Eintragzaehler" VALUE 0xF305C MSA15_FW1 0 DEZ_DB_U 0.000000 255.000000 /end CHARACTERISTIC
/begin CHARACTERISTIC fbwSKWHHLC "KWH Startwert Heilungszaehler" VALUE 0xF305D MSA15_FW1 0 DEZ_DB_U 0.000000 255.000000 /end CHARACTERISTIC
/begin CHARACTERISTIC fbwSKWHPRI "KHW  Prioritaet" VALUE 0xF305A MSA15_FW1 0 DEZ_DB_U 0.000000 3.000000 EXTENDED_LIMITS 0.000000 255.000000 /end CHARACTERISTIC
/begin CHARACTERISTIC fbwSKWHSPC "KHW Code fuer Fehlerspeicherung" VALUE 0xF3058 MSA15_FW3 0 DEZ_DW_U 0.000000 65535.000000 /end CHARACTERISTIC
/begin CHARACTERISTIC fbwSKWHUB1 "KWH Umweltbedingung 1 fuer Fehlerspeicherung" VALUE 0xF3070 MSA15_FW3 0 DEZ_DW_U 0.000000 65535.000000 /end CHARACTERISTIC
/begin CHARACTERISTIC fbwSKWHUB2 "KWH Umweltbedingung 2 fuer Fehlerspeicherung" VALUE 0xF3072 MSA15_FW3 0 DEZ_DW_U 0.000000 65535.000000 /end CHARACTERISTIC
/begin CHARACTERISTIC fbwSKWHUB3 "KWH Umweltbedingung 3 fuer Fehlerspeicherung" VALUE 0xF3074 MSA15_FW3 0 DEZ_DW_U 0.000000 65535.000000 /end CHARACTERISTIC
/begin CHARACTERISTIC fbwSKWHUB4 "KWH Umweltbedingung 4 fuer Fehlerspeicherung" VALUE 0xF3076 MSA15_FW3 0 DEZ_DW_U 0.000000 65535.000000 /end CHARACTERISTIC
/begin CHARACTERISTIC fbwSKWHUB5 "KWH Umweltbedingung 5 fuer Fehlerspeicherung" VALUE 0xF3078 MSA15_FW3 0 DEZ_DW_U 0.000000 65535.000000 /end CHARACTERISTIC
/begin CHARACTERISTIC fbwSLDFBCO "LDF  Blinkcode" VALUE 0xF2A56 MSA15_FW3 0 DEZ_DW_U 0.000000 65535.000000 /end CHARACTERISTIC
/begin CHARACTERISTIC fbwSLDFCC0 "LDF  CARB Speichercode Bit 0" VALUE 0xF2A58 MSA15_FW3 0 DEZ_DW_U 0.000000 65535.000000 /end CHARACTERISTIC
/begin CHARACTERISTIC fbwSLDFCC1 "LDF  CARB Speichercode Bit 1" VALUE 0xF2A5A MSA15_FW3 0 DEZ_DW_U 0.000000 65535.000000 /end CHARACTERISTIC
/begin CHARACTERISTIC fbwSLDFCC2 "LDF  CARB Speichercode Bit 2" VALUE 0xF2A5C MSA15_FW3 0 DEZ_DW_U 0.000000 65535.000000 /end CHARACTERISTIC
/begin CHARACTERISTIC fbwSLDFCC3 "LDF  CARB Speichercode Bit 3" VALUE 0xF2A5E MSA15_FW3 0 DEZ_DW_U 0.000000 65535.000000 /end CHARACTERISTIC
/begin CHARACTERISTIC fbwSLDFCC4 "LDF  CARB Speichercode Bit 4" VALUE 0xF2A60 MSA15_FW3 0 DEZ_DW_U 0.000000 65535.000000 /end CHARACTERISTIC
/begin CHARACTERISTIC fbwSLDFCC5 "LDF  CARB Speichercode Bit 5" VALUE 0xF2A62 MSA15_FW3 0 DEZ_DW_U 0.000000 65535.000000 /end CHARACTERISTIC
/begin CHARACTERISTIC fbwSLDFCC6 "LDF  CARB Speichercode Bit 6" VALUE 0xF2A64 MSA15_FW3 0 DEZ_DW_U 0.000000 65535.000000 /end CHARACTERISTIC
/begin CHARACTERISTIC fbwSLDFCC7 "LDF  CARB Speichercode Bit 7" VALUE 0xF2A66 MSA15_FW3 0 DEZ_DW_U 0.000000 65535.000000 /end CHARACTERISTIC
/begin CHARACTERISTIC fbwSLDFENT "LDF  Entrprellmodus" VALUE 0xF2A53 MSA15_FW1 0 DEZ_DB_U 0.000000 255.000000 /end CHARACTERISTIC
/begin CHARACTERISTIC fbwSLDFFLC "LDF  Startwert Eintragzaehler" VALUE 0xF2A54 MSA15_FW1 0 DEZ_DB_U 0.000000 255.000000 /end CHARACTERISTIC
/begin CHARACTERISTIC fbwSLDFHLC "LDF  Startwert Heilungszaehler" VALUE 0xF2A55 MSA15_FW1 0 DEZ_DB_U 0.000000 255.000000 /end CHARACTERISTIC
/begin CHARACTERISTIC fbwSLDFPRI "LDF  Prioritaet" VALUE 0xF2A52 MSA15_FW1 0 DEZ_DB_U 0.000000 3.000000 EXTENDED_LIMITS 0.000000 255.000000 /end CHARACTERISTIC
/begin CHARACTERISTIC fbwSLDFSPC "LDF  Code fuer Fehlerspeicherung" VALUE 0xF2A50 MSA15_FW3 0 DEZ_DW_U 0.000000 65535.000000 /end CHARACTERISTIC
/begin CHARACTERISTIC fbwSLDFUB1 "LDF Umweltbedingung 1 fuer Fehlerspeicherung" VALUE 0xF2A68 MSA15_FW3 0 DEZ_DW_U 0.000000 65535.000000 /end CHARACTERISTIC
/begin CHARACTERISTIC fbwSLDFUB2 "LDF Umweltbedingung 2 fuer Fehlerspeicherung" VALUE 0xF2A6A MSA15_FW3 0 DEZ_DW_U 0.000000 65535.000000 /end CHARACTERISTIC
/begin CHARACTERISTIC fbwSLDFUB3 "LDF Umweltbedingung 3 fuer Fehlerspeicherung" VALUE 0xF2A6C MSA15_FW3 0 DEZ_DW_U 0.000000 65535.000000 /end CHARACTERISTIC
/begin CHARACTERISTIC fbwSLDFUB4 "LDF Umweltbedingung 4 fuer Fehlerspeicherung" VALUE 0xF2A6E MSA15_FW3 0 DEZ_DW_U 0.000000 65535.000000 /end CHARACTERISTIC
/begin CHARACTERISTIC fbwSLDSBCO "LDS  Blinkcode" VALUE 0xF2D84 MSA15_FW3 0 DEZ_DW_U 0.000000 65535.000000 /end CHARACTERISTIC
/begin CHARACTERISTIC fbwSLDSCC0 "LDS  CARB Speichercode Bit 0" VALUE 0xF2D86 MSA15_FW3 0 DEZ_DW_U 0.000000 65535.000000 /end CHARACTERISTIC
/begin CHARACTERISTIC fbwSLDSCC1 "LDS  CARB Speichercode Bit 1" VALUE 0xF2D88 MSA15_FW3 0 DEZ_DW_U 0.000000 65535.000000 /end CHARACTERISTIC
/begin CHARACTERISTIC fbwSLDSCC2 "LDS  CARB Speichercode Bit 2" VALUE 0xF2D8A MSA15_FW3 0 DEZ_DW_U 0.000000 65535.000000 /end CHARACTERISTIC
/begin CHARACTERISTIC fbwSLDSCC3 "LDS  CARB Speichercode Bit 3" VALUE 0xF2D8C MSA15_FW3 0 DEZ_DW_U 0.000000 65535.000000 /end CHARACTERISTIC
/begin CHARACTERISTIC fbwSLDSCC4 "LDS  CARB Speichercode Bit 4" VALUE 0xF2D8E MSA15_FW3 0 DEZ_DW_U 0.000000 65535.000000 /end CHARACTERISTIC
/begin CHARACTERISTIC fbwSLDSCC5 "LDS  CARB Speichercode Bit 5" VALUE 0xF2D90 MSA15_FW3 0 DEZ_DW_U 0.000000 65535.000000 /end CHARACTERISTIC
/begin CHARACTERISTIC fbwSLDSCC6 "LDS  CARB Speichercode Bit 6" VALUE 0xF2D92 MSA15_FW3 0 DEZ_DW_U 0.000000 65535.000000 /end CHARACTERISTIC
/begin CHARACTERISTIC fbwSLDSCC7 "LDS  CARB Speichercode Bit 7" VALUE 0xF2D94 MSA15_FW3 0 DEZ_DW_U 0.000000 65535.000000 /end CHARACTERISTIC
/begin CHARACTERISTIC fbwSLDSENT "LDS  Entrprellmodus" VALUE 0xF2D81 MSA15_FW1 0 DEZ_DB_U 0.000000 255.000000 /end CHARACTERISTIC
/begin CHARACTERISTIC fbwSLDSFLC "LDS  Startwert Eintragzaehler" VALUE 0xF2D82 MSA15_FW1 0 DEZ_DB_U 0.000000 255.000000 /end CHARACTERISTIC
/begin CHARACTERISTIC fbwSLDSHLC "LDS  Startwert Heilungszaehler" VALUE 0xF2D83 MSA15_FW1 0 DEZ_DB_U 0.000000 255.000000 /end CHARACTERISTIC
/begin CHARACTERISTIC fbwSLDSPRI "LDS  Prioritaet" VALUE 0xF2D80 MSA15_FW1 0 DEZ_DB_U 0.000000 3.000000 EXTENDED_LIMITS 0.000000 255.000000 /end CHARACTERISTIC
/begin CHARACTERISTIC fbwSLDSSPC "LDS  Code fuer Fehlerspeicherung" VALUE 0xF2D7E MSA15_FW3 0 DEZ_DW_U 0.000000 65535.000000 /end CHARACTERISTIC
/begin CHARACTERISTIC fbwSLDSUB1 "LDS Umweltbedingung 1 fuer Fehlerspeicherung" VALUE 0xF2D96 MSA15_FW3 0 DEZ_DW_U 0.000000 65535.000000 /end CHARACTERISTIC
/begin CHARACTERISTIC fbwSLDSUB2 "LDS Umweltbedingung 2 fuer Fehlerspeicherung" VALUE 0xF2D98 MSA15_FW3 0 DEZ_DW_U 0.000000 65535.000000 /end CHARACTERISTIC
/begin CHARACTERISTIC fbwSLDSUB3 "LDS Umweltbedingung 3 fuer Fehlerspeicherung" VALUE 0xF2D9A MSA15_FW3 0 DEZ_DW_U 0.000000 65535.000000 /end CHARACTERISTIC
/begin CHARACTERISTIC fbwSLDSUB4 "LDS Umweltbedingung 4 fuer Fehlerspeicherung" VALUE 0xF2D9C MSA15_FW3 0 DEZ_DW_U 0.000000 65535.000000 /end CHARACTERISTIC
/begin CHARACTERISTIC fbwSLMMBCO "LMM  Blinkcode" VALUE 0xF2B4E MSA15_FW3 0 DEZ_DW_U 0.000000 65535.000000 /end CHARACTERISTIC
/begin CHARACTERISTIC fbwSLMMCC0 "LMM  CARB Speichercode Bit 0" VALUE 0xF2B50 MSA15_FW3 0 DEZ_DW_U 0.000000 65535.000000 /end CHARACTERISTIC
/begin CHARACTERISTIC fbwSLMMCC1 "LMM  CARB Speichercode Bit 1" VALUE 0xF2B52 MSA15_FW3 0 DEZ_DW_U 0.000000 65535.000000 /end CHARACTERISTIC
/begin CHARACTERISTIC fbwSLMMCC2 "LMM  CARB Speichercode Bit 2" VALUE 0xF2B54 MSA15_FW3 0 DEZ_DW_U 0.000000 65535.000000 /end CHARACTERISTIC
/begin CHARACTERISTIC fbwSLMMCC3 "LMM  CARB Speichercode Bit 3" VALUE 0xF2B56 MSA15_FW3 0 DEZ_DW_U 0.000000 65535.000000 /end CHARACTERISTIC
/begin CHARACTERISTIC fbwSLMMCC4 "LMM  CARB Speichercode Bit 4" VALUE 0xF2B58 MSA15_FW3 0 DEZ_DW_U 0.000000 65535.000000 /end CHARACTERISTIC
/begin CHARACTERISTIC fbwSLMMCC5 "LMM  CARB Speichercode Bit 5" VALUE 0xF2B5A MSA15_FW3 0 DEZ_DW_U 0.000000 65535.000000 /end CHARACTERISTIC
/begin CHARACTERISTIC fbwSLMMCC6 "LMM  CARB Speichercode Bit 6" VALUE 0xF2B5C MSA15_FW3 0 DEZ_DW_U 0.000000 65535.000000 /end CHARACTERISTIC
/begin CHARACTERISTIC fbwSLMMCC7 "LMM  CARB Speichercode Bit 7" VALUE 0xF2B5E MSA15_FW3 0 DEZ_DW_U 0.000000 65535.000000 /end CHARACTERISTIC
/begin CHARACTERISTIC fbwSLMMENT "LMM  Entrprellmodus" VALUE 0xF2B4B MSA15_FW1 0 DEZ_DB_U 0.000000 255.000000 /end CHARACTERISTIC
/begin CHARACTERISTIC fbwSLMMFLC "LMM  Startwert Eintragzaehler" VALUE 0xF2B4C MSA15_FW1 0 DEZ_DB_U 0.000000 255.000000 /end CHARACTERISTIC
/begin CHARACTERISTIC fbwSLMMHLC "LMM  Startwert Heilungszaehler" VALUE 0xF2B4D MSA15_FW1 0 DEZ_DB_U 0.000000 255.000000 /end CHARACTERISTIC
/begin CHARACTERISTIC fbwSLMMPRI "LMM  Prioritaet" VALUE 0xF2B4A MSA15_FW1 0 DEZ_DB_U 0.000000 3.000000 EXTENDED_LIMITS 0.000000 255.000000 /end CHARACTERISTIC
/begin CHARACTERISTIC fbwSLMMSPC "LMM  Code fuer Fehlerspeicherung" VALUE 0xF2B48 MSA15_FW3 0 DEZ_DW_U 0.000000 65535.000000 /end CHARACTERISTIC
/begin CHARACTERISTIC fbwSLMMUB1 "LMM Umweltbedingung 1 fuer Fehlerspeicherung" VALUE 0xF2B60 MSA15_FW3 0 DEZ_DW_U 0.000000 65535.000000 /end CHARACTERISTIC
/begin CHARACTERISTIC fbwSLMMUB2 "LMM Umweltbedingung 2 fuer Fehlerspeicherung" VALUE 0xF2B62 MSA15_FW3 0 DEZ_DW_U 0.000000 65535.000000 /end CHARACTERISTIC
/begin CHARACTERISTIC fbwSLMMUB3 "LMM Umweltbedingung 3 fuer Fehlerspeicherung" VALUE 0xF2B64 MSA15_FW3 0 DEZ_DW_U 0.000000 65535.000000 /end CHARACTERISTIC
/begin CHARACTERISTIC fbwSLMMUB4 "LMM Umweltbedingung 4 fuer Fehlerspeicherung" VALUE 0xF2B66 MSA15_FW3 0 DEZ_DW_U 0.000000 65535.000000 /end CHARACTERISTIC
/begin CHARACTERISTIC fbwSLRRBCO "LRR  Blinkcode" VALUE 0xF3098 MSA15_FW3 0 DEZ_DW_U 0.000000 65535.000000 /end CHARACTERISTIC
/begin CHARACTERISTIC fbwSLRRCC0 "LRR  CARB Speichercode Bit 0" VALUE 0xF309A MSA15_FW3 0 DEZ_DW_U 0.000000 65535.000000 /end CHARACTERISTIC
/begin CHARACTERISTIC fbwSLRRCC1 "LRR  CARB Speichercode Bit 1" VALUE 0xF309C MSA15_FW3 0 DEZ_DW_U 0.000000 65535.000000 /end CHARACTERISTIC
/begin CHARACTERISTIC fbwSLRRCC2 "LRR  CARB Speichercode Bit 2" VALUE 0xF309E MSA15_FW3 0 DEZ_DW_U 0.000000 65535.000000 /end CHARACTERISTIC
/begin CHARACTERISTIC fbwSLRRCC3 "LRR  CARB Speichercode Bit 3" VALUE 0xF30A0 MSA15_FW3 0 DEZ_DW_U 0.000000 65535.000000 /end CHARACTERISTIC
/begin CHARACTERISTIC fbwSLRRCC4 "LRR  CARB Speichercode Bit 4" VALUE 0xF30A2 MSA15_FW3 0 DEZ_DW_U 0.000000 65535.000000 /end CHARACTERISTIC
/begin CHARACTERISTIC fbwSLRRCC5 "LRR  CARB Speichercode Bit 5" VALUE 0xF30A4 MSA15_FW3 0 DEZ_DW_U 0.000000 65535.000000 /end CHARACTERISTIC
/begin CHARACTERISTIC fbwSLRRCC6 "LRR  CARB Speichercode Bit 6" VALUE 0xF30A6 MSA15_FW3 0 DEZ_DW_U 0.000000 65535.000000 /end CHARACTERISTIC
/begin CHARACTERISTIC fbwSLRRCC7 "LRR  CARB Speichercode Bit 7" VALUE 0xF30A8 MSA15_FW3 0 DEZ_DW_U 0.000000 65535.000000 /end CHARACTERISTIC
/begin CHARACTERISTIC fbwSLRRENT "LRR  Entrprellmodus" VALUE 0xF3095 MSA15_FW1 0 DEZ_DB_U 0.000000 255.000000 /end CHARACTERISTIC
/begin CHARACTERISTIC fbwSLRRFLC "LRR  Startwert Eintragzaehler" VALUE 0xF3096 MSA15_FW1 0 DEZ_DB_U 0.000000 255.000000 /end CHARACTERISTIC
/begin CHARACTERISTIC fbwSLRRHLC "LRR  Startwert Heilungszaehler" VALUE 0xF3097 MSA15_FW1 0 DEZ_DB_U 0.000000 255.000000 /end CHARACTERISTIC
/begin CHARACTERISTIC fbwSLRRPRI "LRR  Prioritaet" VALUE 0xF3094 MSA15_FW1 0 DEZ_DB_U 0.000000 3.000000 EXTENDED_LIMITS 0.000000 255.000000 /end CHARACTERISTIC
/begin CHARACTERISTIC fbwSLRRSPC "LRR  Code fuer Fehlerspeicherung" VALUE 0xF3092 MSA15_FW3 0 DEZ_DW_U 0.000000 65535.000000 /end CHARACTERISTIC
/begin CHARACTERISTIC fbwSLRRUB1 "LRR Umweltbedingung 1 fuer Fehlerspeicherung" VALUE 0xF30AA MSA15_FW3 0 DEZ_DW_U 0.000000 65535.000000 /end CHARACTERISTIC
/begin CHARACTERISTIC fbwSLRRUB2 "LRR Umweltbedingung 2 fuer Fehlerspeicherung" VALUE 0xF30AC MSA15_FW3 0 DEZ_DW_U 0.000000 65535.000000 /end CHARACTERISTIC
/begin CHARACTERISTIC fbwSLRRUB3 "LRR Umweltbedingung 3 fuer Fehlerspeicherung" VALUE 0xF30AE MSA15_FW3 0 DEZ_DW_U 0.000000 65535.000000 /end CHARACTERISTIC
/begin CHARACTERISTIC fbwSLRRUB4 "LRR Umweltbedingung 4 fuer Fehlerspeicherung" VALUE 0xF30B0 MSA15_FW3 0 DEZ_DW_U 0.000000 65535.000000 /end CHARACTERISTIC
/begin CHARACTERISTIC fbwSLRRUB5 "LRR Umweltbedingung 5 fuer Fehlerspeicherung" VALUE 0xF30B2 MSA15_FW3 0 DEZ_DW_U 0.000000 65535.000000 /end CHARACTERISTIC
/begin CHARACTERISTIC fbwSLTFBCO "LTF  Blinkcode" VALUE 0xF29CC MSA15_FW3 0 DEZ_DW_U 0.000000 65535.000000 /end CHARACTERISTIC
/begin CHARACTERISTIC fbwSLTFCC0 "LTF  CARB Speichercode Bit 0" VALUE 0xF29CE MSA15_FW3 0 DEZ_DW_U 0.000000 65535.000000 /end CHARACTERISTIC
/begin CHARACTERISTIC fbwSLTFCC1 "LTF  CARB Speichercode Bit 1" VALUE 0xF29D0 MSA15_FW3 0 DEZ_DW_U 0.000000 65535.000000 /end CHARACTERISTIC
/begin CHARACTERISTIC fbwSLTFCC2 "LTF  CARB Speichercode Bit 2" VALUE 0xF29D2 MSA15_FW3 0 DEZ_DW_U 0.000000 65535.000000 /end CHARACTERISTIC
/begin CHARACTERISTIC fbwSLTFCC3 "LTF  CARB Speichercode Bit 3" VALUE 0xF29D4 MSA15_FW3 0 DEZ_DW_U 0.000000 65535.000000 /end CHARACTERISTIC
/begin CHARACTERISTIC fbwSLTFCC4 "LTF  CARB Speichercode Bit 4" VALUE 0xF29D6 MSA15_FW3 0 DEZ_DW_U 0.000000 65535.000000 /end CHARACTERISTIC
/begin CHARACTERISTIC fbwSLTFCC5 "LTF  CARB Speichercode Bit 5" VALUE 0xF29D8 MSA15_FW3 0 DEZ_DW_U 0.000000 65535.000000 /end CHARACTERISTIC
/begin CHARACTERISTIC fbwSLTFCC6 "LTF  CARB Speichercode Bit 6" VALUE 0xF29DA MSA15_FW3 0 DEZ_DW_U 0.000000 65535.000000 /end CHARACTERISTIC
/begin CHARACTERISTIC fbwSLTFCC7 "LTF  CARB Speichercode Bit 7" VALUE 0xF29DC MSA15_FW3 0 DEZ_DW_U 0.000000 65535.000000 /end CHARACTERISTIC
/begin CHARACTERISTIC fbwSLTFENT "LTF  Entrprellmodus" VALUE 0xF29C9 MSA15_FW1 0 DEZ_DB_U 0.000000 255.000000 /end CHARACTERISTIC
/begin CHARACTERISTIC fbwSLTFFLC "LTF  Startwert Eintragzaehler" VALUE 0xF29CA MSA15_FW1 0 DEZ_DB_U 0.000000 255.000000 /end CHARACTERISTIC
/begin CHARACTERISTIC fbwSLTFHLC "LTF  Startwert Heilungszaehler" VALUE 0xF29CB MSA15_FW1 0 DEZ_DB_U 0.000000 255.000000 /end CHARACTERISTIC
/begin CHARACTERISTIC fbwSLTFPRI "LTF  Prioritaet" VALUE 0xF29C8 MSA15_FW1 0 DEZ_DB_U 0.000000 3.000000 EXTENDED_LIMITS 0.000000 255.000000 /end CHARACTERISTIC
/begin CHARACTERISTIC fbwSLTFSPC "LTF  Code fuer Fehlerspeicherung" VALUE 0xF29C6 MSA15_FW3 0 DEZ_DW_U 0.000000 65535.000000 /end CHARACTERISTIC
/begin CHARACTERISTIC fbwSLTFUB1 "LTF Umweltbedingung 1 fuer Fehlerspeicherung" VALUE 0xF29DE MSA15_FW3 0 DEZ_DW_U 0.000000 65535.000000 /end CHARACTERISTIC
/begin CHARACTERISTIC fbwSLTFUB2 "LTF Umweltbedingung 2 fuer Fehlerspeicherung" VALUE 0xF29E0 MSA15_FW3 0 DEZ_DW_U 0.000000 65535.000000 /end CHARACTERISTIC
/begin CHARACTERISTIC fbwSLTFUB3 "LTF Umweltbedingung 3 fuer Fehlerspeicherung" VALUE 0xF29E2 MSA15_FW3 0 DEZ_DW_U 0.000000 65535.000000 /end CHARACTERISTIC
/begin CHARACTERISTIC fbwSLTFUB4 "LTF Umweltbedingung 4 fuer Fehlerspeicherung" VALUE 0xF29E4 MSA15_FW3 0 DEZ_DW_U 0.000000 65535.000000 /end CHARACTERISTIC
/begin CHARACTERISTIC fbwSLX1BCO "LDSX  Blinkcode" VALUE 0xF2DA6 MSA15_FW3 0 DEZ_DW_U 0.000000 65535.000000 /end CHARACTERISTIC
/begin CHARACTERISTIC fbwSLX1CC0 "LDSX  CARB Speichercode Bit 0" VALUE 0xF2DA8 MSA15_FW3 0 DEZ_DW_U 0.000000 65535.000000 /end CHARACTERISTIC
/begin CHARACTERISTIC fbwSLX1CC1 "LDSX  CARB Speichercode Bit 1" VALUE 0xF2DAA MSA15_FW3 0 DEZ_DW_U 0.000000 65535.000000 /end CHARACTERISTIC
/begin CHARACTERISTIC fbwSLX1CC2 "LDSX  CARB Speichercode Bit 2" VALUE 0xF2DAC MSA15_FW3 0 DEZ_DW_U 0.000000 65535.000000 /end CHARACTERISTIC
/begin CHARACTERISTIC fbwSLX1CC3 "LDSX  CARB Speichercode Bit 3" VALUE 0xF2DAE MSA15_FW3 0 DEZ_DW_U 0.000000 65535.000000 /end CHARACTERISTIC
/begin CHARACTERISTIC fbwSLX1CC4 "LDSX  CARB Speichercode Bit 4" VALUE 0xF2DB0 MSA15_FW3 0 DEZ_DW_U 0.000000 65535.000000 /end CHARACTERISTIC
/begin CHARACTERISTIC fbwSLX1CC5 "LDSX  CARB Speichercode Bit 5" VALUE 0xF2DB2 MSA15_FW3 0 DEZ_DW_U 0.000000 65535.000000 /end CHARACTERISTIC
/begin CHARACTERISTIC fbwSLX1CC6 "LDSX  CARB Speichercode Bit 6" VALUE 0xF2DB4 MSA15_FW3 0 DEZ_DW_U 0.000000 65535.000000 /end CHARACTERISTIC
/begin CHARACTERISTIC fbwSLX1CC7 "LDSX  CARB Speichercode Bit 7" VALUE 0xF2DB6 MSA15_FW3 0 DEZ_DW_U 0.000000 65535.000000 /end CHARACTERISTIC
/begin CHARACTERISTIC fbwSLX1ENT "LDSX  Entrprellmodus" VALUE 0xF2DA3 MSA15_FW1 0 DEZ_DB_U 0.000000 255.000000 /end CHARACTERISTIC
/begin CHARACTERISTIC fbwSLX1FLC "LDSX  Startwert Eintragzaehler" VALUE 0xF2DA4 MSA15_FW1 0 DEZ_DB_U 0.000000 255.000000 /end CHARACTERISTIC
/begin CHARACTERISTIC fbwSLX1HLC "LDSX  Startwert Heilungszaehler" VALUE 0xF2DA5 MSA15_FW1 0 DEZ_DB_U 0.000000 255.000000 /end CHARACTERISTIC
/begin CHARACTERISTIC fbwSLX1PRI "LDSX  Prioritaet" VALUE 0xF2DA2 MSA15_FW1 0 DEZ_DB_U 0.000000 3.000000 EXTENDED_LIMITS 0.000000 255.000000 /end CHARACTERISTIC
/begin CHARACTERISTIC fbwSLX1SPC "LDSX  Code fuer Fehlerspeicherung" VALUE 0xF2DA0 MSA15_FW3 0 DEZ_DW_U 0.000000 65535.000000 /end CHARACTERISTIC
/begin CHARACTERISTIC fbwSLX1UB1 "LDSX Umweltbedingung 1 fuer Fehlerspeicherung" VALUE 0xF2DB8 MSA15_FW3 0 DEZ_DW_U 0.000000 65535.000000 /end CHARACTERISTIC
/begin CHARACTERISTIC fbwSLX1UB2 "LDSX Umweltbedingung 2 fuer Fehlerspeicherung" VALUE 0xF2DBA MSA15_FW3 0 DEZ_DW_U 0.000000 65535.000000 /end CHARACTERISTIC
/begin CHARACTERISTIC fbwSLX1UB3 "LDSX Umweltbedingung 3 fuer Fehlerspeicherung" VALUE 0xF2DBC MSA15_FW3 0 DEZ_DW_U 0.000000 65535.000000 /end CHARACTERISTIC
/begin CHARACTERISTIC fbwSLX1UB4 "LDSX Umweltbedingung 4 fuer Fehlerspeicherung" VALUE 0xF2DBE MSA15_FW3 0 DEZ_DW_U 0.000000 65535.000000 /end CHARACTERISTIC
/begin CHARACTERISTIC fbwSLX1UB5 "LDSX Umweltbedingung 5 fuer Fehlerspeicherung" VALUE 0xF2DC0 MSA15_FW3 0 DEZ_DW_U 0.000000 65535.000000 /end CHARACTERISTIC
/begin CHARACTERISTIC fbwSMLSBCO "MLS  Blinkcode" VALUE 0xF2EFA MSA15_FW3 0 DEZ_DW_U 0.000000 65535.000000 /end CHARACTERISTIC
/begin CHARACTERISTIC fbwSMLSCC0 "MLS  CARB Speichercode Bit 0" VALUE 0xF2EFC MSA15_FW3 0 DEZ_DW_U 0.000000 65535.000000 /end CHARACTERISTIC
/begin CHARACTERISTIC fbwSMLSCC1 "MLS  CARB Speichercode Bit 1" VALUE 0xF2EFE MSA15_FW3 0 DEZ_DW_U 0.000000 65535.000000 /end CHARACTERISTIC
/begin CHARACTERISTIC fbwSMLSCC2 "MLS  CARB Speichercode Bit 2" VALUE 0xF2F00 MSA15_FW3 0 DEZ_DW_U 0.000000 65535.000000 /end CHARACTERISTIC
/begin CHARACTERISTIC fbwSMLSCC3 "MLS  CARB Speichercode Bit 3" VALUE 0xF2F02 MSA15_FW3 0 DEZ_DW_U 0.000000 65535.000000 /end CHARACTERISTIC
/begin CHARACTERISTIC fbwSMLSCC4 "MLS  CARB Speichercode Bit 4" VALUE 0xF2F04 MSA15_FW3 0 DEZ_DW_U 0.000000 65535.000000 /end CHARACTERISTIC
/begin CHARACTERISTIC fbwSMLSCC5 "MLS  CARB Speichercode Bit 5" VALUE 0xF2F06 MSA15_FW3 0 DEZ_DW_U 0.000000 65535.000000 /end CHARACTERISTIC
/begin CHARACTERISTIC fbwSMLSCC6 "MLS  CARB Speichercode Bit 6" VALUE 0xF2F08 MSA15_FW3 0 DEZ_DW_U 0.000000 65535.000000 /end CHARACTERISTIC
/begin CHARACTERISTIC fbwSMLSCC7 "MLS  CARB Speichercode Bit 7" VALUE 0xF2F0A MSA15_FW3 0 DEZ_DW_U 0.000000 65535.000000 /end CHARACTERISTIC
/begin CHARACTERISTIC fbwSMLSENT "MLS  Entrprellmodus" VALUE 0xF2EF7 MSA15_FW1 0 DEZ_DB_U 0.000000 255.000000 /end CHARACTERISTIC
/begin CHARACTERISTIC fbwSMLSFLC "MLS  Startwert Eintragzaehler" VALUE 0xF2EF8 MSA15_FW1 0 DEZ_DB_U 0.000000 255.000000 /end CHARACTERISTIC
/begin CHARACTERISTIC fbwSMLSHLC "MLS  Startwert Heilungszaehler" VALUE 0xF2EF9 MSA15_FW1 0 DEZ_DB_U 0.000000 255.000000 /end CHARACTERISTIC
/begin CHARACTERISTIC fbwSMLSPRI "MLS  Prioritaet" VALUE 0xF2EF6 MSA15_FW1 0 DEZ_DB_U 0.000000 3.000000 EXTENDED_LIMITS 0.000000 255.000000 /end CHARACTERISTIC
/begin CHARACTERISTIC fbwSMLSSPC "MLS  Code fuer Fehlerspeicherung" VALUE 0xF2EF4 MSA15_FW3 0 DEZ_DW_U 0.000000 65535.000000 /end CHARACTERISTIC
/begin CHARACTERISTIC fbwSMLSUB1 "MLS Umweltbedingung 1 fuer Fehlerspeicherung" VALUE 0xF2F0C MSA15_FW3 0 DEZ_DW_U 0.000000 65535.000000 /end CHARACTERISTIC
/begin CHARACTERISTIC fbwSMLSUB2 "MLS Umweltbedingung 2 fuer Fehlerspeicherung" VALUE 0xF2F0E MSA15_FW3 0 DEZ_DW_U 0.000000 65535.000000 /end CHARACTERISTIC
/begin CHARACTERISTIC fbwSMLSUB3 "MLS Umweltbedingung 3 fuer Fehlerspeicherung" VALUE 0xF2F10 MSA15_FW3 0 DEZ_DW_U 0.000000 65535.000000 /end CHARACTERISTIC
/begin CHARACTERISTIC fbwSMLSUB4 "MLS Umweltbedingung 4 fuer Fehlerspeicherung" VALUE 0xF2F12 MSA15_FW3 0 DEZ_DW_U 0.000000 65535.000000 /end CHARACTERISTIC
/begin CHARACTERISTIC fbwSMMLBCO "MML  Blinkcode" VALUE 0xF2DE0 MSA15_FW3 0 DEZ_DW_U 0.000000 65535.000000 /end CHARACTERISTIC
/begin CHARACTERISTIC fbwSMMLCC0 "MML  CARB Speichercode Bit 0" VALUE 0xF2DE2 MSA15_FW3 0 DEZ_DW_U 0.000000 65535.000000 /end CHARACTERISTIC
/begin CHARACTERISTIC fbwSMMLCC1 "MML  CARB Speichercode Bit 1" VALUE 0xF2DE4 MSA15_FW3 0 DEZ_DW_U 0.000000 65535.000000 /end CHARACTERISTIC
/begin CHARACTERISTIC fbwSMMLCC2 "MML  CARB Speichercode Bit 2" VALUE 0xF2DE6 MSA15_FW3 0 DEZ_DW_U 0.000000 65535.000000 /end CHARACTERISTIC
/begin CHARACTERISTIC fbwSMMLCC3 "MML  CARB Speichercode Bit 3" VALUE 0xF2DE8 MSA15_FW3 0 DEZ_DW_U 0.000000 65535.000000 /end CHARACTERISTIC
/begin CHARACTERISTIC fbwSMMLCC4 "MML  CARB Speichercode Bit 4" VALUE 0xF2DEA MSA15_FW3 0 DEZ_DW_U 0.000000 65535.000000 /end CHARACTERISTIC
/begin CHARACTERISTIC fbwSMMLCC5 "MML  CARB Speichercode Bit 5" VALUE 0xF2DEC MSA15_FW3 0 DEZ_DW_U 0.000000 65535.000000 /end CHARACTERISTIC
/begin CHARACTERISTIC fbwSMMLCC6 "MML  CARB Speichercode Bit 6" VALUE 0xF2DEE MSA15_FW3 0 DEZ_DW_U 0.000000 65535.000000 /end CHARACTERISTIC
/begin CHARACTERISTIC fbwSMMLCC7 "MML  CARB Speichercode Bit 7" VALUE 0xF2DF0 MSA15_FW3 0 DEZ_DW_U 0.000000 65535.000000 /end CHARACTERISTIC
/begin CHARACTERISTIC fbwSMMLENT "MML  Entrprellmodus" VALUE 0xF2DDD MSA15_FW1 0 DEZ_DB_U 0.000000 255.000000 /end CHARACTERISTIC
/begin CHARACTERISTIC fbwSMMLFLC "MML  Startwert Eintragzaehler" VALUE 0xF2DDE MSA15_FW1 0 DEZ_DB_U 0.000000 255.000000 /end CHARACTERISTIC
/begin CHARACTERISTIC fbwSMMLHLC "MML  Startwert Heilungszaehler" VALUE 0xF2DDF MSA15_FW1 0 DEZ_DB_U 0.000000 255.000000 /end CHARACTERISTIC
/begin CHARACTERISTIC fbwSMMLPRI "MML  Prioritaet" VALUE 0xF2DDC MSA15_FW1 0 DEZ_DB_U 0.000000 3.000000 EXTENDED_LIMITS 0.000000 255.000000 /end CHARACTERISTIC
/begin CHARACTERISTIC fbwSMMLSPC "MML  Code fuer Fehlerspeicherung" VALUE 0xF2DDA MSA15_FW3 0 DEZ_DW_U 0.000000 65535.000000 /end CHARACTERISTIC
/begin CHARACTERISTIC fbwSMMLUB1 "MML Umweltbedingung 1 fuer Fehlerspeicherung" VALUE 0xF2DF2 MSA15_FW3 0 DEZ_DW_U 0.000000 65535.000000 /end CHARACTERISTIC
/begin CHARACTERISTIC fbwSMMLUB2 "MML Umweltbedingung 2 fuer Fehlerspeicherung" VALUE 0xF2DF4 MSA15_FW3 0 DEZ_DW_U 0.000000 65535.000000 /end CHARACTERISTIC
/begin CHARACTERISTIC fbwSMMLUB3 "MML Umweltbedingung 3 fuer Fehlerspeicherung" VALUE 0xF2DF6 MSA15_FW3 0 DEZ_DW_U 0.000000 65535.000000 /end CHARACTERISTIC
/begin CHARACTERISTIC fbwSMMLUB4 "MML Umweltbedingung 4 fuer Fehlerspeicherung" VALUE 0xF2DF8 MSA15_FW3 0 DEZ_DW_U 0.000000 65535.000000 /end CHARACTERISTIC
/begin CHARACTERISTIC fbwSNLTBCO "NL Test  Blinkcode" VALUE 0xF3320 MSA15_FW3 0 DEZ_DW_U 0.000000 65535.000000 /end CHARACTERISTIC
/begin CHARACTERISTIC fbwSNLTCC0 "NL Test  CARB *!na Speichercode Bit 0" VALUE 0xF3322 MSA15_FW3 0 DEZ_DW_U 0.000000 65535.000000 /end CHARACTERISTIC
/begin CHARACTERISTIC fbwSNLTCC1 "NL Test  CARB *!na Speichercode Bit 1" VALUE 0xF3324 MSA15_FW3 0 DEZ_DW_U 0.000000 65535.000000 /end CHARACTERISTIC
/begin CHARACTERISTIC fbwSNLTCC2 "NL Test  CARB *!na Speichercode Bit 2" VALUE 0xF3326 MSA15_FW3 0 DEZ_DW_U 0.000000 65535.000000 /end CHARACTERISTIC
/begin CHARACTERISTIC fbwSNLTCC3 "NL Test  CARB *!na Speichercode Bit 3" VALUE 0xF3328 MSA15_FW3 0 DEZ_DW_U 0.000000 65535.000000 /end CHARACTERISTIC
/begin CHARACTERISTIC fbwSNLTCC4 "NL Test  CARB *!na Speichercode Bit 4" VALUE 0xF332A MSA15_FW3 0 DEZ_DW_U 0.000000 65535.000000 /end CHARACTERISTIC
/begin CHARACTERISTIC fbwSNLTCC5 "NL Test  CARB *!na Speichercode Bit 5" VALUE 0xF332C MSA15_FW3 0 DEZ_DW_U 0.000000 65535.000000 /end CHARACTERISTIC
/begin CHARACTERISTIC fbwSNLTCC6 "NL Test  CARB *!na Speichercode Bit 6" VALUE 0xF332E MSA15_FW3 0 DEZ_DW_U 0.000000 65535.000000 /end CHARACTERISTIC
/begin CHARACTERISTIC fbwSNLTCC7 "NL Test  CARB *!na Speichercode Bit 7" VALUE 0xF3330 MSA15_FW3 0 DEZ_DW_U 0.000000 65535.000000 /end CHARACTERISTIC
/begin CHARACTERISTIC fbwSNLTENT "NL Test  Entprellmodus" VALUE 0xF331D MSA15_FW1 0 DEZ_DB_U 0.000000 255.000000 /end CHARACTERISTIC
/begin CHARACTERISTIC fbwSNLTFLC "NL Test  Startwert Eintragzaehler" VALUE 0xF331E MSA15_FW1 0 DEZ_DB_U 0.000000 255.000000 /end CHARACTERISTIC
/begin CHARACTERISTIC fbwSNLTHLC "NL Test  Startwert Heilungszaehler" VALUE 0xF331F MSA15_FW1 0 DEZ_DB_U 0.000000 255.000000 /end CHARACTERISTIC
/begin CHARACTERISTIC fbwSNLTPRI "NL Test Prioritaet" VALUE 0xF331C MSA15_FW1 0 DEZ_DB_U 0.000000 3.000000 EXTENDED_LIMITS 0.000000 255.000000 /end CHARACTERISTIC
/begin CHARACTERISTIC fbwSNLTSPC "NL Test  Code fuer Fehlerspeicherung" VALUE 0xF331A MSA15_FW3 0 DEZ_DW_U 0.000000 65535.000000 /end CHARACTERISTIC
/begin CHARACTERISTIC fbwSNLTUB1 "NL Test  *!na Unweltbedingung 1 fuer Fehlerspeicherung" VALUE 0xF3332 MSA15_FW3 0 DEZ_DW_U 0.000000 65535.000000 /end CHARACTERISTIC
/begin CHARACTERISTIC fbwSNLTUB2 "NL Test  *!na Unweltbedingung 2 fuer Fehlerspeicherung" VALUE 0xF3334 MSA15_FW3 0 DEZ_DW_U 0.000000 65535.000000 /end CHARACTERISTIC
/begin CHARACTERISTIC fbwSNLTUB3 "NL Test  *!na Unweltbedingung 3 fuer Fehlerspeicherung" VALUE 0xF3336 MSA15_FW3 0 DEZ_DW_U 0.000000 65535.000000 /end CHARACTERISTIC
/begin CHARACTERISTIC fbwSNLTUB4 "NL Test  *!na Unweltbedingung 4 fuer Fehlerspeicherung" VALUE 0xF3338 MSA15_FW3 0 DEZ_DW_U 0.000000 65535.000000 /end CHARACTERISTIC
/begin CHARACTERISTIC fbwSNOXBCO "NOX  Blinkcode" VALUE 0xF2F56 MSA15_FW3 0 DEZ_DW_U 0.000000 65535.000000 /end CHARACTERISTIC
/begin CHARACTERISTIC fbwSNOXCC0 "NOX  CARB Speichercode Bit 0" VALUE 0xF2F58 MSA15_FW3 0 DEZ_DW_U 0.000000 65535.000000 /end CHARACTERISTIC
/begin CHARACTERISTIC fbwSNOXCC1 "NOX  CARB Speichercode Bit 1" VALUE 0xF2F5A MSA15_FW3 0 DEZ_DW_U 0.000000 65535.000000 /end CHARACTERISTIC
/begin CHARACTERISTIC fbwSNOXCC2 "NOX  CARB Speichercode Bit 2" VALUE 0xF2F5C MSA15_FW3 0 DEZ_DW_U 0.000000 65535.000000 /end CHARACTERISTIC
/begin CHARACTERISTIC fbwSNOXCC3 "NOX  CARB Speichercode Bit 3" VALUE 0xF2F5E MSA15_FW3 0 DEZ_DW_U 0.000000 65535.000000 /end CHARACTERISTIC
/begin CHARACTERISTIC fbwSNOXCC4 "NOX  CARB Speichercode Bit 4" VALUE 0xF2F60 MSA15_FW3 0 DEZ_DW_U 0.000000 65535.000000 /end CHARACTERISTIC
/begin CHARACTERISTIC fbwSNOXCC5 "NOX  CARB Speichercode Bit 5" VALUE 0xF2F62 MSA15_FW3 0 DEZ_DW_U 0.000000 65535.000000 /end CHARACTERISTIC
/begin CHARACTERISTIC fbwSNOXCC6 "NOX  CARB Speichercode Bit 6" VALUE 0xF2F64 MSA15_FW3 0 DEZ_DW_U 0.000000 65535.000000 /end CHARACTERISTIC
/begin CHARACTERISTIC fbwSNOXCC7 "NOX  CARB Speichercode Bit 7" VALUE 0xF2F66 MSA15_FW3 0 DEZ_DW_U 0.000000 65535.000000 /end CHARACTERISTIC
/begin CHARACTERISTIC fbwSNOXENT "NOX  Entrprellmodus" VALUE 0xF2F53 MSA15_FW1 0 DEZ_DB_U 0.000000 255.000000 /end CHARACTERISTIC
/begin CHARACTERISTIC fbwSNOXFLC "NOX  Startwert Eintragzaehler" VALUE 0xF2F54 MSA15_FW1 0 DEZ_DB_U 0.000000 255.000000 /end CHARACTERISTIC
/begin CHARACTERISTIC fbwSNOXHLC "NOX  Startwert Heilungszaehler" VALUE 0xF2F55 MSA15_FW1 0 DEZ_DB_U 0.000000 255.000000 /end CHARACTERISTIC
/begin CHARACTERISTIC fbwSNOXPRI "NOX  Prioritaet" VALUE 0xF2F52 MSA15_FW1 0 DEZ_DB_U 0.000000 3.000000 EXTENDED_LIMITS 0.000000 255.000000 /end CHARACTERISTIC
/begin CHARACTERISTIC fbwSNOXSPC "NOX  Code fuer Fehlerspeicherung" VALUE 0xF2F50 MSA15_FW3 0 DEZ_DW_U 0.000000 65535.000000 /end CHARACTERISTIC
/begin CHARACTERISTIC fbwSNOXUB1 "NOX Umweltbedingung 1 fuer Fehlerspeicherung" VALUE 0xF2F68 MSA15_FW3 0 DEZ_DW_U 0.000000 65535.000000 /end CHARACTERISTIC
/begin CHARACTERISTIC fbwSNOXUB2 "NOX Umweltbedingung 2 fuer Fehlerspeicherung" VALUE 0xF2F6A MSA15_FW3 0 DEZ_DW_U 0.000000 65535.000000 /end CHARACTERISTIC
/begin CHARACTERISTIC fbwSNOXUB3 "NOX Umweltbedingung 3 fuer Fehlerspeicherung" VALUE 0xF2F6C MSA15_FW3 0 DEZ_DW_U 0.000000 65535.000000 /end CHARACTERISTIC
/begin CHARACTERISTIC fbwSNOXUB4 "NOX Umweltbedingung 4 fuer Fehlerspeicherung" VALUE 0xF2F6E MSA15_FW3 0 DEZ_DW_U 0.000000 65535.000000 /end CHARACTERISTIC
/begin CHARACTERISTIC fbwSODSBCO "ODS  Blinkcode" VALUE 0xF2FE0 MSA15_FW3 0 DEZ_DW_U 0.000000 65535.000000 /end CHARACTERISTIC
/begin CHARACTERISTIC fbwSODSCC0 "ODS  CARB Speichercode Bit 0" VALUE 0xF2FE2 MSA15_FW3 0 DEZ_DW_U 0.000000 65535.000000 /end CHARACTERISTIC
/begin CHARACTERISTIC fbwSODSCC1 "ODS  CARB Speichercode Bit 1" VALUE 0xF2FE4 MSA15_FW3 0 DEZ_DW_U 0.000000 65535.000000 /end CHARACTERISTIC
/begin CHARACTERISTIC fbwSODSCC2 "ODS  CARB Speichercode Bit 2" VALUE 0xF2FE6 MSA15_FW3 0 DEZ_DW_U 0.000000 65535.000000 /end CHARACTERISTIC
/begin CHARACTERISTIC fbwSODSCC3 "ODS  CARB Speichercode Bit 3" VALUE 0xF2FE8 MSA15_FW3 0 DEZ_DW_U 0.000000 65535.000000 /end CHARACTERISTIC
/begin CHARACTERISTIC fbwSODSCC4 "ODS  CARB Speichercode Bit 4" VALUE 0xF2FEA MSA15_FW3 0 DEZ_DW_U 0.000000 65535.000000 /end CHARACTERISTIC
/begin CHARACTERISTIC fbwSODSCC5 "ODS  CARB Speichercode Bit 5" VALUE 0xF2FEC MSA15_FW3 0 DEZ_DW_U 0.000000 65535.000000 /end CHARACTERISTIC
/begin CHARACTERISTIC fbwSODSCC6 "ODS  CARB Speichercode Bit 6" VALUE 0xF2FEE MSA15_FW3 0 DEZ_DW_U 0.000000 65535.000000 /end CHARACTERISTIC
/begin CHARACTERISTIC fbwSODSCC7 "ODS  CARB Speichercode Bit 7" VALUE 0xF2FF0 MSA15_FW3 0 DEZ_DW_U 0.000000 65535.000000 /end CHARACTERISTIC
/begin CHARACTERISTIC fbwSODSENT "ODS  Entrprellmodus" VALUE 0xF2FDD MSA15_FW1 0 DEZ_DB_U 0.000000 255.000000 /end CHARACTERISTIC
/begin CHARACTERISTIC fbwSODSFLC "ODS  Startwert Eintragzaehler" VALUE 0xF2FDE MSA15_FW1 0 DEZ_DB_U 0.000000 255.000000 /end CHARACTERISTIC
/begin CHARACTERISTIC fbwSODSHLC "ODS  Startwert Heilungszaehler" VALUE 0xF2FDF MSA15_FW1 0 DEZ_DB_U 0.000000 255.000000 /end CHARACTERISTIC
/begin CHARACTERISTIC fbwSODSPRI "ODS  Prioritaet" VALUE 0xF2FDC MSA15_FW1 0 DEZ_DB_U 0.000000 3.000000 EXTENDED_LIMITS 0.000000 255.000000 /end CHARACTERISTIC
/begin CHARACTERISTIC fbwSODSSPC "ODS  Code fuer Fehlerspeicherung" VALUE 0xF2FDA MSA15_FW3 0 DEZ_DW_U 0.000000 65535.000000 /end CHARACTERISTIC
/begin CHARACTERISTIC fbwSODSUB1 "ODS Umweltbedingung 1 fuer Fehlerspeicherung" VALUE 0xF2FF2 MSA15_FW3 0 DEZ_DW_U 0.000000 65535.000000 /end CHARACTERISTIC
/begin CHARACTERISTIC fbwSODSUB2 "ODS Umweltbedingung 2 fuer Fehlerspeicherung" VALUE 0xF2FF4 MSA15_FW3 0 DEZ_DW_U 0.000000 65535.000000 /end CHARACTERISTIC
/begin CHARACTERISTIC fbwSODSUB3 "ODS Umweltbedingung 3 fuer Fehlerspeicherung" VALUE 0xF2FF6 MSA15_FW3 0 DEZ_DW_U 0.000000 65535.000000 /end CHARACTERISTIC
/begin CHARACTERISTIC fbwSODSUB4 "ODS Umweltbedingung 4 fuer Fehlerspeicherung" VALUE 0xF2FF8 MSA15_FW3 0 DEZ_DW_U 0.000000 65535.000000 /end CHARACTERISTIC
/begin CHARACTERISTIC fbwSODSUB5 "ODS Umweltbedingung 5 fuer Fehlerspeicherung" VALUE 0xF2FFA MSA15_FW3 0 DEZ_DW_U 0.000000 65535.000000 /end CHARACTERISTIC
/begin CHARACTERISTIC fbwSOTFBCO "OTF  Blinkcode" VALUE 0xF299E MSA15_FW3 0 DEZ_DW_U 0.000000 65535.000000 /end CHARACTERISTIC
/begin CHARACTERISTIC fbwSOTFCC0 "OTF  CARB Speichercode Bit 0" VALUE 0xF29A0 MSA15_FW3 0 DEZ_DW_U 0.000000 65535.000000 /end CHARACTERISTIC
/begin CHARACTERISTIC fbwSOTFCC1 "OTF  CARB Speichercode Bit 1" VALUE 0xF29A2 MSA15_FW3 0 DEZ_DW_U 0.000000 65535.000000 /end CHARACTERISTIC
/begin CHARACTERISTIC fbwSOTFCC2 "OTF  CARB Speichercode Bit 2" VALUE 0xF29A4 MSA15_FW3 0 DEZ_DW_U 0.000000 65535.000000 /end CHARACTERISTIC
/begin CHARACTERISTIC fbwSOTFCC3 "OTF  CARB Speichercode Bit 3" VALUE 0xF29A6 MSA15_FW3 0 DEZ_DW_U 0.000000 65535.000000 /end CHARACTERISTIC
/begin CHARACTERISTIC fbwSOTFCC4 "OTF  CARB Speichercode Bit 4" VALUE 0xF29A8 MSA15_FW3 0 DEZ_DW_U 0.000000 65535.000000 /end CHARACTERISTIC
/begin CHARACTERISTIC fbwSOTFCC5 "OTF  CARB Speichercode Bit 5" VALUE 0xF29AA MSA15_FW3 0 DEZ_DW_U 0.000000 65535.000000 /end CHARACTERISTIC
/begin CHARACTERISTIC fbwSOTFCC6 "OTF  CARB Speichercode Bit 6" VALUE 0xF29AC MSA15_FW3 0 DEZ_DW_U 0.000000 65535.000000 /end CHARACTERISTIC
/begin CHARACTERISTIC fbwSOTFCC7 "OTF  CARB Speichercode Bit 7" VALUE 0xF29AE MSA15_FW3 0 DEZ_DW_U 0.000000 65535.000000 /end CHARACTERISTIC
/begin CHARACTERISTIC fbwSOTFENT "OTF  Entrprellmodus" VALUE 0xF299B MSA15_FW1 0 DEZ_DB_U 0.000000 255.000000 /end CHARACTERISTIC
/begin CHARACTERISTIC fbwSOTFFLC "OTF  Startwert Eintragzaehler" VALUE 0xF299C MSA15_FW1 0 DEZ_DB_U 0.000000 255.000000 /end CHARACTERISTIC
/begin CHARACTERISTIC fbwSOTFHLC "OTF  Startwert Heilungszaehler" VALUE 0xF299D MSA15_FW1 0 DEZ_DB_U 0.000000 255.000000 /end CHARACTERISTIC
/begin CHARACTERISTIC fbwSOTFPRI "OTF  Prioritaet" VALUE 0xF299A MSA15_FW1 0 DEZ_DB_U 0.000000 3.000000 EXTENDED_LIMITS 0.000000 255.000000 /end CHARACTERISTIC
/begin CHARACTERISTIC fbwSOTFSPC "OTF  Code fuer Fehlerspeicherung" VALUE 0xF2998 MSA15_FW3 0 DEZ_DW_U 0.000000 65535.000000 /end CHARACTERISTIC
/begin CHARACTERISTIC fbwSOTFUB1 "OTF Umweltbedingung 1" VALUE 0xF29B0 MSA15_FW3 0 DEZ_DW_U 0.000000 65535.000000 /end CHARACTERISTIC
/begin CHARACTERISTIC fbwSOTFUB2 "OTF Umweltbedingung 2" VALUE 0xF29B2 MSA15_FW3 0 DEZ_DW_U 0.000000 65535.000000 /end CHARACTERISTIC
/begin CHARACTERISTIC fbwSOTFUB3 "OTF Umweltbedingung 3" VALUE 0xF29B4 MSA15_FW3 0 DEZ_DW_U 0.000000 65535.000000 /end CHARACTERISTIC
/begin CHARACTERISTIC fbwSOTFUB4 "OTF Umweltbedingung 4" VALUE 0xF29B6 MSA15_FW3 0 DEZ_DW_U 0.000000 65535.000000 /end CHARACTERISTIC
/begin CHARACTERISTIC fbwSPGSBCO "PGS  Blinkcode" VALUE 0xF2860 MSA15_FW3 0 DEZ_DW_U 0.000000 65535.000000 /end CHARACTERISTIC
/begin CHARACTERISTIC fbwSPGSCC0 "PGS  CARB Speichercode Bit 0" VALUE 0xF2862 MSA15_FW3 0 DEZ_DW_U 0.000000 65535.000000 /end CHARACTERISTIC
/begin CHARACTERISTIC fbwSPGSCC1 "PGS  CARB Speichercode Bit 1" VALUE 0xF2864 MSA15_FW3 0 DEZ_DW_U 0.000000 65535.000000 /end CHARACTERISTIC
/begin CHARACTERISTIC fbwSPGSCC2 "PGS  CARB Speichercode Bit 2" VALUE 0xF2866 MSA15_FW3 0 DEZ_DW_U 0.000000 65535.000000 /end CHARACTERISTIC
/begin CHARACTERISTIC fbwSPGSCC3 "PGS  CARB Speichercode Bit 3" VALUE 0xF2868 MSA15_FW3 0 DEZ_DW_U 0.000000 65535.000000 /end CHARACTERISTIC
/begin CHARACTERISTIC fbwSPGSCC4 "PGS  CARB Speichercode Bit 4" VALUE 0xF286A MSA15_FW3 0 DEZ_DW_U 0.000000 65535.000000 /end CHARACTERISTIC
/begin CHARACTERISTIC fbwSPGSCC5 "PGS  CARB Speichercode Bit 5" VALUE 0xF286C MSA15_FW3 0 DEZ_DW_U 0.000000 65535.000000 /end CHARACTERISTIC
/begin CHARACTERISTIC fbwSPGSCC6 "PGS  CARB Speichercode Bit 6" VALUE 0xF286E MSA15_FW3 0 DEZ_DW_U 0.000000 65535.000000 /end CHARACTERISTIC
/begin CHARACTERISTIC fbwSPGSCC7 "PGS  CARB Speichercode Bit 7" VALUE 0xF2870 MSA15_FW3 0 DEZ_DW_U 0.000000 65535.000000 /end CHARACTERISTIC
/begin CHARACTERISTIC fbwSPGSENT "PGS  Entrprellmodus" VALUE 0xF285D MSA15_FW1 0 DEZ_DB_U 0.000000 255.000000 /end CHARACTERISTIC
/begin CHARACTERISTIC fbwSPGSFLC "PGS  Startwert Eintragzaehler" VALUE 0xF285E MSA15_FW1 0 DEZ_DB_U 0.000000 255.000000 /end CHARACTERISTIC
/begin CHARACTERISTIC fbwSPGSHLC "PGS  Startwert Heilungszaehler" VALUE 0xF285F MSA15_FW1 0 DEZ_DB_U 0.000000 255.000000 /end CHARACTERISTIC
/begin CHARACTERISTIC fbwSPGSPRI "PGS  Prioritaet" VALUE 0xF285C MSA15_FW1 0 DEZ_DB_U 0.000000 3.000000 EXTENDED_LIMITS 0.000000 255.000000 /end CHARACTERISTIC
/begin CHARACTERISTIC fbwSPGSSPC "PGS  Code fuer Fehlerspeicherung" VALUE 0xF285A MSA15_FW3 0 DEZ_DW_U 0.000000 65535.000000 /end CHARACTERISTIC
/begin CHARACTERISTIC fbwSPGSUB1 "PGS Umweltbedingung 1 fuer Fehlerspeicherung" VALUE 0xF2872 MSA15_FW3 0 DEZ_DW_U 0.000000 65535.000000 /end CHARACTERISTIC
/begin CHARACTERISTIC fbwSPGSUB2 "PGS Umweltbedingung 2 fuer Fehlerspeicherung" VALUE 0xF2874 MSA15_FW3 0 DEZ_DW_U 0.000000 65535.000000 /end CHARACTERISTIC
/begin CHARACTERISTIC fbwSPGSUB3 "PGS Umweltbedingung 3 fuer Fehlerspeicherung" VALUE 0xF2876 MSA15_FW3 0 DEZ_DW_U 0.000000 65535.000000 /end CHARACTERISTIC
/begin CHARACTERISTIC fbwSPGSUB4 "PGS Umweltbedingung 4 fuer Fehlerspeicherung" VALUE 0xF2878 MSA15_FW3 0 DEZ_DW_U 0.000000 65535.000000 /end CHARACTERISTIC
/begin CHARACTERISTIC fbwSPWGBCO "PWG  Blinkcode" VALUE 0xF2826 MSA15_FW3 0 DEZ_DW_U 0.000000 65535.000000 /end CHARACTERISTIC
/begin CHARACTERISTIC fbwSPWGCC0 "PWG  CARB Speichercode Bit 0" VALUE 0xF2828 MSA15_FW3 0 DEZ_DW_U 0.000000 65535.000000 /end CHARACTERISTIC
/begin CHARACTERISTIC fbwSPWGCC1 "PWG  CARB Speichercode Bit 1" VALUE 0xF282A MSA15_FW3 0 DEZ_DW_U 0.000000 65535.000000 /end CHARACTERISTIC
/begin CHARACTERISTIC fbwSPWGCC2 "PWG  CARB Speichercode Bit 2" VALUE 0xF282C MSA15_FW3 0 DEZ_DW_U 0.000000 65535.000000 /end CHARACTERISTIC
/begin CHARACTERISTIC fbwSPWGCC3 "PWG  CARB Speichercode Bit 3" VALUE 0xF282E MSA15_FW3 0 DEZ_DW_U 0.000000 65535.000000 /end CHARACTERISTIC
/begin CHARACTERISTIC fbwSPWGCC4 "PWG  CARB Speichercode Bit 4" VALUE 0xF2830 MSA15_FW3 0 DEZ_DW_U 0.000000 65535.000000 /end CHARACTERISTIC
/begin CHARACTERISTIC fbwSPWGCC5 "PWG  CARB Speichercode Bit 5" VALUE 0xF2832 MSA15_FW3 0 DEZ_DW_U 0.000000 65535.000000 /end CHARACTERISTIC
/begin CHARACTERISTIC fbwSPWGCC6 "PWG  CARB Speichercode Bit 6" VALUE 0xF2834 MSA15_FW3 0 DEZ_DW_U 0.000000 65535.000000 /end CHARACTERISTIC
/begin CHARACTERISTIC fbwSPWGCC7 "PWG  CARB Speichercode Bit 7" VALUE 0xF2836 MSA15_FW3 0 DEZ_DW_U 0.000000 65535.000000 /end CHARACTERISTIC
/begin CHARACTERISTIC fbwSPWGENT "PWG  Entrprellmodus" VALUE 0xF2823 MSA15_FW1 0 DEZ_DB_U 0.000000 255.000000 /end CHARACTERISTIC
/begin CHARACTERISTIC fbwSPWGFLC "PWG  Startwert Eintragzaehler" VALUE 0xF2824 MSA15_FW1 0 DEZ_DB_U 0.000000 255.000000 /end CHARACTERISTIC
/begin CHARACTERISTIC fbwSPWGHLC "PWG  Startwert Heilungszaehler" VALUE 0xF2825 MSA15_FW1 0 DEZ_DB_U 0.000000 255.000000 /end CHARACTERISTIC
/begin CHARACTERISTIC fbwSPWGPRI "PWG  Prioritaet" VALUE 0xF2822 MSA15_FW1 0 DEZ_DB_U 0.000000 3.000000 EXTENDED_LIMITS 0.000000 255.000000 /end CHARACTERISTIC
/begin CHARACTERISTIC fbwSPWGSPC "PWG  Code fuer Fehlerspeicherung" VALUE 0xF2820 MSA15_FW3 0 DEZ_DW_U 0.000000 65535.000000 /end CHARACTERISTIC
/begin CHARACTERISTIC fbwSPWGUB1 "PWG Umweltbedingung 1 fuer Fehlerspeicherung" VALUE 0xF2838 MSA15_FW3 0 DEZ_DW_U 0.000000 65535.000000 /end CHARACTERISTIC
/begin CHARACTERISTIC fbwSPWGUB2 "PWG Umweltbedingung 2 fuer Fehlerspeicherung" VALUE 0xF283A MSA15_FW3 0 DEZ_DW_U 0.000000 65535.000000 /end CHARACTERISTIC
/begin CHARACTERISTIC fbwSPWGUB3 "PWG Umweltbedingung 3 fuer Fehlerspeicherung" VALUE 0xF283C MSA15_FW3 0 DEZ_DW_U 0.000000 65535.000000 /end CHARACTERISTIC
/begin CHARACTERISTIC fbwSPWGUB4 "PWG Umweltbedingung 4 fuer Fehlerspeicherung" VALUE 0xF283E MSA15_FW3 0 DEZ_DW_U 0.000000 65535.000000 /end CHARACTERISTIC
/begin CHARACTERISTIC fbwSRUCBCO "RUC  Blinkcode" VALUE 0xF2C52 MSA15_FW3 0 DEZ_DW_U 0.000000 65535.000000 /end CHARACTERISTIC
/begin CHARACTERISTIC fbwSRUCCC0 "RUC  CARB Speichercode Bit 0" VALUE 0xF2C54 MSA15_FW3 0 DEZ_DW_U 0.000000 65535.000000 /end CHARACTERISTIC
/begin CHARACTERISTIC fbwSRUCCC1 "RUC  CARB Speichercode Bit 1" VALUE 0xF2C56 MSA15_FW3 0 DEZ_DW_U 0.000000 65535.000000 /end CHARACTERISTIC
/begin CHARACTERISTIC fbwSRUCCC2 "RUC  CARB Speichercode Bit 2" VALUE 0xF2C58 MSA15_FW3 0 DEZ_DW_U 0.000000 65535.000000 /end CHARACTERISTIC
/begin CHARACTERISTIC fbwSRUCCC3 "RUC  CARB Speichercode Bit 3" VALUE 0xF2C5A MSA15_FW3 0 DEZ_DW_U 0.000000 65535.000000 /end CHARACTERISTIC
/begin CHARACTERISTIC fbwSRUCCC4 "RUC  CARB Speichercode Bit 4" VALUE 0xF2C5C MSA15_FW3 0 DEZ_DW_U 0.000000 65535.000000 /end CHARACTERISTIC
/begin CHARACTERISTIC fbwSRUCCC5 "RUC  CARB Speichercode Bit 5" VALUE 0xF2C5E MSA15_FW3 0 DEZ_DW_U 0.000000 65535.000000 /end CHARACTERISTIC
/begin CHARACTERISTIC fbwSRUCCC6 "RUC  CARB Speichercode Bit 6" VALUE 0xF2C60 MSA15_FW3 0 DEZ_DW_U 0.000000 65535.000000 /end CHARACTERISTIC
/begin CHARACTERISTIC fbwSRUCCC7 "RUC  CARB Speichercode Bit 7" VALUE 0xF2C62 MSA15_FW3 0 DEZ_DW_U 0.000000 65535.000000 /end CHARACTERISTIC
/begin CHARACTERISTIC fbwSRUCENT "uC   Entrprellmodus" VALUE 0xF2C4F MSA15_FW1 0 DEZ_DB_U 0.000000 255.000000 /end CHARACTERISTIC
/begin CHARACTERISTIC fbwSRUCFLC "RUC  Startwert Eintragzaehler" VALUE 0xF2C50 MSA15_FW1 0 DEZ_DB_U 0.000000 255.000000 /end CHARACTERISTIC
/begin CHARACTERISTIC fbwSRUCHLC "RUC  Startwert Heilungszaehler" VALUE 0xF2C51 MSA15_FW1 0 DEZ_DB_U 0.000000 255.000000 /end CHARACTERISTIC
/begin CHARACTERISTIC fbwSRUCPRI "uC   Prioritaet" VALUE 0xF2C4E MSA15_FW1 0 DEZ_DB_U 0.000000 3.000000 EXTENDED_LIMITS 0.000000 255.000000 /end CHARACTERISTIC
/begin CHARACTERISTIC fbwSRUCSPC "uC   Code fuer Fehlerspeicherung" VALUE 0xF2C4C MSA15_FW3 0 DEZ_DW_U 0.000000 65535.000000 /end CHARACTERISTIC
/begin CHARACTERISTIC fbwSRUCUB1 "uC Umweltbedingung 1 fuer Fehlerspeicherung" VALUE 0xF2C64 MSA15_FW3 0 DEZ_DW_U 0.000000 65535.000000 /end CHARACTERISTIC
/begin CHARACTERISTIC fbwSRUCUB2 "uC Umweltbedingung 2 fuer Fehlerspeicherung" VALUE 0xF2C66 MSA15_FW3 0 DEZ_DW_U 0.000000 65535.000000 /end CHARACTERISTIC
/begin CHARACTERISTIC fbwSRUCUB3 "uC Umweltbedingung 3 fuer Fehlerspeicherung" VALUE 0xF2C68 MSA15_FW3 0 DEZ_DW_U 0.000000 65535.000000 /end CHARACTERISTIC
/begin CHARACTERISTIC fbwSRUCUB4 "uC Umweltbedingung 4 fuer Fehlerspeicherung" VALUE 0xF2C6A MSA15_FW3 0 DEZ_DW_U 0.000000 65535.000000 /end CHARACTERISTIC
/begin CHARACTERISTIC fbwSSTBBCO "STB  Blinkcode" VALUE 0xF2C98 MSA15_FW3 0 DEZ_DW_U 0.000000 65535.000000 /end CHARACTERISTIC
/begin CHARACTERISTIC fbwSSTBCC0 "STB  CARB Speichercode Bit 0" VALUE 0xF2C9A MSA15_FW3 0 DEZ_DW_U 0.000000 65535.000000 /end CHARACTERISTIC
/begin CHARACTERISTIC fbwSSTBCC1 "STB  CARB Speichercode Bit 1" VALUE 0xF2C9C MSA15_FW3 0 DEZ_DW_U 0.000000 65535.000000 /end CHARACTERISTIC
/begin CHARACTERISTIC fbwSSTBCC2 "STB  CARB Speichercode Bit 2" VALUE 0xF2C9E MSA15_FW3 0 DEZ_DW_U 0.000000 65535.000000 /end CHARACTERISTIC
/begin CHARACTERISTIC fbwSSTBCC3 "STB  CARB Speichercode Bit 3" VALUE 0xF2CA0 MSA15_FW3 0 DEZ_DW_U 0.000000 65535.000000 /end CHARACTERISTIC
/begin CHARACTERISTIC fbwSSTBCC4 "STB  CARB Speichercode Bit 4" VALUE 0xF2CA2 MSA15_FW3 0 DEZ_DW_U 0.000000 65535.000000 /end CHARACTERISTIC
/begin CHARACTERISTIC fbwSSTBCC5 "STB  CARB Speichercode Bit 5" VALUE 0xF2CA4 MSA15_FW3 0 DEZ_DW_U 0.000000 65535.000000 /end CHARACTERISTIC
/begin CHARACTERISTIC fbwSSTBCC6 "STB  CARB Speichercode Bit 6" VALUE 0xF2CA6 MSA15_FW3 0 DEZ_DW_U 0.000000 65535.000000 /end CHARACTERISTIC
/begin CHARACTERISTIC fbwSSTBCC7 "STB  CARB Speichercode Bit 7" VALUE 0xF2CA8 MSA15_FW3 0 DEZ_DW_U 0.000000 65535.000000 /end CHARACTERISTIC
/begin CHARACTERISTIC fbwSSTBENT "STAB Entrprellmodus" VALUE 0xF2C95 MSA15_FW1 0 DEZ_DB_U 0.000000 255.000000 /end CHARACTERISTIC
/begin CHARACTERISTIC fbwSSTBFLC "STB  Startwert Eintragzaehler" VALUE 0xF2C96 MSA15_FW1 0 DEZ_DB_U 0.000000 255.000000 /end CHARACTERISTIC
/begin CHARACTERISTIC fbwSSTBHLC "STB  Startwert Heilungszaehler" VALUE 0xF2C97 MSA15_FW1 0 DEZ_DB_U 0.000000 255.000000 /end CHARACTERISTIC
/begin CHARACTERISTIC fbwSSTBPRI "STAB Prioritaet" VALUE 0xF2C94 MSA15_FW1 0 DEZ_DB_U 0.000000 3.000000 EXTENDED_LIMITS 0.000000 255.000000 /end CHARACTERISTIC
/begin CHARACTERISTIC fbwSSTBSPC "STAB Code fuer Fehlerspeicherung" VALUE 0xF2C92 MSA15_FW3 0 DEZ_DW_U 0.000000 65535.000000 /end CHARACTERISTIC
/begin CHARACTERISTIC fbwSSTBUB1 "STAB Umweltbedingung 1 fuer Fehlerspeicherung" VALUE 0xF2CAA MSA15_FW3 0 DEZ_DW_U 0.000000 65535.000000 /end CHARACTERISTIC
/begin CHARACTERISTIC fbwSSTBUB2 "STAB Umweltbedingung 2 fuer Fehlerspeicherung" VALUE 0xF2CAC MSA15_FW3 0 DEZ_DW_U 0.000000 65535.000000 /end CHARACTERISTIC
/begin CHARACTERISTIC fbwSSTBUB3 "STAB Umweltbedingung 3 fuer Fehlerspeicherung" VALUE 0xF2CAE MSA15_FW3 0 DEZ_DW_U 0.000000 65535.000000 /end CHARACTERISTIC
/begin CHARACTERISTIC fbwSSTBUB4 "STAB Umweltbedingung 4 fuer Fehlerspeicherung" VALUE 0xF2CB0 MSA15_FW3 0 DEZ_DW_U 0.000000 65535.000000 /end CHARACTERISTIC
/begin CHARACTERISTIC fbwSTHSBCO "THS  Blinkcode" VALUE 0xF2F84 MSA15_FW3 0 DEZ_DW_U 0.000000 65535.000000 /end CHARACTERISTIC
/begin CHARACTERISTIC fbwSTHSCC0 "THS  CARB Speichercode Bit 0" VALUE 0xF2F86 MSA15_FW3 0 DEZ_DW_U 0.000000 65535.000000 /end CHARACTERISTIC
/begin CHARACTERISTIC fbwSTHSCC1 "THS  CARB Speichercode Bit 1" VALUE 0xF2F88 MSA15_FW3 0 DEZ_DW_U 0.000000 65535.000000 /end CHARACTERISTIC
/begin CHARACTERISTIC fbwSTHSCC2 "THS  CARB Speichercode Bit 2" VALUE 0xF2F8A MSA15_FW3 0 DEZ_DW_U 0.000000 65535.000000 /end CHARACTERISTIC
/begin CHARACTERISTIC fbwSTHSCC3 "THS  CARB Speichercode Bit 3" VALUE 0xF2F8C MSA15_FW3 0 DEZ_DW_U 0.000000 65535.000000 /end CHARACTERISTIC
/begin CHARACTERISTIC fbwSTHSCC4 "THS  CARB Speichercode Bit 4" VALUE 0xF2F8E MSA15_FW3 0 DEZ_DW_U 0.000000 65535.000000 /end CHARACTERISTIC
/begin CHARACTERISTIC fbwSTHSCC5 "THS  CARB Speichercode Bit 5" VALUE 0xF2F90 MSA15_FW3 0 DEZ_DW_U 0.000000 65535.000000 /end CHARACTERISTIC
/begin CHARACTERISTIC fbwSTHSCC6 "THS  CARB Speichercode Bit 6" VALUE 0xF2F92 MSA15_FW3 0 DEZ_DW_U 0.000000 65535.000000 /end CHARACTERISTIC
/begin CHARACTERISTIC fbwSTHSCC7 "THS  CARB Speichercode Bit 7" VALUE 0xF2F94 MSA15_FW3 0 DEZ_DW_U 0.000000 65535.000000 /end CHARACTERISTIC
/begin CHARACTERISTIC fbwSTHSENT "THS  Entrprellmodus" VALUE 0xF2F81 MSA15_FW1 0 DEZ_DB_U 0.000000 255.000000 /end CHARACTERISTIC
/begin CHARACTERISTIC fbwSTHSFLC "THS  Startwert Eintragzaehler" VALUE 0xF2F82 MSA15_FW1 0 DEZ_DB_U 0.000000 255.000000 /end CHARACTERISTIC
/begin CHARACTERISTIC fbwSTHSHLC "THS  Startwert Heilungszaehler" VALUE 0xF2F83 MSA15_FW1 0 DEZ_DB_U 0.000000 255.000000 /end CHARACTERISTIC
/begin CHARACTERISTIC fbwSTHSPRI "THS  Prioritaet" VALUE 0xF2F80 MSA15_FW1 0 DEZ_DB_U 0.000000 3.000000 EXTENDED_LIMITS 0.000000 255.000000 /end CHARACTERISTIC
/begin CHARACTERISTIC fbwSTHSSPC "THS  Code fuer Fehlerspeicherung" VALUE 0xF2F7E MSA15_FW3 0 DEZ_DW_U 0.000000 65535.000000 /end CHARACTERISTIC
/begin CHARACTERISTIC fbwSTHSUB1 "THS Umweltbedingung 1 fuer Fehlerspeicherung" VALUE 0xF2F96 MSA15_FW3 0 DEZ_DW_U 0.000000 65535.000000 /end CHARACTERISTIC
/begin CHARACTERISTIC fbwSTHSUB2 "THS Umweltbedingung 2 fuer Fehlerspeicherung" VALUE 0xF2F98 MSA15_FW3 0 DEZ_DW_U 0.000000 65535.000000 /end CHARACTERISTIC
/begin CHARACTERISTIC fbwSTHSUB3 "THS Umweltbedingung 3 fuer Fehlerspeicherung" VALUE 0xF2F9A MSA15_FW3 0 DEZ_DW_U 0.000000 65535.000000 /end CHARACTERISTIC
/begin CHARACTERISTIC fbwSTHSUB4 "THS Umweltbedingung 4 fuer Fehlerspeicherung" VALUE 0xF2F9C MSA15_FW3 0 DEZ_DW_U 0.000000 65535.000000 /end CHARACTERISTIC
/begin CHARACTERISTIC fbwSTSTBCO "TST  Blinkcode" VALUE 0xF296A MSA15_FW3 0 DEZ_DW_U 0.000000 65535.000000 /end CHARACTERISTIC
/begin CHARACTERISTIC fbwSTSTCC0 "TST  CARB Speichercode Bit 0" VALUE 0xF296C MSA15_FW3 0 DEZ_DW_U 0.000000 65535.000000 /end CHARACTERISTIC
/begin CHARACTERISTIC fbwSTSTCC1 "TST  CARB Speichercode Bit 1" VALUE 0xF296E MSA15_FW3 0 DEZ_DW_U 0.000000 65535.000000 /end CHARACTERISTIC
/begin CHARACTERISTIC fbwSTSTCC2 "TST  CARB Speichercode Bit 2" VALUE 0xF2970 MSA15_FW3 0 DEZ_DW_U 0.000000 65535.000000 /end CHARACTERISTIC
/begin CHARACTERISTIC fbwSTSTCC3 "TST  CARB Speichercode Bit 3" VALUE 0xF2972 MSA15_FW3 0 DEZ_DW_U 0.000000 65535.000000 /end CHARACTERISTIC
/begin CHARACTERISTIC fbwSTSTCC4 "TST  CARB Speichercode Bit 4" VALUE 0xF2974 MSA15_FW3 0 DEZ_DW_U 0.000000 65535.000000 /end CHARACTERISTIC
/begin CHARACTERISTIC fbwSTSTCC5 "TST  CARB Speichercode Bit 5" VALUE 0xF2976 MSA15_FW3 0 DEZ_DW_U 0.000000 65535.000000 /end CHARACTERISTIC
/begin CHARACTERISTIC fbwSTSTCC6 "TST  CARB Speichercode Bit 6" VALUE 0xF2978 MSA15_FW3 0 DEZ_DW_U 0.000000 65535.000000 /end CHARACTERISTIC
/begin CHARACTERISTIC fbwSTSTCC7 "TST  CARB Speichercode Bit 7" VALUE 0xF297A MSA15_FW3 0 DEZ_DW_U 0.000000 65535.000000 /end CHARACTERISTIC
/begin CHARACTERISTIC fbwSTSTENT "TST  Entrprellmodus" VALUE 0xF2967 MSA15_FW1 0 DEZ_DB_U 0.000000 255.000000 /end CHARACTERISTIC
/begin CHARACTERISTIC fbwSTSTFLC "TST  Startwert Eintragzaehler" VALUE 0xF2968 MSA15_FW1 0 DEZ_DB_U 0.000000 255.000000 /end CHARACTERISTIC
/begin CHARACTERISTIC fbwSTSTHLC "TST  Startwert Heilungszaehler" VALUE 0xF2969 MSA15_FW1 0 DEZ_DB_U 0.000000 255.000000 /end CHARACTERISTIC
/begin CHARACTERISTIC fbwSTSTPRI "TST  Prioritaet" VALUE 0xF2966 MSA15_FW1 0 DEZ_DB_U 0.000000 3.000000 EXTENDED_LIMITS 0.000000 255.000000 /end CHARACTERISTIC
/begin CHARACTERISTIC fbwSTSTSPC "TST  Code fuer Fehlerspeicherung" VALUE 0xF2964 MSA15_FW3 0 DEZ_DW_U 0.000000 65535.000000 /end CHARACTERISTIC
/begin CHARACTERISTIC fbwSTSTUB1 "TST Umweltbedingung 1" VALUE 0xF297C MSA15_FW3 0 DEZ_DW_U 0.000000 65535.000000 /end CHARACTERISTIC
/begin CHARACTERISTIC fbwSTSTUB2 "TST Umweltbedingung 2" VALUE 0xF297E MSA15_FW3 0 DEZ_DW_U 0.000000 65535.000000 /end CHARACTERISTIC
/begin CHARACTERISTIC fbwSTSTUB3 "TST Umweltbedingung 3" VALUE 0xF2980 MSA15_FW3 0 DEZ_DW_U 0.000000 65535.000000 /end CHARACTERISTIC
/begin CHARACTERISTIC fbwSTSTUB4 "TST Umweltbedingung 4" VALUE 0xF2982 MSA15_FW3 0 DEZ_DW_U 0.000000 65535.000000 /end CHARACTERISTIC
/begin CHARACTERISTIC fbwSTUMBCO "Umgebungstemperatur Blinkcode" VALUE 0xF300E MSA15_FW3 0 DEZ_DW_U 0.000000 65535.000000 /end CHARACTERISTIC
/begin CHARACTERISTIC fbwSTUMCC0 "Umgebungstemperatur CARB Speichercode Bit 0" VALUE 0xF3010 MSA15_FW3 0 DEZ_DW_U 0.000000 65535.000000 /end CHARACTERISTIC
/begin CHARACTERISTIC fbwSTUMCC1 "Umgebungstemperatur CARB Speichercode Bit 1" VALUE 0xF3012 MSA15_FW3 0 DEZ_DW_U 0.000000 65535.000000 /end CHARACTERISTIC
/begin CHARACTERISTIC fbwSTUMCC2 "Umgebungstemperatur CARB Speichercode Bit 2" VALUE 0xF3014 MSA15_FW3 0 DEZ_DW_U 0.000000 65535.000000 /end CHARACTERISTIC
/begin CHARACTERISTIC fbwSTUMCC3 "Umgebungstemperatur CARB Speichercode Bit 3" VALUE 0xF3016 MSA15_FW3 0 DEZ_DW_U 0.000000 65535.000000 /end CHARACTERISTIC
/begin CHARACTERISTIC fbwSTUMCC4 "Umgebungstemperatur CARB Speichercode Bit 4" VALUE 0xF3018 MSA15_FW3 0 DEZ_DW_U 0.000000 65535.000000 /end CHARACTERISTIC
/begin CHARACTERISTIC fbwSTUMCC5 "Umgebungstemperatur CARB Speichercode Bit 5" VALUE 0xF301A MSA15_FW3 0 DEZ_DW_U 0.000000 65535.000000 /end CHARACTERISTIC
/begin CHARACTERISTIC fbwSTUMCC6 "Umgebungstemperatur CARB Speichercode Bit 6" VALUE 0xF301C MSA15_FW3 0 DEZ_DW_U 0.000000 65535.000000 /end CHARACTERISTIC
/begin CHARACTERISTIC fbwSTUMCC7 "Umgebungstemperatur CARB Speichercode Bit 7" VALUE 0xF301E MSA15_FW3 0 DEZ_DW_U 0.000000 65535.000000 /end CHARACTERISTIC
/begin CHARACTERISTIC fbwSTUMENT "Umgebungstemperatur  Entprellmodus" VALUE 0xF300B MSA15_FW1 0 DEZ_DB_U 0.000000 255.000000 /end CHARACTERISTIC
/begin CHARACTERISTIC fbwSTUMFLC "Umgebungstemperatur Startwert Eintragzaehler" VALUE 0xF300C MSA15_FW1 0 DEZ_DB_U 0.000000 255.000000 /end CHARACTERISTIC
/begin CHARACTERISTIC fbwSTUMHLC "Umgebungstemperatur Startwert Heilungszaehler" VALUE 0xF300D MSA15_FW1 0 DEZ_DB_U 0.000000 255.000000 /end CHARACTERISTIC
/begin CHARACTERISTIC fbwSTUMPRI "Umgebungstemperatur  Prioritaet" VALUE 0xF300A MSA15_FW1 0 DEZ_DB_U 0.000000 3.000000 EXTENDED_LIMITS 0.000000 255.000000 /end CHARACTERISTIC
/begin CHARACTERISTIC fbwSTUMSPC "Umgebungstemperatur Code fuer Fehlerspeicherung" VALUE 0xF3008 MSA15_FW3 0 DEZ_DW_U 0.000000 65535.000000 /end CHARACTERISTIC
/begin CHARACTERISTIC fbwSTUMUB1 "Umgebungstemperatur Umweltbedingung 1 fuer Fehlerspeicherung" VALUE 0xF3020 MSA15_FW3 0 DEZ_DW_U 0.000000 65535.000000 /end CHARACTERISTIC
/begin CHARACTERISTIC fbwSTUMUB2 "Umgebungstemperatur Umweltbedingung 2 fuer Fehlerspeicherung" VALUE 0xF3022 MSA15_FW3 0 DEZ_DW_U 0.000000 65535.000000 /end CHARACTERISTIC
/begin CHARACTERISTIC fbwSTUMUB3 "Umgebungstemperatur Umweltbedingung 3 fuer Fehlerspeicherung" VALUE 0xF3024 MSA15_FW3 0 DEZ_DW_U 0.000000 65535.000000 /end CHARACTERISTIC
/begin CHARACTERISTIC fbwSTUMUB4 "Umgebungstemperatur Umweltbedingung 4 fuer Fehlerspeicherung" VALUE 0xF3026 MSA15_FW3 0 DEZ_DW_U 0.000000 65535.000000 /end CHARACTERISTIC
/begin CHARACTERISTIC fbwSTUMUB5 "Umgebungstemperatur Umweltbedingung 5 fuer Fehlerspeicherung" VALUE 0xF3028 MSA15_FW3 0 DEZ_DW_U 0.000000 65535.000000 /end CHARACTERISTIC
/begin CHARACTERISTIC fbwSTV2CC0 "TVK2  CARB Speichercode Bit 0" VALUE 0xF36A4 MSA15_FW3 0 DEZ_DW_U 0.000000 65535.000000 /end CHARACTERISTIC
/begin CHARACTERISTIC fbwSUBTBCO "UBT Blinkcode" VALUE 0xF2784 MSA15_FW3 0 DEZ_DW_U 0.000000 65535.000000 /end CHARACTERISTIC
/begin CHARACTERISTIC fbwSUBTCC0 "UBT CARB Speichercode Bit 0" VALUE 0xF2786 MSA15_FW3 0 DEZ_DW_U 0.000000 65535.000000 /end CHARACTERISTIC
/begin CHARACTERISTIC fbwSUBTCC1 "UBT CARB Speichercode Bit 1" VALUE 0xF2788 MSA15_FW3 0 DEZ_DW_U 0.000000 65535.000000 /end CHARACTERISTIC
/begin CHARACTERISTIC fbwSUBTCC2 "UBT CARB Speichercode Bit 2" VALUE 0xF278A MSA15_FW3 0 DEZ_DW_U 0.000000 65535.000000 /end CHARACTERISTIC
/begin CHARACTERISTIC fbwSUBTCC3 "UBT CARB Speichercode Bit 3" VALUE 0xF278C MSA15_FW3 0 DEZ_DW_U 0.000000 65535.000000 /end CHARACTERISTIC
/begin CHARACTERISTIC fbwSUBTCC4 "UBT  CARB Speichercode Bit 4" VALUE 0xF278E MSA15_FW3 0 DEZ_DW_U 0.000000 65535.000000 /end CHARACTERISTIC
/begin CHARACTERISTIC fbwSUBTCC5 "UBT  CARB Speichercode Bit 5" VALUE 0xF2790 MSA15_FW3 0 DEZ_DW_U 0.000000 65535.000000 /end CHARACTERISTIC
/begin CHARACTERISTIC fbwSUBTCC6 "UBT  CARB Speichercode Bit 6" VALUE 0xF2792 MSA15_FW3 0 DEZ_DW_U 0.000000 65535.000000 /end CHARACTERISTIC
/begin CHARACTERISTIC fbwSUBTCC7 "UBT  CARB Speichercode Bit 7" VALUE 0xF2794 MSA15_FW3 0 DEZ_DW_U 0.000000 65535.000000 /end CHARACTERISTIC
/begin CHARACTERISTIC fbwSUBTENT "UBT Entrprellmodus" VALUE 0xF2781 MSA15_FW1 0 DEZ_DB_U 0.000000 255.000000 /end CHARACTERISTIC
/begin CHARACTERISTIC fbwSUBTFLC "UBT Startwert Eintragzaehler" VALUE 0xF2782 MSA15_FW1 0 DEZ_DB_U 0.000000 255.000000 /end CHARACTERISTIC
/begin CHARACTERISTIC fbwSUBTHLC "UBT Startwert Heilungszaehler" VALUE 0xF2783 MSA15_FW1 0 DEZ_DB_U 0.000000 255.000000 /end CHARACTERISTIC
/begin CHARACTERISTIC fbwSUBTPRI "UBT Prioritaet" VALUE 0xF2780 MSA15_FW1 0 DEZ_DB_U 0.000000 3.000000 EXTENDED_LIMITS 0.000000 255.000000 /end CHARACTERISTIC
/begin CHARACTERISTIC fbwSUBTSPC "UBT Code fuer Fehlerspeicherung" VALUE 0xF277E MSA15_FW3 0 DEZ_DW_U 0.000000 65535.000000 /end CHARACTERISTIC
/begin CHARACTERISTIC fbwSUBTUB1 "UBAT Umweltbedingung 1 fuer Fehlerspeicherung" VALUE 0xF2796 MSA15_FW3 0 DEZ_DW_U 0.000000 65535.000000 /end CHARACTERISTIC
/begin CHARACTERISTIC fbwSUBTUB2 "UBAT Umweltbedingung 2 fuer Fehlerspeicherung" VALUE 0xF2798 MSA15_FW3 0 DEZ_DW_U 0.000000 65535.000000 /end CHARACTERISTIC
/begin CHARACTERISTIC fbwSUBTUB3 "UBAT Umweltbedingung 3 fuer Fehlerspeicherung" VALUE 0xF279A MSA15_FW3 0 DEZ_DW_U 0.000000 65535.000000 /end CHARACTERISTIC
/begin CHARACTERISTIC fbwSUBTUB4 "UBAT Umweltbedingung 4 fuer Fehlerspeicherung" VALUE 0xF279C MSA15_FW3 0 DEZ_DW_U 0.000000 65535.000000 /end CHARACTERISTIC
/begin CHARACTERISTIC fbwSUC1BCO "UC1  Blinkcode" VALUE 0xF27B2 MSA15_FW3 0 DEZ_DW_U 0.000000 65535.000000 /end CHARACTERISTIC
/begin CHARACTERISTIC fbwSUC1CC0 "UC1  CARB Speichercode Bit 0" VALUE 0xF27B4 MSA15_FW3 0 DEZ_DW_U 0.000000 65535.000000 /end CHARACTERISTIC
/begin CHARACTERISTIC fbwSUC1CC1 "UC1  CARB Speichercode Bit 1" VALUE 0xF27B6 MSA15_FW3 0 DEZ_DW_U 0.000000 65535.000000 /end CHARACTERISTIC
/begin CHARACTERISTIC fbwSUC1CC2 "UC1  CARB Speichercode Bit 2" VALUE 0xF27B8 MSA15_FW3 0 DEZ_DW_U 0.000000 65535.000000 /end CHARACTERISTIC
/begin CHARACTERISTIC fbwSUC1CC3 "UC1  CARB Speichercode Bit 3" VALUE 0xF27BA MSA15_FW3 0 DEZ_DW_U 0.000000 65535.000000 /end CHARACTERISTIC
/begin CHARACTERISTIC fbwSUC1CC4 "UC1  CARB Speichercode Bit 4" VALUE 0xF27BC MSA15_FW3 0 DEZ_DW_U 0.000000 65535.000000 /end CHARACTERISTIC
/begin CHARACTERISTIC fbwSUC1CC5 "UC1  CARB Speichercode Bit 5" VALUE 0xF27BE MSA15_FW3 0 DEZ_DW_U 0.000000 65535.000000 /end CHARACTERISTIC
/begin CHARACTERISTIC fbwSUC1CC6 "UC1  CARB Speichercode Bit 6" VALUE 0xF27C0 MSA15_FW3 0 DEZ_DW_U 0.000000 65535.000000 /end CHARACTERISTIC
/begin CHARACTERISTIC fbwSUC1CC7 "UC1  CARB Speichercode Bit 7" VALUE 0xF27C2 MSA15_FW3 0 DEZ_DW_U 0.000000 65535.000000 /end CHARACTERISTIC
/begin CHARACTERISTIC fbwSUC1ENT "UC1 Entrprellmodus" VALUE 0xF27AF MSA15_FW1 0 DEZ_DB_U 0.000000 255.000000 /end CHARACTERISTIC
/begin CHARACTERISTIC fbwSUC1FLC "UC1  Startwert Eintragzaehler" VALUE 0xF27B0 MSA15_FW1 0 DEZ_DB_U 0.000000 255.000000 /end CHARACTERISTIC
/begin CHARACTERISTIC fbwSUC1HLC "UC1  Startwert Heilungszaehler" VALUE 0xF27B1 MSA15_FW1 0 DEZ_DB_U 0.000000 255.000000 /end CHARACTERISTIC
/begin CHARACTERISTIC fbwSUC1PRI "UC1 Prioritaet" VALUE 0xF27AE MSA15_FW1 0 DEZ_DB_U 0.000000 3.000000 EXTENDED_LIMITS 0.000000 255.000000 /end CHARACTERISTIC
/begin CHARACTERISTIC fbwSUC1SPC "UC1 Code fuer Fehlerspeicherung" VALUE 0xF27AC MSA15_FW3 0 DEZ_DW_U 0.000000 65535.000000 /end CHARACTERISTIC
/begin CHARACTERISTIC fbwSUC1UB1 "UC1 Umweltbedingung 1 fuer Fehlerspeicherung" VALUE 0xF27C4 MSA15_FW3 0 DEZ_DW_U 0.000000 65535.000000 /end CHARACTERISTIC
/begin CHARACTERISTIC fbwSUC1UB2 "UC1 Umweltbedingung 2 fuer Fehlerspeicherung" VALUE 0xF27C6 MSA15_FW3 0 DEZ_DW_U 0.000000 65535.000000 /end CHARACTERISTIC
/begin CHARACTERISTIC fbwSUC1UB3 "UC1 Umweltbedingung 3 fuer Fehlerspeicherung" VALUE 0xF27C8 MSA15_FW3 0 DEZ_DW_U 0.000000 65535.000000 /end CHARACTERISTIC
/begin CHARACTERISTIC fbwSUC1UB4 "UC1 Umweltbedingung 4 fuer Fehlerspeicherung" VALUE 0xF27CA MSA15_FW3 0 DEZ_DW_U 0.000000 65535.000000 /end CHARACTERISTIC
/begin CHARACTERISTIC fbwSUC2BCO "UC2  Blinkcode" VALUE 0xF27EC MSA15_FW3 0 DEZ_DW_U 0.000000 65535.000000 /end CHARACTERISTIC
/begin CHARACTERISTIC fbwSUC2CC0 "UC2  CARB Speichercode Bit 0" VALUE 0xF27EE MSA15_FW3 0 DEZ_DW_U 0.000000 65535.000000 /end CHARACTERISTIC
/begin CHARACTERISTIC fbwSUC2CC1 "UC2  CARB Speichercode Bit 1" VALUE 0xF27F0 MSA15_FW3 0 DEZ_DW_U 0.000000 65535.000000 /end CHARACTERISTIC
/begin CHARACTERISTIC fbwSUC2CC2 "UC2  CARB Speichercode Bit 2" VALUE 0xF27F2 MSA15_FW3 0 DEZ_DW_U 0.000000 65535.000000 /end CHARACTERISTIC
/begin CHARACTERISTIC fbwSUC2CC3 "UC2  CARB Speichercode Bit 3" VALUE 0xF27F4 MSA15_FW3 0 DEZ_DW_U 0.000000 65535.000000 /end CHARACTERISTIC
/begin CHARACTERISTIC fbwSUC2CC4 "UC2  CARB Speichercode Bit 4" VALUE 0xF27F6 MSA15_FW3 0 DEZ_DW_U 0.000000 65535.000000 /end CHARACTERISTIC
/begin CHARACTERISTIC fbwSUC2CC5 "UC2  CARB Speichercode Bit 5" VALUE 0xF27F8 MSA15_FW3 0 DEZ_DW_U 0.000000 65535.000000 /end CHARACTERISTIC
/begin CHARACTERISTIC fbwSUC2CC6 "UC2  CARB Speichercode Bit 6" VALUE 0xF27FA MSA15_FW3 0 DEZ_DW_U 0.000000 65535.000000 /end CHARACTERISTIC
/begin CHARACTERISTIC fbwSUC2CC7 "UC2  CARB Speichercode Bit 7" VALUE 0xF27FC MSA15_FW3 0 DEZ_DW_U 0.000000 65535.000000 /end CHARACTERISTIC
/begin CHARACTERISTIC fbwSUC2ENT "UC2 Entrprellmodus" VALUE 0xF27E9 MSA15_FW1 0 DEZ_DB_U 0.000000 255.000000 /end CHARACTERISTIC
/begin CHARACTERISTIC fbwSUC2FLC "UC2  Startwert Eintragzaehler" VALUE 0xF27EA MSA15_FW1 0 DEZ_DB_U 0.000000 255.000000 /end CHARACTERISTIC
/begin CHARACTERISTIC fbwSUC2HLC "UC2  Startwert Heilungszaehler" VALUE 0xF27EB MSA15_FW1 0 DEZ_DB_U 0.000000 255.000000 /end CHARACTERISTIC
/begin CHARACTERISTIC fbwSUC2PRI "UC2 Prioritaet" VALUE 0xF27E8 MSA15_FW1 0 DEZ_DB_U 0.000000 3.000000 EXTENDED_LIMITS 0.000000 255.000000 /end CHARACTERISTIC
/begin CHARACTERISTIC fbwSUC2SPC "UC2 Code fuer Fehlerspeicherung" VALUE 0xF27E6 MSA15_FW3 0 DEZ_DW_U 0.000000 65535.000000 /end CHARACTERISTIC
/begin CHARACTERISTIC fbwSUC2UB1 "UC2 Umweltbedingung 1 fuer Fehlerspeicherung" VALUE 0xF27FE MSA15_FW3 0 DEZ_DW_U 0.000000 65535.000000 /end CHARACTERISTIC
/begin CHARACTERISTIC fbwSUC2UB2 "UC2 Umweltbedingung 2 fuer Fehlerspeicherung" VALUE 0xF2800 MSA15_FW3 0 DEZ_DW_U 0.000000 65535.000000 /end CHARACTERISTIC
/begin CHARACTERISTIC fbwSUC2UB3 "UC2 Umweltbedingung 3 fuer Fehlerspeicherung" VALUE 0xF2802 MSA15_FW3 0 DEZ_DW_U 0.000000 65535.000000 /end CHARACTERISTIC
/begin CHARACTERISTIC fbwSUC2UB4 "UC2 Umweltbedingung 4 fuer Fehlerspeicherung" VALUE 0xF2804 MSA15_FW3 0 DEZ_DW_U 0.000000 65535.000000 /end CHARACTERISTIC
/begin CHARACTERISTIC fbwSUG1BCO "UG1  Blinkcode" VALUE 0xF2BC8 MSA15_FW3 0 DEZ_DW_U 0.000000 65535.000000 /end CHARACTERISTIC
/begin CHARACTERISTIC fbwSUG1CC0 "UG1  CARB Speichercode Bit 0" VALUE 0xF2BCA MSA15_FW3 0 DEZ_DW_U 0.000000 65535.000000 /end CHARACTERISTIC
/begin CHARACTERISTIC fbwSUG1CC1 "UG1  CARB Speichercode Bit 1" VALUE 0xF2BCC MSA15_FW3 0 DEZ_DW_U 0.000000 65535.000000 /end CHARACTERISTIC
/begin CHARACTERISTIC fbwSUG1CC2 "UG1  CARB Speichercode Bit 2" VALUE 0xF2BCE MSA15_FW3 0 DEZ_DW_U 0.000000 65535.000000 /end CHARACTERISTIC
/begin CHARACTERISTIC fbwSUG1CC3 "UG1  CARB Speichercode Bit 3" VALUE 0xF2BD0 MSA15_FW3 0 DEZ_DW_U 0.000000 65535.000000 /end CHARACTERISTIC
/begin CHARACTERISTIC fbwSUG1CC4 "UG1  CARB Speichercode Bit 4" VALUE 0xF2BD2 MSA15_FW3 0 DEZ_DW_U 0.000000 65535.000000 /end CHARACTERISTIC
/begin CHARACTERISTIC fbwSUG1CC5 "UG1  CARB Speichercode Bit 5" VALUE 0xF2BD4 MSA15_FW3 0 DEZ_DW_U 0.000000 65535.000000 /end CHARACTERISTIC
/begin CHARACTERISTIC fbwSUG1CC6 "UG1  CARB Speichercode Bit 6" VALUE 0xF2BD6 MSA15_FW3 0 DEZ_DW_U 0.000000 65535.000000 /end CHARACTERISTIC
/begin CHARACTERISTIC fbwSUG1CC7 "UG1  CARB Speichercode Bit 7" VALUE 0xF2BD8 MSA15_FW3 0 DEZ_DW_U 0.000000 65535.000000 /end CHARACTERISTIC
/begin CHARACTERISTIC fbwSUG1ENT "UG1  Entrprellmodus" VALUE 0xF2BC5 MSA15_FW1 0 DEZ_DB_U 0.000000 255.000000 /end CHARACTERISTIC
/begin CHARACTERISTIC fbwSUG1FLC "UG1  Startwert Eintragzaehler" VALUE 0xF2BC6 MSA15_FW1 0 DEZ_DB_U 0.000000 255.000000 /end CHARACTERISTIC
/begin CHARACTERISTIC fbwSUG1HLC "UG1  Startwert Heilungszaehler" VALUE 0xF2BC7 MSA15_FW1 0 DEZ_DB_U 0.000000 255.000000 /end CHARACTERISTIC
/begin CHARACTERISTIC fbwSUG1PRI "UG1  Prioritaet" VALUE 0xF2BC4 MSA15_FW1 0 DEZ_DB_U 0.000000 3.000000 EXTENDED_LIMITS 0.000000 255.000000 /end CHARACTERISTIC
/begin CHARACTERISTIC fbwSUG1SPC "UG1  Code fuer Fehlerspeicherung" VALUE 0xF2BC2 MSA15_FW3 0 DEZ_DW_U 0.000000 65535.000000 /end CHARACTERISTIC
/begin CHARACTERISTIC fbwSUG1UB1 "UG1 Umweltbedingung 1 fuer Fehlerspeicherung" VALUE 0xF2BDA MSA15_FW3 0 DEZ_DW_U 0.000000 65535.000000 /end CHARACTERISTIC
/begin CHARACTERISTIC fbwSUG1UB2 "UG1 Umweltbedingung 2 fuer Fehlerspeicherung" VALUE 0xF2BDC MSA15_FW3 0 DEZ_DW_U 0.000000 65535.000000 /end CHARACTERISTIC
/begin CHARACTERISTIC fbwSUG1UB3 "UG1 Umweltbedingung 3 fuer Fehlerspeicherung" VALUE 0xF2BDE MSA15_FW3 0 DEZ_DW_U 0.000000 65535.000000 /end CHARACTERISTIC
/begin CHARACTERISTIC fbwSUG1UB4 "UG1 Umweltbedingung 4 fuer Fehlerspeicherung" VALUE 0xF2BE0 MSA15_FW3 0 DEZ_DW_U 0.000000 65535.000000 /end CHARACTERISTIC
/begin CHARACTERISTIC fbwSUG2BCO "UG2  Blinkcode" VALUE 0xF2BF6 MSA15_FW3 0 DEZ_DW_U 0.000000 65535.000000 /end CHARACTERISTIC
/begin CHARACTERISTIC fbwSUG2CC0 "UG2  CARB Speichercode Bit 0" VALUE 0xF2BF8 MSA15_FW3 0 DEZ_DW_U 0.000000 65535.000000 /end CHARACTERISTIC
/begin CHARACTERISTIC fbwSUG2CC1 "UG2  CARB Speichercode Bit 1" VALUE 0xF2BFA MSA15_FW3 0 DEZ_DW_U 0.000000 65535.000000 /end CHARACTERISTIC
/begin CHARACTERISTIC fbwSUG2CC2 "UG2  CARB Speichercode Bit 2" VALUE 0xF2BFC MSA15_FW3 0 DEZ_DW_U 0.000000 65535.000000 /end CHARACTERISTIC
/begin CHARACTERISTIC fbwSUG2CC3 "UG2  CARB Speichercode Bit 3" VALUE 0xF2BFE MSA15_FW3 0 DEZ_DW_U 0.000000 65535.000000 /end CHARACTERISTIC
/begin CHARACTERISTIC fbwSUG2CC4 "UG2  CARB Speichercode Bit 4" VALUE 0xF2C00 MSA15_FW3 0 DEZ_DW_U 0.000000 65535.000000 /end CHARACTERISTIC
/begin CHARACTERISTIC fbwSUG2CC5 "UG2  CARB Speichercode Bit 5" VALUE 0xF2C02 MSA15_FW3 0 DEZ_DW_U 0.000000 65535.000000 /end CHARACTERISTIC
/begin CHARACTERISTIC fbwSUG2CC6 "UG2  CARB Speichercode Bit 6" VALUE 0xF2C04 MSA15_FW3 0 DEZ_DW_U 0.000000 65535.000000 /end CHARACTERISTIC
/begin CHARACTERISTIC fbwSUG2CC7 "UG2  CARB Speichercode Bit 7" VALUE 0xF2C06 MSA15_FW3 0 DEZ_DW_U 0.000000 65535.000000 /end CHARACTERISTIC
/begin CHARACTERISTIC fbwSUG2ENT "UG2  Entrprellmodus" VALUE 0xF2BF3 MSA15_FW1 0 DEZ_DB_U 0.000000 255.000000 /end CHARACTERISTIC
/begin CHARACTERISTIC fbwSUG2FLC "UG2  Startwert Eintragzaehler" VALUE 0xF2BF4 MSA15_FW1 0 DEZ_DB_U 0.000000 255.000000 /end CHARACTERISTIC
/begin CHARACTERISTIC fbwSUG2HLC "UG2  Startwert Heilungszaehler" VALUE 0xF2BF5 MSA15_FW1 0 DEZ_DB_U 0.000000 255.000000 /end CHARACTERISTIC
/begin CHARACTERISTIC fbwSUG2PRI "UG2  Prioritaet" VALUE 0xF2BF2 MSA15_FW1 0 DEZ_DB_U 0.000000 3.000000 EXTENDED_LIMITS 0.000000 255.000000 /end CHARACTERISTIC
/begin CHARACTERISTIC fbwSUG2SPC "UG2  Code fuer Fehlerspeicherung" VALUE 0xF2BF0 MSA15_FW3 0 DEZ_DW_U 0.000000 65535.000000 /end CHARACTERISTIC
/begin CHARACTERISTIC fbwSUG2UB1 "UG2 Umweltbedingung 1 fuer Fehlerspeicherung" VALUE 0xF2C08 MSA15_FW3 0 DEZ_DW_U 0.000000 65535.000000 /end CHARACTERISTIC
/begin CHARACTERISTIC fbwSUG2UB2 "UG2 Umweltbedingung 2 fuer Fehlerspeicherung" VALUE 0xF2C0A MSA15_FW3 0 DEZ_DW_U 0.000000 65535.000000 /end CHARACTERISTIC
/begin CHARACTERISTIC fbwSUG2UB3 "UG2 Umweltbedingung 3 fuer Fehlerspeicherung" VALUE 0xF2C0C MSA15_FW3 0 DEZ_DW_U 0.000000 65535.000000 /end CHARACTERISTIC
/begin CHARACTERISTIC fbwSUG2UB4 "UG2 Umweltbedingung 4 fuer Fehlerspeicherung" VALUE 0xF2C0E MSA15_FW3 0 DEZ_DW_U 0.000000 65535.000000 /end CHARACTERISTIC
/begin CHARACTERISTIC fbwSVDFBCO "VDF  Blinkcode" VALUE 0xF28FC MSA15_FW3 0 DEZ_DW_U 0.000000 65535.000000 /end CHARACTERISTIC
/begin CHARACTERISTIC fbwSVDFCC0 "VDF  CARB Speichercode Bit 0" VALUE 0xF28FE MSA15_FW3 0 DEZ_DW_U 0.000000 65535.000000 /end CHARACTERISTIC
/begin CHARACTERISTIC fbwSVDFCC1 "VDF  CARB Speichercode Bit 1" VALUE 0xF2900 MSA15_FW3 0 DEZ_DW_U 0.000000 65535.000000 /end CHARACTERISTIC
/begin CHARACTERISTIC fbwSVDFCC2 "VDF  CARB Speichercode Bit 2" VALUE 0xF2902 MSA15_FW3 0 DEZ_DW_U 0.000000 65535.000000 /end CHARACTERISTIC
/begin CHARACTERISTIC fbwSVDFCC3 "VDF  CARB Speichercode Bit 3" VALUE 0xF2904 MSA15_FW3 0 DEZ_DW_U 0.000000 65535.000000 /end CHARACTERISTIC
/begin CHARACTERISTIC fbwSVDFCC4 "VDF  CARB Speichercode Bit 4" VALUE 0xF2906 MSA15_FW3 0 DEZ_DW_U 0.000000 65535.000000 /end CHARACTERISTIC
/begin CHARACTERISTIC fbwSVDFCC5 "VDF  CARB Speichercode Bit 5" VALUE 0xF2908 MSA15_FW3 0 DEZ_DW_U 0.000000 65535.000000 /end CHARACTERISTIC
/begin CHARACTERISTIC fbwSVDFCC6 "VDF  CARB Speichercode Bit 6" VALUE 0xF290A MSA15_FW3 0 DEZ_DW_U 0.000000 65535.000000 /end CHARACTERISTIC
/begin CHARACTERISTIC fbwSVDFCC7 "VDF  CARB Speichercode Bit 7" VALUE 0xF290C MSA15_FW3 0 DEZ_DW_U 0.000000 65535.000000 /end CHARACTERISTIC
/begin CHARACTERISTIC fbwSVDFENT "VDF  Entrprellmodus" VALUE 0xF28F9 MSA15_FW1 0 DEZ_DB_U 0.000000 255.000000 /end CHARACTERISTIC
/begin CHARACTERISTIC fbwSVDFFLC "VDF  Startwert Eintragzaehler" VALUE 0xF28FA MSA15_FW1 0 DEZ_DB_U 0.000000 255.000000 /end CHARACTERISTIC
/begin CHARACTERISTIC fbwSVDFHLC "VDF  Startwert Heilungszaehler" VALUE 0xF28FB MSA15_FW1 0 DEZ_DB_U 0.000000 255.000000 /end CHARACTERISTIC
/begin CHARACTERISTIC fbwSVDFPRI "VDF  Prioritaet" VALUE 0xF28F8 MSA15_FW1 0 DEZ_DB_U 0.000000 3.000000 EXTENDED_LIMITS 0.000000 255.000000 /end CHARACTERISTIC
/begin CHARACTERISTIC fbwSVDFSPC "VDF  Code fuer Fehlerspeicherung" VALUE 0xF28F6 MSA15_FW3 0 DEZ_DW_U 0.000000 65535.000000 /end CHARACTERISTIC
/begin CHARACTERISTIC fbwSVDFUB1 "VDF Umweltbedingung 1" VALUE 0xF290E MSA15_FW3 0 DEZ_DW_U 0.000000 65535.000000 /end CHARACTERISTIC
/begin CHARACTERISTIC fbwSVDFUB2 "VDF Umweltbedingung 2" VALUE 0xF2910 MSA15_FW3 0 DEZ_DW_U 0.000000 65535.000000 /end CHARACTERISTIC
/begin CHARACTERISTIC fbwSVDFUB3 "VDF Umweltbedingung 3" VALUE 0xF2912 MSA15_FW3 0 DEZ_DW_U 0.000000 65535.000000 /end CHARACTERISTIC
/begin CHARACTERISTIC fbwSVDFUB4 "VDF Umweltbedingung 4" VALUE 0xF2914 MSA15_FW3 0 DEZ_DW_U 0.000000 65535.000000 /end CHARACTERISTIC
/begin CHARACTERISTIC fbwSVDPBCO "VDP  Blinkcode" VALUE 0xF2936 MSA15_FW3 0 DEZ_DW_U 0.000000 65535.000000 /end CHARACTERISTIC
/begin CHARACTERISTIC fbwSVDPCC0 "VDP  CARB Speichercode Bit 0" VALUE 0xF2938 MSA15_FW3 0 DEZ_DW_U 0.000000 65535.000000 /end CHARACTERISTIC
/begin CHARACTERISTIC fbwSVDPCC1 "VDP  CARB Speichercode Bit 1" VALUE 0xF293A MSA15_FW3 0 DEZ_DW_U 0.000000 65535.000000 /end CHARACTERISTIC
/begin CHARACTERISTIC fbwSVDPCC2 "VDP  CARB Speichercode Bit 2" VALUE 0xF293C MSA15_FW3 0 DEZ_DW_U 0.000000 65535.000000 /end CHARACTERISTIC
/begin CHARACTERISTIC fbwSVDPCC3 "VDP  CARB Speichercode Bit 3" VALUE 0xF293E MSA15_FW3 0 DEZ_DW_U 0.000000 65535.000000 /end CHARACTERISTIC
/begin CHARACTERISTIC fbwSVDPCC4 "VDP  CARB Speichercode Bit 4" VALUE 0xF2940 MSA15_FW3 0 DEZ_DW_U 0.000000 65535.000000 /end CHARACTERISTIC
/begin CHARACTERISTIC fbwSVDPCC5 "VDP  CARB Speichercode Bit 5" VALUE 0xF2942 MSA15_FW3 0 DEZ_DW_U 0.000000 65535.000000 /end CHARACTERISTIC
/begin CHARACTERISTIC fbwSVDPCC6 "VDP  CARB Speichercode Bit 6" VALUE 0xF2944 MSA15_FW3 0 DEZ_DW_U 0.000000 65535.000000 /end CHARACTERISTIC
/begin CHARACTERISTIC fbwSVDPCC7 "VDP  CARB Speichercode Bit 7" VALUE 0xF2946 MSA15_FW3 0 DEZ_DW_U 0.000000 65535.000000 /end CHARACTERISTIC
/begin CHARACTERISTIC fbwSVDPENT "VDP  Entrprellmodus" VALUE 0xF2933 MSA15_FW1 0 DEZ_DB_U 0.000000 255.000000 /end CHARACTERISTIC
/begin CHARACTERISTIC fbwSVDPFLC "VDP  Startwert Eintragzaehler" VALUE 0xF2934 MSA15_FW1 0 DEZ_DB_U 0.000000 255.000000 /end CHARACTERISTIC
/begin CHARACTERISTIC fbwSVDPHLC "VDP  Startwert Heilungszaehler" VALUE 0xF2935 MSA15_FW1 0 DEZ_DB_U 0.000000 255.000000 /end CHARACTERISTIC
/begin CHARACTERISTIC fbwSVDPPRI "VDP  Prioritaet" VALUE 0xF2932 MSA15_FW1 0 DEZ_DB_U 0.000000 3.000000 EXTENDED_LIMITS 0.000000 255.000000 /end CHARACTERISTIC
/begin CHARACTERISTIC fbwSVDPSPC "VDP  Code fuer Fehlerspeicherung" VALUE 0xF2930 MSA15_FW3 0 DEZ_DW_U 0.000000 65535.000000 /end CHARACTERISTIC
/begin CHARACTERISTIC fbwSVDPUB1 "VDP Umweltbedingung 1" VALUE 0xF2948 MSA15_FW3 0 DEZ_DW_U 0.000000 65535.000000 /end CHARACTERISTIC
/begin CHARACTERISTIC fbwSVDPUB2 "VDP Umweltbedingung 2" VALUE 0xF294A MSA15_FW3 0 DEZ_DW_U 0.000000 65535.000000 /end CHARACTERISTIC
/begin CHARACTERISTIC fbwSVDPUB3 "VDP Umweltbedingung 3" VALUE 0xF294C MSA15_FW3 0 DEZ_DW_U 0.000000 65535.000000 /end CHARACTERISTIC
/begin CHARACTERISTIC fbwSVDPUB4 "VDP Umweltbedingung 4" VALUE 0xF294E MSA15_FW3 0 DEZ_DW_U 0.000000 65535.000000 /end CHARACTERISTIC
/begin CHARACTERISTIC fbwSWTFBCO "WTF  Blinkcode" VALUE 0xF289A MSA15_FW3 0 DEZ_DW_U 0.000000 65535.000000 /end CHARACTERISTIC
/begin CHARACTERISTIC fbwSWTFCC0 "WTF  CARB Speichercode Bit 0" VALUE 0xF289C MSA15_FW3 0 DEZ_DW_U 0.000000 65535.000000 /end CHARACTERISTIC
/begin CHARACTERISTIC fbwSWTFCC1 "WTF  CARB Speichercode Bit 1" VALUE 0xF289E MSA15_FW3 0 DEZ_DW_U 0.000000 65535.000000 /end CHARACTERISTIC
/begin CHARACTERISTIC fbwSWTFCC2 "WTF  CARB Speichercode Bit 2" VALUE 0xF28A0 MSA15_FW3 0 DEZ_DW_U 0.000000 65535.000000 /end CHARACTERISTIC
/begin CHARACTERISTIC fbwSWTFCC3 "WTF  CARB Speichercode Bit 3" VALUE 0xF28A2 MSA15_FW3 0 DEZ_DW_U 0.000000 65535.000000 /end CHARACTERISTIC
/begin CHARACTERISTIC fbwSWTFCC4 "WTF  CARB Speichercode Bit 4" VALUE 0xF28A4 MSA15_FW3 0 DEZ_DW_U 0.000000 65535.000000 /end CHARACTERISTIC
/begin CHARACTERISTIC fbwSWTFCC5 "WTF  CARB Speichercode Bit 5" VALUE 0xF28A6 MSA15_FW3 0 DEZ_DW_U 0.000000 65535.000000 /end CHARACTERISTIC
/begin CHARACTERISTIC fbwSWTFCC6 "WTF  CARB Speichercode Bit 6" VALUE 0xF28A8 MSA15_FW3 0 DEZ_DW_U 0.000000 65535.000000 /end CHARACTERISTIC
/begin CHARACTERISTIC fbwSWTFCC7 "WTF  CARB Speichercode Bit 7" VALUE 0xF28AA MSA15_FW3 0 DEZ_DW_U 0.000000 65535.000000 /end CHARACTERISTIC
/begin CHARACTERISTIC fbwSWTFENT "WTF  Entrprellmodus" VALUE 0xF2897 MSA15_FW1 0 DEZ_DB_U 0.000000 255.000000 /end CHARACTERISTIC
/begin CHARACTERISTIC fbwSWTFFLC "WTF  Startwert Eintragzaehler" VALUE 0xF2898 MSA15_FW1 0 DEZ_DB_U 0.000000 255.000000 /end CHARACTERISTIC
/begin CHARACTERISTIC fbwSWTFHLC "WTF  Startwert Heilungszaehler" VALUE 0xF2899 MSA15_FW1 0 DEZ_DB_U 0.000000 255.000000 /end CHARACTERISTIC
/begin CHARACTERISTIC fbwSWTFPRI "WTF  Prioritaet" VALUE 0xF2896 MSA15_FW1 0 DEZ_DB_U 0.000000 3.000000 EXTENDED_LIMITS 0.000000 255.000000 /end CHARACTERISTIC
/begin CHARACTERISTIC fbwSWTFSPC "WTF  Code fuer Fehlerspeicherung" VALUE 0xF2894 MSA15_FW3 0 DEZ_DW_U 0.000000 65535.000000 /end CHARACTERISTIC
/begin CHARACTERISTIC fbwSWTFUB1 "WTF Umweltbedingung 1 fuer Fehlerspeicherung" VALUE 0xF28AC MSA15_FW3 0 DEZ_DW_U 0.000000 65535.000000 /end CHARACTERISTIC
/begin CHARACTERISTIC fbwSWTFUB2 "WTF Umweltbedingung 2 fuer Fehlerspeicherung" VALUE 0xF28AE MSA15_FW3 0 DEZ_DW_U 0.000000 65535.000000 /end CHARACTERISTIC
/begin CHARACTERISTIC fbwSWTFUB3 "WTF Umweltbedingung 3 fuer Fehlerspeicherung" VALUE 0xF28B0 MSA15_FW3 0 DEZ_DW_U 0.000000 65535.000000 /end CHARACTERISTIC
/begin CHARACTERISTIC fbwSWTFUB4 "WTF Umweltbedingung 4 fuer Fehlerspeicherung" VALUE 0xF28B2 MSA15_FW3 0 DEZ_DW_U 0.000000 65535.000000 /end CHARACTERISTIC
/begin CHARACTERISTIC fbwSZHRBCO "ZHR  Blinkcode" VALUE 0xF2E6A MSA15_FW3 0 DEZ_DW_U 0.000000 65535.000000 /end CHARACTERISTIC
/begin CHARACTERISTIC fbwSZHRCC0 "ZHR  CARB Speichercode Bit 0" VALUE 0xF2E6C MSA15_FW3 0 DEZ_DW_U 0.000000 65535.000000 /end CHARACTERISTIC
/begin CHARACTERISTIC fbwSZHRCC1 "ZHR  CARB Speichercode Bit 1" VALUE 0xF2E6E MSA15_FW3 0 DEZ_DW_U 0.000000 65535.000000 /end CHARACTERISTIC
/begin CHARACTERISTIC fbwSZHRCC2 "ZHR  CARB Speichercode Bit 2" VALUE 0xF2E70 MSA15_FW3 0 DEZ_DW_U 0.000000 65535.000000 /end CHARACTERISTIC
/begin CHARACTERISTIC fbwSZHRCC3 "ZHR  CARB Speichercode Bit 3" VALUE 0xF2E72 MSA15_FW3 0 DEZ_DW_U 0.000000 65535.000000 /end CHARACTERISTIC
/begin CHARACTERISTIC fbwSZHRCC4 "ZHR  CARB Speichercode Bit 4" VALUE 0xF2E74 MSA15_FW3 0 DEZ_DW_U 0.000000 65535.000000 /end CHARACTERISTIC
/begin CHARACTERISTIC fbwSZHRCC5 "ZHR  CARB Speichercode Bit 5" VALUE 0xF2E76 MSA15_FW3 0 DEZ_DW_U 0.000000 65535.000000 /end CHARACTERISTIC
/begin CHARACTERISTIC fbwSZHRCC6 "ZHR  CARB Speichercode Bit 6" VALUE 0xF2E78 MSA15_FW3 0 DEZ_DW_U 0.000000 65535.000000 /end CHARACTERISTIC
/begin CHARACTERISTIC fbwSZHRCC7 "ZHR  CARB Speichercode Bit 7" VALUE 0xF2E7A MSA15_FW3 0 DEZ_DW_U 0.000000 65535.000000 /end CHARACTERISTIC
/begin CHARACTERISTIC fbwSZHRENT "ZHR  Entrprellmodus" VALUE 0xF2E67 MSA15_FW1 0 DEZ_DB_U 0.000000 255.000000 /end CHARACTERISTIC
/begin CHARACTERISTIC fbwSZHRFLC "ZHR  Startwert Eintragzaehler" VALUE 0xF2E68 MSA15_FW1 0 DEZ_DB_U 0.000000 255.000000 /end CHARACTERISTIC
/begin CHARACTERISTIC fbwSZHRHLC "ZHR  Startwert Heilungszaehler" VALUE 0xF2E69 MSA15_FW1 0 DEZ_DB_U 0.000000 255.000000 /end CHARACTERISTIC
/begin CHARACTERISTIC fbwSZHRPRI "ZHR  Prioritaet" VALUE 0xF2E66 MSA15_FW1 0 DEZ_DB_U 0.000000 3.000000 EXTENDED_LIMITS 0.000000 255.000000 /end CHARACTERISTIC
/begin CHARACTERISTIC fbwSZHRSPC "ZHR  Code fuer Fehlerspeicherung" VALUE 0xF2E64 MSA15_FW3 0 DEZ_DW_U 0.000000 65535.000000 /end CHARACTERISTIC
/begin CHARACTERISTIC fbwSZHRUB1 "ZHR Umweltbedingung 1 fuer Fehlerspeicherung" VALUE 0xF2E7C MSA15_FW3 0 DEZ_DW_U 0.000000 65535.000000 /end CHARACTERISTIC
/begin CHARACTERISTIC fbwSZHRUB2 "ZHR Umweltbedingung 2 fuer Fehlerspeicherung" VALUE 0xF2E7E MSA15_FW3 0 DEZ_DW_U 0.000000 65535.000000 /end CHARACTERISTIC
/begin CHARACTERISTIC fbwSZHRUB3 "ZHR Umweltbedingung 3 fuer Fehlerspeicherung" VALUE 0xF2E80 MSA15_FW3 0 DEZ_DW_U 0.000000 65535.000000 /end CHARACTERISTIC
/begin CHARACTERISTIC fbwSZHRUB4 "ZHR Umweltbedingung 4 fuer Fehlerspeicherung" VALUE 0xF2E82 MSA15_FW3 0 DEZ_DW_U 0.000000 65535.000000 /end CHARACTERISTIC
/begin CHARACTERISTIC fbwT_DBLNK "DIAG Systemleuchte - BLink - Tastzeit" VALUE 0xF26DA MSA15_FW3 0 ZEIT_ST 0.000000 655350000.000000 /end CHARACTERISTIC
/begin CHARACTERISTIC fbwT_DLAMX "DIA  Maximalzeit fuer Lampentest" VALUE 0xF26D6 MSA15_FW3 0 ZEIT_ST 0.000000 655350000.000000 /end CHARACTERISTIC
/begin CHARACTERISTIC fbwT_DLATS "DIA  Zeit fuer Lampentest (nach Drehzahlschwelle)" VALUE 0xF26D4 MSA15_FW3 0 ZEIT_ST 0.000000 655350000.000000 /end CHARACTERISTIC
/begin CHARACTERISTIC fbwT_DLDRZ "DIA  Drehzahlschwelle fuer Lampentest" VALUE 0xF26D8 MSA15_FW4 0 N 0.000000 6000.000000 EXTENDED_LIMITS 0.000000 32767.000000 /end CHARACTERISTIC
/begin CHARACTERISTIC fbwT_DVERZ "DIAG Systemleuchte - Verzoegerung bis Fehlerblinken" VALUE 0xF26DC MSA15_FW3 0 ZEIT_ST 0.000000 655350000.000000 /end CHARACTERISTIC
/begin CHARACTERISTIC fbwT_MBLNK "MIL BLink - Tastzeit" VALUE 0xF26E4 MSA15_FW3 0 ZEIT_ST 0.000000 655350000.000000 /end CHARACTERISTIC
/begin CHARACTERISTIC fbwT_MLAMX "MIL Maximalzeit fuer Lampentest" VALUE 0xF26E0 MSA15_FW3 0 ZEIT_ST 0.000000 655350000.000000 /end CHARACTERISTIC
/begin CHARACTERISTIC fbwT_MLATS "MIL Zeit fuer Lampentest (nach Drehzahlschwelle)" VALUE 0xF26DE MSA15_FW3 0 ZEIT_ST 0.000000 655350000.000000 /end CHARACTERISTIC
/begin CHARACTERISTIC fbwT_MLDRZ "MIL Drehzahlschwelle fuer Lampentest" VALUE 0xF26E2 MSA15_FW4 0 N 0.000000 6000.000000 EXTENDED_LIMITS 0.000000 32767.000000 /end CHARACTERISTIC
/begin CHARACTERISTIC fbwT_MVERZ "MIL Verzoegerung bis Fehlerblinken" VALUE 0xF26E6 MSA15_FW3 0 ZEIT_ST 0.000000 655350000.000000 /end CHARACTERISTIC
/begin CHARACTERISTIC fbwVERW_DT "FSP WarmUpCycle Differenz Temperatur" VALUE 0xF26C0 MSA15_FW4 0 DIF_T 0.000000 200.000000 EXTENDED_LIMITS -3276.800000 3276.700000 /end CHARACTERISTIC
/begin CHARACTERISTIC fbwVERW_DZ "FSP Driving Cycle Dauer" VALUE 0xF26C8 MSA15_FW3 0 ZEIT_ST 0.000000 655350000.000000 /end CHARACTERISTIC
/begin CHARACTERISTIC fbwVERW_ET "FSP WarmUpCycle End Temperatur" VALUE 0xF26BE MSA15_FW4 0 T -50.040010 149.960000 EXTENDED_LIMITS -273.140000 3003.560000 /end CHARACTERISTIC
/begin CHARACTERISTIC fbwVERW_LI "FSP Loeschzaehler Initialwert" VALUE 0xF26C6 MSA15_FW1 0 DEZ_DB_U 0.000000 255.000000 /end CHARACTERISTIC
/begin CHARACTERISTIC fbwVERW_LS "FSP Loeschzaehler Startwert" VALUE 0xF26C7 MSA15_FW1 0 DEZ_DB_U 0.000000 255.000000 /end CHARACTERISTIC
/begin CHARACTERISTIC fbwVERW_SZ "FSP WarmUpCycle Sperrzeit nach Initialisierung" VALUE 0xF26C2 MSA15_FW3 0 ZEIT_ST 0.000000 655350000.000000 /end CHARACTERISTIC
/begin CHARACTERISTIC fbwVERW_ZB "FSP Zeitbasis fuer Zeitentprellung" VALUE 0xF26C4 MSA15_FW3 0 ZEIT_ST 0.000000 655350000.000000 /end CHARACTERISTIC
/begin CHARACTERISTIC fgwABS_BMI "FGG niedrigste zu erfassende Beschleunigung" VALUE 0xF3798 MSA15_FW2 0 B -10.511610 10.511610 EXTENDED_LIMITS -10.850690 10.765920 /end CHARACTERISTIC
/begin RECORD_LAYOUT MSA15_FW2 FNC_VALUES 1 SBYTE COLUMN_DIR DIRECT /end RECORD_LAYOUT
/begin CHARACTERISTIC fgwABS_BMX "FGG hoechste zu erfassende Beschleunigung" VALUE 0xF3799 MSA15_FW2 0 B -10.511610 10.511610 EXTENDED_LIMITS -10.850690 10.765920 /end CHARACTERISTIC
/begin CHARACTERISTIC fgwABS_NE "FGG Normexponent zur V-Berechnung" VALUE 0xF3790 MSA15_FW4 0 FGG_NE 5.000000 5.000000 EXTENDED_LIMITS 0.000000 7.000000 /end CHARACTERISTIC
/begin CHARACTERISTIC fgwABS_SDA "#SSD FGG Sperrdauer nach PEC-Ueberlauf" VALUE 0xF379C MSA15_FW3 0 ZEIT_ST 100000.000000 655350000.000000 EXTENDED_LIMITS 0.000000 655350000.000000 /end CHARACTERISTIC
/begin CHARACTERISTIC fgwABS_SF "FGG Streckenfaktor zur V-Berechnung" VALUE 0xF378E MSA15_FW3 0 FGG_SF 1.800005 53.986870 EXTENDED_LIMITS 0.670563 67.092080 /end CHARACTERISTIC
/begin CHARACTERISTIC fgwABS_TMX "FGG SF fuer max. impulsfreie Periodendauer" VALUE 0xF3794 MSA15_FW3 0 FGG_TMX 1.800000 53.982730 EXTENDED_LIMITS 1.716666 171.493900 /end CHARACTERISTIC
/begin CHARACTERISTIC fgwABS_VGW "FGG V-Vorgabewert bei defektem FGG" VALUE 0xF3792 MSA15_FW4 0 V 0.000000 300.000000 EXTENDED_LIMITS 0.000000 327.670000 /end CHARACTERISTIC
/begin CHARACTERISTIC fgwABS_VMA "FGG hoechste zu erfassende Geschwindigkeit" VALUE 0xF3796 MSA15_FW4 0 V 0.000000 300.000000 EXTENDED_LIMITS 0.000000 327.670000 /end CHARACTERISTIC
/begin CHARACTERISTIC fgwABS_VMI "FGG niedrigste zu erfassende Geschwindigkeit" VALUE 0xF378C MSA15_FW4 0 V 2.000000 300.000000 EXTENDED_LIMITS 0.000000 327.670000 /end CHARACTERISTIC
/begin CHARACTERISTIC fgwABS_VNX "FGG hoechstes V/N - Verhaeltnis" VALUE 0xF379A MSA15_FW4 0 V_N 0.000000 0.100000 EXTENDED_LIMITS -1.280000 1.279961 /end CHARACTERISTIC
/begin CHARACTERISTIC fgwBEF_GF "FGG Gedaechtnisfaktor fuer Beschleunigungsfilter" VALUE 0xF37C2 MSA15_FW4 0 GF 0.000031 0.999969 /end CHARACTERISTIC
/begin CHARACTERISTIC fgwEGS_G0 "FGG Vorgabewert v/N, GangP und GangN" VALUE 0xF37B0 MSA15_FW3 0 V_N 0.000000 0.100000 EXTENDED_LIMITS -1.280000 1.279961 /end CHARACTERISTIC
/begin CHARACTERISTIC fgwEGS_G1 "FGG Vorgabewert v/N, Gang1 und GangR" VALUE 0xF37B2 MSA15_FW3 0 V_N 0.000000 0.100000 EXTENDED_LIMITS -1.280000 1.279961 /end CHARACTERISTIC
/begin CHARACTERISTIC fgwEGS_G2 "FGG Vorgabewert v/N, Gang2" VALUE 0xF37B4 MSA15_FW3 0 V_N 0.000000 0.100000 EXTENDED_LIMITS -1.280000 1.279961 /end CHARACTERISTIC
/begin CHARACTERISTIC fgwEGS_G3 "FGG Vorgabewert v/N, Gang3" VALUE 0xF37B6 MSA15_FW3 0 V_N 0.000000 0.100000 EXTENDED_LIMITS -1.280000 1.279961 /end CHARACTERISTIC
/begin CHARACTERISTIC fgwEGS_G4 "FGG Vorgabewert v/N, Gang4" VALUE 0xF37B8 MSA15_FW3 0 V_N 0.000000 0.100000 EXTENDED_LIMITS -1.280000 1.279961 /end CHARACTERISTIC
/begin CHARACTERISTIC fgwEGS_G5 "FGG Vorgabewert v/N, Gang5" VALUE 0xF37BA MSA15_FW3 0 V_N 0.000000 0.100000 EXTENDED_LIMITS -1.280000 1.279961 /end CHARACTERISTIC
/begin CHARACTERISTIC fgwEGS_G6 "FGG Vorgabewert v/N      ! ***BC121 hem2wi" VALUE 0xF37BC MSA15_FW3 0 V_N 0.000000 0.100000 EXTENDED_LIMITS -1.280000 1.279961 /end CHARACTERISTIC
/begin CHARACTERISTIC fgwEGS_G7 "FGG Vorgabewert v/N      ! ***BC121 hem2wi" VALUE 0xF37BE MSA15_FW3 0 V_N 0.000000 0.100000 EXTENDED_LIMITS -1.280000 1.279961 /end CHARACTERISTIC
/begin CHARACTERISTIC fgwFGF_GF "FGG Gedaechtnisfaktor fuer Geschwindigkeitsfilter" VALUE 0xF37C0 MSA15_FW4 0 GF 0.000031 0.999969 /end CHARACTERISTIC
/begin CHARACTERISTIC fgwVNF_GF "FGG Gedaechnisfaktor fuer V/N-Filter" VALUE 0xF37C6 MSA15_FW4 0 GF 0.000031 0.999969 /end CHARACTERISTIC
/begin CHARACTERISTIC gswGS_MEZG "GZS obere M_E-Schwelle fuer Zwischengluehen" VALUE 0xF48B2 MSA15_FW4 0 M_E 0.000000 100.000000 EXTENDED_LIMITS -327.680000 327.670000 /end CHARACTERISTIC
/begin CHARACTERISTIC gswGS_M_NG "GZS obere M_E-Schwelle z. Unterbrechung Nachgluehen" VALUE 0xF48AA MSA15_FW4 0 M_E 0.000000 100.000000 EXTENDED_LIMITS -327.680000 327.670000 /end CHARACTERISTIC
/begin CHARACTERISTIC gswGS_NGKL "Nachgluehzeit  t_NG = f(T_W)" CURVE 0xF48C0 MSA15_KL117 0 ZEIT_KLKF 0.000000 327670000.000000
 /begin AXIS_DESCR STD_AXIS anmWTF T 5 -50.040010 149.960000 EXTENDED_LIMITS -273.140000 3003.560000 /end AXIS_DESCR
 EXTENDED_LIMITS -327680000.000000 327670000.000000 /end CHARACTERISTIC
/begin CHARACTERISTIC gswGS_N_G "GZS obere N-Schwelle fuer Ende Vorgluehen" VALUE 0xF48A4 MSA15_FW4 0 N 0.000000 6000.000000 EXTENDED_LIMITS 0.000000 32767.000000 /end CHARACTERISTIC
/begin CHARACTERISTIC gswGS_N_NG "GZS obere N-Schwelle zur Unterbrechung Nachgluehen" VALUE 0xF48AC MSA15_FW4 0 N 0.000000 6000.000000 EXTENDED_LIMITS 0.000000 32767.000000 /end CHARACTERISTIC
/begin CHARACTERISTIC gswGS_N_ZG "GZS obere N-Schwelle fuer Zwischengluehen" VALUE 0xF48B4 MSA15_FW4 0 N 0.000000 6000.000000 EXTENDED_LIMITS 0.000000 32767.000000 /end CHARACTERISTIC
/begin CHARACTERISTIC gswGS_TWNG "GZS obere T_W-Schwelle fuer Nachgluehen" VALUE 0xF48B0 MSA15_FW4 0 T -50.040010 149.960000 EXTENDED_LIMITS -273.140000 3003.560000 /end CHARACTERISTIC
/begin CHARACTERISTIC gswGS_TWSG "GZS obere T_W-Schwelle zum Abschalten Startgluehen" VALUE 0xF48B8 MSA15_FW4 0 T -50.040010 149.960000 EXTENDED_LIMITS -273.140000 3003.560000 /end CHARACTERISTIC
/begin CHARACTERISTIC gswGS_TWZG "GZS obere T_W-Schwelle fuer Zwischengluehen" VALUE 0xF48AE MSA15_FW4 0 T -50.040010 149.960000 EXTENDED_LIMITS -273.140000 3003.560000 /end CHARACTERISTIC
/begin CHARACTERISTIC gswGS_T_1G "GZS Verzoegerungszeit fuer Relais-Ansteuerung" VALUE 0xF48BA MSA15_FW3 0 ZEIT_ST 0.000000 655350000.000000 /end CHARACTERISTIC
/begin CHARACTERISTIC gswGS_T_G "GZS Entprellzeit zur N-Schwelle N_G (Ende Vorgluehen)" VALUE 0xF48BC MSA15_FW3 0 ZEIT_ST 0.000000 655350000.000000 /end CHARACTERISTIC
/begin CHARACTERISTIC gswGS_U_DG "GZS Ubat Schwelle - Gluehrelaisdiagnose = f(Ubat)" VALUE 0xF48BE MSA15_FW3 0 U_B 0.000000 24163.000000 EXTENDED_LIMITS 0.000000 773948.100000 /end CHARACTERISTIC
/begin CHARACTERISTIC gswGS_VGKF "Vorgluehzeit  t_VG = f(U_BATT, T_W)" MAP 0xF48D8 MSA15_KF381 0 ZEIT_KLKF 0.000000 327670000.000000
 /begin AXIS_DESCR STD_AXIS anmUBT U_B 2 0.000000 24163.000000 EXTENDED_LIMITS 0.000000 773948.100000 /end AXIS_DESCR
 /begin AXIS_DESCR STD_AXIS anmWTF T 5 -50.040010 149.960000 EXTENDED_LIMITS -273.140000 3003.560000 /end AXIS_DESCR
 EXTENDED_LIMITS -327680000.000000 327670000.000000 /end CHARACTERISTIC
/begin RECORD_LAYOUT MSA15_KF381 SRC_ADDR_X 1 UWORD NO_AXIS_PTS_X 2 UWORD AXIS_PTS_X 3 SWORD INDEX_INCR DIRECT SRC_ADDR_Y 4 UWORD NO_AXIS_PTS_Y 5 UWORD AXIS_PTS_Y 6 SWORD INDEX_INCR DIRECT FNC_VALUES 7 UWORD COLUMN_DIR DIRECT /end RECORD_LAYOUT
/begin CHARACTERISTIC gswGS_VGWT "spez. T_W-Vorgabewert fuer GZS bei defektem WTF" VALUE 0xF48B6 MSA15_FW4 0 T -50.040010 149.960000 EXTENDED_LIMITS -273.140000 3003.560000 /end CHARACTERISTIC
/begin CHARACTERISTIC gswGS_t_BG "GZS Dauer des Startbereitschafts-Gluehens" VALUE 0xF48A6 MSA15_FW3 0 ZEIT_ST 0.000000 655350000.000000 /end CHARACTERISTIC
/begin CHARACTERISTIC gswGS_t_SG "GZS Dauer des Startgluehens" VALUE 0xF48A8 MSA15_FW3 0 ZEIT_ST 0.000000 655350000.000000 /end CHARACTERISTIC
/begin CHARACTERISTIC gswPW_A_ZG "GZS obere Druck-Schwelle fuer Zwischengluehen" VALUE 0xF4890 MSA15_FW4 0 P 0.000000 3500.000000 EXTENDED_LIMITS -32768.000000 32767.000000 /end CHARACTERISTIC
/begin CHARACTERISTIC gswPW_B_ST "GZS Batteriespannung Step an GZS" VALUE 0xF48A2 MSA15_FW4 0 U_B 0.000000 24163.000000 EXTENDED_LIMITS 0.000000 773948.100000 /end CHARACTERISTIC
/begin CHARACTERISTIC gswPW_B_UG "GZS Batteriespannung Untergrenze an GZS" VALUE 0xF48A0 MSA15_FW4 0 U_B 0.000000 24163.000000 EXTENDED_LIMITS 0.000000 773948.100000 /end CHARACTERISTIC
/begin CHARACTERISTIC gswPW_K_DA "GZS Dauer der Gluehanzeige b. Gluehkerzenfehler" VALUE 0xF4894 MSA15_FW3 0 ZEIT_ST 0.000000 655350000.000000 /end CHARACTERISTIC
/begin CHARACTERISTIC gswPW_L_DA "GZS Dauer des Gluehlampentest" VALUE 0xF4892 MSA15_FW3 0 ZEIT_ST 0.000000 655350000.000000 /end CHARACTERISTIC
/begin CHARACTERISTIC gswPW_M_NG "GZS obere M_E-Schwelle z. Unterbrechung Nachgluehen" VALUE 0xF4888 MSA15_FW4 0 MM3 0.000000 100.000000 EXTENDED_LIMITS -327.680000 327.670000 /end CHARACTERISTIC
/begin CHARACTERISTIC gswPW_M_ZG "GZS obere M_E-Schwelle fuer Zwischengluehen" VALUE 0xF488E MSA15_FW4 0 MM3 0.000000 100.000000 EXTENDED_LIMITS -327.680000 327.670000 /end CHARACTERISTIC
/begin CHARACTERISTIC gswPW_NGKL "GZS Nachgluehzeit  t_NG = f(T_W)" CURVE 0xF4864 MSA15_KL117 0 ZEIT_ST 0.000000 655350000.000000
 /begin AXIS_DESCR STD_AXIS anmWTF T 2 -50.040010 149.960000 EXTENDED_LIMITS -273.140000 3003.560000 /end AXIS_DESCR
/end CHARACTERISTIC
/begin CHARACTERISTIC gswPW_TWNG "GZS obere T_W-Schwelle fuer Nachgluehen" VALUE 0xF4884 MSA15_FW4 0 T -50.040010 149.960000 EXTENDED_LIMITS -273.140000 3003.560000 /end CHARACTERISTIC
/begin CHARACTERISTIC gswPW_T_1G "GZS Verzoegerungszeit fuer Relais-Ansteuerung" VALUE 0xF488A MSA15_FW3 0 ZEIT_ST 0.000000 655350000.000000 /end CHARACTERISTIC
/begin CHARACTERISTIC gswPW_T_G "GZS Entprellzeit zur N-Schwelle N_G (Ende Vorgluehen)" VALUE 0xF4880 MSA15_FW3 0 ZEIT_ST 0.000000 655350000.000000 /end CHARACTERISTIC
/begin CHARACTERISTIC gswPW_T_ZG "GZS obere T_W-Schwelle fuer Zwischengluehen" VALUE 0xF488C MSA15_FW4 0 T -50.040010 149.960000 EXTENDED_LIMITS -273.140000 3003.560000 /end CHARACTERISTIC
/begin CHARACTERISTIC gswPW_UGR "GZS obere U_BATT-Schwelle zum Abschalten GZS" VALUE 0xF487C MSA15_FW4 0 U_B 0.000000 24163.000000 EXTENDED_LIMITS 0.000000 773948.100000 /end CHARACTERISTIC
/begin CHARACTERISTIC gswPW_VGKL "GZS Vorgluehzeit  t_VG = f(T_W)" CURVE 0xF4870 MSA15_KL117 0 ZEIT_ST 0.000000 655350000.000000
 /begin AXIS_DESCR STD_AXIS anmWTF T 2 -50.040010 149.960000 EXTENDED_LIMITS -273.140000 3003.560000 /end AXIS_DESCR
/end CHARACTERISTIC
/begin CHARACTERISTIC gswPW_n_G "GZS obere N-Schwelle fuer Ende Vorgluehen" VALUE 0xF487E MSA15_FW4 0 N 0.000000 6000.000000 EXTENDED_LIMITS 0.000000 32767.000000 /end CHARACTERISTIC
/begin CHARACTERISTIC gswPW_n_NG "GZS obere N-Schwelle zur Unterbrechung Nachgluehen" VALUE 0xF4886 MSA15_FW4 0 N 0.000000 6000.000000 EXTENDED_LIMITS 0.000000 32767.000000 /end CHARACTERISTIC
/begin CHARACTERISTIC gswPW_t_BG "GZS Dauer des Startbereitschafts-Gluehens" VALUE 0xF4882 MSA15_FW3 0 ZEIT_ST 0.000000 655350000.000000 /end CHARACTERISTIC
/begin CHARACTERISTIC gswRA_L_S "GZS Rampe aus - Steigung" VALUE 0xF489E MSA15_FW4 0 PROZDT100 0.000000 1000.000000 EXTENDED_LIMITS 0.000000 3276.700000 /end CHARACTERISTIC
/begin CHARACTERISTIC gswRA_L_Z "GZS Rampe aus - Leistungsziel" VALUE 0xF489C MSA15_FW4 0 PROZ 0.000000 100.000000 EXTENDED_LIMITS -327.680000 327.670000 /end CHARACTERISTIC
/begin CHARACTERISTIC gswRE_L_S "GZS Rampe ein - Steigung" VALUE 0xF489A MSA15_FW4 0 PROZDT100 0.000000 1000.000000 EXTENDED_LIMITS 0.000000 3276.700000 /end CHARACTERISTIC
/begin CHARACTERISTIC gswRE_L_Z "GZS Rampe ein - Leistungsziel" VALUE 0xF4898 MSA15_FW4 0 PROZ 0.000000 100.000000 EXTENDED_LIMITS -327.680000 327.670000 /end CHARACTERISTIC
/begin CHARACTERISTIC gswUB_S1 "GZS untere U_BATT-Hyst.-Schwelle" VALUE 0xF4902 MSA15_FW4 0 U_B 0.000000 24163.000000 EXTENDED_LIMITS 0.000000 773948.100000 /end CHARACTERISTIC
/begin CHARACTERISTIC gswUB_S2 "GZS obere U_BATT-Hyst.-Schwelle" VALUE 0xF4904 MSA15_FW4 0 U_B 0.000000 24163.000000 EXTENDED_LIMITS 0.000000 773948.100000 /end CHARACTERISTIC
/begin CHARACTERISTIC gswUB_W1 "GZS Hysteresewert Wert 1" VALUE 0xF4906 MSA15_FW4 0 DEZ_DW 0.000000 1.000000 EXTENDED_LIMITS -32768.000000 32767.000000 /end CHARACTERISTIC
/begin CHARACTERISTIC gswUB_W2 "GZS Hysteresewert Wert 2" VALUE 0xF4908 MSA15_FW4 0 DEZ_DW 0.000000 1.000000 EXTENDED_LIMITS -32768.000000 32767.000000 /end CHARACTERISTIC
/begin CHARACTERISTIC gswVGK_ab "GZS VGK n-Schwelle fuer Betriebstest" VALUE 0xF4860 MSA15_FW3 0 N 0.000000 6000.000000 EXTENDED_LIMITS 0.000000 32767.000000 /end CHARACTERISTIC
/begin CHARACTERISTIC gswVGK_ein "GZS VGK n-Schwelle fuer Init-Test" VALUE 0xF485C MSA15_FW3 0 N 0.000000 6000.000000 EXTENDED_LIMITS 0.000000 32767.000000 /end CHARACTERISTIC
/begin CHARACTERISTIC gswVGK_ini "GZS Delay fuer Init-Test (ohne SG-Init.)" VALUE 0xF485E MSA15_FW3 0 ZEIT_ST 0.000000 655350000.000000 /end CHARACTERISTIC
/begin CHARACTERISTIC gswVGK_tim "GZS VGK max. Vorgluehzeit" VALUE 0xF4862 MSA15_FW3 0 ZEIT_ST 0.000000 655350000.000000 /end CHARACTERISTIC
/begin CHARACTERISTIC gswVG_L_Z "GZS Leistung f. Vorgluehen" VALUE 0xF4896 MSA15_FW4 0 PROZ 0.000000 100.000000 EXTENDED_LIMITS -327.680000 327.670000 /end CHARACTERISTIC
/begin CHARACTERISTIC khwGLsolKL "Drehzahlabhaengige Soll-Generatorlast" CURVE 0xFB1BA MSA15_KL118 0 PROZ 0.000000 100.000000
 /begin AXIS_DESCR STD_AXIS dzmNmit N 2 0.000000 6000.000000 EXTENDED_LIMITS 0.000000 32767.000000 /end AXIS_DESCR
 EXTENDED_LIMITS -327.680000 327.670000 /end CHARACTERISTIC
/begin CHARACTERISTIC khwGR_MAX "Genlast obere Begrenzung PI-Reglerausgang" VALUE 0xFB1F2 MSA15_FW4 0 PROZ 0.000000 100.000000 EXTENDED_LIMITS -327.680000 327.670000 /end CHARACTERISTIC
/begin CHARACTERISTIC khwGR_MIN "Genlast untere Begrenzung PI-Reglerausgang" VALUE 0xFB1F4 MSA15_FW4 0 PROZ 0.000000 100.000000 EXTENDED_LIMITS -327.680000 327.670000 /end CHARACTERISTIC
/begin CHARACTERISTIC khwHYSN_S1 "Hysterese Ausschaltschwelle KWH - Drehzahl" VALUE 0xFB1CA MSA15_FW4 0 N 0.000000 6000.000000 EXTENDED_LIMITS 0.000000 32767.000000 /end CHARACTERISTIC
/begin CHARACTERISTIC khwHYSN_S2 "Hysterese Einschaltschwelle KWH - Drehzahl" VALUE 0xFB1CC MSA15_FW4 0 N 0.000000 6000.000000 EXTENDED_LIMITS 0.000000 32767.000000 /end CHARACTERISTIC
/begin CHARACTERISTIC khwHYSU_S1 "Hysterese Ausschaltschwelle KWH - UBatt" VALUE 0xFB1C6 MSA15_FW4 0 U_B 0.000000 24163.000000 EXTENDED_LIMITS 0.000000 773948.100000 /end CHARACTERISTIC
/begin CHARACTERISTIC khwHYSU_S2 "Hysterese Einschaltschwelle KWH - UBatt" VALUE 0xFB1C8 MSA15_FW4 0 U_B 0.000000 24163.000000 EXTENDED_LIMITS 0.000000 773948.100000 /end CHARACTERISTIC
/begin CHARACTERISTIC khwHZLSig "Schalter fuer Heizleistungsanforderung" VALUE 0xFB1DC MSA15_FW3 0 DEZ_DB_U 0.000000 2.000000 EXTENDED_LIMITS 0.000000 255.000000 /end CHARACTERISTIC
/begin CHARACTERISTIC khwIR_FEN "Genlast Fenster Kleinsignal I-Regler" VALUE 0xFB1E8 MSA15_FW4 0 PROZ 0.000000 100.000000 EXTENDED_LIMITS -327.680000 327.670000 /end CHARACTERISTIC
/begin CHARACTERISTIC khwIR_NEG "Genlast I-Verstaerkung negatives Grossignal" VALUE 0xFB1EC MSA15_FW4 0 KWH_KI 0.000000 155.000000 EXTENDED_LIMITS 0.000000 159.995100 /end CHARACTERISTIC
/begin CHARACTERISTIC khwIR_NEX "Genlast Normierungsexponent I-Regler" VALUE 0xFB1F0 MSA15_FW4 0 NEX 5.000000 5.000000 EXTENDED_LIMITS -15.000000 15.000000 /end CHARACTERISTIC
/begin CHARACTERISTIC khwIR_POS "Genlast I-Verstaerkung positives Grossignal" VALUE 0xFB1EE MSA15_FW4 0 KWH_KI 0.000000 155.000000 EXTENDED_LIMITS 0.000000 159.995100 /end CHARACTERISTIC
/begin CHARACTERISTIC khwIR_SIG "Genlast I-Verstaerkung Kleinsignal" VALUE 0xFB1EA MSA15_FW4 0 KWH_KI 0.000000 155.000000 EXTENDED_LIMITS 0.000000 159.995100 /end CHARACTERISTIC
/begin CHARACTERISTIC khwKHGL "Gedaechnisfaktor Generatorlast TV Ermittlung" VALUE 0xFB1A2 MSA15_FW4 0 GF 0.000031 0.999969 /end CHARACTERISTIC
/begin CHARACTERISTIC khwKHGL2 "Gedaechnisfaktor Soll-Generatorlast" VALUE 0xFB1A4 MSA15_FW4 0 GF 0.000031 0.999969 /end CHARACTERISTIC
/begin CHARACTERISTIC khwKH_TLKL "Lufttemperaturabh. Wassertemperaturschwellwert" CURVE 0xFB1A6 MSA15_KL118 0 T -50.040010 149.960000
 /begin AXIS_DESCR STD_AXIS camT_UMG T 4 -50.040010 199.960000 EXTENDED_LIMITS -273.140000 3003.560000 /end AXIS_DESCR
 EXTENDED_LIMITS -273.140000 3003.560000 /end CHARACTERISTIC
/begin CHARACTERISTIC khwKH_TWHY "Hysterese Kuehlwassertemp. (khwKH_TLKL)" VALUE 0xFB1D0 MSA15_FW4 0 D_T 0.000000 200.000000 EXTENDED_LIMITS -3276.800000 3276.700000 /end CHARACTERISTIC
/begin CHARACTERISTIC khwKH_tVST "KWH Wartezeit nach Startabwurf" VALUE 0xFB1D2 MSA15_FW3 0 ZEIT_ST 0.000000 655350000.000000 /end CHARACTERISTIC
/begin CHARACTERISTIC khwN_LLKWH "Drehzahlanhebung bei aktivierter Kuehlwasserheizung" VALUE 0xFB1D4 MSA15_FW4 0 N 0.000000 6000.000000 EXTENDED_LIMITS 0.000000 32767.000000 /end CHARACTERISTIC
/begin CHARACTERISTIC khwPBMINV "Schalter ob PBM vom Generator invertiert" VALUE 0xFB1CE MSA15_FW4 0 DEZ_DW 0.000000 1.000000 EXTENDED_LIMITS -32768.000000 32767.000000 /end CHARACTERISTIC
/begin CHARACTERISTIC khwPR_FEN "Genlast Fenster Kleinsignal P-Regler" VALUE 0xFB1DE MSA15_FW4 0 PROZ 0.000000 100.000000 EXTENDED_LIMITS -327.680000 327.670000 /end CHARACTERISTIC
/begin CHARACTERISTIC khwPR_NEG "Genlast P-Verstaerkung negatives Grosssignal" VALUE 0xFB1E2 MSA15_FW4 0 KWH_KP 0.000000 127.000000 EXTENDED_LIMITS 0.000000 127.996100 /end CHARACTERISTIC
/begin CHARACTERISTIC khwPR_NEX "Genlast Normierungsexponent P-Regler" VALUE 0xFB1E6 MSA15_FW4 0 NEX 8.000000 8.000000 EXTENDED_LIMITS -15.000000 15.000000 /end CHARACTERISTIC
/begin CHARACTERISTIC khwPR_POS "Genlast P-Verstaerkung positives Grosssignal" VALUE 0xFB1E4 MSA15_FW4 0 KWH_KP 0.000000 127.000000 EXTENDED_LIMITS 0.000000 127.996100 /end CHARACTERISTIC
/begin CHARACTERISTIC khwPR_SIG "Genlast P-Verstaerkung Kleinsignal" VALUE 0xFB1E0 MSA15_FW4 0 KWH_KP 0.000000 127.000000 EXTENDED_LIMITS 0.000000 127.996100 /end CHARACTERISTIC
/begin CHARACTERISTIC khwREGIVGW "VGW I-Anteil Generatorlastregler" VALUE 0xFB1D6 MSA15_FW4 0 PROZ -100.000000 100.000000 EXTENDED_LIMITS -327.680000 327.670000 /end CHARACTERISTIC
/begin CHARACTERISTIC khwTVdiamn "Unteres TV von ehmFKWH zur KWH Endstufen Diagnose" VALUE 0xFB1D8 MSA15_FW4 0 PROZ 0.000000 100.000000 EXTENDED_LIMITS -327.680000 327.670000 /end CHARACTERISTIC
/begin CHARACTERISTIC khwTVdiamx "Oberes TV von ehmFKWH zur KWH Endstufen Diagnose" VALUE 0xFB1DA MSA15_FW4 0 PROZ 0.000000 100.000000 EXTENDED_LIMITS -327.680000 327.670000 /end CHARACTERISTIC
/begin CHARACTERISTIC klwKLM_ASZ "Aussperrzeit" VALUE 0xFA228 MSA15_FW3 0 ZEIT_ST 0.000000 655350000.000000 /end CHARACTERISTIC
/begin CHARACTERISTIC klwKLM_ESS "Einschaltsperrzeit" VALUE 0xFA22A MSA15_FW3 0 ZEIT_ST 0.000000 655350000.000000 /end CHARACTERISTIC
/begin CHARACTERISTIC klwKLM_ESZ "Einsperrzeit" VALUE 0xFA226 MSA15_FW3 0 ZEIT_ST 0.000000 655350000.000000 /end CHARACTERISTIC
/begin CHARACTERISTIC klwKLM_NAF "N_Anfahr - Offset" VALUE 0xFA210 MSA15_FW3 0 N 0.000000 6000.000000 EXTENDED_LIMITS 0.000000 32767.000000 /end CHARACTERISTIC
/begin CHARACTERISTIC klwKLM_NAS "N_Anfahr - Schwelle" VALUE 0xFA20E MSA15_FW3 0 N 0.000000 6000.000000 EXTENDED_LIMITS 0.000000 32767.000000 /end CHARACTERISTIC
/begin CHARACTERISTIC klwKLM_NBO "N_Beschleunigung - Offset" VALUE 0xFA21C MSA15_FW3 0 N 0.000000 6000.000000 EXTENDED_LIMITS 0.000000 32767.000000 /end CHARACTERISTIC
/begin CHARACTERISTIC klwKLM_NBS "N_Beschleunigung - Schwelle" VALUE 0xFA21A MSA15_FW3 0 N 0.000000 6000.000000 EXTENDED_LIMITS 0.000000 32767.000000 /end CHARACTERISTIC
/begin CHARACTERISTIC klwKLM_NLL "Sollwert LL Drehzahl Klima" VALUE 0xFA22C MSA15_FW3 0 N 0.000000 6000.000000 EXTENDED_LIMITS 0.000000 32767.000000 /end CHARACTERISTIC
/begin CHARACTERISTIC klwKLM_NSO "N_Sturz - Offset" VALUE 0xFA224 MSA15_FW3 0 N 0.000000 6000.000000 EXTENDED_LIMITS 0.000000 32767.000000 /end CHARACTERISTIC
/begin CHARACTERISTIC klwKLM_NSS "N_Sturz - Schwelle" VALUE 0xFA222 MSA15_FW3 0 N 0.000000 6000.000000 EXTENDED_LIMITS 0.000000 32767.000000 /end CHARACTERISTIC
/begin CHARACTERISTIC klwKLM_OTO "KLM Oeltemperatur - Offset" VALUE 0xFA230 MSA15_FW4 0 D_T 0.000000 250.000000 EXTENDED_LIMITS -3276.800000 3276.700000 /end CHARACTERISTIC
/begin CHARACTERISTIC klwKLM_OTS "KLM Oeltemperatur - Schwelle" VALUE 0xFA22E MSA15_FW3 0 T -50.040010 199.960000 EXTENDED_LIMITS -273.140000 3003.560000 /end CHARACTERISTIC
/begin CHARACTERISTIC klwKLM_PDO "PWG/dt - Offset" VALUE 0xFA214 MSA15_FW3 0 PROZDT100 0.000000 1000.000000 EXTENDED_LIMITS 0.000000 3276.700000 /end CHARACTERISTIC
/begin CHARACTERISTIC klwKLM_PDT "PWG/dt - Schwelle" VALUE 0xFA212 MSA15_FW3 0 PROZDT100 0.000000 1000.000000 EXTENDED_LIMITS 0.000000 3276.700000 /end CHARACTERISTIC
/begin CHARACTERISTIC klwKLM_POG "PWG - Offset" VALUE 0xFA204 MSA15_FW3 0 PROZ_S 0.000000 100.000000 EXTENDED_LIMITS -327.680000 327.670000 /end CHARACTERISTIC
/begin CHARACTERISTIC klwKLM_PWG "PWG - Schwelle" VALUE 0xFA202 MSA15_FW3 0 PROZ_S 0.000000 100.000000 EXTENDED_LIMITS -327.680000 327.670000 /end CHARACTERISTIC
/begin CHARACTERISTIC klwKLM_STT "Startaussperrzeit" VALUE 0xFA232 MSA15_FW3 0 ZEIT_ST 0.000000 655350000.000000 /end CHARACTERISTIC
/begin CHARACTERISTIC klwKLM_VAF "V_Anfahr - Offset" VALUE 0xFA20C MSA15_FW3 0 V 0.000000 300.000000 EXTENDED_LIMITS 0.000000 327.670000 /end CHARACTERISTIC
/begin CHARACTERISTIC klwKLM_VAS "V_Anfahr - Schwelle" VALUE 0xFA20A MSA15_FW3 0 V 0.000000 300.000000 EXTENDED_LIMITS 0.000000 327.670000 /end CHARACTERISTIC
/begin CHARACTERISTIC klwKLM_VBO "V_Beschleunigung - Offset" VALUE 0xFA218 MSA15_FW3 0 V 0.000000 300.000000 EXTENDED_LIMITS 0.000000 327.670000 /end CHARACTERISTIC
/begin CHARACTERISTIC klwKLM_VBS "V_Beschleunigung - Schwelle" VALUE 0xFA216 MSA15_FW3 0 V 0.000000 300.000000 EXTENDED_LIMITS 0.000000 327.670000 /end CHARACTERISTIC
/begin CHARACTERISTIC klwKLM_VNO "VzuN - Offset" VALUE 0xFA208 MSA15_FW3 0 V_N 0.000000 0.100000 EXTENDED_LIMITS -1.280000 1.279961 /end CHARACTERISTIC
/begin CHARACTERISTIC klwKLM_VZN "VzuN - Schwelle" VALUE 0xFA206 MSA15_FW3 0 V_N 0.000000 0.100000 EXTENDED_LIMITS -1.280000 1.279961 /end CHARACTERISTIC
/begin CHARACTERISTIC klwKLM_WTO "Wassertemperatur - Offset" VALUE 0xFA220 MSA15_FW4 0 D_T 0.000000 200.000000 EXTENDED_LIMITS -3276.800000 3276.700000 /end CHARACTERISTIC
/begin CHARACTERISTIC klwKLM_WTS "Wassertemperatur - Schwelle" VALUE 0xFA21E MSA15_FW3 0 T -273.140000 149.960000 EXTENDED_LIMITS -273.140000 3003.560000 /end CHARACTERISTIC
/begin CHARACTERISTIC klwT_O_VGW "KLM - Bei defektem OTF ( 1: gesperrt /  0: freigegeben )" VALUE 0xFA235 MSA15_FW1 0 DEZ_DB_U 0.000000 1.000000 EXTENDED_LIMITS 0.000000 255.000000 /end CHARACTERISTIC
/begin CHARACTERISTIC klwT_W_VGW "KLM - Bei defektem WTF ( 1: gesperrt /  0: freigegeben )" VALUE 0xFA234 MSA15_FW1 0 DEZ_DB_U 0.000000 1.000000 EXTENDED_LIMITS 0.000000 255.000000 /end CHARACTERISTIC
/begin CHARACTERISTIC kuwDZG_SCH "Schwellenwert fuer Activierung THS function" VALUE 0xF981C MSA15_FW4 0 N 0.000000 6000.000000 EXTENDED_LIMITS 0.000000 32767.000000 /end CHARACTERISTIC
/begin CHARACTERISTIC kuwTHSKS1 "Schwellenwert S1 der KT-Hysterese" VALUE 0xF9832 MSA15_FW4 0 T -50.040010 149.960000 EXTENDED_LIMITS -273.140000 3003.560000 /end CHARACTERISTIC
/begin CHARACTERISTIC kuwTHSKS2 "Schwellenwert S2 der KT-Hysterese" VALUE 0xF9834 MSA15_FW4 0 T -50.040010 149.960000 EXTENDED_LIMITS -273.140000 3003.560000 /end CHARACTERISTIC
/begin CHARACTERISTIC kuwTHSMS1 "Schwellenwert S1 der Einspritzmenge-Hysterese" VALUE 0xF982A MSA15_FW4 0 M_E 0.000000 100.000000 EXTENDED_LIMITS -327.680000 327.670000 /end CHARACTERISTIC
/begin CHARACTERISTIC kuwTHSMS2 "Schwellenwert S2 der Einspritzmenge-Hysterese" VALUE 0xF982C MSA15_FW4 0 M_E 0.000000 100.000000 EXTENDED_LIMITS -327.680000 327.670000 /end CHARACTERISTIC
/begin CHARACTERISTIC kuwTHSNS1 "Schwellenwert S1 der DZ-Hysterese" VALUE 0xF981E MSA15_FW4 0 N 0.000000 6000.000000 EXTENDED_LIMITS 0.000000 32767.000000 /end CHARACTERISTIC
/begin CHARACTERISTIC kuwTHSNS2 "Schwellenwert S2 der DZ-Hysterese" VALUE 0xF9820 MSA15_FW4 0 N 0.000000 6000.000000 EXTENDED_LIMITS 0.000000 32767.000000 /end CHARACTERISTIC
/begin CHARACTERISTIC kuwTHSOT1 "Schwellenwert S1 der OTF-Hysterese" VALUE 0xF9836 MSA15_FW4 0 T -50.040010 199.960000 EXTENDED_LIMITS -273.140000 3003.560000 /end CHARACTERISTIC
/begin CHARACTERISTIC kuwTHSOT2 "Schwellenwert S2 der OTF-Hysterese" VALUE 0xF9838 MSA15_FW4 0 T -50.040010 199.960000 EXTENDED_LIMITS -273.140000 3003.560000 /end CHARACTERISTIC
/begin CHARACTERISTIC kuwTHSTS1 "Schwellenwert S1 der WT-Hysterese" VALUE 0xF9822 MSA15_FW4 0 T -50.040010 149.960000 EXTENDED_LIMITS -273.140000 3003.560000 /end CHARACTERISTIC
/begin CHARACTERISTIC kuwTHSTS2 "Schwellenwert S2 der WT-Hysterese" VALUE 0xF9824 MSA15_FW4 0 T -50.040010 149.960000 EXTENDED_LIMITS -273.140000 3003.560000 /end CHARACTERISTIC
/begin CHARACTERISTIC kuwTHSTS3 "Schwellenwert S3 der WT-Hysterese" VALUE 0xF9826 MSA15_FW4 0 T -50.040010 149.960000 EXTENDED_LIMITS -273.140000 3003.560000 /end CHARACTERISTIC
/begin CHARACTERISTIC kuwTHSTS4 "Schwellenwert S4 der WT-Hysterese" VALUE 0xF9828 MSA15_FW4 0 T -50.040010 149.960000 EXTENDED_LIMITS -273.140000 3003.560000 /end CHARACTERISTIC
/begin CHARACTERISTIC kuwTHSVS1 "Schwellenwert S1 der FG-Hysterese" VALUE 0xF982E MSA15_FW4 0 V 0.000000 300.000000 EXTENDED_LIMITS 0.000000 327.670000 /end CHARACTERISTIC
/begin CHARACTERISTIC kuwTHSVS2 "Schwellenwert S2 der FG-Hysterese" VALUE 0xF9830 MSA15_FW4 0 V 0.000000 300.000000 EXTENDED_LIMITS 0.000000 327.670000 /end CHARACTERISTIC
/begin CHARACTERISTIC kuwTHTWE1 "Schwellenwert S1 der oder-Veknuepfung der WTF-Hysterese" VALUE 0xF983A MSA15_FW4 0 T -50.040010 149.960000 EXTENDED_LIMITS -273.140000 3003.560000 /end CHARACTERISTIC
/begin CHARACTERISTIC kuwTHTWE2 "Schwellenwert S2 der oder-Verknuefung der WTF-Hysterese" VALUE 0xF983C MSA15_FW4 0 T -50.040010 149.960000 EXTENDED_LIMITS -273.140000 3003.560000 /end CHARACTERISTIC
/begin CHARACTERISTIC ldwDR_FEN "LDR-D Fensterbreite Kleinsignal bei neg.Vorsteuerung" VALUE 0xF40BC MSA15_FW4 0 dP_dZ 0.000000 10000.000000 EXTENDED_LIMITS -1638400.000000 1638350.000000 /end CHARACTERISTIC
/begin CHARACTERISTIC ldwDR_FEP "LDR-D Fensterbreite Kleinsignal bei pos. Vorst." VALUE 0xF40B4 MSA15_FW4 0 dP_dZ 0.000000 10000.000000 EXTENDED_LIMITS -1638400.000000 1638350.000000 /end CHARACTERISTIC
/begin CHARACTERISTIC ldwDR_NEG "LDR-D Verstaerkung neg. Grossignal" VALUE 0xF40C0 MSA15_FW4 0 LDR_KD 0.000000 5.415000 EXTENDED_LIMITS 0.000000 20.479370 /end CHARACTERISTIC
/begin CHARACTERISTIC ldwDR_POS "LDR-D Verstaerkung pos. Grossignal" VALUE 0xF40B8 MSA15_FW4 0 LDR_KD 0.000000 5.415000 EXTENDED_LIMITS 0.000000 20.479370 /end CHARACTERISTIC
/begin CHARACTERISTIC ldwDR_SIN "LDR-D Verstaerkung neg. Kleinsignal" VALUE 0xF40BE MSA15_FW4 0 LDR_KD 0.000000 5.415000 EXTENDED_LIMITS 0.000000 20.479370 /end CHARACTERISTIC
/begin CHARACTERISTIC ldwDR_SIP "LDR-D Verstaerkung pos. Kleinsignal" VALUE 0xF40B6 MSA15_FW4 0 LDR_KD 0.000000 5.415000 EXTENDED_LIMITS 0.000000 20.479370 /end CHARACTERISTIC
/begin CHARACTERISTIC ldwDR_gfKF "LDR Adaption des DT1-Gedaechtnisfaktors f(n)" MAP 0xF4250 MSA15_KF382 0 GF 0.000031 0.999969
 /begin AXIS_DESCR STD_AXIS dzmNmit N 4 0.000000 6000.000000 EXTENDED_LIMITS 0.000000 32767.000000 /end AXIS_DESCR
 /begin AXIS_DESCR STD_AXIS ldoE P 4 0.000000 3500.000000 EXTENDED_LIMITS -32768.000000 32767.000000 /end AXIS_DESCR
/end CHARACTERISTIC
/begin CHARACTERISTIC ldwDRdNGFn "Gedaechtnisfaktor PT1-LDR neg Gradient" VALUE 0xF4856 MSA15_FW4 0 GF 0.000031 0.999969 /end CHARACTERISTIC
/begin CHARACTERISTIC ldwDRdNGFp "Gedaechtnisfaktor PT1-LDR pos Gradient   ! ***BC211 BEW2WI" VALUE 0xF4854 MSA15_FW4 0 GF 0.000031 0.999969 /end CHARACTERISTIC
/begin CHARACTERISTIC ldwDRdNkKL "LDR Adaption der D-Verstaerkung" CURVE 0xF4838 MSA15_KL118 0 FAKT 0.000000 3.200000
 /begin AXIS_DESCR STD_AXIS mrmdNdt20 dN_dZ_U 6 -32750.000000 32750.000000 EXTENDED_LIMITS -1638400.000000 1638350.000000 /end AXIS_DESCR
 EXTENDED_LIMITS -3.276800 3.276700 /end CHARACTERISTIC
/begin CHARACTERISTIC ldwDRf_1KF "LDR Adaption der D-Verstaerkung f(n)" MAP 0xF40C4 MSA15_KF382 0 FAKT 0.000000 3.200000
 /begin AXIS_DESCR STD_AXIS dzmNmit N 8 0.000000 6000.000000 EXTENDED_LIMITS 0.000000 32767.000000 /end AXIS_DESCR
 /begin AXIS_DESCR STD_AXIS ldoE P 6 -3500.000000 3500.000000 EXTENDED_LIMITS -32768.000000 32767.000000 /end AXIS_DESCR
 EXTENDED_LIMITS -3.276800 3.276700 /end CHARACTERISTIC
/begin CHARACTERISTIC ldwDRf_2KF "LDR Adaption der D-Verstaerkung f(n)" MAP 0xF4148 MSA15_KF382 0 FAKT 0.000000 3.200000
 /begin AXIS_DESCR STD_AXIS dzmNmit N 8 0.000000 6000.000000 EXTENDED_LIMITS 0.000000 32767.000000 /end AXIS_DESCR
 /begin AXIS_DESCR STD_AXIS ldoE P 6 -3500.000000 3500.000000 EXTENDED_LIMITS -32768.000000 32767.000000 /end AXIS_DESCR
 EXTENDED_LIMITS -3.276800 3.276700 /end CHARACTERISTIC
/begin CHARACTERISTIC ldwDRf_3KF "LDR Adaption der D-Verstaerkung f(n)" MAP 0xF41CC MSA15_KF382 0 FAKT 0.000000 3.200000
 /begin AXIS_DESCR STD_AXIS dzmNmit N 8 0.000000 6000.000000 EXTENDED_LIMITS 0.000000 32767.000000 /end AXIS_DESCR
 /begin AXIS_DESCR STD_AXIS ldoE P 6 -3500.000000 3500.000000 EXTENDED_LIMITS -32768.000000 32767.000000 /end AXIS_DESCR
 EXTENDED_LIMITS -3.276800 3.276700 /end CHARACTERISTIC
/begin CHARACTERISTIC ldwFWN "LDR Schwelle fuer Drehzahl sportlich" VALUE 0xF3EAC MSA15_FW4 0 N 0.000000 32767.000000 /end CHARACTERISTIC
/begin CHARACTERISTIC ldwFWPT1n "LDR PT1-Gedaechtnisfaktor fuer Signalabfall" VALUE 0xF3EB4 MSA15_FW4 0 GF 0.000031 0.999969 /end CHARACTERISTIC
/begin CHARACTERISTIC ldwFWPT1p "LDR PT1-Gedaechtnisfaktor fuer Signalanstieg" VALUE 0xF3EB2 MSA15_FW4 0 GF 0.000031 0.999969 /end CHARACTERISTIC
/begin CHARACTERISTIC ldwFWPWG "LDR Schwelle fuer Fahrpedal sportlich" VALUE 0xF3EA8 MSA15_FW4 0 PROZ_S 0.000000 327.670000 EXTENDED_LIMITS -327.680000 327.670000 /end CHARACTERISTIC
/begin CHARACTERISTIC ldwFWdPWG "LDR Schwelle fuer Fahrpedalaenderung sportlich" VALUE 0xF3EAA MSA15_FW4 0 PROZDT 0.000000 10000.000000 EXTENDED_LIMITS 0.000000 16383.500000 /end CHARACTERISTIC
/begin CHARACTERISTIC ldwFWoek "LDR Hystereseschwelle zum Schalten auf oeko" VALUE 0xF3EAE MSA15_FW4 0 FAKT 0.000000 3.200000 EXTENDED_LIMITS -3.276800 3.276700 /end CHARACTERISTIC
/begin CHARACTERISTIC ldwFWspo "LDR Hystereseschwelle zum Schalten auf sportlich" VALUE 0xF3EB0 MSA15_FW4 0 FAKT 0.000000 3.200000 EXTENDED_LIMITS -3.276800 3.276700 /end CHARACTERISTIC
/begin CHARACTERISTIC ldwGNG_MGG "Untere Gangschwelle fuer D-Verstaerkungskennfeldauswahl" VALUE 0xF4858 MSA15_FW2 0 DEZ_DB 1.000000 5.000000 EXTENDED_LIMITS -128.000000 127.000000 /end CHARACTERISTIC
/begin CHARACTERISTIC ldwGNG_OGG "Obere Gangschwelle fuer D-Verstaerkungskennfeldauswahl" VALUE 0xF4859 MSA15_FW2 0 DEZ_DB 2.000000 6.000000 EXTENDED_LIMITS -128.000000 127.000000 /end CHARACTERISTIC
/begin CHARACTERISTIC ldwGRmaxKF "Tastverhaeltnis Begrenzung Max-Wert" MAP 0xF3F52 MSA15_KF382 0 PROZ 0.000000 100.000000
 /begin AXIS_DESCR STD_AXIS dzmNmit N 16 0.000000 6000.000000 EXTENDED_LIMITS 0.000000 32767.000000 /end AXIS_DESCR
 /begin AXIS_DESCR STD_AXIS mrmM_EAKT MM3 4 0.000000 100.000000 EXTENDED_LIMITS -327.680000 327.670000 /end AXIS_DESCR
 EXTENDED_LIMITS -327.680000 327.670000 /end CHARACTERISTIC
/begin CHARACTERISTIC ldwGRminKF "Tastverhaeltnis Begrenzung Min-Wert" MAP 0xF4002 MSA15_KF382 0 PROZ 0.000000 100.000000
 /begin AXIS_DESCR STD_AXIS dzmNmit N 16 0.000000 6000.000000 EXTENDED_LIMITS 0.000000 32767.000000 /end AXIS_DESCR
 /begin AXIS_DESCR STD_AXIS mrmM_EAKT MM3 4 0.000000 100.000000 EXTENDED_LIMITS -327.680000 327.670000 /end AXIS_DESCR
 EXTENDED_LIMITS -327.680000 327.670000 /end CHARACTERISTIC
/begin CHARACTERISTIC ldwIR_FEN "LDR Fenster Kleinsignal I-Anteil Param.-Satz 1" VALUE 0xF3F04 MSA15_FW4 0 P 0.000000 3500.000000 EXTENDED_LIMITS -32768.000000 32767.000000 /end CHARACTERISTIC
/begin CHARACTERISTIC ldwIR_NEG "LDR I-Verstaerkung neg. Grosssignal Param.-Satz 1" VALUE 0xF3F08 MSA15_FW4 0 LDR_KI 0.000000 1.250000 EXTENDED_LIMITS 0.000000 7.999756 /end CHARACTERISTIC
/begin CHARACTERISTIC ldwIR_POS "LDR I-Verstaerkung pos. Grosssignal Param.-Satz 1" VALUE 0xF3F0A MSA15_FW4 0 LDR_KI 0.000000 1.250000 EXTENDED_LIMITS 0.000000 7.999756 /end CHARACTERISTIC
/begin CHARACTERISTIC ldwIR_SIG "LDR I-Verstaerkung Kleinsignal Parameter-Satz 1" VALUE 0xF3F06 MSA15_FW4 0 LDR_KI 0.000000 1.250000 EXTENDED_LIMITS 0.000000 7.999756 /end CHARACTERISTIC
/begin CHARACTERISTIC ldwIRfakKL "LDR Adaption der I-Verstaerkung f(n)" CURVE 0xF3F0E MSA15_KL118 0 FAKT 0.000000 3.200000
 /begin AXIS_DESCR STD_AXIS dzmNmit N 16 0.000000 6000.000000 EXTENDED_LIMITS 0.000000 32767.000000 /end AXIS_DESCR
 EXTENDED_LIMITS -3.276800 3.276700 /end CHARACTERISTIC
/begin CHARACTERISTIC ldwKSTWKL "LDR Abschaltzeit nach Kaltstart = f(T_W)" CURVE 0xF4824 MSA15_KL117 0 ZEIT_HP 0.000000 655340000.000000
 /begin AXIS_DESCR STD_AXIS anmWTF T 2 -50.040010 149.960000 EXTENDED_LIMITS -273.140000 3003.560000 /end AXIS_DESCR
 EXTENDED_LIMITS 0.000000 1310700000.000000 /end CHARACTERISTIC
/begin CHARACTERISTIC ldwLDBNAL "ATM obere N-Schwelle bei Ermittlung P_ATM aus LDF" VALUE 0xF3E62 MSA15_FW4 0 N 0.000000 6000.000000 EXTENDED_LIMITS 0.000000 32767.000000 /end CHARACTERISTIC
/begin CHARACTERISTIC ldwLDBP_D "ATM zulaessige Druck-Aweichung  ADF / LDF" VALUE 0xF3E6E MSA15_FW4 0 P 0.000000 3500.000000 EXTENDED_LIMITS -32768.000000 32767.000000 /end CHARACTERISTIC
/begin CHARACTERISTIC ldwLDBP_N "ATM obere N-Schwelle fuer ADF/LDF-Plausibilitaet" VALUE 0xF3E6C MSA15_FW4 0 N 0.000000 1500.000000 EXTENDED_LIMITS 0.000000 32767.000000 /end CHARACTERISTIC
/begin CHARACTERISTIC ldwLDBTAL "ATM Wartezeit bei Ermittlung P_ATM aus LDF" VALUE 0xF3E64 MSA15_FW3 0 ZEIT_ST 0.000000 655350000.000000 /end CHARACTERISTIC
/begin CHARACTERISTIC ldwLDBTVA "ATM obere ARF-TV-Schwelle fuer P_ATM aus LDF" VALUE 0xF3E6A MSA15_FW4 0 PROZ 0.000000 100.000000 EXTENDED_LIMITS -327.680000 327.670000 /end CHARACTERISTIC
/begin CHARACTERISTIC ldwLDBTVD "ATM obere DKR-TV-Schwelle fuer P_ATM aus LDF" VALUE 0xF3E68 MSA15_FW4 0 PROZ 0.000000 100.000000 EXTENDED_LIMITS -327.680000 327.670000 /end CHARACTERISTIC
/begin CHARACTERISTIC ldwLDBdPKL "ATM Druckdifferenz-Korrektur-KL   dP_ATM = f(N)" CURVE 0xF428A MSA15_KL118 0 P -3500.000000 3500.000000
 /begin AXIS_DESCR STD_AXIS dzmNmit N 2 0.000000 6000.000000 EXTENDED_LIMITS 0.000000 32767.000000 /end AXIS_DESCR
 EXTENDED_LIMITS -32768.000000 32767.000000 /end CHARACTERISTIC
/begin CHARACTERISTIC ldwLDF_GF "LDF Filterzeitkonstante  Druckfuehler" VALUE 0xF4288 MSA15_FW4 0 GF 0.000031 0.999969 /end CHARACTERISTIC
/begin CHARACTERISTIC ldwLTG_GF "LDR Gedaechtnisfaktor fuer errechnete Lufttemperatur" VALUE 0xF3E48 MSA15_FW4 0 GF 0.000031 0.999969 /end CHARACTERISTIC
/begin CHARACTERISTIC ldwLTG_Q "LDR 0: LTF, 1: Errechn. Temp.wert" VALUE 0xF3E46 MSA15_FW3 0 DEZ_DW_U 0.000000 1.000000 EXTENDED_LIMITS 0.000000 65535.000000 /end CHARACTERISTIC
/begin CHARACTERISTIC ldwLTG_RK "LDR Spez.Gaskonstante Luft" VALUE 0xF3E44 MSA15_FW3 0 R 0.000000 2.000000 EXTENDED_LIMITS 0.000000 65.535000 /end CHARACTERISTIC
/begin CHARACTERISTIC ldwLTG_VZL "LDR Zylindervolumen" VALUE 0xF3E42 MSA15_FW3 0 VOL 0.000000 10000.000000 /end CHARACTERISTIC
/begin CHARACTERISTIC ldwLTLG_KF "Liefergrad-Kennfeld = f(N,P_L )" MAP 0xF3E4A MSA15_KF381 0 PROZ 0.000000 200.000000
 /begin AXIS_DESCR STD_AXIS dzmNmit N 2 0.000000 6000.000000 EXTENDED_LIMITS 0.000000 32767.000000 /end AXIS_DESCR
 /begin AXIS_DESCR STD_AXIS ldmP_Llin P 2 0.000000 3500.000000 EXTENDED_LIMITS -32768.000000 32767.000000 /end AXIS_DESCR
 EXTENDED_LIMITS -327.680000 327.670000 /end CHARACTERISTIC
/begin CHARACTERISTIC ldwMXWKF "Max.wertekennlinie = f( P_ATM, n )" MAP 0xF4498 MSA15_KF382 0 P 0.000000 3500.000000
 /begin AXIS_DESCR STD_AXIS ldmADF P 10 0.000000 3500.000000 EXTENDED_LIMITS -32768.000000 32767.000000 /end AXIS_DESCR
 /begin AXIS_DESCR STD_AXIS dzmNmit N 10 0.000000 6000.000000 EXTENDED_LIMITS 0.000000 32767.000000 /end AXIS_DESCR
 EXTENDED_LIMITS -32768.000000 32767.000000 /end CHARACTERISTIC
/begin CHARACTERISTIC ldwNLIVG "GSR Vorgabewert I-Anteil im Nachlauf" VALUE 0xF3EA4 MSA15_FW4 0 PROZ 0.000000 100.000000 EXTENDED_LIMITS -327.680000 327.670000 /end CHARACTERISTIC
/begin CHARACTERISTIC ldwNLVGW "GSR Vorgabewert fuer Stellerjustage im Nachlauf" VALUE 0xF3EA2 MSA15_FW4 0 PROZ 0.000000 100.000000 EXTENDED_LIMITS -327.680000 327.670000 /end CHARACTERISTIC
/begin CHARACTERISTIC ldwN_Abs "LDR obere N-Schwelle fuer Kaltstart" VALUE 0xF3EA0 MSA15_FW4 0 N 0.000000 6000.000000 EXTENDED_LIMITS 0.000000 32767.000000 /end CHARACTERISTIC
/begin CHARACTERISTIC ldwPAUEKF "Korrekturkennfeld = f( P_ATM,M_E ), Ueberdruckber." MAP 0xF442A MSA15_KF358 0 P -3500.000000 3500.000000
 /begin AXIS_DESCR STD_AXIS ldmADF P 5 0.000000 3500.000000 EXTENDED_LIMITS -32768.000000 32767.000000 /end AXIS_DESCR
 /begin AXIS_DESCR STD_AXIS ldmM_E MM3 5 0.000000 100.000000 EXTENDED_LIMITS -327.680000 327.670000 /end AXIS_DESCR
 EXTENDED_LIMITS -32768.000000 32767.000000 /end CHARACTERISTIC
/begin CHARACTERISTIC ldwPR_FEN "LDR Fenster Kleinsignal P-Anteil Param.-Satz 1" VALUE 0xF3EB6 MSA15_FW4 0 P 0.000000 3500.000000 EXTENDED_LIMITS -32768.000000 32767.000000 /end CHARACTERISTIC
/begin CHARACTERISTIC ldwPR_NEG "LDR P-Verstaerkung neg. Grosssignal Param.-Satz 1" VALUE 0xF3EBA MSA15_FW4 0 LDR_KP 0.000000 1.000000 EXTENDED_LIMITS 0.000000 2.559922 /end CHARACTERISTIC
/begin CHARACTERISTIC ldwPR_POS "LDR P-Verstaerkung pos. Grosssignal Param.-Satz 1" VALUE 0xF3EBC MSA15_FW4 0 LDR_KP 0.000000 0.625000 EXTENDED_LIMITS 0.000000 2.559922 /end CHARACTERISTIC
/begin CHARACTERISTIC ldwPR_SIG "LDR P-Verstaerkung Kleinsignal Parameter-Satz 1" VALUE 0xF3EB8 MSA15_FW4 0 LDR_KP 0.000000 0.625000 EXTENDED_LIMITS 0.000000 2.559922 /end CHARACTERISTIC
/begin CHARACTERISTIC ldwPRfakKL "LDR Adaption der P-Verstaerkung f(n)" CURVE 0xF3EC0 MSA15_KL118 0 FAKT 0.000000 3.200000
 /begin AXIS_DESCR STD_AXIS dzmNmit N 16 0.000000 6000.000000 EXTENDED_LIMITS 0.000000 32767.000000 /end AXIS_DESCR
 EXTENDED_LIMITS -3.276800 3.276700 /end CHARACTERISTIC
/begin CHARACTERISTIC ldwREG0KL "LDR Schwelle fuer Regelung ausschalten" CURVE 0xF4590 MSA15_KL118 0 MM3 -0.010000 100.000000
 /begin AXIS_DESCR STD_AXIS dzmNmit N 10 0.000000 6000.000000 EXTENDED_LIMITS 0.000000 32767.000000 /end AXIS_DESCR
 EXTENDED_LIMITS -327.680000 327.670000 /end CHARACTERISTIC
/begin CHARACTERISTIC ldwREG1KL "LDR Schwelle fuer Regelung einschalten" CURVE 0xF45BC MSA15_KL118 0 MM3 -0.010000 100.000000
 /begin AXIS_DESCR STD_AXIS dzmNmit N 10 0.000000 6000.000000 EXTENDED_LIMITS 0.000000 32767.000000 /end AXIS_DESCR
 EXTENDED_LIMITS -327.680000 327.670000 /end CHARACTERISTIC
/begin CHARACTERISTIC ldwREGIVG1 "LDR TV-VGW I-Anteil EPW im Betriebsbereich 1" VALUE 0xF3E8C MSA15_FW4 0 PROZ 0.000000 100.000000 EXTENDED_LIMITS -327.680000 327.670000 /end CHARACTERISTIC
/begin CHARACTERISTIC ldwREGIVG2 "LDR TV-VGW I-Anteil EPW im Betriebsbereich 1" VALUE 0xF3E90 MSA15_FW4 0 PROZ 0.000000 100.000000 EXTENDED_LIMITS -327.680000 327.670000 /end CHARACTERISTIC
/begin CHARACTERISTIC ldwREGME3 "LDR obere M_E-Schwelle fuer Betriebsbereich 3" VALUE 0xF3E98 MSA15_FW4 0 MM3 0.000000 100.000000 EXTENDED_LIMITS -327.680000 327.670000 /end CHARACTERISTIC
/begin CHARACTERISTIC ldwREGME4 "LDR obere M_E-Schwelle fuer Betriebsbereich 4" VALUE 0xF3E9A MSA15_FW4 0 MM3 0.000000 100.000000 EXTENDED_LIMITS -327.680000 327.670000 /end CHARACTERISTIC
/begin CHARACTERISTIC ldwREGMXnR "LDR maximal zul. negative Regelabweichung" VALUE 0xF3E9E MSA15_FW4 0 P -3500.000000 0.000000 EXTENDED_LIMITS -32768.000000 32767.000000 /end CHARACTERISTIC
/begin CHARACTERISTIC ldwREGMXpR "LDR maximal zul. positive Regelabweichung" VALUE 0xF3E9C MSA15_FW4 0 P 0.000000 3500.000000 EXTENDED_LIMITS -32768.000000 32767.000000 /end CHARACTERISTIC
/begin CHARACTERISTIC ldwREGN1 "LDR obere N-Schwelle fuer Betriebsbereich 1" VALUE 0xF3E8A MSA15_FW4 0 N 0.000000 6000.000000 EXTENDED_LIMITS 0.000000 32767.000000 /end CHARACTERISTIC
/begin CHARACTERISTIC ldwREGN2 "LDR obere N-Schwelle fuer Betriebsbereich 2" VALUE 0xF3E94 MSA15_FW4 0 N 0.000000 6000.000000 EXTENDED_LIMITS 0.000000 32767.000000 /end CHARACTERISTIC
/begin CHARACTERISTIC ldwREGN3 "LDR obere N-Schwelle fuer Betriebsbereich 3" VALUE 0xF3E96 MSA15_FW4 0 N 0.000000 6000.000000 EXTENDED_LIMITS 0.000000 32767.000000 /end CHARACTERISTIC
/begin CHARACTERISTIC ldwREGVGW1 "LDR TV-VGW fuer EPW im Betriebsbereich 1" VALUE 0xF3E8E MSA15_FW4 0 PROZ 0.000000 100.000000 EXTENDED_LIMITS -327.680000 327.670000 /end CHARACTERISTIC
/begin CHARACTERISTIC ldwREGVGW2 "LDR TV-VGW fuer EPW im Betriebsbereich 2" VALUE 0xF3E92 MSA15_FW4 0 PROZ 0.000000 100.000000 EXTENDED_LIMITS -327.680000 327.670000 /end CHARACTERISTIC
/begin CHARACTERISTIC ldwRGARWmn "LDR Minimalwert fuer I-Anteil" VALUE 0xF485A MSA15_FW4 0 PROZ -100.000000 100.000000 EXTENDED_LIMITS -327.680000 327.670000 /end CHARACTERISTIC
/begin CHARACTERISTIC ldwSDV_FEN "LDR Fensterbreite Kleinsignal bei neg. Vorst." VALUE 0xF3E82 MSA15_FW4 0 dP_dZ 0.000000 10000.000000 EXTENDED_LIMITS -1638400.000000 1638350.000000 /end CHARACTERISTIC
/begin CHARACTERISTIC ldwSDV_FEP "LDR Fensterbreite Kleinsignal bei pos. Vorst." VALUE 0xF3E7A MSA15_FW4 0 dP_dZ 0.000000 10000.000000 EXTENDED_LIMITS -1638400.000000 1638350.000000 /end CHARACTERISTIC
/begin CHARACTERISTIC ldwSDV_GFN "LDR Gedaechtnisfaktor bei neg. Vorsteuerung" VALUE 0xF3E80 MSA15_FW4 0 GF 0.000031 0.999969 /end CHARACTERISTIC
/begin CHARACTERISTIC ldwSDV_GFP "LDR Gedaechtnisfaktor pos. Vorsteuern" VALUE 0xF3E78 MSA15_FW4 0 GF 0.000031 0.999969 /end CHARACTERISTIC
/begin CHARACTERISTIC ldwSDV_NEG "LDR Verstaerk. Gross-S. neg. Vorsteuern" VALUE 0xF3E86 MSA15_FW4 0 LDRS_KD -346.578100 346.578100 EXTENDED_LIMITS -512.000000 511.984400 /end CHARACTERISTIC
/begin CHARACTERISTIC ldwSDV_POS "LDR Verstaerk. Gross-S. pos. Vorsteuern" VALUE 0xF3E7E MSA15_FW4 0 LDRS_KD -346.578100 346.578100 EXTENDED_LIMITS -512.000000 511.984400 /end CHARACTERISTIC
/begin CHARACTERISTIC ldwSDV_SIN "LDR Verstaerk. Klein-S. neg. Vorsteuern" VALUE 0xF3E84 MSA15_FW4 0 LDRS_KD -346.578100 346.578100 EXTENDED_LIMITS -512.000000 511.984400 /end CHARACTERISTIC
/begin CHARACTERISTIC ldwSDV_SIP "LDR Verstaerk. Klein-S. pos. Vorsteuern" VALUE 0xF3E7C MSA15_FW4 0 LDRS_KD -346.578100 346.578100 EXTENDED_LIMITS -512.000000 511.984400 /end CHARACTERISTIC
/begin CHARACTERISTIC ldwSWBLDMN "LDR untere absolute Sollwertgrenze" VALUE 0xF3E74 MSA15_FW4 0 P -3500.000000 3500.000000 EXTENDED_LIMITS -32768.000000 32767.000000 /end CHARACTERISTIC
/begin CHARACTERISTIC ldwSWBLDMX "LDR obere absolute Sollwertgrenze        !###crq2046 Da" VALUE 0xF3E76 MSA15_FW4 0 P -3500.000000 3500.000000 EXTENDED_LIMITS -32768.000000 32767.000000 /end CHARACTERISTIC
/begin CHARACTERISTIC ldwSWoekKF "LDR Sollwert-oeko-Grundkennfeld  P_L = f(N, M_E)" MAP 0xF4296 MSA15_KF358 0 P 0.000000 3500.000000
 /begin AXIS_DESCR STD_AXIS dzmNmit N 16 0.000000 6000.000000 EXTENDED_LIMITS 0.000000 32767.000000 /end AXIS_DESCR
 /begin AXIS_DESCR STD_AXIS ldmM_E MM3 10 0.000000 100.000000 EXTENDED_LIMITS -327.680000 327.670000 /end AXIS_DESCR
 EXTENDED_LIMITS -32768.000000 32767.000000 /end CHARACTERISTIC
/begin CHARACTERISTIC ldwSWspoKF "LDR Sollwert-sport-Grundkennfeld  P_L = f(N, M_E)" MAP 0xF4412 MSA15_KF358 0 P 0.000000 3500.000000
 /begin AXIS_DESCR STD_AXIS dzmNmit N 2 0.000000 6000.000000 EXTENDED_LIMITS 0.000000 32767.000000 /end AXIS_DESCR
 /begin AXIS_DESCR STD_AXIS ldmM_E MM3 2 0.000000 100.000000 EXTENDED_LIMITS -327.680000 327.670000 /end AXIS_DESCR
 EXTENDED_LIMITS -32768.000000 32767.000000 /end CHARACTERISTIC
/begin CHARACTERISTIC ldwTLUEKL "LDR Sollwertkorrektur(Ueberdruck) FAKT = f(T_L)" CURVE 0xF4478 MSA15_KL118 0 FAKT 0.000000 3.200000
 /begin AXIS_DESCR STD_AXIS anmLTF T 7 -50.040010 199.960000 EXTENDED_LIMITS -273.140000 3003.560000 /end AXIS_DESCR
 EXTENDED_LIMITS -3.276800 3.276700 /end CHARACTERISTIC
/begin CHARACTERISTIC ldwTVPAkKL "LDR Korrektur FAKT = f(T_L) fuer Steuerung" CURVE 0xF47E4 MSA15_KL118 0 FAKT 0.000000 3.200000
 /begin AXIS_DESCR STD_AXIS ldmADF P 7 500.000000 1500.000000 EXTENDED_LIMITS -32768.000000 32767.000000 /end AXIS_DESCR
 EXTENDED_LIMITS -3.276800 3.276700 /end CHARACTERISTIC
/begin CHARACTERISTIC ldwTVTLKL "LDR Korrektur FAKT = f(T_L) fuer Steuerung" CURVE 0xF4804 MSA15_KL118 0 FAKT 0.000000 3.200000
 /begin AXIS_DESCR STD_AXIS anmLTF T 7 -50.040010 199.960000 EXTENDED_LIMITS -273.140000 3003.560000 /end AXIS_DESCR
 EXTENDED_LIMITS -3.276800 3.276700 /end CHARACTERISTIC
/begin CHARACTERISTIC ldwTVdPAKF "LDR Korrekturkennfeld = f( P_ATM,M_E ) f. Steuerung" MAP 0xF477C MSA15_KF382 0 PROZ -100.000000 100.000000
 /begin AXIS_DESCR STD_AXIS dzmNmit N 6 0.000000 6000.000000 EXTENDED_LIMITS 0.000000 32767.000000 /end AXIS_DESCR
 /begin AXIS_DESCR STD_AXIS ldoM_Est MM3 6 0.000000 100.000000 EXTENDED_LIMITS -327.680000 327.670000 /end AXIS_DESCR
 EXTENDED_LIMITS -327.680000 327.670000 /end CHARACTERISTIC
/begin CHARACTERISTIC ldwTVoekKF "LDR Steuer-oeko-Grundkennfeld  TV = f(N, M_E)" MAP 0xF45E8 MSA15_KF382 0 PROZ 0.000000 100.000000
 /begin AXIS_DESCR STD_AXIS dzmNmit N 16 0.000000 6000.000000 EXTENDED_LIMITS 0.000000 32767.000000 /end AXIS_DESCR
 /begin AXIS_DESCR STD_AXIS ldoM_Est MM3 10 0.000000 100.000000 EXTENDED_LIMITS -327.680000 327.670000 /end AXIS_DESCR
 EXTENDED_LIMITS -327.680000 327.670000 /end CHARACTERISTIC
/begin CHARACTERISTIC ldwTVspoKF "LDR Steuer-sport-Grundkennfeld  TV = f(N, M_E)" MAP 0xF4764 MSA15_KF382 0 PROZ 0.000000 100.000000
 /begin AXIS_DESCR STD_AXIS dzmNmit N 2 0.000000 6000.000000 EXTENDED_LIMITS 0.000000 32767.000000 /end AXIS_DESCR
 /begin AXIS_DESCR STD_AXIS ldoM_Est MM3 2 0.000000 100.000000 EXTENDED_LIMITS -327.680000 327.670000 /end AXIS_DESCR
 EXTENDED_LIMITS -327.680000 327.670000 /end CHARACTERISTIC
/begin CHARACTERISTIC ldwTVsteu "LDR Vorgabewert bei Betaetigter Kupplung" VALUE 0xF3EA6 MSA15_FW4 0 PROZ 0.000000 100.000000 EXTENDED_LIMITS -327.680000 327.670000 /end CHARACTERISTIC
/begin CHARACTERISTIC mrw1INJ "HCD Volumen pro Impuls" VALUE 0xF3C10 MSA15_FW3 0 MM3 5.000000 100.000000 EXTENDED_LIMITS -327.680000 327.670000 /end CHARACTERISTIC
/begin CHARACTERISTIC mrwABVmax "maximalbegrenzung des Vollastabgleichwerts" VALUE 0xFB16A MSA15_FW3 0 FAKT 0.000000 3.200000 EXTENDED_LIMITS -3.276800 3.276700 /end CHARACTERISTIC
/begin CHARACTERISTIC mrwABVmin "minimalbegrenzung des Vollastabgleichwerts" VALUE 0xFB16C MSA15_FW3 0 FAKT 0.000000 3.200000 EXTENDED_LIMITS -3.276800 3.276700 /end CHARACTERISTIC
/begin CHARACTERISTIC mrwABegOff "Offset zur Begrenzungsmenge fuer ARD Limitierung" VALUE 0xF3A4C MSA15_FW4 0 M_E 0.000000 100.000000 EXTENDED_LIMITS -327.680000 327.670000 /end CHARACTERISTIC
/begin CHARACTERISTIC mrwADB_KL "BEG Anfahrdrehmomentbegrenzung   M_E = f(N)" CURVE 0xFA8BE MSA15_KL118 0 MM3 0.000000 100.000000
 /begin AXIS_DESCR STD_AXIS dzmNmit N 19 0.000000 6000.000000 EXTENDED_LIMITS 0.000000 32767.000000 /end AXIS_DESCR
 EXTENDED_LIMITS -327.680000 327.670000 /end CHARACTERISTIC
/begin CHARACTERISTIC mrwALIVE_T "Timeout fuer ASC_ALIVE Ueberwachung" VALUE 0xF2030 MSA15_FW3 0 ZEIT_ST 0.000000 655350000.000000 /end CHARACTERISTIC
/begin CHARACTERISTIC mrwANFAHKL "#SSD Anfahrdrehmomentenmengenkennlinie" CURVE 0xF2464 MSA15_KL118 0 MM3 0.000000 100.000000
 /begin AXIS_DESCR STD_AXIS dzmNmit N 19 0.000000 6000.000000 EXTENDED_LIMITS 0.000000 32767.000000 /end AXIS_DESCR
 EXTENDED_LIMITS -327.680000 327.670000 /end CHARACTERISTIC
/begin CHARACTERISTIC mrwANFXUKL "#SSD Anfahrkennlinie bei TXU Botschaftsausfall" CURVE 0xF2414 MSA15_KL118 0 MM3 0.000000 100.000000
 /begin AXIS_DESCR STD_AXIS dzmNmit N 19 0.000000 6000.000000 EXTENDED_LIMITS 0.000000 32767.000000 /end AXIS_DESCR
 EXTENDED_LIMITS -327.680000 327.670000 /end CHARACTERISTIC
/begin CHARACTERISTIC mrwANF_FG "Fahrgeschwindigkeitsschwelle fuer Anfahr" VALUE 0xFA8BA MSA15_FW4 0 V 0.000000 300.000000 EXTENDED_LIMITS 0.000000 327.670000 /end CHARACTERISTIC
/begin CHARACTERISTIC mrwANF_PWG "PWG - Schwelle fuer Anfahrkennlinienumschaltung" VALUE 0xFA8B8 MSA15_FW4 0 PROZ_S 0.000000 100.000000 EXTENDED_LIMITS -327.680000 327.670000 /end CHARACTERISTIC
/begin CHARACTERISTIC mrwANF_tmx "Dauer, fuer die die Bedingungen aktiv sein muessen" VALUE 0xFA8BC MSA15_FW3 0 ZEIT_ST 0.000000 655350000.000000 /end CHARACTERISTIC
/begin CHARACTERISTIC mrwARDINMD "Scalter fuer ARD-Antel in MD_IND Berechnung 0=ohne ARD / 1=mit ARD" VALUE 0xF2032 MSA15_FW1 0 DEZ_DB_U 0.000000 1.000000 EXTENDED_LIMITS 0.000000 255.000000 /end CHARACTERISTIC
/begin CHARACTERISTIC mrwARDSMAX "Obere Begrenzung des ARD-Stoerregler-Eingriffs" VALUE 0xF3A4A MSA15_FW4 0 M_E 0.000000 100.000000 EXTENDED_LIMITS -327.680000 327.670000 /end CHARACTERISTIC
/begin CHARACTERISTIC mrwARDSMIN "Untere Begrenzung des ARD-Stoerregler-Eingriffs" VALUE 0xF3A48 MSA15_FW4 0 M_E -100.000000 0.000000 EXTENDED_LIMITS -327.680000 327.670000 /end CHARACTERISTIC
/begin CHARACTERISTIC mrwARDS_I "ARD - Schaltzustand des EGS, bei dem ARD initialisiert wird" VALUE 0xF3E01 MSA15_FW2 0 DEZ_DB_U 0.000000 2.000000 EXTENDED_LIMITS 0.000000 255.000000 /end CHARACTERISTIC
/begin CHARACTERISTIC mrwARDS_L "ARD - Schaltzustand des EGS, bei dem der Leerlaufpar. verwendet wird" VALUE 0xF3E00 MSA15_FW2 0 DEZ_DB_U 0.000000 2.000000 EXTENDED_LIMITS 0.000000 255.000000 /end CHARACTERISTIC
/begin CHARACTERISTIC mrwARDWK_I "ARD - Wandlerkupplungszustand, bei dem ARD initialisiert wird" VALUE 0xF3DFF MSA15_FW2 0 DEZ_DB_U 0.000000 3.000000 EXTENDED_LIMITS 0.000000 255.000000 /end CHARACTERISTIC
/begin CHARACTERISTIC mrwARDWK_L "ARD - Wandlerkupplungszustand, bei dem der Leerlaufpar. verwendet wird" VALUE 0xF3DFE MSA15_FW2 0 DEZ_DB_U 0.000000 3.000000 EXTENDED_LIMITS 0.000000 255.000000 /end CHARACTERISTIC
/begin CHARACTERISTIC mrwARD_L2R "ARD N-Hystere fuer Zustands°bergang LL/Ruckeln" VALUE 0xF3A46 MSA15_FW4 0 N 0.000000 6000.000000 EXTENDED_LIMITS 0.000000 32767.000000 /end CHARACTERISTIC
/begin CHARACTERISTIC mrwARD_R2L "ARD N-Hystere fuer Zustands°bergang Ruckeln/LL" VALUE 0xF3A44 MSA15_FW4 0 N 0.000000 6000.000000 EXTENDED_LIMITS 0.000000 32767.000000 /end CHARACTERISTIC
/begin CHARACTERISTIC mrwARD_TIM "#SSD Wartezeit nach M_EAKT = 0 bis M_EMOT=M_EFAHR=M_EKORR=0" VALUE 0xF3A42 MSA15_FW3 0 ZEIT_ST 0.000000 655350000.000000 /end CHARACTERISTIC
/begin CHARACTERISTIC mrwARD_TRA "#SSD Wartezeit nach M_Eakt = 0 bis Rampenstart fuer M_EMOT=M_EFAHR=M_EKORR=0" VALUE 0xF3A54 MSA15_FW3 0 ZEIT_ST 0.000000 655350000.000000 /end CHARACTERISTIC
/begin CHARACTERISTIC mrwARD_V "ARD V-Schwelle zum Abschalten des Differenzierer" VALUE 0xF3A2C MSA15_FW4 0 V 0.000000 300.000000 EXTENDED_LIMITS 0.000000 327.670000 /end CHARACTERISTIC
/begin CHARACTERISTIC mrwARMEKPt "Timeout fuer den Zustand arming bei EKP-Abschaltung ueber CAN" VALUE 0xF97C8 MSA15_FW3 0 ZEIT_ST 0.000000 655350000.000000 /end CHARACTERISTIC
/begin CHARACTERISTIC mrwASRRAMP "#SSD Rampenschrittweite ASR Mengeneingriff" VALUE 0xF2024 MSA15_FW4 0 dM_E_dZ 0.000000 3000.000000 EXTENDED_LIMITS -16384.000000 16383.500000 /end CHARACTERISTIC
/begin CHARACTERISTIC mrwASR_ALV "Zeitdauer der ASR Erkennung, in der sich ASC_ALIVE 3x aendern muss" VALUE 0xF202C MSA15_FW3 0 ZEIT_ST 0.000000 655350000.000000 /end CHARACTERISTIC
/begin CHARACTERISTIC mrwAUS_max "AUSZ  max. Aussetzer pro Test" VALUE 0xF3BB8 MSA15_FW4 0 DEZ_DW 0.000000 32767.000000 EXTENDED_LIMITS -32768.000000 32767.000000 /end CHARACTERISTIC
/begin CHARACTERISTIC mrwBDBH_KL "#SSD BEG Gangabhaengige Drehmomentbegrenzung (erhoeht) M_E = f(N)" CURVE 0xFA914 MSA15_KL118 0 MM3 0.000000 100.000000
 /begin AXIS_DESCR STD_AXIS dzmNmit N 19 0.000000 6000.000000 EXTENDED_LIMITS 0.000000 32767.000000 /end AXIS_DESCR
 EXTENDED_LIMITS -327.680000 327.670000 /end CHARACTERISTIC
/begin CHARACTERISTIC mrwBDBLRKL "Drehmomentenbegrezungskennlinie bei Low Range" CURVE 0xFA9B4 MSA15_KL118 0 MM3 0.000000 100.000000
 /begin AXIS_DESCR STD_AXIS dzmNmit N 16 0.000000 6000.000000 EXTENDED_LIMITS 0.000000 32767.000000 /end AXIS_DESCR
 EXTENDED_LIMITS -327.680000 327.670000 /end CHARACTERISTIC
/begin CHARACTERISTIC mrwBDBN_KL "#SSD BEG Gangabhaengige Drehmomentbegrenzung (normal) M_E = f(N)" CURVE 0xFA964 MSA15_KL118 0 MM3 0.000000 100.000000
 /begin AXIS_DESCR STD_AXIS dzmNmit N 19 0.000000 6000.000000 EXTENDED_LIMITS 0.000000 32767.000000 /end AXIS_DESCR
 EXTENDED_LIMITS -327.680000 327.670000 /end CHARACTERISTIC
/begin CHARACTERISTIC mrwBDB_ANS "Schrittweite fuer Rampe NKL -> HKL" VALUE 0xFA910 MSA15_FW4 0 dM_E_dZ 0.000000 3000.000000 EXTENDED_LIMITS -16384.000000 16383.500000 /end CHARACTERISTIC
/begin CHARACTERISTIC mrwBDB_GA "#SSD Gaenge, die fuer HKL vorgesehen sind" VALUE 0xFA90E MSA15_FW1 0 DEZ_DB_U 0.000000 255.000000 /end CHARACTERISTIC
/begin CHARACTERISTIC mrwBDB_RED "Schrittweite fuer Rampe HKL -> NKL" VALUE 0xFA912 MSA15_FW4 0 dM_E_dZ 0.000000 3000.000000 EXTENDED_LIMITS -16384.000000 16383.500000 /end CHARACTERISTIC
/begin CHARACTERISTIC mrwBEA_MAX "BEG obere Grenze fuer M_E-Abgleich" VALUE 0xFA2BC MSA15_FW4 0 FAKT 0.000000 3.200000 EXTENDED_LIMITS -3.276800 3.276700 /end CHARACTERISTIC
/begin CHARACTERISTIC mrwBEA_MIN "BEG untere Grenze fuer M_E-Abgleich" VALUE 0xFA2BA MSA15_FW4 0 FAKT 0.000000 3.200000 EXTENDED_LIMITS -3.276800 3.276700 /end CHARACTERISTIC
/begin CHARACTERISTIC mrwBEG_ABS "BEG Dekrement f. Absenkung bei Defekterkennung" VALUE 0xFA2BE MSA15_FW4 0 dVE_dZ 0.000000 3000.000000 EXTENDED_LIMITS -16384.000000 16383.500000 /end CHARACTERISTIC
/begin CHARACTERISTIC mrwBEG_ANH "BEG Inkrement f. Anhebung bei Intakterkennung" VALUE 0xFA2C0 MSA15_FW4 0 dVE_dZ 0.000000 3000.000000 EXTENDED_LIMITS -16384.000000 16383.500000 /end CHARACTERISTIC
/begin CHARACTERISTIC mrwBEG_NTO "#SSD BEG obere N-Schwelle T_W-abhaeng. Vollastanhebung" VALUE 0xFA2B4 MSA15_FW4 0 N 0.000000 6000.000000 EXTENDED_LIMITS 0.000000 32767.000000 /end CHARACTERISTIC
/begin CHARACTERISTIC mrwBEG_NTS "BEG untere N-Schwelle fuer Turboschubbegrenzung" VALUE 0xFA2B8 MSA15_FW4 0 N 0.000000 6000.000000 EXTENDED_LIMITS 0.000000 32767.000000 /end CHARACTERISTIC
/begin CHARACTERISTIC mrwBEG_NTU "#SSD BEG untere N-Schwelle T_W-abhaeng. Vollastanhebung" VALUE 0xFA2B6 MSA15_FW4 0 N 0.000000 6000.000000 EXTENDED_LIMITS 0.000000 32767.000000 /end CHARACTERISTIC
/begin CHARACTERISTIC mrwBEG_TAN "BEG Turboschubbegrenzung  / zul. Mengeninkrement" VALUE 0xFA2B2 MSA15_FW4 0 dVE_dZ 0.000000 3000.000000 EXTENDED_LIMITS -16384.000000 16383.500000 /end CHARACTERISTIC
/begin CHARACTERISTIC mrwBEM_KL "#SSD BEG Mengenbegrenzungs-KL (Systemfehler) M_E = f(N)" CURVE 0xF37D6 MSA15_KL118 0 MM3 0.000000 100.000000
 /begin AXIS_DESCR STD_AXIS dzmNmit N 19 0.000000 6000.000000 EXTENDED_LIMITS 0.000000 32767.000000 /end AXIS_DESCR
 EXTENDED_LIMITS -327.680000 327.670000 /end CHARACTERISTIC
/begin CHARACTERISTIC mrwBKTF_KF "BEG Ueberhitzungsschutz-KF KTF   FAKT = f(T_KTF,V)" MAP 0xFB052 MSA15_KF382 0 FAKT 0.000000 1.000000
 /begin AXIS_DESCR STD_AXIS anmKTF T 2 -50.040010 149.960000 EXTENDED_LIMITS -273.140000 3003.560000 /end AXIS_DESCR
 /begin AXIS_DESCR STD_AXIS fgmFGAKT V 2 0.000000 300.000000 EXTENDED_LIMITS 0.000000 327.670000 /end AXIS_DESCR
 EXTENDED_LIMITS -3.276800 3.276700 /end CHARACTERISTIC
/begin CHARACTERISTIC mrwBM_Edy0 "BEG dyn. Rauchmengenschwelle 0" VALUE 0xFA2C2 MSA15_FW4 0 MM3 0.000000 100.000000 EXTENDED_LIMITS -327.680000 327.670000 /end CHARACTERISTIC
/begin CHARACTERISTIC mrwBM_Edy1 "BEG dyn. Rauchmengenschwelle 1" VALUE 0xFA2C4 MSA15_FW4 0 MM3 0.000000 100.000000 EXTENDED_LIMITS -327.680000 327.670000 /end CHARACTERISTIC
/begin CHARACTERISTIC mrwBM_Edy2 "BEG dyn. Rauchmengenschwelle 2" VALUE 0xFA2C6 MSA15_FW4 0 MM3 0.000000 100.000000 EXTENDED_LIMITS -327.680000 327.670000 /end CHARACTERISTIC
/begin CHARACTERISTIC mrwBM_EdyA "BEG dyn. Rauchmengenschwelle akt." VALUE 0xFA2C8 MSA15_FW4 0 MM3 0.000000 100.000000 EXTENDED_LIMITS -327.680000 327.670000 /end CHARACTERISTIC
/begin CHARACTERISTIC mrwBM_TLKL "Drehzahlabh. Begrenzungsmenge bei leerem Tank" CURVE 0xFB176 MSA15_KL118 0 M_E 0.000000 100.000000
 /begin AXIS_DESCR STD_AXIS dzmNmit N 10 0.000000 6000.000000 EXTENDED_LIMITS 0.000000 32767.000000 /end AXIS_DESCR
 EXTENDED_LIMITS -327.680000 327.670000 /end CHARACTERISTIC
/begin CHARACTERISTIC mrwBM_TLRp "Schrittweite fuer Tankleerbegrenzungsrampen" VALUE 0xFB174 MSA15_FW4 0 dM_E_dZ 0.000000 3000.000000 EXTENDED_LIMITS -16384.000000 16383.500000 /end CHARACTERISTIC
/begin CHARACTERISTIC mrwBM_TLt0 "Totzeit fuer endgueltigen Mengenstopp" VALUE 0xFB172 MSA15_FW3 0 ZEIT_HP 0.000000 1310700000.000000 /end CHARACTERISTIC
/begin CHARACTERISTIC mrwBOEL_KF "#SSD BEG Ueberhitzungsschutz-KF OTF   FAKT = f(T_OEL,V)" MAP 0xFB06A MSA15_KF382 0 FAKT 0.000000 1.000000
 /begin AXIS_DESCR STD_AXIS anmOTF T 2 -50.040010 199.960000 EXTENDED_LIMITS -273.140000 3003.560000 /end AXIS_DESCR
 /begin AXIS_DESCR STD_AXIS fgmFGAKT V 2 0.000000 300.000000 EXTENDED_LIMITS 0.000000 327.670000 /end AXIS_DESCR
 EXTENDED_LIMITS -3.276800 3.276700 /end CHARACTERISTIC
/begin CHARACTERISTIC mrwBRA_KF "#SSD BEG Rauchbegrenzungs - KF    M_E = f(N, M_L)" MAP 0xFAADA MSA15_KF382 0 MM3 0.000000 100.000000
 /begin AXIS_DESCR STD_AXIS dzmNmit N 16 0.000000 6000.000000 EXTENDED_LIMITS 0.000000 32767.000000 /end AXIS_DESCR
 /begin AXIS_DESCR STD_AXIS armM_List M_L 16 0.000000 1500.000000 EXTENDED_LIMITS -3276.800000 3276.700000 /end AXIS_DESCR
 EXTENDED_LIMITS -327.680000 327.670000 /end CHARACTERISTIC
/begin CHARACTERISTIC mrwBRAkAKF "Erste Korrektur Rauchbegrenzung M_E = f(N, M_L)" MAP 0xFA5EC MSA15_KF382 0 MM3 0.000000 100.000000
 /begin AXIS_DESCR STD_AXIS dzmNmit N 11 0.000000 6000.000000 EXTENDED_LIMITS 0.000000 32767.000000 /end AXIS_DESCR
 /begin AXIS_DESCR STD_AXIS armM_List M_L 12 0.000000 1500.000000 EXTENDED_LIMITS -3276.800000 3276.700000 /end AXIS_DESCR
 EXTENDED_LIMITS -327.680000 327.670000 /end CHARACTERISTIC
/begin CHARACTERISTIC mrwBRAkAKL "Korrektur Rauchbegrenzung; Faktor = f(ADF)" CURVE 0xFA72A MSA15_KL118 0 FAKT 0.000000 1.000000
 /begin AXIS_DESCR STD_AXIS anmADF P 8 0.000000 3500.000000 EXTENDED_LIMITS -32768.000000 32767.000000 /end AXIS_DESCR
 EXTENDED_LIMITS -3.276800 3.276700 /end CHARACTERISTIC
/begin CHARACTERISTIC mrwBRAkLKF "Zweite Korrektur Rauchbegrenzung M_E = f(N, M_L)" MAP 0xFA74E MSA15_KF382 0 MM3 0.000000 100.000000
 /begin AXIS_DESCR STD_AXIS dzmNmit N 11 0.000000 6000.000000 EXTENDED_LIMITS 0.000000 32767.000000 /end AXIS_DESCR
 /begin AXIS_DESCR STD_AXIS armM_List M_L 12 0.000000 1500.000000 EXTENDED_LIMITS -3276.800000 3276.700000 /end AXIS_DESCR
 EXTENDED_LIMITS -327.680000 327.670000 /end CHARACTERISTIC
/begin CHARACTERISTIC mrwBRAkLKL "Korrektur Rauchbegrenzung; Faktor = f(LTF)" CURVE 0xFA88C MSA15_KL118 0 FAKT 0.000000 1.000000
 /begin AXIS_DESCR STD_AXIS anmLTF T 8 -50.040010 199.960000 EXTENDED_LIMITS -273.140000 3003.560000 /end AXIS_DESCR
 EXTENDED_LIMITS -3.276800 3.276700 /end CHARACTERISTIC
/begin CHARACTERISTIC mrwBRDY_KF "BEG dynamisches Rauchbegrenzungs - KF    M_E = f(N, M_L)" MAP 0xFA2E2 MSA15_KF382 0 MM3 0.000000 100.000000
 /begin AXIS_DESCR STD_AXIS dzmNmit N 16 0.000000 6000.000000 EXTENDED_LIMITS 0.000000 32767.000000 /end AXIS_DESCR
 /begin AXIS_DESCR STD_AXIS armM_List M_L 16 0.000000 1500.000000 EXTENDED_LIMITS -3276.800000 3276.700000 /end AXIS_DESCR
 EXTENDED_LIMITS -327.680000 327.670000 /end CHARACTERISTIC
/begin CHARACTERISTIC mrwBRLWRKF "Rauchbegrenzungskennfeld bei Low Range" MAP 0xFAD22 MSA15_KF382 0 MM3 0.000000 100.000000
 /begin AXIS_DESCR STD_AXIS dzmNmit N 16 0.000000 6000.000000 EXTENDED_LIMITS 0.000000 32767.000000 /end AXIS_DESCR
 /begin AXIS_DESCR STD_AXIS armM_List M_L 16 0.000000 1500.000000 EXTENDED_LIMITS -3276.800000 3276.700000 /end AXIS_DESCR
 EXTENDED_LIMITS -327.680000 327.670000 /end CHARACTERISTIC
/begin CHARACTERISTIC mrwBUE_KF "#SSD BEG Ueberhitzungsschutz-KF WTF   FAKT = f(T_W, V)" MAP 0xFAFEA MSA15_KF382 0 FAKT 0.000000 1.000000
 /begin AXIS_DESCR STD_AXIS anmWTF T 6 -50.040010 149.960000 EXTENDED_LIMITS -273.140000 3003.560000 /end AXIS_DESCR
 /begin AXIS_DESCR STD_AXIS fgmFGAKT V 6 0.000000 300.000000 EXTENDED_LIMITS 0.000000 327.670000 /end AXIS_DESCR
 EXTENDED_LIMITS -3.276800 3.276700 /end CHARACTERISTIC
/begin CHARACTERISTIC mrwBWT_KF "#SSD BEG T_W-abh. Vollastanhebung        M_E = f(N, T_W)" MAP 0xFA544 MSA15_KF382 0 MM3 0.000000 100.000000
 /begin AXIS_DESCR STD_AXIS dzmNmit N 8 0.000000 6000.000000 EXTENDED_LIMITS 0.000000 32767.000000 /end AXIS_DESCR
 /begin AXIS_DESCR STD_AXIS anmWTF T 8 -50.040010 149.960000 EXTENDED_LIMITS -273.140000 3003.560000 /end AXIS_DESCR
 EXTENDED_LIMITS -327.680000 327.670000 /end CHARACTERISTIC
/begin CHARACTERISTIC mrwBdPV_KF "BEG  Mengenbegrenzungs-KF bei zu geringem Vorfoerderdruck" MAP 0xFB082 MSA15_KF382 0 MM3 0.000000 100.000000
 /begin AXIS_DESCR STD_AXIS dzmNmit N 8 0.000000 6000.000000 EXTENDED_LIMITS 0.000000 32767.000000 /end AXIS_DESCR
 /begin AXIS_DESCR STD_AXIS mrodPV VDF 8 0.000000 5000.000000 EXTENDED_LIMITS -32768.000000 32767.000000 /end AXIS_DESCR
 EXTENDED_LIMITS -327.680000 327.670000 /end CHARACTERISTIC
/begin CHARACTERISTIC mrwCKP_VGW "Vorgabewert fuer Kupplungssignal von EGS" VALUE 0xF202E MSA15_FW1 0 DEZ_DB_U 0.000000 1.000000 EXTENDED_LIMITS 0.000000 255.000000 /end CHARACTERISTIC
/begin CHARACTERISTIC mrwDHyp_N "LLR Nennerparameter  Hyperbel Aufschaltung LLR D-Anteil" VALUE 0xF384E MSA15_FW4 0 DEZ_DW -32768.000000 32767.000000 /end CHARACTERISTIC
/begin CHARACTERISTIC mrwDHyp_Z "LLR Zaehlerparameter Hyperbel Aufschaltung LLR D-Anteil" VALUE 0xF3850 MSA15_FW4 0 DEZ_DW -32768.000000 32767.000000 /end CHARACTERISTIC
/begin CHARACTERISTIC mrwDN_EIN "Drehzahloffset" VALUE 0xF3868 MSA15_FW3 0 N 0.000000 6000.000000 EXTENDED_LIMITS 0.000000 32767.000000 /end CHARACTERISTIC
/begin CHARACTERISTIC mrwDRFMI2 "MIN Begrenzung Fuer Mengendriftkompensation" VALUE 0xF3CDA MSA15_FW4 0 M_E -12.600000 12.600000 EXTENDED_LIMITS -327.680000 327.670000 /end CHARACTERISTIC
/begin CHARACTERISTIC mrwDRFMX2 "MAX Begrenzung Fuer Mengendriftkompensation" VALUE 0xF3CDC MSA15_FW4 0 M_E -12.600000 12.600000 EXTENDED_LIMITS -327.680000 327.670000 /end CHARACTERISTIC
/begin CHARACTERISTIC mrwDSCANK "ARD-SR   Koeff  DT1-Glied: ext. Mengeneingriff" VALUE 0xF3B3E MSA15_FW4 0 ARD_KD 0.000000 1.000000 EXTENDED_LIMITS 0.000000 1.599951 /end CHARACTERISTIC
/begin CHARACTERISTIC mrwDSKUPK "ARD-SR   Koeff  DT1-Glied: Kupplung betaetigt" VALUE 0xF3AD0 MSA15_FW4 0 ARD_KD_KUP 0.000977 1.000000 EXTENDED_LIMITS 0.000049 1.599951 /end CHARACTERISTIC
/begin CHARACTERISTIC mrwDSL1GK "ARD-SR   Koeff  DT1-Glied: Leerlauf, 1.Gang" VALUE 0xF3B34 MSA15_FW4 0 ARD_KD 0.000000 1.000000 EXTENDED_LIMITS 0.000000 1.599951 /end CHARACTERISTIC
/begin CHARACTERISTIC mrwDSL2GK "ARD-SR   Koeff  DT1-Glied: Leerlauf, 2.Gang" VALUE 0xF3B2A MSA15_FW4 0 ARD_KD 0.000000 1.000000 EXTENDED_LIMITS 0.000000 1.599951 /end CHARACTERISTIC
/begin CHARACTERISTIC mrwDSL3GK "ARD-SR   Koeff  DT1-Glied: Leerlauf, 3.Gang" VALUE 0xF3B20 MSA15_FW4 0 ARD_KD 0.000000 1.000000 EXTENDED_LIMITS 0.000000 1.599951 /end CHARACTERISTIC
/begin CHARACTERISTIC mrwDSL4GK "ARD-SR   Koeff  DT1-Glied: Leerlauf, 4.Gang" VALUE 0xF3B16 MSA15_FW4 0 ARD_KD 0.000000 1.000000 EXTENDED_LIMITS 0.000000 1.599951 /end CHARACTERISTIC
/begin CHARACTERISTIC mrwDSL5GK "ARD-SR   Koeff  DT1-Glied: Leerlauf, 5.Gang" VALUE 0xF3B0C MSA15_FW4 0 ARD_KD 0.000000 1.000000 EXTENDED_LIMITS 0.000000 1.599951 /end CHARACTERISTIC
/begin CHARACTERISTIC mrwDSR1GK "ARD-SR   Koeff  DT1-Glied: Ruckeln, 1.Gang" VALUE 0xF3B02 MSA15_FW4 0 ARD_KD 0.000000 1.000000 EXTENDED_LIMITS 0.000000 1.599951 /end CHARACTERISTIC
/begin CHARACTERISTIC mrwDSR2GK "ARD-SR   Koeff  DT1-Glied: Ruckeln, 2.Gang" VALUE 0xF3AF8 MSA15_FW4 0 ARD_KD 0.000000 1.000000 EXTENDED_LIMITS 0.000000 1.599951 /end CHARACTERISTIC
/begin CHARACTERISTIC mrwDSR3GK "ARD-SR   Koeff  DT1-Glied: Ruckeln, 3.Gang" VALUE 0xF3AEE MSA15_FW4 0 ARD_KD 0.000000 1.000000 EXTENDED_LIMITS 0.000000 1.599951 /end CHARACTERISTIC
/begin CHARACTERISTIC mrwDSR4GK "ARD-SR   Koeff  DT1-Glied: Ruckeln, 4.Gang" VALUE 0xF3AE4 MSA15_FW4 0 ARD_KD 0.000000 1.000000 EXTENDED_LIMITS 0.000000 1.599951 /end CHARACTERISTIC
/begin CHARACTERISTIC mrwDSR5GK "ARD-SR   Koeff  DT1-Glied: Ruckeln, 5.Gang" VALUE 0xF3ADA MSA15_FW4 0 ARD_KD 0.000000 1.000000 EXTENDED_LIMITS 0.000000 1.599951 /end CHARACTERISTIC
/begin CHARACTERISTIC mrwDZG_FZY "Fahrzyklusschalter Drehzahl" VALUE 0xFB206 MSA15_FW2 0 DEZ_DB_U 0.000000 1.000000 EXTENDED_LIMITS 0.000000 255.000000 /end CHARACTERISTIC
/begin CHARACTERISTIC mrwDZG_S1 "Drehzahl obere  Hysteresenschwelle" VALUE 0xFB202 MSA15_FW4 0 N 0.000000 6000.000000 EXTENDED_LIMITS 0.000000 32767.000000 /end CHARACTERISTIC
/begin CHARACTERISTIC mrwDZG_S2 "Drehzahl untere Hysteresenschwelle" VALUE 0xFB204 MSA15_FW4 0 N 0.000000 6000.000000 EXTENDED_LIMITS 0.000000 32767.000000 /end CHARACTERISTIC
/begin CHARACTERISTIC mrwEAB_N1 "#SSD EAB_Test im Schub, Drehzahlschwelle n1" VALUE 0xF97A8 MSA15_FW4 0 N 0.000000 6000.000000 EXTENDED_LIMITS 0.000000 32767.000000 /end CHARACTERISTIC
/begin CHARACTERISTIC mrwEAB_N2 "#SSD EAB_Test im Schub, Drehzahlschwelle n2" VALUE 0xF97AA MSA15_FW4 0 N 0.000000 6000.000000 EXTENDED_LIMITS 0.000000 32767.000000 /end CHARACTERISTIC
/begin CHARACTERISTIC mrwEAB_T1 "#SSD EAB_Test im Schub+Nachlauf, untere Wassertemperaturschwelle" VALUE 0xF97C6 MSA15_FW4 0 T -50.040010 149.960000 EXTENDED_LIMITS -273.140000 3003.560000 /end CHARACTERISTIC
/begin CHARACTERISTIC mrwEAB_dP1 "#SSD EAB_Test im Schub, dP_Rail1" VALUE 0xF97AC MSA15_FW4 0 RP 0.000000 1500000.000000 EXTENDED_LIMITS -3276800.000000 3276700.000000 /end CHARACTERISTIC
/begin CHARACTERISTIC mrwEAB_dP2 "#SSD EAB_Test im Schub, dP_Rail2" VALUE 0xF97AE MSA15_FW4 0 RP 0.000000 1500000.000000 EXTENDED_LIMITS -3276800.000000 3276700.000000 /end CHARACTERISTIC
/begin CHARACTERISTIC mrwEAB_dP3 "#SSD EAB_Test im Schub, dP_Rail3" VALUE 0xF97BE MSA15_FW4 0 RP 0.000000 1500000.000000 EXTENDED_LIMITS -3276800.000000 3276700.000000 /end CHARACTERISTIC
/begin CHARACTERISTIC mrwEAB_dt1 "#SSD EAB_Test im Schub, Zeit dt1" VALUE 0xF97B0 MSA15_FW3 0 ZEIT_ST 0.000000 655350000.000000 /end CHARACTERISTIC
/begin CHARACTERISTIC mrwEAB_dt2 "#SSD EAB_Test im Schub, Zeit dt1" VALUE 0xF97C0 MSA15_FW3 0 ZEIT_ST 0.000000 655350000.000000 /end CHARACTERISTIC
/begin CHARACTERISTIC mrwEAB_dt3 "#SSD EAB_Test im Schub, Zeit dt3" VALUE 0xF97C4 MSA15_FW3 0 ZEIT_ST 0.000000 655350000.000000 /end CHARACTERISTIC
/begin CHARACTERISTIC mrwEGSRAMP "#SSD EGS Schrittweite Mengenrampe" VALUE 0xF200C MSA15_FW3 0 dM_E_dZ 0.000000 3000.000000 EXTENDED_LIMITS -16384.000000 16383.500000 /end CHARACTERISTIC
/begin CHARACTERISTIC mrwFAKTmax "Korrekturfaktor - Maximum" VALUE 0xF24D8 MSA15_FW3 0 FAKT 0.000000 3.200000 EXTENDED_LIMITS -3.276800 3.276700 /end CHARACTERISTIC
/begin CHARACTERISTIC mrwFAKTmin "Korrekturfaktor - Minimum" VALUE 0xF24D6 MSA15_FW3 0 FAKT 0.000000 3.200000 EXTENDED_LIMITS -3.276800 3.276700 /end CHARACTERISTIC
/begin CHARACTERISTIC mrwFB2_FEN "FGR Fenster Kleinsignal P-Regler Beschleunigen 2. Gang" VALUE 0xFA092 MSA15_FW3 0 V 0.000000 300.000000 EXTENDED_LIMITS 0.000000 327.670000 /end CHARACTERISTIC
/begin CHARACTERISTIC mrwFB2_NEG "FGR P-Verstaerkung neg. Gross-S. Beschleunigen 2. Gang" VALUE 0xFA096 MSA15_FW3 0 FGR_KP 0.000000 10.000000 EXTENDED_LIMITS 0.000000 15.999510 /end CHARACTERISTIC
/begin CHARACTERISTIC mrwFB2_POS "FGR P-Verstaerkung pos. Gross-S. Beschleunigen 2. Gang" VALUE 0xFA098 MSA15_FW3 0 FGR_KP 0.000000 10.000000 EXTENDED_LIMITS 0.000000 15.999510 /end CHARACTERISTIC
/begin CHARACTERISTIC mrwFB2_SIG "FGR P-Verstaerkung Kleinsignal Beschleunigen 2. Gang" VALUE 0xFA094 MSA15_FW3 0 FGR_KP 0.000000 10.000000 EXTENDED_LIMITS 0.000000 15.999510 /end CHARACTERISTIC
/begin CHARACTERISTIC mrwFB3_FEN "FGR Fenster Kleinsignal P-Regler Beschleunigen 3. Gang" VALUE 0xFA09C MSA15_FW3 0 V 0.000000 300.000000 EXTENDED_LIMITS 0.000000 327.670000 /end CHARACTERISTIC
/begin CHARACTERISTIC mrwFB3_NEG "FGR P-Verstaerkung neg. Gross-S. Beschleunigen 3. Gang" VALUE 0xFA0A0 MSA15_FW3 0 FGR_KP 0.000000 10.000000 EXTENDED_LIMITS 0.000000 15.999510 /end CHARACTERISTIC
/begin CHARACTERISTIC mrwFB3_POS "FGR P-Verstaerkung pos. Gross-S. Beschleunigen 3. Gang" VALUE 0xFA0A2 MSA15_FW3 0 FGR_KP 0.000000 10.000000 EXTENDED_LIMITS 0.000000 15.999510 /end CHARACTERISTIC
/begin CHARACTERISTIC mrwFB3_SIG "FGR P-Verstaerkung Kleinsignal Beschleunigen 3. Gang" VALUE 0xFA09E MSA15_FW3 0 FGR_KP 0.000000 10.000000 EXTENDED_LIMITS 0.000000 15.999510 /end CHARACTERISTIC
/begin CHARACTERISTIC mrwFB4_FEN "FGR Fenster Kleinsignal P-Regler Beschleunigen 4. Gang" VALUE 0xFA0A6 MSA15_FW3 0 V 0.000000 300.000000 EXTENDED_LIMITS 0.000000 327.670000 /end CHARACTERISTIC
/begin CHARACTERISTIC mrwFB4_NEG "FGR P-Verstaerkung neg. Gross-S. Beschleunigen 4. Gang" VALUE 0xFA0AA MSA15_FW3 0 FGR_KP 0.000000 10.000000 EXTENDED_LIMITS 0.000000 15.999510 /end CHARACTERISTIC
/begin CHARACTERISTIC mrwFB4_POS "FGR P-Verstaerkung pos. Gross-S. Beschleunigen 4. Gang" VALUE 0xFA0AC MSA15_FW3 0 FGR_KP 0.000000 10.000000 EXTENDED_LIMITS 0.000000 15.999510 /end CHARACTERISTIC
/begin CHARACTERISTIC mrwFB4_SIG "FGR P-Verstaerkung Kleinsignal Beschleunigen 4. Gang" VALUE 0xFA0A8 MSA15_FW3 0 FGR_KP 0.000000 10.000000 EXTENDED_LIMITS 0.000000 15.999510 /end CHARACTERISTIC
/begin CHARACTERISTIC mrwFB5_FEN "FGR Fenster Kleinsignal P-Regler Beschleunigen 5. Gang" VALUE 0xFA0B0 MSA15_FW3 0 V 0.000000 300.000000 EXTENDED_LIMITS 0.000000 327.670000 /end CHARACTERISTIC
/begin CHARACTERISTIC mrwFB5_NEG "FGR P-Verstaerkung neg. Gross-S. Beschleunigen 5. Gang" VALUE 0xFA0B4 MSA15_FW3 0 FGR_KP 0.000000 10.000000 EXTENDED_LIMITS 0.000000 15.999510 /end CHARACTERISTIC
/begin CHARACTERISTIC mrwFB5_POS "FGR P-Verstaerkung pos. Gross-S. Beschleunigen 5. Gang" VALUE 0xFA0B6 MSA15_FW3 0 FGR_KP 0.000000 10.000000 EXTENDED_LIMITS 0.000000 15.999510 /end CHARACTERISTIC
/begin CHARACTERISTIC mrwFB5_SIG "FGR P-Verstaerkung Kleinsignal Beschleunigen 5. Gang" VALUE 0xFA0B2 MSA15_FW3 0 FGR_KP 0.000000 10.000000 EXTENDED_LIMITS 0.000000 15.999510 /end CHARACTERISTIC
/begin CHARACTERISTIC mrwFCanNeg "ARD-FF: Umschaltschwelle neg. Param. ext. Mengeneingr." VALUE 0xF3A6A MSA15_FW4 0 M_E -100.000000 100.000000 EXTENDED_LIMITS -327.680000 327.670000 /end CHARACTERISTIC
/begin CHARACTERISTIC mrwFCanPos "ARD-FF: Umschaltschwelle pos. Param. ext. Mengeneingr." VALUE 0xF3A68 MSA15_FW4 0 M_E -100.000000 100.000000 EXTENDED_LIMITS -327.680000 327.670000 /end CHARACTERISTIC
/begin CHARACTERISTIC mrwFFCanKn "ARD-FF: neg Koeff Lead-Lag-Glied; ext. Mengeneingriff" VALUE 0xF3ACC MSA15_FW4 0 ARD_KL 0.000000 1.000000 EXTENDED_LIMITS 0.000000 1.999939 /end CHARACTERISTIC
/begin CHARACTERISTIC mrwFFCanKp "ARD-FF: pos Koeff Lead-Lag-Glied; ext. Mengeneingriff" VALUE 0xF3AC8 MSA15_FW4 0 ARD_KL 0.000000 1.000000 EXTENDED_LIMITS 0.000000 1.999939 /end CHARACTERISTIC
/begin CHARACTERISTIC mrwFFKupKn "ARD-FF: neg Koeff Lead-Lag-Glied; Kupplung betaetigt" VALUE 0xF3AAC MSA15_FW4 0 ARD_KL 0.000000 1.000000 EXTENDED_LIMITS 0.000000 1.999939 /end CHARACTERISTIC
/begin CHARACTERISTIC mrwFFKupKp "ARD-FF: pos Koeff Lead-Lag-Glied; Kupplung betaetigt" VALUE 0xF3AA8 MSA15_FW4 0 ARD_KL 0.000000 1.000000 EXTENDED_LIMITS 0.000000 1.999939 /end CHARACTERISTIC
/begin CHARACTERISTIC mrwFFMggKn "ARD-FF: neg Koeff Lead-Lag-Glied; mittlere Getriebegruppe" VALUE 0xF3ABC MSA15_FW4 0 ARD_KL 0.000000 1.000000 EXTENDED_LIMITS 0.000000 1.999939 /end CHARACTERISTIC
/begin CHARACTERISTIC mrwFFMggKp "ARD-FF: pos Koeff Lead-Lag-Glied; mittlere Getriebegruppe" VALUE 0xF3AB8 MSA15_FW4 0 ARD_KL 0.000000 1.000000 EXTENDED_LIMITS 0.000000 1.999939 /end CHARACTERISTIC
/begin CHARACTERISTIC mrwFFOggKn "ARD-FF: neg Koeff Lead-Lag-Glied; obere Getriebegruppe" VALUE 0xF3AB4 MSA15_FW4 0 ARD_KL 0.000000 1.000000 EXTENDED_LIMITS 0.000000 1.999939 /end CHARACTERISTIC
/begin CHARACTERISTIC mrwFFOggKp "ARD-FF: pos Koeff Lead-Lag-Glied; obere Getriebegruppe" VALUE 0xF3AB0 MSA15_FW4 0 ARD_KL 0.000000 1.000000 EXTENDED_LIMITS 0.000000 1.999939 /end CHARACTERISTIC
/begin CHARACTERISTIC mrwFFUggKn "ARD-FF: neg Koeff Lead-Lag-Glied; mittlere Getriebegruppe" VALUE 0xF3AC4 MSA15_FW4 0 ARD_KL 0.000000 1.000000 EXTENDED_LIMITS 0.000000 1.999939 /end CHARACTERISTIC
/begin CHARACTERISTIC mrwFFUggKp "ARD-FF: pos Koeff Lead-Lag-Glied; mittlere Getriebegruppe" VALUE 0xF3AC0 MSA15_FW4 0 ARD_KL 0.000000 1.000000 EXTENDED_LIMITS 0.000000 1.999939 /end CHARACTERISTIC
/begin CHARACTERISTIC mrwFG2_GF "FGR PT1-Gedaechtnisfaktor 2. Gang" VALUE 0xFA112 MSA15_FW3 0 GF 0.000031 0.999969 /end CHARACTERISTIC
/begin CHARACTERISTIC mrwFG3_GF "FGR PT1-Gedaechtnisfaktor 3. Gang" VALUE 0xFA114 MSA15_FW3 0 GF 0.000031 0.999969 /end CHARACTERISTIC
/begin CHARACTERISTIC mrwFG4_GF "FGR PT1-Gedaechtnisfaktor 4. Gang" VALUE 0xFA116 MSA15_FW3 0 GF 0.000031 0.999969 /end CHARACTERISTIC
/begin CHARACTERISTIC mrwFG5_GF "FGR PT1-Gedaechtnisfaktor 5. Gang" VALUE 0xFA118 MSA15_FW3 0 GF 0.000031 0.999969 /end CHARACTERISTIC
/begin CHARACTERISTIC mrwFGR_BES "#SSD Beschleunigungsschwelle Verzoegerungsueberwachung" VALUE 0xFA064 MSA15_FW3 0 B 0.000000 10.002980 EXTENDED_LIMITS -10.850690 10.765920 /end CHARACTERISTIC
/begin CHARACTERISTIC mrwFGR_IOF "Offset Sollwert I_Anteil" VALUE 0xFA074 MSA15_FW3 0 V 0.000000 5.000000 EXTENDED_LIMITS 0.000000 327.670000 /end CHARACTERISTIC
/begin CHARACTERISTIC mrwFGR_IRE "% Initmenge in PT1, 100-x in I-Anteil" VALUE 0xFA08E MSA15_FW4 0 PROZ 0.000000 100.000000 EXTENDED_LIMITS -327.680000 327.670000 /end CHARACTERISTIC
/begin CHARACTERISTIC mrwFGR_IRM "Minimalmenge für I-Anteil" VALUE 0xFA08C MSA15_FW4 0 M_E -100.000000 0.000000 EXTENDED_LIMITS -327.680000 327.670000 /end CHARACTERISTIC
/begin CHARACTERISTIC mrwFGR_MFL "#SSD MFL-Toggle-Zeit" VALUE 0xFA06A MSA15_FW3 0 ZEIT_ST 0.000000 655350000.000000 /end CHARACTERISTIC
/begin CHARACTERISTIC mrwFGR_MMX "Maxmenge FGR" VALUE 0xFA072 MSA15_FW3 0 M_E 0.000000 100.000000 EXTENDED_LIMITS -327.680000 327.670000 /end CHARACTERISTIC
/begin CHARACTERISTIC mrwFGR_RA1 "Rampensteigung bis mrwFGR_RAM Ausrampe" VALUE 0xFA078 MSA15_FW3 0 dM_E_dZ 0.000000 3000.000000 EXTENDED_LIMITS -16384.000000 16383.500000 /end CHARACTERISTIC
/begin CHARACTERISTIC mrwFGR_RA2 "Rampensteigung ab mrwFGR_RAM Ausrampe" VALUE 0xFA07A MSA15_FW3 0 dM_E_dZ 0.000000 3000.000000 EXTENDED_LIMITS -16384.000000 16383.500000 /end CHARACTERISTIC
/begin CHARACTERISTIC mrwFGR_RAM "Mengenschwelle bei FGR Ausrampe zur Rampenumschaltung" VALUE 0xFA080 MSA15_FW3 0 M_E 0.000000 100.000000 EXTENDED_LIMITS -327.680000 327.670000 /end CHARACTERISTIC
/begin CHARACTERISTIC mrwFGR_RB1 "Rampensteigung bis mrwFGR_RBM Bremsrampe" VALUE 0xFA07C MSA15_FW3 0 dM_E_dZ 0.000000 3000.000000 EXTENDED_LIMITS -16384.000000 16383.500000 /end CHARACTERISTIC
/begin CHARACTERISTIC mrwFGR_RB2 "Rampensteigung ab mrwFGR_RBM Bremsrampe" VALUE 0xFA07E MSA15_FW3 0 dM_E_dZ 0.000000 3000.000000 EXTENDED_LIMITS -16384.000000 16383.500000 /end CHARACTERISTIC
/begin CHARACTERISTIC mrwFGR_RBM "Mengenschwelle bei FGR Bremsrampe zur Rampenumschaltung" VALUE 0xFA082 MSA15_FW3 0 M_E 0.000000 100.000000 EXTENDED_LIMITS -327.680000 327.670000 /end CHARACTERISTIC
/begin CHARACTERISTIC mrwFGR_RST "Rampensteigung Uebergangsrampe P-Regler" VALUE 0xFA076 MSA15_FW3 0 dM_E_dZ 0.000000 300.000000 EXTENDED_LIMITS -16384.000000 16383.500000 /end CHARACTERISTIC
/begin CHARACTERISTIC mrwFGR_SBE "Beschleunigungsschwelle fuer Setzwertkorrektur" VALUE 0xFA08A MSA15_FW3 0 B 0.000000 1.017253 EXTENDED_LIMITS -10.850690 10.765920 /end CHARACTERISTIC
/begin CHARACTERISTIC mrwFGR_SET "Maximale Setzwertkorrektur" VALUE 0xFA086 MSA15_FW3 0 V 0.000000 3.000000 EXTENDED_LIMITS 0.000000 327.670000 /end CHARACTERISTIC
/begin CHARACTERISTIC mrwFGR_STT "Maximale Zeit fuer Setzwertkorrektur" VALUE 0xFA088 MSA15_FW3 0 ZEIT_ST 0.000000 10000000.000000 EXTENDED_LIMITS 0.000000 655350000.000000 /end CHARACTERISTIC
/begin CHARACTERISTIC mrwFGR_TIC "Max. # TIPs" VALUE 0xFA06E MSA15_FW3 0 DEZ_DW 0.000000 20.000000 EXTENDED_LIMITS -32768.000000 32767.000000 /end CHARACTERISTIC
/begin CHARACTERISTIC mrwFGR_TIP "Zeitschwelle TIP/Dauerbetaetigung" VALUE 0xFA06C MSA15_FW3 0 ZEIT_ST 0.000000 655350000.000000 /end CHARACTERISTIC
/begin CHARACTERISTIC mrwFGR_TIS "Stufung 1km/h fuer TIP" VALUE 0xFA070 MSA15_FW3 0 V 0.000000 10.000000 EXTENDED_LIMITS 0.000000 327.670000 /end CHARACTERISTIC
/begin CHARACTERISTIC mrwFGR_UEB "Ueberschieben-Zeitdauer" VALUE 0xFA066 MSA15_FW3 0 ZEIT_ST 0.000000 655350000.000000 /end CHARACTERISTIC
/begin CHARACTERISTIC mrwFGR_VMN "#SSD VMIN-Schwelle, untere Regelgeschwindigkeit" VALUE 0xFA05C MSA15_FW3 0 V 0.000000 50.000000 EXTENDED_LIMITS 0.000000 327.670000 /end CHARACTERISTIC
/begin CHARACTERISTIC mrwFGR_VMR "#SSD VMIN-Schwelle, untere Einschaltgeschwindigkeit" VALUE 0xFA05E MSA15_FW3 0 V 0.000000 50.000000 EXTENDED_LIMITS 0.000000 327.670000 /end CHARACTERISTIC
/begin CHARACTERISTIC mrwFGR_VMX "VMAX-Schwelle" VALUE 0xFA060 MSA15_FW3 0 V 0.000000 300.000000 EXTENDED_LIMITS 0.000000 327.670000 /end CHARACTERISTIC
/begin CHARACTERISTIC mrwFGR_VNM "#SSD VzuN Max.Abweichung" VALUE 0xFA05A MSA15_FW3 0 V_N 0.000000 1.270000 EXTENDED_LIMITS -1.280000 1.279961 /end CHARACTERISTIC
/begin CHARACTERISTIC mrwFGR_VUE "Ueberschieben-V-Schwelle" VALUE 0xFA068 MSA15_FW3 0 V 0.000000 50.000000 EXTENDED_LIMITS 0.000000 327.670000 /end CHARACTERISTIC
/begin CHARACTERISTIC mrwFGR_VUM "Umschaltgeschwindigkeit Beschleunigung->Geregelte Fahrt" VALUE 0xFA084 MSA15_FW3 0 V 0.000000 2.000000 EXTENDED_LIMITS 0.000000 327.670000 /end CHARACTERISTIC
/begin CHARACTERISTIC mrwFGR_VZG "Zeitschwelle Verzoegerungsueberwachung" VALUE 0xFA062 MSA15_FW3 0 ZEIT_ST 0.000000 655350000.000000 /end CHARACTERISTIC
/begin CHARACTERISTIC mrwFI2_FEN "FGR Fenster Kleinsignal I-Regler Halten 2. Gang" VALUE 0xFA0C4 MSA15_FW3 0 V 0.000000 300.000000 EXTENDED_LIMITS 0.000000 327.670000 /end CHARACTERISTIC
/begin CHARACTERISTIC mrwFI2_NEG "FGR I-Verstaerkung neg. Gross-S. Halten 2. Gang" VALUE 0xFA0C8 MSA15_FW3 0 FGR_KI 0.000000 9.999847 EXTENDED_LIMITS 0.000000 24.999240 /end CHARACTERISTIC
/begin CHARACTERISTIC mrwFI2_POS "FGR I-Verstaerkung pos. Gross-S. Halten 2. Gang" VALUE 0xFA0CA MSA15_FW3 0 FGR_KI 0.000000 9.999847 EXTENDED_LIMITS 0.000000 24.999240 /end CHARACTERISTIC
/begin CHARACTERISTIC mrwFI2_SIG "FGR I-Verstaerkung Kleinsignal   Halten 2. Gang" VALUE 0xFA0C6 MSA15_FW3 0 FGR_KI 0.000000 9.999847 EXTENDED_LIMITS 0.000000 24.999240 /end CHARACTERISTIC
/begin CHARACTERISTIC mrwFI3_FEN "FGR Fenster Kleinsignal I-Regler Halten 3. Gang" VALUE 0xFA0D8 MSA15_FW3 0 V 0.000000 300.000000 EXTENDED_LIMITS 0.000000 327.670000 /end CHARACTERISTIC
/begin CHARACTERISTIC mrwFI3_NEG "FGR I-Verstaerkung neg. Gross-S. Halten 3. Gang" VALUE 0xFA0DC MSA15_FW3 0 FGR_KI 0.000000 9.999847 EXTENDED_LIMITS 0.000000 24.999240 /end CHARACTERISTIC
/begin CHARACTERISTIC mrwFI3_POS "FGR I-Verstaerkung pos. Gross-S. Halten 3. Gang" VALUE 0xFA0DE MSA15_FW3 0 FGR_KI 0.000000 9.999847 EXTENDED_LIMITS 0.000000 24.999240 /end CHARACTERISTIC
/begin CHARACTERISTIC mrwFI3_SIG "FGR I-Verstaerkung Kleinsignal   Halten 3. Gang" VALUE 0xFA0DA MSA15_FW3 0 FGR_KI 0.000000 9.999847 EXTENDED_LIMITS 0.000000 24.999240 /end CHARACTERISTIC
/begin CHARACTERISTIC mrwFI4_FEN "FGR Fenster Kleinsignal I-Regler Halten 4. Gang" VALUE 0xFA0EC MSA15_FW3 0 V 0.000000 300.000000 EXTENDED_LIMITS 0.000000 327.670000 /end CHARACTERISTIC
/begin CHARACTERISTIC mrwFI4_NEG "FGR I-Verstaerkung neg. Gross-S. Halten 4. Gang" VALUE 0xFA0F0 MSA15_FW3 0 FGR_KI 0.000000 9.999847 EXTENDED_LIMITS 0.000000 24.999240 /end CHARACTERISTIC
/begin CHARACTERISTIC mrwFI4_POS "FGR I-Verstaerkung pos. Gross-S. Halten 4. Gang" VALUE 0xFA0F2 MSA15_FW3 0 FGR_KI 0.000000 9.999847 EXTENDED_LIMITS 0.000000 24.999240 /end CHARACTERISTIC
/begin CHARACTERISTIC mrwFI4_SIG "FGR I-Verstaerkung Kleinsignal   Halten 4. Gang" VALUE 0xFA0EE MSA15_FW3 0 FGR_KI 0.000000 9.999847 EXTENDED_LIMITS 0.000000 24.999240 /end CHARACTERISTIC
/begin CHARACTERISTIC mrwFI5_FEN "FGR Fenster Kleinsignal I-Regler Halten 5. Gang" VALUE 0xFA100 MSA15_FW3 0 V 0.000000 300.000000 EXTENDED_LIMITS 0.000000 327.670000 /end CHARACTERISTIC
/begin CHARACTERISTIC mrwFI5_NEG "FGR I-Verstaerkung neg. Gross-S. Halten 5. Gang" VALUE 0xFA104 MSA15_FW3 0 FGR_KI 0.000000 9.999847 EXTENDED_LIMITS 0.000000 24.999240 /end CHARACTERISTIC
/begin CHARACTERISTIC mrwFI5_POS "FGR I-Verstaerkung pos. Gross-S. Halten 5. Gang" VALUE 0xFA106 MSA15_FW3 0 FGR_KI 0.000000 9.999847 EXTENDED_LIMITS 0.000000 24.999240 /end CHARACTERISTIC
/begin CHARACTERISTIC mrwFI5_SIG "FGR I-Verstaerkung Kleinsignal   Halten 5. Gang" VALUE 0xFA102 MSA15_FW3 0 FGR_KI 0.000000 9.999847 EXTENDED_LIMITS 0.000000 24.999240 /end CHARACTERISTIC
/begin CHARACTERISTIC mrwFKupNeg "ARD-FF: Umschaltschwelle neg. Param. Kupplung" VALUE 0xF3A5A MSA15_FW4 0 M_E -100.000000 100.000000 EXTENDED_LIMITS -327.680000 327.670000 /end CHARACTERISTIC
/begin CHARACTERISTIC mrwFKupPos "ARD-FF: Umschaltschwelle pos. Param. Kupplung" VALUE 0xF3A58 MSA15_FW4 0 M_E -100.000000 100.000000 EXTENDED_LIMITS -327.680000 327.670000 /end CHARACTERISTIC
/begin CHARACTERISTIC mrwFMggNeg "ARD-FF: Umschaltschwelle neg. Param. mittlere GG" VALUE 0xF3A62 MSA15_FW4 0 M_E -100.000000 100.000000 EXTENDED_LIMITS -327.680000 327.670000 /end CHARACTERISTIC
/begin CHARACTERISTIC mrwFMggPos "ARD-FF: Umschaltschwelle pos. Param. mittlere GG" VALUE 0xF3A60 MSA15_FW4 0 M_E -100.000000 100.000000 EXTENDED_LIMITS -327.680000 327.670000 /end CHARACTERISTIC
/begin CHARACTERISTIC mrwFNCAN_a "ARD-FF quadrat. GF, neg. Sig.: ext. Mengeneingriff" VALUE 0xF3AA2 MSA15_FW4 0 DEZ_DW -32768.000000 32767.000000 /end CHARACTERISTIC
/begin CHARACTERISTIC mrwFNCAN_b "ARD-FF linearer GF, neg. Sig.: ext. Mengeneingriff" VALUE 0xF3AA4 MSA15_FW4 0 DEZ_DW -32768.000000 32767.000000 /end CHARACTERISTIC
/begin CHARACTERISTIC mrwFNCAN_c "ARD-FF  konst.  GF, neg. Sig.: ext. Mengeneingriff" VALUE 0xF3AA6 MSA15_FW4 0 DEZ_DW -32768.000000 32767.000000 /end CHARACTERISTIC
/begin CHARACTERISTIC mrwFNKUP_a "ARD-FF quadrat. GF, neg. Sig.: Kupplung betaetigt" VALUE 0xF3A72 MSA15_FW4 0 DEZ_DW -32768.000000 32767.000000 /end CHARACTERISTIC
/begin CHARACTERISTIC mrwFNKUP_b "ARD-FF linearer GF, neg. Sig.: Kupplung betaetigt" VALUE 0xF3A74 MSA15_FW4 0 DEZ_DW -32768.000000 32767.000000 /end CHARACTERISTIC
/begin CHARACTERISTIC mrwFNKUP_c "ARD-FF  konst.  GF, neg. Sig.: Kupplung betaetigt" VALUE 0xF3A76 MSA15_FW4 0 DEZ_DW -32768.000000 32767.000000 /end CHARACTERISTIC
/begin CHARACTERISTIC mrwFNMGG_a "ARD-FF quadrat. GF, neg. Sig.: mittl. Getriebegruppe" VALUE 0xF3A8A MSA15_FW4 0 DEZ_DW -32768.000000 32767.000000 /end CHARACTERISTIC
/begin CHARACTERISTIC mrwFNMGG_b "ARD-FF linearer GF, neg. Sig.: mittl. Getriebegruppe" VALUE 0xF3A8C MSA15_FW4 0 DEZ_DW -32768.000000 32767.000000 /end CHARACTERISTIC
/begin CHARACTERISTIC mrwFNMGG_c "ARD-FF  konst.  GF, neg. Sig.: mittl. Getriebegruppe" VALUE 0xF3A8E MSA15_FW4 0 DEZ_DW -32768.000000 32767.000000 /end CHARACTERISTIC
/begin CHARACTERISTIC mrwFNOGG_a "ARD-FF quadrat. GF, neg. Sig.: obere Getriebegruppe" VALUE 0xF3A7E MSA15_FW4 0 DEZ_DW -32768.000000 32767.000000 /end CHARACTERISTIC
/begin CHARACTERISTIC mrwFNOGG_b "ARD-FF linearer GF, neg. Sig.: obere Getriebegruppe" VALUE 0xF3A80 MSA15_FW4 0 DEZ_DW -32768.000000 32767.000000 /end CHARACTERISTIC
/begin CHARACTERISTIC mrwFNOGG_c "ARD-FF  konst.  GF, neg. Sig.: obere Getriebegruppe" VALUE 0xF3A82 MSA15_FW4 0 DEZ_DW -32768.000000 32767.000000 /end CHARACTERISTIC
/begin CHARACTERISTIC mrwFNUGG_a "ARD-FF quadrat. GF, neg. Sig.: untere Getriebegruppe" VALUE 0xF3A96 MSA15_FW4 0 DEZ_DW -32768.000000 32767.000000 /end CHARACTERISTIC
/begin CHARACTERISTIC mrwFNUGG_b "ARD-FF linearer GF, neg. Sig.: untere Getriebegruppe" VALUE 0xF3A98 MSA15_FW4 0 DEZ_DW -32768.000000 32767.000000 /end CHARACTERISTIC
/begin CHARACTERISTIC mrwFNUGG_c "ARD-FF  konst.  GF, neg. Sig.: untere Getriebegruppe" VALUE 0xF3A9A MSA15_FW4 0 DEZ_DW -32768.000000 32767.000000 /end CHARACTERISTIC
/begin CHARACTERISTIC mrwFOggNeg "ARD-FF: Umschaltschwelle neg. Param. obere GG" VALUE 0xF3A5E MSA15_FW4 0 M_E -100.000000 100.000000 EXTENDED_LIMITS -327.680000 327.670000 /end CHARACTERISTIC
/begin CHARACTERISTIC mrwFOggPos "ARD-FF: Umschaltschwelle pos. Param. obere GG" VALUE 0xF3A5C MSA15_FW4 0 M_E -100.000000 100.000000 EXTENDED_LIMITS -327.680000 327.670000 /end CHARACTERISTIC
/begin CHARACTERISTIC mrwFP2_FEN "FGR Fenster Kleinsignal P-Regler Halten 2. Gang" VALUE 0xFA0BA MSA15_FW3 0 V 0.000000 300.000000 EXTENDED_LIMITS 0.000000 327.670000 /end CHARACTERISTIC
/begin CHARACTERISTIC mrwFP2_NEG "FGR P-Verstaerkung neg. Gross-S. Halten 2. Gang" VALUE 0xFA0BE MSA15_FW3 0 FGR_KP 0.000000 10.000000 EXTENDED_LIMITS 0.000000 15.999510 /end CHARACTERISTIC
/begin CHARACTERISTIC mrwFP2_POS "FGR P-Verstaerkung pos. Gross-S. Halten 2. Gang" VALUE 0xFA0C0 MSA15_FW3 0 FGR_KP 0.000000 10.000000 EXTENDED_LIMITS 0.000000 15.999510 /end CHARACTERISTIC
/begin CHARACTERISTIC mrwFP2_SIG "FGR P-Verstaerkung Kleinsignal   Halten 2. Gang" VALUE 0xFA0BC MSA15_FW3 0 FGR_KP 0.000000 10.000000 EXTENDED_LIMITS 0.000000 15.999510 /end CHARACTERISTIC
/begin CHARACTERISTIC mrwFP3_FEN "FGR Fenster Kleinsignal P-Regler Halten 3. Gang" VALUE 0xFA0CE MSA15_FW3 0 V 0.000000 300.000000 EXTENDED_LIMITS 0.000000 327.670000 /end CHARACTERISTIC
/begin CHARACTERISTIC mrwFP3_NEG "FGR P-Verstaerkung neg. Gross-S. Halten 3. Gang" VALUE 0xFA0D2 MSA15_FW3 0 FGR_KP 0.000000 10.000000 EXTENDED_LIMITS 0.000000 15.999510 /end CHARACTERISTIC
/begin CHARACTERISTIC mrwFP3_POS "FGR P-Verstaerkung pos. Gross-S. Halten 3. Gang" VALUE 0xFA0D4 MSA15_FW3 0 FGR_KP 0.000000 10.000000 EXTENDED_LIMITS 0.000000 15.999510 /end CHARACTERISTIC
/begin CHARACTERISTIC mrwFP3_SIG "FGR P-Verstaerkung Kleinsignal   Halten 3. Gang" VALUE 0xFA0D0 MSA15_FW3 0 FGR_KP 0.000000 10.000000 EXTENDED_LIMITS 0.000000 15.999510 /end CHARACTERISTIC
/begin CHARACTERISTIC mrwFP4_FEN "FGR Fenster Kleinsignal P-Regler Halten 4. Gang" VALUE 0xFA0E2 MSA15_FW3 0 V 0.000000 300.000000 EXTENDED_LIMITS 0.000000 327.670000 /end CHARACTERISTIC
/begin CHARACTERISTIC mrwFP4_NEG "FGR P-Verstaerkung neg. Gross-S. Halten 4. Gang" VALUE 0xFA0E6 MSA15_FW3 0 FGR_KP 0.000000 10.000000 EXTENDED_LIMITS 0.000000 15.999510 /end CHARACTERISTIC
/begin CHARACTERISTIC mrwFP4_POS "FGR P-Verstaerkung pos. Gross-S. Halten 4. Gang" VALUE 0xFA0E8 MSA15_FW3 0 FGR_KP 0.000000 10.000000 EXTENDED_LIMITS 0.000000 15.999510 /end CHARACTERISTIC
/begin CHARACTERISTIC mrwFP4_SIG "FGR P-Verstaerkung Kleinsignal   Halten 4. Gang" VALUE 0xFA0E4 MSA15_FW3 0 FGR_KP 0.000000 10.000000 EXTENDED_LIMITS 0.000000 15.999510 /end CHARACTERISTIC
/begin CHARACTERISTIC mrwFP5_FEN "FGR Fenster Kleinsignal P-Regler Halten 5. Gang" VALUE 0xFA0F6 MSA15_FW3 0 V 0.000000 300.000000 EXTENDED_LIMITS 0.000000 327.670000 /end CHARACTERISTIC
/begin CHARACTERISTIC mrwFP5_NEG "FGR P-Verstaerkung neg. Gross-S. Halten 5. Gang" VALUE 0xFA0FA MSA15_FW3 0 FGR_KP 0.000000 10.000000 EXTENDED_LIMITS 0.000000 15.999510 /end CHARACTERISTIC
/begin CHARACTERISTIC mrwFP5_POS "FGR P-Verstaerkung pos. Gross-S. Halten 5. Gang" VALUE 0xFA0FC MSA15_FW3 0 FGR_KP 0.000000 10.000000 EXTENDED_LIMITS 0.000000 15.999510 /end CHARACTERISTIC
/begin CHARACTERISTIC mrwFP5_SIG "FGR P-Verstaerkung Kleinsignal   Halten 5. Gang" VALUE 0xFA0F8 MSA15_FW3 0 FGR_KP 0.000000 10.000000 EXTENDED_LIMITS 0.000000 15.999510 /end CHARACTERISTIC
/begin CHARACTERISTIC mrwFPCAN_a "ARD-FF quadrat. GF, pos. Sig.: ext. Mengeneingriff" VALUE 0xF3A9C MSA15_FW4 0 DEZ_DW -32768.000000 32767.000000 /end CHARACTERISTIC
/begin CHARACTERISTIC mrwFPCAN_b "ARD-FF linearer GF, pos. Sig.: ext. Mengeneingriff" VALUE 0xF3A9E MSA15_FW4 0 DEZ_DW -32768.000000 32767.000000 /end CHARACTERISTIC
/begin CHARACTERISTIC mrwFPCAN_c "ARD-FF  konst.  GF, pos. Sig.: ext. Mengeneingriff" VALUE 0xF3AA0 MSA15_FW4 0 DEZ_DW -32768.000000 32767.000000 /end CHARACTERISTIC
/begin CHARACTERISTIC mrwFPKUP_a "ARD-FF quadrat. GF, pos. Sig.: Kupplung betaetigt" VALUE 0xF3A6C MSA15_FW4 0 DEZ_DW -32768.000000 32767.000000 /end CHARACTERISTIC
/begin CHARACTERISTIC mrwFPKUP_b "ARD-FF linearer GF, pos. Sig.: Kupplung betaetigt" VALUE 0xF3A6E MSA15_FW4 0 DEZ_DW -32768.000000 32767.000000 /end CHARACTERISTIC
/begin CHARACTERISTIC mrwFPKUP_c "ARD-FF  konst.  GF, pos. Sig.: Kupplung betaetigt" VALUE 0xF3A70 MSA15_FW4 0 DEZ_DW -32768.000000 32767.000000 /end CHARACTERISTIC
/begin CHARACTERISTIC mrwFPMGG_a "ARD-FF quadrat. GF, pos. Sig.: mittl. Getriebegruppe" VALUE 0xF3A84 MSA15_FW4 0 DEZ_DW -32768.000000 32767.000000 /end CHARACTERISTIC
/begin CHARACTERISTIC mrwFPMGG_b "ARD-FF linearer GF, pos. Sig.: mittl. Getriebegruppe" VALUE 0xF3A86 MSA15_FW4 0 DEZ_DW -32768.000000 32767.000000 /end CHARACTERISTIC
/begin CHARACTERISTIC mrwFPMGG_c "ARD-FF  konst.  GF, pos. Sig.: mittl. Getriebegruppe" VALUE 0xF3A88 MSA15_FW4 0 DEZ_DW -32768.000000 32767.000000 /end CHARACTERISTIC
/begin CHARACTERISTIC mrwFPOGG_a "ARD-FF quadrat. GF, pos. Sig.: obere Getriebegruppe" VALUE 0xF3A78 MSA15_FW4 0 DEZ_DW -32768.000000 32767.000000 /end CHARACTERISTIC
/begin CHARACTERISTIC mrwFPOGG_b "ARD-FF linearer GF, pos. Sig.: obere Getriebegruppe" VALUE 0xF3A7A MSA15_FW4 0 DEZ_DW -32768.000000 32767.000000 /end CHARACTERISTIC
/begin CHARACTERISTIC mrwFPOGG_c "ARD-FF  konst.  GF, pos. Sig.: obere Getriebegruppe" VALUE 0xF3A7C MSA15_FW4 0 DEZ_DW -32768.000000 32767.000000 /end CHARACTERISTIC
/begin CHARACTERISTIC mrwFPT_VE2 "Verstaerkung PT1 Gang 2" VALUE 0xFA10A MSA15_FW3 0 FGR_KP 0.000000 10.000000 EXTENDED_LIMITS 0.000000 15.999510 /end CHARACTERISTIC
/begin CHARACTERISTIC mrwFPT_VE3 "Verstaerkung PT1 Gang 3" VALUE 0xFA10C MSA15_FW3 0 FGR_KP 0.000000 10.000000 EXTENDED_LIMITS 0.000000 15.999510 /end CHARACTERISTIC
/begin CHARACTERISTIC mrwFPT_VE4 "Verstaerkung PT1 Gang 4" VALUE 0xFA10E MSA15_FW3 0 FGR_KP 0.000000 10.000000 EXTENDED_LIMITS 0.000000 15.999510 /end CHARACTERISTIC
/begin CHARACTERISTIC mrwFPT_VE5 "Verstaerkung PT1 Gang 5" VALUE 0xFA110 MSA15_FW3 0 FGR_KP 0.000000 10.000000 EXTENDED_LIMITS 0.000000 15.999510 /end CHARACTERISTIC
/begin CHARACTERISTIC mrwFPUGG_a "ARD-FF quadrat. GF, pos. Sig.: untere Getriebegruppe" VALUE 0xF3A90 MSA15_FW4 0 DEZ_DW -32768.000000 32767.000000 /end CHARACTERISTIC
/begin CHARACTERISTIC mrwFPUGG_b "ARD-FF linearer GF, pos. Sig.: untere Getriebegruppe" VALUE 0xF3A92 MSA15_FW4 0 DEZ_DW -32768.000000 32767.000000 /end CHARACTERISTIC
/begin CHARACTERISTIC mrwFPUGG_c "ARD-FF  konst.  GF, pos. Sig.: untere Getriebegruppe" VALUE 0xF3A94 MSA15_FW4 0 DEZ_DW -32768.000000 32767.000000 /end CHARACTERISTIC
/begin CHARACTERISTIC mrwFRAB_KL "Sollwertrampensteigung S/B  Tip+ = F(Vist)" CURVE 0xFA152 MSA15_KL118 0 B_VINC 0.000271 1.499837
 /begin AXIS_DESCR STD_AXIS fgmFGAKT V 3 0.000000 300.000000 EXTENDED_LIMITS 0.000000 327.670000 /end AXIS_DESCR
 EXTENDED_LIMITS -17.778050 17.776960 /end CHARACTERISTIC
/begin CHARACTERISTIC mrwFRAF_KL "Rampenabflachungskennlinie WA+  = f(dV)" CURVE 0xFA12E MSA15_KL118 0 PROZ -100.000000 100.000000
 /begin AXIS_DESCR STD_AXIS mroFVSODIF V_DIFF 4 -10.000000 10.000000 EXTENDED_LIMITS -327.680000 327.670000 /end AXIS_DESCR
 EXTENDED_LIMITS -327.680000 327.670000 /end CHARACTERISTIC
/begin CHARACTERISTIC mrwFRAU_KL "Rampenueberhoehungskl WA+/S/B/Tip+  = f(Zeit)" CURVE 0xFA11A MSA15_KL112 0 PROZ 0.000000 300.000000
 /begin AXIS_DESCR STD_AXIS mroFUETIM ZEIT_ST 4 0.000000 5000000.000000 EXTENDED_LIMITS 0.000000 655350000.000000 /end AXIS_DESCR
 EXTENDED_LIMITS -327.680000 327.670000 /end CHARACTERISTIC
/begin CHARACTERISTIC mrwFRAV_KL "Sollwertrampensteigung S/V Tip- WA- = F(Vist)" CURVE 0xFA162 MSA15_KL118 0 B_VINC 0.000271 1.499837
 /begin AXIS_DESCR STD_AXIS fgmFGAKT V 3 0.000000 300.000000 EXTENDED_LIMITS 0.000000 327.670000 /end AXIS_DESCR
 EXTENDED_LIMITS -17.778050 17.776960 /end CHARACTERISTIC
/begin CHARACTERISTIC mrwFRAW_KL "Sollwertrampensteigung WA+ = F(Vist)" CURVE 0xFA142 MSA15_KL118 0 B_VINC 0.000271 1.499837
 /begin AXIS_DESCR STD_AXIS fgmFGAKT V 3 0.000000 300.000000 EXTENDED_LIMITS 0.000000 327.670000 /end AXIS_DESCR
 EXTENDED_LIMITS -17.778050 17.776960 /end CHARACTERISTIC
/begin CHARACTERISTIC mrwFST_T1 "Entprellzeit fuer Tankfuellstand (Leererkennung)" VALUE 0xFB16E MSA15_FW3 0 ZEIT_HP 0.000000 1310700000.000000 /end CHARACTERISTIC
/begin CHARACTERISTIC mrwFST_T2 "Entprellzeit fuer Tankfuellstand (Nichtleererkennung)" VALUE 0xFB170 MSA15_FW3 0 ZEIT_HP 0.000000 1310700000.000000 /end CHARACTERISTIC
/begin CHARACTERISTIC mrwFUggNeg "ARD-FF: Umschaltschwelle neg. Param. untere GG" VALUE 0xF3A66 MSA15_FW4 0 M_E -100.000000 100.000000 EXTENDED_LIMITS -327.680000 327.670000 /end CHARACTERISTIC
/begin CHARACTERISTIC mrwFUggPos "ARD-FF: Umschaltschwelle pos. Param. untere GG" VALUE 0xF3A64 MSA15_FW4 0 M_E -100.000000 100.000000 EXTENDED_LIMITS -327.680000 327.670000 /end CHARACTERISTIC
/begin CHARACTERISTIC mrwFVHO_KF "M_E Fahrverhalten-KF bei oberer v_Nenn M_E = f( N, PWGfi )" MAP 0xF9E20 MSA15_KF382 0 MM3 0.000000 100.000000
 /begin AXIS_DESCR STD_AXIS dzmNmit N 12 0.000000 6000.000000 EXTENDED_LIMITS 0.000000 32767.000000 /end AXIS_DESCR
 /begin AXIS_DESCR STD_AXIS mrmPWGfi PROZ_S 8 0.000000 100.000000 EXTENDED_LIMITS -327.680000 327.670000 /end AXIS_DESCR
 EXTENDED_LIMITS -327.680000 327.670000 /end CHARACTERISTIC
/begin CHARACTERISTIC mrwFVHU_KF "#SSD M_E Fahrverhalten-KF bei unterer v_Nenn M_E = f( N, PWGfi )" MAP 0xF9D30 MSA15_KF382 0 MM3 0.000000 100.000000
 /begin AXIS_DESCR STD_AXIS dzmNmit N 12 0.000000 6000.000000 EXTENDED_LIMITS 0.000000 32767.000000 /end AXIS_DESCR
 /begin AXIS_DESCR STD_AXIS mrmPWGfi PROZ_S 8 0.000000 100.000000 EXTENDED_LIMITS -327.680000 327.670000 /end AXIS_DESCR
 EXTENDED_LIMITS -327.680000 327.670000 /end CHARACTERISTIC
/begin CHARACTERISTIC mrwFVH_VO "Obere Nenngeschwindigkeit f’r Fahrverhaltenkennfelder" VALUE 0xF9F12 MSA15_FW4 0 V 0.000000 300.000000 EXTENDED_LIMITS 0.000000 327.670000 /end CHARACTERISTIC
/begin CHARACTERISTIC mrwFVH_VU "Untere Nenngeschwindigkeit f’r Fahrverhaltenkennfelder" VALUE 0xF9F10 MSA15_FW4 0 V 0.000000 300.000000 EXTENDED_LIMITS 0.000000 327.670000 /end CHARACTERISTIC
/begin CHARACTERISTIC mrwFVLR_KF "#SSD M_E Fahrverhalten-KF bei Low Range M_E = f( N, PWGfi )" MAP 0xF9C40 MSA15_KF382 0 MM3 0.000000 100.000000
 /begin AXIS_DESCR STD_AXIS dzmNmit N 12 0.000000 6000.000000 EXTENDED_LIMITS 0.000000 32767.000000 /end AXIS_DESCR
 /begin AXIS_DESCR STD_AXIS mrmPWGfi PROZ_S 8 0.000000 100.000000 EXTENDED_LIMITS -327.680000 327.670000 /end AXIS_DESCR
 EXTENDED_LIMITS -327.680000 327.670000 /end CHARACTERISTIC
/begin CHARACTERISTIC mrwFVOR_KF "Kennfeld Vorsteuermenge = f ( Vist, Gang )" MAP 0xFA172 MSA15_KF357 0 M_E 0.000000 100.000000
 /begin AXIS_DESCR STD_AXIS fgmFGAKT V 6 0.000000 300.000000 EXTENDED_LIMITS 0.000000 327.670000 /end AXIS_DESCR
 /begin AXIS_DESCR STD_AXIS mroFGANG DEZ_DW_U 4 2.000000 5.000000 EXTENDED_LIMITS 0.000000 65535.000000 /end AXIS_DESCR
 EXTENDED_LIMITS -327.680000 327.670000 /end CHARACTERISTIC
/begin RECORD_LAYOUT MSA15_KF357 SRC_ADDR_X 1 UWORD NO_AXIS_PTS_X 2 UWORD AXIS_PTS_X 3 SWORD INDEX_INCR DIRECT SRC_ADDR_Y 4 UWORD NO_AXIS_PTS_Y 5 UWORD AXIS_PTS_Y 6 UWORD INDEX_INCR DIRECT FNC_VALUES 7 UWORD COLUMN_DIR DIRECT /end RECORD_LAYOUT
/begin CHARACTERISTIC mrwFVZUNKL "#SSD Gangerkennungskennlinie Gang = f(VzuN)" CURVE 0xFA1BE MSA15_KL117 0 DEZ_DW_U 0.000000 5.000000
 /begin AXIS_DESCR STD_AXIS fgm_VzuN V_N 16 0.000000 0.100000 EXTENDED_LIMITS -1.280000 1.279961 /end AXIS_DESCR
 EXTENDED_LIMITS 0.000000 65535.000000 /end CHARACTERISTIC
/begin CHARACTERISTIC mrwFV_TIPM "Ueberhoehung Sollwertrampe bei TIP-" VALUE 0xFA090 MSA15_FW4 0 PROZ 0.000000 300.000000 EXTENDED_LIMITS -327.680000 327.670000 /end CHARACTERISTIC
/begin CHARACTERISTIC mrwGANG_2 "v/n-Scwelle 1. - 2. Gang" VALUE 0xF3874 MSA15_FW4 0 V_N 0.000000 0.100000 EXTENDED_LIMITS -1.280000 1.279961 /end CHARACTERISTIC
/begin CHARACTERISTIC mrwGANG_3 "v/n-Schwelle 2. - 3. Gang" VALUE 0xF3876 MSA15_FW4 0 V_N 0.000000 0.100000 EXTENDED_LIMITS -1.280000 1.279961 /end CHARACTERISTIC
/begin CHARACTERISTIC mrwGANG_4 "v/n-Schwelle 3. - 4. Gang" VALUE 0xF3878 MSA15_FW4 0 V_N 0.000000 0.100000 EXTENDED_LIMITS -1.280000 1.279961 /end CHARACTERISTIC
/begin CHARACTERISTIC mrwGANG_5 "v/n-Schwelle 4. - 5. Gang" VALUE 0xF387A MSA15_FW4 0 V_N 0.000000 0.100000 EXTENDED_LIMITS -1.280000 1.279961 /end CHARACTERISTIC
/begin CHARACTERISTIC mrwGNG_MGG "Gangschwelle fuer die mittlere Getriebegruppe" VALUE 0xF3A56 MSA15_FW2 0 DEZ_DB 1.000000 5.000000 EXTENDED_LIMITS -128.000000 127.000000 /end CHARACTERISTIC
/begin CHARACTERISTIC mrwGNG_OGG "Gangschwelle fuer die obere Getriebegruppe" VALUE 0xF3A57 MSA15_FW2 0 DEZ_DB 2.000000 6.000000 EXTENDED_LIMITS -128.000000 127.000000 /end CHARACTERISTIC
/begin CHARACTERISTIC mrwGNLzo0 "Zuordnung zum 0.Gang im Low Range Betrieb" VALUE 0xF3884 MSA15_FW2 0 DEZ_DB 0.000000 5.000000 EXTENDED_LIMITS -128.000000 127.000000 /end CHARACTERISTIC
/begin CHARACTERISTIC mrwGNLzo1 "Zuordnung zum 1.Gang im Low Range Betrieb" VALUE 0xF3885 MSA15_FW2 0 DEZ_DB 0.000000 5.000000 EXTENDED_LIMITS -128.000000 127.000000 /end CHARACTERISTIC
/begin CHARACTERISTIC mrwGNLzo2 "Zuordnung zum 2.Gang im Low Range Betrieb" VALUE 0xF3886 MSA15_FW2 0 DEZ_DB 0.000000 5.000000 EXTENDED_LIMITS -128.000000 127.000000 /end CHARACTERISTIC
/begin CHARACTERISTIC mrwGNLzo3 "Zuordnung zum 3.Gang im Low Range Betrieb" VALUE 0xF3887 MSA15_FW2 0 DEZ_DB 0.000000 5.000000 EXTENDED_LIMITS -128.000000 127.000000 /end CHARACTERISTIC
/begin CHARACTERISTIC mrwGNLzo4 "Zuordnung zum 4.Gang im Low Range Betrieb" VALUE 0xF3888 MSA15_FW2 0 DEZ_DB 0.000000 5.000000 EXTENDED_LIMITS -128.000000 127.000000 /end CHARACTERISTIC
/begin CHARACTERISTIC mrwGNLzo5 "Zuordnung zum 5.Gang im Low Range Betrieb" VALUE 0xF3889 MSA15_FW2 0 DEZ_DB 0.000000 5.000000 EXTENDED_LIMITS -128.000000 127.000000 /end CHARACTERISTIC
/begin CHARACTERISTIC mrwGNLzo6 "Zuordnung zum 6.Gang im Low Range Betrieb" VALUE 0xF388A MSA15_FW2 0 DEZ_DB 0.000000 5.000000 EXTENDED_LIMITS -128.000000 127.000000 /end CHARACTERISTIC
/begin CHARACTERISTIC mrwGNLzo7 "Zuordnung zum 7.Gang im Low Range Betrieb" VALUE 0xF388B MSA15_FW2 0 DEZ_DB 0.000000 5.000000 EXTENDED_LIMITS -128.000000 127.000000 /end CHARACTERISTIC
/begin CHARACTERISTIC mrwGN_Del "Zeit fuer camGANG Delay  ! ***BC121 hem2wi" VALUE 0xF388C MSA15_FW3 0 ZEIT_ST 0.000000 655350000.000000 /end CHARACTERISTIC
/begin CHARACTERISTIC mrwGNzo_0 "Zuordnung zum 0.Gang" VALUE 0xF387C MSA15_FW2 0 DEZ_DB 0.000000 5.000000 EXTENDED_LIMITS -128.000000 127.000000 /end CHARACTERISTIC
/begin CHARACTERISTIC mrwGNzo_1 "Zuordnung zum 1.Gang" VALUE 0xF387D MSA15_FW2 0 DEZ_DB 0.000000 5.000000 EXTENDED_LIMITS -128.000000 127.000000 /end CHARACTERISTIC
/begin CHARACTERISTIC mrwGNzo_2 "Zuordnung zum 2.Gang" VALUE 0xF387E MSA15_FW2 0 DEZ_DB 0.000000 5.000000 EXTENDED_LIMITS -128.000000 127.000000 /end CHARACTERISTIC
/begin CHARACTERISTIC mrwGNzo_3 "Zuordnung zum 3.Gang" VALUE 0xF387F MSA15_FW2 0 DEZ_DB 0.000000 5.000000 EXTENDED_LIMITS -128.000000 127.000000 /end CHARACTERISTIC
/begin CHARACTERISTIC mrwGNzo_4 "Zuordnung zum 4.Gang" VALUE 0xF3880 MSA15_FW2 0 DEZ_DB 0.000000 5.000000 EXTENDED_LIMITS -128.000000 127.000000 /end CHARACTERISTIC
/begin CHARACTERISTIC mrwGNzo_5 "Zuordnung zum 5.Gang" VALUE 0xF3881 MSA15_FW2 0 DEZ_DB 0.000000 5.000000 EXTENDED_LIMITS -128.000000 127.000000 /end CHARACTERISTIC
/begin CHARACTERISTIC mrwGNzo_6 "Zuordnung zum 6.Gang" VALUE 0xF3882 MSA15_FW2 0 DEZ_DB 0.000000 5.000000 EXTENDED_LIMITS -128.000000 127.000000 /end CHARACTERISTIC
/begin CHARACTERISTIC mrwGNzo_7 "Zuordnung zum 7.Gang" VALUE 0xF3883 MSA15_FW2 0 DEZ_DB 0.000000 5.000000 EXTENDED_LIMITS -128.000000 127.000000 /end CHARACTERISTIC
/begin CHARACTERISTIC mrwHCDGWKF "HCD- Grundwerte" MAP 0xF3C14 MSA15_KF382 0 MM3pSek 0.000000 1000.000000
 /begin AXIS_DESCR STD_AXIS dzmNmit N 2 0.000000 6000.000000 EXTENDED_LIMITS 0.000000 32767.000000 /end AXIS_DESCR
 /begin AXIS_DESCR STD_AXIS anmAT2 T 2 -50.040010 899.960000 EXTENDED_LIMITS -273.140000 3003.560000 /end AXIS_DESCR
 EXTENDED_LIMITS -16383.500000 16383.500000 /end CHARACTERISTIC
/begin CHARACTERISTIC mrwHCDKOKF "HCD- Korrektur" MAP 0xF3C2C MSA15_KF382 0 MM3pSek 0.000000 1000.000000
 /begin AXIS_DESCR STD_AXIS dzmNmit N 2 0.000000 6000.000000 EXTENDED_LIMITS 0.000000 32767.000000 /end AXIS_DESCR
 /begin AXIS_DESCR STD_AXIS mrmM_EMTS MM3 2 0.000000 100.000000 EXTENDED_LIMITS -327.680000 327.670000 /end AXIS_DESCR
 EXTENDED_LIMITS -16383.500000 16383.500000 /end CHARACTERISTIC
/begin CHARACTERISTIC mrwHCDTWKL "HCD Wassertemperaturgewichtung" CURVE 0xF3C44 MSA15_KL118 0 FAKT 0.000000 3.200000
 /begin AXIS_DESCR STD_AXIS anmWTF T 2 -40.040010 149.960000 EXTENDED_LIMITS -273.140000 3003.560000 /end AXIS_DESCR
 EXTENDED_LIMITS -3.276800 3.276700 /end CHARACTERISTIC
/begin CHARACTERISTIC mrwHCD_AB "Maximaldrehzahl fuer Berechnung HC-Eindüsung" VALUE 0xF3C12 MSA15_FW4 0 N 0.000000 6000.000000 EXTENDED_LIMITS 0.000000 32767.000000 /end CHARACTERISTIC
/begin CHARACTERISTIC mrwIPWG_KF "Berechnung des virtuellen FGR-PWG-Wertes" MAP 0xF2034 MSA15_KF382 0 PROZ_S 0.000000 100.000000
 /begin AXIS_DESCR STD_AXIS dzmNmit N 12 0.000000 6000.000000 EXTENDED_LIMITS 0.000000 32767.000000 /end AXIS_DESCR
 /begin AXIS_DESCR STD_AXIS mrmM_EFGR MM3 8 0.000000 100.000000 EXTENDED_LIMITS -327.680000 327.670000 /end AXIS_DESCR
 EXTENDED_LIMITS -327.680000 327.670000 /end CHARACTERISTIC
/begin CHARACTERISTIC mrwKFVB_KF "#SSD Berechnung des spez. Verbrauch bi = f(N, M_E)" MAP 0xF2124 MSA15_KF382 0 BI_ 0.000000 0.208840
 /begin AXIS_DESCR STD_AXIS dzmNmit N 16 0.000000 6000.000000 EXTENDED_LIMITS 0.000000 32767.000000 /end AXIS_DESCR
 /begin AXIS_DESCR STD_AXIS mroME_KFVB MM3 16 0.000000 100.000000 EXTENDED_LIMITS -327.680000 327.670000 /end AXIS_DESCR
 EXTENDED_LIMITS -0.327680 0.327670 /end CHARACTERISTIC
/begin CHARACTERISTIC mrwLAP_KL "LLR - Drehzahlanhebung bei Automatik P/N Stellung Korrektur" CURVE 0xF3D5C MSA15_KL118 0 N 0.000000 6000.000000
 /begin AXIS_DESCR STD_AXIS anmADF P 6 0.000000 3500.000000 EXTENDED_LIMITS -32768.000000 32767.000000 /end AXIS_DESCR
 EXTENDED_LIMITS 0.000000 32767.000000 /end CHARACTERISTIC
/begin CHARACTERISTIC mrwLDNB_KF "#SSD BEG Laderschutz-Vollastmenge - KF         M_E = f(N, P_ADF)" MAP 0xFA9F8 MSA15_KF382 0 MM3 0.000000 100.000000
 /begin AXIS_DESCR STD_AXIS dzmNmit N 10 0.000000 6000.000000 EXTENDED_LIMITS 0.000000 32767.000000 /end AXIS_DESCR
 /begin AXIS_DESCR STD_AXIS anmADF P 9 500.000000 1500.000000 EXTENDED_LIMITS -32768.000000 32767.000000 /end AXIS_DESCR
 EXTENDED_LIMITS -327.680000 327.670000 /end CHARACTERISTIC
/begin CHARACTERISTIC mrwLFZN_O "Hysterese obere Schwelle" VALUE 0xF3E02 MSA15_FW4 0 N 0.000000 6000.000000 EXTENDED_LIMITS 0.000000 32767.000000 /end CHARACTERISTIC
/begin CHARACTERISTIC mrwLFZN_U "Hysterese untere Schwelle" VALUE 0xF3E04 MSA15_FW4 0 N 0.000000 6000.000000 EXTENDED_LIMITS 0.000000 32767.000000 /end CHARACTERISTIC
/begin CHARACTERISTIC mrwLIM_KF "EXT Mengenbegrenzung bei hoher Kraftstofftemp." MAP 0xF3BBA MSA15_KF382 0 MM3 0.000000 100.000000
 /begin AXIS_DESCR STD_AXIS dzmNmit N 7 0.000000 6000.000000 EXTENDED_LIMITS 0.000000 32767.000000 /end AXIS_DESCR
 /begin AXIS_DESCR STD_AXIS anmKTF T 4 -50.040010 199.960000 EXTENDED_LIMITS -273.140000 3003.560000 /end AXIS_DESCR
 EXTENDED_LIMITS -327.680000 327.670000 /end CHARACTERISTIC
/begin CHARACTERISTIC mrwLL1G_ES "LLR Einschrittmenge Vorsteuerung: Warm, 1.Gang" VALUE 0xF39A8 MSA15_FW4 0 M_E 0.000000 100.000000 EXTENDED_LIMITS -327.680000 327.670000 /end CHARACTERISTIC
/begin CHARACTERISTIC mrwLL2G_ES "LLR Einschrittmenge Vorsteuerung: Warm, 2.Gang" VALUE 0xF39B4 MSA15_FW4 0 M_E 0.000000 100.000000 EXTENDED_LIMITS -327.680000 327.670000 /end CHARACTERISTIC
/begin CHARACTERISTIC mrwLL3G_ES "LLR Einschrittmenge Vorsteuerung: Warm, 3.Gang" VALUE 0xF39C0 MSA15_FW4 0 M_E 0.000000 100.000000 EXTENDED_LIMITS -327.680000 327.670000 /end CHARACTERISTIC
/begin CHARACTERISTIC mrwLL4G_ES "LLR Einschrittmenge Vorsteuerung: Warm, 4.Gang" VALUE 0xF39CC MSA15_FW4 0 M_E 0.000000 100.000000 EXTENDED_LIMITS -327.680000 327.670000 /end CHARACTERISTIC
/begin CHARACTERISTIC mrwLL5G_ES "LLR Einschrittmenge Vorsteuerung: Warm, 5.Gang" VALUE 0xF39D8 MSA15_FW4 0 M_E 0.000000 100.000000 EXTENDED_LIMITS -327.680000 327.670000 /end CHARACTERISTIC
/begin CHARACTERISTIC mrwLLA_MAX "LLR obere dN-Grenze fuer LL-Abgleich" VALUE 0xF3848 MSA15_FW4 0 dN 0.000000 200.000000 EXTENDED_LIMITS -32768.000000 32767.000000 /end CHARACTERISTIC
/begin CHARACTERISTIC mrwLLA_MIN "LLR untere dN-Grenze fuer LL-Abgleich" VALUE 0xF3846 MSA15_FW4 0 dN -200.000000 0.000000 EXTENDED_LIMITS -32768.000000 32767.000000 /end CHARACTERISTIC
/begin CHARACTERISTIC mrwLLA_MX2 "LLR obere dN-Grenze fuer LL-Abgleich fuer vorgeben" VALUE 0xF384A MSA15_FW4 0 dN 0.000000 200.000000 EXTENDED_LIMITS -32768.000000 32767.000000 /end CHARACTERISTIC
/begin CHARACTERISTIC mrwLLD1G_K "LLR Koeffizient  DT1-Glied: Warm, 1.Gang" VALUE 0xF39F8 MSA15_FW4 0 LLR_KD 0.000000 1.279961 /end CHARACTERISTIC
/begin CHARACTERISTIC mrwLLD2G_K "LLR Koeffizient  DT1-Glied: Warm, 2.Gang" VALUE 0xF3A02 MSA15_FW4 0 LLR_KD 0.000000 1.279961 /end CHARACTERISTIC
/begin CHARACTERISTIC mrwLLD3G_K "LLR Koeffizient  DT1-Glied: Warm, 3.Gang" VALUE 0xF3A0C MSA15_FW4 0 LLR_KD 0.000000 1.279961 /end CHARACTERISTIC
/begin CHARACTERISTIC mrwLLD4G_K "LLR Koeffizient  DT1-Glied: Warm, 4.Gang" VALUE 0xF3A16 MSA15_FW4 0 LLR_KD 0.000000 1.279961 /end CHARACTERISTIC
/begin CHARACTERISTIC mrwLLD5G_K "LLR Koeffizient  DT1-Glied: Warm, 5.Gang" VALUE 0xF3A20 MSA15_FW4 0 LLR_KD 0.000000 1.279961 /end CHARACTERISTIC
/begin CHARACTERISTIC mrwLLDKG_K "LLR Koeffizient  DT1-Glied: Kalter Motor, Gang" VALUE 0xF39EE MSA15_FW4 0 LLR_KD 0.000000 1.279961 /end CHARACTERISTIC
/begin CHARACTERISTIC mrwLLDKK_K "LLR Koeffizient  DT1-Glied: Kalter Motor, Kupplung" VALUE 0xF39E4 MSA15_FW4 0 LLR_KD 0.000000 1.279961 /end CHARACTERISTIC
/begin CHARACTERISTIC mrwLLDWK_K "LLR Koeffizient  DT1-Glied: Warmer Motor, Kupplung" VALUE 0xF39DA MSA15_FW4 0 LLR_KD 0.000000 1.279961 /end CHARACTERISTIC
/begin CHARACTERISTIC mrwLLG1G_a "LLR quadrat. G-Faktor DT1-Glied: Warm, 1.Gang" VALUE 0xF39FC MSA15_FW4 0 DEZ_DW -32768.000000 32767.000000 /end CHARACTERISTIC
/begin CHARACTERISTIC mrwLLG1G_b "LLR linearer G-Faktor DT1-Glied: Warm, 1.Gang" VALUE 0xF39FE MSA15_FW4 0 DEZ_DW -32768.000000 32767.000000 /end CHARACTERISTIC
/begin CHARACTERISTIC mrwLLG1G_c "LLR konstanter G-Faktor DT1-Glied: Warm, 1.Gang" VALUE 0xF3A00 MSA15_FW4 0 DEZ_DW -32768.000000 32767.000000 /end CHARACTERISTIC
/begin CHARACTERISTIC mrwLLG2G_a "LLR quadrat. G-Faktor DT1-Glied: Warm, 2.Gang" VALUE 0xF3A06 MSA15_FW4 0 DEZ_DW -32768.000000 32767.000000 /end CHARACTERISTIC
/begin CHARACTERISTIC mrwLLG2G_b "LLR linearer G-Faktor DT1-Glied: Warm, 2.Gang" VALUE 0xF3A08 MSA15_FW4 0 DEZ_DW -32768.000000 32767.000000 /end CHARACTERISTIC
/begin CHARACTERISTIC mrwLLG2G_c "LLR konstanter G-Faktor DT1-Glied: Warm, 2.Gang" VALUE 0xF3A0A MSA15_FW4 0 DEZ_DW -32768.000000 32767.000000 /end CHARACTERISTIC
/begin CHARACTERISTIC mrwLLG3G_a "LLR quadrat. G-Faktor DT1-Glied: Warm, 3.Gang" VALUE 0xF3A10 MSA15_FW4 0 DEZ_DW -32768.000000 32767.000000 /end CHARACTERISTIC
/begin CHARACTERISTIC mrwLLG3G_b "LLR linearer G-Faktor DT1-Glied: Warm, 3.Gang" VALUE 0xF3A12 MSA15_FW4 0 DEZ_DW -32768.000000 32767.000000 /end CHARACTERISTIC
/begin CHARACTERISTIC mrwLLG3G_c "LLR konstanter G-Faktor DT1-Glied: Warm, 3.Gang" VALUE 0xF3A14 MSA15_FW4 0 DEZ_DW -32768.000000 32767.000000 /end CHARACTERISTIC
/begin CHARACTERISTIC mrwLLG4G_a "LLR quadrat. G-Faktor DT1-Glied: Warm, 4.Gang" VALUE 0xF3A1A MSA15_FW4 0 DEZ_DW -32768.000000 32767.000000 /end CHARACTERISTIC
/begin CHARACTERISTIC mrwLLG4G_b "LLR linearer G-Faktor DT1-Glied: Warm, 4.Gang" VALUE 0xF3A1C MSA15_FW4 0 DEZ_DW -32768.000000 32767.000000 /end CHARACTERISTIC
/begin CHARACTERISTIC mrwLLG4G_c "LLR konstanter G-Faktor DT1-Glied: Warm, 4.Gang" VALUE 0xF3A1E MSA15_FW4 0 DEZ_DW -32768.000000 32767.000000 /end CHARACTERISTIC
/begin CHARACTERISTIC mrwLLG5G_a "LLR quadrat. G-Faktor DT1-Glied: Warm, 5.Gang" VALUE 0xF3A24 MSA15_FW4 0 DEZ_DW -32768.000000 32767.000000 /end CHARACTERISTIC
/begin CHARACTERISTIC mrwLLG5G_b "LLR linearer G-Faktor DT1-Glied: Warm, 5.Gang" VALUE 0xF3A26 MSA15_FW4 0 DEZ_DW -32768.000000 32767.000000 /end CHARACTERISTIC
/begin CHARACTERISTIC mrwLLG5G_c "LLR konstanter G-Faktor DT1-Glied: Warm, 5.Gang" VALUE 0xF3A28 MSA15_FW4 0 DEZ_DW -32768.000000 32767.000000 /end CHARACTERISTIC
/begin CHARACTERISTIC mrwLLGKG_a "LLR quadrat. G-Faktor DT1-Glied: Kalter Motor, Gang" VALUE 0xF39F2 MSA15_FW4 0 DEZ_DW -32768.000000 32767.000000 /end CHARACTERISTIC
/begin CHARACTERISTIC mrwLLGKG_b "LLR linearer G-Faktor DT1-Glied: Kalter Motor, Gang" VALUE 0xF39F4 MSA15_FW4 0 DEZ_DW -32768.000000 32767.000000 /end CHARACTERISTIC
/begin CHARACTERISTIC mrwLLGKG_c "LLR konstanter G-Faktor DT1-Glied: Kalter Motor, Gang" VALUE 0xF39F6 MSA15_FW4 0 DEZ_DW -32768.000000 32767.000000 /end CHARACTERISTIC
/begin CHARACTERISTIC mrwLLGKK_a "LLR quadrat. G-Faktor DT1-Glied: Kalter Motor, Kupplung" VALUE 0xF39E8 MSA15_FW4 0 DEZ_DW -32768.000000 32767.000000 /end CHARACTERISTIC
/begin CHARACTERISTIC mrwLLGKK_b "LLR linearer G-Faktor DT1-Glied: Kalter Motor, Kupplung" VALUE 0xF39EA MSA15_FW4 0 DEZ_DW -32768.000000 32767.000000 /end CHARACTERISTIC
/begin CHARACTERISTIC mrwLLGKK_c "LLR konstanter G-Faktor DT1-Glied: Kalter Motor, Kupplung" VALUE 0xF39EC MSA15_FW4 0 DEZ_DW -32768.000000 32767.000000 /end CHARACTERISTIC
/begin COMPU_METHOD ARD_KD "D-Koeffizient KD/T1 (ARD) Hintereinaderschaltung 2 DT1" RAT_FUNC "%8.6" "((mm^3)/(1/min))^1/2" COEFFS 0 6.553600e+04 0.000000 0 0.000000 3.200000 /end COMPU_METHOD
/begin COMPU_METHOD ARD_KD_KUP "D-Koeffizient KD/T1 (ARD) Hintereinaderschaltung 2 DT1" RAT_FUNC "%8.6" "((mm^3)/(1/min))^1/2" COEFFS 0 6.553600e+04 0.000000 0 0.000000 3.200000 /end COMPU_METHOD
/begin COMPU_METHOD ARD_KL "Lead-Lag-Koeffizient Tz/Tn ARD-Fuehrungsformer" RAT_FUNC "%8.6" "(mm^3)/(mm^3)" COEFFS 0 6.553600e+04 0.000000 0 0.000000 4.000000 /end COMPU_METHOD
/begin COMPU_METHOD B "Umrechnung Beschleunigung" RAT_FUNC "%8.5" "m/s^2" COEFFS 0 3.276800e-02 0.000000 0 0.000000 2.777780e-03 /end COMPU_METHOD
/begin COMPU_METHOD BI_ "Spezifischer Verbrauch" RAT_FUNC "%8.6" "mm^3/Nm" COEFFS 0 1.000000 0.000000 0 0.000000 1.000000e-05 /end COMPU_METHOD
/begin COMPU_METHOD B_VINC "Umrechnung Beschleunigung in Geschwindigkeitsinkrement * 256" RAT_FUNC "%8.5" "m/s^2" COEFFS 0 18.432000 5.000000e-03 0 0.000000 1.000000e-02 /end COMPU_METHOD
/begin COMPU_METHOD DEZ_DB "Uebernahme von Festwerten von -128 bis 127" RAT_FUNC "%8.4" "-" COEFFS 0 1.000000 0.000000 0 0.000000 1.000000 /end COMPU_METHOD
/begin COMPU_METHOD DEZ_DB_U "Uebernahme von Festwerten von 0 bis 255" RAT_FUNC "%8.4" "-" COEFFS 0 1.000000 0.000000 0 0.000000 1.000000 /end COMPU_METHOD
/begin COMPU_METHOD DEZ_DW "Uebernahme von Festwerten von -32768 bis 32767" RAT_FUNC "%8.2" "-" COEFFS 0 1.000000 0.000000 0 0.000000 1.000000 /end COMPU_METHOD
/begin COMPU_METHOD DEZ_DW_U "Uebernahme von Festwerten von 0 bis 65535" RAT_FUNC "%8.2" "-" COEFFS 0 1.000000 0.000000 0 0.000000 1.000000 /end COMPU_METHOD
/begin COMPU_METHOD DIF_T "Umrechnung Temperaturdifferenz" RAT_FUNC "%8.3" "Grad C" COEFFS 0 1.000000 0.000000 0 0.000000 1.000000e-01 /end COMPU_METHOD
/begin COMPU_METHOD D_T "Umrechnung Temperaturdifferenz" RAT_FUNC "%8.3" "Grad C" COEFFS 0 1.000000 0.000000 0 0.000000 1.000000e-01 /end COMPU_METHOD
/begin COMPU_METHOD FAKT "Umrechnung fuer multiplikative Faktoren" RAT_FUNC "%8.6" "-" COEFFS 0 1.000000 0.000000 0 0.000000 1.000000e-04 /end COMPU_METHOD
/begin COMPU_METHOD FGG_NE "Umrechnung Normexponent fuer FGG" RAT_FUNC "%1.0" "" COEFFS 0 271.000000 264.000000 0 0.000000 1.000000 /end COMPU_METHOD
/begin COMPU_METHOD FGG_SF "Umrechnung Streckenfaktor fuer FGG" RAT_FUNC "%8.5" "Imp/m" COEFFS 0 0.000000 3600000.000000 0 81.920000 0.000000 /end COMPU_METHOD
/begin COMPU_METHOD FGG_TMX "Umrechnung Periodendauer fuer FGG" RAT_FUNC "%8.4" "Imp/m" COEFFS 0 0.000000 3600000.000000 0 64.000000 0.000000 /end COMPU_METHOD
/begin COMPU_METHOD FGR_KI "I-Verstaerkung KI (FGR)" RAT_FUNC "%8.5" "(mm3)/((km/h)*s)" COEFFS 0 1.310720e+07 0.000000 0 0.000000 10000.000000 /end COMPU_METHOD
/begin COMPU_METHOD FGR_KP "P-Verstaerkung KP (FGR)" RAT_FUNC "%8.5" "(mm3)/(km/h)" COEFFS 0 655.360000 0.000000 0 0.000000 3.200000e-01 /end COMPU_METHOD
/begin COMPU_METHOD GF "zeitsynchroner Gedaechtnisfaktor fuer PT1" RAT_FUNC "%8.6" "-" COEFFS 0 3.276800e+04 0.000000 0 0.000000 1.000000 /end COMPU_METHOD
/begin COMPU_METHOD KWH_KI "I-Verstaerkung KI (Generatorlast)" RAT_FUNC "%8.4" "% Endstufe/ ((% Gene" COEFFS 0 6.553600e+07 0.000000 0 0.000000 320000.000000 /end COMPU_METHOD
/begin COMPU_METHOD KWH_KP "P-Verstaerkung KP (Generatorlast)" RAT_FUNC "%8.4" "% Endstufe/ % Genera" COEFFS 0 655.360000 0.000000 0 0.000000 2.560000 /end COMPU_METHOD
/begin COMPU_METHOD LDRS_KD "D-Koeffizient KD/T1 (LDR-Vorsteuerung-Sollwert)" RAT_FUNC "%8.4" "hPa/hPa" COEFFS 0 6.553600e+04 0.000000 0 0.000000 1024.000000 /end COMPU_METHOD
/begin COMPU_METHOD LDR_KD "D-Koeffizient KD/T1 (LDR)" RAT_FUNC "%8.5" "%/hPa" COEFFS 0 6.553600e+04 0.000000 0 0.000000 40.960000 /end COMPU_METHOD
/begin COMPU_METHOD LDR_KI "I-Verstaerkung KI (LDR)" RAT_FUNC "%8.6" "%/(hPa*s)" COEFFS 0 1.310720e+09 0.000000 0 0.000000 320000.000000 /end COMPU_METHOD
/begin COMPU_METHOD LDR_KP "P-Verstaerkung KP (LDR)" RAT_FUNC "%8.6" "%/hPa" COEFFS 0 6.553600e+04 0.000000 0 0.000000 5.120000 /end COMPU_METHOD
/begin COMPU_METHOD LLR_KD "D-Koeffizient KD/T1 (LLR)" RAT_FUNC "%8.6" "(mm^3)/(1/min)" COEFFS 0 6.553600e+04 0.000000 0 0.000000 2.560000 /end COMPU_METHOD
/begin COMPU_METHOD MM3 "1 * 10E-2" RAT_FUNC "%8.4" "mm^3" COEFFS 0 1.000000 0.000000 0 0.000000 1.000000e-02 /end COMPU_METHOD
/begin COMPU_METHOD MM3pSek "Einduesvolumen pro Sekunde" RAT_FUNC "%8.2" "mm^3/sec" COEFFS 0 2000000.000000 0.000000 0 0.000000 1000000.000000 /end COMPU_METHOD
/begin COMPU_METHOD M_E "Umrechnung Menge" RAT_FUNC "%8.4" "mm^3" COEFFS 0 1.000000 0.000000 0 0.000000 1.000000e-02 /end COMPU_METHOD
/begin COMPU_METHOD M_L "Umrechnung Luftmasse" RAT_FUNC "%8.3" "mg/Hub Luft" COEFFS 0 1.000000 0.000000 0 0.000000 1.000000e-01 /end COMPU_METHOD
/begin COMPU_METHOD N "Umrechnung Drehzahl" RAT_FUNC "%8.2" "1/min" COEFFS 0 1.000000 0.000000 0 0.000000 1.000000 /end COMPU_METHOD
/begin COMPU_METHOD NEX "Umrechnung Normexponent" RAT_FUNC "%8.5" "-" COEFFS 0 1.000000 0.000000 0 0.000000 1.000000 /end COMPU_METHOD
/begin COMPU_METHOD P "Umrechnung Ladedruck" RAT_FUNC "%8.2" "hPa" COEFFS 0 1.000000 0.000000 0 0.000000 1.000000 /end COMPU_METHOD
/begin COMPU_METHOD PROZ "Umrechnung Tastverhaeltnis" RAT_FUNC "%8.4" "%" COEFFS 0 1.000000 0.000000 0 0.000000 1.000000e-02 /end COMPU_METHOD
/begin COMPU_METHOD PROZDT "Differenzquotient dPROZ_S/dt" RAT_FUNC "%8.2" "%/s" COEFFS 0 2.000000e-02 0.000000 0 0.000000 1.000000e-02 /end COMPU_METHOD
/begin COMPU_METHOD PROZDT100 "Umrechnung f. Prozent-TV pro Programmdurchlauf (slow)" RAT_FUNC "%8.3" "%/s" COEFFS 0 100000.000000 0.000000 0 0.000000 10000.000000 /end COMPU_METHOD
/begin COMPU_METHOD PROZ_S "Umrechnung Schleiferspannung in Prozent" RAT_FUNC "%8.4" "%" COEFFS 0 1.000000 0.000000 0 0.000000 1.000000e-02 /end COMPU_METHOD
/begin COMPU_METHOD R "Umrechnung Spez.Gaskonstante" RAT_FUNC "%8.5" "kJ/(kg*K)" COEFFS 0 1000.000000 0.000000 0 0.000000 1.000000 /end COMPU_METHOD
/begin COMPU_METHOD RP "Railpressure" RAT_FUNC "%7.0" "hPa" COEFFS 0 1.000000 0.000000 0 0.000000 100.000000 /end COMPU_METHOD
/begin COMPU_METHOD T "Umrechnung Temperatur" RAT_FUNC "%8.3" "Grad C" COEFFS 0 1.000000 273.140000 0 0.000000 1.000000e-01 /end COMPU_METHOD
/begin COMPU_METHOD U_B "Umrechnung fuer Spannungen bis zu 12V" RAT_FUNC "%8.1" "mV" COEFFS 0 1023.000000 0.000000 0 0.000000 24163.000000 /end COMPU_METHOD
/begin COMPU_METHOD V "Umrechnung Geschwindigkeit" RAT_FUNC "%8.4" "km/h" COEFFS 0 1.000000 0.000000 0 0.000000 1.000000e-02 /end COMPU_METHOD
/begin COMPU_METHOD VDF "Umrechnung Kraftstoffvorfoerderdruck" RAT_FUNC "%8.2" "hPa" COEFFS 0 1.000000 0.000000 0 0.000000 1.000000 /end COMPU_METHOD
/begin COMPU_METHOD VOL "Umrechnung Volumen" RAT_FUNC "%8.2" "ccm" COEFFS 0 1.000000 0.000000 0 0.000000 1.000000 /end COMPU_METHOD
/begin COMPU_METHOD V_DIFF "Umrechnung Geschwindigkeitsdifferenzen" RAT_FUNC "%8.4" "km/h" COEFFS 0 1.000000 0.000000 0 0.000000 1.000000e-02 /end COMPU_METHOD
/begin COMPU_METHOD V_N "Umrechnung V/N" RAT_FUNC "%8.6" "(km/h)/(1/min)" COEFFS 0 256.000000 0.000000 0 0.000000 1.000000e-02 /end COMPU_METHOD
/begin COMPU_METHOD ZEIT_HP "Umrechnung Timer Hauptprogramm" RAT_FUNC "%10.0" "us" COEFFS 0 1.000000 0.000000 0 0.000000 20000.000000 /end COMPU_METHOD
/begin COMPU_METHOD ZEIT_KLKF "Umrechnung Zeit Softwaretimer speziell fuer KL/KF" RAT_FUNC "%9.0" "us" COEFFS 0 1.000000 0.000000 0 0.000000 10000.000000 /end COMPU_METHOD
/begin COMPU_METHOD ZEIT_ST "Umrechnung Zeit Softwaretimer" RAT_FUNC "%9.0" "us" COEFFS 0 1.000000 0.000000 0 0.000000 10000.000000 /end COMPU_METHOD
/begin COMPU_METHOD dM_E_dZ "Mengenaenderung pro Hauptprogrammdurchlauf" RAT_FUNC "%8.2" "mm^3/s" COEFFS 0 2.000000e-02 0.000000 0 0.000000 1.000000e-02 /end COMPU_METHOD
/begin COMPU_METHOD dN "Umrechnung Drehzahloffset" RAT_FUNC "%8.2" "1/min" COEFFS 0 1.000000 0.000000 0 0.000000 1.000000 /end COMPU_METHOD
/begin COMPU_METHOD dN_dZ_U "Drehzahlaenderung pro Hauptprogrammdurchlauf" RAT_FUNC "%7.0" "(U/min)/s" COEFFS 0 2.000000e-02 0.000000 0 0.000000 1.000000 /end COMPU_METHOD
/begin COMPU_METHOD dP_dZ "Ladedruckaenderung pro Hauptprogrammdurchlauf" RAT_FUNC "%7.0" "hPa/s" COEFFS 0 2.000000e-02 0.000000 0 0.000000 1.000000 /end COMPU_METHOD
/begin COMPU_METHOD dVE_dZ "Einspritzvolumenaenderung pro Hauptprogrammdurchlauf" RAT_FUNC "%8.2" "(mm^3)/s" COEFFS 0 2.000000e-02 0.000000 0 0.000000 1.000000e-02 /end COMPU_METHOD
/end MODULE
/end PROJECT
