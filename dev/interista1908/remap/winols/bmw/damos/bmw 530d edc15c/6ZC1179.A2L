/*** Created by DAM2ASAP Version 2.18E, 2nd February 2001 ***/
ASAP2_VERSION 1 3
/begin PROJECT _ "  P079.VC4.VA02  B07902C4.DAM:  DAMPAR_03"
/begin HEADER "EDC15C" PROJECT_NO VAR02 VERSION "MAX_KLKF" /end HEADER
/begin MODULE DIM " "
/begin MOD_PAR "Stand generiert: 16-AUG-2001 17:06:20.64" VERSION "MAX_KLKF 16-AUG-01 B07902C4.HEX       maximale Anzahl KL- /KF-Stuetzstellen" ADDR_EPK 0xFFFF EPK "" CUSTOMER_NO "BMW" USER "R. ALTMANN" PHONE_NO "0711-811-0000" ECU "" CPU_TYPE "S80166"
 /begin MEMORY_LAYOUT PRG_CODE 0x80000 0x70000 -1 -1 -1 -1 -1 /begin IF_DATA ASAP1B_ETK DP_BLOB 0x80000 0x70000 /end IF_DATA /end MEMORY_LAYOUT
 /begin MEMORY_LAYOUT PRG_DATA 0xF0000 0xC000 -1 -1 -1 -1 -1 /begin IF_DATA ASAP1B_ETK DP_BLOB 0xF0000 0xC000 /end IF_DATA /end MEMORY_LAYOUT
 /begin MEMORY_LAYOUT PRG_DATA 0xFC000 0x4000 -1 -1 -1 -1 -1 /begin IF_DATA ASAP1B_ETK DP_BLOB 0xFC000 0x4000 /end IF_DATA /end MEMORY_LAYOUT
 /begin MEMORY_LAYOUT PRG_DATA 0x4C000 0x4000 -1 -1 -1 -1 -1 /begin IF_DATA ASAP1B_ETK DP_BLOB 0x4C000 0x4000 /end IF_DATA /end MEMORY_LAYOUT
/end MOD_PAR
/begin MOD_COMMON " " S_REC_LAYOUT MSA15 DEPOSIT ABSOLUTE BYTE_ORDER MSB_LAST /end MOD_COMMON
/begin IF_DATA ASAP1B_ETK
 /begin SOURCE "SYNCHRO" 103 1 QP_BLOB 1 30 0xF0F80 0xD9C0 0xD96C 5 0 0 /end SOURCE
 /begin SOURCE "ZEIT-1" 4 1 QP_BLOB 2 28 0xF0FC0 0xD9E0 0xD96E 20 0 0 /end SOURCE
 /begin SOURCE "xxx" 0 1 QP_BLOB 4 20 0xF0E60 0xD930 0xD964 0 0 0xF0EF4 /end SOURCE
 /begin SOURCE "xxx" 0 1 QP_BLOB 5 52 0xF0E8A 0xD940 0xD966 0 0 0xF0F36 /end SOURCE
 /begin TP_BLOB 0xD9C0 1 181 12 2 0x0 0x0 0x0 0x0 0 0 ETK_CFG 0xF 0xF0 0xFF 0x2 0xFF 0xFF 0xFF 0x1 EXRAM 0x8000 0xFFFF -1 -1 -1 -1 -1 /end TP_BLOB
/end IF_DATA
/begin CHARACTERISTIC agwAKSNMLS "MLS Luefterdrehzahlschw. fuer AKS-Klappe auf" VALUE 0xF9990 MSA15_FW4 0 MLS_N_DW 0.000000 3000.000000 EXTENDED_LIMITS 0.000000 32766.990000 /end CHARACTERISTIC
/begin RECORD_LAYOUT MSA15_FW4 FNC_VALUES 1 SWORD COLUMN_DIR DIRECT /end RECORD_LAYOUT
/begin CHARACTERISTIC agwAKS_WTF "MLS Temperaturschw. f. AKS-Klappe oder MLS auf" VALUE 0xF998E MSA15_FW4 0 T -50.040010 149.960000 EXTENDED_LIMITS -273.140000 3003.560000 /end CHARACTERISTIC
/begin CHARACTERISTIC agwDSLNHYS "AGG Bandbreite - DZ-Hysterese" VALUE 0xF9880 MSA15_FW3 0 N 0.000000 6000.000000 EXTENDED_LIMITS 0.000000 32767.000000 /end CHARACTERISTIC
/begin RECORD_LAYOUT MSA15_FW3 FNC_VALUES 1 UWORD COLUMN_DIR DIRECT /end RECORD_LAYOUT
/begin CHARACTERISTIC agwDSLN_NL "AGG Drehzahlschwelle fuer 'harte' Ansteuerung im Nachlauf" VALUE 0xF9882 MSA15_FW3 0 N 0.000000 6000.000000 EXTENDED_LIMITS 0.000000 32767.000000 /end CHARACTERISTIC
/begin CHARACTERISTIC agwDSLTIME "AGG Vorlaufzeit nach Startabwurf" VALUE 0xF987E MSA15_FW3 0 ZEIT_ST 0.000000 655350000.000000 /end CHARACTERISTIC
/begin CHARACTERISTIC agwDSLV_S1 "AGG Schwellenwert S1 der FG-Hysterese" VALUE 0xF9894 MSA15_FW4 0 V 0.000000 300.000000 EXTENDED_LIMITS 0.000000 327.670000 /end CHARACTERISTIC
/begin CHARACTERISTIC agwDSLV_S2 "AGG Schwellenwert S2 der FG-Hysterese" VALUE 0xF9896 MSA15_FW4 0 V 0.000000 300.000000 EXTENDED_LIMITS 0.000000 327.670000 /end CHARACTERISTIC
/begin CHARACTERISTIC agwDSL_AB "Maximaldrehzahl fuer Berechnung Motorlagersteuerung" VALUE 0xF9884 MSA15_FW4 0 N 0.000000 6000.000000 EXTENDED_LIMITS 0.000000 32767.000000 /end CHARACTERISTIC
/begin CHARACTERISTIC agwDSL_KL "AGG Bestimmung eines Schwellenwertes fuer DZ-Hysterese" CURVE 0xF983E MSA15_KL117 0 N 0.000000 6000.000000
 /begin AXIS_DESCR STD_AXIS anmWTF T 15 -50.040010 149.960000 EXTENDED_LIMITS -273.140000 3003.560000 /end AXIS_DESCR
 EXTENDED_LIMITS 0.000000 32767.000000 /end CHARACTERISTIC
/begin RECORD_LAYOUT MSA15_KL117 SRC_ADDR_X 1 UWORD NO_AXIS_PTS_X 2 UWORD AXIS_PTS_X 3 SWORD INDEX_INCR DIRECT FNC_VALUES 4 UWORD COLUMN_DIR DIRECT /end RECORD_LAYOUT
/begin CHARACTERISTIC agwFG_KL "MLS Geschw.-Gewichtungskennlinie" CURVE 0xF9946 MSA15_KL118 0 FAKT 0.000000 3.200000
 /begin AXIS_DESCR STD_AXIS fgmFGAKT V 8 0.000000 300.000000 EXTENDED_LIMITS 0.000000 327.670000 /end AXIS_DESCR
 EXTENDED_LIMITS -3.276800 3.276700 /end CHARACTERISTIC
/begin RECORD_LAYOUT MSA15_KL118 SRC_ADDR_X 1 UWORD NO_AXIS_PTS_X 2 UWORD AXIS_PTS_X 3 SWORD INDEX_INCR DIRECT FNC_VALUES 4 SWORD COLUMN_DIR DIRECT /end RECORD_LAYOUT
/begin CHARACTERISTIC agwGangH_t "Dauer der Ansteuerung der Motorlager mit hart bei Gangwechsel aus einer Neutrals" VALUE 0xF9886 MSA15_FW3 0 ZEIT_ST 0.000000 655350000.000000 /end CHARACTERISTIC
/begin CHARACTERISTIC agwMLSKF "MLS Luefterdrehzahl = f(V,agoMLSWTF)" MAP 0xF98AC MSA15_KF358 0 MLS_N_DW 0.000000 3000.000000
 /begin AXIS_DESCR STD_AXIS fgmFGAKT V 5 0.000000 300.000000 EXTENDED_LIMITS 0.000000 327.670000 /end AXIS_DESCR
 /begin AXIS_DESCR STD_AXIS agoMLSWTF T 9 -50.040010 149.960000 EXTENDED_LIMITS -273.140000 3003.560000 /end AXIS_DESCR
 EXTENDED_LIMITS 0.000000 32766.990000 /end CHARACTERISTIC
/begin RECORD_LAYOUT MSA15_KF358 SRC_ADDR_X 1 UWORD NO_AXIS_PTS_X 2 UWORD AXIS_PTS_X 3 SWORD INDEX_INCR DIRECT SRC_ADDR_Y 4 UWORD NO_AXIS_PTS_Y 5 UWORD AXIS_PTS_Y 6 UWORD INDEX_INCR DIRECT FNC_VALUES 7 SWORD COLUMN_DIR DIRECT /end RECORD_LAYOUT
/begin CHARACTERISTIC agwMLSMATV "MLS Maximaler Wert des Tastverhaeltnisses = 95%" VALUE 0xF992E MSA15_FW4 0 PROZ 5.000000 95.000000 EXTENDED_LIMITS -327.680000 327.670000 /end CHARACTERISTIC
/begin CHARACTERISTIC agwMLSMITV "MLS Minimaler Wert des Tastverhaeltnisses = 5%" VALUE 0xF992C MSA15_FW4 0 PROZ 5.000000 5.000000 EXTENDED_LIMITS -327.680000 327.670000 /end CHARACTERISTIC
/begin CHARACTERISTIC agwMLS_TV "MLS Umsetzung Luefterdrehzahl in TV" CURVE 0xF996A MSA15_KL112 0 PROZ 0.000000 100.000000
 /begin AXIS_DESCR STD_AXIS agoN_ELroh MLS_N_DW 8 0.000000 3000.000000 EXTENDED_LIMITS 0.000000 32766.990000 /end AXIS_DESCR
 EXTENDED_LIMITS -327.680000 327.670000 /end CHARACTERISTIC
/begin RECORD_LAYOUT MSA15_KL112 SRC_ADDR_X 1 UWORD NO_AXIS_PTS_X 2 UWORD AXIS_PTS_X 3 UWORD INDEX_INCR DIRECT FNC_VALUES 4 SWORD COLUMN_DIR DIRECT /end RECORD_LAYOUT
/begin CHARACTERISTIC agwMLS_dt "MLS maximale Nachlueftzeit (< 10 min)" VALUE 0xF993C MSA15_FW3 0 ZEIT_ST 0.000000 60000000.000000 EXTENDED_LIMITS 0.000000 655350000.000000 /end CHARACTERISTIC
/begin CHARACTERISTIC agwMLSextN "MLS Drehzahl bei externer Anforderung" VALUE 0xF9942 MSA15_FW4 0 MLS_N_DW 0.000000 3000.000000 EXTENDED_LIMITS 0.000000 32766.990000 /end CHARACTERISTIC
/begin CHARACTERISTIC agwMLStemp "MLS Abschalttemperaturschwelle fuer Nachlueften" VALUE 0xF993E MSA15_FW4 0 T -50.040010 149.960000 EXTENDED_LIMITS -273.140000 3003.560000 /end CHARACTERISTIC
/begin CHARACTERISTIC agwN_EL_KL "MLS Luefterdrehzahl bei Nachlueften = f(agoMLSWTF)" CURVE 0xF9898 MSA15_KL112 0 MLS_N_DW 0.000000 3000.000000
 /begin AXIS_DESCR STD_AXIS agoMLSWTF T 4 -50.040010 149.960000 EXTENDED_LIMITS -273.140000 3003.560000 /end AXIS_DESCR
 EXTENDED_LIMITS 0.000000 32766.990000 /end CHARACTERISTIC
/begin CHARACTERISTIC agwN_ELoff "MLS Solldrehzahl bei Warten auf Hauptrelais Aus" VALUE 0xF9940 MSA15_FW4 0 MLS_N_DW 0.000000 3000.000000 EXTENDED_LIMITS 0.000000 32766.990000 /end CHARACTERISTIC
/begin CHARACTERISTIC agwPT1_GF "MLS Gedaechtnisfaktor PT1-Filter" VALUE 0xF9944 MSA15_FW3 0 GF 0.000031 0.999969 /end CHARACTERISTIC
/begin CHARACTERISTIC agwPWMmin "MLS Minimaler PWM-Wert fuer Korrektur" VALUE 0xF9932 MSA15_FW4 0 PROZ 0.000000 100.000000 EXTENDED_LIMITS -327.680000 327.670000 /end CHARACTERISTIC
/begin CHARACTERISTIC agwSteig "MLS Steigung fuer Korrektur" VALUE 0xF9936 MSA15_FW4 0 FAKT 0.000000 3.200000 EXTENDED_LIMITS -3.276800 3.276700 /end CHARACTERISTIC
/begin CHARACTERISTIC agwTV_aus "MLS TV fuer ausgesch. Luefter" VALUE 0xF9938 MSA15_FW4 0 PROZ 0.000000 100.000000 EXTENDED_LIMITS -327.680000 327.670000 /end CHARACTERISTIC
/begin CHARACTERISTIC agwTVmin "MLS Minimales Tastverhaeltnis fuer Korrektur" VALUE 0xF9930 MSA15_FW4 0 PROZ 0.000000 100.000000 EXTENDED_LIMITS -327.680000 327.670000 /end CHARACTERISTIC
/begin CHARACTERISTIC agwUB_aus "MLS Abschaltspannungsschwelle E-Luefter" VALUE 0xF993A MSA15_FW4 0 U_B 0.000000 24163.000000 EXTENDED_LIMITS 0.000000 773948.100000 /end CHARACTERISTIC
/begin CHARACTERISTIC agwUB_norm "MLS normierte Spannung fuer Korrektur" VALUE 0xF9934 MSA15_FW4 0 U_B 0.000000 24163.000000 EXTENDED_LIMITS 0.000000 773948.100000 /end CHARACTERISTIC
/begin CHARACTERISTIC agwWTF_VGW "MLS WTF-Vorgabewert fuer MLS-KF" VALUE 0xF992A MSA15_FW4 0 T -50.040010 149.960000 EXTENDED_LIMITS -273.140000 3003.560000 /end CHARACTERISTIC
/begin CHARACTERISTIC anwADF_DPL "ADF Rampensteigung Atmosphaerendruckfuehler Signal" VALUE 0xF18CE MSA15_FW4 0 dP_dZ100 0.000000 10000.000000 EXTENDED_LIMITS 0.000000 327670.000000 /end CHARACTERISTIC
/begin CHARACTERISTIC anwADF_GEB "ADF Geberkennwort Atmosphaerendruckfuehler Signal" VALUE 0xF18CA MSA15_FW3 0 DEZ_DW_U 0.000000 65535.000000 /end CHARACTERISTIC
/begin CHARACTERISTIC anwADF_KAN "ADF Kanal Atmosphaerendruckfuehler Signal" VALUE 0xF18C4 MSA15_FW3 0 DEZ_DW_U 27.000000 27.000000 EXTENDED_LIMITS 0.000000 65535.000000 /end CHARACTERISTIC
/begin CHARACTERISTIC anwADF_KL "ADF - Linearisierung P_ADF = f(U_ADF)" CURVE 0xF18D0 MSA15_KL118 0 P 0.000000 3500.000000
 /begin AXIS_DESCR STD_AXIS anoU_ADF U 2 0.000000 5000.000000 EXTENDED_LIMITS 0.000000 160151.500000 /end AXIS_DESCR
 EXTENDED_LIMITS -32768.000000 32767.000000 /end CHARACTERISTIC
/begin CHARACTERISTIC anwADF_MAX "ADF oberer SRC Atmosphaerendruckfuehler Signal" VALUE 0xF18C6 MSA15_FW4 0 U 0.000000 5601.173000 EXTENDED_LIMITS 0.000000 160151.500000 /end CHARACTERISTIC
/begin CHARACTERISTIC anwADF_MIN "ADF unterer SRC Atmosphaerendruckfuehler Signal" VALUE 0xF18C8 MSA15_FW4 0 U 0.000000 5601.173000 EXTENDED_LIMITS 0.000000 160151.500000 /end CHARACTERISTIC
/begin CHARACTERISTIC anwADF_VOR "ADF Vorgabewert Atmosphaerendruckfuehler Signal" VALUE 0xF18CC MSA15_FW4 0 P 0.000000 3500.000000 EXTENDED_LIMITS -32768.000000 32767.000000 /end CHARACTERISTIC
/begin CHARACTERISTIC anwAT1_DPL "AT1 Rampensteigung Abgastemperaturfuehler 1 Signal" VALUE 0xF19C6 MSA15_FW4 0 dT_dZ100 0.000000 2000.000000 EXTENDED_LIMITS -32768.000000 32767.000000 /end CHARACTERISTIC
/begin CHARACTERISTIC anwAT1_GEB "AT1 Geberkennwort Abgastemperaturfuehler 1 Signal" VALUE 0xF19C2 MSA15_FW3 0 DEZ_DW_U 0.000000 65535.000000 /end CHARACTERISTIC
/begin CHARACTERISTIC anwAT1_KAN "AT1 Kanal Abgastemperaturfuehler 1 Signal" VALUE 0xF19BC MSA15_FW3 0 DEZ_DW_U 11.000000 11.000000 EXTENDED_LIMITS 0.000000 65535.000000 /end CHARACTERISTIC
/begin CHARACTERISTIC anwAT1_KL "AT1 - Linearisierung T_AT1 = f(U_AT1)" CURVE 0xF19C8 MSA15_KL118 0 T -50.040010 899.960000
 /begin AXIS_DESCR STD_AXIS anoU_AT1 U 2 0.000000 5000.000000 EXTENDED_LIMITS 0.000000 160151.500000 /end AXIS_DESCR
 EXTENDED_LIMITS -273.140000 3003.560000 /end CHARACTERISTIC
/begin CHARACTERISTIC anwAT1_MAX "AT1 oberer SRC Abgastemperaturfuehler 1 Signal" VALUE 0xF19BE MSA15_FW4 0 U 0.000000 5000.000000 EXTENDED_LIMITS 0.000000 160151.500000 /end CHARACTERISTIC
/begin CHARACTERISTIC anwAT1_MIN "AT1 unterer SRC Abgastemperaturfuehler 1 Signal" VALUE 0xF19C0 MSA15_FW4 0 U 0.000000 5000.000000 EXTENDED_LIMITS 0.000000 160151.500000 /end CHARACTERISTIC
/begin CHARACTERISTIC anwAT1_VOR "AT1 Vorgabewert Abgastemperaturfuehler 1 Signal" VALUE 0xF19C4 MSA15_FW4 0 T -50.040010 899.960000 EXTENDED_LIMITS -273.140000 3003.560000 /end CHARACTERISTIC
/begin CHARACTERISTIC anwAT2_DPL "AT2 Rampensteigung Abgastemperaturfuehler 2 Signal" VALUE 0xF19DE MSA15_FW4 0 dT_dZ100 0.000000 2000.000000 EXTENDED_LIMITS -32768.000000 32767.000000 /end CHARACTERISTIC
/begin CHARACTERISTIC anwAT2_GEB "AT2 Geberkennwort Abgastemperaturfuehler 2 Signal" VALUE 0xF19DA MSA15_FW3 0 DEZ_DW_U 0.000000 65535.000000 /end CHARACTERISTIC
/begin CHARACTERISTIC anwAT2_KAN "AT2 Kanal Abgastemperaturfuehler 2 Signal" VALUE 0xF19D4 MSA15_FW3 0 DEZ_DW_U 75.000000 75.000000 EXTENDED_LIMITS 0.000000 65535.000000 /end CHARACTERISTIC
/begin CHARACTERISTIC anwAT2_KL "AT2 - Linearisierung T_AT2 = f(U_AT2)" CURVE 0xF19E0 MSA15_KL118 0 T -50.040010 899.960000
 /begin AXIS_DESCR STD_AXIS anoU_AT2 U 2 0.000000 5000.000000 EXTENDED_LIMITS 0.000000 160151.500000 /end AXIS_DESCR
 EXTENDED_LIMITS -273.140000 3003.560000 /end CHARACTERISTIC
/begin CHARACTERISTIC anwAT2_MAX "AT2 oberer SRC Abgastemperaturfuehler 2 Signal" VALUE 0xF19D6 MSA15_FW4 0 U 0.000000 5000.000000 EXTENDED_LIMITS 0.000000 160151.500000 /end CHARACTERISTIC
/begin CHARACTERISTIC anwAT2_MIN "AT2 unterer SRC Abgastemperaturfuehler 2 Signal" VALUE 0xF19D8 MSA15_FW4 0 U 0.000000 5000.000000 EXTENDED_LIMITS 0.000000 160151.500000 /end CHARACTERISTIC
/begin CHARACTERISTIC anwAT2_VOR "AT2 Vorgabewert Abgastemperaturfuehler 2 Signal" VALUE 0xF19DC MSA15_FW4 0 T -50.040010 899.960000 EXTENDED_LIMITS -273.140000 3003.560000 /end CHARACTERISTIC
/begin CHARACTERISTIC anwIDV_DPL "IDV Rampensteigung Druckregelventil" VALUE 0xF1AD0 MSA15_FW4 0 dI_dZ 0.000000 100000.000000 EXTENDED_LIMITS 0.000000 250000.000000 /end CHARACTERISTIC
/begin CHARACTERISTIC anwIDV_GEB "#SSD IDV Geberkennwort Druckregelventil" VALUE 0xF1ACC MSA15_FW3 0 DEZ_DW_U 0.000000 65535.000000 /end CHARACTERISTIC
/begin CHARACTERISTIC anwIDV_KAN "#SSD IDV Kanal Druckregelventil" VALUE 0xF1AC6 MSA15_FW3 0 DEZ_DW_U 12.000000 12.000000 EXTENDED_LIMITS 0.000000 65535.000000 /end CHARACTERISTIC
/begin CHARACTERISTIC anwIDV_KL "#SSD IDV - Liniarisierung        I_IDV = f(U_IDV)" CURVE 0xF1AD2 MSA15_KL118 0 IDV 0.000000 5000.000000
 /begin AXIS_DESCR STD_AXIS anoU_IDV U 2 0.000000 5000.000000 EXTENDED_LIMITS 0.000000 160151.500000 /end AXIS_DESCR
 EXTENDED_LIMITS -32768.000000 32767.000000 /end CHARACTERISTIC
/begin CHARACTERISTIC anwIDV_MAX "#SSD IDV oberer SRC Druckregelventil" VALUE 0xF1AC8 MSA15_FW4 0 U 0.000000 5601.173000 EXTENDED_LIMITS 0.000000 160151.500000 /end CHARACTERISTIC
/begin CHARACTERISTIC anwIDV_MIN "#SSD IDV unterer SRC Druckregelventil" VALUE 0xF1ACA MSA15_FW4 0 U 0.000000 5601.173000 EXTENDED_LIMITS 0.000000 160151.500000 /end CHARACTERISTIC
/begin CHARACTERISTIC anwIDV_VOR "#SSD IDV Vorgabewert Druckregelventil" VALUE 0xF1ACE MSA15_FW4 0 IDV 0.000000 5000.000000 EXTENDED_LIMITS -32768.000000 32767.000000 /end CHARACTERISTIC
/begin CHARACTERISTIC anwKDF_Amn "Minimalwert Abgleichwert Diagnose" VALUE 0xF1840 MSA15_FW4 0 KDF -1500000.000000 1500000.000000 EXTENDED_LIMITS -3276800.000000 3276700.000000 /end CHARACTERISTIC
/begin CHARACTERISTIC anwKDF_Amx "Maximalwert Abgleichwert Diagnose" VALUE 0xF1842 MSA15_FW4 0 KDF -1500000.000000 1500000.000000 EXTENDED_LIMITS -3276800.000000 3276700.000000 /end CHARACTERISTIC
/begin CHARACTERISTIC anwKDF_DPL "#SSD KDF Rampensteigung Kraftstoffdruckfuehler Signal" VALUE 0xF183E MSA15_FW4 0 KDF 0.000000 1500000.000000 EXTENDED_LIMITS -3276800.000000 3276700.000000 /end CHARACTERISTIC
/begin CHARACTERISTIC anwKDF_GEB "#SSD KDF Geberkennwort Kraftstoffdruckfuehler Signal" VALUE 0xF183A MSA15_FW3 0 DEZ_DW_U 0.000000 65535.000000 /end CHARACTERISTIC
/begin CHARACTERISTIC anwKDF_KAN "#SSD KDF Kanal Kraftstoffdruckfuehler" VALUE 0xF1834 MSA15_FW3 0 DEZ_DW_U 134.000000 134.000000 EXTENDED_LIMITS 0.000000 65535.000000 /end CHARACTERISTIC
/begin CHARACTERISTIC anwKDF_KL "#SSD KDF - Linearisierung P_KDF = f(U_KDF)" CURVE 0xF1844 MSA15_KL118 0 KDF 0.000000 1500000.000000
 /begin AXIS_DESCR STD_AXIS anoU_KDF U 4 0.000000 5000.000000 EXTENDED_LIMITS 0.000000 160151.500000 /end AXIS_DESCR
 EXTENDED_LIMITS -3276800.000000 3276700.000000 /end CHARACTERISTIC
/begin CHARACTERISTIC anwKDF_MAX "#SSD KDF oberer SRC Kraftstoffdruckfuehler Signal" VALUE 0xF1836 MSA15_FW4 0 U 0.000000 5601.173000 EXTENDED_LIMITS 0.000000 160151.500000 /end CHARACTERISTIC
/begin CHARACTERISTIC anwKDF_MIN "#SSD KDF unterer SRC Kraftstoffdruckfuehler Signal" VALUE 0xF1838 MSA15_FW4 0 U 0.000000 5601.173000 EXTENDED_LIMITS 0.000000 160151.500000 /end CHARACTERISTIC
/begin CHARACTERISTIC anwKDF_VOR "#SSD KDF Vorgabewert    Kraftstoffdruckfuehler Signal" VALUE 0xF183C MSA15_FW4 0 KDF 0.000000 1500000.000000 EXTENDED_LIMITS -3276800.000000 3276700.000000 /end CHARACTERISTIC
/begin CHARACTERISTIC anwKTF_DPL "KTF Rampensteigung Kraftstofftemperaturfuehler" VALUE 0xF18E6 MSA15_FW4 0 dT_dZ100 1.000000 2000.000000 EXTENDED_LIMITS -32768.000000 32767.000000 /end CHARACTERISTIC
/begin CHARACTERISTIC anwKTF_GEB "KTF Geberkennwort  Kraftstofftemperaturfuehler" VALUE 0xF18E2 MSA15_FW3 0 DEZ_DW_U 0.000000 65535.000000 /end CHARACTERISTIC
/begin CHARACTERISTIC anwKTF_KAN "KTF Kanal          Kraftstofftemperaturfuehler" VALUE 0xF18DC MSA15_FW3 0 DEZ_DW_U 26.000000 26.000000 EXTENDED_LIMITS 0.000000 65535.000000 /end CHARACTERISTIC
/begin CHARACTERISTIC anwKTF_KL "KTF - Linearisierung     T_KTF = f(U_KTF)" CURVE 0xF18E8 MSA15_KL118 0 T -50.040010 149.960000
 /begin AXIS_DESCR STD_AXIS anoU_KTF U 16 0.000000 5000.000000 EXTENDED_LIMITS 0.000000 160151.500000 /end AXIS_DESCR
 EXTENDED_LIMITS -273.140000 3003.560000 /end CHARACTERISTIC
/begin CHARACTERISTIC anwKTF_MAX "KTF oberer  SRC    Kraftstofftemperaturfuehler" VALUE 0xF18DE MSA15_FW4 0 U 0.000000 5601.173000 EXTENDED_LIMITS 0.000000 160151.500000 /end CHARACTERISTIC
/begin CHARACTERISTIC anwKTF_MIN "KTF unterer SRC    Kraftstofftemperaturfuehler" VALUE 0xF18E0 MSA15_FW4 0 U 0.000000 5601.173000 EXTENDED_LIMITS 0.000000 160151.500000 /end CHARACTERISTIC
/begin CHARACTERISTIC anwKTF_VOR "KTF Vorgabewert    Kraftstofftemperaturfuehler" VALUE 0xF18E4 MSA15_FW4 0 T -50.040010 149.960000 EXTENDED_LIMITS -273.140000 3003.560000 /end CHARACTERISTIC
/begin CHARACTERISTIC anwLDF_DPL "LDF Rampensteigung Ladedruckfuehler" VALUE 0xF1814 MSA15_FW4 0 dP_dZ 0.000000 3500.000000 EXTENDED_LIMITS -1638400.000000 1638350.000000 /end CHARACTERISTIC
/begin CHARACTERISTIC anwLDF_GEB "LDF Geberkennwort Ladedruckfuehler" VALUE 0xF1810 MSA15_FW3 0 DEZ_DW_U 0.000000 65535.000000 /end CHARACTERISTIC
/begin CHARACTERISTIC anwLDF_KAN "LDF Kanal Ladedruckfuehler" VALUE 0xF180A MSA15_FW3 0 DEZ_DW_U 130.000000 130.000000 EXTENDED_LIMITS 0.000000 65535.000000 /end CHARACTERISTIC
/begin CHARACTERISTIC anwLDF_KL "LDF - Linearisierung P_LDF = f(U_LDF)" CURVE 0xF1820 MSA15_KL118 0 P 0.000000 3500.000000
 /begin AXIS_DESCR STD_AXIS anoU_LDFA U 4 0.000000 5000.000000 EXTENDED_LIMITS 0.000000 160151.500000 /end AXIS_DESCR
 EXTENDED_LIMITS -32768.000000 32767.000000 /end CHARACTERISTIC
/begin CHARACTERISTIC anwLDF_MAX "LDF oberer SRC Ladedruckfuehler" VALUE 0xF180C MSA15_FW4 0 U 0.000000 5601.173000 EXTENDED_LIMITS 0.000000 160151.500000 /end CHARACTERISTIC
/begin CHARACTERISTIC anwLDF_MIN "LDF unterer SRC Ladedruckfuehler" VALUE 0xF180E MSA15_FW4 0 U 0.000000 5601.173000 EXTENDED_LIMITS 0.000000 160151.500000 /end CHARACTERISTIC
/begin CHARACTERISTIC anwLDF_VOR "LDF Vorgabewert Ladedruckfuehler" VALUE 0xF1812 MSA15_FW4 0 P 0.000000 3500.000000 EXTENDED_LIMITS -32768.000000 32767.000000 /end CHARACTERISTIC
/begin CHARACTERISTIC anwLMD_N1 "LMM untere N-Schwelle fuer Luftmassen-Berechnung" VALUE 0xF1878 MSA15_FW4 0 N 0.000000 6000.000000 EXTENDED_LIMITS 0.000000 32767.000000 /end CHARACTERISTIC
/begin CHARACTERISTIC anwLMM_GEB "LMM Geberkennwort Luftmassenmesser Signal" VALUE 0xF185E MSA15_FW3 0 DEZ_DW_U 0.000000 65535.000000 /end CHARACTERISTIC
/begin CHARACTERISTIC anwLMM_KAN "LMM Kanal Luftmassenmesser Signal" VALUE 0xF1858 MSA15_FW3 0 DEZ_DW_U 132.000000 132.000000 EXTENDED_LIMITS 0.000000 65535.000000 /end CHARACTERISTIC
/begin CHARACTERISTIC anwLMM_KL "LMM - Linearisierung M_Lt(proz) = f(U_LMM)" CURVE 0xF1864 MSA15_KL118 0 LMM 0.000000 100.000000
 /begin AXIS_DESCR STD_AXIS anoU_LMM U 4 0.000000 5000.000000 EXTENDED_LIMITS 0.000000 160151.500000 /end AXIS_DESCR
 EXTENDED_LIMITS -327.680000 327.670000 /end CHARACTERISTIC
/begin CHARACTERISTIC anwLMM_MAX "LMM oberer SRC Heissluftmassenmesser Signal" VALUE 0xF185A MSA15_FW4 0 U 0.000000 5601.173000 EXTENDED_LIMITS 0.000000 160151.500000 /end CHARACTERISTIC
/begin CHARACTERISTIC anwLMM_MIN "LMM unterer SRC Heissluftmassenmesser Signal" VALUE 0xF185C MSA15_FW4 0 U 0.000000 5601.173000 EXTENDED_LIMITS 0.000000 160151.500000 /end CHARACTERISTIC
/begin CHARACTERISTIC anwLMM_VOR "LMM Vorgabewert Luftmassenmesser Signal" VALUE 0xF1860 MSA15_FW4 0 LMM 0.000000 327.670000 EXTENDED_LIMITS -327.680000 327.670000 /end CHARACTERISTIC
/begin CHARACTERISTIC anwLTF_DPL "LTF Rampensteigung Lufttemperaturfuehler Signal" VALUE 0xF1976 MSA15_FW4 0 dT_dZ100 0.000000 2000.000000 EXTENDED_LIMITS -32768.000000 32767.000000 /end CHARACTERISTIC
/begin CHARACTERISTIC anwLTF_GEB "LTF Geberkennwort Lufttemperaturfuehler Signal" VALUE 0xF1972 MSA15_FW3 0 DEZ_DW_U 0.000000 65535.000000 /end CHARACTERISTIC
/begin CHARACTERISTIC anwLTF_KAN "LTF Kanal Lufttemperaturfuehler Signal" VALUE 0xF196C MSA15_FW3 0 DEZ_DW_U 74.000000 74.000000 EXTENDED_LIMITS 0.000000 65535.000000 /end CHARACTERISTIC
/begin CHARACTERISTIC anwLTF_KL "LTF - Linearisierung T_LTF = f(U_LTF)" CURVE 0xF1978 MSA15_KL118 0 T -50.040010 199.960000
 /begin AXIS_DESCR STD_AXIS anoU_LTF U 16 0.000000 5000.000000 EXTENDED_LIMITS 0.000000 160151.500000 /end AXIS_DESCR
 EXTENDED_LIMITS -273.140000 3003.560000 /end CHARACTERISTIC
/begin CHARACTERISTIC anwLTF_MAX "LTF oberer SRC Lufttemperaturfuehler Signal" VALUE 0xF196E MSA15_FW4 0 U 0.000000 5601.173000 EXTENDED_LIMITS 0.000000 160151.500000 /end CHARACTERISTIC
/begin CHARACTERISTIC anwLTF_MIN "LTF unterer SRC Lufttemperaturfuehler Signal" VALUE 0xF1970 MSA15_FW4 0 U 0.000000 5601.173000 EXTENDED_LIMITS 0.000000 160151.500000 /end CHARACTERISTIC
/begin CHARACTERISTIC anwLTF_VOR "LTF Vorgabewert Lufttemperaturfuehler Signal" VALUE 0xF1974 MSA15_FW4 0 T -50.040010 199.960000 EXTENDED_LIMITS -273.140000 3003.560000 /end CHARACTERISTIC
/begin CHARACTERISTIC anwM_LM_KL "LMM - Linearisierung M_E(MM3) = f(n)" CURVE 0xF187C MSA15_KL118 0 MM3 0.000000 325.000000
 /begin AXIS_DESCR STD_AXIS dzmNmit N 5 0.000000 6000.000000 EXTENDED_LIMITS 0.000000 32767.000000 /end AXIS_DESCR
 EXTENDED_LIMITS -327.680000 327.670000 /end CHARACTERISTIC
/begin CHARACTERISTIC anwM_LM_T "LMM Verlaengerungszeit fuer Ausblendung der SRC-High-Prufung  !##crq2046 Da" VALUE 0xF187A MSA15_FW4 0 ZEIT_ST 0.000000 655350000.000000 /end CHARACTERISTIC
/begin CHARACTERISTIC anwOTF_DPL "OTF Rampensteigung Oeltemperaturfuehler" VALUE 0xF195E MSA15_FW4 0 dT_dZ100 1.000000 2000.000000 EXTENDED_LIMITS -32768.000000 32767.000000 /end CHARACTERISTIC
/begin CHARACTERISTIC anwOTF_GEB "OTF Geberkennwort  Oeltemperaturfuehler" VALUE 0xF195A MSA15_FW3 0 DEZ_DW_U 0.000000 65535.000000 /end CHARACTERISTIC
/begin CHARACTERISTIC anwOTF_KAN "OTF Kanal          Oeltemperaturfuehler" VALUE 0xF1954 MSA15_FW3 0 DEZ_DW_U 59.000000 59.000000 EXTENDED_LIMITS 0.000000 65535.000000 /end CHARACTERISTIC
/begin CHARACTERISTIC anwOTF_KL "OTF - Linearisierung     T_OTF = f(U_OTF)" CURVE 0xF1960 MSA15_KL118 0 T -50.040010 199.960000
 /begin AXIS_DESCR STD_AXIS anoU_OTF U 2 0.000000 5000.000000 EXTENDED_LIMITS 0.000000 160151.500000 /end AXIS_DESCR
 EXTENDED_LIMITS -273.140000 3003.560000 /end CHARACTERISTIC
/begin CHARACTERISTIC anwOTF_MAX "OTF oberer  SRC    Oeltemperaturfuehler" VALUE 0xF1956 MSA15_FW4 0 U 0.000000 5601.173000 EXTENDED_LIMITS 0.000000 160151.500000 /end CHARACTERISTIC
/begin CHARACTERISTIC anwOTF_MIN "OTF unterer SRC    Oeltemperaturfuehler" VALUE 0xF1958 MSA15_FW4 0 U 0.000000 5601.173000 EXTENDED_LIMITS 0.000000 160151.500000 /end CHARACTERISTIC
/begin CHARACTERISTIC anwOTF_VOR "OTF Vorgabewert    Oeltemperaturfuehler" VALUE 0xF195C MSA15_FW4 0 T -50.040010 149.960000 EXTENDED_LIMITS -273.140000 3003.560000 /end CHARACTERISTIC
/begin CHARACTERISTIC anwPAGATO "obere Grenze von anmADF fuer LDF-Abgleich" VALUE 0xF1816 MSA15_FW4 0 P 0.000000 3500.000000 EXTENDED_LIMITS -32768.000000 32767.000000 /end CHARACTERISTIC
/begin CHARACTERISTIC anwPAGATU "untere Grenze von anmADF fuer LDF-Abgleich" VALUE 0xF1818 MSA15_FW4 0 P 0.000000 3500.000000 EXTENDED_LIMITS -32768.000000 32767.000000 /end CHARACTERISTIC
/begin CHARACTERISTIC anwPAGLDO "obere Bereichsgrenze LDF-Abgleich" VALUE 0xF181C MSA15_FW4 0 P 0.000000 3500.000000 EXTENDED_LIMITS -32768.000000 32767.000000 /end CHARACTERISTIC
/begin CHARACTERISTIC anwPAGLDU "untere Bereichsgrenze LDF-Abgleich" VALUE 0xF181E MSA15_FW4 0 P 0.000000 3500.000000 EXTENDED_LIMITS -32768.000000 32767.000000 /end CHARACTERISTIC
/begin CHARACTERISTIC anwPAGTIM "Minimalzeit der Abgleichbedingungen" VALUE 0xF181A MSA15_FW3 0 ZEIT_ST 0.000000 655350000.000000 /end CHARACTERISTIC
/begin CHARACTERISTIC anwPGS_DPL "#SSD PGS Rampensteigung Pedalwertgeber 2 Signal" VALUE 0xF18B6 MSA15_FW4 0 PROZDT 0.000000 10000.000000 EXTENDED_LIMITS 0.000000 16383.500000 /end CHARACTERISTIC
/begin CHARACTERISTIC anwPGS_GEB "#SSD PGS Geberkennwort Pedalwertgeber 2 Signal" VALUE 0xF18B2 MSA15_FW3 0 DEZ_DW_U 0.000000 65535.000000 /end CHARACTERISTIC
/begin CHARACTERISTIC anwPGS_KAN "PGS Kanal Pedalwertgeber 2 Signal" VALUE 0xF18AC MSA15_FW3 0 DEZ_DW_U 14.000000 14.000000 EXTENDED_LIMITS 0.000000 65535.000000 /end CHARACTERISTIC
/begin CHARACTERISTIC anwPGS_KL "#SSD PGS - Linearisierung PGS = f(U_PGS)" CURVE 0xF18B8 MSA15_KL118 0 PROZ_S 0.000000 100.000000
 /begin AXIS_DESCR STD_AXIS anoU_PGS U 2 0.000000 5000.000000 EXTENDED_LIMITS 0.000000 160151.500000 /end AXIS_DESCR
 EXTENDED_LIMITS -327.680000 327.670000 /end CHARACTERISTIC
/begin CHARACTERISTIC anwPGS_LTI "#SSD ADC Maximaler PGS-Wert nach LTI-Messung" VALUE 0xF1952 MSA15_FW4 0 U 0.000000 5601.173000 EXTENDED_LIMITS 0.000000 160151.500000 /end CHARACTERISTIC
/begin CHARACTERISTIC anwPGS_MAX "#SSD PGS oberer SRC Pedalwertgeber 2 Signal" VALUE 0xF18AE MSA15_FW4 0 U 0.000000 5601.173000 EXTENDED_LIMITS 0.000000 160151.500000 /end CHARACTERISTIC
/begin CHARACTERISTIC anwPGS_MIN "#SSD PGS unterer SRC Pedalwertgeber 2 Signal" VALUE 0xF18B0 MSA15_FW4 0 U 0.000000 5601.173000 EXTENDED_LIMITS 0.000000 160151.500000 /end CHARACTERISTIC
/begin CHARACTERISTIC anwPGS_VOR "#SSD PGS Vorgabewert Pedalwertgeber 2 Signal" VALUE 0xF18B4 MSA15_FW4 0 PROZ_S 0.000000 100.000000 EXTENDED_LIMITS -327.680000 327.670000 /end CHARACTERISTIC
/begin CHARACTERISTIC anwPWG_DPL "#SSD PWG Rampensteigung Pedalwertgeber 1 Signal" VALUE 0xF189E MSA15_FW4 0 PROZDT 0.000000 10000.000000 EXTENDED_LIMITS 0.000000 16383.500000 /end CHARACTERISTIC
/begin CHARACTERISTIC anwPWG_GEB "#SSD PWG Geberkennwort Pedalwertgeber 1 Signal" VALUE 0xF189A MSA15_FW3 0 DEZ_DW_U 0.000000 65535.000000 /end CHARACTERISTIC
/begin CHARACTERISTIC anwPWG_KAN "PWG Kanal Pedalwertgeber 1 Signal" VALUE 0xF1894 MSA15_FW3 0 DEZ_DW_U 13.000000 13.000000 EXTENDED_LIMITS 0.000000 65535.000000 /end CHARACTERISTIC
/begin CHARACTERISTIC anwPWG_KL "#SSD PWG - Linearisierung PWG = f(U_PWG)" CURVE 0xF18A0 MSA15_KL118 0 PROZ_S 0.000000 100.000000
 /begin AXIS_DESCR STD_AXIS anoU_PWG U 2 0.000000 5000.000000 EXTENDED_LIMITS 0.000000 160151.500000 /end AXIS_DESCR
 EXTENDED_LIMITS -327.680000 327.670000 /end CHARACTERISTIC
/begin CHARACTERISTIC anwPWG_MAX "#SSD PWG oberer SRC Pedalwertgeber 1 Signal" VALUE 0xF1896 MSA15_FW4 0 U 0.000000 5601.173000 EXTENDED_LIMITS 0.000000 160151.500000 /end CHARACTERISTIC
/begin CHARACTERISTIC anwPWG_MIN "#SSD PWG unterer SRC Pedalwertgeber 1 Signal" VALUE 0xF1898 MSA15_FW4 0 U 0.000000 5601.173000 EXTENDED_LIMITS 0.000000 160151.500000 /end CHARACTERISTIC
/begin CHARACTERISTIC anwPWG_VOR "#SSD PWG Vorgabewert Pedalwertgeber 1 Signal" VALUE 0xF189C MSA15_FW4 0 PROZ_S 0.000000 100.000000 EXTENDED_LIMITS -327.680000 327.670000 /end CHARACTERISTIC
/begin CHARACTERISTIC anwTST_KAN "#SSD ADC Kanal       ADC-Testspannung" VALUE 0xF194C MSA15_FW3 0 DEZ_DW_U 106.000000 106.000000 EXTENDED_LIMITS 0.000000 65535.000000 /end CHARACTERISTIC
/begin CHARACTERISTIC anwTST_MAX "#SSD ADC oberer  SRC ADC-Testspannung" VALUE 0xF194E MSA15_FW4 0 U 0.000000 5601.173000 EXTENDED_LIMITS 0.000000 160151.500000 /end CHARACTERISTIC
/begin CHARACTERISTIC anwTST_MIN "#SSD ADC unterer SRC ADC-Testspannung" VALUE 0xF1950 MSA15_FW4 0 U 0.000000 5601.173000 EXTENDED_LIMITS 0.000000 160151.500000 /end CHARACTERISTIC
/begin CHARACTERISTIC anwUBT_DPL "UBT Rampensteigung Batteriespannung" VALUE 0xF19F6 MSA15_FW4 0 U_B_DZ100 0.000000 249896.900000 EXTENDED_LIMITS 0.000000 7739481.000000 /end CHARACTERISTIC
/begin CHARACTERISTIC anwUBT_GEB "UBT Geberkennwort Batteriespannung" VALUE 0xF19F2 MSA15_FW3 0 DEZ_DW_U 0.000000 65535.000000 /end CHARACTERISTIC
/begin CHARACTERISTIC anwUBT_KAN "UBT Kanal Batteriespannung" VALUE 0xF19EC MSA15_FW3 0 DEZ_DW_U 9.000000 9.000000 EXTENDED_LIMITS 0.000000 65535.000000 /end CHARACTERISTIC
/begin CHARACTERISTIC anwUBT_KL "UBATT - Liniarisierung" CURVE 0xF19F8 MSA15_KL118 0 U_B 0.000000 24163.000000
 /begin AXIS_DESCR STD_AXIS anoU_UBT U 2 0.000000 24164.220000 EXTENDED_LIMITS 0.000000 160151.500000 /end AXIS_DESCR
 EXTENDED_LIMITS 0.000000 773948.100000 /end CHARACTERISTIC
/begin CHARACTERISTIC anwUBT_MAX "#SSD UBT oberer SRC Batteriespannung" VALUE 0xF19EE MSA15_FW4 0 U_B 0.000000 24163.000000 EXTENDED_LIMITS 0.000000 773948.100000 /end CHARACTERISTIC
/begin CHARACTERISTIC anwUBT_MIN "#SSD UBT unterer SRC Batteriespannung" VALUE 0xF19F0 MSA15_FW4 0 U_B 0.000000 24163.000000 EXTENDED_LIMITS 0.000000 773948.100000 /end CHARACTERISTIC
/begin CHARACTERISTIC anwUBT_VOR "UBT Vorgabewert Batteriespannung" VALUE 0xF19F4 MSA15_FW4 0 U_B 0.000000 24163.000000 EXTENDED_LIMITS 0.000000 773948.100000 /end CHARACTERISTIC
/begin CHARACTERISTIC anwUC1_DPL "UC Rampensteigung Kondensatorspannung Bank 1" VALUE 0xF1A0E MSA15_FW4 0 U_C 0.000000 109997.900000 EXTENDED_LIMITS 0.000000 1348179.000000 /end CHARACTERISTIC
/begin CHARACTERISTIC anwUC1_GEB "UC Geberkennwort Kondensatorspannung     Bank 1" VALUE 0xF1A0A MSA15_FW3 0 DEZ_DW_U 0.000000 65535.000000 /end CHARACTERISTIC
/begin CHARACTERISTIC anwUC1_KAN "#SSD UC Kanal Kondensatorspannung Bank 1" VALUE 0xF1A04 MSA15_FW3 0 DEZ_DW_U 0.000000 65535.000000 /end CHARACTERISTIC
/begin CHARACTERISTIC anwUC1_KL "UC - Liniarisierung Bank 1" CURVE 0xF1A10 MSA15_KL118 0 U_C 0.000000 109997.900000
 /begin AXIS_DESCR STD_AXIS anoU_UC1 U 6 0.000000 32766.370000 EXTENDED_LIMITS 0.000000 160151.500000 /end AXIS_DESCR
 EXTENDED_LIMITS 0.000000 1348179.000000 /end CHARACTERISTIC
/begin CHARACTERISTIC anwUC1_MAX "UC oberer SRC Kondensatorspannung Bank 1" VALUE 0xF1A06 MSA15_FW4 0 U 0.000000 5601.173000 EXTENDED_LIMITS 0.000000 160151.500000 /end CHARACTERISTIC
/begin CHARACTERISTIC anwUC1_MIN "UC unterer SRC Kondensatorspannung Bank 1" VALUE 0xF1A08 MSA15_FW4 0 U 0.000000 5601.173000 EXTENDED_LIMITS 0.000000 160151.500000 /end CHARACTERISTIC
/begin CHARACTERISTIC anwUC1_VOR "UC Vorgabewert Kondensatorspannung Bank 1" VALUE 0xF1A0C MSA15_FW4 0 U_C 0.000000 109997.900000 EXTENDED_LIMITS 0.000000 1348179.000000 /end CHARACTERISTIC
/begin CHARACTERISTIC anwUC2_DPL "UC Rampensteigung Kondensatorspannung Bank 2" VALUE 0xF1A36 MSA15_FW4 0 U_C 0.000000 109997.900000 EXTENDED_LIMITS 0.000000 1348179.000000 /end CHARACTERISTIC
/begin CHARACTERISTIC anwUC2_GEB "UC Geberkennwort Kondensatorspannung Bank 2" VALUE 0xF1A32 MSA15_FW3 0 DEZ_DW_U 0.000000 65535.000000 /end CHARACTERISTIC
/begin CHARACTERISTIC anwUC2_KAN "#SSD UC Kanal Kondensatorspannung        Bank 2" VALUE 0xF1A2C MSA15_FW3 0 DEZ_DW_U 1.000000 1.000000 EXTENDED_LIMITS 0.000000 65535.000000 /end CHARACTERISTIC
/begin CHARACTERISTIC anwUC2_KL "UC2 - Liniarisierung     Bank 2" CURVE 0xF1A38 MSA15_KL118 0 U_C 0.000000 109997.900000
 /begin AXIS_DESCR STD_AXIS anoU_UC2 U 6 0.000000 32766.370000 EXTENDED_LIMITS 0.000000 160151.500000 /end AXIS_DESCR
 EXTENDED_LIMITS 0.000000 1348179.000000 /end CHARACTERISTIC
/begin CHARACTERISTIC anwUC2_MAX "UC oberer SRC Kondensatorspannung Bank 2" VALUE 0xF1A2E MSA15_FW4 0 U 0.000000 5601.173000 EXTENDED_LIMITS 0.000000 160151.500000 /end CHARACTERISTIC
/begin CHARACTERISTIC anwUC2_MIN "UC unterer SRC Kondensatorspannung Bank 2" VALUE 0xF1A30 MSA15_FW4 0 U 0.000000 5601.173000 EXTENDED_LIMITS 0.000000 160151.500000 /end CHARACTERISTIC
/begin CHARACTERISTIC anwUC2_VOR "UC Vorgabewert Kondensatorspannung Bank 2" VALUE 0xF1A34 MSA15_FW4 0 U_C 0.000000 109997.900000 EXTENDED_LIMITS 0.000000 1348179.000000 /end CHARACTERISTIC
/begin CHARACTERISTIC anwUG1_DPL "#SSD UG1 Rampensteigung Geber-Speisung 1" VALUE 0xF1B08 MSA15_FW4 0 dU_dZ100 0.000000 250000.000000 EXTENDED_LIMITS 0.000000 1601515.000000 /end CHARACTERISTIC
/begin CHARACTERISTIC anwUG1_GEB "#SSD UG1 Geberkennwort Geber-Speisung    1" VALUE 0xF1B04 MSA15_FW3 0 DEZ_DW_U 0.000000 65535.000000 /end CHARACTERISTIC
/begin CHARACTERISTIC anwUG1_KAN "#SSD UG1 Kanal Geber-Speisung 1" VALUE 0xF1AFE MSA15_FW3 0 DEZ_DW_U 42.000000 42.000000 EXTENDED_LIMITS 0.000000 65535.000000 /end CHARACTERISTIC
/begin CHARACTERISTIC anwUG1_KL "#SSD UG1 - Liniarisierung" CURVE 0xF1B0A MSA15_KL118 0 U 0.000000 24164.220000
 /begin AXIS_DESCR STD_AXIS anoU_UG1 U 2 0.000000 24164.220000 EXTENDED_LIMITS 0.000000 160151.500000 /end AXIS_DESCR
 EXTENDED_LIMITS 0.000000 160151.500000 /end CHARACTERISTIC
/begin CHARACTERISTIC anwUG1_MAX "#SSD UG1 oberer SRC Geber-Speisung 1" VALUE 0xF1B00 MSA15_FW4 0 U_G 0.000000 5593.206000 EXTENDED_LIMITS 0.000000 578147.000000 /end CHARACTERISTIC
/begin CHARACTERISTIC anwUG1_MIN "#SSD UG1 unterer SRC Geber-Speisung 1" VALUE 0xF1B02 MSA15_FW4 0 U_G 0.000000 5593.206000 EXTENDED_LIMITS 0.000000 578147.000000 /end CHARACTERISTIC
/begin CHARACTERISTIC anwUG1_VOR "#SSD UG1 Vorgabewert Geber-Speisung 1" VALUE 0xF1B06 MSA15_FW4 0 U_G 0.000000 5593.206000 EXTENDED_LIMITS 0.000000 578147.000000 /end CHARACTERISTIC
/begin CHARACTERISTIC anwUG2_DPL "#SSD UG2 Rampensteigung Geber-Speisung 2" VALUE 0xF1B20 MSA15_FW4 0 dU_dZ100 0.000000 250000.000000 EXTENDED_LIMITS 0.000000 1601515.000000 /end CHARACTERISTIC
/begin CHARACTERISTIC anwUG2_GEB "#SSD UG2 Geberkennwort Geber-Speisung 2" VALUE 0xF1B1C MSA15_FW3 0 DEZ_DW_U 0.000000 65535.000000 /end CHARACTERISTIC
/begin CHARACTERISTIC anwUG2_KAN "#SSD UG2 Kanal Geber-Speisung 2" VALUE 0xF1B16 MSA15_FW3 0 DEZ_DW_U 43.000000 43.000000 EXTENDED_LIMITS 0.000000 65535.000000 /end CHARACTERISTIC
/begin CHARACTERISTIC anwUG2_KL "#SSD UG2 - Liniarisierung" CURVE 0xF1B22 MSA15_KL118 0 U 0.000000 24164.220000
 /begin AXIS_DESCR STD_AXIS anoU_UG2 U 2 0.000000 24164.220000 EXTENDED_LIMITS 0.000000 160151.500000 /end AXIS_DESCR
 EXTENDED_LIMITS 0.000000 160151.500000 /end CHARACTERISTIC
/begin CHARACTERISTIC anwUG2_MAX "#SSD UG2 oberer SRC Geber-Speisung 2" VALUE 0xF1B18 MSA15_FW4 0 U_G 0.000000 5593.206000 EXTENDED_LIMITS 0.000000 578147.000000 /end CHARACTERISTIC
/begin CHARACTERISTIC anwUG2_MIN "#SSD UG2 unterer SRC Geber-Speisung      2" VALUE 0xF1B1A MSA15_FW4 0 U_G 0.000000 5593.206000 EXTENDED_LIMITS 0.000000 578147.000000 /end CHARACTERISTIC
/begin CHARACTERISTIC anwUG2_VOR "#SSD UG2 Vorgabewert Geber-Speisung      2" VALUE 0xF1B1E MSA15_FW4 0 U_G 0.000000 5593.206000 EXTENDED_LIMITS 0.000000 578147.000000 /end CHARACTERISTIC
/begin CHARACTERISTIC anwVDF_DPL "VDF Rampensteigung Vorfoerderdruckfuehler" VALUE 0xF1936 MSA15_FW4 0 dPV_dZ100 0.000000 40000.000000 EXTENDED_LIMITS -327680.000000 327670.000000 /end CHARACTERISTIC
/begin CHARACTERISTIC anwVDF_GEB "#SSD VDF Geberkennwort  Vorfoerderdruckfuehler" VALUE 0xF1932 MSA15_FW3 0 DEZ_DW_U 0.000000 65535.000000 /end CHARACTERISTIC
/begin CHARACTERISTIC anwVDF_KAN "#SSD VDF Kanal          Vorfoerderdruckfuehler" VALUE 0xF192C MSA15_FW3 0 DEZ_DW_U 8.000000 8.000000 EXTENDED_LIMITS 0.000000 65535.000000 /end CHARACTERISTIC
/begin CHARACTERISTIC anwVDF_KL "#SSD VDF - Linearisierung     P_VDF = f(U_VDF)" CURVE 0xF1938 MSA15_KL118 0 VDF 0.000000 5000.000000
 /begin AXIS_DESCR STD_AXIS anoU_VDF U 4 0.000000 5000.000000 EXTENDED_LIMITS 0.000000 160151.500000 /end AXIS_DESCR
 EXTENDED_LIMITS -32768.000000 32767.000000 /end CHARACTERISTIC
/begin CHARACTERISTIC anwVDF_MAX "#SSD VDF oberer  SRC    Vorfoerderdruckfuehler" VALUE 0xF192E MSA15_FW4 0 U 0.000000 5601.173000 EXTENDED_LIMITS 0.000000 160151.500000 /end CHARACTERISTIC
/begin CHARACTERISTIC anwVDF_MIN "#SSD VDF unterer SRC    Vorfoerderdruckfuehler" VALUE 0xF1930 MSA15_FW4 0 U 0.000000 5601.173000 EXTENDED_LIMITS 0.000000 160151.500000 /end CHARACTERISTIC
/begin CHARACTERISTIC anwVDF_VOR "#SSD VDF Vorgabewert    Vorfoerderdruckfuehler" VALUE 0xF1934 MSA15_FW4 0 VDF 0.000000 5000.000000 EXTENDED_LIMITS -32768.000000 32767.000000 /end CHARACTERISTIC
/begin CHARACTERISTIC anwWSZ_DZ "WTF N-Schwelle fuer WTF-Plausibilitaet-Test" VALUE 0xF1ADE MSA15_FW4 0 N 0.000000 6000.000000 EXTENDED_LIMITS 0.000000 32767.000000 /end CHARACTERISTIC
/begin CHARACTERISTIC anwWSZ_STM "WTF T_W-Schwelle fuer WTF-Plausibilitaet-Test" VALUE 0xF1AE2 MSA15_FW4 0 T -50.040010 149.960000 EXTENDED_LIMITS -273.140000 3003.560000 /end CHARACTERISTIC
/begin CHARACTERISTIC anwWSZ_SZT "WTF Wartezeit fuer WTF-Plausibilitaet-Test" VALUE 0xF1AE0 MSA15_FW3 0 ZEIT_T100 0.000000 6553500000.000000 /end CHARACTERISTIC
/begin CHARACTERISTIC anwWSZ_mM "WTF Mindestmenge fuer Plaus.-Test" VALUE 0xF1AE8 MSA15_FW4 0 MM3 0.000000 100.000000 EXTENDED_LIMITS -327.680000 327.670000 /end CHARACTERISTIC
/begin CHARACTERISTIC anwWSZ_mT "WTF Mindesttemperatur" VALUE 0xF1AE6 MSA15_FW4 0 T -50.040010 149.960000 EXTENDED_LIMITS -273.140000 3003.560000 /end CHARACTERISTIC
/begin CHARACTERISTIC anwWSZ_mTA "WTF Mindesttemperaturanstieg" VALUE 0xF1AE4 MSA15_FW4 0 dT 0.000000 150.000000 EXTENDED_LIMITS 0.000000 3276.700000 /end CHARACTERISTIC
/begin CHARACTERISTIC anwWSZ_zKL "WTF zulaessige Erwaermungszeit = f(T_WTF)" CURVE 0xF1AEA MSA15_KL117 0 ZEIT_100 0.000000 6553.500000
 /begin AXIS_DESCR STD_AXIS anmWTF T 4 -50.040010 149.960000 EXTENDED_LIMITS -273.140000 3003.560000 /end AXIS_DESCR
/end CHARACTERISTIC
/begin CHARACTERISTIC anwWTF_DPL "WTF Rampensteigung Wassertemperaturfuehler Signal" VALUE 0xF1A60 MSA15_FW4 0 dT_dZ100 0.000000 2000.000000 EXTENDED_LIMITS -32768.000000 32767.000000 /end CHARACTERISTIC
/begin CHARACTERISTIC anwWTF_GEB "WTF Geberkennwort Wassertemperaturfuehler Signal" VALUE 0xF1A5A MSA15_FW3 0 DEZ_DW_U 0.000000 65535.000000 /end CHARACTERISTIC
/begin CHARACTERISTIC anwWTF_KAN "WTF Kanal Wassertemperaturfuehler Signal" VALUE 0xF1A54 MSA15_FW3 0 DEZ_DW_U 58.000000 58.000000 EXTENDED_LIMITS 0.000000 65535.000000 /end CHARACTERISTIC
/begin CHARACTERISTIC anwWTF_KL "WTF - Linearisierung T_WTF = f(U_WTF)" CURVE 0xF1A62 MSA15_KL118 0 T -50.040010 149.960000
 /begin AXIS_DESCR STD_AXIS anoU_WTF U 24 0.000000 5000.000000 EXTENDED_LIMITS 0.000000 160151.500000 /end AXIS_DESCR
 EXTENDED_LIMITS -273.140000 3003.560000 /end CHARACTERISTIC
/begin CHARACTERISTIC anwWTF_MAX "WTF oberer SRC Wassertemperaturfuehler Signal" VALUE 0xF1A56 MSA15_FW4 0 U 0.000000 5601.173000 EXTENDED_LIMITS 0.000000 160151.500000 /end CHARACTERISTIC
/begin CHARACTERISTIC anwWTF_MIN "WTF unterer SRC Wassertemperaturfuehler Signal" VALUE 0xF1A58 MSA15_FW4 0 U 0.000000 5601.173000 EXTENDED_LIMITS 0.000000 160151.500000 /end CHARACTERISTIC
/begin CHARACTERISTIC anwWTF_VGN "WTF Vorgabewert Wassertemperaturfuehler nicht Start" VALUE 0xF1A5E MSA15_FW4 0 T -50.040010 149.960000 EXTENDED_LIMITS -273.140000 3003.560000 /end CHARACTERISTIC
/begin CHARACTERISTIC anwWTF_VGS "WTF Vorgabewert Wassertemperaturfuehler Start" VALUE 0xF1A5C MSA15_FW4 0 T -50.040010 149.960000 EXTENDED_LIMITS -273.140000 3003.560000 /end CHARACTERISTIC
/begin CHARACTERISTIC arwADAGH1 "ADF obere Schwelle" VALUE 0xF49F2 MSA15_FW4 0 P 500.000000 1500.000000 EXTENDED_LIMITS -32768.000000 32767.000000 /end CHARACTERISTIC
/begin CHARACTERISTIC arwADAGH2 "ADF untere Schwelle" VALUE 0xF49F4 MSA15_FW4 0 P 500.000000 1500.000000 EXTENDED_LIMITS -32768.000000 32767.000000 /end CHARACTERISTIC
/begin CHARACTERISTIC arwADAGV1 "N obere Schwelle LB" VALUE 0xF4A0A MSA15_FW4 0 N 0.000000 6000.000000 EXTENDED_LIMITS 0.000000 32767.000000 /end CHARACTERISTIC
/begin CHARACTERISTIC arwADAGV2 "N untere Schwelle LB" VALUE 0xF4A0C MSA15_FW4 0 N 0.000000 6000.000000 EXTENDED_LIMITS 0.000000 32767.000000 /end CHARACTERISTIC
/begin CHARACTERISTIC arwAMEGV1 "Einspritzmenge obere Schwelle LB" VALUE 0xF4A0E MSA15_FW4 0 M_E 0.000000 100.000000 EXTENDED_LIMITS -327.680000 327.670000 /end CHARACTERISTIC
/begin CHARACTERISTIC arwAMEGV2 "Einspritzmenge untere Schwelle LB" VALUE 0xF4A10 MSA15_FW4 0 M_E 0.000000 100.000000 EXTENDED_LIMITS -327.680000 327.670000 /end CHARACTERISTIC
/begin CHARACTERISTIC arwATDFMX "obere Schwelle LDF-ADF" VALUE 0xF49FE MSA15_FW4 0 P 0.000000 1500.000000 EXTENDED_LIMITS -32768.000000 32767.000000 /end CHARACTERISTIC
/begin CHARACTERISTIC arwBGNWUKF "ARF maximales Luftmengenkennfeld   M_L = f(N, M_E)" MAP 0xF1EEC MSA15_KF382 0 M_L -1500.000000 1500.000000
 /begin AXIS_DESCR STD_AXIS dzmNmit N 6 0.000000 6000.000000 EXTENDED_LIMITS 0.000000 32767.000000 /end AXIS_DESCR
 /begin AXIS_DESCR STD_AXIS aroWU_LLR MM3 6 0.000000 100.000000 EXTENDED_LIMITS -327.680000 327.670000 /end AXIS_DESCR
 EXTENDED_LIMITS -3276.800000 3276.700000 /end CHARACTERISTIC
/begin RECORD_LAYOUT MSA15_KF382 SRC_ADDR_X 1 UWORD NO_AXIS_PTS_X 2 UWORD AXIS_PTS_X 3 SWORD INDEX_INCR DIRECT SRC_ADDR_Y 4 UWORD NO_AXIS_PTS_Y 5 UWORD AXIS_PTS_Y 6 SWORD INDEX_INCR DIRECT FNC_VALUES 7 SWORD COLUMN_DIR DIRECT /end RECORD_LAYOUT
/begin CHARACTERISTIC arwDRA_AB "Maximaldrehzahl fuer Berechnung Drallklappensteuerung" VALUE 0xF4974 MSA15_FW4 0 N 0.000000 6000.000000 EXTENDED_LIMITS 0.000000 32767.000000 /end CHARACTERISTIC
/begin CHARACTERISTIC arwDR_GF "ARF Filterzeitkonstante PWG-Differenzierer" VALUE 0xF4DB8 MSA15_FW4 0 GF 0.000031 0.999969 /end CHARACTERISTIC
/begin CHARACTERISTIC arwDR_KOF "ARF Verstaerkungskoeffizient PWG-Differenzierer" VALUE 0xF4DB4 MSA15_FW4 0 ARD_dPWG 0.000000 30.000310 EXTENDED_LIMITS -50.000000 49.998470 /end CHARACTERISTIC
/begin CHARACTERISTIC arwDZAGH1 "N obere Schwelle LL" VALUE 0xF49FA MSA15_FW4 0 N 0.000000 6000.000000 EXTENDED_LIMITS 0.000000 32767.000000 /end CHARACTERISTIC
/begin CHARACTERISTIC arwDZAGH2 "N untere Schwelle LL" VALUE 0xF49FC MSA15_FW4 0 N 0.000000 6000.000000 EXTENDED_LIMITS 0.000000 32767.000000 /end CHARACTERISTIC
/begin CHARACTERISTIC arwDraFix "Ersatzwert Tastverhaeltnis" VALUE 0xF4970 MSA15_FW3 0 PROZ 0.000000 100.000000 EXTENDED_LIMITS -327.680000 327.670000 /end CHARACTERISTIC
/begin CHARACTERISTIC arwDraLTKL "Tastverhaeltnisabgleich LTF W = f(X)" CURVE 0xF4DD4 MSA15_KL118 0 PROZ 0.000000 100.000000
 /begin AXIS_DESCR STD_AXIS anmLTF T 6 -0.040009 199.960000 EXTENDED_LIMITS -273.140000 3003.560000 /end AXIS_DESCR
 EXTENDED_LIMITS -327.680000 327.670000 /end CHARACTERISTIC
/begin CHARACTERISTIC arwDraMax "obere Schwelle Tastverhaeltnis" VALUE 0xF496E MSA15_FW3 0 PROZ 0.000000 100.000000 EXTENDED_LIMITS -327.680000 327.670000 /end CHARACTERISTIC
/begin CHARACTERISTIC arwDraTVKF "Tastverhaeltnis ARF-KF  FAKT = f(M_E, N)" MAP 0xF4C30 MSA15_KF382 0 PROZ 0.000000 100.000000
 /begin AXIS_DESCR STD_AXIS mrmM_EAKT MM3 8 0.000000 100.000000 EXTENDED_LIMITS -327.680000 327.670000 /end AXIS_DESCR
 /begin AXIS_DESCR STD_AXIS dzmNmit N 8 0.000000 6000.000000 EXTENDED_LIMITS 0.000000 32767.000000 /end AXIS_DESCR
 EXTENDED_LIMITS -327.680000 327.670000 /end CHARACTERISTIC
/begin CHARACTERISTIC arwDraVerz "Einschaltverzoegerung fuer Drallklappe" VALUE 0xF4972 MSA15_FW3 0 ZEIT_ST 0.000000 655350000.000000 /end CHARACTERISTIC
/begin CHARACTERISTIC arwDraWTKL "Tastverhaeltnisabgleich WTF W = f(X)" CURVE 0xF4DF0 MSA15_KL118 0 PROZ 0.000000 100.000000
 /begin AXIS_DESCR STD_AXIS anmWTF T 6 -0.040009 199.960000 EXTENDED_LIMITS -273.140000 3003.560000 /end AXIS_DESCR
 EXTENDED_LIMITS -327.680000 327.670000 /end CHARACTERISTIC
/begin CHARACTERISTIC arwFGAGH1 "obere Schwelle Fahrtgeschwindigkeit" VALUE 0xF4A36 MSA15_FW4 0 V 0.000000 300.000000 EXTENDED_LIMITS 0.000000 327.670000 /end CHARACTERISTIC
/begin CHARACTERISTIC arwFGAGH2 "Untere Schwelle Fahrtgeschwindigkeit" VALUE 0xF4A38 MSA15_FW4 0 V 0.000000 300.000000 EXTENDED_LIMITS 0.000000 327.670000 /end CHARACTERISTIC
/begin CHARACTERISTIC arwGR_MAX "ARF obere Begrenzung PI-Reglerausgang" VALUE 0xF4990 MSA15_FW4 0 PROZ 0.000000 100.000000 EXTENDED_LIMITS -327.680000 327.670000 /end CHARACTERISTIC
/begin CHARACTERISTIC arwGR_MIN "ARF untere Begrenzung PI-Reglerausgang" VALUE 0xF4992 MSA15_FW4 0 PROZ 0.000000 100.000000 EXTENDED_LIMITS -327.680000 327.670000 /end CHARACTERISTIC
/begin CHARACTERISTIC arwHYS_S1 "ARF obere Hyster.-Ausschaltschwelle S/W-Steuerung" VALUE 0xF4914 MSA15_FW4 0 PROZ 0.000000 100.000000 EXTENDED_LIMITS -327.680000 327.670000 /end CHARACTERISTIC
/begin CHARACTERISTIC arwHYS_S2 "ARF untere Hyster.-Einschaltschwelle S/W-Steuerung" VALUE 0xF4916 MSA15_FW4 0 PROZ 0.000000 100.000000 EXTENDED_LIMITS -327.680000 327.670000 /end CHARACTERISTIC
/begin CHARACTERISTIC arwHYS_W1 "ARF Tastverhaeltnis zum Ausschalten S/W-Steuerung" VALUE 0xF4918 MSA15_FW4 0 PROZ 0.000000 100.000000 EXTENDED_LIMITS -327.680000 327.670000 /end CHARACTERISTIC
/begin CHARACTERISTIC arwHYS_W2 "ARF Tastverhaeltnis zum Einschalten S/W-Steuerung" VALUE 0xF491A MSA15_FW4 0 PROZ 0.000000 100.000000 EXTENDED_LIMITS -327.680000 327.670000 /end CHARACTERISTIC
/begin CHARACTERISTIC arwIR_FEN "ARF Fenster Kleinsignal I-Regler" VALUE 0xF4986 MSA15_FW4 0 M_L 0.000000 1500.000000 EXTENDED_LIMITS -3276.800000 3276.700000 /end CHARACTERISTIC
/begin CHARACTERISTIC arwIR_NEG "ARF I-Verstaerkung negatives Grossignal" VALUE 0xF498A MSA15_FW4 0 ARF_KI 0.000000 1.999969 EXTENDED_LIMITS 0.000000 4.999847 /end CHARACTERISTIC
/begin CHARACTERISTIC arwIR_POS "ARF I-Verstaerkung positives Grossignal" VALUE 0xF498C MSA15_FW4 0 ARF_KI 0.000000 1.999969 EXTENDED_LIMITS 0.000000 4.999847 /end CHARACTERISTIC
/begin CHARACTERISTIC arwIR_SIG "ARF I-Verstaerkung Kleinsignal" VALUE 0xF4988 MSA15_FW4 0 ARF_KI 0.000000 1.999969 EXTENDED_LIMITS 0.000000 4.999847 /end CHARACTERISTIC
/begin CHARACTERISTIC arwKDV_FEN "ARF Fenster Klein-S. neg. Vorsteuern/kalter Motor" VALUE 0xF1BB0 MSA15_FW4 0 dVE_dZ -3000.000000 3000.000000 EXTENDED_LIMITS -16384.000000 16383.500000 /end CHARACTERISTIC
/begin CHARACTERISTIC arwKDV_FEP "ARF Fenster Klein-S. pos. Vorsteuern/kalter Motor" VALUE 0xF1BA8 MSA15_FW4 0 dVE_dZ -3000.000000 3000.000000 EXTENDED_LIMITS -16384.000000 16383.500000 /end CHARACTERISTIC
/begin CHARACTERISTIC arwKDV_GFN "ARF Gedaechtnisfaktor neg. Vorsteuern/kalter Motor" VALUE 0xF1BAE MSA15_FW4 0 GF 0.000031 0.999969 /end CHARACTERISTIC
/begin CHARACTERISTIC arwKDV_GFP "ARF Gedaechtnisfaktor pos. Vorsteuern/kalter Motor" VALUE 0xF1BA6 MSA15_FW4 0 GF 0.000031 0.999969 /end CHARACTERISTIC
/begin CHARACTERISTIC arwKDV_NEG "ARF Verstaerk. Gross-S. neg. Vorsteuern/kalter Motor" VALUE 0xF1BB4 MSA15_FW4 0 ARF_KD 0.000000 3465.781000 EXTENDED_LIMITS 0.000000 5119.844000 /end CHARACTERISTIC
/begin CHARACTERISTIC arwKDV_POS "ARF Verstaerk. Gross-S. pos. Vorsteuern/kalter Motor" VALUE 0xF1BAC MSA15_FW4 0 ARF_KD 0.000000 3465.781000 EXTENDED_LIMITS 0.000000 5119.844000 /end CHARACTERISTIC
/begin CHARACTERISTIC arwKDV_SIN "ARF Verstaerk. Klein-S. neg. Vorsteuern/kalter Motor" VALUE 0xF1BB2 MSA15_FW4 0 ARF_KD 0.000000 3465.781000 EXTENDED_LIMITS 0.000000 5119.844000 /end CHARACTERISTIC
/begin CHARACTERISTIC arwKDV_SIP "ARF Verstaerk. Klein-S. pos. Vorsteuern/kalter Motor" VALUE 0xF1BAA MSA15_FW4 0 ARF_KD 0.000000 3465.781000 EXTENDED_LIMITS 0.000000 5119.844000 /end CHARACTERISTIC
/begin CHARACTERISTIC arwLDAGH1 "obere Schwelle Ladedruck" VALUE 0xF4A32 MSA15_FW4 0 P 0.000000 3500.000000 EXTENDED_LIMITS -32768.000000 32767.000000 /end CHARACTERISTIC
/begin CHARACTERISTIC arwLDAGH2 "untere Schwelle Ladedruck" VALUE 0xF4A34 MSA15_FW4 0 P 0.000000 3500.000000 EXTENDED_LIMITS -32768.000000 32767.000000 /end CHARACTERISTIC
/begin CHARACTERISTIC arwLMABSB1 "Schrittbegrenzung Leerlaufbereich" VALUE 0xF4A26 MSA15_FW4 0 FAKT 0.000000 3.200000 EXTENDED_LIMITS -3.276800 3.276700 /end CHARACTERISTIC
/begin CHARACTERISTIC arwLMABSB2 "Schrittbegrenzung Lastbereich" VALUE 0xF4A28 MSA15_FW4 0 FAKT 0.000000 3.200000 EXTENDED_LIMITS -3.276800 3.276700 /end CHARACTERISTIC
/begin CHARACTERISTIC arwLMADLG1 "obere Schwelle Defekterkennung Leerlaufbereich" VALUE 0xF4A1E MSA15_FW4 0 FAKT 0.000000 3.200000 EXTENDED_LIMITS -3.276800 3.276700 /end CHARACTERISTIC
/begin CHARACTERISTIC arwLMADLG2 "obere Schwelle Defekterkennung Lastbereich" VALUE 0xF4A20 MSA15_FW4 0 FAKT 0.000000 3.200000 EXTENDED_LIMITS -3.276800 3.276700 /end CHARACTERISTIC
/begin CHARACTERISTIC arwLMAGK1 "Fuellungsgrad bei Leerlauf" VALUE 0xF4A16 MSA15_FW4 0 FAKT 0.000000 3.200000 EXTENDED_LIMITS -3.276800 3.276700 /end CHARACTERISTIC
/begin CHARACTERISTIC arwLMAGK2 "LMM Luftmassen-Korrektur-KF  FAKT = f(N, M_E)" MAP 0xF4B20 MSA15_KF382 0 FAKT 0.000000 3.200000
 /begin AXIS_DESCR STD_AXIS dzmNmit N 10 0.000000 6000.000000 EXTENDED_LIMITS 0.000000 32767.000000 /end AXIS_DESCR
 /begin AXIS_DESCR STD_AXIS mrmM_EAKT MM3 10 0.000000 100.000000 EXTENDED_LIMITS -327.680000 327.670000 /end AXIS_DESCR
 EXTENDED_LIMITS -3.276800 3.276700 /end CHARACTERISTIC
/begin CHARACTERISTIC arwLMAGRA1 "untere Schwelle Korrektur Leerlaufbereich" VALUE 0xF4A22 MSA15_FW4 0 FAKT 0.000000 3.200000 EXTENDED_LIMITS -3.276800 3.276700 /end CHARACTERISTIC
/begin CHARACTERISTIC arwLMAGRA2 "untere Schwelle Korrektur Lastbereich" VALUE 0xF4A24 MSA15_FW4 0 FAKT 0.000000 3.200000 EXTENDED_LIMITS -3.276800 3.276700 /end CHARACTERISTIC
/begin CHARACTERISTIC arwLMAGRF "Referenzwert Luftmengenmesser" VALUE 0xF49EA MSA15_FW4 0 M_Lt 0.000000 300.000000 EXTENDED_LIMITS -3276.800000 3276.700000 /end CHARACTERISTIC
/begin CHARACTERISTIC arwLMAGRX "Abgleichwert obere Schwelle" VALUE 0xF49EC MSA15_FW4 0 M_Lt 0.000000 300.000000 EXTENDED_LIMITS -3276.800000 3276.700000 /end CHARACTERISTIC
/begin CHARACTERISTIC arwLMBEKOF "MLB Anfangswert der HFM-Einschaltkorrektur" VALUE 0xF4910 MSA15_FW4 0 FAKT 0.000000 3.200000 EXTENDED_LIMITS -3.276800 3.276700 /end CHARACTERISTIC
/begin CHARACTERISTIC arwLMBEKTD "MLB Zeitkonstante fuer die HFM-Einschaltkorrektur" VALUE 0xF4912 MSA15_FW3 0 ZEIT_ST 0.000000 655350000.000000 /end CHARACTERISTIC
/begin CHARACTERISTIC arwLMBITK "PLB Isotropenkorrektur-KF  FAKT = f(P_L, P_ADF)" MAP 0xF4A52 MSA15_KF382 0 FAKT 0.000000 3.200000
 /begin AXIS_DESCR STD_AXIS ldmP_Llin P 6 0.000000 3500.000000 EXTENDED_LIMITS -32768.000000 32767.000000 /end AXIS_DESCR
 /begin AXIS_DESCR STD_AXIS ldmADF P 6 0.000000 3500.000000 EXTENDED_LIMITS -32768.000000 32767.000000 /end AXIS_DESCR
 EXTENDED_LIMITS -3.276800 3.276700 /end CHARACTERISTIC
/begin CHARACTERISTIC arwLMBKOKF "MLB Luftmassen-Korrektur-KF  FAKT = f(T_L, P_ADF)" MAP 0xF4B08 MSA15_KF382 0 FAKT 0.000000 3.200000
 /begin AXIS_DESCR STD_AXIS anmLTF T 2 -50.040010 199.960000 EXTENDED_LIMITS -273.140000 3003.560000 /end AXIS_DESCR
 /begin AXIS_DESCR STD_AXIS ldmADF P 2 0.000000 3500.000000 EXTENDED_LIMITS -32768.000000 32767.000000 /end AXIS_DESCR
 EXTENDED_LIMITS -3.276800 3.276700 /end CHARACTERISTIC
/begin CHARACTERISTIC arwLMBLIKL "MLB Luftmesser-Liniarisierungs-KL  M_Lt = f(TV_LM)" CURVE 0xF4CD8 MSA15_KL118 0 M_Lt -1000.000000 1000.000000
 /begin AXIS_DESCR STD_AXIS aroIST_1 LMM 32 0.000000 100.000000 EXTENDED_LIMITS -327.680000 327.670000 /end AXIS_DESCR
 EXTENDED_LIMITS -3276.800000 3276.700000 /end CHARACTERISTIC
/begin CHARACTERISTIC arwLMBMLP2 "PLB Ladedruck-Korrektur-KF   P_Lkorr = f(P_L, T_L)" MAP 0xF4ABA MSA15_KF382 0 P 0.000000 3500.000000
 /begin AXIS_DESCR STD_AXIS aroIST_3 T 5 -50.040010 199.960000 EXTENDED_LIMITS -273.140000 3003.560000 /end AXIS_DESCR
 /begin AXIS_DESCR STD_AXIS aroIST_2 P 5 0.000000 3500.000000 EXTENDED_LIMITS -32768.000000 32767.000000 /end AXIS_DESCR
 EXTENDED_LIMITS -32768.000000 32767.000000 /end CHARACTERISTIC
/begin CHARACTERISTIC arwLMBNORM "MLB Normierungskonstante zur Luftmengenberechnung" VALUE 0xF490A MSA15_FW4 0 LMB_NORM 5.999518 6.000599 EXTENDED_LIMITS 1.017283 33333.330000 /end CHARACTERISTIC
/begin CHARACTERISTIC arwLMBPML "MLB untere M_L-Schwelle  Plausibilitaet M_L = f(N)" VALUE 0xF490E MSA15_FW4 0 M_L 0.000000 1500.000000 EXTENDED_LIMITS -3276.800000 3276.700000 /end CHARACTERISTIC
/begin CHARACTERISTIC arwLMBPN "MLB untere N-Schwelle f. Plausibilitaet M_L = f(N)" VALUE 0xF490C MSA15_FW4 0 N 0.000000 6000.000000 EXTENDED_LIMITS 0.000000 32767.000000 /end CHARACTERISTIC
/begin CHARACTERISTIC arwLMBPN1 "ARF untere Drehzahlschwelle fuer Plausibilitaet" VALUE 0xF4976 MSA15_FW4 0 N 0.000000 6000.000000 EXTENDED_LIMITS 0.000000 32767.000000 /end CHARACTERISTIC
/begin CHARACTERISTIC arwLMBPN2 "ARF obere Drehzahlschwelle fuer Plausibilitaet" VALUE 0xF4978 MSA15_FW4 0 N 0.000000 6000.000000 EXTENDED_LIMITS 0.000000 32767.000000 /end CHARACTERISTIC
/begin CHARACTERISTIC arwLMBPpML "ARF Luftmassenschwelle fuer Plausibilitaet" VALUE 0xF497A MSA15_FW4 0 M_L 0.000000 1500.000000 EXTENDED_LIMITS -3276.800000 3276.700000 /end CHARACTERISTIC
/begin CHARACTERISTIC arwLMB_EKL "MLB Ermittlung eines VGW = f(n)" CURVE 0xF4D74 MSA15_KL118 0 M_L 0.000000 1500.000000
 /begin AXIS_DESCR STD_AXIS dzmNmit N 15 0.000000 6000.000000 EXTENDED_LIMITS 0.000000 32767.000000 /end AXIS_DESCR
 EXTENDED_LIMITS -3276.800000 3276.700000 /end CHARACTERISTIC
/begin CHARACTERISTIC arwLMDGRX "obere Schwelle LTF-LTFalt" VALUE 0xF4A14 MSA15_FW4 0 dL_dZHP5 0.000000 10000.000000 EXTENDED_LIMITS -32768.000000 32767.000000 /end CHARACTERISTIC
/begin CHARACTERISTIC arwLMD_GF "Gedaechtnisfaktor PT1-LDF" VALUE 0xF4DCA MSA15_FW4 0 GF 0.000031 0.999969 /end CHARACTERISTIC
/begin CHARACTERISTIC arwLMKORKF "Gewichtungsfaktor fuer Ersatzmenge  FAKT = f(N, M_E)" MAP 0xF4C18 MSA15_KF382 0 FAKT 0.000000 3.200000
 /begin AXIS_DESCR STD_AXIS dzmNmit N 2 0.000000 6000.000000 EXTENDED_LIMITS 0.000000 32767.000000 /end AXIS_DESCR
 /begin AXIS_DESCR STD_AXIS mrmM_EAKT MM3 2 0.000000 100.000000 EXTENDED_LIMITS -327.680000 327.670000 /end AXIS_DESCR
 EXTENDED_LIMITS -3.276800 3.276700 /end CHARACTERISTIC
/begin CHARACTERISTIC arwLMLBKKL "Korrekturfaktor" CURVE 0xF49DC MSA15_KL118 0 FAKT -3.200000 3.200000
 /begin AXIS_DESCR STD_AXIS aroIST_4P M_Lt 2 -1000.000000 1000.000000 EXTENDED_LIMITS -3276.800000 3276.700000 /end AXIS_DESCR
 EXTENDED_LIMITS -3.276800 3.276700 /end CHARACTERISTIC
/begin CHARACTERISTIC arwLMLLLM "obere Schwelle Lastabgleich Leerlauf" VALUE 0xF4A2C MSA15_FW4 0 M_Lt 0.000000 1000.000000 EXTENDED_LIMITS -3276.800000 3276.700000 /end CHARACTERISTIC
/begin CHARACTERISTIC arwLMLLSM "untere Schwelle Lastabgleichwert Vollast" VALUE 0xF4A2E MSA15_FW4 0 M_Lt 0.000000 1000.000000 EXTENDED_LIMITS -3276.800000 3276.700000 /end CHARACTERISTIC
/begin CHARACTERISTIC arwLML_GF "Gedaechtnisfaktor PT1-LTF" VALUE 0xF4DC8 MSA15_FW4 0 GF 0.000031 0.999969 /end CHARACTERISTIC
/begin CHARACTERISTIC arwLMMEGF "Gedaechtnisfaktor PT1-mrmM_EAKT" VALUE 0xF4DCC MSA15_FW4 0 GF 0.000031 0.999969 /end CHARACTERISTIC
/begin CHARACTERISTIC arwLMMERX "Grenze Mengengradient Lastbereich" VALUE 0xF4A2A MSA15_FW4 0 dM_dZHP5 0.000000 100.000000 EXTENDED_LIMITS -327.680000 327.670000 /end CHARACTERISTIC
/begin CHARACTERISTIC arwLMN_GF "Gedaechtnisfaktor PT1-NPA" VALUE 0xF4DC6 MSA15_FW4 0 GF 0.000031 0.999969 /end CHARACTERISTIC
/begin CHARACTERISTIC arwLMPT11 "Gedaechtnisfaktor PT1    ! ***BC212 BEW2WI" VALUE 0xF4DCE MSA15_FW4 0 GF 0.000031 0.999969 /end CHARACTERISTIC
/begin CHARACTERISTIC arwLMPT12 "Gedaechtnisfaktor PT1    ! ***BC212 BEW2WI" VALUE 0xF4DD0 MSA15_FW4 0 GF 0.000031 0.999969 /end CHARACTERISTIC
/begin CHARACTERISTIC arwLMPT13 "Gedaechtnisfaktor PT1" VALUE 0xF4DD2 MSA15_FW4 0 GF 0.000031 0.999969 /end CHARACTERISTIC
/begin CHARACTERISTIC arwLMTAB "Verzoegerungszeit fuer Startbit" VALUE 0xF49F0 MSA15_FW3 0 ZEIT_ST_SS 0.000000 65535.000000 /end CHARACTERISTIC
/begin CHARACTERISTIC arwLMTGRX "obere Schwelle LTF-LTFalt" VALUE 0xF4A12 MSA15_FW4 0 dT_dZHP5 0.000000 2000.000000 EXTENDED_LIMITS -32768.000000 32767.000000 /end CHARACTERISTIC
/begin CHARACTERISTIC arwLMTM21 "Freigabezeit f’r Abgleich im LL" VALUE 0xF4A18 MSA15_FW3 0 ZEIT_ST 0.000000 655350000.000000 /end CHARACTERISTIC
/begin CHARACTERISTIC arwLMTM22 "Freigabezeit f’r Abgleich im LB" VALUE 0xF4A1A MSA15_FW3 0 ZEIT_ST 0.000000 655350000.000000 /end CHARACTERISTIC
/begin CHARACTERISTIC arwLMTM23 "Verzoegerungszeit f’r Abgleich im LB" VALUE 0xF4A1C MSA15_FW3 0 ZEIT_ST 0.000000 655350000.000000 /end CHARACTERISTIC
/begin CHARACTERISTIC arwLMVAD "Atmosphärendruckschw. für Kennlinienkippen" VALUE 0xF4A40 MSA15_FW4 0 P 500.000000 1500.000000 EXTENDED_LIMITS -32768.000000 32767.000000 /end CHARACTERISTIC
/begin CHARACTERISTIC arwLMVLT "Lufttemp.schwelle für Kennlinienkippen" VALUE 0xF4A3E MSA15_FW4 0 T -50.040010 199.960000 EXTENDED_LIMITS -273.140000 3003.560000 /end CHARACTERISTIC
/begin CHARACTERISTIC arwLMVMEO "Mengenschwelle oben" VALUE 0xF4A4E MSA15_FW4 0 MM3 0.000000 100.000000 EXTENDED_LIMITS -327.680000 327.670000 /end CHARACTERISTIC
/begin CHARACTERISTIC arwLMVMEU "Mengenschwelle unten" VALUE 0xF4A4C MSA15_FW4 0 MM3 0.000000 100.000000 EXTENDED_LIMITS -327.680000 327.670000 /end CHARACTERISTIC
/begin CHARACTERISTIC arwLMVNO "Drehzahlschwelle oben" VALUE 0xF4A4A MSA15_FW4 0 N 0.000000 6000.000000 EXTENDED_LIMITS 0.000000 32767.000000 /end CHARACTERISTIC
/begin CHARACTERISTIC arwLMVNU "Drehzahlschwelle unten" VALUE 0xF4A48 MSA15_FW4 0 N 0.000000 6000.000000 EXTENDED_LIMITS 0.000000 32767.000000 /end CHARACTERISTIC
/begin CHARACTERISTIC arwLMVP "Druckschwelle für Kennlinienkippen" VALUE 0xF4A3C MSA15_FW4 0 P 0.000000 3500.000000 EXTENDED_LIMITS -32768.000000 32767.000000 /end CHARACTERISTIC
/begin CHARACTERISTIC arwLMVTV "Schwelle für ehmFARS" VALUE 0xF4A46 MSA15_FW4 0 PROZ 0.000000 100.000000 EXTENDED_LIMITS -327.680000 327.670000 /end CHARACTERISTIC
/begin CHARACTERISTIC arwLMVdN "Drehzahltoleranz über LL-Drehzahl" VALUE 0xF4A42 MSA15_FW4 0 N 0.000000 6000.000000 EXTENDED_LIMITS 0.000000 32767.000000 /end CHARACTERISTIC
/begin CHARACTERISTIC arwLMVtRau "Zeitdauer Rauchbegrenzung aktiv" VALUE 0xF4A3A MSA15_FW3 0 ZEIT_ST 0.000000 655350000.000000 /end CHARACTERISTIC
/begin CHARACTERISTIC arwLMVtTV "Dauer für TV der ARF unter arwLMVTV" VALUE 0xF4A44 MSA15_FW3 0 ZEIT_ST 0.000000 655350000.000000 /end CHARACTERISTIC
/begin CHARACTERISTIC arwLTAGH1 "LTF obere Schwelle" VALUE 0xF49F6 MSA15_FW4 0 T -50.040010 199.960000 EXTENDED_LIMITS -273.140000 3003.560000 /end CHARACTERISTIC
/begin CHARACTERISTIC arwLTAGH2 "LTF untere Schwelle" VALUE 0xF49F8 MSA15_FW4 0 T -50.040010 199.960000 EXTENDED_LIMITS -273.140000 3003.560000 /end CHARACTERISTIC
/begin CHARACTERISTIC arwLTDFMX "obere Schwelle LTF-WTF" VALUE 0xF4A04 MSA15_FW4 0 dT 0.000000 150.000000 EXTENDED_LIMITS 0.000000 3276.700000 /end CHARACTERISTIC
/begin CHARACTERISTIC arwLTG_RK "Spez.Gaskonstante Luft" VALUE 0xF4A30 MSA15_FW4 0 R_K 0.000000 1.999800 EXTENDED_LIMITS 0.000000 117.963000 /end CHARACTERISTIC
/begin CHARACTERISTIC arwMEAGH1 "Einspritzmenge obere Schwelle LL" VALUE 0xF4A00 MSA15_FW4 0 M_E 0.000000 100.000000 EXTENDED_LIMITS -327.680000 327.670000 /end CHARACTERISTIC
/begin CHARACTERISTIC arwMEAGH2 "Einspritzmenge untere Schwelle LL" VALUE 0xF4A02 MSA15_FW4 0 M_E 0.000000 100.000000 EXTENDED_LIMITS -327.680000 327.670000 /end CHARACTERISTIC
/begin CHARACTERISTIC arwMLGRDKF "ARF Sollwert-Grundkennfeld   M_L = f(N, M_E)" MAP 0xF1BB8 MSA15_KF382 0 M_L -1500.000000 1500.000000
 /begin AXIS_DESCR STD_AXIS dzmNmit N 16 0.000000 6000.000000 EXTENDED_LIMITS 0.000000 32767.000000 /end AXIS_DESCR
 /begin AXIS_DESCR STD_AXIS aroWU_LLR MM3 16 0.000000 100.000000 EXTENDED_LIMITS -327.680000 327.670000 /end AXIS_DESCR
 EXTENDED_LIMITS -3276.800000 3276.700000 /end CHARACTERISTIC
/begin CHARACTERISTIC arwNMAX_AB "ARF obere N-Schwelle zur Abschaltung" VALUE 0xF492E MSA15_FW4 0 N 0.000000 6000.000000 EXTENDED_LIMITS 0.000000 32767.000000 /end CHARACTERISTIC
/begin CHARACTERISTIC arwNM_EMN "Minimalwert Menge-Drehzahlfenster" CURVE 0xF49B8 MSA15_KL118 0 M_E 0.000000 100.000000
 /begin AXIS_DESCR STD_AXIS dzmNmit N 8 0.000000 6000.000000 EXTENDED_LIMITS 0.000000 32767.000000 /end AXIS_DESCR
 EXTENDED_LIMITS -327.680000 327.670000 /end CHARACTERISTIC
/begin CHARACTERISTIC arwNM_EMX "Maximalwert Menge-Drehzahlfenster" CURVE 0xF4994 MSA15_KL118 0 M_E 0.000000 100.000000
 /begin AXIS_DESCR STD_AXIS dzmNmit N 8 0.000000 6000.000000 EXTENDED_LIMITS 0.000000 32767.000000 /end AXIS_DESCR
 EXTENDED_LIMITS -327.680000 327.670000 /end CHARACTERISTIC
/begin CHARACTERISTIC arwNPA_RT "Referenzzeit f’r Nachlauftimer" VALUE 0xF49EE MSA15_FW3 0 ZEIT_ST 0.000000 655350000.000000 /end CHARACTERISTIC
/begin CHARACTERISTIC arwPAKORKL "ARF additive Sollwert-Korrektur  dM_L = f(P_ADF)" CURVE 0xF1E00 MSA15_KL118 0 M_L -1500.000000 1500.000000
 /begin AXIS_DESCR STD_AXIS ldmADF P 6 0.000000 3500.000000 EXTENDED_LIMITS -32768.000000 32767.000000 /end AXIS_DESCR
 EXTENDED_LIMITS -3276.800000 3276.700000 /end CHARACTERISTIC
/begin CHARACTERISTIC arwPR_FEN "ARF Fenster Kleinsignal P-Regler" VALUE 0xF497C MSA15_FW4 0 M_L 0.000000 1500.000000 EXTENDED_LIMITS -3276.800000 3276.700000 /end CHARACTERISTIC
/begin CHARACTERISTIC arwPR_NEG "ARF P-Verstaerkung negatives Grosssignal" VALUE 0xF4980 MSA15_FW4 0 ARF_KP 0.000000 2.000000 EXTENDED_LIMITS 0.000000 3.199902 /end CHARACTERISTIC
/begin CHARACTERISTIC arwPR_POS "ARF P-Verstaerkung positives Grosssignal" VALUE 0xF4982 MSA15_FW4 0 ARF_KP 0.000000 2.000000 EXTENDED_LIMITS 0.000000 3.199902 /end CHARACTERISTIC
/begin CHARACTERISTIC arwPR_SIG "ARF P-Verstaerkung Kleinsignal" VALUE 0xF497E MSA15_FW4 0 ARF_KP 0.000000 2.000000 EXTENDED_LIMITS 0.000000 3.199902 /end CHARACTERISTIC
/begin CHARACTERISTIC arwP_ATM_O "ARF P_ATM-Obereschwelle zur Anschaltung" VALUE 0xF4960 MSA15_FW4 0 P 0.000000 3500.000000 EXTENDED_LIMITS -32768.000000 32767.000000 /end CHARACTERISTIC
/begin CHARACTERISTIC arwP_ATM_U "ARF P_ATM-Untereschwelle zur Abschaltung" VALUE 0xF4962 MSA15_FW4 0 P 0.000000 3500.000000 EXTENDED_LIMITS -32768.000000 32767.000000 /end CHARACTERISTIC
/begin CHARACTERISTIC arwREDNLL3 "ARF N-Schwelle zur zeitabhaengigen Reduzierung im LL" VALUE 0xF1B84 MSA15_FW4 0 N 0.000000 6000.000000 EXTENDED_LIMITS 0.000000 32767.000000 /end CHARACTERISTIC
/begin CHARACTERISTIC arwREDTLL3 "Zeitschwelle zur ARF-Reduzierung im Leerlauf" VALUE 0xF1B86 MSA15_FW3 0 ZEIT_HP 0.000000 1310600000.000000 EXTENDED_LIMITS 0.000000 1310700000.000000 /end CHARACTERISTIC
/begin CHARACTERISTIC arwREDULL3 "ARF reduzierung bei laengerem Leerlauf" VALUE 0xF1B8C MSA15_FW4 0 M_L 0.000000 1500.000000 EXTENDED_LIMITS -3276.800000 3276.700000 /end CHARACTERISTIC
/begin CHARACTERISTIC arwREGDMNR "ARF max. zulaessige negative Regelabweichung RA" VALUE 0xF491E MSA15_FW4 0 M_L -1500.000000 1500.000000 EXTENDED_LIMITS -3276.800000 3276.700000 /end CHARACTERISTIC
/begin CHARACTERISTIC arwREGDMPR "ARF max. zulaessige positive Regelabweichung RA" VALUE 0xF491C MSA15_FW4 0 M_L -1500.000000 1500.000000 EXTENDED_LIMITS -3276.800000 3276.700000 /end CHARACTERISTIC
/begin CHARACTERISTIC arwREGIME "ARF obere M_E-Schwelle zum Ruecksetzen der RA" VALUE 0xF4924 MSA15_FW4 0 MM3 0.000000 100.000000 EXTENDED_LIMITS -327.680000 327.670000 /end CHARACTERISTIC
/begin CHARACTERISTIC arwREGIN1 "ARF untere N-Schwelle zum Ruecksetzen der RA" VALUE 0xF4920 MSA15_FW4 0 N 0.000000 6000.000000 EXTENDED_LIMITS 0.000000 32767.000000 /end CHARACTERISTIC
/begin CHARACTERISTIC arwREGIN2 "ARF obere N-Schwelle zum Ruecksetzen der RA" VALUE 0xF4922 MSA15_FW4 0 N 0.000000 6000.000000 EXTENDED_LIMITS 0.000000 32767.000000 /end CHARACTERISTIC
/begin CHARACTERISTIC arwREGIVG1 "ARF VGW I-Anteil bei Abschaltbedingungen" VALUE 0xF4940 MSA15_FW4 0 PROZ -100.000000 100.000000 EXTENDED_LIMITS -327.680000 327.670000 /end CHARACTERISTIC
/begin CHARACTERISTIC arwREGIVG2 "ARF VGW fuer I-Anteil bei Abschaltung im Schub" VALUE 0xF494C MSA15_FW4 0 PROZ -100.000000 100.000000 EXTENDED_LIMITS -327.680000 327.670000 /end CHARACTERISTIC
/begin CHARACTERISTIC arwREGIVG3 "ARF VGW I-Anteil unter N-Schwelle zum Einschalten" VALUE 0xF4952 MSA15_FW4 0 PROZ -100.000000 100.000000 EXTENDED_LIMITS -327.680000 327.670000 /end CHARACTERISTIC
/begin CHARACTERISTIC arwREGIVG4 "ARF VGW I-Anteil fuer HFM Abgleich" VALUE 0xF4956 MSA15_FW4 0 PROZ -100.000000 100.000000 EXTENDED_LIMITS -327.680000 327.670000 /end CHARACTERISTIC
/begin CHARACTERISTIC arwREGMEAB "ARF M_E-Schwelle zur Abschaltung" VALUE 0xF493C MSA15_FW4 0 MM3 0.000000 100.000000 EXTENDED_LIMITS -327.680000 327.670000 /end CHARACTERISTIC
/begin CHARACTERISTIC arwREGM_EO "ARF  obere M_E-Schwelle zum Setzen der RA" VALUE 0xF492C MSA15_FW4 0 MM3 0.000000 100.000000 EXTENDED_LIMITS -327.680000 327.670000 /end CHARACTERISTIC
/begin CHARACTERISTIC arwREGM_EU "ARF  untere M_E-Schwelle zum Setzen der RA" VALUE 0xF492A MSA15_FW4 0 MM3 0.000000 100.000000 EXTENDED_LIMITS -327.680000 327.670000 /end CHARACTERISTIC
/begin CHARACTERISTIC arwREGN1AB "ARF obere N-Schwelle zur Abschaltung" VALUE 0xF4930 MSA15_FW4 0 N 0.000000 6000.000000 EXTENDED_LIMITS 0.000000 32767.000000 /end CHARACTERISTIC
/begin CHARACTERISTIC arwREGN1AN "ARF untere N-Schwelle zur Abschaltung" VALUE 0xF4932 MSA15_FW4 0 N 0.000000 6000.000000 EXTENDED_LIMITS 0.000000 32767.000000 /end CHARACTERISTIC
/begin CHARACTERISTIC arwREGNEIN "ARF N-Schwelle zum Einschalten" VALUE 0xF494E MSA15_FW4 0 N 0.000000 6000.000000 EXTENDED_LIMITS 0.000000 32767.000000 /end CHARACTERISTIC
/begin CHARACTERISTIC arwREGNLL1 "ARF N-Schwelle zur zeitabhaeng. Abschaltung im LL" VALUE 0xF4934 MSA15_FW4 0 N 0.000000 6000.000000 EXTENDED_LIMITS 0.000000 32767.000000 /end CHARACTERISTIC
/begin CHARACTERISTIC arwREGNLL2 "ARF unter N-Schwelle zur Sofortabschaltung" VALUE 0xF4936 MSA15_FW4 0 N 0.000000 6000.000000 EXTENDED_LIMITS 0.000000 32767.000000 /end CHARACTERISTIC
/begin CHARACTERISTIC arwREGNO "ARF  obere N-Schwelle zum Setzen der RA" VALUE 0xF4928 MSA15_FW4 0 N 0.000000 6000.000000 EXTENDED_LIMITS 0.000000 32767.000000 /end CHARACTERISTIC
/begin CHARACTERISTIC arwREGNU "ARF  untere N-Schwelle zum Setzen der RA" VALUE 0xF4926 MSA15_FW4 0 N 0.000000 6000.000000 EXTENDED_LIMITS 0.000000 32767.000000 /end CHARACTERISTIC
/begin CHARACTERISTIC arwREGSBME "ARF untere M_E-Schwelle zur Definition Schubbetrieb hochprior" VALUE 0xF4944 MSA15_FW4 0 MM3 0.000000 100.000000 EXTENDED_LIMITS -327.680000 327.670000 /end CHARACTERISTIC
/begin CHARACTERISTIC arwREGSBN "ARF obere N-Schwelle zur Definition Schubbetrieb hochprior" VALUE 0xF4942 MSA15_FW4 0 N 0.000000 6000.000000 EXTENDED_LIMITS 0.000000 32767.000000 /end CHARACTERISTIC
/begin CHARACTERISTIC arwREGSMEn "ARF untere M_E-Schwelle zur Definition Schubbetrieb niederprior" VALUE 0xF4948 MSA15_FW4 0 MM3 0.000000 100.000000 EXTENDED_LIMITS -327.680000 327.670000 /end CHARACTERISTIC
/begin CHARACTERISTIC arwREGSNn "ARF obere N-Schwelle zur Definition Schubbetrieb niederprior" VALUE 0xF4946 MSA15_FW4 0 N 0.000000 6000.000000 EXTENDED_LIMITS 0.000000 32767.000000 /end CHARACTERISTIC
/begin CHARACTERISTIC arwREGTLL1 "ARF Zeitschwelle zur Abschaltung im Leerlauf" VALUE 0xF4938 MSA15_FW3 0 ZEIT_HP 0.000000 1310700000.000000 /end CHARACTERISTIC
/begin CHARACTERISTIC arwREGTVG1 "ARF TV-Vorgabewert bei Abschaltbedingungen" VALUE 0xF493E MSA15_FW4 0 PROZ 0.000000 100.000000 EXTENDED_LIMITS -327.680000 327.670000 /end CHARACTERISTIC
/begin CHARACTERISTIC arwREGTVG2 "ARF TV-Vorgabewert bei Abschaltung im Schub" VALUE 0xF494A MSA15_FW4 0 PROZ 0.000000 100.000000 EXTENDED_LIMITS -327.680000 327.670000 /end CHARACTERISTIC
/begin CHARACTERISTIC arwREGTVG3 "ARF TV-Vorgabewert unter N-Schwelle zum Einschalten" VALUE 0xF4950 MSA15_FW4 0 PROZ 0.000000 100.000000 EXTENDED_LIMITS -327.680000 327.670000 /end CHARACTERISTIC
/begin CHARACTERISTIC arwREGTVG4 "ARF TV-Vorgabewert fuer HFM Ableich" VALUE 0xF4954 MSA15_FW4 0 PROZ 0.000000 100.000000 EXTENDED_LIMITS -327.680000 327.670000 /end CHARACTERISTIC
/begin CHARACTERISTIC arwREGTVKL "ARF PI-Regler-Linearisierungs-KL  TV = f(TV_PI)" CURVE 0xF4D5C MSA15_KL118 0 PROZ 0.000000 100.000000
 /begin AXIS_DESCR STD_AXIS aroREG_1 PROZ 5 0.000000 100.000000 EXTENDED_LIMITS -327.680000 327.670000 /end AXIS_DESCR
 EXTENDED_LIMITS -327.680000 327.670000 /end CHARACTERISTIC
/begin CHARACTERISTIC arwREGUBAB "ARF U_BATT-Schwelle zur Abschaltung" VALUE 0xF493A MSA15_FW4 0 U_B 0.000000 24163.000000 EXTENDED_LIMITS 0.000000 773948.100000 /end CHARACTERISTIC
/begin CHARACTERISTIC arwSCHW_KL "ARF Ermittlung eines Schwellwertes dPWG/dt zur Abschaltung" CURVE 0xF4DBA MSA15_KL118 0 dVE_dZ -3000.000000 3000.000000
 /begin AXIS_DESCR STD_AXIS dzmNmit N 2 0.000000 6000.000000 EXTENDED_LIMITS 0.000000 32767.000000 /end AXIS_DESCR
 EXTENDED_LIMITS -16384.000000 16383.500000 /end CHARACTERISTIC
/begin CHARACTERISTIC arwSWBAGMN "ARF untere Grenze additiver Sollwert-Abgleich" VALUE 0xF1B8A MSA15_FW4 0 M_L -1500.000000 0.000000 EXTENDED_LIMITS -3276.800000 3276.700000 /end CHARACTERISTIC
/begin CHARACTERISTIC arwSWBAGMX "ARF obere Grenze additiver Sollwert-Abgleich" VALUE 0xF1B88 MSA15_FW4 0 M_L 0.000000 1500.000000 EXTENDED_LIMITS -3276.800000 3276.700000 /end CHARACTERISTIC
/begin CHARACTERISTIC arwSWBSWMN "ARF untere M_L-Sollwertbegrenzung" VALUE 0xF1B90 MSA15_FW4 0 M_L 0.000000 1500.000000 EXTENDED_LIMITS -3276.800000 3276.700000 /end CHARACTERISTIC
/begin CHARACTERISTIC arwSWBSWMX "ARF obere M_L-Sollwertbegrenzung" VALUE 0xF1B8E MSA15_FW4 0 M_L 0.000000 1500.000000 EXTENDED_LIMITS -3276.800000 3276.700000 /end CHARACTERISTIC
/begin CHARACTERISTIC arwSWBTWDY "ARF T_W-Schwelle fuer Parameter dynam. Vorsteuern" VALUE 0xF1B92 MSA15_FW4 0 T -50.040010 149.960000 EXTENDED_LIMITS -273.140000 3003.560000 /end CHARACTERISTIC
/begin CHARACTERISTIC arwTLKORKF "ARF multipl. Sollwert-Korrektur  FAKT = f(N, T_L)" MAP 0xF1E1C MSA15_KF382 0 FAKT 0.000000 3.200000
 /begin AXIS_DESCR STD_AXIS dzmNmit N 6 0.000000 6000.000000 EXTENDED_LIMITS 0.000000 32767.000000 /end AXIS_DESCR
 /begin AXIS_DESCR STD_AXIS anmLTF T 6 -50.040010 199.960000 EXTENDED_LIMITS -273.140000 3003.560000 /end AXIS_DESCR
 EXTENDED_LIMITS -3.276800 3.276700 /end CHARACTERISTIC
/begin CHARACTERISTIC arwTWKORKF "ARF additive Sollwert-Korrektur  dM_L = f(N, T_W)" MAP 0xF1E84 MSA15_KF382 0 M_L -1500.000000 1500.000000
 /begin AXIS_DESCR STD_AXIS dzmNmit N 6 0.000000 6000.000000 EXTENDED_LIMITS 0.000000 32767.000000 /end AXIS_DESCR
 /begin AXIS_DESCR STD_AXIS anmWTF T 6 -50.040010 149.960000 EXTENDED_LIMITS -273.140000 3003.560000 /end AXIS_DESCR
 EXTENDED_LIMITS -3276.800000 3276.700000 /end CHARACTERISTIC
/begin CHARACTERISTIC arwT_EIN "ARF Zeitschwelle bis Wiedereinschaltung nach dPWG/dt > Schwelle" VALUE 0xF496C MSA15_FW3 0 ZEIT_HP 0.000000 1310600000.000000 EXTENDED_LIMITS 0.000000 1310700000.000000 /end CHARACTERISTIC
/begin CHARACTERISTIC arwT_LH_O "ARF  Obere T_L-Schwelle fuer Heissabschaltung" VALUE 0xF4968 MSA15_FW4 0 T -50.040010 149.960000 EXTENDED_LIMITS -273.140000 3003.560000 /end CHARACTERISTIC
/begin CHARACTERISTIC arwT_LH_U "ARF  Untere T_L-Schwelle fuer Heissabschaltung" VALUE 0xF496A MSA15_FW4 0 T -50.040010 149.960000 EXTENDED_LIMITS -273.140000 3003.560000 /end CHARACTERISTIC
/begin CHARACTERISTIC arwT_L_O "ARF T_L-Obereschwelle zur Anschaltung" VALUE 0xF495C MSA15_FW4 0 T -50.040010 149.960000 EXTENDED_LIMITS -273.140000 3003.560000 /end CHARACTERISTIC
/begin CHARACTERISTIC arwT_L_U "ARF T_L-Untereschwelle zur Abschaltung" VALUE 0xF495E MSA15_FW4 0 T -50.040010 149.960000 EXTENDED_LIMITS -273.140000 3003.560000 /end CHARACTERISTIC
/begin CHARACTERISTIC arwT_WH_O "ARF  Obere T_W-Schwelle fuer Heissabschaltung" VALUE 0xF4964 MSA15_FW4 0 T -50.040010 149.960000 EXTENDED_LIMITS -273.140000 3003.560000 /end CHARACTERISTIC
/begin CHARACTERISTIC arwT_WH_U "ARF  Untere T_W-Schwelle fuer Heissabschaltung" VALUE 0xF4966 MSA15_FW4 0 T -50.040010 149.960000 EXTENDED_LIMITS -273.140000 3003.560000 /end CHARACTERISTIC
/begin CHARACTERISTIC arwT_W_O "ARF T_W-Obereschwelle zur Anschaltung" VALUE 0xF4958 MSA15_FW4 0 T -50.040010 149.960000 EXTENDED_LIMITS -273.140000 3003.560000 /end CHARACTERISTIC
/begin CHARACTERISTIC arwT_W_U "ARF T_W-Untereschwelle zur Abschaltung" VALUE 0xF495A MSA15_FW4 0 T -50.040010 149.960000 EXTENDED_LIMITS -273.140000 3003.560000 /end CHARACTERISTIC
/begin CHARACTERISTIC arwWDV_FEN "ARF Fenster Klein-S. neg. Vorsteuern/warmer Motor" VALUE 0xF1B9E MSA15_FW4 0 dVE_dZ 0.000000 3000.000000 EXTENDED_LIMITS -16384.000000 16383.500000 /end CHARACTERISTIC
/begin CHARACTERISTIC arwWDV_FEP "ARF Fenster Klein-S. pos. Vorsteuern/warmer Motor" VALUE 0xF1B96 MSA15_FW4 0 dVE_dZ 0.000000 3000.000000 EXTENDED_LIMITS -16384.000000 16383.500000 /end CHARACTERISTIC
/begin CHARACTERISTIC arwWDV_GFN "ARF Gedaechtnisfaktor neg. Vorsteuern/warmer Motor" VALUE 0xF1B9C MSA15_FW4 0 GF 0.000031 0.999969 /end CHARACTERISTIC
/begin CHARACTERISTIC arwWDV_GFP "ARF Gedaechtnisfaktor pos. Vorsteuern/warmer Motor" VALUE 0xF1B94 MSA15_FW4 0 GF 0.000031 0.999969 /end CHARACTERISTIC
/begin CHARACTERISTIC arwWDV_NEG "ARF Verstaerk. Gross-S. neg. Vorsteuern/warmer Motor" VALUE 0xF1BA2 MSA15_FW4 0 ARF_KD 0.000000 3465.781000 EXTENDED_LIMITS 0.000000 5119.844000 /end CHARACTERISTIC
/begin CHARACTERISTIC arwWDV_POS "ARF Verstaerk. Gross-S. pos. Vorsteuern/warmer Motor" VALUE 0xF1B9A MSA15_FW4 0 ARF_KD 0.000000 3465.781000 EXTENDED_LIMITS 0.000000 5119.844000 /end CHARACTERISTIC
/begin CHARACTERISTIC arwWDV_SIN "ARF Verstaerk. Klein-S. neg. Vorsteuern/warmer Motor" VALUE 0xF1BA0 MSA15_FW4 0 ARF_KD 0.000000 3465.781000 EXTENDED_LIMITS 0.000000 5119.844000 /end CHARACTERISTIC
/begin CHARACTERISTIC arwWDV_SIP "ARF Verstaerk. Klein-S. pos. Vorsteuern/warmer Motor" VALUE 0xF1B98 MSA15_FW4 0 ARF_KD 0.000000 3465.781000 EXTENDED_LIMITS 0.000000 5119.844000 /end CHARACTERISTIC
/begin CHARACTERISTIC arwWTSHU1 "WTF obere Schwelle Bereich 1" VALUE 0xF4A06 MSA15_FW4 0 T -50.040010 149.960000 EXTENDED_LIMITS -273.140000 3003.560000 /end CHARACTERISTIC
/begin CHARACTERISTIC arwWTSHU2 "WTF untere Schwelle Bereich 1" VALUE 0xF4A08 MSA15_FW4 0 T -50.040010 149.960000 EXTENDED_LIMITS -273.140000 3003.560000 /end CHARACTERISTIC
/begin CHARACTERISTIC caw010_AB0 "EGS1 Arbitration Byte 0" VALUE 0xF1F72 MSA15_FW1 0 DEZ_DB_U 135.000000 135.000000 EXTENDED_LIMITS 0.000000 255.000000 /end CHARACTERISTIC
/begin RECORD_LAYOUT MSA15_FW1 FNC_VALUES 1 UBYTE COLUMN_DIR DIRECT /end RECORD_LAYOUT
/begin CHARACTERISTIC caw010_AB1 "EGS1 Arbitration Byte 1" VALUE 0xF1F73 MSA15_FW1 0 DEZ_DB_U 224.000000 224.000000 EXTENDED_LIMITS 0.000000 255.000000 /end CHARACTERISTIC
/begin CHARACTERISTIC caw010_ADR "EGS1 Baustein Objektadresse" VALUE 0xF1F70 MSA15_FW1 0 DEZ_DB_U 16.000000 16.000000 EXTENDED_LIMITS 0.000000 255.000000 /end CHARACTERISTIC
/begin CHARACTERISTIC caw010_DT0 "EGS1 Ersatzdatenbyte 0" VALUE 0xF1F68 MSA15_FW1 0 DEZ_DB_U 0.000000 255.000000 /end CHARACTERISTIC
/begin CHARACTERISTIC caw010_DT1 "EGS1 Ersatzdatenbyte 1" VALUE 0xF1F69 MSA15_FW1 0 DEZ_DB_U 0.000000 255.000000 /end CHARACTERISTIC
/begin CHARACTERISTIC caw010_DT2 "EGS1 Ersatzdatenbyte 2" VALUE 0xF1F6A MSA15_FW1 0 DEZ_DB_U 0.000000 255.000000 /end CHARACTERISTIC
/begin CHARACTERISTIC caw010_DT3 "#SSD EGS1 Ersatzdatenbyte 3" VALUE 0xF1F6B MSA15_FW1 0 DEZ_DB_U 0.000000 255.000000 /end CHARACTERISTIC
/begin CHARACTERISTIC caw010_DT4 "EGS1 Ersatzdatenbyte 4" VALUE 0xF1F6C MSA15_FW1 0 DEZ_DB_U 0.000000 255.000000 /end CHARACTERISTIC
/begin CHARACTERISTIC caw010_DT5 "EGS1 Ersatzdatenbyte 5" VALUE 0xF1F6D MSA15_FW1 0 DEZ_DB_U 0.000000 255.000000 /end CHARACTERISTIC
/begin CHARACTERISTIC caw010_DT6 "EGS1 Ersatzdatenbyte 6" VALUE 0xF1F6E MSA15_FW1 0 DEZ_DB_U 0.000000 255.000000 /end CHARACTERISTIC
/begin CHARACTERISTIC caw010_DT7 "EGS1 Ersatzdatenbyte 7" VALUE 0xF1F6F MSA15_FW1 0 DEZ_DB_U 0.000000 255.000000 /end CHARACTERISTIC
/begin CHARACTERISTIC caw010_DTL "EGS1 Datenlaenge" VALUE 0xF1F71 MSA15_FW1 0 DEZ_DB_U 6.000000 8.000000 EXTENDED_LIMITS 0.000000 255.000000 /end CHARACTERISTIC
/begin CHARACTERISTIC caw010_INF "EGS1 Ersatzdaten vorhanden ?" VALUE 0xF1F67 MSA15_FW1 0 DEZ_DB_U 0.000000 255.000000 /end CHARACTERISTIC
/begin CHARACTERISTIC caw010_MSC "EGS1 Message Configuration" VALUE 0xF1F74 MSA15_FW1 0 DEZ_DB_U 96.000000 128.000000 EXTENDED_LIMITS 0.000000 255.000000 /end CHARACTERISTIC
/begin CHARACTERISTIC caw010_NSG "EGS1 Anzahl Segmente" VALUE 0xF1F65 MSA15_FW1 0 DEZ_DB_U 1.000000 1.000000 EXTENDED_LIMITS 0.000000 255.000000 /end CHARACTERISTIC
/begin CHARACTERISTIC caw010_PER "EGS1 Empfangsperiode" VALUE 0xF1F64 MSA15_FW1 0 DEZ_DB_U 1.000000 1.000000 EXTENDED_LIMITS 0.000000 255.000000 /end CHARACTERISTIC
/begin CHARACTERISTIC caw010_RTO "#SSD EGS1 Empfangstimeout" VALUE 0xF1F66 MSA15_FW1 0 DEZ_DB_U 50.000000 50.000000 EXTENDED_LIMITS 0.000000 255.000000 /end CHARACTERISTIC
/begin CHARACTERISTIC caw020_AB0 "DDE1 Arbitration Byte 0" VALUE 0xF1F84 MSA15_FW1 0 DEZ_DB_U 98.000000 98.000000 EXTENDED_LIMITS 0.000000 255.000000 /end CHARACTERISTIC
/begin CHARACTERISTIC caw020_AB1 "DDE1 Arbitration Byte 1" VALUE 0xF1F85 MSA15_FW1 0 DEZ_DB_U 192.000000 192.000000 EXTENDED_LIMITS 0.000000 255.000000 /end CHARACTERISTIC
/begin CHARACTERISTIC caw020_ADR "DDE1 Baustein Objektadresse" VALUE 0xF1F82 MSA15_FW1 0 DEZ_DB_U 32.000000 32.000000 EXTENDED_LIMITS 0.000000 255.000000 /end CHARACTERISTIC
/begin CHARACTERISTIC caw020_DT0 "DDE1 Ersatzdatenbyte 0" VALUE 0xF1F7A MSA15_FW1 0 DEZ_DB_U 0.000000 255.000000 /end CHARACTERISTIC
/begin CHARACTERISTIC caw020_DT1 "DDE1 Ersatzdatenbyte 1" VALUE 0xF1F7B MSA15_FW1 0 DEZ_DB_U 0.000000 255.000000 /end CHARACTERISTIC
/begin CHARACTERISTIC caw020_DT2 "DDE1 Ersatzdatenbyte 2" VALUE 0xF1F7C MSA15_FW1 0 DEZ_DB_U 0.000000 255.000000 /end CHARACTERISTIC
/begin CHARACTERISTIC caw020_DT3 "DDE1 Ersatzdatenbyte 3" VALUE 0xF1F7D MSA15_FW1 0 DEZ_DB_U 0.000000 255.000000 /end CHARACTERISTIC
/begin CHARACTERISTIC caw020_DT4 "DDE1 Ersatzdatenbyte 4" VALUE 0xF1F7E MSA15_FW1 0 DEZ_DB_U 0.000000 255.000000 /end CHARACTERISTIC
/begin CHARACTERISTIC caw020_DT5 "DDE1 Ersatzdatenbyte 5" VALUE 0xF1F7F MSA15_FW1 0 DEZ_DB_U 0.000000 255.000000 /end CHARACTERISTIC
/begin CHARACTERISTIC caw020_DT6 "DDE1 Ersatzdatenbyte 6" VALUE 0xF1F80 MSA15_FW1 0 DEZ_DB_U 0.000000 255.000000 /end CHARACTERISTIC
/begin CHARACTERISTIC caw020_DT7 "DDE1 Ersatzdatenbyte 7" VALUE 0xF1F81 MSA15_FW1 0 DEZ_DB_U 0.000000 255.000000 /end CHARACTERISTIC
/begin CHARACTERISTIC caw020_DTL "DDE1 Datenlaenge" VALUE 0xF1F83 MSA15_FW1 0 DEZ_DB_U 6.000000 8.000000 EXTENDED_LIMITS 0.000000 255.000000 /end CHARACTERISTIC
/begin CHARACTERISTIC caw020_INF "DDE1 Mehrfachnutzung Sendeobjekt" VALUE 0xF1F79 MSA15_FW1 0 NULL 0.000000 0.000000 /end CHARACTERISTIC
/begin CHARACTERISTIC caw020_MSC "DDE1 Message Configuration" VALUE 0xF1F86 MSA15_FW1 0 DEZ_DB_U 104.000000 136.000000 EXTENDED_LIMITS 0.000000 255.000000 /end CHARACTERISTIC
/begin CHARACTERISTIC caw020_NSG "DDE1 Anzahl Segmente" VALUE 0xF1F77 MSA15_FW1 0 DEZ_DB_U 1.000000 1.000000 EXTENDED_LIMITS 0.000000 255.000000 /end CHARACTERISTIC
/begin CHARACTERISTIC caw020_PER "DDE1 Sendeperiode" VALUE 0xF1F76 MSA15_FW1 0 DEZ_DB_U 1.000000 1.000000 EXTENDED_LIMITS 0.000000 255.000000 /end CHARACTERISTIC
/begin CHARACTERISTIC caw020_RTO "DDE1 Empfangstimeout" VALUE 0xF1F78 MSA15_FW1 0 DEZ_DB_U 0.000000 255.000000 /end CHARACTERISTIC
/begin CHARACTERISTIC caw030_AB0 "DDE2 Arbitration Byte 0" VALUE 0xF1F96 MSA15_FW1 0 DEZ_DB_U 101.000000 101.000000 EXTENDED_LIMITS 0.000000 255.000000 /end CHARACTERISTIC
/begin CHARACTERISTIC caw030_AB1 "DDE2 Arbitration Byte 1" VALUE 0xF1F97 MSA15_FW1 0 DEZ_DB_U 32.000000 32.000000 EXTENDED_LIMITS 0.000000 255.000000 /end CHARACTERISTIC
/begin CHARACTERISTIC caw030_ADR "DDE2 Baustein Objektadresse" VALUE 0xF1F94 MSA15_FW1 0 DEZ_DB_U 48.000000 48.000000 EXTENDED_LIMITS 0.000000 255.000000 /end CHARACTERISTIC
/begin CHARACTERISTIC caw030_DT0 "DDE2 Ersatzdatenbyte 0" VALUE 0xF1F8C MSA15_FW1 0 DEZ_DB_U 0.000000 255.000000 /end CHARACTERISTIC
/begin CHARACTERISTIC caw030_DT1 "DDE2 Ersatzdatenbyte 1" VALUE 0xF1F8D MSA15_FW1 0 DEZ_DB_U 0.000000 255.000000 /end CHARACTERISTIC
/begin CHARACTERISTIC caw030_DT2 "DDE2 Ersatzdatenbyte 2" VALUE 0xF1F8E MSA15_FW1 0 DEZ_DB_U 0.000000 255.000000 /end CHARACTERISTIC
/begin CHARACTERISTIC caw030_DT3 "DDE2 Ersatzdatenbyte 3" VALUE 0xF1F8F MSA15_FW1 0 DEZ_DB_U 0.000000 255.000000 /end CHARACTERISTIC
/begin CHARACTERISTIC caw030_DT4 "DDE2 Ersatzdatenbyte 4" VALUE 0xF1F90 MSA15_FW1 0 DEZ_DB_U 0.000000 255.000000 /end CHARACTERISTIC
/begin CHARACTERISTIC caw030_DT5 "DDE2 Ersatzdatenbyte 5" VALUE 0xF1F91 MSA15_FW1 0 DEZ_DB_U 0.000000 255.000000 /end CHARACTERISTIC
/begin CHARACTERISTIC caw030_DT6 "DDE2 Ersatzdatenbyte 6" VALUE 0xF1F92 MSA15_FW1 0 DEZ_DB_U 0.000000 255.000000 /end CHARACTERISTIC
/begin CHARACTERISTIC caw030_DT7 "DDE2 Ersatzdatenbyte 7" VALUE 0xF1F93 MSA15_FW1 0 DEZ_DB_U 0.000000 255.000000 /end CHARACTERISTIC
/begin CHARACTERISTIC caw030_DTL "DDE2 Datenlaenge" VALUE 0xF1F95 MSA15_FW1 0 DEZ_DB_U 7.000000 8.000000 EXTENDED_LIMITS 0.000000 255.000000 /end CHARACTERISTIC
/begin CHARACTERISTIC caw030_INF "DDE2 Mehrfachnutzung Sendeobjekt" VALUE 0xF1F8B MSA15_FW1 0 NULL 0.000000 0.000000 /end CHARACTERISTIC
/begin CHARACTERISTIC caw030_MSC "DDE2 Message Configuration" VALUE 0xF1F98 MSA15_FW1 0 DEZ_DB_U 120.000000 136.000000 EXTENDED_LIMITS 0.000000 255.000000 /end CHARACTERISTIC
/begin CHARACTERISTIC caw030_NSG "DDE2 Anzahl Segmente" VALUE 0xF1F89 MSA15_FW1 0 DEZ_DB_U 1.000000 1.000000 EXTENDED_LIMITS 0.000000 255.000000 /end CHARACTERISTIC
/begin CHARACTERISTIC caw030_PER "DDE2 Sendeperiode" VALUE 0xF1F88 MSA15_FW1 0 DEZ_DB_U 1.000000 1.000000 EXTENDED_LIMITS 0.000000 255.000000 /end CHARACTERISTIC
/begin CHARACTERISTIC caw030_RTO "DDE2 Empfangstimeout" VALUE 0xF1F8A MSA15_FW1 0 DEZ_DB_U 0.000000 255.000000 /end CHARACTERISTIC
/begin CHARACTERISTIC caw040_AB0 "INSTR3 Arbitration Byte 0" VALUE 0xF1FA8 MSA15_FW1 0 DEZ_DB_U 194.000000 194.000000 EXTENDED_LIMITS 0.000000 255.000000 /end CHARACTERISTIC
/begin CHARACTERISTIC caw040_AB1 "INSTR3 Arbitration Byte 1" VALUE 0xF1FA9 MSA15_FW1 0 DEZ_DB_U 160.000000 160.000000 EXTENDED_LIMITS 0.000000 255.000000 /end CHARACTERISTIC
/begin CHARACTERISTIC caw040_ADR "INSTR3 Baustein Objektadresse" VALUE 0xF1FA6 MSA15_FW1 0 DEZ_DB_U 208.000000 208.000000 EXTENDED_LIMITS 0.000000 255.000000 /end CHARACTERISTIC
/begin CHARACTERISTIC caw040_DT0 "INSTR3 Ersatzdatenbyte 0" VALUE 0xF1F9E MSA15_FW1 0 DEZ_DB_U 0.000000 255.000000 /end CHARACTERISTIC
/begin CHARACTERISTIC caw040_DT1 "INSTR3 Ersatzdatenbyte 1" VALUE 0xF1F9F MSA15_FW1 0 DEZ_DB_U 0.000000 255.000000 /end CHARACTERISTIC
/begin CHARACTERISTIC caw040_DT2 "INSTR3 Ersatzdatenbyte 2" VALUE 0xF1FA0 MSA15_FW1 0 DEZ_DB_U 0.000000 255.000000 /end CHARACTERISTIC
/begin CHARACTERISTIC caw040_DT3 "INSTR3 Ersatzdatenbyte 3" VALUE 0xF1FA1 MSA15_FW1 0 DEZ_DB_U 0.000000 255.000000 /end CHARACTERISTIC
/begin CHARACTERISTIC caw040_DT4 "INSTR3 Ersatzdatenbyte 4" VALUE 0xF1FA2 MSA15_FW1 0 DEZ_DB_U 0.000000 255.000000 /end CHARACTERISTIC
/begin CHARACTERISTIC caw040_DT5 "INSTR3 Ersatzdatenbyte 5" VALUE 0xF1FA3 MSA15_FW1 0 DEZ_DB_U 0.000000 255.000000 /end CHARACTERISTIC
/begin CHARACTERISTIC caw040_DT6 "INSTR3 Ersatzdatenbyte 6" VALUE 0xF1FA4 MSA15_FW1 0 DEZ_DB_U 0.000000 255.000000 /end CHARACTERISTIC
/begin CHARACTERISTIC caw040_DT7 "INSTR3 Ersatzdatenbyte 7" VALUE 0xF1FA5 MSA15_FW1 0 DEZ_DB_U 0.000000 255.000000 /end CHARACTERISTIC
/begin CHARACTERISTIC caw040_DTL "INSTR3 Datenlaenge" VALUE 0xF1FA7 MSA15_FW1 0 DEZ_DB_U 4.000000 8.000000 EXTENDED_LIMITS 0.000000 255.000000 /end CHARACTERISTIC
/begin CHARACTERISTIC caw040_INF "INSTR3 Ersatzdaten vorhanden     ?" VALUE 0xF1F9D MSA15_FW1 0 DEZ_DB_U 0.000000 255.000000 /end CHARACTERISTIC
/begin CHARACTERISTIC caw040_MSC "INSTR3 Message Configuration" VALUE 0xF1FAA MSA15_FW1 0 DEZ_DB_U 64.000000 128.000000 EXTENDED_LIMITS 0.000000 255.000000 /end CHARACTERISTIC
/begin CHARACTERISTIC caw040_NSG "INSTR3 Anzahl Segmente" VALUE 0xF1F9B MSA15_FW1 0 DEZ_DB_U 1.000000 1.000000 EXTENDED_LIMITS 0.000000 255.000000 /end CHARACTERISTIC
/begin CHARACTERISTIC caw040_PER "INSTR3 Empfangsperiode" VALUE 0xF1F9A MSA15_FW1 0 DEZ_DB_U 1.000000 1.000000 EXTENDED_LIMITS 0.000000 255.000000 /end CHARACTERISTIC
/begin CHARACTERISTIC caw040_RTO "INSTR3 Empfangstimeout" VALUE 0xF1F9C MSA15_FW1 0 DEZ_DB_U 50.000000 50.000000 EXTENDED_LIMITS 0.000000 255.000000 /end CHARACTERISTIC
/begin CHARACTERISTIC caw050_AB0 "ASC1 Arbitration Byte 0" VALUE 0xF1FDC MSA15_FW1 0 DEZ_DB_U 42.000000 42.000000 EXTENDED_LIMITS 0.000000 255.000000 /end CHARACTERISTIC
/begin CHARACTERISTIC caw050_AB1 "ASC1 Arbitration Byte 1" VALUE 0xF1FDD MSA15_FW1 0 DEZ_DB_U 96.000000 96.000000 EXTENDED_LIMITS 0.000000 255.000000 /end CHARACTERISTIC
/begin CHARACTERISTIC caw050_ADR "ASC1 Baustein Objektadresse" VALUE 0xF1FDA MSA15_FW1 0 DEZ_DB_U 80.000000 80.000000 EXTENDED_LIMITS 0.000000 255.000000 /end CHARACTERISTIC
/begin CHARACTERISTIC caw050_DT0 "ASC1 Ersatzdatenbyte 0" VALUE 0xF1FD2 MSA15_FW1 0 DEZ_DB_U 0.000000 255.000000 /end CHARACTERISTIC
/begin CHARACTERISTIC caw050_DT1 "ASC1 Ersatzdatenbyte 1" VALUE 0xF1FD3 MSA15_FW1 0 DEZ_DB_U 0.000000 255.000000 /end CHARACTERISTIC
/begin CHARACTERISTIC caw050_DT2 "ASC1 Ersatzdatenbyte 2" VALUE 0xF1FD4 MSA15_FW1 0 DEZ_DB_U 0.000000 255.000000 /end CHARACTERISTIC
/begin CHARACTERISTIC caw050_DT3 "#SSD ASC1 Ersatzdatenbyte 3" VALUE 0xF1FD5 MSA15_FW1 0 DEZ_DB_U 0.000000 255.000000 /end CHARACTERISTIC
/begin CHARACTERISTIC caw050_DT4 "#SSD ASC1 Ersatzdatenbyte 4" VALUE 0xF1FD6 MSA15_FW1 0 DEZ_DB_U 0.000000 255.000000 /end CHARACTERISTIC
/begin CHARACTERISTIC caw050_DT5 "ASC1 Ersatzdatenbyte 5" VALUE 0xF1FD7 MSA15_FW1 0 DEZ_DB_U 0.000000 255.000000 /end CHARACTERISTIC
/begin CHARACTERISTIC caw050_DT6 "ASC1 Ersatzdatenbyte 6" VALUE 0xF1FD8 MSA15_FW1 0 DEZ_DB_U 0.000000 255.000000 /end CHARACTERISTIC
/begin CHARACTERISTIC caw050_DT7 "ASC1 Ersatzdatenbyte 7" VALUE 0xF1FD9 MSA15_FW1 0 DEZ_DB_U 0.000000 255.000000 /end CHARACTERISTIC
/begin CHARACTERISTIC caw050_DTL "ASC1 Datenlaenge" VALUE 0xF1FDB MSA15_FW1 0 DEZ_DB_U 5.000000 8.000000 EXTENDED_LIMITS 0.000000 255.000000 /end CHARACTERISTIC
/begin CHARACTERISTIC caw050_INF "ASC1 Ersatzdaten vorhanden ?" VALUE 0xF1FD1 MSA15_FW1 0 DEZ_DB_U 0.000000 255.000000 /end CHARACTERISTIC
/begin CHARACTERISTIC caw050_MSC "ASC1 Message Configuration" VALUE 0xF1FDE MSA15_FW1 0 DEZ_DB_U 80.000000 128.000000 EXTENDED_LIMITS 0.000000 255.000000 /end CHARACTERISTIC
/begin CHARACTERISTIC caw050_NSG "ASC1 Anzahl Segmente" VALUE 0xF1FCF MSA15_FW1 0 DEZ_DB_U 1.000000 1.000000 EXTENDED_LIMITS 0.000000 255.000000 /end CHARACTERISTIC
/begin CHARACTERISTIC caw050_PER "ASC1 Empfangsperiode" VALUE 0xF1FCE MSA15_FW1 0 DEZ_DB_U 1.000000 1.000000 EXTENDED_LIMITS 0.000000 255.000000 /end CHARACTERISTIC
/begin CHARACTERISTIC caw050_RTO "#SSD ASC1 Empfangstimeout" VALUE 0xF1FD0 MSA15_FW1 0 DEZ_DB_U 50.000000 50.000000 EXTENDED_LIMITS 0.000000 255.000000 /end CHARACTERISTIC
/begin CHARACTERISTIC caw060_AB0 "DDE4 Arbitration Byte 0" VALUE 0xF1FEE MSA15_FW1 0 DEZ_DB_U 168.000000 168.000000 EXTENDED_LIMITS 0.000000 255.000000 /end CHARACTERISTIC
/begin CHARACTERISTIC caw060_AB1 "DDE4 Arbitration Byte 1" VALUE 0xF1FEF MSA15_FW1 0 DEZ_DB_U 160.000000 160.000000 EXTENDED_LIMITS 0.000000 255.000000 /end CHARACTERISTIC
/begin CHARACTERISTIC caw060_ADR "DDE4 Baustein Objektadresse" VALUE 0xF1FEC MSA15_FW1 0 DEZ_DB_U 192.000000 192.000000 EXTENDED_LIMITS 0.000000 255.000000 /end CHARACTERISTIC
/begin CHARACTERISTIC caw060_DT0 "DDE4 Ersatzdatenbyte 0" VALUE 0xF1FE4 MSA15_FW1 0 DEZ_DB_U 0.000000 255.000000 /end CHARACTERISTIC
/begin CHARACTERISTIC caw060_DT1 "DDE4 Ersatzdatenbyte 1" VALUE 0xF1FE5 MSA15_FW1 0 DEZ_DB_U 0.000000 255.000000 /end CHARACTERISTIC
/begin CHARACTERISTIC caw060_DT2 "DDE4 Ersatzdatenbyte 2" VALUE 0xF1FE6 MSA15_FW1 0 DEZ_DB_U 0.000000 255.000000 /end CHARACTERISTIC
/begin CHARACTERISTIC caw060_DT3 "DDE4 Ersatzdatenbyte 3" VALUE 0xF1FE7 MSA15_FW1 0 DEZ_DB_U 0.000000 255.000000 /end CHARACTERISTIC
/begin CHARACTERISTIC caw060_DT4 "DDE4 Ersatzdatenbyte 4" VALUE 0xF1FE8 MSA15_FW1 0 DEZ_DB_U 0.000000 255.000000 /end CHARACTERISTIC
/begin CHARACTERISTIC caw060_DT5 "DDE4 Ersatzdatenbyte 5" VALUE 0xF1FE9 MSA15_FW1 0 DEZ_DB_U 0.000000 255.000000 /end CHARACTERISTIC
/begin CHARACTERISTIC caw060_DT6 "DDE4 Ersatzdatenbyte 6" VALUE 0xF1FEA MSA15_FW1 0 DEZ_DB_U 0.000000 255.000000 /end CHARACTERISTIC
/begin CHARACTERISTIC caw060_DT7 "DDE4 Ersatzdatenbyte 7" VALUE 0xF1FEB MSA15_FW1 0 DEZ_DB_U 0.000000 255.000000 /end CHARACTERISTIC
/begin CHARACTERISTIC caw060_DTL "DDE4 Datenlaenge" VALUE 0xF1FED MSA15_FW1 0 DEZ_DB_U 4.000000 8.000000 EXTENDED_LIMITS 0.000000 255.000000 /end CHARACTERISTIC
/begin CHARACTERISTIC caw060_INF "DDE4 Mehrfachnutzung Sendeobjekt" VALUE 0xF1FE3 MSA15_FW1 0 NULL 0.000000 0.000000 /end CHARACTERISTIC
/begin CHARACTERISTIC caw060_MSC "DDE4 Message Configuration" VALUE 0xF1FF0 MSA15_FW1 0 DEZ_DB_U 72.000000 72.000000 EXTENDED_LIMITS 0.000000 255.000000 /end CHARACTERISTIC
/begin CHARACTERISTIC caw060_NSG "DDE4 Anzahl Segmente" VALUE 0xF1FE1 MSA15_FW1 0 DEZ_DB_U 1.000000 1.000000 EXTENDED_LIMITS 0.000000 255.000000 /end CHARACTERISTIC
/begin CHARACTERISTIC caw060_PER "DDE4 Sendeperiode" VALUE 0xF1FE0 MSA15_FW1 0 DEZ_DB_U 1.000000 1.000000 EXTENDED_LIMITS 0.000000 255.000000 /end CHARACTERISTIC
/begin CHARACTERISTIC caw060_RTO "DDE4 Empfangstimeout" VALUE 0xF1FE2 MSA15_FW1 0 DEZ_DB_U 0.000000 255.000000 /end CHARACTERISTIC
/begin CHARACTERISTIC caw070_AB0 "INSTR2 Arbitration Byte 0" VALUE 0xF24D2 MSA15_FW1 0 DEZ_DB_U 194.000000 194.000000 EXTENDED_LIMITS 0.000000 255.000000 /end CHARACTERISTIC
/begin CHARACTERISTIC caw070_AB1 "INSTR2 Arbitration Byte 1" VALUE 0xF24D3 MSA15_FW1 0 DEZ_DB_U 96.000000 96.000000 EXTENDED_LIMITS 0.000000 255.000000 /end CHARACTERISTIC
/begin CHARACTERISTIC caw070_ADR "INSTR2 Baustein Objektadresse" VALUE 0xF24D0 MSA15_FW1 0 DEZ_DB_U 112.000000 112.000000 EXTENDED_LIMITS 0.000000 255.000000 /end CHARACTERISTIC
/begin CHARACTERISTIC caw070_DT0 "INSTR2 Ersatzdatenbyte 0" VALUE 0xF24C8 MSA15_FW1 0 DEZ_DB_U 0.000000 255.000000 /end CHARACTERISTIC
/begin CHARACTERISTIC caw070_DT1 "INSTR2 Ersatzdatenbyte 1" VALUE 0xF24C9 MSA15_FW1 0 DEZ_DB_U 0.000000 255.000000 /end CHARACTERISTIC
/begin CHARACTERISTIC caw070_DT2 "INSTR2 Ersatzdatenbyte 2" VALUE 0xF24CA MSA15_FW1 0 DEZ_DB_U 0.000000 255.000000 /end CHARACTERISTIC
/begin CHARACTERISTIC caw070_DT3 "INSTR2 Ersatzdatenbyte 3" VALUE 0xF24CB MSA15_FW1 0 DEZ_DB_U 0.000000 255.000000 /end CHARACTERISTIC
/begin CHARACTERISTIC caw070_DT4 "INSTR2 Ersatzdatenbyte 4" VALUE 0xF24CC MSA15_FW1 0 DEZ_DB_U 0.000000 255.000000 /end CHARACTERISTIC
/begin CHARACTERISTIC caw070_DT5 "INSTR2 Ersatzdatenbyte 5" VALUE 0xF24CD MSA15_FW1 0 DEZ_DB_U 0.000000 255.000000 /end CHARACTERISTIC
/begin CHARACTERISTIC caw070_DT6 "INSTR2 Ersatzdatenbyte 6" VALUE 0xF24CE MSA15_FW1 0 DEZ_DB_U 0.000000 255.000000 /end CHARACTERISTIC
/begin CHARACTERISTIC caw070_DT7 "INSTR2 Ersatzdatenbyte 7" VALUE 0xF24CF MSA15_FW1 0 DEZ_DB_U 0.000000 255.000000 /end CHARACTERISTIC
/begin CHARACTERISTIC caw070_DTL "INSTR2 Datenlaenge" VALUE 0xF24D1 MSA15_FW1 0 DEZ_DB_U 8.000000 8.000000 EXTENDED_LIMITS 0.000000 255.000000 /end CHARACTERISTIC
/begin CHARACTERISTIC caw070_INF "INSTR2 Ersatzdaten vorhanden ?" VALUE 0xF24C7 MSA15_FW1 0 DEZ_DB_U 0.000000 255.000000 /end CHARACTERISTIC
/begin CHARACTERISTIC caw070_MSC "INSTR2 Message Configuration" VALUE 0xF24D4 MSA15_FW1 0 DEZ_DB_U 128.000000 128.000000 EXTENDED_LIMITS 0.000000 255.000000 /end CHARACTERISTIC
/begin CHARACTERISTIC caw070_NSG "INSTR2 Anzahl Segmente" VALUE 0xF24C5 MSA15_FW1 0 DEZ_DB_U 1.000000 1.000000 EXTENDED_LIMITS 0.000000 255.000000 /end CHARACTERISTIC
/begin CHARACTERISTIC caw070_PER "INSTR2 Empfangsperiode" VALUE 0xF24C4 MSA15_FW1 0 DEZ_DB_U 1.000000 1.000000 EXTENDED_LIMITS 0.000000 255.000000 /end CHARACTERISTIC
/begin CHARACTERISTIC caw070_RTO "INSTR2 Empfangstimeout" VALUE 0xF24C6 MSA15_FW1 0 DEZ_DB_U 50.000000 50.000000 EXTENDED_LIMITS 0.000000 255.000000 /end CHARACTERISTIC
/begin CHARACTERISTIC caw080_AB0 "ASC3 Arbitration Byte 0" VALUE 0xF24E8 MSA15_FW1 0 DEZ_DB_U 62.000000 62.000000 EXTENDED_LIMITS 0.000000 255.000000 /end CHARACTERISTIC
/begin CHARACTERISTIC caw080_AB1 "ASC3 Arbitration Byte 1" VALUE 0xF24E9 MSA15_FW1 0 DEZ_DB_U 96.000000 96.000000 EXTENDED_LIMITS 0.000000 255.000000 /end CHARACTERISTIC
/begin CHARACTERISTIC caw080_ADR "ASC3 Baustein Objektadresse" VALUE 0xF24E6 MSA15_FW1 0 DEZ_DB_U 80.000000 128.000000 EXTENDED_LIMITS 0.000000 255.000000 /end CHARACTERISTIC
/begin CHARACTERISTIC caw080_DT0 "ASC3 Ersatzdatenbyte 0" VALUE 0xF24DE MSA15_FW1 0 DEZ_DB_U 0.000000 255.000000 /end CHARACTERISTIC
/begin CHARACTERISTIC caw080_DT1 "ASC3 Ersatzdatenbyte 1" VALUE 0xF24DF MSA15_FW1 0 DEZ_DB_U 0.000000 255.000000 /end CHARACTERISTIC
/begin CHARACTERISTIC caw080_DT2 "ASC3 Ersatzdatenbyte 2" VALUE 0xF24E0 MSA15_FW1 0 DEZ_DB_U 0.000000 255.000000 /end CHARACTERISTIC
/begin CHARACTERISTIC caw080_DT3 "ASC3 Ersatzdatenbyte 3" VALUE 0xF24E1 MSA15_FW1 0 DEZ_DB_U 0.000000 255.000000 /end CHARACTERISTIC
/begin CHARACTERISTIC caw080_DT4 "ASC3 Ersatzdatenbyte 4" VALUE 0xF24E2 MSA15_FW1 0 DEZ_DB_U 0.000000 255.000000 /end CHARACTERISTIC
/begin CHARACTERISTIC caw080_DT5 "ASC3 Ersatzdatenbyte 5" VALUE 0xF24E3 MSA15_FW1 0 DEZ_DB_U 0.000000 255.000000 /end CHARACTERISTIC
/begin CHARACTERISTIC caw080_DT6 "ASC3 Ersatzdatenbyte 6" VALUE 0xF24E4 MSA15_FW1 0 DEZ_DB_U 0.000000 255.000000 /end CHARACTERISTIC
/begin CHARACTERISTIC caw080_DT7 "ASC3 Ersatzdatenbyte 7" VALUE 0xF24E5 MSA15_FW1 0 DEZ_DB_U 0.000000 255.000000 /end CHARACTERISTIC
/begin CHARACTERISTIC caw080_DTL "ASC3 Datenlaenge" VALUE 0xF24E7 MSA15_FW1 0 DEZ_DB_U 5.000000 8.000000 EXTENDED_LIMITS 0.000000 255.000000 /end CHARACTERISTIC
/begin CHARACTERISTIC caw080_INF "ASC3 Ersatzdaten vorhanden ?" VALUE 0xF24DD MSA15_FW1 0 DEZ_DB_U 0.000000 255.000000 /end CHARACTERISTIC
/begin CHARACTERISTIC caw080_MSC "ASC3 Message Configuration" VALUE 0xF24EA MSA15_FW1 0 DEZ_DB_U 80.000000 128.000000 EXTENDED_LIMITS 0.000000 255.000000 /end CHARACTERISTIC
/begin CHARACTERISTIC caw080_NSG "ASC3 Anzahl Segmente" VALUE 0xF24DB MSA15_FW1 0 DEZ_DB_U 1.000000 1.000000 EXTENDED_LIMITS 0.000000 255.000000 /end CHARACTERISTIC
/begin CHARACTERISTIC caw080_PER "ASC3 Empfangsperiode" VALUE 0xF24DA MSA15_FW1 0 DEZ_DB_U 1.000000 1.000000 EXTENDED_LIMITS 0.000000 255.000000 /end CHARACTERISTIC
/begin CHARACTERISTIC caw080_RTO "ASC3 Empfangstimeout" VALUE 0xF24DC MSA15_FW1 0 DEZ_DB_U 50.000000 50.000000 EXTENDED_LIMITS 0.000000 255.000000 /end CHARACTERISTIC
/begin CHARACTERISTIC caw090_AB0 "TXU Arbitration Byte 0" VALUE 0xF24FA MSA15_FW1 0 DEZ_DB_U 136.000000 136.000000 EXTENDED_LIMITS 0.000000 255.000000 /end CHARACTERISTIC
/begin CHARACTERISTIC caw090_AB1 "TXU Arbitration Byte 1" VALUE 0xF24FB MSA15_FW1 0 DEZ_DB_U 160.000000 160.000000 EXTENDED_LIMITS 0.000000 255.000000 /end CHARACTERISTIC
/begin CHARACTERISTIC caw090_ADR "TXU Baustein Objektadresse" VALUE 0xF24F8 MSA15_FW1 0 DEZ_DB_U 144.000000 144.000000 EXTENDED_LIMITS 0.000000 255.000000 /end CHARACTERISTIC
/begin CHARACTERISTIC caw090_DT0 "TXU Ersatzdatenbyte 0" VALUE 0xF24F0 MSA15_FW1 0 DEZ_DB_U 0.000000 255.000000 /end CHARACTERISTIC
/begin CHARACTERISTIC caw090_DT1 "TXU Ersatzdatenbyte 1" VALUE 0xF24F1 MSA15_FW1 0 DEZ_DB_U 0.000000 255.000000 /end CHARACTERISTIC
/begin CHARACTERISTIC caw090_DT2 "TXU Ersatzdatenbyte 2" VALUE 0xF24F2 MSA15_FW1 0 DEZ_DB_U 0.000000 255.000000 /end CHARACTERISTIC
/begin CHARACTERISTIC caw090_DT3 "TXU Ersatzdatenbyte 3" VALUE 0xF24F3 MSA15_FW1 0 DEZ_DB_U 0.000000 255.000000 /end CHARACTERISTIC
/begin CHARACTERISTIC caw090_DT4 "TXU Ersatzdatenbyte 4" VALUE 0xF24F4 MSA15_FW1 0 DEZ_DB_U 0.000000 255.000000 /end CHARACTERISTIC
/begin CHARACTERISTIC caw090_DT5 "TXU Ersatzdatenbyte 5" VALUE 0xF24F5 MSA15_FW1 0 DEZ_DB_U 0.000000 255.000000 /end CHARACTERISTIC
/begin CHARACTERISTIC caw090_DT6 "TXU Ersatzdatenbyte 6" VALUE 0xF24F6 MSA15_FW1 0 DEZ_DB_U 0.000000 255.000000 /end CHARACTERISTIC
/begin CHARACTERISTIC caw090_DT7 "TXU Ersatzdatenbyte 7" VALUE 0xF24F7 MSA15_FW1 0 DEZ_DB_U 0.000000 255.000000 /end CHARACTERISTIC
/begin CHARACTERISTIC caw090_DTL "TXU Datenlaenge" VALUE 0xF24F9 MSA15_FW1 0 DEZ_DB_U 5.000000 8.000000 EXTENDED_LIMITS 0.000000 255.000000 /end CHARACTERISTIC
/begin CHARACTERISTIC caw090_INF "TXU Ersatzdaten vorhanden ?" VALUE 0xF24EF MSA15_FW1 0 DEZ_DB_U 0.000000 255.000000 /end CHARACTERISTIC
/begin CHARACTERISTIC caw090_MSC "TXU Message Configuration" VALUE 0xF24FC MSA15_FW1 0 DEZ_DB_U 80.000000 128.000000 EXTENDED_LIMITS 0.000000 255.000000 /end CHARACTERISTIC
/begin CHARACTERISTIC caw090_NSG "TXU Anzahl Segmente" VALUE 0xF24ED MSA15_FW1 0 DEZ_DB_U 1.000000 1.000000 EXTENDED_LIMITS 0.000000 255.000000 /end CHARACTERISTIC
/begin CHARACTERISTIC caw090_PER "TXU Empfangsperiode" VALUE 0xF24EC MSA15_FW1 0 DEZ_DB_U 1.000000 1.000000 EXTENDED_LIMITS 0.000000 255.000000 /end CHARACTERISTIC
/begin CHARACTERISTIC caw090_RTO "TXU Empfangstimeout" VALUE 0xF24EE MSA15_FW1 0 DEZ_DB_U 50.000000 50.000000 EXTENDED_LIMITS 0.000000 255.000000 /end CHARACTERISTIC
/begin CHARACTERISTIC caw100_AB0 "DDE8 Arbitration Byte 0" VALUE 0xF2000 MSA15_FW1 0 DEZ_DB_U 103.000000 103.000000 EXTENDED_LIMITS 0.000000 255.000000 /end CHARACTERISTIC
/begin CHARACTERISTIC caw100_AB1 "DDE8 Arbitration Byte 1" VALUE 0xF2001 MSA15_FW1 0 NULL 0.000000 0.000000 /end CHARACTERISTIC
/begin CHARACTERISTIC caw100_ADR "DDE8 Baustein Objektadresse" VALUE 0xF1FFE MSA15_FW1 0 DEZ_DB_U 160.000000 160.000000 EXTENDED_LIMITS 0.000000 255.000000 /end CHARACTERISTIC
/begin CHARACTERISTIC caw100_DT0 "DDE8 Ersatzdatenbyte 0" VALUE 0xF1FF6 MSA15_FW1 0 DEZ_DB_U 0.000000 255.000000 /end CHARACTERISTIC
/begin CHARACTERISTIC caw100_DT1 "DDE8 Ersatzdatenbyte 1" VALUE 0xF1FF7 MSA15_FW1 0 DEZ_DB_U 0.000000 255.000000 /end CHARACTERISTIC
/begin CHARACTERISTIC caw100_DT2 "DDE8 Ersatzdatenbyte 2" VALUE 0xF1FF8 MSA15_FW1 0 DEZ_DB_U 0.000000 255.000000 /end CHARACTERISTIC
/begin CHARACTERISTIC caw100_DT3 "DDE8 Ersatzdatenbyte 3" VALUE 0xF1FF9 MSA15_FW1 0 DEZ_DB_U 0.000000 255.000000 /end CHARACTERISTIC
/begin CHARACTERISTIC caw100_DT4 "DDE8 Ersatzdatenbyte 4" VALUE 0xF1FFA MSA15_FW1 0 DEZ_DB_U 0.000000 255.000000 /end CHARACTERISTIC
/begin CHARACTERISTIC caw100_DT5 "DDE8 Ersatzdatenbyte 5" VALUE 0xF1FFB MSA15_FW1 0 DEZ_DB_U 0.000000 255.000000 /end CHARACTERISTIC
/begin CHARACTERISTIC caw100_DT6 "DDE8 Ersatzdatenbyte 6" VALUE 0xF1FFC MSA15_FW1 0 DEZ_DB_U 0.000000 255.000000 /end CHARACTERISTIC
/begin CHARACTERISTIC caw100_DT7 "DDE8 Ersatzdatenbyte 7" VALUE 0xF1FFD MSA15_FW1 0 DEZ_DB_U 0.000000 255.000000 /end CHARACTERISTIC
/begin CHARACTERISTIC caw100_DTL "DDE8 Datenlaenge" VALUE 0xF1FFF MSA15_FW1 0 DEZ_DB_U 4.000000 8.000000 EXTENDED_LIMITS 0.000000 255.000000 /end CHARACTERISTIC
/begin CHARACTERISTIC caw100_INF "DDE8 Mehrfachnutzung Sendeobjekt" VALUE 0xF1FF5 MSA15_FW1 0 NULL 0.000000 0.000000 /end CHARACTERISTIC
/begin CHARACTERISTIC caw100_MSC "DDE8 Message Configuration" VALUE 0xF2002 MSA15_FW1 0 DEZ_DB_U 72.000000 72.000000 EXTENDED_LIMITS 0.000000 255.000000 /end CHARACTERISTIC
/begin CHARACTERISTIC caw100_NSG "DDE8 Anzahl Segmente" VALUE 0xF1FF3 MSA15_FW1 0 DEZ_DB_U 1.000000 1.000000 EXTENDED_LIMITS 0.000000 255.000000 /end CHARACTERISTIC
/begin CHARACTERISTIC caw100_PER "DDE8 Sendeperiode" VALUE 0xF1FF2 MSA15_FW1 0 DEZ_DB_U 1.000000 1.000000 EXTENDED_LIMITS 0.000000 255.000000 /end CHARACTERISTIC
/begin CHARACTERISTIC caw100_RTO "DDE8 Empfangstimeout" VALUE 0xF1FF4 MSA15_FW1 0 DEZ_DB_U 0.000000 255.000000 /end CHARACTERISTIC
/begin CHARACTERISTIC cawDSCtot1 "Zeit fuer DSC Bremseingriff" VALUE 0xF1F5E MSA15_FW3 0 ZEIT_ST 0.000000 10000000.000000 EXTENDED_LIMITS 0.000000 655350000.000000 /end CHARACTERISTIC
/begin CHARACTERISTIC cawDSCtot2 "Zeit fuer DSC Mengeneingriff" VALUE 0xF1F60 MSA15_FW3 0 ZEIT_ST 0.000000 10000000.000000 EXTENDED_LIMITS 0.000000 655350000.000000 /end CHARACTERISTIC
/begin CHARACTERISTIC cawDSCtot3 "Zeit fuer HDC Mengeneingriff" VALUE 0xF1F62 MSA15_FW3 0 ZEIT_ST 0.000000 10000000.000000 EXTENDED_LIMITS 0.000000 655350000.000000 /end CHARACTERISTIC
/begin CHARACTERISTIC cawEKP_VGW "Vorgabewert fuer EKP-Abschaltung bei Botschaftsausfall" VALUE 0xF1FC6 MSA15_FW1 0 DEZ_DB_U 0.000000 3.000000 EXTENDED_LIMITS 0.000000 255.000000 /end CHARACTERISTIC
/begin CHARACTERISTIC cawFNMOT_a "Aktivierung F_N_MOT Signals" VALUE 0xF1F5C MSA15_FW1 0 DEZ_DB_U 0.000000 1.000000 EXTENDED_LIMITS 0.000000 255.000000 /end CHARACTERISTIC
/begin CHARACTERISTIC cawFST_VGW "Vorgabewert Tankfuellstand" VALUE 0xF1FCB MSA15_FW1 0 DEZ_DB_U 0.000000 127.000000 EXTENDED_LIMITS 0.000000 255.000000 /end CHARACTERISTIC
/begin CHARACTERISTIC cawGANGVGW "Vorgabewert fuer EGS1-Botschaftsausfall Ganginfo" VALUE 0xF1FCA MSA15_FW1 0 DEZ_DB_U 0.000000 7.000000 EXTENDED_LIMITS 0.000000 255.000000 /end CHARACTERISTIC
/begin CHARACTERISTIC cawHZL_VGW "Vorgabewert fuer Heizleistungsanforderung" VALUE 0xF1FC7 MSA15_FW1 0 DEZ_DB_U 0.000000 1.000000 EXTENDED_LIMITS 0.000000 255.000000 /end CHARACTERISTIC
/begin CHARACTERISTIC cawINF_CAB ".6=CAN .3=Kombi .1=ASC .4=TXU .5=ASC3 .0=EGS vorhanden   ! ***BC230 VIE2WI      " VALUE 0xF1F54 MSA15_FW1 0 DEZ_DB_U 0.000000 255.000000 /end CHARACTERISTIC
/begin CHARACTERISTIC cawINF_DLY "#SSD CAN Ausblendzeit" VALUE 0xF1F58 MSA15_FW3 0 ZEIT_ST 0.000000 655350000.000000 /end CHARACTERISTIC
/begin CHARACTERISTIC cawINF_TBO "#SSD Mindestzeit zwischen zwei Initialisierungen" VALUE 0xF1F56 MSA15_FW3 0 ZEIT_ST 0.000000 655350000.000000 /end CHARACTERISTIC
/begin CHARACTERISTIC cawINF_UBT "#SSD CAN Ausblendung: UBatt-Schwelle" VALUE 0xF1F5A MSA15_FW3 0 U_B 0.000000 32760.580000 EXTENDED_LIMITS 0.000000 773948.100000 /end CHARACTERISTIC
/begin CHARACTERISTIC cawLMK_VGW "Vorgabewert fuer Lastmoment Klimakompressor" VALUE 0xF1FC0 MSA15_FW4 0 MOMENT 0.000000 31.000000 EXTENDED_LIMITS -32768.000000 32767.000000 /end CHARACTERISTIC
/begin CHARACTERISTIC cawNEL_VGW "MLS Vorgabewert fuer Drehzahlstufe E-Luefter bei Botschaftsausfall" VALUE 0xF1FC4 MSA15_FW4 0 MLS_N_DW 0.000000 3000.000000 EXTENDED_LIMITS 0.000000 32766.990000 /end CHARACTERISTIC
/begin CHARACTERISTIC cawN_EL_KL "MLS CAN-E-Luefter-Drehzahl = f(CAN-Stufe)" CURVE 0xF24B4 MSA15_KL112 0 MLS_N_DW 0.000000 3000.000000
 /begin AXIS_DESCR STD_AXIS caoN_ELcan DEZ_DW_U 3 0.000000 15.000000 EXTENDED_LIMITS 0.000000 65535.000000 /end AXIS_DESCR
 EXTENDED_LIMITS 0.000000 32766.990000 /end CHARACTERISTIC
/begin CHARACTERISTIC cawRangVGW "Vorgabewert von camRangeSt bei Botschaftsausfall" VALUE 0xF1FCC MSA15_FW1 0 DEZ_DB_U 0.000000 7.000000 EXTENDED_LIMITS 0.000000 255.000000 /end CHARACTERISTIC
/begin CHARACTERISTIC cawSAC_VGW "Vorgabewert fuer Schalter Klimabereitschaft" VALUE 0xF1FC3 MSA15_FW1 0 DEZ_DB_U 0.000000 1.000000 EXTENDED_LIMITS 0.000000 255.000000 /end CHARACTERISTIC
/begin CHARACTERISTIC cawSKO_VGW "Vorgabewert fuer Schalter Klimakompressor" VALUE 0xF1FC2 MSA15_FW1 0 DEZ_DB_U 0.000000 1.000000 EXTENDED_LIMITS 0.000000 255.000000 /end CHARACTERISTIC
/begin CHARACTERISTIC cawTUMGVGW "Vorgabewert fuer Umgebungstemperatur" VALUE 0xF1FC8 MSA15_FW3 0 T -50.040010 199.960000 EXTENDED_LIMITS -273.140000 3003.560000 /end CHARACTERISTIC
/begin CHARACTERISTIC cawUEB_T1 "untere Uebertemperaturschwelle" VALUE 0xF1FBC MSA15_FW4 0 T -50.040010 149.960000 EXTENDED_LIMITS -273.140000 3003.560000 /end CHARACTERISTIC
/begin CHARACTERISTIC cawUEB_T2 "obere Uebertemperaturschwelle" VALUE 0xF1FBE MSA15_FW4 0 T -50.040010 149.960000 EXTENDED_LIMITS -273.140000 3003.560000 /end CHARACTERISTIC
/begin CHARACTERISTIC cowAGLVoll "EEPROM Ersatzwert Vollastabgleichfaktor" VALUE 0xF2552 MSA15_FW4 0 FAKT 0.800000 1.200000 EXTENDED_LIMITS -3.276800 3.276700 /end CHARACTERISTIC
/begin CHARACTERISTIC cowAGL_ARF "EEPROM Ersatzwert additiv. ARF-Luftmengen-Abgleich" VALUE 0xF2550 MSA15_FW4 0 M_L -1500.000000 1500.000000 EXTENDED_LIMITS -3276.800000 3276.700000 /end CHARACTERISTIC
/begin CHARACTERISTIC cowAGL_BEG "EEPROM Ersatzwert Begrenzungsmengen-Abgleich" VALUE 0xF254C MSA15_FW4 0 FAKT 0.000000 3.200000 EXTENDED_LIMITS -3.276800 3.276700 /end CHARACTERISTIC
/begin CHARACTERISTIC cowAGL_CKS "EEPROM Ersatzwert Checksummen-Abgleich" VALUE 0xF2554 MSA15_FW4 0 DEZ_DW -32768.000000 32767.000000 /end CHARACTERISTIC
/begin CHARACTERISTIC cowAGL_LLR "EEPROM Ersatzwert Leerlaufdrehzahl-Abgleich" VALUE 0xF254E MSA15_FW4 0 dN -200.000000 200.000000 EXTENDED_LIMITS -32768.000000 32767.000000 /end CHARACTERISTIC
/begin CHARACTERISTIC cowAGL_STA "EEPROM Ersatzwert Startmengen-Abgleich" VALUE 0xF254A MSA15_FW4 0 MM3 0.000000 100.000000 EXTENDED_LIMITS -327.680000 327.670000 /end CHARACTERISTIC
/begin CHARACTERISTIC cowARF_ME "ARF-Mengeneingang Steuerung (0:Wunschm./1:MAX(Wunschm. & Fahrerwunschm.)" VALUE 0xF2556 MSA15_FW1 0 DEZ_DB_U 0.000000 1.000000 EXTENDED_LIMITS 0.000000 255.000000 /end CHARACTERISTIC
/begin CHARACTERISTIC cowAlpina "Deaktivierung der Funktionen der Pumpenelementabschaltung" VALUE 0xF2558 MSA15_FW1 0 DEZ_DB_U 0.000000 1.000000 EXTENDED_LIMITS 0.000000 255.000000 /end CHARACTERISTIC
/begin CHARACTERISTIC cowEABTest "FUN-S Regeln (0) / Einfrieren (1) bei EAB-Test" VALUE 0xF253E MSA15_FW1 0 DEZ_DB_U 0.000000 1.000000 EXTENDED_LIMITS 0.000000 255.000000 /end CHARACTERISTIC
/begin CHARACTERISTIC cowFLDRAB1 "LDR aus bei Fehler (0:DZG,1:PWG,2:PGS,3:LDF,4:LMM,5:IWZ,6:K15,7:EAB_P)" VALUE 0xF251C MSA15_FW1 0 DEZ_DB_U 0.000000 255.000000 /end CHARACTERISTIC
/begin CHARACTERISTIC cowFLDRAB2 "LDR aus bei Fehler (ARS 0:_K,1:_O,2:_pR,3:_nR)                                  " VALUE 0xF251D MSA15_FW1 0 DEZ_DB_U 0.000000 255.000000 /end CHARACTERISTIC
/begin CHARACTERISTIC cowFLDRAB3 "LDR aus bei Fehler (LDS 0:_K,5:_1)" VALUE 0xF251E MSA15_FW1 0 DEZ_DB_U 0.000000 255.000000 /end CHARACTERISTIC
/begin CHARACTERISTIC cowFUN_ADF "FUN-S mit/ohne (1/0) Atmosphaerendruck-Sensor" VALUE 0xF253A MSA15_FW1 0 DEZ_DB_U 1.000000 1.000000 EXTENDED_LIMITS 0.000000 255.000000 /end CHARACTERISTIC
/begin CHARACTERISTIC cowFUN_ARF "FUN-S mit/ohne (1/0) Abgasrueckfuehrung" VALUE 0xF2531 MSA15_FW1 0 DEZ_DB_U 1.000000 1.000000 EXTENDED_LIMITS 0.000000 255.000000 /end CHARACTERISTIC
/begin CHARACTERISTIC cowFUN_BEG "FUN-S Begrenzungsmenge Kochschutz mit (0:OTF / 1:KTF)" VALUE 0xF2544 MSA15_FW1 0 DEZ_DB_U 0.000000 1.000000 EXTENDED_LIMITS 0.000000 255.000000 /end CHARACTERISTIC
/begin CHARACTERISTIC cowFUN_BYP "FUN-S Bypass AUS (0) / Bypass AKTIV (1)" VALUE 0xF2543 MSA15_FW1 0 DEZ_DB_U 0.000000 1.000000 EXTENDED_LIMITS 0.000000 255.000000 /end CHARACTERISTIC
/begin CHARACTERISTIC cowFUN_CKS "FUN-S Checksumme - nicht aendern" VALUE 0xF2538 MSA15_FW1 0 DEZ_DB_U 0.000000 255.000000 /end CHARACTERISTIC
/begin CHARACTERISTIC cowFUN_DSC "FUN-S aktivierung der DSC/HDC Systemreaktion" VALUE 0xF252F MSA15_FW1 0 DEZ_DB 0.000000 4.000000 EXTENDED_LIMITS -128.000000 127.000000 /end CHARACTERISTIC
/begin CHARACTERISTIC cowFUN_DSV "FUN-S Datenstand-Variante" VALUE 0xF252E MSA15_FW1 0 DEZ_DB_U 0.000000 9.000000 EXTENDED_LIMITS 0.000000 255.000000 /end CHARACTERISTIC
/begin CHARACTERISTIC cowFUN_FGB "FUN-S Fahrgeschwindigkeitsbegrenzung ja/nein (1/0)" VALUE 0xF2535 MSA15_FW1 0 NULL 0.000000 0.000000 /end CHARACTERISTIC
/begin CHARACTERISTIC cowFUN_FGR "FUN-S FGR-Typ (0:no /1:FGR/2:var. ADR/4:res./8:feste ADR)" VALUE 0xF2533 MSA15_FW1 0 DEZ_DB_U 1.000000 1.000000 EXTENDED_LIMITS 0.000000 255.000000 /end CHARACTERISTIC
/begin CHARACTERISTIC cowFUN_GDB "FUN-S Getriebe-Differential-Bremse ja/nein (1/0)" VALUE 0xF2534 MSA15_FW1 0 NULL 0.000000 0.000000 /end CHARACTERISTIC
/begin CHARACTERISTIC cowFUN_HYS "FUN-S ARF-Steuerung mit/ohne (1/0) Hysterese" VALUE 0xF2539 MSA15_FW1 0 NULL 0.000000 0.000000 /end CHARACTERISTIC
/begin CHARACTERISTIC cowFUN_KLG "FUN-S Klimageraet (1:verbaut)" VALUE 0xF2536 MSA15_FW1 0 DEZ_DB_U 1.000000 1.000000 EXTENDED_LIMITS 0.000000 255.000000 /end CHARACTERISTIC
/begin CHARACTERISTIC cowFUN_KMB "FUN-S Status - KOMBI (0:ohne CAN/1:mit CAN)" VALUE 0xF2541 MSA15_FW1 0 DEZ_DB_U 0.000000 1.000000 EXTENDED_LIMITS 0.000000 255.000000 /end CHARACTERISTIC
/begin CHARACTERISTIC cowFUN_KWH "FUN-S Kuehlwasserheizung bestueckt ja(1)/nein(0)" VALUE 0xF2547 MSA15_FW1 0 DEZ_DB_U 0.000000 1.000000 EXTENDED_LIMITS 0.000000 255.000000 /end CHARACTERISTIC
/begin CHARACTERISTIC cowFUN_LDR "FUN-S mit/ohne (1/0) Ladedruck-Regelung/-Steuerung" VALUE 0xF2532 MSA15_FW1 0 DEZ_DB_U 1.000000 1.000000 EXTENDED_LIMITS 0.000000 255.000000 /end CHARACTERISTIC
/begin CHARACTERISTIC cowFUN_LMN "Schalter fuer Nullpunktabgleich" VALUE 0xF49E8 MSA15_FW1 0 DEZ_DB_U 0.000000 255.000000 /end CHARACTERISTIC
/begin CHARACTERISTIC cowFUN_LMV "Verschmutzungserkennung aktiv/inaktiv" VALUE 0xF4A50 MSA15_FW1 0 DEZ_DB 0.000000 1.000000 EXTENDED_LIMITS -128.000000 127.000000 /end CHARACTERISTIC
/begin CHARACTERISTIC cowFUN_MSW "FUN-S mit (1)=FGR ueber Mainswitch akt. / (0)=FGR immer akt." VALUE 0xF2542 MSA15_FW1 0 DEZ_DB_U 1.000000 1.000000 EXTENDED_LIMITS 0.000000 255.000000 /end CHARACTERISTIC
/begin CHARACTERISTIC cowFUN_M_E "CAN-EGS-FUN (0 bei HS, 1 nur bei v/n aus CAN-EGS-Gang-VGW, 128 Parameter aus Gan" VALUE 0xF253C MSA15_FW1 0 DEZ_DB_U 0.000000 1.000000 EXTENDED_LIMITS 0.000000 255.000000 /end CHARACTERISTIC
/begin CHARACTERISTIC cowFUN_M_L "FUN-S M_List/P_Lkorr messen / berechnen aus P, T" VALUE 0xF253B MSA15_FW1 0 DEZ_DB_U 0.000000 48.000000 EXTENDED_LIMITS 0.000000 255.000000 /end CHARACTERISTIC
/begin CHARACTERISTIC cowFUN_ODS "Auswahl Oeldruckschalter auf Zeit- oder Drehzahlschwelle" VALUE 0xF2546 MSA15_FW1 0 DEZ_DB_U 0.000000 1.000000 EXTENDED_LIMITS 0.000000 255.000000 /end CHARACTERISTIC
/begin CHARACTERISTIC cowFUN_STA "FUN-S Wiederstart ohne Klemme15 aus/ein (inakt(0)/akt(1))" VALUE 0xF2548 MSA15_FW1 0 DEZ_DB_U 0.000000 1.000000 EXTENDED_LIMITS 0.000000 255.000000 /end CHARACTERISTIC
/begin CHARACTERISTIC cowFUN_TXU "FUN-S des TXU Eingriffs" VALUE 0xF2530 MSA15_FW1 0 DEZ_DB_U 0.000000 1.000000 EXTENDED_LIMITS 0.000000 255.000000 /end CHARACTERISTIC
/begin CHARACTERISTIC cowFVV_AKT "FUN-S Aktiv. v-Abhängigkt. 0: M_E=f(M_EFVU, M_EFVO, v); 1: M_E=M_EFVU" VALUE 0xF2540 MSA15_FW1 0 DEZ_DB_U 0.000000 1.000000 EXTENDED_LIMITS 0.000000 255.000000 /end CHARACTERISTIC
/begin CHARACTERISTIC cowLDR_ADA "LDR Adaption ueber Verbrauch/Drehzahl/Gang (0/1/2)" VALUE 0xF2520 MSA15_FW1 0 DEZ_DB_U 0.000000 1.000000 EXTENDED_LIMITS 0.000000 255.000000 /end CHARACTERISTIC
/begin CHARACTERISTIC cowLDR_ARW "LDR anti reset windup Rueckrechnen/Einfrieren (0/1)" VALUE 0xF2522 MSA15_FW1 0 DEZ_DB_U 0.000000 3.000000 EXTENDED_LIMITS 0.000000 255.000000 /end CHARACTERISTIC
/begin CHARACTERISTIC cowLDR_BEG "LDR Begrenzung TV ueber Verbrauch/Drehzahl/Gang (0/1/2)" VALUE 0xF2521 MSA15_FW1 0 DEZ_DB_U 0.000000 1.000000 EXTENDED_LIMITS 0.000000 255.000000 /end CHARACTERISTIC
/begin CHARACTERISTIC cowLDR_KUP "LDR Steuerung = f(KUP)" VALUE 0xF252D MSA15_FW1 0 DEZ_DB_U 0.000000 1.000000 EXTENDED_LIMITS 0.000000 255.000000 /end CHARACTERISTIC
/begin CHARACTERISTIC cowLDR_ME "LDR Mengeneingang (1:aktuelle/2:wunsch/3:wunsch roh)" VALUE 0xF2523 MSA15_FW1 0 DEZ_DB_U 0.000000 3.000000 EXTENDED_LIMITS 0.000000 255.000000 /end CHARACTERISTIC
/begin CHARACTERISTIC cowLDR_MS "LDR Mengeneingang Steuerung (1:aktuelle/2:wunsch/3:wunsch roh)" VALUE 0xF2524 MSA15_FW1 0 DEZ_DB_U 0.000000 3.000000 EXTENDED_LIMITS 0.000000 255.000000 /end CHARACTERISTIC
/begin CHARACTERISTIC cowLDR_R_A "LDR Umschaltung Relativ- Absolutdruck" VALUE 0xF251F MSA15_FW1 0 DEZ_DB_U 0.000000 255.000000 /end CHARACTERISTIC
/begin CHARACTERISTIC cowLMM_AGL "LMM AGL Wahlschalter BIT0:NPA/BIT1:LA im LL/BIT2:LA im LB" VALUE 0xF252A MSA15_FW1 0 DEZ_DB_U 0.000000 7.000000 EXTENDED_LIMITS 0.000000 255.000000 /end CHARACTERISTIC
/begin CHARACTERISTIC cowRP_VS "FUN-S Raildruckregler mit (1) ohne (0) Vorsteuerung" VALUE 0xF253D MSA15_FW1 0 DEZ_DB_U 0.000000 1.000000 EXTENDED_LIMITS 0.000000 255.000000 /end CHARACTERISTIC
/begin CHARACTERISTIC cowVAR_2AT "Abgastemperatursensoren (0:kein /1:Sensor 1 /2:Sensor 2 /3:beide Sensoren aktiv)" VALUE 0xF2505 MSA15_FW1 0 DEZ_DB_U 1.000000 1.000000 EXTENDED_LIMITS 0.000000 255.000000 /end CHARACTERISTIC
/begin CHARACTERISTIC cowVAR_ARF "VAR-S ARF -Regelung/Steuerung (1/2)               !###crq2046 Da" VALUE 0xF2502 MSA15_FW1 0 DEZ_DB_U 1.000000 1.000000 EXTENDED_LIMITS 0.000000 255.000000 /end CHARACTERISTIC
/begin CHARACTERISTIC cowVAR_ASK "ASK Wahlschalter EIN:1/AUS:0" VALUE 0xF252B MSA15_FW1 0 DEZ_DB_U 0.000000 1.000000 EXTENDED_LIMITS 0.000000 255.000000 /end CHARACTERISTIC
/begin CHARACTERISTIC cowVAR_EAB "EAB-Auswahl (0: EAB nicht verbaut 1: EAB 0-aktiv 2: EAB 1-aktiv)" VALUE 0xF2506 MSA15_FW1 0 DEZ_DB_U 0.000000 2.000000 EXTENDED_LIMITS 0.000000 255.000000 /end CHARACTERISTIC
/begin CHARACTERISTIC cowVAR_FGG "VAR-S FGG-Typ (1:ABS/FGG 4:CAN)" VALUE 0xF2500 MSA15_FW1 0 DEZ_DB_U 1.000000 1.000000 EXTENDED_LIMITS 0.000000 255.000000 /end CHARACTERISTIC
/begin CHARACTERISTIC cowVAR_GTR "VAR-S Getriebetyp (1:Handschalter/ 2:NAG)         !###crq2446 Kf" VALUE 0xF2501 MSA15_FW1 0 DEZ_DB_U 1.000000 1.000000 EXTENDED_LIMITS 0.000000 255.000000 /end CHARACTERISTIC
/begin CHARACTERISTIC cowVAR_GZS "GZS Gluehzeitst.g. (0: Summenfehlerdiag., 1: Relaisanst., 128: PWM-Gluehen)" VALUE 0xF2515 MSA15_FW1 0 DEZ_DB_U 3.000000 129.000000 EXTENDED_LIMITS 0.000000 255.000000 /end CHARACTERISTIC
/begin CHARACTERISTIC cowVAR_KWP "Applikative Umschaltung KWP2000* und Automatisch" VALUE 0xF252C MSA15_FW1 0 DEZ_DB_U 0.000000 1.000000 EXTENDED_LIMITS 0.000000 255.000000 /end CHARACTERISTIC
/begin CHARACTERISTIC cowVAR_LDR "VAR-S LDR-Typ (2:Lad.+DK/8:nur Lad.)" VALUE 0xF24FE MSA15_FW1 0 DEZ_DB_U 8.000000 8.000000 EXTENDED_LIMITS 0.000000 255.000000 /end CHARACTERISTIC
/begin CHARACTERISTIC cowVAR_LFS "VAR-S Luefteransteuerung Typ (0:Lueftersteuergeraet / 1:Relais)" VALUE 0xF2504 MSA15_FW1 0 NULL 0.000000 0.000000 /end CHARACTERISTIC
/begin CHARACTERISTIC cowVAR_LVH "INJ LRR- Mengenaufteilung VE/HE  0:Aus / 1:Ein" VALUE 0xF2528 MSA15_FW1 0 DEZ_DB_U 0.000000 1.000000 EXTENDED_LIMITS 0.000000 255.000000 /end CHARACTERISTIC
/begin CHARACTERISTIC cowVAR_OEL "VAR-S mit/ohne (1/0) Oeltemperatursensor" VALUE 0xF2503 MSA15_FW1 0 OELSENS 1.000000 1.000000 EXTENDED_LIMITS 0.000000 2.000000 /end CHARACTERISTIC
/begin CHARACTERISTIC cowVAR_RVH "#SSD INJ VE-Menge Zwischenspeichern   0:Aus / 1:Ein" VALUE 0xF2529 MSA15_FW1 0 DEZ_DB_U 0.000000 1.000000 EXTENDED_LIMITS 0.000000 255.000000 /end CHARACTERISTIC
/begin CHARACTERISTIC cowVAR_ZYL "VAR-S Zylinderzahl (4 / 5 / 6)" VALUE 0xF24FF MSA15_FW1 0 DEZ_DB_U 6.000000 6.000000 EXTENDED_LIMITS 0.000000 255.000000 /end CHARACTERISTIC
/begin CHARACTERISTIC cowV_AGL_A "KUN-S ARF-Abgleichwert mul/add (2/1)" VALUE 0xF2507 MSA15_FW1 0 DEZ_DB_U 1.000000 1.000000 EXTENDED_LIMITS 0.000000 255.000000 /end CHARACTERISTIC
/begin CHARACTERISTIC cowV_AGL_D "KUN-S DKR-Abgleichwert - nicht aendern" VALUE 0xF2508 MSA15_FW1 0 DEZ_DB_U 0.000000 255.000000 /end CHARACTERISTIC
/begin CHARACTERISTIC cowV_ATK_A "KUN-S  ARF P_ADF-abhaeng. Korrektur mul/add (2/1)" VALUE 0xF2509 MSA15_FW1 0 DEZ_DB_U 1.000000 1.000000 EXTENDED_LIMITS 0.000000 255.000000 /end CHARACTERISTIC
/begin CHARACTERISTIC cowV_ATK_D "KUN-S DKR P_ADF-abhaeng. Korrektur - nicht aendern" VALUE 0xF250A MSA15_FW1 0 DEZ_DB_U 0.000000 255.000000 /end CHARACTERISTIC
/begin CHARACTERISTIC cowV_BRE "KUN-S Bremse (1:HW, 2:CAN)" VALUE 0xF2516 MSA15_FW1 0 DEZ_DB_U 2.000000 2.000000 EXTENDED_LIMITS 0.000000 255.000000 /end CHARACTERISTIC
/begin CHARACTERISTIC cowV_DYN_A "KUN-S ARF Vorst. add/sub(+1/+0) Betrag/Wert(+4/+0)" VALUE 0xF250B MSA15_FW1 0 DEZ_DB_U 0.000000 7.000000 EXTENDED_LIMITS 0.000000 255.000000 /end CHARACTERISTIC
/begin CHARACTERISTIC cowV_DYN_D "KUN-S DKR dynam. Vorsteuerung - nicht aendern" VALUE 0xF250C MSA15_FW1 0 DEZ_DB_U 0.000000 255.000000 /end CHARACTERISTIC
/begin CHARACTERISTIC cowV_DYN_L "KUN-S LDR Vorst. add/sub(+1/+0) Betrag/Wert(+4/+0)" VALUE 0xF250D MSA15_FW1 0 DEZ_DB_U 3.000000 3.000000 EXTENDED_LIMITS 0.000000 255.000000 /end CHARACTERISTIC
/begin CHARACTERISTIC cowV_FMB_1 "#SSD KUN-S Mengenbegr bei Fehler (0:DZG,1:PWG,2:PGS,3:LDF,4:LMM,5:KDF,6:K15)" VALUE 0xF250F MSA15_FW1 0 DEZ_DB_U 0.000000 255.000000 /end CHARACTERISTIC
/begin CHARACTERISTIC cowV_FMB_2 "#SSD KUN-S Mengenbegr bei Fehler (ARS 0:_K,1:_O,2:_pR,3:_nR)                    " VALUE 0xF2510 MSA15_FW1 0 DEZ_DB_U 0.000000 255.000000 /end CHARACTERISTIC
/begin CHARACTERISTIC cowV_FMB_3 "#SSD KUN-S Mengenbegr bei Fehler (LDS 0:_K,1:_O,2:_pR,3:_nR)" VALUE 0xF2511 MSA15_FW1 0 DEZ_DB_U 0.000000 255.000000 /end CHARACTERISTIC
/begin CHARACTERISTIC cowV_FMB_4 "#SSD KUN-S Mengenbegr bei Fehler (0:EEP,1:UC,2:MML,3:ZHR,4:KHP,5:KDR,6:KDP,7:INJ" VALUE 0xF2512 MSA15_FW1 0 DEZ_DB_U 0.000000 255.000000 /end CHARACTERISTIC
/begin CHARACTERISTIC cowV_GZS "KUN-S GZS-Typ (2:Integ. Gluehen,3:GZS m. Relais)" VALUE 0xF2513 MSA15_FW1 0 DEZ_DB_U 3.000000 3.000000 EXTENDED_LIMITS 0.000000 255.000000 /end CHARACTERISTIC
/begin CHARACTERISTIC cowV_GZS_V "Vorgluehzeitberechnung ueber ADF/UBatt (1/0)" VALUE 0xF2514 MSA15_FW1 0 NULL 0.000000 0.000000 /end CHARACTERISTIC
/begin CHARACTERISTIC cowV_LMM_S "KUN-S Luftmassenmesser (3: HFM5)" VALUE 0xF250E MSA15_FW1 0 DEZ_DB_U 3.000000 3.000000 EXTENDED_LIMITS 0.000000 255.000000 /end CHARACTERISTIC
/begin CHARACTERISTIC cowV_MSS "MSS (1:Anlasser, 2:MSS)" VALUE 0xF2517 MSA15_FW1 0 DEZ_DB_U 1.000000 1.000000 EXTENDED_LIMITS 0.000000 255.000000 /end CHARACTERISTIC
/begin CHARACTERISTIC cowV_NE "KUN-S Nacheinspritzung inaktiv (0) / aktiv (1)" VALUE 0xF251A MSA15_FW1 0 DEZ_DB_U 1.000000 1.000000 EXTENDED_LIMITS 0.000000 255.000000 /end CHARACTERISTIC
/begin CHARACTERISTIC cowV_NEr "Schalter Haupteinspritzung beruecksichtigen" VALUE 0xF251B MSA15_FW1 0 DEZ_DB_U 0.000000 255.000000 /end CHARACTERISTIC
/begin CHARACTERISTIC cowV_ZUMHE "MEHE = 0 (0) oder EFAHR (1) wenn EFAHR - MEVE < MHminKL" VALUE 0xF2519 MSA15_FW1 0 DEZ_DB_U 0.000000 1.000000 EXTENDED_LIMITS 0.000000 255.000000 /end CHARACTERISTIC
/begin CHARACTERISTIC cowV_ZUMK2 "Auswahl Korrekturfaktor 2 (1:ldmADF, 2:anmLTF)" VALUE 0xF2518 MSA15_FW1 0 DEZ_DB_U 1.000000 1.000000 EXTENDED_LIMITS 0.000000 255.000000 /end CHARACTERISTIC
/begin CHARACTERISTIC diwBRE_Z1 "DI Bremse Entpr.ein" VALUE 0xF2594 MSA15_FW3 0 ZEIT_HP 0.000000 70000000.000000 EXTENDED_LIMITS 0.000000 1310700000.000000 /end CHARACTERISTIC
/begin CHARACTERISTIC diwBRE_Z2 "DI Bremse Entpr. aus" VALUE 0xF2596 MSA15_FW3 0 ZEIT_HP 0.000000 70000000.000000 EXTENDED_LIMITS 0.000000 1310700000.000000 /end CHARACTERISTIC
/begin CHARACTERISTIC diwBRE_ben "DI Bremse benutzt" VALUE 0xF2592 MSA15_FW1 0 DEZ_DB_U 0.000000 1.000000 EXTENDED_LIMITS 0.000000 255.000000 /end CHARACTERISTIC
/begin CHARACTERISTIC diwBRE_inv "DI Bremse invertiert" VALUE 0xF2593 MSA15_FW1 0 DEZ_DB_U 0.000000 1.000000 EXTENDED_LIMITS 0.000000 255.000000 /end CHARACTERISTIC
/begin CHARACTERISTIC diwBRK_Z1 "DI red. Bremse, Entpr. ein" VALUE 0xF255E MSA15_FW3 0 ZEIT_HP 0.000000 70000000.000000 EXTENDED_LIMITS 0.000000 1310700000.000000 /end CHARACTERISTIC
/begin CHARACTERISTIC diwBRK_Z2 "DI red. Bremse, Entpr. aus" VALUE 0xF2560 MSA15_FW3 0 ZEIT_HP 0.000000 70000000.000000 EXTENDED_LIMITS 0.000000 1310700000.000000 /end CHARACTERISTIC
/begin CHARACTERISTIC diwBRK_ben "DI red. Bremse, benutzt" VALUE 0xF255C MSA15_FW1 0 DEZ_DB_U 0.000000 1.000000 EXTENDED_LIMITS 0.000000 255.000000 /end CHARACTERISTIC
/begin CHARACTERISTIC diwBRK_inv "DI red. Bremse, invertiert" VALUE 0xF255D MSA15_FW1 0 DEZ_DB_U 0.000000 1.000000 EXTENDED_LIMITS 0.000000 255.000000 /end CHARACTERISTIC
/begin CHARACTERISTIC diwGZR_Z1 "DI Entpr. ein" VALUE 0xF25A0 MSA15_FW3 0 ZEIT_HP 0.000000 70000000.000000 EXTENDED_LIMITS 0.000000 1310700000.000000 /end CHARACTERISTIC
/begin CHARACTERISTIC diwGZR_Z2 "DI Gluehrelais Entpr. aus" VALUE 0xF25A2 MSA15_FW3 0 ZEIT_HP 0.000000 70000000.000000 EXTENDED_LIMITS 0.000000 1310700000.000000 /end CHARACTERISTIC
/begin CHARACTERISTIC diwGZR_ben "DI Gluehrelais benutzt" VALUE 0xF259E MSA15_FW1 0 DEZ_DB_U 0.000000 1.000000 EXTENDED_LIMITS 0.000000 255.000000 /end CHARACTERISTIC
/begin CHARACTERISTIC diwGZR_inv "DI Gluehrelais invertiert" VALUE 0xF259F MSA15_FW1 0 DEZ_DB_U 0.000000 1.000000 EXTENDED_LIMITS 0.000000 255.000000 /end CHARACTERISTIC
/begin CHARACTERISTIC diwK15_Z1 "DI Klemme 15 Entpr. ein" VALUE 0xF25B2 MSA15_FW3 0 ZEIT_HP 0.000000 70000000.000000 EXTENDED_LIMITS 0.000000 1310700000.000000 /end CHARACTERISTIC
/begin CHARACTERISTIC diwK15_Z2 "DI Klemme 15 Entpr. aus" VALUE 0xF25B4 MSA15_FW3 0 ZEIT_HP 0.000000 70000000.000000 EXTENDED_LIMITS 0.000000 1310700000.000000 /end CHARACTERISTIC
/begin CHARACTERISTIC diwK15_ben "DI Klemme 15 benutzt" VALUE 0xF25B0 MSA15_FW1 0 DEZ_DB_U 0.000000 1.000000 EXTENDED_LIMITS 0.000000 255.000000 /end CHARACTERISTIC
/begin CHARACTERISTIC diwK15_inv "DI Klemme 15 invertiert" VALUE 0xF25B1 MSA15_FW1 0 DEZ_DB_U 0.000000 1.000000 EXTENDED_LIMITS 0.000000 255.000000 /end CHARACTERISTIC
/begin CHARACTERISTIC diwKUP_Z1 "DI Kupplung Entpr. ein" VALUE 0xF2588 MSA15_FW3 0 ZEIT_HP 0.000000 70000000.000000 EXTENDED_LIMITS 0.000000 1310700000.000000 /end CHARACTERISTIC
/begin CHARACTERISTIC diwKUP_Z2 "DI Kupplung Entpr. aus" VALUE 0xF258A MSA15_FW3 0 ZEIT_HP 0.000000 70000000.000000 EXTENDED_LIMITS 0.000000 1310700000.000000 /end CHARACTERISTIC
/begin CHARACTERISTIC diwKUP_ben "DI Kupplung benutzt" VALUE 0xF2586 MSA15_FW1 0 DEZ_DB_U 0.000000 1.000000 EXTENDED_LIMITS 0.000000 255.000000 /end CHARACTERISTIC
/begin CHARACTERISTIC diwKUP_inv "DI Kupplung invertiert" VALUE 0xF2587 MSA15_FW1 0 DEZ_DB_U 0.000000 1.000000 EXTENDED_LIMITS 0.000000 255.000000 /end CHARACTERISTIC
/begin CHARACTERISTIC diwKWH_Z1 "DI KWH Entprellzeit ein" VALUE 0xF2570 MSA15_FW3 0 ZEIT_HP 0.000000 70000000.000000 EXTENDED_LIMITS 0.000000 1310700000.000000 /end CHARACTERISTIC
/begin CHARACTERISTIC diwKWH_Z2 "DI KWH Entprellzeit aus" VALUE 0xF2572 MSA15_FW3 0 ZEIT_HP 0.000000 70000000.000000 EXTENDED_LIMITS 0.000000 1310700000.000000 /end CHARACTERISTIC
/begin CHARACTERISTIC diwKWH_ben "DI KWH Eingang benutzt" VALUE 0xF256E MSA15_FW1 0 DEZ_DB_U 0.000000 255.000000 /end CHARACTERISTIC
/begin CHARACTERISTIC diwKWH_inv "DI KWH Eingang invertiert" VALUE 0xF256F MSA15_FW1 0 DEZ_DB_U 0.000000 1.000000 EXTENDED_LIMITS 0.000000 255.000000 /end CHARACTERISTIC
/begin CHARACTERISTIC diwMLS_Z1 "DI Motorluefter Entpr. ein" VALUE 0xF25C0 MSA15_FW3 0 ZEIT_HP 0.000000 70000000.000000 EXTENDED_LIMITS 0.000000 1310700000.000000 /end CHARACTERISTIC
/begin CHARACTERISTIC diwMLS_Z2 "DI Oeldruckschalter Entpr. aus" VALUE 0xF25C2 MSA15_FW3 0 ZEIT_HP 0.000000 70000000.000000 EXTENDED_LIMITS 0.000000 1310700000.000000 /end CHARACTERISTIC
/begin CHARACTERISTIC diwMLS_ben "DI Motorluefter benutzt" VALUE 0xF25BE MSA15_FW1 0 DEZ_DB_U 0.000000 1.000000 EXTENDED_LIMITS 0.000000 255.000000 /end CHARACTERISTIC
/begin CHARACTERISTIC diwMLS_inv "DI Motorluefter invertiert" VALUE 0xF25BF MSA15_FW1 0 DEZ_DB_U 0.000000 1.000000 EXTENDED_LIMITS 0.000000 255.000000 /end CHARACTERISTIC
/begin CHARACTERISTIC diwODS_Z1 "DI Oeldruckschalter Entpr. ein" VALUE 0xF258E MSA15_FW3 0 ZEIT_HP 0.000000 70000000.000000 EXTENDED_LIMITS 0.000000 1310700000.000000 /end CHARACTERISTIC
/begin CHARACTERISTIC diwODS_Z2 "DI Oeldruckschalter Entpr. aus" VALUE 0xF2590 MSA15_FW3 0 ZEIT_HP 0.000000 70000000.000000 EXTENDED_LIMITS 0.000000 1310700000.000000 /end CHARACTERISTIC
/begin CHARACTERISTIC diwODS_ben "DI Oeldruckschalter benutzt" VALUE 0xF258C MSA15_FW1 0 DEZ_DB_U 0.000000 1.000000 EXTENDED_LIMITS 0.000000 255.000000 /end CHARACTERISTIC
/begin CHARACTERISTIC diwODS_inv "DI Oeldruckschalter invertiert" VALUE 0xF258D MSA15_FW1 0 DEZ_DB_U 0.000000 1.000000 EXTENDED_LIMITS 0.000000 255.000000 /end CHARACTERISTIC
/begin CHARACTERISTIC diwUKU_VS1 "KUP_E V-Schwelle Erkennen KL15-Signalwechsel in Fahrt" VALUE 0xF25B6 MSA15_FW4 0 V 0.000000 300.000000 EXTENDED_LIMITS 0.000000 327.670000 /end CHARACTERISTIC
/begin CHARACTERISTIC diwUKU_VS2 "KUP_E V-Schwelle Erkennen Kupplungsschalter defekt" VALUE 0xF25B8 MSA15_FW4 0 V 0.000000 300.000000 EXTENDED_LIMITS 0.000000 327.670000 /end CHARACTERISTIC
/begin CHARACTERISTIC diwUKU_tim "KUP Wartezeit bis Kupplung v_Schwelle_Test nach Init" VALUE 0xF25BC MSA15_FW3 0 ZEIT_ST 0.000000 70000000.000000 EXTENDED_LIMITS 0.000000 655350000.000000 /end CHARACTERISTIC
/begin CHARACTERISTIC diwUKU_vgw "KUP_E Vorgabewert Kupplungsschalter nicht auswertbar" VALUE 0xF25BA MSA15_FW1 0 DEZ_DB_U 0.000000 1.000000 EXTENDED_LIMITS 0.000000 255.000000 /end CHARACTERISTIC
/begin CHARACTERISTIC diwZ00_Z1 "DI Z00 Entprellzeit ein" VALUE 0xF259A MSA15_FW3 0 ZEIT_HP 0.000000 70000000.000000 EXTENDED_LIMITS 0.000000 1310700000.000000 /end CHARACTERISTIC
/begin CHARACTERISTIC diwZ00_Z2 "DI Z00 Entprellzeit aus" VALUE 0xF259C MSA15_FW3 0 ZEIT_HP 0.000000 70000000.000000 EXTENDED_LIMITS 0.000000 1310700000.000000 /end CHARACTERISTIC
/begin CHARACTERISTIC diwZ00_ben "DI Z00 Eingang benutzt" VALUE 0xF2598 MSA15_FW1 0 DEZ_DB_U 0.000000 255.000000 /end CHARACTERISTIC
/begin CHARACTERISTIC diwZ00_inv "DI Z00 Eingang invertiert" VALUE 0xF2599 MSA15_FW1 0 DEZ_DB_U 0.000000 1.000000 EXTENDED_LIMITS 0.000000 255.000000 /end CHARACTERISTIC
/begin CHARACTERISTIC dzwDNR_HI "DZG Normierungskonstante High-Wert" VALUE 0xF25F0 MSA15_FW3 0 DEZ_DW_U 152.000000 152.000000 EXTENDED_LIMITS 0.000000 65535.000000 /end CHARACTERISTIC
/begin CHARACTERISTIC dzwDNR_LO "DZG Normierungskonstante Low-Wert" VALUE 0xF25F2 MSA15_FW3 0 DEZ_DW_U 38528.000000 38528.000000 EXTENDED_LIMITS 0.000000 65535.000000 /end CHARACTERISTIC
/begin CHARACTERISTIC dzwDNR_NU "#SSD DZG Periodenwert bis Vorgabe N = 0" VALUE 0xF25F4 MSA15_FW3 0 shift_16 0.000000 4194304.000000 EXTENDED_LIMITS 0.000000 4294902000.000000 /end CHARACTERISTIC
/begin CHARACTERISTIC dzwDZG_ABT "#SSD DZG max. Abtastzeit fuer N-synchrone Berechnungen" VALUE 0xF25D6 MSA15_FW3 0 ZEIT_T0 0.000000 65535.000000 /end CHARACTERISTIC
/begin CHARACTERISTIC dzwDZG_AUS "#SSD DZG Ausblendzaehler fuer dynamische Plausibilitaet" VALUE 0xF25D0 MSA15_FW1 0 DEZ_DB_U 0.000000 255.000000 /end CHARACTERISTIC
/begin CHARACTERISTIC dzwDZG_DPL "#SSD DZG Segmentzahl bis Defekt-Erkennung dyn. Plausib." VALUE 0xF25D2 MSA15_FW3 0 DEZ_DW_U 0.000000 65535.000000 /end CHARACTERISTIC
/begin CHARACTERISTIC dzwDZG_FNS "#SSD DZG Fenster Perioden-Verhaeltnis zum Intakterkennen" VALUE 0xF25CE MSA15_FW3 0 FENSTER 0.000000 1.000000 EXTENDED_LIMITS 0.000000 3.999939 /end CHARACTERISTIC
/begin CHARACTERISTIC dzwDZG_KMX "#SSD DZG Mindestanzahl plaus. Perioden zur Intakterk." VALUE 0xF25DC MSA15_FW3 0 DEZ_DW_U 0.000000 65535.000000 /end CHARACTERISTIC
/begin CHARACTERISTIC dzwDZG_MBE "#SSD DZG max. Periodendauer-Verhaeltnis dyn. Plausibil." VALUE 0xF25C6 MSA15_FW3 0 PER_VERH 0.000000 2.500000 EXTENDED_LIMITS 0.000000 255.996100 /end CHARACTERISTIC
/begin CHARACTERISTIC dzwDZG_MVE "#SSD DZG min. Periodendauer-Verhaeltnis dyn. Plausibil." VALUE 0xF25C8 MSA15_FW3 0 PER_VERH 0.000000 2.000000 EXTENDED_LIMITS 0.000000 255.996100 /end CHARACTERISTIC
/begin CHARACTERISTIC dzwDZG_MXP "#SSD DZG laengste zu berechnende  Periode f.dyn.Plaus." VALUE 0xF25CA MSA15_FW3 0 ZEIT_T0 0.000000 65535.000000 /end CHARACTERISTIC
/begin CHARACTERISTIC dzwDZG_MZI "DZG min. Zeit zw. Interrupts, nicht applizierbar" VALUE 0xF25DA MSA15_FW3 0 DEZ_DW_U 0.000000 65535.000000 /end CHARACTERISTIC
/begin CHARACTERISTIC dzwDZG_NUS "#SSD DZG N-Schwelle zur Erkennung Ueberdrehzahl" VALUE 0xF25CC MSA15_FW4 0 N 0.000000 6000.000000 EXTENDED_LIMITS 0.000000 32767.000000 /end CHARACTERISTIC
/begin CHARACTERISTIC dzwDZG_TOT "#SSD DZG Timeoutzeit Initialwert" VALUE 0xF25D4 MSA15_FW3 0 ZEIT_T_2ms 0.000000 30000000.000000 EXTENDED_LIMITS 0.000000 131070000.000000 /end CHARACTERISTIC
/begin CHARACTERISTIC dzwDZG_UBD "#SSD DZG Ueberdrehzahl-Ausblendezeit nach Start" VALUE 0xF25D8 MSA15_FW3 0 ZEIT_ST 0.000000 655350000.000000 /end CHARACTERISTIC
/begin CHARACTERISTIC dzwDZG_UNS "#SSD DZG untere N-Schwelle  dynamische Plausibilitaet" VALUE 0xF25C4 MSA15_FW4 0 N 0.000000 6000.000000 EXTENDED_LIMITS 0.000000 32767.000000 /end CHARACTERISTIC
/begin CHARACTERISTIC dzwDZGt_FA "#SSD DZG Umrechnungs-Faktor dynam. Timeout" VALUE 0xF25FC MSA15_FW3 0 TOUT_FA 0.031000 2000.000000 EXTENDED_LIMITS 0.030518 2000.000000 /end CHARACTERISTIC
/begin CHARACTERISTIC dzwDZGt_MI "#SSD DZG minimale Periodendauer dynam. Timeout" VALUE 0xF25F6 MSA15_FW3 0 ZEIT_T_2ms 0.000000 131070000.000000 /end CHARACTERISTIC
/begin CHARACTERISTIC dzwDZGt_MX "#SSD DZG maximale Periodendauer dynam. Timeout" VALUE 0xF25F8 MSA15_FW3 0 ZEIT_T_2ms 0.000000 131070000.000000 /end CHARACTERISTIC
/begin CHARACTERISTIC dzwDZGt_OF "#SSD DZG Umrechnungs-Offset dynam. Timeout" VALUE 0xF25FA MSA15_FW3 0 ZEIT_T_2ms 0.000000 131070000.000000 /end CHARACTERISTIC
/begin CHARACTERISTIC dzwFGF_GF "Gedaechtnisfaktor fuer Drehzahlfilter v/n-Berechnung" VALUE 0xF388E MSA15_FW4 0 GF 0.000031 0.999969 /end CHARACTERISTIC
/begin CHARACTERISTIC dzwN_MAX "Maximaldrehzahl fuer Berechnung des LRR" VALUE 0xF25FE MSA15_FW4 0 N 0.000000 6000.000000 EXTENDED_LIMITS 0.000000 32767.000000 /end CHARACTERISTIC
/begin CHARACTERISTIC edcHRL_FZM "#SSD HRL_Fehlerzaehler_MAX" VALUE 0xF2614 MSA15_FW1 0 DEZ_DB_U 0.000000 255.000000 /end CHARACTERISTIC
/begin CHARACTERISTIC edwGAR_KL "#SSD Gatearray Antwort = f(Frage)" CURVE 0xF2600 MSA15_KL111 0 DEZ_DW_U 0.000000 65535.000000 /begin AXIS_DESCR STD_AXIS edoGAFRG DEZ_DW_U 4 0.000000 65535.000000 /end AXIS_DESCR /end CHARACTERISTIC
/begin RECORD_LAYOUT MSA15_KL111 SRC_ADDR_X 1 UWORD NO_AXIS_PTS_X 2 UWORD AXIS_PTS_X 3 UWORD INDEX_INCR DIRECT FNC_VALUES 4 UWORD COLUMN_DIR DIRECT /end RECORD_LAYOUT
/begin CHARACTERISTIC ehwBEG_MAX "EST obere  Begrenzung Stromregler" VALUE 0xFA282 MSA15_FW4 0 PROZ 0.000000 100.000000 EXTENDED_LIMITS -327.680000 327.670000 /end CHARACTERISTIC
/begin CHARACTERISTIC ehwBEG_MIN "EST untere Begrenzung Stromregler" VALUE 0xFA284 MSA15_FW4 0 PROZ 0.000000 100.000000 EXTENDED_LIMITS -327.680000 327.670000 /end CHARACTERISTIC
/begin CHARACTERISTIC ehwCJ4_400 "EST Anzahl CJ400 Bausteine" VALUE 0xF2636 MSA15_FW1 0 DEZ_DB_U 0.000000 255.000000 /end CHARACTERISTIC
/begin CHARACTERISTIC ehwCJ9_920 "#SSD EST Anzahl CJ920 Bausteine" VALUE 0xF2654 MSA15_FW1 0 DEZ_DB_U 0.000000 2.000000 EXTENDED_LIMITS 0.000000 255.000000 /end CHARACTERISTIC
/begin CHARACTERISTIC ehwCJ9_A01 "#SSD EST uC-Port-Pin IN1/CJ920" VALUE 0xF2638 MSA15_FW1 0 DEZ_DB_U 0.000000 255.000000 /end CHARACTERISTIC
/begin CHARACTERISTIC ehwCJ9_A02 "#SSD EST uC-Port-Pin IN2/CJ920" VALUE 0xF2639 MSA15_FW1 0 DEZ_DB_U 0.000000 255.000000 /end CHARACTERISTIC
/begin CHARACTERISTIC ehwCJ9_A03 "#SSD EST uC-Port-Pin IN3/CJ920" VALUE 0xF263A MSA15_FW1 0 DEZ_DB_U 0.000000 255.000000 /end CHARACTERISTIC
/begin CHARACTERISTIC ehwCJ9_A04 "#SSD EST uC-Port-Pin IN4/CJ920" VALUE 0xF263B MSA15_FW1 0 DEZ_DB_U 0.000000 255.000000 /end CHARACTERISTIC
/begin CHARACTERISTIC ehwCJ9_A05 "#SSD EST uC-Port-Pin IN5/CJ920" VALUE 0xF263C MSA15_FW1 0 DEZ_DB_U 0.000000 255.000000 /end CHARACTERISTIC
/begin CHARACTERISTIC ehwCJ9_A06 "#SSD EST uC-Port-Pin IN6/CJ920" VALUE 0xF263D MSA15_FW1 0 DEZ_DB_U 0.000000 255.000000 /end CHARACTERISTIC
/begin CHARACTERISTIC ehwCJ9_A07 "#SSD EST uC-Port-Pin IN7/CJ920" VALUE 0xF263E MSA15_FW1 0 DEZ_DB_U 0.000000 255.000000 /end CHARACTERISTIC
/begin CHARACTERISTIC ehwCJ9_A08 "#SSD EST uC-Port-Pin IN8/CJ920" VALUE 0xF263F MSA15_FW1 0 DEZ_DB_U 0.000000 255.000000 /end CHARACTERISTIC
/begin CHARACTERISTIC ehwCJ9_A09 "#SSD EST uC-Port-Pin IN9/CJ920" VALUE 0xF2640 MSA15_FW1 0 DEZ_DB_U 0.000000 255.000000 /end CHARACTERISTIC
/begin CHARACTERISTIC ehwCJ9_A10 "#SSD EST uC-Port-Pin IN10/CJ920" VALUE 0xF2641 MSA15_FW1 0 DEZ_DB_U 0.000000 255.000000 /end CHARACTERISTIC
/begin CHARACTERISTIC ehwCJ9_A11 "#SSD EST uC-Port-Pin IN11/CJ920" VALUE 0xF2642 MSA15_FW1 0 DEZ_DB_U 0.000000 255.000000 /end CHARACTERISTIC
/begin CHARACTERISTIC ehwCJ9_A12 "#SSD EST uC-Port-Pin IN12/CJ920" VALUE 0xF2643 MSA15_FW1 0 DEZ_DB_U 0.000000 255.000000 /end CHARACTERISTIC
/begin CHARACTERISTIC ehwCJ9_A13 "#SSD EST uC-Port-Pin IN13/CJ920" VALUE 0xF2644 MSA15_FW1 0 DEZ_DB_U 0.000000 255.000000 /end CHARACTERISTIC
/begin CHARACTERISTIC ehwCJ9_A14 "#SSD EST uC-Port-Pin IN14/CJ920" VALUE 0xF2645 MSA15_FW1 0 DEZ_DB_U 0.000000 255.000000 /end CHARACTERISTIC
/begin CHARACTERISTIC ehwCJ9_B01 "#SSD EST uC-Port-Pin IN1/CJ920" VALUE 0xF2646 MSA15_FW1 0 DEZ_DB_U 0.000000 255.000000 /end CHARACTERISTIC
/begin CHARACTERISTIC ehwCJ9_B02 "#SSD EST uC-Port-Pin IN2/CJ920" VALUE 0xF2647 MSA15_FW1 0 DEZ_DB_U 0.000000 255.000000 /end CHARACTERISTIC
/begin CHARACTERISTIC ehwCJ9_B03 "#SSD EST uC-Port-Pin IN3/CJ920" VALUE 0xF2648 MSA15_FW1 0 DEZ_DB_U 0.000000 255.000000 /end CHARACTERISTIC
/begin CHARACTERISTIC ehwCJ9_B04 "#SSD EST uC-Port-Pin IN4/CJ920" VALUE 0xF2649 MSA15_FW1 0 DEZ_DB_U 0.000000 255.000000 /end CHARACTERISTIC
/begin CHARACTERISTIC ehwCJ9_B05 "#SSD EST uC-Port-Pin IN5/CJ920" VALUE 0xF264A MSA15_FW1 0 DEZ_DB_U 0.000000 255.000000 /end CHARACTERISTIC
/begin CHARACTERISTIC ehwCJ9_B06 "#SSD EST uC-Port-Pin IN6/CJ920" VALUE 0xF264B MSA15_FW1 0 DEZ_DB_U 0.000000 255.000000 /end CHARACTERISTIC
/begin CHARACTERISTIC ehwCJ9_B07 "#SSD EST uC-Port-Pin IN7/CJ920" VALUE 0xF264C MSA15_FW1 0 DEZ_DB_U 0.000000 255.000000 /end CHARACTERISTIC
/begin CHARACTERISTIC ehwCJ9_B08 "#SSD EST uC-Port-Pin IN8/CJ920" VALUE 0xF264D MSA15_FW1 0 DEZ_DB_U 0.000000 255.000000 /end CHARACTERISTIC
/begin CHARACTERISTIC ehwCJ9_B09 "#SSD EST uC-Port-Pin IN9/CJ920" VALUE 0xF264E MSA15_FW1 0 DEZ_DB_U 0.000000 255.000000 /end CHARACTERISTIC
/begin CHARACTERISTIC ehwCJ9_B10 "#SSD EST uC-Port-Pin IN10/CJ920" VALUE 0xF264F MSA15_FW1 0 DEZ_DB_U 0.000000 255.000000 /end CHARACTERISTIC
/begin CHARACTERISTIC ehwCJ9_B11 "#SSD EST uC-Port-Pin IN11/CJ920" VALUE 0xF2650 MSA15_FW1 0 DEZ_DB_U 0.000000 255.000000 /end CHARACTERISTIC
/begin CHARACTERISTIC ehwCJ9_B12 "#SSD EST uC-Port-Pin IN12/CJ920" VALUE 0xF2651 MSA15_FW1 0 DEZ_DB_U 0.000000 255.000000 /end CHARACTERISTIC
/begin CHARACTERISTIC ehwCJ9_B13 "#SSD EST uC-Port-Pin IN13/CJ920" VALUE 0xF2652 MSA15_FW1 0 DEZ_DB_U 0.000000 255.000000 /end CHARACTERISTIC
/begin CHARACTERISTIC ehwCJ9_B14 "#SSD EST uC-Port-Pin IN14/CJ920" VALUE 0xF2653 MSA15_FW1 0 DEZ_DB_U 0.000000 255.000000 /end CHARACTERISTIC
/begin CHARACTERISTIC ehwDIA_UBT "#SSD EST UBatt-Schwelle fuer Diagnose der MLS Endstufe" VALUE 0xFA26C MSA15_FW4 0 U_B 0.000000 24163.000000 EXTENDED_LIMITS 0.000000 773948.100000 /end CHARACTERISTIC
/begin CHARACTERISTIC ehwDIAnor1 "#SSD Diagnose aktiv fuer EST 0...15 im Normalbetrieb" VALUE 0xFA260 MSA15_FW3 0 DEZ_DW_U 0.000000 65535.000000 /end CHARACTERISTIC
/begin CHARACTERISTIC ehwDIAnor2 "#SSD Diagnose aktiv fuer EST 16..31 im Normalbetrieb" VALUE 0xFA262 MSA15_FW3 0 DEZ_DW_U 0.000000 65535.000000 /end CHARACTERISTIC
/begin CHARACTERISTIC ehwDIAsta1 "#SSD Diagnose aktiv fuer EST 0...15 bei Motorstart" VALUE 0xFA268 MSA15_FW3 0 DEZ_DW_U 0.000000 65535.000000 /end CHARACTERISTIC
/begin CHARACTERISTIC ehwDIAsta2 "#SSD Diagnose aktiv fuer EST 16..31 bei Motorstart" VALUE 0xFA26A MSA15_FW3 0 DEZ_DW_U 0.000000 65535.000000 /end CHARACTERISTIC
/begin CHARACTERISTIC ehwDIAubt1 "#SSD Diagnose aktiv fuer EST 0...15 bei UBat zu klein" VALUE 0xFA264 MSA15_FW3 0 DEZ_DW_U 0.000000 65535.000000 /end CHARACTERISTIC
/begin CHARACTERISTIC ehwDIAubt2 "#SSD Diagnose aktiv fuer EST 16..31 bei UBat zu klein" VALUE 0xFA266 MSA15_FW3 0 DEZ_DW_U 0.000000 65535.000000 /end CHARACTERISTIC
/begin CHARACTERISTIC ehwESTSTHS "#SSD EST Pinnummer uC Diagnose Kraftstoffdruckregelventil" VALUE 0xFA256 MSA15_FW1 0 DEZ_DB_U 32.000000 62.000000 EXTENDED_LIMITS 0.000000 255.000000 /end CHARACTERISTIC
/begin CHARACTERISTIC ehwEST_AKS "EST Kennwort Abluftklappensteuerung" VALUE 0xFA24A MSA15_FW3 0 DEZ_DW_U 0.000000 65535.000000 /end CHARACTERISTIC
/begin CHARACTERISTIC ehwEST_ARS "#SSD EST Kennwort Abgasrueckfuehrsteller" VALUE 0xFA242 MSA15_FW3 0 DEZ_DW_U 0.000000 65535.000000 /end CHARACTERISTIC
/begin CHARACTERISTIC ehwEST_ASK "EST Kennwort Abstellklappe" VALUE 0xFA23E MSA15_FW3 0 DEZ_DW_U 0.000000 65535.000000 /end CHARACTERISTIC
/begin CHARACTERISTIC ehwEST_DRA "EST Kennwort Drallklappe" VALUE 0xFA240 MSA15_FW3 0 DEZ_DW_U 0.000000 65535.000000 /end CHARACTERISTIC
/begin CHARACTERISTIC ehwEST_EKP "#SSD EST Kennwort elektr. Kraftstoffpumpe" VALUE 0xFA252 MSA15_FW3 0 DEZ_DW_U 0.000000 65535.000000 /end CHARACTERISTIC
/begin CHARACTERISTIC ehwEST_GRS "#SSD EST Kennwort Gluehrelaissteuerung" VALUE 0xFA238 MSA15_FW3 0 DEZ_DW_U 0.000000 65535.000000 /end CHARACTERISTIC
/begin CHARACTERISTIC ehwEST_KDI "#SSD EST Zweites Kennwort Kraftstoffdruckregelventil I-Reg." VALUE 0xFA248 MSA15_FW1 0 DEZ_DB_U 0.000000 255.000000 /end CHARACTERISTIC
/begin CHARACTERISTIC ehwEST_KDR "#SSD EST Kennwort Kraftstoffdruckregelventil" VALUE 0xFA246 MSA15_FW3 0 DEZ_DW_U 0.000000 65535.000000 /end CHARACTERISTIC
/begin CHARACTERISTIC ehwEST_KHP "#SSD EST Kennwort Kraftstoffhochdruckpumpe" VALUE 0xFA244 MSA15_FW3 0 DEZ_DW_U 0.000000 65535.000000 /end CHARACTERISTIC
/begin CHARACTERISTIC ehwEST_KLI "#SSD EST Kennwort Klimakompressor" VALUE 0xFA254 MSA15_FW3 0 DEZ_DW_U 0.000000 65535.000000 /end CHARACTERISTIC
/begin CHARACTERISTIC ehwEST_KWH "EST Kennwort Oeldruckschalter" VALUE 0xFA25E MSA15_FW3 0 DEZ_DW_U 0.000000 65535.000000 /end CHARACTERISTIC
/begin CHARACTERISTIC ehwEST_LDS "#SSD EST Kennwort Ladedruck- / Drosselklappensteller (VTG)" VALUE 0xFA236 MSA15_FW3 0 DEZ_DW_U 0.000000 65535.000000 /end CHARACTERISTIC
/begin CHARACTERISTIC ehwEST_MLS "#SSD EST Kennwort Motorlueftersteuerung" VALUE 0xFA23A MSA15_FW3 0 DEZ_DW_U 0.000000 65535.000000 /end CHARACTERISTIC
/begin CHARACTERISTIC ehwEST_MML "#SSD EST Kennwort Motorlager" VALUE 0xFA23C MSA15_FW3 0 DEZ_DW_U 0.000000 65535.000000 /end CHARACTERISTIC
/begin CHARACTERISTIC ehwEST_NOX "#SSD EST Kennwort HC - Einduesung" VALUE 0xFA24C MSA15_FW3 0 DEZ_DW_U 0.000000 65535.000000 /end CHARACTERISTIC
/begin CHARACTERISTIC ehwEST_ODS "EST Kennwort Oeldruckschalter" VALUE 0xFA25C MSA15_FW3 0 DEZ_DW_U 0.000000 65535.000000 /end CHARACTERISTIC
/begin CHARACTERISTIC ehwEST_T1 "#SSD EST TV-Periodendauer (Timer 1) Ansteuerung EPW" VALUE 0xFA258 MSA15_FW3 0 ZEIT_T1 0.000000 65535.000000 /end CHARACTERISTIC
/begin CHARACTERISTIC ehwEST_T7 "#SSD EST TV-Periodendauer (Timer 7) Ansteuerung EPW" VALUE 0xFA25A MSA15_FW3 0 ZEIT_T1 0.000000 65535.000000 /end CHARACTERISTIC
/begin CHARACTERISTIC ehwEST_THS "#SSD EST Kennwort gesteuerter Thermostat" VALUE 0xFA250 MSA15_FW3 0 DEZ_DW_U 0.000000 65535.000000 /end CHARACTERISTIC
/begin CHARACTERISTIC ehwEST_ZHR "#SSD EST Kennwort Zusatzheizung" VALUE 0xFA24E MSA15_FW3 0 DEZ_DW_U 0.000000 65535.000000 /end CHARACTERISTIC
/begin CHARACTERISTIC ehwGAD_f0 "#SSD Frequenz GAD40-PWM-Kanal 0" VALUE 0xF2666 MSA15_FW1 0 FREQU_5 166.666700 1250.000000 EXTENDED_LIMITS 156.250000 5000.000000 /end CHARACTERISTIC
/begin CHARACTERISTIC ehwGAD_f1 "#SSD Frequenz GAD40-PWM-Kanal 1" VALUE 0xF2667 MSA15_FW1 0 FREQU 32.258060 1000.000000 /end CHARACTERISTIC
/begin CHARACTERISTIC ehwGAD_f2 "#SSD Frequenz GAD40-PWM-Kanal 2" VALUE 0xF2668 MSA15_FW1 0 FREQU 32.258060 1000.000000 /end CHARACTERISTIC
/begin CHARACTERISTIC ehwINJ_GTZ "Entprellzaehler Injektorendstufen (fuer Gutmeldung)" VALUE 0xF2624 MSA15_FW1 0 DEZ_DB_U 0.000000 255.000000 /end CHARACTERISTIC
/begin CHARACTERISTIC ehwInjLAmx "#SSD Erlaubte Anzahl abgefallener Injektoren" VALUE 0xF2625 MSA15_FW1 0 DEZ_DB_U 0.000000 255.000000 /end CHARACTERISTIC
/begin CHARACTERISTIC ehwPWM_PP0 "Period Register PWM-Kanal 0" VALUE 0xF2656 MSA15_FW3 0 DEZ_DW_U 0.000000 65534.000000 EXTENDED_LIMITS 0.000000 65535.000000 /end CHARACTERISTIC
/begin CHARACTERISTIC ehwPWM_PP1 "Period Register PWM-Kanal 1" VALUE 0xF265A MSA15_FW3 0 DEZ_DW_U 0.000000 65534.000000 EXTENDED_LIMITS 0.000000 65535.000000 /end CHARACTERISTIC
/begin CHARACTERISTIC ehwPWM_PP2 "Period Register PWM-Kanal 2" VALUE 0xF265E MSA15_FW3 0 DEZ_DW_U 0.000000 65534.000000 EXTENDED_LIMITS 0.000000 65535.000000 /end CHARACTERISTIC
/begin CHARACTERISTIC ehwPWM_PP3 "Period Register PWM-Kanal 3" VALUE 0xF2662 MSA15_FW3 0 DEZ_DW_U 0.000000 65534.000000 EXTENDED_LIMITS 0.000000 65535.000000 /end CHARACTERISTIC
/begin CHARACTERISTIC ehwPWM_VT0 "Vorteiler PWM-Kanal 0" VALUE 0xF2658 MSA15_FW3 0 DEZ_DW_U 0.000000 1.000000 EXTENDED_LIMITS 0.000000 65535.000000 /end CHARACTERISTIC
/begin CHARACTERISTIC ehwPWM_VT1 "Vorteiler PWM-Kanal 1" VALUE 0xF265C MSA15_FW3 0 DEZ_DW_U 0.000000 1.000000 EXTENDED_LIMITS 0.000000 65535.000000 /end CHARACTERISTIC
/begin CHARACTERISTIC ehwPWM_VT2 "Vorteiler PWM-Kanal 2" VALUE 0xF2660 MSA15_FW3 0 DEZ_DW_U 0.000000 1.000000 EXTENDED_LIMITS 0.000000 65535.000000 /end CHARACTERISTIC
/begin CHARACTERISTIC ehwPWM_VT3 "Vorteiler PWM-Kanal 3" VALUE 0xF2664 MSA15_FW3 0 DEZ_DW_U 0.000000 1.000000 EXTENDED_LIMITS 0.000000 65535.000000 /end CHARACTERISTIC
/begin CHARACTERISTIC ehwSTI_FEN "EST Fensterbreite I-Kleinsignal Stromregler" VALUE 0xFA278 MSA15_FW4 0 IDV 0.000000 5000.000000 EXTENDED_LIMITS -32768.000000 32767.000000 /end CHARACTERISTIC
/begin CHARACTERISTIC ehwSTI_NEG "EST I-Verstaerkung negatives Grossignal Stromregler" VALUE 0xFA27C MSA15_FW4 0 IDV_KI 0.000000 2.000000 EXTENDED_LIMITS 0.000000 3.999878 /end CHARACTERISTIC
/begin CHARACTERISTIC ehwSTI_POS "EST I-Verstaerkung positives Grossignal Stromregler" VALUE 0xFA27E MSA15_FW4 0 IDV_KI 0.000000 2.000000 EXTENDED_LIMITS 0.000000 3.999878 /end CHARACTERISTIC
/begin CHARACTERISTIC ehwSTI_SIG "EST I-Verstaerkung Kleinsignal Stromregler" VALUE 0xFA27A MSA15_FW4 0 IDV_KI 0.000000 2.000000 EXTENDED_LIMITS 0.000000 3.999878 /end CHARACTERISTIC
/begin CHARACTERISTIC ehwSTP_FEN "EST Fensterbreite P-Kleinsignal Stromregler" VALUE 0xFA26E MSA15_FW4 0 IDV 0.000000 5000.000000 EXTENDED_LIMITS -32768.000000 32767.000000 /end CHARACTERISTIC
/begin CHARACTERISTIC ehwSTP_NEG "EST P-Verstaerkung negatives Grossignal Stromregler" VALUE 0xFA272 MSA15_FW4 0 IDV_KP 0.000000 1.000000 EXTENDED_LIMITS 0.000000 1.279961 /end CHARACTERISTIC
/begin CHARACTERISTIC ehwSTP_POS "EST P-Verstaerkung positives Grossignal Stromregler" VALUE 0xFA274 MSA15_FW4 0 IDV_KP 0.000000 1.000000 EXTENDED_LIMITS 0.000000 1.279961 /end CHARACTERISTIC
/begin CHARACTERISTIC ehwSTP_SIG "EST P-Verstaerkung Kleinsignal Stromregler" VALUE 0xFA270 MSA15_FW4 0 IDV_KP 0.000000 1.000000 EXTENDED_LIMITS 0.000000 1.279961 /end CHARACTERISTIC
/begin CHARACTERISTIC ehwTV_I_KL "EST stromgeregelte Endstufe I_soll = f(TV)" CURVE 0xFA286 MSA15_KL112 0 IDV 0.000000 5000.000000
 /begin AXIS_DESCR STD_AXIS ehmFKDR PROZ 10 0.000000 100.000000 EXTENDED_LIMITS -327.680000 327.670000 /end AXIS_DESCR
 EXTENDED_LIMITS -32768.000000 32767.000000 /end CHARACTERISTIC
/begin CHARACTERISTIC ehwUBK_KL "EST U_Batt-Korrektur bei EPW-Steuerung  Faktor = f(U_Batt)" CURVE 0xF266A MSA15_KL118 0 UKOR 0.000000 32.767000
 /begin AXIS_DESCR STD_AXIS anmUBT U_B 6 0.000000 24163.000000 EXTENDED_LIMITS 0.000000 773948.100000 /end AXIS_DESCR
/end CHARACTERISTIC
/begin CHARACTERISTIC ehwUCMINKF "#SSD min. Spannung fuer die Ueberwachung von UC  UC = f(n, U_Batt)" MAP 0xF2686 MSA15_KF382 0 U_C 0.000000 75005.140000
 /begin AXIS_DESCR STD_AXIS dzmNmit N 4 0.000000 6000.000000 EXTENDED_LIMITS 0.000000 32767.000000 /end AXIS_DESCR
 /begin AXIS_DESCR STD_AXIS anmUBT U_B 4 0.000000 24163.000000 EXTENDED_LIMITS 0.000000 773948.100000 /end AXIS_DESCR
 EXTENDED_LIMITS 0.000000 1348179.000000 /end CHARACTERISTIC
/begin CHARACTERISTIC ehwUC_FGRZ "#SSD UC-Pruefung Fehlergrenze" VALUE 0xF261F MSA15_FW1 0 DEZ_DB_U 0.000000 254.000000 EXTENDED_LIMITS 0.000000 255.000000 /end CHARACTERISTIC
/begin CHARACTERISTIC ehwUC_FINC "#SSD UC-Pruefung Fehler-Hochzaehlinkrement" VALUE 0xF261E MSA15_FW1 0 DEZ_DB_U 0.000000 255.000000 /end CHARACTERISTIC
/begin CHARACTERISTIC ehwUC_N "#SSD UC-Pruefung Drehzahlschwelle" VALUE 0xF261C MSA15_FW3 0 N 500.000000 6000.000000 EXTENDED_LIMITS 0.000000 32767.000000 /end CHARACTERISTIC
/begin CHARACTERISTIC ehwUC_RMAX "#SSD UC-Pruefung max. Boosterspannung" VALUE 0xF261A MSA15_FW3 0 U_C 60008.230000 95001.020000 EXTENDED_LIMITS 0.000000 1348179.000000 /end CHARACTERISTIC
/begin CHARACTERISTIC fbwBRS_PLT "#SSD BRE/BRK ext. Plausibilitaetszeit  0=inaktiv" VALUE 0xF255A MSA15_FW3 0 ZEIT_HP 0.000000 1310700000.000000 /end CHARACTERISTIC
/begin CHARACTERISTIC fbwBTS_BIN "BSTZ Zeitschwelle (fest) Erhoehung Betriebstundenzaehler" VALUE 0xF3628 MSA15_FW3 0 DEZ_DW_U 6.000000 6.000000 EXTENDED_LIMITS 0.000000 65535.000000 /end CHARACTERISTIC
/begin CHARACTERISTIC fbwBTS_MNR "BSTZ 'Pseudo'-Messagenummer (fest) BSTZ-Ausgabe" VALUE 0xF362C MSA15_FW3 0 DEZ_DW_U 65534.000000 65534.000000 EXTENDED_LIMITS 0.000000 65535.000000 /end CHARACTERISTIC
/begin CHARACTERISTIC fbwBTS_TIK "BSTZ Timerdauer (fest) fuer Betriebstundenzaehler" VALUE 0xF3626 MSA15_FW3 0 ZEIT_ST 60000000.000000 60000000.000000 EXTENDED_LIMITS 0.000000 655350000.000000 /end CHARACTERISTIC
/begin CHARACTERISTIC fbwEADF_HA "ADF  oberer  SRC  Defekterkennungs-Zeit" VALUE 0xF2B42 MSA15_FW3 0 ZEIT_ST 0.000000 655350000.000000 /end CHARACTERISTIC
/begin CHARACTERISTIC fbwEADF_HB "ADF  oberer  SRC  Intakterkennungs-Zeit" VALUE 0xF2B44 MSA15_FW3 0 ZEIT_ST 0.000000 655350000.000000 /end CHARACTERISTIC
/begin CHARACTERISTIC fbwEADF_HT "ADF  oberer  SRC  zeit-/ereignisgesteuert, loeschbar" VALUE 0xF2B46 MSA15_FW3 0 DEZ_DW_U 0.000000 65535.000000 /end CHARACTERISTIC
/begin CHARACTERISTIC fbwEADF_LA "ADF  unterer SRC  Defekterkennungs-Zeit" VALUE 0xF2B3C MSA15_FW3 0 ZEIT_ST 0.000000 655350000.000000 /end CHARACTERISTIC
/begin CHARACTERISTIC fbwEADF_LB "ADF  unterer SRC  Intakterkennungs-Zeit" VALUE 0xF2B3E MSA15_FW3 0 ZEIT_ST 0.000000 655350000.000000 /end CHARACTERISTIC
/begin CHARACTERISTIC fbwEADF_LT "ADF  unterer SRC  zeit-/ereignisgesteuert, loeschbar" VALUE 0xF2B40 MSA15_FW3 0 DEZ_DW_U 0.000000 65535.000000 /end CHARACTERISTIC
/begin CHARACTERISTIC fbwEAKS_KA "AKS  Kurzschluss  Defekterkennungs-Zeit" VALUE 0xF2F44 MSA15_FW3 0 ZEIT_ST 0.000000 655350000.000000 /end CHARACTERISTIC
/begin CHARACTERISTIC fbwEAKS_KB "AKS  Kurzschluss  Intakterkennungs-Zeit" VALUE 0xF2F46 MSA15_FW3 0 ZEIT_ST 0.000000 655350000.000000 /end CHARACTERISTIC
/begin CHARACTERISTIC fbwEAKS_KT "AKS  Kurzschluss  zeit-/ereignisgesteuert, loeschbar" VALUE 0xF2F48 MSA15_FW3 0 DEZ_DW_U 0.000000 65535.000000 /end CHARACTERISTIC
/begin CHARACTERISTIC fbwEAKS_OA "AKS  Leerlauf  Defekterkennungs-Zeit" VALUE 0xF2F4A MSA15_FW3 0 ZEIT_ST 0.000000 655350000.000000 /end CHARACTERISTIC
/begin CHARACTERISTIC fbwEAKS_OB "AKS  Leerlauf  Intakterkennungs-Zeit" VALUE 0xF2F4C MSA15_FW3 0 ZEIT_ST 0.000000 655350000.000000 /end CHARACTERISTIC
/begin CHARACTERISTIC fbwEAKS_OT "AKS  Leerlauf  zeit-/ereignisgesteuert, loeschbar" VALUE 0xF2F4E MSA15_FW3 0 DEZ_DW_U 0.000000 65535.000000 /end CHARACTERISTIC
/begin CHARACTERISTIC fbwEARS_KA "ARS  Kurzschluss  Defekterkennungs-Zeit" VALUE 0xF2D66 MSA15_FW3 0 ZEIT_ST 0.000000 655350000.000000 /end CHARACTERISTIC
/begin CHARACTERISTIC fbwEARS_KB "ARS  Kurzschluss  Intakterkennungs-Zeit" VALUE 0xF2D68 MSA15_FW3 0 ZEIT_ST 0.000000 655350000.000000 /end CHARACTERISTIC
/begin CHARACTERISTIC fbwEARS_KT "ARS  Kurzschluss  zeit-/ereignisgesteuert, loeschbar" VALUE 0xF2D6A MSA15_FW3 0 DEZ_DW_U 0.000000 65535.000000 /end CHARACTERISTIC
/begin CHARACTERISTIC fbwEARS_OA "ARS  Leerlauf  Defekterkennungs-Zeit" VALUE 0xF2D6C MSA15_FW3 0 ZEIT_ST 0.000000 655350000.000000 /end CHARACTERISTIC
/begin CHARACTERISTIC fbwEARS_OB "ARS  Leerlauf  Intakterkennungs-Zeit" VALUE 0xF2D6E MSA15_FW3 0 ZEIT_ST 0.000000 655350000.000000 /end CHARACTERISTIC
/begin CHARACTERISTIC fbwEARS_OT "ARS  Leerlauf  zeit-/ereignisgesteuert, loeschbar" VALUE 0xF2D70 MSA15_FW3 0 DEZ_DW_U 0.000000 65535.000000 /end CHARACTERISTIC
/begin CHARACTERISTIC fbwEARSnRA "ARS  neg. RA  Defekterkennungs-Zeit" VALUE 0xF2D78 MSA15_FW3 0 ZEIT_ST 0.000000 655350000.000000 /end CHARACTERISTIC
/begin CHARACTERISTIC fbwEARSnRB "ARS  neg. RA  Intakterkennungs-Zeit" VALUE 0xF2D7A MSA15_FW3 0 ZEIT_ST 0.000000 655350000.000000 /end CHARACTERISTIC
/begin CHARACTERISTIC fbwEARSnRT "ARS  neg. RA  zeit-/ereignisgesteuert, loeschbar" VALUE 0xF2D7C MSA15_FW3 0 DEZ_DW_U 0.000000 65535.000000 /end CHARACTERISTIC
/begin CHARACTERISTIC fbwEARSpRA "ARS  pos. RA  Defekterkennungs-Zeit" VALUE 0xF2D72 MSA15_FW3 0 ZEIT_ST 0.000000 655350000.000000 /end CHARACTERISTIC
/begin CHARACTERISTIC fbwEARSpRB "ARS  pos. RA  Intakterkennungs-Zeit" VALUE 0xF2D74 MSA15_FW3 0 ZEIT_ST 0.000000 655350000.000000 /end CHARACTERISTIC
/begin CHARACTERISTIC fbwEARSpRT "ARS  pos. RA  zeit-/ereignisgesteuert, loeschbar" VALUE 0xF2D76 MSA15_FW3 0 DEZ_DW_U 0.000000 65535.000000 /end CHARACTERISTIC
/begin CHARACTERISTIC fbwEASC3FA "ASC3 Botschaftsausfall Defekterkennungs-Zeit" VALUE 0xF33F4 MSA15_FW3 0 ZEIT_ST 0.000000 70000.000000 EXTENDED_LIMITS 0.000000 655350000.000000 /end CHARACTERISTIC
/begin CHARACTERISTIC fbwEASC3FB "ASC3 Botschaftsausfall  Intakterkennungszeit" VALUE 0xF33F6 MSA15_FW3 0 ZEIT_ST 0.000000 70000.000000 EXTENDED_LIMITS 0.000000 655350000.000000 /end CHARACTERISTIC
/begin CHARACTERISTIC fbwEASC3FT "ASC3 Botschaftsausfall zeit-/ereignisgesteuert, loeschbar" VALUE 0xF33F8 MSA15_FW3 0 DEZ_DW_U 0.000000 65535.000000 /end CHARACTERISTIC
/begin CHARACTERISTIC fbwEASC_FA "ASC Botschaftsausfall Defekterkennungs-Zeit" VALUE 0xF33E8 MSA15_FW3 0 ZEIT_ST 0.000000 70000.000000 EXTENDED_LIMITS 0.000000 655350000.000000 /end CHARACTERISTIC
/begin CHARACTERISTIC fbwEASC_FB "ASC Botschaftsausfall  Intakterkennungszeit" VALUE 0xF33EA MSA15_FW3 0 ZEIT_ST 0.000000 70000.000000 EXTENDED_LIMITS 0.000000 655350000.000000 /end CHARACTERISTIC
/begin CHARACTERISTIC fbwEASC_FT "ASC Botschaftsausfall zeit-/ereignisgesteuert, loeschbar" VALUE 0xF33EC MSA15_FW3 0 DEZ_DW_U 0.000000 65535.000000 /end CHARACTERISTIC
/begin CHARACTERISTIC fbwEASK_KA "ASK  Kurzschluss  Defekterkennungs-Zeit" VALUE 0xF2E2A MSA15_FW3 0 ZEIT_ST 0.000000 655350000.000000 /end CHARACTERISTIC
/begin CHARACTERISTIC fbwEASK_KB "ASK  Kurzschluss  Intakterkennungs-Zeit" VALUE 0xF2E2C MSA15_FW3 0 ZEIT_ST 0.000000 655350000.000000 /end CHARACTERISTIC
/begin CHARACTERISTIC fbwEASK_KT "ASK  Kurzschluss  zeit-/ereignisgesteuert, loeschbar" VALUE 0xF2E2E MSA15_FW3 0 DEZ_DW_U 0.000000 65535.000000 /end CHARACTERISTIC
/begin CHARACTERISTIC fbwEASK_OA "ASK  Leerlauf  Defekterkennungs-Zeit" VALUE 0xF2E30 MSA15_FW3 0 ZEIT_ST 0.000000 655350000.000000 /end CHARACTERISTIC
/begin CHARACTERISTIC fbwEASK_OB "ASK  Leerlauf  Intakterkennungs-Zeit" VALUE 0xF2E32 MSA15_FW3 0 ZEIT_ST 0.000000 655350000.000000 /end CHARACTERISTIC
/begin CHARACTERISTIC fbwEASK_OT "ASK  Leerlauf  zeit-/ereignisgesteuert, loeschbar" VALUE 0xF2E34 MSA15_FW3 0 DEZ_DW_U 0.000000 65535.000000 /end CHARACTERISTIC
/begin CHARACTERISTIC fbwEAT1_HA "AT1  oberer  SRC  Defekterkennungs-Zeit" VALUE 0xF2A1C MSA15_FW3 0 ZEIT_ST 0.000000 655350000.000000 /end CHARACTERISTIC
/begin CHARACTERISTIC fbwEAT1_HB "AT1  oberer  SRC  Intakterkennungs-Zeit" VALUE 0xF2A1E MSA15_FW3 0 ZEIT_ST 0.000000 655350000.000000 /end CHARACTERISTIC
/begin CHARACTERISTIC fbwEAT1_HT "AT1  oberer  SRC  zeit-/ereignisgesteuert, loeschbar" VALUE 0xF2A20 MSA15_FW3 0 DEZ_DW_U 0.000000 65535.000000 /end CHARACTERISTIC
/begin CHARACTERISTIC fbwEAT1_LA "AT1  unterer SRC  Defekterkennungs-Zeit" VALUE 0xF2A16 MSA15_FW3 0 ZEIT_ST 0.000000 655350000.000000 /end CHARACTERISTIC
/begin CHARACTERISTIC fbwEAT1_LB "AT1  unterer SRC  Intakterkennungs-Zeit" VALUE 0xF2A18 MSA15_FW3 0 ZEIT_ST 0.000000 655350000.000000 /end CHARACTERISTIC
/begin CHARACTERISTIC fbwEAT1_LT "AT1  unterer SRC  zeit-/ereignisgesteuert, loeschbar" VALUE 0xF2A1A MSA15_FW3 0 DEZ_DW_U 0.000000 65535.000000 /end CHARACTERISTIC
/begin CHARACTERISTIC fbwEAT2_HA "AT2  oberer  SRC  Defekterkennungs-Zeit" VALUE 0xF2A4A MSA15_FW3 0 ZEIT_ST 0.000000 655350000.000000 /end CHARACTERISTIC
/begin CHARACTERISTIC fbwEAT2_HB "AT2  oberer  SRC  Intakterkennungs-Zeit" VALUE 0xF2A4C MSA15_FW3 0 ZEIT_ST 0.000000 655350000.000000 /end CHARACTERISTIC
/begin CHARACTERISTIC fbwEAT2_HT "AT2  oberer  SRC  zeit-/ereignisgesteuert, loeschbar" VALUE 0xF2A4E MSA15_FW3 0 DEZ_DW_U 0.000000 65535.000000 /end CHARACTERISTIC
/begin CHARACTERISTIC fbwEAT2_LA "AT2  unterer SRC  Defekterkennungs-Zeit" VALUE 0xF2A44 MSA15_FW3 0 ZEIT_ST 0.000000 655350000.000000 /end CHARACTERISTIC
/begin CHARACTERISTIC fbwEAT2_LB "AT2  unterer SRC  Intakterkennungs-Zeit" VALUE 0xF2A46 MSA15_FW3 0 ZEIT_ST 0.000000 655350000.000000 /end CHARACTERISTIC
/begin CHARACTERISTIC fbwEAT2_LT "AT2  unterer SRC  zeit-/ereignisgesteuert, loeschbar" VALUE 0xF2A48 MSA15_FW3 0 DEZ_DW_U 0.000000 65535.000000 /end CHARACTERISTIC
/begin CHARACTERISTIC fbwEBRE_PA "#SSD BRE  Plaus. mit BRK  Defekterkennungs-Zeit" VALUE 0xF336A MSA15_FW3 0 ZEIT_ST 0.000000 655350000.000000 /end CHARACTERISTIC
/begin CHARACTERISTIC fbwEBRE_PB "#SSD BRE  Plaus. mit BRK  Intakterkennungs-Zeit" VALUE 0xF336C MSA15_FW3 0 ZEIT_ST 0.000000 655350000.000000 /end CHARACTERISTIC
/begin CHARACTERISTIC fbwEBRE_PT "#SSD BRE  Plaus. mit BRK  zeit-/ereignisgesteuert, loeschbar" VALUE 0xF336E MSA15_FW3 0 DEZ_DW_U 0.000000 65535.000000 /end CHARACTERISTIC
/begin CHARACTERISTIC fbwECAN_DA "#SSD CAN Defekt Zeit bis endgueltig defekt" VALUE 0xF2004 MSA15_FW3 0 ZEIT_ST 0.000000 655350000.000000 /end CHARACTERISTIC
/begin CHARACTERISTIC fbwECAN_DB "#SSD CAN Defekt Zeit bis endgueltig geheilt" VALUE 0xF2006 MSA15_FW3 0 ZEIT_ST 0.000000 655350000.000000 /end CHARACTERISTIC
/begin CHARACTERISTIC fbwECAN_DT "#SSD CAN Defekt Zeit/Ereignisgesteuert, Loeschbar" VALUE 0xF2008 MSA15_FW3 0 DEZ_DW_U 0.000000 65535.000000 /end CHARACTERISTIC
/begin CHARACTERISTIC fbwECAN_OA "#SSD CAN  Offline  Defekterkennungs-Zeit" VALUE 0xF33BA MSA15_FW3 0 ZEIT_ST 0.000000 655350000.000000 /end CHARACTERISTIC
/begin CHARACTERISTIC fbwECAN_OB "#SSD CAN  Offline  Intakterkennungs-Zeit" VALUE 0xF33BC MSA15_FW3 0 ZEIT_ST 0.000000 655350000.000000 /end CHARACTERISTIC
/begin CHARACTERISTIC fbwECAN_OT "#SSD CAN  Offline  zeit-/ereignisgesteuert, loeschbar" VALUE 0xF33BE MSA15_FW3 0 DEZ_DW_U 0.000000 65535.000000 /end CHARACTERISTIC
/begin CHARACTERISTIC fbwEDLA_AA "Diagnoselampe Hilfsfehler Defekterkennungs-Zeit" VALUE 0xF376E MSA15_FW3 0 DEZ_DW_U 0.000000 65535.000000 /end CHARACTERISTIC
/begin CHARACTERISTIC fbwEDLA_AB "Diagnoselampe Hilfsfehler Intakterkennungs-Zeit" VALUE 0xF3770 MSA15_FW3 0 DEZ_DW_U 0.000000 65535.000000 /end CHARACTERISTIC
/begin CHARACTERISTIC fbwEDLA_AT "Diagnoselampe Hilfsfehler zeit-/ereignisgesteuert, Loeschbar" VALUE 0xF3772 MSA15_FW3 0 DEZ_DW_U 0.000000 65535.000000 /end CHARACTERISTIC
/begin CHARACTERISTIC fbwEDRA_KA "DRA  Kurzschluss  Defekterkennungs-Zeit" VALUE 0xF2E58 MSA15_FW3 0 ZEIT_ST 0.000000 655350000.000000 /end CHARACTERISTIC
/begin CHARACTERISTIC fbwEDRA_KB "DRA  Kurzschluss  Intakterkennungs-Zeit" VALUE 0xF2E5A MSA15_FW3 0 ZEIT_ST 0.000000 655350000.000000 /end CHARACTERISTIC
/begin CHARACTERISTIC fbwEDRA_KT "DRA  Kurzschluss  zeit-/ereignisgesteuert, loeschbar" VALUE 0xF2E5C MSA15_FW3 0 DEZ_DW_U 0.000000 65535.000000 /end CHARACTERISTIC
/begin CHARACTERISTIC fbwEDRA_OA "DRA  Leerlauf  Defekterkennungs-Zeit" VALUE 0xF2E5E MSA15_FW3 0 ZEIT_ST 0.000000 655350000.000000 /end CHARACTERISTIC
/begin CHARACTERISTIC fbwEDRA_OB "DRA  Leerlauf  Intakterkennungs-Zeit" VALUE 0xF2E60 MSA15_FW3 0 ZEIT_ST 0.000000 655350000.000000 /end CHARACTERISTIC
/begin CHARACTERISTIC fbwEDRA_OT "DRA  Leerlauf  zeit-/ereignisgesteuert, loeschbar" VALUE 0xF2E62 MSA15_FW3 0 DEZ_DW_U 0.000000 65535.000000 /end CHARACTERISTIC
/begin CHARACTERISTIC fbwEDZG_DA "#SSD DZG  dynam. Plaus.  Defekterkennungs-Zeit" VALUE 0xF2732 MSA15_FW3 0 ZEIT_ST 0.000000 655350000.000000 /end CHARACTERISTIC
/begin CHARACTERISTIC fbwEDZG_DB "#SSD DZG  dynam. Plaus.  Intakterkennungs-Zeit" VALUE 0xF2734 MSA15_FW3 0 ZEIT_ST 0.000000 655350000.000000 /end CHARACTERISTIC
/begin CHARACTERISTIC fbwEDZG_DT "#SSD DZG  dynam. Plaus.  zeit-/ereignisgesteuert, loeschbar" VALUE 0xF2736 MSA15_FW3 0 DEZ_DW_U 0.000000 65535.000000 /end CHARACTERISTIC
/begin CHARACTERISTIC fbwEDZG_UA "#SSD DZG  Ueberdrehzahl  Defekterkennungs-Zeit" VALUE 0xF2738 MSA15_FW3 0 ZEIT_ST 0.000000 655350000.000000 /end CHARACTERISTIC
/begin CHARACTERISTIC fbwEDZG_UB "#SSD DZG  Ueberdrehzahl  Intakterkennungs-Zeit" VALUE 0xF273A MSA15_FW3 0 ZEIT_ST 0.000000 655350000.000000 /end CHARACTERISTIC
/begin CHARACTERISTIC fbwEDZG_UT "#SSD DZG  Ueberdrehzahl  zeit-/ereignisgesteuert, loeschbar" VALUE 0xF273C MSA15_FW3 0 DEZ_DW_U 0.000000 65535.000000 /end CHARACTERISTIC
/begin CHARACTERISTIC fbwEEAB_PA "#SSD EAB  Plausibilitaet  Defekterkennungs-Zeit" VALUE 0xF3110 MSA15_FW3 0 DEZ_DW_U 0.000000 65535.000000 /end CHARACTERISTIC
/begin CHARACTERISTIC fbwEEAB_PB "#SSD EAB  Plausibilitaet  Intakterkennungs-Zeit" VALUE 0xF3112 MSA15_FW3 0 DEZ_DW_U 0.000000 65535.000000 /end CHARACTERISTIC
/begin CHARACTERISTIC fbwEEAB_PT "#SSD EAB  Plausibilitaet  zeit-/ereignisgesteuert, loeschbar" VALUE 0xF3114 MSA15_FW3 0 DEZ_DW_U 0.000000 65535.000000 /end CHARACTERISTIC
/begin CHARACTERISTIC fbwEEEP_AA "#SSD EEPROM AGL Checksum Defekterkennungs-Zeit" VALUE 0xF342E MSA15_FW3 0 DEZ_DW_U 0.000000 65535.000000 /end CHARACTERISTIC
/begin CHARACTERISTIC fbwEEEP_AB "#SSD EEPROM AGL Checksum Intakterkennungs-Zeit" VALUE 0xF3430 MSA15_FW3 0 DEZ_DW_U 0.000000 65535.000000 /end CHARACTERISTIC
/begin CHARACTERISTIC fbwEEEP_AT "#SSD EEPROM AGL Checksum zeit-/ereignisgesteuert, Loeschbar" VALUE 0xF3432 MSA15_FW3 0 DEZ_DW_U 0.000000 65535.000000 /end CHARACTERISTIC
/begin CHARACTERISTIC fbwEEEP_DA "#SSD EEPROM Mengendriftkomp Checksum Defekterkennungs-Zeit" VALUE 0xF3734 MSA15_FW3 0 DEZ_DW_U 0.000000 65535.000000 /end CHARACTERISTIC
/begin CHARACTERISTIC fbwEEEP_DB "#SSD EEPROM Mengendriftkomp Checksum Intakterkennungs-Zeit" VALUE 0xF3736 MSA15_FW3 0 DEZ_DW_U 0.000000 65535.000000 /end CHARACTERISTIC
/begin CHARACTERISTIC fbwEEEP_DT "#SSD EEPROM Mengendriftkomp Checksum zeit-/ereignisgesteuert, Loeschbar" VALUE 0xF3738 MSA15_FW3 0 DEZ_DW_U 0.000000 65535.000000 /end CHARACTERISTIC
/begin CHARACTERISTIC fbwEEEP_KA "#SSD EEPROM Kommunikation Defekterkennungs-Zeit" VALUE 0xF3428 MSA15_FW3 0 DEZ_DW_U 0.000000 65535.000000 /end CHARACTERISTIC
/begin CHARACTERISTIC fbwEEEP_KB "#SSD EEPROM Kommunikation Intakterkennungs-Zeit" VALUE 0xF342A MSA15_FW3 0 DEZ_DW_U 0.000000 65535.000000 /end CHARACTERISTIC
/begin CHARACTERISTIC fbwEEEP_KT "#SSD EEPROM Kommunikation zeit-/ereignisgesteuert, loeschbar" VALUE 0xF342C MSA15_FW3 0 DEZ_DW_U 0.000000 65535.000000 /end CHARACTERISTIC
/begin CHARACTERISTIC fbwEEEP_MA "#SSD EEPROM Mengenabgleich Checksum Defekterkennungs-Zeit" VALUE 0xF362E MSA15_FW3 0 DEZ_DW_U 0.000000 65535.000000 /end CHARACTERISTIC
/begin CHARACTERISTIC fbwEEEP_MB "#SSD EEPROM Mengenabgleich Checksum Intakterkennungs-Zeit" VALUE 0xF3630 MSA15_FW3 0 DEZ_DW_U 0.000000 65535.000000 /end CHARACTERISTIC
/begin CHARACTERISTIC fbwEEEP_MT "#SSD EEPROM Mengenabgleich Checksum zeit-/ereignisgesteuert, Loeschbar" VALUE 0xF3632 MSA15_FW3 0 DEZ_DW_U 0.000000 65535.000000 /end CHARACTERISTIC
/begin CHARACTERISTIC fbwEEGS_FA "#SSD EGS Botschaftsausfall  Defekterkennungs-Zeit" VALUE 0xF33E2 MSA15_FW3 0 ZEIT_ST 0.000000 70000.000000 EXTENDED_LIMITS 0.000000 655350000.000000 /end CHARACTERISTIC
/begin CHARACTERISTIC fbwEEGS_FB "EGS Botschaftsausfall  Intakterkennungs-Zeit" VALUE 0xF33E4 MSA15_FW3 0 ZEIT_ST 0.000000 70000.000000 EXTENDED_LIMITS 0.000000 655350000.000000 /end CHARACTERISTIC
/begin CHARACTERISTIC fbwEEGS_FT "EGS Botschaftsausfall  zeit-/ereignisgesteuert, loeschbar" VALUE 0xF33E6 MSA15_FW3 0 DEZ_DW_U 0.000000 65535.000000 /end CHARACTERISTIC
/begin CHARACTERISTIC fbwEEKP_KA "EKP  Kurzschluss  Defekterkennungs-Zeit" VALUE 0xF2EE8 MSA15_FW3 0 ZEIT_ST 0.000000 655350000.000000 /end CHARACTERISTIC
/begin CHARACTERISTIC fbwEEKP_KB "EKP  Kurzschluss  Intakterkennungs-Zeit" VALUE 0xF2EEA MSA15_FW3 0 ZEIT_ST 0.000000 655350000.000000 /end CHARACTERISTIC
/begin CHARACTERISTIC fbwEEKP_KT "EKP  Kurzschluss  zeit-/ereignisgesteuert, loeschbar" VALUE 0xF2EEC MSA15_FW3 0 DEZ_DW_U 0.000000 65535.000000 /end CHARACTERISTIC
/begin CHARACTERISTIC fbwEEKP_OA "EKP  Leerlauf  Defekterkennungs-Zeit" VALUE 0xF2EEE MSA15_FW3 0 ZEIT_ST 0.000000 655350000.000000 /end CHARACTERISTIC
/begin CHARACTERISTIC fbwEEKP_OB "EKP  Leerlauf  Intakterkennungs-Zeit" VALUE 0xF2EF0 MSA15_FW3 0 ZEIT_ST 0.000000 655350000.000000 /end CHARACTERISTIC
/begin CHARACTERISTIC fbwEEKP_OT "EKP  Leerlauf  zeit-/ereignisgesteuert, loeschbar" VALUE 0xF2EF2 MSA15_FW3 0 DEZ_DW_U 0.000000 65535.000000 /end CHARACTERISTIC
/begin CHARACTERISTIC fbwEEWS_MA "EWS  Manipulationsversuch  Defekterkennung" VALUE 0xF1B66 MSA15_FW3 0 DEZ_DW_U 0.000000 65535.000000 /end CHARACTERISTIC
/begin CHARACTERISTIC fbwEEWS_MB "EWS  Manipulationsversuch  Intakterkennung" VALUE 0xF1B68 MSA15_FW3 0 DEZ_DW_U 0.000000 65535.000000 /end CHARACTERISTIC
/begin CHARACTERISTIC fbwEEWS_MT "EWS  Manipulationsversuch  zeit-/ereignisgesteuert, loeschbar" VALUE 0xF1B6A MSA15_FW3 0 DEZ_DW_U 0.000000 65535.000000 /end CHARACTERISTIC
/begin CHARACTERISTIC fbwEEWS_PA "EWS  Uebertragungsfehler  Defekterkennung" VALUE 0xF1B6C MSA15_FW3 0 DEZ_DW_U 0.000000 65535.000000 /end CHARACTERISTIC
/begin CHARACTERISTIC fbwEEWS_PB "EWS  Uebertragungsfehler  Intakterkennung" VALUE 0xF1B6E MSA15_FW3 0 DEZ_DW_U 0.000000 65535.000000 /end CHARACTERISTIC
/begin CHARACTERISTIC fbwEEWS_PT "EWS  Uebertragungsfehler  zeit-/ereignisgesteuert, loeschbar" VALUE 0xF1B70 MSA15_FW3 0 DEZ_DW_U 0.000000 65535.000000 /end CHARACTERISTIC
/begin CHARACTERISTIC fbwEEWS_TA "EWS  Timeout abgelaufen  Defekterkennung" VALUE 0xF1B72 MSA15_FW3 0 DEZ_DW_U 0.000000 65535.000000 /end CHARACTERISTIC
/begin CHARACTERISTIC fbwEEWS_TB "EWS  Timeout abgelaufen  Intakterkennung" VALUE 0xF1B74 MSA15_FW3 0 DEZ_DW_U 0.000000 65535.000000 /end CHARACTERISTIC
/begin CHARACTERISTIC fbwEEWS_TT "EWS  Timeout abgelaufen  zeit-/ereignisgesteuert, loeschbar" VALUE 0xF1B76 MSA15_FW3 0 DEZ_DW_U 0.000000 65535.000000 /end CHARACTERISTIC
/begin CHARACTERISTIC fbwEEWS_UA "EWS  UC defekt  Defekterkennung" VALUE 0xF1B78 MSA15_FW3 0 DEZ_DW_U 0.000000 65535.000000 /end CHARACTERISTIC
/begin CHARACTERISTIC fbwEEWS_UB "EWS  UC defekt  Intakterkennung" VALUE 0xF1B7A MSA15_FW3 0 DEZ_DW_U 0.000000 65535.000000 /end CHARACTERISTIC
/begin CHARACTERISTIC fbwEEWS_UT "EWS  UC defekt  zeit-/ereignisgesteuert, loeschbar" VALUE 0xF1B7C MSA15_FW3 0 DEZ_DW_U 0.000000 65535.000000 /end CHARACTERISTIC
/begin CHARACTERISTIC fbwEEWS_WA "EWS  WC defekt  Defekterkennung" VALUE 0xF1B7E MSA15_FW3 0 DEZ_DW_U 0.000000 65535.000000 /end CHARACTERISTIC
/begin CHARACTERISTIC fbwEEWS_WB "EWS  WC defekt  Intakterkennung" VALUE 0xF1B80 MSA15_FW3 0 DEZ_DW_U 0.000000 65535.000000 /end CHARACTERISTIC
/begin CHARACTERISTIC fbwEEWS_WT "EWS  WC defekt  zeit-/ereignisgesteuert, loeschbar" VALUE 0xF1B82 MSA15_FW3 0 DEZ_DW_U 0.000000 65535.000000 /end CHARACTERISTIC
/begin CHARACTERISTIC fbwEFGA_PA "FGA  kein Vorschalt-Kontakt  Defekterkennungs-Zeit" VALUE 0xF2BBC MSA15_FW3 0 DEZ_DW_U 0.000000 65535.000000 /end CHARACTERISTIC
/begin CHARACTERISTIC fbwEFGA_PB "FGA  kein Vorschalt-Kontakt  Intakterkennungs-Zeit" VALUE 0xF2BBE MSA15_FW3 0 DEZ_DW_U 0.000000 65535.000000 /end CHARACTERISTIC
/begin CHARACTERISTIC fbwEFGA_PT "FGA  kein Vorschalt-Kontakt  zeit-/ereignisgesteuert, loeschbar" VALUE 0xF2BC0 MSA15_FW3 0 DEZ_DW_U 0.000000 65535.000000 /end CHARACTERISTIC
/begin CHARACTERISTIC fbwEFGG_CA "FGG  CAN Geschwindigkeit ungueltig  Defekterkennungs-Zeit" VALUE 0xF2CF4 MSA15_FW3 0 ZEIT_ST 0.000000 655350000.000000 /end CHARACTERISTIC
/begin CHARACTERISTIC fbwEFGG_CB "FGG  CAN Geschwindigkeit ungueltig  Intakterkennungs-Zeit" VALUE 0xF2CF6 MSA15_FW3 0 ZEIT_ST 0.000000 655350000.000000 /end CHARACTERISTIC
/begin CHARACTERISTIC fbwEFGG_CT "FGG  CAN Geschwindigkeit ungueltig  zeit-/ereignisgesteuert, loeschbar" VALUE 0xF2CF8 MSA15_FW3 0 DEZ_DW_U 0.000000 65535.000000 /end CHARACTERISTIC
/begin CHARACTERISTIC fbwEFGG_FA "FGG  Frequenz  Defekterkennungs-Zeit" VALUE 0xF2CEE MSA15_FW3 0 ZEIT_ST 0.000000 655350000.000000 /end CHARACTERISTIC
/begin CHARACTERISTIC fbwEFGG_FB "FGG  Frequenz  Intakterkennungs-Zeit" VALUE 0xF2CF0 MSA15_FW3 0 ZEIT_ST 0.000000 655350000.000000 /end CHARACTERISTIC
/begin CHARACTERISTIC fbwEFGG_FT "FGG  Frequenz  zeit-/ereignisgesteuert, loeschbar" VALUE 0xF2CF2 MSA15_FW3 0 DEZ_DW_U 0.000000 65535.000000 /end CHARACTERISTIC
/begin CHARACTERISTIC fbwEFGG_HA "FGG  oberer  SRC  Defekterkennungs-Zeit" VALUE 0xF2CE2 MSA15_FW3 0 ZEIT_ST 0.000000 655350000.000000 /end CHARACTERISTIC
/begin CHARACTERISTIC fbwEFGG_HB "FGG  oberer  SRC  Intakterkennungs-Zeit" VALUE 0xF2CE4 MSA15_FW3 0 ZEIT_ST 0.000000 655350000.000000 /end CHARACTERISTIC
/begin CHARACTERISTIC fbwEFGG_HT "FGG  oberer  SRC  zeit-/ereignisgesteuert, loeschbar" VALUE 0xF2CE6 MSA15_FW3 0 DEZ_DW_U 0.000000 65535.000000 /end CHARACTERISTIC
/begin CHARACTERISTIC fbwEFGG_PA "FGG  Plausibilitaet  Defekterkennungs-Zeit" VALUE 0xF2CE8 MSA15_FW3 0 ZEIT_ST 0.000000 655350000.000000 /end CHARACTERISTIC
/begin CHARACTERISTIC fbwEFGG_PB "FGG  Plausibilitaet  Intakterkennungs-Zeit" VALUE 0xF2CEA MSA15_FW3 0 ZEIT_ST 0.000000 655350000.000000 /end CHARACTERISTIC
/begin CHARACTERISTIC fbwEFGG_PT "FGG  Plausibilitaet  zeit-/ereignisgesteuert, loeschbar" VALUE 0xF2CEC MSA15_FW3 0 DEZ_DW_U 0.000000 65535.000000 /end CHARACTERISTIC
/begin CHARACTERISTIC fbwEGAZ_BA "GAZ  CAN-Lampe defekt Defekterkennungs-Zeit" VALUE 0xF30DC MSA15_FW3 0 ZEIT_ST 0.000000 655350000.000000 /end CHARACTERISTIC
/begin CHARACTERISTIC fbwEGAZ_BB "GAZ  CAN-Lampe defekt Intakterkennungs-Zeit" VALUE 0xF30DE MSA15_FW3 0 ZEIT_ST 0.000000 655350000.000000 /end CHARACTERISTIC
/begin CHARACTERISTIC fbwEGAZ_BT "GAZ  CAN-Lampe defekt zeit-/ereignisgesteuert, loeschbar" VALUE 0xF30E0 MSA15_FW3 0 DEZ_DW_U 0.000000 65535.000000 /end CHARACTERISTIC
/begin CHARACTERISTIC fbwEGAZ_DA "GAZ  VGK Betriebsfehler  Defekterkennungs-Zeit" VALUE 0xF30E8 MSA15_FW3 0 ZEIT_ST 0.000000 655350000.000000 /end CHARACTERISTIC
/begin CHARACTERISTIC fbwEGAZ_DB "GAZ  VGK Betriebsfehler  Intakterkennungs-Zeit" VALUE 0xF30EA MSA15_FW3 0 ZEIT_ST 0.000000 655350000.000000 /end CHARACTERISTIC
/begin CHARACTERISTIC fbwEGAZ_DT "GAZ  VGK Betriebsfehler  zeit-/ereignisgesteuert, loeschbar" VALUE 0xF30EC MSA15_FW3 0 DEZ_DW_U 0.000000 65535.000000 /end CHARACTERISTIC
/begin CHARACTERISTIC fbwEGAZ_IA "GAZ  VGK Init.Fehler Defekterkennungs-Zeit" VALUE 0xF30E2 MSA15_FW3 0 ZEIT_ST 0.000000 655350000.000000 /end CHARACTERISTIC
/begin CHARACTERISTIC fbwEGAZ_IB "GAZ  VGK Init.Fehler Intakterkennungs-Zeit" VALUE 0xF30E4 MSA15_FW3 0 ZEIT_ST 0.000000 655350000.000000 /end CHARACTERISTIC
/begin CHARACTERISTIC fbwEGAZ_IT "GAZ  VGK Init.Fehler zeit-/ereignisgesteuert, loeschbar" VALUE 0xF30E6 MSA15_FW3 0 DEZ_DW_U 0.000000 65535.000000 /end CHARACTERISTIC
/begin CHARACTERISTIC fbwEGRS_IA "BMW-Gluehrelais Defekterkennungs-Zeit" VALUE 0xF2EC0 MSA15_FW3 0 ZEIT_ST 0.000000 655350000.000000 /end CHARACTERISTIC
/begin CHARACTERISTIC fbwEGRS_IB "BMW-Gluehrelais Intakterkennungs-Zeit" VALUE 0xF2EC2 MSA15_FW3 0 ZEIT_ST 0.000000 655350000.000000 /end CHARACTERISTIC
/begin CHARACTERISTIC fbwEGRS_IT "BMW-Gluehrelais-Fehler zeit-/ereignisgesteuert, loeschbar" VALUE 0xF2EC4 MSA15_FW3 0 DEZ_DW_U 0.000000 65535.000000 /end CHARACTERISTIC
/begin CHARACTERISTIC fbwEGRS_KA "GRS  Kurzschluss  Defekterkennungs-Zeit" VALUE 0xF2EB4 MSA15_FW3 0 ZEIT_ST 0.000000 655350000.000000 /end CHARACTERISTIC
/begin CHARACTERISTIC fbwEGRS_KB "GRS  Kurzschluss  Intakterkennungs-Zeit" VALUE 0xF2EB6 MSA15_FW3 0 ZEIT_ST 0.000000 655350000.000000 /end CHARACTERISTIC
/begin CHARACTERISTIC fbwEGRS_KT "GRS  Kurzschluss  zeit-/ereignisgesteuert, loeschbar" VALUE 0xF2EB8 MSA15_FW3 0 DEZ_DW_U 0.000000 65535.000000 /end CHARACTERISTIC
/begin CHARACTERISTIC fbwEGRS_OA "GRS  Leerlauf  Defekterkennungs-Zeit" VALUE 0xF2EBA MSA15_FW3 0 ZEIT_ST 0.000000 655350000.000000 /end CHARACTERISTIC
/begin CHARACTERISTIC fbwEGRS_OB "GRS  Leerlauf  Intakterkennungs-Zeit" VALUE 0xF2EBC MSA15_FW3 0 ZEIT_ST 0.000000 655350000.000000 /end CHARACTERISTIC
/begin CHARACTERISTIC fbwEGRS_OT "GRS  Leerlauf  zeit-/ereignisgesteuert, loeschbar" VALUE 0xF2EBE MSA15_FW3 0 DEZ_DW_U 0.000000 65535.000000 /end CHARACTERISTIC
/begin CHARACTERISTIC fbwEGZ1_1A "GZ1  Kerzenausfall GK 1 Defekterkennungs-Zeit" VALUE 0xF347E MSA15_FW3 0 ZEIT_ST 0.000000 655350000.000000 /end CHARACTERISTIC
/begin CHARACTERISTIC fbwEGZ1_1B "GZ1  Kerzenausfall GK 1 Intakterkennungs-Zeit" VALUE 0xF3480 MSA15_FW3 0 ZEIT_ST 0.000000 655350000.000000 /end CHARACTERISTIC
/begin CHARACTERISTIC fbwEGZ1_1T "GZ1  Kerzenausfall GK 1 zeit-/ereignisgesteuert, loeschbar" VALUE 0xF3482 MSA15_FW3 0 DEZ_DW_U 0.000000 65535.000000 /end CHARACTERISTIC
/begin CHARACTERISTIC fbwEGZ1_2A "GZ2  Kerzenausfall GK 2 Defekterkennungs-Zeit" VALUE 0xF3484 MSA15_FW3 0 ZEIT_ST 0.000000 655350000.000000 /end CHARACTERISTIC
/begin CHARACTERISTIC fbwEGZ1_2B "GZ1  Kerzenausfall GK 2 Intakterkennungs-Zeit" VALUE 0xF3486 MSA15_FW3 0 ZEIT_ST 0.000000 655350000.000000 /end CHARACTERISTIC
/begin CHARACTERISTIC fbwEGZ1_2T "GZ1  Kerzenausfall GK 2 zeit-/ereignisgesteuert, loeschbar" VALUE 0xF3488 MSA15_FW3 0 DEZ_DW_U 0.000000 65535.000000 /end CHARACTERISTIC
/begin CHARACTERISTIC fbwEGZ1_3A "GZ1  Kerzenausfall GK 3 Defekterkennungs-Zeit" VALUE 0xF348A MSA15_FW3 0 ZEIT_ST 0.000000 655350000.000000 /end CHARACTERISTIC
/begin CHARACTERISTIC fbwEGZ1_3B "GZ1  Kerzenausfall GK 3 Intakterkennungs-Zeit" VALUE 0xF348C MSA15_FW3 0 ZEIT_ST 0.000000 655350000.000000 /end CHARACTERISTIC
/begin CHARACTERISTIC fbwEGZ1_3T "GZ1  Kerzenausfall GK 3 zeit-/ereignisgesteuert, loeschbar" VALUE 0xF348E MSA15_FW3 0 DEZ_DW_U 0.000000 65535.000000 /end CHARACTERISTIC
/begin CHARACTERISTIC fbwEGZ1_4A "GZ1  Kerzenausfall GK 4 Defekterkennungs-Zeit" VALUE 0xF3490 MSA15_FW3 0 ZEIT_ST 0.000000 655350000.000000 /end CHARACTERISTIC
/begin CHARACTERISTIC fbwEGZ1_4B "GZ1  Kerzenausfall GK 4 Intakterkennungs-Zeit" VALUE 0xF3492 MSA15_FW3 0 ZEIT_ST 0.000000 655350000.000000 /end CHARACTERISTIC
/begin CHARACTERISTIC fbwEGZ1_4T "GZ1  Kerzenausfall GK 4 zeit-/ereignisgesteuert, loeschbar" VALUE 0xF3494 MSA15_FW3 0 DEZ_DW_U 0.000000 65535.000000 /end CHARACTERISTIC
/begin CHARACTERISTIC fbwEGZ1_5A "GZ1  Kerzenausfall GK 5 Defekterkennungs-Zeit" VALUE 0xF3496 MSA15_FW3 0 ZEIT_ST 0.000000 655350000.000000 /end CHARACTERISTIC
/begin CHARACTERISTIC fbwEGZ1_5B "GZ1  Kerzenausfall GK 5 Intakterkennungs-Zeit" VALUE 0xF3498 MSA15_FW3 0 ZEIT_ST 0.000000 655350000.000000 /end CHARACTERISTIC
/begin CHARACTERISTIC fbwEGZ1_5T "GZ1  Kerzenausfall GK 5 zeit-/ereignisgesteuert, loeschbar" VALUE 0xF349A MSA15_FW3 0 DEZ_DW_U 0.000000 65535.000000 /end CHARACTERISTIC
/begin CHARACTERISTIC fbwEGZ1_6A "GZ1  Kerzenausfall GK 6 Defekterkennungs-Zeit" VALUE 0xF349C MSA15_FW3 0 ZEIT_ST 0.000000 655350000.000000 /end CHARACTERISTIC
/begin CHARACTERISTIC fbwEGZ1_6B "GZ1  Kerzenausfall GK 6 Intakterkennungs-Zeit" VALUE 0xF349E MSA15_FW3 0 ZEIT_ST 0.000000 655350000.000000 /end CHARACTERISTIC
/begin CHARACTERISTIC fbwEGZ1_6T "GZ1  Kerzenausfall GK 6 zeit-/ereignisgesteuert, loeschbar" VALUE 0xF34A0 MSA15_FW3 0 DEZ_DW_U 0.000000 65535.000000 /end CHARACTERISTIC
/begin CHARACTERISTIC fbwEGZ2_DA "GZ2  Diag-Reg-Reihenfolge  Defekterkennungs-Zeit" VALUE 0xF34AE MSA15_FW3 0 DEZ_DW_U 0.000000 65535.000000 /end CHARACTERISTIC
/begin CHARACTERISTIC fbwEGZ2_DB "GZ2  Diag-Reg-Reihenfolge  Intakterkennungs-Zeit" VALUE 0xF34B0 MSA15_FW3 0 DEZ_DW_U 0.000000 65535.000000 /end CHARACTERISTIC
/begin CHARACTERISTIC fbwEGZ2_DT "GZ2  Diag-Reg-Reihenfolge  zeit-/ereignisgesteuert, loeschbar" VALUE 0xF34B2 MSA15_FW3 0 DEZ_DW_U 0.000000 65535.000000 /end CHARACTERISTIC
/begin CHARACTERISTIC fbwEGZ2_FA "GZ2  unbekanntes EmByte  Defekterkennungs-Zeit" VALUE 0xF34B4 MSA15_FW3 0 DEZ_DW_U 0.000000 65535.000000 /end CHARACTERISTIC
/begin CHARACTERISTIC fbwEGZ2_FB "GZ2  unbekanntes EmByte  Intakterkennungs-Zeit" VALUE 0xF34B6 MSA15_FW3 0 DEZ_DW_U 0.000000 65535.000000 /end CHARACTERISTIC
/begin CHARACTERISTIC fbwEGZ2_FT "GZ2  unbekanntes EmByte  zeit-/ereignisgesteuert, loeschbar" VALUE 0xF34B8 MSA15_FW3 0 DEZ_DW_U 0.000000 65535.000000 /end CHARACTERISTIC
/begin CHARACTERISTIC fbwEGZ2_GA "GZ2  GZS defekt Defekterkennungs-Zeit" VALUE 0xF34A2 MSA15_FW3 0 ZEIT_ST 0.000000 655350000.000000 /end CHARACTERISTIC
/begin CHARACTERISTIC fbwEGZ2_GB "GZ2  GZS defekt Intakterkennungs-Zeit" VALUE 0xF34A4 MSA15_FW3 0 ZEIT_ST 0.000000 655350000.000000 /end CHARACTERISTIC
/begin CHARACTERISTIC fbwEGZ2_GT "GZ2  GZS defekt zeit-/ereignisgesteuert, loeschbar" VALUE 0xF34A6 MSA15_FW3 0 DEZ_DW_U 0.000000 65535.000000 /end CHARACTERISTIC
/begin CHARACTERISTIC fbwEGZ2_KA "GZ2  Kommunikationsfehler Defekterkennungs-Zeit" VALUE 0xF34E2 MSA15_FW3 0 ZEIT_ST 0.000000 655350000.000000 /end CHARACTERISTIC
/begin CHARACTERISTIC fbwEGZ2_KB "GZ2  Kommunikationsfehler Intakterkennungs-Zeit" VALUE 0xF34E4 MSA15_FW3 0 ZEIT_ST 0.000000 655350000.000000 /end CHARACTERISTIC
/begin CHARACTERISTIC fbwEGZ2_KT "GZ2  Kommunikationsfehler zeit-/ereignisgesteuert, loeschbar" VALUE 0xF34E6 MSA15_FW3 0 DEZ_DW_U 0.000000 65535.000000 /end CHARACTERISTIC
/begin CHARACTERISTIC fbwEGZ2_LA "GZ2  Leitungsdefekt Defekterkennungs-Zeit" VALUE 0xF34BA MSA15_FW3 0 ZEIT_ST 0.000000 655350000.000000 /end CHARACTERISTIC
/begin CHARACTERISTIC fbwEGZ2_LB "GZ2  Leitungsdefekt Intakterkennungs-Zeit" VALUE 0xF34BC MSA15_FW3 0 ZEIT_ST 0.000000 655350000.000000 /end CHARACTERISTIC
/begin CHARACTERISTIC fbwEGZ2_LT "GZ2  Leitungsdefekt zeit-/ereignisgesteuert, loeschbar" VALUE 0xF34BE MSA15_FW3 0 DEZ_DW_U 0.000000 65535.000000 /end CHARACTERISTIC
/begin CHARACTERISTIC fbwEGZ2_UA "GZ2  Ueberstrom Defekterkennungs-Zeit" VALUE 0xF34A8 MSA15_FW3 0 ZEIT_ST 0.000000 655350000.000000 /end CHARACTERISTIC
/begin CHARACTERISTIC fbwEGZ2_UB "GZ2  Ueberstrom Intakterkennungs-Zeit" VALUE 0xF34AA MSA15_FW3 0 ZEIT_ST 0.000000 655350000.000000 /end CHARACTERISTIC
/begin CHARACTERISTIC fbwEGZ2_UT "GZ2  Ueberstrom zeit-/ereignisgesteuert, loeschbar" VALUE 0xF34AC MSA15_FW3 0 DEZ_DW_U 0.000000 65535.000000 /end CHARACTERISTIC
/begin CHARACTERISTIC fbwEHGBnRA "HGB  neg. RA  Defekterkennungs-Zeit" VALUE 0xF270A MSA15_FW3 0 ZEIT_ST 0.000000 655350000.000000 /end CHARACTERISTIC
/begin CHARACTERISTIC fbwEHGBnRB "HGB  neg. RA  Intakterkennungs-Zeit" VALUE 0xF270C MSA15_FW3 0 ZEIT_ST 0.000000 655350000.000000 /end CHARACTERISTIC
/begin CHARACTERISTIC fbwEHGBnRT "HGB  neg. RA  zeit-/ereignisgesteuert, loeschbar" VALUE 0xF270E MSA15_FW3 0 DEZ_DW_U 0.000000 65535.000000 /end CHARACTERISTIC
/begin CHARACTERISTIC fbwEHRL_SA "#SSD HRL  zuspaet  Defekterkennungs-Zeit" VALUE 0xF2C46 MSA15_FW3 0 DEZ_DW_U 0.000000 65535.000000 /end CHARACTERISTIC
/begin CHARACTERISTIC fbwEHRL_SB "#SSD HRL  zuspaet  Intakterkennungs-Zeit" VALUE 0xF2C48 MSA15_FW3 0 DEZ_DW_U 0.000000 65535.000000 /end CHARACTERISTIC
/begin CHARACTERISTIC fbwEHRL_ST "HRL  zuspaet  zeit-/ereignisgesteuert, loeschbar" VALUE 0xF2C4A MSA15_FW3 0 DEZ_DW_U 0.000000 65535.000000 /end CHARACTERISTIC
/begin CHARACTERISTIC fbwEHRL_ZA "HRL  zufrueh  Defekterkennungs-Zeit" VALUE 0xF2C40 MSA15_FW3 0 DEZ_DW_U 0.000000 65535.000000 /end CHARACTERISTIC
/begin CHARACTERISTIC fbwEHRL_ZB "#SSD HRL  zufrueh  Intakterkennungs-Zeit" VALUE 0xF2C42 MSA15_FW3 0 DEZ_DW_U 0.000000 65535.000000 /end CHARACTERISTIC
/begin CHARACTERISTIC fbwEHRL_ZT "HRL  zufrueh  zeit-/ereignisgesteuert, loeschbar" VALUE 0xF2C44 MSA15_FW3 0 DEZ_DW_U 0.000000 65535.000000 /end CHARACTERISTIC
/begin CHARACTERISTIC fbwEHS11A "I11  Ueberstrom HS  Defekterkennungs-Zeit" VALUE 0xF3172 MSA15_FW3 0 ZEIT_ST 0.000000 655350000.000000 /end CHARACTERISTIC
/begin CHARACTERISTIC fbwEHS11B "I11  Ueberstrom HS  Intakterkennungs-Zeit" VALUE 0xF3174 MSA15_FW3 0 ZEIT_ST 655350000.000000 655350000.000000 EXTENDED_LIMITS 0.000000 655350000.000000 /end CHARACTERISTIC
/begin CHARACTERISTIC fbwEHS11T "I11  Ueberstrom HS  zeit-/ereignisgesteuert, loeschbar" VALUE 0xF3176 MSA15_FW3 0 DEZ_DW_U 0.000000 65535.000000 /end CHARACTERISTIC
/begin CHARACTERISTIC fbwEHS12A "I12  Ueberstrom HS  Defekterkennungs-Zeit" VALUE 0xF325A MSA15_FW3 0 ZEIT_ST 0.000000 655350000.000000 /end CHARACTERISTIC
/begin CHARACTERISTIC fbwEHS12B "I12  Ueberstrom HS  Intakterkennungs-Zeit" VALUE 0xF325C MSA15_FW3 0 ZEIT_ST 655350000.000000 655350000.000000 EXTENDED_LIMITS 0.000000 655350000.000000 /end CHARACTERISTIC
/begin CHARACTERISTIC fbwEHS12T "I12  Ueberstrom HS  zeit-/ereignisgesteuert, loeschbar" VALUE 0xF325E MSA15_FW3 0 DEZ_DW_U 0.000000 65535.000000 /end CHARACTERISTIC
/begin CHARACTERISTIC fbwEHS21A "I21  Ueberstrom HS  Defekterkennungs-Zeit" VALUE 0xF31AC MSA15_FW3 0 ZEIT_ST 0.000000 655350000.000000 /end CHARACTERISTIC
/begin CHARACTERISTIC fbwEHS21B "I21  Ueberstrom HS  Intakterkennungs-Zeit" VALUE 0xF31AE MSA15_FW3 0 ZEIT_ST 655350000.000000 655350000.000000 EXTENDED_LIMITS 0.000000 655350000.000000 /end CHARACTERISTIC
/begin CHARACTERISTIC fbwEHS21T "I21  Ueberstrom HS  zeit-/ereignisgesteuert, loeschbar" VALUE 0xF31B0 MSA15_FW3 0 DEZ_DW_U 0.000000 65535.000000 /end CHARACTERISTIC
/begin CHARACTERISTIC fbwEHS22A "I22  Ueberstrom HS  Defekterkennungs-Zeit" VALUE 0xF3294 MSA15_FW3 0 ZEIT_ST 0.000000 655350000.000000 /end CHARACTERISTIC
/begin CHARACTERISTIC fbwEHS22B "I22  Ueberstrom HS  Intakterkennungs-Zeit" VALUE 0xF3296 MSA15_FW3 0 ZEIT_ST 655350000.000000 655350000.000000 EXTENDED_LIMITS 0.000000 655350000.000000 /end CHARACTERISTIC
/begin CHARACTERISTIC fbwEHS22T "I22  Ueberstrom HS  zeit-/ereignisgesteuert, loeschbar" VALUE 0xF3298 MSA15_FW3 0 DEZ_DW_U 0.000000 65535.000000 /end CHARACTERISTIC
/begin CHARACTERISTIC fbwEHS31A "I31  Ueberstrom HS  Defekterkennungs-Zeit" VALUE 0xF31E6 MSA15_FW3 0 ZEIT_ST 0.000000 655350000.000000 /end CHARACTERISTIC
/begin CHARACTERISTIC fbwEHS31B "I31  Ueberstrom HS  Intakterkennungs-Zeit" VALUE 0xF31E8 MSA15_FW3 0 ZEIT_ST 655350000.000000 655350000.000000 EXTENDED_LIMITS 0.000000 655350000.000000 /end CHARACTERISTIC
/begin CHARACTERISTIC fbwEHS31T "I31  Ueberstrom HS  zeit-/ereignisgesteuert, loeschbar" VALUE 0xF31EA MSA15_FW3 0 DEZ_DW_U 0.000000 65535.000000 /end CHARACTERISTIC
/begin CHARACTERISTIC fbwEHS32A "I32  Ueberstrom HS  Defekterkennungs-Zeit" VALUE 0xF32CE MSA15_FW3 0 ZEIT_ST 0.000000 655350000.000000 /end CHARACTERISTIC
/begin CHARACTERISTIC fbwEHS32B "I32  Ueberstrom HS  Intakterkennungs-Zeit" VALUE 0xF32D0 MSA15_FW3 0 ZEIT_ST 655350000.000000 655350000.000000 EXTENDED_LIMITS 0.000000 655350000.000000 /end CHARACTERISTIC
/begin CHARACTERISTIC fbwEHS32T "I32  Ueberstrom HS  zeit-/ereignisgesteuert, loeschbar" VALUE 0xF32D2 MSA15_FW3 0 DEZ_DW_U 0.000000 65535.000000 /end CHARACTERISTIC
/begin CHARACTERISTIC fbwEHS41A "I41  Ueberstrom HS  Defekterkennungs-Zeit" VALUE 0xF3220 MSA15_FW3 0 ZEIT_ST 0.000000 655350000.000000 /end CHARACTERISTIC
/begin CHARACTERISTIC fbwEHS41B "I41  Ueberstrom HS  Intakterkennungs-Zeit" VALUE 0xF3222 MSA15_FW3 0 ZEIT_ST 655350000.000000 655350000.000000 EXTENDED_LIMITS 0.000000 655350000.000000 /end CHARACTERISTIC
/begin CHARACTERISTIC fbwEHS41T "I41  Ueberstrom HS  zeit-/ereignisgesteuert, loeschbar" VALUE 0xF3224 MSA15_FW3 0 DEZ_DW_U 0.000000 65535.000000 /end CHARACTERISTIC
/begin CHARACTERISTIC fbwEHS42A "I42  Ueberstrom HS  Defekterkennungs-Zeit" VALUE 0xF3308 MSA15_FW3 0 ZEIT_ST 0.000000 655350000.000000 /end CHARACTERISTIC
/begin CHARACTERISTIC fbwEHS42B "I42  Ueberstrom HS  Intakterkennungs-Zeit" VALUE 0xF330A MSA15_FW3 0 ZEIT_ST 655350000.000000 655350000.000000 EXTENDED_LIMITS 0.000000 655350000.000000 /end CHARACTERISTIC
/begin CHARACTERISTIC fbwEHS42T "I42  Ueberstrom HS  zeit-/ereignisgesteuert, loeschbar" VALUE 0xF330C MSA15_FW3 0 DEZ_DW_U 0.000000 65535.000000 /end CHARACTERISTIC
/begin CHARACTERISTIC fbwEIDV_HA "#SSD IDV oberer  SRC  Defekterkennungs-Zeit" VALUE 0xF2AB2 MSA15_FW3 0 ZEIT_ST 0.000000 655350000.000000 /end CHARACTERISTIC
/begin CHARACTERISTIC fbwEIDV_HB "#SSD IDV oberer  SRC  Intakterkennungs-Zeit" VALUE 0xF2AB4 MSA15_FW3 0 ZEIT_ST 0.000000 655350000.000000 /end CHARACTERISTIC
/begin CHARACTERISTIC fbwEIDV_HT "#SSD IDV oberer  SRC  zeit-/ereignisgesteuert, loeschbar" VALUE 0xF2AB6 MSA15_FW3 0 DEZ_DW_U 0.000000 65535.000000 /end CHARACTERISTIC
/begin CHARACTERISTIC fbwEIDV_LA "#SSD IDV unterer SRC  Defekterkennungs-Zeit" VALUE 0xF2AAC MSA15_FW3 0 ZEIT_ST 0.000000 655350000.000000 /end CHARACTERISTIC
/begin CHARACTERISTIC fbwEIDV_LB "#SSD IDV unterer SRC  Intakterkennungs-Zeit" VALUE 0xF2AAE MSA15_FW3 0 ZEIT_ST 0.000000 655350000.000000 /end CHARACTERISTIC
/begin CHARACTERISTIC fbwEIDV_LT "#SSD IDV unterer SRC  zeit-/ereignisgesteuert, loeschbar" VALUE 0xF2AB0 MSA15_FW3 0 DEZ_DW_U 0.000000 65535.000000 /end CHARACTERISTIC
/begin CHARACTERISTIC fbwEIN2_FA "INSTR2 Botschaftsausfall Defekterkennungs-Zeit" VALUE 0xF3400 MSA15_FW3 0 ZEIT_ST 0.000000 70000.000000 EXTENDED_LIMITS 0.000000 655350000.000000 /end CHARACTERISTIC
/begin CHARACTERISTIC fbwEIN2_FB "INSTR2 Botschaftsausfall Intakterkennungs-Zeit" VALUE 0xF3402 MSA15_FW3 0 ZEIT_ST 0.000000 655350000.000000 /end CHARACTERISTIC
/begin CHARACTERISTIC fbwEIN2_FT "INSTR2 Botschaftsausfall zeit-/ereignisgesteuert, loeschbar" VALUE 0xF3404 MSA15_FW3 0 DEZ_DW_U 0.000000 65535.000000 /end CHARACTERISTIC
/begin CHARACTERISTIC fbwEINS_FA "INSTR3 Botschaftsausfall Defekterkennungs-Zeit" VALUE 0xF33FA MSA15_FW3 0 ZEIT_ST 0.000000 70000.000000 EXTENDED_LIMITS 0.000000 655350000.000000 /end CHARACTERISTIC
/begin CHARACTERISTIC fbwEINS_FB "INSTR3 Botschaftsausfall Intakterkennungs-Zeit" VALUE 0xF33FC MSA15_FW3 0 ZEIT_ST 0.000000 655350000.000000 /end CHARACTERISTIC
/begin CHARACTERISTIC fbwEINS_FT "INSTR3 Botschaftsausfall zeit-/ereignisgesteuert, loeschbar" VALUE 0xF33FE MSA15_FW3 0 DEZ_DW_U 0.000000 65535.000000 /end CHARACTERISTIC
/begin CHARACTERISTIC fbwEIWZ_AA "#SSD IWZ-Ausfall Defekterkennungs-Anzahl" VALUE 0xF2778 MSA15_FW3 0 DEZ_DW_U 0.000000 65535.000000 /end CHARACTERISTIC
/begin CHARACTERISTIC fbwEIWZ_AB "#SSD IWZ-Ausfall Heilungs-Anzahl" VALUE 0xF277A MSA15_FW3 0 DEZ_DW_U 0.000000 65535.000000 /end CHARACTERISTIC
/begin CHARACTERISTIC fbwEIWZ_AT "#SSD IWZ-Ausfall Ereignissgesteuert = 0" VALUE 0xF277C MSA15_FW3 0 DEZ_DW_U 0.000000 65535.000000 /end CHARACTERISTIC
/begin CHARACTERISTIC fbwEIWZ_DA "#SSD IWZ  dynam. Plaus.  Defekterkennungs-Zeit" VALUE 0xF2760 MSA15_FW3 0 ZEIT_ST 0.000000 655350000.000000 /end CHARACTERISTIC
/begin CHARACTERISTIC fbwEIWZ_DB "IWZ  dynam. Plaus.  Intakterkennungs-Zeit" VALUE 0xF2762 MSA15_FW3 0 ZEIT_ST 0.000000 655350000.000000 /end CHARACTERISTIC
/begin CHARACTERISTIC fbwEIWZ_DT "#SSD IWZ  dynam. Plaus.  zeit-/ereignisgesteuert, loeschbar" VALUE 0xF2764 MSA15_FW3 0 DEZ_DW_U 0.000000 65535.000000 /end CHARACTERISTIC
/begin CHARACTERISTIC fbwEIWZ_KA "#SSD Korrektur He zu spaet" VALUE 0xF2772 MSA15_FW3 0 ZEIT_ST 0.000000 655350000.000000 /end CHARACTERISTIC
/begin CHARACTERISTIC fbwEIWZ_KB "#SSD Korrektur He zu spaet" VALUE 0xF2774 MSA15_FW3 0 ZEIT_ST 0.000000 655350000.000000 /end CHARACTERISTIC
/begin CHARACTERISTIC fbwEIWZ_KT "#SSD Korrektur He zu spaet" VALUE 0xF2776 MSA15_FW3 0 DEZ_DW_U 0.000000 65535.000000 /end CHARACTERISTIC
/begin CHARACTERISTIC fbwEIWZ_NA "#SSD IWZ  Nockenwellensignal Freq. zu hoch" VALUE 0xF276C MSA15_FW3 0 ZEIT_ST 0.000000 655350000.000000 /end CHARACTERISTIC
/begin CHARACTERISTIC fbwEIWZ_NB "#SSD IWZ   Nockenwellensignal Freq. zu hoch" VALUE 0xF276E MSA15_FW3 0 ZEIT_ST 0.000000 655350000.000000 /end CHARACTERISTIC
/begin CHARACTERISTIC fbwEIWZ_NT "#SSD IWZ    Nockenwellensignal Freq. zu hoch" VALUE 0xF2770 MSA15_FW3 0 DEZ_DW_U 0.000000 65535.000000 /end CHARACTERISTIC
/begin CHARACTERISTIC fbwEIWZ_SA "#SSD IWZ  stat. Plausibilitaet" VALUE 0xF2766 MSA15_FW3 0 ZEIT_ST 0.000000 655350000.000000 /end CHARACTERISTIC
/begin CHARACTERISTIC fbwEIWZ_SB "#SSD IWZ  stat. Plausibilitaet" VALUE 0xF2768 MSA15_FW3 0 ZEIT_ST 0.000000 655350000.000000 /end CHARACTERISTIC
/begin CHARACTERISTIC fbwEIWZ_ST "#SSD IWZ  stat. Plausibilitaet" VALUE 0xF276A MSA15_FW3 0 DEZ_DW_U 0.000000 65535.000000 /end CHARACTERISTIC
/begin CHARACTERISTIC fbwEK15_PA "#SSD K15  Plaus. nach Init.  Defekterkennungs-Zeit" VALUE 0xF2D1C MSA15_FW3 0 DEZ_DW_U 0.000000 65535.000000 /end CHARACTERISTIC
/begin CHARACTERISTIC fbwEK15_PB "#SSD K15  Plaus. nach Init.  Intakterkennungs-Zeit" VALUE 0xF2D1E MSA15_FW3 0 DEZ_DW_U 0.000000 65535.000000 /end CHARACTERISTIC
/begin CHARACTERISTIC fbwEK15_PT "#SSD K15  Plaus. nach Init.  zeit-/ereignisgesteuert, loeschbar" VALUE 0xF2D20 MSA15_FW3 0 DEZ_DW_U 0.000000 65535.000000 /end CHARACTERISTIC
/begin CHARACTERISTIC fbwEKAT1PA "KAT  Ueberwachung   Defekterkennungs-Zeit" VALUE 0xF3656 MSA15_FW3 0 ZEIT_ST 0.000000 655350000.000000 /end CHARACTERISTIC
/begin CHARACTERISTIC fbwEKAT1PB "KAT  Ueberwachung Intakterkennungs-Zeit" VALUE 0xF3658 MSA15_FW3 0 ZEIT_ST 0.000000 655350000.000000 /end CHARACTERISTIC
/begin CHARACTERISTIC fbwEKAT1PT "KAT Ueberwachung  zeit-/ereignisgesteuert, loeschbar" VALUE 0xF365A MSA15_FW3 0 DEZ_DW_U 0.000000 65535.000000 /end CHARACTERISTIC
/begin CHARACTERISTIC fbwEKAT2PA "KAT  Ueberwachung   Defekterkennungs-Zeit" VALUE 0xF365C MSA15_FW3 0 ZEIT_ST 0.000000 655350000.000000 /end CHARACTERISTIC
/begin CHARACTERISTIC fbwEKAT2PB "KAT  Ueberwachung Intakterkennungs-Zeit" VALUE 0xF365E MSA15_FW3 0 ZEIT_ST 0.000000 655350000.000000 /end CHARACTERISTIC
/begin CHARACTERISTIC fbwEKAT2PT "KAT Ueberwachung  zeit-/ereignisgesteuert, loeschbar" VALUE 0xF3660 MSA15_FW3 0 DEZ_DW_U 0.000000 65535.000000 /end CHARACTERISTIC
/begin CHARACTERISTIC fbwEKDF_HA "#SSD KDF  Signal oberer  SRC  Defekterkennungs-Zeit" VALUE 0xF2AE0 MSA15_FW3 0 ZEIT_ST 0.000000 655350000.000000 /end CHARACTERISTIC
/begin CHARACTERISTIC fbwEKDF_HB "#SSD KDF  Signal oberer  SRC  Intakterkennungs-Zeit" VALUE 0xF2AE2 MSA15_FW3 0 ZEIT_ST 0.000000 655350000.000000 /end CHARACTERISTIC
/begin CHARACTERISTIC fbwEKDF_HT "#SSD KDF  Signal oberer  SRC  zeit-/ereignisgesteuert, loeschbar" VALUE 0xF2AE4 MSA15_FW3 0 DEZ_DW_U 0.000000 65535.000000 /end CHARACTERISTIC
/begin CHARACTERISTIC fbwEKDF_LA "#SSD KDF  Signal unterer SRC  Defekterkennungs-Zeit" VALUE 0xF2ADA MSA15_FW3 0 ZEIT_ST 0.000000 655350000.000000 /end CHARACTERISTIC
/begin CHARACTERISTIC fbwEKDF_LB "#SSD KDF  Signal unterer SRC  Intakterkennungs-Zeit" VALUE 0xF2ADC MSA15_FW3 0 ZEIT_ST 0.000000 655350000.000000 /end CHARACTERISTIC
/begin CHARACTERISTIC fbwEKDF_LT "#SSD KDF  Signal unterer SRC  zeit-/ereignisgesteuert, loeschbar" VALUE 0xF2ADE MSA15_FW3 0 DEZ_DW_U 0.000000 65535.000000 /end CHARACTERISTIC
/begin CHARACTERISTIC fbwEKDF_PA "KDF  Plausibilitaet  Defekterkennungszeit" VALUE 0xF2AEC MSA15_FW3 0 ZEIT_ST 0.000000 655350000.000000 /end CHARACTERISTIC
/begin CHARACTERISTIC fbwEKDF_PB "KDF  Plausibilitaet  Intakterkennungszeit" VALUE 0xF2AEE MSA15_FW3 0 ZEIT_ST 0.000000 655350000.000000 /end CHARACTERISTIC
/begin CHARACTERISTIC fbwEKDF_PT "KDF  Plausibilitaet  zeit-/ereignisgesteuert, loeschbar" VALUE 0xF2AF0 MSA15_FW3 0 DEZ_DW_U 0.000000 65535.000000 /end CHARACTERISTIC
/begin CHARACTERISTIC fbwEKDF_VA "#SSD KDF  Speisespannungsfehler  Defekterkennungs-Zeit" VALUE 0xF2AE6 MSA15_FW3 0 ZEIT_ST 0.000000 655350000.000000 /end CHARACTERISTIC
/begin CHARACTERISTIC fbwEKDF_VB "#SSD KDF  Speisespannungsfehler  Intakterkennungs-Zeit" VALUE 0xF2AE8 MSA15_FW3 0 ZEIT_ST 0.000000 655350000.000000 /end CHARACTERISTIC
/begin CHARACTERISTIC fbwEKDF_VT "#SSD KDF  Speisespannungsfehler  zeit-/ereignisgesteuert, loeschbar" VALUE 0xF2AEA MSA15_FW3 0 DEZ_DW_U 0.000000 65535.000000 /end CHARACTERISTIC
/begin CHARACTERISTIC fbwEKDPF1A "#SSD KDP F1 Ueberdruck: Defekterkennungszeit" VALUE 0xF358A MSA15_FW3 0 ZEIT_ST 0.000000 655350000.000000 /end CHARACTERISTIC
/begin CHARACTERISTIC fbwEKDPF1B "#SSD KDP F1 Ueberdruck: Intakterkennungszeit" VALUE 0xF358C MSA15_FW3 0 ZEIT_ST 0.000000 655350000.000000 /end CHARACTERISTIC
/begin CHARACTERISTIC fbwEKDPF2A "#SSD KDP F2 Minimaldruck unterschritten: Defekterk.zaehler" VALUE 0xF3590 MSA15_FW3 0 DEZ_DW_U 0.000000 65535.000000 /end CHARACTERISTIC
/begin CHARACTERISTIC fbwEKDPF2B "#SSD KDP F2 Minimaldruck unterschritten: Intakterk.zaehler" VALUE 0xF3592 MSA15_FW3 0 DEZ_DW_U 0.000000 65535.000000 /end CHARACTERISTIC
/begin CHARACTERISTIC fbwEKDPF3A "#SSD KDP F3 TV DBE-Ventil zu gross: Defekterkennungszeit" VALUE 0xF3596 MSA15_FW3 0 ZEIT_ST 0.000000 655350000.000000 /end CHARACTERISTIC
/begin CHARACTERISTIC fbwEKDPF3B "#SSD KDP F3 TV DBE-Ventil zu gross: Intakterkennungszeit" VALUE 0xF3598 MSA15_FW3 0 ZEIT_ST 0.000000 655350000.000000 /end CHARACTERISTIC
/begin CHARACTERISTIC fbwEKDPF4A "#SSD KDP F4 DBE klemmt: Defekterkennungszeit" VALUE 0xF359C MSA15_FW3 0 ZEIT_ST 0.000000 655350000.000000 /end CHARACTERISTIC
/begin CHARACTERISTIC fbwEKDPF4B "#SSD KDP F4 DBE klemmt: Intakterkennungszeit" VALUE 0xF359E MSA15_FW3 0 ZEIT_ST 0.000000 655350000.000000 /end CHARACTERISTIC
/begin CHARACTERISTIC fbwEKDPF5A "#SSD KDP F5 Leckage(hoher Druck): Defekterkennungszeit" VALUE 0xF35A2 MSA15_FW3 0 ZEIT_ST 0.000000 655350000.000000 /end CHARACTERISTIC
/begin CHARACTERISTIC fbwEKDPF5B "#SSD KDP F5 Leckage(hoher Druck): Intakterkennungszeit" VALUE 0xF35A4 MSA15_FW3 0 ZEIT_ST 0.000000 655350000.000000 /end CHARACTERISTIC
/begin CHARACTERISTIC fbwEKDPF6A "#SSD KDP F6 Regelabweichung: Defekterk.zaehler" VALUE 0xF35A8 MSA15_FW3 0 DEZ_DW_U 0.000000 65535.000000 /end CHARACTERISTIC
/begin CHARACTERISTIC fbwEKDPF6B "#SSD KDP F6 Regelabweichung: Intakterk.zaehler" VALUE 0xF35AA MSA15_FW3 0 DEZ_DW_U 0.000000 65535.000000 /end CHARACTERISTIC
/begin CHARACTERISTIC fbwEKDPF7A "#SSD KDP F7 Leckage(mittlerer Druck): Defekterkennungszeit" VALUE 0xF35AE MSA15_FW3 0 ZEIT_ST 0.000000 655350000.000000 /end CHARACTERISTIC
/begin COMPU_METHOD ARD_dPWG "Uebernahme ARF Verstaerkungskoeffizient PWG-Differenzierer" RAT_FUNC "%8.5" "1/s" COEFFS 0 1.310720e+09 0.000000 0 0.000000 2000000.000000 /end COMPU_METHOD
/begin COMPU_METHOD ARF_KD "D-Koeffizient KD/T1 (ARF)" RAT_FUNC "%8.3" "(mg/Hub Luft)/(mm^3)" COEFFS 0 655.360000 0.000000 0 0.000000 102.400000 /end COMPU_METHOD
/begin COMPU_METHOD ARF_KI "I-Verstaerkung KI (ARF)" RAT_FUNC "%8.6" "%/((mg/Hub Luft)*s)" COEFFS 0 1.310720e+08 0.000000 0 0.000000 20000.000000 /end COMPU_METHOD
/begin COMPU_METHOD ARF_KP "P-Verstaerkung KP (ARF)" RAT_FUNC "%8.6" "%/(mg/Hub Luft)" COEFFS 0 6553.600000 0.000000 0 0.000000 6.400000e-01 /end COMPU_METHOD
/begin COMPU_METHOD DEZ_DB "Uebernahme von Festwerten von -128 bis 127" RAT_FUNC "%8.4" "-" COEFFS 0 1.000000 0.000000 0 0.000000 1.000000 /end COMPU_METHOD
/begin COMPU_METHOD DEZ_DB_U "Uebernahme von Festwerten von 0 bis 255" RAT_FUNC "%8.4" "-" COEFFS 0 1.000000 0.000000 0 0.000000 1.000000 /end COMPU_METHOD
/begin COMPU_METHOD DEZ_DW "Uebernahme von Festwerten von -32768 bis 32767" RAT_FUNC "%8.2" "-" COEFFS 0 1.000000 0.000000 0 0.000000 1.000000 /end COMPU_METHOD
/begin COMPU_METHOD DEZ_DW_U "Uebernahme von Festwerten von 0 bis 65535" RAT_FUNC "%8.2" "-" COEFFS 0 1.000000 0.000000 0 0.000000 1.000000 /end COMPU_METHOD
/begin COMPU_METHOD FAKT "Umrechnung fuer multiplikative Faktoren" RAT_FUNC "%8.6" "-" COEFFS 0 1.000000 0.000000 0 0.000000 1.000000e-04 /end COMPU_METHOD
/begin COMPU_METHOD FENSTER "Umrechnung des Periodendauerverhaeltnisses" RAT_FUNC "%8.6" "-" COEFFS 0 1.000000 0.000000 0 0.000000 6.103520e-05 /end COMPU_METHOD
/begin COMPU_METHOD FREQU "Umsetzung von Freuenzen fuer die GAD40-PWM-Unit" RAT_FUNC "%8.3" "Hz" COEFFS 0 0.000000 1000.000000 0 1.000000 0.000000 /end COMPU_METHOD
/begin COMPU_METHOD FREQU_5 "Umsetzung von Freuenzen fuer die GAD40-PWM-Unit" RAT_FUNC "%8.3" "Hz" COEFFS 0 -1.000000 5000.000000 0 1.000000 0.000000 /end COMPU_METHOD
/begin COMPU_METHOD GF "zeitsynchroner Gedaechtnisfaktor fuer PT1" RAT_FUNC "%8.6" "-" COEFFS 0 3.276800e+04 0.000000 0 0.000000 1.000000 /end COMPU_METHOD
/begin COMPU_METHOD IDV "Umrechnung Strom Druckregelventil" RAT_FUNC "%8.2" "mA" COEFFS 0 1.000000 0.000000 0 0.000000 1.000000 /end COMPU_METHOD
/begin COMPU_METHOD IDV_KI "I-Verstaerkung KI (Stromregler)" RAT_FUNC "%8.6" "%/(mA*s)" COEFFS 0 1.310720e+09 0.000000 0 0.000000 160000.000000 /end COMPU_METHOD
/begin COMPU_METHOD IDV_KP "P-Verstaerkung KP (Stromregler)" RAT_FUNC "%8.6" "%/(mA)" COEFFS 0 6.553600e+04 0.000000 0 0.000000 2.560000 /end COMPU_METHOD
/begin COMPU_METHOD KDF "Umrechnung Kraftstoffdruck-Fuehler Hochdruckkreis" RAT_FUNC "%7.0" "hPa" COEFFS 0 1.000000 0.000000 0 0.000000 100.000000 /end COMPU_METHOD
/begin COMPU_METHOD LMB_NORM "Berechnung der Normierung LMB aus der Zylinderzahl" RAT_FUNC "%8.2" "-" COEFFS 0 0.000000 3333.333000 0 1.000000e-01 0.000000 /end COMPU_METHOD
/begin COMPU_METHOD LMM "Umrechnung Luftmassenmesser Rohwert" RAT_FUNC "%8.4" "%" COEFFS 0 1.000000 0.000000 0 0.000000 1.000000e-02 /end COMPU_METHOD
/begin COMPU_METHOD MLS_N_DW "Motorluefterdrehzahl MLS" RAT_FUNC "%8.2" "1/min" COEFFS 0 32767.000000 0.000000 0 0.000000 3000.000000 /end COMPU_METHOD
/begin COMPU_METHOD MM3 "1 * 10E-2" RAT_FUNC "%8.4" "mm^3" COEFFS 0 1.000000 0.000000 0 0.000000 1.000000e-02 /end COMPU_METHOD
/begin COMPU_METHOD MOMENT "Umrechnung Moment" RAT_FUNC "%8.2" "Nm(bei n_Kli=800 1/m" COEFFS 0 1.000000 0.000000 0 0.000000 1.000000 /end COMPU_METHOD
/begin COMPU_METHOD M_E "Umrechnung Menge" RAT_FUNC "%8.4" "mm^3" COEFFS 0 1.000000 0.000000 0 0.000000 1.000000e-02 /end COMPU_METHOD
/begin COMPU_METHOD M_L "Umrechnung Luftmasse" RAT_FUNC "%8.3" "mg/Hub Luft" COEFFS 0 1.000000 0.000000 0 0.000000 1.000000e-01 /end COMPU_METHOD
/begin COMPU_METHOD M_Lt "Umrechnung Luftmassendurchsatz" RAT_FUNC "%8.3" "kg/h Luft" COEFFS 0 1.000000 0.000000 0 0.000000 1.000000e-01 /end COMPU_METHOD
/begin COMPU_METHOD N "Umrechnung Drehzahl" RAT_FUNC "%8.2" "1/min" COEFFS 0 1.000000 0.000000 0 0.000000 1.000000 /end COMPU_METHOD
/begin COMPU_METHOD NULL "Uebernahme von Festwert 0" RAT_FUNC "%8.5" "-" COEFFS 0 1.000000 0.000000 0 0.000000 1.000000 /end COMPU_METHOD
/begin COMPU_METHOD OELSENS "Uebernahme von Festwerten von 0 bis 2" RAT_FUNC "%8.6" "-" COEFFS 0 1.000000 0.000000 0 0.000000 1.000000 /end COMPU_METHOD
/begin COMPU_METHOD P "Umrechnung Ladedruck" RAT_FUNC "%8.2" "hPa" COEFFS 0 1.000000 0.000000 0 0.000000 1.000000 /end COMPU_METHOD
/begin COMPU_METHOD PER_VERH "Umrechnung des Periodendauerverhaeltnises" RAT_FUNC "%8.4" "-" COEFFS 0 256.000000 0.000000 0 0.000000 1.000000 /end COMPU_METHOD
/begin COMPU_METHOD PROZ "Umrechnung Tastverhaeltnis" RAT_FUNC "%8.4" "%" COEFFS 0 1.000000 0.000000 0 0.000000 1.000000e-02 /end COMPU_METHOD
/begin COMPU_METHOD PROZDT "Differenzquotient dPROZ_S/dt" RAT_FUNC "%8.2" "%/s" COEFFS 0 2.000000e-02 0.000000 0 0.000000 1.000000e-02 /end COMPU_METHOD
/begin COMPU_METHOD PROZ_S "Umrechnung Schleiferspannung in Prozent" RAT_FUNC "%8.4" "%" COEFFS 0 1.000000 0.000000 0 0.000000 1.000000e-02 /end COMPU_METHOD
/begin COMPU_METHOD R_K "Umrechnung Spez.Gaskonstante fuer HFM-Abgleich" RAT_FUNC "%8.4" "kJ/(kg*K)" COEFFS 0 120000.000000 0.000000 0 0.000000 216.000000 /end COMPU_METHOD
/begin COMPU_METHOD T "Umrechnung Temperatur" RAT_FUNC "%8.3" "Grad C" COEFFS 0 1.000000 273.140000 0 0.000000 1.000000e-01 /end COMPU_METHOD
/begin COMPU_METHOD TOUT_FA "Umrechnungsfaktor t0 in 2ms Ticks" RAT_FUNC "%8.3" "-" COEFFS 0 0.000000 2000.000000 0 1.000000 0.000000 /end COMPU_METHOD
/begin COMPU_METHOD U "Umrechnung fuer Spannungen" RAT_FUNC "%8.1" "mV" COEFFS 0 1023.000000 0.000000 0 0.000000 5000.000000 /end COMPU_METHOD
/begin COMPU_METHOD UKOR "Umrechnung UBatt Korrektur Koeff." RAT_FUNC "%8.5" "-" COEFFS 0 1.000000 0.000000 0 0.000000 1.000000e-03 /end COMPU_METHOD
/begin COMPU_METHOD U_B "Umrechnung fuer Spannungen bis zu 12V" RAT_FUNC "%8.1" "mV" COEFFS 0 1023.000000 0.000000 0 0.000000 24163.000000 /end COMPU_METHOD
/begin COMPU_METHOD U_B_DZ100 "Umrechnung f. 12-Spannungen pro Programmdurchlauf (slow)" RAT_FUNC "%7.0" "mV/s" COEFFS 0 102300000.000000 0.000000 0 0.000000 24163000000.000000 /end COMPU_METHOD
/begin COMPU_METHOD U_C "Umrechnung fuer Spannungen bis zu   V" RAT_FUNC "%7.0" "mV" COEFFS 0 4.861000e-02 0.000000 0 0.000000 1.000000 /end COMPU_METHOD
/begin COMPU_METHOD U_G "Umrechnung fuer Geberspeisespannungen der Sensoren" RAT_FUNC "%8.1" "mV" COEFFS 0 10230000.000000 0.000000 0 0.000000 180500000.000000 /end COMPU_METHOD
/begin COMPU_METHOD V "Umrechnung Geschwindigkeit" RAT_FUNC "%8.4" "km/h" COEFFS 0 1.000000 0.000000 0 0.000000 1.000000e-02 /end COMPU_METHOD
/begin COMPU_METHOD VDF "Umrechnung Kraftstoffvorfoerderdruck" RAT_FUNC "%8.2" "hPa" COEFFS 0 1.000000 0.000000 0 0.000000 1.000000 /end COMPU_METHOD
/begin COMPU_METHOD ZEIT_100 "Umrechnung Zeit 100ms Ticks" RAT_FUNC "%8.3" "s" COEFFS 0 10.000000 0.000000 0 0.000000 1.000000 /end COMPU_METHOD
/begin COMPU_METHOD ZEIT_HP "Umrechnung Timer Hauptprogramm" RAT_FUNC "%10.0" "us" COEFFS 0 1.000000 0.000000 0 0.000000 20000.000000 /end COMPU_METHOD
/begin COMPU_METHOD ZEIT_ST "Umrechnung Zeit Softwaretimer" RAT_FUNC "%9.0" "us" COEFFS 0 1.000000 0.000000 0 0.000000 10000.000000 /end COMPU_METHOD
/begin COMPU_METHOD ZEIT_ST_SS "Umrechnung Zeit Softwaretimer (Sec)" RAT_FUNC "%8.2" "s" COEFFS 0 1.000000 0.000000 0 0.000000 1.000000 /end COMPU_METHOD
/begin COMPU_METHOD ZEIT_T0 "Umrechnung Timer0" RAT_FUNC "%8.2" "us" COEFFS 0 1.000000 0.000000 0 0.000000 1.000000 /end COMPU_METHOD
/begin COMPU_METHOD ZEIT_T1 "Umrechnung Timer1" RAT_FUNC "%8.2" "us" COEFFS 0 1.000000 0.000000 0 0.000000 1.000000 /end COMPU_METHOD
/begin COMPU_METHOD ZEIT_T100 "Umrechnung der 100ms Ticks" RAT_FUNC "%10.0" "us" COEFFS 0 1.000000 0.000000 0 0.000000 100000.000000 /end COMPU_METHOD
/begin COMPU_METHOD ZEIT_T_2ms "Umrechnung Zaehler im 2ms Task" RAT_FUNC "%9.0" "us" COEFFS 0 1.000000 0.000000 0 0.000000 2000.000000 /end COMPU_METHOD
/begin COMPU_METHOD dI_dZ "Stromaenderung pro Hauptprogrammdurchlauf (IDV)" RAT_FUNC "%8.1" "mA/s" COEFFS 0 2.000000e-02 0.000000 0 0.000000 1.000000 /end COMPU_METHOD
/begin COMPU_METHOD dL_dZHP5 "Umrechnung Ladedruckdifferenz 100ms" RAT_FUNC "%8.2" "hPa/s" COEFFS 0 100000.000000 0.000000 0 0.000000 100000.000000 /end COMPU_METHOD
/begin COMPU_METHOD dM_dZHP5 "Umrechnung Mengendifferenz 100ms" RAT_FUNC "%8.4" "mm^3/s" COEFFS 0 100000.000000 0.000000 0 0.000000 1000.000000 /end COMPU_METHOD
/begin COMPU_METHOD dN "Umrechnung Drehzahloffset" RAT_FUNC "%8.2" "1/min" COEFFS 0 1.000000 0.000000 0 0.000000 1.000000 /end COMPU_METHOD
/begin COMPU_METHOD dPV_dZ100 "Vorfoerderdruckaenderung pro 100ms-Programmdurchlauf" RAT_FUNC "%8.1" "hPa/s" COEFFS 0 1.000000e-01 0.000000 0 0.000000 1.000000 /end COMPU_METHOD
/begin COMPU_METHOD dP_dZ "Ladedruckaenderung pro Hauptprogrammdurchlauf" RAT_FUNC "%7.0" "hPa/s" COEFFS 0 2.000000e-02 0.000000 0 0.000000 1.000000 /end COMPU_METHOD
/begin COMPU_METHOD dP_dZ100 "Druckaenderung pro Programmdurchlauf (slow)" RAT_FUNC "%8.1" "hPa/s" COEFFS 0 100000.000000 0.000000 0 0.000000 1000000.000000 /end COMPU_METHOD
/begin COMPU_METHOD dT "Umrechnung Temperaturdifferenz" RAT_FUNC "%8.3" "Grad C" COEFFS 0 1.000000 0.000000 0 0.000000 1.000000e-01 /end COMPU_METHOD
/begin COMPU_METHOD dT_dZ100 "Umrechnung Temperaturdifferenz" RAT_FUNC "%8.2" "Grad C/s" COEFFS 0 100000.000000 0.000000 0 0.000000 100000.000000 /end COMPU_METHOD
/begin COMPU_METHOD dT_dZHP5 "Umrechnung Temperaturdifferenz 100ms" RAT_FUNC "%8.2" "Grad C/s" COEFFS 0 100000.000000 0.000000 0 0.000000 100000.000000 /end COMPU_METHOD
/begin COMPU_METHOD dU_dZ100 "Umrechnung f. Spannungen pro Programmdurchlauf (slow)" RAT_FUNC "%7.0" "mV/s" COEFFS 0 102300000.000000 0.000000 0 0.000000 5000000000.000000 /end COMPU_METHOD
/begin COMPU_METHOD dVE_dZ "Einspritzvolumenaenderung pro Hauptprogrammdurchlauf" RAT_FUNC "%8.2" "(mm^3)/s" COEFFS 0 2.000000e-02 0.000000 0 0.000000 1.000000e-02 /end COMPU_METHOD
/begin COMPU_METHOD shift_16 "Division mit 65536" RAT_FUNC "%10.0" "-" COEFFS 0 1.000000 0.000000 0 0.000000 6.553600e+04 /end COMPU_METHOD
/end MODULE
/end PROJECT
