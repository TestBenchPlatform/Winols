ASAP2_VERSION 1 2
/begin PROJECT Z432 "430"
/begin HEADER "" VERSION "056.03" PROJECT_NO Z430 /end HEADER
/begin MODULE BMW-EASY ""
/begin MOD_COMMON "common attributes" DEPOSIT ABSOLUT BYTE_ORDER BIG_ENDIAN /end MOD_COMMON
/begin MEASUREMENT DIST_DMTL "dist_dmtl" UWORD LINEAR______0_000000__0H___65529 2 2.0 0.0 65535.0 BIT_MASK 0xffffffff FUNCTION_LIST DMTL ECU_ADDRESS 0x41a62 /end MEASUREMENT
/begin MEASUREMENT DIST_THD_THERMO "dist_thd_thermo" UWORD LINEAR______0_000000__0H___65529 2 2.0 0.0 65535.0 BIT_MASK 0xffffffff ECU_ADDRESS 0x407be /end MEASUREMENT
/begin MEASUREMENT LV_N_DYN "drehz_d_mz4" UWORD RANGE________active___1H__1H_744 2 2.0 0 65535 BIT_MASK 0x100 ECU_ADDRESS 0xfd9a /end MEASUREMENT
/begin MEASUREMENT DRV0_ER "drv0_er" SWORD LINEAR_______21845_000000__FFFF8 2 2.0 -21845.0 21844.333 BIT_MASK 0xffffffff ECU_ADDRESS 0xe262 /end MEASUREMENT
/begin MEASUREMENT DRV1_ER "drv1_er" SWORD LINEAR_______21845_000000__FFFF8 2 2.0 -21845.0 21844.333 BIT_MASK 0xffffffff ECU_ADDRESS 0xe264 /end MEASUREMENT
/begin MEASUREMENT DRV2_MMV_ER "drv2_mmv_er" SWORD LINEAR_______21845_000000__FFFF8 2 2.0 -21845.0 21844.333 BIT_MASK 0xffffffff ECU_ADDRESS 0xe266 /end MEASUREMENT
/begin MEASUREMENT DUMMY_B "dummy_b" UBYTE LINEAR______0_000000__0H___255_0 2 2.0 0.0 255.0 BIT_MASK 0xffffffff ECU_ADDRESS 0x400f8 /end MEASUREMENT
/begin MEASUREMENT DUMMY_W "dummy_w" UWORD LINEAR______0_000000__0H___65535 2 2.0 0.0 65535.0 BIT_MASK 0xffffffff ECU_ADDRESS 0x406c8 /end MEASUREMENT
/begin MEASUREMENT ECFPWM_ECF "ecfpwm_ecf" UBYTE LINEAR______0_000000__0H___99_60 2 2.0 0.0 99.609375 BIT_MASK 0xffffffff ECU_ADDRESS 0x4011c /end MEASUREMENT
/begin MEASUREMENT ECTPWM "ectpwm" UBYTE LINEAR______0_000000__0H___100_0 2 2.0 0.0 100.0 BIT_MASK 0xffffffff ECU_ADDRESS 0x40178 /end MEASUREMENT
/begin MEASUREMENT ECTPWM_TCO_I "ectpwm_tco_i" SWORD LINEAR_______50_000000__FFFF8000 2 2.0 -50.0 49.9985 BIT_MASK 0xffffffff ECU_ADDRESS 0x407c0 /end MEASUREMENT
/begin MEASUREMENT ECTPWM_TCO_P "ectpwm_tco_p" SBYTE LINEAR_______50_000000__FFFFFF80 2 2.0 -50.0 49.61 BIT_MASK 0xffffffff ECU_ADDRESS 0x4017d /end MEASUREMENT
/begin MEASUREMENT EG_CAT "eg_cat" UWORD LINEAR______0_000000__0H___0_755 2 2.0 0.0 0.99998474 BIT_MASK 0xffffffff ECU_ADDRESS 0x41130 /end MEASUREMENT
/begin MEASUREMENT EGY_DEW_DOWN "egy_dew_downvlongword" ULONG LINEAR______0_000000__0H___74756 2 2.0 0.0 7456.426 BIT_MASK 0xffffffff FUNCTION_LIST DPM ECU_ADDRESS 0x40664 /end MEASUREMENT
/begin MEASUREMENT EGY_DEW_END_DOWN "egy_dew_end_downvlongword" ULONG LINEAR______0_000000__0H___74756 2 2.0 0.0 7456.426 BIT_MASK 0xffffffff FUNCTION_LIST DPM ECU_ADDRESS 0x40668 /end MEASUREMENT
/begin MEASUREMENT EGY_DEW_END_UP "egy_dew_end_upvlongword" ULONG LINEAR______0_000000__0H___74756 2 2.0 0.0 7456.426 BIT_MASK 0xffffffff FUNCTION_LIST DPM ECU_ADDRESS 0x4066c /end MEASUREMENT
/begin MEASUREMENT EGY_DEW_STOP_DOWN "egy_dew_stop_down" UWORD LINEAR______0_000000__0H___7456_ 2 2.0 0.0 7456.426 BIT_MASK 0xffffffff FUNCTION_LIST DPM ECU_ADDRESS 0x4065e /end MEASUREMENT
/begin MEASUREMENT EGY_DEW_STOP_UP "egy_dew_stop_up" UWORD LINEAR______0_000000__0H___7456_ 2 2.0 0.0 7456.426 BIT_MASK 0xffffffff FUNCTION_LIST DPM ECU_ADDRESS 0x40660 /end MEASUREMENT
/begin MEASUREMENT EGY_DEW_UP "egy_dew_upvlongword" ULONG LINEAR______0_000000__0H___74757 2 2.0 0.0 7456.426 BIT_MASK 0xffffffff FUNCTION_LIST DPM ECU_ADDRESS 0x40670 /end MEASUREMENT
/begin MEASUREMENT ENVD_0_MON "envd_0_mon" UBYTE LINEAR______0_000000__0H___255_0 2 2.0 0.0 255.0 BIT_MASK 0xffffffff ECU_ADDRESS 0x40079 /end MEASUREMENT
/begin MEASUREMENT ENVD_1_MON "envd_1_mon" UBYTE LINEAR______0_000000__0H___255_0 2 2.0 0.0 255.0 BIT_MASK 0xffffffff ECU_ADDRESS 0x4007a /end MEASUREMENT
/begin MEASUREMENT ENVD_2_MON "envd_2_mon" UBYTE LINEAR______0_000000__0H___255_0 2 2.0 0.0 255.0 BIT_MASK 0xffffffff ECU_ADDRESS 0x4007b /end MEASUREMENT
/begin MEASUREMENT ENVD_3_MON "envd_3_mon" UBYTE LINEAR______0_000000__0H___255_0 2 2.0 0.0 255.0 BIT_MASK 0xffffffff ECU_ADDRESS 0x4007c /end MEASUREMENT
/begin MEASUREMENT ER_1 "erC0D" SWORD LINEAR_______21845_000000__FFFF8 2 2.0 -21845.0 21844.333 BIT_MASK 0xffffffff ECU_ADDRESS 0xe228 /end MEASUREMENT
/begin MEASUREMENT ER_5 "erC1D" SWORD LINEAR_______21845_000000__FFFF8 2 2.0 -21845.0 21844.333 BIT_MASK 0xffffffff ECU_ADDRESS 0xe22a /end MEASUREMENT
/begin MEASUREMENT ER_3 "erC2D" SWORD LINEAR_______21845_000000__FFFF8 2 2.0 -21845.0 21844.333 BIT_MASK 0xffffffff ECU_ADDRESS 0xe22c /end MEASUREMENT
/begin MEASUREMENT ER_6 "erC3D" SWORD LINEAR_______21845_000000__FFFF8 2 2.0 -21845.0 21844.333 BIT_MASK 0xffffffff ECU_ADDRESS 0xe22e /end MEASUREMENT
/begin MEASUREMENT ER_2 "erC4D" SWORD LINEAR_______21845_000000__FFFF8 2 2.0 -21845.0 21844.333 BIT_MASK 0xffffffff ECU_ADDRESS 0xe230 /end MEASUREMENT
/begin MEASUREMENT ER_4 "erC5D" SWORD LINEAR_______21845_000000__FFFF8 2 2.0 -21845.0 21844.333 BIT_MASK 0xffffffff ECU_ADDRESS 0xe232 /end MEASUREMENT
/begin MEASUREMENT ER_1_6 "er_1_6" SWORD LINEAR_______21845_000000__FFFF8 2 2.0 -21845.0 21844.333 BIT_MASK 0xffffffff ECU_ADDRESS 0xe234 /end MEASUREMENT
/begin MEASUREMENT ER_IGCFB_IV_SUM "er_igcfb_iv_sum" UWORD LINEAR______0_000000__0H___65758 2 2.0 0.0 655.35 BIT_MASK 0xffffffff ECU_ADDRESS 0xe268 /end MEASUREMENT
/begin MEASUREMENT ER_QUO_1 "er_quoC0D" SWORD LINEAR_______8_000000__FFFF8000H 2 2.0 -8.0 7.9998 BIT_MASK 0xffffffff ECU_ADDRESS 0x407c6 /end MEASUREMENT
/begin MEASUREMENT ER_QUO_5 "er_quoC1D" SWORD LINEAR_______8_000000__FFFF8000H 2 2.0 -8.0 7.9998 BIT_MASK 0xffffffff ECU_ADDRESS 0x407c8 /end MEASUREMENT
/begin MEASUREMENT ER_QUO_3 "er_quoC2D" SWORD LINEAR_______8_000000__FFFF8000H 2 2.0 -8.0 7.9998 BIT_MASK 0xffffffff ECU_ADDRESS 0x407ca /end MEASUREMENT
/begin MEASUREMENT ER_QUO_6 "er_quoC3D" SWORD LINEAR_______8_000000__FFFF8000H 2 2.0 -8.0 7.9998 BIT_MASK 0xffffffff ECU_ADDRESS 0x407cc /end MEASUREMENT
/begin MEASUREMENT ER_QUO_2 "er_quoC4D" SWORD LINEAR_______8_000000__FFFF8000H 2 2.0 -8.0 7.9998 BIT_MASK 0xffffffff ECU_ADDRESS 0x407ce /end MEASUREMENT
/begin MEASUREMENT ER_QUO_4 "er_quoC5D" SWORD LINEAR_______8_000000__FFFF8000H 2 2.0 -8.0 7.9998 BIT_MASK 0xffffffff ECU_ADDRESS 0x407d0 /end MEASUREMENT
/begin MEASUREMENT ERR_AMT "err_amt" UBYTE LINEAR______0_000000__0H___3_000 2 2.0 0.0 3.0 BIT_MASK 0xffffffff FUNCTION_LIST Z1S1 ECU_ADDRESS 0xfb54 /end MEASUREMENT
/begin MEASUREMENT ERR_COD_1_MC_MU "err_cod_1_mc_mu" UBYTE LINEAR______0_000000__0H___255_0 2 2.0 0.0 255.0 BIT_MASK 0xffffffff ECU_ADDRESS 0xe00e /end MEASUREMENT
/begin MEASUREMENT ERR_CODE_MU_MU "err_code_mu_mu" UBYTE LINEAR______0_000000__0H___255_0 2 2.0 0.0 255.0 BIT_MASK 0xffffffff ECU_ADDRESS 0xe7e9 /end MEASUREMENT
/begin MEASUREMENT FAC_AMP "fac_amp" UWORD LINEAR______0_000000__0H___2_054 2 2.0 0.0 2.0 BIT_MASK 0xffffffff ECU_ADDRESS 0x404a8 /end MEASUREMENT
/begin MEASUREMENT FAC_CP "fac_cp" UWORD LINEAR______0_000000__0H___0_999 2 2.0 0.0 0.99998474 BIT_MASK 0xffffffff ECU_ADDRESS 0x406ea /end MEASUREMENT
/begin MEASUREMENT FAC_CUR_DMTL "fac_cur_dmtl" UBYTE LINEAR______0_000000__0H___1_992 2 2.0 0.0 1.9921875 BIT_MASK 0xffffffff FUNCTION_LIST DMTL ECU_ADDRESS 0x4048f /end MEASUREMENT
/begin MEASUREMENT FAC_GR "fac_gr" UWORD LINEAR______0_000000__0H___255_9 2 2.0 0.0 255.9961 BIT_MASK 0xffffffff ECU_ADDRESS 0x407f8 /end MEASUREMENT
/begin MEASUREMENT FAC_GR_MMV_AV "fac_gr_mmv_avvwordC1D" UWORD LINEAR______0_000000__0H___255_9 2 2.0 0.0 255.9961 BIT_MASK 0xffffffff ECU_ADDRESS 0x40802 /end MEASUREMENT
/begin MEASUREMENT FAC_IGA_TQR "fac_iga_tqr" UWORD LINEAR______0_000000__0H___99_99 2 2.0 0.0 99.998474 BIT_MASK 0xffffffff ECU_ADDRESS 0xe02a /end MEASUREMENT
/begin MEASUREMENT FAC_IGA_TQR_POST "fac_iga_tqr_post" UWORD LINEAR______0_000000__0H___99_99 2 2.0 0.0 99.998474 BIT_MASK 0xffffffff ECU_ADDRESS 0xe04e /end MEASUREMENT
/begin MEASUREMENT FAC_IGA_TRA_GEAR "fac_iga_tra_gear" UBYTE LINEAR______0_000000__0H___0_996 2 2.0 0.0 0.99609375 BIT_MASK 0xffffffff ECU_ADDRESS 0x401c2 /end MEASUREMENT
/begin MEASUREMENT FAC_RON_AD "fac_ron_ad" UWORD LINEAR______0_000000__0H___0_999 2 2.0 0.0 0.99998474 BIT_MASK 0xffffffff ECU_ADDRESS 0xe302 /end MEASUREMENT
/begin MEASUREMENT FAC_SA "fac_sa" UWORD LINEAR______0_000000__0H___1_999 2 2.0 0.0 1.99997 BIT_MASK 0xffffffff ECU_ADDRESS 0xe13c /end MEASUREMENT
/begin MEASUREMENT FAC_TI_DIF_1 "fac_ti_dif_1" UBYTE LINEAR_______0_500000__0H___0_49 2 2.0 -0.5 0.49599999 BIT_MASK 0xffffffff FUNCTION_LIST DPM ECU_ADDRESS 0x4009e /end MEASUREMENT
/begin MEASUREMENT FAC_TI_DIF_2 "fac_ti_dif_2" UBYTE LINEAR_______0_500000__0H___0_49 2 2.0 -0.5 0.49599999 BIT_MASK 0xffffffff FUNCTION_LIST DPM ECU_ADDRESS 0x4009f /end MEASUREMENT
/begin MEASUREMENT FAC_TQD_ETCU "fac_tqd_etcu" UWORD LINEAR______0_000000__0H___99_99 2 2.0 0.0 99.998474 BIT_MASK 0xffffffff ECU_ADDRESS 0xe02e /end MEASUREMENT
/begin MEASUREMENT FAC_TQD_IGA_ASR "fac_tqd_iga_asr" UWORD LINEAR______0_000000__0H___99_99 2 2.0 0.0 99.998474 BIT_MASK 0xffffffff ECU_ADDRESS 0xe030 /end MEASUREMENT
/begin MEASUREMENT FAC_TQD_TPS "fac_tqd_tps" UWORD LINEAR______0_000000__0H___6400_ 2 2.0 0.0 6400.0 BIT_MASK 0xffffffff ECU_ADDRESS 0xe050 /end MEASUREMENT
/begin MEASUREMENT FAC_TQD_TPS_COR "fac_tqd_tps_cor" UWORD LINEAR______0_000000__0H___6400_ 2 2.0 0.0 6400.0 BIT_MASK 0xffffffff ECU_ADDRESS 0xe052 /end MEASUREMENT
/begin MEASUREMENT FAC_TQD_TPS_MAF "fac_tqd_tps_maf" UWORD LINEAR______0_000000__0H___6400_ 2 2.0 0.0 6400.0 BIT_MASK 0xffffffff ECU_ADDRESS 0xe054 /end MEASUREMENT
/begin MEASUREMENT FAC_TQD_TPS_MIN "fac_tqd_tps_min" UWORD LINEAR______0_000000__0H___6400_ 2 2.0 0.0 6400.0 BIT_MASK 0xffffffff ECU_ADDRESS 0xe056 /end MEASUREMENT
/begin MEASUREMENT FAC_TQD_TPS_TOT "fac_tqd_tps_tot" UWORD LINEAR______0_000000__0H___6400_ 2 2.0 0.0 6400.0 BIT_MASK 0xffffffff ECU_ADDRESS 0xe058 /end MEASUREMENT
/begin MEASUREMENT FAC_TQI_COR "fac_tqi_cor" UWORD LINEAR______0_000000__0H___7_999 2 2.0 0.0 7.999878 BIT_MASK 0xffffffff ECU_ADDRESS 0xe05a /end MEASUREMENT
/begin MEASUREMENT FAC_TQI_COR_IGA "fac_tqi_cor_iga" UWORD LINEAR______0_000000__0H___7_999 2 2.0 0.0 7.999878 BIT_MASK 0xffffffff ECU_ADDRESS 0xe05c /end MEASUREMENT
/begin MEASUREMENT FAC_TQR_SCC_ASR "fac_tqr_scc_asr" UWORD LINEAR______0_000000__0H___0_106 2 2.0 0.0 0.99998474 BIT_MASK 0xffffffff ECU_ADDRESS 0xe0b4 /end MEASUREMENT
/begin MEASUREMENT FAC_TQR_SCC_ASR_MMV "fac_tqr_scc_asr_mmv" UWORD LINEAR______0_000000__0H___0_106 2 2.0 0.0 0.99998474 BIT_MASK 0xffffffff ECU_ADDRESS 0xe0b6 /end MEASUREMENT
/begin MEASUREMENT FAC_TQR_SCC_ASR_MMV_TOT "fac_tqr_scc_asr_mmv_tot" UWORD LINEAR______0_000000__0H___0_106 2 2.0 0.0 0.99998474 BIT_MASK 0xffffffff ECU_ADDRESS 0xe0b8 /end MEASUREMENT
/begin MEASUREMENT FAC_VS_CTL_CRU "fac_vs_ctl_cru" UBYTE LINEAR______0_000000__0H___1_992 2 2.0 0.0 1.9921875 BIT_MASK 0xffffffff ECU_ADDRESS 0x400c0 /end MEASUREMENT
/begin MEASUREMENT FAC_VS_LGRD_CRU "fac_vs_lgrd_cru" UBYTE LINEAR______0_000000__0H___0_996 2 2.0 0.0 0.99609375 BIT_MASK 0xffffffff ECU_ADDRESS 0x400bf /end MEASUREMENT
/begin MEASUREMENT FCO "fco" UWORD LINEAR______0_000000__0H___65759 2 2.0 0.0 65535.0 BIT_MASK 0xffffffff ECU_ADDRESS 0x406dc /end MEASUREMENT
/begin MEASUREMENT FCO_AV_DMTL "fco_av_dmtl" UWORD LINEAR______0_000000__0H___4294_ 2 2.0 0.0 4294.9 BIT_MASK 0xffffffff FUNCTION_LIST DMTL ECU_ADDRESS 0x41a38 /end MEASUREMENT
/begin MEASUREMENT LV_DRI "fs" UWORD RANGE________DRI___1H__1H_______ 2 2.0 0 65535 BIT_MASK 0x100 ECU_ADDRESS 0xfd98 /end MEASUREMENT
/begin MEASUREMENT FTL "ftl" UBYTE LINEAR______0_000000__0H___126_0 2 2.0 0.0 126.0 BIT_MASK 0xffffffff ECU_ADDRESS 0x40102 /end MEASUREMENT
/begin MEASUREMENT FTL_INI "ftl_ini" UBYTE LINEAR______0_000000__0H___126_0 2 2.0 0.0 126.0 BIT_MASK 0xffffffff FUNCTION_LIST DMTL ECU_ADDRESS 0x4049b /end MEASUREMENT
/begin MEASUREMENT LV_VS_MAX_FCUT "g_beg" UWORD RANGE________G_BEG___1H__1H_____ 2 2.0 0 65535 BIT_MASK 0x4000 ECU_ADDRESS 0xfd96 /end MEASUREMENT
/begin MEASUREMENT gear "gear" UBYTE LINEAR______0_000000__0H___6_760 2 2.0 0.0 6.0 BIT_MASK 0xffffffff ECU_ADDRESS 0x401a7 /end MEASUREMENT
/begin MEASUREMENT GEAR_AJ "gear_aj" UBYTE LINEAR______0_000000__0H___6_760 2 2.0 0.0 6.0 BIT_MASK 0xffffffff ECU_ADDRESS 0x401a8 /end MEASUREMENT
/begin MEASUREMENT GEAR_EF "gear_ef" UBYTE LINEAR______0_000000__0H___6_760 2 2.0 0.0 6.0 BIT_MASK 0xffffffff ECU_ADDRESS 0x401a9 /end MEASUREMENT
/begin MEASUREMENT GEAR_INFO "gear_info" UBYTE LINEAR______0_000000__0H___7_761 2 2.0 0.0 7.0 BIT_MASK 0xffffffff ECU_ADDRESS 0x400fa /end MEASUREMENT
/begin MEASUREMENT GEAR_INFO_TXT "gear_info_txt" UBYTE GEAR_INFO 2 2.0 0 255 BIT_MASK 0x7 ECU_ADDRESS 0x400fa /end MEASUREMENT
/begin MEASUREMENT GEAR_REQ_LTC "gear_req_ltc" UBYTE LINEAR______0_000000__0H___6_760 2 2.0 0.0 6.0 BIT_MASK 0xffffffff ECU_ADDRESS 0xfb67 /end MEASUREMENT
/begin MEASUREMENT GEAR_SEL_DISP "gear_sel_disp" UBYTE LINEAR______0_000000__0H___255_0 2 2.0 0.0 255.0 BIT_MASK 0xffffffff ECU_ADDRESS 0x400fb /end MEASUREMENT
/begin MEASUREMENT GEAR_TXT "gear_txt" UBYTE GEAR_CONV 2 2.0 0 255 BIT_MASK 0x7 ECU_ADDRESS 0x401a7 /end MEASUREMENT
/begin MEASUREMENT GR_RAX_AV "gr_rax_av" UWORD LINEAR______0_000000__0H___255_9 2 2.0 0.0 255.9961 BIT_MASK 0xffffffff ECU_ADDRESS 0x407fa /end MEASUREMENT
/begin MEASUREMENT ID_LAM_TCO_MIN "id_lam_tco_min" UBYTE LINEAR_______48_000000__0H___142 2 2.0 -48.0 142.5 BIT_MASK 0xffffffff ECU_ADDRESS 0x403dd /end MEASUREMENT
/begin MEASUREMENT ID_T_WAIT_DIAG_SA "id_t_wait_diag_sa" UWORD LINEAR______0_000000__0H___1310_ 2 2.0 0.0 1310.7 BIT_MASK 0xffffffff ECU_ADDRESS 0x410d2 /end MEASUREMENT
/begin MEASUREMENT IGA_1...6 "iga_1_6" UBYTE LINEAR_______23_625000__FFH___72 2 2.0 -23.625 72.0 BIT_MASK 0xffffffff ECU_ADDRESS 0x403ac /end MEASUREMENT
/begin MEASUREMENT IGA_ADD_PSTE "iga_add_pstevbyteC1D" UBYTE LINEAR_______48_000000__0H___041 2 2.0 -48.0 0.0 BIT_MASK 0xffffffff ECU_ADDRESS 0x4081b /end MEASUREMENT
/begin MEASUREMENT IGA_AJ "iga_aj" SBYTE LINEAR_______48_000000__FFFFFF80 2 2.0 -48.0 47.625 BIT_MASK 0xffffffff ECU_ADDRESS 0x400db /end MEASUREMENT
/begin MEASUREMENT IGA_AJ_COR "iga_aj_cor" SBYTE LINEAR_______48_000000__FFFFFF80 2 2.0 -48.0 47.625 BIT_MASK 0xffffffff ECU_ADDRESS 0x400dc /end MEASUREMENT
/begin MEASUREMENT IGA_ASR "iga_asr" UBYTE LINEAR_______23_625000__0H___72_ 2 2.0 -23.625 72.0 BIT_MASK 0xffffffff ECU_ADDRESS 0x40020 /end MEASUREMENT
/begin MEASUREMENT IGA_CH "iga_ch" UBYTE LINEAR_______48_000000__0H___47_ 2 2.0 -48.0 47.625 BIT_MASK 0xffffffff ECU_ADDRESS 0x40480 /end MEASUREMENT
/begin MEASUREMENT IGA_CH_2 "iga_ch_2" UBYTE LINEAR_______48_000000__0H___47_ 2 2.0 -48.0 47.625 BIT_MASK 0xffffffff ECU_ADDRESS 0x40481 /end MEASUREMENT
/begin MEASUREMENT IGA_CH_3 "iga_ch_3vbyteC1D" UBYTE LINEAR_______48_000000__0H___47_ 2 2.0 -48.0 47.625 BIT_MASK 0xffffffff ECU_ADDRESS 0xe379 /end MEASUREMENT
/begin MEASUREMENT IGA_CH_OFS "iga_ch_ofsvbyteC1D" UBYTE LINEAR_______48_000000__0H___47_ 2 2.0 -48.0 47.625 BIT_MASK 0xffffffff ECU_ADDRESS 0xe2a9 /end MEASUREMENT
/begin MEASUREMENT IGA_CS_IS "iga_cs_is" UWORD LINEAR_______48_000000__0H___762 2 2.0 -48.0 0.0 BIT_MASK 0xffffffff ECU_ADDRESS 0x40810 /end MEASUREMENT
/begin MEASUREMENT IGA_CYCNR_TRA_KNK "iga_cycnr_tra_knk" UBYTE LINEAR______0_000000__0H___255_4 2 2.0 0.0 255.0 BIT_MASK 0xffffffff ECU_ADDRESS 0x401cc /end MEASUREMENT
/begin MEASUREMENT IGA_DIF_1 "iga_dif_1" UBYTE LINEAR______0_000000__0H___95_22 2 2.0 0.0 95.625 BIT_MASK 0xffffffff ECU_ADDRESS 0x40214 /end MEASUREMENT
/begin MEASUREMENT IGA_DIF_2 "iga_dif_2" UBYTE LINEAR______0_000000__0H___95_22 2 2.0 0.0 95.625 BIT_MASK 0xffffffff ECU_ADDRESS 0x40215 /end MEASUREMENT
/begin MEASUREMENT IGA_EGR_MON2 "iga_egr_mon2" UBYTE LINEAR_______48_000000__0H___47_ 2 2.0 -48.0 47.625 BIT_MASK 0xffffffff FUNCTION_LIST MON2 ECU_ADDRESS 0x4006d /end MEASUREMENT
/begin MEASUREMENT IGA_END_MW_KNK "iga_end_mw_knk" UBYTE LINEAR_______23_625000__0H___72_ 2 2.0 -23.625 72.0 BIT_MASK 0xffffffff ECU_ADDRESS 0x401b9 /end MEASUREMENT
/begin MEASUREMENT IGA_1 "iga_igcC0D" UBYTE LINEAR_______23_625000__FFH___72 2 2.0 -23.625 72.0 BIT_MASK 0xffffffff ECU_ADDRESS 0xfbab /end MEASUREMENT
/begin MEASUREMENT IGA_5 "iga_igcC1D" UBYTE LINEAR_______23_625000__FFH___72 2 2.0 -23.625 72.0 BIT_MASK 0xffffffff ECU_ADDRESS 0xfbac /end MEASUREMENT
/begin MEASUREMENT IGA_3 "iga_igcC2D" UBYTE LINEAR_______23_625000__FFH___72 2 2.0 -23.625 72.0 BIT_MASK 0xffffffff ECU_ADDRESS 0xfbad /end MEASUREMENT
/begin MEASUREMENT IGA_6 "iga_igcC3D" UBYTE LINEAR_______23_625000__FFH___72 2 2.0 -23.625 72.0 BIT_MASK 0xffffffff ECU_ADDRESS 0xfbae /end MEASUREMENT
/begin MEASUREMENT IGA_2 "iga_igcC4D" UBYTE LINEAR_______23_625000__FFH___72 2 2.0 -23.625 72.0 BIT_MASK 0xffffffff ECU_ADDRESS 0xfbaf /end MEASUREMENT
/begin MEASUREMENT IGA_4 "iga_igcC5D" UBYTE LINEAR_______23_625000__FFH___72 2 2.0 -23.625 72.0 BIT_MASK 0xffffffff ECU_ADDRESS 0xfbb0 /end MEASUREMENT
/begin MEASUREMENT IGA_IGC_MON2 "iga_igc_mon2" UBYTE LINEAR_______23_625000__0H___72_ 2 2.0 -23.625 72.0 BIT_MASK 0xffffffff FUNCTION_LIST MON2 ECU_ADDRESS 0x4006c /end MEASUREMENT
/begin MEASUREMENT IGA_ISAPWM_LGRD "iga_isapwm_lgrdvbyteC1D" UBYTE LINEAR_______48_000000__0H___041 2 2.0 -48.0 0.0 BIT_MASK 0xffffffff ECU_ADDRESS 0x40819 /end MEASUREMENT
/begin MEASUREMENT IGA_KNK_1 "iga_knkC0D" UBYTE LINEAR_______48_000000__0H___107 2 2.0 -48.0 0.0 BIT_MASK 0xffffffff ECU_ADDRESS 0x40399 /end MEASUREMENT
/begin MEASUREMENT IGA_KNK_5 "iga_knkC1D" UBYTE LINEAR_______48_000000__0H___107 2 2.0 -48.0 0.0 BIT_MASK 0xffffffff ECU_ADDRESS 0x4039a /end MEASUREMENT
/begin MEASUREMENT IGA_KNK_3 "iga_knkC2D" UBYTE LINEAR_______48_000000__0H___107 2 2.0 -48.0 0.0 BIT_MASK 0xffffffff ECU_ADDRESS 0x4039b /end MEASUREMENT
/begin MEASUREMENT IGA_KNK_6 "iga_knkC3D" UBYTE LINEAR_______48_000000__0H___107 2 2.0 -48.0 0.0 BIT_MASK 0xffffffff ECU_ADDRESS 0x4039c /end MEASUREMENT
/begin MEASUREMENT IGA_KNK_2 "iga_knkC4D" UBYTE LINEAR_______48_000000__0H___107 2 2.0 -48.0 0.0 BIT_MASK 0xffffffff ECU_ADDRESS 0x4039d /end MEASUREMENT
/begin MEASUREMENT IGA_KNK_4 "iga_knkC5D" UBYTE LINEAR_______48_000000__0H___107 2 2.0 -48.0 0.0 BIT_MASK 0xffffffff ECU_ADDRESS 0x4039e /end MEASUREMENT
/begin MEASUREMENT IGA_KNK_1_6 "iga_knk_1_6" UBYTE LINEAR_______48_000000__0H___041 2 2.0 -48.0 0.0 BIT_MASK 0xffffffff ECU_ADDRESS 0xfb6e /end MEASUREMENT
/begin MEASUREMENT IGA_KNK_LIH "iga_knk_lih" UBYTE LINEAR_______23_625000__0H___72_ 2 2.0 -23.625 72.0 BIT_MASK 0xffffffff ECU_ADDRESS 0x403b9 /end MEASUREMENT
/begin MEASUREMENT IGA_MV_1 "iga_mv_1" UBYTE LINEAR_______23_625000__0H___72_ 2 2.0 -23.625 72.0 BIT_MASK 0xffffffff ECU_ADDRESS 0x403ca /end MEASUREMENT
/begin MEASUREMENT IGA_MV_12 "iga_mv_12" UBYTE LINEAR_______23_625000__0H___72_ 2 2.0 -23.625 72.0 BIT_MASK 0xffffffff ECU_ADDRESS 0x403ab /end MEASUREMENT
/begin MEASUREMENT IGA_MV_2 "iga_mv_2" UBYTE LINEAR_______23_625000__0H___72_ 2 2.0 -23.625 72.0 BIT_MASK 0xffffffff ECU_ADDRESS 0x403cb /end MEASUREMENT
/begin MEASUREMENT IGA_MV_KNK "iga_mv_knk" UBYTE LINEAR_______48_000000__0H___47_ 2 2.0 -48.0 47.625 BIT_MASK 0xffffffff ECU_ADDRESS 0x40216 /end MEASUREMENT
/begin MEASUREMENT IGA_OFS_MAX_IS "iga_ofs_max_is" UBYTE LINEAR_______48_000000__0H___47_ 2 2.0 -48.0 47.625 BIT_MASK 0xffffffff ECU_ADDRESS 0x401be /end MEASUREMENT
/begin MEASUREMENT IGA_OFS_MAX_IS_LGRD "iga_ofs_max_is_lgrdvbyteC1D" UBYTE LINEAR_______48_000000__0H___47_ 2 2.0 -48.0 47.625 BIT_MASK 0xffffffff ECU_ADDRESS 0xe2ab /end MEASUREMENT
/begin MEASUREMENT IGA_OPTM "iga_optm" UBYTE LINEAR_______23_625000__0H___72_ 2 2.0 -23.625 72.0 BIT_MASK 0xffffffff ECU_ADDRESS 0x40025 /end MEASUREMENT
/begin MEASUREMENT IGA_TIA_TCO "iga_tia_tco" UBYTE LINEAR_______48_000000__0H___47_ 2 2.0 -48.0 47.625 BIT_MASK 0xffffffff ECU_ADDRESS 0x401c8 /end MEASUREMENT
/begin MEASUREMENT IGA_TIA_TCO_IS "iga_tia_tco_is" UBYTE LINEAR_______48_000000__0H___47_ 2 2.0 -48.0 47.625 BIT_MASK 0xffffffff ECU_ADDRESS 0x401c9 /end MEASUREMENT
/begin MEASUREMENT IGA_TOT_OFS "iga_tot_ofs" UBYTE LINEAR_______23_625000__0H___72_ 2 2.0 -23.625 72.0 BIT_MASK 0xffffffff ECU_ADDRESS 0x401c4 /end MEASUREMENT
/begin MEASUREMENT IGA_TOT_OFS_LGRD "iga_tot_ofs_lgrdvbyteC1D" UBYTE LINEAR_______23_625000__0H___72_ 2 2.0 -23.625 72.0 BIT_MASK 0xffffffff ECU_ADDRESS 0xe2b7 /end MEASUREMENT
/begin MEASUREMENT IGA_TRA_KNK "iga_tra_knk" UBYTE LINEAR_______48_000000__0H___47_ 2 2.0 -48.0 47.625 BIT_MASK 0xffffffff ECU_ADDRESS 0x40217 /end MEASUREMENT
/begin MEASUREMENT IGAB_IVVT "igab_ivvt" UBYTE LINEAR_______23_625000__0H___72_ 2 2.0 -23.625 72.0 BIT_MASK 0xffffffff ECU_ADDRESS 0x401cb /end MEASUREMENT
/begin MEASUREMENT IM_P3 "im_P3" UWORD LINEAR______0_000000__0H___65763 2 2.0 0.0 65535.0 BIT_MASK 0xffffffff ECU_ADDRESS 0xfdd0 /end MEASUREMENT
/begin MEASUREMENT INF_REAC "inf_reac" UWORD RANGE_____00000010 2 2.0 0 65535 BIT_MASK 0x1800 ECU_ADDRESS 0xfd96 /end MEASUREMENT
/begin MEASUREMENT EV_ABSCHALTEN "inh_iv" UWORD LINEAR______0_000000__0H___65535 2 2.0 0.0 65535.0 BIT_MASK 0xffffffff ECU_ADDRESS 0xfb9a /end MEASUREMENT
/begin MEASUREMENT INH_SWI_IV "inh_swi_iv" UWORD LINEAR______0_000000__0H___65535 2 2.0 0.0 65535.0 BIT_MASK 0xffffffff ECU_ADDRESS 0xe474 /end MEASUREMENT
/begin MEASUREMENT IP_THD_ER "ip_thd_er" UWORD LINEAR_______1_000000__1H____218 2 2.0 -21844.0 -1.0 BIT_MASK 0xffffffff ECU_ADDRESS 0xe282 /end MEASUREMENT
/begin MEASUREMENT ISAPWM "isapwm" UWORD LINEAR______0_000000__0H___99_99 2 2.0 0.0 99.998474 BIT_MASK 0xffffffff ECU_ADDRESS 0x4083c /end MEASUREMENT
/begin MEASUREMENT ISAPWM_ACCIN_AD_MMV_IS "isapwm_accin_ad_mmv_is" SWORD LINEAR_______50_000000__FFFF8000 2 2.0 -50.0 49.9985 BIT_MASK 0xffffffff ECU_ADDRESS 0x40862 /end MEASUREMENT
/begin MEASUREMENT ISAPWM_AD "isapwm_ad" SWORD LINEAR_______200_000000__FFFF111 2 2.0 -200.0 199.9938 BIT_MASK 0xffffffff ECU_ADDRESS 0x4084e /end MEASUREMENT
/begin MEASUREMENT ISAPWM_AD_COR_IS "isapwm_ad_cor_is" SWORD LINEAR_______50_000000__FFFF8000 2 2.0 -50.0 49.9985 BIT_MASK 0xffffffff ECU_ADDRESS 0x40852 /end MEASUREMENT
/begin MEASUREMENT ISAPWM_AD_IS "isapwm_ad_is" SWORD LINEAR_______50_000000__FFFF8000 2 2.0 -50.0 49.9985 BIT_MASK 0xffffffff ECU_ADDRESS 0x40854 /end MEASUREMENT
/begin MEASUREMENT ISAPWM_AD_MMV_IS "isapwm_ad_mmv_is" SWORD LINEAR_______50_000000__FFFF8000 2 2.0 -50.0 49.9985 BIT_MASK 0xffffffff ECU_ADDRESS 0x40850 /end MEASUREMENT
/begin MEASUREMENT ISAPWM_ADD_PSTE "isapwm_add_pste" UWORD LINEAR______0_000000__0H___399_9 2 2.0 0.0 399.9938 BIT_MASK 0xffffffff ECU_ADDRESS 0x4089c /end MEASUREMENT
/begin MEASUREMENT ISAPWM_AMT "isapwm_amt" SWORD LINEAR_______200_000000__FFFF764 2 2.0 -200.0 199.9938 BIT_MASK 0xffffffff ECU_ADDRESS 0x40864 /end MEASUREMENT
/begin MEASUREMENT ISAPWM_D_IS "isapwm_d_is" SWORD LINEAR_______50_000000__FFFF8000 2 2.0 -50.0 49.9985 BIT_MASK 0xffffffff ECU_ADDRESS 0x40858 /end MEASUREMENT
/begin MEASUREMENT ISAPWM_DIF "isapwm_dif" UWORD LINEAR______0_000000__0H___99_99 2 2.0 0.0 99.998474 BIT_MASK 0xffffffff ECU_ADDRESS 0x40870 /end MEASUREMENT
/begin MEASUREMENT ISAPWM_DRI_AD_MMV_IS "isapwm_dri_ad_mmv_is" SWORD LINEAR_______50_000000__FFFF8000 2 2.0 -50.0 49.9985 BIT_MASK 0xffffffff ECU_ADDRESS 0x4085a /end MEASUREMENT
/begin MEASUREMENT ISAPWM_IS "isapwm_is" SWORD LINEAR_______50_000000__FFFF8000 2 2.0 -50.0 49.9985 BIT_MASK 0xffffffff ECU_ADDRESS 0x40856 /end MEASUREMENT
/begin MEASUREMENT ISAPWM_ISA "isapwm_isa" UWORD LINEAR______0_000000__0H___99_99 2 2.0 0.0 99.998474 BIT_MASK 0xffffffff ECU_ADDRESS 0x40830 /end MEASUREMENT
/begin MEASUREMENT ISAPWM_LOAD "isapwm_load" UWORD LINEAR______0_000000__0H___399_9 2 2.0 0.0 399.9938 BIT_MASK 0xffffffff ECU_ADDRESS 0x40876 /end MEASUREMENT
/begin MEASUREMENT ISAPWM_LOAD_1 "isapwm_load_1" UWORD LINEAR______0_000000__0H___399_9 2 2.0 0.0 399.9938 BIT_MASK 0xffffffff ECU_ADDRESS 0x40872 /end MEASUREMENT
/begin MEASUREMENT ISAPWM_LOAD_ACCIN "isapwm_load_accin" UWORD LINEAR______0_000000__0H___399_9 2 2.0 0.0 399.9938 BIT_MASK 0xffffffff ECU_ADDRESS 0x4087a /end MEASUREMENT
/begin MEASUREMENT ISAPWM_LOAD_ACCIN_STAT "isapwm_load_accin_stat" UWORD LINEAR______0_000000__0H___399_9 2 2.0 0.0 399.9938 BIT_MASK 0xffffffff ECU_ADDRESS 0x4087c /end MEASUREMENT
/begin MEASUREMENT ISAPWM_LOAD_ACCIN_TRA "isapwm_load_accin_tra" SWORD LINEAR_______200_000000__FFFF111 2 2.0 -200.0 199.9938 BIT_MASK 0xffffffff ECU_ADDRESS 0x4088c /end MEASUREMENT
/begin MEASUREMENT ISAPWM_LOAD_ACCIN_WOUT_1 "isapwm_load_accin_wout_1" UWORD LINEAR______0_000000__0H___399_9 2 2.0 0.0 399.9938 BIT_MASK 0xffffffff ECU_ADDRESS 0x4087e /end MEASUREMENT
/begin MEASUREMENT ISAPWM_LOAD_LGRD "isapwm_load_lgrd" SWORD LINEAR_______200_000000__FFFF111 2 2.0 -200.0 199.9938 BIT_MASK 0xffffffff ECU_ADDRESS 0x4088a /end MEASUREMENT
/begin MEASUREMENT ISAPWM_LOAD_PQ_COR "isapwm_load_pq_cor" UWORD LINEAR______0_000000__0H___399_9 2 2.0 0.0 399.9938 BIT_MASK 0xffffffff ECU_ADDRESS 0x40878 /end MEASUREMENT
/begin MEASUREMENT ISAPWM_LOAD_TOT "isapwm_load_tot" UWORD LINEAR______0_000000__0H___399_9 2 2.0 0.0 399.9938 BIT_MASK 0xffffffff ECU_ADDRESS 0x40874 /end MEASUREMENT
/begin MEASUREMENT ISAPWM_MMV_DIAGCPS "isapwm_mmv_diagcps" UWORD LINEAR______0_000000__0H___99_99 2 2.0 0.0 99.998474 BIT_MASK 0xffffffff ECU_ADDRESS 0x408a0 /end MEASUREMENT
/begin MEASUREMENT ISAPWM_MMV_IS "isapwm_mmv_is" SWORD LINEAR_______50_000000__FFFF8000 2 2.0 -50.0 49.9985 BIT_MASK 0xffffffff ECU_ADDRESS 0x4085c /end MEASUREMENT
/begin MEASUREMENT ISAPWM_P_IS "isapwm_p_is" SWORD LINEAR_______50_000000__FFFF8000 2 2.0 -50.0 49.9985 BIT_MASK 0xffffffff ECU_ADDRESS 0x4085e /end MEASUREMENT
/begin MEASUREMENT ISAPWM_PVS_ADD_LOW_N "isapwm_pvs_add_low_n" UWORD LINEAR______0_000000__0H___99_99 2 2.0 0.0 99.998474 BIT_MASK 0xffffffff FUNCTION_LIST Z10I ECU_ADDRESS 0xe198 /end MEASUREMENT
/begin MEASUREMENT ISAPWM_SP_ST "isapwm_sp_st" UWORD LINEAR______0_000000__0H___99_99 2 2.0 0.0 99.998474 BIT_MASK 0xffffffff ECU_ADDRESS 0x40880 /end MEASUREMENT
/begin MEASUREMENT ISAPWM_TPS "isapwm_tps" UWORD LINEAR______0_000000__0H___99_99 2 2.0 0.0 99.998474 BIT_MASK 0xffffffff ECU_ADDRESS 0x4086e /end MEASUREMENT
/begin MEASUREMENT IV_OFF_COUNT_ER_1 "iv_off_ctr_erC0D" UBYTE LINEAR______0_000000__0H___255_0 2 2.0 0.0 255.0 BIT_MASK 0xffffffff ECU_ADDRESS 0x40187 /end MEASUREMENT
/begin MEASUREMENT IV_OFF_COUNT_ER_5 "iv_off_ctr_erC1D" UBYTE LINEAR______0_000000__0H___255_0 2 2.0 0.0 255.0 BIT_MASK 0xffffffff ECU_ADDRESS 0x40188 /end MEASUREMENT
/begin MEASUREMENT IV_OFF_COUNT_ER_3 "iv_off_ctr_erC2D" UBYTE LINEAR______0_000000__0H___255_0 2 2.0 0.0 255.0 BIT_MASK 0xffffffff ECU_ADDRESS 0x40189 /end MEASUREMENT
/begin MEASUREMENT IV_OFF_COUNT_ER_6 "iv_off_ctr_erC3D" UBYTE LINEAR______0_000000__0H___255_0 2 2.0 0.0 255.0 BIT_MASK 0xffffffff ECU_ADDRESS 0x4018a /end MEASUREMENT
/begin MEASUREMENT IV_OFF_COUNT_ER_2 "iv_off_ctr_erC4D" UBYTE LINEAR______0_000000__0H___255_0 2 2.0 0.0 255.0 BIT_MASK 0xffffffff ECU_ADDRESS 0x4018b /end MEASUREMENT
/begin MEASUREMENT IV_OFF_COUNT_ER_4 "iv_off_ctr_erC5D" UBYTE LINEAR______0_000000__0H___255_0 2 2.0 0.0 255.0 BIT_MASK 0xffffffff ECU_ADDRESS 0x4018c /end MEASUREMENT
/begin MEASUREMENT IVVT_EX_FLAGS "ivvt_ex_flags" UWORD LINEAR______0_000000__0H___65535 2 2.0 0.0 65535.0 BIT_MASK 0xffffffff ECU_ADDRESS 0xfda0 /end MEASUREMENT
/begin MEASUREMENT CAM_SP_ADD_IN_CH_2_IS "ivvt_ivpos_ofs_ch2" SBYTE LINEAR_______48_000000__FFFFFF80 2 2.0 -48.0 47.625 BIT_MASK 0xffffffff ECU_ADDRESS 0x40a61 /end MEASUREMENT
/begin MEASUREMENT CAM_AD_IN "ivvt_ivcam_advbyteC1D" SBYTE LINEAR_______48_000000__FFFFFF80 2 2.0 -48.0 47.625 BIT_MASK 0xffffffff ECU_ADDRESS 0x4091f /end MEASUREMENT
/begin MEASUREMENT CAM_AV_IN "ivvt_ivcam_av" UBYTE LINEAR______60_000000__0H___155_ 2 2.0 60.0 155.625 BIT_MASK 0xffffffff ECU_ADDRESS 0x40940 /end MEASUREMENT
/begin MEASUREMENT CAM_AV_IN_RAW "ivvt_ivcam_av_raw" UBYTE LINEAR______60_000000__0H___1765 2 2.0 60.0 155.625 BIT_MASK 0xffffffff ECU_ADDRESS 0x40941 /end MEASUREMENT
/begin MEASUREMENT CAM_CLC_IN "ivvt_ivcam_clcvbyteC1D" UBYTE LINEAR______60_000000__0H___1766 2 2.0 60.0 155.625 BIT_MASK 0xffffffff ECU_ADDRESS 0x40923 /end MEASUREMENT
/begin MEASUREMENT CAM_CLC_WOUT_DLY_IN "ivvt_ivcam_clc_wout_dlyvbyteC1D" UBYTE LINEAR______60_000000__0H___1766 2 2.0 60.0 155.625 BIT_MASK 0xffffffff ECU_ADDRESS 0x40921 /end MEASUREMENT
/begin MEASUREMENT CAM_DIF_IN "ivvt_ivcam_dif" SBYTE LINEAR_______48_000000__FFFFFF80 2 2.0 -48.0 47.625 BIT_MASK 0xffffffff ECU_ADDRESS 0x40a5f /end MEASUREMENT
/begin MEASUREMENT CAM_DIF_CTL_IN "ivvt_ivcam_dif_ctl" SBYTE LINEAR_______48_000000__FFFFFF80 2 2.0 -48.0 47.625 BIT_MASK 0xffffffff ECU_ADDRESS 0x40a5e /end MEASUREMENT
/begin MEASUREMENT CAM_SP_IN "ivvt_ivcam_sp" UBYTE LINEAR______60_000000__0H___1767 2 2.0 60.0 155.625 BIT_MASK 0xffffffff ECU_ADDRESS 0x4093e /end MEASUREMENT
/begin MEASUREMENT CAM_SP_DIF_IN "ivvt_ivcam_sp_dif" SBYTE LINEAR_______48_000000__FFFFFF80 2 2.0 -48.0 47.625 BIT_MASK 0xffffffff ECU_ADDRESS 0x40a60 /end MEASUREMENT
/begin MEASUREMENT DLY_IVVT_IN "ivvt_ivdly" UBYTE LINEAR______0_000000__0H___2550_ 2 2.0 0.0 2550.0 BIT_MASK 0xffffffff ECU_ADDRESS 0x40935 /end MEASUREMENT
/begin MEASUREMENT TOTZ_VANOS_GEM_E "ivvt_ivdly_mes" UBYTE LINEAR______0_000000__0H___2550_ 2 2.0 0.0 2550.0 BIT_MASK 0xffffffff ECU_ADDRESS 0x40936 /end MEASUREMENT
/begin MEASUREMENT IVVT_DLY_VALVE_IN "ivvt_ivdly_valve" SWORD LINEAR_______20480_00000__FFFF80 2 2.0 -20480.0 20479.375 BIT_MASK 0xffffffff ECU_ADDRESS 0x4092e /end MEASUREMENT
/begin MEASUREMENT IVVTPWM_IN "ivvt_ivpwm_vb" UBYTE LINEAR______0_000000__0H___99_60 2 2.0 0.0 99.609375 BIT_MASK 0xffffffff ECU_ADDRESS 0x40a47 /end MEASUREMENT
/begin MEASUREMENT LV_IVVT_STATE_ACT_IN "ivvt_ivstate_act" UBYTE RVANOS_STATE_ACTIVE_RANGE 2 2.0 0 255 BIT_MASK 0xffffffff ECU_ADDRESS 0x40934 /end MEASUREMENT
/begin MEASUREMENT T_IVVT_IN "ivvt_ivt" SWORD LINEAR_______20480_00000__FFF768 2 2.0 -20480.0 20479.375 BIT_MASK 0xffffffff ECU_ADDRESS 0x4092c /end MEASUREMENT
/begin MEASUREMENT T_ADD_MIN_ADH_IN "ivvt_ivt_add_min_adh" UBYTE LINEAR______0_000000__0H___159_3 2 2.0 0.0 159.375 BIT_MASK 0xffffffff ECU_ADDRESS 0x40a5d /end MEASUREMENT
/begin MEASUREMENT T_CTL_IVVT_IN "ivvt_ivt_ctl" SWORD LINEAR_______20480_00000__FFFF80 2 2.0 -20480.0 20479.375 BIT_MASK 0xffffffff ECU_ADDRESS 0x4092a /end MEASUREMENT
/begin MEASUREMENT T_CTL_IVVT_I_IN "ivvt_ivt_ctl_i" SWORD LINEAR_______20480_00000__FFFF80 2 2.0 -20480.0 20479.375 BIT_MASK 0xffffffff ECU_ADDRESS 0x40930 /end MEASUREMENT
/begin MEASUREMENT T_SUM_IVVT_IN "ivvt_ivt_sum" SWORD LINEAR_______20480_00000__FFFF80 2 2.0 -20480.0 20479.375 BIT_MASK 0xffffffff ECU_ADDRESS 0x40928 /end MEASUREMENT
/begin MEASUREMENT VEL_DRIFT_IVVTHPWM_IN "ivvt_ivvel_drift_hpwm_in" SWORD LINEAR_______95_625000__FFFFF769 2 2.0 -96.25 96.25 BIT_MASK 0xffffffff ECU_ADDRESS 0x40924 /end MEASUREMENT
/begin MEASUREMENT IVVT_IN_FLAGS "ivvt_in_flags" UWORD LINEAR______0_000000__0H___65535 2 2.0 0.0 65535.0 BIT_MASK 0xffffffff ECU_ADDRESS 0xfd9e /end MEASUREMENT
/begin MEASUREMENT CAM_SP_ADD_EX_CH_2_IS "ivvt_ovpos_ofs_ch2" SBYTE LINEAR_______48_000000__FFFFFF80 2 2.0 -48.0 47.625 BIT_MASK 0xffffffff ECU_ADDRESS 0x40bcf /end MEASUREMENT
/begin MEASUREMENT CAM_AD_EX "ivvt_ovcam_advbyteC1D" SBYTE LINEAR_______48_000000__FFFFFF80 2 2.0 -48.0 47.625 BIT_MASK 0xffffffff ECU_ADDRESS 0x40a8d /end MEASUREMENT
/begin MEASUREMENT CAM_AV_EX "ivvt_ovcam_av" UBYTE LINEAR_______155_625000__FFH____ 2 2.0 -155.625 -60.0 BIT_MASK 0xffffffff ECU_ADDRESS 0x40aae /end MEASUREMENT
/begin MEASUREMENT CAM_AV_EX_RAW "ivvt_ovcam_av_raw" UBYTE LINEAR_______155_625000__FFH____ 2 2.0 -155.625 -60.0 BIT_MASK 0xffffffff ECU_ADDRESS 0x40aaf /end MEASUREMENT
/begin MEASUREMENT CAM_CLC_EX "ivvt_ovcam_clcvbyteC1D" UBYTE LINEAR_______155_625000__FFH____ 2 2.0 -155.625 -60.0 BIT_MASK 0xffffffff ECU_ADDRESS 0x40a91 /end MEASUREMENT
/begin MEASUREMENT CAM_CLC_WOUT_DLY_EX "ivvt_ovcam_clc_wout_dlyvbyteC1D" UBYTE LINEAR_______155_625000__FFH____ 2 2.0 -155.625 -60.0 BIT_MASK 0xffffffff ECU_ADDRESS 0x40a8f /end MEASUREMENT
/begin MEASUREMENT CAM_DIF_EX "ivvt_ovcam_dif" SBYTE LINEAR_______48_000000__FFFFFF80 2 2.0 -48.0 47.625 BIT_MASK 0xffffffff ECU_ADDRESS 0x40bcd /end MEASUREMENT
/begin MEASUREMENT CAM_DIF_CTL_EX "ivvt_ovcam_dif_ctl" SBYTE LINEAR_______48_000000__FFFFFF80 2 2.0 -48.0 47.625 BIT_MASK 0xffffffff ECU_ADDRESS 0x40bcc /end MEASUREMENT
/begin MEASUREMENT CAM_SP_EX "ivvt_ovcam_sp" UBYTE LINEAR_______155_625000__FFH____ 2 2.0 -155.625 -60.0 BIT_MASK 0xffffffff ECU_ADDRESS 0x40aac /end MEASUREMENT
/begin MEASUREMENT CAM_SP_DIF_EX "ivvt_ovcam_sp_dif" SBYTE LINEAR_______48_000000__FFFFFF80 2 2.0 -48.0 47.625 BIT_MASK 0xffffffff ECU_ADDRESS 0x40bce /end MEASUREMENT
/begin MEASUREMENT DLY_IVVT_EX "ivvt_ovdly" UBYTE LINEAR______0_000000__0H___2550_ 2 2.0 0.0 2550.0 BIT_MASK 0xffffffff ECU_ADDRESS 0x40aa3 /end MEASUREMENT
/begin MEASUREMENT TOTZ_VANOS_GEM_A "ivvt_ovdly_mes" UBYTE LINEAR______0_000000__0H___2550_ 2 2.0 0.0 2550.0 BIT_MASK 0xffffffff ECU_ADDRESS 0x40aa4 /end MEASUREMENT
/begin MEASUREMENT IVVT_DLY_VALVE_EX "ivvt_ovdly_valve" SWORD LINEAR_______20480_00000__FFFF80 2 2.0 -20480.0 20479.375 BIT_MASK 0xffffffff ECU_ADDRESS 0x40a9c /end MEASUREMENT
/begin MEASUREMENT IVVTPWM_EX "ivvt_ovpwm_vb" UBYTE LINEAR______0_000000__0H___99_60 2 2.0 0.0 99.609375 BIT_MASK 0xffffffff ECU_ADDRESS 0x40bb5 /end MEASUREMENT
/begin MEASUREMENT LV_IVVT_STATE_ACT_EX "ivvt_ovstate_act" UBYTE RVANOS_STATE_ACTIVE_RANGE 2 2.0 0 255 BIT_MASK 0xffffffff ECU_ADDRESS 0x40aa2 /end MEASUREMENT
/begin MEASUREMENT T_IVVT_EX "ivvt_ovt" SWORD LINEAR_______20480_00000__FFF768 2 2.0 -20480.0 20479.375 BIT_MASK 0xffffffff ECU_ADDRESS 0x40a9a /end MEASUREMENT
/begin MEASUREMENT T_ADD_MIN_ADH_EX "ivvt_ovt_add_min_adh" UBYTE LINEAR______0_000000__0H___159_3 2 2.0 0.0 159.375 BIT_MASK 0xffffffff ECU_ADDRESS 0x40bcb /end MEASUREMENT
/begin MEASUREMENT T_CTL_IVVT_EX "ivvt_ovt_ctl" SWORD LINEAR_______20480_00000__FFFF80 2 2.0 -20480.0 20479.375 BIT_MASK 0xffffffff ECU_ADDRESS 0x40a98 /end MEASUREMENT
/begin MEASUREMENT T_CTL_IVVT_I_EX "ivvt_ovt_ctl_i" SWORD LINEAR_______20480_00000__FFFF80 2 2.0 -20480.0 20479.375 BIT_MASK 0xffffffff ECU_ADDRESS 0x40a9e /end MEASUREMENT
/begin MEASUREMENT T_SUM_IVVT_EX "ivvt_ovt_sum" SWORD LINEAR_______20480_00000__FFFF80 2 2.0 -20480.0 20479.375 BIT_MASK 0xffffffff ECU_ADDRESS 0x40a96 /end MEASUREMENT
/begin MEASUREMENT VEL_DRIFT_IVVTHPWM_EX "ivvt_ovvel_drift_hpwm_in" SWORD LINEAR______95_625000__FFFFFF01H 2 2.0 -96.25 96.25 BIT_MASK 0xffffffff ECU_ADDRESS 0x40a92 /end MEASUREMENT
/begin MEASUREMENT LV_ACIN "ka" UWORD RANGE________ACIN___1H__1H______ 2 2.0 0 65535 BIT_MASK 0x40 ECU_ADDRESS 0xfd98 /end MEASUREMENT
/begin MEASUREMENT LV_CAT_ENR_1 "KAT_ANFETTUNG_1" UBYTE RANGE________active___1H__1H____ 2 2.0 0 255 BIT_MASK 0x10 ECU_ADDRESS 0x40c3e /end MEASUREMENT
/begin MEASUREMENT LV_CAT_ENR_2 "KAT_ANFETTUNG_2" UBYTE RANGE________active___1H__1H____ 2 2.0 0 255 BIT_MASK 0x10 ECU_ADDRESS 0x40d9c /end MEASUREMENT
/begin MEASUREMENT LV_CAT_DIAG_END_1 "katw_diag_end_1" UWORD RANGE________YES___1H__1H____745 2 2.0 0 65535 BIT_MASK 0x8 ECU_ADDRESS 0x40c62 /end MEASUREMENT
/begin MEASUREMENT LV_CAT_DIAG_END_2 "katw_diag_end_2" UWORD RANGE________YES___1H__1H____745 2 2.0 0 65535 BIT_MASK 0x8 ECU_ADDRESS 0x40dc0 /end MEASUREMENT
/begin MEASUREMENT LV_CH "kh" UWORD RANGE________CH___1H__1H________ 2 2.0 0 65535 BIT_MASK 0x20 ECU_ADDRESS 0xfd96 /end MEASUREMENT
/begin MEASUREMENT LV_CH_2 "kh2" UWORD RANGE________CH2___1H__1H_______ 2 2.0 0 65535 BIT_MASK 0x8 ECU_ADDRESS 0xfd9a /end MEASUREMENT
/begin MEASUREMENT LV_CH_3 "kh3" UWORD RANGE________CH3___1H__1H_______ 2 2.0 0 65535 BIT_MASK 0x10 ECU_ADDRESS 0xfd9a /end MEASUREMENT
/begin MEASUREMENT LV_ACCIN "kk" UWORD RANGE________ACCIN___1H__1H_____ 2 2.0 0 65535 BIT_MASK 0x80 ECU_ADDRESS 0xfd98 /end MEASUREMENT
/begin MEASUREMENT LV_RLY_ACCIN "kk_relais" UWORD RANGE________ACCIN_RELAIS___1H__ 2 2.0 0 65535 BIT_MASK 0x2000 ECU_ADDRESS 0xfd98 /end MEASUREMENT
/begin MEASUREMENT KM_CTR "km_ctr" UWORD LINEAR______0_000000__0H___65534 2 2.0 0.0 655340.0 BIT_MASK 0xffffffff ECU_ADDRESS 0x406d4 /end MEASUREMENT
/begin MEASUREMENT KM_CTR_PVS_BLS "km_ctr_pvs_bls" UWORD LINEAR______0_000000__0H___65534 2 2.0 0.0 655340.0 BIT_MASK 0xffffffff FUNCTION_LIST DMTL ECU_ADDRESS 0x40738 /end MEASUREMENT
/begin MEASUREMENT KM_CTR_SUPP_ST "km_ctr_supp_st" UWORD LINEAR______0_000000__0H___65112 2 2.0 0.0 65535.0 BIT_MASK 0xffffffff ECU_ADDRESS 0x41142 /end MEASUREMENT
/begin MEASUREMENT KNK_PWM "knk_pwm" UWORD LINEAR______0_000000__0H___99770 2 2.0 0.0 99.998474 BIT_MASK 0xffffffff ECU_ADDRESS 0x40bea /end MEASUREMENT
/begin MEASUREMENT KNKS_1 "knksC0D" UBYTE LINEAR______0_000000__0H___5_100 2 2.0 0.0 5.0999999 BIT_MASK 0xffffffff ECU_ADDRESS 0xfc39 /end MEASUREMENT
/begin MEASUREMENT KNKS_5 "knksC1D" UBYTE LINEAR______0_000000__0H___5_100 2 2.0 0.0 5.0999999 BIT_MASK 0xffffffff ECU_ADDRESS 0xfc3a /end MEASUREMENT
/begin MEASUREMENT KNKS_3 "knksC2D" UBYTE LINEAR______0_000000__0H___5_100 2 2.0 0.0 5.0999999 BIT_MASK 0xffffffff ECU_ADDRESS 0xfc3b /end MEASUREMENT
/begin MEASUREMENT KNKS_6 "knksC3D" UBYTE LINEAR______0_000000__0H___5_100 2 2.0 0.0 5.0999999 BIT_MASK 0xffffffff ECU_ADDRESS 0xfc3c /end MEASUREMENT
/begin MEASUREMENT KNKS_2 "knksC4D" UBYTE LINEAR______0_000000__0H___5_100 2 2.0 0.0 5.0999999 BIT_MASK 0xffffffff ECU_ADDRESS 0xfc3d /end MEASUREMENT
/begin MEASUREMENT KNKS_4 "knksC5D" UBYTE LINEAR______0_000000__0H___5_100 2 2.0 0.0 5.0999999 BIT_MASK 0xffffffff ECU_ADDRESS 0xfc3e /end MEASUREMENT
/begin MEASUREMENT KNKS_1_6 "knks_1_6" UBYTE LINEAR______0_000000__0H___5_100 2 2.0 0.0 5.0999999 BIT_MASK 0xffffffff ECU_ADDRESS 0xfb6f /end MEASUREMENT
/begin MEASUREMENT LV_KNK_ACT "kr" UWORD RANGE________active___1H__1H_771 2 2.0 0 65535 BIT_MASK 0x4 ECU_ADDRESS 0xfd9a /end MEASUREMENT
/begin MEASUREMENT LV_COP_1 "ks_bk1" UWORD RANGE________COP___1H__1H_______ 2 2.0 0 65535 BIT_MASK 0x40 ECU_ADDRESS 0xfd96 /end MEASUREMENT
/begin MEASUREMENT LV_COP_2 "ks_bk2" UWORD RANGE________COP___1H__1H_______ 2 2.0 0 65535 BIT_MASK 0x200 ECU_ADDRESS 0xfd96 /end MEASUREMENT
/begin MEASUREMENT LV_FSD_LOCK "KSD_GESPERRT" UWORD RANGE________YES___1H__1H____772 2 2.0 0 65535 BIT_MASK 0x20 ECU_ADDRESS 0xfda4 /end MEASUREMENT
/begin MEASUREMENT LAM "LAM" UWORD RANGE________LAM1___0H__0H____LA 2 2.0 0 65535 BIT_MASK 0x400 ECU_ADDRESS 0xfda4 /end MEASUREMENT
/begin MEASUREMENT LAM_DIAG_SAV_MAX "lam_diag_sav_max" UWORD LINEAR_______50_000000__0H___440 2 2.0 -50.0 49.998471 BIT_MASK 0xffffffff ECU_ADDRESS 0x410cc /end MEASUREMENT
/begin MEASUREMENT LAM_MV_BEG "lam_mv_beg" UWORD LINEAR_______50_000000__0H___440 2 2.0 -50.0 49.998471 BIT_MASK 0xffffffff ECU_ADDRESS 0x40714 /end MEASUREMENT
/begin MEASUREMENT LAM_MV_DIF_CP_COR "lam_mv_dif_cp_cor" UWORD LINEAR_______50_000000__0H___440 2 2.0 -50.0 49.998471 BIT_MASK 0xffffffff ECU_ADDRESS 0x40702 /end MEASUREMENT
/begin MEASUREMENT LAM_MV_DYN_DLY_1 "LAM_MV_DYN_DLY_1" UWORD RANGE________0___0H__0H____1___1 2 2.0 0 65535 BIT_MASK 0x1000 ECU_ADDRESS 0x40c62 /end MEASUREMENT
/begin MEASUREMENT LAM_MV_DYN_DLY_2 "LAM_MV_DYN_DLY_2" UWORD RANGE________0___0H__0H____1___1 2 2.0 0 65535 BIT_MASK 0x1000 ECU_ADDRESS 0x40dc0 /end MEASUREMENT
/begin MEASUREMENT LAM_MV_MMV "lam_mv_mmv" UWORD LINEAR_______50_000000__0H___440 2 2.0 -50.0 49.998471 BIT_MASK 0xffffffff ECU_ADDRESS 0x40704 /end MEASUREMENT
/begin MEASUREMENT LAM_MV_MMV_DIF "lam_mv_mmv_dif" UWORD LINEAR_______50_000000__0H___440 2 2.0 -50.0 49.998471 BIT_MASK 0xffffffff ECU_ADDRESS 0x40706 /end MEASUREMENT
/begin MEASUREMENT LAMMW_TE_VERS "lam_mv_st_cp" UWORD LINEAR_______50_000000__0H___440 2 2.0 -50.0 49.998471 BIT_MASK 0xffffffff ECU_ADDRESS 0x40708 /end MEASUREMENT
/begin MEASUREMENT LAM_STATE_3 "lam_state_3" UWORD LINEAR______0_000000__0H___65773 2 2.0 0.0 65535.0 BIT_MASK 0xffffffff ECU_ADDRESS 0xfda4 /end MEASUREMENT
/begin MEASUREMENT LAM_1_BITWORD_1 "lam1vbit_vword" UWORD LINEAR______0_000000__0H___65535 2 2.0 0.0 65535.0 BIT_MASK 0xffffffff FUNCTION_LIST R_LS_CALC ECU_ADDRESS 0x40c38 /end MEASUREMENT
/begin MEASUREMENT CAT_DIAG_1 "lam1vcat_diag" UWORD LINEAR______0_000000__0H___2559_ 2 2.0 0.0 2559.9609 BIT_MASK 0xffffffff ECU_ADDRESS 0x40d28 /end MEASUREMENT
/begin MEASUREMENT CAT_DIAG_ERR_1 "lam1vcat_diag_err" UBYTE LINEAR______0_000000__0H___255_0 2 2.0 0.0 255.0 BIT_MASK 0xffffffff ECU_ADDRESS 0x40cee /end MEASUREMENT
/begin MEASUREMENT CAT_DIAG_SF_1 "lam1vcat_diag_sf" UWORD LINEAR______0_000000__0H___65773 2 2.0 0.0 65535.0 BIT_MASK 0xffffffff ECU_ADDRESS 0x40c62 /end MEASUREMENT
/begin MEASUREMENT CAT_DIAG_TEG_1 "lam1vcat_diag_teg" UWORD LINEAR______0_000000__0H___63_99 2 2.0 0.0 63.999023 BIT_MASK 0xffffffff ECU_ADDRESS 0x40d48 /end MEASUREMENT
/begin MEASUREMENT CAT_EXOTH_POW_1 "lam1vcat_exoth_pow" UWORD LINEAR______0_000000__0H___7_774 2 2.0 0.0 7.999878 BIT_MASK 0xffffffff ECU_ADDRESS 0x40d44 /end MEASUREMENT
/begin MEASUREMENT CTR_LAM_AFL_AFR_1 "lam1vctr_lam_afl_afr" UBYTE LINEAR______0_000000__0H___25775 2 2.0 0.0 255.0 BIT_MASK 0xffffffff ECU_ADDRESS 0x40ce4 /end MEASUREMENT
/begin MEASUREMENT CTR_LAM_CYCNR_DIAG_1 "lam1vctr_lam_cycnr_diag" UWORD LINEAR______0_000000__0H___65776 2 2.0 0.0 65535.0 BIT_MASK 0xffffffff ECU_ADDRESS 0x40c3a /end MEASUREMENT
/begin MEASUREMENT CTR_LAM_DLY_1 "lam1vctr_lam_dly" UWORD LINEAR______0_000000__0H___65777 2 2.0 0.0 65535.0 BIT_MASK 0xffffffff ECU_ADDRESS 0x40d10 /end MEASUREMENT
/begin MEASUREMENT CTR_LAM_MAX_CYCNR_1 "lam1vctr_lam_max_cycnr" UBYTE LINEAR______0_000000__0H___25778 2 2.0 0.0 255.0 BIT_MASK 0xffffffff ECU_ADDRESS 0x40ce3 /end MEASUREMENT
/begin MEASUREMENT CTR_LAM_SUM_P_IS_1 "lam1vctr_lam_sum_p_is" UBYTE LINEAR______0_000000__0H___255_0 2 2.0 0.0 255.0 BIT_MASK 0xffffffff ECU_ADDRESS 0x40ce2 /end MEASUREMENT
/begin MEASUREMENT CTR_VLS_CAT_DIAG_1 "lam1vctr_vls_cat_diag" UBYTE LINEAR______0_000000__0H___255_0 2 2.0 0.0 255.0 BIT_MASK 0xffffffff ECU_ADDRESS 0x40d15 /end MEASUREMENT
/begin MEASUREMENT CYCNR_CAT_DIAG_1 "lam1vcycnr_cat_diag" UBYTE LINEAR______0_000000__0H___25775 2 2.0 0.0 255.0 BIT_MASK 0xffffffff ECU_ADDRESS 0x40cef /end MEASUREMENT
/begin MEASUREMENT DRV1_VLS_DOWN_ABS_MAX_1 "lam1vdrv1_vls_down_abs_max" SWORD LINEAR_______1_275000__FFFF8080H 2 2.0 -1.275 1.275 BIT_MASK 0xffffffff FUNCTION_LIST R_LS_CALC ECU_ADDRESS 0x40cd2 /end MEASUREMENT
/begin MEASUREMENT DRV1_VLS_DOWN_MMV_1 "lam1vdrv1_vls_down_mmv" SWORD LINEAR_______1_275000__FFFF80102 2 2.0 -1.275 1.275 BIT_MASK 0xffffffff FUNCTION_LIST R_LS_CALC ECU_ADDRESS 0x40cd0 /end MEASUREMENT
/begin MEASUREMENT DRV1_VLS_UP_ABS_MAX_1 "lam1vdrv1_vls_up_abs_max" SWORD LINEAR_______1_275000__FFFF8080H 2 2.0 -1.275 1.275 BIT_MASK 0xffffffff FUNCTION_LIST R_LS_CALC ECU_ADDRESS 0x40cba /end MEASUREMENT
/begin MEASUREMENT DRV1_VLS_UP_MMV_1 "lam1vdrv1_vls_up_mmv" SWORD LINEAR_______1_275000__FFFF80102 2 2.0 -1.275 1.275 BIT_MASK 0xffffffff FUNCTION_LIST R_LS_CALC ECU_ADDRESS 0x40cb8 /end MEASUREMENT
/begin MEASUREMENT LAM_1 "lam1vlam" UWORD LINEAR_______50_000000__0H___440 2 2.0 -50.0 49.998471 BIT_MASK 0xffffffff ECU_ADDRESS 0x40c40 /end MEASUREMENT
/begin MEASUREMENT LAM_I_1 "lam1vlam_i" UWORD LINEAR_______50_000000__0H___779 2 2.0 -50.0 49.998471 BIT_MASK 0xffffffff ECU_ADDRESS 0x40c44 /end MEASUREMENT
/begin MEASUREMENT LAM_INT_1 "lam1vlam_intvbyteC1D" UBYTE LINEAR_______50_000000__0H___49_ 2 2.0 -50.0 49.6094 BIT_MASK 0xffffffff ECU_ADDRESS 0x40c55 /end MEASUREMENT
/begin MEASUREMENT LAM_LIM_AFL_1 "lam1vlam_lim_afl" UWORD LINEAR_______50_000000__0H___779 2 2.0 -50.0 49.998471 BIT_MASK 0xffffffff ECU_ADDRESS 0x40c46 /end MEASUREMENT
/begin MEASUREMENT LAM_LIM_AFR_1 "lam1vlam_lim_afr" UWORD LINEAR_______50_000000__0H___779 2 2.0 -50.0 49.998471 BIT_MASK 0xffffffff ECU_ADDRESS 0x40c48 /end MEASUREMENT
/begin MEASUREMENT LAM_MV_1 "lam1vlam_mvvbyteC1D" UBYTE LINEAR_______50_000000__0H___49_ 2 2.0 -50.0 49.6094 BIT_MASK 0xffffffff ECU_ADDRESS 0x40c59 /end MEASUREMENT
/begin MEASUREMENT LAM_MV_DYW_1 "lam1vlam_mv_dywvbyteC1D" UBYTE LINEAR_______50_000000__0H___49_ 2 2.0 -50.0 49.6094 BIT_MASK 0xffffffff ECU_ADDRESS 0x40c57 /end MEASUREMENT
/begin MEASUREMENT LAM_MV_MMV_CAT_1 "lam1vlam_mv_mmv_catvwordC1D" UWORD LINEAR_______50_000000__0H___780 2 2.0 -50.0 49.998471 BIT_MASK 0xffffffff ECU_ADDRESS 0x40c6a /end MEASUREMENT
/begin MEASUREMENT LAM_OLD_1 "lam1vlam_old" UWORD LINEAR_______50_000000__0H___779 2 2.0 -50.0 49.998471 BIT_MASK 0xffffffff ECU_ADDRESS 0x40c42 /end MEASUREMENT
/begin MEASUREMENT LAM_STATE_1_LOW_BYTE_1 "lam1vlam_statevbyteC0D" UBYTE LINEAR______0_000000__0H___25781 2 2.0 0.0 255.0 BIT_MASK 0xffffffff ECU_ADDRESS 0x40c3c /end MEASUREMENT
/begin MEASUREMENT LAM_STATE_1_HIGH_BYTE_1 "lam1vlam_statevbyteC1D" UBYTE LINEAR______0_000000__0H___25781 2 2.0 0.0 255.0 BIT_MASK 0xffffffff ECU_ADDRESS 0x40c3d /end MEASUREMENT
/begin MEASUREMENT LAM_STATE_2_LOW_BYTE_1 "lam1vlam_state_2vbyteC0D" UBYTE LINEAR______0_000000__0H___25781 2 2.0 0.0 255.0 BIT_MASK 0xffffffff ECU_ADDRESS 0x40c3e /end MEASUREMENT
/begin MEASUREMENT LAM_STATE_2_HIGH_BYTE_1 "lam1vlam_state_2vbyteC1D" UBYTE LINEAR______0_000000__0H___25781 2 2.0 0.0 255.0 BIT_MASK 0xffffffff ECU_ADDRESS 0x40c3f /end MEASUREMENT
/begin MEASUREMENT MAF_DYW_1 "lam1vmaf_dywvbyteC1D" UBYTE LINEAR______0_000000__0H___1389_ 2 2.0 0.0 1389.0 BIT_MASK 0xffffffff ECU_ADDRESS 0x40c5d /end MEASUREMENT
/begin MEASUREMENT MAF_INT_CAT_1 "lam1vmaf_int_cat" UWORD LINEAR______0_000000__0H___18782 2 2.0 0.0 1820.42 BIT_MASK 0xffffffff ECU_ADDRESS 0x40d2e /end MEASUREMENT
/begin MEASUREMENT MAF_INT_DLY_1 "lam1vmaf_int_dly" UWORD LINEAR______0_000000__0H___18783 2 2.0 0.0 1820.42 BIT_MASK 0xffffffff ECU_ADDRESS 0x40c8e /end MEASUREMENT
/begin MEASUREMENT MAF_INT_DLY_P_I_1 "lam1vmaf_int_dly_p_i" UWORD LINEAR______0_000000__0H___18783 2 2.0 0.0 1820.42 BIT_MASK 0xffffffff ECU_ADDRESS 0x40c90 /end MEASUREMENT
/begin MEASUREMENT N_DYW_1 "lam1vn_dywvword" UWORD LINEAR______1_000000__1H___81784 2 2.0 1.0 8160.0 BIT_MASK 0xffffffff ECU_ADDRESS 0x40c5a /end MEASUREMENT
/begin MEASUREMENT O2_CAT1 "lam1vo2_cat" UBYTE LINEAR______0_000000__0H___0_996 2 2.0 0.0 0.99609375 BIT_MASK 0xffffffff ECU_ADDRESS 0x40d38 /end MEASUREMENT
/begin MEASUREMENT O2_CAT_DIF_SUM_1 "lam1vo2_cat_dif_sum" UWORD LINEAR______0_000000__0H___5119_ 2 2.0 0.0 5119.9219 BIT_MASK 0xffffffff ECU_ADDRESS 0x40d1e /end MEASUREMENT
/begin MEASUREMENT O2_CAT_MV_1 "lam1vo2_cat_mv" UBYTE LINEAR______0_000000__0H___0_996 2 2.0 0.0 0.99609375 BIT_MASK 0xffffffff ECU_ADDRESS 0x40d34 /end MEASUREMENT
/begin MEASUREMENT O2_CAT_MV_OLD_1 "lam1vo2_cat_mv_old" UBYTE LINEAR______0_000000__0H___0_996 2 2.0 0.0 0.99609375 BIT_MASK 0xffffffff ECU_ADDRESS 0x40d36 /end MEASUREMENT
/begin MEASUREMENT O2_CAT_QUO_1 "lam1vo2_cat_quo" UWORD LINEAR______0_000000__0H___20_00 2 2.0 0.0 20.0 BIT_MASK 0xffffffff ECU_ADDRESS 0x40d2c /end MEASUREMENT
/begin MEASUREMENT O2_CAT_QUO_SUM_1 "lam1vo2_cat_quo_sum" UWORD LINEAR______0_000000__0H___2559_ 2 2.0 0.0 2559.9609 BIT_MASK 0xffffffff ECU_ADDRESS 0x40d22 /end MEASUREMENT
/begin MEASUREMENT O2_CAT_SUM_1 "lam1vo2_cat_sum" UWORD LINEAR______0_000000__0H___5_119 2 2.0 0.0 5.1192065 BIT_MASK 0xffffffff ECU_ADDRESS 0x40d20 /end MEASUREMENT
/begin MEASUREMENT OV_TI_AD_ADD_FAC_1 "lam1vov_ti_ad_add_fac" UBYTE LINEAR______0_000000__0H___0_785 2 2.0 0.0 0.99609375 BIT_MASK 0xffffffff ECU_ADDRESS 0x40ce8 /end MEASUREMENT
/begin MEASUREMENT OV_TI_AD_FAC_FAC_1 "lam1vov_ti_ad_fac_fac" UBYTE LINEAR______0_000000__0H___0_785 2 2.0 0.0 0.99609375 BIT_MASK 0xffffffff ECU_ADDRESS 0x40ce7 /end MEASUREMENT
/begin MEASUREMENT PVS_GRD_DEC_CTL_1 "lam1vpvs_grd_dec_ctl" UBYTE LINEAR______0_000000__0H___5_120 2 2.0 0.0 5.12 BIT_MASK 0xffffffff ECU_ADDRESS 0x40cda /end MEASUREMENT
/begin MEASUREMENT PVS_GRD_SUM_1 "lam1vpvs_grd_sum" UWORD LINEAR______0_000000__0H___76786 2 2.0 0.0 767916.0 BIT_MASK 0xffffffff ECU_ADDRESS 0x40c7a /end MEASUREMENT
/begin MEASUREMENT PVS_GRD_SUM_DLY_1 "lam1vpvs_grd_sum_dly" UWORD LINEAR______0_000000__0H___76787 2 2.0 0.0 767916.0 BIT_MASK 0xffffffff ECU_ADDRESS 0x40c7c /end MEASUREMENT
/begin MEASUREMENT R_LS_DOWN_1 "lam1vr_ls_down" UWORD LINEAR______0_000000__0H___65142 2 2.0 0.0 65535.0 BIT_MASK 0xffffffff ECU_ADDRESS 0x40d86 /end MEASUREMENT
/begin MEASUREMENT R_LS_UP_1 "lam1vr_ls_up" UWORD LINEAR______0_000000__0H___65142 2 2.0 0.0 65535.0 BIT_MASK 0xffffffff ECU_ADDRESS 0x40d84 /end MEASUREMENT
/begin MEASUREMENT STATE_DOWN_DIAG_1 "lam1vstate_down_diag" UBYTE LINEAR______0_000000__0H___25788 2 2.0 0.0 255.0 BIT_MASK 0xffffffff ECU_ADDRESS 0x40d14 /end MEASUREMENT
/begin MEASUREMENT STATE_SA_DIAG_SF_1 "lam1vstate_sa_diag_sf" UBYTE LINEAR______0_000000__0H___25789 2 2.0 0.0 255.0 BIT_MASK 0xffffffff ECU_ADDRESS 0x40c74 /end MEASUREMENT
/begin MEASUREMENT SUM_AFL_AFR_1 "lam1vsum_afl_afr" UBYTE LINEAR______0_000000__0H___25790 2 2.0 0.0 255.0 BIT_MASK 0xffffffff ECU_ADDRESS 0x40cf6 /end MEASUREMENT
/begin MEASUREMENT SUM_AFL_VLS_SA_DIAG_1 "lam1vsum_afl_vls_sa_diag" UWORD LINEAR______0_000000__0H___65776 2 2.0 0.0 65535.0 BIT_MASK 0xffffffff ECU_ADDRESS 0x40c76 /end MEASUREMENT
/begin MEASUREMENT SUM_CAT_DIAG_1 "lam1vsum_cat_diag" UWORD LINEAR______0_000000__0H___65776 2 2.0 0.0 65535.0 BIT_MASK 0xffffffff ECU_ADDRESS 0x40d24 /end MEASUREMENT
/begin MEASUREMENT SUM_CRLC_TI_AD_ADD_CLC_1 "lam1vsum_crlc_ti_ad_add_clc" UWORD LINEAR______0_000000__0H___25791 2 2.0 0.0 255.996 BIT_MASK 0xffffffff ECU_ADDRESS 0x40cfc /end MEASUREMENT
/begin MEASUREMENT SUM_CRLC_TI_AD_FAC_CLC_1 "lam1vsum_crlc_ti_ad_fac_clc" UWORD LINEAR______0_000000__0H___25791 2 2.0 0.0 255.996 BIT_MASK 0xffffffff ECU_ADDRESS 0x40cfe /end MEASUREMENT
/begin MEASUREMENT SUM_CYC_1 "lam1vsum_cyc" UWORD LINEAR______0_000000__0H___65776 2 2.0 0.0 65535.0 BIT_MASK 0xffffffff ECU_ADDRESS 0x40d26 /end MEASUREMENT
/begin MEASUREMENT SUM_CYCNR_AFL_1 "lam1vsum_cycnr_afl" UWORD LINEAR______0_000000__0H___65776 2 2.0 0.0 65535.0 BIT_MASK 0xffffffff ECU_ADDRESS 0x40d68 /end MEASUREMENT
/begin MEASUREMENT SUM_CYCNR_AFR_1 "lam1vsum_cycnr_afr" UWORD LINEAR______0_000000__0H___65776 2 2.0 0.0 65535.0 BIT_MASK 0xffffffff ECU_ADDRESS 0x40d66 /end MEASUREMENT
/begin MEASUREMENT SUM_LAM_P_1 "lam1vsum_lam_p" UBYTE LINEAR______0_000000__0H___25790 2 2.0 0.0 255.0 BIT_MASK 0xffffffff ECU_ADDRESS 0x40ce5 /end MEASUREMENT
/begin MEASUREMENT SUM_P_CAT_1 "lam1vsum_p_cat" UBYTE LINEAR______0_000000__0H___25790 2 2.0 0.0 255.0 BIT_MASK 0xffffffff ECU_ADDRESS 0x40cf4 /end MEASUREMENT
/begin MEASUREMENT SUM_P_CP_1 "lam1vsum_p_cp" UBYTE LINEAR______0_000000__0H___25790 2 2.0 0.0 255.0 BIT_MASK 0xffffffff ECU_ADDRESS 0x40ce6 /end MEASUREMENT
/begin MEASUREMENT SUM_P_JUMP_1 "lam1vsum_p_jump" UBYTE LINEAR______0_000000__0H___25790 2 2.0 0.0 255.0 BIT_MASK 0xffffffff ECU_ADDRESS 0x40cf7 /end MEASUREMENT
/begin MEASUREMENT SUM_P_LAM_LIM_1 "lam1vsum_p_lam_lim" UBYTE LINEAR______0_000000__0H___25790 2 2.0 0.0 255.0 BIT_MASK 0xffffffff ECU_ADDRESS 0x40cf9 /end MEASUREMENT
/begin MEASUREMENT SUM_P_LIM_DYN_1 "lam1vsum_p_lim_dyn" UBYTE LINEAR______0_000000__0H___25790 2 2.0 0.0 255.0 BIT_MASK 0xffffffff ECU_ADDRESS 0x40cfa /end MEASUREMENT
/begin MEASUREMENT SUM_P_LS_DIAG_1 "lam1vsum_p_ls_diag" UBYTE LINEAR______0_000000__0H___25790 2 2.0 0.0 255.0 BIT_MASK 0xffffffff ECU_ADDRESS 0x40d00 /end MEASUREMENT
/begin MEASUREMENT SUM_P_RAMP_INTR_1 "lam1vsum_p_ramp_intr" UBYTE LINEAR______0_000000__0H___25790 2 2.0 0.0 255.0 BIT_MASK 0xffffffff ECU_ADDRESS 0x40cf8 /end MEASUREMENT
/begin MEASUREMENT T_CAT_DIAG_TEG_1 "lam1vt_cat_diag_teg" UBYTE LINEAR______0_000000__0H___25_50 2 2.0 0.0 25.5 BIT_MASK 0xffffffff ECU_ADDRESS 0x40d4a /end MEASUREMENT
/begin MEASUREMENT T_DLY_1 "lam1vt_dly" UWORD LINEAR_______2_555800__0H___2_55 2 2.0 -2.5558 2.5557 BIT_MASK 0xffffffff ECU_ADDRESS 0x40d06 /end MEASUREMENT
/begin MEASUREMENT T_DLY_AD_1 "lam1vt_dly_ad" SWORD LINEAR_______640_020000__FFFF792 2 2.0 -640.02 639.98 BIT_MASK 0xffffffff ECU_ADDRESS 0x40c88 /end MEASUREMENT
/begin MEASUREMENT T_DLY_AD_MMV_1 "lam1vt_dly_ad_mmv" SWORD LINEAR_______640_020000__FFFF792 2 2.0 -640.02 639.98 BIT_MASK 0xffffffff ECU_ADDRESS 0x40c8a /end MEASUREMENT
/begin MEASUREMENT T_DLY_I_1 "lam1vt_dly_ivwordC1D" SWORD LINEAR_______640_020000__FFFF792 2 2.0 -640.02 639.98 BIT_MASK 0xffffffff ECU_ADDRESS 0x40c86 /end MEASUREMENT
/begin MEASUREMENT T_DLY_P_1 "lam1vt_dly_p" SWORD LINEAR_______2_555800__FFFF8000H 2 2.0 -2.5558 2.555522 BIT_MASK 0xffffffff ECU_ADDRESS 0x40c82 /end MEASUREMENT
/begin MEASUREMENT T_DLY_TCO_1 "lam1vt_dly_tco" UWORD LINEAR_______2_555800__0H___2_55 2 2.0 -2.5558 2.5557 BIT_MASK 0xffffffff ECU_ADDRESS 0x40d08 /end MEASUREMENT
/begin MEASUREMENT T_DLY_TCO_IS_1 "lam1vt_dly_tco_is" UWORD LINEAR_______2_555800__0H___2_55 2 2.0 -2.5558 2.5557 BIT_MASK 0xffffffff ECU_ADDRESS 0x40d0a /end MEASUREMENT
/begin MEASUREMENT T_LAM_DLY_1 "lam1vt_lam_dly" SWORD LINEAR_______2_555800__FFFF8000H 2 2.0 -2.5558 2.555522 BIT_MASK 0xffffffff ECU_ADDRESS 0x40c8c /end MEASUREMENT
/begin MEASUREMENT T_SUM_MAX_FSD_1 "lam1vt_sum_max_fsd" UWORD LINEAR______0_000000__0H___13793 2 2.0 0.0 1310.7 BIT_MASK 0xffffffff ECU_ADDRESS 0x40d74 /end MEASUREMENT
/begin MEASUREMENT T_SUM_MIN_FSD_1 "lam1vt_sum_min_fsd" UWORD LINEAR______0_000000__0H___13793 2 2.0 0.0 1310.7 BIT_MASK 0xffffffff ECU_ADDRESS 0x40d76 /end MEASUREMENT
/begin MEASUREMENT T_VLS_CYC_AFL_1 "lam1vt_vls_cyc_afl" UWORD LINEAR______0_000000__0H___13794 2 2.0 0.0 1310.7 BIT_MASK 0xffffffff ECU_ADDRESS 0x40c6e /end MEASUREMENT
/begin MEASUREMENT T_VLS_CYC_AFL_MAX_SUM_1 "lam1vt_vls_cyc_afl_max_sum" UWORD LINEAR______0_000000__0H___13795 2 2.0 0.0 1310.7 BIT_MASK 0xffffffff ECU_ADDRESS 0x40d50 /end MEASUREMENT
/begin MEASUREMENT T_VLS_CYC_AFL_SUM_1 "lam1vt_vls_cyc_afl_sum" UWORD LINEAR______0_000000__0H___13795 2 2.0 0.0 1310.7 BIT_MASK 0xffffffff ECU_ADDRESS 0x40d4c /end MEASUREMENT
/begin MEASUREMENT T_VLS_CYC_AFR_1 "lam1vt_vls_cyc_afr" UWORD LINEAR______0_000000__0H___13794 2 2.0 0.0 1310.7 BIT_MASK 0xffffffff ECU_ADDRESS 0x40c6c /end MEASUREMENT
/begin MEASUREMENT T_VLS_CYC_AFR_MAX_SUM_1 "lam1vt_vls_cyc_afr_max_sum" UWORD LINEAR______0_000000__0H___13795 2 2.0 0.0 1310.7 BIT_MASK 0xffffffff ECU_ADDRESS 0x40d52 /end MEASUREMENT
/begin MEASUREMENT T_VLS_CYC_AFR_SUM_1 "lam1vt_vls_cyc_afr_sum" UWORD LINEAR______0_000000__0H___13795 2 2.0 0.0 1310.7 BIT_MASK 0xffffffff ECU_ADDRESS 0x40d4e /end MEASUREMENT
/begin MEASUREMENT T_VLS_CYCNR_AFL_1 "lam1vt_vls_cycnr_afl" UWORD LINEAR______0_000000__0H___65796 2 2.0 0.0 655.35 BIT_MASK 0xffffffff ECU_ADDRESS 0x40c66 /end MEASUREMENT
/begin MEASUREMENT T_VLS_CYCNR_AFR_1 "lam1vt_vls_cycnr_afr" UWORD LINEAR______0_000000__0H___65796 2 2.0 0.0 655.35 BIT_MASK 0xffffffff ECU_ADDRESS 0x40c64 /end MEASUREMENT
/begin MEASUREMENT TEG_DOWN_MDL_1 "lam1vteg_down_mdl" UWORD LINEAR______0_000000__0H___10253 2 2.0 0.0 1023.9844 BIT_MASK 0xffffffff ECU_ADDRESS 0x40d40 /end MEASUREMENT
/begin MEASUREMENT TEMP_CAT_1 "lam1vtemp_cat" UWORD LINEAR______0_000000__0H___10797 2 2.0 0.0 1023.0 BIT_MASK 0xffffffff ECU_ADDRESS 0x40c78 /end MEASUREMENT
/begin MEASUREMENT TI_AD_ADD_MMV_1 "lam1vti_ad_add_mmv" UWORD TI_SGN_16_RES 2 2.0 -131.072 131.068 BIT_MASK 0xffffffff ECU_ADDRESS 0x40c4a /end MEASUREMENT
/begin MEASUREMENT TI_AD_ADD_MMV_ES_1 "lam1vti_ad_add_mmv_es" SWORD LINEAR_______174_762666__FFFF798 2 2.0 -174.76267 174.75733 BIT_MASK 0xffffffff ECU_ADDRESS 0x40c4c /end MEASUREMENT
/begin MEASUREMENT TI_AD_ADD_MMV_PR_1 "lam1vti_ad_add_mmv_pr" SWORD LINEAR_______50_000000__FFFF8799 2 2.0 -50.0 49.9985 BIT_MASK 0xffffffff ECU_ADDRESS 0x40c4e /end MEASUREMENT
/begin MEASUREMENT TI_AD_FAC_MMV_1 "lam1vti_ad_fac_mmv" UWORD LINEAR_______50_000000__0H___780 2 2.0 -50.0 49.998471 BIT_MASK 0xffffffff ECU_ADDRESS 0x40c50 /end MEASUREMENT
/begin MEASUREMENT TI_BANK_1 "lam1vti_bank" UWORD LINEAR______0_000000__0H___349_5 2 2.0 0.0 349.52 BIT_MASK 0xffffffff ECU_ADDRESS 0x40d72 /end MEASUREMENT
/begin MEASUREMENT TI_COP_CBK_1 "lam1vti_cop" UWORD LINEAR______0_000000__0H___16800 2 2.0 0.0 16.0 BIT_MASK 0xffffffff ECU_ADDRESS 0x40d70 /end MEASUREMENT
/begin MEASUREMENT TI_LAM_1 "lam1vti_lam" UWORD LINEAR_______100_00000__0H___100 2 2.0 -100.0 100.0 BIT_MASK 0xffffffff ECU_ADDRESS 0x40c52 /end MEASUREMENT
/begin MEASUREMENT TIB_1 "lam1vtib" UWORD LINEAR______0_000000__0H___34801 2 2.0 0.0 349.5 BIT_MASK 0xffffffff ECU_ADDRESS 0x40d6e /end MEASUREMENT
/begin MEASUREMENT TMC_1 "lam1vtmc" SWORD LINEAR_______512_000000__FFFF802 2 2.0 -512.0 511.98438 BIT_MASK 0xffffffff ECU_ADDRESS 0x40d3e /end MEASUREMENT
/begin MEASUREMENT VLS_AFL_CYCNR_DOWN_1 "lam1vvls_afl_cycnr_down" UWORD LINEAR______0_000000__0H___65803 2 2.0 0.0 655.35 BIT_MASK 0xffffffff ECU_ADDRESS 0x40c72 /end MEASUREMENT
/begin MEASUREMENT VLS_AFR_CYCNR_DOWN_1 "lam1vvls_afr_cycnr_down" UWORD LINEAR______0_000000__0H___65803 2 2.0 0.0 655.35 BIT_MASK 0xffffffff ECU_ADDRESS 0x40c70 /end MEASUREMENT
/begin MEASUREMENT VLS_BOL_UP_1 "lam1vvls_bol_up" UBYTE LINEAR______0_000000__0H___1_804 2 2.0 0.0 1.275 BIT_MASK 0xffffffff ECU_ADDRESS 0x40ce1 /end MEASUREMENT
/begin MEASUREMENT VLS_CAT_CYCNR_1 "lam1vvls_cat_cycnr" UBYTE LINEAR______0_000000__0H___1_992 2 2.0 0.0 1.9921875 BIT_MASK 0xffffffff ECU_ADDRESS 0x40d19 /end MEASUREMENT
/begin MEASUREMENT VLS_CAT_CYCNR_AV_1 "lam1vvls_cat_cycnr_av" UBYTE LINEAR______0_000000__0H___51805 2 2.0 0.0 5100.0 BIT_MASK 0xffffffff ECU_ADDRESS 0x40d1a /end MEASUREMENT
/begin MEASUREMENT VLS_CAT_CYCNR_QUO_SUM_1 "lam1vvls_cat_cycnr_quo_sum" UWORD LINEAR______0_000000__0H___509_0 2 2.0 0.0 509.0055 BIT_MASK 0xffffffff ECU_ADDRESS 0x40d1c /end MEASUREMENT
/begin MEASUREMENT VLS_CAT_END_PUC_1 "lam1vvls_cat_end_puc" UBYTE LINEAR______0_000000__0H___1_804 2 2.0 0.0 1.275 BIT_MASK 0xffffffff ECU_ADDRESS 0x40d17 /end MEASUREMENT
/begin MEASUREMENT VLS_CAT_O2_SUM_LONG_1 "lam1vvls_cat_o2_sumvlongword" ULONG UNSIGNED_LONG 2 2.0 0.0 4.2949673e+009 BIT_MASK 0xffffffff ECU_ADDRESS 0x40d30 /end MEASUREMENT
/begin MEASUREMENT VLS_CAT_O2_SUM_HIGH_WORD_1 "lam1vvls_cat_o2_sumvwordC1D" UWORD LINEAR______0_000000__0H___42806 2 2.0 0.0 4.2949673e+009 BIT_MASK 0xffffffff ECU_ADDRESS 0x40d32 /end MEASUREMENT
/begin MEASUREMENT VLS_CAT_TRAN_PUC_1 "lam1vvls_cat_tran_puc" UBYTE LINEAR______0_000000__0H___1_804 2 2.0 0.0 1.275 BIT_MASK 0xffffffff ECU_ADDRESS 0x40d16 /end MEASUREMENT
/begin MEASUREMENT VLS_CYC_AFL_RATIO_MV_1 "lam1vvls_cyc_afl_ratio_mv" UWORD LINEAR______0_000000__0H___25807 2 2.0 0.0 255.9961 BIT_MASK 0xffffffff ECU_ADDRESS 0x40d56 /end MEASUREMENT
/begin MEASUREMENT VLS_CYC_AFR_RATIO_MV_1 "lam1vvls_cyc_afr_ratio_mv" UWORD LINEAR______0_000000__0H___25807 2 2.0 0.0 255.9961 BIT_MASK 0xffffffff ECU_ADDRESS 0x40d54 /end MEASUREMENT
/begin MEASUREMENT VLS_CYCNR_AFL_RATIO_1 "lam1vvls_cycnr_afl_ratio" UWORD LINEAR______0_000000__0H___25808 2 2.0 0.0 255.9961 BIT_MASK 0xffffffff ECU_ADDRESS 0x40d60 /end MEASUREMENT
/begin MEASUREMENT VLS_CYCNR_AFL_RATIO_MV_1 "lam1vvls_cycnr_afl_ratio_mv" UWORD LINEAR______0_000000__0H___25791 2 2.0 0.0 255.996 BIT_MASK 0xffffffff ECU_ADDRESS 0x40d5c /end MEASUREMENT
/begin MEASUREMENT VLS_CYCNR_AFL_RATIO_SUM_1 "lam1vvls_cycnr_afl_ratio_sum" UWORD LINEAR______0_000000__0H___25808 2 2.0 0.0 255.9961 BIT_MASK 0xffffffff ECU_ADDRESS 0x40d64 /end MEASUREMENT
/begin MEASUREMENT VLS_CYCNR_AFR_RATIO_1 "lam1vvls_cycnr_afr_ratio" UWORD LINEAR______0_000000__0H___25808 2 2.0 0.0 255.9961 BIT_MASK 0xffffffff ECU_ADDRESS 0x40d5e /end MEASUREMENT
/begin MEASUREMENT VLS_CYCNR_AFR_RATIO_MV_1 "lam1vvls_cycnr_afr_ratio_mv" UWORD LINEAR______0_000000__0H___25807 2 2.0 0.0 255.9961 BIT_MASK 0xffffffff ECU_ADDRESS 0x40d5a /end MEASUREMENT
/begin MEASUREMENT VLS_CYCNR_AFR_RATIO_SUM_1 "lam1vvls_cycnr_afr_ratio_sum" UWORD LINEAR______0_000000__0H___25808 2 2.0 0.0 255.9961 BIT_MASK 0xffffffff ECU_ADDRESS 0x40d62 /end MEASUREMENT
/begin MEASUREMENT VLS_CYCNR_MAX_1 "lam1vvls_cycnr_max" UBYTE LINEAR______0_000000__0H___1_804 2 2.0 0.0 1.275 BIT_MASK 0xffffffff ECU_ADDRESS 0x40cec /end MEASUREMENT
/begin MEASUREMENT VLS_CYCNR_MIN_1 "lam1vvls_cycnr_min" UBYTE LINEAR______0_000000__0H___1_804 2 2.0 0.0 1.275 BIT_MASK 0xffffffff ECU_ADDRESS 0x40ced /end MEASUREMENT
/begin MEASUREMENT VLS_DIAG_STATE_1 "lam1vvls_diag_state" UBYTE LINEAR______0_000000__0H___25789 2 2.0 0.0 255.0 BIT_MASK 0xffffffff ECU_ADDRESS 0x40cea /end MEASUREMENT
/begin MEASUREMENT VLS_DIF_CUR_OFF_DOWN_1 "lam1vvls_dif_cur_off_down" UWORD LINEAR______0_000000__0H___5_184 2 2.0 0.0 5.0 BIT_MASK 0xffffffff FUNCTION_LIST R_LS_CALC ECU_ADDRESS 0x40d90 /end MEASUREMENT
/begin MEASUREMENT VLS_DIF_CUR_OFF_UP_1 "lam1vvls_dif_cur_off_up" UWORD LINEAR______0_000000__0H___5_184 2 2.0 0.0 5.0 BIT_MASK 0xffffffff FUNCTION_LIST R_LS_CALC ECU_ADDRESS 0x40d8e /end MEASUREMENT
/begin MEASUREMENT VLS_DIF_DLY_1 "lam1vvls_dif_dly" UBYTE LINEAR_______0_637500__0H___0809 2 2.0 -0.6375 0.6375 BIT_MASK 0xffffffff ECU_ADDRESS 0x40d01 /end MEASUREMENT
/begin MEASUREMENT VLS_DOWN_1 "lam1vvls_down" UBYTE LINEAR______0_000000__0H___1_804 2 2.0 0.0 1.275 BIT_MASK 0xffffffff ECU_ADDRESS 0x40cf1 /end MEASUREMENT
/begin MEASUREMENT VLS_DOWN_MMV_1 "lam1vvls_down_mmvvbyteC1D" UBYTE LINEAR______0_000000__0H___1_810 2 2.0 0.0 1.275 BIT_MASK 0xffffffff ECU_ADDRESS 0x40cf3 /end MEASUREMENT
/begin MEASUREMENT VLS_DOWN_1_PREV_DIAG "lam1vvls_down_prev_diag" UBYTE LINEAR______0_000000__0H___1_804 2 2.0 0.0 1.275 BIT_MASK 0xffffffff ECU_ADDRESS 0x40cf0 /end MEASUREMENT
/begin MEASUREMENT VLS_DOWN_SCG_DIAG_CNT_1 "lam1vvls_down_scg_diag_cnt" UWORD LINEAR______0_000000__0H___65811 2 2.0 0.0 65535.0 BIT_MASK 0xffffffff ECU_ADDRESS 0x40c9e /end MEASUREMENT
/begin MEASUREMENT VLS_MAX_CYCNR_AFL_1 "lam1vvls_max_cycnr_afl" UWORD LINEAR______0_000000__0H___65803 2 2.0 0.0 655.35 BIT_MASK 0xffffffff ECU_ADDRESS 0x40d6a /end MEASUREMENT
/begin MEASUREMENT VLS_MAX_CYCNR_AFR_1 "lam1vvls_max_cycnr_afr" UWORD LINEAR______0_000000__0H___65803 2 2.0 0.0 655.35 BIT_MASK 0xffffffff ECU_ADDRESS 0x40d6c /end MEASUREMENT
/begin MEASUREMENT VLS_MMV_MAX_UP_1 "lam1vvls_mmv_max_upvbyteC1D" UBYTE LINEAR______0_000000__0H___1_804 2 2.0 0.0 1.275 BIT_MASK 0xffffffff ECU_ADDRESS 0x40c5f /end MEASUREMENT
/begin MEASUREMENT VLS_MMV_MIN_UP_1 "lam1vvls_mmv_min_upvbyteC1D" UBYTE LINEAR______0_000000__0H___1_804 2 2.0 0.0 1.275 BIT_MASK 0xffffffff ECU_ADDRESS 0x40c61 /end MEASUREMENT
/begin MEASUREMENT VLS_RAW_1 "lam1vvls_raw" UBYTE LINEAR______0_000000__0H___1_275 2 2.0 0.0 1.275 BIT_MASK 0xffffffff ECU_ADDRESS 0x40cdf /end MEASUREMENT
/begin MEASUREMENT VLS_TOL_UP_1 "lam1vvls_tol_up" UBYTE LINEAR______0_000000__0H___1_804 2 2.0 0.0 1.275 BIT_MASK 0xffffffff ECU_ADDRESS 0x40ce0 /end MEASUREMENT
/begin MEASUREMENT VLS_UP_1 "lam1vvls_up" UBYTE LINEAR______0_000000__0H___1_804 2 2.0 0.0 1.275 BIT_MASK 0xffffffff ECU_ADDRESS 0x40cdc /end MEASUREMENT
/begin MEASUREMENT VLS_UP_OL_DIAG_CNT_1 "lam1vvls_up_ol_diag_cnt" UWORD LINEAR______0_000000__0H___65113 2 2.0 0.0 65535.0 BIT_MASK 0xffffffff ECU_ADDRESS 0x40ca0 /end MEASUREMENT
/begin MEASUREMENT VLS_UP_1_PREV_DIAG "lam1vvls_up_prev_diag" UBYTE LINEAR______0_000000__0H___1_804 2 2.0 0.0 1.275 BIT_MASK 0xffffffff ECU_ADDRESS 0x40ce9 /end MEASUREMENT
/begin MEASUREMENT VLS_UP_1_PREV_DIAG_OLD "lam1vvls_up_prev_diag_old" UBYTE LINEAR______0_000000__0H___1_804 2 2.0 0.0 1.275 BIT_MASK 0xffffffff ECU_ADDRESS 0x40ceb /end MEASUREMENT
/begin MEASUREMENT VLS_UP_SCG_DIAG_CNT_1 "lam1vvls_up_scg_diag_cnt" UWORD LINEAR______0_000000__0H___65812 2 2.0 0.0 65535.0 BIT_MASK 0xffffffff ECU_ADDRESS 0x40ca2 /end MEASUREMENT
/begin MEASUREMENT LAM_2_BITWORD_1 "lam2vbit_vword" UWORD LINEAR______0_000000__0H___65535 2 2.0 0.0 65535.0 BIT_MASK 0xffffffff FUNCTION_LIST R_LS_CALC ECU_ADDRESS 0x40d96 /end MEASUREMENT
/begin MEASUREMENT CAT_DIAG_2 "lam2vcat_diag" UWORD LINEAR______0_000000__0H___2559_ 2 2.0 0.0 2559.9609 BIT_MASK 0xffffffff ECU_ADDRESS 0x40e86 /end MEASUREMENT
/begin MEASUREMENT CAT_DIAG_ERR_2 "lam2vcat_diag_err" UBYTE LINEAR______0_000000__0H___25790 2 2.0 0.0 255.0 BIT_MASK 0xffffffff ECU_ADDRESS 0x40e4c /end MEASUREMENT
/begin MEASUREMENT CAT_DIAG_SF_2 "lam2vcat_diag_sf" UWORD LINEAR______0_000000__0H___65773 2 2.0 0.0 65535.0 BIT_MASK 0xffffffff ECU_ADDRESS 0x40dc0 /end MEASUREMENT
/begin MEASUREMENT CAT_DIAG_TEG_2 "lam2vcat_diag_teg" UWORD LINEAR______0_000000__0H___63_99 2 2.0 0.0 63.999023 BIT_MASK 0xffffffff ECU_ADDRESS 0x40ea6 /end MEASUREMENT
/begin MEASUREMENT CAT_EXOTH_POW_2 "lam2vcat_exoth_pow" UWORD LINEAR______0_000000__0H___7_774 2 2.0 0.0 7.999878 BIT_MASK 0xffffffff ECU_ADDRESS 0x40ea2 /end MEASUREMENT
/begin MEASUREMENT CTR_LAM_AFL_AFR_2 "lam2vctr_lam_afl_afr" UBYTE LINEAR______0_000000__0H___25790 2 2.0 0.0 255.0 BIT_MASK 0xffffffff ECU_ADDRESS 0x40e42 /end MEASUREMENT
/begin MEASUREMENT CTR_LAM_CYCNR_DIAG_2 "lam2vctr_lam_cycnr_diag" UWORD LINEAR______0_000000__0H___65776 2 2.0 0.0 65535.0 BIT_MASK 0xffffffff ECU_ADDRESS 0x40d98 /end MEASUREMENT
/begin MEASUREMENT CTR_LAM_DLY_2 "lam2vctr_lam_dly" UWORD LINEAR______0_000000__0H___65777 2 2.0 0.0 65535.0 BIT_MASK 0xffffffff ECU_ADDRESS 0x40e6e /end MEASUREMENT
/begin MEASUREMENT CTR_LAM_MAX_CYCNR_2 "lam2vctr_lam_max_cycnr" UBYTE LINEAR______0_000000__0H___25778 2 2.0 0.0 255.0 BIT_MASK 0xffffffff ECU_ADDRESS 0x40e41 /end MEASUREMENT
/begin MEASUREMENT CTR_LAM_SUM_P_IS_2 "lam2vctr_lam_sum_p_is" UBYTE LINEAR______0_000000__0H___25789 2 2.0 0.0 255.0 BIT_MASK 0xffffffff ECU_ADDRESS 0x40e40 /end MEASUREMENT
/begin MEASUREMENT CTR_VLS_CAT_DIAG_2 "lam2vctr_vls_cat_diag" UBYTE LINEAR______0_000000__0H___25789 2 2.0 0.0 255.0 BIT_MASK 0xffffffff ECU_ADDRESS 0x40e73 /end MEASUREMENT
/begin MEASUREMENT CYCNR_CAT_DIAG_2 "lam2vcycnr_cat_diag" UBYTE LINEAR______0_000000__0H___25790 2 2.0 0.0 255.0 BIT_MASK 0xffffffff ECU_ADDRESS 0x40e4d /end MEASUREMENT
/begin MEASUREMENT DRV1_VLS_DOWN_ABS_MAX_2 "lam2vdrv1_vls_down_abs_max" SWORD LINEAR_______1_275000__FFFF8080H 2 2.0 -1.275 1.275 BIT_MASK 0xffffffff FUNCTION_LIST R_LS_CALC ECU_ADDRESS 0x40e30 /end MEASUREMENT
/begin MEASUREMENT DRV1_VLS_DOWN_MMV_2 "lam2vdrv1_vls_down_mmv" SWORD LINEAR_______1_275000__FFFF80102 2 2.0 -1.275 1.275 BIT_MASK 0xffffffff FUNCTION_LIST R_LS_CALC ECU_ADDRESS 0x40e2e /end MEASUREMENT
/begin MEASUREMENT DRV1_VLS_UP_ABS_MAX_2 "lam2vdrv1_vls_up_abs_max" SWORD LINEAR_______1_275000__FFFF8080H 2 2.0 -1.275 1.275 BIT_MASK 0xffffffff FUNCTION_LIST R_LS_CALC ECU_ADDRESS 0x40e18 /end MEASUREMENT
/begin MEASUREMENT DRV1_VLS_UP_MMV_2 "lam2vdrv1_vls_up_mmv" SWORD LINEAR_______1_275000__FFFF80102 2 2.0 -1.275 1.275 BIT_MASK 0xffffffff FUNCTION_LIST R_LS_CALC ECU_ADDRESS 0x40e16 /end MEASUREMENT
/begin MEASUREMENT LAM_2 "lam2vlam" UWORD LINEAR_______50_000000__0H___440 2 2.0 -50.0 49.998471 BIT_MASK 0xffffffff ECU_ADDRESS 0x40d9e /end MEASUREMENT
/begin MEASUREMENT LAM_I_2 "lam2vlam_i" UWORD LINEAR_______50_000000__0H___779 2 2.0 -50.0 49.998471 BIT_MASK 0xffffffff ECU_ADDRESS 0x40da2 /end MEASUREMENT
/begin MEASUREMENT LAM_INT_2 "lam2vlam_intvbyteC1D" UBYTE LINEAR_______50_000000__0H___813 2 2.0 -50.0 49.6094 BIT_MASK 0xffffffff ECU_ADDRESS 0x40db3 /end MEASUREMENT
/begin MEASUREMENT LAM_LIM_AFL_2 "lam2vlam_lim_afl" UWORD LINEAR_______50_000000__0H___779 2 2.0 -50.0 49.998471 BIT_MASK 0xffffffff ECU_ADDRESS 0x40da4 /end MEASUREMENT
/begin MEASUREMENT LAM_LIM_AFR_2 "lam2vlam_lim_afr" UWORD LINEAR_______50_000000__0H___779 2 2.0 -50.0 49.998471 BIT_MASK 0xffffffff ECU_ADDRESS 0x40da6 /end MEASUREMENT
/begin MEASUREMENT LAM_MV_2 "lam2vlam_mvvbyteC1D" UBYTE LINEAR_______50_000000__0H___814 2 2.0 -50.0 49.6094 BIT_MASK 0xffffffff ECU_ADDRESS 0x40db7 /end MEASUREMENT
/begin MEASUREMENT LAM_MV_DYW_2 "lam2vlam_mv_dywvbyteC1D" UBYTE LINEAR_______50_000000__0H___814 2 2.0 -50.0 49.6094 BIT_MASK 0xffffffff ECU_ADDRESS 0x40db5 /end MEASUREMENT
/begin MEASUREMENT LAM_MV_MMV_CAT_2 "lam2vlam_mv_mmv_catvwordC1D" UWORD LINEAR_______50_000000__0H___780 2 2.0 -50.0 49.998471 BIT_MASK 0xffffffff ECU_ADDRESS 0x40dc8 /end MEASUREMENT
/begin MEASUREMENT LAM_OLD_2 "lam2vlam_old" UWORD LINEAR_______50_000000__0H___779 2 2.0 -50.0 49.998471 BIT_MASK 0xffffffff ECU_ADDRESS 0x40da0 /end MEASUREMENT
/begin MEASUREMENT LAM_STATE_1_LOW_BYTE_2 "lam2vlam_statevbyteC0D" UBYTE LINEAR______0_000000__0H___25815 2 2.0 0.0 255.0 BIT_MASK 0xffffffff ECU_ADDRESS 0x40d9a /end MEASUREMENT
/begin MEASUREMENT LAM_STATE_1_HIGH_BYTE_2 "lam2vlam_statevbyteC1D" UBYTE LINEAR______0_000000__0H___25815 2 2.0 0.0 255.0 BIT_MASK 0xffffffff ECU_ADDRESS 0x40d9b /end MEASUREMENT
/begin MEASUREMENT LAM_STATE_2_LOW_BYTE_2 "lam2vlam_state_2vbyteC0D" UBYTE LINEAR______0_000000__0H___25815 2 2.0 0.0 255.0 BIT_MASK 0xffffffff ECU_ADDRESS 0x40d9c /end MEASUREMENT
/begin MEASUREMENT LAM_STATE_2_HIGH_BYTE_2 "lam2vlam_state_2vbyteC1D" UBYTE LINEAR______0_000000__0H___25815 2 2.0 0.0 255.0 BIT_MASK 0xffffffff ECU_ADDRESS 0x40d9d /end MEASUREMENT
/begin MEASUREMENT MAF_DYW_2 "lam2vmaf_dywvbyteC1D" UBYTE LINEAR______0_000000__0H___1389_ 2 2.0 0.0 1389.0 BIT_MASK 0xffffffff ECU_ADDRESS 0x40dbb /end MEASUREMENT
/begin MEASUREMENT MAF_INT_CAT_2 "lam2vmaf_int_cat" UWORD LINEAR______0_000000__0H___18782 2 2.0 0.0 1820.42 BIT_MASK 0xffffffff ECU_ADDRESS 0x40e8c /end MEASUREMENT
/begin MEASUREMENT MAF_INT_DLY_2 "lam2vmaf_int_dly" UWORD LINEAR______0_000000__0H___18783 2 2.0 0.0 1820.42 BIT_MASK 0xffffffff ECU_ADDRESS 0x40dec /end MEASUREMENT
/begin MEASUREMENT MAF_INT_DLY_P_I_2 "lam2vmaf_int_dly_p_i" UWORD LINEAR______0_000000__0H___18783 2 2.0 0.0 1820.42 BIT_MASK 0xffffffff ECU_ADDRESS 0x40dee /end MEASUREMENT
/begin MEASUREMENT N_DYW_2 "lam2vn_dywvword" UWORD LINEAR______0_000000__0H___81816 2 2.0 0.0 8160.0 BIT_MASK 0xffffffff ECU_ADDRESS 0x40db8 /end MEASUREMENT
/begin MEASUREMENT O2_CAT2 "lam2vo2_cat" UBYTE LINEAR______0_000000__0H___0_996 2 2.0 0.0 0.99609375 BIT_MASK 0xffffffff ECU_ADDRESS 0x40e96 /end MEASUREMENT
/begin MEASUREMENT O2_CAT_DIF_SUM_2 "lam2vo2_cat_dif_sum" UWORD LINEAR______0_000000__0H___5119_ 2 2.0 0.0 5119.9219 BIT_MASK 0xffffffff ECU_ADDRESS 0x40e7c /end MEASUREMENT
/begin MEASUREMENT O2_CAT_MV_2 "lam2vo2_cat_mv" UBYTE LINEAR______0_000000__0H___0_996 2 2.0 0.0 0.99609375 BIT_MASK 0xffffffff ECU_ADDRESS 0x40e92 /end MEASUREMENT
/begin MEASUREMENT O2_CAT_MV_OLD_2 "lam2vo2_cat_mv_old" UBYTE LINEAR______0_000000__0H___0_996 2 2.0 0.0 0.99609375 BIT_MASK 0xffffffff ECU_ADDRESS 0x40e94 /end MEASUREMENT
/begin MEASUREMENT O2_CAT_QUO_2 "lam2vo2_cat_quo" UWORD LINEAR______0_000000__0H___20_00 2 2.0 0.0 20.0 BIT_MASK 0xffffffff ECU_ADDRESS 0x40e8a /end MEASUREMENT
/begin MEASUREMENT O2_CAT_QUO_SUM_2 "lam2vo2_cat_quo_sum" UWORD LINEAR______0_000000__0H___2559_ 2 2.0 0.0 2559.9609 BIT_MASK 0xffffffff ECU_ADDRESS 0x40e80 /end MEASUREMENT
/begin MEASUREMENT O2_CAT_SUM_2 "lam2vo2_cat_sum" UWORD LINEAR______0_000000__0H___5_119 2 2.0 0.0 5.1192065 BIT_MASK 0xffffffff ECU_ADDRESS 0x40e7e /end MEASUREMENT
/begin MEASUREMENT OV_TI_AD_ADD_FAC_2 "lam2vov_ti_ad_add_fac" UBYTE LINEAR______0_000000__0H___0_996 2 2.0 0.0 0.99609375 BIT_MASK 0xffffffff ECU_ADDRESS 0x40e46 /end MEASUREMENT
/begin MEASUREMENT OV_TI_AD_FAC_FAC_2 "lam2vov_ti_ad_fac_fac" UBYTE LINEAR______0_000000__0H___0_785 2 2.0 0.0 0.99609375 BIT_MASK 0xffffffff ECU_ADDRESS 0x40e45 /end MEASUREMENT
/begin MEASUREMENT PVS_GRD_DEC_CTL_2 "lam2vpvs_grd_dec_ctl" UBYTE LINEAR______0_000000__0H___5_120 2 2.0 0.0 5.12 BIT_MASK 0xffffffff ECU_ADDRESS 0x40e38 /end MEASUREMENT
/begin MEASUREMENT PVS_GRD_SUM_2 "lam2vpvs_grd_sum" UWORD LINEAR______0_000000__0H___76786 2 2.0 0.0 767916.0 BIT_MASK 0xffffffff ECU_ADDRESS 0x40dd8 /end MEASUREMENT
/begin MEASUREMENT PVS_GRD_SUM_DLY_2 "lam2vpvs_grd_sum_dly" UWORD LINEAR______0_000000__0H___76787 2 2.0 0.0 767916.0 BIT_MASK 0xffffffff ECU_ADDRESS 0x40dda /end MEASUREMENT
/begin MEASUREMENT R_LS_DOWN_2 "lam2vr_ls_down" UWORD LINEAR______0_000000__0H___65142 2 2.0 0.0 65535.0 BIT_MASK 0xffffffff ECU_ADDRESS 0x40ee4 /end MEASUREMENT
/begin MEASUREMENT R_LS_UP_2 "lam2vr_ls_up" UWORD LINEAR______0_000000__0H___65142 2 2.0 0.0 65535.0 BIT_MASK 0xffffffff ECU_ADDRESS 0x40ee2 /end MEASUREMENT
/begin MEASUREMENT STATE_DOWN_DIAG_2 "lam2vstate_down_diag" UBYTE LINEAR______0_000000__0H___25788 2 2.0 0.0 255.0 BIT_MASK 0xffffffff ECU_ADDRESS 0x40e72 /end MEASUREMENT
/begin MEASUREMENT STATE_SA_DIAG_SF_2 "lam2vstate_sa_diag_sf" UBYTE LINEAR______0_000000__0H___25789 2 2.0 0.0 255.0 BIT_MASK 0xffffffff ECU_ADDRESS 0x40dd2 /end MEASUREMENT
/begin MEASUREMENT SUM_AFL_AFR_2 "lam2vsum_afl_afr" UBYTE LINEAR______0_000000__0H___25790 2 2.0 0.0 255.0 BIT_MASK 0xffffffff ECU_ADDRESS 0x40e54 /end MEASUREMENT
/begin MEASUREMENT SUM_AFL_VLS_SA_DIAG_2 "lam2vsum_afl_vls_sa_diag" UWORD LINEAR______0_000000__0H___65776 2 2.0 0.0 65535.0 BIT_MASK 0xffffffff ECU_ADDRESS 0x40dd4 /end MEASUREMENT
/begin MEASUREMENT SUM_CAT_DIAG_2 "lam2vsum_cat_diag" UWORD LINEAR______0_000000__0H___65776 2 2.0 0.0 65535.0 BIT_MASK 0xffffffff ECU_ADDRESS 0x40e82 /end MEASUREMENT
/begin MEASUREMENT SUM_CRLC_TI_AD_ADD_CLC_2 "lam2vsum_crlc_ti_ad_add_clc" UWORD LINEAR______0_000000__0H___25791 2 2.0 0.0 255.996 BIT_MASK 0xffffffff ECU_ADDRESS 0x40e5a /end MEASUREMENT
/begin MEASUREMENT SUM_CRLC_TI_AD_FAC_CLC_2 "lam2vsum_crlc_ti_ad_fac_clc" UWORD LINEAR______0_000000__0H___25791 2 2.0 0.0 255.996 BIT_MASK 0xffffffff ECU_ADDRESS 0x40e5c /end MEASUREMENT
/begin MEASUREMENT SUM_CYC_2 "lam2vsum_cyc" UWORD LINEAR______0_000000__0H___65776 2 2.0 0.0 65535.0 BIT_MASK 0xffffffff ECU_ADDRESS 0x40e84 /end MEASUREMENT
/begin MEASUREMENT SUM_CYCNR_AFL_2 "lam2vsum_cycnr_afl" UWORD LINEAR______0_000000__0H___65776 2 2.0 0.0 65535.0 BIT_MASK 0xffffffff ECU_ADDRESS 0x40ec6 /end MEASUREMENT
/begin MEASUREMENT SUM_CYCNR_AFR_2 "lam2vsum_cycnr_afr" UWORD LINEAR______0_000000__0H___65776 2 2.0 0.0 65535.0 BIT_MASK 0xffffffff ECU_ADDRESS 0x40ec4 /end MEASUREMENT
/begin MEASUREMENT SUM_LAM_P_2 "lam2vsum_lam_p" UBYTE LINEAR______0_000000__0H___25790 2 2.0 0.0 255.0 BIT_MASK 0xffffffff ECU_ADDRESS 0x40e43 /end MEASUREMENT
/begin MEASUREMENT SUM_P_CAT_2 "lam2vsum_p_cat" UBYTE LINEAR______0_000000__0H___25790 2 2.0 0.0 255.0 BIT_MASK 0xffffffff ECU_ADDRESS 0x40e52 /end MEASUREMENT
/begin MEASUREMENT SUM_P_CP_2 "lam2vsum_p_cp" UBYTE LINEAR______0_000000__0H___25790 2 2.0 0.0 255.0 BIT_MASK 0xffffffff ECU_ADDRESS 0x40e44 /end MEASUREMENT
/begin MEASUREMENT SUM_P_JUMP_2 "lam2vsum_p_jump" UBYTE LINEAR______0_000000__0H___25790 2 2.0 0.0 255.0 BIT_MASK 0xffffffff ECU_ADDRESS 0x40e55 /end MEASUREMENT
/begin MEASUREMENT SUM_P_LAM_LIM_2 "lam2vsum_p_lam_lim" UBYTE LINEAR______0_000000__0H___25790 2 2.0 0.0 255.0 BIT_MASK 0xffffffff ECU_ADDRESS 0x40e57 /end MEASUREMENT
/begin MEASUREMENT SUM_P_LIM_DYN_2 "lam2vsum_p_lim_dyn" UBYTE LINEAR______0_000000__0H___25790 2 2.0 0.0 255.0 BIT_MASK 0xffffffff ECU_ADDRESS 0x40e58 /end MEASUREMENT
/begin MEASUREMENT SUM_P_LS_DIAG_2 "lam2vsum_p_ls_diag" UBYTE LINEAR______0_000000__0H___25790 2 2.0 0.0 255.0 BIT_MASK 0xffffffff ECU_ADDRESS 0x40e5e /end MEASUREMENT
/begin MEASUREMENT SUM_P_RAMP_INTR_2 "lam2vsum_p_ramp_intr" UBYTE LINEAR______0_000000__0H___25790 2 2.0 0.0 255.0 BIT_MASK 0xffffffff ECU_ADDRESS 0x40e56 /end MEASUREMENT
/begin MEASUREMENT T_CAT_DIAG_TEG_2 "lam2vt_cat_diag_teg" UBYTE LINEAR______0_000000__0H___25_50 2 2.0 0.0 25.5 BIT_MASK 0xffffffff ECU_ADDRESS 0x40ea8 /end MEASUREMENT
/begin MEASUREMENT T_DLY_2 "lam2vt_dly" UWORD LINEAR_______2_555800__0H___2_55 2 2.0 -2.5558 2.5557 BIT_MASK 0xffffffff ECU_ADDRESS 0x40e64 /end MEASUREMENT
/begin MEASUREMENT T_DLY_AD_2 "lam2vt_dly_ad" SWORD LINEAR_______640_020000__FFFF792 2 2.0 -640.02 639.98 BIT_MASK 0xffffffff ECU_ADDRESS 0x40de6 /end MEASUREMENT
/begin MEASUREMENT T_DLY_AD_MMV_2 "lam2vt_dly_ad_mmv" SWORD LINEAR_______640_020000__FFFF792 2 2.0 -640.02 639.98 BIT_MASK 0xffffffff ECU_ADDRESS 0x40de8 /end MEASUREMENT
/begin MEASUREMENT T_DLY_I_2 "lam2vt_dly_ivwordC1D" SWORD LINEAR_______640_020000__FFFF792 2 2.0 -640.02 639.98 BIT_MASK 0xffffffff ECU_ADDRESS 0x40de4 /end MEASUREMENT
/begin MEASUREMENT T_DLY_P_2 "lam2vt_dly_p" SWORD LINEAR_______2_555800__FFFF8000H 2 2.0 -2.5558 2.555522 BIT_MASK 0xffffffff ECU_ADDRESS 0x40de0 /end MEASUREMENT
/begin MEASUREMENT T_DLY_TCO_2 "lam2vt_dly_tco" UWORD LINEAR_______2_555800__0H___2_55 2 2.0 -2.5558 2.5557 BIT_MASK 0xffffffff ECU_ADDRESS 0x40e66 /end MEASUREMENT
/begin MEASUREMENT T_DLY_TCO_IS_2 "lam2vt_dly_tco_is" UWORD LINEAR_______2_555800__0H___2_55 2 2.0 -2.5558 2.5557 BIT_MASK 0xffffffff ECU_ADDRESS 0x40e68 /end MEASUREMENT
/begin MEASUREMENT T_LAM_DLY_2 "lam2vt_lam_dly" SWORD LINEAR_______2_555800__FFFF8000H 2 2.0 -2.5558 2.555522 BIT_MASK 0xffffffff ECU_ADDRESS 0x40dea /end MEASUREMENT
/begin MEASUREMENT T_SUM_MAX_FSD_2 "lam2vt_sum_max_fsd" UWORD LINEAR______0_000000__0H___13793 2 2.0 0.0 1310.7 BIT_MASK 0xffffffff ECU_ADDRESS 0x40ed2 /end MEASUREMENT
/begin MEASUREMENT T_SUM_MIN_FSD_2 "lam2vt_sum_min_fsd" UWORD LINEAR______0_000000__0H___13793 2 2.0 0.0 1310.7 BIT_MASK 0xffffffff ECU_ADDRESS 0x40ed4 /end MEASUREMENT
/begin MEASUREMENT T_VLS_CYC_AFL_2 "lam2vt_vls_cyc_afl" UWORD LINEAR______0_000000__0H___13794 2 2.0 0.0 1310.7 BIT_MASK 0xffffffff ECU_ADDRESS 0x40dcc /end MEASUREMENT
/begin MEASUREMENT T_VLS_CYC_AFL_MAX_SUM_2 "lam2vt_vls_cyc_afl_max_sum" UWORD LINEAR______0_000000__0H___13795 2 2.0 0.0 1310.7 BIT_MASK 0xffffffff ECU_ADDRESS 0x40eae /end MEASUREMENT
/begin MEASUREMENT T_VLS_CYC_AFL_SUM_2 "lam2vt_vls_cyc_afl_sum" UWORD LINEAR______0_000000__0H___13795 2 2.0 0.0 1310.7 BIT_MASK 0xffffffff ECU_ADDRESS 0x40eaa /end MEASUREMENT
/begin MEASUREMENT T_VLS_CYC_AFR_2 "lam2vt_vls_cyc_afr" UWORD LINEAR______0_000000__0H___13794 2 2.0 0.0 1310.7 BIT_MASK 0xffffffff ECU_ADDRESS 0x40dca /end MEASUREMENT
/begin MEASUREMENT T_VLS_CYC_AFR_MAX_SUM_2 "lam2vt_vls_cyc_afr_max_sum" UWORD LINEAR______0_000000__0H___13795 2 2.0 0.0 1310.7 BIT_MASK 0xffffffff ECU_ADDRESS 0x40eb0 /end MEASUREMENT
/begin MEASUREMENT T_VLS_CYC_AFR_SUM_2 "lam2vt_vls_cyc_afr_sum" UWORD LINEAR______0_000000__0H___13795 2 2.0 0.0 1310.7 BIT_MASK 0xffffffff ECU_ADDRESS 0x40eac /end MEASUREMENT
/begin MEASUREMENT T_VLS_CYCNR_AFL_2 "lam2vt_vls_cycnr_afl" UWORD LINEAR______0_000000__0H___65796 2 2.0 0.0 655.35 BIT_MASK 0xffffffff ECU_ADDRESS 0x40dc4 /end MEASUREMENT
/begin MEASUREMENT T_VLS_CYCNR_AFR_2 "lam2vt_vls_cycnr_afr" UWORD LINEAR______0_000000__0H___65796 2 2.0 0.0 655.35 BIT_MASK 0xffffffff ECU_ADDRESS 0x40dc2 /end MEASUREMENT
/begin MEASUREMENT TEG_DOWN_MDL_2 "lam2vteg_down_mdl" UWORD LINEAR______0_000000__0H___10253 2 2.0 0.0 1023.9844 BIT_MASK 0xffffffff ECU_ADDRESS 0x40e9e /end MEASUREMENT
/begin MEASUREMENT TEMP_CAT_2 "lam2vtemp_cat" UWORD LINEAR______0_000000__0H___10797 2 2.0 0.0 1023.0 BIT_MASK 0xffffffff ECU_ADDRESS 0x40dd6 /end MEASUREMENT
/begin MEASUREMENT TI_AD_ADD_MMV_2 "lam2vti_ad_add_mmv" UWORD TI_SGN_16_RES 2 2.0 -131.072 131.068 BIT_MASK 0xffffffff ECU_ADDRESS 0x40da8 /end MEASUREMENT
/begin MEASUREMENT TI_AD_ADD_MMV_ES_2 "lam2vti_ad_add_mmv_es" SWORD LINEAR_______174_762666__FFFF798 2 2.0 -174.76267 174.75733 BIT_MASK 0xffffffff ECU_ADDRESS 0x40daa /end MEASUREMENT
/begin MEASUREMENT TI_AD_ADD_MMV_PR_2 "lam2vti_ad_add_mmv_pr" SWORD LINEAR_______50_000000__FFFF8799 2 2.0 -50.0 49.9985 BIT_MASK 0xffffffff ECU_ADDRESS 0x40dac /end MEASUREMENT
/begin MEASUREMENT TI_AD_FAC_MMV_2 "lam2vti_ad_fac_mmv" UWORD LINEAR_______50_000000__0H___780 2 2.0 -50.0 49.998471 BIT_MASK 0xffffffff ECU_ADDRESS 0x40dae /end MEASUREMENT
/begin MEASUREMENT TI_BANK_2 "lam2vti_bank" UWORD LINEAR______0_000000__0H___349_5 2 2.0 0.0 349.52 BIT_MASK 0xffffffff ECU_ADDRESS 0x40ed0 /end MEASUREMENT
/begin MEASUREMENT TI_COP_CBK_2 "lam2vti_cop" UWORD LINEAR______0_000000__0H___16800 2 2.0 0.0 16.0 BIT_MASK 0xffffffff ECU_ADDRESS 0x40ece /end MEASUREMENT
/begin MEASUREMENT TI_LAM_2 "lam2vti_lam" UWORD LINEAR_______100_00000__0H___100 2 2.0 -100.0 100.0 BIT_MASK 0xffffffff ECU_ADDRESS 0x40db0 /end MEASUREMENT
/begin MEASUREMENT TIB_2 "lam2vtib" UWORD LINEAR______0_000000__0H___34801 2 2.0 0.0 349.5 BIT_MASK 0xffffffff ECU_ADDRESS 0x40ecc /end MEASUREMENT
/begin MEASUREMENT TMC_2 "lam2vtmc" SWORD LINEAR_______512_000000__FFFF802 2 2.0 -512.0 511.98438 BIT_MASK 0xffffffff ECU_ADDRESS 0x40e9c /end MEASUREMENT
/begin MEASUREMENT VLS_AFL_CYCNR_DOWN_2 "lam2vvls_afl_cycnr_down" UWORD LINEAR______0_000000__0H___65803 2 2.0 0.0 655.35 BIT_MASK 0xffffffff ECU_ADDRESS 0x40dd0 /end MEASUREMENT
/begin MEASUREMENT VLS_AFR_CYCNR_DOWN_2 "lam2vvls_afr_cycnr_down" UWORD LINEAR______0_000000__0H___65803 2 2.0 0.0 655.35 BIT_MASK 0xffffffff ECU_ADDRESS 0x40dce /end MEASUREMENT
/begin MEASUREMENT VLS_BOL_UP_2 "lam2vvls_bol_up" UBYTE LINEAR______0_000000__0H___1_804 2 2.0 0.0 1.275 BIT_MASK 0xffffffff ECU_ADDRESS 0x40e3f /end MEASUREMENT
/begin MEASUREMENT VLS_CAT_CYCNR_2 "lam2vvls_cat_cycnr" UBYTE LINEAR______0_000000__0H___1_992 2 2.0 0.0 1.9921875 BIT_MASK 0xffffffff ECU_ADDRESS 0x40e77 /end MEASUREMENT
/begin MEASUREMENT VLS_CAT_CYCNR_AV_2 "lam2vvls_cat_cycnr_av" UBYTE LINEAR______0_000000__0H___51805 2 2.0 0.0 5100.0 BIT_MASK 0xffffffff ECU_ADDRESS 0x40e78 /end MEASUREMENT
/begin MEASUREMENT VLS_CAT_CYCNR_QUO_SUM_2 "lam2vvls_cat_cycnr_quo_sum" UWORD LINEAR______0_000000__0H___509_0 2 2.0 0.0 509.0055 BIT_MASK 0xffffffff ECU_ADDRESS 0x40e7a /end MEASUREMENT
/begin MEASUREMENT VLS_CAT_END_PUC_2 "lam2vvls_cat_end_puc" UBYTE LINEAR______0_000000__0H___1_804 2 2.0 0.0 1.275 BIT_MASK 0xffffffff ECU_ADDRESS 0x40e75 /end MEASUREMENT
/begin MEASUREMENT VLS_CAT_O2_SUM_LONG_2 "lam2vvls_cat_o2_sumvlongword" ULONG UNSIGNED_LONG 2 2.0 0.0 4.2949673e+009 BIT_MASK 0xffffffff ECU_ADDRESS 0x40e8e /end MEASUREMENT
/begin MEASUREMENT VLS_CAT_O2_SUM_HIGH_WORD_2 "lam2vvls_cat_o2_sumvwordC1D" UWORD LINEAR______0_000000__0H___42806 2 2.0 0.0 4.2949673e+009 BIT_MASK 0xffffffff ECU_ADDRESS 0x40e90 /end MEASUREMENT
/begin MEASUREMENT VLS_CAT_TRAN_PUC_2 "lam2vvls_cat_tran_puc" UBYTE LINEAR______0_000000__0H___1_804 2 2.0 0.0 1.275 BIT_MASK 0xffffffff ECU_ADDRESS 0x40e74 /end MEASUREMENT
/begin MEASUREMENT VLS_CYC_AFL_RATIO_MV_2 "lam2vvls_cyc_afl_ratio_mv" UWORD LINEAR______0_000000__0H___25807 2 2.0 0.0 255.9961 BIT_MASK 0xffffffff ECU_ADDRESS 0x40eb4 /end MEASUREMENT
/begin MEASUREMENT VLS_CYC_AFR_RATIO_MV_2 "lam2vvls_cyc_afr_ratio_mv" UWORD LINEAR______0_000000__0H___25807 2 2.0 0.0 255.9961 BIT_MASK 0xffffffff ECU_ADDRESS 0x40eb2 /end MEASUREMENT
/begin MEASUREMENT VLS_CYCNR_AFL_RATIO_2 "lam2vvls_cycnr_afl_ratio" UWORD LINEAR______0_000000__0H___25808 2 2.0 0.0 255.9961 BIT_MASK 0xffffffff ECU_ADDRESS 0x40ebe /end MEASUREMENT
/begin MEASUREMENT VLS_CYCNR_AFL_RATIO_MV_2 "lam2vvls_cycnr_afl_ratio_mv" UWORD LINEAR______0_000000__0H___25791 2 2.0 0.0 255.996 BIT_MASK 0xffffffff ECU_ADDRESS 0x40eba /end MEASUREMENT
/begin MEASUREMENT VLS_CYCNR_AFL_RATIO_SUM_2 "lam2vvls_cycnr_afl_ratio_sum" UWORD LINEAR______0_000000__0H___25808 2 2.0 0.0 255.9961 BIT_MASK 0xffffffff ECU_ADDRESS 0x40ec2 /end MEASUREMENT
/begin MEASUREMENT VLS_CYCNR_AFR_RATIO_2 "lam2vvls_cycnr_afr_ratio" UWORD LINEAR______0_000000__0H___25808 2 2.0 0.0 255.9961 BIT_MASK 0xffffffff ECU_ADDRESS 0x40ebc /end MEASUREMENT
/begin MEASUREMENT VLS_CYCNR_AFR_RATIO_MV_2 "lam2vvls_cycnr_afr_ratio_mv" UWORD LINEAR______0_000000__0H___25807 2 2.0 0.0 255.9961 BIT_MASK 0xffffffff ECU_ADDRESS 0x40eb8 /end MEASUREMENT
/begin MEASUREMENT VLS_CYCNR_AFR_RATIO_SUM_2 "lam2vvls_cycnr_afr_ratio_sum" UWORD LINEAR______0_000000__0H___25808 2 2.0 0.0 255.9961 BIT_MASK 0xffffffff ECU_ADDRESS 0x40ec0 /end MEASUREMENT
/begin MEASUREMENT VLS_CYCNR_MAX_2 "lam2vvls_cycnr_max" UBYTE LINEAR______0_000000__0H___1_804 2 2.0 0.0 1.275 BIT_MASK 0xffffffff ECU_ADDRESS 0x40e4a /end MEASUREMENT
/begin MEASUREMENT VLS_CYCNR_MIN_2 "lam2vvls_cycnr_min" UBYTE LINEAR______0_000000__0H___1_804 2 2.0 0.0 1.275 BIT_MASK 0xffffffff ECU_ADDRESS 0x40e4b /end MEASUREMENT
/begin MEASUREMENT VLS_DIAG_STATE_2 "lam2vvls_diag_state" UBYTE LINEAR______0_000000__0H___25789 2 2.0 0.0 255.0 BIT_MASK 0xffffffff ECU_ADDRESS 0x40e48 /end MEASUREMENT
/begin MEASUREMENT VLS_DIF_CUR_OFF_DOWN_2 "lam2vvls_dif_cur_off_down" UWORD LINEAR______0_000000__0H___5_184 2 2.0 0.0 5.0 BIT_MASK 0xffffffff FUNCTION_LIST R_LS_CALC ECU_ADDRESS 0x40eee /end MEASUREMENT
/begin MEASUREMENT VLS_DIF_CUR_OFF_UP_2 "lam2vvls_dif_cur_off_up" UWORD LINEAR______0_000000__0H___5_184 2 2.0 0.0 5.0 BIT_MASK 0xffffffff FUNCTION_LIST R_LS_CALC ECU_ADDRESS 0x40eec /end MEASUREMENT
/begin MEASUREMENT VLS_DIF_DLY_2 "lam2vvls_dif_dly" UBYTE LINEAR_______0_637500__0H___0809 2 2.0 -0.6375 0.6375 BIT_MASK 0xffffffff ECU_ADDRESS 0x40e5f /end MEASUREMENT
/begin MEASUREMENT VLS_DOWN_2 "lam2vvls_down" UBYTE LINEAR______0_000000__0H___1_804 2 2.0 0.0 1.275 BIT_MASK 0xffffffff ECU_ADDRESS 0x40e4f /end MEASUREMENT
/begin MEASUREMENT VLS_DOWN_MMV_2 "lam2vvls_down_mmvvbyteC1D" UBYTE LINEAR______0_000000__0H___1_810 2 2.0 0.0 1.275 BIT_MASK 0xffffffff ECU_ADDRESS 0x40e51 /end MEASUREMENT
/begin MEASUREMENT VLS_DOWN_2_PREV_DIAG "lam2vvls_down_prev_diag" UBYTE LINEAR______0_000000__0H___1_804 2 2.0 0.0 1.275 BIT_MASK 0xffffffff ECU_ADDRESS 0x40e4e /end MEASUREMENT
/begin MEASUREMENT VLS_DOWN_SCG_DIAG_CNT_2 "lam2vvls_down_scg_diag_cnt" UWORD LINEAR______0_000000__0H___65811 2 2.0 0.0 65535.0 BIT_MASK 0xffffffff ECU_ADDRESS 0x40dfc /end MEASUREMENT
/begin MEASUREMENT VLS_MAX_CYCNR_AFL_2 "lam2vvls_max_cycnr_afl" UWORD LINEAR______0_000000__0H___65803 2 2.0 0.0 655.35 BIT_MASK 0xffffffff ECU_ADDRESS 0x40ec8 /end MEASUREMENT
/begin MEASUREMENT VLS_MAX_CYCNR_AFR_2 "lam2vvls_max_cycnr_afr" UWORD LINEAR______0_000000__0H___65803 2 2.0 0.0 655.35 BIT_MASK 0xffffffff ECU_ADDRESS 0x40eca /end MEASUREMENT
/begin MEASUREMENT VLS_MMV_MAX_UP_2 "lam2vvls_mmv_max_upvbyteC1D" UBYTE LINEAR______0_000000__0H___1_804 2 2.0 0.0 1.275 BIT_MASK 0xffffffff ECU_ADDRESS 0x40dbd /end MEASUREMENT
/begin MEASUREMENT VLS_MMV_MIN_UP_2 "lam2vvls_mmv_min_upvbyteC1D" UBYTE LINEAR______0_000000__0H___1_804 2 2.0 0.0 1.275 BIT_MASK 0xffffffff ECU_ADDRESS 0x40dbf /end MEASUREMENT
/begin MEASUREMENT VLS_RAW_2 "lam2vvls_raw" UBYTE LINEAR______0_000000__0H___1_275 2 2.0 0.0 1.275 BIT_MASK 0xffffffff ECU_ADDRESS 0x40e3d /end MEASUREMENT
/begin MEASUREMENT VLS_TOL_UP_2 "lam2vvls_tol_up" UBYTE LINEAR______0_000000__0H___1_804 2 2.0 0.0 1.275 BIT_MASK 0xffffffff ECU_ADDRESS 0x40e3e /end MEASUREMENT
/begin MEASUREMENT VLS_UP_2 "lam2vvls_up" UBYTE LINEAR______0_000000__0H___1_804 2 2.0 0.0 1.275 BIT_MASK 0xffffffff ECU_ADDRESS 0x40e3a /end MEASUREMENT
/begin MEASUREMENT VLS_UP_OL_DIAG_CNT_2 "lam2vvls_up_ol_diag_cnt" UWORD LINEAR______0_000000__0H___65113 2 2.0 0.0 65535.0 BIT_MASK 0xffffffff ECU_ADDRESS 0x40dfe /end MEASUREMENT
/begin MEASUREMENT VLS_UP_2_PREV_DIAG "lam2vvls_up_prev_diag" UBYTE LINEAR______0_000000__0H___1_804 2 2.0 0.0 1.275 BIT_MASK 0xffffffff ECU_ADDRESS 0x40e47 /end MEASUREMENT
/begin MEASUREMENT VLS_UP_2_PREV_DIAG_OLD "lam2vvls_up_prev_diag_old" UBYTE LINEAR______0_000000__0H___1_804 2 2.0 0.0 1.275 BIT_MASK 0xffffffff ECU_ADDRESS 0x40e49 /end MEASUREMENT
/begin MEASUREMENT VLS_UP_SCG_DIAG_CNT_2 "lam2vvls_up_scg_diag_cnt" UWORD LINEAR______0_000000__0H___65812 2 2.0 0.0 65535.0 BIT_MASK 0xffffffff ECU_ADDRESS 0x40e00 /end MEASUREMENT
/begin MEASUREMENT LAMB_CH "lamb_ch" UWORD LINEAR______0_000000__0H___1_999 2 2.0 0.0 1.99997 BIT_MASK 0xffffffff ECU_ADDRESS 0xe13e /end MEASUREMENT
/begin MEASUREMENT LV_LSCL_1 "Lambdaregler1" UBYTE RANGE________active___1H__1H_817 2 2.0 0 255 BIT_MASK 0x8 ECU_ADDRESS 0x40c3c /end MEASUREMENT
/begin MEASUREMENT LV_LSCL_2 "Lambdaregler2" UBYTE RANGE________active___1H__1H_817 2 2.0 0 255 BIT_MASK 0x8 ECU_ADDRESS 0x40d9a /end MEASUREMENT
/begin MEASUREMENT LV_LAM_LIM_1 "Lambdaregleranschlag1" UBYTE RANGE________YES___1H__1H____818 2 2.0 0 255 BIT_MASK 0x2 ECU_ADDRESS 0x40c3c /end MEASUREMENT
/begin MEASUREMENT LV_LAM_LIM_2 "Lambdaregleranschlag2" UBYTE RANGE________YES___1H__1H____818 2 2.0 0 255 BIT_MASK 0x2 ECU_ADDRESS 0x40d9a /end MEASUREMENT
/begin MEASUREMENT LV_LAM_CTL_1 "Lambdareglerzustand1" UBYTE RANGE________ON___1H__1H____OFF_ 2 2.0 0 255 BIT_MASK 0x1 ECU_ADDRESS 0x40c3c /end MEASUREMENT
/begin MEASUREMENT LV_LAM_CTL_2 "Lambdareglerzustand2" UBYTE RANGE________ON___1H__1H____OFF_ 2 2.0 0 255 BIT_MASK 0x1 ECU_ADDRESS 0x40d9a /end MEASUREMENT
/begin MEASUREMENT LV_DOWN_LS_1 "Lambdasonde_NKAT1" UBYTE RANGE________0___0H__0H____1_819 2 2.0 0 255 BIT_MASK 0x40 ECU_ADDRESS 0x40c3c /end MEASUREMENT
/begin MEASUREMENT LV_DOWN_LS_2 "Lambdasonde_NKAT2" UBYTE RANGE________0___0H__0H____1_819 2 2.0 0 255 BIT_MASK 0x40 ECU_ADDRESS 0x40d9a /end MEASUREMENT
/begin MEASUREMENT LV_UP_LS_1 "Lambdasonde_VKAT1" UBYTE RANGE________0___0H__0H____1_819 2 2.0 0 255 BIT_MASK 0x20 ECU_ADDRESS 0x40c3c /end MEASUREMENT
/begin MEASUREMENT LV_UP_LS_2 "Lambdasonde_VKAT2" UBYTE RANGE________0___0H__0H____1_819 2 2.0 0 255 BIT_MASK 0x20 ECU_ADDRESS 0x40d9a /end MEASUREMENT
/begin MEASUREMENT LV_AFR_1 "Lambdazustand1" UBYTE RANGE________rich___1H__1H____le 2 2.0 0 255 BIT_MASK 0x4 ECU_ADDRESS 0x40c3d /end MEASUREMENT
/begin MEASUREMENT LV_AFR_2 "Lambdazustand2" UBYTE RANGE________rich___1H__1H____le 2 2.0 0 255 BIT_MASK 0x4 ECU_ADDRESS 0x40d9b /end MEASUREMENT
/begin MEASUREMENT CTR_STOP_FSD "lrvctr_stop_fsd" UBYTE LINEAR______0_000000__0H___25789 2 2.0 0.0 255.0 BIT_MASK 0xffffffff ECU_ADDRESS 0x40c33 /end MEASUREMENT
/begin MEASUREMENT LAM_MV_DIF_CP "lrvlam_mv_dif_cp" UWORD LINEAR_______50_000000__0H___779 2 2.0 -50.0 49.998471 BIT_MASK 0xffffffff ECU_ADDRESS 0x40c2c /end MEASUREMENT
/begin MEASUREMENT LAM_MV_DIF_CP_LD "lrvlam_mv_dif_cp_ld" UWORD LINEAR_______50_000000__0H___779 2 2.0 -50.0 49.998471 BIT_MASK 0xffffffff ECU_ADDRESS 0x40c2e /end MEASUREMENT
/begin MEASUREMENT LAM_TRA "lrvlam_tra" UWORD LINEAR_______50_000000__0H___779 2 2.0 -50.0 49.998471 BIT_MASK 0xffffffff ECU_ADDRESS 0x40c30 /end MEASUREMENT
/begin MEASUREMENT SUM_LAM_BANK "lrvsum_lam_bank" UBYTE LINEAR______0_000000__0H___25789 2 2.0 0.0 255.0 BIT_MASK 0xffffffff ECU_ADDRESS 0x40c32 /end MEASUREMENT
/begin MEASUREMENT LV_LAM_SLOW "LR_langsam" UWORD RANGE________active___1H__1H_744 2 2.0 0 65535 BIT_MASK 0x2 ECU_ADDRESS 0xfda4 /end MEASUREMENT
/begin MEASUREMENT LV_LAM_DLY_AD_1 "lr_trim_ad_1" UWORD RANGE________active___1H__1H_820 2 2.0 0 65535 BIT_MASK 0x2000 ECU_ADDRESS 0x40c62 /end MEASUREMENT
/begin MEASUREMENT LV_LAM_DLY_AD_2 "lr_trim_ad_2" UWORD RANGE________active___1H__1H_820 2 2.0 0 65535 BIT_MASK 0x2000 ECU_ADDRESS 0x40dc0 /end MEASUREMENT
/begin MEASUREMENT LV_LAM_DLY_DIAG_1 "lr_trim_diag_1" UWORD RANGE________active___1H__1H_820 2 2.0 0 65535 BIT_MASK 0x4000 ECU_ADDRESS 0x40c62 /end MEASUREMENT
/begin MEASUREMENT LV_LAM_DLY_DIAG_2 "lr_trim_diag_2" UWORD RANGE________active___1H__1H_820 2 2.0 0 65535 BIT_MASK 0x4000 ECU_ADDRESS 0x40dc0 /end MEASUREMENT
/begin MEASUREMENT LV_LAM_DLY_I_CTL_1 "lr_trim_ireg_1" UBYTE RANGE________active___1H__1H_817 2 2.0 0 255 BIT_MASK 0x2 ECU_ADDRESS 0x40c3f /end MEASUREMENT
/begin MEASUREMENT LV_LAM_DLY_I_CTL_2 "lr_trim_ireg_2" UBYTE RANGE________active___1H__1H_817 2 2.0 0 255 BIT_MASK 0x2 ECU_ADDRESS 0x40d9d /end MEASUREMENT
/begin MEASUREMENT LV_LAM_DLY_CTL_1 "lr_trim_reg_1" UBYTE RANGE________active___1H__1H_817 2 2.0 0 255 BIT_MASK 0x1 ECU_ADDRESS 0x40c3f /end MEASUREMENT
/begin MEASUREMENT LV_LAM_DLY_CTL_2 "lr_trim_reg_2" UBYTE RANGE________active___1H__1H_817 2 2.0 0 255 BIT_MASK 0x1 ECU_ADDRESS 0x40d9d /end MEASUREMENT
/begin MEASUREMENT LV_LAM_STOP_1 "LR1_angehalten" UBYTE RANGE________YES___1H__1H____818 2 2.0 0 255 BIT_MASK 0x40 ECU_ADDRESS 0x40c3d /end MEASUREMENT
/begin MEASUREMENT LV_LAM_LOCK_1 "LR1_gesperrt" UBYTE RANGE________YES___1H__1H____NO_ 2 2.0 0 255 BIT_MASK 0x4 ECU_ADDRESS 0x40c3c /end MEASUREMENT
/begin MEASUREMENT LV_LAM_FSD_1 "LR1_KSD" UBYTE RANGE________active___1H__1H_821 2 2.0 0 255 BIT_MASK 0x4 ECU_ADDRESS 0x40c3e /end MEASUREMENT
/begin MEASUREMENT LV_LAM_IS_1 "LR1_LL" UBYTE RANGE________active___1H__1H_817 2 2.0 0 255 BIT_MASK 0x10 ECU_ADDRESS 0x40c3d /end MEASUREMENT
/begin MEASUREMENT LV_LAM_DIR_1 "LR1_Reglerrichtung" UBYTE RANGE________rich___1H__1H____le 2 2.0 0 255 BIT_MASK 0x8 ECU_ADDRESS 0x40c3d /end MEASUREMENT
/begin MEASUREMENT LV_LAM_CR_1 "LR1_ruecksteuern" UBYTE RANGE________active___1H__1H_822 2 2.0 0 255 BIT_MASK 0x8 ECU_ADDRESS 0x40c3c /end MEASUREMENT
/begin MEASUREMENT LV_LAM_LOCK_ERR_1 "LR1_SPERR_ERR" UBYTE RANGE________YES___1H__1H____818 2 2.0 0 255 BIT_MASK 0x2 ECU_ADDRESS 0x40c3e /end MEASUREMENT
/begin MEASUREMENT LV_LAM_STOP_2 "LR2_angehalten" UBYTE RANGE________YES___1H__1H____818 2 2.0 0 255 BIT_MASK 0x40 ECU_ADDRESS 0x40d9b /end MEASUREMENT
/begin MEASUREMENT LV_LAM_LOCK_2 "LR2_gesperrt" UBYTE RANGE________YES___1H__1H____NO_ 2 2.0 0 255 BIT_MASK 0x4 ECU_ADDRESS 0x40d9a /end MEASUREMENT
/begin MEASUREMENT LV_LAM_FSD_2 "LR2_KSD" UBYTE RANGE________active___1H__1H_821 2 2.0 0 255 BIT_MASK 0x4 ECU_ADDRESS 0x40d9c /end MEASUREMENT
/begin MEASUREMENT LV_LAM_IS_2 "LR2_LL" UBYTE RANGE________active___1H__1H_817 2 2.0 0 255 BIT_MASK 0x10 ECU_ADDRESS 0x40d9b /end MEASUREMENT
/begin MEASUREMENT LV_LAM_DIR_2 "LR2_Reglerrichtung" UBYTE RANGE________rich___1H__1H____le 2 2.0 0 255 BIT_MASK 0x8 ECU_ADDRESS 0x40d9b /end MEASUREMENT
/begin MEASUREMENT LV_LAM_CR_2 "LR2_ruecksteuern" UBYTE RANGE________active___1H__1H_822 2 2.0 0 255 BIT_MASK 0x8 ECU_ADDRESS 0x40d9a /end MEASUREMENT
/begin MEASUREMENT LV_LAM_LOCK_ERR_2 "LR2_SPERR_ERR" UBYTE RANGE________YES___1H__1H____818 2 2.0 0 255 BIT_MASK 0x2 ECU_ADDRESS 0x40d9c /end MEASUREMENT
/begin MEASUREMENT CTR_CYCNR_LSH_DIAG_UP_1 "lsh1vctr_cycnr_lsh_diag" UBYTE LINEAR______0_000000__0H___25823 2 2.0 0.0 255.0 BIT_MASK 0xffffffff ECU_ADDRESS 0x40f20 /end MEASUREMENT
/begin MEASUREMENT CTR_LSH_DIAG_UP_1 "lsh1vctr_lsh_diag" UBYTE LINEAR______0_000000__0H___25823 2 2.0 0.0 255.0 BIT_MASK 0xffffffff ECU_ADDRESS 0x40f14 /end MEASUREMENT
/begin MEASUREMENT LSHWPM_UP_1 "lsh1vlshpwm" UBYTE LINEAR______0_000000__0H___99_60 2 2.0 0.0 99.609375 BIT_MASK 0xffffffff FUNCTION_LIST DPM ECU_ADDRESS 0x40f1a /end MEASUREMENT
/begin MEASUREMENT R_MV_LS_DIAG_UP_1 "lsh1vr_mv_ls_diag" UWORD LINEAR______0_000000__0H___65142 2 2.0 0.0 65535.0 BIT_MASK 0xffffffff ECU_ADDRESS 0x40f22 /end MEASUREMENT
/begin MEASUREMENT STATE_LSH_UP_1 "lsh1vstate_lsh" UBYTE LINEAR______1_000000__1H___6_000 2 2.0 1.0 6.0 BIT_MASK 0xffffffff ECU_ADDRESS 0x40f17 /end MEASUREMENT
/begin MEASUREMENT CTR_CYCNR_LSH_DIAG_UP_2 "lsh2vctr_cycnr_lsh_diag" UBYTE LINEAR______0_000000__0H___25823 2 2.0 0.0 255.0 BIT_MASK 0xffffffff ECU_ADDRESS 0x40f30 /end MEASUREMENT
/begin MEASUREMENT CTR_LSH_DIAG_UP_2 "lsh2vctr_lsh_diag" UBYTE LINEAR______0_000000__0H___25823 2 2.0 0.0 255.0 BIT_MASK 0xffffffff ECU_ADDRESS 0x40f24 /end MEASUREMENT
/begin MEASUREMENT LSHWPM_UP_2 "lsh2vlshpwm" UBYTE LINEAR______0_000000__0H___99_60 2 2.0 0.0 99.609375 BIT_MASK 0xffffffff FUNCTION_LIST DPM ECU_ADDRESS 0x40f2a /end MEASUREMENT
/begin MEASUREMENT R_MV_LS_DIAG_UP_2 "lsh2vr_mv_ls_diag" UWORD LINEAR______0_000000__0H___65142 2 2.0 0.0 65535.0 BIT_MASK 0xffffffff ECU_ADDRESS 0x40f32 /end MEASUREMENT
/begin MEASUREMENT STATE_LSH_UP_2 "lsh2vstate_lsh" UBYTE LINEAR______1_000000__1H___6_000 2 2.0 1.0 6.0 BIT_MASK 0xffffffff ECU_ADDRESS 0x40f27 /end MEASUREMENT
/begin MEASUREMENT CTR_CYCNR_LSH_DIAG_DOWN_1 "lsh3vctr_cycnr_lsh_diag" UBYTE LINEAR______0_000000__0H___25823 2 2.0 0.0 255.0 BIT_MASK 0xffffffff ECU_ADDRESS 0x40f50 /end MEASUREMENT
/begin MEASUREMENT CTR_LSH_DIAG_DOWN_1 "lsh3vctr_lsh_diag" UBYTE LINEAR______0_000000__0H___25823 2 2.0 0.0 255.0 BIT_MASK 0xffffffff ECU_ADDRESS 0x40f44 /end MEASUREMENT
/begin MEASUREMENT LSHWPM_DOWN_1 "lsh3vlshpwm" UBYTE LINEAR______0_000000__0H___99_60 2 2.0 0.0 99.609375 BIT_MASK 0xffffffff FUNCTION_LIST DPM ECU_ADDRESS 0x40f4a /end MEASUREMENT
/begin MEASUREMENT R_MV_LS_DIAG_DOWN_1 "lsh3vr_mv_ls_diag" UWORD LINEAR______0_000000__0H___65142 2 2.0 0.0 65535.0 BIT_MASK 0xffffffff ECU_ADDRESS 0x40f52 /end MEASUREMENT
/begin MEASUREMENT STATE_LSH_DOWN_1 "lsh3vstate_lsh" UBYTE LINEAR______1_000000__1H___6_000 2 2.0 1.0 6.0 BIT_MASK 0xffffffff ECU_ADDRESS 0x40f47 /end MEASUREMENT
/begin MEASUREMENT CTR_CYCNR_LSH_DIAG_DOWN_2 "lsh4vctr_cycnr_lsh_diag" UBYTE LINEAR______0_000000__0H___25823 2 2.0 0.0 255.0 BIT_MASK 0xffffffff ECU_ADDRESS 0x40f60 /end MEASUREMENT
/begin MEASUREMENT CTR_LSH_DIAG_DOWN_2 "lsh4vctr_lsh_diag" UBYTE LINEAR______0_000000__0H___25823 2 2.0 0.0 255.0 BIT_MASK 0xffffffff ECU_ADDRESS 0x40f54 /end MEASUREMENT
/begin MEASUREMENT LSHWPM_DOWN_2 "lsh4vlshpwm" UBYTE LINEAR______0_000000__0H___99_60 2 2.0 0.0 99.609375 BIT_MASK 0xffffffff FUNCTION_LIST DPM ECU_ADDRESS 0x40f5a /end MEASUREMENT
/begin MEASUREMENT R_MV_LS_DIAG_DOWN_2 "lsh4vr_mv_ls_diag" UWORD LINEAR______0_000000__0H___65142 2 2.0 0.0 65535.0 BIT_MASK 0xffffffff ECU_ADDRESS 0x40f62 /end MEASUREMENT
/begin MEASUREMENT STATE_LSH_DOWN_2 "lsh4vstate_lsh" UBYTE LINEAR______1_000000__1H___6_000 2 2.0 1.0 6.0 BIT_MASK 0xffffffff ECU_ADDRESS 0x40f57 /end MEASUREMENT
/begin MEASUREMENT LV_AJ_ACT "lv_aj_act" UBYTE RANGE________0___0H__0H____1_824 2 2.0 0 255 BIT_MASK 0x4 FUNCTION_LIST JOHE_OD ECU_ADDRESS 0xfd1a /end MEASUREMENT
/begin MEASUREMENT LV_AJ_IGA_CR "lv_aj_iga_cr" UBYTE RANGE________0___0H__0H____1_824 2 2.0 0 255 BIT_MASK 0x8 FUNCTION_LIST JOHE_OD ECU_ADDRESS 0xfd1a /end MEASUREMENT
/begin MEASUREMENT LV_AMT_ACT "lv_amt_act" UBYTE RANGE________0___0H__0H____1_824 2 2.0 0 255 BIT_MASK 0x4 ECU_ADDRESS 0xfd21 /end MEASUREMENT
/begin MEASUREMENT LV_AMT_ES "lv_amt_es" UBYTE RANGE________0___0H__0H____1_824 2 2.0 0 255 BIT_MASK 0x8 FUNCTION_LIST JOHE_OD ECU_ADDRESS 0xfd21 /end MEASUREMENT
/begin MEASUREMENT LV_AMT_INH_MON "lv_amt_inh_mon" UBYTE RANGE________0___0H__0H____1_824 2 2.0 0 255 BIT_MASK 0x40 FUNCTION_LIST JOHE_OD ECU_ADDRESS 0xfd0a /end MEASUREMENT
/begin MEASUREMENT LV_ASR_ACT "lv_asr_act" UBYTE RANGE________0___0H__0H____1_824 2 2.0 0 255 BIT_MASK 0x40 FUNCTION_LIST JOHE_OD ECU_ADDRESS 0xfd1f /end MEASUREMENT
/begin MEASUREMENT LV_BLS "lv_bls" UBYTE RANGE________OFF___0H__0H____ON_ 2 2.0 0 255 BIT_MASK 0x80 ECU_ADDRESS 0xfd2d /end MEASUREMENT
/begin MEASUREMENT LV_BOFF_MON "lv_boff_mon" UBYTE RANGE________0___0H__0H____1_819 2 2.0 0 255 BIT_MASK 0x1 ECU_ADDRESS 0xfd0b /end MEASUREMENT
/begin MEASUREMENT LV_BRAKE_MON "lv_brake_mon" UBYTE RANGE________0___0H__0H____1_824 2 2.0 0 255 BIT_MASK 0x40 ECU_ADDRESS 0xfd0b /end MEASUREMENT
/begin MEASUREMENT LV_BTS "lv_bts" UBYTE RANGE________OFF___0H__0H____ON_ 2 2.0 0 255 BIT_MASK 0x1 ECU_ADDRESS 0xfd2e /end MEASUREMENT
/begin MEASUREMENT LV_CAT_AFR_CH_1 "lv_cat_afr_ch_1" UBYTE RANGE________0___0H__0H____1_824 2 2.0 0 255 BIT_MASK 0x1 FUNCTION_LIST JOHE_OD ECU_ADDRESS 0xfd3e /end MEASUREMENT
/begin MEASUREMENT LV_CAT_AFR_CH_2 "lv_cat_afr_ch_2" UBYTE RANGE________0___0H__0H____1_824 2 2.0 0 255 BIT_MASK 0x80 FUNCTION_LIST JOHE_OD ECU_ADDRESS 0xfd3d /end MEASUREMENT
/begin MEASUREMENT LV_CAT_AFR_HST_1 "lv_cat_afr_hst_1" UBYTE RANGE________0___0H__0H____1_824 2 2.0 0 255 BIT_MASK 0x4 FUNCTION_LIST JOHE_OD ECU_ADDRESS 0xfd3d /end MEASUREMENT
/begin MEASUREMENT LV_CAT_AFR_HST_2 "lv_cat_afr_hst_2" UBYTE RANGE________0___0H__0H____1_824 2 2.0 0 255 BIT_MASK 0x8 FUNCTION_LIST JOHE_OD ECU_ADDRESS 0xfd3d /end MEASUREMENT
/begin MEASUREMENT LV_CAT_AFR_PUC_1 "lv_cat_afr_puc_1" UBYTE RANGE________0___0H__0H____1_824 2 2.0 0 255 BIT_MASK 0x10 FUNCTION_LIST JOHE_OD ECU_ADDRESS 0xfd3d /end MEASUREMENT
/begin MEASUREMENT LV_CAT_AFR_PUC_2 "lv_cat_afr_puc_2" UBYTE RANGE________0___0H__0H____1_824 2 2.0 0 255 BIT_MASK 0x20 FUNCTION_LIST JOHE_OD ECU_ADDRESS 0xfd3d /end MEASUREMENT
/begin MEASUREMENT LV_CAT_AFR_SAP_1 "lv_cat_afr_sap_1" UBYTE RANGE________active___1H__1H_817 2 2.0 0 255 BIT_MASK 0x40 ECU_ADDRESS 0xfd3d /end MEASUREMENT
/begin MEASUREMENT LV_CAT_AFR_SAP_2 "lv_cat_afr_sap_2" UBYTE RANGE________active___1H__1H_817 2 2.0 0 255 BIT_MASK 0x2 ECU_ADDRESS 0xfd3e /end MEASUREMENT
/begin MEASUREMENT LV_CAT_DIAG_END "lv_cat_diag_end" UBYTE RANGE________0___0H__0H____1_824 2 2.0 0 255 BIT_MASK 0x80 ECU_ADDRESS 0xfd4c /end MEASUREMENT
/begin MEASUREMENT LV_CAT_DIAG_END_BK_1 "lv_cat_diag_end_bk_1" UBYTE RANGE________0___0H__0H____1_824 2 2.0 0 255 BIT_MASK 0x2 ECU_ADDRESS 0xfd4d /end MEASUREMENT
/begin MEASUREMENT LV_CAT_DIAG_END_BK_2 "lv_cat_diag_end_bk_2" UBYTE RANGE________0___0H__0H____1_824 2 2.0 0 255 BIT_MASK 0x4 ECU_ADDRESS 0xfd4d /end MEASUREMENT
/begin MEASUREMENT LV_CAT_DIAG_GLOB_ERR "lv_cat_diag_glob_err" UBYTE RANGE________0___0H__0H____1_824 2 2.0 0 255 BIT_MASK 0x1 ECU_ADDRESS 0xfd4d /end MEASUREMENT
/begin MEASUREMENT LV_CAT_DIAG_START "lv_cat_diag_start" UBYTE RANGE________0___0H__0H____1_824 2 2.0 0 255 BIT_MASK 0x10 ECU_ADDRESS 0xfd4d /end MEASUREMENT
/begin MEASUREMENT LV_CAT_DIAG_TEMP "lv_cat_diag_temp" UBYTE RANGE________0___0H__0H____1_824 2 2.0 0 255 BIT_MASK 0x8 ECU_ADDRESS 0xfd4d /end MEASUREMENT
/begin MEASUREMENT LV_CD_COP_1 "lv_cd_cop_1" UBYTE RANGE________0___0H__0H____1_824 2 2.0 0 255 BIT_MASK 0x20 ECU_ADDRESS 0xfd4b /end MEASUREMENT
/begin MEASUREMENT LV_CD_COP_2 "lv_cd_cop_2" UBYTE RANGE________0___0H__0H____1_824 2 2.0 0 255 BIT_MASK 0x40 ECU_ADDRESS 0xfd4b /end MEASUREMENT
/begin MEASUREMENT LV_CH_2_IGA "lv_ch_2_iga" UBYTE RANGE________0___0H__0H____1_824 2 2.0 0 255 BIT_MASK 0x80 ECU_ADDRESS 0xfd4f /end MEASUREMENT
/begin MEASUREMENT LV_CH_2_INTR "lv_ch_2_intr" UBYTE RANGE________0___0H__0H____1_824 2 2.0 0 255 BIT_MASK 0x40 ECU_ADDRESS 0xfd4f /end MEASUREMENT
/begin MEASUREMENT LV_CH_2_RED_ACT "lv_ch_2_red_act" UBYTE RANGE________0___0H__0H____1_824 2 2.0 0 255 BIT_MASK 0x20 ECU_ADDRESS 0xfd4f /end MEASUREMENT
/begin MEASUREMENT LV_CH_ACT_IGA "lv_ch_act_iga" UBYTE RANGE________0___0H__0H____1_824 2 2.0 0 255 BIT_MASK 0x2 ECU_ADDRESS 0xfd51 /end MEASUREMENT
/begin MEASUREMENT LV_CH_ACT_IGA_MON2 "lv_ch_act_iga_mon2" UWORD RANGE________0___0H__0H____1___1 2 2.0 0 65535 BIT_MASK 0x2000 ECU_ADDRESS 0xfd82 /end MEASUREMENT
/begin MEASUREMENT LV_CHK_DMTL_CUR_DMTL_VLD "lv_chk_dmtl_cur_dmtl_vld" UBYTE RANGE________0___0H__0H____1_819 2 2.0 0 255 BIT_MASK 0x2 FUNCTION_LIST DMTL ECU_ADDRESS 0xfd63 /end MEASUREMENT
/begin MEASUREMENT LV_CHK_DMTL_VLD "lv_chk_dmtl_vld" UBYTE RANGE________0___0H__0H____1_819 2 2.0 0 255 BIT_MASK 0x1 FUNCTION_LIST DMTL ECU_ADDRESS 0xfd64 /end MEASUREMENT
/begin MEASUREMENT LV_CI_COP_1 "lv_ci_cop_1" UBYTE RANGE________0___0H__0H____1_824 2 2.0 0 255 BIT_MASK 0x80 ECU_ADDRESS 0xfd4b /end MEASUREMENT
/begin MEASUREMENT LV_CI_COP_2 "lv_ci_cop_2" UBYTE RANGE________0___0H__0H____1_824 2 2.0 0 255 BIT_MASK 0x1 ECU_ADDRESS 0xfd4c /end MEASUREMENT
/begin MEASUREMENT LV_CI_COP_STEP2_1 "lv_ci_cop_step2_1" UBYTE RANGE________0___0H__0H____1_819 2 2.0 0 255 BIT_MASK 0x40 ECU_ADDRESS 0xfd49 /end MEASUREMENT
/begin MEASUREMENT LV_CI_COP_STEP2_2 "lv_ci_cop_step2_2" UBYTE RANGE________0___0H__0H____1_819 2 2.0 0 255 BIT_MASK 0x80 ECU_ADDRESS 0xfd49 /end MEASUREMENT
/begin MEASUREMENT LV_CITY "lv_city" UBYTE RANGE________0___0H__0H____1_819 2 2.0 0 255 BIT_MASK 0x80 FUNCTION_LIST Z1S1 ECU_ADDRESS 0xfd20 /end MEASUREMENT
/begin MEASUREMENT LV_CLR_FSP_DMTL "lv_clr_fsp_dmtl" UBYTE RANGE________0___0H__0H____1_819 2 2.0 0 255 BIT_MASK 0x40 FUNCTION_LIST THKO_DMTL ECU_ADDRESS 0xfd52 /end MEASUREMENT
/begin MEASUREMENT LV_CLR_FTL "lv_clr_ftl" UBYTE RANGE________0___0H__0H____1_819 2 2.0 0 255 BIT_MASK 0x1 FUNCTION_LIST THKO_DMTL ECU_ADDRESS 0xfd53 /end MEASUREMENT
/begin MEASUREMENT LV_COP_CDN_BEG_1 "lv_cop_cdn_beg_1" UBYTE RANGE________0___0H__0H____1_824 2 2.0 0 255 BIT_MASK 0x1 FUNCTION_LIST JOHE_OD ECU_ADDRESS 0xfd4a /end MEASUREMENT
/begin MEASUREMENT LV_COP_CDN_BEG_2 "lv_cop_cdn_beg_2" UBYTE RANGE________0___0H__0H____1_824 2 2.0 0 255 BIT_MASK 0x2 FUNCTION_LIST JOHE_OD ECU_ADDRESS 0xfd4a /end MEASUREMENT
/begin MEASUREMENT LV_CPS_CLOSED "lv_cps_closed" UBYTE RANGE________0___0H__0H____1_824 2 2.0 0 255 BIT_MASK 0x2 FUNCTION_LIST JOHE_OD ECU_ADDRESS 0xfd53 /end MEASUREMENT
/begin MEASUREMENT LV_CRU_ACT "lv_cru_act" UBYTE RANGE________0___0H__0H____1_824 2 2.0 0 255 BIT_MASK 0x20 FUNCTION_LIST JOHE_OD ECU_ADDRESS 0xfd18 /end MEASUREMENT
/begin MEASUREMENT LV_CRU_FATAL_ERR "lv_cru_fatal_err" UBYTE RANGE________0___0H__0H____1_824 2 2.0 0 255 BIT_MASK 0x4 FUNCTION_LIST JOHE_OD ECU_ADDRESS 0xfd18 /end MEASUREMENT
/begin MEASUREMENT LV_CRU_INH_MON "lv_cru_inh_mon" UBYTE RANGE________0___0H__0H____1_824 2 2.0 0 255 BIT_MASK 0x2 ECU_ADDRESS 0xfd0b /end MEASUREMENT
/begin MEASUREMENT LV_CRU_MAIN_SWI "lv_cru_main_swi" UBYTE RANGE________ON___1H__1H____O825 2 2.0 0 255 BIT_MASK 0x10 ECU_ADDRESS 0xfd18 /end MEASUREMENT
/begin MEASUREMENT LV_CRU_NEW_DATA "lv_cru_new_data" UBYTE RANGE________0___0H__0H____1_824 2 2.0 0 255 BIT_MASK 0x40 ECU_ADDRESS 0xfd79 /end MEASUREMENT
/begin MEASUREMENT LV_CRU_OFF_BY_ASR_ESP_CTL "lv_cru_off_by_asr_esp_ctl" UBYTE RANGE________active___1H__1H____ 2 2.0 0 255 BIT_MASK 0x1 ECU_ADDRESS 0xfd19 /end MEASUREMENT
/begin MEASUREMENT LV_CRU_OFF_IRR "lv_cru_off_irr" UBYTE RANGE________0___0H__0H____1_824 2 2.0 0 255 BIT_MASK 0x80 ECU_ADDRESS 0xfd19 /end MEASUREMENT
/begin MEASUREMENT LV_CRU_OVERT_ACT "lv_cru_overt_act" UBYTE RANGE________active___1H__1H____ 2 2.0 0 255 BIT_MASK 0x4 ECU_ADDRESS 0xfd19 /end MEASUREMENT
/begin MEASUREMENT LV_CRU_VLIMIT_ACT "lv_cru_vlimit_act" UBYTE RANGE________active___1H__1H____ 2 2.0 0 255 BIT_MASK 0x8 ECU_ADDRESS 0xfd18 /end MEASUREMENT
/begin MEASUREMENT LV_CS "lv_cs" UBYTE RANGE________OFF___0H__0H____ON_ 2 2.0 0 255 BIT_MASK 0x4 ECU_ADDRESS 0xfd2e /end MEASUREMENT
/begin MEASUREMENT LV_CS_DIAG "lv_cs_diag" UBYTE RANGE________0___0H__0H____1_824 2 2.0 0 255 BIT_MASK 0x40 ECU_ADDRESS 0xfd27 /end MEASUREMENT
/begin MEASUREMENT LV_CT "lv_ct" UBYTE RANGE________0___0H__0H____1_824 2 2.0 0 255 BIT_MASK 0x1 ECU_ADDRESS 0xfd43 /end MEASUREMENT
/begin MEASUREMENT LV_CTR_CNL_SMALL_LEAK_MES "lv_ctr_cnl_small_leak_mes" UBYTE RANGE________0___0H__0H____1_819 2 2.0 0 255 BIT_MASK 0x2 FUNCTION_LIST DMTL ECU_ADDRESS 0xfd64 /end MEASUREMENT
/begin MEASUREMENT LV_CUR_DMTL_COR_FIL "lv_cur_dmtl_cor_fil" UBYTE RANGE________0___0H__0H____1_819 2 2.0 0 255 BIT_MASK 0x4 FUNCTION_LIST DMTL ECU_ADDRESS 0xfd53 /end MEASUREMENT
/begin MEASUREMENT LV_CUR_DMTL_DMTLS_TEST "lv_cur_dmtl_dmtls_test" UBYTE RANGE________0___0H__0H____1_819 2 2.0 0 255 BIT_MASK 0x4 FUNCTION_LIST DMTL ECU_ADDRESS 0xfd63 /end MEASUREMENT
/begin MEASUREMENT LV_CUR_DMTL_REF_DIF_MAX "lv_cur_dmtl_ref_dif_max" UBYTE RANGE________0___0H__0H____1_819 2 2.0 0 255 BIT_MASK 0x8 FUNCTION_LIST DMTL ECU_ADDRESS 0xfd53 /end MEASUREMENT
/begin MEASUREMENT LV_CUR_DMTL_REF_MES_MAX "lv_cur_dmtl_ref_mes_max" UBYTE RANGE________0___0H__0H____1_819 2 2.0 0 255 BIT_MASK 0x10 FUNCTION_LIST DMTL ECU_ADDRESS 0xfd63 /end MEASUREMENT
/begin MEASUREMENT LV_CUR_DMTL_REF_MES_MIN "lv_cur_dmtl_ref_mes_min" UBYTE RANGE________0___0H__0H____1_819 2 2.0 0 255 BIT_MASK 0x8 FUNCTION_LIST DMTL ECU_ADDRESS 0xfd63 /end MEASUREMENT
/begin MEASUREMENT LV_CYC_DMTL "lv_cyc_dmtl" UBYTE RANGE________0___0H__0H____1_819 2 2.0 0 255 BIT_MASK 0x10 FUNCTION_LIST DMTL ECU_ADDRESS 0xfd53 /end MEASUREMENT
/begin MEASUREMENT LV_CYC_ROUGH_LEAK "lv_cyc_rough_leak" UBYTE RANGE________0___0H__0H____1_819 2 2.0 0 255 BIT_MASK 0x20 FUNCTION_LIST DMTL ECU_ADDRESS 0xfd53 /end MEASUREMENT
/begin MEASUREMENT LV_CYC_ROUGH_LEAK_MODE6 "lv_cyc_rough_leak_mode6" UBYTE RANGE________0___0H__0H____1_819 2 2.0 0 255 BIT_MASK 0x40 FUNCTION_LIST DMTL ECU_ADDRESS 0xfd53 /end MEASUREMENT
/begin MEASUREMENT LV_CYC_ROUGH_LEAK_SUSP "lv_cyc_rough_leak_susp" UBYTE RANGE________0___0H__0H____1_819 2 2.0 0 255 BIT_MASK 0x80 FUNCTION_LIST DMTL ECU_ADDRESS 0xfd53 /end MEASUREMENT
/begin MEASUREMENT LV_CYC_SMALL_LEAK "lv_cyc_small_leak" UBYTE RANGE________0___0H__0H____1_819 2 2.0 0 255 BIT_MASK 0x4 FUNCTION_LIST DMTL ECU_ADDRESS 0xfd54 /end MEASUREMENT
/begin MEASUREMENT LV_CYC_SMALL_LEAK_MODE6 "lv_cyc_small_leak_mode6" UBYTE RANGE________0___0H__0H____1_819 2 2.0 0 255 BIT_MASK 0x8 FUNCTION_LIST DMTL ECU_ADDRESS 0xfd54 /end MEASUREMENT
/begin MEASUREMENT LV_CYCNR_IS "lv_cycnr_is" UBYTE RANGE________LV_CYCNR_IS___1H__1 2 2.0 0 255 BIT_MASK 0x2 ECU_ADDRESS 0xfd35 /end MEASUREMENT
/begin MEASUREMENT LV_DET_FUC_OPEN "lv_det_fuc_open" UBYTE RANGE________0___0H__0H____1_819 2 2.0 0 255 BIT_MASK 0x20 FUNCTION_LIST DMTL ECU_ADDRESS 0xfd54 /end MEASUREMENT
/begin MEASUREMENT LV_DET_REFU "lv_det_refu" UBYTE RANGE________0___0H__0H____1_819 2 2.0 0 255 BIT_MASK 0x40 FUNCTION_LIST DMTL ECU_ADDRESS 0xfd54 /end MEASUREMENT
/begin MEASUREMENT LV_DEV_AMT "lv_dev_amt" UBYTE RANGE________0___0H__0H____1_824 2 2.0 0 255 BIT_MASK 0x10 FUNCTION_LIST Z1S1 ECU_ADDRESS 0xfd21 /end MEASUREMENT
/begin MEASUREMENT LV_DEV_PSTE "lv_dev_pste" UBYTE RANGE________0___0H__0H____1_819 2 2.0 0 255 BIT_MASK 0x4 ECU_ADDRESS 0xfd22 /end MEASUREMENT
/begin MEASUREMENT LV_DIAG_SAFM_INTR "lv_diag_safm_intr" UBYTE RANGE________0___0H__0H____1_819 2 2.0 0 255 BIT_MASK 0x80 ECU_ADDRESS 0xfd11 /end MEASUREMENT
/begin MEASUREMENT LV_DIAG_SAFM_INTR_CDN "lv_diag_safm_intr_cdn" UBYTE RANGE________0___0H__0H____1_819 2 2.0 0 255 BIT_MASK 0x1 ECU_ADDRESS 0xfd12 /end MEASUREMENT
/begin MEASUREMENT LV_DIAG_VPLAUS "lv_diag_vplaus" UBYTE RANGE________1___1H__1H_______0H 2 2.0 0 255 BIT_MASK 0x2 ECU_ADDRESS 0xfd4e /end MEASUREMENT
/begin MEASUREMENT LV_DIST_DET_ROUGH_LEAK "lv_dist_det_rough_leak" UBYTE RANGE________0___0H__0H____1_819 2 2.0 0 255 BIT_MASK 0x80 FUNCTION_LIST DMTL ECU_ADDRESS 0xfd54 /end MEASUREMENT
/begin MEASUREMENT LV_DIST_DMTL_MIN "lv_dist_dmtl_min" UBYTE RANGE________0___0H__0H____1_819 2 2.0 0 255 BIT_MASK 0x2 FUNCTION_LIST DMTL ECU_ADDRESS 0xfd55 /end MEASUREMENT
/begin MEASUREMENT LV_DMTL_ACT "lv_dmtl_act" UBYTE RANGE________0___0H__0H____1_824 2 2.0 0 255 BIT_MASK 0x4 FUNCTION_LIST JOHE_OD ECU_ADDRESS 0xfd55 /end MEASUREMENT
/begin MEASUREMENT LV_DMTL_ASA "lv_dmtl_asa" UBYTE RANGE________0___0H__0H____1_824 2 2.0 0 255 BIT_MASK 0x40 FUNCTION_LIST JOHE_OD ECU_ADDRESS 0xfd62 /end MEASUREMENT
/begin MEASUREMENT LV_DMTL_EOL "lv_dmtl_eol" UBYTE RANGE________0___0H__0H____1_824 2 2.0 0 255 BIT_MASK 0x80 FUNCTION_LIST JOHE_OD ECU_ADDRESS 0xfd62 /end MEASUREMENT
/begin MEASUREMENT LV_DMTL_PUMP_ON "lv_dmtl_pump_on" UBYTE RANGE________0___0H__0H____1_824 2 2.0 0 255 BIT_MASK 0x20 FUNCTION_LIST JOHE_OD ECU_ADDRESS 0xfd55 /end MEASUREMENT
/begin MEASUREMENT LV_DMTL_RST_ROUGH_LEAK "lv_dmtl_rst_rough_leak" UBYTE RANGE________0___0H__0H____1_824 2 2.0 0 255 BIT_MASK 0x40 FUNCTION_LIST JOHE_OD ECU_ADDRESS 0xfd55 /end MEASUREMENT
/begin MEASUREMENT LV_DMTL_STOP "lv_dmtl_stop" UBYTE RANGE________0___0H__0H____1_824 2 2.0 0 255 BIT_MASK 0x80 FUNCTION_LIST JOHE_OD ECU_ADDRESS 0xfd55 /end MEASUREMENT
/begin MEASUREMENT LV_DMTLS_ON "lv_dmtls_on" UBYTE RANGE________0___0H__0H____1_819 2 2.0 0 255 BIT_MASK 0x1 FUNCTION_LIST DMTL ECU_ADDRESS 0xfd56 /end MEASUREMENT
/begin MEASUREMENT LV_DR_DMTL "lv_dr_dmtl" UBYTE RANGE________0___0H__0H____1_819 2 2.0 0 255 BIT_MASK 0x2 FUNCTION_LIST DMTL ECU_ADDRESS 0xfd56 /end MEASUREMENT
/begin MEASUREMENT LV_DR_DMTL_PUMP "lv_dr_dmtl_pump" UBYTE RANGE________0___0H__0H____1_819 2 2.0 0 255 BIT_MASK 0x4 FUNCTION_LIST DMTL ECU_ADDRESS 0xfd56 /end MEASUREMENT
/begin MEASUREMENT LV_DR_DMTLS "lv_dr_dmtls" UBYTE RANGE________0___0H__0H____1_819 2 2.0 0 255 BIT_MASK 0x8 FUNCTION_LIST DMTL ECU_ADDRESS 0xfd56 /end MEASUREMENT
/begin MEASUREMENT LV_DYN_LIM_1_ACT "lv_dyn_lim_1_act" UBYTE RANGE________active___1H__1H_821 2 2.0 0 255 BIT_MASK 0x2 ECU_ADDRESS 0xfd27 /end MEASUREMENT
/begin MEASUREMENT LV_DYN_LIM_2_ACT "lv_dyn_lim_2_act" UBYTE RANGE________active___1H__1H_821 2 2.0 0 255 BIT_MASK 0x4 ECU_ADDRESS 0xfd27 /end MEASUREMENT
/begin MEASUREMENT LV_ECF_ACT "lv_ecf_act" UBYTE RANGE________0___0H__0H____1_819 2 2.0 0 255 BIT_MASK 0x20 ECU_ADDRESS 0xfd24 /end MEASUREMENT
/begin MEASUREMENT LV_ENA_FCO_DIAG "lv_ena_fco_diag" UBYTE RANGE________0___0H__0H____1_819 2 2.0 0 255 BIT_MASK 0x10 FUNCTION_LIST DMTL ECU_ADDRESS 0xfd56 /end MEASUREMENT
/begin MEASUREMENT LV_ENA_FTL_DIAG "lv_ena_ftl_diag" UBYTE RANGE________0___0H__0H____1_819 2 2.0 0 255 BIT_MASK 0x20 FUNCTION_LIST DMTL ECU_ADDRESS 0xfd56 /end MEASUREMENT
/begin MEASUREMENT LV_ENA_FTL_INI "lv_ena_ftl_ini" UBYTE RANGE________0___0H__0H____1_819 2 2.0 0 255 BIT_MASK 0x40 FUNCTION_LIST THKO_DMTL ECU_ADDRESS 0xfd56 /end MEASUREMENT
/begin MEASUREMENT LV_ENA_FUC "lv_ena_fuc" UBYTE RANGE________0___0H__0H____1_819 2 2.0 0 255 BIT_MASK 0x1 FUNCTION_LIST DMTL ECU_ADDRESS 0xfd66 /end MEASUREMENT
/begin MEASUREMENT LV_ENA_LEAK_DMTL "lv_ena_leak_dmtl" UBYTE RANGE________0___0H__0H____1_819 2 2.0 0 255 BIT_MASK 0x10 FUNCTION_LIST DMTL ECU_ADDRESS 0xfd51 /end MEASUREMENT
/begin MEASUREMENT LV_ENA_MAIN_DMTL "lv_ena_main_dmtl" UBYTE RANGE________0___0H__0H____1_819 2 2.0 0 255 BIT_MASK 0x80 FUNCTION_LIST DMTL ECU_ADDRESS 0xfd56 /end MEASUREMENT
/begin MEASUREMENT LV_ENA_MAIN_DMTL_FUC "lv_ena_main_dmtl_fuc" UBYTE RANGE________0___0H__0H____1_819 2 2.0 0 255 BIT_MASK 0x40 FUNCTION_LIST DMTL ECU_ADDRESS 0xfd65 /end MEASUREMENT
/begin MEASUREMENT LV_ENA_OSC_ROUGH_LEAK_MES "lv_ena_osc_rough_leak_mes" UBYTE RANGE________0___0H__0H____1_819 2 2.0 0 255 BIT_MASK 0x1 ECU_ADDRESS 0xfd57 /end MEASUREMENT
/begin MEASUREMENT LV_ENA_OSC_SMALL_LEAK_MES "lv_ena_osc_small_leak_mes" UBYTE RANGE________0___0H__0H____1_819 2 2.0 0 255 BIT_MASK 0x2 ECU_ADDRESS 0xfd57 /end MEASUREMENT
/begin MEASUREMENT LV_ENA_ROUGH_LEAK_1 "lv_ena_rough_leak_1" UBYTE RANGE________0___0H__0H____1_819 2 2.0 0 255 BIT_MASK 0x4 FUNCTION_LIST DMTL ECU_ADDRESS 0xfd57 /end MEASUREMENT
/begin MEASUREMENT LV_ENA_ROUGH_LEAK_2 "lv_ena_rough_leak_2" UBYTE RANGE________0___0H__0H____1_819 2 2.0 0 255 BIT_MASK 0x8 FUNCTION_LIST DMTL ECU_ADDRESS 0xfd57 /end MEASUREMENT
/begin MEASUREMENT LV_ENA_ROUGH_LEAK_3 "lv_ena_rough_leak_3" UBYTE RANGE________0___0H__0H____1_819 2 2.0 0 255 BIT_MASK 0x10 FUNCTION_LIST DMTL ECU_ADDRESS 0xfd57 /end MEASUREMENT
/begin MEASUREMENT LV_ENA_ROUGH_LEAK_4 "lv_ena_rough_leak_4" UBYTE RANGE________0___0H__0H____1_819 2 2.0 0 255 BIT_MASK 0x40 FUNCTION_LIST DMTL ECU_ADDRESS 0xfd57 /end MEASUREMENT
/begin MEASUREMENT LV_ENA_ROUGH_LEAK_MES "lv_ena_rough_leak_mes" UBYTE RANGE________0___0H__0H____1_819 2 2.0 0 255 BIT_MASK 0x80 FUNCTION_LIST DMTL ECU_ADDRESS 0xfd57 /end MEASUREMENT
/begin MEASUREMENT LV_ENA_ROUGH_LEAK_MES_ONLY "lv_ena_rough_leak_mes_only" UBYTE RANGE________0___0H__0H____1_819 2 2.0 0 255 BIT_MASK 0x1 FUNCTION_LIST DMTL ECU_ADDRESS 0xfd58 /end MEASUREMENT
/begin MEASUREMENT LV_ENA_SMALL_LEAK_1 "lv_ena_small_leak_1" UBYTE RANGE________0___0H__0H____1_819 2 2.0 0 255 BIT_MASK 0x4 FUNCTION_LIST DMTL ECU_ADDRESS 0xfd58 /end MEASUREMENT
/begin MEASUREMENT LV_ENA_SMALL_LEAK_MES "lv_ena_small_leak_mes" UBYTE RANGE________0___0H__0H____1_819 2 2.0 0 255 BIT_MASK 0x10 FUNCTION_LIST DMTL ECU_ADDRESS 0xfd58 /end MEASUREMENT
/begin MEASUREMENT LV_ENA_SMALL_LEAK_MES_END "lv_ena_small_leak_mes_end" UBYTE RANGE________0___0H__0H____1_819 2 2.0 0 255 BIT_MASK 0x20 FUNCTION_LIST DMTL ECU_ADDRESS 0xfd58 /end MEASUREMENT
/begin MEASUREMENT LV_ENA_SMALL_LEAK_REFU "lv_ena_small_leak_refu" UBYTE RANGE________0___0H__0H____1_819 2 2.0 0 255 BIT_MASK 0x80 FUNCTION_LIST DMTL ECU_ADDRESS 0xfd58 /end MEASUREMENT
/begin MEASUREMENT LV_ENA_SMALL_LEAK_REFU_1 "lv_ena_small_leak_refu_1" UBYTE RANGE________0___0H__0H____1_819 2 2.0 0 255 BIT_MASK 0x1 FUNCTION_LIST DMTL ECU_ADDRESS 0xfd59 /end MEASUREMENT
/begin MEASUREMENT LV_ENA_SMALL_LEAK_REFU_2 "lv_ena_small_leak_refu_2" UBYTE RANGE________0___0H__0H____1_819 2 2.0 0 255 BIT_MASK 0x2 FUNCTION_LIST DMTL ECU_ADDRESS 0xfd59 /end MEASUREMENT
/begin MEASUREMENT LV_ENG_STOP "lv_eng_stop" UBYTE RANGE________0___0H__0H____1_819 2 2.0 0 255 BIT_MASK 0x20 FUNCTION_LIST Z1S1 ECU_ADDRESS 0xfd20 /end MEASUREMENT
/begin MEASUREMENT LV_ER_CARB_B4 "lv_er_carb_b4" UBYTE RANGE________0___0H__0H____1_819 2 2.0 0 255 BIT_MASK 0x80 ECU_ADDRESS 0xfd29 /end MEASUREMENT
/begin MEASUREMENT LV_ER_DELAY_ST "lv_er_delay_st" UBYTE RANGE________0___0H__0H____1_819 2 2.0 0 255 BIT_MASK 0x4 ECU_ADDRESS 0xfd2b /end MEASUREMENT
/begin MEASUREMENT LV_ER_FADE_OUT "lv_er_fade_out" UBYTE RANGE________active___1H__1H_822 2 2.0 0 255 BIT_MASK 0x10 ECU_ADDRESS 0xfd2a /end MEASUREMENT
/begin MEASUREMENT LV_ER_N_MIN_CONST "lv_er_n_min_const" UBYTE RANGE________0___0H__0H____1_824 2 2.0 0 255 BIT_MASK 0xffffffff ECU_ADDRESS 0x4018e /end MEASUREMENT
/begin MEASUREMENT LV_ERR_AMP "lv_err_amp" UBYTE RANGE________0___0H__0H____1_824 2 2.0 0 255 BIT_MASK 0x2 FUNCTION_LIST JOHE_OD ECU_ADDRESS 0xfdbe /end MEASUREMENT
/begin MEASUREMENT LV_ERR_CAT_EFF_1 "lv_err_cat_eff_1" UBYTE RANGE________0___0H__0H____1_824 2 2.0 0 255 BIT_MASK 0x10 FUNCTION_LIST JOHE_OD ECU_ADDRESS 0xfdbf /end MEASUREMENT
/begin MEASUREMENT LV_ERR_CAT_EFF_2 "lv_err_cat_eff_2" UBYTE RANGE________0___0H__0H____1_824 2 2.0 0 255 BIT_MASK 0x20 FUNCTION_LIST JOHE_OD ECU_ADDRESS 0xfdbf /end MEASUREMENT
/begin MEASUREMENT LV_ERR_CONV_MON "lv_err_conv_mon" UBYTE RANGE________0___0H__0H____1_824 2 2.0 0 255 BIT_MASK 0x1 FUNCTION_LIST JOHE_OD ECU_ADDRESS 0xfd08 /end MEASUREMENT
/begin MEASUREMENT LV_ERR_CONV_MON2 "lv_err_conv_mon2" UBYTE RANGE________0___0H__0H____1_824 2 2.0 0 255 BIT_MASK 0x4 FUNCTION_LIST JOHE_OD ECU_ADDRESS 0xfd82 /end MEASUREMENT
/begin MEASUREMENT LV_ERR_CPS "lv_err_cps" UBYTE RANGE________0___0H__0H____1_824 2 2.0 0 255 BIT_MASK 0x2 FUNCTION_LIST JOHE_OD ECU_ADDRESS 0xfdb3 /end MEASUREMENT
/begin MEASUREMENT LV_ERR_CS "lv_err_cs" UBYTE RANGE________0___0H__0H____1_824 2 2.0 0 255 BIT_MASK 0x40 ECU_ADDRESS 0xfdbf /end MEASUREMENT
/begin MEASUREMENT LV_ERR_DET_DMTL_MAX "lv_err_det_dmtl_max" UBYTE RANGE________0___0H__0H____1_819 2 2.0 0 255 BIT_MASK 0x8 FUNCTION_LIST DMTL ECU_ADDRESS 0xfd59 /end MEASUREMENT
/begin MEASUREMENT LV_ERR_DET_DMTL_MIN "lv_err_det_dmtl_min" UBYTE RANGE________0___0H__0H____1_819 2 2.0 0 255 BIT_MASK 0x10 FUNCTION_LIST DMTL ECU_ADDRESS 0xfd59 /end MEASUREMENT
/begin MEASUREMENT LV_ERR_DET_ROUGH_LEAK_MIN "lv_err_det_rough_leak_min" UBYTE RANGE________0___0H__0H____1_819 2 2.0 0 255 BIT_MASK 0x20 FUNCTION_LIST DMTL ECU_ADDRESS 0xfd59 /end MEASUREMENT
/begin MEASUREMENT LV_ERR_DET_SMALL_LEAK_MIN "lv_err_det_small_leak_min" UBYTE RANGE________0___0H__0H____1_819 2 2.0 0 255 BIT_MASK 0x40 FUNCTION_LIST DMTL ECU_ADDRESS 0xfd59 /end MEASUREMENT
/begin MEASUREMENT LV_ERR_DIAGCPS "lv_err_diagcps" UBYTE RANGE________0___0H__0H____1_819 2 2.0 0 255 BIT_MASK 0x2 ECU_ADDRESS 0xfdbd /end MEASUREMENT
/begin MEASUREMENT LV_ERR_DMTL "lv_err_dmtl" UBYTE RANGE________0___0H__0H____1_819 2 2.0 0 255 BIT_MASK 0x10 FUNCTION_LIST DMTL ECU_ADDRESS 0xfdc0 /end MEASUREMENT
/begin MEASUREMENT LV_ERR_DMTLM "lv_err_dmtlm" UBYTE RANGE________0___0H__0H____1_819 2 2.0 0 255 BIT_MASK 0x40 FUNCTION_LIST DMTL ECU_ADDRESS 0xfdc0 /end MEASUREMENT
/begin MEASUREMENT LV_ERR_DR_DMTL "lv_err_dr_dmtl" UBYTE RANGE________0___0H__0H____1_819 2 2.0 0 255 BIT_MASK 0x80 ECU_ADDRESS 0xfd59 /end MEASUREMENT
/begin MEASUREMENT LV_ERR_FTL "lv_err_ftl" UBYTE RANGE________0___0H__0H____1_819 2 2.0 0 255 BIT_MASK 0x40 FUNCTION_LIST DMTL ECU_ADDRESS 0xfd51 /end MEASUREMENT
/begin MEASUREMENT LV_ERR_FTL_PLAUS "lv_err_ftl_plaus" UBYTE RANGE________0___0H__0H____1_819 2 2.0 0 255 BIT_MASK 0x80 FUNCTION_LIST DMTL ECU_ADDRESS 0xfd51 /end MEASUREMENT
/begin MEASUREMENT LV_ERR_LSH_DOWN_1 "lv_err_lsh_down_1" UBYTE RANGE________0___0H__0H____1_824 2 2.0 0 255 BIT_MASK 0x10 ECU_ADDRESS 0xfdb0 /end MEASUREMENT
/begin MEASUREMENT LV_ERR_LSH_DOWN_2 "lv_err_lsh_down_2" UBYTE RANGE________0___0H__0H____1_824 2 2.0 0 255 BIT_MASK 0x40 ECU_ADDRESS 0xfdb0 /end MEASUREMENT
/begin MEASUREMENT LV_ERR_LSH_UP_1 "lv_err_lsh_up_1" UBYTE RANGE________0___0H__0H____1_824 2 2.0 0 255 BIT_MASK 0x1 ECU_ADDRESS 0xfdb0 /end MEASUREMENT
/begin MEASUREMENT LV_ERR_LSH_UP_2 "lv_err_lsh_up_2" UBYTE RANGE________0___0H__0H____1_824 2 2.0 0 255 BIT_MASK 0x4 ECU_ADDRESS 0xfdb0 /end MEASUREMENT
/begin MEASUREMENT LV_ERR_MAF_MON "lv_err_maf_mon" UBYTE RANGE________0___0H__0H____1_824 2 2.0 0 255 BIT_MASK 0x4 ECU_ADDRESS 0xfd0b /end MEASUREMENT
/begin MEASUREMENT LV_ERR_MAF_MON2 "lv_err_maf_mon2" UWORD RANGE________0___0H__0H____1___1 2 2.0 0 65535 BIT_MASK 0x100 ECU_ADDRESS 0xfd82 /end MEASUREMENT
/begin MEASUREMENT LV_ERR_MU "lv_err_mu" UBYTE RANGE____________0H__0H____ERR_M 2 2.0 0 255 BIT_MASK 0x80 ECU_ADDRESS 0xfd7a /end MEASUREMENT
/begin MEASUREMENT LV_ERR_MU_MON2 "lv_err_mu_mon2" UWORD RANGE________0___0H__0H____1___1 2 2.0 0 65535 BIT_MASK 0x200 ECU_ADDRESS 0xfd82 /end MEASUREMENT
/begin MEASUREMENT LV_ERR_N_32_MON "lv_err_n_32_mon" UBYTE RANGE________0___0H__0H____1_824 2 2.0 0 255 BIT_MASK 0x40 ECU_ADDRESS 0xfd08 /end MEASUREMENT
/begin MEASUREMENT LV_ERR_N_32_MON2 "lv_err_n_32_mon2" UWORD RANGE________0___0H__0H____1___1 2 2.0 0 65535 BIT_MASK 0x8 ECU_ADDRESS 0xfd82 /end MEASUREMENT
/begin MEASUREMENT LV_ERR_PVS_MON "lv_err_pvs_mon" UBYTE RANGE________0___0H__0H____1_824 2 2.0 0 255 BIT_MASK 0x80 ECU_ADDRESS 0xfd08 /end MEASUREMENT
/begin MEASUREMENT LV_ERR_PVS_MON2 "lv_err_pvs_mon2" UWORD RANGE________0___0H__0H____1___1 2 2.0 0 65535 BIT_MASK 0x40 ECU_ADDRESS 0xfd82 /end MEASUREMENT
/begin MEASUREMENT LV_ERR_PVS_RATIO_MON "lv_err_pvs_ratio_mon" UBYTE RANGE________0___0H__0H____1_824 2 2.0 0 255 BIT_MASK 0x1 ECU_ADDRESS 0xfd09 /end MEASUREMENT
/begin MEASUREMENT LV_ERR_RAM_MON "lv_err_ram_mon" UBYTE RANGE________0___0H__0H____1_824 2 2.0 0 255 BIT_MASK 0x8 ECU_ADDRESS 0xfd7b /end MEASUREMENT
/begin MEASUREMENT LV_ERR_RLY_MAIN "lv_err_rly_main" UBYTE RANGE________0___0H__0H____1_824 2 2.0 0 255 BIT_MASK 0x20 ECU_ADDRESS 0xfdb9 /end MEASUREMENT
/begin MEASUREMENT LV_ERR_ROUGH_LEAK "lv_err_rough_leak" UBYTE RANGE________0___0H__0H____1_819 2 2.0 0 255 BIT_MASK 0x1 FUNCTION_LIST DMTL ECU_ADDRESS 0xfd5a /end MEASUREMENT
/begin MEASUREMENT LV_ERR_SIG_DMTL "lv_err_sig_dmtl" UBYTE RANGE________0___0H__0H____1_819 2 2.0 0 255 BIT_MASK 0x20 FUNCTION_LIST DMTL ECU_ADDRESS 0xfd63 /end MEASUREMENT
/begin MEASUREMENT LV_ERR_SMALL_LEAK "lv_err_small_leak" UBYTE RANGE________0___0H__0H____1_819 2 2.0 0 255 BIT_MASK 0x2 FUNCTION_LIST DMTL ECU_ADDRESS 0xfd5a /end MEASUREMENT
/begin MEASUREMENT LV_ERR_TMP_MU "lv_err_tmp_mu" UBYTE RANGE________0___0H__0H____1_824 2 2.0 0 255 BIT_MASK 0x1 ECU_ADDRESS 0xfd7b /end MEASUREMENT
/begin MEASUREMENT LV_ERR_TMP_MU_MON2 "lv_err_tmp_mu_mon2" UWORD RANGE________0___0H__0H____1___1 2 2.0 0 65535 BIT_MASK 0x200 ECU_ADDRESS 0xfd82 /end MEASUREMENT
/begin MEASUREMENT LV_ERR_TPS_MON "lv_err_tps_mon" UBYTE RANGE________0___0H__0H____1_824 2 2.0 0 255 BIT_MASK 0x8 ECU_ADDRESS 0xfd0b /end MEASUREMENT
/begin MEASUREMENT LV_ERR_TPS_MON2 "lv_err_tps_mon2" UWORD RANGE________0___0H__0H____1___1 2 2.0 0 65535 BIT_MASK 0x80 ECU_ADDRESS 0xfd82 /end MEASUREMENT
/begin MEASUREMENT LV_ERR_TQ_LOSS_MON "lv_err_tq_loss_mon" UBYTE RANGE________0___0H__0H____1_824 2 2.0 0 255 BIT_MASK 0x2 ECU_ADDRESS 0xfd0c /end MEASUREMENT
/begin MEASUREMENT LV_ERR_TQ_LOSS_MON2 "lv_err_tq_loss_mon2" UWORD RANGE________0___0H__0H____1___1 2 2.0 0 65535 BIT_MASK 0x20 ECU_ADDRESS 0xfd82 /end MEASUREMENT
/begin MEASUREMENT LV_ERR_TQI_AV_MON "lv_err_tqi_av_mon" UBYTE RANGE________0___0H__0H____1_824 2 2.0 0 255 BIT_MASK 0x2 ECU_ADDRESS 0xfd09 /end MEASUREMENT
/begin MEASUREMENT LV_ERR_TQI_AV_MON2 "lv_err_tqi_av_mon2" UWORD RANGE________0___0H__0H____1___1 2 2.0 0 65535 BIT_MASK 0x4000 ECU_ADDRESS 0xfd84 /end MEASUREMENT
/begin MEASUREMENT LV_ERR_TQI_ISC_MON "lv_err_tqi_isc_mon" UBYTE RANGE________0___0H__0H____1_824 2 2.0 0 255 BIT_MASK 0x4 ECU_ADDRESS 0xfd0c /end MEASUREMENT
/begin MEASUREMENT LV_ERR_TQI_ISC_MON2 "lv_err_tqi_isc_mon2" UWORD RANGE________0___0H__0H____1___1 2 2.0 0 65535 BIT_MASK 0x10 ECU_ADDRESS 0xfd82 /end MEASUREMENT
/begin MEASUREMENT LV_ERR_TQI_LIM "lv_err_tqi_lim" UBYTE RANGE________0___0H__0H____1_824 2 2.0 0 255 BIT_MASK 0x80 ECU_ADDRESS 0xfdbb /end MEASUREMENT
/begin MEASUREMENT LV_ERR_TQI_N_MAX_MON "lv_err_tqi_n_max_mon" UBYTE RANGE________0___0H__0H____1_824 2 2.0 0 255 BIT_MASK 0x20 ECU_ADDRESS 0xfd08 /end MEASUREMENT
/begin MEASUREMENT LV_ERR_TQI_N_MAX_MON2 "lv_err_tqi_n_max_mon2" UWORD RANGE________0___0H__0H____1___1 2 2.0 0 65535 BIT_MASK 0x8000 ECU_ADDRESS 0xfd84 /end MEASUREMENT
/begin MEASUREMENT LV_ERR_TRAN_ENA_MON2 "lv_err_tran_ena_mon2" UWORD RANGE________0___0H__0H____1___1 2 2.0 0 65535 BIT_MASK 0x800 ECU_ADDRESS 0xfd82 /end MEASUREMENT
/begin MEASUREMENT LV_ERR_V_REF_1 "lv_err_v_ref_1" UBYTE RANGE________0___0H__0H____1_824 2 2.0 0 255 BIT_MASK 0x1 ECU_ADDRESS 0xfd10 /end MEASUREMENT
/begin MEASUREMENT LV_ERR_V_REF_1_MON "lv_err_v_ref_1_mon" UBYTE RANGE________0___0H__0H____1_824 2 2.0 0 255 BIT_MASK 0x80 ECU_ADDRESS 0xfd0b /end MEASUREMENT
/begin MEASUREMENT LV_ERR_V_REF_2 "lv_err_v_ref_2" UBYTE RANGE________0___0H__0H____1_824 2 2.0 0 255 BIT_MASK 0x2 ECU_ADDRESS 0xfd10 /end MEASUREMENT
/begin MEASUREMENT LV_ERR_V_REF_2_MON "lv_err_v_ref_2_mon" UBYTE RANGE________0___0H__0H____1_824 2 2.0 0 255 BIT_MASK 0x1 ECU_ADDRESS 0xfd0c /end MEASUREMENT
/begin MEASUREMENT LV_ERR_VDMTL "lv_err_vdmtl" UBYTE RANGE________0___0H__0H____1_819 2 2.0 0 255 BIT_MASK 0x20 ECU_ADDRESS 0xfdc0 /end MEASUREMENT
/begin MEASUREMENT LV_ERR_VLS_DOWN_1 "lv_err_vls_down_1" UBYTE RANGE________0___0H__0H____1_824 2 2.0 0 255 BIT_MASK 0x2 ECU_ADDRESS 0xfdb1 /end MEASUREMENT
/begin MEASUREMENT LV_ERR_VLS_DOWN_2 "lv_err_vls_down_2" UBYTE RANGE________0___0H__0H____1_824 2 2.0 0 255 BIT_MASK 0x8 ECU_ADDRESS 0xfdb2 /end MEASUREMENT
/begin MEASUREMENT LV_ERR_VLS_DOWN_ACT_CHK_1 "lv_err_vls_down_act_chk_1" UBYTE RANGE________0___0H__0H____1_824 2 2.0 0 255 BIT_MASK 0x1 ECU_ADDRESS 0xfdb2 /end MEASUREMENT
/begin MEASUREMENT LV_ERR_VLS_DOWN_ACT_CHK_2 "lv_err_vls_down_act_chk_2" UBYTE RANGE________0___0H__0H____1_824 2 2.0 0 255 BIT_MASK 0x2 ECU_ADDRESS 0xfdb2 /end MEASUREMENT
/begin MEASUREMENT LV_ERR_VLS_UP_1 "lv_err_vls_up_1" UBYTE RANGE________0___0H__0H____1_824 2 2.0 0 255 BIT_MASK 0x4 ECU_ADDRESS 0xfdaf /end MEASUREMENT
/begin MEASUREMENT LV_ERR_VLS_UP_2 "lv_err_vls_up_2" UBYTE RANGE________0___0H__0H____1_824 2 2.0 0 255 BIT_MASK 0x40 ECU_ADDRESS 0xfdaf /end MEASUREMENT
/begin MEASUREMENT LV_ERR_WHEEL "lv_err_wheel" UBYTE RANGE________0___0H__0H____1_824 2 2.0 0 255 BIT_MASK 0x2 ECU_ADDRESS 0xfd18 /end MEASUREMENT
/begin MEASUREMENT LV_ES_MON2 "lv_es_mon2" UWORD RANGE________0___0H__0H____1___1 2 2.0 0 65535 BIT_MASK 0x4000 ECU_ADDRESS 0xfd82 /end MEASUREMENT
/begin MEASUREMENT LV_FCO_DIAG_MAX "lv_fco_diag_max" UBYTE RANGE________0___0H__0H____1_819 2 2.0 0 255 BIT_MASK 0x4 FUNCTION_LIST DMTL ECU_ADDRESS 0xfd5a /end MEASUREMENT
/begin MEASUREMENT LV_FCO_DIAG_MIN "lv_fco_diag_min" UBYTE RANGE________0___0H__0H____1_819 2 2.0 0 255 BIT_MASK 0x8 FUNCTION_LIST DMTL ECU_ADDRESS 0xfd5a /end MEASUREMENT
/begin MEASUREMENT LV_FCO_H_FTL "lv_fco_h_ftl" UBYTE RANGE________0___0H__0H____1_819 2 2.0 0 255 BIT_MASK 0x10 FUNCTION_LIST DMTL ECU_ADDRESS 0xfd5a /end MEASUREMENT
/begin MEASUREMENT LV_FSD_PU_PUC_REAC "lv_fsd_pu_puc_reac" UBYTE RANGE________0___0H__0H____1_819 2 2.0 0 255 BIT_MASK 0x40 ECU_ADDRESS 0xfd3e /end MEASUREMENT
/begin MEASUREMENT LV_FTL_DEC "lv_ftl_dec" UBYTE RANGE________0___0H__0H____1_819 2 2.0 0 255 BIT_MASK 0x80 FUNCTION_LIST DMTL ECU_ADDRESS 0xfd5a /end MEASUREMENT
/begin MEASUREMENT LV_FTL_DEC_IGK_ON "lv_ftl_dec_igk_on" UBYTE RANGE________0___0H__0H____1_819 2 2.0 0 255 BIT_MASK 0x1 FUNCTION_LIST DMTL ECU_ADDRESS 0xfd5b /end MEASUREMENT
/begin MEASUREMENT LV_FTL_DIAG "lv_ftl_diag" UBYTE RANGE________0___0H__0H____1_819 2 2.0 0 255 BIT_MASK 0x2 FUNCTION_LIST DMTL ECU_ADDRESS 0xfd5b /end MEASUREMENT
/begin MEASUREMENT LV_FTL_DIF_IGN_OFF "lv_ftl_dif_ign_off" UBYTE RANGE________0___0H__0H____1_819 2 2.0 0 255 BIT_MASK 0x4 FUNCTION_LIST THKO_DMTL ECU_ADDRESS 0xfd5b /end MEASUREMENT
/begin MEASUREMENT LV_FTL_DMTL_MAX "lv_ftl_dmtl_max" UBYTE RANGE________0___0H__0H____1_819 2 2.0 0 255 BIT_MASK 0x8 FUNCTION_LIST DMTL ECU_ADDRESS 0xfd5b /end MEASUREMENT
/begin MEASUREMENT LV_FTL_DMTL_MIN "lv_ftl_dmtl_min" UBYTE RANGE________0___0H__0H____1_819 2 2.0 0 255 BIT_MASK 0x10 FUNCTION_LIST DMTL ECU_ADDRESS 0xfd5b /end MEASUREMENT
/begin MEASUREMENT LV_FTL_DMTL_VAL "lv_ftl_dmtl_val" UBYTE RANGE________0___0H__0H____1_819 2 2.0 0 255 BIT_MASK 0x20 FUNCTION_LIST THKO_DMTL ECU_ADDRESS 0xfd5b /end MEASUREMENT
/begin MEASUREMENT LV_FTL_DYN "lv_ftl_dyn" UBYTE RANGE________0___0H__0H____1_819 2 2.0 0 255 BIT_MASK 0x40 FUNCTION_LIST DMTL ECU_ADDRESS 0xfd5b /end MEASUREMENT
/begin MEASUREMENT LV_FTL_INC "lv_ftl_inc" UBYTE RANGE________0___0H__0H____1_819 2 2.0 0 255 BIT_MASK 0x80 FUNCTION_LIST DMTL ECU_ADDRESS 0xfd5b /end MEASUREMENT
/begin MEASUREMENT LV_FTL_INC_IGK_ON "lv_ftl_inc_igk_on" UBYTE RANGE________0___0H__0H____1_819 2 2.0 0 255 BIT_MASK 0x1 FUNCTION_LIST DMTL ECU_ADDRESS 0xfd5c /end MEASUREMENT
/begin MEASUREMENT LV_FUC_CAN "lv_fuc_can" UBYTE RANGE________0___0H__0H____1_819 2 2.0 0 255 BIT_MASK 0x1 FUNCTION_LIST DMTL ECU_ADDRESS 0xfd52 /end MEASUREMENT
/begin MEASUREMENT LV_FUC_INT "lv_fuc_int" UBYTE RANGE________0___0H__0H____1_819 2 2.0 0 255 BIT_MASK 0x40 FUNCTION_LIST DMTL ECU_ADDRESS 0xfd66 /end MEASUREMENT
/begin MEASUREMENT LV_FUC_OPEN "lv_fuc_open" UBYTE RANGE________0___0H__0H____1_819 2 2.0 0 255 BIT_MASK 0x20 FUNCTION_LIST DMTL ECU_ADDRESS 0xfd66 /end MEASUREMENT
/begin MEASUREMENT LV_GP "lv_gp" UBYTE RANGE________0___0H__0H____1_824 2 2.0 0 255 BIT_MASK 0x1 FUNCTION_LIST Z1S1 ECU_ADDRESS 0xfd22 /end MEASUREMENT
/begin MEASUREMENT LV_GS "lv_gs" UBYTE RANGE________0___0H__0H____1_824 2 2.0 0 255 BIT_MASK 0x40 FUNCTION_LIST Z1S1 ECU_ADDRESS 0xfd20 /end MEASUREMENT
/begin MEASUREMENT LV_HPA "lv_hpa" UBYTE RANGE________0___0H__0H____1_824 2 2.0 0 255 BIT_MASK 0x1 FUNCTION_LIST Z1S1 ECU_ADDRESS 0xfd21 /end MEASUREMENT
/begin MEASUREMENT LV_IGA_COR_ASR_ACT "lv_iga_cor_asr_act" UBYTE RANGE________active___1H__1H_822 2 2.0 0 255 BIT_MASK 0x8 ECU_ADDRESS 0xfd17 /end MEASUREMENT
/begin MEASUREMENT DYN_ZW_EINGRIFF "lv_iga_cor_asr_dyn" UBYTE RANGE________active___1H__1H_822 2 2.0 0 255 BIT_MASK 0x20 ECU_ADDRESS 0xfd17 /end MEASUREMENT
/begin MEASUREMENT LV_IGA_COR_LIM_DYN "lv_iga_cor_lim_dyn" UBYTE RANGE________0___0H__0H____1_824 2 2.0 0 255 BIT_MASK 0x40 ECU_ADDRESS 0xfd17 /end MEASUREMENT
/begin MEASUREMENT LV_IGK "lv_igk" UBYTE RANGE____________0H__0H____IGK__ 2 2.0 0 255 BIT_MASK 0x1 ECU_ADDRESS 0xfd74 /end MEASUREMENT
/begin MEASUREMENT LV_IGK_MON "lv_igk_mon" UBYTE RANGE________0___0H__0H____1_824 2 2.0 0 255 BIT_MASK 0x8 ECU_ADDRESS 0xfd0c /end MEASUREMENT
/begin MEASUREMENT LV_IGN_COIL "lv_ign_coil" UBYTE RANGE________0___0H__0H____1_824 2 2.0 0 255 BIT_MASK 0x20 ECU_ADDRESS 0xfd31 /end MEASUREMENT
/begin MEASUREMENT LV_IM_EF "lv_im_ef" UBYTE RANGE________OPEN___0H__0H____CL 2 2.0 0 255 BIT_MASK 0x40 ECU_ADDRESS 0xfdc8 /end MEASUREMENT
/begin MEASUREMENT LV_HDMTL_ON "lv_im_hdmtl" UBYTE RANGE________0___0H__0H____1_819 2 2.0 0 255 BIT_MASK 0x10 FUNCTION_LIST DMTL ECU_ADDRESS 0xfdc8 /end MEASUREMENT
/begin MEASUREMENT LV_IM_RLY_EFP "lv_im_rly_efp" UBYTE RANGE________ON___1H__1H____OFF_ 2 2.0 0 255 BIT_MASK 0x20 ECU_ADDRESS 0xfdc8 /end MEASUREMENT
/begin MEASUREMENT LV_VIM "lv_im_vim" UBYTE RANGE________OFF___0H__0H____ON_ 2 2.0 0 255 BIT_MASK 0x20 ECU_ADDRESS 0xfdc9 /end MEASUREMENT
/begin MEASUREMENT LV_ISA_LIH_ACT "lv_isa_lih_act" UBYTE RANGE________active___1H__1H_821 2 2.0 0 255 BIT_MASK 0x40 ECU_ADDRESS 0xfd26 /end MEASUREMENT
/begin MEASUREMENT LV_ISAPWM_DYW "lv_isapwm_dyw" UBYTE RANGE________ISAPWM___1H__1H____ 2 2.0 0 255 BIT_MASK 0x10 ECU_ADDRESS 0xfd35 /end MEASUREMENT
/begin MEASUREMENT LV_ISC_ACT "lv_isc_act" UBYTE RANGE________0___0H__0H____1_824 2 2.0 0 255 BIT_MASK 0x4 ECU_ADDRESS 0xfd36 /end MEASUREMENT
/begin MEASUREMENT LV_ISCL "lv_iscl" UBYTE RANGE________0___0H__0H____1_824 2 2.0 0 255 BIT_MASK 0x1 FUNCTION_LIST JOHE_OD ECU_ADDRESS 0xfd18 /end MEASUREMENT
/begin MEASUREMENT LV_IV_TRANS_MON "lv_iv_trans_mon" UBYTE RANGE________0___0H__0H____1_824 2 2.0 0 255 BIT_MASK 0x10 ECU_ADDRESS 0xfd08 /end MEASUREMENT
/begin MEASUREMENT LV_IVVT_ACT "lv_ivvt_act" UBYTE RANGE________0___0H__0H____1_824 2 2.0 0 255 BIT_MASK 0x1 ECU_ADDRESS 0xfd39 /end MEASUREMENT
/begin MEASUREMENT LV_IVVT_CAM_REF_EDGE "lv_ivvt_cam_ref_edge" UBYTE RANGE________0___0H__0H____1_824 2 2.0 0 255 BIT_MASK 0x2 ECU_ADDRESS 0xfd39 /end MEASUREMENT
/begin MEASUREMENT LV_CH_2_IVVT "lv_ivvt_ch_2" UBYTE RANGE________0___0H__0H____1_824 2 2.0 0 255 BIT_MASK 0x80 ECU_ADDRESS 0xfd39 /end MEASUREMENT
/begin MEASUREMENT LV_KD "lv_kd" UBYTE RANGE________0___0H__0H____1_819 2 2.0 0 255 BIT_MASK 0x20 FUNCTION_LIST THKO_DMTL ECU_ADDRESS 0xfd0e /end MEASUREMENT
/begin MEASUREMENT LV_KNK_1 "lv_knk_0" UBYTE RANGE________NO___0H__0H____YES_ 2 2.0 0 255 BIT_MASK 0x2 ECU_ADDRESS 0xfd67 /end MEASUREMENT
/begin MEASUREMENT LV_KNK_5 "lv_knk_1" UBYTE RANGE________NO___0H__0H____YES_ 2 2.0 0 255 BIT_MASK 0x4 ECU_ADDRESS 0xfd67 /end MEASUREMENT
/begin MEASUREMENT LV_KNK_1...6 "lv_knk_1_6" UBYTE RANGE________NO___0H__0H____YES_ 2 2.0 0 255 BIT_MASK 0x1 ECU_ADDRESS 0xfd67 /end MEASUREMENT
/begin MEASUREMENT LV_KNK_3 "lv_knk_2" UBYTE RANGE________NO___0H__0H____YES_ 2 2.0 0 255 BIT_MASK 0x8 ECU_ADDRESS 0xfd67 /end MEASUREMENT
/begin MEASUREMENT LV_KNK_6 "lv_knk_3" UBYTE RANGE________NO___0H__0H____YES_ 2 2.0 0 255 BIT_MASK 0x10 ECU_ADDRESS 0xfd67 /end MEASUREMENT
/begin MEASUREMENT LV_KNK_2 "lv_knk_4" UBYTE RANGE________NO___0H__0H____YES_ 2 2.0 0 255 BIT_MASK 0x20 ECU_ADDRESS 0xfd67 /end MEASUREMENT
/begin MEASUREMENT LV_KNK_4 "lv_knk_5" UBYTE RANGE________NO___0H__0H____YES_ 2 2.0 0 255 BIT_MASK 0x40 ECU_ADDRESS 0xfd67 /end MEASUREMENT
/begin MEASUREMENT LV_KNK_LIH "lv_knk_lih" UWORD RANGE_NOTLAUF 2 2.0 0 65535 BIT_MASK 0x2000 ECU_ADDRESS 0xfd9a /end MEASUREMENT
/begin MEASUREMENT LV_LD_FSD "lv_ld_fsd" UBYTE RANGE________0___0H__0H____1_824 2 2.0 0 255 BIT_MASK 0x8 ECU_ADDRESS 0xfd25 /end MEASUREMENT
/begin MEASUREMENT LV_MAF_OR_MAF_HFM_ERR "lv_maf_or_maf_hfm_err" UBYTE RANGE________0___0H__0H____1_819 2 2.0 0 255 BIT_MASK 0x8 ECU_ADDRESS 0xfd41 /end MEASUREMENT
/begin MEASUREMENT LV_MIL_ON "lv_mil_on" UBYTE RANGE________ON___1H__1H____OFF_ 2 2.0 0 255 BIT_MASK 0x10 ECU_ADDRESS 0xfd1d /end MEASUREMENT
/begin MEASUREMENT LV_MIS_A_STATE "lv_mis_a_state" UBYTE RANGE________0___0H__0H____1_819 2 2.0 0 255 BIT_MASK 0x2 ECU_ADDRESS 0xfd2a /end MEASUREMENT
/begin MEASUREMENT LV_MIS_STATE "lv_mis_state" UBYTE RANGE________0___0H__0H____1_819 2 2.0 0 255 BIT_MASK 0x1 ECU_ADDRESS 0xfd2a /end MEASUREMENT
/begin MEASUREMENT LV_MIS_STATE_OFF_IV "lv_mis_state_off_iv" UBYTE RANGE________active___1H__1H_822 2 2.0 0 255 BIT_MASK 0x20 ECU_ADDRESS 0xfd2a /end MEASUREMENT
/begin MEASUREMENT LV_MSR_ACT "lv_msr_act" UBYTE RANGE________LV_MSR___1H__1H____ 2 2.0 0 255 BIT_MASK 0x80 ECU_ADDRESS 0xfd1f /end MEASUREMENT
/begin MEASUREMENT LV_MSR_INH_MON "lv_msr_inh_mon" UBYTE RANGE________0___0H__0H____1_824 2 2.0 0 255 BIT_MASK 0x20 ECU_ADDRESS 0xfd0a /end MEASUREMENT
/begin MEASUREMENT LV_MTC_CTL_1_ERR "lv_mtc_ctl_1_err" UBYTE RANGE________0___0H__0H____1_824 2 2.0 0 255 BIT_MASK 0x40 FUNCTION_LIST JOHE_OD ECU_ADDRESS 0xfd0c /end MEASUREMENT
/begin MEASUREMENT LV_MTC_CTL_2_ERR "lv_mtc_ctl_2_err" UBYTE RANGE________0___0H__0H____1_824 2 2.0 0 255 BIT_MASK 0x80 FUNCTION_LIST JOHE_OD ECU_ADDRESS 0xfd0c /end MEASUREMENT
/begin MEASUREMENT LV_MTC_CTL_3_ERR "lv_mtc_ctl_3_err" UBYTE RANGE________0___0H__0H____1_824 2 2.0 0 255 BIT_MASK 0x1 ECU_ADDRESS 0xfd0d /end MEASUREMENT
/begin MEASUREMENT LV_MTC_CUR_OFF "lv_mtc_cur_off" UBYTE RANGE____________0H__0H____MTC_C 2 2.0 0 255 BIT_MASK 0x2 ECU_ADDRESS 0xfd0d /end MEASUREMENT
/begin MEASUREMENT LV_MTC_DIAG_CUR_OFF "lv_mtc_diag_cur_off" UBYTE RANGE____________0H__0H____MTC_D 2 2.0 0 255 BIT_MASK 0x4 ECU_ADDRESS 0xfd0d /end MEASUREMENT
/begin MEASUREMENT LV_MTC_LIH_CUR_OFF "lv_mtc_lih_cur_off" UBYTE RANGE____________0H__0H____MTC_L 2 2.0 0 255 BIT_MASK 0x10 ECU_ADDRESS 0xfd16 /end MEASUREMENT
/begin MEASUREMENT LV_MTCPWM_CLOSE_ACT "lv_mtcpwm_close_act" UBYTE RANGE________0___0H__0H____1_824 2 2.0 0 255 BIT_MASK 0x20 ECU_ADDRESS 0xfd0d /end MEASUREMENT
/begin MEASUREMENT LV_MTCPWM_DIAG_CUR_OFF "lv_mtcpwm_diag_cur_off" UBYTE RANGE____________0H__0H____MTCPW 2 2.0 0 255 BIT_MASK 0x10 ECU_ADDRESS 0xfd0c /end MEASUREMENT
/begin MEASUREMENT LV_MTCPWM_HYS_ACT "lv_mtcpwm_hys_act" UBYTE RANGE________0___0H__0H____1_819 2 2.0 0 255 BIT_MASK 0x8 ECU_ADDRESS 0xfd0d /end MEASUREMENT
/begin MEASUREMENT LV_N_DYW "lv_n_dyw" UBYTE RANGE________N___1H__1H________0 2 2.0 0 255 BIT_MASK 0x8 ECU_ADDRESS 0xfd35 /end MEASUREMENT
/begin MEASUREMENT LV_N_LIM_ETC_LIH "lv_n_lim_etc_lih" UBYTE RANGE________0___0H__0H____1_824 2 2.0 0 255 BIT_MASK 0x4 FUNCTION_LIST JOHE_OD ECU_ADDRESS 0xfd16 /end MEASUREMENT
/begin MEASUREMENT LV_N_LIM_ETC_LIH_REV "lv_n_lim_etc_lih_rev" UBYTE RANGE________0___0H__0H____1_824 2 2.0 0 255 BIT_MASK 0x8 FUNCTION_LIST JOHE_OD ECU_ADDRESS 0xfd16 /end MEASUREMENT
/begin MEASUREMENT LV_N_LIM_ETC_MON "lv_n_lim_etc_mon" UBYTE RANGE________0___0H__0H____1_824 2 2.0 0 255 BIT_MASK 0x10 FUNCTION_LIST JOHE_OD ECU_ADDRESS 0xfd0b /end MEASUREMENT
/begin MEASUREMENT LV_N_LIM_ETC_MON2 "lv_n_lim_etc_mon2" UBYTE RANGE________0___0H__0H____1_824 2 2.0 0 255 BIT_MASK 0x2 FUNCTION_LIST JOHE_OD ECU_ADDRESS 0xfd82 /end MEASUREMENT
/begin MEASUREMENT LV_N_LIM_REQ_MON "lv_n_lim_req_mon" UBYTE RANGE________0___0H__0H____1_824 2 2.0 0 255 BIT_MASK 0x4 ECU_ADDRESS 0xfd08 /end MEASUREMENT
/begin MEASUREMENT LV_N_LIM_REQ_MON2 "lv_n_lim_req_mon2" UWORD RANGE________0___0H__0H____1___1 2 2.0 0 65535 BIT_MASK 0x400 ECU_ADDRESS 0xfd84 /end MEASUREMENT
/begin MEASUREMENT LV_N_LIM_TPS_AD "lv_n_lim_tps_ad" UBYTE RANGE________0___0H__0H____1_819 2 2.0 0 255 BIT_MASK 0x80 ECU_ADDRESS 0xfd14 /end MEASUREMENT
/begin MEASUREMENT LV_OFF_IV_MON "lv_off_iv_mon" UBYTE RANGE________0___0H__0H____1_824 2 2.0 0 255 BIT_MASK 0x8 ECU_ADDRESS 0xfd08 /end MEASUREMENT
/begin MEASUREMENT LV_OFF_IV_MON2 "lv_off_iv_mon2" UWORD RANGE________0___0H__0H____1___1 2 2.0 0 65535 BIT_MASK 0x1000 ECU_ADDRESS 0xfd84 /end MEASUREMENT
/begin MEASUREMENT LV_OFF_MTC_IV_MU_MON "lv_off_mtc_iv_mu_mon" UBYTE RANGE________0___0H__0H____1_824 2 2.0 0 255 BIT_MASK 0x10 ECU_ADDRESS 0xfd7b /end MEASUREMENT
/begin MEASUREMENT LV_OFF_MTC_IV_MU_MON2 "lv_off_mtc_iv_mu_mon2" UWORD RANGE________0___0H__0H____1___1 2 2.0 0 65535 BIT_MASK 0x800 ECU_ADDRESS 0xfd84 /end MEASUREMENT
/begin MEASUREMENT LV_OFF_MTC_MON "lv_off_mtc_mon" UBYTE RANGE________0___0H__0H____1_824 2 2.0 0 255 BIT_MASK 0x2 ECU_ADDRESS 0xfd08 /end MEASUREMENT
/begin MEASUREMENT LV_OFF_MTC_MON2 "lv_off_mtc_mon2" UWORD RANGE________0___0H__0H____1___1 2 2.0 0 65535 BIT_MASK 0x2000 ECU_ADDRESS 0xfd84 /end MEASUREMENT
/begin MEASUREMENT LV_PLAUS_ASR "lv_plaus_asr" UBYTE RANGE________0___0H__0H____1_819 2 2.0 0 255 BIT_MASK 0x20 ECU_ADDRESS 0xfd23 /end MEASUREMENT
/begin MEASUREMENT LV_PLAUS_ASR_CTL "lv_plaus_asr_ctl" UBYTE RANGE________0___0H__0H____1_819 2 2.0 0 255 BIT_MASK 0x80 ECU_ADDRESS 0xfd23 /end MEASUREMENT
/begin MEASUREMENT LV_PLAUS_ESP_CTL "lv_plaus_esp_ctl" UBYTE RANGE________0___0H__0H____1_819 2 2.0 0 255 BIT_MASK 0x1 ECU_ADDRESS 0xfd24 /end MEASUREMENT
/begin MEASUREMENT LV_PLAUS_MSR "lv_plaus_msr" UBYTE RANGE________0___0H__0H____1_819 2 2.0 0 255 BIT_MASK 0x40 ECU_ADDRESS 0xfd23 /end MEASUREMENT
/begin MEASUREMENT LV_PREV_STATE_IV0_MON2 "lv_prev_state_iv0_mon2" UWORD RANGE________0___0H__0H____1___1 2 2.0 0 65535 BIT_MASK 0x1 ECU_ADDRESS 0xfd86 /end MEASUREMENT
/begin MEASUREMENT LV_PREV_STATE_IV1_MON2 "lv_prev_state_iv1_mon2" UWORD RANGE________0___0H__0H____1___1 2 2.0 0 65535 BIT_MASK 0x2 ECU_ADDRESS 0xfd86 /end MEASUREMENT
/begin MEASUREMENT LV_PREV_STATE_IV2_MON2 "lv_prev_state_iv2_mon2" UWORD RANGE________0___0H__0H____1___1 2 2.0 0 65535 BIT_MASK 0x4 ECU_ADDRESS 0xfd86 /end MEASUREMENT
/begin MEASUREMENT LV_PREV_STATE_IV3_MON2 "lv_prev_state_iv3_mon2" UWORD RANGE________0___0H__0H____1___1 2 2.0 0 65535 BIT_MASK 0x8 ECU_ADDRESS 0xfd86 /end MEASUREMENT
/begin MEASUREMENT LV_PREV_STATE_IV4_MON2 "lv_prev_state_iv4_mon2" UWORD RANGE________0___0H__0H____1___1 2 2.0 0 65535 BIT_MASK 0x10 ECU_ADDRESS 0xfd86 /end MEASUREMENT
/begin MEASUREMENT LV_PREV_STATE_IV5_MON2 "lv_prev_state_iv5_mon2" UWORD RANGE________0___0H__0H____1___1 2 2.0 0 65535 BIT_MASK 0x20 ECU_ADDRESS 0xfd86 /end MEASUREMENT
/begin MEASUREMENT LV_PVS_AV_STAT "lv_pvs_av_stat" UBYTE RANGE________0___0H__0H____1_819 2 2.0 0 255 BIT_MASK 0x10 ECU_ADDRESS 0xfd0f /end MEASUREMENT
/begin MEASUREMENT LV_PVS_BLS_BTS_NOT_PLAUS "lv_pvs_bls_bts_not_plaus" UBYTE RANGE________0___0H__0H____1_819 2 2.0 0 255 BIT_MASK 0x20 ECU_ADDRESS 0xfd0f /end MEASUREMENT
/begin MEASUREMENT LV_PVS_ERR "lv_pvs_err" UBYTE RANGE________NO_ERROR___0H__0H__ 2 2.0 0 255 BIT_MASK 0x40 ECU_ADDRESS 0xfd0e /end MEASUREMENT
/begin MEASUREMENT LV_PVS_ERR_1 "lv_pvs_err_1" UBYTE RANGE________NO_ERROR___0H__0H__ 2 2.0 0 255 BIT_MASK 0x4 ECU_ADDRESS 0xfd11 /end MEASUREMENT
/begin MEASUREMENT LV_PVS_ERR_2 "lv_pvs_err_2" UBYTE RANGE________NO_ERROR___0H__0H__ 2 2.0 0 255 BIT_MASK 0x8 ECU_ADDRESS 0xfd11 /end MEASUREMENT
/begin MEASUREMENT LV_PVS_ERR_PRED "lv_pvs_err_pred" UBYTE RANGE________0___0H__0H____1_824 2 2.0 0 255 BIT_MASK 0x4 ECU_ADDRESS 0xfd10 /end MEASUREMENT
/begin MEASUREMENT LV_PVS_H_R_1 "lv_pvs_h_r_1" UBYTE RANGE________0___0H__0H____1_824 2 2.0 0 255 BIT_MASK 0x40 ECU_ADDRESS 0xfd10 /end MEASUREMENT
/begin MEASUREMENT LV_PVS_H_R_2 "lv_pvs_h_r_2" UBYTE RANGE________0___0H__0H____1_824 2 2.0 0 255 BIT_MASK 0x80 ECU_ADDRESS 0xfd10 /end MEASUREMENT
/begin MEASUREMENT LV_PVS_RATIO_ERR "lv_pvs_ratio_err" UBYTE RANGE________NO_ERROR___0H__0H__ 2 2.0 0 255 BIT_MASK 0x8 ECU_ADDRESS 0xfd10 /end MEASUREMENT
/begin MEASUREMENT LV_PVS_SRCL_1 "lv_pvs_srcl_1" UBYTE RANGE________0___0H__0H____1_824 2 2.0 0 255 BIT_MASK 0x10 ECU_ADDRESS 0xfd10 /end MEASUREMENT
/begin MEASUREMENT LV_PVS_SRCL_2 "lv_pvs_srcl_2" UBYTE RANGE________0___0H__0H____1_824 2 2.0 0 255 BIT_MASK 0x20 ECU_ADDRESS 0xfd10 /end MEASUREMENT
/begin MEASUREMENT LV_R_DOWN_LS_MES_VLD_1 "lv_r_down_ls_mes_vld_1" UWORD RANGE________0___0H__0H____1___1 2 2.0 0 65535 BIT_MASK 0x8 FUNCTION_LIST R_LS_CALC ECU_ADDRESS 0x40c38 /end MEASUREMENT
/begin MEASUREMENT LV_R_DOWN_LS_MES_VLD_2 "lv_r_down_ls_mes_vld_2" UWORD RANGE________0___0H__0H____1___1 2 2.0 0 65535 BIT_MASK 0x8 FUNCTION_LIST R_LS_CALC ECU_ADDRESS 0x40d96 /end MEASUREMENT
/begin MEASUREMENT LV_R_LS_DOWN_AFR_MES_1 "lv_r_ls_down_afr_mes_1" UWORD RANGE________0___0H__0H____1___1 2 2.0 0 65535 BIT_MASK 0x80 FUNCTION_LIST R_LS_CALC ECU_ADDRESS 0x40c38 /end MEASUREMENT
/begin MEASUREMENT LV_R_LS_DOWN_AFR_MES_2 "lv_r_ls_down_afr_mes_2" UWORD RANGE________0___0H__0H____1___1 2 2.0 0 65535 BIT_MASK 0x80 FUNCTION_LIST R_LS_CALC ECU_ADDRESS 0x40d96 /end MEASUREMENT
/begin MEASUREMENT LV_R_LS_UP_AFR_MES_1 "lv_r_ls_up_afr_mes_1" UWORD RANGE________0___0H__0H____1___1 2 2.0 0 65535 BIT_MASK 0x40 FUNCTION_LIST R_LS_CALC ECU_ADDRESS 0x40c38 /end MEASUREMENT
/begin MEASUREMENT LV_R_LS_UP_AFR_MES_2 "lv_r_ls_up_afr_mes_2" UWORD RANGE________0___0H__0H____1___1 2 2.0 0 65535 BIT_MASK 0x40 FUNCTION_LIST R_LS_CALC ECU_ADDRESS 0x40d96 /end MEASUREMENT
/begin MEASUREMENT LV_R_UP_LS_MES_VLD_1 "lv_r_up_ls_mes_vld_1" UWORD RANGE________0___0H__0H____1___1 2 2.0 0 65535 BIT_MASK 0x4 FUNCTION_LIST R_LS_CALC ECU_ADDRESS 0x40c38 /end MEASUREMENT
/begin MEASUREMENT LV_R_UP_LS_MES_VLD_2 "lv_r_up_ls_mes_vld_2" UWORD RANGE________0___0H__0H____1___1 2 2.0 0 65535 BIT_MASK 0x4 FUNCTION_LIST R_LS_CALC ECU_ADDRESS 0x40d96 /end MEASUREMENT
/begin MEASUREMENT LV_RD_FTL "lv_rd_ftl" UBYTE RANGE________0___0H__0H____1_819 2 2.0 0 255 BIT_MASK 0x8 FUNCTION_LIST DMTL ECU_ADDRESS 0xfd5d /end MEASUREMENT
/begin MEASUREMENT LV_REF_LEAK_ROUGH_LEAK_SUSP "lv_ref_leak_rough_leak_susp" UBYTE RANGE________0___0H__0H____1_819 2 2.0 0 255 BIT_MASK 0x8 ECU_ADDRESS 0xfd5e /end MEASUREMENT
/begin MEASUREMENT LV_REFU "lv_refu" UBYTE RANGE________0___0H__0H____1_819 2 2.0 0 255 BIT_MASK 0x10 FUNCTION_LIST DMTL ECU_ADDRESS 0xfd5e /end MEASUREMENT
/begin MEASUREMENT LV_REFU_1 "lv_refu_1" UBYTE RANGE________0___0H__0H____1_819 2 2.0 0 255 BIT_MASK 0x20 FUNCTION_LIST DMTL ECU_ADDRESS 0xfd5e /end MEASUREMENT
/begin MEASUREMENT LV_REFU_DMTL "lv_refu_dmtl" UBYTE RANGE________0___0H__0H____1_819 2 2.0 0 255 BIT_MASK 0x40 FUNCTION_LIST DMTL ECU_ADDRESS 0xfd5e /end MEASUREMENT
/begin MEASUREMENT LV_REFU_END "lv_refu_end" UBYTE RANGE________0___0H__0H____1_819 2 2.0 0 255 BIT_MASK 0x80 FUNCTION_LIST DMTL ECU_ADDRESS 0xfd5e /end MEASUREMENT
/begin MEASUREMENT LV_REFU_RLS_DIAG "lv_refu_rls_diag" UBYTE RANGE________0___0H__0H____1_819 2 2.0 0 255 BIT_MASK 0x2 FUNCTION_LIST DMTL ECU_ADDRESS 0xfd5f /end MEASUREMENT
/begin MEASUREMENT LV_REFU_VAL "lv_refu_val" UBYTE RANGE________0___0H__0H____1_819 2 2.0 0 255 BIT_MASK 0x4 FUNCTION_LIST DMTL ECU_ADDRESS 0xfd5f /end MEASUREMENT
/begin MEASUREMENT LV_REFU_VAL_1 "lv_refu_val_1" UBYTE RANGE________0___0H__0H____1_819 2 2.0 0 255 BIT_MASK 0x8 FUNCTION_LIST DMTL ECU_ADDRESS 0xfd5f /end MEASUREMENT
/begin MEASUREMENT LV_REQ_CPS_CLOSE_ROUGH "lv_req_cps_close_rough" UBYTE RANGE________0___0H__0H____1_819 2 2.0 0 255 BIT_MASK 0x20 FUNCTION_LIST DMTL ECU_ADDRESS 0xfd5f /end MEASUREMENT
/begin MEASUREMENT LV_REQ_ENA_ROUGH_LEAK "lv_req_ena_rough_leak" UBYTE RANGE________0___0H__0H____1_824 2 2.0 0 255 BIT_MASK 0x80 FUNCTION_LIST JOHE_OD ECU_ADDRESS 0xfd5f /end MEASUREMENT
/begin MEASUREMENT LV_REQ_HEAT "lv_req_heat" UBYTE RANGE________0___0H__0H____1_819 2 2.0 0 255 BIT_MASK 0x80 ECU_ADDRESS 0xfd1d /end MEASUREMENT
/begin MEASUREMENT LV_REQ_OBD_DIAG "lv_req_obd_diag" UBYTE RANGE________0___0H__0H____1_824 2 2.0 0 255 BIT_MASK 0x2 FUNCTION_LIST JOHE_OD ECU_ADDRESS 0xfd66 /end MEASUREMENT
/begin MEASUREMENT LV_REQ_PWL_DMTL "lv_req_pwl_dmtl" UBYTE RANGE________0___0H__0H____1_824 2 2.0 0 255 BIT_MASK 0x8 FUNCTION_LIST JOHE_OD ECU_ADDRESS 0xfd51 /end MEASUREMENT
/begin MEASUREMENT LV_REQ_PWL_ROUGH_LEAK "lv_req_pwl_rough_leak" UBYTE RANGE________0___0H__0H____1_824 2 2.0 0 255 BIT_MASK 0x1 FUNCTION_LIST JOHE_OD ECU_ADDRESS 0xfd60 /end MEASUREMENT
/begin MEASUREMENT LV_REQ_PWL_SMALL_LEAK "lv_req_pwl_small_leak" UBYTE RANGE________0___0H__0H____1_824 2 2.0 0 255 BIT_MASK 0x2 FUNCTION_LIST JOHE_OD ECU_ADDRESS 0xfd60 /end MEASUREMENT
/begin MEASUREMENT LV_REQ_ROUGH_LEAK "lv_req_rough_leak" UBYTE RANGE________0___0H__0H____1_819 2 2.0 0 255 BIT_MASK 0x80 FUNCTION_LIST DMTL ECU_ADDRESS 0xfd65 /end MEASUREMENT
/begin MEASUREMENT LV_REST "lv_rest" UBYTE RANGE________0___0H__0H____1_824 2 2.0 0 255 BIT_MASK 0x8 FUNCTION_LIST ETM ECU_ADDRESS 0xfd4b /end MEASUREMENT
/begin MEASUREMENT LV_RLY_ACC_TRIG_VL "lv_rly_acc_trig_vl" UBYTE RANGE________0___0H__0H____1_824 2 2.0 0 255 BIT_MASK 0x80 ECU_ADDRESS 0xfd42 /end MEASUREMENT
/begin MEASUREMENT LV_RON_LOW "lv_ron_low" UBYTE RANGE________0___0H__0H____1_824 2 2.0 0 255 BIT_MASK 0x80 ECU_ADDRESS 0xfd3a /end MEASUREMENT
/begin MEASUREMENT LV_ROUGH_LEAK_MES_LEN "lv_rough_leak_mes_len" UBYTE RANGE________0___0H__0H____1_819 2 2.0 0 255 BIT_MASK 0x40 FUNCTION_LIST DMTL ECU_ADDRESS 0xfd63 /end MEASUREMENT
/begin MEASUREMENT LV_ROUGH_LEAK_SUSP "lv_rough_leak_susp" UBYTE RANGE________0___0H__0H____1_819 2 2.0 0 255 BIT_MASK 0x4 FUNCTION_LIST DMTL ECU_ADDRESS 0xfd60 /end MEASUREMENT
/begin MEASUREMENT LV_ROUGH_LEAK_SUSP_1 "lv_rough_leak_susp_1" UBYTE RANGE________0___0H__0H____1_819 2 2.0 0 255 BIT_MASK 0x8 FUNCTION_LIST DMTL ECU_ADDRESS 0xfd60 /end MEASUREMENT
/begin MEASUREMENT LV_ROUGH_LEAK_SUSP_2 "lv_rough_leak_susp_2" UBYTE RANGE________0___0H__0H____1_819 2 2.0 0 255 BIT_MASK 0x20 FUNCTION_LIST DMTL ECU_ADDRESS 0xfd60 /end MEASUREMENT
/begin MEASUREMENT LV_ROUGH_LEAK_SUSP_3 "lv_rough_leak_susp_3" UBYTE RANGE________0___0H__0H____1_819 2 2.0 0 255 BIT_MASK 0x40 FUNCTION_LIST DMTL ECU_ADDRESS 0xfd60 /end MEASUREMENT
/begin MEASUREMENT LV_ROUGH_LEAK_SUSP_4 "lv_rough_leak_susp_4" UBYTE RANGE________0___0H__0H____1_819 2 2.0 0 255 BIT_MASK 0x80 FUNCTION_LIST DMTL ECU_ADDRESS 0xfd60 /end MEASUREMENT
/begin MEASUREMENT LV_ROUGH_LEAK_SUSP_SET "lv_rough_leak_susp_set" UBYTE RANGE________0___0H__0H____1_819 2 2.0 0 255 BIT_MASK 0x1 FUNCTION_LIST DMTL ECU_ADDRESS 0xfd61 /end MEASUREMENT
/begin MEASUREMENT LV_SA_DIAG_CDN "lv_sa_diag_cdn" UWORD RANGE________0___0H__0H____1___1 2 2.0 0 65535 BIT_MASK 0x200 ECU_ADDRESS 0xfda6 /end MEASUREMENT
/begin MEASUREMENT LV_SA_DIAG_END "lv_sa_diag_end" UWORD RANGE________0___0H__0H____1___1 2 2.0 0 65535 BIT_MASK 0x800 ECU_ADDRESS 0xfda6 /end MEASUREMENT
/begin MEASUREMENT LV_SA_DIAG_GLOB_ERR "lv_sa_diag_glob_err" UBYTE RANGE________0___0H__0H____1_824 2 2.0 0 255 BIT_MASK 0x2 ECU_ADDRESS 0xfd12 /end MEASUREMENT
/begin MEASUREMENT LV_SA_DIAG_PROLONG "lv_sa_diag_prolong" UWORD RANGE________0___0H__0H____1___1 2 2.0 0 65535 BIT_MASK 0x100 ECU_ADDRESS 0xfda6 /end MEASUREMENT
/begin MEASUREMENT LV_SA_LOCK_LAM "lv_sa_lock_lam" UWORD RANGE________0___0H__0H____1___1 2 2.0 0 65535 BIT_MASK 0x4 ECU_ADDRESS 0xfda6 /end MEASUREMENT
/begin MEASUREMENT LV_SA_SAP_ACT "lv_sa_sap_act" UWORD RANGE________0___0H__0H____1___1 2 2.0 0 65535 BIT_MASK 0x2 ECU_ADDRESS 0xfda6 /end MEASUREMENT
/begin MEASUREMENT LV_SA_SAV_ACT "lv_sa_sav_act" UWORD RANGE________0___0H__0H____1___1 2 2.0 0 65535 BIT_MASK 0x1 ECU_ADDRESS 0xfda6 /end MEASUREMENT
/begin MEASUREMENT LV_SA_T_DIAG_START "lv_sa_t_diag_start" UBYTE RANGE________0___0H__0H____1_824 2 2.0 0 255 BIT_MASK 0x4 FUNCTION_LIST JOHE_OD ECU_ADDRESS 0xfd12 /end MEASUREMENT
/begin MEASUREMENT LV_SAP_ACT_SAV_DIAG "lv_sap_act_sav_diag" UBYTE RANGE________0___0H__0H____1_824 2 2.0 0 255 BIT_MASK 0x2000 FUNCTION_LIST JOHE_OD ECU_ADDRESS 0xfda6 /end MEASUREMENT
/begin MEASUREMENT LV_SAP_SAV_ACT "lv_sap_sav_act" UBYTE RANGE________0___0H__0H____1_824 2 2.0 0 255 BIT_MASK 0x8 FUNCTION_LIST JOHE_OD ECU_ADDRESS 0xfd12 /end MEASUREMENT
/begin MEASUREMENT LV_SAV_DIAG_CNL "lv_sav_diag_cnl" UBYTE RANGE________0___0H__0H____1_824 2 2.0 0 255 BIT_MASK 0x8000 FUNCTION_LIST JOHE_OD ECU_ADDRESS 0xfda6 /end MEASUREMENT
/begin MEASUREMENT LV_SAV_DIAG_END "lv_sav_diag_end" UBYTE RANGE________0___0H__0H____1_824 2 2.0 0 255 BIT_MASK 0x1000 FUNCTION_LIST JOHE_OD ECU_ADDRESS 0xfda6 /end MEASUREMENT
/begin MEASUREMENT LV_SAV_DIAG_THD "lv_sav_diag_thd" UBYTE RANGE________0___0H__0H____1_824 2 2.0 0 255 BIT_MASK 0x2000 FUNCTION_LIST JOHE_OD ECU_ADDRESS 0xfda6 /end MEASUREMENT
/begin MEASUREMENT LV_SDR_DMTL "lv_sdr_dmtl" UBYTE RANGE________0___0H__0H____1_819 2 2.0 0 255 BIT_MASK 0x2 FUNCTION_LIST DMTL ECU_ADDRESS 0xfd61 /end MEASUREMENT
/begin MEASUREMENT LV_SEG_AD_ACT_STATE "lv_seg_ad_act_state" UBYTE RANGE________0___0H__0H____1_819 2 2.0 0 255 BIT_MASK 0x40 ECU_ADDRESS 0xfd2a /end MEASUREMENT
/begin MEASUREMENT LV_SEG_AD_STATE "lv_seg_ad_state" UBYTE RANGE________YES___1H__1H____NO_ 2 2.0 0 255 BIT_MASK 0x8 ECU_ADDRESS 0xfd2a /end MEASUREMENT
/begin MEASUREMENT LV_SMALL_LEAK_MES_LEN "lv_small_leak_mes_len" UBYTE RANGE________0___0H__0H____1_819 2 2.0 0 255 BIT_MASK 0x80 FUNCTION_LIST DMTL ECU_ADDRESS 0xfd63 /end MEASUREMENT
/begin MEASUREMENT LV_ST_MON2 "lv_st_mon2" UWORD RANGE________0___0H__0H____1___1 2 2.0 0 65535 BIT_MASK 0x8000 ECU_ADDRESS 0xfd82 /end MEASUREMENT
/begin MEASUREMENT STATE_CC_AJ "lv_state_cc_aj" UBYTE RANGE________0___0H__0H____1_824 2 2.0 0 255 BIT_MASK 0x4 ECU_ADDRESS 0xfd1f /end MEASUREMENT
/begin MEASUREMENT LV_STATE_RR "lv_state_rr" UBYTE RANGE________active___1H__1H_822 2 2.0 0 255 BIT_MASK 0x40 ECU_ADDRESS 0xfd45 /end MEASUREMENT
/begin MEASUREMENT LV_SUPP_ST_ACT "lv_supp_st_act" UBYTE RANGE________0___0H__0H____1_824 2 2.0 0 255 BIT_MASK 0x4 ECU_ADDRESS 0xfd4e /end MEASUREMENT
/begin MEASUREMENT LV_SWI_WUP "lv_swi_wup" UBYTE RANGE________0___0H__0H____1_824 2 2.0 0 255 BIT_MASK 0x4 ECU_ADDRESS 0xfd20 /end MEASUREMENT
/begin MEASUREMENT LV_T_COP_STEP2_1 "lv_t_cop_step2_1" UBYTE RANGE________0___0H__0H____1_819 2 2.0 0 255 BIT_MASK 0x4 ECU_ADDRESS 0xfd4a /end MEASUREMENT
/begin MEASUREMENT LV_T_COP_STEP2_2 "lv_t_cop_step2_2" UBYTE RANGE________0___0H__0H____1_819 2 2.0 0 255 BIT_MASK 0x8 ECU_ADDRESS 0xfd4a /end MEASUREMENT
/begin MEASUREMENT LV_T_DIAG_SA "lv_t_diag_sa" UWORD RANGE________0___0H__0H____1___1 2 2.0 0 65535 BIT_MASK 0x400 ECU_ADDRESS 0xfda6 /end MEASUREMENT
/begin MEASUREMENT LV_T_DLY_DMTL_PWL "lv_t_dly_dmtl_pwl" UBYTE RANGE________0___0H__0H____1_819 2 2.0 0 255 BIT_MASK 0x20 FUNCTION_LIST DMTL ECU_ADDRESS 0xfd61 /end MEASUREMENT
/begin MEASUREMENT LV_T_REL_CAN_REC "lv_t_rel_can_rec" UBYTE RANGE________0___0H__0H____1_824 2 2.0 0 255 BIT_MASK 0x8 ECU_ADDRESS 0xfd1f /end MEASUREMENT
/begin MEASUREMENT LV_T_SEG_AD_ERR "lv_t_seg_ad_err" UBYTE RANGE________0___0H__0H____1_819 2 2.0 0 255 BIT_MASK 0x1 ECU_ADDRESS 0xfd2b /end MEASUREMENT
/begin MEASUREMENT LV_T_SEG_TOOTH_ERR "lv_t_seg_tooth_err" UBYTE RANGE________0___0H__0H____1_819 2 2.0 0 255 BIT_MASK 0x80 ECU_ADDRESS 0xfd2a /end MEASUREMENT
/begin MEASUREMENT LV_TAM_REC "lv_tam_rec" UBYTE RANGE________0___0H__0H____1_819 2 2.0 0 255 BIT_MASK 0x20 FUNCTION_LIST ETM ECU_ADDRESS 0xfd1f /end MEASUREMENT
/begin MEASUREMENT LV_TEG_DOWN_MES_GRD_MAX_2 "lv_teg_down_mes_grd_max_2" UBYTE RANGE________0___0H__0H____1_824 2 2.0 0 255 BIT_MASK 0x2 ECU_ADDRESS 0xfd13 /end MEASUREMENT
/begin MEASUREMENT LV_TEG_UP_MES_GRD_MAX_1 "lv_teg_up_mes_grd_max_1" UBYTE RANGE________0___0H__0H____1_824 2 2.0 0 255 BIT_MASK 0x80 ECU_ADDRESS 0xfd12 /end MEASUREMENT
/begin MEASUREMENT LV_TEG_UP_MES_GRD_MAX_2 "lv_teg_up_mes_grd_max_2" UBYTE RANGE________0___0H__0H____1_824 2 2.0 0 255 BIT_MASK 0x1 ECU_ADDRESS 0xfd13 /end MEASUREMENT
/begin MEASUREMENT LV_TEMP_DEW_MIN_DOWN "lv_temp_dew_min_down" UBYTE RANGE________0___0H__0H____1_824 2 2.0 0 255 BIT_MASK 0x20 FUNCTION_LIST DPM ECU_ADDRESS 0xfd12 /end MEASUREMENT
/begin MEASUREMENT LV_TEMP_DEW_MIN_UP "lv_temp_dew_min_up" UBYTE RANGE________0___0H__0H____1_824 2 2.0 0 255 BIT_MASK 0x40 FUNCTION_LIST DPM ECU_ADDRESS 0xfd12 /end MEASUREMENT
/begin MEASUREMENT LV_THD_CUR_DMTL_DIF_MES "lv_thd_cur_dmtl_dif_mes" UBYTE RANGE________0___0H__0H____1_824 2 2.0 0 255 BIT_MASK 0x40 FUNCTION_LIST JOHE_OD ECU_ADDRESS 0xfd61 /end MEASUREMENT
/begin MEASUREMENT LV_TI_CH "lv_ti_ch" UBYTE RANGE________0___0H__0H____1_819 2 2.0 0 255 BIT_MASK 0x20 ECU_ADDRESS 0xfd50 /end MEASUREMENT
/begin MEASUREMENT LV_TPS_AD_CUR_OFF "lv_tps_ad_cur_off" UBYTE RANGE____________0H__0H____TPS_A 2 2.0 0 255 BIT_MASK 0x20 ECU_ADDRESS 0xfd14 /end MEASUREMENT
/begin MEASUREMENT LV_TPS_AD_DIAG_CUR_OFF "lv_tps_ad_diag_cur_off" UBYTE RANGE____________0H__0H____TP826 2 2.0 0 255 BIT_MASK 0x40 ECU_ADDRESS 0xfd14 /end MEASUREMENT
/begin MEASUREMENT LV_TPS_AD_MEC_BOL "lv_tps_ad_mec_bol" UBYTE RANGE________0___0H__0H____1_819 2 2.0 0 255 BIT_MASK 0x10 ECU_ADDRESS 0xfd0d /end MEASUREMENT
/begin COMPU_METHOD LINEAR______0_000000__0H___255_0 "" FORM "%3.0" "-" FORMULA "1.0*X" FORMULA_INV "1.0*X" /end COMPU_METHOD
/begin COMPU_METHOD LINEAR______0_000000__0H___65535 "" FORM "%5.0" "-" FORMULA "1.0*X" FORMULA_INV "1.0*X" /end COMPU_METHOD
/begin COMPU_METHOD LINEAR______0_000000__0H___0_996 "" FORM "%5.3" "-" FORMULA "0.00390625*X" FORMULA_INV "256.0*X" /end COMPU_METHOD
/begin COMPU_METHOD LINEAR______0_000000__0H___255_4 "" FORM "%3.0" "*seg" FORMULA "1.0*X" FORMULA_INV "1.0*X" /end COMPU_METHOD
/begin COMPU_METHOD LINEAR______0_000000__0H___99_60 "" FORM "%4.1" "%" FORMULA "0.390625*X" FORMULA_INV "2.56*X" /end COMPU_METHOD
/begin COMPU_METHOD LINEAR_______48_000000__0H___142 "" FORM "%5.1" "°C" FORMULA "0.75*X-48.0" FORMULA_INV "1.3333333*X+64.0" /end COMPU_METHOD
/begin COMPU_METHOD LINEAR______0_000000__0H___65534 "" FORM "%6.0" "km" FORMULA "10.0*X" FORMULA_INV "0.1*X" /end COMPU_METHOD
/begin COMPU_METHOD LINEAR______0_000000__0H___1_992 "" FORM "%5.3" "-" FORMULA "0.0078125*X" FORMULA_INV "128.0*X" /end COMPU_METHOD
/begin COMPU_METHOD LINEAR_______48_000000__0H___47_ "" FORM "%6.2" "°CRK" FORMULA "0.375*X-48.0" FORMULA_INV "2.6666667*X+128.0" /end COMPU_METHOD
/begin COMPU_METHOD LINEAR_______23_625000__0H___72_ "" FORM "%5.1" "°CRK" FORMULA "0.375*X-23.625" FORMULA_INV "2.6666667*X+63.0" /end COMPU_METHOD
/begin COMPU_METHOD LINEAR______0_000000__0H___399_9 "" FORM "%7.3" "%" FORMULA "0.0061035142*X" FORMULA_INV "163.84004*X" /end COMPU_METHOD
/begin COMPU_METHOD LINEAR_______50_000000__0H___49_ "" FORM "%5.1" "%" FORMULA "0.3906251*X-50.0" FORMULA_INV "2.5599994*X+127.99997" /end COMPU_METHOD
/begin COMPU_METHOD LINEAR______0_000000__0H___1389_ "" FORM "%4.0" "mg/stk" FORMULA "5.4470588*X" FORMULA_INV "0.18358531*X" /end COMPU_METHOD
/begin COMPU_METHOD LINEAR______0_000000__0H___349_5 "" FORM "%7.3" "ms" FORMULA "0.0053333333*X" FORMULA_INV "187.5*X" /end COMPU_METHOD
/begin COMPU_METHOD LINEAR______0_000000__0H___95_22 "" FORM "%5.2" "°CRK" FORMULA "0.375*X" FORMULA_INV "2.6666667*X" /end COMPU_METHOD
/begin COMPU_METHOD LINEAR_______155_625000__FFH____ "" FORM "%6.1" "°CRK" FORMULA "-0.375*X-60.0" FORMULA_INV "-2.6666667*X-160.0" /end COMPU_METHOD
/begin COMPU_METHOD LINEAR______60_000000__0H___155_ "" FORM "%6.2" "°CRK" FORMULA "0.375*X+60.0" FORMULA_INV "2.6666667*X-160.0" /end COMPU_METHOD
/begin COMPU_METHOD LINEAR______0_000000__0H___0_999 "" FORM "%7.5" "-" FORMULA "1.5258789e-005*X" FORMULA_INV "65536.0*X" /end COMPU_METHOD
/begin COMPU_METHOD LINEAR______0_000000__0H___65529 "" FORM "%5.0" "m" FORMULA "1.0*X" FORMULA_INV "1.0*X" /end COMPU_METHOD
/begin COMPU_METHOD LINEAR______0_000000__0H___2550_ "" FORM "%4.0" "ms" FORMULA "10.0*X" FORMULA_INV "0.1*X" /end COMPU_METHOD
/begin COMPU_METHOD LINEAR______0_000000__0H___2559_ "" FORM "%7.2" "-" FORMULA "0.0390625*X" FORMULA_INV "25.6*X" /end COMPU_METHOD
/begin COMPU_METHOD LINEAR______0_000000__0H___25_50 "" FORM "%4.1" "s" FORMULA "0.1*X" FORMULA_INV "10.0*X" /end COMPU_METHOD
/begin COMPU_METHOD LINEAR______0_000000__0H___1_999 "" FORM "%7.5" "-" FORMULA "3.0517585e-005*X" FORMULA_INV "32767.992*X" /end COMPU_METHOD
/begin COMPU_METHOD LINEAR______0_000000__0H___7_999 "" FORM "%6.4" "-" FORMULA "0.00012207031*X" FORMULA_INV "8191.9999*X" /end COMPU_METHOD
/begin COMPU_METHOD LINEAR______0_000000__0H___99_99 "" FORM "%6.3" "%" FORMULA "0.0015258789*X" FORMULA_INV "655.36*X" /end COMPU_METHOD
/begin COMPU_METHOD LINEAR_______50_000000__0H___440 "" FORM "%7.3" "%" FORMULA "0.0015258789*X-50.0" FORMULA_INV "655.36002*X+32768.001" /end COMPU_METHOD
/begin COMPU_METHOD LINEAR_______48_000000__0H___041 "" FORM "%5.1" "°CRK" FORMULA "0.375*X-48.0" FORMULA_INV "2.6666667*X+128.0" /end COMPU_METHOD
/begin COMPU_METHOD LINEAR______0_000000__0H___100_0 "" FORM "%5.1" "%" FORMULA "0.39215686*X" FORMULA_INV "2.55*X" /end COMPU_METHOD
/begin COMPU_METHOD LINEAR______0_000000__0H___10253 "" FORM "%7.2" "°C" FORMULA "0.015625*X" FORMULA_INV "64.0*X" /end COMPU_METHOD
/begin COMPU_METHOD LINEAR______0_000000__0H___2_054 "" FORM "%7.5" "-" FORMULA "3.0518044e-005*X" FORMULA_INV "32767.5*X" /end COMPU_METHOD
/begin COMPU_METHOD LINEAR______0_000000__0H___5_100 "" FORM "%4.2" "V" FORMULA "0.02*X" FORMULA_INV "50.000001*X" /end COMPU_METHOD
/begin COMPU_METHOD LINEAR______0_000000__0H___1_275 "" FORM "%5.3" "V" FORMULA "0.005*X" FORMULA_INV "200.0*X" /end COMPU_METHOD
/begin COMPU_METHOD LINEAR______0_000000__0H___159_3 "" FORM "%5.1" "ms" FORMULA "0.625*X" FORMULA_INV "1.6*X" /end COMPU_METHOD
/begin COMPU_METHOD LINEAR______0_000000__0H___126_0 "" FORM "%3.0" "L" FORMULA "1.0*X" FORMULA_INV "1.0*X" /end COMPU_METHOD
/begin COMPU_METHOD LINEAR_______1_000000__1H____218 "" FORM "%7.1" "us" FORMULA "-0.66663615*X-0.33336385" FORMULA_INV "-1.5000687*X-0.50006867" /end COMPU_METHOD
/begin COMPU_METHOD LINEAR_______0_500000__0H___0_49 "" FORM "%5.3" "-" FORMULA "0.0039058823*X-0.5" FORMULA_INV "256.0241*X+128.01205" /end COMPU_METHOD
/begin COMPU_METHOD LINEAR______0_000000__0H___7456_ "" FORM "%8.3" "kJ" FORMULA "0.11377777*X" FORMULA_INV "8.7890633*X" /end COMPU_METHOD
/begin COMPU_METHOD LINEAR______0_000000__0H___255_9 "" FORM "%7.3" "-" FORMULA "0.0039062501*X" FORMULA_INV "255.99999*X" /end COMPU_METHOD
/begin COMPU_METHOD LINEAR______0_000000__0H___63_99 "" FORM "%7.4" "°C*kJ/s" FORMULA "0.0009765625*X" FORMULA_INV "1024.0*X" /end COMPU_METHOD
/begin COMPU_METHOD LINEAR______0_000000__0H___3_000 "" FORM "%2.0" "-" FORMULA "1.0*X" FORMULA_INV "1.0*X" /end COMPU_METHOD
/begin COMPU_METHOD LINEAR_______1_275000__FFFF8080H "" FORM "%6.3" "V" FORMULA "3.90625e-005*X" FORMULA_INV "25600.0*X" /end COMPU_METHOD
/begin COMPU_METHOD LINEAR_______1_275000__FFFF80102 "" FORM "%6.3" "V/10ms" FORMULA "3.90625e-005*X" FORMULA_INV "25600.0*X" /end COMPU_METHOD
/begin COMPU_METHOD LINEAR______0_000000__0H___4294_ "" FORM "%6.1" "L" FORMULA "0.065535973*X" FORMULA_INV "15.258795*X" /end COMPU_METHOD
/begin COMPU_METHOD LINEAR______0_000000__0H___0_106 "" FORM "%5.3" "-" FORMULA "1.5258789e-005*X" FORMULA_INV "65536.0*X" /end COMPU_METHOD
/begin COMPU_METHOD LINEAR_______48_000000__0H___107 "" FORM "%4.1" "°CRK" FORMULA "0.375*X-48.0" FORMULA_INV "2.6666667*X+128.0" /end COMPU_METHOD
/begin COMPU_METHOD LINEAR_______50_000000__FFFF8000 "" FORM "%7.3" "%" FORMULA "0.0015258793*X+1.2939651e-005" FORMULA_INV "655.35983*X-0.0084801272" /end COMPU_METHOD
/begin COMPU_METHOD LINEAR_______200_000000__FFFF111 "" FORM "%8.4" "%" FORMULA "0.0061035142*X-4.8242924e-005" FORMULA_INV "163.84004*X+0.0079041225" /end COMPU_METHOD
/begin COMPU_METHOD LINEAR_______50_000000__FFFFFF80 "" FORM "%6.2" "%" FORMULA "0.39062745*X+0.00031372549" FORMULA_INV "2.5599839*X-0.00080313222" /end COMPU_METHOD
/begin COMPU_METHOD LINEAR______0_000000__0H___65112 "" FORM "%5.0" "km" FORMULA "1.0*X" FORMULA_INV "1.0*X" /end COMPU_METHOD
/begin COMPU_METHOD LINEAR______0_000000__0H___65113 "" FORM "%5.0" "*20ms" FORMULA "1.0*X" FORMULA_INV "1.0*X" /end COMPU_METHOD
/begin COMPU_METHOD LINEAR______0_000000__0H___65142 "" FORM "%5.0" "ohm" FORMULA "1.0*X" FORMULA_INV "1.0*X" /end COMPU_METHOD
/begin COMPU_METHOD LINEAR______0_000000__0H___1310_ "" FORM "%7.2" "s" FORMULA "0.019999999*X" FORMULA_INV "50.000002*X" /end COMPU_METHOD
/begin COMPU_METHOD LINEAR______0_000000__0H___5_184 "" FORM "%5.3" "V" FORMULA "0.0048875855*X" FORMULA_INV "204.6*X" /end COMPU_METHOD
/begin COMPU_METHOD LINEAR_______48_000000__FFFFFF80 "" FORM "%6.2" "°CRK" FORMULA "0.375*X" FORMULA_INV "2.6666667*X" /end COMPU_METHOD
/begin COMPU_METHOD RANGE________active___1H__1H____ "" TAB_VERB "%8.4" "-" COMPU_TAB_REF RANGE________active___1H__1H____ /end COMPU_METHOD
/begin COMPU_METHOD RANGE________active___1H__1H_744 "" TAB_VERB "%8.4" "-" COMPU_TAB_REF RANGE________active___1H__1H_744 /end COMPU_METHOD
/begin COMPU_METHOD RANGE________YES___1H__1H____NO_ "" TAB_VERB "%8.4" "-" COMPU_TAB_REF RANGE________YES___1H__1H____NO_ /end COMPU_METHOD
/begin COMPU_METHOD RANGE________YES___1H__1H____745 "" TAB_VERB "%8.4" "" COMPU_TAB_REF RANGE________YES___1H__1H____745 /end COMPU_METHOD
/begin COMPU_METHOD RANGE________0___0H__0H____1___1 "" TAB_VERB "%8.4" "-" COMPU_TAB_REF RANGE________0___0H__0H____1___1 /end COMPU_METHOD
/begin COMPU_METHOD LINEAR_______21845_000000__FFFF8 "" FORM "%6.0" "us" FORMULA "0.66665649*X-5.0863564e-006" FORMULA_INV "1.5000229*X+7.629651e-006" /end COMPU_METHOD
/begin COMPU_METHOD LINEAR______0_000000__0H___0_755 "" FORM "%7.5" "kg/s" FORMULA "1.5258789e-005*X" FORMULA_INV "65536.0*X" /end COMPU_METHOD
/begin COMPU_METHOD LINEAR______0_000000__0H___74756 "" FORM "%8.3" "kJ" FORMULA "1.7360845e-006*X" FORMULA_INV "576008.84*X" /end COMPU_METHOD
/begin COMPU_METHOD LINEAR______0_000000__0H___74757 "" FORM "%8.3" "kJ" FORMULA "1.7360845e-006*X" FORMULA_INV "576008.84*X" /end COMPU_METHOD
/begin COMPU_METHOD LINEAR______0_000000__0H___65758 "" FORM "%7.3" "-" FORMULA "0.01*X" FORMULA_INV "100.0*X" /end COMPU_METHOD
/begin COMPU_METHOD LINEAR_______8_000000__FFFF8000H "" FORM "%5.2" "-" FORMULA "0.0002441413*X+2.2070649e-005" FORMULA_INV "4095.9887*X-0.09040113" /end COMPU_METHOD
/begin COMPU_METHOD LINEAR______0_000000__0H___6400_ "" FORM "%7.2" "%" FORMULA "0.097751711*X" FORMULA_INV "10.23*X" /end COMPU_METHOD
/begin COMPU_METHOD LINEAR______0_000000__0H___65759 "" FORM "%5.0" "UL" FORMULA "1.0*X" FORMULA_INV "1.0*X" /end COMPU_METHOD
/begin COMPU_METHOD RANGE________DRI___1H__1H_______ "" TAB_VERB "%8.4" "-" COMPU_TAB_REF RANGE________DRI___1H__1H_______ /end COMPU_METHOD
/begin COMPU_METHOD RANGE________G_BEG___1H__1H_____ "" TAB_VERB "%8.4" "-" COMPU_TAB_REF RANGE________G_BEG___1H__1H_____ /end COMPU_METHOD
/begin COMPU_METHOD LINEAR______0_000000__0H___6_760 "" FORM "%2.0" "gear" FORMULA "1.0*X" FORMULA_INV "1.0*X" /end COMPU_METHOD
/begin COMPU_METHOD LINEAR______0_000000__0H___7_761 "" FORM "%2.0" "gear" FORMULA "1.0*X" FORMULA_INV "1.0*X" /end COMPU_METHOD
/begin COMPU_METHOD GEAR_INFO "" TAB_VERB "%8.4" "gear" COMPU_TAB_REF GEAR_INFO_TAB_NAME /end COMPU_METHOD
/begin COMPU_METHOD GEAR_CONV "" TAB_VERB "%8.4" "gear" COMPU_TAB_REF GEAR_CONV_TAB_NAME /end COMPU_METHOD
/begin COMPU_METHOD LINEAR_______23_625000__FFH___72 "" FORM "%5.1" "°CRK" FORMULA "-0.375*X+72.0" FORMULA_INV "-2.6666667*X+192.0" /end COMPU_METHOD
/begin COMPU_METHOD LINEAR_______48_000000__0H___762 "" FORM "%7.3" "°CRK" FORMULA "0.0014648438*X-48.0" FORMULA_INV "682.66667*X+32768.0" /end COMPU_METHOD
/begin COMPU_METHOD LINEAR______0_000000__0H___65763 "" FORM "%8.4" "hex" FORMULA "1.0*X" FORMULA_INV "1.0*X" /end COMPU_METHOD
/begin COMPU_METHOD RANGE_____00000010 "" TAB_VERB "%8.4" "-" COMPU_TAB_REF RANGE_____00000010_TAB_NAME /end COMPU_METHOD
/begin COMPU_METHOD LINEAR_______200_000000__FFFF764 "" FORM "%7.3" "%" FORMULA "0.0061035142*X-4.8242924e-005" FORMULA_INV "163.84004*X+0.0079041225" /end COMPU_METHOD
/begin COMPU_METHOD LINEAR______60_000000__0H___1765 "" FORM "%7.3" "°CRK" FORMULA "0.375*X+60.0" FORMULA_INV "2.6666667*X-160.0" /end COMPU_METHOD
/begin COMPU_METHOD LINEAR______60_000000__0H___1766 "" FORM "%8.3" "°CRK" FORMULA "0.375*X+60.0" FORMULA_INV "2.6666667*X-160.0" /end COMPU_METHOD
/begin COMPU_METHOD LINEAR______60_000000__0H___1767 "" FORM "%4.1" "°CRK" FORMULA "0.375*X+60.0" FORMULA_INV "2.6666667*X-160.0" /end COMPU_METHOD
/begin COMPU_METHOD LINEAR_______20480_00000__FFFF80 "" FORM "%8.1" "ms" FORMULA "0.625*X" FORMULA_INV "1.6*X" /end COMPU_METHOD
/begin COMPU_METHOD RVANOS_STATE_ACTIVE_RANGE "" TAB_VERB "%8.4" "-" COMPU_TAB_REF RVANOS_STATE_ACTIVE_RANGE_TN /end COMPU_METHOD
/begin COMPU_METHOD LINEAR_______20480_00000__FFF768 "" FORM "%8.1" "ms" FORMULA "0.625*X" FORMULA_INV "1.6*X" /end COMPU_METHOD
/begin COMPU_METHOD LINEAR_______95_625000__FFFFF769 "" FORM "%5.1" "°CRK/s" FORMULA "0.37745098*X" FORMULA_INV "2.6493506*X" /end COMPU_METHOD
/begin COMPU_METHOD LINEAR______95_625000__FFFFFF01H "" FORM "%5.1" "°CRK/s" FORMULA "-0.37745098*X" FORMULA_INV "-2.6493506*X" /end COMPU_METHOD
/begin COMPU_METHOD RANGE________ACIN___1H__1H______ "" TAB_VERB "%8.4" "-" COMPU_TAB_REF RANGE________ACIN___1H__1H______ /end COMPU_METHOD
/begin COMPU_METHOD RANGE________CH___1H__1H________ "" TAB_VERB "%8.4" "-" COMPU_TAB_REF RANGE________CH___1H__1H________ /end COMPU_METHOD
/begin COMPU_METHOD RANGE________CH2___1H__1H_______ "" TAB_VERB "%8.4" "-" COMPU_TAB_REF RANGE________CH2___1H__1H_______ /end COMPU_METHOD
/begin COMPU_METHOD RANGE________CH3___1H__1H_______ "" TAB_VERB "%8.4" "-" COMPU_TAB_REF RANGE________CH3___1H__1H_______ /end COMPU_METHOD
/begin COMPU_METHOD RANGE________ACCIN___1H__1H_____ "" TAB_VERB "%8.4" "-" COMPU_TAB_REF RANGE________ACCIN___1H__1H_____ /end COMPU_METHOD
/begin COMPU_METHOD RANGE________ACCIN_RELAIS___1H__ "" TAB_VERB "%8.4" "-" COMPU_TAB_REF RANGE________ACCIN_RELAIS___1H__ /end COMPU_METHOD
/begin COMPU_METHOD LINEAR______0_000000__0H___99770 "" FORM "%5.2" "-" FORMULA "0.0015258789*X" FORMULA_INV "655.36*X" /end COMPU_METHOD
/begin COMPU_METHOD RANGE________active___1H__1H_771 "" TAB_VERB "%8.4" "-" COMPU_TAB_REF RANGE________active___1H__1H_771 /end COMPU_METHOD
/begin COMPU_METHOD RANGE________COP___1H__1H_______ "" TAB_VERB "%8.4" "-" COMPU_TAB_REF RANGE________COP___1H__1H_______ /end COMPU_METHOD
/begin COMPU_METHOD RANGE________YES___1H__1H____772 "" TAB_VERB "%8.4" "-" COMPU_TAB_REF RANGE________YES___1H__1H____772 /end COMPU_METHOD
/begin COMPU_METHOD RANGE________LAM1___0H__0H____LA "" TAB_VERB "%8.4" "-" COMPU_TAB_REF RANGE________LAM1___0H__0H____LA /end COMPU_METHOD
/begin COMPU_METHOD LINEAR______0_000000__0H___65773 "" FORM "%8.4" "hex" FORMULA "1.0*X" FORMULA_INV "1.0*X" /end COMPU_METHOD
/begin COMPU_METHOD LINEAR______0_000000__0H___7_774 "" FORM "%7.4" "kJ/s" FORMULA "0.00012207031*X" FORMULA_INV "8191.9999*X" /end COMPU_METHOD
/begin COMPU_METHOD LINEAR______0_000000__0H___25775 "" FORM "%4.0" "-" FORMULA "1.0*X" FORMULA_INV "1.0*X" /end COMPU_METHOD
/begin COMPU_METHOD LINEAR______0_000000__0H___65776 "" FORM "%5.0" "-" FORMULA "1.0*X" FORMULA_INV "1.0*X" /end COMPU_METHOD
/begin COMPU_METHOD LINEAR______0_000000__0H___65777 "" FORM "%5.0" "*10ms" FORMULA "1.0*X" FORMULA_INV "1.0*X" /end COMPU_METHOD
/begin COMPU_METHOD LINEAR______0_000000__0H___25778 "" FORM "%4.0" "*20ms" FORMULA "1.0*X" FORMULA_INV "1.0*X" /end COMPU_METHOD
/begin COMPU_METHOD LINEAR_______50_000000__0H___779 "" FORM "%4.1" "%" FORMULA "0.0015258789*X-50.0" FORMULA_INV "655.36002*X+32768.001" /end COMPU_METHOD
/begin COMPU_METHOD LINEAR_______50_000000__0H___780 "" FORM "%5.1" "%" FORMULA "0.0015258789*X-50.0" FORMULA_INV "655.36002*X+32768.001" /end COMPU_METHOD
/begin COMPU_METHOD LINEAR______0_000000__0H___25781 "" FORM "%8.4" "hex" FORMULA "1.0*X" FORMULA_INV "1.0*X" /end COMPU_METHOD
/begin COMPU_METHOD LINEAR______0_000000__0H___18782 "" FORM "%5.0" "g" FORMULA "0.027777829*X" FORMULA_INV "35.999934*X" /end COMPU_METHOD
/begin COMPU_METHOD LINEAR______0_000000__0H___18783 "" FORM "%7.2" "g" FORMULA "0.027777829*X" FORMULA_INV "35.999934*X" /end COMPU_METHOD
/begin COMPU_METHOD LINEAR______1_000000__1H___81784 "" FORM "%4.0" "rpm" FORMULA "1.0*X" FORMULA_INV "1.0*X" /end COMPU_METHOD
/begin COMPU_METHOD LINEAR______0_000000__0H___5119_ "" FORM "%7.2" "g/180" FORMULA "0.078125*X" FORMULA_INV "12.8*X" /end COMPU_METHOD
/begin COMPU_METHOD LINEAR______0_000000__0H___20_00 "" FORM "%4.1" "-" FORMULA "0.0390625*X" FORMULA_INV "25.6*X" /end COMPU_METHOD
/begin COMPU_METHOD LINEAR______0_000000__0H___5_119 "" FORM "%7.5" "s" FORMULA "7.8114085e-005*X" FORMULA_INV "12801.789*X" /end COMPU_METHOD
/begin COMPU_METHOD LINEAR______0_000000__0H___0_785 "" FORM "%4.3" "-" FORMULA "0.00390625*X" FORMULA_INV "256.0*X" /end COMPU_METHOD
/begin COMPU_METHOD LINEAR______0_000000__0H___5_120 "" FORM "%2.1" "*20ms" FORMULA "0.020078431*X" FORMULA_INV "49.804688*X" /end COMPU_METHOD
/begin COMPU_METHOD LINEAR______0_000000__0H___76786 "" FORM "%6.0" "°TPS/s" FORMULA "11.717647*X" FORMULA_INV "0.085341365*X" /end COMPU_METHOD
/begin COMPU_METHOD LINEAR______0_000000__0H___76787 "" FORM "%6.1" "°TPS/s" FORMULA "11.717647*X" FORMULA_INV "0.085341365*X" /end COMPU_METHOD
/begin COMPU_METHOD LINEAR______0_000000__0H___25788 "" FORM "%8.4" "-" FORMULA "1.0*X" FORMULA_INV "1.0*X" /end COMPU_METHOD
/begin COMPU_METHOD LINEAR______0_000000__0H___25789 "" FORM "%3.0" "-" FORMULA "1.0*X" FORMULA_INV "1.0*X" /end COMPU_METHOD
/begin COMPU_METHOD LINEAR______0_000000__0H___25790 "" FORM "%4.0" "-" FORMULA "1.0*X" FORMULA_INV "1.0*X" /end COMPU_METHOD
/begin COMPU_METHOD LINEAR______0_000000__0H___25791 "" FORM "%6.3" "-" FORMULA "0.0039062486*X" FORMULA_INV "256.00009*X" /end COMPU_METHOD
/begin COMPU_METHOD LINEAR_______2_555800__0H___2_55 "" FORM "%8.5" "s" FORMULA "7.799649e-005*X-2.5558" FORMULA_INV "12821.09*X+32768.141" /end COMPU_METHOD
/begin COMPU_METHOD LINEAR_______640_020000__FFFF792 "" FORM "%7.2" "ms" FORMULA "0.019531548*X-0.010234226" FORMULA_INV "51.199219*X+0.52398437" /end COMPU_METHOD
/begin COMPU_METHOD LINEAR_______2_555800__FFFF8000H "" FORM "%8.5" "s" FORMULA "7.7993774e-005*X-0.00010000311" FORMULA_INV "12821.536*X+1.2821935" /end COMPU_METHOD
/begin COMPU_METHOD LINEAR______0_000000__0H___13793 "" FORM "%6.1" "s" FORMULA "0.019999999*X" FORMULA_INV "50.000002*X" /end COMPU_METHOD
/begin COMPU_METHOD LINEAR______0_000000__0H___13794 "" FORM "%8.3" "s" FORMULA "0.019999999*X" FORMULA_INV "50.000002*X" /end COMPU_METHOD
/begin COMPU_METHOD LINEAR______0_000000__0H___13795 "" FORM "%7.3" "s" FORMULA "0.019999999*X" FORMULA_INV "50.000002*X" /end COMPU_METHOD
/begin COMPU_METHOD LINEAR______0_000000__0H___65796 "" FORM "%6.2" "s" FORMULA "0.01*X" FORMULA_INV "100.0*X" /end COMPU_METHOD
/begin COMPU_METHOD LINEAR______0_000000__0H___10797 "" FORM "%5.0" "°C" FORMULA "1.0*X" FORMULA_INV "1.0*X" /end COMPU_METHOD
/begin COMPU_METHOD TI_SGN_16_RES "" FORM "%6.2" "ms" FORMULA "0.004*X-131.072" FORMULA_INV "250.0*X+32768.0" /end COMPU_METHOD
/begin COMPU_METHOD LINEAR_______174_762666__FFFF798 "" FORM "%6.2" "ms" FORMULA "0.0053333333*X-2.8421709e-014" FORMULA_INV "187.5*X+5.3290705e-012" /end COMPU_METHOD
/begin COMPU_METHOD LINEAR_______50_000000__FFFF8799 "" FORM "%5.1" "%" FORMULA "0.0015258793*X+1.2939651e-005" FORMULA_INV "655.35983*X-0.0084801272" /end COMPU_METHOD
/begin COMPU_METHOD LINEAR______0_000000__0H___16800 "" FORM "%7.4" "-" FORMULA "0.00024414435*X" FORMULA_INV "4095.9375*X" /end COMPU_METHOD
/begin COMPU_METHOD LINEAR_______100_00000__0H___100 "" FORM "%4.1" "%" FORMULA "0.024414063*X-100.0" FORMULA_INV "40.96*X+4096.0" /end COMPU_METHOD
/begin COMPU_METHOD LINEAR______0_000000__0H___34801 "" FORM "%4.1" "ms" FORMULA "0.0053330282*X" FORMULA_INV "187.51073*X" /end COMPU_METHOD
/begin COMPU_METHOD LINEAR_______512_000000__FFFF802 "" FORM "%7.2" "°C" FORMULA "0.015625*X" FORMULA_INV "64.0*X" /end COMPU_METHOD
/begin COMPU_METHOD LINEAR______0_000000__0H___65803 "" FORM "%5.2" "s" FORMULA "0.01*X" FORMULA_INV "100.0*X" /end COMPU_METHOD
/begin COMPU_METHOD LINEAR______0_000000__0H___1_804 "" FORM "%4.2" "V" FORMULA "0.005*X" FORMULA_INV "200.0*X" /end COMPU_METHOD
/begin COMPU_METHOD LINEAR______0_000000__0H___51805 "" FORM "%4.0" "ms" FORMULA "20.0*X" FORMULA_INV "0.05*X" /end COMPU_METHOD
/begin COMPU_METHOD LINEAR______0_000000__0H___509_0 "" FORM "%7.3" "-" FORMULA "0.0077669261*X" FORMULA_INV "128.75106*X" /end COMPU_METHOD
/begin COMPU_METHOD UNSIGNED_LONG "" FORM "%11.0" "-" FORMULA "1.0*X" FORMULA_INV "1.0*X" /end COMPU_METHOD
/begin COMPU_METHOD LINEAR______0_000000__0H___42806 "" FORM "%11.0" "-" FORMULA "65537.0*X" FORMULA_INV "1.5258556e-005*X" /end COMPU_METHOD
/begin COMPU_METHOD LINEAR______0_000000__0H___25807 "" FORM "%7.3" "-" FORMULA "0.0039062501*X" FORMULA_INV "255.99999*X" /end COMPU_METHOD
/begin COMPU_METHOD LINEAR______0_000000__0H___25808 "" FORM "%6.2" "-" FORMULA "0.0039062501*X" FORMULA_INV "255.99999*X" /end COMPU_METHOD
/begin COMPU_METHOD LINEAR_______0_637500__0H___0809 "" FORM "%5.3" "V" FORMULA "0.005*X-0.6375" FORMULA_INV "200.0*X+127.5" /end COMPU_METHOD
/begin COMPU_METHOD LINEAR______0_000000__0H___1_810 "" FORM "%5.3" "V" FORMULA "0.005*X" FORMULA_INV "200.0*X" /end COMPU_METHOD
/begin COMPU_METHOD LINEAR______0_000000__0H___65811 "" FORM "%6.0" "*20ms" FORMULA "1.0*X" FORMULA_INV "1.0*X" /end COMPU_METHOD
/begin COMPU_METHOD LINEAR______0_000000__0H___65812 "" FORM "%5.0" "*10ms" FORMULA "1.0*X" FORMULA_INV "1.0*X" /end COMPU_METHOD
/begin COMPU_METHOD LINEAR_______50_000000__0H___813 "" FORM "%5.1" "%" FORMULA "0.3906251*X-50.0" FORMULA_INV "2.5599994*X+127.99997" /end COMPU_METHOD
/begin COMPU_METHOD LINEAR_______50_000000__0H___814 "" FORM "%4.1" "%" FORMULA "0.3906251*X-50.0" FORMULA_INV "2.5599994*X+127.99997" /end COMPU_METHOD
/begin COMPU_METHOD LINEAR______0_000000__0H___25815 "" FORM "%8.4" "hex" FORMULA "1.0*X" FORMULA_INV "1.0*X" /end COMPU_METHOD
/begin COMPU_METHOD LINEAR______0_000000__0H___81816 "" FORM "%4.0" "rpm" FORMULA "1.0*X" FORMULA_INV "1.0*X" /end COMPU_METHOD
/begin COMPU_METHOD RANGE________active___1H__1H_817 "" TAB_VERB "%8.4" "" COMPU_TAB_REF RANGE________active___1H__1H_817 /end COMPU_METHOD
/begin COMPU_METHOD RANGE________YES___1H__1H____818 "" TAB_VERB "%8.4" "" COMPU_TAB_REF RANGE________YES___1H__1H____818 /end COMPU_METHOD
/begin COMPU_METHOD RANGE________ON___1H__1H____OFF_ "" TAB_VERB "%8.4" "" COMPU_TAB_REF RANGE________ON___1H__1H____OFF_ /end COMPU_METHOD
/begin COMPU_METHOD RANGE________0___0H__0H____1_819 "" TAB_VERB "%8.4" "" COMPU_TAB_REF RANGE________0___0H__0H____1_819 /end COMPU_METHOD
/begin COMPU_METHOD RANGE________rich___1H__1H____le "" TAB_VERB "%8.4" "" COMPU_TAB_REF RANGE________rich___1H__1H____le /end COMPU_METHOD
/begin COMPU_METHOD RANGE________active___1H__1H_820 "" TAB_VERB "%8.4" "" COMPU_TAB_REF RANGE________active___1H__1H_820 /end COMPU_METHOD
/begin COMPU_METHOD RANGE________active___1H__1H_821 "" TAB_VERB "%8.4" "" COMPU_TAB_REF RANGE________active___1H__1H_821 /end COMPU_METHOD
/begin COMPU_METHOD RANGE________active___1H__1H_822 "" TAB_VERB "%8.4" "-" COMPU_TAB_REF RANGE________active___1H__1H_822 /end COMPU_METHOD
/begin COMPU_METHOD LINEAR______0_000000__0H___25823 "" FORM "%3.0" "cyc" FORMULA "1.0*X" FORMULA_INV "1.0*X" /end COMPU_METHOD
/begin COMPU_METHOD LINEAR______1_000000__1H___6_000 "" FORM "%2.0" "-" FORMULA "1.0*X" FORMULA_INV "1.0*X" /end COMPU_METHOD
/begin COMPU_METHOD RANGE________0___0H__0H____1_824 "" TAB_VERB "%8.4" "-" COMPU_TAB_REF RANGE________0___0H__0H____1_824 /end COMPU_METHOD
/begin COMPU_METHOD RANGE________OFF___0H__0H____ON_ "" TAB_VERB "%8.4" "" COMPU_TAB_REF RANGE________OFF___0H__0H____ON_ /end COMPU_METHOD
/begin COMPU_METHOD RANGE________ON___1H__1H____O825 "" TAB_VERB "%8.4" "-" COMPU_TAB_REF RANGE________ON___1H__1H____O825 /end COMPU_METHOD
/begin COMPU_METHOD RANGE________LV_CYCNR_IS___1H__1 "" TAB_VERB "%8.4" "-" COMPU_TAB_REF RANGE________LV_CYCNR_IS___1H__1 /end COMPU_METHOD
/begin COMPU_METHOD RANGE________1___1H__1H_______0H "" TAB_VERB "%8.4" "-" COMPU_TAB_REF RANGE________1___1H__1H_______0H /end COMPU_METHOD
/begin COMPU_METHOD RANGE____________0H__0H____ERR_M "" TAB_VERB "%8.4" "-" COMPU_TAB_REF RANGE____________0H__0H____ERR_M /end COMPU_METHOD
/begin COMPU_METHOD RANGE____________0H__0H____IGK__ "" TAB_VERB "%8.4" "" COMPU_TAB_REF RANGE____________0H__0H____IGK__ /end COMPU_METHOD
/begin COMPU_METHOD RANGE________OPEN___0H__0H____CL "" TAB_VERB "%8.4" "" COMPU_TAB_REF RANGE________OPEN___0H__0H____CL /end COMPU_METHOD
/begin COMPU_METHOD RANGE________ISAPWM___1H__1H____ "" TAB_VERB "%8.4" "-" COMPU_TAB_REF RANGE________ISAPWM___1H__1H____ /end COMPU_METHOD
/begin COMPU_METHOD RANGE________NO___0H__0H____YES_ "" TAB_VERB "%8.4" "-" COMPU_TAB_REF RANGE________NO___0H__0H____YES_ /end COMPU_METHOD
/begin COMPU_METHOD RANGE_NOTLAUF "" TAB_VERB "%8.4" "-" COMPU_TAB_REF RANGE_NOTLAUF_TAB_NAME /end COMPU_METHOD
/begin COMPU_METHOD RANGE________LV_MSR___1H__1H____ "" TAB_VERB "%8.4" "" COMPU_TAB_REF RANGE________LV_MSR___1H__1H____ /end COMPU_METHOD
/begin COMPU_METHOD RANGE____________0H__0H____MTC_C "" TAB_VERB "%8.4" "" COMPU_TAB_REF RANGE____________0H__0H____MTC_C /end COMPU_METHOD
/begin COMPU_METHOD RANGE____________0H__0H____MTC_D "" TAB_VERB "%8.4" "" COMPU_TAB_REF RANGE____________0H__0H____MTC_D /end COMPU_METHOD
/begin COMPU_METHOD RANGE____________0H__0H____MTC_L "" TAB_VERB "%8.4" "" COMPU_TAB_REF RANGE____________0H__0H____MTC_L /end COMPU_METHOD
/begin COMPU_METHOD RANGE____________0H__0H____MTCPW "" TAB_VERB "%8.4" "" COMPU_TAB_REF RANGE____________0H__0H____MTCPW /end COMPU_METHOD
/begin COMPU_METHOD RANGE________N___1H__1H________0 "" TAB_VERB "%8.4" "-" COMPU_TAB_REF RANGE________N___1H__1H________0 /end COMPU_METHOD
/begin COMPU_METHOD RANGE________NO_ERROR___0H__0H__ "" TAB_VERB "%8.4" "" COMPU_TAB_REF RANGE________NO_ERROR___0H__0H__ /end COMPU_METHOD
/begin COMPU_METHOD RANGE____________0H__0H____TPS_A "" TAB_VERB "%8.4" "" COMPU_TAB_REF RANGE____________0H__0H____TPS_A /end COMPU_METHOD
/begin COMPU_METHOD RANGE____________0H__0H____TP826 "" TAB_VERB "%8.4" "" COMPU_TAB_REF RANGE____________0H__0H____TP826 /end COMPU_METHOD
/begin COMPU_VTAB RANGE________active___1H__1H____ "" TAB_VERB 2 0x0 "passive" 0x1 "active" /end COMPU_VTAB
/begin COMPU_VTAB RANGE________active___1H__1H_744 "" TAB_VERB 2 0x0 "passive" 0x1 "active" /end COMPU_VTAB
/begin COMPU_VTAB RANGE________YES___1H__1H____NO_ "" TAB_VERB 2 0x0 "NO" 0x1 "YES" /end COMPU_VTAB
/begin COMPU_VTAB RANGE________YES___1H__1H____745 "" TAB_VERB 2 0x0 "NO" 0x1 "YES" /end COMPU_VTAB
/begin COMPU_VTAB RANGE________0___0H__0H____1___1 "" TAB_VERB 2 0x0 "0" 0x1 "1" /end COMPU_VTAB
/begin COMPU_VTAB RANGE________DRI___1H__1H_______ "" TAB_VERB 2 0x0 "" 0x1 "DRI" /end COMPU_VTAB
/begin COMPU_VTAB RANGE________G_BEG___1H__1H_____ "" TAB_VERB 2 0x0 "" 0x1 "G_BEG" /end COMPU_VTAB
/begin COMPU_VTAB GEAR_INFO_TAB_NAME "" TAB_VERB 8 0x0 "NEUTRAL" 0x1 "1" 0x2 "2" 0x3 "3" 0x4 "4" 0x5 "5" 0x6 "6" 0x7 "REVERSE" /end COMPU_VTAB
/begin COMPU_VTAB GEAR_CONV_TAB_NAME "" TAB_VERB 7 0x0 "NEUTRAL" 0x1 "1" 0x2 "2" 0x3 "3" 0x4 "4" 0x5 "5" 0x6 "6" /end COMPU_VTAB
/begin COMPU_VTAB RANGE_____00000010_TAB_NAME "" TAB_VERB 4 0x0 "" 0x1 "INF" 0x2 "REAC" 0x3 "" /end COMPU_VTAB
/begin COMPU_VTAB RVANOS_STATE_ACTIVE_RANGE_TN "" TAB_VERB 5 0x0 "INIT" 0x1 "HOLD_DLY" 0x2 "HOLD_AD" 0x3 "ADJ" 0x4 "END_POS" /end COMPU_VTAB
/begin COMPU_VTAB RANGE________ACIN___1H__1H______ "" TAB_VERB 2 0x0 "" 0x1 "ACIN" /end COMPU_VTAB
/begin COMPU_VTAB RANGE________CH___1H__1H________ "" TAB_VERB 2 0x0 "" 0x1 "CH" /end COMPU_VTAB
/begin COMPU_VTAB RANGE________CH2___1H__1H_______ "" TAB_VERB 2 0x0 "" 0x1 "CH2" /end COMPU_VTAB
/begin COMPU_VTAB RANGE________CH3___1H__1H_______ "" TAB_VERB 2 0x0 "" 0x1 "CH3" /end COMPU_VTAB
/begin COMPU_VTAB RANGE________ACCIN___1H__1H_____ "" TAB_VERB 2 0x0 "" 0x1 "ACCIN" /end COMPU_VTAB
/begin COMPU_VTAB RANGE________ACCIN_RELAIS___1H__ "" TAB_VERB 2 0x0 "" 0x1 "ACCIN_RELAIS" /end COMPU_VTAB
/begin COMPU_VTAB RANGE________active___1H__1H_771 "" TAB_VERB 2 0x0 " passive" 0x1 "active" /end COMPU_VTAB
/begin COMPU_VTAB RANGE________COP___1H__1H_______ "" TAB_VERB 2 0x0 "" 0x1 "COP" /end COMPU_VTAB
/begin COMPU_VTAB RANGE________YES___1H__1H____772 "" TAB_VERB 2 0x0 "NO" 0x1 "YES" /end COMPU_VTAB
/begin COMPU_VTAB RANGE________LAM1___0H__0H____LA "" TAB_VERB 2 0x0 "LAM1" 0x1 "LAM2" /end COMPU_VTAB
/begin COMPU_VTAB RANGE________active___1H__1H_817 "" TAB_VERB 2 0x0 "passive" 0x1 "active" /end COMPU_VTAB
/begin COMPU_VTAB RANGE________YES___1H__1H____818 "" TAB_VERB 2 0x0 "NO" 0x1 "YES" /end COMPU_VTAB
/begin COMPU_VTAB RANGE________ON___1H__1H____OFF_ "" TAB_VERB 2 0x0 "OFF" 0x1 "ON" /end COMPU_VTAB
/begin COMPU_VTAB RANGE________0___0H__0H____1_819 "" TAB_VERB 2 0x0 "0" 0x1 "1" /end COMPU_VTAB
/begin COMPU_VTAB RANGE________rich___1H__1H____le "" TAB_VERB 2 0x0 "rich" 0x1 "lean" /end COMPU_VTAB
/begin COMPU_VTAB RANGE________active___1H__1H_820 "" TAB_VERB 2 0x0 "passive" 0x1 "active" /end COMPU_VTAB
/begin COMPU_VTAB RANGE________active___1H__1H_821 "" TAB_VERB 2 0x0 " passive" 0x1 "active" /end COMPU_VTAB
/begin COMPU_VTAB RANGE________active___1H__1H_822 "" TAB_VERB 2 0x0 " passive" 0x1 "active" /end COMPU_VTAB
/begin COMPU_VTAB RANGE________0___0H__0H____1_824 "" TAB_VERB 2 0x0 "0" 0x1 "1" /end COMPU_VTAB
/begin COMPU_VTAB RANGE________OFF___0H__0H____ON_ "" TAB_VERB 2 0x0 "OFF" 0x1 "ON" /end COMPU_VTAB
/begin COMPU_VTAB RANGE________ON___1H__1H____O825 "" TAB_VERB 2 0x0 "OFF" 0x1 "ON" /end COMPU_VTAB
/begin COMPU_VTAB RANGE________LV_CYCNR_IS___1H__1 "" TAB_VERB 2 0x0 "" 0x1 "LV_CYCNR_IS" /end COMPU_VTAB
/begin COMPU_VTAB RANGE________1___1H__1H_______0H "" TAB_VERB 2 0x0 "" 0x1 "1" /end COMPU_VTAB
/begin COMPU_VTAB RANGE____________0H__0H____ERR_M "" TAB_VERB 2 0x0 "" 0x1 "ERR_MU" /end COMPU_VTAB
/begin COMPU_VTAB RANGE____________0H__0H____IGK__ "" TAB_VERB 2 0x0 "" 0x1 "IGK" /end COMPU_VTAB
/begin COMPU_VTAB RANGE________OPEN___0H__0H____CL "" TAB_VERB 2 0x0 "OPEN" 0x1 "CLOSED" /end COMPU_VTAB
/begin COMPU_VTAB RANGE________ISAPWM___1H__1H____ "" TAB_VERB 2 0x0 "" 0x1 "ISAPWM" /end COMPU_VTAB
/begin COMPU_VTAB RANGE________NO___0H__0H____YES_ "" TAB_VERB 2 0x0 "NO" 0x1 "YES" /end COMPU_VTAB
/begin COMPU_VTAB RANGE_NOTLAUF_TAB_NAME "" TAB_VERB 2 0x0 "" 0x1 "Notlauf" /end COMPU_VTAB
/begin COMPU_VTAB RANGE________LV_MSR___1H__1H____ "" TAB_VERB 2 0x0 "" 0x1 "LV_MSR" /end COMPU_VTAB
/begin COMPU_VTAB RANGE____________0H__0H____MTC_C "" TAB_VERB 2 0x0 "" 0x1 "MTC_CUR_OFF" /end COMPU_VTAB
/begin COMPU_VTAB RANGE____________0H__0H____MTC_D "" TAB_VERB 2 0x0 "" 0x1 "MTC_DIAG_CUR_OFF" /end COMPU_VTAB
/begin COMPU_VTAB RANGE____________0H__0H____MTC_L "" TAB_VERB 2 0x0 "" 0x1 "MTC_LIH_CUR_OFF" /end COMPU_VTAB
/begin COMPU_VTAB RANGE____________0H__0H____MTCPW "" TAB_VERB 2 0x0 "" 0x1 "MTCPWM_DIAG_CUR_OFF" /end COMPU_VTAB
/begin COMPU_VTAB RANGE________N___1H__1H________0 "" TAB_VERB 2 0x0 "" 0x1 "N" /end COMPU_VTAB
/begin COMPU_VTAB RANGE________NO_ERROR___0H__0H__ "" TAB_VERB 10 0x0 "NO ERROR" 0x1 "ERROR" 0x2 "ERROR" 0x3 "ERROR" 0x4 "ERROR" 0x5 "ERROR" 0x6 "ERROR" 0x7 "ERROR" 0x8 "ERROR" 0x9 "ERROR" /end COMPU_VTAB
/begin COMPU_VTAB RANGE____________0H__0H____TPS_A "" TAB_VERB 2 0x0 "" 0x1 "TPS_AD_CUR_OFF" /end COMPU_VTAB
/begin COMPU_VTAB RANGE____________0H__0H____TP826 "" TAB_VERB 2 0x0 "" 0x1 "TPS_AD_DIAG_CUR_OFF" /end COMPU_VTAB
/end MODULE
/end PROJECT
