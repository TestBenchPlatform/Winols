ASAP2_VERSION 1 2
/begin PROJECT Z432 "430"
/begin HEADER "" VERSION "056.03" PROJECT_NO Z430 /end HEADER
/begin MODULE BMW-EASY ""
/begin MOD_COMMON "common attributes" DEPOSIT ABSOLUT BYTE_ORDER BIG_ENDIAN /end MOD_COMMON
/begin CHARACTERISTIC c_cur_dmtl_ref_leak_max "C_CUR_DMTL_REF_LEAK_MAX" VALUE 0x7010e a_85 100 LINEAR______0_000000__0H___400_0 0.0 400.0 BIT_MASK 0xffffffff FUNCTION_LIST DMTL /end CHARACTERISTIC
/begin CHARACTERISTIC c_cur_dmtl_ref_leak_min "C_CUR_DMTL_REF_LEAK_MIN" VALUE 0x70110 a_85 100 LINEAR______0_000000__0H___400_0 0.0 400.0 BIT_MASK 0xffffffff FUNCTION_LIST DMTL /end CHARACTERISTIC
/begin CHARACTERISTIC c_cur_dmtl_ref_ofs "C_CUR_DMTL_REF_OFS" VALUE 0x70112 a_85 100 LINEAR______0_000000__0H___400_0 0.0 400.0 BIT_MASK 0xffffffff FUNCTION_LIST DMTL /end CHARACTERISTIC
/begin CHARACTERISTIC c_cur_igc_cycnr "C_CUR_IGC_CYCNR" VALUE 0x70adc a_86 2 LINEAR______1_000000__1H___25596 1.0 255.0 BIT_MASK 0xffffffff /end CHARACTERISTIC
/begin CHARACTERISTIC c_cur_igc_dec "C_CUR_IGC_DEC" VALUE 0x70114 a_85 5 LINEAR______0_000000__0H___1_097 0.0 1.0 BIT_MASK 0xffffffff /end CHARACTERISTIC
/begin CHARACTERISTIC c_cur_igc_fac_max "C_CUR_IGC_FAC_MAX" VALUE 0x70116 a_85 10 LINEAR______1_000000__8000H___98 1.0 1.5 BIT_MASK 0xffffffff /end CHARACTERISTIC
/begin CHARACTERISTIC c_cur_igc_fac_min "C_CUR_IGC_FAC_MIN" VALUE 0x70118 a_85 10 LINEAR______0_500000__4000H___1_ 0.5 1.0 BIT_MASK 0xffffffff /end CHARACTERISTIC
/begin CHARACTERISTIC c_cur_igc_inc "C_CUR_IGC_INC" VALUE 0x7011a a_85 5 LINEAR______0_000000__0H___1_097 0.0 1.0 BIT_MASK 0xffffffff /end CHARACTERISTIC
/begin CHARACTERISTIC c_cur_igc_max_diag "C_CUR_IGC_MAX_DIAG" VALUE 0x70add a_86 10 LINEAR______0_000000__0H___143_8 0.0 143.8 BIT_MASK 0xffffffff /end CHARACTERISTIC
/begin CHARACTERISTIC c_cycnr_ad_adc_knk "C_CYCNR_AD_ADC_KNK" VALUE 0x7011c a_85 1 LINEAR______0_000000__0H___65599 0.0 65535.0 BIT_MASK 0xffffffff /end CHARACTERISTIC
/begin CHARACTERISTIC c_cycnr_ad_rtd_knk "C_CYCNR_AD_RTD_KNK" VALUE 0x7011e a_85 1 LINEAR______0_000000__0H___65599 0.0 65535.0 BIT_MASK 0xffffffff /end CHARACTERISTIC
/begin CHARACTERISTIC c_cycnr_fac_ron "C_CYCNR_FAC_RON" VALUE 0x70ade a_86 5 LINEAR______1_000000__1H___255_0 1.0 255.0 BIT_MASK 0xffffffff /end CHARACTERISTIC
/begin CHARACTERISTIC c_cycnr_fac_ron_low_min "C_CYCNR_FAC_RON_LOW_MIN" VALUE 0x70120 a_85 100 LINEAR______0_000000__0H___65535 0.0 65535.0 BIT_MASK 0xffffffff /end CHARACTERISTIC
/begin CHARACTERISTIC c_cycnr_hys_puc "C_CYCNR_HYS_PUC" VALUE 0x70122 a_85 100 LINEAR______0_000000__0H___65573 0.0 65535.0 BIT_MASK 0xffffffff /end CHARACTERISTIC
/begin CHARACTERISTIC c_cycnr_hys_puc_st "C_CYCNR_HYS_PUC_ST" VALUE 0x70124 a_85 100 LINEAR______0_000000__0H___65573 0.0 65535.0 BIT_MASK 0xffffffff /end CHARACTERISTIC
/begin CHARACTERISTIC c_cycnr_iga_es "C_CYCNR_IGA_ES" VALUE 0x70adf a_86 100 LINEAR______0_000000__0H___15100 0.0 15.0 BIT_MASK 0xffffffff /end CHARACTERISTIC
/begin CHARACTERISTIC c_cycnr_isa_off "C_CYCNR_ISA_OFF" VALUE 0x70ae0 a_86 100 LINEAR______0_000000__0H___255_0 0.0 255.0 BIT_MASK 0xffffffff /end CHARACTERISTIC
/begin CHARACTERISTIC c_cycnr_st_tipr_fac_st_es "C_CYCNR_ST_TIPR_FAC_ST_ES" VALUE 0x70126 a_85 100 LINEAR______0_000000__0H___65573 0.0 65535.0 BIT_MASK 0xffffffff /end CHARACTERISTIC
/begin CHARACTERISTIC c_cycnr_supp_dyn_dly_er "C_CYCNR_SUPP_DYN_DLY_ER" VALUE 0x70ae1 a_86 100 LINEAR______0_000000__0H___255_4 0.0 255.0 BIT_MASK 0xffffffff /end CHARACTERISTIC
/begin CHARACTERISTIC c_cycnr_supp_st "C_CYCNR_SUPP_ST" VALUE 0x70ae2 a_86 100 LINEAR______0_000000__0H___255_4 0.0 255.0 BIT_MASK 0xffffffff /end CHARACTERISTIC
/begin CHARACTERISTIC c_deac_fct "C_DEAC_FCT" VALUE 0x70ae3 a_86 100 LINEAR______0_000000__0H___255_0 0.0 255.0 BIT_MASK 0xffffffff /end CHARACTERISTIC
/begin CHARACTERISTIC c_delta_tia "C_DELTA_TIA" VALUE 0x70ae4 a_86 15 LINEAR_______48_000000__0H___142 -48.0 142.5 BIT_MASK 0xffffffff FUNCTION_LIST ETM /end CHARACTERISTIC
/begin CHARACTERISTIC c_dew_wall "C_DEW_WALL" VALUE 0x70128 a_85 100 LINEAR_______33_000000__0H___989 -33.0 989.9844 BIT_MASK 0xffffffff FUNCTION_LIST ETM /end CHARACTERISTIC
/begin CHARACTERISTIC c_dif_max_t_seg_ad_er "C_DYN_MAX_T_SEG_AD_ER" VALUE 0x7012a a_85 100 LINEAR______0_000000__0H___7_101 0.0 7.8125 BIT_MASK 0xffffffff /end CHARACTERISTIC
/begin CHARACTERISTIC c_dist_refu_rough_leak_susp_min "C_DIST_REFU_ROUGH_LEAK_SUSP_MIN" VALUE 0x7012c a_85 100 LINEAR______0_000000__0H___65529 0.0 65535.0 BIT_MASK 0xffffffff FUNCTION_LIST DMTL /end CHARACTERISTIC
/begin CHARACTERISTIC c_dly_er_rr "C_DLY_ER_RR" VALUE 0x7012e a_85 100 LINEAR______0_000000__0H___10000 0.0 10000.0 BIT_MASK 0xffffffff /end CHARACTERISTIC
/begin CHARACTERISTIC c_drv1_vls_down_abs_max "C_DRV1_VLS_DOWN_ABS_MAX" VALUE 0x70db8 a_95 100 LINEAR_______1_275000__FFFF8080H -1.275 1.275 BIT_MASK 0xffffffff FUNCTION_LIST R_LS_CALC /end CHARACTERISTIC
/begin CHARACTERISTIC c_drv1_vls_down_max "C_DRV1_VLS_DOWN_MAX" VALUE 0x70dba a_95 100 LINEAR_______1_275000__FFFF80102 -1.275 1.275 BIT_MASK 0xffffffff FUNCTION_LIST R_LS_CALC /end CHARACTERISTIC
/begin CHARACTERISTIC c_drv1_vls_up_abs_max "C_DRV1_VLS_UP_ABS_MAX" VALUE 0x70dbc a_95 100 LINEAR_______1_275000__FFFF8080H -1.275 1.275 BIT_MASK 0xffffffff FUNCTION_LIST R_LS_CALC /end CHARACTERISTIC
/begin CHARACTERISTIC c_drv1_vls_up_max "C_DRV1_VLS_UP_MAX" VALUE 0x70dbe a_95 100 LINEAR_______1_275000__FFFF80102 -1.275 1.275 BIT_MASK 0xffffffff FUNCTION_LIST R_LS_CALC /end CHARACTERISTIC
/begin CHARACTERISTIC c_dtc_ad_mec_ref_ivvt_ex_0 "C_DTC_AD_MEC_REF_IVVT_EX_0" VALUE 0x70130 a_85 100 LINEAR______0_000000__0H___65535 0.0 65535.0 BIT_MASK 0xffffffff /end CHARACTERISTIC
/begin CHARACTERISTIC c_dtc_ad_mec_ref_ivvt_ex_1 "C_DTC_AD_MEC_REF_IVVT_EX_1" VALUE 0x70132 a_85 100 LINEAR______0_000000__0H___65535 0.0 65535.0 BIT_MASK 0xffffffff /end CHARACTERISTIC
/begin CHARACTERISTIC c_dtc_ad_mec_ref_ivvt_ex_2 "C_DTC_AD_MEC_REF_IVVT_EX_2" VALUE 0x70134 a_85 100 LINEAR______0_000000__0H___65535 0.0 65535.0 BIT_MASK 0xffffffff /end CHARACTERISTIC
/begin CHARACTERISTIC c_dtc_ad_mec_ref_ivvt_ex_3 "C_DTC_AD_MEC_REF_IVVT_EX_3" VALUE 0x70136 a_85 100 LINEAR______0_000000__0H___65535 0.0 65535.0 BIT_MASK 0xffffffff /end CHARACTERISTIC
/begin CHARACTERISTIC c_dtc_ad_mec_ref_ivvt_in_0 "C_DTC_AD_MEC_REF_IVVT_IN_0" VALUE 0x70138 a_85 100 LINEAR______0_000000__0H___65535 0.0 65535.0 BIT_MASK 0xffffffff /end CHARACTERISTIC
/begin CHARACTERISTIC c_dtc_ad_mec_ref_ivvt_in_1 "C_DTC_AD_MEC_REF_IVVT_IN_1" VALUE 0x7013a a_85 100 LINEAR______0_000000__0H___65535 0.0 65535.0 BIT_MASK 0xffffffff /end CHARACTERISTIC
/begin CHARACTERISTIC c_dtc_ad_mec_ref_ivvt_in_2 "C_DTC_AD_MEC_REF_IVVT_IN_2" VALUE 0x7013c a_85 100 LINEAR______0_000000__0H___65535 0.0 65535.0 BIT_MASK 0xffffffff /end CHARACTERISTIC
/begin CHARACTERISTIC c_dtc_ad_mec_ref_ivvt_in_3 "C_DTC_AD_MEC_REF_IVVT_IN_3" VALUE 0x7013e a_85 100 LINEAR______0_000000__0H___65535 0.0 65535.0 BIT_MASK 0xffffffff /end CHARACTERISTIC
/begin CHARACTERISTIC c_dtc_amp_0 "C_DTC_AMP_0" VALUE 0x70140 a_85 100 LINEAR______0_000000__0H___65535 0.0 65535.0 BIT_MASK 0xffffffff /end CHARACTERISTIC
/begin CHARACTERISTIC c_dtc_amp_1 "C_DTC_AMP_1" VALUE 0x70142 a_85 100 LINEAR______0_000000__0H___65535 0.0 65535.0 BIT_MASK 0xffffffff /end CHARACTERISTIC
/begin CHARACTERISTIC c_dtc_amp_2 "C_DTC_AMP_2" VALUE 0x70144 a_85 100 LINEAR______0_000000__0H___65535 0.0 65535.0 BIT_MASK 0xffffffff /end CHARACTERISTIC
/begin CHARACTERISTIC c_dtc_amp_3 "C_DTC_AMP_3" VALUE 0x70146 a_85 100 LINEAR______0_000000__0H___65535 0.0 65535.0 BIT_MASK 0xffffffff /end CHARACTERISTIC
/begin CHARACTERISTIC c_dtc_bls_plaus_0 "C_DTC_BLS_PLAUS_0" VALUE 0x70148 a_85 100 LINEAR______0_000000__0H___65535 0.0 65535.0 BIT_MASK 0xffffffff /end CHARACTERISTIC
/begin CHARACTERISTIC c_dtc_bls_plaus_1 "C_DTC_BLS_PLAUS_1" VALUE 0x7014a a_85 100 LINEAR______0_000000__0H___65535 0.0 65535.0 BIT_MASK 0xffffffff /end CHARACTERISTIC
/begin CHARACTERISTIC c_dtc_bls_plaus_2 "C_DTC_BLS_PLAUS_2" VALUE 0x7014c a_85 100 LINEAR______0_000000__0H___65535 0.0 65535.0 BIT_MASK 0xffffffff /end CHARACTERISTIC
/begin CHARACTERISTIC c_dtc_bls_plaus_3 "C_DTC_BLS_PLAUS_3" VALUE 0x7014e a_85 100 LINEAR______0_000000__0H___65535 0.0 65535.0 BIT_MASK 0xffffffff /end CHARACTERISTIC
/begin CHARACTERISTIC c_dtc_cam_0 "C_DTC_CAM_0" VALUE 0x70150 a_85 100 LINEAR______0_000000__0H___65535 0.0 65535.0 BIT_MASK 0xffffffff /end CHARACTERISTIC
/begin CHARACTERISTIC c_dtc_cam_1 "C_DTC_CAM_1" VALUE 0x70152 a_85 100 LINEAR______0_000000__0H___65535 0.0 65535.0 BIT_MASK 0xffffffff /end CHARACTERISTIC
/begin CHARACTERISTIC c_dtc_cam_2 "C_DTC_CAM_2" VALUE 0x70154 a_85 100 LINEAR______0_000000__0H___65535 0.0 65535.0 BIT_MASK 0xffffffff /end CHARACTERISTIC
/begin CHARACTERISTIC c_dtc_cam_3 "C_DTC_CAM_3" VALUE 0x70156 a_85 100 LINEAR______0_000000__0H___65535 0.0 65535.0 BIT_MASK 0xffffffff /end CHARACTERISTIC
/begin CHARACTERISTIC c_dtc_cam_ex_0 "C_DTC_CAM_EX_0" VALUE 0x70158 a_85 100 LINEAR______0_000000__0H___65535 0.0 65535.0 BIT_MASK 0xffffffff /end CHARACTERISTIC
/begin CHARACTERISTIC c_dtc_cam_ex_1 "C_DTC_CAM_EX_1" VALUE 0x7015a a_85 100 LINEAR______0_000000__0H___65535 0.0 65535.0 BIT_MASK 0xffffffff /end CHARACTERISTIC
/begin CHARACTERISTIC c_dtc_cam_ex_2 "C_DTC_CAM_EX_2" VALUE 0x7015c a_85 100 LINEAR______0_000000__0H___65535 0.0 65535.0 BIT_MASK 0xffffffff /end CHARACTERISTIC
/begin CHARACTERISTIC c_dtc_cam_ex_3 "C_DTC_CAM_EX_3" VALUE 0x7015e a_85 100 LINEAR______0_000000__0H___65535 0.0 65535.0 BIT_MASK 0xffffffff /end CHARACTERISTIC
/begin CHARACTERISTIC c_dtc_cam_ex_ivvt_0 "C_DTC_CAM_EX_IVVT_0" VALUE 0x70160 a_85 100 LINEAR______0_000000__0H___65535 0.0 65535.0 BIT_MASK 0xffffffff /end CHARACTERISTIC
/begin CHARACTERISTIC c_dtc_cam_ex_ivvt_1 "C_DTC_CAM_EX_IVVT_1" VALUE 0x70162 a_85 100 LINEAR______0_000000__0H___65535 0.0 65535.0 BIT_MASK 0xffffffff /end CHARACTERISTIC
/begin CHARACTERISTIC c_dtc_cam_ex_ivvt_2 "C_DTC_CAM_EX_IVVT_2" VALUE 0x70164 a_85 100 LINEAR______0_000000__0H___65535 0.0 65535.0 BIT_MASK 0xffffffff /end CHARACTERISTIC
/begin CHARACTERISTIC c_dtc_cam_ex_ivvt_3 "C_DTC_CAM_EX_IVVT_3" VALUE 0x70166 a_85 100 LINEAR______0_000000__0H___65535 0.0 65535.0 BIT_MASK 0xffffffff /end CHARACTERISTIC
/begin CHARACTERISTIC c_dtc_cam_in_ivvt_0 "C_DTC_CAM_IN_IVVT_0" VALUE 0x70168 a_85 100 LINEAR______0_000000__0H___65535 0.0 65535.0 BIT_MASK 0xffffffff /end CHARACTERISTIC
/begin CHARACTERISTIC c_dtc_cam_in_ivvt_1 "C_DTC_CAM_IN_IVVT_1" VALUE 0x7016a a_85 100 LINEAR______0_000000__0H___65535 0.0 65535.0 BIT_MASK 0xffffffff /end CHARACTERISTIC
/begin CHARACTERISTIC c_dtc_cam_in_ivvt_2 "C_DTC_CAM_IN_IVVT_2" VALUE 0x7016c a_85 100 LINEAR______0_000000__0H___65535 0.0 65535.0 BIT_MASK 0xffffffff /end CHARACTERISTIC
/begin CHARACTERISTIC c_dtc_cam_in_ivvt_3 "C_DTC_CAM_IN_IVVT_3" VALUE 0x7016e a_85 100 LINEAR______0_000000__0H___65535 0.0 65535.0 BIT_MASK 0xffffffff /end CHARACTERISTIC
/begin CHARACTERISTIC c_dtc_can_boff_0 "C_DTC_CAN_BOFF_0" VALUE 0x70170 a_85 100 LINEAR______0_000000__0H___65535 0.0 65535.0 BIT_MASK 0xffffffff /end CHARACTERISTIC
/begin CHARACTERISTIC c_dtc_can_boff_1 "C_DTC_CAN_BOFF_1" VALUE 0x70172 a_85 100 LINEAR______0_000000__0H___65535 0.0 65535.0 BIT_MASK 0xffffffff /end CHARACTERISTIC
/begin CHARACTERISTIC c_dtc_can_boff_2 "C_DTC_CAN_BOFF_2" VALUE 0x70174 a_85 100 LINEAR______0_000000__0H___65535 0.0 65535.0 BIT_MASK 0xffffffff /end CHARACTERISTIC
/begin CHARACTERISTIC c_dtc_can_boff_3 "C_DTC_CAN_BOFF_3" VALUE 0x70176 a_85 100 LINEAR______0_000000__0H___65535 0.0 65535.0 BIT_MASK 0xffffffff /end CHARACTERISTIC
/begin CHARACTERISTIC c_dtc_cat_diag_1_0 "C_DTC_CAT_DIAG_1_0" VALUE 0x70178 a_85 100 LINEAR______0_000000__0H___65535 0.0 65535.0 BIT_MASK 0xffffffff /end CHARACTERISTIC
/begin CHARACTERISTIC c_dtc_cat_diag_1_1 "C_DTC_CAT_DIAG_1_1" VALUE 0x7017a a_85 100 LINEAR______0_000000__0H___65535 0.0 65535.0 BIT_MASK 0xffffffff /end CHARACTERISTIC
/begin CHARACTERISTIC c_dtc_cat_diag_1_2 "C_DTC_CAT_DIAG_1_2" VALUE 0x7017c a_85 100 LINEAR______0_000000__0H___65535 0.0 65535.0 BIT_MASK 0xffffffff /end CHARACTERISTIC
/begin CHARACTERISTIC c_dtc_cat_diag_1_3 "C_DTC_CAT_DIAG_1_3" VALUE 0x7017e a_85 100 LINEAR______0_000000__0H___65535 0.0 65535.0 BIT_MASK 0xffffffff /end CHARACTERISTIC
/begin CHARACTERISTIC c_dtc_cat_diag_2_0 "C_DTC_CAT_DIAG_2_0" VALUE 0x70180 a_85 100 LINEAR______0_000000__0H___65535 0.0 65535.0 BIT_MASK 0xffffffff /end CHARACTERISTIC
/begin CHARACTERISTIC c_dtc_cat_diag_2_1 "C_DTC_CAT_DIAG_2_1" VALUE 0x70182 a_85 100 LINEAR______0_000000__0H___65535 0.0 65535.0 BIT_MASK 0xffffffff /end CHARACTERISTIC
/begin CHARACTERISTIC c_dtc_cat_diag_2_2 "C_DTC_CAT_DIAG_2_2" VALUE 0x70184 a_85 100 LINEAR______0_000000__0H___65535 0.0 65535.0 BIT_MASK 0xffffffff /end CHARACTERISTIC
/begin CHARACTERISTIC c_dtc_cat_diag_2_3 "C_DTC_CAT_DIAG_2_3" VALUE 0x70186 a_85 100 LINEAR______0_000000__0H___65535 0.0 65535.0 BIT_MASK 0xffffffff /end CHARACTERISTIC
/begin CHARACTERISTIC c_dtc_cat_eff_1_0 "C_DTC_CAT_EFF_1_0" VALUE 0x70188 a_85 100 LINEAR______0_000000__0H___65535 0.0 65535.0 BIT_MASK 0xffffffff /end CHARACTERISTIC
/begin CHARACTERISTIC c_dtc_cat_eff_1_1 "C_DTC_CAT_EFF_1_1" VALUE 0x7018a a_85 100 LINEAR______0_000000__0H___65535 0.0 65535.0 BIT_MASK 0xffffffff /end CHARACTERISTIC
/begin CHARACTERISTIC c_dtc_cat_eff_1_2 "C_DTC_CAT_EFF_1_2" VALUE 0x7018c a_85 100 LINEAR______0_000000__0H___65535 0.0 65535.0 BIT_MASK 0xffffffff /end CHARACTERISTIC
/begin CHARACTERISTIC c_dtc_cat_eff_1_3 "C_DTC_CAT_EFF_1_3" VALUE 0x7018e a_85 100 LINEAR______0_000000__0H___65535 0.0 65535.0 BIT_MASK 0xffffffff /end CHARACTERISTIC
/begin CHARACTERISTIC c_dtc_cat_eff_2_0 "C_DTC_CAT_EFF_2_0" VALUE 0x70190 a_85 100 LINEAR______0_000000__0H___65535 0.0 65535.0 BIT_MASK 0xffffffff /end CHARACTERISTIC
/begin CHARACTERISTIC c_dtc_cat_eff_2_1 "C_DTC_CAT_EFF_2_1" VALUE 0x70192 a_85 100 LINEAR______0_000000__0H___65535 0.0 65535.0 BIT_MASK 0xffffffff /end CHARACTERISTIC
/begin CHARACTERISTIC c_dtc_cat_eff_2_2 "C_DTC_CAT_EFF_2_2" VALUE 0x70194 a_85 100 LINEAR______0_000000__0H___65535 0.0 65535.0 BIT_MASK 0xffffffff /end CHARACTERISTIC
/begin CHARACTERISTIC c_dtc_cat_eff_2_3 "C_DTC_CAT_EFF_2_3" VALUE 0x70196 a_85 100 LINEAR______0_000000__0H___65535 0.0 65535.0 BIT_MASK 0xffffffff /end CHARACTERISTIC
/begin CHARACTERISTIC c_dtc_cc_0 "C_DTC_CC_0" VALUE 0x70198 a_85 100 LINEAR______0_000000__0H___65535 0.0 65535.0 BIT_MASK 0xffffffff /end CHARACTERISTIC
/begin CHARACTERISTIC c_dtc_cc_1 "C_DTC_CC_1" VALUE 0x7019a a_85 100 LINEAR______0_000000__0H___65535 0.0 65535.0 BIT_MASK 0xffffffff /end CHARACTERISTIC
/begin CHARACTERISTIC c_dtc_cc_2 "C_DTC_CC_2" VALUE 0x7019c a_85 100 LINEAR______0_000000__0H___65535 0.0 65535.0 BIT_MASK 0xffffffff /end CHARACTERISTIC
/begin CHARACTERISTIC c_dtc_cc_3 "C_DTC_CC_3" VALUE 0x7019e a_85 100 LINEAR______0_000000__0H___65535 0.0 65535.0 BIT_MASK 0xffffffff /end CHARACTERISTIC
/begin CHARACTERISTIC c_dtc_cps_0 "C_DTC_CPS_0" VALUE 0x701a0 a_85 100 LINEAR______0_000000__0H___65535 0.0 65535.0 BIT_MASK 0xffffffff /end CHARACTERISTIC
/begin CHARACTERISTIC c_dtc_cps_1 "C_DTC_CPS_1" VALUE 0x701a2 a_85 100 LINEAR______0_000000__0H___65535 0.0 65535.0 BIT_MASK 0xffffffff /end CHARACTERISTIC
/begin CHARACTERISTIC c_dtc_cps_2 "C_DTC_CPS_2" VALUE 0x701a4 a_85 100 LINEAR______0_000000__0H___65535 0.0 65535.0 BIT_MASK 0xffffffff /end CHARACTERISTIC
/begin CHARACTERISTIC c_dtc_cps_3 "C_DTC_CPS_3" VALUE 0x701a6 a_85 100 LINEAR______0_000000__0H___65535 0.0 65535.0 BIT_MASK 0xffffffff /end CHARACTERISTIC
/begin CHARACTERISTIC c_dtc_crk_0 "C_DTC_CRK_0" VALUE 0x701a8 a_85 100 LINEAR______0_000000__0H___65535 0.0 65535.0 BIT_MASK 0xffffffff /end CHARACTERISTIC
/begin CHARACTERISTIC c_dtc_crk_1 "C_DTC_CRK_1" VALUE 0x701aa a_85 100 LINEAR______0_000000__0H___65535 0.0 65535.0 BIT_MASK 0xffffffff /end CHARACTERISTIC
/begin CHARACTERISTIC c_dtc_crk_2 "C_DTC_CRK_2" VALUE 0x701ac a_85 100 LINEAR______0_000000__0H___65535 0.0 65535.0 BIT_MASK 0xffffffff /end CHARACTERISTIC
/begin CHARACTERISTIC c_dtc_crk_3 "C_DTC_CRK_3" VALUE 0x701ae a_85 100 LINEAR______0_000000__0H___65535 0.0 65535.0 BIT_MASK 0xffffffff /end CHARACTERISTIC
/begin CHARACTERISTIC c_dtc_cs_0 "C_DTC_CS_0" VALUE 0x701b0 a_85 100 LINEAR______0_000000__0H___65535 0.0 65535.0 BIT_MASK 0xffffffff /end CHARACTERISTIC
/begin CHARACTERISTIC c_dtc_cs_1 "C_DTC_CS_1" VALUE 0x701b2 a_85 100 LINEAR______0_000000__0H___65535 0.0 65535.0 BIT_MASK 0xffffffff /end CHARACTERISTIC
/begin CHARACTERISTIC c_dtc_cs_2 "C_DTC_CS_2" VALUE 0x701b4 a_85 100 LINEAR______0_000000__0H___65535 0.0 65535.0 BIT_MASK 0xffffffff /end CHARACTERISTIC
/begin CHARACTERISTIC c_dtc_cs_3 "C_DTC_CS_3" VALUE 0x701b6 a_85 100 LINEAR______0_000000__0H___65535 0.0 65535.0 BIT_MASK 0xffffffff /end CHARACTERISTIC
/begin CHARACTERISTIC c_dtc_ct_0 "C_DTC_CT_0" VALUE 0x701b8 a_85 100 LINEAR______0_000000__0H___65535 0.0 65535.0 BIT_MASK 0xffffffff /end CHARACTERISTIC
/begin CHARACTERISTIC c_dtc_ct_1 "C_DTC_CT_1" VALUE 0x701ba a_85 100 LINEAR______0_000000__0H___65535 0.0 65535.0 BIT_MASK 0xffffffff /end CHARACTERISTIC
/begin CHARACTERISTIC c_dtc_ct_2 "C_DTC_CT_2" VALUE 0x701bc a_85 100 LINEAR______0_000000__0H___65535 0.0 65535.0 BIT_MASK 0xffffffff /end CHARACTERISTIC
/begin CHARACTERISTIC c_dtc_ct_3 "C_DTC_CT_3" VALUE 0x701be a_85 100 LINEAR______0_000000__0H___65535 0.0 65535.0 BIT_MASK 0xffffffff /end CHARACTERISTIC
/begin CHARACTERISTIC c_dtc_ctoc_0 "C_DTC_CTOC_0" VALUE 0x701c0 a_85 100 LINEAR______0_000000__0H___65535 0.0 65535.0 BIT_MASK 0xffffffff /end CHARACTERISTIC
/begin CHARACTERISTIC c_dtc_ctoc_1 "C_DTC_CTOC_1" VALUE 0x701c2 a_85 100 LINEAR______0_000000__0H___65535 0.0 65535.0 BIT_MASK 0xffffffff /end CHARACTERISTIC
/begin CHARACTERISTIC c_dtc_ctoc_2 "C_DTC_CTOC_2" VALUE 0x701c4 a_85 100 LINEAR______0_000000__0H___65535 0.0 65535.0 BIT_MASK 0xffffffff /end CHARACTERISTIC
/begin CHARACTERISTIC c_dtc_ctoc_3 "C_DTC_CTOC_3" VALUE 0x701c6 a_85 100 LINEAR______0_000000__0H___65535 0.0 65535.0 BIT_MASK 0xffffffff /end CHARACTERISTIC
/begin CHARACTERISTIC c_dtc_diagcps_0 "C_DTC_DIAGCPS_0" VALUE 0x701c8 a_85 100 LINEAR______0_000000__0H___65535 0.0 65535.0 BIT_MASK 0xffffffff /end CHARACTERISTIC
/begin CHARACTERISTIC c_dtc_diagcps_1 "C_DTC_DIAGCPS_1" VALUE 0x701ca a_85 100 LINEAR______0_000000__0H___65535 0.0 65535.0 BIT_MASK 0xffffffff /end CHARACTERISTIC
/begin CHARACTERISTIC c_dtc_diagcps_2 "C_DTC_DIAGCPS_2" VALUE 0x701cc a_85 100 LINEAR______0_000000__0H___65535 0.0 65535.0 BIT_MASK 0xffffffff /end CHARACTERISTIC
/begin CHARACTERISTIC c_dtc_diagcps_3 "C_DTC_DIAGCPS_3" VALUE 0x701ce a_85 100 LINEAR______0_000000__0H___65535 0.0 65535.0 BIT_MASK 0xffffffff /end CHARACTERISTIC
/begin CHARACTERISTIC c_dtc_dmtl_0 "C_DTC_DMTL_0" VALUE 0x701d0 a_85 100 LINEAR______0_000000__0H___65535 0.0 65535.0 BIT_MASK 0xffffffff FUNCTION_LIST DMTL /end CHARACTERISTIC
/begin CHARACTERISTIC c_dtc_dmtl_1 "C_DTC_DMTL_1" VALUE 0x701d2 a_85 100 LINEAR______0_000000__0H___65535 0.0 65535.0 BIT_MASK 0xffffffff FUNCTION_LIST DMTL /end CHARACTERISTIC
/begin CHARACTERISTIC c_dtc_dmtl_2 "C_DTC_DMTL_2" VALUE 0x701d4 a_85 100 LINEAR______0_000000__0H___65535 0.0 65535.0 BIT_MASK 0xffffffff FUNCTION_LIST DMTL /end CHARACTERISTIC
/begin CHARACTERISTIC c_dtc_dmtl_3 "C_DTC_DMTL_3" VALUE 0x701d6 a_85 100 LINEAR______0_000000__0H___65535 0.0 65535.0 BIT_MASK 0xffffffff FUNCTION_LIST DMTL /end CHARACTERISTIC
/begin CHARACTERISTIC c_dtc_dmtl_leak_0 "C_DTC_DMTL_LEAK_0" VALUE 0x701d8 a_85 100 LINEAR______0_000000__0H___65535 0.0 65535.0 BIT_MASK 0xffffffff FUNCTION_LIST DMTL /end CHARACTERISTIC
/begin CHARACTERISTIC c_dtc_dmtl_leak_1 "C_DTC_DMTL_LEAK_1" VALUE 0x701da a_85 100 LINEAR______0_000000__0H___65535 0.0 65535.0 BIT_MASK 0xffffffff FUNCTION_LIST DMTL /end CHARACTERISTIC
/begin CHARACTERISTIC c_dtc_dmtl_leak_2 "C_DTC_DMTL_LEAK_2" VALUE 0x701dc a_85 100 LINEAR______0_000000__0H___65535 0.0 65535.0 BIT_MASK 0xffffffff FUNCTION_LIST DMTL /end CHARACTERISTIC
/begin CHARACTERISTIC c_dtc_dmtl_leak_3 "C_DTC_DMTL_LEAK_3" VALUE 0x701de a_85 100 LINEAR______0_000000__0H___65535 0.0 65535.0 BIT_MASK 0xffffffff FUNCTION_LIST DMTL /end CHARACTERISTIC
/begin CHARACTERISTIC c_dtc_dmtlm_0 "C_DTC_DMTLM_0" VALUE 0x701e0 a_85 100 LINEAR______0_000000__0H___65535 0.0 65535.0 BIT_MASK 0xffffffff FUNCTION_LIST DMTL /end CHARACTERISTIC
/begin CHARACTERISTIC c_dtc_dmtlm_1 "C_DTC_DMTLM_1" VALUE 0x701e2 a_85 100 LINEAR______0_000000__0H___65535 0.0 65535.0 BIT_MASK 0xffffffff FUNCTION_LIST DMTL /end CHARACTERISTIC
/begin CHARACTERISTIC c_dtc_dmtlm_2 "C_DTC_DMTLM_2" VALUE 0x701e4 a_85 100 LINEAR______0_000000__0H___65535 0.0 65535.0 BIT_MASK 0xffffffff FUNCTION_LIST DMTL /end CHARACTERISTIC
/begin CHARACTERISTIC c_dtc_dmtlm_3 "C_DTC_DMTLM_3" VALUE 0x701e6 a_85 100 LINEAR______0_000000__0H___65535 0.0 65535.0 BIT_MASK 0xffffffff FUNCTION_LIST DMTL /end CHARACTERISTIC
/begin CHARACTERISTIC c_dtc_ecf_0 "C_DTC_ECF_0" VALUE 0x701e8 a_85 100 LINEAR______0_000000__0H___65535 0.0 65535.0 BIT_MASK 0xffffffff /end CHARACTERISTIC
/begin CHARACTERISTIC c_dtc_ecf_1 "C_DTC_ECF_1" VALUE 0x701ea a_85 100 LINEAR______0_000000__0H___65535 0.0 65535.0 BIT_MASK 0xffffffff /end CHARACTERISTIC
/begin CHARACTERISTIC c_dtc_ecf_2 "C_DTC_ECF_2" VALUE 0x701ec a_85 100 LINEAR______0_000000__0H___65535 0.0 65535.0 BIT_MASK 0xffffffff /end CHARACTERISTIC
/begin CHARACTERISTIC c_dtc_ecf_3 "C_DTC_ECF_3" VALUE 0x701ee a_85 100 LINEAR______0_000000__0H___65535 0.0 65535.0 BIT_MASK 0xffffffff /end CHARACTERISTIC
/begin CHARACTERISTIC c_dtc_ect_0 "C_DTC_ECT_0" VALUE 0x701f0 a_85 100 LINEAR______0_000000__0H___65535 0.0 65535.0 BIT_MASK 0xffffffff /end CHARACTERISTIC
/begin CHARACTERISTIC c_dtc_ect_1 "C_DTC_ECT_1" VALUE 0x701f2 a_85 100 LINEAR______0_000000__0H___65535 0.0 65535.0 BIT_MASK 0xffffffff /end CHARACTERISTIC
/begin CHARACTERISTIC c_dtc_ect_2 "C_DTC_ECT_2" VALUE 0x701f4 a_85 100 LINEAR______0_000000__0H___65535 0.0 65535.0 BIT_MASK 0xffffffff /end CHARACTERISTIC
/begin CHARACTERISTIC c_dtc_ect_3 "C_DTC_ECT_3" VALUE 0x701f6 a_85 100 LINEAR______0_000000__0H___65535 0.0 65535.0 BIT_MASK 0xffffffff /end CHARACTERISTIC
/begin CHARACTERISTIC c_dtc_ect_mec_0 "C_DTC_ECT_MEC_0" VALUE 0x701f8 a_85 15 LINEAR______0_000000__0H___65535 0.0 65535.0 BIT_MASK 0xffffffff /end CHARACTERISTIC
/begin CHARACTERISTIC c_dtc_ect_mec_1 "C_DTC_ECT_MEC_1" VALUE 0x701fa a_85 15 LINEAR______0_000000__0H___65535 0.0 65535.0 BIT_MASK 0xffffffff /end CHARACTERISTIC
/begin CHARACTERISTIC c_dtc_ect_mec_2 "C_DTC_ECT_MEC_2" VALUE 0x701fc a_85 15 LINEAR______0_000000__0H___65535 0.0 65535.0 BIT_MASK 0xffffffff /end CHARACTERISTIC
/begin CHARACTERISTIC c_dtc_ect_mec_3 "C_DTC_ECT_MEC_3" VALUE 0x701fe a_85 15 LINEAR______0_000000__0H___65535 0.0 65535.0 BIT_MASK 0xffffffff /end CHARACTERISTIC
/begin CHARACTERISTIC c_dtc_ecu_0 "C_DTC_ECU_0" VALUE 0x70200 a_85 100 LINEAR______0_000000__0H___65535 0.0 65535.0 BIT_MASK 0xffffffff /end CHARACTERISTIC
/begin CHARACTERISTIC c_dtc_ecu_1 "C_DTC_ECU_1" VALUE 0x70202 a_85 100 LINEAR______0_000000__0H___65535 0.0 65535.0 BIT_MASK 0xffffffff /end CHARACTERISTIC
/begin CHARACTERISTIC c_dtc_ecu_2 "C_DTC_ECU_2" VALUE 0x70204 a_85 100 LINEAR______0_000000__0H___65535 0.0 65535.0 BIT_MASK 0xffffffff /end CHARACTERISTIC
/begin CHARACTERISTIC c_dtc_ecu_3 "C_DTC_ECU_3" VALUE 0x70206 a_85 100 LINEAR______0_000000__0H___65535 0.0 65535.0 BIT_MASK 0xffffffff /end CHARACTERISTIC
/begin CHARACTERISTIC c_dtc_ef_0 "C_DTC_EF_0" VALUE 0x70208 a_85 100 LINEAR______0_000000__0H___65535 0.0 65535.0 BIT_MASK 0xffffffff /end CHARACTERISTIC
/begin CHARACTERISTIC c_dtc_ef_1 "C_DTC_EF_1" VALUE 0x7020a a_85 100 LINEAR______0_000000__0H___65535 0.0 65535.0 BIT_MASK 0xffffffff /end CHARACTERISTIC
/begin CHARACTERISTIC c_dtc_ef_2 "C_DTC_EF_2" VALUE 0x7020c a_85 100 LINEAR______0_000000__0H___65535 0.0 65535.0 BIT_MASK 0xffffffff /end CHARACTERISTIC
/begin CHARACTERISTIC c_dtc_ef_3 "C_DTC_EF_3" VALUE 0x7020e a_85 100 LINEAR______0_000000__0H___65535 0.0 65535.0 BIT_MASK 0xffffffff /end CHARACTERISTIC
/begin CHARACTERISTIC c_dtc_er_ad_0 "C_DTC_ER_AD_0" VALUE 0x70210 a_85 100 LINEAR______0_000000__0H___65535 0.0 65535.0 BIT_MASK 0xffffffff /end CHARACTERISTIC
/begin CHARACTERISTIC c_dtc_er_ad_1 "C_DTC_ER_AD_1" VALUE 0x70212 a_85 100 LINEAR______0_000000__0H___65535 0.0 65535.0 BIT_MASK 0xffffffff /end CHARACTERISTIC
/begin CHARACTERISTIC c_dtc_er_ad_2 "C_DTC_ER_AD_2" VALUE 0x70214 a_85 100 LINEAR______0_000000__0H___65535 0.0 65535.0 BIT_MASK 0xffffffff /end CHARACTERISTIC
/begin CHARACTERISTIC c_dtc_er_ad_3 "C_DTC_ER_AD_3" VALUE 0x70216 a_85 100 LINEAR______0_000000__0H___65535 0.0 65535.0 BIT_MASK 0xffffffff /end CHARACTERISTIC
/begin CHARACTERISTIC c_dtc_igcfb_0_0 "C_DTC_IGCFB_0_0" VALUE 0x70218 a_85 100 LINEAR______0_000000__0H___65535 0.0 65535.0 BIT_MASK 0xffffffff /end CHARACTERISTIC
/begin CHARACTERISTIC c_dtc_igcfb_0_1 "C_DTC_IGCFB_0_1" VALUE 0x7021a a_85 100 LINEAR______0_000000__0H___65535 0.0 65535.0 BIT_MASK 0xffffffff /end CHARACTERISTIC
/begin CHARACTERISTIC c_dtc_igcfb_0_2 "C_DTC_IGCFB_0_2" VALUE 0x7021c a_85 100 LINEAR______0_000000__0H___65535 0.0 65535.0 BIT_MASK 0xffffffff /end CHARACTERISTIC
/begin CHARACTERISTIC c_dtc_igcfb_0_3 "C_DTC_IGCFB_0_3" VALUE 0x7021e a_85 100 LINEAR______0_000000__0H___65535 0.0 65535.0 BIT_MASK 0xffffffff /end CHARACTERISTIC
/begin CHARACTERISTIC c_dtc_igcfb_1_0 "C_DTC_IGCFB_1_0" VALUE 0x70220 a_85 100 LINEAR______0_000000__0H___65535 0.0 65535.0 BIT_MASK 0xffffffff /end CHARACTERISTIC
/begin CHARACTERISTIC c_dtc_igcfb_1_1 "C_DTC_IGCFB_1_1" VALUE 0x70222 a_85 100 LINEAR______0_000000__0H___65535 0.0 65535.0 BIT_MASK 0xffffffff /end CHARACTERISTIC
/begin CHARACTERISTIC c_dtc_igcfb_1_2 "C_DTC_IGCFB_1_2" VALUE 0x70224 a_85 100 LINEAR______0_000000__0H___65535 0.0 65535.0 BIT_MASK 0xffffffff /end CHARACTERISTIC
/begin CHARACTERISTIC c_dtc_igcfb_1_3 "C_DTC_IGCFB_1_3" VALUE 0x70226 a_85 100 LINEAR______0_000000__0H___65535 0.0 65535.0 BIT_MASK 0xffffffff /end CHARACTERISTIC
/begin CHARACTERISTIC c_dtc_igcfb_2_0 "C_DTC_IGCFB_2_0" VALUE 0x70228 a_85 100 LINEAR______0_000000__0H___65535 0.0 65535.0 BIT_MASK 0xffffffff /end CHARACTERISTIC
/begin CHARACTERISTIC c_dtc_igcfb_2_1 "C_DTC_IGCFB_2_1" VALUE 0x7022a a_85 100 LINEAR______0_000000__0H___65535 0.0 65535.0 BIT_MASK 0xffffffff /end CHARACTERISTIC
/begin CHARACTERISTIC c_dtc_igcfb_2_2 "C_DTC_IGCFB_2_2" VALUE 0x7022c a_85 100 LINEAR______0_000000__0H___65535 0.0 65535.0 BIT_MASK 0xffffffff /end CHARACTERISTIC
/begin CHARACTERISTIC c_dtc_igcfb_2_3 "C_DTC_IGCFB_2_3" VALUE 0x7022e a_85 100 LINEAR______0_000000__0H___65535 0.0 65535.0 BIT_MASK 0xffffffff /end CHARACTERISTIC
/begin CHARACTERISTIC c_dtc_igcfb_3_0 "C_DTC_IGCFB_3_0" VALUE 0x70230 a_85 100 LINEAR______0_000000__0H___65535 0.0 65535.0 BIT_MASK 0xffffffff /end CHARACTERISTIC
/begin CHARACTERISTIC c_dtc_igcfb_3_1 "C_DTC_IGCFB_3_1" VALUE 0x70232 a_85 100 LINEAR______0_000000__0H___65535 0.0 65535.0 BIT_MASK 0xffffffff /end CHARACTERISTIC
/begin CHARACTERISTIC c_dtc_igcfb_3_2 "C_DTC_IGCFB_3_2" VALUE 0x70234 a_85 100 LINEAR______0_000000__0H___65535 0.0 65535.0 BIT_MASK 0xffffffff /end CHARACTERISTIC
/begin CHARACTERISTIC c_dtc_igcfb_3_3 "C_DTC_IGCFB_3_3" VALUE 0x70236 a_85 100 LINEAR______0_000000__0H___65535 0.0 65535.0 BIT_MASK 0xffffffff /end CHARACTERISTIC
/begin CHARACTERISTIC c_dtc_igcfb_4_0 "C_DTC_IGCFB_4_0" VALUE 0x70238 a_85 100 LINEAR______0_000000__0H___65535 0.0 65535.0 BIT_MASK 0xffffffff /end CHARACTERISTIC
/begin CHARACTERISTIC c_dtc_igcfb_4_1 "C_DTC_IGCFB_4_1" VALUE 0x7023a a_85 100 LINEAR______0_000000__0H___65535 0.0 65535.0 BIT_MASK 0xffffffff /end CHARACTERISTIC
/begin CHARACTERISTIC c_dtc_igcfb_4_2 "C_DTC_IGCFB_4_2" VALUE 0x7023c a_85 100 LINEAR______0_000000__0H___65535 0.0 65535.0 BIT_MASK 0xffffffff /end CHARACTERISTIC
/begin CHARACTERISTIC c_dtc_igcfb_4_3 "C_DTC_IGCFB_4_3" VALUE 0x7023e a_85 100 LINEAR______0_000000__0H___65535 0.0 65535.0 BIT_MASK 0xffffffff /end CHARACTERISTIC
/begin CHARACTERISTIC c_dtc_igcfb_5_0 "C_DTC_IGCFB_5_0" VALUE 0x70240 a_85 100 LINEAR______0_000000__0H___65535 0.0 65535.0 BIT_MASK 0xffffffff /end CHARACTERISTIC
/begin CHARACTERISTIC c_dtc_igcfb_5_1 "C_DTC_IGCFB_5_1" VALUE 0x70242 a_85 100 LINEAR______0_000000__0H___65535 0.0 65535.0 BIT_MASK 0xffffffff /end CHARACTERISTIC
/begin CHARACTERISTIC c_dtc_igcfb_5_2 "C_DTC_IGCFB_5_2" VALUE 0x70244 a_85 100 LINEAR______0_000000__0H___65535 0.0 65535.0 BIT_MASK 0xffffffff /end CHARACTERISTIC
/begin CHARACTERISTIC c_dtc_igcfb_5_3 "C_DTC_IGCFB_5_3" VALUE 0x70246 a_85 100 LINEAR______0_000000__0H___65535 0.0 65535.0 BIT_MASK 0xffffffff /end CHARACTERISTIC
/begin CHARACTERISTIC c_dtc_imob_0 "C_DTC_IMOB_0" VALUE 0x70248 a_85 100 LINEAR______0_000000__0H___65535 0.0 65535.0 BIT_MASK 0xffffffff /end CHARACTERISTIC
/begin CHARACTERISTIC c_dtc_imob_1 "C_DTC_IMOB_1" VALUE 0x7024a a_85 100 LINEAR______0_000000__0H___65535 0.0 65535.0 BIT_MASK 0xffffffff /end CHARACTERISTIC
/begin CHARACTERISTIC c_dtc_imob_2 "C_DTC_IMOB_2" VALUE 0x7024c a_85 100 LINEAR______0_000000__0H___65535 0.0 65535.0 BIT_MASK 0xffffffff /end CHARACTERISTIC
/begin CHARACTERISTIC c_dtc_imob_3 "C_DTC_IMOB_3" VALUE 0x7024e a_85 100 LINEAR______0_000000__0H___65535 0.0 65535.0 BIT_MASK 0xffffffff /end CHARACTERISTIC
/begin CHARACTERISTIC c_dtc_is_0 "C_DTC_IS_0" VALUE 0x70250 a_85 100 LINEAR______0_000000__0H___65535 0.0 65535.0 BIT_MASK 0xffffffff /end CHARACTERISTIC
/begin CHARACTERISTIC c_dtc_is_1 "C_DTC_IS_1" VALUE 0x70252 a_85 100 LINEAR______0_000000__0H___65535 0.0 65535.0 BIT_MASK 0xffffffff /end CHARACTERISTIC
/begin CHARACTERISTIC c_dtc_is_2 "C_DTC_IS_2" VALUE 0x70254 a_85 100 LINEAR______0_000000__0H___65535 0.0 65535.0 BIT_MASK 0xffffffff /end CHARACTERISTIC
/begin CHARACTERISTIC c_dtc_is_3 "C_DTC_IS_3" VALUE 0x70256 a_85 100 LINEAR______0_000000__0H___65535 0.0 65535.0 BIT_MASK 0xffffffff /end CHARACTERISTIC
/begin CHARACTERISTIC c_dtc_isa_1_0 "C_DTC_ISA_1_0" VALUE 0x70258 a_85 100 LINEAR______0_000000__0H___65535 0.0 65535.0 BIT_MASK 0xffffffff /end CHARACTERISTIC
/begin CHARACTERISTIC c_dtc_isa_1_1 "C_DTC_ISA_1_1" VALUE 0x7025a a_85 100 LINEAR______0_000000__0H___65535 0.0 65535.0 BIT_MASK 0xffffffff /end CHARACTERISTIC
/begin CHARACTERISTIC c_dtc_isa_1_2 "C_DTC_ISA_1_2" VALUE 0x7025c a_85 100 LINEAR______0_000000__0H___65535 0.0 65535.0 BIT_MASK 0xffffffff /end CHARACTERISTIC
/begin CHARACTERISTIC c_dtc_isa_1_3 "C_DTC_ISA_1_3" VALUE 0x7025e a_85 100 LINEAR______0_000000__0H___65535 0.0 65535.0 BIT_MASK 0xffffffff /end CHARACTERISTIC
/begin CHARACTERISTIC c_dtc_isa_2_0 "C_DTC_ISA_2_0" VALUE 0x70260 a_85 100 LINEAR______0_000000__0H___65535 0.0 65535.0 BIT_MASK 0xffffffff /end CHARACTERISTIC
/begin CHARACTERISTIC c_dtc_isa_2_1 "C_DTC_ISA_2_1" VALUE 0x70262 a_85 100 LINEAR______0_000000__0H___65535 0.0 65535.0 BIT_MASK 0xffffffff /end CHARACTERISTIC
/begin CHARACTERISTIC c_dtc_isa_2_2 "C_DTC_ISA_2_2" VALUE 0x70264 a_85 100 LINEAR______0_000000__0H___65535 0.0 65535.0 BIT_MASK 0xffffffff /end CHARACTERISTIC
/begin CHARACTERISTIC c_dtc_isa_2_3 "C_DTC_ISA_2_3" VALUE 0x70266 a_85 100 LINEAR______0_000000__0H___65535 0.0 65535.0 BIT_MASK 0xffffffff /end CHARACTERISTIC
/begin CHARACTERISTIC c_dtc_iv_0_0 "C_DTC_IV_0_0" VALUE 0x70268 a_85 100 LINEAR______0_000000__0H___65535 0.0 65535.0 BIT_MASK 0xffffffff /end CHARACTERISTIC
/begin CHARACTERISTIC c_dtc_iv_0_1 "C_DTC_IV_0_1" VALUE 0x7026a a_85 100 LINEAR______0_000000__0H___65535 0.0 65535.0 BIT_MASK 0xffffffff /end CHARACTERISTIC
/begin CHARACTERISTIC c_dtc_iv_0_2 "C_DTC_IV_0_2" VALUE 0x7026c a_85 100 LINEAR______0_000000__0H___65535 0.0 65535.0 BIT_MASK 0xffffffff /end CHARACTERISTIC
/begin CHARACTERISTIC c_dtc_iv_0_3 "C_DTC_IV_0_3" VALUE 0x7026e a_85 100 LINEAR______0_000000__0H___65535 0.0 65535.0 BIT_MASK 0xffffffff /end CHARACTERISTIC
/begin CHARACTERISTIC c_dtc_iv_1_0 "C_DTC_IV_1_0" VALUE 0x70270 a_85 100 LINEAR______0_000000__0H___65535 0.0 65535.0 BIT_MASK 0xffffffff /end CHARACTERISTIC
/begin CHARACTERISTIC c_dtc_iv_1_1 "C_DTC_IV_1_1" VALUE 0x70272 a_85 100 LINEAR______0_000000__0H___65535 0.0 65535.0 BIT_MASK 0xffffffff /end CHARACTERISTIC
/begin CHARACTERISTIC c_dtc_iv_1_2 "C_DTC_IV_1_2" VALUE 0x70274 a_85 100 LINEAR______0_000000__0H___65535 0.0 65535.0 BIT_MASK 0xffffffff /end CHARACTERISTIC
/begin CHARACTERISTIC c_dtc_iv_1_3 "C_DTC_IV_1_3" VALUE 0x70276 a_85 100 LINEAR______0_000000__0H___65535 0.0 65535.0 BIT_MASK 0xffffffff /end CHARACTERISTIC
/begin CHARACTERISTIC c_dtc_iv_2_0 "C_DTC_IV_2_0" VALUE 0x70278 a_85 100 LINEAR______0_000000__0H___65535 0.0 65535.0 BIT_MASK 0xffffffff /end CHARACTERISTIC
/begin CHARACTERISTIC c_dtc_iv_2_1 "C_DTC_IV_2_1" VALUE 0x7027a a_85 100 LINEAR______0_000000__0H___65535 0.0 65535.0 BIT_MASK 0xffffffff /end CHARACTERISTIC
/begin CHARACTERISTIC c_dtc_iv_2_2 "C_DTC_IV_2_2" VALUE 0x7027c a_85 100 LINEAR______0_000000__0H___65535 0.0 65535.0 BIT_MASK 0xffffffff /end CHARACTERISTIC
/begin CHARACTERISTIC c_dtc_iv_2_3 "C_DTC_IV_2_3" VALUE 0x7027e a_85 100 LINEAR______0_000000__0H___65535 0.0 65535.0 BIT_MASK 0xffffffff /end CHARACTERISTIC
/begin CHARACTERISTIC c_dtc_iv_3_0 "C_DTC_IV_3_0" VALUE 0x70280 a_85 100 LINEAR______0_000000__0H___65535 0.0 65535.0 BIT_MASK 0xffffffff /end CHARACTERISTIC
/begin CHARACTERISTIC c_dtc_iv_3_1 "C_DTC_IV_3_1" VALUE 0x70282 a_85 100 LINEAR______0_000000__0H___65535 0.0 65535.0 BIT_MASK 0xffffffff /end CHARACTERISTIC
/begin CHARACTERISTIC c_dtc_iv_3_2 "C_DTC_IV_3_2" VALUE 0x70284 a_85 100 LINEAR______0_000000__0H___65535 0.0 65535.0 BIT_MASK 0xffffffff /end CHARACTERISTIC
/begin CHARACTERISTIC c_dtc_iv_3_3 "C_DTC_IV_3_3" VALUE 0x70286 a_85 100 LINEAR______0_000000__0H___65535 0.0 65535.0 BIT_MASK 0xffffffff /end CHARACTERISTIC
/begin CHARACTERISTIC c_dtc_iv_4_0 "C_DTC_IV_4_0" VALUE 0x70288 a_85 100 LINEAR______0_000000__0H___65535 0.0 65535.0 BIT_MASK 0xffffffff /end CHARACTERISTIC
/begin CHARACTERISTIC c_dtc_iv_4_1 "C_DTC_IV_4_1" VALUE 0x7028a a_85 100 LINEAR______0_000000__0H___65535 0.0 65535.0 BIT_MASK 0xffffffff /end CHARACTERISTIC
/begin CHARACTERISTIC c_dtc_iv_4_2 "C_DTC_IV_4_2" VALUE 0x7028c a_85 100 LINEAR______0_000000__0H___65535 0.0 65535.0 BIT_MASK 0xffffffff /end CHARACTERISTIC
/begin CHARACTERISTIC c_dtc_iv_4_3 "C_DTC_IV_4_3" VALUE 0x7028e a_85 100 LINEAR______0_000000__0H___65535 0.0 65535.0 BIT_MASK 0xffffffff /end CHARACTERISTIC
/begin CHARACTERISTIC c_dtc_iv_5_0 "C_DTC_IV_5_0" VALUE 0x70290 a_85 100 LINEAR______0_000000__0H___65535 0.0 65535.0 BIT_MASK 0xffffffff /end CHARACTERISTIC
/begin CHARACTERISTIC c_dtc_iv_5_1 "C_DTC_IV_5_1" VALUE 0x70292 a_85 100 LINEAR______0_000000__0H___65535 0.0 65535.0 BIT_MASK 0xffffffff /end CHARACTERISTIC
/begin CHARACTERISTIC c_dtc_iv_5_2 "C_DTC_IV_5_2" VALUE 0x70294 a_85 100 LINEAR______0_000000__0H___65535 0.0 65535.0 BIT_MASK 0xffffffff /end CHARACTERISTIC
/begin CHARACTERISTIC c_dtc_iv_5_3 "C_DTC_IV_5_3" VALUE 0x70296 a_85 100 LINEAR______0_000000__0H___65535 0.0 65535.0 BIT_MASK 0xffffffff /end CHARACTERISTIC
/begin CHARACTERISTIC c_dtc_knk_1_0 "C_DTC_KNK_1_0" VALUE 0x70298 a_85 100 LINEAR______0_000000__0H___65535 0.0 65535.0 BIT_MASK 0xffffffff /end CHARACTERISTIC
/begin CHARACTERISTIC c_dtc_knk_1_1 "C_DTC_KNK_1_1" VALUE 0x7029a a_85 100 LINEAR______0_000000__0H___65535 0.0 65535.0 BIT_MASK 0xffffffff /end CHARACTERISTIC
/begin CHARACTERISTIC c_dtc_knk_1_2 "C_DTC_KNK_1_2" VALUE 0x7029c a_85 100 LINEAR______0_000000__0H___65535 0.0 65535.0 BIT_MASK 0xffffffff /end CHARACTERISTIC
/begin CHARACTERISTIC c_dtc_knk_1_3 "C_DTC_KNK_1_3" VALUE 0x7029e a_85 100 LINEAR______0_000000__0H___65535 0.0 65535.0 BIT_MASK 0xffffffff /end CHARACTERISTIC
/begin CHARACTERISTIC c_dtc_knk_2_0 "C_DTC_KNK_2_0" VALUE 0x702a0 a_85 100 LINEAR______0_000000__0H___65535 0.0 65535.0 BIT_MASK 0xffffffff /end CHARACTERISTIC
/begin CHARACTERISTIC c_dtc_knk_2_1 "C_DTC_KNK_2_1" VALUE 0x702a2 a_85 100 LINEAR______0_000000__0H___65535 0.0 65535.0 BIT_MASK 0xffffffff /end CHARACTERISTIC
/begin CHARACTERISTIC c_dtc_knk_2_2 "C_DTC_KNK_2_2" VALUE 0x702a4 a_85 100 LINEAR______0_000000__0H___65535 0.0 65535.0 BIT_MASK 0xffffffff /end CHARACTERISTIC
/begin CHARACTERISTIC c_dtc_knk_2_3 "C_DTC_KNK_2_3" VALUE 0x702a6 a_85 100 LINEAR______0_000000__0H___65535 0.0 65535.0 BIT_MASK 0xffffffff /end CHARACTERISTIC
/begin CHARACTERISTIC c_dtc_lam_dly_down_1_0 "C_DTC_LAM_DLY_DOWN_1_0" VALUE 0x702a8 a_85 100 LINEAR______0_000000__0H___65535 0.0 65535.0 BIT_MASK 0xffffffff /end CHARACTERISTIC
/begin CHARACTERISTIC c_dtc_lam_dly_down_1_1 "C_DTC_LAM_DLY_DOWN_1_1" VALUE 0x702aa a_85 100 LINEAR______0_000000__0H___65535 0.0 65535.0 BIT_MASK 0xffffffff /end CHARACTERISTIC
/begin CHARACTERISTIC c_dtc_lam_dly_down_1_2 "C_DTC_LAM_DLY_DOWN_1_2" VALUE 0x702ac a_85 100 LINEAR______0_000000__0H___65535 0.0 65535.0 BIT_MASK 0xffffffff /end CHARACTERISTIC
/begin CHARACTERISTIC c_dtc_lam_dly_down_1_3 "C_DTC_LAM_DLY_DOWN_1_3" VALUE 0x702ae a_85 100 LINEAR______0_000000__0H___65535 0.0 65535.0 BIT_MASK 0xffffffff /end CHARACTERISTIC
/begin CHARACTERISTIC c_dtc_lam_dly_down_2_0 "C_DTC_LAM_DLY_DOWN_2_0" VALUE 0x702b0 a_85 100 LINEAR______0_000000__0H___65535 0.0 65535.0 BIT_MASK 0xffffffff /end CHARACTERISTIC
/begin CHARACTERISTIC c_dtc_lam_dly_down_2_1 "C_DTC_LAM_DLY_DOWN_2_1" VALUE 0x702b2 a_85 100 LINEAR______0_000000__0H___65535 0.0 65535.0 BIT_MASK 0xffffffff /end CHARACTERISTIC
/begin CHARACTERISTIC c_dtc_lam_dly_down_2_2 "C_DTC_LAM_DLY_DOWN_2_2" VALUE 0x702b4 a_85 100 LINEAR______0_000000__0H___65535 0.0 65535.0 BIT_MASK 0xffffffff /end CHARACTERISTIC
/begin CHARACTERISTIC c_dtc_lam_dly_down_2_3 "C_DTC_LAM_DLY_DOWN_2_3" VALUE 0x702b6 a_85 100 LINEAR______0_000000__0H___65535 0.0 65535.0 BIT_MASK 0xffffffff /end CHARACTERISTIC
/begin CHARACTERISTIC c_dtc_lam_dly_up_1_0 "C_DTC_LAM_DLY_UP_1_0" VALUE 0x702b8 a_85 100 LINEAR______0_000000__0H___65535 0.0 65535.0 BIT_MASK 0xffffffff /end CHARACTERISTIC
/begin CHARACTERISTIC c_dtc_lam_dly_up_1_1 "C_DTC_LAM_DLY_UP_1_1" VALUE 0x702ba a_85 100 LINEAR______0_000000__0H___65535 0.0 65535.0 BIT_MASK 0xffffffff /end CHARACTERISTIC
/begin CHARACTERISTIC c_dtc_lam_dly_up_1_2 "C_DTC_LAM_DLY_UP_1_2" VALUE 0x702bc a_85 100 LINEAR______0_000000__0H___65535 0.0 65535.0 BIT_MASK 0xffffffff /end CHARACTERISTIC
/begin CHARACTERISTIC c_dtc_lam_dly_up_1_3 "C_DTC_LAM_DLY_UP_1_3" VALUE 0x702be a_85 100 LINEAR______0_000000__0H___65535 0.0 65535.0 BIT_MASK 0xffffffff /end CHARACTERISTIC
/begin CHARACTERISTIC c_dtc_lam_dly_up_2_0 "C_DTC_LAM_DLY_UP_2_0" VALUE 0x702c0 a_85 100 LINEAR______0_000000__0H___65535 0.0 65535.0 BIT_MASK 0xffffffff /end CHARACTERISTIC
/begin CHARACTERISTIC c_dtc_lam_dly_up_2_1 "C_DTC_LAM_DLY_UP_2_1" VALUE 0x702c2 a_85 100 LINEAR______0_000000__0H___65535 0.0 65535.0 BIT_MASK 0xffffffff /end CHARACTERISTIC
/begin CHARACTERISTIC c_dtc_lam_dly_up_2_2 "C_DTC_LAM_DLY_UP_2_2" VALUE 0x702c4 a_85 100 LINEAR______0_000000__0H___65535 0.0 65535.0 BIT_MASK 0xffffffff /end CHARACTERISTIC
/begin CHARACTERISTIC c_dtc_lam_dly_up_2_3 "C_DTC_LAM_DLY_UP_2_3" VALUE 0x702c6 a_85 100 LINEAR______0_000000__0H___65535 0.0 65535.0 BIT_MASK 0xffffffff /end CHARACTERISTIC
/begin CHARACTERISTIC c_dtc_lam_lim_1_0 "C_DTC_LAM_LIM_1_0" VALUE 0x702c8 a_85 100 LINEAR______0_000000__0H___65535 0.0 65535.0 BIT_MASK 0xffffffff /end CHARACTERISTIC
/begin CHARACTERISTIC c_dtc_lam_lim_1_1 "C_DTC_LAM_LIM_1_1" VALUE 0x702ca a_85 100 LINEAR______0_000000__0H___65535 0.0 65535.0 BIT_MASK 0xffffffff /end CHARACTERISTIC
/begin CHARACTERISTIC c_dtc_lam_lim_1_2 "C_DTC_LAM_LIM_1_2" VALUE 0x702cc a_85 100 LINEAR______0_000000__0H___65535 0.0 65535.0 BIT_MASK 0xffffffff /end CHARACTERISTIC
/begin CHARACTERISTIC c_dtc_lam_lim_1_3 "C_DTC_LAM_LIM_1_3" VALUE 0x702ce a_85 100 LINEAR______0_000000__0H___65535 0.0 65535.0 BIT_MASK 0xffffffff /end CHARACTERISTIC
/begin CHARACTERISTIC c_dtc_lam_lim_2_0 "C_DTC_LAM_LIM_2_0" VALUE 0x702d0 a_85 100 LINEAR______0_000000__0H___65535 0.0 65535.0 BIT_MASK 0xffffffff /end CHARACTERISTIC
/begin CHARACTERISTIC c_dtc_lam_lim_2_1 "C_DTC_LAM_LIM_2_1" VALUE 0x702d2 a_85 100 LINEAR______0_000000__0H___65535 0.0 65535.0 BIT_MASK 0xffffffff /end CHARACTERISTIC
/begin CHARACTERISTIC c_dtc_lam_lim_2_2 "C_DTC_LAM_LIM_2_2" VALUE 0x702d4 a_85 100 LINEAR______0_000000__0H___65535 0.0 65535.0 BIT_MASK 0xffffffff /end CHARACTERISTIC
/begin CHARACTERISTIC c_dtc_lam_lim_2_3 "C_DTC_LAM_LIM_2_3" VALUE 0x702d6 a_85 100 LINEAR______0_000000__0H___65535 0.0 65535.0 BIT_MASK 0xffffffff /end CHARACTERISTIC
/begin CHARACTERISTIC c_dtc_lam_stop_1_0 "C_DTC_LAM_STOP_1_0" VALUE 0x702d8 a_85 100 LINEAR______0_000000__0H___65535 0.0 65535.0 BIT_MASK 0xffffffff /end CHARACTERISTIC
/begin CHARACTERISTIC c_dtc_lam_stop_1_1 "C_DTC_LAM_STOP_1_1" VALUE 0x702da a_85 100 LINEAR______0_000000__0H___65535 0.0 65535.0 BIT_MASK 0xffffffff /end CHARACTERISTIC
/begin CHARACTERISTIC c_dtc_lam_stop_1_2 "C_DTC_LAM_STOP_1_2" VALUE 0x702dc a_85 100 LINEAR______0_000000__0H___65535 0.0 65535.0 BIT_MASK 0xffffffff /end CHARACTERISTIC
/begin CHARACTERISTIC c_dtc_lam_stop_1_3 "C_DTC_LAM_STOP_1_3" VALUE 0x702de a_85 100 LINEAR______0_000000__0H___65535 0.0 65535.0 BIT_MASK 0xffffffff /end CHARACTERISTIC
/begin CHARACTERISTIC c_dtc_lam_stop_2_0 "C_DTC_LAM_STOP_2_0" VALUE 0x702e0 a_85 100 LINEAR______0_000000__0H___65535 0.0 65535.0 BIT_MASK 0xffffffff /end CHARACTERISTIC
/begin CHARACTERISTIC c_dtc_lam_stop_2_1 "C_DTC_LAM_STOP_2_1" VALUE 0x702e2 a_85 100 LINEAR______0_000000__0H___65535 0.0 65535.0 BIT_MASK 0xffffffff /end CHARACTERISTIC
/begin CHARACTERISTIC c_dtc_lam_stop_2_2 "C_DTC_LAM_STOP_2_2" VALUE 0x702e4 a_85 100 LINEAR______0_000000__0H___65535 0.0 65535.0 BIT_MASK 0xffffffff /end CHARACTERISTIC
/begin CHARACTERISTIC c_dtc_lam_stop_2_3 "C_DTC_LAM_STOP_2_3" VALUE 0x702e6 a_85 100 LINEAR______0_000000__0H___65535 0.0 65535.0 BIT_MASK 0xffffffff /end CHARACTERISTIC
/begin CHARACTERISTIC c_dtc_leak_big_0 "C_DTC_LEAK_BIG_0" VALUE 0x702e8 a_85 100 LINEAR______0_000000__0H___65535 0.0 65535.0 BIT_MASK 0xffffffff /end CHARACTERISTIC
/begin CHARACTERISTIC c_dtc_leak_big_1 "C_DTC_LEAK_BIG_1" VALUE 0x702ea a_85 100 LINEAR______0_000000__0H___65535 0.0 65535.0 BIT_MASK 0xffffffff /end CHARACTERISTIC
/begin CHARACTERISTIC c_dtc_leak_big_2 "C_DTC_LEAK_BIG_2" VALUE 0x702ec a_85 100 LINEAR______0_000000__0H___65535 0.0 65535.0 BIT_MASK 0xffffffff /end CHARACTERISTIC
/begin CHARACTERISTIC c_dtc_leak_big_3 "C_DTC_LEAK_BIG_3" VALUE 0x702ee a_85 100 LINEAR______0_000000__0H___65535 0.0 65535.0 BIT_MASK 0xffffffff /end CHARACTERISTIC
/begin CHARACTERISTIC c_dtc_leak_small_0 "C_DTC_LEAK_SMALL_0" VALUE 0x702f0 a_85 100 LINEAR______0_000000__0H___65535 0.0 65535.0 BIT_MASK 0xffffffff /end CHARACTERISTIC
/begin CHARACTERISTIC c_dtc_leak_small_1 "C_DTC_LEAK_SMALL_1" VALUE 0x702f2 a_85 100 LINEAR______0_000000__0H___65535 0.0 65535.0 BIT_MASK 0xffffffff /end CHARACTERISTIC
/begin CHARACTERISTIC c_dtc_leak_small_2 "C_DTC_LEAK_SMALL_2" VALUE 0x702f4 a_85 100 LINEAR______0_000000__0H___65535 0.0 65535.0 BIT_MASK 0xffffffff /end CHARACTERISTIC
/begin CHARACTERISTIC c_dtc_leak_small_3 "C_DTC_LEAK_SMALL_3" VALUE 0x702f6 a_85 100 LINEAR______0_000000__0H___65535 0.0 65535.0 BIT_MASK 0xffffffff /end CHARACTERISTIC
/begin CHARACTERISTIC c_dtc_ls_frq_1_0 "C_DTC_LS_FRQ_1_0" VALUE 0x702f8 a_85 100 LINEAR______0_000000__0H___65535 0.0 65535.0 BIT_MASK 0xffffffff /end CHARACTERISTIC
/begin CHARACTERISTIC c_dtc_ls_frq_1_1 "C_DTC_LS_FRQ_1_1" VALUE 0x702fa a_85 100 LINEAR______0_000000__0H___65535 0.0 65535.0 BIT_MASK 0xffffffff /end CHARACTERISTIC
/begin CHARACTERISTIC c_dtc_ls_frq_1_2 "C_DTC_LS_FRQ_1_2" VALUE 0x702fc a_85 100 LINEAR______0_000000__0H___65535 0.0 65535.0 BIT_MASK 0xffffffff /end CHARACTERISTIC
/begin CHARACTERISTIC c_dtc_ls_frq_1_3 "C_DTC_LS_FRQ_1_3" VALUE 0x702fe a_85 100 LINEAR______0_000000__0H___65535 0.0 65535.0 BIT_MASK 0xffffffff /end CHARACTERISTIC
/begin CHARACTERISTIC c_dtc_ls_frq_2_0 "C_DTC_LS_FRQ_2_0" VALUE 0x70300 a_85 100 LINEAR______0_000000__0H___65535 0.0 65535.0 BIT_MASK 0xffffffff /end CHARACTERISTIC
/begin CHARACTERISTIC c_dtc_ls_frq_2_1 "C_DTC_LS_FRQ_2_1" VALUE 0x70302 a_85 100 LINEAR______0_000000__0H___65535 0.0 65535.0 BIT_MASK 0xffffffff /end CHARACTERISTIC
/begin CHARACTERISTIC c_dtc_ls_frq_2_2 "C_DTC_LS_FRQ_2_2" VALUE 0x70304 a_85 100 LINEAR______0_000000__0H___65535 0.0 65535.0 BIT_MASK 0xffffffff /end CHARACTERISTIC
/begin CHARACTERISTIC c_dtc_ls_frq_2_3 "C_DTC_LS_FRQ_2_3" VALUE 0x70306 a_85 100 LINEAR______0_000000__0H___65535 0.0 65535.0 BIT_MASK 0xffffffff /end CHARACTERISTIC
/begin CHARACTERISTIC c_dtc_lsh_down_1_0 "C_DTC_LSH_DOWN_1_0" VALUE 0x70308 a_85 100 LINEAR______0_000000__0H___65535 0.0 65535.0 BIT_MASK 0xffffffff /end CHARACTERISTIC
/begin CHARACTERISTIC c_dtc_lsh_down_1_1 "C_DTC_LSH_DOWN_1_1" VALUE 0x7030a a_85 100 LINEAR______0_000000__0H___65535 0.0 65535.0 BIT_MASK 0xffffffff /end CHARACTERISTIC
/begin CHARACTERISTIC c_dtc_lsh_down_1_2 "C_DTC_LSH_DOWN_1_2" VALUE 0x7030c a_85 100 LINEAR______0_000000__0H___65535 0.0 65535.0 BIT_MASK 0xffffffff /end CHARACTERISTIC
/begin CHARACTERISTIC c_dtc_lsh_down_1_3 "C_DTC_LSH_DOWN_1_3" VALUE 0x7030e a_85 100 LINEAR______0_000000__0H___65535 0.0 65535.0 BIT_MASK 0xffffffff /end CHARACTERISTIC
/begin CHARACTERISTIC c_dtc_lsh_down_2_0 "C_DTC_LSH_DOWN_2_0" VALUE 0x70310 a_85 100 LINEAR______0_000000__0H___65535 0.0 65535.0 BIT_MASK 0xffffffff /end CHARACTERISTIC
/begin CHARACTERISTIC c_dtc_lsh_down_2_1 "C_DTC_LSH_DOWN_2_1" VALUE 0x70312 a_85 100 LINEAR______0_000000__0H___65535 0.0 65535.0 BIT_MASK 0xffffffff /end CHARACTERISTIC
/begin CHARACTERISTIC c_dtc_lsh_down_2_2 "C_DTC_LSH_DOWN_2_2" VALUE 0x70314 a_85 100 LINEAR______0_000000__0H___65535 0.0 65535.0 BIT_MASK 0xffffffff /end CHARACTERISTIC
/begin CHARACTERISTIC c_dtc_lsh_down_2_3 "C_DTC_LSH_DOWN_2_3" VALUE 0x70316 a_85 100 LINEAR______0_000000__0H___65535 0.0 65535.0 BIT_MASK 0xffffffff /end CHARACTERISTIC
/begin CHARACTERISTIC c_dtc_lsh_obd_down_1_0 "C_DTC_LSH_OBD_DOWN_1_0" VALUE 0x70318 a_85 100 LINEAR______0_000000__0H___65535 0.0 65535.0 BIT_MASK 0xffffffff /end CHARACTERISTIC
/begin CHARACTERISTIC c_dtc_lsh_obd_down_1_1 "C_DTC_LSH_OBD_DOWN_1_1" VALUE 0x7031a a_85 100 LINEAR______0_000000__0H___65535 0.0 65535.0 BIT_MASK 0xffffffff /end CHARACTERISTIC
/begin CHARACTERISTIC c_dtc_lsh_obd_down_1_2 "C_DTC_LSH_OBD_DOWN_1_2" VALUE 0x7031c a_85 100 LINEAR______0_000000__0H___65535 0.0 65535.0 BIT_MASK 0xffffffff /end CHARACTERISTIC
/begin CHARACTERISTIC c_dtc_lsh_obd_down_1_3 "C_DTC_LSH_OBD_DOWN_1_3" VALUE 0x7031e a_85 100 LINEAR______0_000000__0H___65535 0.0 65535.0 BIT_MASK 0xffffffff /end CHARACTERISTIC
/begin CHARACTERISTIC c_dtc_lsh_obd_down_2_0 "C_DTC_LSH_OBD_DOWN_2_0" VALUE 0x70320 a_85 100 LINEAR______0_000000__0H___65535 0.0 65535.0 BIT_MASK 0xffffffff /end CHARACTERISTIC
/begin CHARACTERISTIC c_dtc_lsh_obd_down_2_1 "C_DTC_LSH_OBD_DOWN_2_1" VALUE 0x70322 a_85 100 LINEAR______0_000000__0H___65535 0.0 65535.0 BIT_MASK 0xffffffff /end CHARACTERISTIC
/begin CHARACTERISTIC c_dtc_lsh_obd_down_2_2 "C_DTC_LSH_OBD_DOWN_2_2" VALUE 0x70324 a_85 100 LINEAR______0_000000__0H___65535 0.0 65535.0 BIT_MASK 0xffffffff /end CHARACTERISTIC
/begin CHARACTERISTIC c_dtc_lsh_obd_down_2_3 "C_DTC_LSH_OBD_DOWN_2_3" VALUE 0x70326 a_85 100 LINEAR______0_000000__0H___65535 0.0 65535.0 BIT_MASK 0xffffffff /end CHARACTERISTIC
/begin CHARACTERISTIC c_dtc_lsh_obd_up_1_0 "C_DTC_LSH_OBD_UP_1_0" VALUE 0x70328 a_85 100 LINEAR______0_000000__0H___65535 0.0 65535.0 BIT_MASK 0xffffffff /end CHARACTERISTIC
/begin CHARACTERISTIC c_dtc_lsh_obd_up_1_1 "C_DTC_LSH_OBD_UP_1_1" VALUE 0x7032a a_85 100 LINEAR______0_000000__0H___65535 0.0 65535.0 BIT_MASK 0xffffffff /end CHARACTERISTIC
/begin CHARACTERISTIC c_dtc_lsh_obd_up_1_2 "C_DTC_LSH_OBD_UP_1_2" VALUE 0x7032c a_85 100 LINEAR______0_000000__0H___65535 0.0 65535.0 BIT_MASK 0xffffffff /end CHARACTERISTIC
/begin CHARACTERISTIC c_dtc_lsh_obd_up_1_3 "C_DTC_LSH_OBD_UP_1_3" VALUE 0x7032e a_85 100 LINEAR______0_000000__0H___65535 0.0 65535.0 BIT_MASK 0xffffffff /end CHARACTERISTIC
/begin CHARACTERISTIC c_dtc_lsh_obd_up_2_0 "C_DTC_LSH_OBD_UP_2_0" VALUE 0x70330 a_85 100 LINEAR______0_000000__0H___65535 0.0 65535.0 BIT_MASK 0xffffffff /end CHARACTERISTIC
/begin CHARACTERISTIC c_dtc_lsh_obd_up_2_1 "C_DTC_LSH_OBD_UP_2_1" VALUE 0x70332 a_85 100 LINEAR______0_000000__0H___65535 0.0 65535.0 BIT_MASK 0xffffffff /end CHARACTERISTIC
/begin CHARACTERISTIC c_dtc_lsh_obd_up_2_2 "C_DTC_LSH_OBD_UP_2_2" VALUE 0x70334 a_85 100 LINEAR______0_000000__0H___65535 0.0 65535.0 BIT_MASK 0xffffffff /end CHARACTERISTIC
/begin CHARACTERISTIC c_dtc_lsh_obd_up_2_3 "C_DTC_LSH_OBD_UP_2_3" VALUE 0x70336 a_85 100 LINEAR______0_000000__0H___65535 0.0 65535.0 BIT_MASK 0xffffffff /end CHARACTERISTIC
/begin CHARACTERISTIC c_dtc_lsh_up_1_0 "C_DTC_LSH_UP_1_0" VALUE 0x70338 a_85 100 LINEAR______0_000000__0H___65535 0.0 65535.0 BIT_MASK 0xffffffff /end CHARACTERISTIC
/begin CHARACTERISTIC c_dtc_lsh_up_1_1 "C_DTC_LSH_UP_1_1" VALUE 0x7033a a_85 100 LINEAR______0_000000__0H___65535 0.0 65535.0 BIT_MASK 0xffffffff /end CHARACTERISTIC
/begin CHARACTERISTIC c_dtc_lsh_up_1_2 "C_DTC_LSH_UP_1_2" VALUE 0x7033c a_85 100 LINEAR______0_000000__0H___65535 0.0 65535.0 BIT_MASK 0xffffffff /end CHARACTERISTIC
/begin CHARACTERISTIC c_dtc_lsh_up_1_3 "C_DTC_LSH_UP_1_3" VALUE 0x7033e a_85 100 LINEAR______0_000000__0H___65535 0.0 65535.0 BIT_MASK 0xffffffff /end CHARACTERISTIC
/begin CHARACTERISTIC c_dtc_lsh_up_2_0 "C_DTC_LSH_UP_2_0" VALUE 0x70340 a_85 100 LINEAR______0_000000__0H___65535 0.0 65535.0 BIT_MASK 0xffffffff /end CHARACTERISTIC
/begin CHARACTERISTIC c_dtc_lsh_up_2_1 "C_DTC_LSH_UP_2_1" VALUE 0x70342 a_85 100 LINEAR______0_000000__0H___65535 0.0 65535.0 BIT_MASK 0xffffffff /end CHARACTERISTIC
/begin CHARACTERISTIC c_dtc_lsh_up_2_2 "C_DTC_LSH_UP_2_2" VALUE 0x70344 a_85 100 LINEAR______0_000000__0H___65535 0.0 65535.0 BIT_MASK 0xffffffff /end CHARACTERISTIC
/begin CHARACTERISTIC c_dtc_lsh_up_2_3 "C_DTC_LSH_UP_2_3" VALUE 0x70346 a_85 100 LINEAR______0_000000__0H___65535 0.0 65535.0 BIT_MASK 0xffffffff /end CHARACTERISTIC
/begin CHARACTERISTIC c_dtc_maf_0 "C_DTC_MAF_0" VALUE 0x70348 a_85 100 LINEAR______0_000000__0H___65535 0.0 65535.0 BIT_MASK 0xffffffff /end CHARACTERISTIC
/begin CHARACTERISTIC c_dtc_maf_1 "C_DTC_MAF_1" VALUE 0x7034a a_85 100 LINEAR______0_000000__0H___65535 0.0 65535.0 BIT_MASK 0xffffffff /end CHARACTERISTIC
/begin CHARACTERISTIC c_dtc_maf_2 "C_DTC_MAF_2" VALUE 0x7034c a_85 100 LINEAR______0_000000__0H___65535 0.0 65535.0 BIT_MASK 0xffffffff /end CHARACTERISTIC
/begin CHARACTERISTIC c_dtc_maf_3 "C_DTC_MAF_3" VALUE 0x7034e a_85 100 LINEAR______0_000000__0H___65535 0.0 65535.0 BIT_MASK 0xffffffff /end CHARACTERISTIC
/begin CHARACTERISTIC c_dtc_maf_mafm_0 "C_DTC_MAF_MAFM_0" VALUE 0x70350 a_85 100 LINEAR______0_000000__0H___65535 0.0 65535.0 BIT_MASK 0xffffffff /end CHARACTERISTIC
/begin CHARACTERISTIC c_dtc_maf_mafm_1 "C_DTC_MAF_MAFM_1" VALUE 0x70352 a_85 100 LINEAR______0_000000__0H___65535 0.0 65535.0 BIT_MASK 0xffffffff /end CHARACTERISTIC
/begin CHARACTERISTIC c_dtc_maf_mafm_2 "C_DTC_MAF_MAFM_2" VALUE 0x70354 a_85 100 LINEAR______0_000000__0H___65535 0.0 65535.0 BIT_MASK 0xffffffff /end CHARACTERISTIC
/begin CHARACTERISTIC c_dtc_maf_mafm_3 "C_DTC_MAF_MAFM_3" VALUE 0x70356 a_85 100 LINEAR______0_000000__0H___65535 0.0 65535.0 BIT_MASK 0xffffffff /end CHARACTERISTIC
/begin CHARACTERISTIC c_dtc_mec_isa_0 "C_DTC_MEC_ISA_0" VALUE 0x70358 a_85 100 LINEAR______0_000000__0H___65535 0.0 65535.0 BIT_MASK 0xffffffff /end CHARACTERISTIC
/begin CHARACTERISTIC c_dtc_mec_isa_1 "C_DTC_MEC_ISA_1" VALUE 0x7035a a_85 100 LINEAR______0_000000__0H___65535 0.0 65535.0 BIT_MASK 0xffffffff /end CHARACTERISTIC
/begin CHARACTERISTIC c_dtc_mec_isa_2 "C_DTC_MEC_ISA_2" VALUE 0x7035c a_85 100 LINEAR______0_000000__0H___65535 0.0 65535.0 BIT_MASK 0xffffffff /end CHARACTERISTIC
/begin CHARACTERISTIC c_dtc_mec_isa_3 "C_DTC_MEC_ISA_3" VALUE 0x7035e a_85 100 LINEAR______0_000000__0H___65535 0.0 65535.0 BIT_MASK 0xffffffff /end CHARACTERISTIC
/begin CHARACTERISTIC c_dtc_mec_ivvt_ex_0 "C_DTC_MEC_IVVT_EX_0" VALUE 0x70360 a_85 100 LINEAR______0_000000__0H___65535 0.0 65535.0 BIT_MASK 0xffffffff /end CHARACTERISTIC
/begin CHARACTERISTIC c_dtc_mec_ivvt_ex_1 "C_DTC_MEC_IVVT_EX_1" VALUE 0x70362 a_85 100 LINEAR______0_000000__0H___65535 0.0 65535.0 BIT_MASK 0xffffffff /end CHARACTERISTIC
/begin CHARACTERISTIC c_dtc_mec_ivvt_ex_2 "C_DTC_MEC_IVVT_EX_2" VALUE 0x70364 a_85 100 LINEAR______0_000000__0H___65535 0.0 65535.0 BIT_MASK 0xffffffff /end CHARACTERISTIC
/begin CHARACTERISTIC c_dtc_mec_ivvt_ex_3 "C_DTC_MEC_IVVT_EX_3" VALUE 0x70366 a_85 100 LINEAR______0_000000__0H___65535 0.0 65535.0 BIT_MASK 0xffffffff /end CHARACTERISTIC
/begin CHARACTERISTIC c_dtc_mec_ivvt_in_0 "C_DTC_MEC_IVVT_IN_0" VALUE 0x70368 a_85 100 LINEAR______0_000000__0H___65535 0.0 65535.0 BIT_MASK 0xffffffff /end CHARACTERISTIC
/begin CHARACTERISTIC c_dtc_mec_ivvt_in_1 "C_DTC_MEC_IVVT_IN_1" VALUE 0x7036a a_85 100 LINEAR______0_000000__0H___65535 0.0 65535.0 BIT_MASK 0xffffffff /end CHARACTERISTIC
/begin CHARACTERISTIC c_dtc_mec_ivvt_in_2 "C_DTC_MEC_IVVT_IN_2" VALUE 0x7036c a_85 100 LINEAR______0_000000__0H___65535 0.0 65535.0 BIT_MASK 0xffffffff /end CHARACTERISTIC
/begin CHARACTERISTIC c_dtc_mec_ivvt_in_3 "C_DTC_MEC_IVVT_IN_3" VALUE 0x7036e a_85 100 LINEAR______0_000000__0H___65535 0.0 65535.0 BIT_MASK 0xffffffff /end CHARACTERISTIC
/begin CHARACTERISTIC c_dtc_mec_sav_0 "C_DTC_MEC_SAV_0" VALUE 0x70370 a_85 100 LINEAR______0_000000__0H___65535 0.0 65535.0 BIT_MASK 0xffffffff /end CHARACTERISTIC
/begin CHARACTERISTIC c_dtc_mec_sav_1 "C_DTC_MEC_SAV_1" VALUE 0x70372 a_85 100 LINEAR______0_000000__0H___65535 0.0 65535.0 BIT_MASK 0xffffffff /end CHARACTERISTIC
/begin CHARACTERISTIC c_dtc_mec_sav_2 "C_DTC_MEC_SAV_2" VALUE 0x70374 a_85 100 LINEAR______0_000000__0H___65535 0.0 65535.0 BIT_MASK 0xffffffff /end CHARACTERISTIC
/begin CHARACTERISTIC c_dtc_mec_sav_3 "C_DTC_MEC_SAV_3" VALUE 0x70376 a_85 100 LINEAR______0_000000__0H___65535 0.0 65535.0 BIT_MASK 0xffffffff /end CHARACTERISTIC
/begin CHARACTERISTIC c_dtc_min_saf_0 "C_DTC_MIN_SAF_0" VALUE 0x70378 a_85 100 LINEAR______0_000000__0H___65535 0.0 65535.0 BIT_MASK 0xffffffff /end CHARACTERISTIC
/begin CHARACTERISTIC c_dtc_min_saf_1 "C_DTC_MIN_SAF_1" VALUE 0x7037a a_85 100 LINEAR______0_000000__0H___65535 0.0 65535.0 BIT_MASK 0xffffffff /end CHARACTERISTIC
/begin CHARACTERISTIC c_dtc_min_saf_2 "C_DTC_MIN_SAF_2" VALUE 0x7037c a_85 100 LINEAR______0_000000__0H___65535 0.0 65535.0 BIT_MASK 0xffffffff /end CHARACTERISTIC
/begin CHARACTERISTIC c_dtc_min_saf_3 "C_DTC_MIN_SAF_3" VALUE 0x7037e a_85 100 LINEAR______0_000000__0H___65535 0.0 65535.0 BIT_MASK 0xffffffff /end CHARACTERISTIC
/begin CHARACTERISTIC c_dtc_mis_0_0 "C_DTC_MIS_0_0" VALUE 0x70380 a_85 100 LINEAR______0_000000__0H___65535 0.0 65535.0 BIT_MASK 0xffffffff /end CHARACTERISTIC
/begin CHARACTERISTIC c_dtc_mis_0_1 "C_DTC_MIS_0_1" VALUE 0x70382 a_85 100 LINEAR______0_000000__0H___65535 0.0 65535.0 BIT_MASK 0xffffffff /end CHARACTERISTIC
/begin CHARACTERISTIC c_dtc_mis_0_2 "C_DTC_MIS_0_2" VALUE 0x70384 a_85 100 LINEAR______0_000000__0H___65535 0.0 65535.0 BIT_MASK 0xffffffff /end CHARACTERISTIC
/begin CHARACTERISTIC c_dtc_mis_0_3 "C_DTC_MIS_0_3" VALUE 0x70386 a_85 100 LINEAR______0_000000__0H___65535 0.0 65535.0 BIT_MASK 0xffffffff /end CHARACTERISTIC
/begin CHARACTERISTIC c_dtc_mis_1_0 "C_DTC_MIS_1_0" VALUE 0x70388 a_85 100 LINEAR______0_000000__0H___65535 0.0 65535.0 BIT_MASK 0xffffffff /end CHARACTERISTIC
/begin CHARACTERISTIC c_dtc_mis_1_1 "C_DTC_MIS_1_1" VALUE 0x7038a a_85 100 LINEAR______0_000000__0H___65535 0.0 65535.0 BIT_MASK 0xffffffff /end CHARACTERISTIC
/begin CHARACTERISTIC c_dtc_mis_1_2 "C_DTC_MIS_1_2" VALUE 0x7038c a_85 100 LINEAR______0_000000__0H___65535 0.0 65535.0 BIT_MASK 0xffffffff /end CHARACTERISTIC
/begin CHARACTERISTIC c_dtc_mis_1_3 "C_DTC_MIS_1_3" VALUE 0x7038e a_85 100 LINEAR______0_000000__0H___65535 0.0 65535.0 BIT_MASK 0xffffffff /end CHARACTERISTIC
/begin CHARACTERISTIC c_dtc_mis_2_0 "C_DTC_MIS_2_0" VALUE 0x70390 a_85 100 LINEAR______0_000000__0H___65535 0.0 65535.0 BIT_MASK 0xffffffff /end CHARACTERISTIC
/begin CHARACTERISTIC c_dtc_mis_2_1 "C_DTC_MIS_2_1" VALUE 0x70392 a_85 100 LINEAR______0_000000__0H___65535 0.0 65535.0 BIT_MASK 0xffffffff /end CHARACTERISTIC
/begin CHARACTERISTIC c_dtc_mis_2_2 "C_DTC_MIS_2_2" VALUE 0x70394 a_85 100 LINEAR______0_000000__0H___65535 0.0 65535.0 BIT_MASK 0xffffffff /end CHARACTERISTIC
/begin CHARACTERISTIC c_dtc_mis_2_3 "C_DTC_MIS_2_3" VALUE 0x70396 a_85 100 LINEAR______0_000000__0H___65535 0.0 65535.0 BIT_MASK 0xffffffff /end CHARACTERISTIC
/begin CHARACTERISTIC c_dtc_mis_3_0 "C_DTC_MIS_3_0" VALUE 0x70398 a_85 100 LINEAR______0_000000__0H___65535 0.0 65535.0 BIT_MASK 0xffffffff /end CHARACTERISTIC
/begin CHARACTERISTIC c_dtc_mis_3_1 "C_DTC_MIS_3_1" VALUE 0x7039a a_85 100 LINEAR______0_000000__0H___65535 0.0 65535.0 BIT_MASK 0xffffffff /end CHARACTERISTIC
/begin CHARACTERISTIC c_dtc_mis_3_2 "C_DTC_MIS_3_2" VALUE 0x7039c a_85 100 LINEAR______0_000000__0H___65535 0.0 65535.0 BIT_MASK 0xffffffff /end CHARACTERISTIC
/begin CHARACTERISTIC c_dtc_mis_3_3 "C_DTC_MIS_3_3" VALUE 0x7039e a_85 100 LINEAR______0_000000__0H___65535 0.0 65535.0 BIT_MASK 0xffffffff /end CHARACTERISTIC
/begin CHARACTERISTIC c_dtc_mis_4_0 "C_DTC_MIS_4_0" VALUE 0x703a0 a_85 100 LINEAR______0_000000__0H___65535 0.0 65535.0 BIT_MASK 0xffffffff /end CHARACTERISTIC
/begin CHARACTERISTIC c_dtc_mis_4_1 "C_DTC_MIS_4_1" VALUE 0x703a2 a_85 100 LINEAR______0_000000__0H___65535 0.0 65535.0 BIT_MASK 0xffffffff /end CHARACTERISTIC
/begin CHARACTERISTIC c_dtc_mis_4_2 "C_DTC_MIS_4_2" VALUE 0x703a4 a_85 100 LINEAR______0_000000__0H___65535 0.0 65535.0 BIT_MASK 0xffffffff /end CHARACTERISTIC
/begin CHARACTERISTIC c_dtc_mis_4_3 "C_DTC_MIS_4_3" VALUE 0x703a6 a_85 100 LINEAR______0_000000__0H___65535 0.0 65535.0 BIT_MASK 0xffffffff /end CHARACTERISTIC
/begin CHARACTERISTIC c_dtc_mis_5_0 "C_DTC_MIS_5_0" VALUE 0x703a8 a_85 100 LINEAR______0_000000__0H___65535 0.0 65535.0 BIT_MASK 0xffffffff /end CHARACTERISTIC
/begin CHARACTERISTIC c_dtc_mis_5_1 "C_DTC_MIS_5_1" VALUE 0x703aa a_85 100 LINEAR______0_000000__0H___65535 0.0 65535.0 BIT_MASK 0xffffffff /end CHARACTERISTIC
/begin CHARACTERISTIC c_dtc_mis_5_2 "C_DTC_MIS_5_2" VALUE 0x703ac a_85 100 LINEAR______0_000000__0H___65535 0.0 65535.0 BIT_MASK 0xffffffff /end CHARACTERISTIC
/begin CHARACTERISTIC c_dtc_mis_5_3 "C_DTC_MIS_5_3" VALUE 0x703ae a_85 100 LINEAR______0_000000__0H___65535 0.0 65535.0 BIT_MASK 0xffffffff /end CHARACTERISTIC
/begin CHARACTERISTIC c_dtc_mis_frs "C_DTC_MIS_FRS" VALUE 0x703b0 a_85 100 LINEAR______0_000000__0H___65535 0.0 65535.0 BIT_MASK 0xffffffff /end CHARACTERISTIC
/begin CHARACTERISTIC c_dtc_mis_multi "C_DTC_MIS_MULTI" VALUE 0x703b2 a_85 100 LINEAR______0_000000__0H___65535 0.0 65535.0 BIT_MASK 0xffffffff /end CHARACTERISTIC
/begin CHARACTERISTIC c_dtc_mis_t_seg "C_DTC_MIS_T_SEG" VALUE 0x703b4 a_85 100 LINEAR______0_000000__0H___65535 0.0 65535.0 BIT_MASK 0xffffffff /end CHARACTERISTIC
/begin CHARACTERISTIC c_dtc_mon_plaus_0 "C_DTC_MON_PLAUS_0" VALUE 0x703b6 a_85 100 LINEAR______0_000000__0H___65535 0.0 65535.0 BIT_MASK 0xffffffff /end CHARACTERISTIC
/begin CHARACTERISTIC c_dtc_mon_plaus_1 "C_DTC_MON_PLAUS_1" VALUE 0x703b8 a_85 100 LINEAR______0_000000__0H___65535 0.0 65535.0 BIT_MASK 0xffffffff /end CHARACTERISTIC
/begin CHARACTERISTIC c_dtc_mon_plaus_2 "C_DTC_MON_PLAUS_2" VALUE 0x703ba a_85 100 LINEAR______0_000000__0H___65535 0.0 65535.0 BIT_MASK 0xffffffff /end CHARACTERISTIC
/begin CHARACTERISTIC c_dtc_mon_plaus_3 "C_DTC_MON_PLAUS_3" VALUE 0x703bc a_85 100 LINEAR______0_000000__0H___65535 0.0 65535.0 BIT_MASK 0xffffffff /end CHARACTERISTIC
/begin CHARACTERISTIC c_dtc_mon_tqi_av_0 "C_DTC_MON_TQI_AV_0" VALUE 0x703be a_85 100 LINEAR______0_000000__0H___65535 0.0 65535.0 BIT_MASK 0xffffffff /end CHARACTERISTIC
/begin CHARACTERISTIC c_dtc_mon_tqi_av_1 "C_DTC_MON_TQI_AV_1" VALUE 0x703c0 a_85 100 LINEAR______0_000000__0H___65535 0.0 65535.0 BIT_MASK 0xffffffff /end CHARACTERISTIC
/begin CHARACTERISTIC c_dtc_mon_tqi_av_2 "C_DTC_MON_TQI_AV_2" VALUE 0x703c2 a_85 100 LINEAR______0_000000__0H___65535 0.0 65535.0 BIT_MASK 0xffffffff /end CHARACTERISTIC
/begin CHARACTERISTIC c_dtc_mon_tqi_av_3 "C_DTC_MON_TQI_AV_3" VALUE 0x703c4 a_85 100 LINEAR______0_000000__0H___65535 0.0 65535.0 BIT_MASK 0xffffffff /end CHARACTERISTIC
/begin CHARACTERISTIC c_dtc_mon_tqi_n_max_0 "C_DTC_MON_TQI_N_MAX_0" VALUE 0x703c6 a_85 100 LINEAR______0_000000__0H___65535 0.0 65535.0 BIT_MASK 0xffffffff /end CHARACTERISTIC
/begin CHARACTERISTIC c_dtc_mon_tqi_n_max_1 "C_DTC_MON_TQI_N_MAX_1" VALUE 0x703c8 a_85 100 LINEAR______0_000000__0H___65535 0.0 65535.0 BIT_MASK 0xffffffff /end CHARACTERISTIC
/begin CHARACTERISTIC c_dtc_mon_tqi_n_max_2 "C_DTC_MON_TQI_N_MAX_2" VALUE 0x703ca a_85 100 LINEAR______0_000000__0H___65535 0.0 65535.0 BIT_MASK 0xffffffff /end CHARACTERISTIC
/begin CHARACTERISTIC c_dtc_mon_tqi_n_max_3 "C_DTC_MON_TQI_N_MAX_3" VALUE 0x703cc a_85 100 LINEAR______0_000000__0H___65535 0.0 65535.0 BIT_MASK 0xffffffff /end CHARACTERISTIC
/begin CHARACTERISTIC c_dtc_msw_2_0 "C_DTC_MSW_2_0" VALUE 0x703ce a_85 100 LINEAR______0_000000__0H___65535 0.0 65535.0 BIT_MASK 0xffffffff /end CHARACTERISTIC
/begin CHARACTERISTIC c_dtc_msw_2_1 "C_DTC_MSW_2_1" VALUE 0x703d0 a_85 100 LINEAR______0_000000__0H___65535 0.0 65535.0 BIT_MASK 0xffffffff /end CHARACTERISTIC
/begin CHARACTERISTIC c_dtc_msw_2_2 "C_DTC_MSW_2_2" VALUE 0x703d2 a_85 100 LINEAR______0_000000__0H___65535 0.0 65535.0 BIT_MASK 0xffffffff /end CHARACTERISTIC
/begin CHARACTERISTIC c_dtc_msw_2_3 "C_DTC_MSW_2_3" VALUE 0x703d4 a_85 100 LINEAR______0_000000__0H___65535 0.0 65535.0 BIT_MASK 0xffffffff /end CHARACTERISTIC
/begin CHARACTERISTIC c_dtc_msw_3_0 "C_DTC_MSW_3_0" VALUE 0x703d6 a_85 100 LINEAR______0_000000__0H___65535 0.0 65535.0 BIT_MASK 0xffffffff /end CHARACTERISTIC
/begin CHARACTERISTIC c_dtc_msw_3_1 "C_DTC_MSW_3_1" VALUE 0x703d8 a_85 100 LINEAR______0_000000__0H___65535 0.0 65535.0 BIT_MASK 0xffffffff /end CHARACTERISTIC
/begin CHARACTERISTIC c_dtc_msw_3_2 "C_DTC_MSW_3_2" VALUE 0x703da a_85 100 LINEAR______0_000000__0H___65535 0.0 65535.0 BIT_MASK 0xffffffff /end CHARACTERISTIC
/begin CHARACTERISTIC c_dtc_msw_3_3 "C_DTC_MSW_3_3" VALUE 0x703dc a_85 100 LINEAR______0_000000__0H___65535 0.0 65535.0 BIT_MASK 0xffffffff /end CHARACTERISTIC
/begin CHARACTERISTIC c_dtc_msw_tog_0 "C_DTC_MSW_TOG_0" VALUE 0x703de a_85 100 LINEAR______0_000000__0H___65535 0.0 65535.0 BIT_MASK 0xffffffff /end CHARACTERISTIC
/begin CHARACTERISTIC c_dtc_msw_tog_1 "C_DTC_MSW_TOG_1" VALUE 0x703e0 a_85 100 LINEAR______0_000000__0H___65535 0.0 65535.0 BIT_MASK 0xffffffff /end CHARACTERISTIC
/begin CHARACTERISTIC c_dtc_msw_tog_2 "C_DTC_MSW_TOG_2" VALUE 0x703e2 a_85 100 LINEAR______0_000000__0H___65535 0.0 65535.0 BIT_MASK 0xffffffff /end CHARACTERISTIC
/begin CHARACTERISTIC c_dtc_msw_tog_3 "C_DTC_MSW_TOG_3" VALUE 0x703e4 a_85 100 LINEAR______0_000000__0H___65535 0.0 65535.0 BIT_MASK 0xffffffff /end CHARACTERISTIC
/begin CHARACTERISTIC c_dtc_mtc_ctl_1_0 "C_DTC_MTC_CTL_1_0" VALUE 0x703e6 a_85 100 LINEAR______0_000000__0H___65535 0.0 65535.0 BIT_MASK 0xffffffff /end CHARACTERISTIC
/begin CHARACTERISTIC c_dtc_mtc_ctl_1_1 "C_DTC_MTC_CTL_1_1" VALUE 0x703e8 a_85 100 LINEAR______0_000000__0H___65535 0.0 65535.0 BIT_MASK 0xffffffff /end CHARACTERISTIC
/begin CHARACTERISTIC c_dtc_mtc_ctl_1_2 "C_DTC_MTC_CTL_1_2" VALUE 0x703ea a_85 100 LINEAR______0_000000__0H___65535 0.0 65535.0 BIT_MASK 0xffffffff /end CHARACTERISTIC
/begin CHARACTERISTIC c_dtc_mtc_ctl_1_3 "C_DTC_MTC_CTL_1_3" VALUE 0x703ec a_85 100 LINEAR______0_000000__0H___65535 0.0 65535.0 BIT_MASK 0xffffffff /end CHARACTERISTIC
/begin CHARACTERISTIC c_dtc_mtc_ctl_2_0 "C_DTC_MTC_CTL_2_0" VALUE 0x703ee a_85 100 LINEAR______0_000000__0H___65535 0.0 65535.0 BIT_MASK 0xffffffff /end CHARACTERISTIC
/begin CHARACTERISTIC c_dtc_mtc_ctl_2_1 "C_DTC_MTC_CTL_2_1" VALUE 0x703f0 a_85 100 LINEAR______0_000000__0H___65535 0.0 65535.0 BIT_MASK 0xffffffff /end CHARACTERISTIC
/begin CHARACTERISTIC c_dtc_mtc_ctl_2_2 "C_DTC_MTC_CTL_2_2" VALUE 0x703f2 a_85 100 LINEAR______0_000000__0H___65535 0.0 65535.0 BIT_MASK 0xffffffff /end CHARACTERISTIC
/begin CHARACTERISTIC c_dtc_mtc_ctl_2_3 "C_DTC_MTC_CTL_2_3" VALUE 0x703f4 a_85 100 LINEAR______0_000000__0H___65535 0.0 65535.0 BIT_MASK 0xffffffff /end CHARACTERISTIC
/begin CHARACTERISTIC c_dtc_mtc_ctl_3_0 "C_DTC_MTC_CTL_3_0" VALUE 0x703f6 a_85 100 LINEAR______0_000000__0H___65535 0.0 65535.0 BIT_MASK 0xffffffff /end CHARACTERISTIC
/begin CHARACTERISTIC c_dtc_mtc_ctl_3_1 "C_DTC_MTC_CTL_3_1" VALUE 0x703f8 a_85 100 LINEAR______0_000000__0H___65535 0.0 65535.0 BIT_MASK 0xffffffff /end CHARACTERISTIC
/begin CHARACTERISTIC c_dtc_mtc_ctl_3_2 "C_DTC_MTC_CTL_3_2" VALUE 0x703fa a_85 100 LINEAR______0_000000__0H___65535 0.0 65535.0 BIT_MASK 0xffffffff /end CHARACTERISTIC
/begin CHARACTERISTIC c_dtc_mtc_ctl_3_3 "C_DTC_MTC_CTL_3_3" VALUE 0x703fc a_85 100 LINEAR______0_000000__0H___65535 0.0 65535.0 BIT_MASK 0xffffffff /end CHARACTERISTIC
/begin CHARACTERISTIC c_dtc_mtc_dr_0 "C_DTC_MTC_DR_0" VALUE 0x703fe a_85 100 LINEAR______0_000000__0H___65535 0.0 65535.0 BIT_MASK 0xffffffff /end CHARACTERISTIC
/begin CHARACTERISTIC c_dtc_mtc_dr_1 "C_DTC_MTC_DR_1" VALUE 0x70400 a_85 100 LINEAR______0_000000__0H___65535 0.0 65535.0 BIT_MASK 0xffffffff /end CHARACTERISTIC
/begin CHARACTERISTIC c_dtc_mtc_dr_2 "C_DTC_MTC_DR_2" VALUE 0x70402 a_85 100 LINEAR______0_000000__0H___65535 0.0 65535.0 BIT_MASK 0xffffffff /end CHARACTERISTIC
/begin CHARACTERISTIC c_dtc_mtc_dr_3 "C_DTC_MTC_DR_3" VALUE 0x70404 a_85 100 LINEAR______0_000000__0H___65535 0.0 65535.0 BIT_MASK 0xffffffff /end CHARACTERISTIC
/begin CHARACTERISTIC c_dtc_otcc_0 "C_DTC_OTCC_0" VALUE 0x70406 a_85 100 LINEAR______0_000000__0H___65535 0.0 65535.0 BIT_MASK 0xffffffff /end CHARACTERISTIC
/begin CHARACTERISTIC c_dtc_otcc_1 "C_DTC_OTCC_1" VALUE 0x70408 a_85 100 LINEAR______0_000000__0H___65535 0.0 65535.0 BIT_MASK 0xffffffff /end CHARACTERISTIC
/begin CHARACTERISTIC c_dtc_otcc_2 "C_DTC_OTCC_2" VALUE 0x7040a a_85 100 LINEAR______0_000000__0H___65535 0.0 65535.0 BIT_MASK 0xffffffff /end CHARACTERISTIC
/begin CHARACTERISTIC c_dtc_otcc_3 "C_DTC_OTCC_3" VALUE 0x7040c a_85 100 LINEAR______0_000000__0H___65535 0.0 65535.0 BIT_MASK 0xffffffff /end CHARACTERISTIC
/begin CHARACTERISTIC c_dtc_pvs_1_0 "C_DTC_PVS_1_0" VALUE 0x7040e a_85 100 LINEAR______0_000000__0H___65535 0.0 65535.0 BIT_MASK 0xffffffff /end CHARACTERISTIC
/begin CHARACTERISTIC c_dtc_pvs_1_1 "C_DTC_PVS_1_1" VALUE 0x70410 a_85 100 LINEAR______0_000000__0H___65535 0.0 65535.0 BIT_MASK 0xffffffff /end CHARACTERISTIC
/begin CHARACTERISTIC c_dtc_pvs_1_2 "C_DTC_PVS_1_2" VALUE 0x70412 a_85 100 LINEAR______0_000000__0H___65535 0.0 65535.0 BIT_MASK 0xffffffff /end CHARACTERISTIC
/begin CHARACTERISTIC c_dtc_pvs_1_3 "C_DTC_PVS_1_3" VALUE 0x70414 a_85 100 LINEAR______0_000000__0H___65535 0.0 65535.0 BIT_MASK 0xffffffff /end CHARACTERISTIC
/begin CHARACTERISTIC c_dtc_pvs_2_0 "C_DTC_PVS_2_0" VALUE 0x70416 a_85 100 LINEAR______0_000000__0H___65535 0.0 65535.0 BIT_MASK 0xffffffff /end CHARACTERISTIC
/begin CHARACTERISTIC c_dtc_pvs_2_1 "C_DTC_PVS_2_1" VALUE 0x70418 a_85 100 LINEAR______0_000000__0H___65535 0.0 65535.0 BIT_MASK 0xffffffff /end CHARACTERISTIC
/begin CHARACTERISTIC c_dtc_pvs_2_2 "C_DTC_PVS_2_2" VALUE 0x7041a a_85 100 LINEAR______0_000000__0H___65535 0.0 65535.0 BIT_MASK 0xffffffff /end CHARACTERISTIC
/begin CHARACTERISTIC c_dtc_pvs_2_3 "C_DTC_PVS_2_3" VALUE 0x7041c a_85 100 LINEAR______0_000000__0H___65535 0.0 65535.0 BIT_MASK 0xffffffff /end CHARACTERISTIC
/begin CHARACTERISTIC c_dtc_pvs_bls_0 "C_DTC_PVS_BLS_0" VALUE 0x7041e a_85 100 LINEAR______0_000000__0H___65535 0.0 65535.0 BIT_MASK 0xffffffff /end CHARACTERISTIC
/begin CHARACTERISTIC c_dtc_pvs_bls_1 "C_DTC_PVS_BLS_1" VALUE 0x70420 a_85 100 LINEAR______0_000000__0H___65535 0.0 65535.0 BIT_MASK 0xffffffff /end CHARACTERISTIC
/begin CHARACTERISTIC c_dtc_pvs_bls_2 "C_DTC_PVS_BLS_2" VALUE 0x70422 a_85 100 LINEAR______0_000000__0H___65535 0.0 65535.0 BIT_MASK 0xffffffff /end CHARACTERISTIC
/begin CHARACTERISTIC c_dtc_pvs_bls_3 "C_DTC_PVS_BLS_3" VALUE 0x70424 a_85 100 LINEAR______0_000000__0H___65535 0.0 65535.0 BIT_MASK 0xffffffff /end CHARACTERISTIC
/begin CHARACTERISTIC c_dtc_pvs_bls_bts_plaus_0 "C_DTC_PVS_BLS_BTS_PLAUS_0" VALUE 0x70426 a_85 100 LINEAR______0_000000__0H___65535 0.0 65535.0 BIT_MASK 0xffffffff /end CHARACTERISTIC
/begin CHARACTERISTIC c_dtc_pvs_bls_bts_plaus_1 "C_DTC_PVS_BLS_BTS_PLAUS_1" VALUE 0x70428 a_85 100 LINEAR______0_000000__0H___65535 0.0 65535.0 BIT_MASK 0xffffffff /end CHARACTERISTIC
/begin CHARACTERISTIC c_dtc_pvs_bls_bts_plaus_2 "C_DTC_PVS_BLS_BTS_PLAUS_2" VALUE 0x7042a a_85 100 LINEAR______0_000000__0H___65535 0.0 65535.0 BIT_MASK 0xffffffff /end CHARACTERISTIC
/begin CHARACTERISTIC c_dtc_pvs_bls_bts_plaus_3 "C_DTC_PVS_BLS_BTS_PLAUS_3" VALUE 0x7042c a_85 100 LINEAR______0_000000__0H___65535 0.0 65535.0 BIT_MASK 0xffffffff /end CHARACTERISTIC
/begin CHARACTERISTIC c_dtc_pvs_pvs_0 "C_DTC_PVS_PVS_0" VALUE 0x7042e a_85 100 LINEAR______0_000000__0H___65535 0.0 65535.0 BIT_MASK 0xffffffff /end CHARACTERISTIC
/begin CHARACTERISTIC c_dtc_pvs_pvs_1 "C_DTC_PVS_PVS_1" VALUE 0x70430 a_85 100 LINEAR______0_000000__0H___65535 0.0 65535.0 BIT_MASK 0xffffffff /end CHARACTERISTIC
/begin CHARACTERISTIC c_dtc_pvs_pvs_2 "C_DTC_PVS_PVS_2" VALUE 0x70432 a_85 100 LINEAR______0_000000__0H___65535 0.0 65535.0 BIT_MASK 0xffffffff /end CHARACTERISTIC
/begin CHARACTERISTIC c_dtc_pvs_pvs_3 "C_DTC_PVS_PVS_3" VALUE 0x70434 a_85 100 LINEAR______0_000000__0H___65535 0.0 65535.0 BIT_MASK 0xffffffff /end CHARACTERISTIC
/begin CHARACTERISTIC c_dtc_pvs_ratio_0 "C_DTC_PVS_RATIO_0" VALUE 0x70436 a_85 100 LINEAR______0_000000__0H___65535 0.0 65535.0 BIT_MASK 0xffffffff /end CHARACTERISTIC
/begin CHARACTERISTIC c_dtc_pvs_ratio_1 "C_DTC_PVS_RATIO_1" VALUE 0x70438 a_85 100 LINEAR______0_000000__0H___65535 0.0 65535.0 BIT_MASK 0xffffffff /end CHARACTERISTIC
/begin CHARACTERISTIC c_dtc_pvs_ratio_2 "C_DTC_PVS_RATIO_2" VALUE 0x7043a a_85 100 LINEAR______0_000000__0H___65535 0.0 65535.0 BIT_MASK 0xffffffff /end CHARACTERISTIC
/begin CHARACTERISTIC c_dtc_pvs_ratio_3 "C_DTC_PVS_RATIO_3" VALUE 0x7043c a_85 100 LINEAR______0_000000__0H___65535 0.0 65535.0 BIT_MASK 0xffffffff /end CHARACTERISTIC
/begin CHARACTERISTIC c_dtc_r_igcfb_0 "C_DTC_R_IGCFB_0" VALUE 0x7043e a_85 100 LINEAR______0_000000__0H___65535 0.0 65535.0 BIT_MASK 0xffffffff /end CHARACTERISTIC
/begin CHARACTERISTIC c_dtc_r_igcfb_1 "C_DTC_R_IGCFB_1" VALUE 0x70440 a_85 100 LINEAR______0_000000__0H___65535 0.0 65535.0 BIT_MASK 0xffffffff /end CHARACTERISTIC
/begin CHARACTERISTIC c_dtc_r_igcfb_2 "C_DTC_R_IGCFB_2" VALUE 0x70442 a_85 100 LINEAR______0_000000__0H___65535 0.0 65535.0 BIT_MASK 0xffffffff /end CHARACTERISTIC
/begin CHARACTERISTIC c_dtc_r_igcfb_3 "C_DTC_R_IGCFB_3" VALUE 0x70444 a_85 100 LINEAR______0_000000__0H___65535 0.0 65535.0 BIT_MASK 0xffffffff /end CHARACTERISTIC
/begin CHARACTERISTIC c_dtc_rly_accout_0 "C_DTC_RLY_ACCOUT_0" VALUE 0x70446 a_85 100 LINEAR______0_000000__0H___65535 0.0 65535.0 BIT_MASK 0xffffffff /end CHARACTERISTIC
/begin CHARACTERISTIC c_dtc_rly_accout_1 "C_DTC_RLY_ACCOUT_1" VALUE 0x70448 a_85 100 LINEAR______0_000000__0H___65535 0.0 65535.0 BIT_MASK 0xffffffff /end CHARACTERISTIC
/begin CHARACTERISTIC c_dtc_rly_accout_2 "C_DTC_RLY_ACCOUT_2" VALUE 0x7044a a_85 100 LINEAR______0_000000__0H___65535 0.0 65535.0 BIT_MASK 0xffffffff /end CHARACTERISTIC
/begin CHARACTERISTIC c_dtc_rly_accout_3 "C_DTC_RLY_ACCOUT_3" VALUE 0x7044c a_85 100 LINEAR______0_000000__0H___65535 0.0 65535.0 BIT_MASK 0xffffffff /end CHARACTERISTIC
/begin CHARACTERISTIC c_dtc_rly_efp_0 "C_DTC_RLY_EFP_0" VALUE 0x7044e a_85 100 LINEAR______0_000000__0H___65535 0.0 65535.0 BIT_MASK 0xffffffff /end CHARACTERISTIC
/begin CHARACTERISTIC c_dtc_rly_efp_1 "C_DTC_RLY_EFP_1" VALUE 0x70450 a_85 100 LINEAR______0_000000__0H___65535 0.0 65535.0 BIT_MASK 0xffffffff /end CHARACTERISTIC
/begin CHARACTERISTIC c_dtc_rly_efp_2 "C_DTC_RLY_EFP_2" VALUE 0x70452 a_85 100 LINEAR______0_000000__0H___65535 0.0 65535.0 BIT_MASK 0xffffffff /end CHARACTERISTIC
/begin CHARACTERISTIC c_dtc_rly_efp_3 "C_DTC_RLY_EFP_3" VALUE 0x70454 a_85 100 LINEAR______0_000000__0H___65535 0.0 65535.0 BIT_MASK 0xffffffff /end CHARACTERISTIC
/begin CHARACTERISTIC c_dtc_rly_main_0 "C_DTC_RLY_MAIN_0" VALUE 0x70456 a_85 100 LINEAR______0_000000__0H___65535 0.0 65535.0 BIT_MASK 0xffffffff /end CHARACTERISTIC
/begin CHARACTERISTIC c_dtc_rly_main_1 "C_DTC_RLY_MAIN_1" VALUE 0x70458 a_85 100 LINEAR______0_000000__0H___65535 0.0 65535.0 BIT_MASK 0xffffffff /end CHARACTERISTIC
/begin CHARACTERISTIC c_dtc_rly_main_2 "C_DTC_RLY_MAIN_2" VALUE 0x7045a a_85 100 LINEAR______0_000000__0H___65535 0.0 65535.0 BIT_MASK 0xffffffff /end CHARACTERISTIC
/begin CHARACTERISTIC c_dtc_rly_main_3 "C_DTC_RLY_MAIN_3" VALUE 0x7045c a_85 100 LINEAR______0_000000__0H___65535 0.0 65535.0 BIT_MASK 0xffffffff /end CHARACTERISTIC
/begin CHARACTERISTIC c_dtc_rly_main_dly_0 "C_DTC_RLY_MAIN_DLY_0" VALUE 0x7045e a_85 100 LINEAR______0_000000__0H___65535 0.0 65535.0 BIT_MASK 0xffffffff /end CHARACTERISTIC
/begin CHARACTERISTIC c_dtc_rly_main_dly_1 "C_DTC_RLY_MAIN_DLY_1" VALUE 0x70460 a_85 100 LINEAR______0_000000__0H___65535 0.0 65535.0 BIT_MASK 0xffffffff /end CHARACTERISTIC
/begin CHARACTERISTIC c_dtc_rly_main_dly_2 "C_DTC_RLY_MAIN_DLY_2" VALUE 0x70462 a_85 100 LINEAR______0_000000__0H___65535 0.0 65535.0 BIT_MASK 0xffffffff /end CHARACTERISTIC
/begin CHARACTERISTIC c_dtc_rly_main_dly_3 "C_DTC_RLY_MAIN_DLY_3" VALUE 0x70464 a_85 100 LINEAR______0_000000__0H___65535 0.0 65535.0 BIT_MASK 0xffffffff /end CHARACTERISTIC
/begin CHARACTERISTIC c_dtc_sa_1_0 "C_DTC_SA_1_0" VALUE 0x70466 a_85 100 LINEAR______0_000000__0H___65535 0.0 65535.0 BIT_MASK 0xffffffff /end CHARACTERISTIC
/begin CHARACTERISTIC c_dtc_sa_1_1 "C_DTC_SA_1_1" VALUE 0x70468 a_85 100 LINEAR______0_000000__0H___65535 0.0 65535.0 BIT_MASK 0xffffffff /end CHARACTERISTIC
/begin CHARACTERISTIC c_dtc_sa_1_2 "C_DTC_SA_1_2" VALUE 0x7046a a_85 100 LINEAR______0_000000__0H___65535 0.0 65535.0 BIT_MASK 0xffffffff /end CHARACTERISTIC
/begin CHARACTERISTIC c_dtc_sa_1_3 "C_DTC_SA_1_3" VALUE 0x7046c a_85 100 LINEAR______0_000000__0H___65535 0.0 65535.0 BIT_MASK 0xffffffff /end CHARACTERISTIC
/begin CHARACTERISTIC c_dtc_sa_2_0 "C_DTC_SA_2_0" VALUE 0x7046e a_85 100 LINEAR______0_000000__0H___65535 0.0 65535.0 BIT_MASK 0xffffffff /end CHARACTERISTIC
/begin CHARACTERISTIC c_dtc_sa_2_1 "C_DTC_SA_2_1" VALUE 0x70470 a_85 100 LINEAR______0_000000__0H___65535 0.0 65535.0 BIT_MASK 0xffffffff /end CHARACTERISTIC
/begin CHARACTERISTIC c_dtc_sa_2_2 "C_DTC_SA_2_2" VALUE 0x70472 a_85 100 LINEAR______0_000000__0H___65535 0.0 65535.0 BIT_MASK 0xffffffff /end CHARACTERISTIC
/begin CHARACTERISTIC c_dtc_sa_2_3 "C_DTC_SA_2_3" VALUE 0x70474 a_85 100 LINEAR______0_000000__0H___65535 0.0 65535.0 BIT_MASK 0xffffffff /end CHARACTERISTIC
/begin CHARACTERISTIC c_dtc_sa_conf_0 "C_DTC_SA_CONF_0" VALUE 0x70476 a_85 100 LINEAR______0_000000__0H___65535 0.0 65535.0 BIT_MASK 0xffffffff /end CHARACTERISTIC
/begin CHARACTERISTIC c_dtc_sa_conf_1 "C_DTC_SA_CONF_1" VALUE 0x70478 a_85 100 LINEAR______0_000000__0H___65535 0.0 65535.0 BIT_MASK 0xffffffff /end CHARACTERISTIC
/begin CHARACTERISTIC c_dtc_sa_conf_2 "C_DTC_SA_CONF_2" VALUE 0x7047a a_85 100 LINEAR______0_000000__0H___65535 0.0 65535.0 BIT_MASK 0xffffffff /end CHARACTERISTIC
/begin CHARACTERISTIC c_dtc_sa_conf_3 "C_DTC_SA_CONF_3" VALUE 0x7047c a_85 100 LINEAR______0_000000__0H___65535 0.0 65535.0 BIT_MASK 0xffffffff /end CHARACTERISTIC
/begin CHARACTERISTIC c_dtc_safm_0 "C_DTC_SAFM_0" VALUE 0x7047e a_85 100 LINEAR______0_000000__0H___65535 0.0 65535.0 BIT_MASK 0xffffffff /end CHARACTERISTIC
/begin CHARACTERISTIC c_dtc_safm_1 "C_DTC_SAFM_1" VALUE 0x70480 a_85 100 LINEAR______0_000000__0H___65535 0.0 65535.0 BIT_MASK 0xffffffff /end CHARACTERISTIC
/begin CHARACTERISTIC c_dtc_safm_2 "C_DTC_SAFM_2" VALUE 0x70482 a_85 100 LINEAR______0_000000__0H___65535 0.0 65535.0 BIT_MASK 0xffffffff /end CHARACTERISTIC
/begin CHARACTERISTIC c_dtc_safm_3 "C_DTC_SAFM_3" VALUE 0x70484 a_85 100 LINEAR______0_000000__0H___65535 0.0 65535.0 BIT_MASK 0xffffffff /end CHARACTERISTIC
/begin CHARACTERISTIC c_dtc_sap_0 "C_DTC_SAP_0" VALUE 0x70486 a_85 100 LINEAR______0_000000__0H___65535 0.0 65535.0 BIT_MASK 0xffffffff /end CHARACTERISTIC
/begin CHARACTERISTIC c_dtc_sap_1 "C_DTC_SAP_1" VALUE 0x70488 a_85 100 LINEAR______0_000000__0H___65535 0.0 65535.0 BIT_MASK 0xffffffff /end CHARACTERISTIC
/begin CHARACTERISTIC c_dtc_sap_2 "C_DTC_SAP_2" VALUE 0x7048a a_85 100 LINEAR______0_000000__0H___65535 0.0 65535.0 BIT_MASK 0xffffffff /end CHARACTERISTIC
/begin CHARACTERISTIC c_dtc_sap_3 "C_DTC_SAP_3" VALUE 0x7048c a_85 100 LINEAR______0_000000__0H___65535 0.0 65535.0 BIT_MASK 0xffffffff /end CHARACTERISTIC
/begin CHARACTERISTIC c_dtc_sap_safm_0 "C_DTC_SAP_SAFM_0" VALUE 0x7048e a_85 100 LINEAR______0_000000__0H___65535 0.0 65535.0 BIT_MASK 0xffffffff /end CHARACTERISTIC
/begin CHARACTERISTIC c_dtc_sap_safm_1 "C_DTC_SAP_SAFM_1" VALUE 0x70490 a_85 100 LINEAR______0_000000__0H___65535 0.0 65535.0 BIT_MASK 0xffffffff /end CHARACTERISTIC
/begin CHARACTERISTIC c_dtc_sap_safm_2 "C_DTC_SAP_SAFM_2" VALUE 0x70492 a_85 100 LINEAR______0_000000__0H___65535 0.0 65535.0 BIT_MASK 0xffffffff /end CHARACTERISTIC
/begin CHARACTERISTIC c_dtc_sap_safm_3 "C_DTC_SAP_SAFM_3" VALUE 0x70494 a_85 100 LINEAR______0_000000__0H___65535 0.0 65535.0 BIT_MASK 0xffffffff /end CHARACTERISTIC
/begin CHARACTERISTIC c_dtc_sav_0 "C_DTC_SAV_0" VALUE 0x70496 a_85 100 LINEAR______0_000000__0H___65535 0.0 65535.0 BIT_MASK 0xffffffff /end CHARACTERISTIC
/begin CHARACTERISTIC c_dtc_sav_1 "C_DTC_SAV_1" VALUE 0x70498 a_85 100 LINEAR______0_000000__0H___65535 0.0 65535.0 BIT_MASK 0xffffffff /end CHARACTERISTIC
/begin CHARACTERISTIC c_dtc_sav_1_safm_0 "C_DTC_SAV_1_SAFM_0" VALUE 0x7049a a_85 100 LINEAR______0_000000__0H___65535 0.0 65535.0 BIT_MASK 0xffffffff /end CHARACTERISTIC
/begin CHARACTERISTIC c_dtc_sav_1_safm_1 "C_DTC_SAV_1_SAFM_1" VALUE 0x7049c a_85 100 LINEAR______0_000000__0H___65535 0.0 65535.0 BIT_MASK 0xffffffff /end CHARACTERISTIC
/begin CHARACTERISTIC c_dtc_sav_1_safm_2 "C_DTC_SAV_1_SAFM_2" VALUE 0x7049e a_85 100 LINEAR______0_000000__0H___65535 0.0 65535.0 BIT_MASK 0xffffffff /end CHARACTERISTIC
/begin CHARACTERISTIC c_dtc_sav_1_safm_3 "C_DTC_SAV_1_SAFM_3" VALUE 0x704a0 a_85 100 LINEAR______0_000000__0H___65535 0.0 65535.0 BIT_MASK 0xffffffff /end CHARACTERISTIC
/begin CHARACTERISTIC c_dtc_sav_2 "C_DTC_SAV_2" VALUE 0x704a2 a_85 100 LINEAR______0_000000__0H___65535 0.0 65535.0 BIT_MASK 0xffffffff /end CHARACTERISTIC
/begin CHARACTERISTIC c_dtc_sav_3 "C_DTC_SAV_3" VALUE 0x704a4 a_85 100 LINEAR______0_000000__0H___65535 0.0 65535.0 BIT_MASK 0xffffffff /end CHARACTERISTIC
/begin CHARACTERISTIC c_dtc_sav_safm_0 "C_DTC_SAV_SAFM_0" VALUE 0x704a6 a_85 100 LINEAR______0_000000__0H___65535 0.0 65535.0 BIT_MASK 0xffffffff /end CHARACTERISTIC
/begin CHARACTERISTIC c_dtc_sav_safm_1 "C_DTC_SAV_SAFM_1" VALUE 0x704a8 a_85 100 LINEAR______0_000000__0H___65535 0.0 65535.0 BIT_MASK 0xffffffff /end CHARACTERISTIC
/begin CHARACTERISTIC c_dtc_sav_safm_2 "C_DTC_SAV_SAFM_2" VALUE 0x704aa a_85 100 LINEAR______0_000000__0H___65535 0.0 65535.0 BIT_MASK 0xffffffff /end CHARACTERISTIC
/begin CHARACTERISTIC c_dtc_sav_safm_3 "C_DTC_SAV_SAFM_3" VALUE 0x704ac a_85 100 LINEAR______0_000000__0H___65535 0.0 65535.0 BIT_MASK 0xffffffff /end CHARACTERISTIC
/begin CHARACTERISTIC c_dtc_t_igcfb_2_0 "C_DTC_T_IGCFB_2_0" VALUE 0x704ae a_85 100 LINEAR______0_000000__0H___65535 0.0 65535.0 BIT_MASK 0xffffffff /end CHARACTERISTIC
/begin CHARACTERISTIC c_dtc_t_igcfb_2_1 "C_DTC_T_IGCFB_2_1" VALUE 0x704b0 a_85 100 LINEAR______0_000000__0H___65535 0.0 65535.0 BIT_MASK 0xffffffff /end CHARACTERISTIC
/begin CHARACTERISTIC c_dtc_t_igcfb_2_2 "C_DTC_T_IGCFB_2_2" VALUE 0x704b2 a_85 100 LINEAR______0_000000__0H___65535 0.0 65535.0 BIT_MASK 0xffffffff /end CHARACTERISTIC
/begin CHARACTERISTIC c_dtc_t_igcfb_2_3 "C_DTC_T_IGCFB_2_3" VALUE 0x704b4 a_85 100 LINEAR______0_000000__0H___65535 0.0 65535.0 BIT_MASK 0xffffffff /end CHARACTERISTIC
/begin CHARACTERISTIC c_dtc_t_lam_act_0 "C_DTC_T_LAM_ACT_0" VALUE 0x704b6 a_85 100 LINEAR______0_000000__0H___65535 0.0 65535.0 BIT_MASK 0xffffffff /end CHARACTERISTIC
/begin CHARACTERISTIC c_dtc_t_lam_act_1 "C_DTC_T_LAM_ACT_1" VALUE 0x704b8 a_85 100 LINEAR______0_000000__0H___65535 0.0 65535.0 BIT_MASK 0xffffffff /end CHARACTERISTIC
/begin CHARACTERISTIC c_dtc_t_lam_act_2 "C_DTC_T_LAM_ACT_2" VALUE 0x704ba a_85 100 LINEAR______0_000000__0H___65535 0.0 65535.0 BIT_MASK 0xffffffff /end CHARACTERISTIC
/begin CHARACTERISTIC c_dtc_t_lam_act_3 "C_DTC_T_LAM_ACT_3" VALUE 0x704bc a_85 100 LINEAR______0_000000__0H___65535 0.0 65535.0 BIT_MASK 0xffffffff /end CHARACTERISTIC
/begin CHARACTERISTIC c_dtc_tco_0 "C_DTC_TCO_0" VALUE 0x704be a_85 100 LINEAR______0_000000__0H___65535 0.0 65535.0 BIT_MASK 0xffffffff /end CHARACTERISTIC
/begin CHARACTERISTIC c_dtc_tco_1 "C_DTC_TCO_1" VALUE 0x704c0 a_85 100 LINEAR______0_000000__0H___65535 0.0 65535.0 BIT_MASK 0xffffffff /end CHARACTERISTIC
/begin CHARACTERISTIC c_dtc_tco_2 "C_DTC_TCO_2" VALUE 0x704c2 a_85 100 LINEAR______0_000000__0H___65535 0.0 65535.0 BIT_MASK 0xffffffff /end CHARACTERISTIC
/begin CHARACTERISTIC c_dtc_tco_3 "C_DTC_TCO_3" VALUE 0x704c4 a_85 100 LINEAR______0_000000__0H___65535 0.0 65535.0 BIT_MASK 0xffffffff /end CHARACTERISTIC
/begin CHARACTERISTIC c_dtc_tco_ex_0 "C_DTC_TCO_EX_0" VALUE 0x704c6 a_85 100 LINEAR______0_000000__0H___65535 0.0 65535.0 BIT_MASK 0xffffffff /end CHARACTERISTIC
/begin CHARACTERISTIC c_dtc_tco_ex_1 "C_DTC_TCO_EX_1" VALUE 0x704c8 a_85 100 LINEAR______0_000000__0H___65535 0.0 65535.0 BIT_MASK 0xffffffff /end CHARACTERISTIC
/begin CHARACTERISTIC c_dtc_tco_ex_2 "C_DTC_TCO_EX_2" VALUE 0x704ca a_85 100 LINEAR______0_000000__0H___65535 0.0 65535.0 BIT_MASK 0xffffffff /end CHARACTERISTIC
/begin CHARACTERISTIC c_dtc_tco_ex_3 "C_DTC_TCO_EX_3" VALUE 0x704cc a_85 100 LINEAR______0_000000__0H___65535 0.0 65535.0 BIT_MASK 0xffffffff /end CHARACTERISTIC
/begin CHARACTERISTIC c_dtc_tco_max_0 "C_DTC_TCO_MAX_0" VALUE 0x704ce a_85 100 LINEAR______0_000000__0H___65535 0.0 65535.0 BIT_MASK 0xffffffff /end CHARACTERISTIC
/begin CHARACTERISTIC c_dtc_tco_max_1 "C_DTC_TCO_MAX_1" VALUE 0x704d0 a_85 100 LINEAR______0_000000__0H___65535 0.0 65535.0 BIT_MASK 0xffffffff /end CHARACTERISTIC
/begin CHARACTERISTIC c_dtc_tco_max_2 "C_DTC_TCO_MAX_2" VALUE 0x704d2 a_85 100 LINEAR______0_000000__0H___65535 0.0 65535.0 BIT_MASK 0xffffffff /end CHARACTERISTIC
/begin CHARACTERISTIC c_dtc_tco_max_3 "C_DTC_TCO_MAX_3" VALUE 0x704d4 a_85 100 LINEAR______0_000000__0H___65535 0.0 65535.0 BIT_MASK 0xffffffff /end CHARACTERISTIC
/begin CHARACTERISTIC c_dtc_teg_down_1_0 "C_DTC_TEG_DOWN_1_0" VALUE 0x704d6 a_85 100 LINEAR______0_000000__0H___65535 0.0 65535.0 BIT_MASK 0xffffffff /end CHARACTERISTIC
/begin CHARACTERISTIC c_dtc_teg_down_1_1 "C_DTC_TEG_DOWN_1_1" VALUE 0x704d8 a_85 100 LINEAR______0_000000__0H___65535 0.0 65535.0 BIT_MASK 0xffffffff /end CHARACTERISTIC
/begin CHARACTERISTIC c_dtc_teg_down_1_2 "C_DTC_TEG_DOWN_1_2" VALUE 0x704da a_85 100 LINEAR______0_000000__0H___65535 0.0 65535.0 BIT_MASK 0xffffffff /end CHARACTERISTIC
/begin CHARACTERISTIC c_dtc_teg_down_1_3 "C_DTC_TEG_DOWN_1_3" VALUE 0x704dc a_85 100 LINEAR______0_000000__0H___65535 0.0 65535.0 BIT_MASK 0xffffffff /end CHARACTERISTIC
/begin CHARACTERISTIC c_dtc_teg_down_2_0 "C_DTC_TEG_DOWN_2_0" VALUE 0x704de a_85 100 LINEAR______0_000000__0H___65535 0.0 65535.0 BIT_MASK 0xffffffff /end CHARACTERISTIC
/begin CHARACTERISTIC c_dtc_teg_down_2_1 "C_DTC_TEG_DOWN_2_1" VALUE 0x704e0 a_85 100 LINEAR______0_000000__0H___65535 0.0 65535.0 BIT_MASK 0xffffffff /end CHARACTERISTIC
/begin CHARACTERISTIC c_dtc_teg_down_2_2 "C_DTC_TEG_DOWN_2_2" VALUE 0x704e2 a_85 100 LINEAR______0_000000__0H___65535 0.0 65535.0 BIT_MASK 0xffffffff /end CHARACTERISTIC
/begin CHARACTERISTIC c_dtc_teg_down_2_3 "C_DTC_TEG_DOWN_2_3" VALUE 0x704e4 a_85 100 LINEAR______0_000000__0H___65535 0.0 65535.0 BIT_MASK 0xffffffff /end CHARACTERISTIC
/begin CHARACTERISTIC c_dtc_teg_up_1_0 "C_DTC_TEG_UP_1_0" VALUE 0x704e6 a_85 100 LINEAR______0_000000__0H___65535 0.0 65535.0 BIT_MASK 0xffffffff /end CHARACTERISTIC
/begin CHARACTERISTIC c_dtc_teg_up_1_1 "C_DTC_TEG_UP_1_1" VALUE 0x704e8 a_85 100 LINEAR______0_000000__0H___65535 0.0 65535.0 BIT_MASK 0xffffffff /end CHARACTERISTIC
/begin CHARACTERISTIC c_dtc_teg_up_1_2 "C_DTC_TEG_UP_1_2" VALUE 0x704ea a_85 100 LINEAR______0_000000__0H___65535 0.0 65535.0 BIT_MASK 0xffffffff /end CHARACTERISTIC
/begin CHARACTERISTIC c_dtc_teg_up_1_3 "C_DTC_TEG_UP_1_3" VALUE 0x704ec a_85 100 LINEAR______0_000000__0H___65535 0.0 65535.0 BIT_MASK 0xffffffff /end CHARACTERISTIC
/begin CHARACTERISTIC c_dtc_teg_up_2_0 "C_DTC_TEG_UP_2_0" VALUE 0x704ee a_85 100 LINEAR______0_000000__0H___65535 0.0 65535.0 BIT_MASK 0xffffffff /end CHARACTERISTIC
/begin CHARACTERISTIC c_dtc_teg_up_2_1 "C_DTC_TEG_UP_2_1" VALUE 0x704f0 a_85 100 LINEAR______0_000000__0H___65535 0.0 65535.0 BIT_MASK 0xffffffff /end CHARACTERISTIC
/begin CHARACTERISTIC c_dtc_teg_up_2_2 "C_DTC_TEG_UP_2_2" VALUE 0x704f2 a_85 100 LINEAR______0_000000__0H___65535 0.0 65535.0 BIT_MASK 0xffffffff /end CHARACTERISTIC
/begin CHARACTERISTIC c_dtc_teg_up_2_3 "C_DTC_TEG_UP_2_3" VALUE 0x704f4 a_85 100 LINEAR______0_000000__0H___65535 0.0 65535.0 BIT_MASK 0xffffffff /end CHARACTERISTIC
/begin CHARACTERISTIC c_dtc_tia_0 "C_DTC_TIA_0" VALUE 0x704f6 a_85 100 LINEAR______0_000000__0H___65535 0.0 65535.0 BIT_MASK 0xffffffff /end CHARACTERISTIC
/begin CHARACTERISTIC c_dtc_tia_1 "C_DTC_TIA_1" VALUE 0x704f8 a_85 100 LINEAR______0_000000__0H___65535 0.0 65535.0 BIT_MASK 0xffffffff /end CHARACTERISTIC
/begin CHARACTERISTIC c_dtc_tia_2 "C_DTC_TIA_2" VALUE 0x704fa a_85 100 LINEAR______0_000000__0H___65535 0.0 65535.0 BIT_MASK 0xffffffff /end CHARACTERISTIC
/begin CHARACTERISTIC c_dtc_tia_3 "C_DTC_TIA_3" VALUE 0x704fc a_85 100 LINEAR______0_000000__0H___65535 0.0 65535.0 BIT_MASK 0xffffffff /end CHARACTERISTIC
/begin CHARACTERISTIC c_dtc_toil_0 "C_DTC_TOIL_0" VALUE 0x704fe a_85 100 LINEAR______0_000000__0H___65535 0.0 65535.0 BIT_MASK 0xffffffff /end CHARACTERISTIC
/begin CHARACTERISTIC c_dtc_toil_1 "C_DTC_TOIL_1" VALUE 0x70500 a_85 100 LINEAR______0_000000__0H___65535 0.0 65535.0 BIT_MASK 0xffffffff /end CHARACTERISTIC
/begin CHARACTERISTIC c_dtc_toil_2 "C_DTC_TOIL_2" VALUE 0x70502 a_85 100 LINEAR______0_000000__0H___65535 0.0 65535.0 BIT_MASK 0xffffffff /end CHARACTERISTIC
/begin CHARACTERISTIC c_dtc_toil_3 "C_DTC_TOIL_3" VALUE 0x70504 a_85 100 LINEAR______0_000000__0H___65535 0.0 65535.0 BIT_MASK 0xffffffff /end CHARACTERISTIC
/begin CHARACTERISTIC c_dtc_tout_amt_1_0 "C_DTC_TOUT_AMT_1_0" VALUE 0x70506 a_85 100 LINEAR______0_000000__0H___65535 0.0 65535.0 BIT_MASK 0xffffffff FUNCTION_LIST Z1S1 /end CHARACTERISTIC
/begin CHARACTERISTIC c_dtc_tout_amt_1_1 "C_DTC_TOUT_AMT_1_1" VALUE 0x70508 a_85 100 LINEAR______0_000000__0H___65535 0.0 65535.0 BIT_MASK 0xffffffff FUNCTION_LIST Z1S1 /end CHARACTERISTIC
/begin CHARACTERISTIC c_dtc_tout_amt_1_2 "C_DTC_TOUT_AMT_1_2" VALUE 0x7050a a_85 100 LINEAR______0_000000__0H___65535 0.0 65535.0 BIT_MASK 0xffffffff FUNCTION_LIST Z1S1 /end CHARACTERISTIC
/begin CHARACTERISTIC c_dtc_tout_amt_1_3 "C_DTC_TOUT_AMT_1_3" VALUE 0x7050c a_85 100 LINEAR______0_000000__0H___65535 0.0 65535.0 BIT_MASK 0xffffffff FUNCTION_LIST Z1S1 /end CHARACTERISTIC
/begin CHARACTERISTIC c_dtc_tout_asr_1_0 "C_DTC_TOUT_ASR_1_0" VALUE 0x7050e a_85 100 LINEAR______0_000000__0H___65535 0.0 65535.0 BIT_MASK 0xffffffff /end CHARACTERISTIC
/begin CHARACTERISTIC c_dtc_tout_asr_1_1 "C_DTC_TOUT_ASR_1_1" VALUE 0x70510 a_85 100 LINEAR______0_000000__0H___65535 0.0 65535.0 BIT_MASK 0xffffffff /end CHARACTERISTIC
/begin CHARACTERISTIC c_dtc_tout_asr_1_2 "C_DTC_TOUT_ASR_1_2" VALUE 0x70512 a_85 100 LINEAR______0_000000__0H___65535 0.0 65535.0 BIT_MASK 0xffffffff /end CHARACTERISTIC
/begin CHARACTERISTIC c_dtc_tout_asr_1_3 "C_DTC_TOUT_ASR_1_3" VALUE 0x70514 a_85 100 LINEAR______0_000000__0H___65535 0.0 65535.0 BIT_MASK 0xffffffff /end CHARACTERISTIC
/begin CHARACTERISTIC c_dtc_tout_asr_3_0 "C_DTC_TOUT_ASR_3_0" VALUE 0x70516 a_85 100 LINEAR______0_000000__0H___65535 0.0 65535.0 BIT_MASK 0xffffffff /end CHARACTERISTIC
/begin CHARACTERISTIC c_dtc_tout_asr_3_1 "C_DTC_TOUT_ASR_3_1" VALUE 0x70518 a_85 100 LINEAR______0_000000__0H___65535 0.0 65535.0 BIT_MASK 0xffffffff /end CHARACTERISTIC
/begin CHARACTERISTIC c_dtc_tout_asr_3_2 "C_DTC_TOUT_ASR_3_2" VALUE 0x7051a a_85 100 LINEAR______0_000000__0H___65535 0.0 65535.0 BIT_MASK 0xffffffff /end CHARACTERISTIC
/begin CHARACTERISTIC c_dtc_tout_asr_3_3 "C_DTC_TOUT_ASR_3_3" VALUE 0x7051c a_85 100 LINEAR______0_000000__0H___65535 0.0 65535.0 BIT_MASK 0xffffffff /end CHARACTERISTIC
/begin CHARACTERISTIC c_dtc_tout_cng_ecu_1_0 "C_DTC_TOUT_CNG_ECU_1_0" VALUE 0x7051e a_85 100 LINEAR______0_000000__0H___65535 0.0 65535.0 BIT_MASK 0xffffffff /end CHARACTERISTIC
/begin CHARACTERISTIC c_dtc_tout_cng_ecu_1_1 "C_DTC_TOUT_CNG_ECU_1_1" VALUE 0x70520 a_85 100 LINEAR______0_000000__0H___65535 0.0 65535.0 BIT_MASK 0xffffffff /end CHARACTERISTIC
/begin CHARACTERISTIC c_dtc_tout_cng_ecu_1_2 "C_DTC_TOUT_CNG_ECU_1_2" VALUE 0x70522 a_85 100 LINEAR______0_000000__0H___65535 0.0 65535.0 BIT_MASK 0xffffffff /end CHARACTERISTIC
/begin CHARACTERISTIC c_dtc_tout_cng_ecu_1_3 "C_DTC_TOUT_CNG_ECU_1_3" VALUE 0x70524 a_85 100 LINEAR______0_000000__0H___65535 0.0 65535.0 BIT_MASK 0xffffffff /end CHARACTERISTIC
/begin CHARACTERISTIC c_dtc_tout_etcu_1_0 "C_DTC_TOUT_ETCU_1_0" VALUE 0x70526 a_85 100 LINEAR______0_000000__0H___65535 0.0 65535.0 BIT_MASK 0xffffffff /end CHARACTERISTIC
/begin CHARACTERISTIC c_dtc_tout_etcu_1_1 "C_DTC_TOUT_ETCU_1_1" VALUE 0x70528 a_85 100 LINEAR______0_000000__0H___65535 0.0 65535.0 BIT_MASK 0xffffffff /end CHARACTERISTIC
/begin CHARACTERISTIC c_dtc_tout_etcu_1_2 "C_DTC_TOUT_ETCU_1_2" VALUE 0x7052a a_85 100 LINEAR______0_000000__0H___65535 0.0 65535.0 BIT_MASK 0xffffffff /end CHARACTERISTIC
/begin CHARACTERISTIC c_dtc_tout_etcu_1_3 "C_DTC_TOUT_ETCU_1_3" VALUE 0x7052c a_85 100 LINEAR______0_000000__0H___65535 0.0 65535.0 BIT_MASK 0xffffffff /end CHARACTERISTIC
/begin CHARACTERISTIC c_dtc_tout_icl_2_0 "C_DTC_TOUT_ICL_2_0" VALUE 0x7052e a_85 100 LINEAR______0_000000__0H___65535 0.0 65535.0 BIT_MASK 0xffffffff /end CHARACTERISTIC
/begin CHARACTERISTIC c_dtc_tout_icl_2_1 "C_DTC_TOUT_ICL_2_1" VALUE 0x70530 a_85 100 LINEAR______0_000000__0H___65535 0.0 65535.0 BIT_MASK 0xffffffff /end CHARACTERISTIC
/begin CHARACTERISTIC c_dtc_tout_icl_2_2 "C_DTC_TOUT_ICL_2_2" VALUE 0x70532 a_85 100 LINEAR______0_000000__0H___65535 0.0 65535.0 BIT_MASK 0xffffffff /end CHARACTERISTIC
/begin CHARACTERISTIC c_dtc_tout_icl_2_3 "C_DTC_TOUT_ICL_2_3" VALUE 0x70534 a_85 100 LINEAR______0_000000__0H___65535 0.0 65535.0 BIT_MASK 0xffffffff /end CHARACTERISTIC
/begin CHARACTERISTIC c_dtc_tout_icl_3_0 "C_DTC_TOUT_ICL_3_0" VALUE 0x70536 a_85 100 LINEAR______0_000000__0H___65535 0.0 65535.0 BIT_MASK 0xffffffff /end CHARACTERISTIC
/begin CHARACTERISTIC c_dtc_tout_icl_3_1 "C_DTC_TOUT_ICL_3_1" VALUE 0x70538 a_85 100 LINEAR______0_000000__0H___65535 0.0 65535.0 BIT_MASK 0xffffffff /end CHARACTERISTIC
/begin CHARACTERISTIC c_dtc_tout_icl_3_2 "C_DTC_TOUT_ICL_3_2" VALUE 0x7053a a_85 100 LINEAR______0_000000__0H___65535 0.0 65535.0 BIT_MASK 0xffffffff /end CHARACTERISTIC
/begin CHARACTERISTIC c_dtc_tout_icl_3_3 "C_DTC_TOUT_ICL_3_3" VALUE 0x7053c a_85 100 LINEAR______0_000000__0H___65535 0.0 65535.0 BIT_MASK 0xffffffff /end CHARACTERISTIC
/begin CHARACTERISTIC c_dtc_tout_imob_0 "C_DTC_TOUT_IMOB_0" VALUE 0x7053e a_85 100 LINEAR______0_000000__0H___65535 0.0 65535.0 BIT_MASK 0xffffffff /end CHARACTERISTIC
/begin CHARACTERISTIC c_dtc_tout_imob_1 "C_DTC_TOUT_IMOB_1" VALUE 0x70540 a_85 100 LINEAR______0_000000__0H___65535 0.0 65535.0 BIT_MASK 0xffffffff /end CHARACTERISTIC
/begin CHARACTERISTIC c_dtc_tout_imob_2 "C_DTC_TOUT_IMOB_2" VALUE 0x70542 a_85 100 LINEAR______0_000000__0H___65535 0.0 65535.0 BIT_MASK 0xffffffff /end CHARACTERISTIC
/begin CHARACTERISTIC c_dtc_tout_imob_3 "C_DTC_TOUT_IMOB_3" VALUE 0x70544 a_85 100 LINEAR______0_000000__0H___65535 0.0 65535.0 BIT_MASK 0xffffffff /end CHARACTERISTIC
/begin CHARACTERISTIC c_dtc_tout_pste_1_0 "C_DTC_TOUT_PSTE_1_0" VALUE 0x70546 a_85 100 LINEAR______0_000000__0H___65535 0.0 65535.0 BIT_MASK 0xffffffff /end CHARACTERISTIC
/begin CHARACTERISTIC c_dtc_tout_pste_1_1 "C_DTC_TOUT_PSTE_1_1" VALUE 0x70548 a_85 100 LINEAR______0_000000__0H___65535 0.0 65535.0 BIT_MASK 0xffffffff /end CHARACTERISTIC
/begin CHARACTERISTIC c_dtc_tout_pste_1_2 "C_DTC_TOUT_PSTE_1_2" VALUE 0x7054a a_85 100 LINEAR______0_000000__0H___65535 0.0 65535.0 BIT_MASK 0xffffffff /end CHARACTERISTIC
/begin CHARACTERISTIC c_dtc_tout_pste_1_3 "C_DTC_TOUT_PSTE_1_3" VALUE 0x7054c a_85 100 LINEAR______0_000000__0H___65535 0.0 65535.0 BIT_MASK 0xffffffff /end CHARACTERISTIC
/begin CHARACTERISTIC c_dtc_tps_1_0 "C_DTC_TPS_1_0" VALUE 0x7054e a_85 100 LINEAR______0_000000__0H___65535 0.0 65535.0 BIT_MASK 0xffffffff /end CHARACTERISTIC
/begin CHARACTERISTIC c_dtc_tps_1_1 "C_DTC_TPS_1_1" VALUE 0x70550 a_85 100 LINEAR______0_000000__0H___65535 0.0 65535.0 BIT_MASK 0xffffffff /end CHARACTERISTIC
/begin CHARACTERISTIC c_dtc_tps_1_2 "C_DTC_TPS_1_2" VALUE 0x70552 a_85 100 LINEAR______0_000000__0H___65535 0.0 65535.0 BIT_MASK 0xffffffff /end CHARACTERISTIC
/begin CHARACTERISTIC c_dtc_tps_1_3 "C_DTC_TPS_1_3" VALUE 0x70554 a_85 100 LINEAR______0_000000__0H___65535 0.0 65535.0 BIT_MASK 0xffffffff /end CHARACTERISTIC
/begin CHARACTERISTIC c_dtc_tps_2_0 "C_DTC_TPS_2_0" VALUE 0x70556 a_85 100 LINEAR______0_000000__0H___65535 0.0 65535.0 BIT_MASK 0xffffffff /end CHARACTERISTIC
/begin CHARACTERISTIC c_dtc_tps_2_1 "C_DTC_TPS_2_1" VALUE 0x70558 a_85 100 LINEAR______0_000000__0H___65535 0.0 65535.0 BIT_MASK 0xffffffff /end CHARACTERISTIC
/begin CHARACTERISTIC c_dtc_tps_2_2 "C_DTC_TPS_2_2" VALUE 0x7055a a_85 100 LINEAR______0_000000__0H___65535 0.0 65535.0 BIT_MASK 0xffffffff /end CHARACTERISTIC
/begin CHARACTERISTIC c_dtc_tps_2_3 "C_DTC_TPS_2_3" VALUE 0x7055c a_85 100 LINEAR______0_000000__0H___65535 0.0 65535.0 BIT_MASK 0xffffffff /end CHARACTERISTIC
/begin CHARACTERISTIC c_dtc_tps_ad_0 "C_DTC_TPS_AD_0" VALUE 0x7055e a_85 100 LINEAR______0_000000__0H___65535 0.0 65535.0 BIT_MASK 0xffffffff /end CHARACTERISTIC
/begin CHARACTERISTIC c_dtc_tps_ad_1 "C_DTC_TPS_AD_1" VALUE 0x70560 a_85 100 LINEAR______0_000000__0H___65535 0.0 65535.0 BIT_MASK 0xffffffff /end CHARACTERISTIC
/begin CHARACTERISTIC c_dtc_tps_ad_2 "C_DTC_TPS_AD_2" VALUE 0x70562 a_85 100 LINEAR______0_000000__0H___65535 0.0 65535.0 BIT_MASK 0xffffffff /end CHARACTERISTIC
/begin CHARACTERISTIC c_dtc_tps_ad_3 "C_DTC_TPS_AD_3" VALUE 0x70564 a_85 100 LINEAR______0_000000__0H___65535 0.0 65535.0 BIT_MASK 0xffffffff /end CHARACTERISTIC
/begin CHARACTERISTIC c_dtc_tps_maf_1_0 "C_DTC_TPS_MAF_1_0" VALUE 0x70566 a_85 100 LINEAR______0_000000__0H___65535 0.0 65535.0 BIT_MASK 0xffffffff /end CHARACTERISTIC
/begin CHARACTERISTIC c_dtc_tps_maf_1_1 "C_DTC_TPS_MAF_1_1" VALUE 0x70568 a_85 100 LINEAR______0_000000__0H___65535 0.0 65535.0 BIT_MASK 0xffffffff /end CHARACTERISTIC
/begin CHARACTERISTIC c_dtc_tps_maf_1_2 "C_DTC_TPS_MAF_1_2" VALUE 0x7056a a_85 100 LINEAR______0_000000__0H___65535 0.0 65535.0 BIT_MASK 0xffffffff /end CHARACTERISTIC
/begin CHARACTERISTIC c_dtc_tps_maf_1_3 "C_DTC_TPS_MAF_1_3" VALUE 0x7056c a_85 100 LINEAR______0_000000__0H___65535 0.0 65535.0 BIT_MASK 0xffffffff /end CHARACTERISTIC
/begin CHARACTERISTIC c_dtc_tps_maf_2_0 "C_DTC_TPS_MAF_2_0" VALUE 0x7056e a_85 100 LINEAR______0_000000__0H___65535 0.0 65535.0 BIT_MASK 0xffffffff /end CHARACTERISTIC
/begin CHARACTERISTIC c_dtc_tps_maf_2_1 "C_DTC_TPS_MAF_2_1" VALUE 0x70570 a_85 100 LINEAR______0_000000__0H___65535 0.0 65535.0 BIT_MASK 0xffffffff /end CHARACTERISTIC
/begin CHARACTERISTIC c_dtc_tps_maf_2_2 "C_DTC_TPS_MAF_2_2" VALUE 0x70572 a_85 100 LINEAR______0_000000__0H___65535 0.0 65535.0 BIT_MASK 0xffffffff /end CHARACTERISTIC
/begin CHARACTERISTIC c_dtc_tps_maf_2_3 "C_DTC_TPS_MAF_2_3" VALUE 0x70574 a_85 100 LINEAR______0_000000__0H___65535 0.0 65535.0 BIT_MASK 0xffffffff /end CHARACTERISTIC
/begin CHARACTERISTIC c_dtc_tps_st_chk_1_0 "C_DTC_TPS_ST_CHK_1_0" VALUE 0x70576 a_85 100 LINEAR______0_000000__0H___65535 0.0 65535.0 BIT_MASK 0xffffffff /end CHARACTERISTIC
/begin CHARACTERISTIC c_dtc_tps_st_chk_1_1 "C_DTC_TPS_ST_CHK_1_1" VALUE 0x70578 a_85 100 LINEAR______0_000000__0H___65535 0.0 65535.0 BIT_MASK 0xffffffff /end CHARACTERISTIC
/begin CHARACTERISTIC c_dtc_tps_st_chk_1_2 "C_DTC_TPS_ST_CHK_1_2" VALUE 0x7057a a_85 100 LINEAR______0_000000__0H___65535 0.0 65535.0 BIT_MASK 0xffffffff /end CHARACTERISTIC
/begin CHARACTERISTIC c_dtc_tps_st_chk_1_3 "C_DTC_TPS_ST_CHK_1_3" VALUE 0x7057c a_85 100 LINEAR______0_000000__0H___65535 0.0 65535.0 BIT_MASK 0xffffffff /end CHARACTERISTIC
/begin CHARACTERISTIC c_dtc_tps_st_chk_2_0 "C_DTC_TPS_ST_CHK_2_0" VALUE 0x7057e a_85 100 LINEAR______0_000000__0H___65535 0.0 65535.0 BIT_MASK 0xffffffff /end CHARACTERISTIC
/begin CHARACTERISTIC c_dtc_tps_st_chk_2_1 "C_DTC_TPS_ST_CHK_2_1" VALUE 0x70580 a_85 100 LINEAR______0_000000__0H___65535 0.0 65535.0 BIT_MASK 0xffffffff /end CHARACTERISTIC
/begin CHARACTERISTIC c_dtc_tps_st_chk_2_2 "C_DTC_TPS_ST_CHK_2_2" VALUE 0x70582 a_85 100 LINEAR______0_000000__0H___65535 0.0 65535.0 BIT_MASK 0xffffffff /end CHARACTERISTIC
/begin CHARACTERISTIC c_dtc_tps_st_chk_2_3 "C_DTC_TPS_ST_CHK_2_3" VALUE 0x70584 a_85 100 LINEAR______0_000000__0H___65535 0.0 65535.0 BIT_MASK 0xffffffff /end CHARACTERISTIC
/begin CHARACTERISTIC c_dtc_tqi_amt_1_0 "C_DTC_TQI_AMT_1_0" VALUE 0x70586 a_85 100 LINEAR______0_000000__0H___65535 0.0 65535.0 BIT_MASK 0xffffffff FUNCTION_LIST Z1S1 /end CHARACTERISTIC
/begin CHARACTERISTIC c_dtc_tqi_amt_1_1 "C_DTC_TQI_AMT_1_1" VALUE 0x70588 a_85 100 LINEAR______0_000000__0H___65535 0.0 65535.0 BIT_MASK 0xffffffff FUNCTION_LIST Z1S1 /end CHARACTERISTIC
/begin CHARACTERISTIC c_dtc_tqi_amt_1_2 "C_DTC_TQI_AMT_1_2" VALUE 0x7058a a_85 100 LINEAR______0_000000__0H___65535 0.0 65535.0 BIT_MASK 0xffffffff FUNCTION_LIST Z1S1 /end CHARACTERISTIC
/begin CHARACTERISTIC c_dtc_tqi_amt_1_3 "C_DTC_TQI_AMT_1_3" VALUE 0x7058c a_85 100 LINEAR______0_000000__0H___65535 0.0 65535.0 BIT_MASK 0xffffffff FUNCTION_LIST Z1S1 /end CHARACTERISTIC
/begin CHARACTERISTIC c_dtc_tqi_lim_0 "C_DTC_TQI_LIM_0" VALUE 0x7058e a_85 100 LINEAR______0_000000__0H___65535 0.0 65535.0 BIT_MASK 0xffffffff /end CHARACTERISTIC
/begin CHARACTERISTIC c_dtc_tqi_lim_1 "C_DTC_TQI_LIM_1" VALUE 0x70590 a_85 100 LINEAR______0_000000__0H___65535 0.0 65535.0 BIT_MASK 0xffffffff /end CHARACTERISTIC
/begin CHARACTERISTIC c_dtc_tqi_lim_2 "C_DTC_TQI_LIM_2" VALUE 0x70592 a_85 100 LINEAR______0_000000__0H___65535 0.0 65535.0 BIT_MASK 0xffffffff /end CHARACTERISTIC
/begin CHARACTERISTIC c_dtc_tqi_lim_3 "C_DTC_TQI_LIM_3" VALUE 0x70594 a_85 100 LINEAR______0_000000__0H___65535 0.0 65535.0 BIT_MASK 0xffffffff /end CHARACTERISTIC
/begin CHARACTERISTIC c_dtc_tqi_n_max_nvmy_mon_0 "C_DTC_TQI_N_MAX_NVMY_MON_0" VALUE 0x70596 a_85 100 LINEAR______0_000000__0H___65535 0.0 65535.0 BIT_MASK 0xffffffff /end CHARACTERISTIC
/begin CHARACTERISTIC c_dtc_tqi_n_max_nvmy_mon_1 "C_DTC_TQI_N_MAX_NVMY_MON_1" VALUE 0x70598 a_85 100 LINEAR______0_000000__0H___65535 0.0 65535.0 BIT_MASK 0xffffffff /end CHARACTERISTIC
/begin CHARACTERISTIC c_dtc_tqi_n_max_nvmy_mon_2 "C_DTC_TQI_N_MAX_NVMY_MON_2" VALUE 0x7059a a_85 100 LINEAR______0_000000__0H___65535 0.0 65535.0 BIT_MASK 0xffffffff /end CHARACTERISTIC
/begin CHARACTERISTIC c_dtc_tqi_n_max_nvmy_mon_3 "C_DTC_TQI_N_MAX_NVMY_MON_3" VALUE 0x7059c a_85 100 LINEAR______0_000000__0H___65535 0.0 65535.0 BIT_MASK 0xffffffff /end CHARACTERISTIC
/begin CHARACTERISTIC c_dtc_var_amp_0 "C_DTC_VAR_AMP_0" VALUE 0x7059e a_85 100 LINEAR______0_000000__0H___65535 0.0 65535.0 BIT_MASK 0xffffffff /end CHARACTERISTIC
/begin CHARACTERISTIC c_dtc_var_amp_1 "C_DTC_VAR_AMP_1" VALUE 0x705a0 a_85 100 LINEAR______0_000000__0H___65535 0.0 65535.0 BIT_MASK 0xffffffff /end CHARACTERISTIC
/begin CHARACTERISTIC c_dtc_var_amp_2 "C_DTC_VAR_AMP_2" VALUE 0x705a2 a_85 100 LINEAR______0_000000__0H___65535 0.0 65535.0 BIT_MASK 0xffffffff /end CHARACTERISTIC
/begin CHARACTERISTIC c_dtc_var_amp_3 "C_DTC_VAR_AMP_3" VALUE 0x705a4 a_85 100 LINEAR______0_000000__0H___65535 0.0 65535.0 BIT_MASK 0xffffffff /end CHARACTERISTIC
/begin CHARACTERISTIC c_dtc_vcc_poti_1_0 "C_DTC_VCC_POTI_1_0" VALUE 0x705a6 a_85 100 LINEAR______0_000000__0H___65535 0.0 65535.0 BIT_MASK 0xffffffff /end CHARACTERISTIC
/begin CHARACTERISTIC c_dtc_vcc_poti_1_1 "C_DTC_VCC_POTI_1_1" VALUE 0x705a8 a_85 100 LINEAR______0_000000__0H___65535 0.0 65535.0 BIT_MASK 0xffffffff /end CHARACTERISTIC
/begin CHARACTERISTIC c_dtc_vcc_poti_1_2 "C_DTC_VCC_POTI_1_2" VALUE 0x705aa a_85 100 LINEAR______0_000000__0H___65535 0.0 65535.0 BIT_MASK 0xffffffff /end CHARACTERISTIC
/begin CHARACTERISTIC c_dtc_vcc_poti_1_3 "C_DTC_VCC_POTI_1_3" VALUE 0x705ac a_85 100 LINEAR______0_000000__0H___65535 0.0 65535.0 BIT_MASK 0xffffffff /end CHARACTERISTIC
/begin CHARACTERISTIC c_dtc_vcc_poti_2_0 "C_DTC_VCC_POTI_2_0" VALUE 0x705ae a_85 100 LINEAR______0_000000__0H___65535 0.0 65535.0 BIT_MASK 0xffffffff /end CHARACTERISTIC
/begin CHARACTERISTIC c_dtc_vcc_poti_2_1 "C_DTC_VCC_POTI_2_1" VALUE 0x705b0 a_85 100 LINEAR______0_000000__0H___65535 0.0 65535.0 BIT_MASK 0xffffffff /end CHARACTERISTIC
/begin CHARACTERISTIC c_dtc_vcc_poti_2_2 "C_DTC_VCC_POTI_2_2" VALUE 0x705b2 a_85 100 LINEAR______0_000000__0H___65535 0.0 65535.0 BIT_MASK 0xffffffff /end CHARACTERISTIC
/begin CHARACTERISTIC c_dtc_vcc_poti_2_3 "C_DTC_VCC_POTI_2_3" VALUE 0x705b4 a_85 100 LINEAR______0_000000__0H___65535 0.0 65535.0 BIT_MASK 0xffffffff /end CHARACTERISTIC
/begin CHARACTERISTIC c_dtc_vdmtl_0 "C_DTC_VDMTL_0" VALUE 0x705b6 a_85 100 LINEAR______0_000000__0H___65535 0.0 65535.0 BIT_MASK 0xffffffff FUNCTION_LIST DMTL /end CHARACTERISTIC
/begin CHARACTERISTIC c_dtc_vdmtl_1 "C_DTC_VDMTL_1" VALUE 0x705b8 a_85 100 LINEAR______0_000000__0H___65535 0.0 65535.0 BIT_MASK 0xffffffff FUNCTION_LIST DMTL /end CHARACTERISTIC
/begin CHARACTERISTIC c_dtc_vdmtl_2 "C_DTC_VDMTL_2" VALUE 0x705ba a_85 100 LINEAR______0_000000__0H___65535 0.0 65535.0 BIT_MASK 0xffffffff FUNCTION_LIST DMTL /end CHARACTERISTIC
/begin CHARACTERISTIC c_dtc_vdmtl_3 "C_DTC_VDMTL_3" VALUE 0x705bc a_85 100 LINEAR______0_000000__0H___65535 0.0 65535.0 BIT_MASK 0xffffffff FUNCTION_LIST DMTL /end CHARACTERISTIC
/begin CHARACTERISTIC c_dtc_vim_0 "C_DTC_VIM_0" VALUE 0x705be a_85 100 LINEAR______0_000000__0H___65535 0.0 65535.0 BIT_MASK 0xffffffff /end CHARACTERISTIC
/begin CHARACTERISTIC c_dtc_vim_1 "C_DTC_VIM_1" VALUE 0x705c0 a_85 100 LINEAR______0_000000__0H___65535 0.0 65535.0 BIT_MASK 0xffffffff /end CHARACTERISTIC
/begin CHARACTERISTIC c_dtc_vim_2 "C_DTC_VIM_2" VALUE 0x705c2 a_85 100 LINEAR______0_000000__0H___65535 0.0 65535.0 BIT_MASK 0xffffffff /end CHARACTERISTIC
/begin CHARACTERISTIC c_dtc_vim_3 "C_DTC_VIM_3" VALUE 0x705c4 a_85 100 LINEAR______0_000000__0H___65535 0.0 65535.0 BIT_MASK 0xffffffff /end CHARACTERISTIC
/begin CHARACTERISTIC c_dtc_vls_down_1_0 "C_DTC_VLS_DOWN_1_0" VALUE 0x705c6 a_85 100 LINEAR______0_000000__0H___65535 0.0 65535.0 BIT_MASK 0xffffffff /end CHARACTERISTIC
/begin CHARACTERISTIC c_dtc_vls_down_1_1 "C_DTC_VLS_DOWN_1_1" VALUE 0x705c8 a_85 100 LINEAR______0_000000__0H___65535 0.0 65535.0 BIT_MASK 0xffffffff /end CHARACTERISTIC
/begin CHARACTERISTIC c_dtc_vls_down_1_2 "C_DTC_VLS_DOWN_1_2" VALUE 0x705ca a_85 100 LINEAR______0_000000__0H___65535 0.0 65535.0 BIT_MASK 0xffffffff /end CHARACTERISTIC
/begin CHARACTERISTIC c_dtc_vls_down_1_3 "C_DTC_VLS_DOWN_1_3" VALUE 0x705cc a_85 100 LINEAR______0_000000__0H___65535 0.0 65535.0 BIT_MASK 0xffffffff /end CHARACTERISTIC
/begin CHARACTERISTIC c_dtc_vls_down_2_0 "C_DTC_VLS_DOWN_2_0" VALUE 0x705ce a_85 100 LINEAR______0_000000__0H___65535 0.0 65535.0 BIT_MASK 0xffffffff /end CHARACTERISTIC
/begin CHARACTERISTIC c_dtc_vls_down_2_1 "C_DTC_VLS_DOWN_2_1" VALUE 0x705d0 a_85 100 LINEAR______0_000000__0H___65535 0.0 65535.0 BIT_MASK 0xffffffff /end CHARACTERISTIC
/begin CHARACTERISTIC c_dtc_vls_down_2_2 "C_DTC_VLS_DOWN_2_2" VALUE 0x705d2 a_85 100 LINEAR______0_000000__0H___65535 0.0 65535.0 BIT_MASK 0xffffffff /end CHARACTERISTIC
/begin CHARACTERISTIC c_dtc_vls_down_2_3 "C_DTC_VLS_DOWN_2_3" VALUE 0x705d4 a_85 100 LINEAR______0_000000__0H___65535 0.0 65535.0 BIT_MASK 0xffffffff /end CHARACTERISTIC
/begin CHARACTERISTIC c_dtc_vls_down_act_chk_1_0 "C_DTC_VLS_DOWN_ACT_CHK_1_0" VALUE 0x705d6 a_85 100 LINEAR______0_000000__0H___65535 0.0 65535.0 BIT_MASK 0xffffffff /end CHARACTERISTIC
/begin CHARACTERISTIC c_dtc_vls_down_act_chk_1_1 "C_DTC_VLS_DOWN_ACT_CHK_1_1" VALUE 0x705d8 a_85 100 LINEAR______0_000000__0H___65535 0.0 65535.0 BIT_MASK 0xffffffff /end CHARACTERISTIC
/begin CHARACTERISTIC c_dtc_vls_down_act_chk_1_2 "C_DTC_VLS_DOWN_ACT_CHK_1_2" VALUE 0x705da a_85 100 LINEAR______0_000000__0H___65535 0.0 65535.0 BIT_MASK 0xffffffff /end CHARACTERISTIC
/begin CHARACTERISTIC c_dtc_vls_down_act_chk_1_3 "C_DTC_VLS_DOWN_ACT_CHK_1_3" VALUE 0x705dc a_85 100 LINEAR______0_000000__0H___65535 0.0 65535.0 BIT_MASK 0xffffffff /end CHARACTERISTIC
/begin CHARACTERISTIC c_dtc_vls_down_act_chk_2_0 "C_DTC_VLS_DOWN_ACT_CHK_2_0" VALUE 0x705de a_85 100 LINEAR______0_000000__0H___65535 0.0 65535.0 BIT_MASK 0xffffffff /end CHARACTERISTIC
/begin CHARACTERISTIC c_dtc_vls_down_act_chk_2_1 "C_DTC_VLS_DOWN_ACT_CHK_2_1" VALUE 0x705e0 a_85 100 LINEAR______0_000000__0H___65535 0.0 65535.0 BIT_MASK 0xffffffff /end CHARACTERISTIC
/begin CHARACTERISTIC c_dtc_vls_down_act_chk_2_2 "C_DTC_VLS_DOWN_ACT_CHK_2_2" VALUE 0x705e2 a_85 100 LINEAR______0_000000__0H___65535 0.0 65535.0 BIT_MASK 0xffffffff /end CHARACTERISTIC
/begin CHARACTERISTIC c_dtc_vls_down_act_chk_2_3 "C_DTC_VLS_DOWN_ACT_CHK_2_3" VALUE 0x705e4 a_85 100 LINEAR______0_000000__0H___65535 0.0 65535.0 BIT_MASK 0xffffffff /end CHARACTERISTIC
/begin CHARACTERISTIC c_dtc_vls_down_afl_1_0 "C_DTC_VLS_DOWN_AFL_1_0" VALUE 0x705e6 a_85 100 LINEAR______0_000000__0H___65535 0.0 65535.0 BIT_MASK 0xffffffff /end CHARACTERISTIC
/begin CHARACTERISTIC c_dtc_vls_down_afl_1_1 "C_DTC_VLS_DOWN_AFL_1_1" VALUE 0x705e8 a_85 100 LINEAR______0_000000__0H___65535 0.0 65535.0 BIT_MASK 0xffffffff /end CHARACTERISTIC
/begin CHARACTERISTIC c_dtc_vls_down_afl_1_2 "C_DTC_VLS_DOWN_AFL_1_2" VALUE 0x705ea a_85 100 LINEAR______0_000000__0H___65535 0.0 65535.0 BIT_MASK 0xffffffff /end CHARACTERISTIC
/begin CHARACTERISTIC c_dtc_vls_down_afl_1_3 "C_DTC_VLS_DOWN_AFL_1_3" VALUE 0x705ec a_85 100 LINEAR______0_000000__0H___65535 0.0 65535.0 BIT_MASK 0xffffffff /end CHARACTERISTIC
/begin CHARACTERISTIC c_dtc_vls_down_afl_2_0 "C_DTC_VLS_DOWN_AFL_2_0" VALUE 0x705ee a_85 100 LINEAR______0_000000__0H___65535 0.0 65535.0 BIT_MASK 0xffffffff /end CHARACTERISTIC
/begin CHARACTERISTIC c_dtc_vls_down_afl_2_1 "C_DTC_VLS_DOWN_AFL_2_1" VALUE 0x705f0 a_85 100 LINEAR______0_000000__0H___65535 0.0 65535.0 BIT_MASK 0xffffffff /end CHARACTERISTIC
/begin CHARACTERISTIC c_dtc_vls_down_afl_2_2 "C_DTC_VLS_DOWN_AFL_2_2" VALUE 0x705f2 a_85 100 LINEAR______0_000000__0H___65535 0.0 65535.0 BIT_MASK 0xffffffff /end CHARACTERISTIC
/begin CHARACTERISTIC c_dtc_vls_down_afl_2_3 "C_DTC_VLS_DOWN_AFL_2_3" VALUE 0x705f4 a_85 100 LINEAR______0_000000__0H___65535 0.0 65535.0 BIT_MASK 0xffffffff /end CHARACTERISTIC
/begin CHARACTERISTIC c_dtc_vls_down_post_puc_1_0 "C_DTC_VLS_DOWN_POST_PUC_1_0" VALUE 0x705f6 a_85 100 LINEAR______0_000000__0H___65535 0.0 65535.0 BIT_MASK 0xffffffff /end CHARACTERISTIC
/begin CHARACTERISTIC c_dtc_vls_down_post_puc_1_1 "C_DTC_VLS_DOWN_POST_PUC_1_1" VALUE 0x705f8 a_85 100 LINEAR______0_000000__0H___65535 0.0 65535.0 BIT_MASK 0xffffffff /end CHARACTERISTIC
/begin CHARACTERISTIC c_dtc_vls_down_post_puc_1_2 "C_DTC_VLS_DOWN_POST_PUC_1_2" VALUE 0x705fa a_85 100 LINEAR______0_000000__0H___65535 0.0 65535.0 BIT_MASK 0xffffffff /end CHARACTERISTIC
/begin CHARACTERISTIC c_dtc_vls_down_post_puc_1_3 "C_DTC_VLS_DOWN_POST_PUC_1_3" VALUE 0x705fc a_85 100 LINEAR______0_000000__0H___65535 0.0 65535.0 BIT_MASK 0xffffffff /end CHARACTERISTIC
/begin CHARACTERISTIC c_dtc_vls_down_post_puc_2_0 "C_DTC_VLS_DOWN_POST_PUC_2_0" VALUE 0x705fe a_85 100 LINEAR______0_000000__0H___65535 0.0 65535.0 BIT_MASK 0xffffffff /end CHARACTERISTIC
/begin CHARACTERISTIC c_dtc_vls_down_post_puc_2_1 "C_DTC_VLS_DOWN_POST_PUC_2_1" VALUE 0x70600 a_85 100 LINEAR______0_000000__0H___65535 0.0 65535.0 BIT_MASK 0xffffffff /end CHARACTERISTIC
/begin CHARACTERISTIC c_dtc_vls_down_post_puc_2_2 "C_DTC_VLS_DOWN_POST_PUC_2_2" VALUE 0x70602 a_85 100 LINEAR______0_000000__0H___65535 0.0 65535.0 BIT_MASK 0xffffffff /end CHARACTERISTIC
/begin CHARACTERISTIC c_dtc_vls_down_post_puc_2_3 "C_DTC_VLS_DOWN_POST_PUC_2_3" VALUE 0x70604 a_85 100 LINEAR______0_000000__0H___65535 0.0 65535.0 BIT_MASK 0xffffffff /end CHARACTERISTIC
/begin CHARACTERISTIC c_dtc_vls_down_t_1_0 "C_DTC_VLS_DOWN_T_1_0" VALUE 0x70606 a_85 100 LINEAR______0_000000__0H___65535 0.0 65535.0 BIT_MASK 0xffffffff /end CHARACTERISTIC
/begin CHARACTERISTIC c_dtc_vls_down_t_1_1 "C_DTC_VLS_DOWN_T_1_1" VALUE 0x70608 a_85 100 LINEAR______0_000000__0H___65535 0.0 65535.0 BIT_MASK 0xffffffff /end CHARACTERISTIC
/begin CHARACTERISTIC c_dtc_vls_down_t_1_2 "C_DTC_VLS_DOWN_T_1_2" VALUE 0x7060a a_85 100 LINEAR______0_000000__0H___65535 0.0 65535.0 BIT_MASK 0xffffffff /end CHARACTERISTIC
/begin CHARACTERISTIC c_dtc_vls_down_t_1_3 "C_DTC_VLS_DOWN_T_1_3" VALUE 0x7060c a_85 100 LINEAR______0_000000__0H___65535 0.0 65535.0 BIT_MASK 0xffffffff /end CHARACTERISTIC
/begin CHARACTERISTIC c_dtc_vls_down_t_2_0 "C_DTC_VLS_DOWN_T_2_0" VALUE 0x7060e a_85 100 LINEAR______0_000000__0H___65535 0.0 65535.0 BIT_MASK 0xffffffff /end CHARACTERISTIC
/begin CHARACTERISTIC c_dtc_vls_down_t_2_1 "C_DTC_VLS_DOWN_T_2_1" VALUE 0x70610 a_85 100 LINEAR______0_000000__0H___65535 0.0 65535.0 BIT_MASK 0xffffffff /end CHARACTERISTIC
/begin CHARACTERISTIC c_dtc_vls_down_t_2_2 "C_DTC_VLS_DOWN_T_2_2" VALUE 0x70612 a_85 100 LINEAR______0_000000__0H___65535 0.0 65535.0 BIT_MASK 0xffffffff /end CHARACTERISTIC
/begin CHARACTERISTIC c_dtc_vls_down_t_2_3 "C_DTC_VLS_DOWN_T_2_3" VALUE 0x70614 a_85 100 LINEAR______0_000000__0H___65535 0.0 65535.0 BIT_MASK 0xffffffff /end CHARACTERISTIC
/begin CHARACTERISTIC c_dtc_vls_jump_1_0 "C_DTC_VLS_JUMP_1_0" VALUE 0x70616 a_85 100 LINEAR______0_000000__0H___65535 0.0 65535.0 BIT_MASK 0xffffffff /end CHARACTERISTIC
/begin CHARACTERISTIC c_dtc_vls_jump_1_1 "C_DTC_VLS_JUMP_1_1" VALUE 0x70618 a_85 100 LINEAR______0_000000__0H___65535 0.0 65535.0 BIT_MASK 0xffffffff /end CHARACTERISTIC
/begin CHARACTERISTIC c_dtc_vls_jump_1_2 "C_DTC_VLS_JUMP_1_2" VALUE 0x7061a a_85 100 LINEAR______0_000000__0H___65535 0.0 65535.0 BIT_MASK 0xffffffff /end CHARACTERISTIC
/begin CHARACTERISTIC c_dtc_vls_jump_1_3 "C_DTC_VLS_JUMP_1_3" VALUE 0x7061c a_85 100 LINEAR______0_000000__0H___65535 0.0 65535.0 BIT_MASK 0xffffffff /end CHARACTERISTIC
/begin CHARACTERISTIC c_dtc_vls_jump_2_0 "C_DTC_VLS_JUMP_2_0" VALUE 0x7061e a_85 100 LINEAR______0_000000__0H___65535 0.0 65535.0 BIT_MASK 0xffffffff /end CHARACTERISTIC
/begin CHARACTERISTIC c_dtc_vls_jump_2_1 "C_DTC_VLS_JUMP_2_1" VALUE 0x70620 a_85 100 LINEAR______0_000000__0H___65535 0.0 65535.0 BIT_MASK 0xffffffff /end CHARACTERISTIC
/begin CHARACTERISTIC c_dtc_vls_jump_2_2 "C_DTC_VLS_JUMP_2_2" VALUE 0x70622 a_85 100 LINEAR______0_000000__0H___65535 0.0 65535.0 BIT_MASK 0xffffffff /end CHARACTERISTIC
/begin CHARACTERISTIC c_dtc_vls_jump_2_3 "C_DTC_VLS_JUMP_2_3" VALUE 0x70624 a_85 100 LINEAR______0_000000__0H___65535 0.0 65535.0 BIT_MASK 0xffffffff /end CHARACTERISTIC
/begin CHARACTERISTIC c_dtc_vls_stk_1_0 "C_DTC_VLS_STK_1_0" VALUE 0x70626 a_85 100 LINEAR______0_000000__0H___65535 0.0 65535.0 BIT_MASK 0xffffffff /end CHARACTERISTIC
/begin CHARACTERISTIC c_dtc_vls_stk_1_1 "C_DTC_VLS_STK_1_1" VALUE 0x70628 a_85 100 LINEAR______0_000000__0H___65535 0.0 65535.0 BIT_MASK 0xffffffff /end CHARACTERISTIC
/begin CHARACTERISTIC c_dtc_vls_stk_1_2 "C_DTC_VLS_STK_1_2" VALUE 0x7062a a_85 100 LINEAR______0_000000__0H___65535 0.0 65535.0 BIT_MASK 0xffffffff /end CHARACTERISTIC
/begin CHARACTERISTIC c_dtc_vls_stk_1_3 "C_DTC_VLS_STK_1_3" VALUE 0x7062c a_85 100 LINEAR______0_000000__0H___65535 0.0 65535.0 BIT_MASK 0xffffffff /end CHARACTERISTIC
/begin CHARACTERISTIC c_dtc_vls_stk_2_0 "C_DTC_VLS_STK_2_0" VALUE 0x7062e a_85 100 LINEAR______0_000000__0H___65535 0.0 65535.0 BIT_MASK 0xffffffff /end CHARACTERISTIC
/begin CHARACTERISTIC c_dtc_vls_stk_2_1 "C_DTC_VLS_STK_2_1" VALUE 0x70630 a_85 100 LINEAR______0_000000__0H___65535 0.0 65535.0 BIT_MASK 0xffffffff /end CHARACTERISTIC
/begin CHARACTERISTIC c_dtc_vls_stk_2_2 "C_DTC_VLS_STK_2_2" VALUE 0x70632 a_85 100 LINEAR______0_000000__0H___65535 0.0 65535.0 BIT_MASK 0xffffffff /end CHARACTERISTIC
/begin CHARACTERISTIC c_dtc_vls_stk_2_3 "C_DTC_VLS_STK_2_3" VALUE 0x70634 a_85 100 LINEAR______0_000000__0H___65535 0.0 65535.0 BIT_MASK 0xffffffff /end CHARACTERISTIC
/begin CHARACTERISTIC c_dtc_vls_up_1_0 "C_DTC_VLS_UP_1_0" VALUE 0x70636 a_85 100 LINEAR______0_000000__0H___65535 0.0 65535.0 BIT_MASK 0xffffffff /end CHARACTERISTIC
/begin CHARACTERISTIC c_dtc_vls_up_1_1 "C_DTC_VLS_UP_1_1" VALUE 0x70638 a_85 100 LINEAR______0_000000__0H___65535 0.0 65535.0 BIT_MASK 0xffffffff /end CHARACTERISTIC
/begin CHARACTERISTIC c_dtc_vls_up_1_2 "C_DTC_VLS_UP_1_2" VALUE 0x7063a a_85 100 LINEAR______0_000000__0H___65535 0.0 65535.0 BIT_MASK 0xffffffff /end CHARACTERISTIC
/begin CHARACTERISTIC c_dtc_vls_up_1_3 "C_DTC_VLS_UP_1_3" VALUE 0x7063c a_85 100 LINEAR______0_000000__0H___65535 0.0 65535.0 BIT_MASK 0xffffffff /end CHARACTERISTIC
/begin CHARACTERISTIC c_dtc_vls_up_2_0 "C_DTC_VLS_UP_2_0" VALUE 0x7063e a_85 100 LINEAR______0_000000__0H___65535 0.0 65535.0 BIT_MASK 0xffffffff /end CHARACTERISTIC
/begin CHARACTERISTIC c_dtc_vls_up_2_1 "C_DTC_VLS_UP_2_1" VALUE 0x70640 a_85 100 LINEAR______0_000000__0H___65535 0.0 65535.0 BIT_MASK 0xffffffff /end CHARACTERISTIC
/begin CHARACTERISTIC c_dtc_vls_up_2_2 "C_DTC_VLS_UP_2_2" VALUE 0x70642 a_85 100 LINEAR______0_000000__0H___65535 0.0 65535.0 BIT_MASK 0xffffffff /end CHARACTERISTIC
/begin CHARACTERISTIC c_dtc_vls_up_2_3 "C_DTC_VLS_UP_2_3" VALUE 0x70644 a_85 100 LINEAR______0_000000__0H___65535 0.0 65535.0 BIT_MASK 0xffffffff /end CHARACTERISTIC
/begin CHARACTERISTIC c_dtc_vs_0 "C_DTC_VS_0" VALUE 0x70646 a_85 100 LINEAR______0_000000__0H___65535 0.0 65535.0 BIT_MASK 0xffffffff /end CHARACTERISTIC
/begin CHARACTERISTIC c_dtc_vs_1 "C_DTC_VS_1" VALUE 0x70648 a_85 100 LINEAR______0_000000__0H___65535 0.0 65535.0 BIT_MASK 0xffffffff /end CHARACTERISTIC
/begin CHARACTERISTIC c_dtc_vs_2 "C_DTC_VS_2" VALUE 0x7064a a_85 100 LINEAR______0_000000__0H___65535 0.0 65535.0 BIT_MASK 0xffffffff /end CHARACTERISTIC
/begin CHARACTERISTIC c_dtc_vs_3 "C_DTC_VS_3" VALUE 0x7064c a_85 100 LINEAR______0_000000__0H___65535 0.0 65535.0 BIT_MASK 0xffffffff /end CHARACTERISTIC
/begin CHARACTERISTIC c_dyn_max_t_seg_ad_er "C_DYN_MAX_T_SEG_AD_ER" VALUE 0x7064e a_85 5 LINEAR______0_000000__0H___32767 0.0 32767.0 BIT_MASK 0xffffffff /end CHARACTERISTIC
/begin CHARACTERISTIC c_dyw_cycnr_is "C_DYW_CYCNR_IS" VALUE 0x70ae5 a_86 10 LINEAR______1_000000__1H___25103 1.0 255.0 BIT_MASK 0xffffffff /end CHARACTERISTIC
/begin CHARACTERISTIC c_ecfpwm_act_ecf "C_ECFPWM_ACT_ECF" VALUE 0x70ae6 a_86 100 LINEAR______0_000000__0H___99_60 0.0 99.609375 BIT_MASK 0xffffffff /end CHARACTERISTIC
/begin CHARACTERISTIC c_ecfpwm_max "C_ECFPWM_MAX" VALUE 0x70ae7 a_86 100 LINEAR______0_000000__0H___99_60 0.0 99.609375 BIT_MASK 0xffffffff /end CHARACTERISTIC
/begin CHARACTERISTIC c_ecfpwm_min "C_ECFPWM_MIN" VALUE 0x70ae8 a_86 100 LINEAR______0_000000__0H___99_60 0.0 99.609375 BIT_MASK 0xffffffff /end CHARACTERISTIC
/begin CHARACTERISTIC c_eff_iga_lim_mon "C_EFF_IGA_LIM_MON" VALUE 0x71265 a_86 100 LINEAR______0_000000__0H___1_992 0.0 1.9921875 BIT_MASK 0xffffffff /end CHARACTERISTIC
/begin CHARACTERISTIC c_eff_iga_lim_mon2 "C_EFF_IGA_LIM_MON2" VALUE 0x70ae9 a_86 100 LINEAR______0_000000__0H___1_992 0.0 1.9921875 BIT_MASK 0xffffffff FUNCTION_LIST MON2 /end CHARACTERISTIC
/begin CHARACTERISTIC c_ena_fco_diag "C_ENA_FCO_DIAG" VALUE 0x70650 a_85 100 LINEAR______0_000000__0H___4294_ 0.0 4294.9 BIT_MASK 0xffffffff FUNCTION_LIST DMTL /end CHARACTERISTIC
/begin CHARACTERISTIC c_etcu_1_cycnr_max "C_ETCU_1_CYCNR_MAX" VALUE 0x70aea a_86 19 LINEAR______1_000000__1H___255_0 1.0 255.0 BIT_MASK 0xffffffff /end CHARACTERISTIC
/begin CHARACTERISTIC c_fac_ac_pos_cru "C_FAC_AC_POS_CRU" VALUE 0x70aeb a_86 10 LINEAR______0_000000__0H___0_996 0.0 0.99609375 BIT_MASK 0xffffffff /end CHARACTERISTIC
/begin CHARACTERISTIC c_fac_amp_cp_is "C_FAC_AMP_CP_IS" VALUE 0x70652 a_85 100 LINEAR______0_000000__0H___2_054 0.0 2.0 BIT_MASK 0xffffffff /end CHARACTERISTIC
/begin CHARACTERISTIC c_fac_amp_max "C_FAC_AMP_MAX" VALUE 0x70654 a_85 100 LINEAR______0_000000__0H___1_999 0.0 1.99997 BIT_MASK 0xffffffff /end CHARACTERISTIC
/begin CHARACTERISTIC c_fac_amp_min "C_FAC_AMP_MIN" VALUE 0x70656 a_85 100 LINEAR______0_000000__0H___1_999 0.0 1.99997 BIT_MASK 0xffffffff /end CHARACTERISTIC
/begin CHARACTERISTIC c_fac_cam_dif_ctl_1 "C_FAC_CAM_DIF_CTL_1" VALUE 0x70aec a_86 100 LINEAR______0_000000__0H___0_996 0.0 0.99609375 BIT_MASK 0xffffffff /end CHARACTERISTIC
/begin CHARACTERISTIC c_fac_cam_dif_ctl_2 "C_FAC_CAM_DIF_CTL_2" VALUE 0x70aed a_86 100 LINEAR______0_000000__0H___0_996 0.0 0.99609375 BIT_MASK 0xffffffff /end CHARACTERISTIC
/begin CHARACTERISTIC c_fac_cam_sp_in_isapwm_min "C_FAC_CAM_SP_IN_ISAPWM_MIN" VALUE 0x70aee a_86 100 LINEAR______0_000000__0H___0_996 0.0 0.99609375 BIT_MASK 0xffffffff /end CHARACTERISTIC
/begin CHARACTERISTIC c_fac_cam_sp_pl_cat_var "C_FAC_CAM_SP_PL_CAT_VAR" VALUE 0x70aef a_86 100 LINEAR______0_000000__0H___0_996 0.0 0.99609375 BIT_MASK 0xffffffff /end CHARACTERISTIC
/begin CHARACTERISTIC c_fac_ch_2_n_sp_red "C_FAC_CH_2_N_SP_RED" VALUE 0x70af0 a_86 100 LINEAR______0_000000__0H___0_996 0.0 0.99609375 BIT_MASK 0xffffffff /end CHARACTERISTIC
/begin CHARACTERISTIC c_fac_cor_amp "C_FAC_COR_AMP" VALUE 0x70af1 a_86 100 LINEAR______0_000000__0H___0_996 0.0 0.99609375 BIT_MASK 0xffffffff /end CHARACTERISTIC
/begin CHARACTERISTIC c_fac_cor_pu_wf "C_FAC_COR_PU_WF" VALUE 0x70af2 a_86 100 LINEAR______0_000000__0H___0_996 0.0 0.99609375 BIT_MASK 0xffffffff /end CHARACTERISTIC
/begin CHARACTERISTIC c_fac_cor_puc_wf "C_FAC_COR_PUC_WF" VALUE 0x70af3 a_86 100 LINEAR______0_000000__0H___0_996 0.0 0.99609375 BIT_MASK 0xffffffff /end CHARACTERISTIC
/begin CHARACTERISTIC c_fac_cp_cyl_lam_ad_max "C_FAC_CP_CYL_LAM_AD_MAX" VALUE 0x70af4 a_86 100 LINEAR______0_000000__0H___0_996 0.0 0.99609375 BIT_MASK 0xffffffff FUNCTION_LIST CSCM /end CHARACTERISTIC
/begin CHARACTERISTIC c_fac_cp_min_fsd "C_FAC_CP_MIN_FSD" VALUE 0x70af5 a_86 100 LINEAR______0_000000__0H___0_996 0.0 0.99609375 BIT_MASK 0xffffffff /end CHARACTERISTIC
/begin CHARACTERISTIC c_fac_crlc_dec_down_1 "C_FAC_CRLC_DEC_DOWN_1" VALUE 0x70af6 a_86 100 LINEAR______0_000000__0H___1_992 0.0 1.9921875 BIT_MASK 0xffffffff FUNCTION_LIST ETM /end CHARACTERISTIC
/begin CHARACTERISTIC c_fac_crlc_dec_down_2 "C_FAC_CRLC_DEC_DOWN_2" VALUE 0x70af7 a_86 100 LINEAR______0_000000__0H___1_992 0.0 1.9921875 BIT_MASK 0xffffffff FUNCTION_LIST ETM /end CHARACTERISTIC
/begin CHARACTERISTIC c_fac_crlc_dec_puc_down_1 "C_FAC_CRLC_DEC_PUC_DOWN_1" VALUE 0x70af8 a_86 100 LINEAR______0_000000__0H___1_992 0.0 1.9921875 BIT_MASK 0xffffffff FUNCTION_LIST ETM /end CHARACTERISTIC
/begin CHARACTERISTIC c_fac_crlc_dec_puc_down_2 "C_FAC_CRLC_DEC_PUC_DOWN_2" VALUE 0x70af9 a_86 100 LINEAR______0_000000__0H___1_992 0.0 1.9921875 BIT_MASK 0xffffffff FUNCTION_LIST ETM /end CHARACTERISTIC
/begin CHARACTERISTIC c_fac_crlc_inc_down_1 "C_FAC_CRLC_INC_DOWN_1" VALUE 0x70afa a_86 100 LINEAR______0_000000__0H___1_992 0.0 1.9921875 BIT_MASK 0xffffffff FUNCTION_LIST ETM /end CHARACTERISTIC
/begin CHARACTERISTIC c_fac_crlc_inc_down_2 "C_FAC_CRLC_INC_DOWN_2" VALUE 0x70afb a_86 100 LINEAR______0_000000__0H___1_992 0.0 1.9921875 BIT_MASK 0xffffffff FUNCTION_LIST ETM /end CHARACTERISTIC
/begin CHARACTERISTIC c_fac_crlc_wall_dec_down_1 "C_FAC_CRLC_WALL_DEC_DOWN_1" VALUE 0x70afc a_86 100 LINEAR______0_000000__0H___1_992 0.0 1.9921875 BIT_MASK 0xffffffff FUNCTION_LIST ETM /end CHARACTERISTIC
/begin CHARACTERISTIC c_fac_crlc_wall_dec_down_2 "C_FAC_CRLC_WALL_DEC_DOWN_2" VALUE 0x70afd a_86 100 LINEAR______0_000000__0H___1_992 0.0 1.9921875 BIT_MASK 0xffffffff FUNCTION_LIST ETM /end CHARACTERISTIC
/begin CHARACTERISTIC c_fac_crlc_wall_dec_puc_down_1 "C_FAC_CRLC_WALL_DEC_PUC_DOWN_1" VALUE 0x70afe a_86 100 LINEAR______0_000000__0H___1_992 0.0 1.9921875 BIT_MASK 0xffffffff FUNCTION_LIST ETM /end CHARACTERISTIC
/begin CHARACTERISTIC c_fac_crlc_wall_dec_puc_down_2 "C_FAC_CRLC_WALL_DEC_PUC_DOWN_2" VALUE 0x70aff a_86 100 LINEAR______0_000000__0H___1_992 0.0 1.9921875 BIT_MASK 0xffffffff FUNCTION_LIST ETM /end CHARACTERISTIC
/begin CHARACTERISTIC c_fac_crlc_wall_inc_down_1 "C_FAC_CRLC_WALL_INC_DOWN_1" VALUE 0x70b00 a_86 100 LINEAR______0_000000__0H___1_992 0.0 1.9921875 BIT_MASK 0xffffffff FUNCTION_LIST ETM /end CHARACTERISTIC
/begin CHARACTERISTIC c_fac_crlc_wall_inc_down_2 "C_FAC_CRLC_WALL_INC_DOWN_2" VALUE 0x70b01 a_86 100 LINEAR______0_000000__0H___1_992 0.0 1.9921875 BIT_MASK 0xffffffff FUNCTION_LIST ETM /end CHARACTERISTIC
/begin CHARACTERISTIC c_fac_dly_ivvt_hld "C_FAC_DLY_IVVT_HLD" VALUE 0x70b02 a_86 100 LINEAR______0_000000__0H___15_93 0.0 15.9375 BIT_MASK 0xffffffff /end CHARACTERISTIC
/begin CHARACTERISTIC c_fac_egy_dew_stop "C_FAC_EGY_DEW_STOP" VALUE 0x70b03 a_86 15 LINEAR______0_000000__0H___0_996 0.0 0.99609375 BIT_MASK 0xffffffff FUNCTION_LIST DPM /end CHARACTERISTIC
/begin CHARACTERISTIC c_fac_hfm_max_diag "C_FAC_HFM_MAX_DIAG" VALUE 0x70658 a_85 100 LINEAR______1_000000__100H___16_ 1.0 16.0 BIT_MASK 0xffffffff /end CHARACTERISTIC
/begin CHARACTERISTIC c_fac_hfm_min_diag "C_FAC_HFM_MIN_DIAG" VALUE 0x7065a a_85 100 LINEAR______0_062500__10H___1_00 0.0625 1.0 BIT_MASK 0xffffffff /end CHARACTERISTIC
/begin CHARACTERISTIC c_fac_iga_aj_2 "C_FAC_IGA_AJ_2" VALUE 0x70b04 a_86 100 LINEAR______0_000000__0H___0_996 0.0 0.99609375 BIT_MASK 0xffffffff /end CHARACTERISTIC
/begin CHARACTERISTIC c_fac_iga_aj_3 "C_FAC_IGA_AJ_3" VALUE 0x70b05 a_86 100 LINEAR______0_000000__0H___0_996 0.0 0.99609375 BIT_MASK 0xffffffff /end CHARACTERISTIC
/begin CHARACTERISTIC c_fac_iga_ch_2_is "C_FAC_IGA_CH_2_IS" VALUE 0x70b06 a_86 100 LINEAR______0_000000__0H___0_996 0.0 0.99609375 BIT_MASK 0xffffffff /end CHARACTERISTIC
/begin CHARACTERISTIC c_fac_iga_ch_3 "C_FAC_IGA_CH_3" VALUE 0x70b07 a_86 100 LINEAR______0_000000__0H___0_996 0.0 0.99609375 BIT_MASK 0xffffffff /end CHARACTERISTIC
/begin CHARACTERISTIC c_fac_iga_isapwm_min_is "C_FAC_IGA_ISAPWM_MIN_IS" VALUE 0x70b08 a_86 100 LINEAR______0_000000__0H___0_996 0.0 0.99609375 BIT_MASK 0xffffffff /end CHARACTERISTIC
/begin CHARACTERISTIC c_fac_inc_cor_cp "C_FAC_INC_COR_CP" VALUE 0x70b09 a_86 20 LINEAR______0_000000__0H___0_996 0.0 0.99609375 BIT_MASK 0xffffffff /end CHARACTERISTIC
/begin CHARACTERISTIC c_fac_isapwm_accin_ad "C_FAC_ISAPWM_ACCIN_AD" VALUE 0x70b0a a_86 10 LINEAR______0_000000__0H___0_996 0.0 0.99609375 BIT_MASK 0xffffffff /end CHARACTERISTIC
/begin CHARACTERISTIC c_fac_ivvt_ch_2_red "C_FAC_IVVT_CH2_RED" VALUE 0x70b0b a_86 100 LINEAR______0_000000__0H___0_996 0.0 0.99609375 BIT_MASK 0xffffffff /end CHARACTERISTIC
/begin CHARACTERISTIC c_fac_ramp_slop "C_FAC_RAMP_SLOP" VALUE 0x7065c a_85 100 LINEAR______0_000000__0H___0_999 0.0 0.99998474 BIT_MASK 0xffffffff /end CHARACTERISTIC
/begin CHARACTERISTIC c_fac_ron_ad_cold "C_FAC_RON_AD_COLD" VALUE 0x70b0c a_86 100 LINEAR______0_000000__0H___1_992 0.0 1.9921875 BIT_MASK 0xffffffff /end CHARACTERISTIC
/begin CHARACTERISTIC c_fac_ron_ad_hot "C_FAC_RON_AD_HOT" VALUE 0x70b0d a_86 100 LINEAR______0_000000__0H___1_992 0.0 1.9921875 BIT_MASK 0xffffffff /end CHARACTERISTIC
/begin CHARACTERISTIC c_fac_ron_ad_min "C_FAC_RON_AD_MIN" VALUE 0x7065e a_85 100 LINEAR______0_000000__0H___0_999 0.0 0.99998474 BIT_MASK 0xffffffff /end CHARACTERISTIC
/begin CHARACTERISTIC c_fac_t_accin_on "C_FAC_T_ACCIN_ON" VALUE 0x70660 a_85 20 LINEAR______0_000000__0H___0_999 0.0 0.99998474 BIT_MASK 0xffffffff /end CHARACTERISTIC
/begin CHARACTERISTIC c_fac_t_cur_dmtl_stat_len "C_FAC_T_CUR_DMTL_STAT_LEN" VALUE 0x70662 a_85 100 LINEAR______0_000000__0H___0_999 0.0 0.99998474 BIT_MASK 0xffffffff /end CHARACTERISTIC
/begin CHARACTERISTIC c_fac_t_ivvt_adh_1 "C_FAC_T_IVVT_ADH_1" VALUE 0x70b0e a_86 100 LINEAR______0_000000__0H___15_93 0.0 15.9375 BIT_MASK 0xffffffff /end CHARACTERISTIC
/begin CHARACTERISTIC c_fac_t_ivvt_adh_2 "C_FAC_T_IVVT_ADH_2" VALUE 0x70b0f a_86 100 LINEAR______0_000000__0H___15_93 0.0 15.9375 BIT_MASK 0xffffffff /end CHARACTERISTIC
/begin CHARACTERISTIC c_fac_temp_ecf_down_1 "C_FAC_TEMP_ECF_DOWN_1" VALUE 0x70b10 a_86 100 LINEAR______0_000000__0H___1_992 0.0 1.9921875 BIT_MASK 0xffffffff FUNCTION_LIST ETM /end CHARACTERISTIC
/begin CHARACTERISTIC c_fac_temp_ecf_down_2 "C_FAC_TEMP_ECF_DOWN_2" VALUE 0x70b11 a_86 100 LINEAR______0_000000__0H___1_992 0.0 1.9921875 BIT_MASK 0xffffffff FUNCTION_LIST ETM /end CHARACTERISTIC
/begin CHARACTERISTIC c_fac_temp_iga_dif_down "C_FAC_TEMP_IGA_DIF_DOWN" VALUE 0x70b12 a_86 100 LINEAR______0_000000__0H___1_992 0.0 1.9921875 BIT_MASK 0xffffffff FUNCTION_LIST ETM /end CHARACTERISTIC
/begin CHARACTERISTIC c_fac_temp_sap_down "C_FAC_TEMP_SAP_DOWN" VALUE 0x70b13 a_86 100 LINEAR______0_000000__0H___1_992 0.0 1.9921875 BIT_MASK 0xffffffff FUNCTION_LIST ETM /end CHARACTERISTIC
/begin CHARACTERISTIC c_fac_temp_sub_down_1 "C_FAC_TEMP_SUB_DOWN_1" VALUE 0x70b14 a_86 100 LINEAR______0_000000__0H___1_992 0.0 1.9921875 BIT_MASK 0xffffffff FUNCTION_LIST ETM /end CHARACTERISTIC
/begin CHARACTERISTIC c_fac_temp_sub_down_2 "C_FAC_TEMP_SUB_DOWN_2" VALUE 0x70b15 a_86 100 LINEAR______0_000000__0H___1_992 0.0 1.9921875 BIT_MASK 0xffffffff FUNCTION_LIST ETM /end CHARACTERISTIC
/begin CHARACTERISTIC c_fac_temp_sub_ivvt_fl_down_1 "C_FAC_TEMP_SUB_IVVT_FL_DOWN_1" VALUE 0x70b16 a_86 100 LINEAR______0_000000__0H___1_992 0.0 1.9921875 BIT_MASK 0xffffffff FUNCTION_LIST ETM /end CHARACTERISTIC
/begin CHARACTERISTIC c_fac_temp_sub_ivvt_fl_down_2 "C_FAC_TEMP_SUB_IVVT_FL_DOWN_2" VALUE 0x70b17 a_86 100 LINEAR______0_000000__0H___1_992 0.0 1.9921875 BIT_MASK 0xffffffff FUNCTION_LIST ETM /end CHARACTERISTIC
/begin CHARACTERISTIC c_fac_temp_sub_puc_down "C_FAC_TEMP_SUB_PUC_DOWN" VALUE 0x70b18 a_86 100 LINEAR______0_000000__0H___1_992 0.0 1.9921875 BIT_MASK 0xffffffff FUNCTION_LIST ETM /end CHARACTERISTIC
/begin CHARACTERISTIC c_fac_temp_sub_vs_down_1 "C_FAC_TEMP_SUB_VS_DOWN_1" VALUE 0x70b19 a_86 100 LINEAR______0_000000__0H___1_992 0.0 1.9921875 BIT_MASK 0xffffffff FUNCTION_LIST ETM /end CHARACTERISTIC
/begin CHARACTERISTIC c_fac_temp_sub_vs_down_2 "C_FAC_TEMP_SUB_VS_DOWN_2" VALUE 0x70b1a a_86 100 LINEAR______0_000000__0H___1_992 0.0 1.9921875 BIT_MASK 0xffffffff FUNCTION_LIST ETM /end CHARACTERISTIC
/begin CHARACTERISTIC c_fac_temp_sub_wall_down_1 "C_FAC_TEMP_SUB_WALL_DOWN_1" VALUE 0x70b1b a_86 100 LINEAR______0_000000__0H___1_992 0.0 1.9921875 BIT_MASK 0xffffffff FUNCTION_LIST ETM /end CHARACTERISTIC
/begin CHARACTERISTIC c_fac_temp_sub_wall_down_2 "C_FAC_TEMP_SUB_WALL_DOWN_2" VALUE 0x70b1c a_86 100 LINEAR______0_000000__0H___1_992 0.0 1.9921875 BIT_MASK 0xffffffff FUNCTION_LIST ETM /end CHARACTERISTIC
/begin CHARACTERISTIC c_fac_temp_sub_wall_puc_down "C_FAC_TEMP_SUB_WALL_PUC_DOWN" VALUE 0x70b1f a_86 100 LINEAR______0_000000__0H___1_992 0.0 1.9921875 BIT_MASK 0xffffffff FUNCTION_LIST ETM /end CHARACTERISTIC
/begin CHARACTERISTIC c_fac_temp_sub_wall_vs_down_1 "C_FAC_TEMP_SUB_WALL_VS_DOWN_1" VALUE 0x70b20 a_86 100 LINEAR______0_000000__0H___1_992 0.0 1.9921875 BIT_MASK 0xffffffff FUNCTION_LIST ETM /end CHARACTERISTIC
/begin CHARACTERISTIC c_fac_temp_sub_wall_vs_down_2 "C_FAC_TEMP_SUB_WALL_VS_DOWN_2" VALUE 0x70b21 a_86 100 LINEAR______0_000000__0H___1_992 0.0 1.9921875 BIT_MASK 0xffffffff FUNCTION_LIST ETM /end CHARACTERISTIC
/begin CHARACTERISTIC c_fac_temp_ti_dif_down "C_FAC_TEMP_TI_DIF_DOWN" VALUE 0x70b22 a_86 100 LINEAR______0_000000__0H___1_992 0.0 1.9921875 BIT_MASK 0xffffffff FUNCTION_LIST ETM /end CHARACTERISTIC
/begin CHARACTERISTIC c_fac_temp_wall_ecf_down_1 "C_FAC_TEMP_WALL_ECF_DOWN_1" VALUE 0x70b23 a_86 100 LINEAR______0_000000__0H___1_992 0.0 1.9921875 BIT_MASK 0xffffffff FUNCTION_LIST ETM /end CHARACTERISTIC
/begin CHARACTERISTIC c_fac_temp_wall_ecf_down_2 "C_FAC_TEMP_WALL_ECF_DOWN_2" VALUE 0x70b24 a_86 100 LINEAR______0_000000__0H___1_992 0.0 1.9921875 BIT_MASK 0xffffffff FUNCTION_LIST ETM /end CHARACTERISTIC
/begin CHARACTERISTIC c_fac_temp_wall_iga_dif_down "C_FAC_TEMP_WALL_IGA_DIF_DOWN" VALUE 0x70b25 a_86 100 LINEAR______0_000000__0H___1_992 0.0 1.9921875 BIT_MASK 0xffffffff FUNCTION_LIST ETM /end CHARACTERISTIC
/begin CHARACTERISTIC c_fac_temp_wall_sap_down "C_FAC_TEMP_WALL_SAP_DOWN" VALUE 0x70b26 a_86 100 LINEAR______0_000000__0H___1_992 0.0 1.9921875 BIT_MASK 0xffffffff FUNCTION_LIST ETM /end CHARACTERISTIC
/begin CHARACTERISTIC c_fac_temp_wall_ti_dif_down "C_FAC_TEMP_WALL_TI_DIF_DOWN" VALUE 0x70b27 a_86 100 LINEAR______0_000000__0H___1_992 0.0 1.9921875 BIT_MASK 0xffffffff FUNCTION_LIST ETM /end CHARACTERISTIC
/begin CHARACTERISTIC c_fac_tqi_cor_max_mon "C_FAC_TQI_COR_MAX_MON" VALUE 0x7123c a_85 100 LINEAR______0_000000__0H___7_999 0.0 7.999878 BIT_MASK 0xffffffff /end CHARACTERISTIC
/begin CHARACTERISTIC c_fac_tqi_cor_min_mon "C_FAC_TQI_COR_MIN_MON" VALUE 0x7123e a_85 100 LINEAR______0_000000__0H___7_999 0.0 7.999878 BIT_MASK 0xffffffff /end CHARACTERISTIC
/begin CHARACTERISTIC c_fac_tra_knk "C_FAC_TRA_KNK" VALUE 0x70b28 a_86 10 LINEAR______1_000000__20H___7_96 1.0 7.9679999 BIT_MASK 0xffffffff /end CHARACTERISTIC
/begin CHARACTERISTIC c_fac_vls_cat_diag_max "C_FAC_VLS_CAT_DIAG_MAX" VALUE 0x70b29 a_86 100 LINEAR______0_000000__0H___0_996 0.0 0.99609375 BIT_MASK 0xffffffff /end CHARACTERISTIC
/begin CHARACTERISTIC c_fac_vls_cat_diag_min "C_FAC_VLS_CAT_DIAG_MIN" VALUE 0x70b2a a_86 100 LINEAR______0_000000__0H___0_996 0.0 0.99609375 BIT_MASK 0xffffffff /end CHARACTERISTIC
/begin CHARACTERISTIC c_fac_vls_dly_frq_afl "C_FAC_VLS_DLY_FRQ_AFL" VALUE 0x70664 a_85 100 LINEAR______0_000000__0H___1_999 0.0 1.99997 BIT_MASK 0xffffffff /end CHARACTERISTIC
/begin CHARACTERISTIC c_fac_vls_dly_frq_afr "C_FAC_VLS_DLY_FRQ_AFR" VALUE 0x70666 a_85 100 LINEAR______0_000000__0H___1_999 0.0 1.99997 BIT_MASK 0xffffffff /end CHARACTERISTIC
/begin CHARACTERISTIC c_fac_vls_frq_2 "C_FAC_VLS_FRQ_2" VALUE 0x70668 a_85 100 LINEAR______0_000000__0H___1_999 0.0 1.99997 BIT_MASK 0xffffffff /end CHARACTERISTIC
/begin CHARACTERISTIC c_fac_vls_swi_2 "C_FAC_VLS_SWI_2" VALUE 0x7066a a_85 100 LINEAR______0_000000__0H___1_999 0.0 1.99997 BIT_MASK 0xffffffff /end CHARACTERISTIC
/begin CHARACTERISTIC c_fac_vs_dif_rng_cru "C_FAC_VS_DIF_RNG_CRU" VALUE 0x70b2b a_86 10 LINEAR______0_000000__0H___0_996 0.0 0.99609375 BIT_MASK 0xffffffff /end CHARACTERISTIC
/begin CHARACTERISTIC c_fac_vs_fil "C_FAC_VS_FIL" VALUE 0x70b2c a_86 10 LINEAR______0_000000__0H___255_0 0.0 255.0 BIT_MASK 0xffffffff /end CHARACTERISTIC
/begin CHARACTERISTIC c_fco_diag_max "C_FCO_DIAG_MAX" VALUE 0x70da4 a_87 100 LINEAR_______128_000000__FFFF104 -128.0 127.0 BIT_MASK 0xffffffff FUNCTION_LIST DMTL /end CHARACTERISTIC
/begin CHARACTERISTIC c_fco_diag_min "C_FCO_DIAG_MIN" VALUE 0x70da5 a_87 100 LINEAR_______128_000000__FFFF104 -128.0 127.0 BIT_MASK 0xffffffff FUNCTION_LIST DMTL /end CHARACTERISTIC
/begin CHARACTERISTIC c_ftl_dec_ftl_diag_min "C_FTL_DEC_FTL_DIAG_MIN" VALUE 0x70da6 a_87 100 LINEAR_______128_000000__FFFF104 -128.0 127.0 BIT_MASK 0xffffffff FUNCTION_LIST DMTL /end CHARACTERISTIC
/begin CHARACTERISTIC c_ftl_diag_max "C_FTL_DIAG_MAX" VALUE 0x7066c a_85 100 LINEAR______0_000000__0H___12105 0.0 126.0 BIT_MASK 0xffffffff FUNCTION_LIST DMTL /end CHARACTERISTIC
/begin CHARACTERISTIC c_ftl_diag_min "C_FTL_DIAG_MIN" VALUE 0x70da7 a_87 100 LINEAR_______128_000000__FFFF104 -128.0 127.0 BIT_MASK 0xffffffff FUNCTION_LIST DMTL /end CHARACTERISTIC
/begin CHARACTERISTIC c_ftl_dmtl_max "C_FTL_DMTL_MAX" VALUE 0x70b2d a_86 4 LINEAR______0_000000__0H___126_0 0.0 126.0 BIT_MASK 0xffffffff FUNCTION_LIST DMTL /end CHARACTERISTIC
/begin CHARACTERISTIC c_ftl_dmtl_min "C_FTL_DMTL_MIN" VALUE 0x70b2e a_86 4 LINEAR______0_000000__0H___126_0 0.0 126.0 BIT_MASK 0xffffffff FUNCTION_LIST DMTL /end CHARACTERISTIC
/begin CHARACTERISTIC c_gr_max_slow_pu_at "C_GR_MAX_SLOW_PU_AT" VALUE 0x7066e a_85 10 LINEAR______0_000000__0H___81608 0.0 8160.0 BIT_MASK 0xffffffff /end CHARACTERISTIC
/begin CHARACTERISTIC c_gr_max_slow_pu_mt "C_GR_MAX_SLOW_PU_MT" VALUE 0x70670 a_85 10 LINEAR______0_000000__0H___81608 0.0 8160.0 BIT_MASK 0xffffffff /end CHARACTERISTIC
/begin CHARACTERISTIC c_gr_rax_sp "C_GR_RAX_SP" VALUE 0x70672 a_85 100 LINEAR______0_000000__0H___255_9 0.0 255.9961 BIT_MASK 0xffffffff /end CHARACTERISTIC
/begin CHARACTERISTIC c_hys_fac_scc "C_HYS_FAC_SCC" VALUE 0x70674 a_85 100 LINEAR______0_000000__0H___0_106 0.0 0.99998474 BIT_MASK 0xffffffff /end CHARACTERISTIC
/begin CHARACTERISTIC c_hys_ftl_dmtl "C_HYS_FTL_DMTL" VALUE 0x70b2f a_86 4 LINEAR______0_000000__0H___126_0 0.0 126.0 BIT_MASK 0xffffffff FUNCTION_LIST DMTL /end CHARACTERISTIC
/begin CHARACTERISTIC c_hys_ini_ivvt "C_HYS_INI_IVVT" VALUE 0x70b30 a_86 100 LINEAR______0_000000__0H___47_62 0.0 47.625 BIT_MASK 0xffffffff /end CHARACTERISTIC
/begin CHARACTERISTIC c_icl_2_cycnr_max "C_ICL_2_CYCNR_MAX" VALUE 0x70b31 a_86 100 LINEAR______1_000000__1H___255_0 1.0 255.0 BIT_MASK 0xffffffff /end CHARACTERISTIC
/begin CHARACTERISTIC c_icl_3_cycnr_max "C_ICL_3_CYCNR_MAX" VALUE 0x70b32 a_86 19 LINEAR______1_000000__1H___255_0 1.0 255.0 BIT_MASK 0xffffffff /end CHARACTERISTIC
/begin CHARACTERISTIC c_iga_ad_dif_max "C_IGA_AD_DIF_MAX" VALUE 0x70b33 a_86 10 LINEAR______0_000000__0H___47_62 0.0 47.625 BIT_MASK 0xffffffff /end CHARACTERISTIC
/begin CHARACTERISTIC c_iga_crk_diag_inc "C_IGA_CRK_DIAG_INC" VALUE 0x70676 a_85 10 LINEAR______0_001465__1H___47_99 0.001465 47.99854 BIT_MASK 0xffffffff /end CHARACTERISTIC
/begin CHARACTERISTIC c_iga_dif_cycnr_er "C_IGA_DIF_CYCNR_ER" VALUE 0x70b34 a_86 5 LINEAR______0_000000__0H___255_0 0.0 255.0 BIT_MASK 0xffffffff /end CHARACTERISTIC
/begin CHARACTERISTIC c_iga_dif_max_er "C_IGA_DIF_MAX_ER" VALUE 0x70b35 a_86 5 LINEAR______0_000000__0H___95_22 0.0 95.625 BIT_MASK 0xffffffff /end CHARACTERISTIC
/begin CHARACTERISTIC c_iga_inc_ad "C_IGA_INC_AD" VALUE 0x70b36 a_86 100 LINEAR______0_000000__0H___6_000 0.0 6.0 BIT_MASK 0xffffffff /end CHARACTERISTIC
/begin CHARACTERISTIC c_iga_isapwm_min_is_lgrd "C_IGA_ISAPWM_MIN_IS_LGRD" VALUE 0x70678 a_85 100 LINEAR______0_001465__1H___47_99 0.001465 47.99854 BIT_MASK 0xffffffff /end CHARACTERISTIC
/begin CHARACTERISTIC c_iga_knk_ad_max "C_IGA_KNK_AD_MAX" VALUE 0x70b37 a_86 100 LINEAR_______48_000000__0H___107 -48.0 0.0 BIT_MASK 0xffffffff /end CHARACTERISTIC
/begin CHARACTERISTIC c_iga_knk_ad_max_ron "C_IGA_KNK_AD_MAX_RON" VALUE 0x70b38 a_86 100 LINEAR_______48_000000__0H___107 -48.0 0.0 BIT_MASK 0xffffffff /end CHARACTERISTIC
/begin CHARACTERISTIC c_iga_knk_dif_max_min "C_IGA_KNK_DIF_MAX_MIN" VALUE 0x70b39 a_86 10 LINEAR______0_000000__0H___48_00 0.0 48.0 BIT_MASK 0xffffffff /end CHARACTERISTIC
/begin CHARACTERISTIC c_iga_lgrd_1 "C_IGA_LGRD_1" VALUE 0x7067a a_85 10 LINEAR______0_001465__1H___47_99 0.001465 47.99854 BIT_MASK 0xffffffff /end CHARACTERISTIC
/begin CHARACTERISTIC c_iga_lgrd_2 "C_IGA_LGRD_2" VALUE 0x7067c a_85 10 LINEAR______0_001465__1H___47_99 0.001465 47.99854 BIT_MASK 0xffffffff /end CHARACTERISTIC
/begin CHARACTERISTIC c_iga_lgrd_3 "C_IGA_LGRD_3" VALUE 0x7067e a_85 10 LINEAR______0_001465__1H___47_99 0.001465 47.99854 BIT_MASK 0xffffffff /end CHARACTERISTIC
/begin CHARACTERISTIC c_iga_lgrd_ch "C_IGA_LGRD_CH" VALUE 0x70680 a_85 10 LINEAR______0_001465__1H___47108 0.001465 47.99854 BIT_MASK 0xffffffff /end CHARACTERISTIC
/begin CHARACTERISTIC c_iga_lgrd_cs_is "C_IGA_LGRD_CS_IS" VALUE 0x70682 a_85 100 LINEAR______0_001465__1H___47_99 0.001465 47.99854 BIT_MASK 0xffffffff /end CHARACTERISTIC
/begin CHARACTERISTIC c_iga_lgrd_fac_2_ch_2 "C_IGA_LGRD_FAC_2_CH_2" VALUE 0x70684 a_85 100 LINEAR______0_000000__0H___0_109 0.0 0.99998474 BIT_MASK 0xffffffff /end CHARACTERISTIC
/begin CHARACTERISTIC c_iga_lgrd_fac_ch "C_IGA_LGRD_FAC_CH" VALUE 0x70686 a_85 100 LINEAR______0_000000__0H___0_109 0.0 0.99998474 BIT_MASK 0xffffffff /end CHARACTERISTIC
/begin CHARACTERISTIC c_iga_lgrd_fac_ch_2 "C_IGA_LGRD_FAC_CH_2" VALUE 0x70688 a_85 100 LINEAR______0_000000__0H___0_109 0.0 0.99998474 BIT_MASK 0xffffffff /end CHARACTERISTIC
/begin CHARACTERISTIC c_iga_lgrd_pl_ch_3 "C_IGA_LGRD_PL_CH_3" VALUE 0x7068a a_85 100 LINEAR______0_001465__1H___47108 0.001465 47.99854 BIT_MASK 0xffffffff /end CHARACTERISTIC
/begin CHARACTERISTIC c_iga_lgrd_pste "C_IGA_LGRD_PSTE" VALUE 0x7068c a_85 100 LINEAR______0_001465__1H___47_99 0.001465 47.99854 BIT_MASK 0xffffffff /end CHARACTERISTIC
/begin CHARACTERISTIC c_iga_maf_lgrd "C_IGA_MAF_LGRD" VALUE 0x70b3a a_86 5 LINEAR______5_440000__1H___1389_ 5.4400001 1389.0 BIT_MASK 0xffffffff /end CHARACTERISTIC
/begin CHARACTERISTIC c_iga_max_ad "C_IGA_MAX_AD" VALUE 0x70b3b a_86 10 LINEAR_______48_000000__0H___041 -48.0 0.0 BIT_MASK 0xffffffff /end CHARACTERISTIC
/begin CHARACTERISTIC c_iga_min_ad "C_IGA_MIN_AD" VALUE 0x70b3c a_86 10 LINEAR_______48_000000__0H___041 -48.0 0.0 BIT_MASK 0xffffffff /end CHARACTERISTIC
/begin CHARACTERISTIC c_iga_mv_knk_ron "C_IGA_MV_KNK_RON" VALUE 0x70b3d a_86 100 LINEAR_______48_000000__0H___47_ -48.0 47.625 BIT_MASK 0xffffffff /end CHARACTERISTIC
/begin CHARACTERISTIC c_iga_n_lgrd "C_IGA_N_LGRD" VALUE 0x7068e a_85 10 LINEAR______1_000000__1H___8160_ 1.0 8160.0 BIT_MASK 0xffffffff /end CHARACTERISTIC
/begin CHARACTERISTIC c_iga_ofs_supp_st "C_IGA_OFS_SUPP_ST" VALUE 0x70b3e a_86 100 LINEAR_______48_000000__0H___47_ -48.0 47.625 BIT_MASK 0xffffffff /end CHARACTERISTIC
/begin CHARACTERISTIC c_iga_pste_add_min "C_IGA_PSTE_ADD_MIN" VALUE 0x70b3f a_86 100 LINEAR_______48_000000__0H___107 -48.0 0.0 BIT_MASK 0xffffffff /end CHARACTERISTIC
/begin CHARACTERISTIC c_iga_sas "C_IGA_SAS" VALUE 0x70b40 a_86 100 LINEAR_______23_625000__0H___72_ -23.625 72.0 BIT_MASK 0xffffffff /end CHARACTERISTIC
/begin CHARACTERISTIC c_iga_vs_cor_max_is "C_IGA_VS_COR_MAX_IS" VALUE 0x70b41 a_86 100 LINEAR_______48_000000__0H___47_ -48.0 47.625 BIT_MASK 0xffffffff /end CHARACTERISTIC
/begin CHARACTERISTIC c_iga_vs_cor_min_is "C_IGA_VS_COR_MIN_IS" VALUE 0x70b42 a_86 100 LINEAR_______48_000000__0H___47_ -48.0 47.625 BIT_MASK 0xffffffff /end CHARACTERISTIC
/begin CHARACTERISTIC c_isapwm_accin_dec_tra "C_ISAPWM_ACCIN_DEC_TRA" VALUE 0x70690 a_85 20 LINEAR______0_000200__1H___6_248 0.0002 6.24847 BIT_MASK 0xffffffff /end CHARACTERISTIC
/begin CHARACTERISTIC c_isapwm_accin_i_max "C_ISAPWM_ACCIN_I_MAX" VALUE 0x70dc0 a_95 10 LINEAR_______50_000000__FFFF8000 -50.0 49.9985 BIT_MASK 0xffffffff /end CHARACTERISTIC
/begin CHARACTERISTIC c_isapwm_accin_i_min "C_ISAPWM_ACCIN_I_MIN" VALUE 0x70dc2 a_95 10 LINEAR_______50_000000__FFFF8000 -50.0 49.9985 BIT_MASK 0xffffffff /end CHARACTERISTIC
/begin CHARACTERISTIC c_isapwm_accin_lgrd "C_ISAPWM_ACCIN_LGRD" VALUE 0x70b43 a_86 0 LINEAR______0_0066100__1H___1_55 0.00661 1.5564 BIT_MASK 0xffffffff /end CHARACTERISTIC
/begin CHARACTERISTIC c_isapwm_accin_max_ad_is "C_ISAPWM_ACCIN_MAX_AD_IS" VALUE 0x70692 a_85 10 LINEAR______0_000000__0H___49_99 0.0 49.998501 BIT_MASK 0xffffffff /end CHARACTERISTIC
/begin CHARACTERISTIC c_isapwm_accin_min_ad_is "C_ISAPWM_ACCIN_MIN_AD_IS" VALUE 0x70dc4 a_95 10 LINEAR_______50_000000__FFFF8110 -50.0 0.0 BIT_MASK 0xffffffff /end CHARACTERISTIC
/begin CHARACTERISTIC c_isapwm_accin_vs_i_max_is "C_ISAPWM_ACCIN_VS_I_MAX_IS" VALUE 0x70dc6 a_95 10 LINEAR_______50_000000__FFFF8000 -50.0 49.9985 BIT_MASK 0xffffffff /end CHARACTERISTIC
/begin CHARACTERISTIC c_isapwm_accin_vs_i_min_is "C_ISAPWM_ACCIN_VS_I_MIN_IS" VALUE 0x70dc8 a_95 10 LINEAR_______50_000000__FFFF8000 -50.0 49.9985 BIT_MASK 0xffffffff /end CHARACTERISTIC
/begin CHARACTERISTIC c_isapwm_acin_lgrd_is "C_ISAPWM_ACIN_LGRD_IS" VALUE 0x70694 a_85 20 LINEAR______0_006100__1H___24_99 0.0061 24.9938 BIT_MASK 0xffffffff /end CHARACTERISTIC
/begin CHARACTERISTIC c_isapwm_ad_max_is "C_ISAPWM_AD_MAX_IS" VALUE 0x70696 a_85 10 LINEAR______0_000000__0H___49_99 0.0 49.998501 BIT_MASK 0xffffffff /end CHARACTERISTIC
/begin CHARACTERISTIC c_isapwm_ad_max_isa "C_ISAPWM_AD_MAX_ISA" VALUE 0x70b44 a_86 10 LINEAR______0_000000__0H___99_60 0.0 99.609375 BIT_MASK 0xffffffff /end CHARACTERISTIC
/begin CHARACTERISTIC c_isapwm_ad_min_isa "C_ISAPWM_AD_MIN_ISA" VALUE 0x70b45 a_86 10 LINEAR______0_000000__0H___99_60 0.0 99.609375 BIT_MASK 0xffffffff /end CHARACTERISTIC
/begin CHARACTERISTIC c_isapwm_add_i "C_ISAPWM_ADD_I" VALUE 0x70698 a_85 2 LINEAR______0_000000__0H___99_99 0.0 99.998474 BIT_MASK 0xffffffff /end CHARACTERISTIC
/begin CHARACTERISTIC c_isapwm_amt_add_max "C_ISAPWM_AMT_ADD_MAX" VALUE 0x70dca a_95 100 LINEAR_______200_000000__FFFF111 -200.0 199.9938 BIT_MASK 0xffffffff FUNCTION_LIST Z1S1 /end CHARACTERISTIC
/begin CHARACTERISTIC c_isapwm_crlc_is "C_ISAPWM_CRLC_IS" VALUE 0x70b46 a_86 20 LINEAR______0_000000__0H___0_996 0.0 0.99609375 BIT_MASK 0xffffffff /end CHARACTERISTIC
/begin CHARACTERISTIC c_isapwm_d_lgrd "C_ISAPWM_D_LGRD" VALUE 0x70b47 a_86 4 LINEAR______0_000000__0H___24_90 0.0 24.902 BIT_MASK 0xffffffff /end CHARACTERISTIC
/begin CHARACTERISTIC c_isapwm_dyw_diagcps "C_ISAPWM_DYW_DIAGCPS" VALUE 0x70b48 a_86 5 LINEAR______0_000000__0H___99_60 0.0 99.609375 BIT_MASK 0xffffffff /end CHARACTERISTIC
/begin CHARACTERISTIC c_isapwm_dyw_is "C_ISAPWM_DYW_IS" VALUE 0x7069a a_85 5 LINEAR______0_000000__0H___99_99 0.0 99.998474 BIT_MASK 0xffffffff /end CHARACTERISTIC
/begin CHARACTERISTIC c_isapwm_dyw_n_dif "C_ISAPWM_DYW_N_DIF" VALUE 0x70b49 a_86 100 LINEAR______0_000000__0H___99_60 0.0 99.609375 BIT_MASK 0xffffffff /end CHARACTERISTIC
/begin CHARACTERISTIC c_isapwm_i_max "C_ISAPWM_I_MAX" VALUE 0x70dcc a_95 10 LINEAR_______50_000000__FFFF8000 -50.0 49.9985 BIT_MASK 0xffffffff /end CHARACTERISTIC
/begin CHARACTERISTIC c_isapwm_i_max_is "C_ISAPWM_I_MAX_IS" VALUE 0x70dce a_95 10 LINEAR_______50_000000__FFFF8000 -50.0 49.9985 BIT_MASK 0xffffffff /end CHARACTERISTIC
/begin CHARACTERISTIC c_isapwm_i_min "C_ISAPWM_I_MIN" VALUE 0x70dd0 a_95 10 LINEAR_______50_000000__FFFF8000 -50.0 49.9985 BIT_MASK 0xffffffff /end CHARACTERISTIC
/begin CHARACTERISTIC c_isapwm_i_min_is "C_ISAPWM_I_MIN_IS" VALUE 0x70dd2 a_95 10 LINEAR_______50_000000__FFFF8000 -50.0 49.9985 BIT_MASK 0xffffffff /end CHARACTERISTIC
/begin CHARACTERISTIC c_isapwm_isa_diag "C_ISAPWM_ISA_DIAG" VALUE 0x7069c a_85 5 LINEAR______0_000000__0H___99_99 0.0 99.998474 BIT_MASK 0xffffffff /end CHARACTERISTIC
/begin CHARACTERISTIC c_isapwm_lgrd "C_ISAPWM_LGRD" VALUE 0x70b4a a_86 10 LINEAR______0_097700__1H___24_90 0.0977 24.902 BIT_MASK 0xffffffff /end CHARACTERISTIC
/begin CHARACTERISTIC c_isapwm_lgrd_crp "C_ISAPWM_LGRD_CRP" VALUE 0x7069e a_85 100 LINEAR______0_006100__1H___24_99 0.0061 24.9938 BIT_MASK 0xffffffff FUNCTION_LIST Z1S1 /end CHARACTERISTIC
/begin CHARACTERISTIC c_isapwm_lgrd_ecf "C_ISAPWM_LGRD_ECF" VALUE 0x706a0 a_85 100 LINEAR______0_006100__1H___24_99 0.0061 24.9938 BIT_MASK 0xffffffff /end CHARACTERISTIC
/begin CHARACTERISTIC c_isapwm_lgrd_hpa "C_ISAPWM_LGRD_HPA" VALUE 0x706a2 a_85 100 LINEAR______0_006100__1H___24_99 0.0061 24.9938 BIT_MASK 0xffffffff FUNCTION_LIST Z1S1 /end CHARACTERISTIC
/begin CHARACTERISTIC c_isapwm_ltg "C_ISAPWM_LTG" VALUE 0x706a4 a_85 100 LINEAR______0_000000__0H___399_9 0.0 399.9938 BIT_MASK 0xffffffff /end CHARACTERISTIC
/begin CHARACTERISTIC c_isapwm_maf_min_isa_diag "C_ISAPWM_MAF_MIN_ISA_DIAG" VALUE 0x706a6 a_85 30 LINEAR______0_000000__0H___99_99 0.0 99.998474 BIT_MASK 0xffffffff /end CHARACTERISTIC
/begin CHARACTERISTIC c_isapwm_min_ad_is "C_ISAPWM_MIN_AD_IS" VALUE 0x70dd4 a_95 10 LINEAR_______50_000000__FFFF8110 -50.0 0.0 BIT_MASK 0xffffffff /end CHARACTERISTIC
/begin CHARACTERISTIC c_isapwm_off_high "C_ISAPWM_OFF_HIGH" VALUE 0x706a8 a_85 100 LINEAR______0_000000__0H___99_99 0.0 99.998474 BIT_MASK 0xffffffff /end CHARACTERISTIC
/begin CHARACTERISTIC c_isapwm_off_low "C_ISAPWM_OFF_LOW" VALUE 0x706aa a_85 100 LINEAR______0_000000__0H___99_99 0.0 99.998474 BIT_MASK 0xffffffff /end CHARACTERISTIC
/begin CHARACTERISTIC c_isapwm_pste_add_max "C_ISAPWM_PSTE_ADD_MAX" VALUE 0x706ac a_85 100 LINEAR______0_000000__0H___399_9 0.0 399.9938 BIT_MASK 0xffffffff /end CHARACTERISTIC
/begin CHARACTERISTIC c_isapwm_sap_dec_tra "C_ISAPWM_SAP_DEC_TRA" VALUE 0x706ae a_85 16 LINEAR______0_000200__1H___6_248 0.0002 6.24847 BIT_MASK 0xffffffff /end CHARACTERISTIC
/begin CHARACTERISTIC c_isapwm_slow_pu_dec "C_ISAPWM_SLOW_PU_DEC" VALUE 0x706b0 a_85 10 LINEAR______0_006100__1H___24_99 0.0061 24.9938 BIT_MASK 0xffffffff /end CHARACTERISTIC
/begin CHARACTERISTIC c_isapwm_vs_i_max_is "C_ISAPWM_VS_I_MAX_IS" VALUE 0x70dd6 a_95 10 LINEAR_______50_000000__FFFF8000 -50.0 49.9985 BIT_MASK 0xffffffff /end CHARACTERISTIC
/begin CHARACTERISTIC c_isapwm_vs_i_min_is "C_ISAPWM_VS_I_MIN_IS" VALUE 0x70dd8 a_95 10 LINEAR_______50_000000__FFFF8000 -50.0 49.9985 BIT_MASK 0xffffffff /end CHARACTERISTIC
/begin CHARACTERISTIC c_ivvthpwm_ad_ofs_ex "C_IVVTHPWM_AD_OFS_EX" VALUE 0x70da8 a_87 100 LINEAR_______50_000000__FFFFFF80 -50.0 49.61 BIT_MASK 0xffffffff /end CHARACTERISTIC
/begin CHARACTERISTIC c_ivvtpwm_adc_ex "C_IVVTPWM_ADC_EX" VALUE 0x70b4b a_86 100 LINEAR______0_000000__0H___99_60 0.0 99.609375 BIT_MASK 0xffffffff /end CHARACTERISTIC
/begin CHARACTERISTIC c_ivvtpwm_adc_in "C_IVVTPWM_ADC_IN" VALUE 0x70b4c a_86 100 LINEAR______0_000000__0H___99_60 0.0 99.609375 BIT_MASK 0xffffffff /end CHARACTERISTIC
/begin CHARACTERISTIC c_ivvtpwm_rtd_ex "C_IVVTPWM_RTD_EX" VALUE 0x70b4d a_86 100 LINEAR______0_000000__0H___99_60 0.0 99.609375 BIT_MASK 0xffffffff /end CHARACTERISTIC
/begin CHARACTERISTIC c_ivvtpwm_rtd_in "C_IVVTPWM_RTD_IN" VALUE 0x70b4e a_86 100 LINEAR______0_000000__0H___99_60 0.0 99.609375 BIT_MASK 0xffffffff /end CHARACTERISTIC
/begin CHARACTERISTIC c_km_ctr_sub "C_KM_CTR_SUB" VALUE 0x706b2 a_85 100 LINEAR______0_000000__0H___65534 0.0 655340.0 BIT_MASK 0xffffffff /end CHARACTERISTIC
/begin CHARACTERISTIC c_km_ctr_supp_st "C_KM_CTR_SUPP_ST" VALUE 0x706b4 a_85 100 LINEAR______0_000000__0H___65112 0.0 65535.0 BIT_MASK 0xffffffff /end CHARACTERISTIC
/begin CHARACTERISTIC c_lam_ctl_conf "C_LAM_CTL_CONF" VALUE 0x70b4f a_86 100 LINEAR______0_000000__0H___1_000 0.0 1.0 BIT_MASK 0xffffffff /end CHARACTERISTIC
/begin CHARACTERISTIC c_lam_cycnr "C_LAM_CYCNR" VALUE 0x706b6 a_85 100 LINEAR______0_010000__1H___655_3 0.01 655.34998 BIT_MASK 0xffffffff /end CHARACTERISTIC
/begin CHARACTERISTIC c_lam_cycnr_diag "C_LAM_CYCNR_DIAG" VALUE 0x706b8 a_85 100 LINEAR______0_000000__0H___65113 0.0 65535.0 BIT_MASK 0xffffffff /end CHARACTERISTIC
/begin CHARACTERISTIC c_lam_cycnr_max "C_LAM_CYCNR_MAX" VALUE 0x70b50 a_86 10 LINEAR______0_000000__0H___25114 0.0 255.0 BIT_MASK 0xffffffff /end CHARACTERISTIC
/begin CHARACTERISTIC c_lam_dif_hys_cp "C_LAM_DIF_HYS_CP" VALUE 0x706ba a_85 100 LINEAR______0_000000__0H___31_25 0.0 31.25 BIT_MASK 0xffffffff /end CHARACTERISTIC
/begin CHARACTERISTIC c_lam_dif_sav_min_diag "C_LAM_DIF_SAV_MIN_DIAG" VALUE 0x706bc a_85 100 LINEAR______0_000000__0H___31_25 0.0 31.25 BIT_MASK 0xffffffff /end CHARACTERISTIC
/begin CHARACTERISTIC c_lam_fac_i_1 "C_LAM_FAC_I_1" VALUE 0x70b51 a_86 2 LINEAR______0_000000__0H___0_996 0.0 0.99609375 BIT_MASK 0xffffffff /end CHARACTERISTIC
/begin CHARACTERISTIC c_lam_fac_i_2 "C_LAM_FAC_I_2" VALUE 0x70b52 a_86 2 LINEAR______0_000000__0H___0_996 0.0 0.99609375 BIT_MASK 0xffffffff /end CHARACTERISTIC
/begin CHARACTERISTIC c_lam_fac_p "C_LAM_FAC_P" VALUE 0x70b53 a_86 4 LINEAR______0_000000__0H___0_996 0.0 0.99609375 BIT_MASK 0xffffffff /end CHARACTERISTIC
/begin CHARACTERISTIC c_lam_maf_min_diag "C_LAM_MAF_MIN_DIAG" VALUE 0x706be a_85 1 LINEAR______0_000000__0H___16383 0.0 16383.75 BIT_MASK 0xffffffff /end CHARACTERISTIC
/begin CHARACTERISTIC c_lam_max "C_LAM_MAX" VALUE 0x706c0 a_85 100 LINEAR______0_000000__8000H___31 0.0 31.25 BIT_MASK 0xffffffff /end CHARACTERISTIC
/begin CHARACTERISTIC c_lam_max_fsd "C_LAM_MAX_FSD" VALUE 0x706c2 a_85 100 LINEAR_______31_250000__3000H___ -31.25 31.25 BIT_MASK 0xffffffff /end CHARACTERISTIC
/begin CHARACTERISTIC c_lam_min "C_LAM_MIN" VALUE 0x706c4 a_85 100 LINEAR_______31_250000__3000H115 -31.25 0.0 BIT_MASK 0xffffffff /end CHARACTERISTIC
/begin CHARACTERISTIC c_lam_min_cp "C_LAM_MIN_CP" VALUE 0x706c6 a_85 20 LINEAR_______31_250000__3000H115 -31.25 0.0 BIT_MASK 0xffffffff /end CHARACTERISTIC
/begin CHARACTERISTIC c_lam_min_fsd "C_LAM_MIN_FSD" VALUE 0x706c8 a_85 100 LINEAR_______31_250000__3000H___ -31.25 31.25 BIT_MASK 0xffffffff /end CHARACTERISTIC
/begin CHARACTERISTIC c_lam_min_tra_ld "C_LAM_MIN_TRA_LD" VALUE 0x706ca a_85 20 LINEAR______0_000015__1H___0_250 1.53e-005 0.25 BIT_MASK 0xffffffff /end CHARACTERISTIC
/begin CHARACTERISTIC c_lam_mv_crlc "C_LAM_MV_CRLC" VALUE 0x70b54 a_86 5 LINEAR______0_000000__0H___0_996 0.0 0.99609375 BIT_MASK 0xffffffff /end CHARACTERISTIC
/begin CHARACTERISTIC c_lam_mv_crlc_cat "C_LAM_MV_CRLC_CAT" VALUE 0x706cc a_85 100 LINEAR______0_000000__0H___0_999 0.0 0.99998474 BIT_MASK 0xffffffff /end CHARACTERISTIC
/begin CHARACTERISTIC c_lam_mv_dif_cor_max_cp "C_LAM_MV_DIF_COR_MAX_CP" VALUE 0x706ce a_85 20 LINEAR______0_000000__8000H___31 0.0 31.25 BIT_MASK 0xffffffff /end CHARACTERISTIC
/begin CHARACTERISTIC c_lam_mv_dif_cp_diagcps "C_LAM_MV_DIF_CP_DIAGCPS" VALUE 0x706d0 a_85 20 LINEAR______0_000000__0H___31_25 0.0 31.25 BIT_MASK 0xffffffff /end CHARACTERISTIC
/begin CHARACTERISTIC c_lam_mv_dif_cp_dly "C_LAM_MV_DIF_CP_DLY" VALUE 0x706d2 a_85 100 LINEAR_______31_250000__3000H116 -31.25 31.25 BIT_MASK 0xffffffff /end CHARACTERISTIC
/begin CHARACTERISTIC c_lam_mv_dif_cp_dly_diag "C_LAM_MV_DIF_CP_DLY_DIAG" VALUE 0x706d4 a_85 100 LINEAR_______31_250000__3000H116 -31.25 31.25 BIT_MASK 0xffffffff /end CHARACTERISTIC
/begin CHARACTERISTIC c_lam_mv_dif_cp_dmtl_max "C_LAM_MV_DIF_CP_DMTL_MAX" VALUE 0x706d6 a_85 100 LINEAR______0_000000__0H___49_99 0.0 49.998501 BIT_MASK 0xffffffff FUNCTION_LIST DMTL /end CHARACTERISTIC
/begin CHARACTERISTIC c_lam_mv_dif_cp_fl "C_LAM_MV_DIF_CP_FL" VALUE 0x706d8 a_85 100 LINEAR_______31_250000__3000H115 -31.25 0.0 BIT_MASK 0xffffffff /end CHARACTERISTIC
/begin CHARACTERISTIC c_lam_mv_dif_cp_fsd "C_LAM_MV_DIF_CP_FSD" VALUE 0x706da a_85 100 LINEAR_______31_250000__3000H116 -31.25 31.25 BIT_MASK 0xffffffff /end CHARACTERISTIC
/begin CHARACTERISTIC c_lam_mv_dif_cp_lam_is "C_LAM_MV_DIF_CP_LAM_IS" VALUE 0x70dda a_95 100 LINEAR_______31_250000__FFFFB000 -31.25 0.0 BIT_MASK 0xffffffff /end CHARACTERISTIC
/begin CHARACTERISTIC c_lam_mv_dif_max_cp_1 "C_LAM_MV_DIF_MAX_CP_1" VALUE 0x70ddc a_95 20 LINEAR______0_000000__0H___31117 0.0 31.25 BIT_MASK 0xffffffff /end CHARACTERISTIC
/begin CHARACTERISTIC c_lam_mv_dyw "C_LAM_MV_DYW" VALUE 0x70b55 a_86 2 LINEAR______0_000000__0H___99_60 0.0 99.609375 BIT_MASK 0xffffffff /end CHARACTERISTIC
/begin CHARACTERISTIC c_lam_mv_dyw_cat "C_LAM_MV_DYW_CAT" VALUE 0x706dc a_85 100 LINEAR______0_000000__0H___31_25 0.0 31.25 BIT_MASK 0xffffffff /end CHARACTERISTIC
/begin CHARACTERISTIC c_lam_mv_dyw_dly "C_LAM_MV_DYW_DLY" VALUE 0x706de a_85 100 LINEAR______0_000000__0H___31_25 0.0 31.25 BIT_MASK 0xffffffff /end CHARACTERISTIC
/begin CHARACTERISTIC c_lam_mv_mmv_dif_cp "C_LAM_MV_MMV_DIF_CP" VALUE 0x706e0 a_85 20 LINEAR______0_000000__8000H___31 0.0 31.25 BIT_MASK 0xffffffff /end CHARACTERISTIC
/begin CHARACTERISTIC c_lam_n_min "C_LAM_N_MIN" VALUE 0x70b56 a_86 5 LINEAR______0_000000__0H___8160_ 0.0 8160.0 BIT_MASK 0xffffffff /end CHARACTERISTIC
/begin CHARACTERISTIC c_lam_p_sum_ad "C_LAM_P_SUM_AD" VALUE 0x70b57 a_86 2 LINEAR______0_000000__0H___25118 0.0 255.0 BIT_MASK 0xffffffff /end CHARACTERISTIC
/begin CHARACTERISTIC c_lam_p_sum_ad_is "C_LAM_P_SUM_AD_IS" VALUE 0x70b58 a_86 2 LINEAR______1_000000__1H___25119 1.0 255.0 BIT_MASK 0xffffffff /end CHARACTERISTIC
/begin CHARACTERISTIC c_lam_p_sum_diag "C_LAM_P_SUM_DIAG" VALUE 0x70b59 a_86 10 LINEAR______1_000000__1H___255_0 1.0 255.0 BIT_MASK 0xffffffff /end CHARACTERISTIC
/begin CHARACTERISTIC c_lam_p_sum_is "C_LAM_P_SUM_IS" VALUE 0x70b5a a_86 2 LINEAR______0_000000__0H___25118 0.0 255.0 BIT_MASK 0xffffffff /end CHARACTERISTIC
/begin CHARACTERISTIC c_lam_sum_mv_mmv_clc "C_LAM_SUM_MV_MMV_CLC" VALUE 0x70b5b a_86 100 LINEAR______0_000000__0H___255_0 0.0 255.0 BIT_MASK 0xffffffff /end CHARACTERISTIC
/begin CHARACTERISTIC c_lam_thd_sav_diag "C_LAM_THD_SAV_DIAG" VALUE 0x706e2 a_85 100 LINEAR______0_000000__8000H___31 0.0 31.25 BIT_MASK 0xffffffff /end CHARACTERISTIC
/begin CHARACTERISTIC c_lam_tra_max_dif_1 "C_LAM_TRA_MAX_DIF_1" VALUE 0x706e4 a_85 5 LINEAR______0_000000__8000H___31 0.0 31.25 BIT_MASK 0xffffffff /end CHARACTERISTIC
/begin CHARACTERISTIC c_lam_tra_max_dif_2 "C_LAM_TRA_MAX_DIF_2" VALUE 0x706e6 a_85 5 LINEAR______0_000000__8000H___31 0.0 31.25 BIT_MASK 0xffffffff /end CHARACTERISTIC
/begin CHARACTERISTIC c_lgrd_cppwm_neg_diagcps "C_LGRD_CPPWM_NEG_DIAGCPS" VALUE 0x70b5c a_86 10 LINEAR______0_024000__1H___6_120 0.024 6.12 BIT_MASK 0xffffffff /end CHARACTERISTIC
/begin CHARACTERISTIC c_lgrd_cppwm_pos_diagcps "C_LGRD_CPPWM_POS_DIAGCPS" VALUE 0x70b5d a_86 10 LINEAR______0_024000__1H___6_120 0.024 6.12 BIT_MASK 0xffffffff /end CHARACTERISTIC
/begin CHARACTERISTIC c_lgrd_isapwm_off "C_LGRD_ISAPWM_OFF" VALUE 0x706e8 a_85 100 LINEAR______0_000000__0H___99120 0.0 99.998474 BIT_MASK 0xffffffff /end CHARACTERISTIC
/begin CHARACTERISTIC c_lgrd_tq_loss_ecf "C_LGRD_TQ_LOSS_ECF" VALUE 0x706ea a_85 100 LINEAR______0_000000__0H___1022_ 0.0 1022.9688 BIT_MASK 0xffffffff /end CHARACTERISTIC
/begin CHARACTERISTIC c_lgrd_tqd_mtc_cat "C_LGRD_TQD_MTC_CAT" VALUE 0x706ec a_85 100 LINEAR______0_001526__1H___99_99 1.526e-005 99.9847 BIT_MASK 0xffffffff /end CHARACTERISTIC
/begin CHARACTERISTIC c_lshpwm_min_diag "C_LSHPWM_MIN_DIAG" VALUE 0x70b5e a_86 100 LINEAR______0_000000__0H___99_60 0.0 99.609375 BIT_MASK 0xffffffff /end CHARACTERISTIC
/begin CHARACTERISTIC c_maf_ad_isa "C_MAF_AD_ISA" VALUE 0x70b5f a_86 10 LINEAR______0_000000__0H___63_75 0.0 63.75 BIT_MASK 0xffffffff /end CHARACTERISTIC
/begin CHARACTERISTIC c_maf_crlc_cat "C_MAF_CRLC_CAT" VALUE 0x706ee a_85 100 LINEAR______0_000000__0H___0_999 0.0 0.99998474 BIT_MASK 0xffffffff /end CHARACTERISTIC
/begin CHARACTERISTIC c_maf_diagcps "C_MAF_DIAGCPS" VALUE 0x706f0 a_85 5 LINEAR______0_000000__0H___13818 0.0 1389.0 BIT_MASK 0xffffffff /end CHARACTERISTIC
/begin CHARACTERISTIC c_maf_dif_dly_er "C_MAF_DIF_DLY_ER" VALUE 0x706f2 a_85 5 LINEAR______0_010000__1H___655_3 0.01 655.34998 BIT_MASK 0xffffffff /end CHARACTERISTIC
/begin CHARACTERISTIC c_maf_dif_min_pu "C_MAF_DIF_MIN_PU" VALUE 0x70b60 a_86 30 LINEAR______0_000000__0H___1389_ 0.0 1389.0 BIT_MASK 0xffffffff /end CHARACTERISTIC
/begin CHARACTERISTIC c_maf_dif_tps_diag "C_MAF_DIF_TPS_DIAG" VALUE 0x706f4 a_85 100 LINEAR______0_000000__0H___0_999 0.0 0.99998474 BIT_MASK 0xffffffff /end CHARACTERISTIC
/begin CHARACTERISTIC c_maf_dyw "C_MAF_DYW" VALUE 0x70b61 a_86 5 LINEAR______0_000000__0H___1389_ 0.0 1389.0 BIT_MASK 0xffffffff /end CHARACTERISTIC
/begin CHARACTERISTIC c_maf_dyw_cat "C_MAF_DYW_CAT" VALUE 0x706f6 a_85 100 LINEAR______0_000000__0H___13818 0.0 1389.0 BIT_MASK 0xffffffff /end CHARACTERISTIC
/begin CHARACTERISTIC c_maf_dyw_dly "C_MAF_DYW_DLY" VALUE 0x706f8 a_85 100 LINEAR______0_000000__0H___13818 0.0 1389.0 BIT_MASK 0xffffffff /end CHARACTERISTIC
/begin CHARACTERISTIC c_maf_hys_cop "C_MAF_HYS_COP" VALUE 0x70b62 a_86 2 LINEAR______0_000000__0H___1389_ 0.0 1389.0 BIT_MASK 0xffffffff /end CHARACTERISTIC
/begin CHARACTERISTIC c_maf_hys_vim "C_MAF_HYS_VIM" VALUE 0x70b63 a_86 2 LINEAR______0_000000__0H___1389_ 0.0 1389.0 BIT_MASK 0xffffffff /end CHARACTERISTIC
/begin CHARACTERISTIC c_maf_iga_hys "C_MAF_IGA_HYS" VALUE 0x706fa a_85 10 LINEAR______0_000000__0H___694_5 0.0 694.5 BIT_MASK 0xffffffff /end CHARACTERISTIC
/begin CHARACTERISTIC c_maf_iga_hys_knk "C_MAF_IGA_HYS_KNK" VALUE 0x70b64 a_86 2 LINEAR______0_000000__0H___1389_ 0.0 1389.0 BIT_MASK 0xffffffff /end CHARACTERISTIC
/begin CHARACTERISTIC c_maf_iga_pas "C_MAF_IGA_PAS" VALUE 0x706fc a_85 10 LINEAR______0_000000__0H___13818 0.0 1389.0 BIT_MASK 0xffffffff /end CHARACTERISTIC
/begin CHARACTERISTIC c_maf_inc_hys "C_MAF_INC_HYS" VALUE 0x706fe a_85 100 LINEAR______0_000000__0H___13818 0.0 1389.0 BIT_MASK 0xffffffff /end CHARACTERISTIC
/begin CHARACTERISTIC c_maf_int_afl_max_diag "C_MAF_INT_AFL_MAX_DIAG" VALUE 0x70700 a_85 100 LINEAR______0_000000__0H___1820_ 0.0 1820.42 BIT_MASK 0xffffffff /end CHARACTERISTIC
/begin CHARACTERISTIC c_maf_int_afr_max_diag "C_MAF_INT_AFR_MAX_DIAG" VALUE 0x70702 a_85 100 LINEAR______0_000000__0H___1820_ 0.0 1820.42 BIT_MASK 0xffffffff /end CHARACTERISTIC
/begin CHARACTERISTIC c_maf_int_dly_hst_max "C_MAF_INT_DLY_HST_MAX" VALUE 0x70704 a_85 100 LINEAR______0_000000__0H___1820_ 0.0 1820.42 BIT_MASK 0xffffffff /end CHARACTERISTIC
/begin CHARACTERISTIC c_maf_int_dly_puc_max "C_MAF_INT_DLY_PUC_MAX" VALUE 0x70706 a_85 100 LINEAR______0_000000__0H___1820_ 0.0 1820.42 BIT_MASK 0xffffffff /end CHARACTERISTIC
/begin CHARACTERISTIC c_maf_int_dly_sap_max "C_MAF_INT_DLY_SAP_MAX" VALUE 0x70708 a_85 100 LINEAR______0_000000__0H___1820_ 0.0 1820.42 BIT_MASK 0xffffffff /end CHARACTERISTIC
/begin CHARACTERISTIC c_maf_int_lam_dly_i "C_MAF_INT_LAM_DLY_I" VALUE 0x7070a a_85 100 LINEAR______0_000000__0H___1820_ 0.0 1820.42 BIT_MASK 0xffffffff /end CHARACTERISTIC
/begin CHARACTERISTIC c_maf_int_min_cat "C_MAF_INT_MIN_CAT" VALUE 0x7070c a_85 100 LINEAR______0_000000__0H___1820_ 0.0 1820.42 BIT_MASK 0xffffffff /end CHARACTERISTIC
/begin CHARACTERISTIC c_maf_int_min_dly "C_MAF_INT_MIN_DLY" VALUE 0x7070e a_85 100 LINEAR______0_000000__0H___1820_ 0.0 1820.42 BIT_MASK 0xffffffff /end CHARACTERISTIC
/begin CHARACTERISTIC c_maf_int_min_dly_puc "C_MAF_INT_MIN_DLY_PUC" VALUE 0x70710 a_85 100 LINEAR______0_000000__0H___1820_ 0.0 1820.42 BIT_MASK 0xffffffff /end CHARACTERISTIC
/begin CHARACTERISTIC c_maf_int_min_vls_eol "C_MAF_INT_MIN_VLS_EOL" VALUE 0x70712 a_85 100 LINEAR______0_000000__0H___1820_ 0.0 1820.42 BIT_MASK 0xffffffff /end CHARACTERISTIC
/begin CHARACTERISTIC c_maf_int_puc_vls_down "C_MAF_INT_PUC_VLS_DOWN" VALUE 0x70714 a_85 100 LINEAR______0_000000__0H___1820_ 0.0 1820.42 BIT_MASK 0xffffffff /end CHARACTERISTIC
/begin CHARACTERISTIC c_maf_int_vls_cat_post_puc "C_MAF_INT_VLS_CAT_POST_PUC" VALUE 0x70716 a_85 100 LINEAR______0_000000__0H___1820_ 0.0 1820.42 BIT_MASK 0xffffffff /end CHARACTERISTIC
/begin CHARACTERISTIC c_maf_int_vls_cat_puc "C_MAF_INT_VLS_CAT_PUC" VALUE 0x70718 a_85 100 LINEAR______0_000000__0H___1820_ 0.0 1820.42 BIT_MASK 0xffffffff /end CHARACTERISTIC
/begin CHARACTERISTIC c_maf_int_vls_down "C_MAF_INT_VLS_DOWN" VALUE 0x7071a a_85 100 LINEAR______0_000000__0H___1820_ 0.0 1820.42 BIT_MASK 0xffffffff /end CHARACTERISTIC
/begin CHARACTERISTIC c_maf_kgh_cat_diag_max "C_MAF_KGH_CAT_DIAG_MAX" VALUE 0x7071c a_85 100 LINEAR______0_000000__0H___16383 0.0 16383.75 BIT_MASK 0xffffffff /end CHARACTERISTIC
/begin CHARACTERISTIC c_maf_kgh_cat_diag_min "C_MAF_KGH_CAT_DIAG_MIN" VALUE 0x7071e a_85 100 LINEAR______0_000000__0H___16383 0.0 16383.75 BIT_MASK 0xffffffff /end CHARACTERISTIC
/begin CHARACTERISTIC c_maf_kgh_diag_ini "C_MAF_KGH_DIAG_INI" VALUE 0x70720 a_85 30 LINEAR______0_000000__0H___16383 0.0 16383.75 BIT_MASK 0xffffffff /end CHARACTERISTIC
/begin CHARACTERISTIC c_maf_kgh_max_lsh_diag "C_MAF_KGH_MAX_LSH_DIAG" VALUE 0x70722 a_85 10 LINEAR______0_000000__0H___16383 0.0 16383.75 BIT_MASK 0xffffffff /end CHARACTERISTIC
/begin CHARACTERISTIC c_maf_kgh_max_puc_down_diag "C_MAF_KGH_MAX_PUC_DOWN_DIAG" VALUE 0x70724 a_85 100 LINEAR______0_000000__0H___16383 0.0 16383.75 BIT_MASK 0xffffffff /end CHARACTERISTIC
/begin CHARACTERISTIC c_maf_kgh_max_sa "C_MAF_KGH_MAX_SA" VALUE 0x70726 a_85 10 LINEAR______0_000000__0H___16383 0.0 16383.75 BIT_MASK 0xffffffff /end CHARACTERISTIC
/begin CHARACTERISTIC c_maf_kgh_min_puc_down_diag "C_MAF_KGH_MIN_PUC_DOWN_DIAG" VALUE 0x70728 a_85 100 LINEAR______0_000000__0H___16383 0.0 16383.75 BIT_MASK 0xffffffff /end CHARACTERISTIC
/begin CHARACTERISTIC c_maf_kgh_min_saf "C_MAF_KGH_MIN_SAF" VALUE 0x7072a a_85 10 LINEAR______0_000000__0H___16383 0.0 16383.75 BIT_MASK 0xffffffff /end CHARACTERISTIC
/begin CHARACTERISTIC c_maf_kgh_min_saf_eol "C_MAF_KGH_MIN_SAF_EOL" VALUE 0x7072c a_85 10 LINEAR______0_000000__0H___16383 0.0 16383.75 BIT_MASK 0xffffffff /end CHARACTERISTIC
/begin CHARACTERISTIC c_maf_kgh_r_ls_mes_max "C_MAF_KGH_R_LS_MES_MAX" VALUE 0x7072e a_85 100 LINEAR______0_000000__0H___16383 0.0 16383.75 BIT_MASK 0xffffffff FUNCTION_LIST R_LS_CALC /end CHARACTERISTIC
/begin CHARACTERISTIC c_maf_lam_dly_p_max "C_MAF_LAM_DLY_P_MAX" VALUE 0x70730 a_85 100 LINEAR______0_000000__0H___13818 0.0 1389.0 BIT_MASK 0xffffffff /end CHARACTERISTIC
/begin CHARACTERISTIC c_maf_lam_dly_p_min "C_MAF_LAM_DLY_P_MIN" VALUE 0x70732 a_85 100 LINEAR______0_000000__0H___13818 0.0 1389.0 BIT_MASK 0xffffffff /end CHARACTERISTIC
/begin CHARACTERISTIC c_maf_lam_tol_tra "C_MAF_LAM_TOL_TRA" VALUE 0x70734 a_85 1 LINEAR______0_000000__0H___16383 0.0 16383.75 BIT_MASK 0xffffffff /end CHARACTERISTIC
/begin CHARACTERISTIC c_maf_lam_tra_bol "C_MAF_LAM_TRA_BOL" VALUE 0x70736 a_85 1 LINEAR______0_000000__0H___16383 0.0 16383.75 BIT_MASK 0xffffffff /end CHARACTERISTIC
/begin CHARACTERISTIC c_maf_max "C_MAF_MAX" VALUE 0x70b65 a_86 5 LINEAR______0_000000__0H___1389_ 0.0 1389.0 BIT_MASK 0xffffffff /end CHARACTERISTIC
/begin CHARACTERISTIC c_maf_max_ch_3 "C_MAF_MAX_CH_3" VALUE 0x70b66 a_86 100 LINEAR______0_000000__0H___1389_ 0.0 1389.0 BIT_MASK 0xffffffff /end CHARACTERISTIC
/begin CHARACTERISTIC c_maf_max_diag "C_MAF_MAX_DIAG" VALUE 0x70738 a_85 30 LINEAR______0_000000__0H___16383 0.0 16383.75 BIT_MASK 0xffffffff /end CHARACTERISTIC
/begin CHARACTERISTIC c_maf_max_diag_sa "C_MAF_MAX_DIAG_SA" VALUE 0x70b67 a_86 100 LINEAR______0_000000__0H___1389_ 0.0 1389.0 BIT_MASK 0xffffffff /end CHARACTERISTIC
/begin CHARACTERISTIC c_maf_max_diagcps "C_MAF_MAX_DIAGCPS" VALUE 0x70b68 a_86 100 LINEAR______0_000000__0H___1389_ 0.0 1389.0 BIT_MASK 0xffffffff /end CHARACTERISTIC
/begin CHARACTERISTIC c_maf_max_hfm_diag "C_MAF_MAX_HFM_DIAG" VALUE 0x70b69 a_86 100 LINEAR______0_000000__0H___1389_ 0.0 1389.0 BIT_MASK 0xffffffff /end CHARACTERISTIC
/begin CHARACTERISTIC c_maf_max_is_diag "C_MAF_MAX_IS_DIAG" VALUE 0x70b6a a_86 10 LINEAR______0_000000__0H___1389_ 0.0 1389.0 BIT_MASK 0xffffffff /end CHARACTERISTIC
/begin CHARACTERISTIC c_maf_mes_max_stat "C_MAF_MES_MAX_STAT" VALUE 0x70b6b a_86 100 LINEAR______0_000000__0H___1389_ 0.0 1389.0 BIT_MASK 0xffffffff /end CHARACTERISTIC
/begin CHARACTERISTIC c_maf_min_aj "C_MAF_MIN_AJ" VALUE 0x7073a a_85 100 LINEAR______0_000000__0H___13818 0.0 1389.0 BIT_MASK 0xffffffff /end CHARACTERISTIC
/begin CHARACTERISTIC c_maf_min_cs_diag "C_MAF_MIN_CS_DIAG" VALUE 0x70b6c a_86 100 LINEAR______0_000000__0H___1389_ 0.0 1389.0 BIT_MASK 0xffffffff /end CHARACTERISTIC
/begin CHARACTERISTIC c_maf_min_diag "C_MAF_MIN_DIAG" VALUE 0x7073c a_85 30 LINEAR______0_000000__0H___16383 0.0 16383.75 BIT_MASK 0xffffffff /end CHARACTERISTIC
/begin CHARACTERISTIC c_maf_min_fsd "C_MAF_MIN_FSD" VALUE 0x7073e a_85 100 LINEAR______0_000000__0H___13121 0.0 1389.0 BIT_MASK 0xffffffff /end CHARACTERISTIC
/begin CHARACTERISTIC c_maf_min_hfm_diag "C_MAF_MIN_HFM_DIAG" VALUE 0x70b6d a_86 100 LINEAR______0_000000__0H___1389_ 0.0 1389.0 BIT_MASK 0xffffffff /end CHARACTERISTIC
/begin CHARACTERISTIC c_maf_min_is_knk "C_MAF_MIN_IS_KNK" VALUE 0x70b6e a_86 100 LINEAR______0_000000__0H___1389_ 0.0 1389.0 BIT_MASK 0xffffffff /end CHARACTERISTIC
/begin CHARACTERISTIC c_maf_min_knks_diag "C_MAF_MIN_KNKS_DIAG" VALUE 0x70740 a_85 30 LINEAR______0_000000__0H___16383 0.0 16383.75 BIT_MASK 0xffffffff /end CHARACTERISTIC
/begin CHARACTERISTIC c_maf_min_ti_ad_fsd "C_MAF_MIN_TI_AD_FSD" VALUE 0x70b6f a_86 100 LINEAR______0_000000__0H___1389_ 0.0 1389.0 BIT_MASK 0xffffffff /end CHARACTERISTIC
/begin CHARACTERISTIC c_maf_min_vls_diag "C_MAF_MIN_VLS_DIAG" VALUE 0x70742 a_85 100 LINEAR______0_000000__0H___13818 0.0 1389.0 BIT_MASK 0xffffffff /end CHARACTERISTIC
/begin CHARACTERISTIC c_maf_mmv_dif_crlc "C_MAF_MMV_DIF_CRLC" VALUE 0x70b70 a_86 10 LINEAR______0_000000__0H___0_996 0.0 0.99609375 BIT_MASK 0xffffffff /end CHARACTERISTIC
/begin CHARACTERISTIC c_maf_mmv_hys "C_MAF_MMV_HYS" VALUE 0x70b71 a_86 100 LINEAR______0_000000__0H___5_426 0.0 5.426 BIT_MASK 0xffffffff /end CHARACTERISTIC
/begin CHARACTERISTIC c_maf_sub_mmv_crlc_mon "C_MAF_SUB_MMV_CRLC_MON" VALUE 0x71240 a_85 100 LINEAR______0_000000__0H___1_027 0.0 1.0 BIT_MASK 0xffffffff /end CHARACTERISTIC
/begin CHARACTERISTIC c_maf_ti_ad_add_max "C_MAF_TI_AD_ADD_MAX" VALUE 0x70b72 a_86 5 LINEAR______0_000000__0H___1389_ 0.0 1389.0 BIT_MASK 0xffffffff /end CHARACTERISTIC
/begin CHARACTERISTIC c_maf_ti_ad_fac_min "C_MAF_TI_AD_FAC_MIN" VALUE 0x70b73 a_86 5 LINEAR______0_000000__0H___1389_ 0.0 1389.0 BIT_MASK 0xffffffff /end CHARACTERISTIC
/begin CHARACTERISTIC c_maf_ti_ad_max "C_MAF_TI_AD_MAX" VALUE 0x70744 a_85 100 LINEAR______0_000000__0H___16383 0.0 16383.75 BIT_MASK 0xffffffff /end CHARACTERISTIC
/begin CHARACTERISTIC c_maf_vs_min_diag "C_MAF_VS_MIN_DIAG" VALUE 0x70b74 a_86 10 LINEAR______0_000000__0H___1389_ 0.0 1389.0 BIT_MASK 0xffffffff /end CHARACTERISTIC
/begin CHARACTERISTIC c_map_grd_dly_er "C_MAP_GRD_DLY_ER" VALUE 0x70746 a_85 100 LINEAR______0_010000__1H___655_3 0.01 655.34998 BIT_MASK 0xffffffff /end CHARACTERISTIC
/begin CHARACTERISTIC c_mis_a_min_nr "C_MIS_A_MIN_NR" VALUE 0x70748 a_85 5 LINEAR______0_000000__0H___65122 0.0 65535.0 BIT_MASK 0xffffffff /end CHARACTERISTIC
/begin CHARACTERISTIC c_mis_a_thd "C_MIS_A_THD" VALUE 0x7074a a_85 5 LINEAR______0_000000__0H___65122 0.0 65535.0 BIT_MASK 0xffffffff /end CHARACTERISTIC
/begin CHARACTERISTIC c_mis_b_min_nr "C_MIS_B_MIN_NR" VALUE 0x7074c a_85 5 LINEAR______0_000000__0H___500_0 0.0 500.0 BIT_MASK 0xffffffff /end CHARACTERISTIC
/begin CHARACTERISTIC c_mis_max_nr_off_iv "C_MIS_MAX_NR_OFF_IV" VALUE 0x70b75 a_86 5 LINEAR______0_000000__0H___6_123 0.0 6.0 BIT_MASK 0xffffffff /end CHARACTERISTIC
/begin CHARACTERISTIC c_mis_min_nr_puc "C_MIS_MIN_NR_PUC" VALUE 0x70b76 a_86 5 LINEAR______1_000000__0H___255_0 1.0 255.0 BIT_MASK 0xffffffff /end CHARACTERISTIC
/begin CHARACTERISTIC c_mis_nr_off_iv_igcfb "C_MIS_NR_OFF_IV_IGCFB" VALUE 0x70b77 a_86 5 LINEAR______0_000000__0H___6_123 0.0 6.0 BIT_MASK 0xffffffff /end CHARACTERISTIC
/begin CHARACTERISTIC c_mon2 "C_MON2" VALUE 0x70b78 a_86 100 LINEAR______0_000000__0H___1_124 0.0 1.0 BIT_MASK 0xffffffff /end CHARACTERISTIC
/begin CHARACTERISTIC c_mtc_lih_max "C_MTC_LIH_MAX" VALUE 0x7074e a_85 100 LINEAR______0_000000__0H___119_9 0.0 119.99817 BIT_MASK 0xffffffff /end CHARACTERISTIC
/begin CHARACTERISTIC c_mtcpwm_add_fil "C_MTCPWM_ADD_FIL" VALUE 0x70b79 a_86 100 LINEAR______0_000000__0H___0_996 0.0 0.99609375 BIT_MASK 0xffffffff /end CHARACTERISTIC
/begin CHARACTERISTIC c_mtcpwm_close "C_MTCPWM_CLOSE" VALUE 0x70dde a_95 100 LINEAR_______100_000000__FFFF800 -100.0 99.996948 BIT_MASK 0xffffffff /end CHARACTERISTIC
/begin CHARACTERISTIC c_mtcpwm_close_max "C_MTCPWM_CLOSE_MAX" VALUE 0x70de0 a_95 100 LINEAR_______100_000000__FFFF800 -100.0 99.996948 BIT_MASK 0xffffffff /end CHARACTERISTIC
/begin CHARACTERISTIC c_mtcpwm_hys "C_MTCPWM_HYS" VALUE 0x70de2 a_95 100 LINEAR______0_000000__0H___10125 0.0 100.0 BIT_MASK 0xffffffff /end CHARACTERISTIC
/begin CHARACTERISTIC c_mtcpwm_i_add "C_MTCPWM_I_ADD" VALUE 0x70750 a_85 100 LINEAR______0_000000__0H___10126 0.0 100.0 BIT_MASK 0xffffffff /end CHARACTERISTIC
/begin CHARACTERISTIC c_mtcpwm_i_ini "C_MTCPWM_I_INI" VALUE 0x70de4 a_95 100 LINEAR_______100_000000__FFFF800 -100.0 99.996948 BIT_MASK 0xffffffff /end CHARACTERISTIC
/begin CHARACTERISTIC c_mtcpwm_i_max_neg "C_MTCPWM_I_MAX_NEG" VALUE 0x70de6 a_95 100 LINEAR_______100_000000__FFFF800 -100.0 99.996948 BIT_MASK 0xffffffff /end CHARACTERISTIC
/begin CHARACTERISTIC c_mtcpwm_i_max_pos "C_MTCPWM_I_MAX_POS" VALUE 0x70de8 a_95 100 LINEAR_______100_000000__FFFF800 -100.0 99.996948 BIT_MASK 0xffffffff /end CHARACTERISTIC
/begin CHARACTERISTIC c_mtcpwm_pi_max_diag "C_MTCPWM_PI_MAX_DIAG" VALUE 0x70752 a_85 100 LINEAR______0_000000__0H___10126 0.0 100.0 BIT_MASK 0xffffffff /end CHARACTERISTIC
/begin CHARACTERISTIC c_n_32_cat_diag_max "C_N_32_CAT_DIAG_MAX" VALUE 0x70b7a a_86 100 LINEAR______0_000000__0H___8160_ 0.0 8160.0 BIT_MASK 0xffffffff /end CHARACTERISTIC
/begin CHARACTERISTIC c_n_32_cat_diag_min "C_N_32_CAT_DIAG_MIN" VALUE 0x70b7b a_86 100 LINEAR______0_000000__0H___8160_ 0.0 8160.0 BIT_MASK 0xffffffff /end CHARACTERISTIC
/begin CHARACTERISTIC c_n_32_dif_max_mon "C_N_32_DIF_MAX_MON" VALUE 0x71266 a_86 100 LINEAR______0_000000__0H___8160_ 0.0 8160.0 BIT_MASK 0xffffffff /end CHARACTERISTIC
/begin CHARACTERISTIC c_n_ad_dyw_is "C_N_AD_DYW_IS" VALUE 0x70b7c a_86 5 LINEAR______0_000000__0H___25127 0.0 255.0 BIT_MASK 0xffffffff /end CHARACTERISTIC
/begin CHARACTERISTIC c_n_cam_ad_max "C_N_CAM_AD_MAX" VALUE 0x70b7d a_86 100 LINEAR______0_000000__0H___8160_ 0.0 8160.0 BIT_MASK 0xffffffff /end CHARACTERISTIC
/begin CHARACTERISTIC c_n_crlc_cat "C_N_CRLC_CAT" VALUE 0x70754 a_85 100 LINEAR______0_000000__0H___0_999 0.0 0.99998474 BIT_MASK 0xffffffff /end CHARACTERISTIC
/begin CHARACTERISTIC c_n_diagcps "C_N_DIAGCPS" VALUE 0x70756 a_85 5 LINEAR______0_000000__0H___81612 0.0 8160.0 BIT_MASK 0xffffffff /end CHARACTERISTIC
/begin CHARACTERISTIC c_n_dif_ast "C_N_DIF_AST" VALUE 0x70758 a_85 100 LINEAR______0_000000__0H___10128 0.0 1000.0 BIT_MASK 0xffffffff /end CHARACTERISTIC
/begin COMPU_METHOD LINEAR______0_000000__0H___255_0 "" FORM "%3.0" "-" FORMULA "1.0*X" FORMULA_INV "1.0*X" /end COMPU_METHOD
/begin COMPU_METHOD LINEAR______0_000000__0H___8160_ "" FORM "%4.0" "rpm" FORMULA "32.0*X" FORMULA_INV "0.03125*X" /end COMPU_METHOD
/begin COMPU_METHOD LINEAR______0_000000__0H___65535 "" FORM "%5.0" "-" FORMULA "1.0*X" FORMULA_INV "1.0*X" /end COMPU_METHOD
/begin COMPU_METHOD LINEAR______0_000000__0H___0_996 "" FORM "%5.3" "-" FORMULA "0.00390625*X" FORMULA_INV "256.0*X" /end COMPU_METHOD
/begin COMPU_METHOD LINEAR______0_000000__0H___255_4 "" FORM "%3.0" "*seg" FORMULA "1.0*X" FORMULA_INV "1.0*X" /end COMPU_METHOD
/begin COMPU_METHOD LINEAR______0_000000__0H___1_000 "" FORM "%2.0" "-" FORMULA "1.0*X" FORMULA_INV "1.0*X" /end COMPU_METHOD
/begin COMPU_METHOD LINEAR______0_000000__0H___99_60 "" FORM "%4.1" "%" FORMULA "0.390625*X" FORMULA_INV "2.56*X" /end COMPU_METHOD
/begin COMPU_METHOD LINEAR_______48_000000__0H___142 "" FORM "%5.1" "°C" FORMULA "0.75*X-48.0" FORMULA_INV "1.3333333*X+64.0" /end COMPU_METHOD
/begin COMPU_METHOD LINEAR______0_000000__0H___65534 "" FORM "%6.0" "km" FORMULA "10.0*X" FORMULA_INV "0.1*X" /end COMPU_METHOD
/begin COMPU_METHOD LINEAR______0_000000__0H___1_992 "" FORM "%5.3" "-" FORMULA "0.0078125*X" FORMULA_INV "128.0*X" /end COMPU_METHOD
/begin COMPU_METHOD LINEAR______0_000000__0H___81608 "" FORM "%4.0" "rpm/(km/h)" FORMULA "1.0*X" FORMULA_INV "1.0*X" /end COMPU_METHOD
/begin COMPU_METHOD LINEAR_______48_000000__0H___47_ "" FORM "%6.2" "°CRK" FORMULA "0.375*X-48.0" FORMULA_INV "2.6666667*X+128.0" /end COMPU_METHOD
/begin COMPU_METHOD LINEAR_______23_625000__0H___72_ "" FORM "%5.1" "°CRK" FORMULA "0.375*X-23.625" FORMULA_INV "2.6666667*X+63.0" /end COMPU_METHOD
/begin COMPU_METHOD LINEAR______0_001465__1H___47_99 "" FORM "%6.3" "°CRK/seg" FORMULA "0.0014648439*X+1.5610694e-007" FORMULA_INV "682.6666*X-0.00010656899" /end COMPU_METHOD
/begin COMPU_METHOD LINEAR______0_000000__0H___399_9 "" FORM "%7.3" "%" FORMULA "0.0061035142*X" FORMULA_INV "163.84004*X" /end COMPU_METHOD
/begin COMPU_METHOD LINEAR______0_000000__0H___1389_ "" FORM "%4.0" "mg/stk" FORMULA "5.4470588*X" FORMULA_INV "0.18358531*X" /end COMPU_METHOD
/begin COMPU_METHOD LINEAR______1_000000__1H___255_0 "" FORM "%3.0" "-" FORMULA "1.0*X" FORMULA_INV "1.0*X" /end COMPU_METHOD
/begin COMPU_METHOD LINEAR______0_000000__0H___81612 "" FORM "%4.0" "rpm" FORMULA "1.0*X" FORMULA_INV "1.0*X" /end COMPU_METHOD
/begin COMPU_METHOD LINEAR______0_000000__0H___63_75 "" FORM "%5.2" "kg/h" FORMULA "0.25*X" FORMULA_INV "4.0*X" /end COMPU_METHOD
/begin COMPU_METHOD LINEAR______0_000000__0H___13818 "" FORM "%5.1" "mg/stk" FORMULA "0.021194781*X" FORMULA_INV "47.181425*X" /end COMPU_METHOD
/begin COMPU_METHOD LINEAR______0_000000__0H___16383 "" FORM "%8.2" "kg/h" FORMULA "0.25*X" FORMULA_INV "4.0*X" /end COMPU_METHOD
/begin COMPU_METHOD LINEAR______0_010000__1H___655_3 "" FORM "%6.2" "s" FORMULA "0.0099999996*X+3.7247841e-010" FORMULA_INV "100.0*X-3.7247842e-008" /end COMPU_METHOD
/begin COMPU_METHOD LINEAR______0_000000__0H___95_22 "" FORM "%5.2" "°CRK" FORMULA "0.375*X" FORMULA_INV "2.6666667*X" /end COMPU_METHOD
/begin COMPU_METHOD LINEAR______0_000000__0H___0_999 "" FORM "%7.5" "-" FORMULA "1.5258789e-005*X" FORMULA_INV "65536.0*X" /end COMPU_METHOD
/begin COMPU_METHOD LINEAR______0_000000__0H___1_027 "" FORM "%7.5" "-" FORMULA "1.5259022e-005*X" FORMULA_INV "65535.0*X" /end COMPU_METHOD
/begin COMPU_METHOD LINEAR_______33_000000__0H___989 "" FORM "%6.2" "°C" FORMULA "0.015609741*X-33.0" FORMULA_INV "64.06256*X+2114.0645" /end COMPU_METHOD
/begin COMPU_METHOD LINEAR______0_000000__0H___143_8 "" FORM "%5.1" "mA" FORMULA "0.56392157*X" FORMULA_INV "1.7732962*X" /end COMPU_METHOD
/begin COMPU_METHOD LINEAR______0_000000__0H___65529 "" FORM "%5.0" "m" FORMULA "1.0*X" FORMULA_INV "1.0*X" /end COMPU_METHOD
/begin COMPU_METHOD LINEAR______0_000000__0H___1_999 "" FORM "%7.5" "-" FORMULA "3.0517585e-005*X" FORMULA_INV "32767.992*X" /end COMPU_METHOD
/begin COMPU_METHOD LINEAR______0_000000__0H___7_999 "" FORM "%6.4" "-" FORMULA "0.00012207031*X" FORMULA_INV "8191.9999*X" /end COMPU_METHOD
/begin COMPU_METHOD LINEAR______0_000000__0H___99_99 "" FORM "%6.3" "%" FORMULA "0.0015258789*X" FORMULA_INV "655.36*X" /end COMPU_METHOD
/begin COMPU_METHOD LINEAR_______48_000000__0H___041 "" FORM "%5.1" "°CRK" FORMULA "0.375*X-48.0" FORMULA_INV "2.6666667*X+128.0" /end COMPU_METHOD
/begin COMPU_METHOD LINEAR______0_000000__0H___119_9 "" FORM "%7.3" "°TPS" FORMULA "0.0018310547*X" FORMULA_INV "546.13333*X" /end COMPU_METHOD
/begin COMPU_METHOD LINEAR______0_006100__1H___24_99 "" FORM "%6.3" "%/10ms" FORMULA "0.0061034929*X-3.4929165e-006" FORMULA_INV "163.84061*X+0.00057228156" /end COMPU_METHOD
/begin COMPU_METHOD LINEAR______0_000015__1H___0_250 "" FORM "%8.6" "-" FORMULA "1.5258787e-005*X+4.1213453e-008" FORMULA_INV "65536.011*X-0.0027009653" /end COMPU_METHOD
/begin COMPU_METHOD LINEAR______0_000000__0H___1820_ "" FORM "%7.2" "g" FORMULA "0.027777829*X" FORMULA_INV "35.999934*X" /end COMPU_METHOD
/begin COMPU_METHOD LINEAR______0_000000__0H___2_054 "" FORM "%7.5" "-" FORMULA "3.0518044e-005*X" FORMULA_INV "32767.5*X" /end COMPU_METHOD
/begin COMPU_METHOD LINEAR______0_000000__0H___48_00 "" FORM "%5.2" "°CRK" FORMULA "0.375*X" FORMULA_INV "2.6666667*X" /end COMPU_METHOD
/begin COMPU_METHOD LINEAR______0_000000__0H___126_0 "" FORM "%3.0" "L" FORMULA "1.0*X" FORMULA_INV "1.0*X" /end COMPU_METHOD
/begin COMPU_METHOD LINEAR_______31_250000__3000H___ "" FORM "%7.3" "%" FORMULA "0.0015258789*X-50.0" FORMULA_INV "655.36*X+32768.0" /end COMPU_METHOD
/begin COMPU_METHOD LINEAR______0_000000__0H___65573 "" FORM "%5.0" "*seg" FORMULA "1.0*X" FORMULA_INV "1.0*X" /end COMPU_METHOD
/begin COMPU_METHOD LINEAR______0_000000__0H___1022_ "" FORM "%7.2" "Nm" FORMULA "0.031219482*X" FORMULA_INV "32.031281*X" /end COMPU_METHOD
/begin COMPU_METHOD LINEAR______0_000000__0H___400_0 "" FORM "%7.3" "mA" FORMULA "0.0061036088*X" FORMULA_INV "163.8375*X" /end COMPU_METHOD
/begin COMPU_METHOD LINEAR______0_000000__0H___47_62 "" FORM "%5.2" "°CRK" FORMULA "0.375*X" FORMULA_INV "2.6666667*X" /end COMPU_METHOD
/begin COMPU_METHOD LINEAR______0_000000__0H___255_9 "" FORM "%7.3" "-" FORMULA "0.0039062501*X" FORMULA_INV "255.99999*X" /end COMPU_METHOD
/begin COMPU_METHOD LINEAR______1_000000__1H___25596 "" FORM "%3.0" "*wcyc" FORMULA "1.0*X" FORMULA_INV "1.0*X" /end COMPU_METHOD
/begin COMPU_METHOD LINEAR______0_000000__0H___1_097 "" FORM "%7.5" "-" FORMULA "3.0517578e-005*X" FORMULA_INV "32768.0*X" /end COMPU_METHOD
/begin COMPU_METHOD LINEAR______1_000000__8000H___98 "" FORM "%7.5" "-" FORMULA "3.0517578e-005*X" FORMULA_INV "32768.0*X" /end COMPU_METHOD
/begin COMPU_METHOD LINEAR______0_500000__4000H___1_ "" FORM "%6.4" "-" FORMULA "3.0517578e-005*X" FORMULA_INV "32768.0*X" /end COMPU_METHOD
/begin COMPU_METHOD LINEAR______0_000000__0H___65599 "" FORM "%5.0" "*wcyc" FORMULA "1.0*X" FORMULA_INV "1.0*X" /end COMPU_METHOD
/begin COMPU_METHOD LINEAR______0_000000__0H___15100 "" FORM "%2.0" "-" FORMULA "1.0*X" FORMULA_INV "1.0*X" /end COMPU_METHOD
/begin COMPU_METHOD LINEAR______0_000000__0H___7_101 "" FORM "%4.2" "%" FORMULA "0.01528865*X" FORMULA_INV "65.408*X" /end COMPU_METHOD
/begin COMPU_METHOD LINEAR______0_000000__0H___10000 "" FORM "%5.0" "ms" FORMULA "10.0*X" FORMULA_INV "0.1*X" /end COMPU_METHOD
/begin COMPU_METHOD LINEAR_______1_275000__FFFF8080H "" FORM "%6.3" "V" FORMULA "3.90625e-005*X" FORMULA_INV "25600.0*X" /end COMPU_METHOD
/begin COMPU_METHOD LINEAR_______1_275000__FFFF80102 "" FORM "%6.3" "V/10ms" FORMULA "3.90625e-005*X" FORMULA_INV "25600.0*X" /end COMPU_METHOD
/begin COMPU_METHOD LINEAR______0_000000__0H___32767 "" FORM "%5.0" "us" FORMULA "1.0*X" FORMULA_INV "1.0*X" /end COMPU_METHOD
/begin COMPU_METHOD LINEAR______1_000000__1H___25103 "" FORM "%3.0" "*40ms" FORMULA "1.0*X" FORMULA_INV "1.0*X" /end COMPU_METHOD
/begin COMPU_METHOD LINEAR______0_000000__0H___4294_ "" FORM "%6.1" "L" FORMULA "0.065535973*X" FORMULA_INV "15.258795*X" /end COMPU_METHOD
/begin COMPU_METHOD LINEAR______0_000000__0H___15_93 "" FORM "%5.2" "-" FORMULA "0.0625*X" FORMULA_INV "16.0*X" /end COMPU_METHOD
/begin COMPU_METHOD LINEAR______1_000000__100H___16_ "" FORM "%6.3" "-" FORMULA "0.00390625*X" FORMULA_INV "256.0*X" /end COMPU_METHOD
/begin COMPU_METHOD LINEAR______0_062500__10H___1_00 "" FORM "%5.3" "-" FORMULA "0.00390625*X" FORMULA_INV "256.0*X" /end COMPU_METHOD
/begin COMPU_METHOD LINEAR______1_000000__20H___7_96 "" FORM "%4.2" "-" FORMULA "0.031246637*X+0.00010763193" FORMULA_INV "32.003445*X-0.0034445925" /end COMPU_METHOD
/begin COMPU_METHOD LINEAR_______128_000000__FFFF104 "" FORM "%4.0" "L" FORMULA "1.0*X" FORMULA_INV "1.0*X" /end COMPU_METHOD
/begin COMPU_METHOD LINEAR______0_000000__0H___12105 "" FORM "%3.0" "L" FORMULA "0.065522621*X" FORMULA_INV "15.261905*X" /end COMPU_METHOD
/begin COMPU_METHOD LINEAR______0_000000__0H___0_106 "" FORM "%5.3" "-" FORMULA "1.5258789e-005*X" FORMULA_INV "65536.0*X" /end COMPU_METHOD
/begin COMPU_METHOD LINEAR______0_000000__0H___6_000 "" FORM "%3.1" "°CRK" FORMULA "0.375*X" FORMULA_INV "2.6666667*X" /end COMPU_METHOD
/begin COMPU_METHOD LINEAR_______48_000000__0H___107 "" FORM "%4.1" "°CRK" FORMULA "0.375*X-48.0" FORMULA_INV "2.6666667*X+128.0" /end COMPU_METHOD
/begin COMPU_METHOD LINEAR______0_001465__1H___47108 "" FORM "%6.3" "°CRK/wcyc" FORMULA "0.0014648439*X+1.5610694e-007" FORMULA_INV "682.6666*X-0.00010656899" /end COMPU_METHOD
/begin COMPU_METHOD LINEAR______0_000000__0H___0_109 "" FORM "%7.5" "-/wcyc" FORMULA "1.5258789e-005*X" FORMULA_INV "65536.0*X" /end COMPU_METHOD
/begin COMPU_METHOD LINEAR______5_440000__1H___1389_ "" FORM "%4.0" "mg/stk" FORMULA "5.4470866*X-0.0070865539" FORMULA_INV "0.18358438*X+0.0013009806" /end COMPU_METHOD
/begin COMPU_METHOD LINEAR______1_000000__1H___8160_ "" FORM "%4.0" "rpm" FORMULA "1.0*X" FORMULA_INV "1.0*X" /end COMPU_METHOD
/begin COMPU_METHOD LINEAR______0_000200__1H___6_248 "" FORM "%5.3" "%/10ms" FORMULA "0.0061137671*X-0.0059137671" FORMULA_INV "163.56527*X+0.96728695" /end COMPU_METHOD
/begin COMPU_METHOD LINEAR_______50_000000__FFFF8000 "" FORM "%7.3" "%" FORMULA "0.0015258793*X+1.2939651e-005" FORMULA_INV "655.35983*X-0.0084801272" /end COMPU_METHOD
/begin COMPU_METHOD LINEAR______0_0066100__1H___1_55 "" FORM "%5.3" "%/10ms" FORMULA "0.0061015354*X+0.00050846457" FORMULA_INV "163.89317*X-0.083333871" /end COMPU_METHOD
/begin COMPU_METHOD LINEAR______0_000000__0H___49_99 "" FORM "%7.3" "%" FORMULA "0.0015258797*X" FORMULA_INV "655.35965*X" /end COMPU_METHOD
/begin COMPU_METHOD LINEAR_______50_000000__FFFF8110 "" FORM "%7.3" "%" FORMULA "0.0015258789*X" FORMULA_INV "655.36*X" /end COMPU_METHOD
/begin COMPU_METHOD LINEAR_______200_000000__FFFF111 "" FORM "%8.4" "%" FORMULA "0.0061035142*X-4.8242924e-005" FORMULA_INV "163.84004*X+0.0079041225" /end COMPU_METHOD
/begin COMPU_METHOD LINEAR______0_000000__0H___24_90 "" FORM "%4.1" "%/40ms" FORMULA "0.097654904*X" FORMULA_INV "10.240141*X" /end COMPU_METHOD
/begin COMPU_METHOD LINEAR______0_097700__1H___24_90 "" FORM "%4.1" "%/40ms" FORMULA "0.097654726*X+4.5273898e-005" FORMULA_INV "10.24016*X-0.00046361195" /end COMPU_METHOD
/begin COMPU_METHOD LINEAR_______50_000000__FFFFFF80 "" FORM "%6.2" "%" FORMULA "0.39062745*X+0.00031372549" FORMULA_INV "2.5599839*X-0.00080313222" /end COMPU_METHOD
/begin COMPU_METHOD LINEAR______0_000000__0H___65112 "" FORM "%5.0" "km" FORMULA "1.0*X" FORMULA_INV "1.0*X" /end COMPU_METHOD
/begin COMPU_METHOD LINEAR______0_000000__0H___65113 "" FORM "%5.0" "*20ms" FORMULA "1.0*X" FORMULA_INV "1.0*X" /end COMPU_METHOD
/begin COMPU_METHOD LINEAR______0_000000__0H___25114 "" FORM "%3.0" "*20ms" FORMULA "1.0*X" FORMULA_INV "1.0*X" /end COMPU_METHOD
/begin COMPU_METHOD LINEAR______0_000000__0H___31_25 "" FORM "%6.3" "%" FORMULA "0.0015258789*X" FORMULA_INV "655.36*X" /end COMPU_METHOD
/begin COMPU_METHOD LINEAR______0_000000__8000H___31 "" FORM "%5.2" "%" FORMULA "0.0015258789*X-50.0" FORMULA_INV "655.36*X+32768.0" /end COMPU_METHOD
/begin COMPU_METHOD LINEAR_______31_250000__3000H115 "" FORM "%7.3" "%" FORMULA "0.0015258789*X-50.0" FORMULA_INV "655.36*X+32768.0" /end COMPU_METHOD
/begin COMPU_METHOD LINEAR_______31_250000__3000H116 "" FORM "%7.3" "-" FORMULA "0.0015258789*X-50.0" FORMULA_INV "655.36*X+32768.0" /end COMPU_METHOD
/begin COMPU_METHOD LINEAR_______31_250000__FFFFB000 "" FORM "%6.2" "-" FORMULA "0.0015258789*X" FORMULA_INV "655.36*X" /end COMPU_METHOD
/begin COMPU_METHOD LINEAR______0_000000__0H___31117 "" FORM "%6.3" "%" FORMULA "0.0015258789*X" FORMULA_INV "655.36*X" /end COMPU_METHOD
/begin COMPU_METHOD LINEAR______0_000000__0H___25118 "" FORM "%3.0" "sum" FORMULA "1.0*X" FORMULA_INV "1.0*X" /end COMPU_METHOD
/begin COMPU_METHOD LINEAR______1_000000__1H___25119 "" FORM "%3.0" "sum" FORMULA "1.0*X" FORMULA_INV "1.0*X" /end COMPU_METHOD
/begin COMPU_METHOD LINEAR______0_024000__1H___6_120 "" FORM "%5.3" "%/20ms" FORMULA "0.024*X" FORMULA_INV "41.666667*X" /end COMPU_METHOD
/begin COMPU_METHOD LINEAR______0_000000__0H___99120 "" FORM "%6.3" "%/10ms" FORMULA "0.0015258789*X" FORMULA_INV "655.36*X" /end COMPU_METHOD
/begin COMPU_METHOD LINEAR______0_001526__1H___99_99 "" FORM "%6.3" "%/10ms" FORMULA "0.0015256918*X-0.0015104318" FORMULA_INV "655.44038*X+0.98999798" /end COMPU_METHOD
/begin COMPU_METHOD LINEAR______0_000000__0H___694_5 "" FORM "%6.2" "mg/stk" FORMULA "0.021195105*X" FORMULA_INV "47.180706*X" /end COMPU_METHOD
/begin COMPU_METHOD LINEAR______0_000000__0H___13121 "" FORM "%4.0" "mg/stk" FORMULA "0.021194781*X" FORMULA_INV "47.181425*X" /end COMPU_METHOD
/begin COMPU_METHOD LINEAR______0_000000__0H___5_426 "" FORM "%4.2" "mg/stk" FORMULA "0.021278431*X" FORMULA_INV "46.995945*X" /end COMPU_METHOD
/begin COMPU_METHOD LINEAR______0_000000__0H___65122 "" FORM "%5.0" "1/200rev" FORMULA "1.0*X" FORMULA_INV "1.0*X" /end COMPU_METHOD
/begin COMPU_METHOD LINEAR______0_000000__0H___500_0 "" FORM "%3.0" "1/1000rev" FORMULA "1.0*X" FORMULA_INV "1.0*X" /end COMPU_METHOD
/begin COMPU_METHOD LINEAR______0_000000__0H___6_123 "" FORM "%2.0" "cyl" FORMULA "1.0*X" FORMULA_INV "1.0*X" /end COMPU_METHOD
/begin COMPU_METHOD LINEAR______1_000000__0H___255_0 "" FORM "%4.0" "PUC-phases" FORMULA "1.0*X+1.0" FORMULA_INV "1.0*X-1.0" /end COMPU_METHOD
/begin COMPU_METHOD LINEAR______0_000000__0H___1_124 "" FORM "%4.0" "-" FORMULA "1.0*X" FORMULA_INV "1.0*X" /end COMPU_METHOD
/begin COMPU_METHOD LINEAR_______100_000000__FFFF800 "" FORM "%6.3" "%" FORMULA "0.0030517578*X-1.0937669e-009" FORMULA_INV "327.68*X+3.5840552e-007" /end COMPU_METHOD
/begin COMPU_METHOD LINEAR______0_000000__0H___10125 "" FORM "%7.3" "%" FORMULA "0.0030518509*X" FORMULA_INV "327.67*X" /end COMPU_METHOD
/begin COMPU_METHOD LINEAR______0_000000__0H___10126 "" FORM "%7.3" "%" FORMULA "0.0030518509*X" FORMULA_INV "327.67*X" /end COMPU_METHOD
/begin COMPU_METHOD LINEAR______0_000000__0H___25127 "" FORM "%3.0" "rpm" FORMULA "1.0*X" FORMULA_INV "1.0*X" /end COMPU_METHOD
/begin COMPU_METHOD LINEAR______0_000000__0H___10128 "" FORM "%4.0" "rpm" FORMULA "1.0*X" FORMULA_INV "1.0*X" /end COMPU_METHOD
/begin RECORD_LAYOUT a_85 FNC_VALUES 1 UWORD ROW_DIR DIRECT /end RECORD_LAYOUT
/begin RECORD_LAYOUT a_86 FNC_VALUES 1 UBYTE ROW_DIR DIRECT /end RECORD_LAYOUT
/begin RECORD_LAYOUT a_87 FNC_VALUES 1 SBYTE ROW_DIR DIRECT /end RECORD_LAYOUT
/begin RECORD_LAYOUT a_95 FNC_VALUES 1 SWORD ROW_DIR DIRECT /end RECORD_LAYOUT
/end MODULE
/end PROJECT
