ASAP2_VERSION 1 2
/begin PROJECT Z42D "011"
/begin HEADER "" VERSION "0AD.03" PROJECT_NO Z011 /end HEADER
/begin MODULE BMW-EASY ""
/begin MOD_COMMON "common attributes" DEPOSIT ABSOLUT BYTE_ORDER BIG_ENDIAN /end MOD_COMMON
/begin CHARACTERISTIC kf_ti_aebg_ns__tkw "KF_TI_AEBG_NS" CURVE 0x4c100 a_7 10 LINEAR______0_040000__AH___16_38 0.04 16.384
 /begin AXIS_DESCR COM_AXIS tkw LINEAR_______48_000000__0H___114 8 -48.0 142.5 AXIS_PTS_REF sstm_tkw_1_5 MAX_GRAD 100 MONOTONY MON_INCREASE /end AXIS_DESCR
/end CHARACTERISTIC
/begin CHARACTERISTIC kf_ti_dk__dk__n "KF_TI_DK" MAP 0x4de70 a_4 100 LINEAR______0_000000__0H___32_76 0.0 32.7675
 /begin AXIS_DESCR COM_AXIS drehzahl ES_8_RES8 8 0.0 8160.0 AXIS_PTS_REF sstm_n_21_7 MAX_GRAD 100 MONOTONY MON_INCREASE /end AXIS_DESCR
 /begin AXIS_DESCR COM_AXIS dk LINEAR______0_000000__0H___11959 12 0.0 119.5 AXIS_PTS_REF sstm_dk_21_7 MAX_GRAD 100 MONOTONY MON_INCREASE /end AXIS_DESCR
/end CHARACTERISTIC
/begin CHARACTERISTIC kf_ti_dk_abr_ba__n "KF_TI_DK_ABR_BA" CURVE 0x4ded0 a_3 100 LINEAR______0_000000__0H___0_106 0.0 0.99608999
 /begin AXIS_DESCR COM_AXIS drehzahl ES_8_RES8 8 0.0 8160.0 AXIS_PTS_REF sstm_n_21_7 MAX_GRAD 100 MONOTONY MON_INCREASE /end AXIS_DESCR
/end CHARACTERISTIC
/begin CHARACTERISTIC kf_ti_dk_abr_sr__n "KF_TI_DK_ABR_SR" CURVE 0x4ded8 a_3 100 LINEAR______0_000000__0H___0_106 0.0 0.99608999
 /begin AXIS_DESCR COM_AXIS drehzahl ES_8_RES8 8 0.0 8160.0 AXIS_PTS_REF sstm_n_21_7 MAX_GRAD 100 MONOTONY MON_INCREASE /end AXIS_DESCR
/end CHARACTERISTIC
/begin CHARACTERISTIC kf_ti_dk_tkw_fak__tkw "KF_TI_DK_TKW_FAK" CURVE 0x4dee0 a_3 100 LINEAR______0_000000__0H___7_107 0.0 7.9679999
 /begin AXIS_DESCR COM_AXIS tkw LINEAR_______48_000000__0H___114 8 -48.0 142.5 AXIS_PTS_REF sstm_tkw_21_7 MAX_GRAD 100 MONOTONY MON_INCREASE /end AXIS_DESCR
/end CHARACTERISTIC
/begin CHARACTERISTIC kf_ti_dk_vue_fak__vue "KF_TI_DK_VUE_FAK" CURVE 0x4dee8 a_19 100 LINEAR______0_000000__0H___1_998 0.0 1.9922
 /begin AXIS_DESCR COM_AXIS vue LINEAR______0_000000__0H___120_0 8 0.0 120.0 AXIS_PTS_REF sstm_vue_1_7 MAX_GRAD 100 MONOTONY MON_INCREASE /end AXIS_DESCR
/end CHARACTERISTIC
/begin CHARACTERISTIC kf_ti_fak_fwl_at__tkw__t_ns "KF_TI_FAK_FWL_AT" MAP 0x4c110 a_43 40 LINEAR______0_500000__0H___1_500 0.5 1.5
 /begin AXIS_DESCR COM_AXIS zeit_nach_start LINEAR______0_000000__0H___6553_ 8 0.0 6553.5 AXIS_PTS_REF sstm_t_ns_1_8 MAX_GRAD 100 MONOTONY MON_INCREASE /end AXIS_DESCR
 /begin AXIS_DESCR COM_AXIS tkw LINEAR_______48_000000__0H___121 8 -48.0 142.5 AXIS_PTS_REF sstm_tkw_1_22 MAX_GRAD 100 MONOTONY MON_INCREASE /end AXIS_DESCR
/end CHARACTERISTIC
/begin CHARACTERISTIC kf_ti_fak_fwl_mt__tkw__t_ns "KF_TI_FAK_FWL_MT" MAP 0x4c190 a_43 40 LINEAR______0_500000__0H___1_500 0.5 1.5
 /begin AXIS_DESCR COM_AXIS zeit_nach_start LINEAR______0_000000__0H___6553_ 8 0.0 6553.5 AXIS_PTS_REF sstm_t_ns_1_8 MAX_GRAD 100 MONOTONY MON_INCREASE /end AXIS_DESCR
 /begin AXIS_DESCR COM_AXIS tkw LINEAR_______48_000000__0H___121 8 -48.0 142.5 AXIS_PTS_REF sstm_tkw_1_22 MAX_GRAD 100 MONOTONY MON_INCREASE /end AXIS_DESCR
/end CHARACTERISTIC
/begin CHARACTERISTIC kf_ti_fak_kat_at__tkw__t_ns "KF_TI_FAK_KAT_AT" MAP 0x4c210 a_43 40 LINEAR______0_500000__0H___1_500 0.5 1.5
 /begin AXIS_DESCR COM_AXIS ti_ns LINEAR______0_000000__0H___6553_ 8 0.0 6553.5 AXIS_PTS_REF sstm_t_ns_2_8 MAX_GRAD 100 MONOTONY MON_INCREASE /end AXIS_DESCR
 /begin AXIS_DESCR COM_AXIS tkw LINEAR_______48_000000__0H___142 8 -48.0 142.5 AXIS_PTS_REF sstm_tkw_2_4 MAX_GRAD 100 MONOTONY MON_INCREASE /end AXIS_DESCR
/end CHARACTERISTIC
/begin CHARACTERISTIC kf_ti_fak_kat_mt__tkw__t_ns "KF_TI_FAK_KAT_MT" MAP 0x4c290 a_43 40 LINEAR______0_500000__0H___1_500 0.5 1.5
 /begin AXIS_DESCR COM_AXIS ti_ns LINEAR______0_000000__0H___6553_ 8 0.0 6553.5 AXIS_PTS_REF sstm_t_ns_2_8 MAX_GRAD 100 MONOTONY MON_INCREASE /end AXIS_DESCR
 /begin AXIS_DESCR COM_AXIS tkw LINEAR_______48_000000__0H___142 8 -48.0 142.5 AXIS_PTS_REF sstm_tkw_2_4 MAX_GRAD 100 MONOTONY MON_INCREASE /end AXIS_DESCR
/end CHARACTERISTIC
/begin CHARACTERISTIC kf_ti_fak_lwf__lm__n "KF_TI_FAK_LWF" MAP 0x4def0 a_4 100 LINEAR______0_000000__0H___1_998 0.0 1.9922
 /begin AXIS_DESCR COM_AXIS drehzahl ES_8_RES8 8 0.0 8160.0 AXIS_PTS_REF sstm_n_21_7 MAX_GRAD 100 MONOTONY MON_INCREASE /end AXIS_DESCR
 /begin AXIS_DESCR COM_AXIS lm MAF_8_RES 8 0.0 1389.0 AXIS_PTS_REF sstm_lm_23_7 MAX_GRAD 100 MONOTONY MON_INCREASE /end AXIS_DESCR
/end CHARACTERISTIC
/begin CHARACTERISTIC kf_ti_fak_swf__lm__n "KF_TI_FAK_SWF" MAP 0x4df30 a_4 100 LINEAR______0_000000__0H___1_998 0.0 1.9922
 /begin AXIS_DESCR COM_AXIS drehzahl ES_8_RES8 8 0.0 8160.0 AXIS_PTS_REF sstm_n_21_7 MAX_GRAD 100 MONOTONY MON_INCREASE /end AXIS_DESCR
 /begin AXIS_DESCR COM_AXIS lm MAF_8_RES 8 0.0 1389.0 AXIS_PTS_REF sstm_lm_23_7 MAX_GRAD 100 MONOTONY MON_INCREASE /end AXIS_DESCR
/end CHARACTERISTIC
/begin CHARACTERISTIC kf_ti_fwl__n__lm "KF_TI_FWL" MAP 0x4df70 a_4 15 LINEAR______0_000000__0H___0_104 0.0 0.99610001
 /begin AXIS_DESCR COM_AXIS lm MAF_8_RES 8 0.0 1389.0 AXIS_PTS_REF sst_lm_kf_ti_fwl MAX_GRAD 100 MONOTONY MON_INCREASE /end AXIS_DESCR
 /begin AXIS_DESCR COM_AXIS drehzahl ES_8_RES8 8 0.0 8160.0 AXIS_PTS_REF sst_n_kf_ti_fwl MAX_GRAD 100 MONOTONY MON_INCREASE /end AXIS_DESCR
/end CHARACTERISTIC
/begin CHARACTERISTIC kf_ti_inc_ks__zw_dif__t "KF_TI_INC_KS" MAP 0x4dfb0 a_4 100 LINEAR______0_000488__1H___0_124 0.000488 0.12451
 /begin AXIS_DESCR COM_AXIS dummy LINEAR______0_000000__0H___25108 4 0.0 255.0 AXIS_PTS_REF sst_t_kf_ti_inc_ks MAX_GRAD 100 MONOTONY MON_INCREASE /end AXIS_DESCR
 /begin AXIS_DESCR COM_AXIS dummy LINEAR______0_000000__0H___95_62 4 0.0 95.625 AXIS_PTS_REF sst_zw_dif_kf_ti_inc_ks MAX_GRAD 100 MONOTONY MON_INCREASE /end AXIS_DESCR
/end CHARACTERISTIC
/begin CHARACTERISTIC kf_ti_kat__n__lm "KF_TI_KAT" MAP 0x4dfc0 a_4 15 LINEAR______0_000000__0H___0_104 0.0 0.99610001
 /begin AXIS_DESCR COM_AXIS lm MAF_8_RES 8 0.0 1389.0 AXIS_PTS_REF sstm_lm_6_4 MAX_GRAD 100 MONOTONY MON_INCREASE /end AXIS_DESCR
 /begin AXIS_DESCR COM_AXIS drehzahl ES_8_RES8 8 0.0 8160.0 AXIS_PTS_REF sstm_n_5_4 MAX_GRAD 100 MONOTONY MON_INCREASE /end AXIS_DESCR
/end CHARACTERISTIC
/begin CHARACTERISTIC kf_ti_katv__n__lm "KF_TI_KATV" MAP 0x4c310 a_1 10 LINEAR______0_000000__0H___0_109 0.0 0.99610001
 /begin AXIS_DESCR COM_AXIS lm MAF_8_RES 6 0.0 1389.0 AXIS_PTS_REF sst_lm_kf_ti_katv MAX_GRAD 100 MONOTONY MON_INCREASE /end AXIS_DESCR
 /begin AXIS_DESCR COM_AXIS drehzahl ES_8_RES8 6 0.0 8160.0 AXIS_PTS_REF sst_n_kf_ti_katv MAX_GRAD 100 MONOTONY MON_INCREASE /end AXIS_DESCR
/end CHARACTERISTIC
/begin CHARACTERISTIC kf_ti_katv_fak__tkw "KF_TI_KATV_FAK" CURVE 0x4e000 a_3 100 LINEAR______0_000000__0H___0_104 0.0 0.99610001
 /begin AXIS_DESCR COM_AXIS tkw LINEAR_______48_000000__0H___133 2 -48.0 142.5 AXIS_PTS_REF sst_tkw_kf_ti_katv_fak MAX_GRAD 100 MONOTONY MON_INCREASE /end AXIS_DESCR
/end CHARACTERISTIC
/begin CHARACTERISTIC kf_ti_kns__tal__tkw "KF_TI_KNS" MAP 0x4e002 a_4 10 LINEAR______0_000000__0H___3_110 0.0 3.984
 /begin AXIS_DESCR COM_AXIS tkw LINEAR_______48_000000__0H___114 8 -48.0 142.5 AXIS_PTS_REF sstm_tkw_1_5 MAX_GRAD 100 MONOTONY MON_INCREASE /end AXIS_DESCR
 /begin AXIS_DESCR COM_AXIS tal LINEAR_______48_000000__0H___114 2 -48.0 142.5 AXIS_PTS_REF sst_tal_kf_ti_kns MAX_GRAD 100 MONOTONY MON_INCREASE /end AXIS_DESCR
/end CHARACTERISTIC
/begin CHARACTERISTIC kf_ti_kns_wst__tkw "KF_TI_KNS_WST" CURVE 0x4e012 a_3 10 LINEAR______0_500000__80H___0_99 0.5 0.99610001
 /begin AXIS_DESCR COM_AXIS tkw LINEAR_______48_000000__0H___114 8 -48.0 142.5 AXIS_PTS_REF sstm_tkw_1_5 MAX_GRAD 100 MONOTONY MON_INCREASE /end AXIS_DESCR
/end CHARACTERISTIC
/begin CHARACTERISTIC kf_ti_ks_1_bk1__n__lm "KF_TI_KS_1_BK1" MAP 0x4e01a a_4 10 LINEAR______0_000000__0H___0_925 0.0 0.99599999
 /begin AXIS_DESCR COM_AXIS lm MAF_8_RES40 8 0.0 1389.0 AXIS_PTS_REF sstm_lm_kf_ti_ks MAX_GRAD 100 MONOTONY MON_INCREASE /end AXIS_DESCR
 /begin AXIS_DESCR COM_AXIS drehzahl ES_8_RES8 10 0.0 8160.0 AXIS_PTS_REF sstm_n_1_8 MAX_GRAD 100 MONOTONY MON_INCREASE /end AXIS_DESCR
/end CHARACTERISTIC
/begin CHARACTERISTIC kf_ti_ks_1_bk2__n__lm "KF_TI_KS_1_BK2" MAP 0x4e06a a_4 10 LINEAR______0_000000__0H___0_925 0.0 0.99599999
 /begin AXIS_DESCR COM_AXIS lm MAF_8_RES40 8 0.0 1389.0 AXIS_PTS_REF sstm_lm_kf_ti_ks MAX_GRAD 100 MONOTONY MON_INCREASE /end AXIS_DESCR
 /begin AXIS_DESCR COM_AXIS drehzahl ES_8_RES8 10 0.0 8160.0 AXIS_PTS_REF sstm_n_1_8 MAX_GRAD 100 MONOTONY MON_INCREASE /end AXIS_DESCR
/end CHARACTERISTIC
/begin CHARACTERISTIC kf_ti_ks_2_bk1__n__lm "KF_TI_KS_2_BK1" MAP 0x4e0ba a_4 10 LINEAR______0_000000__0H___0_925 0.0 0.99599999
 /begin AXIS_DESCR COM_AXIS lm MAF_8_RES40 8 0.0 1389.0 AXIS_PTS_REF sstm_lm_kf_ti_ks MAX_GRAD 100 MONOTONY MON_INCREASE /end AXIS_DESCR
 /begin AXIS_DESCR COM_AXIS drehzahl ES_8_RES8 10 0.0 8160.0 AXIS_PTS_REF sstm_n_1_8 MAX_GRAD 100 MONOTONY MON_INCREASE /end AXIS_DESCR
/end CHARACTERISTIC
/begin CHARACTERISTIC kf_ti_ks_2_bk2__n__lm "KF_TI_KS_2_BK2" MAP 0x4e10a a_4 10 LINEAR______0_000000__0H___0_925 0.0 0.99599999
 /begin AXIS_DESCR COM_AXIS lm MAF_8_RES40 8 0.0 1389.0 AXIS_PTS_REF sstm_lm_kf_ti_ks MAX_GRAD 100 MONOTONY MON_INCREASE /end AXIS_DESCR
 /begin AXIS_DESCR COM_AXIS drehzahl ES_8_RES8 10 0.0 8160.0 AXIS_PTS_REF sstm_n_1_8 MAX_GRAD 100 MONOTONY MON_INCREASE /end AXIS_DESCR
/end CHARACTERISTIC
/begin CHARACTERISTIC kf_ti_ks_3_bk1__n__lm "KF_TI_KS_3_BK1" MAP 0x4e15a a_4 10 LINEAR______0_000000__0H___0_925 0.0 0.99599999
 /begin AXIS_DESCR COM_AXIS lm MAF_8_RES40 8 0.0 1389.0 AXIS_PTS_REF sstm_lm_kf_ti_ks MAX_GRAD 100 MONOTONY MON_INCREASE /end AXIS_DESCR
 /begin AXIS_DESCR COM_AXIS drehzahl ES_8_RES8 10 0.0 8160.0 AXIS_PTS_REF sstm_n_1_8 MAX_GRAD 100 MONOTONY MON_INCREASE /end AXIS_DESCR
/end CHARACTERISTIC
/begin CHARACTERISTIC kf_ti_ks_3_bk2__n__lm "KF_TI_KS_3_BK2" MAP 0x4e1aa a_4 10 LINEAR______0_000000__0H___0_925 0.0 0.99599999
 /begin AXIS_DESCR COM_AXIS lm MAF_8_RES40 8 0.0 1389.0 AXIS_PTS_REF sstm_lm_kf_ti_ks MAX_GRAD 100 MONOTONY MON_INCREASE /end AXIS_DESCR
 /begin AXIS_DESCR COM_AXIS drehzahl ES_8_RES8 10 0.0 8160.0 AXIS_PTS_REF sstm_n_1_8 MAX_GRAD 100 MONOTONY MON_INCREASE /end AXIS_DESCR
/end CHARACTERISTIC
/begin CHARACTERISTIC kf_ti_ks_4_bk1__n__lm "KF_TI_KS_4_BK1" MAP 0x4e1fa a_4 10 LINEAR______0_000000__0H___0_925 0.0 0.99599999
 /begin AXIS_DESCR COM_AXIS lm MAF_8_RES40 8 0.0 1389.0 AXIS_PTS_REF sstm_lm_kf_ti_ks MAX_GRAD 100 MONOTONY MON_INCREASE /end AXIS_DESCR
 /begin AXIS_DESCR COM_AXIS drehzahl ES_8_RES8 10 0.0 8160.0 AXIS_PTS_REF sstm_n_1_8 MAX_GRAD 100 MONOTONY MON_INCREASE /end AXIS_DESCR
/end CHARACTERISTIC
/begin CHARACTERISTIC kf_ti_ks_4_bk2__n__lm "KF_TI_KS_4_BK2" MAP 0x4e24a a_4 10 LINEAR______0_000000__0H___0_925 0.0 0.99599999
 /begin AXIS_DESCR COM_AXIS lm MAF_8_RES40 8 0.0 1389.0 AXIS_PTS_REF sstm_lm_kf_ti_ks MAX_GRAD 100 MONOTONY MON_INCREASE /end AXIS_DESCR
 /begin AXIS_DESCR COM_AXIS drehzahl ES_8_RES8 10 0.0 8160.0 AXIS_PTS_REF sstm_n_1_8 MAX_GRAD 100 MONOTONY MON_INCREASE /end AXIS_DESCR
/end CHARACTERISTIC
/begin CHARACTERISTIC kf_ti_ks_5_bk1__n__lm "KF_TI_KS_5_BK1" MAP 0x4e29a a_4 10 LINEAR______0_000000__0H___0_925 0.0 0.99599999
 /begin AXIS_DESCR COM_AXIS lm MAF_8_RES40 8 0.0 1389.0 AXIS_PTS_REF sstm_lm_kf_ti_ks MAX_GRAD 100 MONOTONY MON_INCREASE /end AXIS_DESCR
 /begin AXIS_DESCR COM_AXIS drehzahl ES_8_RES8 10 0.0 8160.0 AXIS_PTS_REF sstm_n_1_8 MAX_GRAD 100 MONOTONY MON_INCREASE /end AXIS_DESCR
/end CHARACTERISTIC
/begin CHARACTERISTIC kf_ti_ks_5_bk2__n__lm "KF_TI_KS_5_BK2" MAP 0x4e2ea a_4 10 LINEAR______0_000000__0H___0_925 0.0 0.99599999
 /begin AXIS_DESCR COM_AXIS lm MAF_8_RES40 8 0.0 1389.0 AXIS_PTS_REF sstm_lm_kf_ti_ks MAX_GRAD 100 MONOTONY MON_INCREASE /end AXIS_DESCR
 /begin AXIS_DESCR COM_AXIS drehzahl ES_8_RES8 10 0.0 8160.0 AXIS_PTS_REF sstm_n_1_8 MAX_GRAD 100 MONOTONY MON_INCREASE /end AXIS_DESCR
/end CHARACTERISTIC
/begin CHARACTERISTIC kf_ti_kst__n__tkw "KF_TI_KST" MAP 0x4c358 a_29 10 TI_BAS_16_RES 0.0 262.14
 /begin AXIS_DESCR COM_AXIS tkw LINEAR_______48_000000__0H___114 8 -48.0 142.5 AXIS_PTS_REF sstm_tkw_1_5 MAX_GRAD 100 MONOTONY MON_INCREASE /end AXIS_DESCR
 /begin AXIS_DESCR COM_AXIS drehzahl IS_13_RES 3 0.0 8160.0 AXIS_PTS_REF sstm_n_2_5 MAX_GRAD 100 MONOTONY MON_INCREASE /end AXIS_DESCR
/end CHARACTERISTIC
/begin CHARACTERISTIC kf_ti_kst_pu_kor__fak_pu "KF_TI_KST_PU_KOR" CURVE 0x4e33a a_3 100 LINEAR______0_000000__0H___1_992 0.0 1.9922
 /begin AXIS_DESCR COM_AXIS fak_pu LINEAR______0_000000__0H___1_992 6 0.0 1.9922 AXIS_PTS_REF sst_fak_pu_kf_ti_kst_pu_kor MAX_GRAD 100 MONOTONY MON_INCREASE /end AXIS_DESCR
/end CHARACTERISTIC
/begin CHARACTERISTIC kf_ti_ll__n_dif_kor "KF_TI_LL" CURVE 0x4e340 a_19 10 LINEAR_______0_500000__0H___0_49 -0.5 0.49599999
 /begin AXIS_DESCR COM_AXIS n_dif_kor LINEAR_______1024_000000__7C00H_ 6 -1024.0 1016.0 AXIS_PTS_REF sst_n_dif_kor_kf_ti_ll MAX_GRAD 100 MONOTONY MON_INCREASE /end AXIS_DESCR
/end CHARACTERISTIC
/begin CHARACTERISTIC kf_ti_lwf_min__tkw "KF_TI_LWF_MIN" CURVE 0x4c388 a_7 100 LINEAR______0_000000__0H___262_1 0.0 262.144
 /begin AXIS_DESCR COM_AXIS tkw LINEAR_______48_000000__0H___142 4 -48.0 142.5 AXIS_PTS_REF sstm_tkw_kf_ti_xwf_min MAX_GRAD 100 MONOTONY MON_INCREASE /end AXIS_DESCR
/end CHARACTERISTIC
/begin CHARACTERISTIC kf_ti_pu_kor__fak_pu "KF_TI_PU_KOR" CURVE 0x4c390 a_7 100 LINEAR______0_000000__0H___2_111 0.0 2.0
 /begin AXIS_DESCR COM_AXIS fak_pu LINEAR______0_000000__0H___2_112 6 0.0 2.0 AXIS_PTS_REF sst_fak_pu_kf_ti_pu_kor MAX_GRAD 100 MONOTONY MON_INCREASE /end AXIS_DESCR
/end CHARACTERISTIC
/begin CHARACTERISTIC kf_ti_st_wst__tkw "KF_TI_ST_WST" CURVE 0x4e346 a_3 20 LINEAR______0_500000__80H___0_99 0.5 0.99610001
 /begin AXIS_DESCR COM_AXIS tkw LINEAR_______48_000000__0H___114 8 -48.0 142.5 AXIS_PTS_REF sstm_tkw_1_5 MAX_GRAD 100 MONOTONY MON_INCREASE /end AXIS_DESCR
/end CHARACTERISTIC
/begin CHARACTERISTIC kf_ti_swf_min__tkw "KF_TI_SWF_MIN" CURVE 0x4c39c a_7 100 LINEAR______0_000000__0H___262_1 0.0 262.144
 /begin AXIS_DESCR COM_AXIS tkw LINEAR_______48_000000__0H___142 4 -48.0 142.5 AXIS_PTS_REF sstm_tkw_kf_ti_xwf_min MAX_GRAD 100 MONOTONY MON_INCREASE /end AXIS_DESCR
/end CHARACTERISTIC
/begin CHARACTERISTIC kf_ti_tkw_fwl__tkw "KF_TI_TKW_FWL" CURVE 0x4e34e a_3 10 LINEAR______0_000000__0H___1_998 0.0 1.9922
 /begin AXIS_DESCR COM_AXIS tkw LINEAR_______48_000000__0H___121 8 -48.0 142.5 AXIS_PTS_REF sstm_tkw_1_22 MAX_GRAD 100 MONOTONY MON_INCREASE /end AXIS_DESCR
/end CHARACTERISTIC
/begin CHARACTERISTIC kf_ti_tkw_fwl_ll__tkw "KF_TI_TKW_FWL_LL" CURVE 0x4e356 a_3 10 LINEAR______0_000000__0H___1_998 0.0 1.9922
 /begin AXIS_DESCR COM_AXIS tkw LINEAR_______48_000000__0H___121 8 -48.0 142.5 AXIS_PTS_REF sstm_tkw_1_22 MAX_GRAD 100 MONOTONY MON_INCREASE /end AXIS_DESCR
/end CHARACTERISTIC
/begin CHARACTERISTIC kf_ti_tkw_kat__tkw "KF_TI_TKW_KAT" CURVE 0x4e35e a_3 10 LINEAR______0_000000__0H___1_998 0.0 1.9922
 /begin AXIS_DESCR COM_AXIS tkw LINEAR_______48_000000__0H___142 8 -48.0 142.5 AXIS_PTS_REF sstm_tkw_2_4 MAX_GRAD 100 MONOTONY MON_INCREASE /end AXIS_DESCR
/end CHARACTERISTIC
/begin CHARACTERISTIC kf_ti_tkw_kat_ll__tkw "KF_TI_TKW_KAT_LL" CURVE 0x4e366 a_3 10 LINEAR______0_000000__0H___1_998 0.0 1.9922
 /begin AXIS_DESCR COM_AXIS tkw LINEAR_______48_000000__0H___142 8 -48.0 142.5 AXIS_PTS_REF sstm_tkw_2_4 MAX_GRAD 100 MONOTONY MON_INCREASE /end AXIS_DESCR
/end CHARACTERISTIC
/begin CHARACTERISTIC kf_ti_tkw_neg_swf__n__tkw "KF_TI_TKW_NEG_SWF" MAP 0x4e36e a_4 100 LINEAR______0_000000__0H___127_5 0.0 127.5
 /begin AXIS_DESCR COM_AXIS tkw LINEAR_______48_000000__0H___114 8 -48.0 142.5 AXIS_PTS_REF sstm_tkw_21_7 MAX_GRAD 100 MONOTONY MON_INCREASE /end AXIS_DESCR
 /begin AXIS_DESCR COM_AXIS drehzahl ES_8_RES8 8 0.0 8160.0 AXIS_PTS_REF sstm_n_21_7 MAX_GRAD 100 MONOTONY MON_INCREASE /end AXIS_DESCR
/end CHARACTERISTIC
/begin CHARACTERISTIC kf_ti_tkw_pos_swf__n__tkw "KF_TI_TKW_POS_SWF" MAP 0x4e3ae a_4 100 LINEAR______0_000000__0H___127_5 0.0 127.5
 /begin AXIS_DESCR COM_AXIS tkw LINEAR_______48_000000__0H___114 8 -48.0 142.5 AXIS_PTS_REF sstm_tkw_21_7 MAX_GRAD 100 MONOTONY MON_INCREASE /end AXIS_DESCR
 /begin AXIS_DESCR COM_AXIS drehzahl ES_8_RES8 8 0.0 8160.0 AXIS_PTS_REF sstm_n_21_7 MAX_GRAD 100 MONOTONY MON_INCREASE /end AXIS_DESCR
/end CHARACTERISTIC
/begin CHARACTERISTIC kf_ti_tkw_wf__n__tkw "KF_TI_TKW_WF" MAP 0x4e3ee a_4 100 LINEAR______0_000000__0H___25113 0.0 255.0
 /begin AXIS_DESCR COM_AXIS tkw LINEAR_______48_000000__0H___114 8 -48.0 142.5 AXIS_PTS_REF sstm_tkw_21_7 MAX_GRAD 100 MONOTONY MON_INCREASE /end AXIS_DESCR
 /begin AXIS_DESCR COM_AXIS drehzahl ES_8_RES8 8 0.0 8160.0 AXIS_PTS_REF sstm_n_21_7 MAX_GRAD 100 MONOTONY MON_INCREASE /end AXIS_DESCR
/end CHARACTERISTIC
/begin CHARACTERISTIC kf_ti_tkw_wf_neg__n__tkw "KF_TI_TKW_WF_NEG" MAP 0x4e42e a_4 100 LINEAR______0_000000__0H___25113 0.0 255.0
 /begin AXIS_DESCR COM_AXIS tkw LINEAR_______48_000000__0H___114 8 -48.0 142.5 AXIS_PTS_REF sstm_tkw_21_7 MAX_GRAD 100 MONOTONY MON_INCREASE /end AXIS_DESCR
 /begin AXIS_DESCR COM_AXIS drehzahl ES_8_RES8 8 0.0 8160.0 AXIS_PTS_REF sstm_n_21_7 MAX_GRAD 100 MONOTONY MON_INCREASE /end AXIS_DESCR
/end CHARACTERISTIC
/begin CHARACTERISTIC kf_ti_tkw_wl__tkw__tkw_st "KF_TI_TKW_WL" MAP 0x4e46e a_4 10 LINEAR______0_000000__0H___1_998 0.0 1.9922
 /begin AXIS_DESCR COM_AXIS tkw_st LINEAR_______48_000000__0H___114 3 -48.0 142.5 AXIS_PTS_REF sst_tkw_st_ti_tkw_wl MAX_GRAD 100 MONOTONY MON_INCREASE /end AXIS_DESCR
 /begin AXIS_DESCR COM_AXIS tkw LINEAR_______48_000000__0H___114 8 -48.0 142.5 AXIS_PTS_REF sstm_tkw_4_4 MAX_GRAD 100 MONOTONY MON_INCREASE /end AXIS_DESCR
/end CHARACTERISTIC
/begin CHARACTERISTIC kf_ti_tkw1_vanos_ll__n__lm "KF_TI_TKW1_VANOS_LL" MAP 0x4c3a4 a_38 100 TI_BAS_16_RES 0.0 262.14
 /begin AXIS_DESCR COM_AXIS lm MAF_16_RES79 6 0.0 1389.0 AXIS_PTS_REF sstm_lm_1_28 MAX_GRAD 100 MONOTONY MON_INCREASE /end AXIS_DESCR
 /begin AXIS_DESCR COM_AXIS drehzahl IS_13_RES 6 0.0 8160.0 AXIS_PTS_REF sstm_n_1_28 MAX_GRAD 100 MONOTONY MON_INCREASE /end AXIS_DESCR
/end CHARACTERISTIC
/begin CHARACTERISTIC kf_ti_tkw2_vanos_ll__n__lm "KF_TI_TKW2_VANOS_LL" MAP 0x4c3ec a_38 100 TI_BAS_16_RES 0.0 262.14
 /begin AXIS_DESCR COM_AXIS lm MAF_16_RES79 6 0.0 1389.0 AXIS_PTS_REF sstm_lm_1_28 MAX_GRAD 100 MONOTONY MON_INCREASE /end AXIS_DESCR
 /begin AXIS_DESCR COM_AXIS drehzahl IS_13_RES 6 0.0 8160.0 AXIS_PTS_REF sstm_n_1_28 MAX_GRAD 100 MONOTONY MON_INCREASE /end AXIS_DESCR
/end CHARACTERISTIC
/begin CHARACTERISTIC kf_ti_tkw2_vanos_tl_bk1__n__lm "KF_TI_TKW2_VANOS_TL_BK1" MAP 0x4c434 a_38 100 TI_BAS_16_RES 0.0 262.14
 /begin AXIS_DESCR COM_AXIS lm MAF_16_RES79 12 0.0 1389.0 AXIS_PTS_REF sstm_lm_4_7 MAX_GRAD 100 MONOTONY MON_INCREASE /end AXIS_DESCR
 /begin AXIS_DESCR COM_AXIS drehzahl IS_13_RES 16 0.0 8160.0 AXIS_PTS_REF sstm_n_4_7 MAX_GRAD 100 MONOTONY MON_INCREASE /end AXIS_DESCR
/end CHARACTERISTIC
/begin CHARACTERISTIC kf_ti_tkw2_vanos_tl_bk2__n__lm "KF_TI_TKW2_VANOS_TL_BK2" MAP 0x4c5b4 a_38 100 TI_BAS_16_RES 0.0 262.14
 /begin AXIS_DESCR COM_AXIS lm MAF_16_RES79 12 0.0 1389.0 AXIS_PTS_REF sstm_lm_4_7 MAX_GRAD 100 MONOTONY MON_INCREASE /end AXIS_DESCR
 /begin AXIS_DESCR COM_AXIS drehzahl IS_13_RES 16 0.0 8160.0 AXIS_PTS_REF sstm_n_4_7 MAX_GRAD 100 MONOTONY MON_INCREASE /end AXIS_DESCR
/end CHARACTERISTIC
/begin CHARACTERISTIC kf_ti_vl__n "KF_TI_VL" CURVE 0x4e486 a_19 5 LINEAR______0_000000__0H___0_104 0.0 0.99610001
 /begin AXIS_DESCR COM_AXIS drehzahl IS_13_RES 16 0.0 8160.0 AXIS_PTS_REF sstm_n_4_7 MAX_GRAD 100 MONOTONY MON_INCREASE /end AXIS_DESCR
/end CHARACTERISTIC
/begin CHARACTERISTIC kf_ti_vue_lwf__vue "KF_TI_VUE_LWF" CURVE 0x4e496 a_19 100 LINEAR______0_000000__0H___1_998 0.0 1.9922
 /begin AXIS_DESCR COM_AXIS vue LINEAR______0_000000__0H___120_0 8 0.0 120.0 AXIS_PTS_REF sstm_vue_1_7 MAX_GRAD 100 MONOTONY MON_INCREASE /end AXIS_DESCR
/end CHARACTERISTIC
/begin CHARACTERISTIC kf_ti_vue_swf__vue "KF_TI_VUE_SWF" CURVE 0x4e49e a_19 100 LINEAR______0_000000__0H___1_998 0.0 1.9922
 /begin AXIS_DESCR COM_AXIS vue LINEAR______0_000000__0H___120_0 8 0.0 120.0 AXIS_PTS_REF sstm_vue_1_7 MAX_GRAD 100 MONOTONY MON_INCREASE /end AXIS_DESCR
/end CHARACTERISTIC
/begin CHARACTERISTIC kf_ti_vue_wl__tkw__vue "KF_TI_VUE_WL" MAP 0x4e4a6 a_11 100 LINEAR______0_500000__40H___1_50 0.5 1.5
 /begin AXIS_DESCR COM_AXIS vue LINEAR______0_000000__0H___12099 8 0.0 120.0 AXIS_PTS_REF sstm_vue_kf_xxx_vue_xxx MAX_GRAD 100 MONOTONY MON_INCREASE /end AXIS_DESCR
 /begin AXIS_DESCR COM_AXIS tkw LINEAR_______48_000000__0H___100 8 -48.0 142.5 AXIS_PTS_REF sstm_tkw_6_1 MAX_GRAD 100 MONOTONY MON_INCREASE /end AXIS_DESCR
/end CHARACTERISTIC
/begin CHARACTERISTIC kf_ti_wl__n__lm "KF_TI_WL" MAP 0x4e4e6 a_4 15 LINEAR______0_000000__0H___0_104 0.0 0.99610001
 /begin AXIS_DESCR COM_AXIS lm MAF_8_RES 8 0.0 1389.0 AXIS_PTS_REF sstm_lm_6_4 MAX_GRAD 100 MONOTONY MON_INCREASE /end AXIS_DESCR
 /begin AXIS_DESCR COM_AXIS drehzahl ES_8_RES8 8 0.0 8160.0 AXIS_PTS_REF sstm_n_5_4 MAX_GRAD 100 MONOTONY MON_INCREASE /end AXIS_DESCR
/end CHARACTERISTIC
/begin CHARACTERISTIC kf_tib__n__lm "KF_TIB" MAP 0x4c734 a_38 25 TI_BAS_16_RES 0.0 262.14
 /begin AXIS_DESCR COM_AXIS lm MAF_16_RES79 12 0.0 1389.0 AXIS_PTS_REF sstm_lm_4_7 MAX_GRAD 100 MONOTONY MON_INCREASE /end AXIS_DESCR
 /begin AXIS_DESCR COM_AXIS drehzahl IS_13_RES 16 0.0 8160.0 AXIS_PTS_REF sstm_n_4_7 MAX_GRAD 100 MONOTONY MON_INCREASE /end AXIS_DESCR
/end CHARACTERISTIC
/begin CHARACTERISTIC kf_tkw__utkw "KF_TKW" CURVE 0x4e526 a_19 15 LINEAR_______48_000000__0H___114 -48.0 142.5
 /begin AXIS_DESCR COM_AXIS dummy LINEAR______0_078000__10H___4_99 16 0.078 4.995 AXIS_PTS_REF sst_utkw_kf_tkw MAX_GRAD 100 MONOTONY MON_INCREASE /end AXIS_DESCR
/end CHARACTERISTIC
/begin CHARACTERISTIC kf_tkw_ers_inc__lm_kg_h "KF_TKW_ERS_INC" CURVE 0x4e536 a_19 20 LINEAR______0_750000__1H___190_5 0.75 190.5
 /begin AXIS_DESCR COM_AXIS lm_kg_h LINEAR______0_250000__1H___16383 4 0.25 16383.75 AXIS_PTS_REF sst_lm_kg_h_kf_tkw_ers_inc MAX_GRAD 100 MONOTONY MON_INCREASE /end AXIS_DESCR
/end CHARACTERISTIC
/begin CHARACTERISTIC kf_tmag__toel__tkw "KF_TMAG" MAP 0x4e53a a_4 100 LINEAR_______48_000000__0H___155 -48.0 155.0
 /begin AXIS_DESCR COM_AXIS tkw LINEAR_______48_000000__0H___189 10 -48.0 142.5 AXIS_PTS_REF sst_tkw_kf_tmag MAX_GRAD 100 MONOTONY MON_INCREASE /end AXIS_DESCR
 /begin AXIS_DESCR COM_AXIS toel LINEAR_______48_000000__0H___156 10 -48.0 155.0 AXIS_PTS_REF sst_toel_kf_tmag MAX_GRAD 100 MONOTONY MON_INCREASE /end AXIS_DESCR
/end CHARACTERISTIC
/begin CHARACTERISTIC kf_tmdk__tkw__tal "KF_TMDK" MAP 0x4e59e a_4 100 LINEAR_______48_000000__0H___142 -48.0 142.5
 /begin AXIS_DESCR COM_AXIS tal LINEAR_______48_000000__0H___121 6 -48.0 142.5 AXIS_PTS_REF sst_tal_kf_tmdk MAX_GRAD 100 MONOTONY MON_INCREASE /end AXIS_DESCR
 /begin AXIS_DESCR COM_AXIS tkw LINEAR_______48_000000__0H___142 6 -48.0 142.5 AXIS_PTS_REF sst_tkw_kf_tmdk MAX_GRAD 100 MONOTONY MON_INCREASE /end AXIS_DESCR
/end CHARACTERISTIC
/begin CHARACTERISTIC kf_tn_grd_end_ar__n "KF_TN_GRD_END_AR" CURVE 0x4c8b4 a_9 100 LINEAR_______0_125000__0H___0_12 -0.125 0.124996
 /begin AXIS_DESCR COM_AXIS drehzahl IS_13_RES114 10 0.0 8160.0 AXIS_PTS_REF sstm_n_1_7 MAX_GRAD 100 MONOTONY MON_INCREASE /end AXIS_DESCR
/end CHARACTERISTIC
/begin CHARACTERISTIC kf_tn_grd_st_1_ar__n__lm "KF_TN_GRD_ST_1_AR" MAP 0x4c8c8 a_29 100 LINEAR_______0_125000__0H___0_00 -0.125 0.0
 /begin AXIS_DESCR COM_AXIS lm MAF_8_RES40 3 0.0 1389.0 AXIS_PTS_REF sstm_lm_kf_tn_grd_st_ar MAX_GRAD 100 MONOTONY MON_INCREASE /end AXIS_DESCR
 /begin AXIS_DESCR COM_AXIS drehzahl IS_13_RES114 10 0.0 8160.0 AXIS_PTS_REF sstm_n_1_7 MAX_GRAD 100 MONOTONY MON_INCREASE /end AXIS_DESCR
/end CHARACTERISTIC
/begin CHARACTERISTIC kf_tn_grd_st_2_ar__n__lm "KF_TN_GRD_ST_2_AR" MAP 0x4c904 a_29 100 LINEAR_______0_125000__0H___0_00 -0.125 0.0
 /begin AXIS_DESCR COM_AXIS lm MAF_8_RES40 3 0.0 1389.0 AXIS_PTS_REF sstm_lm_kf_tn_grd_st_ar MAX_GRAD 100 MONOTONY MON_INCREASE /end AXIS_DESCR
 /begin AXIS_DESCR COM_AXIS drehzahl IS_13_RES114 10 0.0 8160.0 AXIS_PTS_REF sstm_n_1_7 MAX_GRAD 100 MONOTONY MON_INCREASE /end AXIS_DESCR
/end CHARACTERISTIC
/begin CHARACTERISTIC kf_tn2_fgr__vsoll_fgr "KF_TN2_FGR" CURVE 0x4c940 a_9 10 LINEAR______0_000000__0H___408_0 0.0 408.0
 /begin AXIS_DESCR COM_AXIS v_soll_fgr LINEAR______0_000000__0H___511_9 5 0.0 511.99218 AXIS_PTS_REF sstm_vsoll_fgr MAX_GRAD 100 MONOTONY MON_INCREASE /end AXIS_DESCR
/end CHARACTERISTIC
/begin CHARACTERISTIC kf_toel__utoel "KF_TOEL" CURVE 0x4e5c2 a_3 100 LINEAR_______48_000000__0H___130 -48.0 155.0
 /begin AXIS_DESCR COM_AXIS dummy LINEAR______0_000000__0H___5_000 16 0.0 5.0 AXIS_PTS_REF sst_utoel_toel MAX_GRAD 100 MONOTONY MON_INCREASE /end AXIS_DESCR
/end CHARACTERISTIC
/begin CHARACTERISTIC kf_toel_max_van_diag__n "KF_TOEL_MAX_VAN_DIAG" CURVE 0x4e5d2 a_3 100 LINEAR_______48_000000__0H___155 -48.0 155.0
 /begin AXIS_DESCR COM_AXIS n_32 ES_8_RES 4 0.0 8160.0 AXIS_PTS_REF sstm_n_4_5 MAX_GRAD 100 MONOTONY MON_INCREASE /end AXIS_DESCR
/end CHARACTERISTIC
/begin CHARACTERISTIC kf_toel_max_vanos__n "KF_TOEL_MAX_VANOS" CURVE 0x4e5d6 a_3 100 LINEAR_______48_000000__0H___155 -48.0 155.0
 /begin AXIS_DESCR COM_AXIS drehzahl ES_8_RES41 6 0.0 8160.0 AXIS_PTS_REF sstm_n_6_2 MAX_GRAD 100 MONOTONY MON_INCREASE /end AXIS_DESCR
/end CHARACTERISTIC
/begin CHARACTERISTIC kf_toel_min_van_diag__n "KF_TOEL_MIN_VAN_DIAG" CURVE 0x4e5dc a_3 100 LINEAR_______48_000000__0H___155 -48.0 155.0
 /begin AXIS_DESCR COM_AXIS n_32 ES_8_RES 4 0.0 8160.0 AXIS_PTS_REF sstm_n_4_5 MAX_GRAD 100 MONOTONY MON_INCREASE /end AXIS_DESCR
/end CHARACTERISTIC
/begin CHARACTERISTIC kf_tors_0_at__n "KF_TORS_0_AT" CURVE 0x4c94a a_7 100 LINEAR______0_000000__0H___1_115 0.0 1.9961
 /begin AXIS_DESCR COM_AXIS n_32 ES_8_RES17 6 0.0 8160.0 AXIS_PTS_REF sstm_n_kf_tors_0_at MAX_GRAD 100 MONOTONY MON_INCREASE /end AXIS_DESCR
/end CHARACTERISTIC
/begin CHARACTERISTIC kf_tors_0_mt__n "KF_TORS_0_MT" CURVE 0x4c956 a_7 100 LINEAR______0_000000__0H___1_115 0.0 1.9961
 /begin AXIS_DESCR COM_AXIS n_32 ES_8_RES17 6 0.0 8160.0 AXIS_PTS_REF sstm_n_kf_tors_0_mt MAX_GRAD 100 MONOTONY MON_INCREASE /end AXIS_DESCR
/end CHARACTERISTIC
/begin CHARACTERISTIC kf_tors_1_at__n "KF_TORS_1_AT" CURVE 0x4c962 a_7 100 LINEAR______0_000000__0H___1_115 0.0 1.9961
 /begin AXIS_DESCR COM_AXIS n_32 ES_8_RES17 6 0.0 8160.0 AXIS_PTS_REF sstm_n_kf_tors_1_at MAX_GRAD 100 MONOTONY MON_INCREASE /end AXIS_DESCR
/end CHARACTERISTIC
/begin CHARACTERISTIC kf_tors_1_mt__n "KF_TORS_1_MT" CURVE 0x4c96e a_7 100 LINEAR______0_000000__0H___1_115 0.0 1.9961
 /begin AXIS_DESCR COM_AXIS n_32 ES_8_RES17 6 0.0 8160.0 AXIS_PTS_REF sstm_n_kf_tors_1_mt MAX_GRAD 100 MONOTONY MON_INCREASE /end AXIS_DESCR
/end CHARACTERISTIC
/begin CHARACTERISTIC kf_tors_2_at__n "KF_TORS_2_AT" CURVE 0x4c97a a_7 100 LINEAR______0_000000__0H___1_115 0.0 1.9961
 /begin AXIS_DESCR COM_AXIS n_32 ES_8_RES17 6 0.0 8160.0 AXIS_PTS_REF sstm_n_kf_tors_2_at MAX_GRAD 100 MONOTONY MON_INCREASE /end AXIS_DESCR
/end CHARACTERISTIC
/begin CHARACTERISTIC kf_tors_2_mt__n "KF_TORS_2_MT" CURVE 0x4c986 a_7 100 LINEAR______0_000000__0H___1_115 0.0 1.9961
 /begin AXIS_DESCR COM_AXIS n_32 ES_8_RES17 6 0.0 8160.0 AXIS_PTS_REF sstm_n_kf_tors_2_mt MAX_GRAD 100 MONOTONY MON_INCREASE /end AXIS_DESCR
/end CHARACTERISTIC
/begin CHARACTERISTIC kf_tors_3_at__n "KF_TORS_3_AT" CURVE 0x4c992 a_7 100 LINEAR______0_000000__0H___1_115 0.0 1.9961
 /begin AXIS_DESCR COM_AXIS n_32 ES_8_RES17 6 0.0 8160.0 AXIS_PTS_REF sstm_n_kf_tors_3_at MAX_GRAD 100 MONOTONY MON_INCREASE /end AXIS_DESCR
/end CHARACTERISTIC
/begin CHARACTERISTIC kf_tors_3_mt__n "KF_TORS_3_MT" CURVE 0x4c99e a_7 100 LINEAR______0_000000__0H___1_115 0.0 1.9961
 /begin AXIS_DESCR COM_AXIS n_32 ES_8_RES17 6 0.0 8160.0 AXIS_PTS_REF sstm_n_kf_tors_3_mt MAX_GRAD 100 MONOTONY MON_INCREASE /end AXIS_DESCR
/end CHARACTERISTIC
/begin CHARACTERISTIC kf_tors_4_at__n "KF_TORS_4_AT" CURVE 0x4c9aa a_7 100 LINEAR______0_000000__0H___1_115 0.0 1.9961
 /begin AXIS_DESCR COM_AXIS n_32 ES_8_RES17 6 0.0 8160.0 AXIS_PTS_REF sstm_n_kf_tors_4_at MAX_GRAD 100 MONOTONY MON_INCREASE /end AXIS_DESCR
/end CHARACTERISTIC
/begin CHARACTERISTIC kf_tors_4_mt__n "KF_TORS_4_MT" CURVE 0x4c9b6 a_7 100 LINEAR______0_000000__0H___1_115 0.0 1.9961
 /begin AXIS_DESCR COM_AXIS n_32 ES_8_RES17 6 0.0 8160.0 AXIS_PTS_REF sstm_n_kf_tors_4_mt MAX_GRAD 100 MONOTONY MON_INCREASE /end AXIS_DESCR
/end CHARACTERISTIC
/begin CHARACTERISTIC kf_tors_5_at__n "KF_TORS_5_AT" CURVE 0x4c9c2 a_7 100 LINEAR______0_000000__0H___1_115 0.0 1.9961
 /begin AXIS_DESCR COM_AXIS n_32 ES_8_RES17 6 0.0 8160.0 AXIS_PTS_REF sstm_n_kf_tors_5_at MAX_GRAD 100 MONOTONY MON_INCREASE /end AXIS_DESCR
/end CHARACTERISTIC
/begin CHARACTERISTIC kf_tors_5_mt__n "KF_TORS_5_MT" CURVE 0x4c9ce a_7 100 LINEAR______0_000000__0H___1_115 0.0 1.9961
 /begin AXIS_DESCR COM_AXIS n_32 ES_8_RES17 6 0.0 8160.0 AXIS_PTS_REF sstm_n_kf_tors_5_mt MAX_GRAD 100 MONOTONY MON_INCREASE /end AXIS_DESCR
/end CHARACTERISTIC
/begin CHARACTERISTIC kf_tv_bab_max_ll__n "KF_TV_BAB_MAX_LL" CURVE 0x4c9da a_7 10 LINEAR______0_000000__0H___511_9 0.0 511.99218
 /begin AXIS_DESCR COM_AXIS n_32 ES_8_RES116 3 0.0 8160.0 AXIS_PTS_REF sst_n_kf_tv_bab_max_ll MAX_GRAD 100 MONOTONY MON_INCREASE /end AXIS_DESCR
/end CHARACTERISTIC
/begin CHARACTERISTIC kf_uls_kat_max_zyka__lm_kg_h "KF_ULS_KAT_MAX_ZYKA" CURVE 0x4e5e0 a_19 100 LINEAR______0_000000__0H___5100_ 0.0 5100.0
 /begin AXIS_DESCR COM_AXIS lm_kg_h MAF_KGH_16_RES117 8 0.0 16383.75 AXIS_PTS_REF sst_lm_kg_h_kf_uls_kat_max_zyka MAX_GRAD 100 MONOTONY MON_INCREASE /end AXIS_DESCR
/end CHARACTERISTIC
/begin CHARACTERISTIC kf_uls_max_zyka_fett__n__lm "KF_ULS_MAX_ZYKA_FETT" MAP 0x4e5e8 a_11 100 LINEAR______0_000000__0H___51118 0.0 5100.0
 /begin AXIS_DESCR COM_AXIS lm MAF_16_RES79 8 0.0 1389.0 AXIS_PTS_REF sstm_lm_kf_uls_max_zyka MAX_GRAD 100 MONOTONY MON_INCREASE /end AXIS_DESCR
 /begin AXIS_DESCR COM_AXIS drehzahl ES_8_RES8 8 0.0 8160.0 AXIS_PTS_REF sstm_n_1_22 MAX_GRAD 100 MONOTONY MON_INCREASE /end AXIS_DESCR
/end CHARACTERISTIC
/begin CHARACTERISTIC kf_uls_max_zyka_fm__n__lm "KF_ULS_MAX_ZYKA_FM" MAP 0x4e628 a_11 100 LINEAR______0_000000__0H___25119 0.0 2550.0
 /begin AXIS_DESCR COM_AXIS lm MAF_16_RES79 8 0.0 1389.0 AXIS_PTS_REF sstm_lm_kf_uls_max_zyka MAX_GRAD 100 MONOTONY MON_INCREASE /end AXIS_DESCR
 /begin AXIS_DESCR COM_AXIS drehzahl ES_8_RES8 8 0.0 8160.0 AXIS_PTS_REF sstm_n_1_22 MAX_GRAD 100 MONOTONY MON_INCREASE /end AXIS_DESCR
/end CHARACTERISTIC
/begin CHARACTERISTIC kf_uls_max_zyka_mager__n__lm "KF_ULS_MAX_ZYKA_MAGER" MAP 0x4e668 a_11 100 LINEAR______0_000000__0H___51118 0.0 5100.0
 /begin AXIS_DESCR COM_AXIS lm MAF_16_RES79 8 0.0 1389.0 AXIS_PTS_REF sstm_lm_kf_uls_max_zyka MAX_GRAD 100 MONOTONY MON_INCREASE /end AXIS_DESCR
 /begin AXIS_DESCR COM_AXIS drehzahl ES_8_RES8 8 0.0 8160.0 AXIS_PTS_REF sstm_n_1_22 MAX_GRAD 100 MONOTONY MON_INCREASE /end AXIS_DESCR
/end CHARACTERISTIC
/begin CHARACTERISTIC kf_uls_max_zyka_mf__n__lm "KF_ULS_MAX_ZYKA_MF" MAP 0x4e6a8 a_11 100 LINEAR______0_000000__0H___25119 0.0 2550.0
 /begin AXIS_DESCR COM_AXIS lm MAF_16_RES79 8 0.0 1389.0 AXIS_PTS_REF sstm_lm_kf_uls_max_zyka MAX_GRAD 100 MONOTONY MON_INCREASE /end AXIS_DESCR
 /begin AXIS_DESCR COM_AXIS drehzahl ES_8_RES8 8 0.0 8160.0 AXIS_PTS_REF sstm_n_1_22 MAX_GRAD 100 MONOTONY MON_INCREASE /end AXIS_DESCR
/end CHARACTERISTIC
/begin CHARACTERISTIC kf_uls_soll_zv__n__lm "KF_ULS_SOLL_ZV" MAP 0x4e6e8 a_4 100 LINEAR______0_000000__0H___1_275 0.0 1.275
 /begin AXIS_DESCR COM_AXIS lm MAF_8_RES37 4 0.0 1389.0 AXIS_PTS_REF sst_lm_kf_uls_soll_zv MAX_GRAD 100 MONOTONY MON_INCREASE /end AXIS_DESCR
 /begin AXIS_DESCR COM_AXIS n_32 ES_8_RES17 4 0.0 8160.0 AXIS_PTS_REF sst_n_kf_uls_soll_zv MAX_GRAD 100 MONOTONY MON_INCREASE /end AXIS_DESCR
/end CHARACTERISTIC
/begin CHARACTERISTIC kf_v_kr__n "V_KR" CURVE 0x4e6f8 a_3 10 LINEAR______0_003900__0H___1_120 0.0039 1.0
 /begin AXIS_DESCR COM_AXIS drehzahl ES_8_RES8 8 0.0 8160.0 AXIS_PTS_REF sstm_n_3_9 MAX_GRAD 100 MONOTONY MON_INCREASE /end AXIS_DESCR
/end CHARACTERISTIC
/begin CHARACTERISTIC kf_van_reg_fak_a__n "KF_VAN_REG_FAK_A" CURVE 0x4e700 a_3 10 LINEAR______0_000000__0H___3_121 0.0 3.984375
 /begin AXIS_DESCR COM_AXIS drehzahl ES_8_RES41 6 0.0 8160.0 AXIS_PTS_REF sstm_n_6_2 MAX_GRAD 100 MONOTONY MON_INCREASE /end AXIS_DESCR
/end CHARACTERISTIC
/begin CHARACTERISTIC kf_van_reg_fak_e__n "KF_VAN_REG_FAK_E" CURVE 0x4e706 a_3 10 LINEAR______0_000000__0H___3_121 0.0 3.984375
 /begin AXIS_DESCR COM_AXIS drehzahl ES_8_RES41 6 0.0 8160.0 AXIS_PTS_REF sstm_n_6_2 MAX_GRAD 100 MONOTONY MON_INCREASE /end AXIS_DESCR
/end CHARACTERISTIC
/begin CHARACTERISTIC kf_ve_anst_fak_fgr__t_anst_fgr "KF_VE_ANST_FAK_FGR" CURVE 0x4e70c a_3 10 LINEAR______0_000000__0H___1_992 0.0 1.9922
 /begin AXIS_DESCR COM_AXIS t_anst_fgr LINEAR______0_000000__0H___25_50 5 0.0 25.5 AXIS_PTS_REF sstm_t_anst_fgr MAX_GRAD 100 MONOTONY MON_INCREASE /end AXIS_DESCR
/end CHARACTERISTIC
/begin CHARACTERISTIC kf_vsr__n__lm_gem "KF_VSR" MAP 0x4c9e0 a_1 100 LINEAR______1_000000__1H___20_33 1.0 20.331
 /begin AXIS_DESCR COM_AXIS lm_gem MAF_8_RES37 6 0.0 1389.0 AXIS_PTS_REF sstm_lm_gem_kf_vsr MAX_GRAD 100 MONOTONY MON_INCREASE /end AXIS_DESCR
 /begin AXIS_DESCR COM_AXIS n_32 ES_8_RES17 6 0.0 8160.0 AXIS_PTS_REF sstm_n_32_kf_vsr MAX_GRAD 100 MONOTONY MON_INCREASE /end AXIS_DESCR
/end CHARACTERISTIC
/begin CHARACTERISTIC kf_vsr_neg__n__lm_gem "KF_VSR_NEG" MAP 0x4ca28 a_1 100 LINEAR______1_000000__1H___20_33 1.0 20.331
 /begin AXIS_DESCR COM_AXIS lm_gem MAF_8_RES37 6 0.0 1389.0 AXIS_PTS_REF sstm_lm_gem_kf_vsr MAX_GRAD 100 MONOTONY MON_INCREASE /end AXIS_DESCR
 /begin AXIS_DESCR COM_AXIS n_32 ES_8_RES17 6 0.0 8160.0 AXIS_PTS_REF sstm_n_32_kf_vsr MAX_GRAD 100 MONOTONY MON_INCREASE /end AXIS_DESCR
/end CHARACTERISTIC
/begin CHARACTERISTIC kf_vti_kst__tkw "KF_VTI_KST" CURVE 0x4ca70 a_7 10 TI_BAS_16_RES 0.0 262.14
 /begin AXIS_DESCR COM_AXIS tkw LINEAR_______48_000000__0H___114 8 -48.0 142.5 AXIS_PTS_REF sstm_tkw_1_5 MAX_GRAD 100 MONOTONY MON_INCREASE /end AXIS_DESCR
/end CHARACTERISTIC
/begin CHARACTERISTIC kf_wa_anst_fak_fgr__t_anst_fgr "KF_WA_ANST_FAK_FGR" CURVE 0x4e716 a_3 10 LINEAR______0_000000__0H___1_992 0.0 1.9922
 /begin AXIS_DESCR COM_AXIS t_anst_fgr LINEAR______0_000000__0H___25_50 5 0.0 25.5 AXIS_PTS_REF sstm_t_anst_fgr MAX_GRAD 100 MONOTONY MON_INCREASE /end AXIS_DESCR
/end CHARACTERISTIC
/begin CHARACTERISTIC kf_wf_auss_a__n__lm "KF_WF_AUSS_A" MAP 0x4e71b a_4 5 LINEAR______0_000000__0H___10122 0.0 100.0
 /begin AXIS_DESCR COM_AXIS lm MAF_8_RES 6 0.0 1389.0 AXIS_PTS_REF sst_lm_kf_wf_auss_a MAX_GRAD 100 MONOTONY MON_INCREASE /end AXIS_DESCR
 /begin AXIS_DESCR COM_AXIS drehzahl ES_8_RES8 6 0.0 8160.0 AXIS_PTS_REF sst_n_kf_wf_auss_a MAX_GRAD 100 MONOTONY MON_INCREASE /end AXIS_DESCR
/end CHARACTERISTIC
/begin CHARACTERISTIC kf_wf_lu__n__lm "KF_WF_LU" MAP 0x4e73f a_4 10 LINEAR______0_000000__0H___2_550 0.0 2.55
 /begin AXIS_DESCR COM_AXIS lm MAF_8_RES40 6 0.0 1389.0 AXIS_PTS_REF sst_lm_kf_wf_lu MAX_GRAD 100 MONOTONY MON_INCREASE /end AXIS_DESCR
 /begin AXIS_DESCR COM_AXIS n_32 ES_8_RES41 6 0.0 8160.0 AXIS_PTS_REF sst_n_kf_wf_lu MAX_GRAD 100 MONOTONY MON_INCREASE /end AXIS_DESCR
/end CHARACTERISTIC
/begin CHARACTERISTIC kf_wf_zsr__n__lm "KF_WF_ZSR" MAP 0x4e763 a_4 10 LINEAR______0_000000__0H___2_550 0.0 2.55
 /begin AXIS_DESCR COM_AXIS lm MAF_8_RES40 6 0.0 1389.0 AXIS_PTS_REF sst_lm_kf_wf_zsr MAX_GRAD 100 MONOTONY MON_INCREASE /end AXIS_DESCR
 /begin AXIS_DESCR COM_AXIS n_32 ES_8_RES8 6 0.0 8160.0 AXIS_PTS_REF sst_n_kf_wf_zsr MAX_GRAD 100 MONOTONY MON_INCREASE /end AXIS_DESCR
/end CHARACTERISTIC
/begin CHARACTERISTIC kf_zsi_soll__n__lm "KF_ZSI_SOLL" MAP 0x4e787 a_4 8 LINEAR______0_000000__0H___143_8 0.0 143.8
 /begin AXIS_DESCR COM_AXIS lm MAF_8_RES 6 0.0 1389.0 AXIS_PTS_REF sst_lm_kf_zsi_soll MAX_GRAD 100 MONOTONY MON_INCREASE /end AXIS_DESCR
 /begin AXIS_DESCR COM_AXIS drehzahl ES_8_RES8 6 0.0 8160.0 AXIS_PTS_REF sst_n_kf_zsi_soll MAX_GRAD 100 MONOTONY MON_INCREASE /end AXIS_DESCR
/end CHARACTERISTIC
/begin CHARACTERISTIC kf_zw_ad_roz_max__tal__tkw "KF_ZW_AD_ROZ_MAX" MAP 0x4e7ab a_4 20 LINEAR______0_000000__0H___1_123 0.0 1.0
 /begin AXIS_DESCR COM_AXIS tkw LINEAR_______48_000000__0H___114 4 -48.0 142.5 AXIS_PTS_REF sst_tkw_kf_zw_ad_roz_max MAX_GRAD 100 MONOTONY MON_INCREASE /end AXIS_DESCR
 /begin AXIS_DESCR COM_AXIS tal LINEAR_______48_000000__0H___114 4 -48.0 142.5 AXIS_PTS_REF sst_tal_kf_zw_ad_roz_max MAX_GRAD 100 MONOTONY MON_INCREASE /end AXIS_DESCR
/end CHARACTERISTIC
/begin CHARACTERISTIC kf_zw_aebg_max_sa__n "KF_ZW_AEBG_MAX_SA" CURVE 0x4e7bb a_19 10 LINEAR______0_375000__1H___47_62 0.375 47.625
 /begin AXIS_DESCR COM_AXIS drehzahl IS_13_RES 4 0.0 8160.0 AXIS_PTS_REF sstm_n_4_1 MAX_GRAD 100 MONOTONY MON_INCREASE /end AXIS_DESCR
/end CHARACTERISTIC
/begin CHARACTERISTIC kf_zw_aebg_well__ngrd "KF_ZW_AEBG_WELL" CURVE 0x4ca80 a_7 10 LINEAR______0_001460__1H___48_00 0.00146 48.0
 /begin AXIS_DESCR COM_AXIS dummy LINEAR_______4096_000000__0H___4 4 -4096.0 4064.0 AXIS_PTS_REF sst_ngrd_kf_zw_aebg_well MAX_GRAD 100 MONOTONY MON_INCREASE /end AXIS_DESCR
/end CHARACTERISTIC
/begin CHARACTERISTIC kf_zw_ar__n__lm "KF_ZW_AR_" MAP 0x4e7bf a_4 5 LINEAR_______48_000000__0H___124 -48.0 0.0
 /begin AXIS_DESCR COM_AXIS lm MAF_8_RES 6 0.0 1389.0 AXIS_PTS_REF sst_lm_zw_ar MAX_GRAD 100 MONOTONY MON_INCREASE /end AXIS_DESCR
 /begin AXIS_DESCR COM_AXIS drehzahl ES_8_RES8 8 0.0 8160.0 AXIS_PTS_REF sst_n_zw_ar MAX_GRAD 100 MONOTONY MON_INCREASE /end AXIS_DESCR
/end CHARACTERISTIC
/begin CHARACTERISTIC kf_zw_best_dif__dmdk "KF_ZW_BEST_DIF" CURVE 0x4e7ef a_3 13 LINEAR_______23_625000__0H___72_ -23.625 72.0
 /begin AXIS_DESCR COM_AXIS dummy LINEAR______0_000000__0H___11125 4 0.0 119.5 AXIS_PTS_REF sst_dmdk_kf_zw_best_dif MAX_GRAD 100 MONOTONY MON_INCREASE /end AXIS_DESCR
/end CHARACTERISTIC
/begin CHARACTERISTIC kf_zw_best_tkw1__n__lm "KF_ZW_BEST_TKW1" MAP 0x4e7f3 a_13 20 LINEAR_______23_625000__0H___126 -23.625 72.0
 /begin AXIS_DESCR COM_AXIS lm_zw MAF_16_RES49 12 0.0 1389.0 AXIS_PTS_REF sstm_lm_zw_12_1 MAX_GRAD 100 MONOTONY MON_INCREASE /end AXIS_DESCR
 /begin AXIS_DESCR COM_AXIS drehzahl IS_13_RES62 16 0.0 8160.0 AXIS_PTS_REF sstm_n_16_2 MAX_GRAD 100 MONOTONY MON_INCREASE /end AXIS_DESCR
/end CHARACTERISTIC
/begin CHARACTERISTIC kf_zw_best_tkw2__n__lm "KF_ZW_BEST_TKW2" MAP 0x4e8b3 a_13 20 LINEAR_______23_625000__0H___126 -23.625 72.0
 /begin AXIS_DESCR COM_AXIS lm_zw MAF_16_RES49 12 0.0 1389.0 AXIS_PTS_REF sstm_lm_zw_12_1 MAX_GRAD 100 MONOTONY MON_INCREASE /end AXIS_DESCR
 /begin AXIS_DESCR COM_AXIS drehzahl IS_13_RES62 16 0.0 8160.0 AXIS_PTS_REF sstm_n_16_2 MAX_GRAD 100 MONOTONY MON_INCREASE /end AXIS_DESCR
/end CHARACTERISTIC
/begin CHARACTERISTIC kf_zw_dif_mdz__md_fak "KF_ZW_DIF_MDZ" CURVE 0x4e973 a_19 20 LINEAR_______48_000000__80H__127 -48.0 0.0
 /begin AXIS_DESCR COM_AXIS dummy LINEAR______0_000000__0H___1_128 8 0.0 1.0 AXIS_PTS_REF sst_mdz_fak_kf_zw_dif_mdz MAX_GRAD 100 MONOTONY MON_INCREASE /end AXIS_DESCR
/end CHARACTERISTIC
/begin CHARACTERISTIC kf_zw_fak_kat2__tkw__t_ns "KF_ZW_FAK_KAT2" MAP 0x4e97b a_11 15 LINEAR______0_000000__0H___0_129 0.0 0.99599999
 /begin AXIS_DESCR COM_AXIS dummy LINEAR______0_000000__0H___65130 8 0.0 6553.5 AXIS_PTS_REF sstm_t_ns_1_3 MAX_GRAD 100 MONOTONY MON_INCREASE /end AXIS_DESCR
 /begin AXIS_DESCR COM_AXIS dummy LINEAR_______48_000000__0H___142 8 -48.0 142.5 AXIS_PTS_REF sstm_tkw_2_3 MAX_GRAD 100 MONOTONY MON_INCREASE /end AXIS_DESCR
/end CHARACTERISTIC
/begin CHARACTERISTIC kf_zw_fak_ll__tkw "KF_ZW_FAK_LL" CURVE 0x4e9bb a_3 10 LINEAR______0_000000__0H___0_925 0.0 0.99599999
 /begin AXIS_DESCR COM_AXIS tkw LINEAR_______48_000000__0H___114 4 -48.0 142.5 AXIS_PTS_REF sstm_tkw_2_6 MAX_GRAD 100 MONOTONY MON_INCREASE /end AXIS_DESCR
/end CHARACTERISTIC
/begin CHARACTERISTIC kf_zw_inst_fak__tal__roz_fak "KF_ZW_INST_FAK" MAP 0x4e9bf a_4 10 LINEAR______0_000000__0H___0_925 0.0 0.99599999
 /begin AXIS_DESCR COM_AXIS zw_kr_ad_roz LINEAR______0_000000__0H___1_131 3 0.0 1.0 AXIS_PTS_REF sst_roz_fak_kf_zw_inst_fak MAX_GRAD 100 MONOTONY MON_INCREASE /end AXIS_DESCR
 /begin AXIS_DESCR COM_AXIS tal LINEAR_______48_000000__0H___133 4 -48.0 142.5 AXIS_PTS_REF sst_tal_kf_zw_inst_fak MAX_GRAD 100 MONOTONY MON_INCREASE /end AXIS_DESCR
/end CHARACTERISTIC
/begin CHARACTERISTIC kf_zw_inst_kr__n__lm "KF_ZW_INST_KR" MAP 0x4e9cb a_4 10 LINEAR_______48_000000__0H___0_0 -48.0 0.0
 /begin AXIS_DESCR COM_AXIS lm_zw MAF_8_RES40 4 0.0 1389.0 AXIS_PTS_REF sst_lm_zw_tab_zw_inst_kr MAX_GRAD 100 MONOTONY MON_INCREASE /end AXIS_DESCR
 /begin AXIS_DESCR COM_AXIS drehzahl ES_8_RES8 4 0.0 8160.0 AXIS_PTS_REF sstm_n_4_4 MAX_GRAD 100 MONOTONY MON_INCREASE /end AXIS_DESCR
/end CHARACTERISTIC
/begin CHARACTERISTIC kf_zw_kat__n__lm "KF_ZW_KAT" MAP 0x4e9db a_4 15 LINEAR_______48_000000__0H___132 -48.0 47.625
 /begin AXIS_DESCR COM_AXIS lm MAF_8_RES 8 0.0 1389.0 AXIS_PTS_REF sstm_lm_8_1 MAX_GRAD 100 MONOTONY MON_INCREASE /end AXIS_DESCR
 /begin AXIS_DESCR COM_AXIS drehzahl ES_8_RES 8 0.0 8160.0 AXIS_PTS_REF sstm_n_8_2 MAX_GRAD 100 MONOTONY MON_INCREASE /end AXIS_DESCR
/end CHARACTERISTIC
/begin CHARACTERISTIC kf_zw_kat_katv__n__lm "KF_ZW_KAT_KATV" MAP 0x4ea1b a_4 15 LINEAR_______48_000000__0H___132 -48.0 47.625
 /begin AXIS_DESCR COM_AXIS lm MAF_8_RES 8 0.0 1389.0 AXIS_PTS_REF sstm_lm_8_1 MAX_GRAD 100 MONOTONY MON_INCREASE /end AXIS_DESCR
 /begin AXIS_DESCR COM_AXIS drehzahl ES_8_RES 8 0.0 8160.0 AXIS_PTS_REF sstm_n_8_2 MAX_GRAD 100 MONOTONY MON_INCREASE /end AXIS_DESCR
/end CHARACTERISTIC
/begin CHARACTERISTIC kf_zw_kat_ll__n "KF_ZW_KAT_LL" CURVE 0x4ea5b a_3 15 LINEAR_______48_000000__0H___132 -48.0 47.625
 /begin AXIS_DESCR COM_AXIS drehzahl ES_8_RES8 4 0.0 8160.0 AXIS_PTS_REF sst_n_kf_zw_kat_ll MAX_GRAD 100 MONOTONY MON_INCREASE /end AXIS_DESCR
/end CHARACTERISTIC
/begin CHARACTERISTIC kf_zw_kat2__n__pwg_ist "KF_ZW_KAT2" MAP 0x4ea5f a_4 15 LINEAR_______48_000000__0H___134 -48.0 0.0
 /begin AXIS_DESCR COM_AXIS pwg_ist LINEAR______0_000000__0H___11135 8 0.0 119.5 AXIS_PTS_REF sst_pwg_ist_kf_zw_kat2 MAX_GRAD 100 MONOTONY MON_INCREASE /end AXIS_DESCR
 /begin AXIS_DESCR COM_AXIS n_32 ES_8_RES41 8 0.0 8160.0 AXIS_PTS_REF sst_n_kf_zw_kat2 MAX_GRAD 100 MONOTONY MON_INCREASE /end AXIS_DESCR
/end CHARACTERISTIC
/begin CHARACTERISTIC kf_zw_kor_nw_dif_a__nw_dif "KF_ZW_KOR_NW_DIF_A" CURVE 0x4ea9f a_3 15 LINEAR_______48_000000__0H___136 -48.0 47.625
 /begin AXIS_DESCR COM_AXIS dummy LINEAR_______48_000000__0H___137 10 -48.0 47.625 AXIS_PTS_REF sstm_nw_dif_10_1 MAX_GRAD 100 MONOTONY MON_INCREASE /end AXIS_DESCR
/end CHARACTERISTIC
/begin CHARACTERISTIC kf_zw_kor_nw_dif_e__nw_dif "KF_ZW_KOR_NW_DIF_E" CURVE 0x4eaa9 a_3 15 LINEAR_______48_000000__0H___136 -48.0 47.625
 /begin AXIS_DESCR COM_AXIS dummy LINEAR_______48_000000__0H___137 10 -48.0 47.625 AXIS_PTS_REF sstm_nw_dif_10_1 MAX_GRAD 100 MONOTONY MON_INCREASE /end AXIS_DESCR
/end CHARACTERISTIC
/begin CHARACTERISTIC kf_zw_kr_dg__n__lm "KF_ZW_KR_DG" MAP 0x4eab3 a_4 100 LINEAR_______23_625000__0H___126 -23.625 72.0
 /begin AXIS_DESCR COM_AXIS lm_kr MAF_8_RES 8 0.0 1389.0 AXIS_PTS_REF sst_lm_kf_zw_kr_dg MAX_GRAD 100 MONOTONY MON_INCREASE /end AXIS_DESCR
 /begin AXIS_DESCR COM_AXIS drehzahl ES_8_RES8 8 0.0 8160.0 AXIS_PTS_REF sstm_n_3_9 MAX_GRAD 100 MONOTONY MON_INCREASE /end AXIS_DESCR
/end CHARACTERISTIC
/begin CHARACTERISTIC kf_zw_kup_swi_ll__tkw "KF_ZW_KUP_SWI_LL" CURVE 0x4eaf3 a_3 10 LINEAR_______48_000000__0H___0_0 -48.0 0.0
 /begin AXIS_DESCR COM_AXIS tkw LINEAR_______48_000000__0H___121 6 -48.0 142.5 AXIS_PTS_REF sstm_tkw_1_6 MAX_GRAD 100 MONOTONY MON_INCREASE /end AXIS_DESCR
/end CHARACTERISTIC
/begin CHARACTERISTIC kf_zw_lm_n__n__lm "KF_ZW_LM_N" MAP 0x4eaf9 a_4 5 LINEAR_______48_000000__0H___47_ -48.0 47.625
 /begin AXIS_DESCR COM_AXIS lm_zw MAF_8_RES40 6 0.0 1389.0 AXIS_PTS_REF sst_lm_kf_zw_lm_n MAX_GRAD 100 MONOTONY MON_INCREASE /end AXIS_DESCR
 /begin AXIS_DESCR COM_AXIS drehzahl ES_8_RES8 8 0.0 8160.0 AXIS_PTS_REF sst_n_kf_zw_lm_n MAX_GRAD 100 MONOTONY MON_INCREASE /end AXIS_DESCR
/end CHARACTERISTIC
/begin CHARACTERISTIC kf_zw_lm_n_kr_dg__n__lm "KF_ZW_LM_N_KR_DG" MAP 0x4eb29 a_4 100 LINEAR_______48_000000__0H___47_ -48.0 47.625
 /begin AXIS_DESCR COM_AXIS lm_kr MAF_8_RES 8 0.0 1389.0 AXIS_PTS_REF sst_lm_kf_zw_kr_dg MAX_GRAD 100 MONOTONY MON_INCREASE /end AXIS_DESCR
 /begin AXIS_DESCR COM_AXIS drehzahl ES_8_RES8 8 0.0 8160.0 AXIS_PTS_REF sstm_n_3_9 MAX_GRAD 100 MONOTONY MON_INCREASE /end AXIS_DESCR
/end CHARACTERISTIC
/begin CHARACTERISTIC kf_zw_lm_n_ll__n__lm "KF_ZW_LM_N_LL" MAP 0x4eb69 a_4 5 LINEAR_______48_000000__0H___47_ -48.0 47.625
 /begin AXIS_DESCR COM_AXIS lm_zw MAF_8_RES37 4 0.0 1389.0 AXIS_PTS_REF sst_lm_kf_zw_lm_n_ll MAX_GRAD 100 MONOTONY MON_INCREASE /end AXIS_DESCR
 /begin AXIS_DESCR COM_AXIS n_32 ES_8_RES 4 0.0 8160.0 AXIS_PTS_REF sst_n_kf_zw_lm_n_ll MAX_GRAD 100 MONOTONY MON_INCREASE /end AXIS_DESCR
/end CHARACTERISTIC
/begin CHARACTERISTIC kf_zw_max_sa__n "KF_ZW_MAX_SA" CURVE 0x4eb79 a_19 10 LINEAR_______48_000000__0H___124 -48.0 0.0
 /begin AXIS_DESCR COM_AXIS drehzahl IS_13_RES 4 0.0 8160.0 AXIS_PTS_REF sstm_n_4_1 MAX_GRAD 100 MONOTONY MON_INCREASE /end AXIS_DESCR
/end CHARACTERISTIC
/begin CHARACTERISTIC kf_zw_mdz__n__lm "KF_ZW_MDZ" MAP 0x4eb7d a_4 20 LINEAR_______23_625000__0H___126 -23.625 72.0
 /begin AXIS_DESCR COM_AXIS lm MAF_8_RES 8 0.0 1389.0 AXIS_PTS_REF sstm_lm_2_3 MAX_GRAD 100 MONOTONY MON_INCREASE /end AXIS_DESCR
 /begin AXIS_DESCR COM_AXIS drehzahl ES_8_RES8 9 0.0 8160.0 AXIS_PTS_REF sstm_n_5_3 MAX_GRAD 100 MONOTONY MON_INCREASE /end AXIS_DESCR
/end CHARACTERISTIC
/begin CHARACTERISTIC kf_zw_n_dif_ll__n_dif_kor "KF_ZW_N_DIF_LL" CURVE 0x4ebc5 a_19 5 LINEAR_______48_000000__0H___47_ -48.0 47.625
 /begin AXIS_DESCR COM_AXIS n_dif_kor LINEAR_______1024_000000__7C00H_ 12 -1024.0 1016.0 AXIS_PTS_REF sstm_n_dif_kor_6_6 MAX_GRAD 100 MONOTONY MON_INCREASE /end AXIS_DESCR
/end CHARACTERISTIC
/begin CHARACTERISTIC kf_zw_ns__n_dif_kor "KF_ZW_NS" CURVE 0x4ebd1 a_19 5 LINEAR_______48_000000__0H___138 -48.0 47.625
 /begin AXIS_DESCR COM_AXIS n_dif_kor LINEAR_______1024_000000__7C00H_ 4 -1024.0 1016.0 AXIS_PTS_REF sst_n_dif_kor_kf_zw_ns MAX_GRAD 100 MONOTONY MON_INCREASE /end AXIS_DESCR
/end CHARACTERISTIC
/begin CHARACTERISTIC kf_zw_roz91_vanos_tl__n__lm "KF_ZW_ROZ91_VANOS_TL" MAP 0x4ebd5 a_13 5 LINEAR_______23_625000__0H___126 -23.625 72.0
 /begin AXIS_DESCR COM_AXIS lm_zw MAF_16_RES49 16 0.0 1389.0 AXIS_PTS_REF sstm_lm_zw_kf_zw_tkw_vanos_tl MAX_GRAD 100 MONOTONY MON_INCREASE /end AXIS_DESCR
 /begin AXIS_DESCR COM_AXIS drehzahl IS_13_RES84 20 0.0 8160.0 AXIS_PTS_REF sstm_n_kf_zw_tkw_vanos_tl MAX_GRAD 100 MONOTONY MON_INCREASE /end AXIS_DESCR
/end CHARACTERISTIC
/begin CHARACTERISTIC kf_zw_roz98_vanos_tl__n__lm "KF_ZW_ROZ98_VANOS_TL" MAP 0x4ed15 a_13 5 LINEAR_______23_625000__0H___126 -23.625 72.0
 /begin AXIS_DESCR COM_AXIS lm_zw MAF_16_RES49 16 0.0 1389.0 AXIS_PTS_REF sstm_lm_zw_kf_zw_tkw_vanos_tl MAX_GRAD 100 MONOTONY MON_INCREASE /end AXIS_DESCR
 /begin AXIS_DESCR COM_AXIS drehzahl IS_13_RES84 20 0.0 8160.0 AXIS_PTS_REF sstm_n_kf_zw_tkw_vanos_tl MAX_GRAD 100 MONOTONY MON_INCREASE /end AXIS_DESCR
/end CHARACTERISTIC
/begin CHARACTERISTIC kf_zw_st__n "KF_ZW_ST" CURVE 0x4ee55 a_19 5 LINEAR_______23_625000__0H___139 -23.625 72.0
 /begin AXIS_DESCR COM_AXIS drehzahl IS_13_RES 3 0.0 8160.0 AXIS_PTS_REF sstm_n_2_5 MAX_GRAD 100 MONOTONY MON_INCREASE /end AXIS_DESCR
/end CHARACTERISTIC
/begin CHARACTERISTIC kf_zw_tallfs_min_ll__tallfs__lm "KF_ZW_TALLFS_MIN_ll" MAP 0x4ee58 a_4 10 LINEAR_______48_000000__0H___134 -48.0 0.0
 /begin AXIS_DESCR COM_AXIS lm MAF_8_RES40 2 0.0 1389.0 AXIS_PTS_REF sstm_lm_2_1 MAX_GRAD 100 MONOTONY MON_INCREASE /end AXIS_DESCR
 /begin AXIS_DESCR COM_AXIS tallfs LINEAR______0_000000__0H___99_61 5 0.0 99.610001 AXIS_PTS_REF sstm_tallfs_5_1 MAX_GRAD 100 MONOTONY MON_INCREASE /end AXIS_DESCR
/end CHARACTERISTIC
/begin CHARACTERISTIC kf_zw_tkw_kat_at__tkw__t_ns "KF_ZW_TKW_KAT_AT" MAP 0x4ee62 a_11 100 LINEAR______0_000000__0H___0_925 0.0 0.99599999
 /begin AXIS_DESCR COM_AXIS dummy LINEAR______0_000000__0H___65130 8 0.0 6553.5 AXIS_PTS_REF sstm_t_ns_kf_zw_tkw_kat MAX_GRAD 100 MONOTONY MON_INCREASE /end AXIS_DESCR
 /begin AXIS_DESCR COM_AXIS dummy LINEAR_______48_000000__0H___142 8 -48.0 142.5 AXIS_PTS_REF sstm_tkw_kf_zw_tkw_kat MAX_GRAD 100 MONOTONY MON_INCREASE /end AXIS_DESCR
/end CHARACTERISTIC
/begin CHARACTERISTIC kf_zw_tkw_kat_ll__tkw__t_ns "KF_ZW_TKW_KAT_LL" MAP 0x4eea2 a_11 100 LINEAR______0_000000__0H___0_925 0.0 0.99599999
 /begin AXIS_DESCR COM_AXIS dummy LINEAR______0_000000__0H___65130 8 0.0 6553.5 AXIS_PTS_REF sstm_t_ns_1_3 MAX_GRAD 100 MONOTONY MON_INCREASE /end AXIS_DESCR
 /begin AXIS_DESCR COM_AXIS dummy LINEAR_______48_000000__0H___142 8 -48.0 142.5 AXIS_PTS_REF sstm_tkw_2_3 MAX_GRAD 100 MONOTONY MON_INCREASE /end AXIS_DESCR
/end CHARACTERISTIC
/begin CHARACTERISTIC kf_zw_tkw_kat_mt__tkw__t_ns "KF_ZW_TKW_KAT_MT" MAP 0x4eee2 a_11 100 LINEAR______0_000000__0H___0_925 0.0 0.99599999
 /begin AXIS_DESCR COM_AXIS dummy LINEAR______0_000000__0H___65130 8 0.0 6553.5 AXIS_PTS_REF sstm_t_ns_kf_zw_tkw_kat MAX_GRAD 100 MONOTONY MON_INCREASE /end AXIS_DESCR
 /begin AXIS_DESCR COM_AXIS dummy LINEAR_______48_000000__0H___142 8 -48.0 142.5 AXIS_PTS_REF sstm_tkw_kf_zw_tkw_kat MAX_GRAD 100 MONOTONY MON_INCREASE /end AXIS_DESCR
/end CHARACTERISTIC
/begin CHARACTERISTIC kf_zw_tkw_st__tkw "KF_ZW_TKW_ST" CURVE 0x4ef22 a_3 5 LINEAR_______48_000000__0H___138 -48.0 47.625
 /begin AXIS_DESCR COM_AXIS tkw LINEAR_______48_000000__0H___114 8 -48.0 142.5 AXIS_PTS_REF sstm_tkw_1_5 MAX_GRAD 100 MONOTONY MON_INCREASE /end AXIS_DESCR
/end CHARACTERISTIC
/begin CHARACTERISTIC kf_zw_tkw1_vanos_ll__n__lm "KF_ZW_TKW1_VANOS_LL" MAP 0x4ef2a a_13 5 LINEAR_______23_625000__0H___139 -23.625 72.0
 /begin AXIS_DESCR COM_AXIS lm MAF_16_RES79 6 0.0 1389.0 AXIS_PTS_REF sstm_lm_1_28 MAX_GRAD 100 MONOTONY MON_INCREASE /end AXIS_DESCR
 /begin AXIS_DESCR COM_AXIS drehzahl IS_13_RES 6 0.0 8160.0 AXIS_PTS_REF sstm_n_1_28 MAX_GRAD 100 MONOTONY MON_INCREASE /end AXIS_DESCR
/end CHARACTERISTIC
/begin CHARACTERISTIC kf_zw_tkw1_vanos_tl__n__lm "KF_ZW_TKW1_VANOS_TL" MAP 0x4ef4e a_13 5 LINEAR_______23_625000__0H___126 -23.625 72.0
 /begin AXIS_DESCR COM_AXIS lm_zw MAF_16_RES49 16 0.0 1389.0 AXIS_PTS_REF sstm_lm_zw_kf_zw_tkw_vanos_tl MAX_GRAD 100 MONOTONY MON_INCREASE /end AXIS_DESCR
 /begin AXIS_DESCR COM_AXIS drehzahl IS_13_RES84 20 0.0 8160.0 AXIS_PTS_REF sstm_n_kf_zw_tkw_vanos_tl MAX_GRAD 100 MONOTONY MON_INCREASE /end AXIS_DESCR
/end CHARACTERISTIC
/begin CHARACTERISTIC kf_zw_tkw2_vanos_ll__n__lm "KF_ZW_TKW2_VANOS_LL" MAP 0x4f08e a_13 5 LINEAR_______23_625000__0H___139 -23.625 72.0
 /begin AXIS_DESCR COM_AXIS lm MAF_16_RES79 6 0.0 1389.0 AXIS_PTS_REF sstm_lm_1_28 MAX_GRAD 100 MONOTONY MON_INCREASE /end AXIS_DESCR
 /begin AXIS_DESCR COM_AXIS drehzahl IS_13_RES 6 0.0 8160.0 AXIS_PTS_REF sstm_n_1_28 MAX_GRAD 100 MONOTONY MON_INCREASE /end AXIS_DESCR
/end CHARACTERISTIC
/begin CHARACTERISTIC kf_zwb__n__lm "KF_ZWB" MAP 0x4f0b2 a_13 5 LINEAR_______23_625000__0H___126 -23.625 72.0
 /begin AXIS_DESCR COM_AXIS lm_zw MAF_16_RES49 12 0.0 1389.0 AXIS_PTS_REF sstm_lm_zw_12_1 MAX_GRAD 100 MONOTONY MON_INCREASE /end AXIS_DESCR
 /begin AXIS_DESCR COM_AXIS drehzahl IS_13_RES62 16 0.0 8160.0 AXIS_PTS_REF sstm_n_16_2 MAX_GRAD 100 MONOTONY MON_INCREASE /end AXIS_DESCR
/end CHARACTERISTIC
/begin CHARACTERISTIC kf_zwb_fr__tkw "KF_ZWB_FR" CURVE 0x4f172 a_3 5 LINEAR_______23_625000__0H___139 -23.625 72.0
 /begin AXIS_DESCR COM_AXIS tkw LINEAR_______48_000000__0H___114 4 -48.0 142.5 AXIS_PTS_REF sstm_tkw_2_6 MAX_GRAD 100 MONOTONY MON_INCREASE /end AXIS_DESCR
/end CHARACTERISTIC
/begin CHARACTERISTIC kf_zwb_ll__n__lm "KF_ZWB_LL" MAP 0x4f176 a_13 5 LINEAR_______23_625000__0H___139 -23.625 72.0
 /begin AXIS_DESCR COM_AXIS lm MAF_16_RES79 4 0.0 1389.0 AXIS_PTS_REF sst_lm_kf_zwb_ll MAX_GRAD 100 MONOTONY MON_INCREASE /end AXIS_DESCR
 /begin AXIS_DESCR COM_AXIS drehzahl IS_13_RES 4 0.0 8160.0 AXIS_PTS_REF sst_n_kf_zwb_ll MAX_GRAD 100 MONOTONY MON_INCREASE /end AXIS_DESCR
/end CHARACTERISTIC
/begin CHARACTERISTIC kf_zwb_s__n__tkw "KF_ZWB_S" MAP 0x4f186 a_2 10 LINEAR_______23_625000__0H___140 -23.625 72.0
 /begin AXIS_DESCR COM_AXIS tkw LINEAR_______48_000000__0H___133 4 -48.0 142.5 AXIS_PTS_REF sstm_tkw_5_4 MAX_GRAD 100 MONOTONY MON_INCREASE /end AXIS_DESCR
 /begin AXIS_DESCR COM_AXIS drehzahl IS_13_RES84 6 0.0 8160.0 AXIS_PTS_REF sstm_n_3_4 MAX_GRAD 100 MONOTONY MON_INCREASE /end AXIS_DESCR
/end CHARACTERISTIC
/begin CHARACTERISTIC kf_zwb_sa__n__tkw "KF_ZWB_SA" MAP 0x4f19e a_2 10 LINEAR_______23_625000__0H___140 -23.625 72.0
 /begin AXIS_DESCR COM_AXIS tkw LINEAR_______48_000000__0H___133 4 -48.0 142.5 AXIS_PTS_REF sstm_tkw_5_4 MAX_GRAD 100 MONOTONY MON_INCREASE /end AXIS_DESCR
 /begin AXIS_DESCR COM_AXIS drehzahl IS_13_RES84 6 0.0 8160.0 AXIS_PTS_REF sstm_n_3_4 MAX_GRAD 100 MONOTONY MON_INCREASE /end AXIS_DESCR
/end CHARACTERISTIC
/begin CHARACTERISTIC kf_zwb_sa_kk__n__tkw "KF_ZWB_SA_KK" MAP 0x4f1b6 a_2 10 LINEAR_______23_625000__0H___140 -23.625 72.0
 /begin AXIS_DESCR COM_AXIS tkw LINEAR_______48_000000__0H___133 4 -48.0 142.5 AXIS_PTS_REF sstm_tkw_5_4 MAX_GRAD 100 MONOTONY MON_INCREASE /end AXIS_DESCR
 /begin AXIS_DESCR COM_AXIS drehzahl IS_13_RES84 6 0.0 8160.0 AXIS_PTS_REF sstm_n_3_4 MAX_GRAD 100 MONOTONY MON_INCREASE /end AXIS_DESCR
/end CHARACTERISTIC
/begin CHARACTERISTIC tab_add_kr__n "TAB_ADD_KR" CURVE 0x4f89b a_141 10 LINEAR_______2_560000__FFFFFF80H -2.5599999 2.54
 /begin AXIS_DESCR COM_AXIS n_kr ES_8_RES8 16 0.0 8160.0 AXIS_PTS_REF sstm_n_2_9 MAX_GRAD 100 MONOTONY MON_INCREASE /end AXIS_DESCR
/end CHARACTERISTIC
/begin CHARACTERISTIC tab_anz_nw_ad__toel "TAB_ANZ_NW_AD" CURVE 0x4f1ce a_3 100 LINEAR______0_000000__0H___254_0 0.0 254.0
 /begin AXIS_DESCR COM_AXIS toel LINEAR_______48_000000__0H___156 6 -48.0 155.0 AXIS_PTS_REF sstm_toel_tab_totz_t_12 MAX_GRAD 100 MONOTONY MON_INCREASE /end AXIS_DESCR
/end CHARACTERISTIC
/begin CHARACTERISTIC tab_anz_per_ldp_dyf__t_per_ldp "TAB_ANZ_PER_LDP_DYF" CURVE 0x4f1d4 a_19 100 LINEAR______0_000000__0H___25142 0.0 255.0
 /begin AXIS_DESCR COM_AXIS t_per_ldp LINEAR______0_000000__0H___655_3 6 0.0 655.34998 AXIS_PTS_REF sstm_t_per_ldp MAX_GRAD 100 MONOTONY MON_INCREASE /end AXIS_DESCR
/end CHARACTERISTIC
/begin CHARACTERISTIC tab_auss_a_obd_kat__temp_ers_kat "TAB_AUSS_OBD_KAT" CURVE 0x4f1da a_19 100 LINEAR______0_000000__0H___2_143 0.0 2.0
 /begin AXIS_DESCR COM_AXIS temp_gmw_ers_kat LINEAR_______33_000000__0H___144 6 -33.0 990.0 AXIS_PTS_REF sst_temp_ers_kat_tab_auss_a_obd MAX_GRAD 100 MONOTONY MON_INCREASE /end AXIS_DESCR
/end CHARACTERISTIC
/begin CHARACTERISTIC tab_disa_tl__n_disa__lm "TAB_DISA_TL" MAP 0x4f1e0 a_13 10 LINEAR______0_000000__0H___1_145 0.0 1.0
 /begin AXIS_DESCR COM_AXIS lm MAF_16_RES146 6 0.0 1389.0 AXIS_PTS_REF sst_lm_tab_disa_tl MAX_GRAD 100 MONOTONY MON_INCREASE /end AXIS_DESCR
 /begin AXIS_DESCR COM_AXIS drehzahl IS_13_RES62 8 0.0 8160.0 AXIS_PTS_REF sstm_n_disa_1 MAX_GRAD 100 MONOTONY MON_INCREASE /end AXIS_DESCR
/end CHARACTERISTIC
/begin CHARACTERISTIC tab_disa_vl__n_disa "TAB_DISA_VL" CURVE 0x4f210 a_19 10 LINEAR______0_000000__0H___1_145 0.0 1.0
 /begin AXIS_DESCR COM_AXIS drehzahl IS_13_RES62 8 0.0 8160.0 AXIS_PTS_REF sstm_n_disa_1 MAX_GRAD 100 MONOTONY MON_INCREASE /end AXIS_DESCR
/end CHARACTERISTIC
/begin CHARACTERISTIC tab_dk_grd_inst_kr__n "TAB_DK_GRD_INST_KR" CURVE 0x4f218 a_3 10 LINEAR______0_000000__0H___2988_ 0.0 2988.0
 /begin AXIS_DESCR COM_AXIS drehzahl ES_8_RES8 4 0.0 8160.0 AXIS_PTS_REF sstm_n_4_4 MAX_GRAD 100 MONOTONY MON_INCREASE /end AXIS_DESCR
/end CHARACTERISTIC
/begin CHARACTERISTIC tab_dk_grd_zw_inst__n "TAB_DK_GRD_ZW_INST" CURVE 0x4f21c a_3 10 LINEAR______0_000000__0H___2988_ 0.0 2988.0
 /begin AXIS_DESCR COM_AXIS drehzahl ES_8_RES8 4 0.0 8160.0 AXIS_PTS_REF sstm_n_4_4 MAX_GRAD 100 MONOTONY MON_INCREASE /end AXIS_DESCR
/end CHARACTERISTIC
/begin CHARACTERISTIC tab_dk_vl__n "TAB_DK_VL" CURVE 0x4f220 a_19 10 LINEAR______0_000000__0H___11959 0.0 119.5
 /begin AXIS_DESCR COM_AXIS drehzahl IS_13_RES 16 0.0 8160.0 AXIS_PTS_REF sstm_n_4_7 MAX_GRAD 100 MONOTONY MON_INCREASE /end AXIS_DESCR
/end CHARACTERISTIC
/begin CHARACTERISTIC tab_dk_vl_disa__n_disa "TAB_DK_VL_DISA" CURVE 0x4f230 a_19 10 LINEAR______0_000000__0H___11959 0.0 119.5
 /begin AXIS_DESCR COM_AXIS drehzahl IS_13_RES 8 0.0 8160.0 AXIS_PTS_REF sst_n_disa_tab_dk_vl_disa MAX_GRAD 100 MONOTONY MON_INCREASE /end AXIS_DESCR
/end CHARACTERISTIC
/begin CHARACTERISTIC tab_dk_vl_vanos__n "TAB_DK_VL_VANOS" CURVE 0x4f238 a_19 10 LINEAR______0_000000__0H___11125 0.0 119.5
 /begin AXIS_DESCR COM_AXIS drehzahl IS_13_RES 16 0.0 8160.0 AXIS_PTS_REF sstm_n_4_7 MAX_GRAD 100 MONOTONY MON_INCREASE /end AXIS_DESCR
/end CHARACTERISTIC
/begin CHARACTERISTIC tab_fak_inst_zyka_kr__n "TAB_FAK_INST_ZYKA_KR" CURVE 0x4f248 a_3 10 LINEAR______0_000000__0H___25147 0.0 255.0
 /begin AXIS_DESCR COM_AXIS drehzahl ES_8_RES8 4 0.0 8160.0 AXIS_PTS_REF sstm_n_4_4 MAX_GRAD 100 MONOTONY MON_INCREASE /end AXIS_DESCR
/end CHARACTERISTIC
/begin CHARACTERISTIC tab_fak_ti_well__zyka "TAB_FAK_TI_WELL" CURVE 0x4f24c a_3 100 LINEAR______0_000000__0H___1_992 0.0 1.9922
 /begin AXIS_DESCR COM_AXIS dummy LINEAR______1_000000__1H___16_00 16 1.0 16.0 AXIS_PTS_REF sstm_zyka_16_1 MAX_GRAD 100 MONOTONY MON_INCREASE /end AXIS_DESCR
/end CHARACTERISTIC
/begin CHARACTERISTIC tab_fak_ti_wetl__zyka "TAB_FAK_TI_WETL" CURVE 0x4f25c a_3 100 LINEAR______0_000000__0H___1_992 0.0 1.9922
 /begin AXIS_DESCR COM_AXIS dummy LINEAR______1_000000__1H___16_00 16 1.0 16.0 AXIS_PTS_REF sstm_zyka_16_1 MAX_GRAD 100 MONOTONY MON_INCREASE /end AXIS_DESCR
/end CHARACTERISTIC
/begin CHARACTERISTIC tab_fs_nsoll_min_ub__ub_gmw "TAB_FS_NSOLL_MIN_UB" CURVE 0x4ca88 a_7 1 LINEAR______0_000000__0H___81692 0.0 8160.0
 /begin AXIS_DESCR COM_AXIS ubat_gmw LINEAR______0_000000__0H___26_82 2 0.0 26.0 AXIS_PTS_REF sstm_ub_gmw_1_6 MAX_GRAD 15 /end AXIS_DESCR
/end CHARACTERISTIC
/begin CHARACTERISTIC tab_gang__n_v_fgr "TAB_GANG" CURVE 0x4f26c a_19 100 LINEAR______0_000000__0H___5_148 0.0 5.0
 /begin AXIS_DESCR COM_AXIS n_v_fgr LINEAR______0_000000__0H___16320 6 0.0 16320.0 AXIS_PTS_REF sst_n_v_fgr_tab_gang MAX_GRAD 100 MONOTONY MON_INCREASE /end AXIS_DESCR
/end CHARACTERISTIC
/begin CHARACTERISTIC tab_krfb_0__n__lm "Zylinder 1" MAP 0x4f272 a_4 11 TAB_KRFB_X 0.375 95.625
 /begin AXIS_DESCR COM_AXIS lm_kr MAF_8_RES 4 0.0 1389.0 AXIS_PTS_REF sstm_lm_1_9 MAX_GRAD 100 MONOTONY MON_INCREASE /end AXIS_DESCR
 /begin AXIS_DESCR COM_AXIS n_kr ES_8_RES8 16 0.0 8160.0 AXIS_PTS_REF sstm_n_2_9 MAX_GRAD 100 MONOTONY MON_INCREASE /end AXIS_DESCR
/end CHARACTERISTIC
/begin CHARACTERISTIC tab_krfb_1__n__lm "Zylinder 5" MAP 0x4f2b2 a_4 11 TAB_KRFB_X 0.375 95.625
 /begin AXIS_DESCR COM_AXIS lm_kr MAF_8_RES 4 0.0 1389.0 AXIS_PTS_REF sstm_lm_1_9 MAX_GRAD 100 MONOTONY MON_INCREASE /end AXIS_DESCR
 /begin AXIS_DESCR COM_AXIS n_kr ES_8_RES8 16 0.0 8160.0 AXIS_PTS_REF sstm_n_2_9 MAX_GRAD 100 MONOTONY MON_INCREASE /end AXIS_DESCR
/end CHARACTERISTIC
/begin CHARACTERISTIC tab_krfb_2__n__lm "Zylinder 3" MAP 0x4f2f2 a_4 11 TAB_KRFB_X 0.375 95.625
 /begin AXIS_DESCR COM_AXIS lm_kr MAF_8_RES 4 0.0 1389.0 AXIS_PTS_REF sstm_lm_1_9 MAX_GRAD 100 MONOTONY MON_INCREASE /end AXIS_DESCR
 /begin AXIS_DESCR COM_AXIS n_kr ES_8_RES8 16 0.0 8160.0 AXIS_PTS_REF sstm_n_2_9 MAX_GRAD 100 MONOTONY MON_INCREASE /end AXIS_DESCR
/end CHARACTERISTIC
/begin CHARACTERISTIC tab_krfb_3__n__lm "Zylinder 6" MAP 0x4f332 a_4 11 TAB_KRFB_X 0.375 95.625
 /begin AXIS_DESCR COM_AXIS lm_kr MAF_8_RES 4 0.0 1389.0 AXIS_PTS_REF sstm_lm_1_9 MAX_GRAD 100 MONOTONY MON_INCREASE /end AXIS_DESCR
 /begin AXIS_DESCR COM_AXIS n_kr ES_8_RES8 16 0.0 8160.0 AXIS_PTS_REF sstm_n_2_9 MAX_GRAD 100 MONOTONY MON_INCREASE /end AXIS_DESCR
/end CHARACTERISTIC
/begin CHARACTERISTIC tab_krfb_4__n__lm "Zylinder 2" MAP 0x4f372 a_4 11 TAB_KRFB_X 0.375 95.625
 /begin AXIS_DESCR COM_AXIS lm_kr MAF_8_RES 4 0.0 1389.0 AXIS_PTS_REF sstm_lm_1_9 MAX_GRAD 100 MONOTONY MON_INCREASE /end AXIS_DESCR
 /begin AXIS_DESCR COM_AXIS n_kr ES_8_RES8 16 0.0 8160.0 AXIS_PTS_REF sstm_n_2_9 MAX_GRAD 100 MONOTONY MON_INCREASE /end AXIS_DESCR
/end CHARACTERISTIC
/begin CHARACTERISTIC tab_krfb_5__n__lm "Zylinder 4" MAP 0x4f3b2 a_4 11 TAB_KRFB_X 0.375 95.625
 /begin AXIS_DESCR COM_AXIS lm_kr MAF_8_RES 4 0.0 1389.0 AXIS_PTS_REF sstm_lm_1_9 MAX_GRAD 100 MONOTONY MON_INCREASE /end AXIS_DESCR
 /begin AXIS_DESCR COM_AXIS n_kr ES_8_RES8 16 0.0 8160.0 AXIS_PTS_REF sstm_n_2_9 MAX_GRAD 100 MONOTONY MON_INCREASE /end AXIS_DESCR
/end CHARACTERISTIC
/begin CHARACTERISTIC tab_krfe_0__n__lm "Zylinder 1" MAP 0x4f3f2 a_4 11 TAB_KRFE_X 12.0 107.625
 /begin AXIS_DESCR COM_AXIS lm_kr MAF_8_RES 4 0.0 1389.0 AXIS_PTS_REF sstm_lm_1_9 MAX_GRAD 100 MONOTONY MON_INCREASE /end AXIS_DESCR
 /begin AXIS_DESCR COM_AXIS n_kr ES_8_RES8 16 0.0 8160.0 AXIS_PTS_REF sstm_n_2_9 MAX_GRAD 100 MONOTONY MON_INCREASE /end AXIS_DESCR
/end CHARACTERISTIC
/begin CHARACTERISTIC tab_krfe_1__n__lm "Zylinder 5" MAP 0x4f432 a_4 11 TAB_KRFE_X 12.0 107.625
 /begin AXIS_DESCR COM_AXIS lm_kr MAF_8_RES 4 0.0 1389.0 AXIS_PTS_REF sstm_lm_1_9 MAX_GRAD 100 MONOTONY MON_INCREASE /end AXIS_DESCR
 /begin AXIS_DESCR COM_AXIS n_kr ES_8_RES8 16 0.0 8160.0 AXIS_PTS_REF sstm_n_2_9 MAX_GRAD 100 MONOTONY MON_INCREASE /end AXIS_DESCR
/end CHARACTERISTIC
/begin CHARACTERISTIC tab_krfe_2__n__lm "Zylinder 3" MAP 0x4f472 a_4 11 TAB_KRFE_X 12.0 107.625
 /begin AXIS_DESCR COM_AXIS lm_kr MAF_8_RES 4 0.0 1389.0 AXIS_PTS_REF sstm_lm_1_9 MAX_GRAD 100 MONOTONY MON_INCREASE /end AXIS_DESCR
 /begin AXIS_DESCR COM_AXIS n_kr ES_8_RES8 16 0.0 8160.0 AXIS_PTS_REF sstm_n_2_9 MAX_GRAD 100 MONOTONY MON_INCREASE /end AXIS_DESCR
/end CHARACTERISTIC
/begin CHARACTERISTIC tab_krfe_3__n__lm "Zylinder 6" MAP 0x4f4b2 a_4 11 TAB_KRFE_X 12.0 107.625
 /begin AXIS_DESCR COM_AXIS lm_kr MAF_8_RES 4 0.0 1389.0 AXIS_PTS_REF sstm_lm_1_9 MAX_GRAD 100 MONOTONY MON_INCREASE /end AXIS_DESCR
 /begin AXIS_DESCR COM_AXIS n_kr ES_8_RES8 16 0.0 8160.0 AXIS_PTS_REF sstm_n_2_9 MAX_GRAD 100 MONOTONY MON_INCREASE /end AXIS_DESCR
/end CHARACTERISTIC
/begin CHARACTERISTIC tab_krfe_4__n__lm "Zylinder 2" MAP 0x4f4f2 a_4 11 TAB_KRFE_X 12.0 107.625
 /begin AXIS_DESCR COM_AXIS lm_kr MAF_8_RES 4 0.0 1389.0 AXIS_PTS_REF sstm_lm_1_9 MAX_GRAD 100 MONOTONY MON_INCREASE /end AXIS_DESCR
 /begin AXIS_DESCR COM_AXIS n_kr ES_8_RES8 16 0.0 8160.0 AXIS_PTS_REF sstm_n_2_9 MAX_GRAD 100 MONOTONY MON_INCREASE /end AXIS_DESCR
/end CHARACTERISTIC
/begin CHARACTERISTIC tab_krfe_5__n__lm "Zylinder 4" MAP 0x4f532 a_4 11 TAB_KRFE_X 12.0 107.625
 /begin AXIS_DESCR COM_AXIS lm_kr MAF_8_RES 4 0.0 1389.0 AXIS_PTS_REF sstm_lm_1_9 MAX_GRAD 100 MONOTONY MON_INCREASE /end AXIS_DESCR
 /begin AXIS_DESCR COM_AXIS n_kr ES_8_RES8 16 0.0 8160.0 AXIS_PTS_REF sstm_n_2_9 MAX_GRAD 100 MONOTONY MON_INCREASE /end AXIS_DESCR
/end CHARACTERISTIC
/begin CHARACTERISTIC tab_krs_fak_schw__tal "TAB_KRS_FAK_SCHW" CURVE 0x4f572 a_3 100 LINEAR______0_000000__0H___1_149 0.0 1.9961
 /begin AXIS_DESCR COM_AXIS tal LINEAR_______48_000000__0H___121 6 -48.0 142.5 AXIS_PTS_REF sst_tal_tab_krs_fak_schw MAX_GRAD 100 MONOTONY MON_INCREASE /end AXIS_DESCR
/end CHARACTERISTIC
/begin CHARACTERISTIC tab_ksd_dec__toil_max "TAB_KSD_DEC" CURVE 0x4f578 a_3 100 LINEAR______0_000000__0H___25147 0.0 255.0
 /begin AXIS_DESCR COM_AXIS toil_max LINEAR_______48_000000__0H___150 4 -48.0 155.0 AXIS_PTS_REF sst_toil_max_tab_ksd_dec MAX_GRAD 100 MONOTONY MON_INCREASE /end AXIS_DESCR
/end CHARACTERISTIC
/begin CHARACTERISTIC tab_ksd_inc__tkw_st "TAB_KSD_INC" CURVE 0x4f57c a_3 100 LINEAR______0_000000__0H___25147 0.0 255.0
 /begin AXIS_DESCR COM_AXIS dummy LINEAR_______48_000000__0H___114 4 -48.0 142.5 AXIS_PTS_REF sst_tkw_st MAX_GRAD 100 MONOTONY MON_INCREASE /end AXIS_DESCR
/end CHARACTERISTIC
/begin CHARACTERISTIC tab_lam_tkw_min__tkw_st "TAB_LAM_TKW_MIN" CURVE 0x4f580 a_3 14 LINEAR_______48_000000__0H___114 -48.0 142.5
 /begin AXIS_DESCR COM_AXIS tkw_st LINEAR_______48_000000__0H___114 6 -48.0 142.5 AXIS_PTS_REF sstm_tkw_1_8 MAX_GRAD 100 MONOTONY MON_INCREASE /end AXIS_DESCR
/end CHARACTERISTIC
/begin CHARACTERISTIC tab_lam_tkw_min_ll__tkw_st "TAB_LAM_TKW_MIN_LL" CURVE 0x4f586 a_3 14 LINEAR_______48_000000__0H___114 -48.0 142.5
 /begin AXIS_DESCR COM_AXIS tkw_st LINEAR_______48_000000__0H___114 6 -48.0 142.5 AXIS_PTS_REF sstm_tkw_1_8 MAX_GRAD 100 MONOTONY MON_INCREASE /end AXIS_DESCR
/end CHARACTERISTIC
/begin CHARACTERISTIC tab_lm_min_kr_ad__n "TAB_LM_MIN_KR_AD" CURVE 0x4f58c a_3 7 MAF_8_RES 0.0 1389.0
 /begin AXIS_DESCR COM_AXIS n_kr ES_8_RES8 16 0.0 8160.0 AXIS_PTS_REF sstm_n_2_9 MAX_GRAD 100 MONOTONY MON_INCREASE /end AXIS_DESCR
/end CHARACTERISTIC
/begin CHARACTERISTIC tab_lm_min_kr_ad_2__n "TAB_LM_MIN_KR_AD_2" CURVE 0x4f59c a_3 7 MAF_8_RES 0.0 1389.0
 /begin AXIS_DESCR COM_AXIS n_kr ES_8_RES8 16 0.0 8160.0 AXIS_PTS_REF sstm_n_2_9 MAX_GRAD 100 MONOTONY MON_INCREASE /end AXIS_DESCR
/end CHARACTERISTIC
/begin CHARACTERISTIC tab_mitko_dec_kat__lm_kg_h "TAB_MITKO_DEC_KAT" CURVE 0x4ca8c a_9 100 LINEAR______0_000000__0H___0_151 0.0 0.99998474
 /begin AXIS_DESCR COM_AXIS lm_kg_h MAF_KGH_16_RES15 8 0.0 16383.75 AXIS_PTS_REF sstm_lm_kg_h_2_22 MAX_GRAD 100 MONOTONY MON_INCREASE /end AXIS_DESCR
/end CHARACTERISTIC
/begin CHARACTERISTIC tab_mitko_dec_kat_el__lm_kg_h "TAB_MITKO_DEC_KAT_EL" CURVE 0x4ca9c a_9 100 LINEAR______0_000000__0H___0_151 0.0 0.99998474
 /begin AXIS_DESCR COM_AXIS lm_kg_h MAF_KGH_16_RES15 8 0.0 16383.75 AXIS_PTS_REF sstm_lm_kg_h_2_22 MAX_GRAD 100 MONOTONY MON_INCREASE /end AXIS_DESCR
/end CHARACTERISTIC
/begin CHARACTERISTIC tab_mitko_inc_kat__lm_kg_h "TAB_MITKO_INC_KAT" CURVE 0x4caac a_9 100 LINEAR______0_000000__0H___0_151 0.0 0.99998474
 /begin AXIS_DESCR COM_AXIS lm_kg_h MAF_KGH_16_RES15 8 0.0 16383.75 AXIS_PTS_REF sstm_lm_kg_h_2_22 MAX_GRAD 100 MONOTONY MON_INCREASE /end AXIS_DESCR
/end CHARACTERISTIC
/begin CHARACTERISTIC tab_mitko_inc_kat_el__lm_kg_h "TAB_MITKO_INC_KAT_EL" CURVE 0x4cabc a_9 100 LINEAR______0_000000__0H___0_151 0.0 0.99998474
 /begin AXIS_DESCR COM_AXIS lm_kg_h MAF_KGH_16_RES15 8 0.0 16383.75 AXIS_PTS_REF sstm_lm_kg_h_2_22 MAX_GRAD 100 MONOTONY MON_INCREASE /end AXIS_DESCR
/end CHARACTERISTIC
/begin CHARACTERISTIC tab_mitko_lm_diag__n "TAB_MITKO_LM_DIAG" CURVE 0x4f5ac a_3 100 LINEAR______0_000000__0H___0_152 0.0 0.99610001
 /begin AXIS_DESCR COM_AXIS n_32 ES_8_RES 4 0.0 8160.0 AXIS_PTS_REF sst_n_tab_mitko_lm_diag MAX_GRAD 100 MONOTONY MON_INCREASE /end AXIS_DESCR
/end CHARACTERISTIC
/begin CHARACTERISTIC tab_n_el_min_kk__n_el "TAB_N_EL_MIN_KK" CURVE 0x4f5b0 a_3 100 LINEAR______0_000000__0H___15_94 0.0 15.94
 /begin AXIS_DESCR COM_AXIS dummy LINEAR______0_000000__0H___15_00 16 0.0 15.0 AXIS_PTS_REF sst_n_el_tab_n_el_min_kk MAX_GRAD 100 MONOTONY MON_INCREASE /end AXIS_DESCR
/end CHARACTERISTIC
/begin CHARACTERISTIC tab_ngrd_max_kr__n "TAB_NGRD_MAX_KR" CURVE 0x4f5c0 a_3 5 LINEAR______0_000000__0H___4064_ 0.0 4064.0
 /begin AXIS_DESCR COM_AXIS n_kr ES_8_RES8 16 0.0 8160.0 AXIS_PTS_REF sstm_n_2_9 MAX_GRAD 100 MONOTONY MON_INCREASE /end AXIS_DESCR
/end CHARACTERISTIC
/begin CHARACTERISTIC tab_nmax_aebg__gang "TAB_NMAX_AEBG" CURVE 0x4cacc a_7 100 LINEAR______0_12500000__1H___816 0.125 8160.0
 /begin AXIS_DESCR COM_AXIS gang LINEAR______0_000000__0H___7_000 6 0.0 7.0 AXIS_PTS_REF sstm_gang_6_1 MAX_GRAD 100 MONOTONY MON_INCREASE /end AXIS_DESCR
/end CHARACTERISTIC
/begin CHARACTERISTIC tab_nmax_aebg_at__gang "TAB_NMAX_AEBG_AT" CURVE 0x4cad8 a_7 100 LINEAR______0_12500000__1H___816 0.125 8160.0
 /begin AXIS_DESCR COM_AXIS gang LINEAR______0_000000__0H___7_000 6 0.0 7.0 AXIS_PTS_REF sstm_gang_6_1 MAX_GRAD 100 MONOTONY MON_INCREASE /end AXIS_DESCR
/end CHARACTERISTIC
/begin CHARACTERISTIC tab_nmax_at__ntv "TAB_NMAX_AT" CURVE 0x4f5d0 a_19 10 ES_8_RES41 0.0 8160.0
 /begin AXIS_DESCR COM_AXIS n_v_fgr LINEAR______0_000000__0H___16153 3 0.0 16320.0 AXIS_PTS_REF sstm_ntv_at_1_3 MAX_GRAD 100 /end AXIS_DESCR
/end CHARACTERISTIC
/begin CHARACTERISTIC tab_nmax_diag_gang_at__gang "TAB_NMAX_DIAG_GANG_AT" CURVE 0x4f5d3 a_3 10 ES_8_RES41 0.0 8160.0
 /begin AXIS_DESCR COM_AXIS gang LINEAR______0_000000__0H___7_000 6 0.0 7.0 AXIS_PTS_REF sstm_gang_6_1 MAX_GRAD 100 MONOTONY MON_INCREASE /end AXIS_DESCR
/end CHARACTERISTIC
/begin CHARACTERISTIC tab_nmax_diag_gang_mt__gang "TAB_NMAX_DIAG_GANG_MT" CURVE 0x4f5d9 a_3 10 ES_8_RES41 0.0 8160.0
 /begin AXIS_DESCR COM_AXIS gang LINEAR______0_000000__0H___7_000 6 0.0 7.0 AXIS_PTS_REF sstm_gang_6_1 MAX_GRAD 100 MONOTONY MON_INCREASE /end AXIS_DESCR
/end CHARACTERISTIC
/begin CHARACTERISTIC tab_nmax_max_at__ntv "TAB_NMAX_MAX_AT" CURVE 0x4f5df a_19 10 ES_8_RES41 0.0 8160.0
 /begin AXIS_DESCR COM_AXIS n_v_fgr LINEAR______0_000000__0H___16153 3 0.0 16320.0 AXIS_PTS_REF sstm_ntv_at_1_3 MAX_GRAD 100 /end AXIS_DESCR
/end CHARACTERISTIC
/begin CHARACTERISTIC tab_nmax_max_mt__ntv "TAB_NMAX_MAX_MT" CURVE 0x4f5e2 a_19 10 ES_8_RES41 0.0 8160.0
 /begin AXIS_DESCR COM_AXIS n_v_fgr LINEAR______0_000000__0H___16153 3 0.0 16320.0 AXIS_PTS_REF sstm_ntv_mt_1_3 MAX_GRAD 100 /end AXIS_DESCR
/end CHARACTERISTIC
/begin CHARACTERISTIC tab_nmax_mt__ntv "TAB_NMAX_MT" CURVE 0x4f5e5 a_19 10 ES_8_RES41 0.0 8160.0
 /begin AXIS_DESCR COM_AXIS n_v_fgr LINEAR______0_000000__0H___16153 3 0.0 16320.0 AXIS_PTS_REF sstm_ntv_mt_1_3 MAX_GRAD 100 /end AXIS_DESCR
/end CHARACTERISTIC
/begin CHARACTERISTIC tab_nmax_zyka__tv "TAB_NMAX_ZYKA__TV" CURVE 0x4f5e8 a_3 4 LINEAR______1_000000__1H___25154 1.0 255.0
 /begin AXIS_DESCR COM_AXIS geschwind LINEAR______0_000000__0H___25147 5 0.0 255.0 AXIS_PTS_REF sst_tv_tab_nmax_zyka MAX_GRAD 100 MONOTONY MON_INCREASE /end AXIS_DESCR
/end CHARACTERISTIC
/begin CHARACTERISTIC tab_nmax_zyka_diag__n "TAB_NMAX_ZYKA_DIAG" CURVE 0x4f5ed a_3 100 LINEAR______1_000000__1H___255_0 1.0 255.0
 /begin AXIS_DESCR COM_AXIS n_32 ES_8_RES41 4 0.0 8160.0 AXIS_PTS_REF sst_n_tab_nmax_zyka_diag MAX_GRAD 100 MONOTONY MON_INCREASE /end AXIS_DESCR
/end CHARACTERISTIC
/begin CHARACTERISTIC tab_nsoll_min_ub__ub_gmw "TAB_NSOLL_MIN_UB" CURVE 0x4cae4 a_7 1 LINEAR______0_000000__0H___81692 0.0 8160.0
 /begin AXIS_DESCR COM_AXIS ubat_gmw LINEAR______0_000000__0H___26_82 2 0.0 26.0 AXIS_PTS_REF sstm_ub_gmw_1_6 MAX_GRAD 15 /end AXIS_DESCR
/end CHARACTERISTIC
/begin CHARACTERISTIC tab_o2_int_max_at__n__lm "TAB_O2_INT_MAX_AT" MAP 0x4f5f1 a_4 100 LINEAR______0_000000__0H___1_155 0.0 1.9961
 /begin AXIS_DESCR COM_AXIS lm MAF_8_RES40 6 0.0 1389.0 AXIS_PTS_REF sst_lm_tab_o2_int_max_at MAX_GRAD 100 MONOTONY MON_INCREASE /end AXIS_DESCR
 /begin AXIS_DESCR COM_AXIS n_32 ES_8_RES41 6 0.0 8160.0 AXIS_PTS_REF sst_n_tab_o2_int_max_at MAX_GRAD 100 MONOTONY MON_INCREASE /end AXIS_DESCR
/end CHARACTERISTIC
/begin CHARACTERISTIC tab_o2_int_max_mt__n__lm "TAB_O2_INT_MAX_MT" MAP 0x4f615 a_4 100 LINEAR______0_000000__0H___1_155 0.0 1.9961
 /begin AXIS_DESCR COM_AXIS lm MAF_8_RES40 6 0.0 1389.0 AXIS_PTS_REF sst_lm_tab_o2_int_max_mt MAX_GRAD 100 MONOTONY MON_INCREASE /end AXIS_DESCR
 /begin AXIS_DESCR COM_AXIS n_32 ES_8_RES41 6 0.0 8160.0 AXIS_PTS_REF sst_n_tab_o2_int_max_mt MAX_GRAD 100 MONOTONY MON_INCREASE /end AXIS_DESCR
/end CHARACTERISTIC
/begin CHARACTERISTIC tab_p_grd_inst_kr__n "TAB_P_GRD_INST_KR" CURVE 0x4f8b8 a_156 100 LINEAR_______5434_259766__FFFF80 -5434.2598 5434.1768
 /begin AXIS_DESCR COM_AXIS drehzahl ES_8_RES8 4 0.0 8160.0 AXIS_PTS_REF sstm_n_4_4 MAX_GRAD 100 MONOTONY MON_INCREASE /end AXIS_DESCR
/end CHARACTERISTIC
/begin CHARACTERISTIC tab_p_grd_zw_inst__n "TAB_P_GRD_ZW_INST" CURVE 0x4f8c0 a_156 100 LINEAR_______5434_259766__FFFF80 -5434.2598 5434.1768
 /begin AXIS_DESCR COM_AXIS drehzahl ES_8_RES8 4 0.0 8160.0 AXIS_PTS_REF sstm_n_4_4 MAX_GRAD 100 MONOTONY MON_INCREASE /end AXIS_DESCR
/end CHARACTERISTIC
/begin CHARACTERISTIC tab_patt_za__nr_patt "TAB_PATT_ZA" CURVE 0x4cae8 a_7 100 LINEAR______0_000000__0H___8191_ 0.0 8191.0
 /begin AXIS_DESCR COM_AXIS dummy LINEAR______0_000000__0H___13_00 14 0.0 13.0 AXIS_PTS_REF sst_nr_patt_tab_patt_za MAX_GRAD 100 MONOTONY MON_INCREASE /end AXIS_DESCR
/end CHARACTERISTIC
/begin CHARACTERISTIC tab_t_kat_ti__tkw_st "TAB_T_KAT_TI" CURVE 0x4cb04 a_7 10 LINEAR______0_000000__0H___65130 0.0 6553.5
 /begin AXIS_DESCR COM_AXIS tkw_st LINEAR_______48_000000__0H___121 8 -48.0 142.5 AXIS_PTS_REF sstm_tkw_st_8_1 MAX_GRAD 100 MONOTONY MON_INCREASE /end AXIS_DESCR
/end CHARACTERISTIC
/begin CHARACTERISTIC tab_t_kat_ti_katv__tkw_st "TAB_T_KAT_TI_KATV" CURVE 0x4cb14 a_7 10 LINEAR______0_000000__0H___65130 0.0 6553.5
 /begin AXIS_DESCR COM_AXIS tkw_st LINEAR_______48_000000__0H___121 8 -48.0 142.5 AXIS_PTS_REF sstm_tkw_st_8_1 MAX_GRAD 100 MONOTONY MON_INCREASE /end AXIS_DESCR
/end CHARACTERISTIC
/begin CHARACTERISTIC tab_t_kat_zw__tkw_st "TAB_T_KAT_ZW" CURVE 0x4cb24 a_7 10 LINEAR______0_000000__0H___65130 0.0 6553.5
 /begin AXIS_DESCR COM_AXIS tkw_st LINEAR_______48_000000__0H___142 8 -48.0 142.5 AXIS_PTS_REF sstm_tkw_st_2_1 MAX_GRAD 100 MONOTONY MON_INCREASE /end AXIS_DESCR
/end CHARACTERISTIC
/begin CHARACTERISTIC tab_t_kat_zw_katv__tkw_st "TAB_T_KAT_ZW_KATV" CURVE 0x4cb34 a_7 10 LINEAR______0_000000__0H___65130 0.0 6553.5
 /begin AXIS_DESCR COM_AXIS tkw_st LINEAR_______48_000000__0H___142 8 -48.0 142.5 AXIS_PTS_REF sstm_tkw_st_2_1 MAX_GRAD 100 MONOTONY MON_INCREASE /end AXIS_DESCR
/end CHARACTERISTIC
/begin CHARACTERISTIC tab_t_kat2__tkw_st "TAB_T_KAT2" CURVE 0x4cb44 a_7 10 LINEAR______0_000000__0H___6553_ 0.0 6553.5
 /begin AXIS_DESCR COM_AXIS tkw_st LINEAR_______48_000000__0H___142 8 -48.0 142.5 AXIS_PTS_REF sstm_tkw_st_2_1 MAX_GRAD 100 MONOTONY MON_INCREASE /end AXIS_DESCR
/end CHARACTERISTIC
/begin CHARACTERISTIC tab_t_kat2_katv__tkw_st "TAB_T_KAT2_KATV" CURVE 0x4cb54 a_7 10 LINEAR______0_000000__0H___6553_ 0.0 6553.5
 /begin AXIS_DESCR COM_AXIS tkw_st LINEAR_______48_000000__0H___142 8 -48.0 142.5 AXIS_PTS_REF sstm_tkw_st_2_1 MAX_GRAD 100 MONOTONY MON_INCREASE /end AXIS_DESCR
/end CHARACTERISTIC
/begin CHARACTERISTIC tab_t_kh2_nsoll__tkw_st "TAB_T_KH2_NSOLL" CURVE 0x4cb64 a_7 10 LINEAR______0_000000__0H___6553_ 0.0 6553.5
 /begin AXIS_DESCR COM_AXIS tkw_st LINEAR_______48_000000__0H___142 8 -48.0 142.5 AXIS_PTS_REF sstm_tkw_st_2_1 MAX_GRAD 100 MONOTONY MON_INCREASE /end AXIS_DESCR
/end CHARACTERISTIC
/begin CHARACTERISTIC tab_t_max_ar_at__gang "TAB_T_MAX_AR_AT" CURVE 0x4f639 a_3 100 LINEAR______10_000000__1H___2550 10.0 2550.0
 /begin AXIS_DESCR COM_AXIS gang LINEAR______0_000000__0H___7_000 6 0.0 7.0 AXIS_PTS_REF sstm_gang_6_1 MAX_GRAD 100 MONOTONY MON_INCREASE /end AXIS_DESCR
/end CHARACTERISTIC
/begin CHARACTERISTIC tab_t_max_ar_mt__gang "TAB_T_MAX_AR_MT" CURVE 0x4f63f a_3 100 LINEAR______10_000000__1H___2550 10.0 2550.0
 /begin AXIS_DESCR COM_AXIS gang LINEAR______0_000000__0H___7_000 6 0.0 7.0 AXIS_PTS_REF sstm_gang_6_1 MAX_GRAD 100 MONOTONY MON_INCREASE /end AXIS_DESCR
/end CHARACTERISTIC
/begin CHARACTERISTIC tab_t_per_ldp_dyf__t_per_ldp "TAB_T_PER_LDP_DYF" CURVE 0x4cb74 a_9 100 LINEAR______0_000000__0H___655_3 0.0 655.34998
 /begin AXIS_DESCR COM_AXIS t_per_ldp LINEAR______0_000000__0H___655_3 6 0.0 655.34998 AXIS_PTS_REF sstm_t_per_ldp MAX_GRAD 100 MONOTONY MON_INCREASE /end AXIS_DESCR
/end CHARACTERISTIC
/begin CHARACTERISTIC tab_t_sa_verz_tkw__tkw "TAB_T_SA_VERZ_TKW" CURVE 0x4cb80 a_7 100 LINEAR______0_000000__0H___8_388 0.0 8.38848
 /begin AXIS_DESCR COM_AXIS tkw LINEAR_______48_000000__0H___142 4 -48.0 142.5 AXIS_PTS_REF sst_tkw_tab_t_sa_verz_tkw__tkw MAX_GRAD 100 MONOTONY MON_INCREASE /end AXIS_DESCR
/end CHARACTERISTIC
/begin CHARACTERISTIC tab_t_slow_s_llfs__n "TAB_T_SLOW_S_LLFS" CURVE 0x4f645 a_3 100 LINEAR______0_100000__1H___25_50 0.1 25.5
 /begin AXIS_DESCR COM_AXIS n_32 ES_8_RES116 6 0.0 8160.0 AXIS_PTS_REF sstm_n_slow_s MAX_GRAD 100 MONOTONY MON_INCREASE /end AXIS_DESCR
/end CHARACTERISTIC
/begin CHARACTERISTIC tab_t_slow_s_zw__n "TAB_T_SLOW_S_ZW" CURVE 0x4f64b a_3 100 LINEAR______0_100000__1H___25157 0.1 25.5
 /begin AXIS_DESCR COM_AXIS n_32 ES_8_RES116 6 0.0 8160.0 AXIS_PTS_REF sstm_n_slow_s MAX_GRAD 100 MONOTONY MON_INCREASE /end AXIS_DESCR
/end CHARACTERISTIC
/begin CHARACTERISTIC tab_t_slp_aus__tkw_st "TAB_T_SLP_AUS" CURVE 0x4cb88 a_7 10 LINEAR______0_100000__1H___6553_ 0.1 6553.5
 /begin AXIS_DESCR COM_AXIS tkw_st LINEAR_______48_000000__0H___121 8 -48.0 142.5 AXIS_PTS_REF sstm_tkw_st_8_2 MAX_GRAD 100 MONOTONY MON_INCREASE /end AXIS_DESCR
/end CHARACTERISTIC
/begin CHARACTERISTIC tab_t_slp_ein__tkw_st "TAB_T_SLP_EIN" CURVE 0x4cb98 a_7 10 LINEAR______0_100000__1H___6553_ 0.1 6553.5
 /begin AXIS_DESCR COM_AXIS tkw LINEAR_______48_000000__0H___121 8 -48.0 142.5 AXIS_PTS_REF sst_tkw_t_slp_ein MAX_GRAD 100 MONOTONY MON_INCREASE /end AXIS_DESCR
/end CHARACTERISTIC
/begin CHARACTERISTIC tab_t_slp_max_diag__tkw_st "TAB_T_SLP_MAX_DIAG" CURVE 0x4cba8 a_7 10 LINEAR______0_100000__1H___6553_ 0.1 6553.5
 /begin AXIS_DESCR COM_AXIS tkw_st LINEAR_______48_000000__0H___121 8 -48.0 142.5 AXIS_PTS_REF sstm_tkw_st_8_2 MAX_GRAD 100 MONOTONY MON_INCREASE /end AXIS_DESCR
/end CHARACTERISTIC
/begin CHARACTERISTIC tab_t_slv_aus__tkw_st "TAB_T_SLV_AUS" CURVE 0x4cbb8 a_7 10 LINEAR______0_100000__1H___6553_ 0.1 6553.5
 /begin AXIS_DESCR COM_AXIS tkw_st LINEAR_______48_000000__0H___121 8 -48.0 142.5 AXIS_PTS_REF sstm_tkw_st_8_2 MAX_GRAD 100 MONOTONY MON_INCREASE /end AXIS_DESCR
/end CHARACTERISTIC
/begin CHARACTERISTIC tab_t_slv_ein__tkw_st "TAB_T_SLV_EIN" CURVE 0x4cbc8 a_7 10 LINEAR______0_100000__1H___6553_ 0.1 6553.5
 /begin AXIS_DESCR COM_AXIS tkw LINEAR_______48_000000__0H___142 8 -48.0 142.5 AXIS_PTS_REF sst_tkw_t_slv_ein MAX_GRAD 100 MONOTONY MON_INCREASE /end AXIS_DESCR
/end CHARACTERISTIC
/begin CHARACTERISTIC tab_t_slv_max_diag__tkw_st "TAB_T_SLV_MAX_DIAG" CURVE 0x4cbd8 a_7 10 LINEAR______0_100000__1H___6553_ 0.1 6553.5
 /begin AXIS_DESCR COM_AXIS tkw_st LINEAR_______48_000000__0H___121 8 -48.0 142.5 AXIS_PTS_REF sstm_tkw_st_8_2 MAX_GRAD 100 MONOTONY MON_INCREASE /end AXIS_DESCR
/end CHARACTERISTIC
/begin CHARACTERISTIC tab_t_tkw_min__tkw_st "TAB_T_TKW_MIN" CURVE 0x4f651 a_3 100 LINEAR______10_000000__1H___2158 10.0 2550.0
 /begin AXIS_DESCR COM_AXIS tkw_st LINEAR_______48_000000__0H___114 6 -48.0 142.5 AXIS_PTS_REF sstm_tkw_1_8 MAX_GRAD 100 MONOTONY MON_INCREASE /end AXIS_DESCR
/end CHARACTERISTIC
/begin CHARACTERISTIC tab_t_totz_zw_ar_at__gang "TAB_T_TOTZ_ZW_AR_AT" CURVE 0x4f657 a_3 100 LINEAR______10_000000__1H___2550 10.0 2550.0
 /begin AXIS_DESCR COM_AXIS gang LINEAR______0_000000__0H___7_000 6 0.0 7.0 AXIS_PTS_REF sstm_gang_6_1 MAX_GRAD 100 MONOTONY MON_INCREASE /end AXIS_DESCR
/end CHARACTERISTIC
/begin CHARACTERISTIC tab_t_totz_zw_ar_mt__gang "TAB_T_TOTZ_ZW_AR_MT" CURVE 0x4f65d a_3 100 LINEAR______10_000000__1H___2550 10.0 2550.0
 /begin AXIS_DESCR COM_AXIS gang LINEAR______0_000000__0H___7_000 6 0.0 7.0 AXIS_PTS_REF sstm_gang_6_1 MAX_GRAD 100 MONOTONY MON_INCREASE /end AXIS_DESCR
/end CHARACTERISTIC
/begin CHARACTERISTIC tab_t_wait_diag_sl__tkw "TAB_T_WAIT_DIAG_SL" CURVE 0x4cbe8 a_7 10 LINEAR______0_020000__1H___1310_ 0.02 1310.0
 /begin AXIS_DESCR COM_AXIS tkw LINEAR_______48_000000__0H___114 8 -48.0 142.5 AXIS_PTS_REF sst_tkw_tab_t_wait_diag_sl MAX_GRAD 100 MONOTONY MON_INCREASE /end AXIS_DESCR
/end CHARACTERISTIC
/begin CHARACTERISTIC tab_t_zsr_min__n__lm "TAB_T_ZSR_MIN" MAP 0x4cbf8 a_1 5 ZSR_BAS_16_RES 0.0 262.14
 /begin AXIS_DESCR COM_AXIS lm MAF_8_RES 6 0.0 1389.0 AXIS_PTS_REF sst_lm_tab_t_zsr_min MAX_GRAD 100 MONOTONY MON_INCREASE /end AXIS_DESCR
 /begin AXIS_DESCR COM_AXIS drehzahl ES_8_RES8 8 0.0 8160.0 AXIS_PTS_REF sst_n_tab_t_zsr_min MAX_GRAD 100 MONOTONY MON_INCREASE /end AXIS_DESCR
/end CHARACTERISTIC
/begin CHARACTERISTIC tab_t_zw_inc_ar_at__gang "TAB_T_ZW_INC_AR_AT" CURVE 0x4f663 a_3 100 LINEAR______0_000000__0H___2097_ 0.0 2097.12
 /begin AXIS_DESCR COM_AXIS gang LINEAR______0_000000__0H___7_000 6 0.0 7.0 AXIS_PTS_REF sstm_gang_6_1 MAX_GRAD 100 MONOTONY MON_INCREASE /end AXIS_DESCR
/end CHARACTERISTIC
/begin CHARACTERISTIC tab_t_zw_inc_ar_mt__gang "TAB_T_ZW_INC_AR_MT" CURVE 0x4f669 a_3 100 LINEAR______0_000000__0H___2097_ 0.0 2097.12
 /begin AXIS_DESCR COM_AXIS gang LINEAR______0_000000__0H___7_000 6 0.0 7.0 AXIS_PTS_REF sstm_gang_6_1 MAX_GRAD 100 MONOTONY MON_INCREASE /end AXIS_DESCR
/end CHARACTERISTIC
/begin CHARACTERISTIC tab_tael_kl15_aus__temp_kat "TAB_TAEL_KL15_AUS" CURVE 0x4f66f a_3 100 LINEAR______0_000000__0H___99159 0.0 99.610001
 /begin AXIS_DESCR COM_AXIS temp_gmw_ers_kat LINEAR_______33_000000__0H___990 6 -33.0 990.0 AXIS_PTS_REF sstm_temp_kat_6_1 MAX_GRAD 100 MONOTONY MON_INCREASE /end AXIS_DESCR
/end CHARACTERISTIC
/begin CHARACTERISTIC tab_tah_ad_van_a_sam__tmag "TAB_TAH_AD_VANOS_A" CURVE 0x51186 a_3 100 LINEAR_______50_000000__0H___160 -50.0 49.599998
 /begin AXIS_DESCR COM_AXIS tab_tmag LINEAR_______48_000000__0H___155 6 -48.0 155.0 AXIS_PTS_REF sstm_tmag_9_7 MAX_GRAD 100 MONOTONY MON_INCREASE /end AXIS_DESCR
/end CHARACTERISTIC
/begin CHARACTERISTIC tab_tah_ad_van_e_sam__tmag "TAB_TAH_AD_VANOS_E" CURVE 0x51180 a_3 100 LINEAR_______50_000000__0H___160 -50.0 49.599998
 /begin AXIS_DESCR COM_AXIS tab_tmag LINEAR_______48_000000__0H___155 6 -48.0 155.0 AXIS_PTS_REF sstm_tmag_9_7 MAX_GRAD 100 MONOTONY MON_INCREASE /end AXIS_DESCR
/end CHARACTERISTIC
/begin CHARACTERISTIC tab_tah_kor_ad_van__v_drift "TAB_TAH_KOR_AD_VAN" CURVE 0x4f675 a_3 100 LINEAR______0_000000__0H___49_59 0.0 49.599998
 /begin AXIS_DESCR COM_AXIS dummy LINEAR______0_000000__0H___95161 6 0.0 95.625 AXIS_PTS_REF sst_v_drift_tah_kor_ad_van MAX_GRAD 100 MONOTONY MON_INCREASE /end AXIS_DESCR
/end CHARACTERISTIC
/begin CHARACTERISTIC tab_takfk_add__n__tkw_soll "TAB_TAKFK_ADD" MAP 0x4f67b a_4 100 LINEAR______0_000000__0H___99162 0.0 99.599998
 /begin AXIS_DESCR COM_AXIS dummy LINEAR_______48_000000__0H___133 8 -48.0 142.5 AXIS_PTS_REF sst_tkw_soll_tab_takfk_add MAX_GRAD 100 MONOTONY MON_INCREASE /end AXIS_DESCR
 /begin AXIS_DESCR COM_AXIS drehzahl ES_8_RES8 8 0.0 8160.0 AXIS_PTS_REF sst_n_tab_takfk_add MAX_GRAD 100 MONOTONY MON_INCREASE /end AXIS_DESCR
/end CHARACTERISTIC
/begin CHARACTERISTIC tab_tallfs_slow_s__n "TAB_TALLFS_SLOW_S" CURVE 0x4cc58 a_7 15 TALLFS 0.0 399.9938
 /begin AXIS_DESCR COM_AXIS n_32 ES_8_RES116 6 0.0 8160.0 AXIS_PTS_REF sstm_n_slow_s MAX_GRAD 100 MONOTONY MON_INCREASE /end AXIS_DESCR
/end CHARACTERISTIC
/begin CHARACTERISTIC tab_talsh_ini_vkat__tal__tkw "TAB_TALSH_INI_VKAT" MAP 0x4f6bb a_4 100 LINEAR______0_000000__0H___99_61 0.0 99.610001
 /begin AXIS_DESCR COM_AXIS tkw LINEAR_______48_000000__0H___142 4 -48.0 142.5 AXIS_PTS_REF sstm_tkw_lsh MAX_GRAD 100 MONOTONY MON_INCREASE /end AXIS_DESCR
 /begin AXIS_DESCR COM_AXIS tal LINEAR_______48_000000__0H___142 4 -48.0 142.5 AXIS_PTS_REF sstm_tal_lsh MAX_GRAD 100 MONOTONY MON_INCREASE /end AXIS_DESCR
/end CHARACTERISTIC
/begin CHARACTERISTIC tab_talsh_nkat__n__lm "TAB_TALSH_NKAT" MAP 0x4f6cb a_4 100 LINEAR______0_000000__0H___99_61 0.0 99.610001
 /begin AXIS_DESCR COM_AXIS lm MAF_8_RES37 6 0.0 1389.0 AXIS_PTS_REF sstm_lm_tab_talsh_xkaty MAX_GRAD 100 MONOTONY MON_INCREASE /end AXIS_DESCR
 /begin AXIS_DESCR COM_AXIS n_32 ES_8_RES 8 0.0 8160.0 AXIS_PTS_REF sstm_n_tab_talsh_xkaty MAX_GRAD 100 MONOTONY MON_INCREASE /end AXIS_DESCR
/end CHARACTERISTIC
/begin CHARACTERISTIC tab_talsh_t_dec_vkat__lm_kgh "TAB_TALSH_T_DEC_VKAT" CURVE 0x4cc64 a_9 100 LINEAR______0_000000__0H___65163 0.0 65535.0
 /begin AXIS_DESCR COM_AXIS lm_kg_h MAF_KGH_16_RES117 6 0.0 16383.75 AXIS_PTS_REF sstm_lm_kgh_lsh_t MAX_GRAD 100 MONOTONY MON_INCREASE /end AXIS_DESCR
/end CHARACTERISTIC
/begin CHARACTERISTIC tab_talsh_t_ini_vkat__tal__tkw "TAB_TALSH_T_INI_VKAT" MAP 0x4cc70 a_1 100 LINEAR______0_000000__0H___65164 0.0 65534.0
 /begin AXIS_DESCR COM_AXIS tkw LINEAR_______48_000000__0H___142 4 -48.0 142.5 AXIS_PTS_REF sstm_tkw_lsh MAX_GRAD 100 MONOTONY MON_INCREASE /end AXIS_DESCR
 /begin AXIS_DESCR COM_AXIS tal LINEAR_______48_000000__0H___142 4 -48.0 142.5 AXIS_PTS_REF sstm_tal_lsh MAX_GRAD 100 MONOTONY MON_INCREASE /end AXIS_DESCR
/end CHARACTERISTIC
/begin CHARACTERISTIC tab_talsh_vkat1__n__lm "TAB_TALSH_VKAT1" MAP 0x4f6fb a_4 100 LINEAR______0_000000__0H___99_61 0.0 99.610001
 /begin AXIS_DESCR COM_AXIS lm MAF_8_RES37 6 0.0 1389.0 AXIS_PTS_REF sstm_lm_tab_talsh_xkaty MAX_GRAD 100 MONOTONY MON_INCREASE /end AXIS_DESCR
 /begin AXIS_DESCR COM_AXIS n_32 ES_8_RES 8 0.0 8160.0 AXIS_PTS_REF sstm_n_tab_talsh_xkaty MAX_GRAD 100 MONOTONY MON_INCREASE /end AXIS_DESCR
/end CHARACTERISTIC
/begin CHARACTERISTIC tab_talsh_vkat2__n__lm "TAB_TALSH_VKAT2" MAP 0x4f72b a_4 100 LINEAR______0_000000__0H___99_61 0.0 99.610001
 /begin AXIS_DESCR COM_AXIS lm MAF_8_RES37 6 0.0 1389.0 AXIS_PTS_REF sstm_lm_tab_talsh_xkaty MAX_GRAD 100 MONOTONY MON_INCREASE /end AXIS_DESCR
 /begin AXIS_DESCR COM_AXIS n_32 ES_8_RES 8 0.0 8160.0 AXIS_PTS_REF sstm_n_tab_talsh_xkaty MAX_GRAD 100 MONOTONY MON_INCREASE /end AXIS_DESCR
/end CHARACTERISTIC
/begin CHARACTERISTIC tab_temp_gmw_ini_kat__tkw_st "TAB_TEMP_GMW_INI_KAT" CURVE 0x4f75b a_3 100 LINEAR_______33_000000__0H___165 -33.0 990.0
 /begin AXIS_DESCR COM_AXIS tkw_st LINEAR_______48_000000__0H___121 6 -48.0 142.5 AXIS_PTS_REF sst_tkw_st_tab_temp_gmw_ini_kat MAX_GRAD 100 MONOTONY MON_INCREASE /end AXIS_DESCR
/end CHARACTERISTIC
/begin CHARACTERISTIC tab_temp_sond_inc__tal "TAB_TEMP_SOND_INC" CURVE 0x4f761 a_3 100 LINEAR______0_000000__0H___23_81 0.0 23.8125
 /begin AXIS_DESCR COM_AXIS tal LINEAR_______48_000000__0H___142 4 -48.0 142.5 AXIS_PTS_REF sst_tal_tab_temp_sond_inc MAX_GRAD 100 MONOTONY MON_INCREASE /end AXIS_DESCR
/end CHARACTERISTIC
/begin CHARACTERISTIC tab_ti_dec_wf__n "TAB_TI_DEC_WF" CURVE 0x4cc90 a_7 100 LINEAR______0_000000__0H___262_1 0.0 262.144
 /begin AXIS_DESCR COM_AXIS n_32 ES_8_RES 8 0.0 8160.0 AXIS_PTS_REF sstm_n_8_3 MAX_GRAD 100 MONOTONY MON_INCREASE /end AXIS_DESCR
/end CHARACTERISTIC
/begin CHARACTERISTIC tab_ti_inc_wf__n "TAB_TI_INC_WF" CURVE 0x4cca0 a_7 100 LINEAR______0_000000__0H___262_1 0.0 262.144
 /begin AXIS_DESCR COM_AXIS n_32 ES_8_RES 8 0.0 8160.0 AXIS_PTS_REF sstm_n_8_3 MAX_GRAD 100 MONOTONY MON_INCREASE /end AXIS_DESCR
/end CHARACTERISTIC
/begin CHARACTERISTIC tab_ti_kor_zyl_aus__n "TAB_TI_KOR_ZYL_AUS" CURVE 0x4ccb0 a_7 100 LINEAR______0_000000__0H___1_166 0.0 1.0
 /begin AXIS_DESCR COM_AXIS n_32 ES_8_RES8 4 0.0 8160.0 AXIS_PTS_REF sst_n_tab_ti_kor_zyl_aus MAX_GRAD 100 MONOTONY MON_INCREASE /end AXIS_DESCR
/end CHARACTERISTIC
/begin CHARACTERISTIC tab_ti_ks2_add__n__lm "TAB_TI_KS2_ADD" MAP 0x4f765 a_4 10 LINEAR______0_000000__0H___0_925 0.0 0.99599999
 /begin AXIS_DESCR COM_AXIS lm MAF_8_RES40 8 0.0 1389.0 AXIS_PTS_REF sstm_lm_kf_ti_ks MAX_GRAD 100 MONOTONY MON_INCREASE /end AXIS_DESCR
 /begin AXIS_DESCR COM_AXIS drehzahl ES_8_RES8 10 0.0 8160.0 AXIS_PTS_REF sstm_n_1_8 MAX_GRAD 100 MONOTONY MON_INCREASE /end AXIS_DESCR
/end CHARACTERISTIC
/begin CHARACTERISTIC tab_ti_tkw_neg_wf__tkw "TAB_TI_TKW_NEG_WF" CURVE 0x4f7b5 a_3 100 LINEAR______0_000000__0H___3_927 0.0 3.984375
 /begin AXIS_DESCR COM_AXIS tkw LINEAR_______48_000000__0H___121 8 -48.0 142.5 AXIS_PTS_REF sstm_tkw_4_8 MAX_GRAD 100 MONOTONY MON_INCREASE /end AXIS_DESCR
/end CHARACTERISTIC
/begin CHARACTERISTIC tab_ti_tkw_pos_wf__tkw "TAB_TI_TKW_POS_WF" CURVE 0x4f7bd a_3 100 LINEAR______0_000000__0H___3_927 0.0 3.984375
 /begin AXIS_DESCR COM_AXIS tkw LINEAR_______48_000000__0H___121 8 -48.0 142.5 AXIS_PTS_REF sstm_tkw_4_8 MAX_GRAD 100 MONOTONY MON_INCREASE /end AXIS_DESCR
/end CHARACTERISTIC
/begin CHARACTERISTIC tab_tkw_soll_kfk__n__lm_ers "TAB_TKW_SOLL_KFK" MAP 0x4f7c5 a_4 100 LINEAR_______48_000000__0H___142 -48.0 142.5
 /begin AXIS_DESCR COM_AXIS lm_ers_diag MAF_8_RES40 6 0.0 1389.0 AXIS_PTS_REF sstm_lm_ers_diag_6_1 MAX_GRAD 100 MONOTONY MON_INCREASE /end AXIS_DESCR
 /begin AXIS_DESCR COM_AXIS n_32 ES_8_RES41 12 0.0 8160.0 AXIS_PTS_REF sstm_n_12_1 MAX_GRAD 100 MONOTONY MON_INCREASE /end AXIS_DESCR
/end CHARACTERISTIC
/begin CHARACTERISTIC tab_tkw_soll_kfk_ka__n__lm_ers "TAB_TKW_SOLL_KFK_KA" MAP 0x4f80d a_4 100 LINEAR_______48_000000__0H___142 -48.0 142.5
 /begin AXIS_DESCR COM_AXIS lm_ers_diag MAF_8_RES40 6 0.0 1389.0 AXIS_PTS_REF sstm_lm_ers_diag_6_1 MAX_GRAD 100 MONOTONY MON_INCREASE /end AXIS_DESCR
 /begin AXIS_DESCR COM_AXIS n_32 ES_8_RES41 12 0.0 8160.0 AXIS_PTS_REF sstm_n_12_1 MAX_GRAD 100 MONOTONY MON_INCREASE /end AXIS_DESCR
/end CHARACTERISTIC
/begin CHARACTERISTIC tab_totz_st_vanos__toel "TAB_TOTZ_ST_VANOS" CURVE 0x4f855 a_3 100 LINEAR______100_000000__1H___255 100.0 25500.0
 /begin AXIS_DESCR COM_AXIS toel LINEAR_______48_000000__0H___156 6 -48.0 155.0 AXIS_PTS_REF sstm_toel_tab_totz_t_12 MAX_GRAD 100 MONOTONY MON_INCREASE /end AXIS_DESCR
/end CHARACTERISTIC
/begin CHARACTERISTIC tab_tv_dif_bab__v "TAB_TV_DIF_BAB" CURVE 0x4ccb8 a_9 100 LINEAR_______256_000000__0H___25 -256.0 255.99218
 /begin AXIS_DESCR COM_AXIS v_fil LINEAR______0_000000__0H___511_9 2 0.0 511.99218 AXIS_PTS_REF sst_v_fil_tab_tv_dif_bab MAX_GRAD 100 MONOTONY MON_INCREASE /end AXIS_DESCR
/end CHARACTERISTIC
/begin CHARACTERISTIC tab_uls_down_mitko__lm_kg_h "TAB_ULS_DOWN_MITKO" CURVE 0x4f85b a_19 100 LINEAR______0_000000__0H___0_965 0.0 0.99609375
 /begin AXIS_DESCR COM_AXIS lm_kg_h MAF_KGH_16_RES117 4 0.0 16383.75 AXIS_PTS_REF sst_lm_kg_h_tab_uls_down_mitko MAX_GRAD 100 MONOTONY MON_INCREASE /end AXIS_DESCR
/end CHARACTERISTIC
/begin CHARACTERISTIC tab_verz_n__n "TAB_VERZ_N" CURVE 0x4f85f a_3 100 LINEAR______0_000000__0H___1_167 0.0 1.0
 /begin AXIS_DESCR COM_AXIS n_32 ES_8_RES 4 0.0 8160.0 AXIS_PTS_REF sst_n_tab_verz_n MAX_GRAD 100 MONOTONY MON_INCREASE /end AXIS_DESCR
/end CHARACTERISTIC
/begin CHARACTERISTIC tab_zw_ad_0__n__lm "Zylinder 1" MAP 0x51000 a_4 100 LINEAR_______48_000000__0H___124 -48.0 0.0
 /begin AXIS_DESCR COM_AXIS lm_kr MAF_8_RES 4 0.0 1389.0 AXIS_PTS_REF sstm_lm_1_9 MAX_GRAD 100 MONOTONY MON_INCREASE /end AXIS_DESCR
 /begin AXIS_DESCR COM_AXIS n_kr ES_8_RES8 16 0.0 8160.0 AXIS_PTS_REF sstm_n_2_9 MAX_GRAD 100 MONOTONY MON_INCREASE /end AXIS_DESCR
/end CHARACTERISTIC
/begin CHARACTERISTIC tab_zw_ad_1__n__lm "Zylinder 5" MAP 0x51040 a_4 100 LINEAR_______48_000000__0H___124 -48.0 0.0
 /begin AXIS_DESCR COM_AXIS lm_kr MAF_8_RES 4 0.0 1389.0 AXIS_PTS_REF sstm_lm_1_9 MAX_GRAD 100 MONOTONY MON_INCREASE /end AXIS_DESCR
 /begin AXIS_DESCR COM_AXIS n_kr ES_8_RES8 16 0.0 8160.0 AXIS_PTS_REF sstm_n_2_9 MAX_GRAD 100 MONOTONY MON_INCREASE /end AXIS_DESCR
/end CHARACTERISTIC
/begin CHARACTERISTIC tab_zw_ad_2__n__lm "Zylinder 3" MAP 0x51080 a_4 100 LINEAR_______48_000000__0H___124 -48.0 0.0
 /begin AXIS_DESCR COM_AXIS lm_kr MAF_8_RES 4 0.0 1389.0 AXIS_PTS_REF sstm_lm_1_9 MAX_GRAD 100 MONOTONY MON_INCREASE /end AXIS_DESCR
 /begin AXIS_DESCR COM_AXIS n_kr ES_8_RES8 16 0.0 8160.0 AXIS_PTS_REF sstm_n_2_9 MAX_GRAD 100 MONOTONY MON_INCREASE /end AXIS_DESCR
/end CHARACTERISTIC
/begin CHARACTERISTIC tab_zw_ad_3__n__lm "Zylinder 6" MAP 0x510c0 a_4 100 LINEAR_______48_000000__0H___124 -48.0 0.0
 /begin AXIS_DESCR COM_AXIS lm_kr MAF_8_RES 4 0.0 1389.0 AXIS_PTS_REF sstm_lm_1_9 MAX_GRAD 100 MONOTONY MON_INCREASE /end AXIS_DESCR
 /begin AXIS_DESCR COM_AXIS n_kr ES_8_RES8 16 0.0 8160.0 AXIS_PTS_REF sstm_n_2_9 MAX_GRAD 100 MONOTONY MON_INCREASE /end AXIS_DESCR
/end CHARACTERISTIC
/begin CHARACTERISTIC tab_zw_ad_4__n__lm "Zylinder 2" MAP 0x51100 a_4 100 LINEAR_______48_000000__0H___124 -48.0 0.0
 /begin AXIS_DESCR COM_AXIS lm_kr MAF_8_RES 4 0.0 1389.0 AXIS_PTS_REF sstm_lm_1_9 MAX_GRAD 100 MONOTONY MON_INCREASE /end AXIS_DESCR
 /begin AXIS_DESCR COM_AXIS n_kr ES_8_RES8 16 0.0 8160.0 AXIS_PTS_REF sstm_n_2_9 MAX_GRAD 100 MONOTONY MON_INCREASE /end AXIS_DESCR
/end CHARACTERISTIC
/begin CHARACTERISTIC tab_zw_ad_5__n__lm "Zylinder 4" MAP 0x51140 a_4 100 LINEAR_______48_000000__0H___124 -48.0 0.0
 /begin AXIS_DESCR COM_AXIS lm_kr MAF_8_RES 4 0.0 1389.0 AXIS_PTS_REF sstm_lm_1_9 MAX_GRAD 100 MONOTONY MON_INCREASE /end AXIS_DESCR
 /begin AXIS_DESCR COM_AXIS n_kr ES_8_RES8 16 0.0 8160.0 AXIS_PTS_REF sstm_n_2_9 MAX_GRAD 100 MONOTONY MON_INCREASE /end AXIS_DESCR
/end CHARACTERISTIC
/begin CHARACTERISTIC tab_zw_aebg_st_ar__n "TAB_ZW_AEBG_ST_AR" CURVE 0x4f863 a_3 100 LINEAR______0_375000__1H___95_62 0.375 95.625
 /begin AXIS_DESCR COM_AXIS drehzahl ES_8_RES8 8 0.0 8160.0 AXIS_PTS_REF sstm_n_1_3 MAX_GRAD 100 /end AXIS_DESCR
/end CHARACTERISTIC
/begin CHARACTERISTIC tab_zw_aebg_wetl__n "TAB_ZW_AEBG_WETL" CURVE 0x4ccbc a_7 1 LINEAR______0_001460__1H___47_99 0.00146 47.998501
 /begin AXIS_DESCR COM_AXIS drehzahl ES_8_RES8 4 0.0 8160.0 AXIS_PTS_REF sst_n_tab_zw_aebg_wetl MAX_GRAD 100 MONOTONY MON_INCREASE /end AXIS_DESCR
/end CHARACTERISTIC
/begin CHARACTERISTIC tab_zw_dec_kr_1__n "TAB_ZW_DEC_KR_1" CURVE 0x4f8ab a_141 10 LINEAR______47_625000__FFFFFF81H 0.0 47.625
 /begin AXIS_DESCR COM_AXIS n_kr ES_8_RES8 6 0.0 8160.0 AXIS_PTS_REF sstm_n_4_9 MAX_GRAD 100 MONOTONY MON_INCREASE /end AXIS_DESCR
/end CHARACTERISTIC
/begin CHARACTERISTIC tab_zw_dec_kr_2__n "TAB_ZW_DEC_KR_2" CURVE 0x4f8b1 a_141 10 LINEAR______47_625000__FFFFFF81H 0.0 47.625
 /begin AXIS_DESCR COM_AXIS n_kr ES_8_RES8 6 0.0 8160.0 AXIS_PTS_REF sstm_n_4_9 MAX_GRAD 100 MONOTONY MON_INCREASE /end AXIS_DESCR
/end CHARACTERISTIC
/begin CHARACTERISTIC tab_zw_inc_kr__n "TAB_ZW_INC_KR" CURVE 0x4ccc4 a_7 5 LINEAR______0_001460__1H___47_99 0.00146 47.998501
 /begin AXIS_DESCR COM_AXIS n_kr ES_8_RES8 16 0.0 8160.0 AXIS_PTS_REF sstm_n_2_9 MAX_GRAD 100 MONOTONY MON_INCREASE /end AXIS_DESCR
/end CHARACTERISTIC
/begin CHARACTERISTIC tab_zw_inst_dec__n "TAB_ZW_INST_DEC" CURVE 0x4cce4 a_7 100 LINEAR______0_001460__1H___47168 0.00146 47.998501
 /begin AXIS_DESCR COM_AXIS drehzahl ES_8_RES8 4 0.0 8160.0 AXIS_PTS_REF sstm_n_4_4 MAX_GRAD 100 MONOTONY MON_INCREASE /end AXIS_DESCR
/end CHARACTERISTIC
/begin CHARACTERISTIC tab_zw_inst_inc__n "TAB_ZW_INST_INC" CURVE 0x4ccec a_7 100 LINEAR______0_001460__1H___47168 0.00146 47.998501
 /begin AXIS_DESCR COM_AXIS drehzahl ES_8_RES8 4 0.0 8160.0 AXIS_PTS_REF sstm_n_4_4 MAX_GRAD 100 MONOTONY MON_INCREASE /end AXIS_DESCR
/end CHARACTERISTIC
/begin CHARACTERISTIC tab_zw_wetl__n__tkw "TAB_ZW_WETL" MAP 0x4f86b a_4 15 LINEAR_______48_000000__0H___124 -48.0 0.0
 /begin AXIS_DESCR COM_AXIS tkw LINEAR_______48_000000__0H___114 6 -48.0 142.5 AXIS_PTS_REF sstm_tkw_1_4 MAX_GRAD 100 MONOTONY MON_INCREASE /end AXIS_DESCR
 /begin AXIS_DESCR COM_AXIS drehzahl ES_8_RES8 4 0.0 8160.0 AXIS_PTS_REF sst_n_tab_zw_wetl MAX_GRAD 100 MONOTONY MON_INCREASE /end AXIS_DESCR
/end CHARACTERISTIC
/begin CHARACTERISTIC tab_zw_zyka_inst_kr__n "TAB_ZW_ZYKA_INST_KR" CURVE 0x4f883 a_3 10 LINEAR______0_000000__0H___25147 0.0 255.0
 /begin AXIS_DESCR COM_AXIS drehzahl ES_8_RES8 4 0.0 8160.0 AXIS_PTS_REF sstm_n_4_4 MAX_GRAD 100 MONOTONY MON_INCREASE /end AXIS_DESCR
/end CHARACTERISTIC
/begin CHARACTERISTIC tab_zyka_ngrd_inst_kr__n "TAB_ZYKA_NGRD_INST_KR" CURVE 0x4f887 a_3 20 LINEAR______0_000000__0H___25169 0.0 255.0
 /begin AXIS_DESCR COM_AXIS n_kr ES_8_RES8 16 0.0 8160.0 AXIS_PTS_REF sstm_n_2_9 MAX_GRAD 100 MONOTONY MON_INCREASE /end AXIS_DESCR
/end CHARACTERISTIC
/begin CHARACTERISTIC tab_zyka_totz_zw_inst__n "TAB_ZYKA_TOTZ_ZW_INST" CURVE 0x4f897 a_3 10 LINEAR______0_000000__0H___25142 0.0 255.0
 /begin AXIS_DESCR COM_AXIS drehzahl ES_8_RES8 4 0.0 8160.0 AXIS_PTS_REF sstm_n_4_4 MAX_GRAD 100 MONOTONY MON_INCREASE /end AXIS_DESCR
/end CHARACTERISTIC
/begin CHARACTERISTIC kf_aebg_tp_fak_fgr__vsoll_dif_fg "KF_AEBG_TP_FAK_FGR" CURVE 0x4cd8c a_19 10 LINEAR______0_000000__0H___0_998 0.0 0.9984
 /begin AXIS_DESCR COM_AXIS v_soll_dif_fgr LINEAR_______256_000000__0H___25 5 -256.0 255.99218 AXIS_PTS_REF sstm_vsoll_dif_fgr MAX_GRAD 100 MONOTONY MON_INCREASE /end AXIS_DESCR
/end CHARACTERISTIC
/begin CHARACTERISTIC kf_aebg_wa_fak_fgr__vsoll_dif_fg "KF_AEBG_WA_FAK_FGR" CURVE 0x4cd91 a_19 10 LINEAR______0_000000__0H___0_998 0.0 0.9984
 /begin AXIS_DESCR COM_AXIS v_soll_dif_fgr LINEAR_______256_000000__0H___25 5 -256.0 255.99218 AXIS_PTS_REF sstm_vsoll_dif_fgr MAX_GRAD 100 MONOTONY MON_INCREASE /end AXIS_DESCR
/end CHARACTERISTIC
/begin CHARACTERISTIC kf_be_wk_anst_fak_fgr__t_anst_fg "KF_BE_WK_ANST_FAK_FGR" CURVE 0x4cd9b a_3 10 LINEAR______0_000000__0H___1_992 0.0 1.9922
 /begin AXIS_DESCR COM_AXIS t_anst_fgr LINEAR______0_000000__0H___25_50 5 0.0 25.5 AXIS_PTS_REF sstm_t_anst_fgr MAX_GRAD 100 MONOTONY MON_INCREASE /end AXIS_DESCR
/end CHARACTERISTIC
/begin CHARACTERISTIC kf_nwsoll_e_tallfs_min__tallfs__ "KF_NWSOLL_E_TALLFS_MIN" MAP 0x4d4cf a_4 10 LINEAR_______48_000000__0H___170 -48.0 47.625
 /begin AXIS_DESCR COM_AXIS lm MAF_8_RES40 2 0.0 1389.0 AXIS_PTS_REF sstm_lm_2_1 MAX_GRAD 100 MONOTONY MON_INCREASE /end AXIS_DESCR
 /begin AXIS_DESCR COM_AXIS tallfs LINEAR______0_000000__0H___99_61 5 0.0 99.610001 AXIS_PTS_REF sstm_tallfs_5_1 MAX_GRAD 100 MONOTONY MON_INCREASE /end AXIS_DESCR
/end CHARACTERISTIC
/begin CHARACTERISTIC kf_t_van_reg_fr_a__nwdifa__vtotz "KF_T_VAN_REG_FR_A" MAP 0x4dbf1 a_4 100 LINEAR______0_000000__0H___159_3 0.0 159.375
 /begin AXIS_DESCR COM_AXIS dummy LINEAR______0_000000__0H___2550_ 6 0.0 2550.0 AXIS_PTS_REF sstm_vtotzy_kf_t_van_reg_y MAX_GRAD 100 MONOTONY MON_INCREASE /end AXIS_DESCR
 /begin AXIS_DESCR COM_AXIS dummy LINEAR______0_000000__0H___48_00 8 0.0 48.0 AXIS_PTS_REF sstm_nwdifx_kf_t_van_reg_x MAX_GRAD 100 MONOTONY MON_INCREASE /end AXIS_DESCR
/end CHARACTERISTIC
/begin CHARACTERISTIC kf_t_van_reg_fr_e__nwdife__vtotz "KF_T_VAN_REG_FR_E" MAP 0x4dc21 a_4 100 LINEAR______0_000000__0H___159_3 0.0 159.375
 /begin AXIS_DESCR COM_AXIS dummy LINEAR______0_000000__0H___2550_ 6 0.0 2550.0 AXIS_PTS_REF sstm_vtotzy_kf_t_van_reg_y MAX_GRAD 100 MONOTONY MON_INCREASE /end AXIS_DESCR
 /begin AXIS_DESCR COM_AXIS dummy LINEAR______0_000000__0H___48_00 8 0.0 48.0 AXIS_PTS_REF sstm_nwdifx_kf_t_van_reg_x MAX_GRAD 100 MONOTONY MON_INCREASE /end AXIS_DESCR
/end CHARACTERISTIC
/begin CHARACTERISTIC kf_t_van_reg_sp_a__nwdifa__vtotz "KF_T_VAN_REG_SP_A" MAP 0x4dc51 a_4 100 LINEAR______0_000000__0H___159_3 0.0 159.375
 /begin AXIS_DESCR COM_AXIS dummy LINEAR______0_000000__0H___2550_ 6 0.0 2550.0 AXIS_PTS_REF sstm_vtotzy_kf_t_van_reg_y MAX_GRAD 100 MONOTONY MON_INCREASE /end AXIS_DESCR
 /begin AXIS_DESCR COM_AXIS dummy LINEAR______0_000000__0H___48_00 8 0.0 48.0 AXIS_PTS_REF sstm_nwdifx_kf_t_van_reg_x MAX_GRAD 100 MONOTONY MON_INCREASE /end AXIS_DESCR
/end CHARACTERISTIC
/begin CHARACTERISTIC kf_t_van_reg_sp_e__nwdife__vtotz "KF_T_VAN_REG_SP_E" MAP 0x4dc81 a_4 100 LINEAR______0_000000__0H___159_3 0.0 159.375
 /begin AXIS_DESCR COM_AXIS dummy LINEAR______0_000000__0H___2550_ 6 0.0 2550.0 AXIS_PTS_REF sstm_vtotzy_kf_t_van_reg_y MAX_GRAD 100 MONOTONY MON_INCREASE /end AXIS_DESCR
 /begin AXIS_DESCR COM_AXIS dummy LINEAR______0_000000__0H___48_00 8 0.0 48.0 AXIS_PTS_REF sstm_nwdifx_kf_t_van_reg_x MAX_GRAD 100 MONOTONY MON_INCREASE /end AXIS_DESCR
/end CHARACTERISTIC
/begin CHARACTERISTIC kf_ve_wk_anst_fak_fgr__t_anst_fg "KF_VE_WK_ANST_FAK_FGR" CURVE 0x4e711 a_3 10 LINEAR______0_000000__0H___1_992 0.0 1.9922
 /begin AXIS_DESCR COM_AXIS t_anst_fgr LINEAR______0_000000__0H___25_50 5 0.0 25.5 AXIS_PTS_REF sstm_t_anst_fgr MAX_GRAD 100 MONOTONY MON_INCREASE /end AXIS_DESCR
/end CHARACTERISTIC
/begin CHARACTERISTIC kf_tallfs_nsoll_min__n__nsoll_di "KF_TALLFS_NSOLL_MIN" MAP 0x4b8a2 a_43 10 TALLFS_IN_10MS 0.0061 24.9938
 /begin AXIS_DESCR COM_AXIS nsoll_dif_ubat LINEAR______0_000000__0H___10171 4 0.0 1000.0 AXIS_PTS_REF sst_nsoll_dif_kf_tallfs_nsoll_mi MAX_GRAD 3 /end AXIS_DESCR
 /begin AXIS_DESCR COM_AXIS drehzahl ES_8_RES41 4 0.0 8160.0 AXIS_PTS_REF sst_n_kf_tallfs_nsoll_min MAX_GRAD 25 /end AXIS_DESCR
/end CHARACTERISTIC
/begin CHARACTERISTIC kf_o2_kat_int_max__uls_kat_o2_su "KF_O2_KAT_INT_MAX" CURVE 0x4d9a9 a_19 100 LINEAR______0_000000__0H___0_965 0.0 0.99609375
 /begin AXIS_DESCR COM_AXIS dummy LINEAR______0_000000__0H___42949 6 0.0 4.2949673e+009 AXIS_PTS_REF sst_uls_kat_o2_sum_kf_o2_kat_int MAX_GRAD 100 MONOTONY MON_INCREASE /end AXIS_DESCR
/end CHARACTERISTIC
/begin CHARACTERISTIC A_DK_ACT "A_DK_ACT" VALUE 0x480aa a_172 100 LINEAR_______32768_000000__FFFF8 -32768.0 32767.0 BIT_MASK 0xffffffff /end CHARACTERISTIC
/begin CHARACTERISTIC A_DK_SET "A_DK_SET" VALUE 0x480ac a_172 100 LINEAR_______32768_000000__FFFF8 -32768.0 32767.0 BIT_MASK 0xffffffff /end CHARACTERISTIC
/begin CHARACTERISTIC A_EK "A_EK" VALUE 0x480ae a_172 100 LINEAR_______32768_000000__FFFF8 -32768.0 32767.0 BIT_MASK 0xffffffff /end CHARACTERISTIC
/begin CHARACTERISTIC a_fak_s "A_FAK_S" VALUE 0x48138 a_173 100 LINEAR______0_000000__0H___0_996 0.0 0.99610001 BIT_MASK 0xffffffff /end CHARACTERISTIC
/begin CHARACTERISTIC a_fak_sa "A_FAK_SA" VALUE 0x48139 a_173 100 LINEAR______0_000000__0H___0_996 0.0 0.99610001 BIT_MASK 0xffffffff /end CHARACTERISTIC
/begin CHARACTERISTIC a_max_fgr "A_MAX_FGR" VALUE 0x48418 a_174 100 LINEAR______0_000000__0H___7110_ 0.0 7110.8941 BIT_MASK 0xffffffff /end CHARACTERISTIC
/begin CHARACTERISTIC a_max_fgr_set "A_MAX_FGR_SET" VALUE 0x487e4 a_175 100 LINEAR_______27_780000__FFFFFF80 -27.78 0.0 BIT_MASK 0xffffffff /end CHARACTERISTIC
/begin CHARACTERISTIC a_neg_be_fgr "A_NEG_BE_FGR" VALUE 0x4841a a_174 100 LINEAR______0_000000__0H___51176 0.0 511.9789 BIT_MASK 0xffffffff /end CHARACTERISTIC
/begin CHARACTERISTIC a_neg_tp_fgr "A_NEG_TP_FGR" VALUE 0x4841c a_174 100 LINEAR______0_000000__0H___51176 0.0 511.9789 BIT_MASK 0xffffffff /end CHARACTERISTIC
/begin CHARACTERISTIC a_neg_ve_fgr "A_NEG_VE_FGR" VALUE 0x4841e a_174 100 LINEAR______0_000000__0H___51176 0.0 511.9789 BIT_MASK 0xffffffff /end CHARACTERISTIC
/begin CHARACTERISTIC a_neg_wa_fgr "A_NEG_WA_FGR" VALUE 0x48420 a_174 100 LINEAR______0_000000__0H___51176 0.0 511.9789 BIT_MASK 0xffffffff /end CHARACTERISTIC
/begin CHARACTERISTIC a_pos_be_fgr "A_POS_BE_FGR" VALUE 0x48422 a_174 100 LINEAR______0_000000__0H___51176 0.0 511.9789 BIT_MASK 0xffffffff /end CHARACTERISTIC
/begin CHARACTERISTIC a_pos_fak_fgr "A_POS_FAK_FGR" VALUE 0x4813a a_173 10 LINEAR______0_000000__0H___0_998 0.0 0.9984 BIT_MASK 0xffffffff /end CHARACTERISTIC
/begin CHARACTERISTIC a_pos_tp_fgr "A_POS_TP_FGR" VALUE 0x48424 a_174 100 LINEAR______0_000000__0H___51176 0.0 511.9789 BIT_MASK 0xffffffff /end CHARACTERISTIC
/begin CHARACTERISTIC a_pos_ve_fgr "A_POS_VE_FGR" VALUE 0x48426 a_174 100 LINEAR______0_000000__0H___51176 0.0 511.9789 BIT_MASK 0xffffffff /end CHARACTERISTIC
/begin CHARACTERISTIC a_pos_wa_fgr "A_POS_WA_FGR" VALUE 0x48428 a_174 100 LINEAR______0_000000__0H___51176 0.0 511.9789 BIT_MASK 0xffffffff /end CHARACTERISTIC
/begin CHARACTERISTIC acr_diag_can_kombi_max "ACR_DIAG_CAN_KOMBI_MAX" VALUE 0x4813b a_173 100 LINEAR_______48_000000__0H___121 -48.0 142.5 BIT_MASK 0xffffffff /end CHARACTERISTIC
/begin CHARACTERISTIC acr_diag_cfa_pwm_max "ACR_DIAG_CFA_PWM_MAX" VALUE 0x4813c a_173 100 LINEAR______0_000000__0H___99177 0.0 99.610001 BIT_MASK 0xffffffff /end CHARACTERISTIC
/begin CHARACTERISTIC acr_diag_cfa_pwm_min "ACR_DIAG_CFA_PWM_MIN" VALUE 0x4813d a_173 100 LINEAR______0_000000__0H___99177 0.0 99.610001 BIT_MASK 0xffffffff /end CHARACTERISTIC
/begin CHARACTERISTIC acr_diag_cps_pwm_max "ACR_DIAG_CPS_PWM_MAX" VALUE 0x4813e a_173 100 LINEAR______0_000000__0H___99177 0.0 99.610001 BIT_MASK 0xffffffff /end CHARACTERISTIC
/begin CHARACTERISTIC acr_diag_cps_pwm_min "ACR_DIAG_CPS_PWM_MIN" VALUE 0x4813f a_173 100 LINEAR______0_000000__0H___99177 0.0 99.610001 BIT_MASK 0xffffffff /end CHARACTERISTIC
/begin CHARACTERISTIC acr_diag_hth_pwm_max "ACR_DIAG_HTH_PWM_MAX" VALUE 0x48140 a_173 100 LINEAR______0_000000__0H___99177 0.0 99.610001 BIT_MASK 0xffffffff /end CHARACTERISTIC
/begin CHARACTERISTIC acr_diag_hth_pwm_min "ACR_DIAG_HTH_PWM_MIN" VALUE 0x48141 a_173 100 LINEAR______0_000000__0H___99177 0.0 99.610001 BIT_MASK 0xffffffff /end CHARACTERISTIC
/begin CHARACTERISTIC acr_diag_isa_pwm_max "ACR_DIAG_ISA_PWM_MAX" VALUE 0x48142 a_173 100 LINEAR______0_000000__0H___99177 0.0 99.610001 BIT_MASK 0xffffffff /end CHARACTERISTIC
/begin CHARACTERISTIC acr_diag_isa_pwm_min "ACR_DIAG_ISA_PWM_MIN" VALUE 0x48143 a_173 100 LINEAR______0_000000__0H___99177 0.0 99.610001 BIT_MASK 0xffffffff /end CHARACTERISTIC
/begin CHARACTERISTIC acr_diag_iv_tinj_max "ACR_DIAG_IV_TINJ_MAX" VALUE 0x48144 a_173 100 LINEAR______0_000000__0H___2_040 0.0 2.04 BIT_MASK 0xffffffff /end CHARACTERISTIC
/begin CHARACTERISTIC acr_diag_iv_tinj_min "ACR_DIAG_IV_TINJ_MIN" VALUE 0x48145 a_173 100 LINEAR______0_000000__0H___2_040 0.0 2.04 BIT_MASK 0xffffffff /end CHARACTERISTIC
/begin CHARACTERISTIC acr_diag_iv_tp_max "ACR_DIAG_IV_TP_MAX" VALUE 0x48146 a_173 100 LINEAR______0_000000__0H___2550_ 0.0 2550.0 BIT_MASK 0xffffffff /end CHARACTERISTIC
/begin CHARACTERISTIC acr_diag_iv_tp_min "ACR_DIAG_IV_TP_MIN" VALUE 0x48147 a_173 100 LINEAR______0_000000__0H___2550_ 0.0 2550.0 BIT_MASK 0xffffffff /end CHARACTERISTIC
/begin CHARACTERISTIC acr_diag_ivvt_dc_i_max "ACR_DIAG_IVVT_DC_I_MAX" VALUE 0x48148 a_173 100 LINEAR______0_000000__0H___99_61 0.0 99.610001 BIT_MASK 0xffffffff /end CHARACTERISTIC
/begin CHARACTERISTIC acr_diag_ivvt_dc_i_min "ACR_DIAG_IVVT_DC_I_MIN" VALUE 0x48149 a_173 100 LINEAR______0_000000__0H___99_61 0.0 99.610001 BIT_MASK 0xffffffff /end CHARACTERISTIC
/begin CHARACTERISTIC acr_diag_ivvt_dc_o_max "ACR_DIAG_IVVT_DC_O_MAX" VALUE 0x4814a a_173 100 LINEAR______0_000000__0H___99_61 0.0 99.610001 BIT_MASK 0xffffffff /end CHARACTERISTIC
/begin CHARACTERISTIC acr_diag_ivvt_dc_o_min "ACR_DIAG_IVVT_DC_O_MIN" VALUE 0x4814b a_173 100 LINEAR______0_000000__0H___99_61 0.0 99.610001 BIT_MASK 0xffffffff /end CHARACTERISTIC
/begin CHARACTERISTIC acr_diag_ivvt_n_max "ACR_DIAG_IVVT_N_MAX" VALUE 0x4814c a_173 100 ES_8_RES17 0.0 8160.0 BIT_MASK 0xffffffff /end CHARACTERISTIC
/begin CHARACTERISTIC acr_diag_ivvt_n_min "ACR_DIAG_IVVT_N_MIN" VALUE 0x4814d a_173 100 ES_8_RES17 0.0 8160.0 BIT_MASK 0xffffffff /end CHARACTERISTIC
/begin CHARACTERISTIC acr_diag_ivvt_pos_i_max "ACR_DIAG_IVVT_POS_I_MAX" VALUE 0x4814e a_173 100 LINEAR______60_000000__0H___1178 60.0 155.625 BIT_MASK 0xffffffff /end CHARACTERISTIC
/begin CHARACTERISTIC acr_diag_ivvt_pos_i_min "ACR_DIAG_IVVT_POS_I_MIN" VALUE 0x4814f a_173 100 LINEAR______60_000000__0H___1178 60.0 155.625 BIT_MASK 0xffffffff /end CHARACTERISTIC
/begin CHARACTERISTIC acr_diag_ivvt_pos_o_max "ACR_DIAG_IVVT_POS_O_MAX" VALUE 0x48150 a_173 100 LINEAR_______155_625000__FFH__63 -155.625 -60.0 BIT_MASK 0xffffffff /end CHARACTERISTIC
/begin CHARACTERISTIC acr_diag_ivvt_pos_o_min "ACR_DIAG_IVVT_POS_O_MIN" VALUE 0x48151 a_173 100 LINEAR_______155_625000__FFH__63 -155.625 -60.0 BIT_MASK 0xffffffff /end CHARACTERISTIC
/begin CHARACTERISTIC acr_diag_ivvt_t_i_max "ACR_DIAG_IVVT_T_I_MAX" VALUE 0x48152 a_173 100 LINEAR______60_000000__0H___1178 60.0 155.625 BIT_MASK 0xffffffff /end CHARACTERISTIC
/begin CHARACTERISTIC acr_diag_ivvt_t_i_min "ACR_DIAG_IVVT_T_I_MIN" VALUE 0x48153 a_173 100 LINEAR______60_000000__0H___1178 60.0 155.625 BIT_MASK 0xffffffff /end CHARACTERISTIC
/begin CHARACTERISTIC acr_diag_ivvt_t_o_max "ACR_DIAG_IVVT_T_O_MAX" VALUE 0x48154 a_173 100 LINEAR_______155_625000__FFH__63 -155.625 -60.0 BIT_MASK 0xffffffff /end CHARACTERISTIC
/begin CHARACTERISTIC acr_diag_ivvt_t_o_min "ACR_DIAG_IVVT_T_O_MIN" VALUE 0x48155 a_173 100 LINEAR_______155_625000__FFH__63 -155.625 -60.0 BIT_MASK 0xffffffff /end CHARACTERISTIC
/begin CHARACTERISTIC acr_diag_ivvt_tgt_i_max "ACR_DIAG_IVVT_TGT_I_MAX" VALUE 0x48156 a_173 100 LINEAR______60_000000__0H___1178 60.0 155.625 BIT_MASK 0xffffffff /end CHARACTERISTIC
/begin CHARACTERISTIC acr_diag_ivvt_tgt_i_min "ACR_DIAG_IVVT_TGT_I_MIN" VALUE 0x48157 a_173 100 LINEAR______60_000000__0H___1178 60.0 155.625 BIT_MASK 0xffffffff /end CHARACTERISTIC
/begin CHARACTERISTIC acr_diag_ivvt_tgt_o_max "ACR_DIAG_IVVT_TGT_O_MAX" VALUE 0x48158 a_173 100 LINEAR_______155_625000__FFH__63 -155.625 -60.0 BIT_MASK 0xffffffff /end CHARACTERISTIC
/begin CHARACTERISTIC acr_diag_ivvt_tgt_o_min "ACR_DIAG_IVVT_TGT_O_MIN" VALUE 0x48159 a_173 100 LINEAR_______155_625000__FFH__63 -155.625 -60.0 BIT_MASK 0xffffffff /end CHARACTERISTIC
/begin CHARACTERISTIC acr_diag_ivvt_tgt_t_i_max "ACR_DIAG_IVVT_TGT_T_I_MAX" VALUE 0x4815a a_173 100 LINEAR______0_000000__0H___25108 0.0 255.0 BIT_MASK 0xffffffff /end CHARACTERISTIC
/begin CHARACTERISTIC acr_diag_ivvt_tgt_t_i_min "ACR_DIAG_IVVT_TGT_T_I_MIN" VALUE 0x4815b a_173 100 LINEAR______0_000000__0H___25108 0.0 255.0 BIT_MASK 0xffffffff /end CHARACTERISTIC
/begin CHARACTERISTIC acr_diag_ivvt_tgt_t_o_max "ACR_DIAG_IVVT_TGT_T_O_MAX" VALUE 0x4815c a_173 100 LINEAR______0_000000__0H___25108 0.0 255.0 BIT_MASK 0xffffffff /end CHARACTERISTIC
/begin CHARACTERISTIC acr_diag_ivvt_tgt_t_o_min "ACR_DIAG_IVVT_TGT_T_O_MIN" VALUE 0x4815d a_173 100 LINEAR______0_000000__0H___25108 0.0 255.0 BIT_MASK 0xffffffff /end CHARACTERISTIC
/begin CHARACTERISTIC acr_diag_ivvt_toil_max "ACR_DIAG_IVVT_TOIL_MAX" VALUE 0x4815e a_173 100 LINEAR_______48_000000__0H___155 -48.0 155.0 BIT_MASK 0xffffffff /end CHARACTERISTIC
/begin CHARACTERISTIC acr_diag_ivvt_toil_min "ACR_DIAG_IVVT_TOIL_MIN" VALUE 0x4815f a_173 100 LINEAR_______48_000000__0H___155 -48.0 155.0 BIT_MASK 0xffffffff /end CHARACTERISTIC
/begin CHARACTERISTIC acr_diag_lsh_pwm_max "ACR_DIAG_LSH_PWM_MAX" VALUE 0x48160 a_173 100 LINEAR______0_000000__0H___99177 0.0 99.610001 BIT_MASK 0xffffffff /end CHARACTERISTIC
/begin CHARACTERISTIC acr_diag_lsh_pwm_max_pre "ACR_DIAG_LSH_PWM_MAX_PRE" VALUE 0x48161 a_173 100 LINEAR______0_000000__0H___99177 0.0 99.610001 BIT_MASK 0xffffffff /end CHARACTERISTIC
/begin CHARACTERISTIC acr_diag_lsh_pwm_min "ACR_DIAG_LSH_PWM_MIN" VALUE 0x48162 a_173 100 LINEAR______0_000000__0H___99177 0.0 99.610001 BIT_MASK 0xffffffff /end CHARACTERISTIC
/begin CHARACTERISTIC acr_diag_mtc_max "ACR_DIAG_MTC_MAX" VALUE 0x48163 a_173 100 MTC_NORM_8_RES 0.0 119.53125 BIT_MASK 0xffffffff /end CHARACTERISTIC
/begin CHARACTERISTIC acr_diag_mtc_min "ACR_DIAG_MTC_MIN" VALUE 0x48164 a_173 100 MTC_NORM_8_RES 0.0 119.53125 BIT_MASK 0xffffffff /end CHARACTERISTIC
/begin CHARACTERISTIC acr_diag_n_max "ACR_DIAG_N_MAX" VALUE 0x48165 a_173 100 ES_8_RES17 0.0 8160.0 BIT_MASK 0xffffffff /end CHARACTERISTIC
/begin CHARACTERISTIC acr_diag_set_is_nmax "ACR_DIAG_SET_IS_MAX" VALUE 0x48166 a_173 100 ES_8_RES17 0.0 8160.0 BIT_MASK 0xffffffff /end CHARACTERISTIC
/begin CHARACTERISTIC acr_diag_set_is_nmin "ACR_DIAG_SET_IS_MIN" VALUE 0x48167 a_173 100 ES_8_RES17 0.0 8160.0 BIT_MASK 0xffffffff /end CHARACTERISTIC
/begin CHARACTERISTIC acr_diag_vfil_max "ACR_DIAG_VFIL_MAX" VALUE 0x4842a a_174 100 LINEAR______0_000000__0H___51179 0.0 511.99218 BIT_MASK 0xffffffff /end CHARACTERISTIC
/begin CHARACTERISTIC ACT_VALUE_CHANGE_LIMIT "ACT_VALUE_CHANGE_LIMIT" VALUE 0x480b0 a_172 100 LINEAR_______32768_000000__FFFF8 -32768.0 32767.0 BIT_MASK 0xffffffff /end CHARACTERISTIC
/begin CHARACTERISTIC ad_gmw_llfs_diag_aebg "AD_GMW_LLFS_DIAG_AEBG" VALUE 0x48168 a_173 100 LINEAR______0_015625__1H___3_984 0.015625 3.984375 BIT_MASK 0xffffffff /end CHARACTERISTIC
/begin CHARACTERISTIC ad_mitko_ll "AD_MITKO_LL" VALUE 0x48169 a_173 10 LINEAR______0_000000__0H___0_996 0.0 0.99610001 BIT_MASK 0xffffffff /end CHARACTERISTIC
/begin CHARACTERISTIC ad_mitko_llfs "AD_MITKO_LLFS" VALUE 0x4816a a_173 10 LINEAR______0_000000__0H___0_996 0.0 0.99610001 BIT_MASK 0xffffffff /end CHARACTERISTIC
/begin CHARACTERISTIC ADF "ADF" VALUE 0x480b2 a_172 100 LINEAR_______32768_000000__FFFF8 -32768.0 32767.0 BIT_MASK 0xffffffff /end CHARACTERISTIC
/begin CHARACTERISTIC ADH_DEC_FKT "ADH_DEC_FKT" VALUE 0x480b4 a_172 100 LINEAR_______32768_000000__FF180 -32768.0 32767.0 BIT_MASK 0xffffffff /end CHARACTERISTIC
/begin CHARACTERISTIC ADH_TIME_LIMIT "ADH_TIME_LIMIT" VALUE 0x487e5 a_175 100 SIGNEDCHAR -128.0 127.0 BIT_MASK 0xffffffff /end CHARACTERISTIC
/begin CHARACTERISTIC aebg_md_mdk_kat "AEBG_MD_MDK_KAT" VALUE 0x4842c a_174 100 LINEAR______0_000015__1H___99_99 1.526e-005 99.999985 BIT_MASK 0xffffffff /end CHARACTERISTIC
/begin CHARACTERISTIC aebg_tate_neg_fc "AEBG_TATE_NEG_FC" VALUE 0x4816b a_173 10 LINEAR______0_024000__1H___6_120 0.024 6.12 BIT_MASK 0xffffffff /end CHARACTERISTIC
/begin CHARACTERISTIC aebg_tate_pos_fc "AEBG_TATE_POS_FC" VALUE 0x4816c a_173 10 LINEAR______0_024000__1H___6_120 0.024 6.12 BIT_MASK 0xffffffff /end CHARACTERISTIC
/begin CHARACTERISTIC ak_zust_tv_min_ak "AK_ZUST_TV_MIN_AK" VALUE 0x4816d a_173 100 LINEAR______0_000000__0H___1_167 0.0 1.0 BIT_MASK 0xffffffff /end CHARACTERISTIC
/begin CHARACTERISTIC ampl_fact_lsh_i "AMPL_FACT_LSH_I" VALUE 0x4842e a_174 100 LINEAR______0_000000__0H___1_181 0.0 1.999953 BIT_MASK 0xffffffff /end CHARACTERISTIC
/begin CHARACTERISTIC anz_a_ftp_min "ANZ_A_FTP_MIN" VALUE 0x48430 a_174 100 LINEAR______0_000000__0H___200_0 0.0 200.0 BIT_MASK 0xffffffff /end CHARACTERISTIC
/begin CHARACTERISTIC anz_be_max "ANZ_BE_MAX" VALUE 0x4816e a_173 10 LINEAR______0_000000__0H___25182 0.0 255.0 BIT_MASK 0xffffffff /end CHARACTERISTIC
/begin CHARACTERISTIC anz_dc_ready "ANZ_DC_READY" VALUE 0x4816f a_173 100 LINEAR______0_000000__0H___25142 0.0 255.0 BIT_MASK 0xffffffff /end CHARACTERISTIC
/begin CHARACTERISTIC anz_diag_fc_max "ANZ_DIAG_FC_MAX" VALUE 0x48170 a_173 5 LINEAR______0_000000__0H___25183 0.0 255.0 BIT_MASK 0xffffffff /end CHARACTERISTIC
/begin CHARACTERISTIC anz_diag_n_dif_max "ANZ_DIAG_N_DIF_MAX" VALUE 0x48171 a_173 100 LINEAR______0_000000__0H___25142 0.0 255.0 BIT_MASK 0xffffffff /end CHARACTERISTIC
/begin CHARACTERISTIC anz_end_p_ramp "ANZ_END_P_RAMP" VALUE 0x48172 a_173 100 LINEAR______0_000000__0H___25182 0.0 255.0 BIT_MASK 0xffffffff /end CHARACTERISTIC
/begin CHARACTERISTIC anz_hfm_diag_max "ANZ_HFM_DIAG_MAX" VALUE 0x48173 a_173 100 LINEAR______1_000000__1H___25184 1.0 255.0 BIT_MASK 0xffffffff /end CHARACTERISTIC
/begin CHARACTERISTIC anz_hfm_max "ANZ_HFM_MAX" VALUE 0x48174 a_173 100 LINEAR______1_000000__1H___25184 1.0 255.0 BIT_MASK 0xffffffff /end CHARACTERISTIC
/begin CHARACTERISTIC anz_hub_max_ctc "ANZ_HUB_MAX_CTC" VALUE 0x48175 a_173 100 LINEAR______0_000000__0H___25142 0.0 255.0 BIT_MASK 0xffffffff /end CHARACTERISTIC
/begin CHARACTERISTIC anz_hub_max_ldp "ANZ_HUB_MAX_LDP" VALUE 0x48176 a_173 100 LINEAR______0_000000__0H___25142 0.0 255.0 BIT_MASK 0xffffffff /end CHARACTERISTIC
/begin CHARACTERISTIC anz_hz_max_fus_gkk_rul "ANZ_HZ_MAX_FUS_GKK_RUL" VALUE 0x48177 a_173 100 LINEAR______0_000000__0H___25185 0.0 255.0 BIT_MASK 0xffffffff /end CHARACTERISTIC
/begin CHARACTERISTIC anz_hz_max_gkk_rul "ANZ_HZ_MAX_GKK_RUL" VALUE 0x48178 a_173 100 LINEAR______0_000000__0H___25185 0.0 255.0 BIT_MASK 0xffffffff /end CHARACTERISTIC
/begin CHARACTERISTIC anz_imp_mfl "ANZ_IMP_MFL" VALUE 0x48179 a_173 100 LINEAR______1_000000__1H___25186 1.0 255.0 BIT_MASK 0xffffffff /end CHARACTERISTIC
/begin CHARACTERISTIC anz_lammw_gmw_ber "ANZ_LAMMW_GMW_BER" VALUE 0x4817a a_173 100 LINEAR______0_000000__0H___25182 0.0 255.0 BIT_MASK 0xffffffff /end CHARACTERISTIC
/begin CHARACTERISTIC anz_mager_uls_min "ANZ_MAGER_ULS_MIN" VALUE 0x48432 a_174 10 LINEAR______0_000000__0H___32766 0.0 32766.0 BIT_MASK 0xffffffff /end CHARACTERISTIC
/begin CHARACTERISTIC anz_max_auss_rul "ANZ_MAX_AUSS_RUL" VALUE 0x48434 a_174 100 LINEAR______1_000000__0H___3000_ 1.0 3000.0 BIT_MASK 0xffffffff /end CHARACTERISTIC
/begin CHARACTERISTIC anz_max_ev_aus_auss "ANZ_MAX_EV_AUS_AUSS" VALUE 0x4817b a_173 5 LINEAR______0_000000__0H___6_000 0.0 6.0 BIT_MASK 0xffffffff /end CHARACTERISTIC
/begin CHARACTERISTIC anz_mdk_dif_diag_max "ANZ_MDK_DIF_DIAG_MAX" VALUE 0x4817c a_173 100 LINEAR______0_000000__0H___25182 0.0 255.0 BIT_MASK 0xffffffff /end CHARACTERISTIC
/begin CHARACTERISTIC anz_min_auss_a "ANZ_MIN_AUSS_A" VALUE 0x48436 a_174 5 LINEAR______0_000000__0H___65187 0.0 65535.0 BIT_MASK 0xffffffff /end CHARACTERISTIC
/begin CHARACTERISTIC anz_min_auss_b "ANZ_MIN_AUSS_B" VALUE 0x48438 a_174 5 LINEAR______0_000000__0H___500_0 0.0 500.0 BIT_MASK 0xffffffff /end CHARACTERISTIC
/begin CHARACTERISTIC anz_min_sa_auss "ANZ_MIN_SA_AUSS" VALUE 0x4817d a_173 5 LINEAR______1_000000__0H___255_0 1.0 255.0 BIT_MASK 0xffffffff /end CHARACTERISTIC
/begin CHARACTERISTIC anz_n_dif_max "ANZ_N_DIF_MAX" VALUE 0x4817e a_173 100 LINEAR______0_000000__0H___25142 0.0 255.0 BIT_MASK 0xffffffff /end CHARACTERISTIC
/begin CHARACTERISTIC anz_seg_totz_tah_vanos "ANZ_SEG_TOTZ_TAH_VANOS" VALUE 0x4817f a_173 100 LINEAR______1_000000__1H___25186 1.0 255.0 BIT_MASK 0xffffffff /end CHARACTERISTIC
/begin CHARACTERISTIC anz_sl_wst_max "ANZ_SL_WST_MAX" VALUE 0x48180 a_173 10 LINEAR______0_000000__0H___25182 0.0 255.0 BIT_MASK 0xffffffff /end CHARACTERISTIC
/begin CHARACTERISTIC anz_t_te_2 "ANZ_T_TE_2" VALUE 0x48181 a_173 100 LINEAR______0_000000__0H___25142 0.0 255.0 BIT_MASK 0xffffffff /end CHARACTERISTIC
/begin CHARACTERISTIC anz_tate_fc_max "ANZ_TATE_FC_MAX" VALUE 0x48182 a_173 100 LINEAR______0_000000__0H___25188 0.0 255.0 BIT_MASK 0xffffffff /end CHARACTERISTIC
/begin CHARACTERISTIC anz_tate_wst_ldp_min "ANZ_TATE_WST_LDP_MIN" VALUE 0x4843a a_174 10 LINEAR______0_000000__0H___171_3 0.0 171.33 BIT_MASK 0xffffffff /end CHARACTERISTIC
/begin CHARACTERISTIC anz_trig_ar "ANZ_TRIG_AR" VALUE 0x48183 a_173 100 LINEAR______1_000000__1H___10_00 1.0 10.0 BIT_MASK 0xffffffff /end CHARACTERISTIC
/begin CHARACTERISTIC anz_wst_max_ldp "ANZ_WST_MAX_LDP" VALUE 0x48184 a_173 10 LINEAR______0_000000__0H___25182 0.0 255.0 BIT_MASK 0xffffffff /end CHARACTERISTIC
/begin CHARACTERISTIC anz_z_sync "ANZ_Z_SYNC" VALUE 0x48185 a_173 100 LINEAR______4_000000__4H___56_00 4.0 56.0 BIT_MASK 0xffffffff /end CHARACTERISTIC
/begin CHARACTERISTIC anz_zyk_nw_a_diag "ANZ_ZYK_NW_A_DIAG" VALUE 0x48186 a_173 100 LINEAR______0_000000__0H___25142 0.0 255.0 BIT_MASK 0xffffffff /end CHARACTERISTIC
/begin CHARACTERISTIC anz_zyka_lsh_diag "ANZ_ZYKA_LSH_DIAG" VALUE 0x48187 a_173 100 LINEAR______0_000000__0H___254_0 0.0 254.0 BIT_MASK 0xffffffff /end CHARACTERISTIC
/begin CHARACTERISTIC anz_zyka_max_lsh_diag "ANZ_ZYKA_MAX_LSH_DIAG" VALUE 0x48188 a_173 100 LINEAR______0_000000__0H___254_0 0.0 254.0 BIT_MASK 0xffffffff /end CHARACTERISTIC
/begin CHARACTERISTIC asc1_zyka_max "ASC1_ZYKA_MAX" VALUE 0x48189 a_173 100 LINEAR______1_000000__1H___255_0 1.0 255.0 BIT_MASK 0xffffffff /end CHARACTERISTIC
/begin CHARACTERISTIC asc3_zyka_max "ASC3_ZYKA_MAX" VALUE 0x4818a a_173 100 LINEAR______1_000000__1H___255_0 1.0 255.0 BIT_MASK 0xffffffff /end CHARACTERISTIC
/begin CHARACTERISTIC B_DK_ACT "B_DK_ACT" VALUE 0x480b6 a_172 100 LINEAR_______32768_000000__FFFF8 -32768.0 32767.0 BIT_MASK 0xffffffff /end CHARACTERISTIC
/begin CHARACTERISTIC B_DK_SET "B_DK_SET" VALUE 0x480b8 a_172 100 LINEAR_______32768_000000__FFFF8 -32768.0 32767.0 BIT_MASK 0xffffffff /end CHARACTERISTIC
/begin CHARACTERISTIC B0 "B0" VALUE 0x487fc a_189 100 LINEAR_______2147483647_000000__ -2.1474836e+009 2.1474836e+009 BIT_MASK 0xffffffff FUNCTION_LIST hella /end CHARACTERISTIC
/begin CHARACTERISTIC B1 "B1" VALUE 0x48800 a_189 100 LINEAR_______21856_000000__FFFF8 -21856.0 21856.0 BIT_MASK 0xffffffff FUNCTION_LIST hella /end CHARACTERISTIC
/begin CHARACTERISTIC B2 "B2" VALUE 0x48804 a_189 100 LINEAR_______2147483647_000000__ -2.1474836e+009 2.1474836e+009 BIT_MASK 0xffffffff FUNCTION_LIST hella /end CHARACTERISTIC
/begin CHARACTERISTIC bd_mz "BD_MZ" VALUE 0x4818b a_173 20 LINEAR______0_000000__0H___1_020 0.0 1.02 BIT_MASK 0xffffffff /end CHARACTERISTIC
/begin CHARACTERISTIC CEL_DYN_F1 "CEL_DYN_F1" VALUE 0x4843c a_174 100 LINEAR______0_000000__0H___65190 0.0 65535.0 BIT_MASK 0xffffffff /end CHARACTERISTIC
/begin CHARACTERISTIC CEL_DYN_F2 "CEL_DYN_F2" VALUE 0x4843e a_174 100 LINEAR______0_000000__0H___65190 0.0 65535.0 BIT_MASK 0xffffffff /end CHARACTERISTIC
/begin CHARACTERISTIC CEL_FILT "CEL_FILT" VALUE 0x480ba a_172 100 LINEAR_______32768_000000__FFFF8 -32768.0 32767.0 BIT_MASK 0xffffffff /end CHARACTERISTIC
/begin CHARACTERISTIC CELL_LIMIT "CELL_LIMIT" VALUE 0x480bc a_172 100 LINEAR_______32768_000000__FF180 -32768.0 32767.0 BIT_MASK 0xffffffff /end CHARACTERISTIC
/begin CHARACTERISTIC CELL_PERCENT "CELL_PERCENT" VALUE 0x48440 a_174 100 LINEAR______0_000000__0H___65190 0.0 65535.0 BIT_MASK 0xffffffff /end CHARACTERISTIC
/begin CHARACTERISTIC code_chksum_ke "CODE_CHKSUM_KE" VALUE 0x48442 a_174 100 LINEAR______0_000000__0H___65163 0.0 65535.0 BIT_MASK 0xffffffff /end CHARACTERISTIC
/begin CHARACTERISTIC ddt_schw "DDT_SCHW" VALUE 0x48444 a_174 10 LINEAR______0_000000__0H___10_24 0.0 10.24 BIT_MASK 0xffffffff /end CHARACTERISTIC
/begin CHARACTERISTIC DECIDE_CHANGE_MOVEMENT_LIMIT "DECIDE_CHANGE_MOVEMENT_LIMIT" VALUE 0x480be a_172 100 LINEAR_______32768_000000__FF180 -32768.0 32767.0 BIT_MASK 0xffffffff /end CHARACTERISTIC
/begin CHARACTERISTIC DECIDE_MOVEMENT_LIMIT "DECIDE_MOVEMENT_LIMIT" VALUE 0x480c0 a_172 100 LINEAR_______32768_000000__FF180 -32768.0 32767.0 BIT_MASK 0xffffffff /end CHARACTERISTIC
/begin CHARACTERISTIC DECT_MS "DECT_MS" VALUE 0x480c2 a_172 100 LINEAR_______32768_000000__FF180 -32768.0 32767.0 BIT_MASK 0xffffffff /end CHARACTERISTIC
/begin CHARACTERISTIC DES_VERSIONC0D "" VALUE 0x0 a_173 100 defaultConversion 0 255 BIT_MASK 0xffffffff /end CHARACTERISTIC
/begin CHARACTERISTIC DES_VERSIONC1D "" VALUE 0x1 a_173 100 defaultConversion191 0 255 BIT_MASK 0xffffffff /end CHARACTERISTIC
/begin AXIS_PTS sstm_t_anst_fgr "T_ANST_FGR" 0x48865 t_anst_fgr a_892 100 LINEAR______0_000000__0H___25_50 5 0.0 25.5 /end AXIS_PTS
/begin AXIS_PTS sstm_n_1_28 "N" 0x490b8 drehzahl a_893 100 IS_13_RES 6 0.0 8160.0 /end AXIS_PTS
/begin AXIS_PTS sstm_tkw_1_5 "TKW" 0x4889a tkw a_892 15 LINEAR_______48_000000__0H___114 8 -48.0 142.5 /end AXIS_PTS
/begin AXIS_PTS sstm_lm_1_9 "LM" 0x488b4 lm_kr a_892 5 MAF_8_RES 4 0.0 1389.0 /end AXIS_PTS
/begin AXIS_PTS sstm_n_2_9 "N" 0x488a3 n_kr a_892 20 ES_8_RES8 16 0.0 8160.0 /end AXIS_PTS
/begin AXIS_PTS sstm_tkw_1_6 "TKW" 0x488d8 tkw a_892 15 LINEAR_______48_000000__0H___121 6 -48.0 142.5 /end AXIS_PTS
/begin AXIS_PTS sstm_n_3_9 "N" 0x48962 drehzahl a_892 20 ES_8_RES8 8 0.0 8160.0 /end AXIS_PTS
/begin AXIS_PTS sstm_vsoll_fgr "VSOLL_FGR" 0x49196 v_soll_fgr a_893 100 LINEAR______0_000000__0H___511_9 5 0.0 511.99218 /end AXIS_PTS
/begin AXIS_PTS sstm_n_1_8 "N" 0x48a0b drehzahl a_892 10 ES_8_RES8 10 0.0 8160.0 /end AXIS_PTS
/begin AXIS_PTS sstm_tkw_21_7 "TKW" 0x48a29 tkw a_892 15 LINEAR_______48_000000__0H___114 8 -48.0 142.5 /end AXIS_PTS
/begin AXIS_PTS sstm_n_kf_tors_0_at "N" 0x48a4d n_32 a_892 100 ES_8_RES17 6 0.0 8160.0 /end AXIS_PTS
/begin AXIS_PTS sstm_n_kf_tors_0_mt "N" 0x48a5b n_32 a_892 100 ES_8_RES17 6 0.0 8160.0 /end AXIS_PTS
/begin AXIS_PTS sstm_n_kf_tors_1_at "N" 0x48a69 n_32 a_892 100 ES_8_RES17 6 0.0 8160.0 /end AXIS_PTS
/begin AXIS_PTS sstm_n_kf_tors_1_mt "N" 0x48a77 n_32 a_892 100 ES_8_RES17 6 0.0 8160.0 /end AXIS_PTS
/begin AXIS_PTS sstm_n_kf_tors_2_at "N" 0x48a85 n_32 a_892 100 ES_8_RES17 6 0.0 8160.0 /end AXIS_PTS
/begin AXIS_PTS sstm_n_kf_tors_2_mt "N" 0x48a93 n_32 a_892 100 ES_8_RES17 6 0.0 8160.0 /end AXIS_PTS
/begin AXIS_PTS sstm_n_kf_tors_3_at "N" 0x48aa1 n_32 a_892 100 ES_8_RES17 6 0.0 8160.0 /end AXIS_PTS
/begin AXIS_PTS sstm_n_kf_tors_3_mt "N" 0x48aaf n_32 a_892 100 ES_8_RES17 6 0.0 8160.0 /end AXIS_PTS
/begin AXIS_PTS sstm_n_kf_tors_4_at "N" 0x48abd n_32 a_892 100 ES_8_RES17 6 0.0 8160.0 /end AXIS_PTS
/begin AXIS_PTS sstm_n_kf_tors_4_mt "N" 0x48acb n_32 a_892 100 ES_8_RES17 6 0.0 8160.0 /end AXIS_PTS
/begin AXIS_PTS sstm_n_kf_tors_5_at "N" 0x48ad9 n_32 a_892 100 ES_8_RES17 6 0.0 8160.0 /end AXIS_PTS
/begin AXIS_PTS sstm_n_kf_tors_5_mt "N" 0x48ae7 n_32 a_892 100 ES_8_RES17 6 0.0 8160.0 /end AXIS_PTS
/begin AXIS_PTS sstm_gang_6_1 "GANG" 0x48b12 gang a_892 10 LINEAR______0_000000__0H___7_000 6 0.0 7.0 /end AXIS_PTS
/begin AXIS_PTS sstm_temp_kat_6_1 "TEMP_GMW_ERS_KAT" 0x48b62 temp_gmw_ers_kat a_892 100 LINEAR_______33_000000__0H___990 6 -33.0 990.0 /end AXIS_PTS
/begin AXIS_PTS sstm_tkw_2_6 "TKW" 0x48b7e tkw a_892 15 LINEAR_______48_000000__0H___114 4 -48.0 142.5 /end AXIS_PTS
/begin AXIS_PTS sstm_n_3_4 "N" 0x49370 drehzahl a_893 10 IS_13_RES84 6 0.0 8160.0 /end AXIS_PTS
/begin AXIS_PTS sstm_tmag_9_7 "TMAG" 0x48c54 tab_tmag a_892 100 LINEAR_______48_000000__0H___155 6 -48.0 155.0 /end AXIS_PTS
/begin AXIS_PTS sstm_n_dif_kor_6_6 "N_DIF_KOR" 0x49406 n_dif_kor a_893 5 LINEAR_______1024_000000__7C00H_ 12 -1024.0 1016.0 /end AXIS_PTS
/begin AXIS_PTS sstm_n_2_5 "N" 0x4943a drehzahl a_893 10 IS_13_RES 3 0.0 8160.0 /end AXIS_PTS
/begin AXIS_PTS sstm_vue_kf_xxx_vue_xxx "VUE" 0x49442 vue a_893 100 LINEAR______0_000000__0H___12099 8 0.0 120.0 /end AXIS_PTS
/begin AXIS_PTS sstm_tkw_6_1 "TKW" 0x48cc9 tkw a_892 100 LINEAR_______48_000000__0H___100 8 -48.0 142.5 /end AXIS_PTS
/begin AXIS_PTS sstm_lm_kg_h_2_22 "LM_KG_H" 0x4946a lm_kg_h a_893 10 MAF_KGH_16_RES15 8 0.0 16383.75 /end AXIS_PTS
/begin AXIS_PTS sstm_n_21_7 "N" 0x48d07 drehzahl a_892 100 ES_8_RES8 8 0.0 8160.0 /end AXIS_PTS
/begin AXIS_PTS sstm_dk_21_7 "DK" 0x48d1d dk a_892 30 LINEAR______0_000000__0H___11959 12 0.0 119.5 /end AXIS_PTS
/begin AXIS_PTS sstm_vue_1_7 "VUE" 0x494ac vue a_893 100 LINEAR______0_000000__0H___120_0 8 0.0 120.0 /end AXIS_PTS
/begin AXIS_PTS sstm_t_ns_1_8 "T_NS" 0x494be zeit_nach_start a_893 15 LINEAR______0_000000__0H___6553_ 8 0.0 6553.5 /end AXIS_PTS
/begin AXIS_PTS sstm_tkw_1_22 "TKW" 0x48d2a tkw a_892 15 LINEAR_______48_000000__0H___121 8 -48.0 142.5 /end AXIS_PTS
/begin AXIS_PTS sstm_t_ns_2_8 "T_NS" 0x494d0 ti_ns a_893 15 LINEAR______0_000000__0H___6553_ 8 0.0 6553.5 /end AXIS_PTS
/begin AXIS_PTS sstm_tkw_2_4 "TKW" 0x48d33 tkw a_892 15 LINEAR_______48_000000__0H___142 8 -48.0 142.5 /end AXIS_PTS
/begin AXIS_PTS sstm_lm_23_7 "LM" 0x48d3c lm a_892 5 MAF_8_RES 8 0.0 1389.0 /end AXIS_PTS
/begin AXIS_PTS sst_lm_kf_ti_fwl "LM" 0x48d4e lm a_892 5 MAF_8_RES 8 0.0 1389.0 /end AXIS_PTS
/begin AXIS_PTS sst_n_kf_ti_fwl "N" 0x48d45 drehzahl a_892 10 ES_8_RES8 8 0.0 8160.0 /end AXIS_PTS
/begin AXIS_PTS sst_t_kf_ti_inc_ks "TIME" 0x48d5c dummy a_892 100 LINEAR______0_000000__0H___25108 4 0.0 255.0 /end AXIS_PTS
/begin AXIS_PTS sst_zw_dif_kf_ti_inc_ks "ZW_DIF" 0x48d57 dummy a_892 100 LINEAR______0_000000__0H___95_62 4 0.0 95.625 /end AXIS_PTS
/begin AXIS_PTS sstm_lm_6_4 "LM" 0x48d6a lm a_892 5 MAF_8_RES 8 0.0 1389.0 /end AXIS_PTS
/begin AXIS_PTS sstm_n_5_4 "N" 0x48d61 drehzahl a_892 10 ES_8_RES8 8 0.0 8160.0 /end AXIS_PTS
/begin AXIS_PTS sst_lm_kf_ti_katv "LM" 0x48d7a lm a_892 15 MAF_8_RES 6 0.0 1389.0 /end AXIS_PTS
/begin AXIS_PTS sst_n_kf_ti_katv "N" 0x48d73 drehzahl a_892 13 ES_8_RES8 6 0.0 8160.0 /end AXIS_PTS
/begin AXIS_PTS sst_tkw_kf_ti_katv_fak "TKW" 0x48d81 tkw a_892 100 LINEAR_______48_000000__0H___133 2 -48.0 142.5 /end AXIS_PTS
/begin AXIS_PTS sst_tal_kf_ti_kns "TAL" 0x48d84 tal a_892 15 LINEAR_______48_000000__0H___114 2 -48.0 142.5 /end AXIS_PTS
/begin AXIS_PTS sstm_lm_kf_ti_ks "LM" 0x48d87 lm a_892 10 MAF_8_RES40 8 0.0 1389.0 /end AXIS_PTS
/begin AXIS_PTS sst_fak_pu_kf_ti_kst_pu_kor "FAK_PU" 0x48d90 fak_pu a_892 100 LINEAR______0_000000__0H___1_992 6 0.0 1.9922 /end AXIS_PTS
/begin AXIS_PTS sst_n_dif_kor_kf_ti_ll "N_DIF_KOR" 0x494e2 n_dif_kor a_893 5 LINEAR_______1024_000000__7C00H_ 6 -1024.0 1016.0 /end AXIS_PTS
/begin AXIS_PTS sstm_tkw_kf_ti_xwf_min "TKW" 0x48d97 tkw a_892 100 LINEAR_______48_000000__0H___142 4 -48.0 142.5 /end AXIS_PTS
/begin AXIS_PTS sst_fak_pu_kf_ti_pu_kor "FAK_PU" 0x48d9c fak_pu a_892 100 LINEAR______0_000000__0H___2_112 6 0.0 2.0 /end AXIS_PTS
/begin AXIS_PTS sst_tkw_st_ti_tkw_wl "TKW_ST" 0x48dac tkw_st a_892 15 LINEAR_______48_000000__0H___114 3 -48.0 142.5 /end AXIS_PTS
/begin AXIS_PTS sstm_tkw_4_4 "TKW" 0x48da3 tkw a_892 15 LINEAR_______48_000000__0H___114 8 -48.0 142.5 /end AXIS_PTS
/begin AXIS_PTS sstm_lm_1_28 "LM" 0x494f0 lm a_893 100 MAF_16_RES79 6 0.0 1389.0 /end AXIS_PTS
/begin AXIS_PTS sstm_lm_4_7 "LM" 0x49520 lm a_893 100 MAF_16_RES79 12 0.0 1389.0 /end AXIS_PTS
/begin AXIS_PTS sstm_n_4_7 "N" 0x494fe drehzahl a_893 100 IS_13_RES 16 0.0 8160.0 /end AXIS_PTS
/begin AXIS_PTS sst_utkw_kf_tkw "UTKW" 0x4953a dummy a_893 90 LINEAR______0_078000__10H___4_99 16 0.078 4.995 /end AXIS_PTS
/begin AXIS_PTS sst_lm_kg_h_kf_tkw_ers_inc "LM_KG_H" 0x4955c lm_kg_h a_893 5 LINEAR______0_250000__1H___16383 4 0.25 16383.75 /end AXIS_PTS
/begin AXIS_PTS sst_tkw_kf_tmag "TKW" 0x48dbb tkw a_892 100 LINEAR_______48_000000__0H___189 10 -48.0 142.5 /end AXIS_PTS
/begin AXIS_PTS sst_toel_kf_tmag "TOEL" 0x48db0 toel a_892 100 LINEAR_______48_000000__0H___156 10 -48.0 155.0 /end AXIS_PTS
/begin AXIS_PTS sst_tal_kf_tmdk "TAL" 0x48dcd tal a_892 100 LINEAR_______48_000000__0H___121 6 -48.0 142.5 /end AXIS_PTS
/begin AXIS_PTS sst_tkw_kf_tmdk "TKW" 0x48dc6 tkw a_892 100 LINEAR_______48_000000__0H___142 6 -48.0 142.5 /end AXIS_PTS
/begin AXIS_PTS sstm_n_1_7 "N" 0x49566 drehzahl a_893 100 IS_13_RES114 10 0.0 8160.0 /end AXIS_PTS
/begin AXIS_PTS sstm_lm_kf_tn_grd_st_ar "LM" 0x48dd4 lm a_892 5 MAF_8_RES40 3 0.0 1389.0 /end AXIS_PTS
/begin AXIS_PTS sst_utoel_toel "UTOEL" 0x48dd8 dummy a_892 100 LINEAR______0_000000__0H___5_000 16 0.0 5.0 /end AXIS_PTS
/begin AXIS_PTS sstm_n_4_5 "N" 0x48de9 n_32 a_892 10 ES_8_RES 4 0.0 8160.0 /end AXIS_PTS
/begin AXIS_PTS sstm_n_6_2 "N" 0x48dee drehzahl a_892 100 ES_8_RES41 6 0.0 8160.0 /end AXIS_PTS
/begin AXIS_PTS sst_n_kf_tv_bab_max_ll "N" 0x48df5 n_32 a_892 10 ES_8_RES116 3 0.0 8160.0 /end AXIS_PTS
/begin AXIS_PTS sst_lm_kg_h_kf_uls_kat_max_zyka "LM_KG_H" 0x4957c lm_kg_h a_893 100 MAF_KGH_16_RES117 8 0.0 16383.75 /end AXIS_PTS
/begin AXIS_PTS sstm_lm_kf_uls_max_zyka "LM" 0x4958e lm a_893 5 MAF_16_RES79 8 0.0 1389.0 /end AXIS_PTS
/begin AXIS_PTS sstm_n_1_22 "N" 0x48df9 drehzahl a_892 10 ES_8_RES8 8 0.0 8160.0 /end AXIS_PTS
/begin AXIS_PTS sst_lm_kf_uls_soll_zv "LM" 0x48e07 lm a_892 100 MAF_8_RES37 4 0.0 1389.0 /end AXIS_PTS
/begin AXIS_PTS sst_n_kf_uls_soll_zv "N" 0x48e02 n_32 a_892 100 ES_8_RES17 4 0.0 8160.0 /end AXIS_PTS
/begin AXIS_PTS sstm_lm_gem_kf_vsr "LM_GEM" 0x48e13 lm_gem a_892 100 MAF_8_RES37 6 0.0 1389.0 /end AXIS_PTS
/begin AXIS_PTS sstm_n_32_kf_vsr "N" 0x48e0c n_32 a_892 100 ES_8_RES17 6 0.0 8160.0 /end AXIS_PTS
/begin AXIS_PTS sst_lm_kf_wf_auss_a "LM" 0x48e21 lm a_892 10 MAF_8_RES 6 0.0 1389.0 /end AXIS_PTS
/begin AXIS_PTS sst_n_kf_wf_auss_a "N" 0x48e1a drehzahl a_892 5 ES_8_RES8 6 0.0 8160.0 /end AXIS_PTS
/begin AXIS_PTS sst_lm_kf_wf_lu "LM" 0x48e2f lm a_892 100 MAF_8_RES40 6 0.0 1389.0 /end AXIS_PTS
/begin AXIS_PTS sst_n_kf_wf_lu "N" 0x48e28 n_32 a_892 100 ES_8_RES41 6 0.0 8160.0 /end AXIS_PTS
/begin AXIS_PTS sst_lm_kf_wf_zsr "LM" 0x48e3d lm a_892 100 MAF_8_RES40 6 0.0 1389.0 /end AXIS_PTS
/begin AXIS_PTS sst_n_kf_wf_zsr "N" 0x48e36 n_32 a_892 100 ES_8_RES8 6 0.0 8160.0 /end AXIS_PTS
/begin AXIS_PTS sst_lm_kf_zsi_soll "LM" 0x48e4b lm a_892 7 MAF_8_RES 6 0.0 1389.0 /end AXIS_PTS
/begin AXIS_PTS sst_n_kf_zsi_soll "N" 0x48e44 drehzahl a_892 25 ES_8_RES8 6 0.0 8160.0 /end AXIS_PTS
/begin AXIS_PTS sst_tkw_kf_zw_ad_roz_max "TKW" 0x48e57 tkw a_892 15 LINEAR_______48_000000__0H___114 4 -48.0 142.5 /end AXIS_PTS
/begin AXIS_PTS sst_tal_kf_zw_ad_roz_max "TAL" 0x48e52 tal a_892 15 LINEAR_______48_000000__0H___114 4 -48.0 142.5 /end AXIS_PTS
/begin AXIS_PTS sstm_n_4_1 "N" 0x495a0 drehzahl a_893 10 IS_13_RES 4 0.0 8160.0 /end AXIS_PTS
/begin AXIS_PTS sst_ngrd_kf_zw_aebg_well "NGRD" 0x48e5c dummy a_892 1 LINEAR_______4096_000000__0H___4 4 -4096.0 4064.0 /end AXIS_PTS
/begin AXIS_PTS sst_lm_zw_ar "LM" 0x48e6a lm a_892 5 MAF_8_RES 6 0.0 1389.0 /end AXIS_PTS
/begin AXIS_PTS sst_n_zw_ar "N" 0x48e61 drehzahl a_892 10 ES_8_RES8 8 0.0 8160.0 /end AXIS_PTS
/begin AXIS_PTS sst_dmdk_kf_zw_best_dif "DMDK" 0x48e71 dummy a_892 100 LINEAR______0_000000__0H___11125 4 0.0 119.5 /end AXIS_PTS
/begin AXIS_PTS sstm_lm_zw_12_1 "LM_ZW" 0x495cc lm_zw a_893 100 MAF_16_RES49 12 0.0 1389.0 /end AXIS_PTS
/begin AXIS_PTS sstm_n_16_2 "N" 0x495aa drehzahl a_893 100 IS_13_RES62 16 0.0 8160.0 /end AXIS_PTS
/begin AXIS_PTS sst_mdz_fak_kf_zw_dif_mdz "MDZ_FAK" 0x495e6 dummy a_893 20 LINEAR______0_000000__0H___1_128 8 0.0 1.0 /end AXIS_PTS
/begin AXIS_PTS sstm_t_ns_1_3 "T_NS" 0x495f8 dummy a_893 15 LINEAR______0_000000__0H___65130 8 0.0 6553.5 /end AXIS_PTS
/begin AXIS_PTS sstm_tkw_2_3 "TKW" 0x48e76 dummy a_892 10 LINEAR_______48_000000__0H___142 8 -48.0 142.5 /end AXIS_PTS
/begin AXIS_PTS sst_roz_fak_kf_zw_inst_fak "ZW_KR_AD_ROZ" 0x48e84 zw_kr_ad_roz a_892 10 LINEAR______0_000000__0H___1_131 3 0.0 1.0 /end AXIS_PTS
/begin AXIS_PTS sst_tal_kf_zw_inst_fak "TAL" 0x48e7f tal a_892 10 LINEAR_______48_000000__0H___133 4 -48.0 142.5 /end AXIS_PTS
/begin AXIS_PTS sst_lm_zw_tab_zw_inst_kr "LM_ZW" 0x48e8d lm_zw a_892 5 MAF_8_RES40 4 0.0 1389.0 /end AXIS_PTS
/begin AXIS_PTS sstm_n_4_4 "N" 0x48e88 drehzahl a_892 20 ES_8_RES8 4 0.0 8160.0 /end AXIS_PTS
/begin AXIS_PTS sstm_lm_8_1 "LM" 0x48e9b lm a_892 5 MAF_8_RES 8 0.0 1389.0 /end AXIS_PTS
/begin AXIS_PTS sstm_n_8_2 "N" 0x48e92 drehzahl a_892 100 ES_8_RES 8 0.0 8160.0 /end AXIS_PTS
/begin AXIS_PTS sst_n_kf_zw_kat_ll "N" 0x48ea4 drehzahl a_892 10 ES_8_RES8 4 0.0 8160.0 /end AXIS_PTS
/begin AXIS_PTS sst_pwg_ist_kf_zw_kat2 "PWG_IST" 0x48eb2 pwg_ist a_892 5 LINEAR______0_000000__0H___11135 8 0.0 119.5 /end AXIS_PTS
/begin AXIS_PTS sst_n_kf_zw_kat2 "N" 0x48ea9 n_32 a_892 10 ES_8_RES41 8 0.0 8160.0 /end AXIS_PTS
/begin AXIS_PTS sstm_nw_dif_10_1 "NW_DIF" 0x48ebb dummy a_892 100 LINEAR_______48_000000__0H___137 10 -48.0 47.625 /end AXIS_PTS
/begin AXIS_PTS sst_lm_kf_zw_kr_dg "LM" 0x48ec6 lm_kr a_892 5 MAF_8_RES 8 0.0 1389.0 /end AXIS_PTS
/begin AXIS_PTS sst_lm_kf_zw_lm_n "LM_ZW" 0x48ed8 lm_zw a_892 5 MAF_8_RES40 6 0.0 1389.0 /end AXIS_PTS
/begin AXIS_PTS sst_n_kf_zw_lm_n "N" 0x48ecf drehzahl a_892 10 ES_8_RES8 8 0.0 8160.0 /end AXIS_PTS
/begin AXIS_PTS sst_lm_kf_zw_lm_n_ll "LM_ZW" 0x48ee4 lm_zw a_892 5 MAF_8_RES37 4 0.0 1389.0 /end AXIS_PTS
/begin AXIS_PTS sst_n_kf_zw_lm_n_ll "N" 0x48edf n_32 a_892 10 ES_8_RES 4 0.0 8160.0 /end AXIS_PTS
/begin AXIS_PTS sstm_lm_2_3 "LM" 0x48ef3 lm a_892 10 MAF_8_RES 8 0.0 1389.0 /end AXIS_PTS
/begin AXIS_PTS sstm_n_5_3 "N" 0x48ee9 drehzahl a_892 20 ES_8_RES8 9 0.0 8160.0 /end AXIS_PTS
/begin AXIS_PTS sst_n_dif_kor_kf_zw_ns "N_DIF_KOR" 0x4960a n_dif_kor a_893 5 LINEAR_______1024_000000__7C00H_ 4 -1024.0 1016.0 /end AXIS_PTS
/begin AXIS_PTS sstm_lm_zw_kf_zw_tkw_vanos_tl "LM_ZW" 0x4963e lm_zw a_893 100 MAF_16_RES49 16 0.0 1389.0 /end AXIS_PTS
/begin AXIS_PTS sstm_n_kf_zw_tkw_vanos_tl "N" 0x49614 drehzahl a_893 100 IS_13_RES84 20 0.0 8160.0 /end AXIS_PTS
/begin AXIS_PTS sstm_lm_2_1 "LM" 0x48ba1 lm a_892 10 MAF_8_RES40 2 0.0 1389.0 /end AXIS_PTS
/begin AXIS_PTS sstm_tallfs_5_1 "TALLFS" 0x48b9b tallfs a_892 10 LINEAR______0_000000__0H___99_61 5 0.0 99.610001 /end AXIS_PTS
/begin AXIS_PTS sstm_t_ns_kf_zw_tkw_kat "T_NS" 0x49660 dummy a_893 15 LINEAR______0_000000__0H___65130 8 0.0 6553.5 /end AXIS_PTS
/begin AXIS_PTS sstm_tkw_kf_zw_tkw_kat "TKW" 0x48efc dummy a_892 10 LINEAR_______48_000000__0H___142 8 -48.0 142.5 /end AXIS_PTS
/begin AXIS_PTS sst_lm_kf_zwb_ll "LM" 0x4967c lm a_893 5 MAF_16_RES79 4 0.0 1389.0 /end AXIS_PTS
/begin AXIS_PTS sst_n_kf_zwb_ll "N" 0x49672 drehzahl a_893 15 IS_13_RES 4 0.0 8160.0 /end AXIS_PTS
/begin AXIS_PTS sstm_tkw_5_4 "TKW" 0x48f05 tkw a_892 10 LINEAR_______48_000000__0H___133 4 -48.0 142.5 /end AXIS_PTS
/begin AXIS_PTS sstm_toel_tab_totz_t_12 "TOEL" 0x48f0a toel a_892 100 LINEAR_______48_000000__0H___156 6 -48.0 155.0 /end AXIS_PTS
/begin AXIS_PTS sstm_t_per_ldp "T_PER_LDP" 0x49686 t_per_ldp a_893 100 LINEAR______0_000000__0H___655_3 6 0.0 655.34998 /end AXIS_PTS
/begin AXIS_PTS sst_temp_ers_kat_tab_auss_a_obd "TEMP_GMW_ERS_KAT" 0x49694 temp_gmw_ers_kat a_893 100 LINEAR_______33_000000__0H___144 6 -33.0 990.0 /end AXIS_PTS
/begin AXIS_PTS sst_lm_tab_disa_tl "LM" 0x496b4 lm a_893 10 MAF_16_RES146 6 0.0 1389.0 /end AXIS_PTS
/begin AXIS_PTS sstm_n_disa_1 "N_DISA" 0x496a2 drehzahl a_893 100 IS_13_RES62 8 0.0 8160.0 /end AXIS_PTS
/begin AXIS_PTS sst_n_disa_tab_dk_vl_disa "N" 0x496c2 drehzahl a_893 100 IS_13_RES 8 0.0 8160.0 /end AXIS_PTS
/begin AXIS_PTS sstm_zyka_16_1 "ZYKA" 0x48f11 dummy a_892 100 LINEAR______1_000000__1H___16_00 16 1.0 16.0 /end AXIS_PTS
/begin AXIS_PTS sstm_ub_gmw_1_6 "UB_GMW" 0x48f22 ubat_gmw a_892 8 LINEAR______0_000000__0H___26_82 2 0.0 26.0 /end AXIS_PTS
/begin AXIS_PTS sst_n_v_fgr_tab_gang "N_V_FGR" 0x496d4 n_v_fgr a_893 100 LINEAR______0_000000__0H___16320 6 0.0 16320.0 /end AXIS_PTS
/begin AXIS_PTS sst_tal_tab_krs_fak_schw "TAL" 0x48f25 tal a_892 100 LINEAR_______48_000000__0H___121 6 -48.0 142.5 /end AXIS_PTS
/begin AXIS_PTS sst_toil_max_tab_ksd_dec "TOIL_MAX" 0x48f2c toil_max a_892 100 LINEAR_______48_000000__0H___150 4 -48.0 155.0 /end AXIS_PTS
/begin AXIS_PTS sst_tkw_st "TKW_ST" 0x48f31 dummy a_892 100 LINEAR_______48_000000__0H___114 4 -48.0 142.5 /end AXIS_PTS
/begin AXIS_PTS sstm_tkw_1_8 "TKW_ST" 0x48f36 tkw_st a_892 14 LINEAR_______48_000000__0H___114 6 -48.0 142.5 /end AXIS_PTS
/begin AXIS_PTS sst_n_tab_mitko_lm_diag "N" 0x48f3d n_32 a_892 100 ES_8_RES 4 0.0 8160.0 /end AXIS_PTS
/begin AXIS_PTS sst_n_el_tab_n_el_min_kk "N_EL" 0x48f42 dummy a_892 100 LINEAR______0_000000__0H___15_00 16 0.0 15.0 /end AXIS_PTS
/begin AXIS_PTS sstm_ntv_at_1_3 "N/TV" 0x496e2 n_v_fgr a_893 100 LINEAR______0_000000__0H___16153 3 0.0 16320.0 /end AXIS_PTS
/begin AXIS_PTS sstm_ntv_mt_1_3 "N/TV" 0x496ea n_v_fgr a_893 100 LINEAR______0_000000__0H___16153 3 0.0 16320.0 /end AXIS_PTS
/begin AXIS_PTS sst_tv_tab_nmax_zyka "TV" 0x48f53 geschwind a_892 12 LINEAR______0_000000__0H___25147 5 0.0 255.0 /end AXIS_PTS
/begin AXIS_PTS sst_n_tab_nmax_zyka_diag "N" 0x48f59 n_32 a_892 100 ES_8_RES41 4 0.0 8160.0 /end AXIS_PTS
/begin AXIS_PTS sst_lm_tab_o2_int_max_at "LM" 0x48f65 lm a_892 10 MAF_8_RES40 6 0.0 1389.0 /end AXIS_PTS
/begin AXIS_PTS sst_n_tab_o2_int_max_at "N" 0x48f5e n_32 a_892 10 ES_8_RES41 6 0.0 8160.0 /end AXIS_PTS
/begin AXIS_PTS sst_lm_tab_o2_int_max_mt "LM" 0x48f73 lm a_892 10 MAF_8_RES40 6 0.0 1389.0 /end AXIS_PTS
/begin AXIS_PTS sst_n_tab_o2_int_max_mt "N" 0x48f6c n_32 a_892 10 ES_8_RES41 6 0.0 8160.0 /end AXIS_PTS
/begin AXIS_PTS sst_nr_patt_tab_patt_za "NR_PATT" 0x48f7a dummy a_892 100 LINEAR______0_000000__0H___13_00 14 0.0 13.0 /end AXIS_PTS
/begin AXIS_PTS sstm_tkw_st_8_1 "TKW_ST" 0x48f89 tkw_st a_892 15 LINEAR_______48_000000__0H___121 8 -48.0 142.5 /end AXIS_PTS
/begin AXIS_PTS sstm_tkw_st_2_1 "TKW_ST" 0x48f92 tkw_st a_892 15 LINEAR_______48_000000__0H___142 8 -48.0 142.5 /end AXIS_PTS
/begin AXIS_PTS sst_tkw_tab_t_sa_verz_tkw__tkw "TKW" 0x48f9b tkw a_892 20 LINEAR_______48_000000__0H___142 4 -48.0 142.5 /end AXIS_PTS
/begin AXIS_PTS sstm_n_slow_s "N" 0x48fa0 n_32 a_892 100 ES_8_RES116 6 0.0 8160.0 /end AXIS_PTS
/begin AXIS_PTS sstm_tkw_st_8_2 "TKW_ST" 0x48fa7 tkw_st a_892 15 LINEAR_______48_000000__0H___121 8 -48.0 142.5 /end AXIS_PTS
/begin AXIS_PTS sst_tkw_t_slp_ein "TKW" 0x48fb0 tkw a_892 15 LINEAR_______48_000000__0H___121 8 -48.0 142.5 /end AXIS_PTS
/begin AXIS_PTS sst_tkw_t_slv_ein "TKW" 0x48fb9 tkw a_892 15 LINEAR_______48_000000__0H___142 8 -48.0 142.5 /end AXIS_PTS
/begin AXIS_PTS sst_tkw_tab_t_wait_diag_sl "TKW" 0x48fc2 tkw a_892 15 LINEAR_______48_000000__0H___114 8 -48.0 142.5 /end AXIS_PTS
/begin AXIS_PTS sst_lm_tab_t_zsr_min "LM" 0x48fd4 lm a_892 5 MAF_8_RES 6 0.0 1389.0 /end AXIS_PTS
/begin AXIS_PTS sst_n_tab_t_zsr_min "N" 0x48fcb drehzahl a_892 20 ES_8_RES8 8 0.0 8160.0 /end AXIS_PTS
/begin AXIS_PTS sst_v_drift_tah_kor_ad_van "V_DRIFT" 0x48fdb dummy a_892 100 LINEAR______0_000000__0H___95161 6 0.0 95.625 /end AXIS_PTS
/begin AXIS_PTS sst_tkw_soll_tab_takfk_add "TKW_SOLL" 0x48feb dummy a_892 100 LINEAR_______48_000000__0H___133 8 -48.0 142.5 /end AXIS_PTS
/begin AXIS_PTS sst_n_tab_takfk_add "N" 0x48fe2 drehzahl a_892 100 ES_8_RES8 8 0.0 8160.0 /end AXIS_PTS
/begin AXIS_PTS sstm_tkw_lsh "TKW" 0x48ff9 tkw a_892 100 LINEAR_______48_000000__0H___142 4 -48.0 142.5 /end AXIS_PTS
/begin AXIS_PTS sstm_tal_lsh "TAL" 0x48ff4 tal a_892 100 LINEAR_______48_000000__0H___142 4 -48.0 142.5 /end AXIS_PTS
/begin AXIS_PTS sstm_lm_tab_talsh_xkaty "LM" 0x49007 lm a_892 100 MAF_8_RES37 6 0.0 1389.0 /end AXIS_PTS
/begin AXIS_PTS sstm_n_tab_talsh_xkaty "N" 0x48ffe n_32 a_892 100 ES_8_RES 8 0.0 8160.0 /end AXIS_PTS
/begin AXIS_PTS sstm_lm_kgh_lsh_t "LM_KG_H" 0x496f2 lm_kg_h a_893 100 MAF_KGH_16_RES117 6 0.0 16383.75 /end AXIS_PTS
/begin AXIS_PTS sst_tkw_st_tab_temp_gmw_ini_kat "TKW_ST" 0x4900e tkw_st a_892 10 LINEAR_______48_000000__0H___121 6 -48.0 142.5 /end AXIS_PTS
/begin AXIS_PTS sst_tal_tab_temp_sond_inc "TAL" 0x49015 tal a_892 100 LINEAR_______48_000000__0H___142 4 -48.0 142.5 /end AXIS_PTS
/begin AXIS_PTS sstm_n_8_3 "N" 0x4901a n_32 a_892 100 ES_8_RES 8 0.0 8160.0 /end AXIS_PTS
/begin AXIS_PTS sst_n_tab_ti_kor_zyl_aus "N" 0x49023 n_32 a_892 100 ES_8_RES8 4 0.0 8160.0 /end AXIS_PTS
/begin AXIS_PTS sstm_tkw_4_8 "TKW" 0x49028 tkw a_892 15 LINEAR_______48_000000__0H___121 8 -48.0 142.5 /end AXIS_PTS
/begin AXIS_PTS sstm_lm_ers_diag_6_1 "LM_ERS_DIAG" 0x4903e lm_ers_diag a_892 100 MAF_8_RES40 6 0.0 1389.0 /end AXIS_PTS
/begin AXIS_PTS sstm_n_12_1 "N" 0x49031 n_32 a_892 100 ES_8_RES41 12 0.0 8160.0 /end AXIS_PTS
/begin AXIS_PTS sst_v_fil_tab_tv_dif_bab "V_FIL" 0x49700 v_fil a_893 100 LINEAR______0_000000__0H___511_9 2 0.0 511.99218 /end AXIS_PTS
/begin AXIS_PTS sst_lm_kg_h_tab_uls_down_mitko "LM_KG_H" 0x49706 lm_kg_h a_893 100 MAF_KGH_16_RES117 4 0.0 16383.75 /end AXIS_PTS
/begin AXIS_PTS sst_n_tab_verz_n "N" 0x49045 n_32 a_892 100 ES_8_RES 4 0.0 8160.0 /end AXIS_PTS
/begin AXIS_PTS sstm_n_1_3 "N" 0x4904a drehzahl a_892 100 ES_8_RES8 8 0.0 8160.0 /end AXIS_PTS
/begin AXIS_PTS sst_n_tab_zw_aebg_wetl "N" 0x49053 drehzahl a_892 10 ES_8_RES8 4 0.0 8160.0 /end AXIS_PTS
/begin AXIS_PTS sstm_n_4_9 "N" 0x49058 n_kr a_892 10 ES_8_RES8 6 0.0 8160.0 /end AXIS_PTS
/begin AXIS_PTS sstm_tkw_1_4 "TKW" 0x49064 tkw a_892 15 LINEAR_______48_000000__0H___114 6 -48.0 142.5 /end AXIS_PTS
/begin AXIS_PTS sst_n_tab_zw_wetl "N" 0x4905f drehzahl a_892 10 ES_8_RES8 4 0.0 8160.0 /end AXIS_PTS
/begin AXIS_PTS sstm_vsoll_dif_fgr "VSOLL_DIF_FGR" 0x49086 v_soll_dif_fgr a_893 100 LINEAR_______256_000000__0H___25 5 -256.0 255.99218 /end AXIS_PTS
/begin AXIS_PTS sstm_vtotzy_kf_t_van_reg_y "TOTZ_VANOS_Y" 0x48c3c dummy a_892 100 LINEAR______0_000000__0H___2550_ 6 0.0 2550.0 /end AXIS_PTS
/begin AXIS_PTS sstm_nwdifx_kf_t_van_reg_x "NW_DIF_REG_X" 0x48c33 dummy a_892 100 LINEAR______0_000000__0H___48_00 8 0.0 48.0 /end AXIS_PTS
/begin AXIS_PTS sst_nsoll_dif_kf_tallfs_nsoll_mi "NSOLL_DIF" 0x493fc nsoll_dif_ubat a_893 2 LINEAR______0_000000__0H___10171 4 0.0 1000.0 /end AXIS_PTS
/begin AXIS_PTS sst_n_kf_tallfs_nsoll_min "N" 0x48cb3 drehzahl a_892 12 ES_8_RES41 4 0.0 8160.0 /end AXIS_PTS
/begin AXIS_PTS sst_uls_kat_o2_sum_kf_o2_kat_int "ULS_KAT_O2_SUM" 0x492cc dummy a_893 10 LINEAR______0_000000__0H___42949 6 0.0 4.2949673e+009 /end AXIS_PTS
/begin COMPU_METHOD ES_8_RES "" FORM "%4.0" "[1/min]" FORMULA "32.0*X" FORMULA_INV "0.03125*X" /end COMPU_METHOD
/begin COMPU_METHOD LINEAR______0_000000__0H___99_61 "" FORM "%4.1" "[%]" FORMULA "0.39062745*X" FORMULA_INV "2.5599839*X" /end COMPU_METHOD
/begin COMPU_METHOD LINEAR_______48_000000__0H___155 "" FORM "%5.1" "[°C]" FORMULA "0.79607843*X-48.0" FORMULA_INV "1.2561576*X+60.295567" /end COMPU_METHOD
/begin COMPU_METHOD LINEAR_______48_000000__0H___156 "" FORM "%3.0" "[°C]" FORMULA "0.79607843*X-48.0" FORMULA_INV "1.2561576*X+60.295567" /end COMPU_METHOD
/begin COMPU_METHOD LINEAR______0_000000__0H___1_992 "" FORM "%5.3" "[-]" FORMULA "0.0078125491*X" FORMULA_INV "127.9992*X" /end COMPU_METHOD
/begin COMPU_METHOD LINEAR______0_000000__0H___25_50 "" FORM "%5.2" "[s]" FORMULA "0.1*X" FORMULA_INV "10.0*X" /end COMPU_METHOD
/begin COMPU_METHOD ES_8_RES8 "" FORM "%5.0" "" FORMULA "32.0*X" FORMULA_INV "0.03125*X" /end COMPU_METHOD
/begin COMPU_METHOD LINEAR______0_000000__0H___2988_ "" FORM "%6.1" "" FORMULA "11.717647*X" FORMULA_INV "0.085341365*X" /end COMPU_METHOD
/begin COMPU_METHOD MTC_NORM_8_RES "" FORM "%5.1" "[°DK]" FORMULA "0.46875*X" FORMULA_INV "2.1333333*X" /end COMPU_METHOD
/begin COMPU_METHOD LINEAR_______48_000000__0H___142 "" FORM "%5.1" "[°C]" FORMULA "0.75*X-48.0" FORMULA_INV "1.3333333*X+64.0" /end COMPU_METHOD
/begin COMPU_METHOD TI_BAS_16_RES "" FORM "%7.3" "" FORMULA "0.004*X" FORMULA_INV "250.0*X" /end COMPU_METHOD
/begin COMPU_METHOD IS_13_RES "" FORM "%5.0" "" FORMULA "1.0*X" FORMULA_INV "1.0*X" /end COMPU_METHOD
/begin COMPU_METHOD LINEAR_______48_000000__0H___114 "" FORM "%4.0" "" FORMULA "0.75*X-48.0" FORMULA_INV "1.3333333*X+64.0" /end COMPU_METHOD
/begin COMPU_METHOD MAF_KGH_16_RES15 "" FORM "%6.1" "" FORMULA "0.25*X" FORMULA_INV "4.0*X" /end COMPU_METHOD
/begin COMPU_METHOD MAF_8_RES "" FORM "%5.0" "" FORMULA "5.4470588*X" FORMULA_INV "0.18358531*X" /end COMPU_METHOD
/begin COMPU_METHOD ES_8_RES17 "" FORM "%4.0" "[U/min]" FORMULA "32.0*X" FORMULA_INV "0.03125*X" /end COMPU_METHOD
/begin COMPU_METHOD LINEAR______0_000000__0H___0_996 "" FORM "%5.3" "[-]" FORMULA "0.0039062745*X" FORMULA_INV "255.99839*X" /end COMPU_METHOD
/begin COMPU_METHOD LINEAR_______48_000000__0H___121 "" FORM "%4.0" "[°C]" FORMULA "0.75*X-48.0" FORMULA_INV "1.3333333*X+64.0" /end COMPU_METHOD
/begin COMPU_METHOD LINEAR______0_000000__0H___15_94 "" FORM "%5.2" "[-]" FORMULA "0.062509802*X" FORMULA_INV "15.997491*X" /end COMPU_METHOD
/begin COMPU_METHOD LINEAR_______48_000000__0H___0_0 "" FORM "%5.1" "[°KW]" FORMULA "0.375*X-48.0" FORMULA_INV "2.6666667*X+128.0" /end COMPU_METHOD
/begin COMPU_METHOD LINEAR______0_000000__0H___0_925 "" FORM "%5.3" "" FORMULA "0.0039058823*X" FORMULA_INV "256.0241*X" /end COMPU_METHOD
/begin COMPU_METHOD LINEAR______0_000000__0H___3_927 "" FORM "%5.3" "[-]" FORMULA "0.015625*X" FORMULA_INV "64.0*X" /end COMPU_METHOD
/begin COMPU_METHOD LINEAR______0_000000__0H___2550_ "" FORM "%4.0" "[ms]" FORMULA "10.0*X" FORMULA_INV "0.1*X" /end COMPU_METHOD
/begin COMPU_METHOD LINEAR_______48_000000__0H___130 "" FORM "%5.1" "" FORMULA "0.79607843*X-48.0" FORMULA_INV "1.2561576*X+60.295567" /end COMPU_METHOD
/begin COMPU_METHOD LINEAR_______48_000000__0H___133 "" FORM "%5.1" "" FORMULA "0.75*X-48.0" FORMULA_INV "1.3333333*X+64.0" /end COMPU_METHOD
/begin COMPU_METHOD LINEAR______1_000000__1H___255_0 "" FORM "%4.0" "[-]" FORMULA "1.0*X" FORMULA_INV "1.0*X" /end COMPU_METHOD
/begin COMPU_METHOD MAF_8_RES37 "" FORM "%4.0" "[mg/Hub]" FORMULA "5.4470588*X" FORMULA_INV "0.18358531*X" /end COMPU_METHOD
/begin COMPU_METHOD LINEAR_______256_000000__0H___25 "" FORM "%6.2" "[km/h]" FORMULA "0.0078124999*X-256.0" FORMULA_INV "128.0*X+32768.0" /end COMPU_METHOD
/begin COMPU_METHOD LINEAR______0_000000__0H___511_9 "" FORM "%6.2" "[km/h]" FORMULA "0.0078124999*X" FORMULA_INV "128.0*X" /end COMPU_METHOD
/begin COMPU_METHOD MAF_8_RES40 "" FORM "%5.0" "[mg/Hub]" FORMULA "5.4470588*X" FORMULA_INV "0.18358531*X" /end COMPU_METHOD
/begin COMPU_METHOD ES_8_RES41 "" FORM "%5.0" "[1/min]" FORMULA "32.0*X" FORMULA_INV "0.03125*X" /end COMPU_METHOD
/begin COMPU_METHOD LINEAR______0_000000__0H___95_62 "" FORM "%5.2" "[°KW]" FORMULA "0.375*X" FORMULA_INV "2.6666667*X" /end COMPU_METHOD
/begin COMPU_METHOD MAF_16_RES49 "" FORM "%5.0" "[mg/Hub]" FORMULA "0.021194781*X" FORMULA_INV "47.181425*X" /end COMPU_METHOD
/begin COMPU_METHOD LINEAR______0_000000__0H___7_000 "" FORM "%2.0" "[-]" FORMULA "1.0*X" FORMULA_INV "1.0*X" /end COMPU_METHOD
/begin COMPU_METHOD LINEAR_______33_000000__0H___990 "" FORM "%5.1" "[°C]" FORMULA "4.0117647*X-33.0" FORMULA_INV "0.24926686*X+8.2258065" /end COMPU_METHOD
/begin COMPU_METHOD LINEAR______0_000000__0H___11959 "" FORM "%5.1" "" FORMULA "0.46862745*X" FORMULA_INV "2.1338912*X" /end COMPU_METHOD
/begin COMPU_METHOD LINEAR______0_000000__0H___120_0 "" FORM "%5.1" "" FORMULA "0.375*X" FORMULA_INV "2.6666667*X" /end COMPU_METHOD
/begin COMPU_METHOD LINEAR_______48_000000__0H___47_ "" FORM "%5.1" "[°KW]" FORMULA "0.375*X-48.0" FORMULA_INV "2.6666667*X+128.0" /end COMPU_METHOD
/begin COMPU_METHOD IS_13_RES62 "" FORM "%5.0" "[1/min]" FORMULA "1.0*X" FORMULA_INV "1.0*X" /end COMPU_METHOD
/begin COMPU_METHOD LINEAR_______155_625000__FFH__63 "" FORM "%7.2" "[°KW]" FORMULA "-0.375*X-60.0" FORMULA_INV "-2.6666667*X-160.0" /end COMPU_METHOD
/begin COMPU_METHOD LINEAR______0_000000__0H___0_965 "" FORM "%5.3" "[-]" FORMULA "0.00390625*X" FORMULA_INV "256.0*X" /end COMPU_METHOD
/begin COMPU_METHOD LINEAR______0_000000__0H___1_275 "" FORM "%5.3" "[V]" FORMULA "0.005*X" FORMULA_INV "200.0*X" /end COMPU_METHOD
/begin COMPU_METHOD TALLFS "" FORM "%7.3" "[%]" FORMULA "0.0061035142*X" FORMULA_INV "163.84004*X" /end COMPU_METHOD
/begin COMPU_METHOD MAF_16_RES79 "" FORM "%5.0" "" FORMULA "0.021194781*X" FORMULA_INV "47.181425*X" /end COMPU_METHOD
/begin COMPU_METHOD LINEAR______0_000000__0H___26_82 "" FORM "%3.1" "[V]" FORMULA "0.10196078*X" FORMULA_INV "9.8076923*X" /end COMPU_METHOD
/begin COMPU_METHOD LINEAR______0_000000__0H___8_388 "" FORM "%5.3" "[s]" FORMULA "0.000128*X" FORMULA_INV "7812.5*X" /end COMPU_METHOD
/begin COMPU_METHOD IS_13_RES84 "" FORM "%5.0" "[U/min]" FORMULA "1.0*X" FORMULA_INV "1.0*X" /end COMPU_METHOD
/begin COMPU_METHOD LINEAR______0_000000__0H___159_3 "" FORM "%6.2" "[ms]" FORMULA "0.625*X" FORMULA_INV "1.6*X" /end COMPU_METHOD
/begin COMPU_METHOD LINEAR_______4096_000000__0H___4 "" FORM "%7.0" "" FORMULA "32.0*X-4096.0" FORMULA_INV "0.03125*X+128.0" /end COMPU_METHOD
/begin COMPU_METHOD LINEAR_______48_000000__0H___189 "" FORM "%3.0" "[°C]" FORMULA "0.75*X-48.0" FORMULA_INV "1.3333333*X+64.0" /end COMPU_METHOD
/begin COMPU_METHOD TALLFS_IN_10MS "" FORM "%7.3" "[%]" FORMULA "0.0061034929*X-3.4929165e-006" FORMULA_INV "163.84061*X+0.00057228156" /end COMPU_METHOD
/begin COMPU_METHOD LINEAR______0_000000__0H___81692 "" FORM "%4.0" "[1/min]" FORMULA "0.25*X" FORMULA_INV "4.0*X" /end COMPU_METHOD
/begin COMPU_METHOD LINEAR_______1024_000000__7C00H_ "" FORM "%6.0" "" FORMULA "1.0*X-32768.0" FORMULA_INV "1.0*X+32768.0" /end COMPU_METHOD
/begin COMPU_METHOD LINEAR______0_000000__0H___1_998 "" FORM "%5.3" "" FORMULA "0.0078125491*X" FORMULA_INV "127.9992*X" /end COMPU_METHOD
/begin COMPU_METHOD LINEAR______0_000000__0H___12099 "" FORM "%5.1" "[°KW]" FORMULA "0.375*X" FORMULA_INV "2.6666667*X" /end COMPU_METHOD
/begin COMPU_METHOD LINEAR_______48_000000__0H___100 "" FORM "%5.2" "[°C]" FORMULA "0.75*X-48.0" FORMULA_INV "1.3333333*X+64.0" /end COMPU_METHOD
/begin COMPU_METHOD LINEAR______0_250000__1H___16383 "" FORM "%5.1" "" FORMULA "0.25*X" FORMULA_INV "4.0*X" /end COMPU_METHOD
/begin COMPU_METHOD LINEAR______0_000000__0H___0_104 "" FORM "%5.3" "" FORMULA "0.0039062745*X" FORMULA_INV "255.99839*X" /end COMPU_METHOD
/begin COMPU_METHOD LINEAR______0_040000__AH___16_38 "" FORM "%6.3" "[ms/120°KW]" FORMULA "0.004*X" FORMULA_INV "250.0*X" /end COMPU_METHOD
/begin COMPU_METHOD LINEAR______0_000000__0H___32_76 "" FORM "%5.2" "[ms]" FORMULA "0.1285*X" FORMULA_INV "7.7821012*X" /end COMPU_METHOD
/begin COMPU_METHOD LINEAR______0_000000__0H___0_106 "" FORM "%5.3" "" FORMULA "0.0039062353*X" FORMULA_INV "256.00097*X" /end COMPU_METHOD
/begin COMPU_METHOD LINEAR______0_000000__0H___7_107 "" FORM "%5.3" "[-]" FORMULA "0.031247059*X" FORMULA_INV "32.003012*X" /end COMPU_METHOD
/begin COMPU_METHOD LINEAR______0_500000__0H___1_500 "" FORM "%6.4" "[-]" FORMULA "0.00024414063*X+0.5" FORMULA_INV "4096.0*X-2048.0" /end COMPU_METHOD
/begin COMPU_METHOD LINEAR______0_000000__0H___6553_ "" FORM "%6.1" "[s]" FORMULA "0.1*X" FORMULA_INV "10.0*X" /end COMPU_METHOD
/begin COMPU_METHOD LINEAR______0_000488__1H___0_124 "" FORM "%6.4" "[-]" FORMULA "0.00048827559*X-2.7559055e-007" FORMULA_INV "2048.0237*X+0.00056441599" /end COMPU_METHOD
/begin COMPU_METHOD LINEAR______0_000000__0H___25108 "" FORM "%3.0" "[s]" FORMULA "1.0*X" FORMULA_INV "1.0*X" /end COMPU_METHOD
/begin COMPU_METHOD LINEAR______0_000000__0H___0_109 "" FORM "%5.3" "" FORMULA "0.00024324787*X" FORMULA_INV "4111.033*X" /end COMPU_METHOD
/begin COMPU_METHOD LINEAR______0_000000__0H___3_110 "" FORM "%4.2" "" FORMULA "0.015623529*X" FORMULA_INV "64.006025*X" /end COMPU_METHOD
/begin COMPU_METHOD LINEAR______0_500000__80H___0_99 "" FORM "%5.3" "" FORMULA "0.0039062993*X-6.3092913e-006" FORMULA_INV "255.99677*X+0.0016151582" /end COMPU_METHOD
/begin COMPU_METHOD LINEAR_______0_500000__0H___0_49 "" FORM "%5.3" "" FORMULA "0.0039058823*X-0.5" FORMULA_INV "256.0241*X+128.01205" /end COMPU_METHOD
/begin COMPU_METHOD LINEAR______0_000000__0H___262_1 "" FORM "%7.3" "[ms]" FORMULA "0.004000061*X" FORMULA_INV "249.99619*X" /end COMPU_METHOD
/begin COMPU_METHOD LINEAR______0_000000__0H___2_111 "" FORM "%7.5" "[-]" FORMULA "3.0518044e-005*X" FORMULA_INV "32767.5*X" /end COMPU_METHOD
/begin COMPU_METHOD LINEAR______0_000000__0H___2_112 "" FORM "%5.3" "[-]" FORMULA "0.0078431373*X" FORMULA_INV "127.5*X" /end COMPU_METHOD
/begin COMPU_METHOD LINEAR______0_000000__0H___127_5 "" FORM "%5.1" "" FORMULA "0.5*X" FORMULA_INV "2.0*X" /end COMPU_METHOD
/begin COMPU_METHOD LINEAR______0_000000__0H___25113 "" FORM "%5.1" "[-]" FORMULA "1.0*X" FORMULA_INV "1.0*X" /end COMPU_METHOD
/begin COMPU_METHOD LINEAR______0_500000__40H___1_50 "" FORM "%5.3" "[-]" FORMULA "0.0078125*X" FORMULA_INV "128.0*X" /end COMPU_METHOD
/begin COMPU_METHOD LINEAR______0_078000__10H___4_99 "" FORM "%5.3" "" FORMULA "0.0048828203*X-0.00012512413" FORMULA_INV "204.79967*X+0.025625381" /end COMPU_METHOD
/begin COMPU_METHOD LINEAR______0_750000__1H___190_5 "" FORM "%6.2" "[°C/10s]" FORMULA "0.75*X" FORMULA_INV "1.3333333*X" /end COMPU_METHOD
/begin COMPU_METHOD LINEAR_______0_125000__0H___0_12 "" FORM "%6.4" "" FORMULA "3.8146944e-006*X-0.125" FORMULA_INV "262144.19*X+32768.024" /end COMPU_METHOD
/begin COMPU_METHOD IS_13_RES114 "" FORM "%5.0" "[-]" FORMULA "1.0*X" FORMULA_INV "1.0*X" /end COMPU_METHOD
/begin COMPU_METHOD LINEAR_______0_125000__0H___0_00 "" FORM "%6.4" "[-]" FORMULA "3.8146973e-006*X-0.125" FORMULA_INV "262144.0*X+32768.0" /end COMPU_METHOD
/begin COMPU_METHOD LINEAR______0_000000__0H___408_0 "" FORM "%6.2" "[s]" FORMULA "0.05*X" FORMULA_INV "20.0*X" /end COMPU_METHOD
/begin COMPU_METHOD LINEAR______0_000000__0H___5_000 "" FORM "%4.2" "" FORMULA "0.019607843*X" FORMULA_INV "51.0*X" /end COMPU_METHOD
/begin COMPU_METHOD LINEAR______0_000000__0H___1_115 "" FORM "%5.4" "[-]" FORMULA "0.0039062622*X" FORMULA_INV "255.9992*X" /end COMPU_METHOD
/begin COMPU_METHOD ES_8_RES116 "" FORM "%5.0" "[U/min]" FORMULA "32.0*X" FORMULA_INV "0.03125*X" /end COMPU_METHOD
/begin COMPU_METHOD LINEAR______0_000000__0H___5100_ "" FORM "%5.0" "[ms]" FORMULA "20.0*X" FORMULA_INV "0.05*X" /end COMPU_METHOD
/begin COMPU_METHOD MAF_KGH_16_RES117 "" FORM "%6.1" "[kg/h]" FORMULA "0.25*X" FORMULA_INV "4.0*X" /end COMPU_METHOD
/begin COMPU_METHOD LINEAR______0_000000__0H___51118 "" FORM "%5.0" "" FORMULA "20.0*X" FORMULA_INV "0.05*X" /end COMPU_METHOD
/begin COMPU_METHOD LINEAR______0_000000__0H___25119 "" FORM "%5.0" "[ms]" FORMULA "10.0*X" FORMULA_INV "0.1*X" /end COMPU_METHOD
/begin COMPU_METHOD LINEAR______0_003900__0H___1_120 "" FORM "%5.3" "" FORMULA "0.0039062745*X+0.0039" FORMULA_INV "255.99839*X-0.99839374" /end COMPU_METHOD
/begin COMPU_METHOD LINEAR______0_000000__0H___3_121 "" FORM "%5.3" "" FORMULA "0.015625*X" FORMULA_INV "64.0*X" /end COMPU_METHOD
/begin COMPU_METHOD LINEAR______1_000000__1H___20_33 "" FORM "%5.2" "[dm^3]" FORMULA "0.0070268993*X+0.9929731" FORMULA_INV "142.31028*X-141.31028" /end COMPU_METHOD
/begin COMPU_METHOD LINEAR______0_000000__0H___10122 "" FORM "%4.0" "" FORMULA "1.0*X" FORMULA_INV "1.0*X" /end COMPU_METHOD
/begin COMPU_METHOD LINEAR______0_000000__0H___2_550 "" FORM "%4.2" "" FORMULA "0.0099999998*X" FORMULA_INV "100.0*X" /end COMPU_METHOD
/begin COMPU_METHOD LINEAR______0_000000__0H___143_8 "" FORM "%5.1" "" FORMULA "0.56392158*X" FORMULA_INV "1.7732962*X" /end COMPU_METHOD
/begin COMPU_METHOD LINEAR______0_000000__0H___1_123 "" FORM "%5.2" "[-]" FORMULA "0.0039215686*X" FORMULA_INV "255.0*X" /end COMPU_METHOD
/begin COMPU_METHOD LINEAR______0_375000__1H___47_62 "" FORM "%6.2" "[°KW/120°KW]" FORMULA "0.375*X" FORMULA_INV "2.6666667*X" /end COMPU_METHOD
/begin COMPU_METHOD LINEAR______0_001460__1H___48_00 "" FORM "%6.3" "" FORMULA "0.0014648439*X-4.8438978e-006" FORMULA_INV "682.6666*X+0.0033067672" /end COMPU_METHOD
/begin COMPU_METHOD LINEAR_______48_000000__0H___124 "" FORM "%5.1" "" FORMULA "0.375*X-48.0" FORMULA_INV "2.6666667*X+128.0" /end COMPU_METHOD
/begin COMPU_METHOD LINEAR_______23_625000__0H___72_ "" FORM "%7.3" "[°KW]" FORMULA "0.375*X-23.625" FORMULA_INV "2.6666667*X+63.0" /end COMPU_METHOD
/begin COMPU_METHOD LINEAR______0_000000__0H___11125 "" FORM "%5.1" "[°DK]" FORMULA "0.46862745*X" FORMULA_INV "2.1338912*X" /end COMPU_METHOD
/begin COMPU_METHOD LINEAR_______23_625000__0H___126 "" FORM "%5.1" "[°KW]" FORMULA "0.375*X-23.625" FORMULA_INV "2.6666667*X+63.0" /end COMPU_METHOD
/begin COMPU_METHOD LINEAR_______48_000000__80H__127 "" FORM "%7.3" "[°KW]" FORMULA "-0.375*X" FORMULA_INV "-2.6666667*X" /end COMPU_METHOD
/begin COMPU_METHOD LINEAR______0_000000__0H___1_128 "" FORM "%5.3" "[-]" FORMULA "1.5289117e-005*X" FORMULA_INV "65406.0*X" /end COMPU_METHOD
/begin COMPU_METHOD LINEAR______0_000000__0H___0_129 "" FORM "%5.3" "[]" FORMULA "0.0039058823*X" FORMULA_INV "256.0241*X" /end COMPU_METHOD
/begin COMPU_METHOD LINEAR______0_000000__0H___65130 "" FORM "%6.1" "" FORMULA "0.1*X" FORMULA_INV "10.0*X" /end COMPU_METHOD
/begin COMPU_METHOD LINEAR______0_000000__0H___1_131 "" FORM "%5.2" "" FORMULA "0.0039215686*X" FORMULA_INV "255.0*X" /end COMPU_METHOD
/begin COMPU_METHOD LINEAR_______48_000000__0H___132 "" FORM "%6.3" "" FORMULA "0.375*X-48.0" FORMULA_INV "2.6666667*X+128.0" /end COMPU_METHOD
/begin COMPU_METHOD LINEAR_______48_000000__0H___134 "" FORM "%6.2" "[°KW]" FORMULA "0.375*X-48.0" FORMULA_INV "2.6666667*X+128.0" /end COMPU_METHOD
/begin COMPU_METHOD LINEAR______0_000000__0H___11135 "" FORM "%5.0" "[°DK]" FORMULA "0.46862745*X" FORMULA_INV "2.1338912*X" /end COMPU_METHOD
/begin COMPU_METHOD LINEAR_______48_000000__0H___136 "" FORM "%6.3" "[°KW]" FORMULA "0.375*X-48.0" FORMULA_INV "2.6666667*X+128.0" /end COMPU_METHOD
/begin COMPU_METHOD LINEAR_______48_000000__0H___137 "" FORM "%7.3" "[°KW]" FORMULA "0.375*X-48.0" FORMULA_INV "2.6666667*X+128.0" /end COMPU_METHOD
/begin COMPU_METHOD LINEAR_______48_000000__0H___138 "" FORM "%5.1" "" FORMULA "0.375*X-48.0" FORMULA_INV "2.6666667*X+128.0" /end COMPU_METHOD
/begin COMPU_METHOD LINEAR_______23_625000__0H___139 "" FORM "%5.1" "" FORMULA "0.375*X-23.625" FORMULA_INV "2.6666667*X+63.0" /end COMPU_METHOD
/begin COMPU_METHOD LINEAR_______23_625000__0H___140 "" FORM "%5.2" "[°KW]" FORMULA "0.375*X-23.625" FORMULA_INV "2.6666667*X+63.0" /end COMPU_METHOD
/begin COMPU_METHOD LINEAR_______2_560000__FFFFFF80H "" FORM "%4.2" "" FORMULA "0.02*X+9.8039217e-009" FORMULA_INV "50.000001*X-4.9019609e-007" /end COMPU_METHOD
/begin COMPU_METHOD LINEAR______0_000000__0H___254_0 "" FORM "%3.0" "[-]" FORMULA "1.0*X" FORMULA_INV "1.0*X" /end COMPU_METHOD
/begin COMPU_METHOD LINEAR______0_000000__0H___25142 "" FORM "%3.0" "[-]" FORMULA "1.0*X" FORMULA_INV "1.0*X" /end COMPU_METHOD
/begin COMPU_METHOD LINEAR______0_000000__0H___655_3 "" FORM "%6.2" "[s]" FORMULA "0.0099999996*X" FORMULA_INV "100.0*X" /end COMPU_METHOD
/begin COMPU_METHOD LINEAR______0_000000__0H___2_143 "" FORM "%2.0" "[-]" FORMULA "1.0*X" FORMULA_INV "1.0*X" /end COMPU_METHOD
/begin COMPU_METHOD LINEAR_______33_000000__0H___144 "" FORM "%5.1" "[°C]" FORMULA "0.015609979*X-33.0" FORMULA_INV "64.061584*X+2114.0323" /end COMPU_METHOD
/begin COMPU_METHOD LINEAR______0_000000__0H___1_145 "" FORM "%1.0" "[-]" FORMULA "1.0*X" FORMULA_INV "1.0*X" /end COMPU_METHOD
/begin COMPU_METHOD MAF_16_RES146 "" FORM "%6.2" "[mg/Hub]" FORMULA "0.021194781*X" FORMULA_INV "47.181425*X" /end COMPU_METHOD
/begin COMPU_METHOD LINEAR______0_000000__0H___25147 "" FORM "%4.0" "" FORMULA "1.0*X" FORMULA_INV "1.0*X" /end COMPU_METHOD
/begin COMPU_METHOD LINEAR______1_000000__1H___16_00 "" FORM "%3.0" "[-]" FORMULA "1.0*X" FORMULA_INV "1.0*X" /end COMPU_METHOD
/begin COMPU_METHOD LINEAR______0_000000__0H___5_148 "" FORM "%3.0" "[Gang]" FORMULA "1.0*X" FORMULA_INV "1.0*X" /end COMPU_METHOD
/begin COMPU_METHOD LINEAR______0_000000__0H___16320 "" FORM "%5.0" "[min-1/ km/h]" FORMULA "2.0*X" FORMULA_INV "0.5*X" /end COMPU_METHOD
/begin COMPU_METHOD TAB_KRFB_X "" FORM "%5.1" "[°KW]" FORMULA "0.375*X" FORMULA_INV "2.6666667*X" /end COMPU_METHOD
/begin COMPU_METHOD TAB_KRFE_X "" FORM "%5.1" "[°KW]" FORMULA "0.375*X+12.0" FORMULA_INV "2.6666667*X-32.0" /end COMPU_METHOD
/begin COMPU_METHOD LINEAR______0_000000__0H___1_149 "" FORM "%4.2" "[-]" FORMULA "0.0078278431*X" FORMULA_INV "127.74911*X" /end COMPU_METHOD
/begin COMPU_METHOD LINEAR_______48_000000__0H___150 "" FORM "%4.0" "[°C]" FORMULA "0.79607843*X-48.0" FORMULA_INV "1.2561576*X+60.295567" /end COMPU_METHOD
/begin COMPU_METHOD LINEAR______0_000000__0H___0_151 "" FORM "%7.5" "" FORMULA "1.5258789e-005*X" FORMULA_INV "65536.0*X" /end COMPU_METHOD
/begin COMPU_METHOD LINEAR______0_000000__0H___0_152 "" FORM "%6.4" "[-]" FORMULA "0.0039062745*X" FORMULA_INV "255.99839*X" /end COMPU_METHOD
/begin COMPU_METHOD LINEAR______0_000000__0H___15_00 "" FORM "%2.0" "[-]" FORMULA "1.0*X" FORMULA_INV "1.0*X" /end COMPU_METHOD
/begin COMPU_METHOD LINEAR______0_000000__0H___4064_ "" FORM "%6.0" "" FORMULA "32.0*X" FORMULA_INV "0.03125*X" /end COMPU_METHOD
/begin COMPU_METHOD LINEAR______0_12500000__1H___816 "" FORM "%7.3" "[1/min/10ms]" FORMULA "0.125*X" FORMULA_INV "8.0*X" /end COMPU_METHOD
/begin COMPU_METHOD LINEAR______0_000000__0H___16153 "" FORM "%5.0" "[1/min / km/h]" FORMULA "2.0*X" FORMULA_INV "0.5*X" /end COMPU_METHOD
/begin COMPU_METHOD LINEAR______1_000000__1H___25154 "" FORM "%4.0" "" FORMULA "1.0*X" FORMULA_INV "1.0*X" /end COMPU_METHOD
/begin COMPU_METHOD LINEAR______0_000000__0H___1_155 "" FORM "%5.3" "[-]" FORMULA "0.0078278431*X" FORMULA_INV "127.74911*X" /end COMPU_METHOD
/begin COMPU_METHOD LINEAR_______5434_259766__FFFF80 "" FORM "%6.1" "[hPa/480°KW]" FORMULA "0.16584171*X+0.041460356" FORMULA_INV "6.0298461*X-0.24999957" /end COMPU_METHOD
/begin COMPU_METHOD LINEAR______0_000000__0H___8191_ "" FORM "%4.0" "[-]" FORMULA "1.0*X" FORMULA_INV "1.0*X" /end COMPU_METHOD
/begin COMPU_METHOD LINEAR______0_000000__0H___13_00 "" FORM "%3.0" "[-]" FORMULA "1.0*X" FORMULA_INV "1.0*X" /end COMPU_METHOD
/begin COMPU_METHOD LINEAR______10_000000__1H___2550 "" FORM "%5.0" "[ms]" FORMULA "10.0*X" FORMULA_INV "0.1*X" /end COMPU_METHOD
/begin COMPU_METHOD LINEAR______0_100000__1H___25_50 "" FORM "%4.2" "[s]" FORMULA "0.1*X+1.3877788e-017" FORMULA_INV "10.0*X-1.3877788e-016" /end COMPU_METHOD
/begin COMPU_METHOD LINEAR______0_100000__1H___25157 "" FORM "%4.1" "[s]" FORMULA "0.1*X+1.3877788e-017" FORMULA_INV "10.0*X-1.3877788e-016" /end COMPU_METHOD
/begin COMPU_METHOD LINEAR______0_100000__1H___6553_ "" FORM "%6.1" "[0.1s]" FORMULA "0.1*X+1.3877788e-017" FORMULA_INV "10.0*X-1.3877788e-016" /end COMPU_METHOD
/begin COMPU_METHOD LINEAR______10_000000__1H___2158 "" FORM "%6.1" "[s]" FORMULA "10.0*X" FORMULA_INV "0.1*X" /end COMPU_METHOD
/begin COMPU_METHOD LINEAR______0_020000__1H___1310_ "" FORM "%7.2" "" FORMULA "0.02*X" FORMULA_INV "50.0*X" /end COMPU_METHOD
/begin COMPU_METHOD ZSR_BAS_16_RES "" FORM "%6.3" "" FORMULA "0.004*X" FORMULA_INV "250.0*X" /end COMPU_METHOD
/begin COMPU_METHOD LINEAR______0_000000__0H___2097_ "" FORM "%5.0" "[ms]" FORMULA "8.224*X" FORMULA_INV "0.12159533*X" /end COMPU_METHOD
/begin COMPU_METHOD LINEAR______0_000000__0H___99159 "" FORM "%5.2" "[%]" FORMULA "0.39062745*X" FORMULA_INV "2.5599839*X" /end COMPU_METHOD
/begin COMPU_METHOD LINEAR_______50_000000__0H___160 "" FORM "%5.1" "[%]" FORMULA "0.39058823*X-50.0" FORMULA_INV "2.560241*X+128.01205" /end COMPU_METHOD
/begin COMPU_METHOD LINEAR______0_000000__0H___49_59 "" FORM "%5.1" "[%]" FORMULA "0.39055117*X" FORMULA_INV "2.560484*X" /end COMPU_METHOD
/begin COMPU_METHOD LINEAR______0_000000__0H___95161 "" FORM "%4.1" "[°KW/s]" FORMULA "0.375*X" FORMULA_INV "2.6666667*X" /end COMPU_METHOD
/begin COMPU_METHOD LINEAR______0_000000__0H___99162 "" FORM "%5.1" "" FORMULA "0.39058823*X" FORMULA_INV "2.560241*X" /end COMPU_METHOD
/begin COMPU_METHOD LINEAR______0_000000__0H___65163 "" FORM "%5.0" "[-]" FORMULA "1.0*X" FORMULA_INV "1.0*X" /end COMPU_METHOD
/begin COMPU_METHOD LINEAR______0_000000__0H___65164 "" FORM "%5.0" "[-]" FORMULA "1.0*X" FORMULA_INV "1.0*X" /end COMPU_METHOD
/begin COMPU_METHOD LINEAR_______33_000000__0H___165 "" FORM "%4.0" "[°C]" FORMULA "4.0117647*X-33.0" FORMULA_INV "0.24926686*X+8.2258065" /end COMPU_METHOD
/begin COMPU_METHOD LINEAR______0_000000__0H___23_81 "" FORM "%5.1" "[°C/sec]" FORMULA "0.09375*X" FORMULA_INV "10.666667*X" /end COMPU_METHOD
/begin COMPU_METHOD LINEAR______0_000000__0H___1_166 "" FORM "%5.3" "[-]" FORMULA "0.00024414063*X" FORMULA_INV "4096.0*X" /end COMPU_METHOD
/begin COMPU_METHOD LINEAR______100_000000__1H___255 "" FORM "%6.0" "" FORMULA "100.0*X" FORMULA_INV "0.01*X" /end COMPU_METHOD
/begin COMPU_METHOD LINEAR______0_000000__0H___1_167 "" FORM "%2.0" "[-]" FORMULA "1.0*X" FORMULA_INV "1.0*X" /end COMPU_METHOD
/begin COMPU_METHOD LINEAR______0_375000__1H___95_62 "" FORM "%6.3" "" FORMULA "0.375*X" FORMULA_INV "2.6666667*X" /end COMPU_METHOD
/begin COMPU_METHOD LINEAR______0_001460__1H___47_99 "" FORM "%6.3" "" FORMULA "0.0014648428*X-4.8428499e-006" FORMULA_INV "682.66709*X+0.0033060542" /end COMPU_METHOD
/begin COMPU_METHOD LINEAR______47_625000__FFFFFF81H "" FORM "%5.1" "" FORMULA "-0.375*X" FORMULA_INV "-2.6666667*X" /end COMPU_METHOD
/begin COMPU_METHOD LINEAR______0_001460__1H___47168 "" FORM "%6.3" "[°KW/120°KW]" FORMULA "0.0014648428*X-4.8428499e-006" FORMULA_INV "682.66709*X+0.0033060542" /end COMPU_METHOD
/begin COMPU_METHOD LINEAR______0_000000__0H___25169 "" FORM "%4.0" "[* 120°KW]" FORMULA "1.0*X" FORMULA_INV "1.0*X" /end COMPU_METHOD
/begin COMPU_METHOD LINEAR______0_000000__0H___0_998 "" FORM "%5.3" "[-]" FORMULA "0.0039152941*X" FORMULA_INV "255.40865*X" /end COMPU_METHOD
/begin COMPU_METHOD LINEAR_______48_000000__0H___170 "" FORM "%6.2" "[°KW]" FORMULA "0.375*X-48.0" FORMULA_INV "2.6666667*X+128.0" /end COMPU_METHOD
/begin COMPU_METHOD LINEAR______0_000000__0H___48_00 "" FORM "%5.2" "[°KW]" FORMULA "0.375*X" FORMULA_INV "2.6666667*X" /end COMPU_METHOD
/begin COMPU_METHOD LINEAR______0_000000__0H___10171 "" FORM "%5.0" "[1/min]" FORMULA "0.25*X" FORMULA_INV "4.0*X" /end COMPU_METHOD
/begin COMPU_METHOD LINEAR______0_000000__0H___42949 "" FORM "%11.0" "[-]" FORMULA "65537.0*X" FORMULA_INV "1.5258556e-005*X" /end COMPU_METHOD
/begin COMPU_METHOD LINEAR_______32768_000000__FFFF8 "" FORM "%6.0" "" FORMULA "1.0*X" FORMULA_INV "1.0*X" /end COMPU_METHOD
/begin COMPU_METHOD LINEAR______0_000000__0H___7110_ "" FORM "%7.2" "[m/s^2]" FORMULA "0.21701389*X" FORMULA_INV "4.608*X" /end COMPU_METHOD
/begin COMPU_METHOD LINEAR_______27_780000__FFFFFF80 "" FORM "%6.2" "[m/s^2]" FORMULA "0.21703125*X" FORMULA_INV "4.6076314*X" /end COMPU_METHOD
/begin COMPU_METHOD LINEAR______0_000000__0H___51176 "" FORM "%6.2" "[m/s^2]" FORMULA "0.021701378*X" FORMULA_INV "46.080024*X" /end COMPU_METHOD
/begin COMPU_METHOD LINEAR______0_000000__0H___99177 "" FORM "%4.1" "[%PWM]" FORMULA "0.39062745*X" FORMULA_INV "2.5599839*X" /end COMPU_METHOD
/begin COMPU_METHOD LINEAR______0_000000__0H___2_040 "" FORM "%5.3" "[ms]" FORMULA "0.008*X" FORMULA_INV "125.0*X" /end COMPU_METHOD
/begin COMPU_METHOD LINEAR______60_000000__0H___1178 "" FORM "%6.2" "[°KW]" FORMULA "0.375*X+60.0" FORMULA_INV "2.6666667*X-160.0" /end COMPU_METHOD
/begin COMPU_METHOD LINEAR______0_000000__0H___51179 "" FORM "%3.0" "[km/h]" FORMULA "0.0078124999*X" FORMULA_INV "128.0*X" /end COMPU_METHOD
/begin COMPU_METHOD LINEAR______0_015625__1H___3_984 "" FORM "%4.2" "[-/100ms]" FORMULA "0.015625*X" FORMULA_INV "64.0*X" /end COMPU_METHOD
/begin COMPU_METHOD LINEAR_______32768_000000__FF180 "" FORM "%6.0" "[-]" FORMULA "1.0*X" FORMULA_INV "1.0*X" /end COMPU_METHOD
/begin COMPU_METHOD SIGNEDCHAR "" FORM "%4.0" "[-]" FORMULA "1.0*X" FORMULA_INV "1.0*X" /end COMPU_METHOD
/begin COMPU_METHOD LINEAR______0_000015__1H___99_99 "" FORM "%5.3" "[%/10ms]" FORMULA "0.001525925*X-0.001510665" FORMULA_INV "655.3402*X+0.98999951" /end COMPU_METHOD
/begin COMPU_METHOD LINEAR______0_024000__1H___6_120 "" FORM "%5.3" "[%/20ms]" FORMULA "0.024*X" FORMULA_INV "41.666667*X" /end COMPU_METHOD
/begin COMPU_METHOD LINEAR______0_000000__0H___1_181 "" FORM "%7.5" "[V/A]" FORMULA "4.6958277e-005*X" FORMULA_INV "21295.5*X" /end COMPU_METHOD
/begin COMPU_METHOD LINEAR______0_000000__0H___200_0 "" FORM "%3.0" "[1/200KW_Umdr.]" FORMULA "0.33333333*X" FORMULA_INV "3.0*X" /end COMPU_METHOD
/begin COMPU_METHOD LINEAR______0_000000__0H___25182 "" FORM "%4.0" "[-]" FORMULA "1.0*X" FORMULA_INV "1.0*X" /end COMPU_METHOD
/begin COMPU_METHOD LINEAR______0_000000__0H___25183 "" FORM "%4.0" "[Zyklen]" FORMULA "1.0*X" FORMULA_INV "1.0*X" /end COMPU_METHOD
/begin COMPU_METHOD LINEAR______1_000000__1H___25184 "" FORM "%3.0" "[s]" FORMULA "1.0*X" FORMULA_INV "1.0*X" /end COMPU_METHOD
/begin COMPU_METHOD LINEAR______0_000000__0H___25185 "" FORM "%4.0" "[]" FORMULA "1.0*X" FORMULA_INV "1.0*X" /end COMPU_METHOD
/begin COMPU_METHOD LINEAR______1_000000__1H___25186 "" FORM "%3.0" "[-]" FORMULA "1.0*X" FORMULA_INV "1.0*X" /end COMPU_METHOD
/begin COMPU_METHOD LINEAR______0_000000__0H___32766 "" FORM "%6.0" "[]" FORMULA "1.0*X" FORMULA_INV "1.0*X" /end COMPU_METHOD
/begin COMPU_METHOD LINEAR______1_000000__0H___3000_ "" FORM "%5.0" "[1/1000KW_Umdr.]" FORMULA "0.99966667*X+1.0" FORMULA_INV "1.0003334*X-1.0003334" /end COMPU_METHOD
/begin COMPU_METHOD LINEAR______0_000000__0H___6_000 "" FORM "%2.0" "[Zylinder]" FORMULA "1.0*X" FORMULA_INV "1.0*X" /end COMPU_METHOD
/begin COMPU_METHOD LINEAR______0_000000__0H___65187 "" FORM "%6.0" "[1/200KW_Umdr.]" FORMULA "1.0*X" FORMULA_INV "1.0*X" /end COMPU_METHOD
/begin COMPU_METHOD LINEAR______0_000000__0H___500_0 "" FORM "%4.0" "[1/1000KW_Umdr.]" FORMULA "1.0*X" FORMULA_INV "1.0*X" /end COMPU_METHOD
/begin COMPU_METHOD LINEAR______1_000000__0H___255_0 "" FORM "%4.0" "[SA-Phasen]" FORMULA "1.0*X+1.0" FORMULA_INV "1.0*X-1.0" /end COMPU_METHOD
/begin COMPU_METHOD LINEAR______0_000000__0H___25188 "" FORM "%3.0" "[Zyklen]" FORMULA "1.0*X" FORMULA_INV "1.0*X" /end COMPU_METHOD
/begin COMPU_METHOD LINEAR______0_000000__0H___171_3 "" FORM "%7.3" "[%*min]" FORMULA "0.0026143282*X" FORMULA_INV "382.50744*X" /end COMPU_METHOD
/begin COMPU_METHOD LINEAR______1_000000__1H___10_00 "" FORM "%3.0" "[-]" FORMULA "1.0*X" FORMULA_INV "1.0*X" /end COMPU_METHOD
/begin COMPU_METHOD LINEAR______4_000000__4H___56_00 "" FORM "%2.0" "[-]" FORMULA "1.0*X" FORMULA_INV "1.0*X" /end COMPU_METHOD
/begin COMPU_METHOD LINEAR_______2147483647_000000__ "" FORM "%11.0" "" FORMULA "1.9922179*X-2.1307717e+009" FORMULA_INV "0.50195312*X+1.0695475e+009" /end COMPU_METHOD
/begin COMPU_METHOD LINEAR_______21856_000000__FFFF8 "" FORM "%11.0" "" FORMULA "0.66700237*X+0.33350118" FORMULA_INV "1.4992451*X-0.5" /end COMPU_METHOD
/begin COMPU_METHOD LINEAR______0_000000__0H___1_020 "" FORM "%5.3" "[ms]" FORMULA "0.004*X" FORMULA_INV "250.0*X" /end COMPU_METHOD
/begin COMPU_METHOD LINEAR______0_000000__0H___65190 "" FORM "%5.0" "" FORMULA "1.0*X" FORMULA_INV "1.0*X" /end COMPU_METHOD
/begin COMPU_METHOD LINEAR______0_000000__0H___10_24 "" FORM "%6.3" "[hPa]" FORMULA "0.0049999999*X" FORMULA_INV "200.0*X" /end COMPU_METHOD
/begin COMPU_METHOD defaultConversion "" FORM "%8.4" "[]" FORMULA "1.0*X" FORMULA_INV "1.0*X" /end COMPU_METHOD
/begin COMPU_METHOD defaultConversion191 "" FORM "%8.4" "[]" FORMULA "1.0*X" FORMULA_INV "1.0*X" /end COMPU_METHOD
/begin RECORD_LAYOUT a_1 FNC_VALUES 1 UWORD COLUMN_DIR DIRECT /end RECORD_LAYOUT
/begin RECORD_LAYOUT a_2 FNC_VALUES 1 UBYTE COLUMN_DIR DIRECT /end RECORD_LAYOUT
/begin RECORD_LAYOUT a_3 FNC_VALUES 1 UBYTE COLUMN_DIR DIRECT /end RECORD_LAYOUT
/begin RECORD_LAYOUT a_4 FNC_VALUES 1 UBYTE COLUMN_DIR DIRECT /end RECORD_LAYOUT
/begin RECORD_LAYOUT a_7 FNC_VALUES 1 UWORD COLUMN_DIR DIRECT /end RECORD_LAYOUT
/begin RECORD_LAYOUT a_9 FNC_VALUES 1 UWORD COLUMN_DIR DIRECT /end RECORD_LAYOUT
/begin RECORD_LAYOUT a_11 FNC_VALUES 1 UBYTE COLUMN_DIR DIRECT /end RECORD_LAYOUT
/begin RECORD_LAYOUT a_13 FNC_VALUES 1 UBYTE COLUMN_DIR DIRECT /end RECORD_LAYOUT
/begin RECORD_LAYOUT a_19 FNC_VALUES 1 UBYTE COLUMN_DIR DIRECT /end RECORD_LAYOUT
/begin RECORD_LAYOUT a_29 FNC_VALUES 1 UWORD COLUMN_DIR DIRECT /end RECORD_LAYOUT
/begin RECORD_LAYOUT a_38 FNC_VALUES 1 UWORD COLUMN_DIR DIRECT /end RECORD_LAYOUT
/begin RECORD_LAYOUT a_43 FNC_VALUES 1 UWORD COLUMN_DIR DIRECT /end RECORD_LAYOUT
/begin RECORD_LAYOUT a_141 FNC_VALUES 1 SBYTE COLUMN_DIR DIRECT /end RECORD_LAYOUT
/begin RECORD_LAYOUT a_156 FNC_VALUES 1 SWORD COLUMN_DIR DIRECT /end RECORD_LAYOUT
/begin RECORD_LAYOUT a_172 FNC_VALUES 1 SWORD ROW_DIR DIRECT /end RECORD_LAYOUT
/begin RECORD_LAYOUT a_173 FNC_VALUES 1 UBYTE ROW_DIR DIRECT /end RECORD_LAYOUT
/begin RECORD_LAYOUT a_174 FNC_VALUES 1 UWORD ROW_DIR DIRECT /end RECORD_LAYOUT
/begin RECORD_LAYOUT a_175 FNC_VALUES 1 SBYTE ROW_DIR DIRECT /end RECORD_LAYOUT
/begin RECORD_LAYOUT a_189 FNC_VALUES 1 SLONG ROW_DIR DIRECT /end RECORD_LAYOUT
/begin RECORD_LAYOUT a_892 AXIS_PTS_X 1 UBYTE INDEX_INCR DIRECT /end RECORD_LAYOUT
/begin RECORD_LAYOUT a_893 AXIS_PTS_X 1 UWORD INDEX_INCR DIRECT /end RECORD_LAYOUT
/end MODULE
/end PROJECT
