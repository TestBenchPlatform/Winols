ASAP2_VERSION 1 2
/begin PROJECT Z42D "011"
/begin HEADER "" VERSION "0AD.03" PROJECT_NO Z011 /end HEADER
/begin MODULE BMW-EASY ""
/begin MOD_COMMON "common attributes" DEPOSIT ABSOLUT BYTE_ORDER BIG_ENDIAN /end MOD_COMMON
/begin MEASUREMENT lr_bank2vanz_kat_diag "ANZ_KAT_DIAG_2" UWORD LINEAR______0_000000__0H___65163 2 2.0 0.0 65535.0 BIT_MASK 0xffffffff /begin IF_DATA ASAP1B_ADDRESS KP_BLOB 0xe4a8 /end IF_DATA /end MEASUREMENT
/begin MEASUREMENT lr_bank2vanz_lam_p "ANZ_LAM_P_2" UBYTE LINEAR______0_000000__0H___25182 2 2.0 0.0 255.0 BIT_MASK 0xffffffff /begin IF_DATA ASAP1B_ADDRESS KP_BLOB 0xe4ca /end IF_DATA /end MEASUREMENT
/begin MEASUREMENT lr_bank2vanz_mager "ANZ_MAGER_FETT_2" UWORD LINEAR______0_000000__0H___65163 2 2.0 0.0 65535.0 BIT_MASK 0xffffffff /begin IF_DATA ASAP1B_ADDRESS KP_BLOB 0xe464 /end IF_DATA /end MEASUREMENT
/begin MEASUREMENT lr_bank2vanz_mager_uls_sl_diag "ANZ_MAGER_ULS_SL_DIAG_2" UWORD LINEAR______0_000000__0H___65163 2 2.0 0.0 65535.0 BIT_MASK 0xffffffff /begin IF_DATA ASAP1B_ADDRESS KP_BLOB 0xe448 /end IF_DATA /end MEASUREMENT
/begin MEASUREMENT lr_bank2vanz_p_begr_dyn "lr_bank2^anz_p_begr_dyn" UBYTE LINEAR______0_000000__0H___25182 2 2.0 0.0 255.0 BIT_MASK 0xffffffff /begin IF_DATA ASAP1B_ADDRESS KP_BLOB 0xe4e0 /end IF_DATA /end MEASUREMENT
/begin MEASUREMENT lr_bank2vanz_p_kat "ANZ_P_KAT_2" UBYTE LINEAR______0_000000__0H___25182 2 2.0 0.0 255.0 BIT_MASK 0xffffffff /begin IF_DATA ASAP1B_ADDRESS KP_BLOB 0xe4da /end IF_DATA /end MEASUREMENT
/begin MEASUREMENT lr_bank2vanz_p_lr_anschl "lr_bank2^anz_p_lr_anschl" UBYTE LINEAR______0_000000__0H___25182 2 2.0 0.0 255.0 BIT_MASK 0xffffffff /begin IF_DATA ASAP1B_ADDRESS KP_BLOB 0xe4df /end IF_DATA /end MEASUREMENT
/begin MEASUREMENT lr_bank2vanz_p_ls_diag "lr_bank2^anz_p_ls_diag" UBYTE LINEAR______0_000000__0H___25182 2 2.0 0.0 255.0 BIT_MASK 0xffffffff /begin IF_DATA ASAP1B_ADDRESS KP_BLOB 0xe4e6 /end IF_DATA /end MEASUREMENT
/begin MEASUREMENT lr_bank2vanz_p_ra_untbr "lr_bank2^anz_p_ra_untbr" UBYTE LINEAR______0_000000__0H___25182 2 2.0 0.0 255.0 BIT_MASK 0xffffffff /begin IF_DATA ASAP1B_ADDRESS KP_BLOB 0xe4de /end IF_DATA /end MEASUREMENT
/begin MEASUREMENT lr_bank2vanz_p_spr "lr_bank2^anz_p_spr" UBYTE LINEAR______0_000000__0H___25182 2 2.0 0.0 255.0 BIT_MASK 0xffffffff /begin IF_DATA ASAP1B_ADDRESS KP_BLOB 0xe4dd /end IF_DATA /end MEASUREMENT
/begin MEASUREMENT lr_bank2vanz_p_te "ANZ_P_TE_2" UBYTE LINEAR______0_000000__0H___25182 2 2.0 0.0 255.0 BIT_MASK 0xffffffff /begin IF_DATA ASAP1B_ADDRESS KP_BLOB 0xe4cb /end IF_DATA /end MEASUREMENT
/begin MEASUREMENT lr_bank2vanz_uls_kat_diag "ANZ_ULS_KAT_DIAG_2" UBYTE LINEAR______0_000000__0H___25142 2 2.0 0.0 255.0 BIT_MASK 0xffffffff /begin IF_DATA ASAP1B_ADDRESS KP_BLOB 0xe4ed /end IF_DATA /end MEASUREMENT
/begin MEASUREMENT lr_bank2vdk_grd_dec_ctr "lr_bank2^dk_grd_dec_ctr" UBYTE LINEAR______0_000000__0H___5_120 2 2.0 0.0 5.12 BIT_MASK 0xffffffff /begin IF_DATA ASAP1B_ADDRESS KP_BLOB 0xe4c1 /end IF_DATA /end MEASUREMENT
/begin MEASUREMENT lr_bank2vdk_grd_sum "DK_GRD_SUM_2" UWORD LINEAR______0_000000__0H___76791 2 2.0 0.0 767916.0 BIT_MASK 0xffffffff /begin IF_DATA ASAP1B_ADDRESS KP_BLOB 0xe47a /end IF_DATA /end MEASUREMENT
/begin MEASUREMENT lr_bank2vdk_grd_sum_zv "DK_GRD_SUM_ZV_2" UWORD LINEAR______0_000000__0H___76953 2 2.0 0.0 767916.0 BIT_MASK 0xffffffff /begin IF_DATA ASAP1B_ADDRESS KP_BLOB 0xe47c /end IF_DATA /end MEASUREMENT
/begin MEASUREMENT lr_bank2vdrehzahl_mwvword "N_MW2" UWORD LINEAR______0_000000__0H___81793 2 2.0 0.0 8160.0 BIT_MASK 0xffffffff /begin IF_DATA ASAP1B_ADDRESS KP_BLOB 0xe42c /end IF_DATA /end MEASUREMENT
/begin MEASUREMENT lr_bank2vkat_diag "KAT_DIAG_2" UWORD LINEAR______0_000000__0H___255_9 2 2.0 0.0 255.996 BIT_MASK 0xffffffff /begin IF_DATA ASAP1B_ADDRESS KP_BLOB 0xe4ac /end IF_DATA /end MEASUREMENT
/begin MEASUREMENT lr_bank2vkat_diag_bk_flags "KAT_DIAG_BK_FLAGS_2" UWORD LINEAR______0_000000__0H___65904 2 2.0 0.0 65535.0 BIT_MASK 0xffffffff /begin IF_DATA ASAP1B_ADDRESS KP_BLOB 0xe434 /end IF_DATA /end MEASUREMENT
/begin MEASUREMENT lr_bank2vkat_diag_err "KAT_DIAG_ERR_2" UBYTE LINEAR______0_000000__0H___25182 2 2.0 0.0 255.0 BIT_MASK 0xffffffff /begin IF_DATA ASAP1B_ADDRESS KP_BLOB 0xe4d3 /end IF_DATA /end MEASUREMENT
/begin MEASUREMENT lr_bank2vkf_t_zv_lr_neg "KF_T_ZV_LR_NEG_2" UWORD LINEAR______0_000000__0H___1_955 2 2.0 0.0 1.2799 BIT_MASK 0xffffffff /begin IF_DATA ASAP1B_ADDRESS KP_BLOB 0xe4a0 /end IF_DATA /end MEASUREMENT
/begin MEASUREMENT lr_bank2vkf_t_zv_lr_pos "KF_T_ZV_LR_POS_2" UWORD LINEAR______0_000000__0H___1_955 2 2.0 0.0 1.2799 BIT_MASK 0xffffffff /begin IF_DATA ASAP1B_ADDRESS KP_BLOB 0xe49e /end IF_DATA /end MEASUREMENT
/begin MEASUREMENT lr_bank2vkf_ti_ad_add_fak "KF_TI_AD_ADD_FAK_2" UBYTE LINEAR______0_000000__0H___0_923 2 2.0 0.0 0.99610001 BIT_MASK 0xffffffff /begin IF_DATA ASAP1B_ADDRESS KP_BLOB 0xe4cd /end IF_DATA /end MEASUREMENT
/begin MEASUREMENT lr_bank2vkf_ti_ad_fak_fak "KF_TI_AD_FAK_FAK_2" UBYTE LINEAR______0_000000__0H___0_923 2 2.0 0.0 0.99610001 BIT_MASK 0xffffffff /begin IF_DATA ASAP1B_ADDRESS KP_BLOB 0xe4cc /end IF_DATA /end MEASUREMENT
/begin MEASUREMENT lr_bank2vlam_i "LAM_I_2" UWORD LINEAR_______50_000000__0H___49_ 2 2.0 -50.0 49.998501 BIT_MASK 0xffffffff /begin IF_DATA ASAP1B_ADDRESS KP_BLOB 0xe416 /end IF_DATA /end MEASUREMENT
/begin MEASUREMENT lr_bank2vlambda_intvbyteC1D "Lambda_Int_2" UBYTE LINEAR_______50_000000__0H___956 2 2.0 -50.0 49.609001 BIT_MASK 0xffffffff /begin IF_DATA ASAP1B_ADDRESS KP_BLOB 0xe427 /end IF_DATA /end MEASUREMENT
/begin MEASUREMENT lr_bank2vlammwvbyteC1D "LAMMW_2" UBYTE LINEAR_______50_000000__0H___957 2 2.0 -50.0 49.609001 BIT_MASK 0xffffffff /begin IF_DATA ASAP1B_ADDRESS KP_BLOB 0xe42b /end IF_DATA /end MEASUREMENT
/begin MEASUREMENT lr_bank2vlammw_gmw_katvwordC1D "LAMMW_GMW_KAT_2" UWORD LINEAR_______50_000000__0H___947 2 2.0 -50.0 49.998501 BIT_MASK 0xffffffff /begin IF_DATA ASAP1B_ADDRESS KP_BLOB 0xe43c /end IF_DATA /end MEASUREMENT
/begin MEASUREMENT lr_bank2vlammw_mwvbyteC1D "LAMMW_MW_2" UBYTE LINEAR_______50_000000__0H___957 2 2.0 -50.0 49.609001 BIT_MASK 0xffffffff /begin IF_DATA ASAP1B_ADDRESS KP_BLOB 0xe429 /end IF_DATA /end MEASUREMENT
/begin MEASUREMENT lr_bank2vlm_int_kat "LM_INT_KAT_2" UWORD LM_INT_SA_RANGE731 2 2.0 0.0 1820.42 BIT_MASK 0xffffffff /begin IF_DATA ASAP1B_ADDRESS KP_BLOB 0xe4b0 /end IF_DATA /end MEASUREMENT
/begin MEASUREMENT lr_bank2vlm_int_zv "LM_INT_ZV_2" UWORD LM_INT_SA_RANGE733 2 2.0 0.0 1820.42 BIT_MASK 0xffffffff /begin IF_DATA ASAP1B_ADDRESS KP_BLOB 0xe490 /end IF_DATA /end MEASUREMENT
/begin MEASUREMENT lr_bank2vlm_int_zv_pi "LM_INT_ZV_PI_2" UWORD LM_INT_SA_RANGE733 2 2.0 0.0 1820.42 BIT_MASK 0xffffffff /begin IF_DATA ASAP1B_ADDRESS KP_BLOB 0xe492 /end IF_DATA /end MEASUREMENT
/begin MEASUREMENT lr_bank2vlm_mwvbyteC1D "LM_MW2" UBYTE MAF_8_RES37 2 2.0 0.0 1389.0 BIT_MASK 0xffffffff /begin IF_DATA ASAP1B_ADDRESS KP_BLOB 0xe42f /end IF_DATA /end MEASUREMENT
/begin MEASUREMENT lr_bank2vlr_fak "LAM_2" UWORD LINEAR_______50_000000__0H___49_ 2 2.0 -50.0 49.998501 BIT_MASK 0xffffffff /begin IF_DATA ASAP1B_ADDRESS KP_BLOB 0xe412 /end IF_DATA /end MEASUREMENT
/begin MEASUREMENT lr_bank2vlr_fak_alt "LAM_ALT_2" UWORD LINEAR_______50_000000__0H___49_ 2 2.0 -50.0 49.998501 BIT_MASK 0xffffffff /begin IF_DATA ASAP1B_ADDRESS KP_BLOB 0xe414 /end IF_DATA /end MEASUREMENT
/begin MEASUREMENT lr_bank2vlr_grz_fett "LR_GRZ_FETT_2" UWORD LINEAR_______50_000000__0H___49_ 2 2.0 -50.0 49.998501 BIT_MASK 0xffffffff /begin IF_DATA ASAP1B_ADDRESS KP_BLOB 0xe41a /end IF_DATA /end MEASUREMENT
/begin MEASUREMENT lr_bank2vlr_grz_mager "LR_GRZ_MAGER_2" UWORD LINEAR_______50_000000__0H___49_ 2 2.0 -50.0 49.998501 BIT_MASK 0xffffffff /begin IF_DATA ASAP1B_ADDRESS KP_BLOB 0xe418 /end IF_DATA /end MEASUREMENT
/begin MEASUREMENT lr_bank2vlr_zustvbyteC0D "" UBYTE LINEAR______0_000000__0H___25905 2 2.0 0.0 255.0 BIT_MASK 0xffffffff /begin IF_DATA ASAP1B_ADDRESS KP_BLOB 0xe40e /end IF_DATA /end MEASUREMENT
/begin MEASUREMENT lr_bank2vlr_zustvbyteC1D "" UBYTE LINEAR______0_000000__0H___25905 2 2.0 0.0 255.0 BIT_MASK 0xffffffff /begin IF_DATA ASAP1B_ADDRESS KP_BLOB 0xe40f /end IF_DATA /end MEASUREMENT
/begin MEASUREMENT lr_bank2vlr1vbyteC0D "" UBYTE LINEAR______0_000000__0H___25905 2 2.0 0.0 255.0 BIT_MASK 0xffffffff /begin IF_DATA ASAP1B_ADDRESS KP_BLOB 0xe410 /end IF_DATA /end MEASUREMENT
/begin MEASUREMENT lr_bank2vlr1vbyteC1D "" UBYTE LINEAR______0_000000__0H___25905 2 2.0 0.0 255.0 BIT_MASK 0xffffffff /begin IF_DATA ASAP1B_ADDRESS KP_BLOB 0xe411 /end IF_DATA /end MEASUREMENT
/begin MEASUREMENT lr_bank2vo2_kat "O2_KAT2" UBYTE LINEAR______0_000000__0H___0_965 2 2.0 0.0 0.99609375 BIT_MASK 0xffffffff /begin IF_DATA ASAP1B_ADDRESS KP_BLOB 0xe4be /end IF_DATA /end MEASUREMENT
/begin MEASUREMENT lr_bank2vo2_kat_dif_sum "O2_KAT_DIF_SUM_2" UWORD LINEAR______0_000000__0H___25741 2 2.0 0.0 255.996 BIT_MASK 0xffffffff /begin IF_DATA ASAP1B_ADDRESS KP_BLOB 0xe4a2 /end IF_DATA /end MEASUREMENT
/begin MEASUREMENT lr_bank2vo2_kat_int "O2_KAT_INT_2" UBYTE LINEAR______0_000000__0H___0_965 2 2.0 0.0 0.99609375 BIT_MASK 0xffffffff /begin IF_DATA ASAP1B_ADDRESS KP_BLOB 0xe4bb /end IF_DATA /end MEASUREMENT
/begin MEASUREMENT lr_bank2vo2_kat_mw "O2_KAT_MW_2" UBYTE LINEAR______0_000000__0H___0_965 2 2.0 0.0 0.99609375 BIT_MASK 0xffffffff /begin IF_DATA ASAP1B_ADDRESS KP_BLOB 0xe4ba /end IF_DATA /end MEASUREMENT
/begin MEASUREMENT lr_bank2vo2_kat_mw_alt "O2_KAT_MW_ALT_2" UBYTE LINEAR______0_000000__0H___0_965 2 2.0 0.0 0.99609375 BIT_MASK 0xffffffff /begin IF_DATA ASAP1B_ADDRESS KP_BLOB 0xe4bc /end IF_DATA /end MEASUREMENT
/begin MEASUREMENT lr_bank2vo2_kat_quo "O2_KAT_QUO_2" UWORD LINEAR______0_000000__0H___1_989 2 2.0 0.0 1.989 BIT_MASK 0xffffffff /begin IF_DATA ASAP1B_ADDRESS KP_BLOB 0xe4ae /end IF_DATA /end MEASUREMENT
/begin MEASUREMENT lr_bank2vo2_kat_quo_sum "O2_KAT_QUO_SUM_2" UWORD LINEAR______0_000000__0H___255_9 2 2.0 0.0 255.996 BIT_MASK 0xffffffff /begin IF_DATA ASAP1B_ADDRESS KP_BLOB 0xe4a6 /end IF_DATA /end MEASUREMENT
/begin MEASUREMENT lr_bank2vo2_kat_sum "O2_KAT_SUM_2" UWORD LINEAR______0_000000__0H___25741 2 2.0 0.0 255.996 BIT_MASK 0xffffffff /begin IF_DATA ASAP1B_ADDRESS KP_BLOB 0xe4a4 /end IF_DATA /end MEASUREMENT
/begin MEASUREMENT lr_bank2vsl_diag_flags "SL_DIAG_FLAGS_2" UBYTE LINEAR______0_000000__0H___25142 2 2.0 0.0 255.0 BIT_MASK 0xffffffff /begin IF_DATA ASAP1B_ADDRESS KP_BLOB 0xe446 /end IF_DATA /end MEASUREMENT
/begin MEASUREMENT lr_bank2vstate_nkat_diag "STATE_NKAT_DIAG_2" UBYTE LINEAR______0_000000__0H___25958 2 2.0 0.0 255.0 BIT_MASK 0xffffffff /begin IF_DATA ASAP1B_ADDRESS KP_BLOB 0xe4ec /end IF_DATA /end MEASUREMENT
/begin MEASUREMENT lr_bank2vsum_mitko_ti_ad_add_ber "SUM_MITKO_TI_AD_ADD_BER_2" UWORD LINEAR______0_000000__0H___25959 2 2.0 0.0 255.996 BIT_MASK 0xffffffff /begin IF_DATA ASAP1B_ADDRESS KP_BLOB 0xe4e2 /end IF_DATA /end MEASUREMENT
/begin MEASUREMENT lr_bank2vsum_mitko_ti_ad_fak_ber "SUM_MITKO_TI_AD_FAK_BER_2" UWORD LINEAR______0_000000__0H___25959 2 2.0 0.0 255.996 BIT_MASK 0xffffffff /begin IF_DATA ASAP1B_ADDRESS KP_BLOB 0xe4e4 /end IF_DATA /end MEASUREMENT
/begin MEASUREMENT lr_bank2vt_ksd_sum_max "T_KSD_SUM_MAX_2" UWORD LINEAR______0_000000__0H___13960 2 2.0 0.0 1310.7 BIT_MASK 0xffffffff /begin IF_DATA ASAP1B_ADDRESS KP_BLOB 0xe472 /end IF_DATA /end MEASUREMENT
/begin MEASUREMENT lr_bank2vt_ksd_sum_min "T_KSD_SUM_MIN_2" UWORD LINEAR______0_000000__0H___13960 2 2.0 0.0 1310.7 BIT_MASK 0xffffffff /begin IF_DATA ASAP1B_ADDRESS KP_BLOB 0xe474 /end IF_DATA /end MEASUREMENT
/begin MEASUREMENT lr_bank2vt_zv_ad "T_ZV_LAM_AD_2" SWORD LINEAR_______640_020000__FFFF800 2 2.0 -640.02 639.98 BIT_MASK 0xffffffff /begin IF_DATA ASAP1B_ADDRESS KP_BLOB 0xe48a /end IF_DATA /end MEASUREMENT
/begin MEASUREMENT lr_bank2vt_zv_ad_gmw "T_ZV_LAM_AD_GMW_2" SWORD LINEAR_______640_020000__FFFF800 2 2.0 -640.02 639.98 BIT_MASK 0xffffffff /begin IF_DATA ASAP1B_ADDRESS KP_BLOB 0xe48c /end IF_DATA /end MEASUREMENT
/begin MEASUREMENT lr_bank2vt_zv_ivwordC1D "T_ZV_LAM_I_2" SWORD LINEAR_______640_020000__FFFF800 2 2.0 -640.02 639.98 BIT_MASK 0xffffffff /begin IF_DATA ASAP1B_ADDRESS KP_BLOB 0xe488 /end IF_DATA /end MEASUREMENT
/begin MEASUREMENT lr_bank2vt_zv_lam "T_ZV_LAM_2" SWORD LINEAR_______1280_000000__FFFFC0 2 2.0 -1280.0 1279.9 BIT_MASK 0xffffffff /begin IF_DATA ASAP1B_ADDRESS KP_BLOB 0xe48e /end IF_DATA /end MEASUREMENT
/begin MEASUREMENT lr_bank2vt_zv_lam_neg "T_ZV_LAM_NEG_2" UWORD LINEAR______0_000000__0H___5_119 2 2.0 0.0 5.1196 BIT_MASK 0xffffffff /begin IF_DATA ASAP1B_ADDRESS KP_BLOB 0xe482 /end IF_DATA /end MEASUREMENT
/begin MEASUREMENT lr_bank2vt_zv_lam_pos "T_ZV_LAM_POS_2" UWORD LINEAR______0_000000__0H___5_119 2 2.0 0.0 5.1196 BIT_MASK 0xffffffff /begin IF_DATA ASAP1B_ADDRESS KP_BLOB 0xe480 /end IF_DATA /end MEASUREMENT
/begin MEASUREMENT lr_bank2vt_zv_p "T_ZV_LAM_P_2" SWORD LINEAR_______640_020000__FFFF800 2 2.0 -640.02 639.98 BIT_MASK 0xffffffff /begin IF_DATA ASAP1B_ADDRESS KP_BLOB 0xe484 /end IF_DATA /end MEASUREMENT
/begin MEASUREMENT lr_bank2vti_ad_add_gmw "TI_AD_ADD_GMW_2" UWORD TI_SGN_16_RES 2 2.0 -131.072 131.068 BIT_MASK 0xffffffff /begin IF_DATA ASAP1B_ADDRESS KP_BLOB 0xe41c /end IF_DATA /end MEASUREMENT
/begin MEASUREMENT lr_bank2vti_ad_add_gmw_ms "TI_AD_ADD_GMW_MS_2" SWORD TI_2co_SGN_16_RES 2 2.0 -131.072 131.068 BIT_MASK 0xffffffff /begin IF_DATA ASAP1B_ADDRESS KP_BLOB 0xe41e /end IF_DATA /end MEASUREMENT
/begin MEASUREMENT lr_bank2vti_ad_add_gmw_pr "TI_AD_ADD_GMW_PR_2" SWORD LINEAR_______50_000000__FFFF8961 2 2.0 -50.0 49.998501 BIT_MASK 0xffffffff /begin IF_DATA ASAP1B_ADDRESS KP_BLOB 0xe420 /end IF_DATA /end MEASUREMENT
/begin MEASUREMENT lr_bank2vti_ad_fak_gmw "TI_AD_FAK_GMW_2" UWORD LINEAR_______50_000000__0H___947 2 2.0 -50.0 49.998501 BIT_MASK 0xffffffff /begin IF_DATA ASAP1B_ADDRESS KP_BLOB 0xe422 /end IF_DATA /end MEASUREMENT
/begin MEASUREMENT lr_bank2vti_ks "TI_KS_2" UWORD LINEAR______0_000000__0H___15962 2 2.0 0.0 15.99975 BIT_MASK 0xffffffff /begin IF_DATA ASAP1B_ADDRESS KP_BLOB 0xe46e /end IF_DATA /end MEASUREMENT
/begin MEASUREMENT lr_bank2vti_lam "TI_LAM_2" UWORD LINEAR_______100_00000__0H___100 2 2.0 -100.0 100.0 BIT_MASK 0xffffffff /begin IF_DATA ASAP1B_ADDRESS KP_BLOB 0xe424 /end IF_DATA /end MEASUREMENT
/begin MEASUREMENT lr_bank2vti_ohne_totz "TI_OHNE_TOTZ_2" UWORD LINEAR______0_000000__0H___26921 2 2.0 0.0 262.144 BIT_MASK 0xffffffff /begin IF_DATA ASAP1B_ADDRESS KP_BLOB 0xe470 /end IF_DATA /end MEASUREMENT
/begin MEASUREMENT lr_bank2vtib "TIB_2" UWORD LINEAR______0_000000__0H___26963 2 2.0 0.0 262.144 BIT_MASK 0xffffffff /begin IF_DATA ASAP1B_ADDRESS KP_BLOB 0xe46c /end IF_DATA /end MEASUREMENT
/begin MEASUREMENT lr_bank2vtkat "TKAT_2" UWORD LINEAR______0_000000__0H___10964 2 2.0 0.0 1023.0 BIT_MASK 0xffffffff /begin IF_DATA ASAP1B_ADDRESS KP_BLOB 0xe44a /end IF_DATA /end MEASUREMENT
/begin MEASUREMENT lr_bank2vuls "ULS_VKAT_2_NDIAG" UBYTE LINEAR______0_000000__0H___1_873 2 2.0 0.0 1.275 BIT_MASK 0xffffffff /begin IF_DATA ASAP1B_ADDRESS KP_BLOB 0xe4c3 /end IF_DATA /end MEASUREMENT
/begin MEASUREMENT lr_bank2vuls_10ms "ULS_VKAT_2_VDIAG_10MS" UBYTE LINEAR______0_000000__0H___1_873 2 2.0 0.0 1.275 BIT_MASK 0xffffffff /begin IF_DATA ASAP1B_ADDRESS KP_BLOB 0xe4ce /end IF_DATA /end MEASUREMENT
/begin MEASUREMENT lr_bank2vuls_alt "ULS_VKAT_2_VDIAG_ALT" UBYTE LINEAR______0_000000__0H___1_873 2 2.0 0.0 1.275 BIT_MASK 0xffffffff /begin IF_DATA ASAP1B_ADDRESS KP_BLOB 0xe4d0 /end IF_DATA /end MEASUREMENT
/begin MEASUREMENT lr_bank2vuls_diag_zust "ULS_DIAG_ZUST_2" UBYTE LINEAR______0_000000__0H___25142 2 2.0 0.0 255.0 BIT_MASK 0xffffffff /begin IF_DATA ASAP1B_ADDRESS KP_BLOB 0xe4cf /end IF_DATA /end MEASUREMENT
/begin MEASUREMENT lr_bank2vuls_dif_zv "ULS_DIF_ZV_2" UBYTE LINEAR_______0_637500__0H___0965 2 2.0 -0.6375 0.6375 BIT_MASK 0xffffffff /begin IF_DATA ASAP1B_ADDRESS KP_BLOB 0xe4e7 /end IF_DATA /end MEASUREMENT
/begin MEASUREMENT lr_bank2vuls_fett_zyka "ULS_FETT_ZYKA_2" UWORD LINEAR______0_000000__0H___13966 2 2.0 0.0 1310.7 BIT_MASK 0xffffffff /begin IF_DATA ASAP1B_ADDRESS KP_BLOB 0xe43e /end IF_DATA /end MEASUREMENT
/begin MEASUREMENT lr_bank2vuls_fett_zyka_kat "ULS_FETT_ZYKA_NKAT_2" UWORD LINEAR______0_000000__0H___65842 2 2.0 0.0 655.34998 BIT_MASK 0xffffffff /begin IF_DATA ASAP1B_ADDRESS KP_BLOB 0xe442 /end IF_DATA /end MEASUREMENT
/begin MEASUREMENT lr_bank2vuls_frq_fett_quo "ULS_FRQ_FETT_QUO_2" UWORD LINEAR______0_000000__0H___255_9 2 2.0 0.0 255.996 BIT_MASK 0xffffffff /begin IF_DATA ASAP1B_ADDRESS KP_BLOB 0xe454 /end IF_DATA /end MEASUREMENT
/begin MEASUREMENT lr_bank2vuls_frq_mager_quo "ULS_FRQ_MAGER_QUO_2" UWORD LINEAR______0_000000__0H___255_9 2 2.0 0.0 255.996 BIT_MASK 0xffffffff /begin IF_DATA ASAP1B_ADDRESS KP_BLOB 0xe456 /end IF_DATA /end MEASUREMENT
/begin MEASUREMENT lr_bank2vuls_gmw_maxvbyteC1D "ULS_GMW_MAX_VKAT_2" UBYTE LINEAR______0_000000__0H___1_873 2 2.0 0.0 1.275 BIT_MASK 0xffffffff /begin IF_DATA ASAP1B_ADDRESS KP_BLOB 0xe431 /end IF_DATA /end MEASUREMENT
/begin MEASUREMENT lr_bank2vuls_gmw_minvbyteC1D "ULS_GMW_MIN_VKAT_2" UBYTE LINEAR______0_000000__0H___1_873 2 2.0 0.0 1.275 BIT_MASK 0xffffffff /begin IF_DATA ASAP1B_ADDRESS KP_BLOB 0xe433 /end IF_DATA /end MEASUREMENT
/begin MEASUREMENT lr_bank2vuls_kat "ULS_KAT_2" UBYTE LINEAR______0_000000__0H___1_873 2 2.0 0.0 1.275 BIT_MASK 0xffffffff /begin IF_DATA ASAP1B_ADDRESS KP_BLOB 0xe4d6 /end IF_DATA /end MEASUREMENT
/begin MEASUREMENT lr_bank2vuls_kat_entry_sa "ULS_KAT_ENTRY_SA_2" UBYTE LINEAR______0_000000__0H___1_873 2 2.0 0.0 1.275 BIT_MASK 0xffffffff /begin IF_DATA ASAP1B_ADDRESS KP_BLOB 0xe4ee /end IF_DATA /end MEASUREMENT
/begin MEASUREMENT lr_bank2vuls_kat_exit_sa "ULS_KAT_EXIT_SA_2" UBYTE LINEAR______0_000000__0H___1_873 2 2.0 0.0 1.275 BIT_MASK 0xffffffff /begin IF_DATA ASAP1B_ADDRESS KP_BLOB 0xe4ef /end IF_DATA /end MEASUREMENT
/begin MEASUREMENT lr_bank2vuls_kat_gmwvbyteC1D "ULS_DOWN_GMW_2" UBYTE LINEAR______0_000000__0H___1_275 2 2.0 0.0 1.275 BIT_MASK 0xffffffff /begin IF_DATA ASAP1B_ADDRESS KP_BLOB 0xe4d9 /end IF_DATA /end MEASUREMENT
/begin MEASUREMENT lr_bank2vuls_kat_o2_sumvlongword "ULS_KAT2_O2_SUM_LONG" ULONG UNSIGNED_LONG967 2 2.0 0.0 4.2949673e+009 BIT_MASK 0xffffffff /begin IF_DATA ASAP1B_ADDRESS KP_BLOB 0xe4b6 /end IF_DATA /end MEASUREMENT
/begin MEASUREMENT lr_bank2vuls_kat_o2_sumvwordC1D "ULS_KAT2_O2_SUM_HIGH_WORD" UWORD LINEAR______0_000000__0H___42949 2 2.0 0.0 4.2949673e+009 BIT_MASK 0xffffffff /begin IF_DATA ASAP1B_ADDRESS KP_BLOB 0xe4b8 /end IF_DATA /end MEASUREMENT
/begin MEASUREMENT lr_bank2vuls_kat_roh "ULS_DOWN_2" UBYTE LINEAR______0_000000__0H___1_873 2 2.0 0.0 1.275 BIT_MASK 0xffffffff /begin IF_DATA ASAP1B_ADDRESS KP_BLOB 0xe4d5 /end IF_DATA /end MEASUREMENT
/begin MEASUREMENT lr_bank2vuls_kat_zyka "ULS_KAT_ZYKA_2" UBYTE LINEAR______0_000000__0H___1_155 2 2.0 0.0 1.9961 BIT_MASK 0xffffffff /begin IF_DATA ASAP1B_ADDRESS KP_BLOB 0xe4f1 /end IF_DATA /end MEASUREMENT
/begin MEASUREMENT lr_bank2vuls_kat_zyka_akt "ULS_KAT_ZYKA_AKT_2" UBYTE LINEAR______0_000000__0H___51740 2 2.0 0.0 5100.0 BIT_MASK 0xffffffff /begin IF_DATA ASAP1B_ADDRESS KP_BLOB 0xe4f2 /end IF_DATA /end MEASUREMENT
/begin MEASUREMENT lr_bank2vuls_kat_zyka_quo_sum "ULS_KAT_ZYKA_QUO_SUM_2" UWORD LINEAR______0_000000__0H___509_0 2 2.0 0.0 509.0055 BIT_MASK 0xffffffff /begin IF_DATA ASAP1B_ADDRESS KP_BLOB 0xe4f4 /end IF_DATA /end MEASUREMENT
/begin MEASUREMENT lr_bank2vuls_km_diag_cnt "ULS_KM_DIAG_CNT_2" UWORD LINEAR______0_000000__0H___65968 2 2.0 0.0 65535.0 BIT_MASK 0xffffffff /begin IF_DATA ASAP1B_ADDRESS KP_BLOB 0xe478 /end IF_DATA /end MEASUREMENT
/begin MEASUREMENT lr_bank2vuls_km_nkat_diag_cnt "ULS_KM_NKAT_DIAG_CNT_2" UWORD LINEAR______0_000000__0H___65769 2 2.0 0.0 65535.0 BIT_MASK 0xffffffff /begin IF_DATA ASAP1B_ADDRESS KP_BLOB 0xe4b4 /end IF_DATA /end MEASUREMENT
/begin MEASUREMENT lr_bank2vuls_lb_diag_cnt "ULS_LB_DIAG_CNT_2" UWORD LINEAR______0_000000__0H___65968 2 2.0 0.0 65535.0 BIT_MASK 0xffffffff /begin IF_DATA ASAP1B_ADDRESS KP_BLOB 0xe476 /end IF_DATA /end MEASUREMENT
/begin MEASUREMENT lr_bank2vuls_lb_nkat_diag_cnt "ULS_LB_NKAT_DIAG_CNT_2" UWORD LINEAR______0_000000__0H___65769 2 2.0 0.0 65535.0 BIT_MASK 0xffffffff /begin IF_DATA ASAP1B_ADDRESS KP_BLOB 0xe4b2 /end IF_DATA /end MEASUREMENT
/begin MEASUREMENT lr_bank2vuls_mager_zyka "ULS_MAGER_ZYKA_2" UWORD LINEAR______0_000000__0H___13966 2 2.0 0.0 1310.7 BIT_MASK 0xffffffff /begin IF_DATA ASAP1B_ADDRESS KP_BLOB 0xe440 /end IF_DATA /end MEASUREMENT
/begin MEASUREMENT lr_bank2vuls_mager_zyka_kat "ULS_MAGER_ZYKA_NKAT_2" UWORD LINEAR______0_000000__0H___65842 2 2.0 0.0 655.34998 BIT_MASK 0xffffffff /begin IF_DATA ASAP1B_ADDRESS KP_BLOB 0xe444 /end IF_DATA /end MEASUREMENT
/begin MEASUREMENT lr_bank2vuls_max_zyka "lr_bank2^uls_max_zyka" UBYTE LINEAR______0_000000__0H___1_873 2 2.0 0.0 1.275 BIT_MASK 0xffffffff /begin IF_DATA ASAP1B_ADDRESS KP_BLOB 0xe4d1 /end IF_DATA /end MEASUREMENT
/begin MEASUREMENT lr_bank2vuls_max_zyka_f "ULS_MAX_ZYKA_F_2" UWORD LINEAR______0_000000__0H___13969 2 2.0 0.0 1310.7 BIT_MASK 0xffffffff /begin IF_DATA ASAP1B_ADDRESS KP_BLOB 0xe452 /end IF_DATA /end MEASUREMENT
/begin MEASUREMENT lr_bank2vuls_max_zyka_fett "ULS_MAX_ZYKA_FETT_2" UWORD LINEAR______0_000000__0H___65842 2 2.0 0.0 655.34998 BIT_MASK 0xffffffff /begin IF_DATA ASAP1B_ADDRESS KP_BLOB 0xe46a /end IF_DATA /end MEASUREMENT
/begin MEASUREMENT lr_bank2vuls_max_zyka_m "ULS_MAX_ZYKA_M_2" UWORD LINEAR______0_000000__0H___13969 2 2.0 0.0 1310.7 BIT_MASK 0xffffffff /begin IF_DATA ASAP1B_ADDRESS KP_BLOB 0xe450 /end IF_DATA /end MEASUREMENT
/begin MEASUREMENT lr_bank2vuls_max_zyka_mager "ULS_MAX_ZYKA_MAGER_2" UWORD LINEAR______0_000000__0H___65842 2 2.0 0.0 655.34998 BIT_MASK 0xffffffff /begin IF_DATA ASAP1B_ADDRESS KP_BLOB 0xe468 /end IF_DATA /end MEASUREMENT
/begin MEASUREMENT lr_bank2vuls_min_zyka "lr_bank2^uls_min_zyka" UBYTE LINEAR______0_000000__0H___1_873 2 2.0 0.0 1.275 BIT_MASK 0xffffffff /begin IF_DATA ASAP1B_ADDRESS KP_BLOB 0xe4d2 /end IF_DATA /end MEASUREMENT
/begin MEASUREMENT lr_bank2vuls_ob "ULS_OB_VKAT_2" UBYTE LINEAR______0_000000__0H___1_873 2 2.0 0.0 1.275 BIT_MASK 0xffffffff /begin IF_DATA ASAP1B_ADDRESS KP_BLOB 0xe4c5 /end IF_DATA /end MEASUREMENT
/begin MEASUREMENT lr_bank2vuls_roh "ULS_VKAT_2_VDIAG" UBYTE LINEAR______0_000000__0H___1_873 2 2.0 0.0 1.275 BIT_MASK 0xffffffff /begin IF_DATA ASAP1B_ADDRESS KP_BLOB 0xe4c4 /end IF_DATA /end MEASUREMENT
/begin MEASUREMENT lr_bank2vuls_unt "ULS_UNT_VKAT_2" UBYTE LINEAR______0_000000__0H___1_873 2 2.0 0.0 1.275 BIT_MASK 0xffffffff /begin IF_DATA ASAP1B_ADDRESS KP_BLOB 0xe4c6 /end IF_DATA /end MEASUREMENT
/begin MEASUREMENT lr_bank2vuls_zyka_f_s "ULS_ZYKA_F_S_2" UWORD LINEAR______0_000000__0H___13969 2 2.0 0.0 1310.7 BIT_MASK 0xffffffff /begin IF_DATA ASAP1B_ADDRESS KP_BLOB 0xe44e /end IF_DATA /end MEASUREMENT
/begin MEASUREMENT lr_bank2vuls_zyka_fett "ULS_ZYKA_FETT_2" UWORD LINEAR______0_000000__0H___25959 2 2.0 0.0 255.996 BIT_MASK 0xffffffff /begin IF_DATA ASAP1B_ADDRESS KP_BLOB 0xe45a /end IF_DATA /end MEASUREMENT
/begin MEASUREMENT lr_bank2vuls_zyka_fett_quo "ULS_ZYKA_FETT_QUO_2" UWORD LINEAR______0_000000__0H___25970 2 2.0 0.0 255.996 BIT_MASK 0xffffffff /begin IF_DATA ASAP1B_ADDRESS KP_BLOB 0xe45e /end IF_DATA /end MEASUREMENT
/begin MEASUREMENT lr_bank2vuls_zyka_fett_quo_sum "ULS_ZYKA_FETT_QUO_SUM_2" UWORD LINEAR______0_000000__0H___25970 2 2.0 0.0 255.996 BIT_MASK 0xffffffff /begin IF_DATA ASAP1B_ADDRESS KP_BLOB 0xe462 /end IF_DATA /end MEASUREMENT
/begin MEASUREMENT lr_bank2vuls_zyka_fm "ULS_ZYKA_FM_2" UWORD LINEAR______0_000000__0H___655_3 2 2.0 0.0 655.34998 BIT_MASK 0xffffffff /begin IF_DATA ASAP1B_ADDRESS KP_BLOB 0xe438 /end IF_DATA /end MEASUREMENT
/begin MEASUREMENT lr_bank2vuls_zyka_m_s "ULS_ZYKA_M_S_2" UWORD LINEAR______0_000000__0H___13969 2 2.0 0.0 1310.7 BIT_MASK 0xffffffff /begin IF_DATA ASAP1B_ADDRESS KP_BLOB 0xe44c /end IF_DATA /end MEASUREMENT
/begin MEASUREMENT lr_bank2vuls_zyka_mager "ULS_ZYKA_MAGER_2" UWORD LINEAR______0_000000__0H___255_9 2 2.0 0.0 255.996 BIT_MASK 0xffffffff /begin IF_DATA ASAP1B_ADDRESS KP_BLOB 0xe458 /end IF_DATA /end MEASUREMENT
/begin MEASUREMENT lr_bank2vuls_zyka_mager_quo "ULS_ZYKA_MAGER_QUO_2" UWORD LINEAR______0_000000__0H___25970 2 2.0 0.0 255.996 BIT_MASK 0xffffffff /begin IF_DATA ASAP1B_ADDRESS KP_BLOB 0xe45c /end IF_DATA /end MEASUREMENT
/begin MEASUREMENT lr_bank2vuls_zyka_mager_quo_sum "ULS_ZYKA_MAGER_QUO_SUM_2" UWORD LINEAR______0_000000__0H___25970 2 2.0 0.0 255.996 BIT_MASK 0xffffffff /begin IF_DATA ASAP1B_ADDRESS KP_BLOB 0xe460 /end IF_DATA /end MEASUREMENT
/begin MEASUREMENT lr_bank2vuls_zyka_mf "ULS_ZYKA_MF_2" UWORD LINEAR______0_000000__0H___655_3 2 2.0 0.0 655.34998 BIT_MASK 0xffffffff /begin IF_DATA ASAP1B_ADDRESS KP_BLOB 0xe436 /end IF_DATA /end MEASUREMENT
/begin MEASUREMENT lr_bank2vz_katw_diag "lr_bank2^Z_KATW_DIAG" UBYTE LINEAR______0_000000__0H___25182 2 2.0 0.0 255.0 BIT_MASK 0xffffffff /begin IF_DATA ASAP1B_ADDRESS KP_BLOB 0xe4d4 /end IF_DATA /end MEASUREMENT
/begin MEASUREMENT lr_bank2vz_lam_anz_p_ll "Z_LAM_ANZ_P_LL_2" UBYTE LINEAR______0_000000__0H___25142 2 2.0 0.0 255.0 BIT_MASK 0xffffffff /begin IF_DATA ASAP1B_ADDRESS KP_BLOB 0xe4c7 /end IF_DATA /end MEASUREMENT
/begin MEASUREMENT lr_bank2vz_lam_max_zyka "lr_bank2^z_lam_max_zyka" UBYTE LINEAR______0_000000__0H___25764 2 2.0 0.0 255.0 BIT_MASK 0xffffffff /begin IF_DATA ASAP1B_ADDRESS KP_BLOB 0xe4c8 /end IF_DATA /end MEASUREMENT
/begin MEASUREMENT lr_bank2vz_lam_wechsel "Z_LAM_WECHSEL_2" UBYTE LINEAR______0_000000__0H___25182 2 2.0 0.0 255.0 BIT_MASK 0xffffffff /begin IF_DATA ASAP1B_ADDRESS KP_BLOB 0xe4c9 /end IF_DATA /end MEASUREMENT
/begin MEASUREMENT lr_bank2vz_lam_zyka_diag "lr_bank2^z_lam_zyka_diag" UWORD LINEAR______0_000000__0H___65163 2 2.0 0.0 65535.0 BIT_MASK 0xffffffff /begin IF_DATA ASAP1B_ADDRESS KP_BLOB 0xe40c /end IF_DATA /end MEASUREMENT
/begin MEASUREMENT lr_bank2vzv_counter "lr_bank2^zv_counter" UWORD LINEAR______0_000000__0H___65971 2 2.0 0.0 65535.0 BIT_MASK 0xffffffff /begin IF_DATA ASAP1B_ADDRESS KP_BLOB 0xe47e /end IF_DATA /end MEASUREMENT
/begin MEASUREMENT LR_langsam "LR_langsam" UWORD RANGE________aktiv___1H__1H__895 2 2.0 0 65535 BIT_MASK 0x2 /begin IF_DATA ASAP1B_ADDRESS KP_BLOB 0xfd48 /end IF_DATA /end MEASUREMENT
/begin MEASUREMENT lr_trim_ad_1 "LR_TRIM_AD_1" UWORD RANGE________aktiv___1H__1H__972 2 2.0 0 65535 BIT_MASK 0x2000 /begin IF_DATA ASAP1B_ADDRESS KP_BLOB 0xe34a /end IF_DATA /end MEASUREMENT
/begin MEASUREMENT lr_trim_ad_2 "LR_TRIM_AD_2" UWORD RANGE________aktiv___1H__1H__972 2 2.0 0 65535 BIT_MASK 0x2000 /begin IF_DATA ASAP1B_ADDRESS KP_BLOB 0xe434 /end IF_DATA /end MEASUREMENT
/begin MEASUREMENT lr_trim_diag_1 "LR_TRIM_DIAG_1" UWORD RANGE________aktiv___1H__1H__972 2 2.0 0 65535 BIT_MASK 0x4000 /begin IF_DATA ASAP1B_ADDRESS KP_BLOB 0xe34a /end IF_DATA /end MEASUREMENT
/begin MEASUREMENT lr_trim_diag_2 "LR_TRIM_DIAG_2" UWORD RANGE________aktiv___1H__1H__972 2 2.0 0 65535 BIT_MASK 0x4000 /begin IF_DATA ASAP1B_ADDRESS KP_BLOB 0xe434 /end IF_DATA /end MEASUREMENT
/begin MEASUREMENT lr_trim_ireg_1 "LR_TRIM_IREG_1" UBYTE RANGE________aktiv___1H__1H__932 2 2.0 0 255 BIT_MASK 0x2 /begin IF_DATA ASAP1B_ADDRESS KP_BLOB 0xe327 /end IF_DATA /end MEASUREMENT
/begin MEASUREMENT lr_trim_ireg_2 "LR_TRIM_IREG_2" UBYTE RANGE________aktiv___1H__1H__932 2 2.0 0 255 BIT_MASK 0x2 /begin IF_DATA ASAP1B_ADDRESS KP_BLOB 0xe411 /end IF_DATA /end MEASUREMENT
/begin MEASUREMENT lr_trim_reg_1 "LR_TRIM_REG_1" UBYTE RANGE________aktiv___1H__1H__932 2 2.0 0 255 BIT_MASK 0x1 /begin IF_DATA ASAP1B_ADDRESS KP_BLOB 0xe327 /end IF_DATA /end MEASUREMENT
/begin MEASUREMENT lr_trim_reg_2 "LR_TRIM_REG_2" UBYTE RANGE________aktiv___1H__1H__932 2 2.0 0 255 BIT_MASK 0x1 /begin IF_DATA ASAP1B_ADDRESS KP_BLOB 0xe411 /end IF_DATA /end MEASUREMENT
/begin MEASUREMENT LR1_angehalten "LR1_angehalten" UBYTE RANGE________JA___1H__1H____N948 2 2.0 0 255 BIT_MASK 0x40 /begin IF_DATA ASAP1B_ADDRESS KP_BLOB 0xe325 /end IF_DATA /end MEASUREMENT
/begin MEASUREMENT LR1_gesperrt "LR1_gesperrt" UBYTE RANGE________JA___1H__1H____NEIN 2 2.0 0 255 BIT_MASK 0x4 /begin IF_DATA ASAP1B_ADDRESS KP_BLOB 0xe324 /end IF_DATA /end MEASUREMENT
/begin MEASUREMENT LR1_KSD "LR1_KSD" UBYTE RANGE________aktiv___1H__1H__973 2 2.0 0 255 BIT_MASK 0x4 /begin IF_DATA ASAP1B_ADDRESS KP_BLOB 0xe326 /end IF_DATA /end MEASUREMENT
/begin MEASUREMENT LR1_LL "LR1_LL" UBYTE RANGE________aktiv___1H__1H__932 2 2.0 0 255 BIT_MASK 0x10 /begin IF_DATA ASAP1B_ADDRESS KP_BLOB 0xe325 /end IF_DATA /end MEASUREMENT
/begin MEASUREMENT LR1_Reglerrichtung "LR1_Reglerrichtung" UBYTE RANGE________fett___1H__1H____ma 2 2.0 0 255 BIT_MASK 0x8 /begin IF_DATA ASAP1B_ADDRESS KP_BLOB 0xe325 /end IF_DATA /end MEASUREMENT
/begin MEASUREMENT LR1_ruecksteuern "LR1_ruecksteuern" UBYTE RANGE________aktiv___1H__1H_____ 2 2.0 0 255 BIT_MASK 0x8 /begin IF_DATA ASAP1B_ADDRESS KP_BLOB 0xe324 /end IF_DATA /end MEASUREMENT
/begin MEASUREMENT LR1_SPERR_ERR "LR1_SPERR_ERR" UBYTE RANGE________JA___1H__1H____N948 2 2.0 0 255 BIT_MASK 0x2 /begin IF_DATA ASAP1B_ADDRESS KP_BLOB 0xe326 /end IF_DATA /end MEASUREMENT
/begin MEASUREMENT lr2 "" UWORD LINEAR______0_000000__0H___65904 2 2.0 0.0 65535.0 BIT_MASK 0xffffffff /begin IF_DATA ASAP1B_ADDRESS KP_BLOB 0xfd48 /end IF_DATA /end MEASUREMENT
/begin MEASUREMENT LR2_angehalten "LR2_angehalten" UBYTE RANGE________JA___1H__1H____N948 2 2.0 0 255 BIT_MASK 0x40 /begin IF_DATA ASAP1B_ADDRESS KP_BLOB 0xe40f /end IF_DATA /end MEASUREMENT
/begin MEASUREMENT LR2_gesperrt "LR2_gesperrt" UBYTE RANGE________JA___1H__1H____NEIN 2 2.0 0 255 BIT_MASK 0x4 /begin IF_DATA ASAP1B_ADDRESS KP_BLOB 0xe40e /end IF_DATA /end MEASUREMENT
/begin MEASUREMENT LR2_KSD "LR2_KSD" UBYTE RANGE________aktiv___1H__1H__973 2 2.0 0 255 BIT_MASK 0x4 /begin IF_DATA ASAP1B_ADDRESS KP_BLOB 0xe410 /end IF_DATA /end MEASUREMENT
/begin MEASUREMENT LR2_LL "LR2_LL" UBYTE RANGE________aktiv___1H__1H__932 2 2.0 0 255 BIT_MASK 0x10 /begin IF_DATA ASAP1B_ADDRESS KP_BLOB 0xe40f /end IF_DATA /end MEASUREMENT
/begin MEASUREMENT LR2_Reglerrichtung "LR2_Reglerrichtung" UBYTE RANGE________fett___1H__1H____ma 2 2.0 0 255 BIT_MASK 0x8 /begin IF_DATA ASAP1B_ADDRESS KP_BLOB 0xe40f /end IF_DATA /end MEASUREMENT
/begin MEASUREMENT LR2_ruecksteuern "LR2_ruecksteuern" UBYTE RANGE________aktiv___1H__1H_____ 2 2.0 0 255 BIT_MASK 0x8 /begin IF_DATA ASAP1B_ADDRESS KP_BLOB 0xe40e /end IF_DATA /end MEASUREMENT
/begin MEASUREMENT LR2_SPERR_ERR "LR2_SPERR_ERR" UBYTE RANGE________JA___1H__1H____N948 2 2.0 0 255 BIT_MASK 0x2 /begin IF_DATA ASAP1B_ADDRESS KP_BLOB 0xe410 /end IF_DATA /end MEASUREMENT
/begin MEASUREMENT lsh_bank1vanz_lsh_diag "ANZ_LSH_DIAG_VKAT1" UBYTE LINEAR______0_000000__0H___25188 2 2.0 0.0 255.0 BIT_MASK 0xffffffff /begin IF_DATA ASAP1B_ADDRESS KP_BLOB 0xcec7 /end IF_DATA /end MEASUREMENT
/begin MEASUREMENT lsh_bank1vanz_zyka_lsh_diag "ANZ_ZYKA_LSH_DIAG_VKAT1" UBYTE LINEAR______0_000000__0H___25188 2 2.0 0.0 255.0 BIT_MASK 0xffffffff /begin IF_DATA ASAP1B_ADDRESS KP_BLOB 0xcec6 /end IF_DATA /end MEASUREMENT
/begin MEASUREMENT lsh_bank1vilsh "ILSH_NIEDR_FRQ_VKAT1" UWORD LINEAR______0_000000__0H___4_995 2 2.0 0.0 4.9951167 BIT_MASK 0xffffffff /begin IF_DATA ASAP1B_ADDRESS KP_BLOB 0xceca /end IF_DATA /end MEASUREMENT
/begin MEASUREMENT lsh_bank1vkf_talsh "KF_TALSH_VKAT_1" UBYTE LINEAR______0_000000__0H___99974 2 2.0 0.0 99.610001 BIT_MASK 0xffffffff /begin IF_DATA ASAP1B_ADDRESS KP_BLOB 0xcecd /end IF_DATA /end MEASUREMENT
/begin MEASUREMENT lsh_bank1vrlsh "RLSH_VKAT1" UWORD LINEAR______0_000000__0H___25808 2 2.0 0.0 255.996 BIT_MASK 0xffffffff /begin IF_DATA ASAP1B_ADDRESS KP_BLOB 0xcec8 /end IF_DATA /end MEASUREMENT
/begin MEASUREMENT lsh_bank1vtalsh "TALSH_VKAT_1" UBYTE LINEAR______0_000000__0H___99974 2 2.0 0.0 99.610001 BIT_MASK 0xffffffff /begin IF_DATA ASAP1B_ADDRESS KP_BLOB 0xcecc /end IF_DATA /end MEASUREMENT
/begin MEASUREMENT lsh_bank2vanz_lsh_diag "ANZ_LSH_DIAG_VKAT2" UBYTE LINEAR______0_000000__0H___25188 2 2.0 0.0 255.0 BIT_MASK 0xffffffff /begin IF_DATA ASAP1B_ADDRESS KP_BLOB 0xced1 /end IF_DATA /end MEASUREMENT
/begin MEASUREMENT lsh_bank2vanz_zyka_lsh_diag "ANZ_ZYKA_LSH_DIAG_VKAT2" UBYTE LINEAR______0_000000__0H___25188 2 2.0 0.0 255.0 BIT_MASK 0xffffffff /begin IF_DATA ASAP1B_ADDRESS KP_BLOB 0xced0 /end IF_DATA /end MEASUREMENT
/begin MEASUREMENT lsh_bank2vilsh "ILSH_NIEDR_FRQ_VKAT2" UWORD LINEAR______0_000000__0H___4_995 2 2.0 0.0 4.9951167 BIT_MASK 0xffffffff /begin IF_DATA ASAP1B_ADDRESS KP_BLOB 0xced4 /end IF_DATA /end MEASUREMENT
/begin MEASUREMENT lsh_bank2vkf_talsh "KF_TALSH_VKAT_2" UBYTE LINEAR______0_000000__0H___99974 2 2.0 0.0 99.610001 BIT_MASK 0xffffffff /begin IF_DATA ASAP1B_ADDRESS KP_BLOB 0xced7 /end IF_DATA /end MEASUREMENT
/begin MEASUREMENT lsh_bank2vrlsh "RLSH_VKAT2" UWORD LINEAR______0_000000__0H___25808 2 2.0 0.0 255.996 BIT_MASK 0xffffffff /begin IF_DATA ASAP1B_ADDRESS KP_BLOB 0xced2 /end IF_DATA /end MEASUREMENT
/begin MEASUREMENT lsh_bank2vtalsh "TALSH_VKAT_2" UBYTE LINEAR______0_000000__0H___99974 2 2.0 0.0 99.610001 BIT_MASK 0xffffffff /begin IF_DATA ASAP1B_ADDRESS KP_BLOB 0xced6 /end IF_DATA /end MEASUREMENT
/begin MEASUREMENT lsh_bank3vanz_lsh_diag "ANZ_LSH_DIAG_NKAT1" UBYTE LINEAR______0_000000__0H___25188 2 2.0 0.0 255.0 BIT_MASK 0xffffffff /begin IF_DATA ASAP1B_ADDRESS KP_BLOB 0xc1e7 /end IF_DATA /end MEASUREMENT
/begin MEASUREMENT lsh_bank3vanz_zyka_lsh_diag "ANZ_ZYKA_LSH_DIAG_NKAT1" UBYTE LINEAR______0_000000__0H___25188 2 2.0 0.0 255.0 BIT_MASK 0xffffffff /begin IF_DATA ASAP1B_ADDRESS KP_BLOB 0xc1e6 /end IF_DATA /end MEASUREMENT
/begin MEASUREMENT lsh_bank3vilsh "ILSH_NIEDR_FRQ_NKAT1" UWORD LINEAR______0_000000__0H___4_995 2 2.0 0.0 4.9951167 BIT_MASK 0xffffffff /begin IF_DATA ASAP1B_ADDRESS KP_BLOB 0xc1ea /end IF_DATA /end MEASUREMENT
/begin MEASUREMENT lsh_bank3vkf_talsh "KF_TALSH_NKAT_1" UBYTE LINEAR______0_000000__0H___99974 2 2.0 0.0 99.610001 BIT_MASK 0xffffffff /begin IF_DATA ASAP1B_ADDRESS KP_BLOB 0xc1ed /end IF_DATA /end MEASUREMENT
/begin MEASUREMENT lsh_bank3vrlsh "RLSH_NKAT1" UWORD LINEAR______0_000000__0H___25808 2 2.0 0.0 255.996 BIT_MASK 0xffffffff /begin IF_DATA ASAP1B_ADDRESS KP_BLOB 0xc1e8 /end IF_DATA /end MEASUREMENT
/begin MEASUREMENT lsh_bank3vtalsh "TALSH_NKAT_1" UBYTE LINEAR______0_000000__0H___99974 2 2.0 0.0 99.610001 BIT_MASK 0xffffffff /begin IF_DATA ASAP1B_ADDRESS KP_BLOB 0xc1ec /end IF_DATA /end MEASUREMENT
/begin MEASUREMENT lsh_bank4vanz_lsh_diag "ANZ_LSH_DIAG_NKAT2" UBYTE LINEAR______0_000000__0H___25188 2 2.0 0.0 255.0 BIT_MASK 0xffffffff /begin IF_DATA ASAP1B_ADDRESS KP_BLOB 0xc1f1 /end IF_DATA /end MEASUREMENT
/begin MEASUREMENT lsh_bank4vanz_zyka_lsh_diag "ANZ_ZYKA_LSH_DIAG_NKAT2" UBYTE LINEAR______0_000000__0H___25188 2 2.0 0.0 255.0 BIT_MASK 0xffffffff /begin IF_DATA ASAP1B_ADDRESS KP_BLOB 0xc1f0 /end IF_DATA /end MEASUREMENT
/begin MEASUREMENT lsh_bank4vilsh "ILSH_NIEDR_FRQ_NKAT2" UWORD LINEAR______0_000000__0H___4_995 2 2.0 0.0 4.9951167 BIT_MASK 0xffffffff /begin IF_DATA ASAP1B_ADDRESS KP_BLOB 0xc1f4 /end IF_DATA /end MEASUREMENT
/begin MEASUREMENT lsh_bank4vkf_talsh "KF_TALSH_NKAT_2" UBYTE LINEAR______0_000000__0H___99974 2 2.0 0.0 99.610001 BIT_MASK 0xffffffff /begin IF_DATA ASAP1B_ADDRESS KP_BLOB 0xc1f7 /end IF_DATA /end MEASUREMENT
/begin MEASUREMENT lsh_bank4vrlsh "RLSH_NKAT2" UWORD LINEAR______0_000000__0H___25808 2 2.0 0.0 255.996 BIT_MASK 0xffffffff /begin IF_DATA ASAP1B_ADDRESS KP_BLOB 0xc1f2 /end IF_DATA /end MEASUREMENT
/begin MEASUREMENT lsh_bank4vtalsh "TALSH_NKAT_2" UBYTE LINEAR______0_000000__0H___99974 2 2.0 0.0 99.610001 BIT_MASK 0xffffffff /begin IF_DATA ASAP1B_ADDRESS KP_BLOB 0xc1f6 /end IF_DATA /end MEASUREMENT
/begin MEASUREMENT lsh_nkat_state "LSH_NKAT_STATE" UBYTE LSH_CONV 2 2.0 0 255 BIT_MASK 0xffffffff /begin IF_DATA ASAP1B_ADDRESS KP_BLOB 0xc1c9 /end IF_DATA /end MEASUREMENT
/begin MEASUREMENT lsh_state "LSH_STATE" UBYTE LSH_CONV 2 2.0 0 255 BIT_MASK 0xffffffff /begin IF_DATA ASAP1B_ADDRESS KP_BLOB 0xc1c0 /end IF_DATA /end MEASUREMENT
/begin MEASUREMENT luC0D "LU_1" SWORD LINEAR_______32768_000000__FF975 2 2.0 -32768.0 32767.0 BIT_MASK 0xffffffff /begin IF_DATA ASAP1B_ADDRESS KP_BLOB 0xe2c8 /end IF_DATA /end MEASUREMENT
/begin MEASUREMENT luC1D "LU_5" SWORD LINEAR_______32768_000000__FF975 2 2.0 -32768.0 32767.0 BIT_MASK 0xffffffff /begin IF_DATA ASAP1B_ADDRESS KP_BLOB 0xe2ca /end IF_DATA /end MEASUREMENT
/begin MEASUREMENT luC2D "LU_3" SWORD LINEAR_______32768_000000__FF975 2 2.0 -32768.0 32767.0 BIT_MASK 0xffffffff /begin IF_DATA ASAP1B_ADDRESS KP_BLOB 0xe2cc /end IF_DATA /end MEASUREMENT
/begin MEASUREMENT luC3D "LU_6" SWORD LINEAR_______32768_000000__FF975 2 2.0 -32768.0 32767.0 BIT_MASK 0xffffffff /begin IF_DATA ASAP1B_ADDRESS KP_BLOB 0xe2ce /end IF_DATA /end MEASUREMENT
/begin MEASUREMENT luC4D "LU_2" SWORD LINEAR_______32768_000000__FF975 2 2.0 -32768.0 32767.0 BIT_MASK 0xffffffff /begin IF_DATA ASAP1B_ADDRESS KP_BLOB 0xe2d0 /end IF_DATA /end MEASUREMENT
/begin MEASUREMENT luC5D "LU_4" SWORD LINEAR_______32768_000000__FF975 2 2.0 -32768.0 32767.0 BIT_MASK 0xffffffff /begin IF_DATA ASAP1B_ADDRESS KP_BLOB 0xe2d2 /end IF_DATA /end MEASUREMENT
/begin MEASUREMENT lu_1_6 "LU_1_6" SWORD LINEAR_______32768_000000__FF975 2 2.0 -32768.0 32767.0 BIT_MASK 0xffffffff /begin IF_DATA ASAP1B_ADDRESS KP_BLOB 0x0 /end IF_DATA /end MEASUREMENT
/begin MEASUREMENT lu_adC0D "LU_AD_1" SWORD LINEAR_______7_812500__FFFF8040H 2 2.0 -7.8125 7.8125 BIT_MASK 0xffffffff /begin IF_DATA ASAP1B_ADDRESS KP_BLOB 0xe2f0 /end IF_DATA /end MEASUREMENT
/begin MEASUREMENT lu_adC1D "LU_AD_5" SWORD LINEAR_______7_812500__FFFF8040H 2 2.0 -7.8125 7.8125 BIT_MASK 0xffffffff /begin IF_DATA ASAP1B_ADDRESS KP_BLOB 0xe2f2 /end IF_DATA /end MEASUREMENT
/begin MEASUREMENT lu_adC2D "LU_AD_3" SWORD LINEAR_______7_812500__FFFF8040H 2 2.0 -7.8125 7.8125 BIT_MASK 0xffffffff /begin IF_DATA ASAP1B_ADDRESS KP_BLOB 0xe2f4 /end IF_DATA /end MEASUREMENT
/begin MEASUREMENT lu_adC3D "LU_AD_6" SWORD LINEAR_______7_812500__FFFF8040H 2 2.0 -7.8125 7.8125 BIT_MASK 0xffffffff /begin IF_DATA ASAP1B_ADDRESS KP_BLOB 0xe2f6 /end IF_DATA /end MEASUREMENT
/begin MEASUREMENT lu_adC4D "LU_AD_2" SWORD LINEAR_______7_812500__FFFF8040H 2 2.0 -7.8125 7.8125 BIT_MASK 0xffffffff /begin IF_DATA ASAP1B_ADDRESS KP_BLOB 0xe2f8 /end IF_DATA /end MEASUREMENT
/begin MEASUREMENT lu_adC5D "LU_AD_4" SWORD LINEAR_______7_812500__FFFF8040H 2 2.0 -7.8125 7.8125 BIT_MASK 0xffffffff /begin IF_DATA ASAP1B_ADDRESS KP_BLOB 0xe2fa /end IF_DATA /end MEASUREMENT
/begin MEASUREMENT lu_ausb "LU_AUSB" UWORD RANGE________aktiv___1H__1H__944 2 2.0 0 65535 BIT_MASK 0x8 /begin IF_DATA ASAP1B_ADDRESS KP_BLOB 0xfd7a /end IF_DATA /end MEASUREMENT
/begin MEASUREMENT lu_dyn "LU_DYN" SWORD LINEAR_______32768_000000__FF975 2 2.0 -32768.0 32767.0 BIT_MASK 0xffffffff /begin IF_DATA ASAP1B_ADDRESS KP_BLOB 0xe2c2 /end IF_DATA /end MEASUREMENT
/begin MEASUREMENT lu_ev_zust "LU_EV_ZUST" UWORD RANGE________aktiv___1H__1H__944 2 2.0 0 65535 BIT_MASK 0x10 /begin IF_DATA ASAP1B_ADDRESS KP_BLOB 0xfd7a /end IF_DATA /end MEASUREMENT
/begin MEASUREMENT lu_flags "" UWORD LINEAR______0_000000__0H___65904 2 2.0 0.0 65535.0 BIT_MASK 0xffffffff /begin IF_DATA ASAP1B_ADDRESS KP_BLOB 0xfd7a /end IF_DATA /end MEASUREMENT
/begin MEASUREMENT lu_kru_gmw "LU_KRU_GMW" SWORD LINEAR_______32768_000000__FF975 2 2.0 -32768.0 32767.0 BIT_MASK 0xffffffff /begin IF_DATA ASAP1B_ADDRESS KP_BLOB 0xe2c6 /end IF_DATA /end MEASUREMENT
/begin MEASUREMENT lu_quotC0D "LU_QUOT_1" SWORD LINEAR_______8_000000__FFFF8000H 2 2.0 -8.0 7.9998 BIT_MASK 0xffffffff /begin IF_DATA ASAP1B_ADDRESS KP_BLOB 0xcf2c /end IF_DATA /end MEASUREMENT
/begin MEASUREMENT lu_quotC1D "LU_QUOT_5" SWORD LINEAR_______8_000000__FFFF8000H 2 2.0 -8.0 7.9998 BIT_MASK 0xffffffff /begin IF_DATA ASAP1B_ADDRESS KP_BLOB 0xcf2e /end IF_DATA /end MEASUREMENT
/begin MEASUREMENT lu_quotC2D "LU_QUOT_3" SWORD LINEAR_______8_000000__FFFF8000H 2 2.0 -8.0 7.9998 BIT_MASK 0xffffffff /begin IF_DATA ASAP1B_ADDRESS KP_BLOB 0xcf30 /end IF_DATA /end MEASUREMENT
/begin MEASUREMENT lu_quotC3D "LU_QUOT_6" SWORD LINEAR_______8_000000__FFFF8000H 2 2.0 -8.0 7.9998 BIT_MASK 0xffffffff /begin IF_DATA ASAP1B_ADDRESS KP_BLOB 0xcf32 /end IF_DATA /end MEASUREMENT
/begin MEASUREMENT lu_quotC4D "LU_QUOT_2" SWORD LINEAR_______8_000000__FFFF8000H 2 2.0 -8.0 7.9998 BIT_MASK 0xffffffff /begin IF_DATA ASAP1B_ADDRESS KP_BLOB 0xcf34 /end IF_DATA /end MEASUREMENT
/begin MEASUREMENT lu_quotC5D "LU_QUOT_4" SWORD LINEAR_______8_000000__FFFF8000H 2 2.0 -8.0 7.9998 BIT_MASK 0xffffffff /begin IF_DATA ASAP1B_ADDRESS KP_BLOB 0xcf36 /end IF_DATA /end MEASUREMENT
/begin MEASUREMENT lu_sta "LU_STA" SWORD LINEAR_______32768_000000__FF975 2 2.0 -32768.0 32767.0 BIT_MASK 0xffffffff /begin IF_DATA ASAP1B_ADDRESS KP_BLOB 0xe2c0 /end IF_DATA /end MEASUREMENT
/begin MEASUREMENT lu_status_1 "" UBYTE LINEAR______0_000000__0H___1_976 2 2.0 0.0 1.0 BIT_MASK 0xffffffff /begin IF_DATA ASAP1B_ADDRESS KP_BLOB 0xc60d /end IF_DATA /end MEASUREMENT
/begin MEASUREMENT lu_tors "LU_TORS" SWORD LINEAR_______32768_000000__FF975 2 2.0 -32768.0 32767.0 BIT_MASK 0xffffffff /begin IF_DATA ASAP1B_ADDRESS KP_BLOB 0xe2c4 /end IF_DATA /end MEASUREMENT
/begin MEASUREMENT lu_zsr_ev_sum "LU_ZSR_EV_SUM" UWORD LINEAR______0_000000__0H___65977 2 2.0 0.0 655.34998 BIT_MASK 0xffffffff /begin IF_DATA ASAP1B_ADDRESS KP_BLOB 0xe2ae /end IF_DATA /end MEASUREMENT
/begin MEASUREMENT lv_aufst_ks2_bk1 "LV_AUFST_KS2_BK1" UBYTE RANGE________0___0H__0H____1_978 2 2.0 0 255 BIT_MASK 0x8 /begin IF_DATA ASAP1B_ADDRESS KP_BLOB 0xfd09 /end IF_DATA /end MEASUREMENT
/begin MEASUREMENT lv_aufst_ks2_bk2 "LV_AUFST_KS2_BK2" UBYTE RANGE________0___0H__0H____1_978 2 2.0 0 255 BIT_MASK 0x80 /begin IF_DATA ASAP1B_ADDRESS KP_BLOB 0xfd09 /end IF_DATA /end MEASUREMENT
/begin MEASUREMENT lv_bls_deb_sig "BLS" UBYTE RANGE________AUS___0H__0H____EIN 2 2.0 0 255 BIT_MASK 0x8 /begin IF_DATA ASAP1B_ADDRESS KP_BLOB 0xfd03 /end IF_DATA /end MEASUREMENT
/begin MEASUREMENT lv_bts_deb_sig "BTS" UBYTE RANGE________AUS___0H__0H____EIN 2 2.0 0 255 BIT_MASK 0x20 /begin IF_DATA ASAP1B_ADDRESS KP_BLOB 0xfd03 /end IF_DATA /end MEASUREMENT
/begin MEASUREMENT lv_cfa_time_activ "LV_CFA_TIME_ACTIV" UBYTE RANGE________0___0H__0H____1_978 2 2.0 0 255 BIT_MASK 0x1 /begin IF_DATA ASAP1B_ADDRESS KP_BLOB 0xfd16 /end IF_DATA /end MEASUREMENT
/begin MEASUREMENT lv_cs_deb_sig "KUP_SWI" UBYTE RANGE________AUS___0H__0H____EIN 2 2.0 0 255 BIT_MASK 0x40 /begin IF_DATA ASAP1B_ADDRESS KP_BLOB 0xfd03 /end IF_DATA /end MEASUREMENT
/begin MEASUREMENT lv_entry_ks_bk1 "LV_ENTRY_KS_BK1" UBYTE RANGE________0___0H__0H____1_978 2 2.0 0 255 BIT_MASK 0x10 /begin IF_DATA ASAP1B_ADDRESS KP_BLOB 0xfd09 /end IF_DATA /end MEASUREMENT
/begin MEASUREMENT lv_entry_ks_bk2 "LV_ENTRY_KS_BK2" UBYTE RANGE________0___0H__0H____1_978 2 2.0 0 255 BIT_MASK 0x1 /begin IF_DATA ASAP1B_ADDRESS KP_BLOB 0xfd0a /end IF_DATA /end MEASUREMENT
/begin MEASUREMENT lv_im_ef "Abgasklappe" UBYTE RANGE________OFFEN___0H__0H____G 2 2.0 0 255 BIT_MASK 0x40 /begin IF_DATA ASAP1B_ADDRESS KP_BLOB 0xfda3 /end IF_DATA /end MEASUREMENT
/begin MEASUREMENT lv_im_rly_efp "Kraftstoffpumpe" UBYTE RANGE________EIN___1H__1H____AUS 2 2.0 0 255 BIT_MASK 0x20 /begin IF_DATA ASAP1B_ADDRESS KP_BLOB 0xfda3 /end IF_DATA /end MEASUREMENT
/begin MEASUREMENT lv_im_vepu "Saugstrahlpumpe" UBYTE RANGE________EIN___1H__1H____AUS 2 2.0 0 255 BIT_MASK 0x1 /begin IF_DATA ASAP1B_ADDRESS KP_BLOB 0xfda2 /end IF_DATA /end MEASUREMENT
/begin MEASUREMENT lv_im_vim "DISA-ANSTEUERUNG" UBYTE RANGE________AUS___0H__0H____EIN 2 2.0 0 255 BIT_MASK 0x20 /begin IF_DATA ASAP1B_ADDRESS KP_BLOB 0xfda2 /end IF_DATA /end MEASUREMENT
/begin MEASUREMENT lv_ll_left "LV_LL_LEFT" UBYTE RANGE________0___0H__0H____1_978 2 2.0 0 255 BIT_MASK 0x2 /begin IF_DATA ASAP1B_ADDRESS KP_BLOB 0xfd0f /end IF_DATA /end MEASUREMENT
/begin MEASUREMENT lv_lsh_nkat_tkw_ein "LV_LSH_NKAT_TKW_EIN" UBYTE RANGE________0___0H__0H____1_978 2 2.0 0 255 BIT_MASK 0x20 /begin IF_DATA ASAP1B_ADDRESS KP_BLOB 0xfd0d /end IF_DATA /end MEASUREMENT
/begin MEASUREMENT lv_plaus_asr "B_ASC" UBYTE RANGE________0___0H__0H____1_978 2 2.0 0 255 BIT_MASK 0x2 /begin IF_DATA ASAP1B_ADDRESS KP_BLOB 0xfd13 /end IF_DATA /end MEASUREMENT
/begin MEASUREMENT lv_plaus_asr_ctl "ASC_REG" UBYTE RANGE________0___0H__0H____1_978 2 2.0 0 255 BIT_MASK 0x80 /begin IF_DATA ASAP1B_ADDRESS KP_BLOB 0xfd12 /end IF_DATA /end MEASUREMENT
/begin MEASUREMENT lv_plaus_dsr_ctl "DSC_REG" UBYTE RANGE________0___0H__0H____1_978 2 2.0 0 255 BIT_MASK 0x1 /begin IF_DATA ASAP1B_ADDRESS KP_BLOB 0xfd13 /end IF_DATA /end MEASUREMENT
/begin MEASUREMENT lv_plaus_msr "B_MSR" UBYTE RANGE________0___0H__0H____1_978 2 2.0 0 255 BIT_MASK 0x4 /begin IF_DATA ASAP1B_ADDRESS KP_BLOB 0xfd13 /end IF_DATA /end MEASUREMENT
/begin MEASUREMENT lv_req_heat "S_HZL" UBYTE RANGE________0___0H__0H____1_978 2 2.0 0 255 BIT_MASK 0x1 /begin IF_DATA ASAP1B_ADDRESS KP_BLOB 0xfd12 /end IF_DATA /end MEASUREMENT
/begin MEASUREMENT lv_s_wk_ar "S_WK_AR" UBYTE RANGE________0___0H__0H____1_979 2 2.0 0 255 BIT_MASK 0x8 /begin IF_DATA ASAP1B_ADDRESS KP_BLOB 0xfd10 /end IF_DATA /end MEASUREMENT
/begin MEASUREMENT lv_t_ks2_bk1 "LV_T_KS2_BK1" UBYTE RANGE________0___0H__0H____1_978 2 2.0 0 255 BIT_MASK 0x4 /begin IF_DATA ASAP1B_ADDRESS KP_BLOB 0xfd09 /end IF_DATA /end MEASUREMENT
/begin MEASUREMENT lv_t_ks2_bk2 "LV_T_KS2_BK2" UBYTE RANGE________0___0H__0H____1_978 2 2.0 0 255 BIT_MASK 0x40 /begin IF_DATA ASAP1B_ADDRESS KP_BLOB 0xfd09 /end IF_DATA /end MEASUREMENT
/begin MEASUREMENT lv_temp_min_ers_kat_red "LV_TEMP_MIN_ERS_KAT_RED" UBYTE RANGE________0___0H__0H____1_978 2 2.0 0 255 BIT_MASK 0x40 /begin IF_DATA ASAP1B_ADDRESS KP_BLOB 0xfd0d /end IF_DATA /end MEASUREMENT
/begin MEASUREMENT lv_ti_reac_puc "LV_TI_REAC_PUC" UBYTE RANGE________0___0H__0H____1_979 2 2.0 0 255 BIT_MASK 0x20 /begin IF_DATA ASAP1B_ADDRESS KP_BLOB 0xfd2d /end IF_DATA /end MEASUREMENT
/begin MEASUREMENT lv_verm_lb_nkat1 "LV_VERM_LB_NKAT1" UBYTE RANGE____________0H__0H_____Verm 2 2.0 0 255 BIT_MASK 0x80 /begin IF_DATA ASAP1B_ADDRESS KP_BLOB 0xfd1f /end IF_DATA /end MEASUREMENT
/begin MEASUREMENT lv_verm_lb_nkat2 "LV_VERM_LB_NKAT2" UBYTE RANGE____________0H__0H____Verm_ 2 2.0 0 255 BIT_MASK 0x1 /begin IF_DATA ASAP1B_ADDRESS KP_BLOB 0xfd20 /end IF_DATA /end MEASUREMENT
/begin MEASUREMENT m_ind "M_IND" UWORD LINEAR______0_000000__0H___1023_ 2 2.0 0.0 1023.0 BIT_MASK 0xffffffff /begin IF_DATA ASAP1B_ADDRESS KP_BLOB 0xfb0c /end IF_DATA /end MEASUREMENT
/begin MEASUREMENT m_ind_asc_kor "M_IND_ASC" UWORD LINEAR______0_000000__0H___1023_ 2 2.0 0.0 1023.0 BIT_MASK 0xffffffff /begin IF_DATA ASAP1B_ADDRESS KP_BLOB 0xfafc /end IF_DATA /end MEASUREMENT
/begin MEASUREMENT m_ind_asc_lm_kor "M_IND_ASC_LM_KOR" UWORD LINEAR______0_000000__0H___1023_ 2 2.0 0.0 1023.0 BIT_MASK 0xffffffff /begin IF_DATA ASAP1B_ADDRESS KP_BLOB 0xfb00 /end IF_DATA /end MEASUREMENT
/begin MEASUREMENT m_ind_egs "M_IND_EGS" UWORD LINEAR______0_000000__0H___1023_ 2 2.0 0.0 1023.0 BIT_MASK 0xffffffff /begin IF_DATA ASAP1B_ADDRESS KP_BLOB 0xfafa /end IF_DATA /end MEASUREMENT
/begin MEASUREMENT m_ind_msr_kor "M_IND_MSR_KOR" UWORD LINEAR______0_000000__0H___1023_ 2 2.0 0.0 1023.0 BIT_MASK 0xffffffff /begin IF_DATA ASAP1B_ADDRESS KP_BLOB 0xfb06 /end IF_DATA /end MEASUREMENT
/begin MEASUREMENT m_ind_ne "M_IND_NE" UWORD LINEAR______0_000000__0H___1023_ 2 2.0 0.0 1023.0 BIT_MASK 0xffffffff /begin IF_DATA ASAP1B_ADDRESS KP_BLOB 0xfb0e /end IF_DATA /end MEASUREMENT
/begin MEASUREMENT m_ind_pwg "M_IND_PWG" UWORD LINEAR______0_000000__0H___1023_ 2 2.0 0.0 1023.0 BIT_MASK 0xffffffff /begin IF_DATA ASAP1B_ADDRESS KP_BLOB 0xfb08 /end IF_DATA /end MEASUREMENT
/begin MEASUREMENT m_ldp "M_LDP" SWORD LINEAR_______1024_000000__FFFFFC 2 2.0 -1024.0 1024.0 BIT_MASK 0xffffffff /begin IF_DATA ASAP1B_ADDRESS KP_BLOB 0xcf12 /end IF_DATA /end MEASUREMENT
/begin MEASUREMENT m_ldp_gmw "M_LDP_GMW" SWORD LINEAR_______1024_000000__FFF980 2 2.0 -1024.0 1024.0 BIT_MASK 0xffffffff /begin IF_DATA ASAP1B_ADDRESS KP_BLOB 0xcf14 /end IF_DATA /end MEASUREMENT
/begin MEASUREMENT m_mdk_ist "M_MDK_IST" UWORD LINEAR______0_000000__0H___1023_ 2 2.0 0.0 1023.0 BIT_MASK 0xffffffff /begin IF_DATA ASAP1B_ADDRESS KP_BLOB 0xfb18 /end IF_DATA /end MEASUREMENT
/begin MEASUREMENT m_mdk_ist_gmw "M_MDK_IST_GMW" UWORD LINEAR______0_000000__0H___1023_ 2 2.0 0.0 1023.0 BIT_MASK 0xffffffff /begin IF_DATA ASAP1B_ADDRESS KP_BLOB 0xfb14 /end IF_DATA /end MEASUREMENT
/begin MEASUREMENT m_mdk_lm "M_MDK_LM" UWORD LINEAR______0_000000__0H___1023_ 2 2.0 0.0 1023.0 BIT_MASK 0xffffffff /begin IF_DATA ASAP1B_ADDRESS KP_BLOB 0xfb10 /end IF_DATA /end MEASUREMENT
/begin MEASUREMENT m_mdk_lm_kor "M_MDK_LM_KOR" UWORD LINEAR______0_000000__0H___1023_ 2 2.0 0.0 1023.0 BIT_MASK 0xffffffff /begin IF_DATA ASAP1B_ADDRESS KP_BLOB 0xfb12 /end IF_DATA /end MEASUREMENT
/begin MEASUREMENT m_mdk_soll "M_MDK_SOLL" UWORD LINEAR______0_000000__0H___1023_ 2 2.0 0.0 1023.0 BIT_MASK 0xffffffff /begin IF_DATA ASAP1B_ADDRESS KP_BLOB 0xfb1a /end IF_DATA /end MEASUREMENT
/begin MEASUREMENT m_reib "M_REIB" UWORD LINEAR______0_000000__0H___1023_ 2 2.0 0.0 1023.0 BIT_MASK 0xffffffff /begin IF_DATA ASAP1B_ADDRESS KP_BLOB 0xfb0a /end IF_DATA /end MEASUREMENT
/begin MEASUREMENT map_grd "Saugrohrdruckgradient" SWORD LINEAR_______5434_259766__FFFF80 2 2.0 -5434.2598 5434.1768 BIT_MASK 0xffffffff /begin IF_DATA ASAP1B_ADDRESS KP_BLOB 0xfa54 /end IF_DATA /end MEASUREMENT
/begin MEASUREMENT md_fak "MD_FAK" UWORD LINEAR______0_000000__0H___6400_ 2 2.0 0.0 6400.0 BIT_MASK 0xffffffff /begin IF_DATA ASAP1B_ADDRESS KP_BLOB 0xfb1c /end IF_DATA /end MEASUREMENT
/begin MEASUREMENT md_ind_asc "MD_IND_ASC" UBYTE LINEAR______0_000000__0H___10088 2 2.0 0.0 100.0 BIT_MASK 0xffffffff /begin IF_DATA ASAP1B_ADDRESS KP_BLOB 0xc5fa /end IF_DATA /end MEASUREMENT
/begin MEASUREMENT md_ind_asc_lm "MD_IND_ASC_LM" UBYTE LINEAR______0_000000__0H___10088 2 2.0 0.0 100.0 BIT_MASK 0xffffffff /begin IF_DATA ASAP1B_ADDRESS KP_BLOB 0xc5fb /end IF_DATA /end MEASUREMENT
/begin MEASUREMENT md_ind_msr "MD_IND_MSR" UBYTE LINEAR______0_000000__0H___10981 2 2.0 0.0 100.0 BIT_MASK 0xffffffff /begin IF_DATA ASAP1B_ADDRESS KP_BLOB 0xc5fc /end IF_DATA /end MEASUREMENT
/begin MEASUREMENT mdk_aus_pwg "MDK_AUS_PWG" UWORD RANGE____________0H__0H____1___1 2 2.0 0 65535 BIT_MASK 0x8 /begin IF_DATA ASAP1B_ADDRESS KP_BLOB 0xfd58 /end IF_DATA /end MEASUREMENT
/begin MEASUREMENT mdk_ist "MDK_IST" UWORD MTC_NORM_16_RES51 2 2.0 0.0 119.99817 BIT_MASK 0xffffffff /begin IF_DATA ASAP1B_ADDRESS KP_BLOB 0xfaac /end IF_DATA /end MEASUREMENT
/begin MEASUREMENT mdk_ist_notlauf "MDK_IST_NOTLAUF" UWORD RANGE____________0H__0H____1___1 2 2.0 0 65535 BIT_MASK 0x2 /begin IF_DATA ASAP1B_ADDRESS KP_BLOB 0xfd58 /end IF_DATA /end MEASUREMENT
/begin MEASUREMENT mdk_llfs_dif "MDK_LLFS_DIF" UWORD MTC_NORM_16_RES 2 2.0 0.0 119.99817 BIT_MASK 0xffffffff /begin IF_DATA ASAP1B_ADDRESS KP_BLOB 0xe0dc /end IF_DATA /end MEASUREMENT
/begin MEASUREMENT mdk_notlauf "MDK_NOTLAUF" UWORD RANGE____________0H__0H____1___1 2 2.0 0 65535 BIT_MASK 0x80 /begin IF_DATA ASAP1B_ADDRESS KP_BLOB 0xfd58 /end IF_DATA /end MEASUREMENT
/begin MEASUREMENT mdk_soll "MDK_SOLL" UWORD MTC_NORM_16_RES51 2 2.0 0.0 119.99817 BIT_MASK 0xffffffff /begin IF_DATA ASAP1B_ADDRESS KP_BLOB 0xfaae /end IF_DATA /end MEASUREMENT
/begin MEASUREMENT mdk_soll_pwg "MDK_SOLL_PWG" UWORD MTC_NORM_16_RES51 2 2.0 0.0 119.99817 BIT_MASK 0xffffffff /begin IF_DATA ASAP1B_ADDRESS KP_BLOB 0xe0d8 /end IF_DATA /end MEASUREMENT
/begin MEASUREMENT mdk_sum_ist "MDK_SUM_IST" UWORD MTC_NORM_16_RES51 2 2.0 0.0 119.99817 BIT_MASK 0xffffffff /begin IF_DATA ASAP1B_ADDRESS KP_BLOB 0xe0ee /end IF_DATA /end MEASUREMENT
/begin MEASUREMENT mdk_sum_soll "MDK_SUM_SOLL" UWORD MTC_NORM_16_RES51 2 2.0 0.0 119.99817 BIT_MASK 0xffffffff /begin IF_DATA ASAP1B_ADDRESS KP_BLOB 0xe0f0 /end IF_DATA /end MEASUREMENT
/begin MEASUREMENT mdk1 "MDK1" UWORD MTC_NORM_16_RES51 2 2.0 0.0 119.99817 BIT_MASK 0xffffffff /begin IF_DATA ASAP1B_ADDRESS KP_BLOB 0xe0e6 /end IF_DATA /end MEASUREMENT
/begin MEASUREMENT mdk1_ad_gmw "MDK1_AD_GMW" UWORD MTC_IN_DK_16_RES 2 2.0 0.0 239.99634 BIT_MASK 0xffffffff /begin IF_DATA ASAP1B_ADDRESS KP_BLOB 0xe0e2 /end IF_DATA /end MEASUREMENT
/begin MEASUREMENT mdk1_poti_16bit "MDK1_POTI" UWORD MTC_IN_DK_16_RES982 2 2.0 0.0 239.99634 BIT_MASK 0xffffffff /begin IF_DATA ASAP1B_ADDRESS KP_BLOB 0xe0de /end IF_DATA /end MEASUREMENT
/begin MEASUREMENT mdk1_supply "U_DKFW1" UWORD LINEAR______0_000000__0H___12_95 2 2.0 0.0 12.95 BIT_MASK 0xffffffff /begin IF_DATA ASAP1B_ADDRESS KP_BLOB 0xce1e /end IF_DATA /end MEASUREMENT
/begin MEASUREMENT mdk2 "MDK2" UWORD MTC_NORM_16_RES51 2 2.0 0.0 119.99817 BIT_MASK 0xffffffff /begin IF_DATA ASAP1B_ADDRESS KP_BLOB 0xe0e8 /end IF_DATA /end MEASUREMENT
/begin MEASUREMENT mdk2_ad_gmw "MDK2_AD_GMW" UWORD MTC_IN_DK_16_RES 2 2.0 0.0 239.99634 BIT_MASK 0xffffffff /begin IF_DATA ASAP1B_ADDRESS KP_BLOB 0xe0e4 /end IF_DATA /end MEASUREMENT
/begin MEASUREMENT mdk2_poti_16bit "MDK2_POTI" UWORD MTC_IN_DK_16_RES982 2 2.0 0.0 239.99634 BIT_MASK 0xffffffff /begin IF_DATA ASAP1B_ADDRESS KP_BLOB 0xe0e0 /end IF_DATA /end MEASUREMENT
/begin MEASUREMENT mdk2_supply "U_DKFW2" UWORD LINEAR______0_000000__0H___12_95 2 2.0 0.0 12.95 BIT_MASK 0xffffffff /begin IF_DATA ASAP1B_ADDRESS KP_BLOB 0xce20 /end IF_DATA /end MEASUREMENT
/begin MEASUREMENT mdz_egs "MD_IND_EGS" UBYTE LINEAR______0_000000__0H___10983 2 2.0 0.0 100.0 BIT_MASK 0xffffffff /begin IF_DATA ASAP1B_ADDRESS KP_BLOB 0xc5fd /end IF_DATA /end MEASUREMENT
/begin MEASUREMENT mfl_request "" UBYTE LINEAR______0_000000__0H___25905 2 2.0 0.0 255.0 BIT_MASK 0xffffffff /begin IF_DATA ASAP1B_ADDRESS KP_BLOB 0xce0e /end IF_DATA /end MEASUREMENT
/begin MEASUREMENT mfl_request_sams "MFL" UBYTE FGR_RANGE 2 2.0 0 255 BIT_MASK 0xffffffff /begin IF_DATA ASAP1B_ADDRESS KP_BLOB 0xce0e /end IF_DATA /end MEASUREMENT
/begin MEASUREMENT mis_a_inside_ftp "MIS_A_INSIDE_FTP" UBYTE LINEAR______0_000000__0H___25182 2 2.0 0.0 255.0 BIT_MASK 0xffffffff /begin IF_DATA ASAP1B_ADDRESS KP_BLOB 0xcfa4 /end IF_DATA /end MEASUREMENT
/begin MEASUREMENT mis_a_obd_ctr "MIS_A_OBD_CTR" UBYTE LINEAR______0_000000__0H___25182 2 2.0 0.0 255.0 BIT_MASK 0xffffffff /begin IF_DATA ASAP1B_ADDRESS KP_BLOB 0xc220 /end IF_DATA /end MEASUREMENT
/begin MEASUREMENT mis_b4_obd_ctr "MIS_B4_OBD_CTR" UBYTE LINEAR______0_000000__0H___25142 2 2.0 0.0 255.0 BIT_MASK 0xffffffff /begin IF_DATA ASAP1B_ADDRESS KP_BLOB 0xc221 /end IF_DATA /end MEASUREMENT
/begin MEASUREMENT moment_comp "Momentenkomp." UWORD RANGE________aktiv___1H__1H__913 2 2.0 0 65535 BIT_MASK 0x1000 /begin IF_DATA ASAP1B_ADDRESS KP_BLOB 0xfd5a /end IF_DATA /end MEASUREMENT
/begin MEASUREMENT mot_zust_1 "" UWORD LINEAR______0_000000__0H___65904 2 2.0 0.0 65535.0 BIT_MASK 0xffffffff /begin IF_DATA ASAP1B_ADDRESS KP_BLOB 0xfd3c /end IF_DATA /end MEASUREMENT
/begin MEASUREMENT mot_zust_2 "" UWORD LINEAR______0_000000__0H___65904 2 2.0 0.0 65535.0 BIT_MASK 0xffffffff /begin IF_DATA ASAP1B_ADDRESS KP_BLOB 0xfd3e /end IF_DATA /end MEASUREMENT
/begin MEASUREMENT mot_zust_4 "" UWORD LINEAR______0_000000__0H___65904 2 2.0 0.0 65535.0 BIT_MASK 0xffffffff /begin IF_DATA ASAP1B_ADDRESS KP_BLOB 0xfd42 /end IF_DATA /end MEASUREMENT
/begin MEASUREMENT msr "MSR" UWORD RANGE________MSR___1H__1H_______ 2 2.0 0 65535 BIT_MASK 0x400 /begin IF_DATA ASAP1B_ADDRESS KP_BLOB 0xfd56 /end IF_DATA /end MEASUREMENT
/begin MEASUREMENT mtc_llfs_limphome "" UWORD LINEAR______0_000000__0H___65904 2 2.0 0.0 65535.0 BIT_MASK 0xffffffff /begin IF_DATA ASAP1B_ADDRESS KP_BLOB 0xfd5a /end IF_DATA /end MEASUREMENT
/begin MEASUREMENT mtc_state "" UBYTE LINEAR______0_000000__0H___25905 2 2.0 0.0 255.0 BIT_MASK 0xffffffff /begin IF_DATA ASAP1B_ADDRESS KP_BLOB 0xc5f7 /end IF_DATA /end MEASUREMENT
/begin MEASUREMENT mtc_state_sams "MDK_STATUS" UBYTE MDK_STATUS 2 2.0 0 255 BIT_MASK 0x7 /begin IF_DATA ASAP1B_ADDRESS KP_BLOB 0xc5f7 /end IF_DATA /end MEASUREMENT
/begin MEASUREMENT mtc_swing_detect_cnt "EPZ_MDK_2" UBYTE LINEAR______0_000000__0H___25182 2 2.0 0.0 255.0 BIT_MASK 0xffffffff /begin IF_DATA ASAP1B_ADDRESS KP_BLOB 0xc2da /end IF_DATA /end MEASUREMENT
/begin MEASUREMENT mtc_system_flags "MDK_FLAGS" UWORD LINEAR______0_000000__0H___65904 2 2.0 0.0 65535.0 BIT_MASK 0xffffffff /begin IF_DATA ASAP1B_ADDRESS KP_BLOB 0xfd58 /end IF_DATA /end MEASUREMENT
/begin MEASUREMENT mult_adap_1_eingeschwungen "mult_adap_1_eingeschwungen" UBYTE RANGE________JA___1H__1H____NEIN 2 2.0 0 255 BIT_MASK 0x40 /begin IF_DATA ASAP1B_ADDRESS KP_BLOB 0xe326 /end IF_DATA /end MEASUREMENT
/begin MEASUREMENT mult_adap_2_eingeschwungen "mult_adap_2_eingeschwungen" UBYTE RANGE________JA___1H__1H____NEIN 2 2.0 0 255 BIT_MASK 0x40 /begin IF_DATA ASAP1B_ADDRESS KP_BLOB 0xe410 /end IF_DATA /end MEASUREMENT
/begin MEASUREMENT n_32 "N_32" UBYTE ES_8_RES17 2 2.0 0.0 8160.0 BIT_MASK 0xffffffff /begin IF_DATA ASAP1B_ADDRESS KP_BLOB 0xc41c /end IF_DATA /end MEASUREMENT
/begin MEASUREMENT n_beg "N_BEG" UWORD RANGE________N_BEG___1H__1H_____ 2 2.0 0 65535 BIT_MASK 0x8000 /begin IF_DATA ASAP1B_ADDRESS KP_BLOB 0xfd3c /end IF_DATA /end MEASUREMENT
/begin MEASUREMENT n_bg "N (Begr.Dyn.)" UWORD RANGE________N___1H__1H________0 2 2.0 0 65535 BIT_MASK 0x10 /begin IF_DATA ASAP1B_ADDRESS KP_BLOB 0xfd5e /end IF_DATA /end MEASUREMENT
/begin MEASUREMENT n_dif "N_DIF" SWORD ES_2co_16_RES 2 2.0 -32768.0 32767.0 BIT_MASK 0xffffffff /begin IF_DATA ASAP1B_ADDRESS KP_BLOB 0xcdfc /end IF_DATA /end MEASUREMENT
/begin MEASUREMENT n_dif_gmw "N_DIF_GMW" SWORD ES_2co_16_RES 2 2.0 -32768.0 32767.0 BIT_MASK 0xffffffff /begin IF_DATA ASAP1B_ADDRESS KP_BLOB 0xce06 /end IF_DATA /end MEASUREMENT
/begin MEASUREMENT n_dif_kor "N_DIF_KOR" SWORD ES_2co_16_RES984 2 2.0 -32768.0 32767.0 BIT_MASK 0xffffffff /begin IF_DATA ASAP1B_ADDRESS KP_BLOB 0xce04 /end IF_DATA /end MEASUREMENT
/begin MEASUREMENT n_dif_mitko_erm "N_DIF_MITKO_ERM" UBYTE LINEAR______0_000000__0H___0_920 2 2.0 0.0 0.99599999 BIT_MASK 0xffffffff /begin IF_DATA ASAP1B_ADDRESS KP_BLOB 0xcdf3 /end IF_DATA /end MEASUREMENT
/begin MEASUREMENT n_el_kor_fil "N_EL_KOR_FIL" UBYTE LINEAR______0_000000__0H___15_94 2 2.0 0.0 15.94 BIT_MASK 0xffffffff /begin IF_DATA ASAP1B_ADDRESS KP_BLOB 0xc321 /end IF_DATA /end MEASUREMENT
/begin MEASUREMENT n_fc "N_FC" UWORD IS_13_RES78 2 2.0 0.0 8160.0 BIT_MASK 0xffffffff /begin IF_DATA ASAP1B_ADDRESS KP_BLOB 0xe258 /end IF_DATA /end MEASUREMENT
/begin MEASUREMENT n_gmw_katvwordC1D "N_GMW_KAT" UWORD IS_13_RES78 2 2.0 0.0 8160.0 BIT_MASK 0xffffffff /begin IF_DATA ASAP1B_ADDRESS KP_BLOB 0xe26c /end IF_DATA /end MEASUREMENT
/begin MEASUREMENT n_grw "NMAX_AKT" UBYTE ES_8_RES17 2 2.0 0.0 8160.0 BIT_MASK 0xffffffff /begin IF_DATA ASAP1B_ADDRESS KP_BLOB 0xc428 /end IF_DATA /end MEASUREMENT
/begin MEASUREMENT n_kr "Drehzahl KR" UBYTE ES_8_RES985 2 2.0 0.0 8160.0 BIT_MASK 0xffffffff /begin IF_DATA ASAP1B_ADDRESS KP_BLOB 0xc467 /end IF_DATA /end MEASUREMENT
/begin MEASUREMENT n_ll_ende "N_LL_ENDE" UWORD IS_13_RES78 2 2.0 0.0 8160.0 BIT_MASK 0xffffffff /begin IF_DATA ASAP1B_ADDRESS KP_BLOB 0xe170 /end IF_DATA /end MEASUREMENT
/begin MEASUREMENT n_proz "N_PROZ" UBYTE LINEAR______0_000000__0H___99_61 2 2.0 0.0 99.610001 BIT_MASK 0xffffffff /begin IF_DATA ASAP1B_ADDRESS KP_BLOB 0xc327 /end IF_DATA /end MEASUREMENT
/begin MEASUREMENT n_proz_el "N_PROZ_EL" UBYTE LINEAR______0_000000__0H___99_61 2 2.0 0.0 99.610001 BIT_MASK 0xffffffff /begin IF_DATA ASAP1B_ADDRESS KP_BLOB 0xc326 /end IF_DATA /end MEASUREMENT
/begin MEASUREMENT n_v_fgr "N_V_FGR" UWORD LINEAR______0_000000__0H___16320 2 2.0 0.0 16320.0 BIT_MASK 0xffffffff /begin IF_DATA ASAP1B_ADDRESS KP_BLOB 0xe1be /end IF_DATA /end MEASUREMENT
/begin MEASUREMENT nbeg_status "NBEG_STATUS" UWORD RANGE________Normal___0H__0H____ 2 2.0 0 65535 BIT_MASK 0x80 /begin IF_DATA ASAP1B_ADDRESS KP_BLOB 0xfd5a /end IF_DATA /end MEASUREMENT
/begin MEASUREMENT ngrd "NGRD" SBYTE LINEAR_______4096_000000__FFF986 2 2.0 -4096.0 4064.0 BIT_MASK 0xffffffff /begin IF_DATA ASAP1B_ADDRESS KP_BLOB 0xc41d /end IF_DATA /end MEASUREMENT
/begin MEASUREMENT nmax "NMAX" UBYTE ES_8_RES17 2 2.0 0.0 8160.0 BIT_MASK 0xffffffff /begin IF_DATA ASAP1B_ADDRESS KP_BLOB 0xc42a /end IF_DATA /end MEASUREMENT
/begin MEASUREMENT nmax_diag "NMAX_DIAG" UWORD LINEAR______0_000000__0H___81987 2 2.0 0.0 8191.875 BIT_MASK 0xffffffff /begin IF_DATA ASAP1B_ADDRESS KP_BLOB 0xfa56 /end IF_DATA /end MEASUREMENT
/begin MEASUREMENT nmax_diag_end "NMAX_DIAG_ZIEL" UBYTE ES_8_RES17 2 2.0 0.0 8160.0 BIT_MASK 0xffffffff /begin IF_DATA ASAP1B_ADDRESS KP_BLOB 0xc42f /end IF_DATA /end MEASUREMENT
/begin MEASUREMENT nmax_max "NMAX_MAX" UBYTE ES_8_RES17 2 2.0 0.0 8160.0 BIT_MASK 0xffffffff /begin IF_DATA ASAP1B_ADDRESS KP_BLOB 0xc42b /end IF_DATA /end MEASUREMENT
/begin MEASUREMENT nmax_ob_st "NMAX_OB_ST" UBYTE ES_8_RES 2 2.0 0.0 8160.0 BIT_MASK 0xffffffff /begin IF_DATA ASAP1B_ADDRESS KP_BLOB 0xc189 /end IF_DATA /end MEASUREMENT
/begin MEASUREMENT nmin_sa "NMIN_SA" UBYTE ES_8_RES 2 2.0 0.0 8160.0 BIT_MASK 0xffffffff /begin IF_DATA ASAP1B_ADDRESS KP_BLOB 0xc420 /end IF_DATA /end MEASUREMENT
/begin MEASUREMENT nr_kf_ti_ks_bk1 "NR_KF_TI_KS_BK1" UWORD LINEAR______1_000000__100H___5_0 2 2.0 1.0 5.0 BIT_MASK 0xffffffff /begin IF_DATA ASAP1B_ADDRESS KP_BLOB 0xe1e0 /end IF_DATA /end MEASUREMENT
/begin MEASUREMENT nr_kf_ti_ks_bk2 "NR_KF_TI_KS_BK2" UWORD LINEAR______1_000000__100H___5_0 2 2.0 1.0 5.0 BIT_MASK 0xffffffff /begin IF_DATA ASAP1B_ADDRESS KP_BLOB 0xe1e8 /end IF_DATA /end MEASUREMENT
/begin MEASUREMENT ns "NS" UWORD RANGE________NS___1H__1H________ 2 2.0 0 65535 BIT_MASK 0x8 /begin IF_DATA ASAP1B_ADDRESS KP_BLOB 0xfd3c /end IF_DATA /end MEASUREMENT
/begin MEASUREMENT nsoll_add_offset "NDIFKAT2" UWORD LINEAR______0_000000__0H___1000_ 2 2.0 0.0 1000.0 BIT_MASK 0xffffffff /begin IF_DATA ASAP1B_ADDRESS KP_BLOB 0xe190 /end IF_DATA /end MEASUREMENT
/begin MEASUREMENT nsoll_add_ss "NSOLL_ADD_SS" SWORD LINEAR_______8192_000000__FFFF80 2 2.0 -8192.0 8191.75 BIT_MASK 0xffffffff /begin IF_DATA ASAP1B_ADDRESS KP_BLOB 0xe18e /end IF_DATA /end MEASUREMENT
/begin MEASUREMENT nsoll_dif_ubat "NSOLL_DIF_UBAT" UWORD LINEAR______0_000000__0H___1000_ 2 2.0 0.0 1000.0 BIT_MASK 0xffffffff /begin IF_DATA ASAP1B_ADDRESS KP_BLOB 0xe182 /end IF_DATA /end MEASUREMENT
/begin MEASUREMENT nsoll_ll "LL-Solldrehzahl" UWORD IS_13_RES988 2 2.0 0.0 8160.0 BIT_MASK 0xffffffff /begin IF_DATA ASAP1B_ADDRESS KP_BLOB 0xe16c /end IF_DATA /end MEASUREMENT
/begin MEASUREMENT nsoll_ll_ser "NSOLL_LL_SER" UBYTE LINEAR_______256_000000__0___254 2 2.0 -256.0 254.0 BIT_MASK 0xffffffff /begin IF_DATA ASAP1B_ADDRESS KP_BLOB 0xe193 /end IF_DATA /end MEASUREMENT
/begin MEASUREMENT nw_grd_a "NW_GRD_A" SWORD LINEAR_______95_625000__FFFFF989 2 2.0 -95.625 95.625 BIT_MASK 0xffffffff /begin IF_DATA ASAP1B_ADDRESS KP_BLOB 0xd11c /end IF_DATA /end MEASUREMENT
/begin MEASUREMENT nw_grd_e "NW_GRD_E" SWORD LINEAR_______95_625000__FFFFF989 2 2.0 -95.625 95.625 BIT_MASK 0xffffffff /begin IF_DATA ASAP1B_ADDRESS KP_BLOB 0xcfb2 /end IF_DATA /end MEASUREMENT
/begin MEASUREMENT nw_ref_a "NW_REF_A" UWORD LINEAR_______155_996700__FFFFH__ 2 2.0 -155.9967 -60.0 BIT_MASK 0xffff /begin IF_DATA ASAP1B_ADDRESS KP_BLOB 0xd11a /end IF_DATA /end MEASUREMENT
/begin MEASUREMENT nw_ref_e "NW_REF_E" UWORD LINEAR______60_000000__0H___1990 2 2.0 60.0 155.9967 BIT_MASK 0xffff /begin IF_DATA ASAP1B_ADDRESS KP_BLOB 0xcfb0 /end IF_DATA /end MEASUREMENT
/begin MEASUREMENT nw_verst_a "NW_VERST_A" UWORD NW_VERST_SP 2 2.0 0 65535 BIT_MASK 0x7 /begin IF_DATA ASAP1B_ADDRESS KP_BLOB 0xfd66 /end IF_DATA /end MEASUREMENT
/begin MEASUREMENT nw_verst_e "NW_VERST_E" UWORD NW_VERST_FR 2 2.0 0 65535 BIT_MASK 0x7 /begin IF_DATA ASAP1B_ADDRESS KP_BLOB 0xfd64 /end IF_DATA /end MEASUREMENT
/begin MEASUREMENT nwsoll_e_aebgvbyteC1D "NWSOLL_E_AEBG" UWORD LINEAR_______48_000000__0H___991 2 2.0 -48.0 47.625 BIT_MASK 0xffffffff /begin IF_DATA ASAP1B_ADDRESS KP_BLOB 0xe085 /end IF_DATA /end MEASUREMENT
/begin MEASUREMENT obd_flags "OBD_FLAGS" UWORD LINEAR______0_000000__0H___65163 2 2.0 0.0 65535.0 BIT_MASK 0xffffffff /begin IF_DATA ASAP1B_ADDRESS KP_BLOB 0xfd7c /end IF_DATA /end MEASUREMENT
/begin MEASUREMENT p "Saugrohrdruck" UWORD LINEAR______0_000000__0H___54805 2 2.0 0.0 5434.2598 BIT_MASK 0xffffffff /begin IF_DATA ASAP1B_ADDRESS KP_BLOB 0xe064 /end IF_DATA /end MEASUREMENT
/begin MEASUREMENT pq_hs "PQ_HS" UBYTE LINEAR______0_000000__0H___1_993 2 2.0 0.0 1.0 BIT_MASK 0xffffffff /begin IF_DATA ASAP1B_ADDRESS KP_BLOB 0xc426 /end IF_DATA /end MEASUREMENT
/begin MEASUREMENT pq_ts "PQ_TS" UBYTE LINEAR______0_000000__0H___0_203 2 2.0 0.0 0.99599999 BIT_MASK 0xffffffff /begin IF_DATA ASAP1B_ADDRESS KP_BLOB 0xc427 /end IF_DATA /end MEASUREMENT
/begin MEASUREMENT pwg "PWG" UWORD MTC_NORM_16_RES10 2 2.0 0.0 119.99817 BIT_MASK 0xffffffff /begin IF_DATA ASAP1B_ADDRESS KP_BLOB 0xfaa4 /end IF_DATA /end MEASUREMENT
/begin MEASUREMENT pwg_ad_fak_kor "PWG_AD_FAK_KOR" UWORD LINEAR______0_000000__0H___1_994 2 2.0 0.0 1.9922 BIT_MASK 0xffffffff /begin IF_DATA ASAP1B_ADDRESS KP_BLOB 0xe0fe /end IF_DATA /end MEASUREMENT
/begin MEASUREMENT pwg_aus_mdk "PWG_AUS_MDK" UWORD RANGE____________0H__0H____1___1 2 2.0 0 65535 BIT_MASK 0x4 /begin IF_DATA ASAP1B_ADDRESS KP_BLOB 0xfd58 /end IF_DATA /end MEASUREMENT
/begin MEASUREMENT pwg_dif "PWG_DIF" SWORD PVS_NORM_2co_16_RES 2 2.0 -59.8 59.8 BIT_MASK 0xffffffff /begin IF_DATA ASAP1B_ADDRESS KP_BLOB 0xe0d0 /end IF_DATA /end MEASUREMENT
/begin MEASUREMENT pwg_fak_kup_swi "PWG_FAK_KUP_SWI" UBYTE LINEAR______0_000000__0H___0_996 2 2.0 0.0 0.99610001 BIT_MASK 0xffffffff /begin IF_DATA ASAP1B_ADDRESS KP_BLOB 0xc2ea /end IF_DATA /end MEASUREMENT
/begin MEASUREMENT pwg_fgr "PWG_FGR" UWORD MTC_NORM_16_RES10 2 2.0 0.0 119.99817 BIT_MASK 0xffffffff /begin IF_DATA ASAP1B_ADDRESS KP_BLOB 0xe0a4 /end IF_DATA /end MEASUREMENT
/begin MEASUREMENT pwg_ist "PWG_IST" UWORD MTC_NORM_16_RES10 2 2.0 0.0 119.99817 BIT_MASK 0xffffffff /begin IF_DATA ASAP1B_ADDRESS KP_BLOB 0xfaa8 /end IF_DATA /end MEASUREMENT
/begin MEASUREMENT pwg_ist_kor "PWG_IST_KOR" UWORD MTC_NORM_16_RES10 2 2.0 0.0 119.99817 BIT_MASK 0xffffffff /begin IF_DATA ASAP1B_ADDRESS KP_BLOB 0xe0ac /end IF_DATA /end MEASUREMENT
/begin MEASUREMENT pwg_ist_notlauf "PWG_IST_NOTLAUF" UWORD RANGE____________0H__0H____1___1 2 2.0 0 65535 BIT_MASK 0x1 /begin IF_DATA ASAP1B_ADDRESS KP_BLOB 0xfd58 /end IF_DATA /end MEASUREMENT
/begin MEASUREMENT pwg_ist_roh "PWG_IST_ROH" UWORD MTC_NORM_16_RES51 2 2.0 0.0 119.99817 BIT_MASK 0xffffffff /begin IF_DATA ASAP1B_ADDRESS KP_BLOB 0xe0aa /end IF_DATA /end MEASUREMENT
/begin MEASUREMENT pwg_kor "PWG_KOR" UWORD MTC_NORM_16_RES10 2 2.0 0.0 119.99817 BIT_MASK 0xffffffff /begin IF_DATA ASAP1B_ADDRESS KP_BLOB 0xe0b6 /end IF_DATA /end MEASUREMENT
/begin MEASUREMENT pwg_llfs "PWG_LLFS" UWORD MTC_NORM_16_RES10 2 2.0 0.0 119.99817 BIT_MASK 0xffffffff /begin IF_DATA ASAP1B_ADDRESS KP_BLOB 0xe0b2 /end IF_DATA /end MEASUREMENT
/begin MEASUREMENT pwg_llfs_1 "PWG_LLFS_1" UWORD MTC_NORM_16_RES10 2 2.0 0.0 119.99817 BIT_MASK 0xffffffff /begin IF_DATA ASAP1B_ADDRESS KP_BLOB 0xe0b0 /end IF_DATA /end MEASUREMENT
/begin MEASUREMENT pwg_m_ind "PWG_M_IND" UWORD MTC_NORM_16_RES68 2 2.0 0.0 119.99817 BIT_MASK 0xffffffff /begin IF_DATA ASAP1B_ADDRESS KP_BLOB 0xe0ae /end IF_DATA /end MEASUREMENT
/begin MEASUREMENT pwg_max "PWG_MAX" UWORD MTC_NORM_16_RES51 2 2.0 0.0 119.99817 BIT_MASK 0xffffffff /begin IF_DATA ASAP1B_ADDRESS KP_BLOB 0xfaa6 /end IF_DATA /end MEASUREMENT
/begin MEASUREMENT pwg1 "PWG1" UWORD MTC_NORM_16_RES10 2 2.0 0.0 119.99817 BIT_MASK 0xffffffff /begin IF_DATA ASAP1B_ADDRESS KP_BLOB 0xe0b8 /end IF_DATA /end MEASUREMENT
/begin MEASUREMENT pwg1_ad_gmw "PWG1_AD_GMW" UWORD MTC_IN_DK_16_RES995 2 2.0 0.0 239.99634 BIT_MASK 0xffffffff /begin IF_DATA ASAP1B_ADDRESS KP_BLOB 0xe0c0 /end IF_DATA /end MEASUREMENT
/begin MEASUREMENT pwg1_poti_16bit "PWG1_POTI" UWORD MTC_IN_DK_16_RES982 2 2.0 0.0 239.99634 BIT_MASK 0xffffffff /begin IF_DATA ASAP1B_ADDRESS KP_BLOB 0xe0bc /end IF_DATA /end MEASUREMENT
/begin MEASUREMENT pwg2 "PWG2" UWORD MTC_NORM_16_RES10 2 2.0 0.0 119.99817 BIT_MASK 0xffffffff /begin IF_DATA ASAP1B_ADDRESS KP_BLOB 0xe0ba /end IF_DATA /end MEASUREMENT
/begin MEASUREMENT pwg2_ad_gmw "PWG2_AD_GMW" UWORD MTC_IN_DK_16_RES995 2 2.0 0.0 239.99634 BIT_MASK 0xffffffff /begin IF_DATA ASAP1B_ADDRESS KP_BLOB 0xe0c2 /end IF_DATA /end MEASUREMENT
/begin MEASUREMENT pwg2_poti_16bit "PWG2_POTI" UWORD MTC_IN_DK_16_RES982 2 2.0 0.0 239.99634 BIT_MASK 0xffffffff /begin IF_DATA ASAP1B_ADDRESS KP_BLOB 0xe0be /end IF_DATA /end MEASUREMENT
/begin MEASUREMENT pwm_norm "PWM_NORM" SWORD MTC_PWM_2CO_16_RES 2 2.0 -100.0 99.997 BIT_MASK 0xffffffff /begin IF_DATA ASAP1B_ADDRESS KP_BLOB 0xfaa0 /end IF_DATA /end MEASUREMENT
/begin MEASUREMENT reed_switch "REED_SWITCH" UWORD RANGE________AUF___0H__0H____ZU_ 2 2.0 0 65535 BIT_MASK 0x8000 /begin IF_DATA ASAP1B_ADDRESS KP_BLOB 0xfd9a /end IF_DATA /end MEASUREMENT
/begin MEASUREMENT rk_stat_bg "RK_STAT_BG" UBYTE LINEAR______0_000000__0H___25142 2 2.0 0.0 255.0 BIT_MASK 0xffffffff /begin IF_DATA ASAP1B_ADDRESS KP_BLOB 0xfaee /end IF_DATA /end MEASUREMENT
/begin MEASUREMENT rr_state "RR_STATE" UWORD RANGE________aktiv___1H__1H__944 2 2.0 0 65535 BIT_MASK 0x4 /begin IF_DATA ASAP1B_ADDRESS KP_BLOB 0xfd7a /end IF_DATA /end MEASUREMENT
/begin MEASUREMENT rv_ad_t_a "RV_AD_T_A" UWORD RANGE________0___0H__0H____1___1 2 2.0 0 65535 BIT_MASK 0x80 /begin IF_DATA ASAP1B_ADDRESS KP_BLOB 0xfd66 /end IF_DATA /end MEASUREMENT
/begin MEASUREMENT rv_ad_t_e "RV_AD_T_E" UWORD RANGE________0___0H__0H____1___1 2 2.0 0 65535 BIT_MASK 0x80 /begin IF_DATA ASAP1B_ADDRESS KP_BLOB 0xfd64 /end IF_DATA /end MEASUREMENT
/begin MEASUREMENT rv_adapt_ena_a "RV_ADAPT_ENA_A" UWORD RANGE________0___0H__0H____1___1 2 2.0 0 65535 BIT_MASK 0x400 /begin IF_DATA ASAP1B_ADDRESS KP_BLOB 0xfd66 /end IF_DATA /end MEASUREMENT
/begin MEASUREMENT rv_adapt_ena_e "RV_ADAPT_ENA_E" UWORD RANGE________0___0H__0H____1___1 2 2.0 0 65535 BIT_MASK 0x400 /begin IF_DATA ASAP1B_ADDRESS KP_BLOB 0xfd64 /end IF_DATA /end MEASUREMENT
/begin MEASUREMENT rv_aktiv "RV_AKTIV" UWORD RANGE________0___0H__0H____1_996 2 2.0 0 65535 BIT_MASK 0x2 /begin IF_DATA ASAP1B_ADDRESS KP_BLOB 0xfd62 /end IF_DATA /end MEASUREMENT
/begin MEASUREMENT rv_neuer_soll_a "RV_NEUER_SOLL_A" UWORD RANGE________0___0H__0H____1___1 2 2.0 0 65535 BIT_MASK 0x8 /begin IF_DATA ASAP1B_ADDRESS KP_BLOB 0xfd66 /end IF_DATA /end MEASUREMENT
/begin MEASUREMENT rv_neuer_soll_e "RV_NEUER_SOLL_E" UWORD RANGE________0___0H__0H____1___1 2 2.0 0 65535 BIT_MASK 0x8 /begin IF_DATA ASAP1B_ADDRESS KP_BLOB 0xfd64 /end IF_DATA /end MEASUREMENT
/begin MEASUREMENT rv_nw_grd_kl_a "RV_NW_GRD_KL_A" UWORD RANGE________0___0H__0H____1___1 2 2.0 0 65535 BIT_MASK 0x10 /begin IF_DATA ASAP1B_ADDRESS KP_BLOB 0xfd66 /end IF_DATA /end MEASUREMENT
/begin MEASUREMENT rv_nw_grd_kl_e "RV_NW_GRD_KL_E" UWORD RANGE________0___0H__0H____1___1 2 2.0 0 65535 BIT_MASK 0x10 /begin IF_DATA ASAP1B_ADDRESS KP_BLOB 0xfd64 /end IF_DATA /end MEASUREMENT
/begin MEASUREMENT rv_nw_ref "RV_NW_REF" UWORD RANGE________0___0H__0H____1___1 2 2.0 0 65535 BIT_MASK 0x4 /begin IF_DATA ASAP1B_ADDRESS KP_BLOB 0xfd62 /end IF_DATA /end MEASUREMENT
/begin MEASUREMENT rv_vzw_nw_dif_a "RV_VZW_NW_DIF_A" UWORD RANGE________0___0H__0H____1___1 2 2.0 0 65535 BIT_MASK 0x100 /begin IF_DATA ASAP1B_ADDRESS KP_BLOB 0xfd66 /end IF_DATA /end MEASUREMENT
/begin MEASUREMENT rv_vzw_nw_dif_e "RV_VZW_NW_DIF_E" UWORD RANGE________0___0H__0H____1___1 2 2.0 0 65535 BIT_MASK 0x100 /begin IF_DATA ASAP1B_ADDRESS KP_BLOB 0xfd64 /end IF_DATA /end MEASUREMENT
/begin MEASUREMENT rvanos_flags "" UWORD LINEAR______0_000000__0H___65929 2 2.0 0.0 65535.0 BIT_MASK 0xffffffff /begin IF_DATA ASAP1B_ADDRESS KP_BLOB 0xfd62 /end IF_DATA /end MEASUREMENT
/begin MEASUREMENT s_wk "S_WK" UBYTE S_WK_RANGE 2 2.0 0 255 BIT_MASK 0xffffffff /begin IF_DATA ASAP1B_ADDRESS KP_BLOB 0xc364 /end IF_DATA /end MEASUREMENT
/begin MEASUREMENT sa_diag_cnd "SA_DIAG_CND" UBYTE SA_DIAG_CND_RANGE 2 2.0 0 255 BIT_MASK 0xffffffff /begin IF_DATA ASAP1B_ADDRESS KP_BLOB 0xc338 /end IF_DATA /end MEASUREMENT
/begin MEASUREMENT sam_klopf_zyl_0 "Klopfen Z1" UWORD RANGE________NEIN___0H__0H____JA 2 2.0 0 65535 BIT_MASK 0x2 /begin IF_DATA ASAP1B_ADDRESS KP_BLOB 0xfd6a /end IF_DATA /end MEASUREMENT
/begin MEASUREMENT sam_klopf_zyl_1 "Klopfen Z5" UWORD RANGE________NEIN___0H__0H____JA 2 2.0 0 65535 BIT_MASK 0x4 /begin IF_DATA ASAP1B_ADDRESS KP_BLOB 0xfd6a /end IF_DATA /end MEASUREMENT
/begin MEASUREMENT sam_klopf_zyl_1_6 "Klopfen Z1 bis Z6" UWORD RANGE________NEIN___0H__0H____JA 2 2.0 0 65535 BIT_MASK 0x1 /begin IF_DATA ASAP1B_ADDRESS KP_BLOB 0xfd6a /end IF_DATA /end MEASUREMENT
/begin MEASUREMENT sam_klopf_zyl_2 "Klopfen Z3" UWORD RANGE________NEIN___0H__0H____JA 2 2.0 0 65535 BIT_MASK 0x8 /begin IF_DATA ASAP1B_ADDRESS KP_BLOB 0xfd6a /end IF_DATA /end MEASUREMENT
/begin MEASUREMENT sam_klopf_zyl_3 "Klopfen Z6" UWORD RANGE________NEIN___0H__0H____JA 2 2.0 0 65535 BIT_MASK 0x10 /begin IF_DATA ASAP1B_ADDRESS KP_BLOB 0xfd6a /end IF_DATA /end MEASUREMENT
/begin MEASUREMENT sam_klopf_zyl_4 "Klopfen Z2" UWORD RANGE________NEIN___0H__0H____JA 2 2.0 0 65535 BIT_MASK 0x20 /begin IF_DATA ASAP1B_ADDRESS KP_BLOB 0xfd6a /end IF_DATA /end MEASUREMENT
/begin MEASUREMENT sam_klopf_zyl_5 "Klopfen Z4" UWORD RANGE________NEIN___0H__0H____JA 2 2.0 0 65535 BIT_MASK 0x40 /begin IF_DATA ASAP1B_ADDRESS KP_BLOB 0xfd6a /end IF_DATA /end MEASUREMENT
/begin MEASUREMENT sam_word_0 "" UWORD LINEAR______0_000000__0H___65904 2 2.0 0.0 65535.0 BIT_MASK 0xffffffff /begin IF_DATA ASAP1B_ADDRESS KP_BLOB 0xfd6a /end IF_DATA /end MEASUREMENT
/begin MEASUREMENT sav_diag_cnd "SAV_DIAG_CND" UBYTE SAV_DIAG_CND_RANGE 2 2.0 0 255 BIT_MASK 0xffffffff /begin IF_DATA ASAP1B_ADDRESS KP_BLOB 0xc339 /end IF_DATA /end MEASUREMENT
/begin MEASUREMENT schw_nC0D "LU_SCHW_1" SWORD LINEAR_______32768_000000__FF975 2 2.0 -32768.0 32767.0 BIT_MASK 0xffffffff /begin IF_DATA ASAP1B_ADDRESS KP_BLOB 0xe2e0 /end IF_DATA /end MEASUREMENT
/begin MEASUREMENT schw_nC1D "LU_SCHW_5" SWORD LINEAR_______32768_000000__FF975 2 2.0 -32768.0 32767.0 BIT_MASK 0xffffffff /begin IF_DATA ASAP1B_ADDRESS KP_BLOB 0xe2e2 /end IF_DATA /end MEASUREMENT
/begin MEASUREMENT schw_nC2D "LU_SCHW_3" SWORD LINEAR_______32768_000000__FF975 2 2.0 -32768.0 32767.0 BIT_MASK 0xffffffff /begin IF_DATA ASAP1B_ADDRESS KP_BLOB 0xe2e4 /end IF_DATA /end MEASUREMENT
/begin MEASUREMENT schw_nC3D "LU_SCHW_6" SWORD LINEAR_______32768_000000__FF975 2 2.0 -32768.0 32767.0 BIT_MASK 0xffffffff /begin IF_DATA ASAP1B_ADDRESS KP_BLOB 0xe2e6 /end IF_DATA /end MEASUREMENT
/begin MEASUREMENT schw_nC4D "LU_SCHW_2" SWORD LINEAR_______32768_000000__FF975 2 2.0 -32768.0 32767.0 BIT_MASK 0xffffffff /begin IF_DATA ASAP1B_ADDRESS KP_BLOB 0xe2e8 /end IF_DATA /end MEASUREMENT
/begin MEASUREMENT schw_nC5D "LU_SCHW_4" SWORD LINEAR_______32768_000000__FF975 2 2.0 -32768.0 32767.0 BIT_MASK 0xffffffff /begin IF_DATA ASAP1B_ADDRESS KP_BLOB 0xe2ea /end IF_DATA /end MEASUREMENT
/begin MEASUREMENT schw_rad_grd_sws_ldp "SCHW_SWS_LDP" UWORD LINEAR______0_000000__0H___25580 2 2.0 0.0 255.0 BIT_MASK 0xffffffff /begin IF_DATA ASAP1B_ADDRESS KP_BLOB 0xcf0e /end IF_DATA /end MEASUREMENT
/begin MEASUREMENT seg_ad_lern "SEG_AD_LERN" UWORD RANGE________JA___1H__1H____N902 2 2.0 0 65535 BIT_MASK 0x2 /begin IF_DATA ASAP1B_ADDRESS KP_BLOB 0xfd7a /end IF_DATA /end MEASUREMENT
/begin MEASUREMENT seg_ad_zust "SEG_AD_ZUST" UWORD RANGE________aktiv___1H__1H__895 2 2.0 0 65535 BIT_MASK 0x1 /begin IF_DATA ASAP1B_ADDRESS KP_BLOB 0xfd7a /end IF_DATA /end MEASUREMENT
/begin MEASUREMENT seg_t_mes_0_rr "TN_SWS_1" UWORD LINEAR______0_000000__0H___26911 2 2.0 0.0 262.144 BIT_MASK 0xffffffff /begin IF_DATA ASAP1B_ADDRESS KP_BLOB 0xcf24 /end IF_DATA /end MEASUREMENT
/begin MEASUREMENT seg_t_mes_1_rr "TN_SWS" UWORD LINEAR______0_000000__0H___26911 2 2.0 0.0 262.144 BIT_MASK 0xffffffff /begin IF_DATA ASAP1B_ADDRESS KP_BLOB 0xcf26 /end IF_DATA /end MEASUREMENT
/begin MEASUREMENT sl_akt_verl "SL_AKT_VERL" UWORD RANGE________0___0H__0H____1___1 2 2.0 0 65535 BIT_MASK 0x100 /begin IF_DATA ASAP1B_ADDRESS KP_BLOB 0xfd68 /end IF_DATA /end MEASUREMENT
/begin MEASUREMENT sl_diag_end "SL_DIAG_END" UWORD RANGE________0___0H__0H____1___1 2 2.0 0 65535 BIT_MASK 0x800 /begin IF_DATA ASAP1B_ADDRESS KP_BLOB 0xfd68 /end IF_DATA /end MEASUREMENT
/begin MEASUREMENT sl_flags "SL_FLAGS" UWORD LINEAR______0_000000__0H___65163 2 2.0 0.0 65535.0 BIT_MASK 0xffffffff /begin IF_DATA ASAP1B_ADDRESS KP_BLOB 0xfd68 /end IF_DATA /end MEASUREMENT
/begin MEASUREMENT sl_wst_ctr "SL_WST_CTR" UBYTE LINEAR______0_000000__0H___25142 2 2.0 0.0 255.0 BIT_MASK 0xffffffff /begin IF_DATA ASAP1B_ADDRESS KP_BLOB 0xc334 /end IF_DATA /end MEASUREMENT
/begin MEASUREMENT slp_akt_min "SLP_AKT_MIN" UWORD RANGE________0___0H__0H____1___1 2 2.0 0 65535 BIT_MASK 0x2 /begin IF_DATA ASAP1B_ADDRESS KP_BLOB 0xfd68 /end IF_DATA /end MEASUREMENT
/begin MEASUREMENT slp_akt_slv_diag "SLP_AKT_SLV_DIAG" UWORD RANGE________0___0H__0H____1___1 2 2.0 0 65535 BIT_MASK 0x2000 /begin IF_DATA ASAP1B_ADDRESS KP_BLOB 0xfd68 /end IF_DATA /end MEASUREMENT
/begin MEASUREMENT slv_akt_min "SLV_AKT_MIN" UWORD RANGE________0___0H__0H____1___1 2 2.0 0 65535 BIT_MASK 0x1 /begin IF_DATA ASAP1B_ADDRESS KP_BLOB 0xfd68 /end IF_DATA /end MEASUREMENT
/begin MEASUREMENT slv_diag_abr "SLV_DIAG_ABR" UWORD RANGE________0___0H__0H____1___1 2 2.0 0 65535 BIT_MASK 0x8000 /begin IF_DATA ASAP1B_ADDRESS KP_BLOB 0xfd68 /end IF_DATA /end MEASUREMENT
/begin MEASUREMENT slv_diag_end "SLV_DIAG_END" UWORD RANGE________0___0H__0H____1___1 2 2.0 0 65535 BIT_MASK 0x1000 /begin IF_DATA ASAP1B_ADDRESS KP_BLOB 0xfd68 /end IF_DATA /end MEASUREMENT
/begin MEASUREMENT soi "Einspritzbeginn" UBYTE LINEAR_______180_000000__0H__997 2 2.0 -180.0 504.0 BIT_MASK 0xffffffff /begin IF_DATA ASAP1B_ADDRESS KP_BLOB 0xe54a /end IF_DATA /end MEASUREMENT
/begin MEASUREMENT spi_rcv_buf_CUC5D "KE_RAMZELLE_1" UBYTE LINEAR______0_000000__0H___25142 2 2.0 0.0 255.0 BIT_MASK 0xffffffff /begin IF_DATA ASAP1B_ADDRESS KP_BLOB 0xe597 /end IF_DATA /end MEASUREMENT
/begin MEASUREMENT spi_rcv_buf_CUC6D "KE_RAMZELLE_2" UBYTE LINEAR______0_000000__0H___25142 2 2.0 0.0 255.0 BIT_MASK 0xffffffff /begin IF_DATA ASAP1B_ADDRESS KP_BLOB 0xe598 /end IF_DATA /end MEASUREMENT
/begin MEASUREMENT stat_md_e "" UBYTE LINEAR______0_000000__0H___25905 2 2.0 0.0 255.0 BIT_MASK 0xffffffff /begin IF_DATA ASAP1B_ADDRESS KP_BLOB 0xc5fe /end IF_DATA /end MEASUREMENT
/begin MEASUREMENT stat_md_e_sams "STAT_MD_E" UBYTE STATE_MD_RANGE 2 2.0 0 255 BIT_MASK 0x3 /begin IF_DATA ASAP1B_ADDRESS KP_BLOB 0xc5fe /end IF_DATA /end MEASUREMENT
/begin MEASUREMENT state_efp_crash "STATE_EKP_CRASH" UBYTE STATE_EKP_CRASH_RANGE 2 2.0 0 255 BIT_MASK 0x3 /begin IF_DATA ASAP1B_ADDRESS KP_BLOB 0xc32b /end IF_DATA /end MEASUREMENT
/begin MEASUREMENT state_gelernte_varianten "STATE_GELERNTE_VARIANTEN" UWORD STATE_VARIANTEN 2 2.0 0 65535 BIT_MASK 0x3f /begin IF_DATA ASAP1B_ADDRESS KP_BLOB 0xfd3e /end IF_DATA /end MEASUREMENT
/begin MEASUREMENT state_ivvt "STATE_IVVT_DUMMY" UBYTE LINEAR______0_000000__0H___25905 2 2.0 0.0 255.0 BIT_MASK 0xffffffff /begin IF_DATA ASAP1B_ADDRESS KP_BLOB 0xc303 /end IF_DATA /end MEASUREMENT
/begin MEASUREMENT state_ivvt_sams "STATE_IVVT" UBYTE STATE_IVVT 2 2.0 0 255 BIT_MASK 0x3 /begin IF_DATA ASAP1B_ADDRESS KP_BLOB 0xc303 /end IF_DATA /end MEASUREMENT
/begin MEASUREMENT sum_rr "SWS_COUNT" UWORD LINEAR______0_000000__0H___65163 2 2.0 0.0 65535.0 BIT_MASK 0xffffffff /begin IF_DATA ASAP1B_ADDRESS KP_BLOB 0xcf28 /end IF_DATA /end MEASUREMENT
/begin MEASUREMENT sws_ldp "SWS_LDP" UWORD RANGE________JA___1H__1H____N902 2 2.0 0 65535 BIT_MASK 0x800 /begin IF_DATA ASAP1B_ADDRESS KP_BLOB 0xfd78 /end IF_DATA /end MEASUREMENT
/begin MEASUREMENT t_akt_ldp "T_AKT_LDP" UWORD LINEAR______0_000000__0H___6553_ 2 2.0 0.0 6553.5 BIT_MASK 0xffffffff /begin IF_DATA ASAP1B_ADDRESS KP_BLOB 0xcf08 /end IF_DATA /end MEASUREMENT
/begin MEASUREMENT t_anst_fgr "T_ANST_FGR" UBYTE LINEAR______0_000000__0H___25735 2 2.0 0.0 25.5 BIT_MASK 0xffffffff /begin IF_DATA ASAP1B_ADDRESS KP_BLOB 0xce0b /end IF_DATA /end MEASUREMENT
/begin MEASUREMENT t_bts_plaus_ctr "T_BTS_PLAUS" UBYTE LINEAR______0_000000__0H___25735 2 2.0 0.0 25.5 BIT_MASK 0xffffffff /begin IF_DATA ASAP1B_ADDRESS KP_BLOB 0xc1de /end IF_DATA /end MEASUREMENT
/begin MEASUREMENT t_hbridge_max_ctr "T_HBRIDGE_MAX_CTR" UBYTE LINEAR______0_000000__0H___1275_ 2 2.0 0.0 1275.0 BIT_MASK 0xffffffff /begin IF_DATA ASAP1B_ADDRESS KP_BLOB 0xc2e5 /end IF_DATA /end MEASUREMENT
/begin MEASUREMENT t_hbridge_tamdk_max_ctr "T_HBRIDGE_TAMDK_MAX_CTR" UBYTE LINEAR______0_000000__0H___1275_ 2 2.0 0.0 1275.0 BIT_MASK 0xffffffff /begin IF_DATA ASAP1B_ADDRESS KP_BLOB 0xc2e6 /end IF_DATA /end MEASUREMENT
/begin MEASUREMENT t_ksd_dc_1 "T_KSD_DC_1" UWORD LINEAR______0_000000__0H___65829 2 2.0 0.0 65535.0 BIT_MASK 0xffffffff /begin IF_DATA ASAP1B_ADDRESS KP_BLOB 0xe21a /end IF_DATA /end MEASUREMENT
/begin MEASUREMENT t_ksd_dc_2 "T_KSD_DC_2" UWORD LINEAR______0_000000__0H___65829 2 2.0 0.0 65535.0 BIT_MASK 0xffffffff /begin IF_DATA ASAP1B_ADDRESS KP_BLOB 0xe21c /end IF_DATA /end MEASUREMENT
/begin MEASUREMENT t_ldp_wst "T_LDP_WST" UWORD LINEAR______0_000000__0H___6553_ 2 2.0 0.0 6553.5 BIT_MASK 0xffffffff /begin IF_DATA ASAP1B_ADDRESS KP_BLOB 0xcf0a /end IF_DATA /end MEASUREMENT
/begin MEASUREMENT t_min_dk_dif_ctr "T_MIN_DK_DIF_CTR" UBYTE LINEAR______0_000000__0H___2550_ 2 2.0 0.0 2550.0 BIT_MASK 0xffffffff /begin IF_DATA ASAP1B_ADDRESS KP_BLOB 0xc2e0 /end IF_DATA /end MEASUREMENT
/begin MEASUREMENT t_per_ldp "T_PER_LDP" UWORD LINEAR______0_000000__0H___655_3 2 2.0 0.0 655.34998 BIT_MASK 0xffffffff /begin IF_DATA ASAP1B_ADDRESS KP_BLOB 0xceea /end IF_DATA /end MEASUREMENT
/begin MEASUREMENT t_per_ldp_end "T_PER_LDP_END" UWORD LINEAR______0_000000__0H___655_3 2 2.0 0.0 655.34998 BIT_MASK 0xffffffff /begin IF_DATA ASAP1B_ADDRESS KP_BLOB 0xcf02 /end IF_DATA /end MEASUREMENT
/begin MEASUREMENT t_rest_sa "T_REST_SA" UWORD LINEAR______0_000000__0H___8_998 2 2.0 0.0 8.38848 BIT_MASK 0xffffffff /begin IF_DATA ASAP1B_ADDRESS KP_BLOB 0xfa6e /end IF_DATA /end MEASUREMENT
/begin MEASUREMENT t_rest_zw_inc_ar "T_REST_ZW_INC_AR" UWORD LINEAR______0_000000__0H___20999 2 2.0 0.0 2097.12 BIT_MASK 0xffffffff /begin IF_DATA ASAP1B_ADDRESS KP_BLOB 0xe0a2 /end IF_DATA /end MEASUREMENT
/begin MEASUREMENT t_sa "T_SA" UBYTE LINEAR______0_000000__0H___25735 2 2.0 0.0 25.5 BIT_MASK 0xffffffff /begin IF_DATA ASAP1B_ADDRESS KP_BLOB 0xc1be /end IF_DATA /end MEASUREMENT
/begin MEASUREMENT t_sa_zv "T_MIN_SA_ZV" UBYTE LINEAR______0_000000__0H___21000 2 2.0 0.0 2.55 BIT_MASK 0xffffffff /begin IF_DATA ASAP1B_ADDRESS KP_BLOB 0xc1bf /end IF_DATA /end MEASUREMENT
/begin MEASUREMENT t_sl_diag "T_DIAG_SL" UWORD LINEAR______0_000000__0H___13960 2 2.0 0.0 1310.7 BIT_MASK 0xffffffff /begin IF_DATA ASAP1B_ADDRESS KP_BLOB 0xd286 /end IF_DATA /end MEASUREMENT
/begin MEASUREMENT t_sl_prolong "T_SL_VERL" UWORD LINEAR______0_000000__0H___61001 2 2.0 0.0 6553.5 BIT_MASK 0xffffffff /begin IF_DATA ASAP1B_ADDRESS KP_BLOB 0xce34 /end IF_DATA /end MEASUREMENT
/begin MEASUREMENT t_tamdk_max_diag_ctr "T_TAMDK_MAX_DIAG_CTR" UBYTE LINEAR______0_000000__0H___2550_ 2 2.0 0.0 2550.0 BIT_MASK 0xffffffff /begin IF_DATA ASAP1B_ADDRESS KP_BLOB 0xc2de /end IF_DATA /end MEASUREMENT
/begin MEASUREMENT t_te "T_TE" UWORD LINEAR______0_000000__0H___65837 2 2.0 0.0 6553.5 BIT_MASK 0xffffffff /begin IF_DATA ASAP1B_ADDRESS KP_BLOB 0xe23c /end IF_DATA /end MEASUREMENT
/begin MEASUREMENT t_totz_sl_diag "T_TOTZ_SL_DIAG" UWORD LINEAR______0_000000__0H___13960 2 2.0 0.0 1310.7 BIT_MASK 0xffffffff /begin IF_DATA ASAP1B_ADDRESS KP_BLOB 0xd288 /end IF_DATA /end MEASUREMENT
/begin MEASUREMENT t_wait_bab_cnt "T_WAIT_BAB_CNT" UBYTE LINEAR______0_000000__0H___25735 2 2.0 0.0 25.5 BIT_MASK 0xffffffff /begin IF_DATA ASAP1B_ADDRESS KP_BLOB 0xc20c /end IF_DATA /end MEASUREMENT
/begin MEASUREMENT t_wait_bab_ll_cnt "T_WAIT_BAB_LL_CNT" UBYTE LINEAR______0_000000__0H___25735 2 2.0 0.0 25.5 BIT_MASK 0xffffffff /begin IF_DATA ASAP1B_ADDRESS KP_BLOB 0xc20d /end IF_DATA /end MEASUREMENT
/begin MEASUREMENT t_zw_inc_ar "T_ZW_INC_AR" UBYTE LINEAR______0_000000__0H___25119 2 2.0 0.0 2550.0 BIT_MASK 0xffffffff /begin IF_DATA ASAP1B_ADDRESS KP_BLOB 0xcdf1 /end IF_DATA /end MEASUREMENT
/begin MEASUREMENT ta_kfk_sav "TA_KFK" UBYTE LINEAR______0_000000__0H___11002 2 2.0 0.0 100.0 BIT_MASK 0xffffffff /begin IF_DATA ASAP1B_ADDRESS KP_BLOB 0xc319 /end IF_DATA /end MEASUREMENT
/begin MEASUREMENT ta_tkw_i "TA_TKW_I" SWORD LINEAR_______50_000000__FFFF1003 2 2.0 -50.0 49.6 BIT_MASK 0xffffffff /begin IF_DATA ASAP1B_ADDRESS KP_BLOB 0xce2a /end IF_DATA /end MEASUREMENT
/begin MEASUREMENT ta_tkw_p "TA_TKW_P" SBYTE LINEAR_______50_000000__FFFFFF80 2 2.0 -50.0 49.610001 BIT_MASK 0xffffffff /begin IF_DATA ASAP1B_ADDRESS KP_BLOB 0xc314 /end IF_DATA /end MEASUREMENT
/begin MEASUREMENT tab_lam_tkw_min "TAB_LAM_TKW_MIN" UBYTE LINEAR_______48_000000__0H___143 2 2.0 -48.0 143.25 BIT_MASK 0xffffffff /begin IF_DATA ASAP1B_ADDRESS KP_BLOB 0xc1bb /end IF_DATA /end MEASUREMENT
/begin MEASUREMENT tab_lam_tkw_min_ll "TAB_LAM_TKW_MIN_LL" UBYTE LINEAR_______48_000000__0H___143 2 2.0 -48.0 143.25 BIT_MASK 0xffffffff /begin IF_DATA ASAP1B_ADDRESS KP_BLOB 0xc1bc /end IF_DATA /end MEASUREMENT
/begin MEASUREMENT tab_t_wait_diag_sl "TAB_T_WAIT_DIAG_SL" UWORD LINEAR______0_000000__0H___13960 2 2.0 0.0 1310.7 BIT_MASK 0xffffffff /begin IF_DATA ASAP1B_ADDRESS KP_BLOB 0xd28a /end IF_DATA /end MEASUREMENT
/begin MEASUREMENT tab_ti_1_6 "Einspritzdauer 1 .. 6" UWORD TI_BAS_16_RES910 2 2.0 0.0 262.14 BIT_MASK 0xffffffff /begin IF_DATA ASAP1B_ADDRESS KP_BLOB 0xe320 /end IF_DATA /end MEASUREMENT
/begin MEASUREMENT tab_ti_ks2_add "TAB_TI_KS2_ADD" UWORD LINEAR______0_000000__0H___16941 2 2.0 0.0 16.0 BIT_MASK 0xffffffff /begin IF_DATA ASAP1B_ADDRESS KP_BLOB 0xe1de /end IF_DATA /end MEASUREMENT
/begin MEASUREMENT tab_ti_samC0D "Einspritzdauer 1" UWORD TI_BAS_16_RES910 2 2.0 0.0 262.14 BIT_MASK 0xffffffff /begin IF_DATA ASAP1B_ADDRESS KP_BLOB 0xe314 /end IF_DATA /end MEASUREMENT
/begin MEASUREMENT tab_ti_samC1D "Einspritzdauer 5" UWORD TI_BAS_16_RES910 2 2.0 0.0 262.14 BIT_MASK 0xffffffff /begin IF_DATA ASAP1B_ADDRESS KP_BLOB 0xe316 /end IF_DATA /end MEASUREMENT
/begin MEASUREMENT tab_ti_samC2D "Einspritzdauer 3" UWORD TI_BAS_16_RES910 2 2.0 0.0 262.14 BIT_MASK 0xffffffff /begin IF_DATA ASAP1B_ADDRESS KP_BLOB 0xe318 /end IF_DATA /end MEASUREMENT
/begin MEASUREMENT tab_ti_samC3D "Einspritzdauer 6" UWORD TI_BAS_16_RES910 2 2.0 0.0 262.14 BIT_MASK 0xffffffff /begin IF_DATA ASAP1B_ADDRESS KP_BLOB 0xe31a /end IF_DATA /end MEASUREMENT
/begin MEASUREMENT tab_ti_samC4D "Einspritzdauer 2" UWORD TI_BAS_16_RES910 2 2.0 0.0 262.14 BIT_MASK 0xffffffff /begin IF_DATA ASAP1B_ADDRESS KP_BLOB 0xe31c /end IF_DATA /end MEASUREMENT
/begin MEASUREMENT tab_ti_samC5D "Einspritzdauer 4" UWORD TI_BAS_16_RES910 2 2.0 0.0 262.14 BIT_MASK 0xffffffff /begin IF_DATA ASAP1B_ADDRESS KP_BLOB 0xe31e /end IF_DATA /end MEASUREMENT
/begin MEASUREMENT tab_tmag "TMAG" UBYTE LINEAR_______48_000000__0H___150 2 2.0 -48.0 155.0 BIT_MASK 0xffffffff /begin IF_DATA ASAP1B_ADDRESS KP_BLOB 0xc305 /end IF_DATA /end MEASUREMENT
/begin MEASUREMENT tab_tv_dif_bab "TAB_TV_DIF_BAB" SWORD LINEAR_______256_000000__FFFF800 2 2.0 -256.0 255.9921 BIT_MASK 0xffffffff /begin IF_DATA ASAP1B_ADDRESS KP_BLOB 0xcf16 /end IF_DATA /end MEASUREMENT
/begin MEASUREMENT tael_el "TAEL_EL" UBYTE LINEAR______0_000000__0H___99_61 2 2.0 0.0 99.610001 BIT_MASK 0xffffffff /begin IF_DATA ASAP1B_ADDRESS KP_BLOB 0xc31b /end IF_DATA /end MEASUREMENT
/begin MEASUREMENT tal "TAL" UBYTE LINEAR_______48_000000__0H___189 2 2.0 -48.0 142.5 BIT_MASK 0xffffffff /begin IF_DATA ASAP1B_ADDRESS KP_BLOB 0xc413 /end IF_DATA /end MEASUREMENT
/begin MEASUREMENT tal_ref "TAL_REF" UBYTE LINEAR_______48_000000__0H___189 2 2.0 -48.0 142.5 BIT_MASK 0xffffffff /begin IF_DATA ASAP1B_ADDRESS KP_BLOB 0xc200 /end IF_DATA /end MEASUREMENT
/begin MEASUREMENT tallfs "TALLFS" UWORD LINEAR______0_000000__0H___99_99 2 2.0 0.0 99.998001 BIT_MASK 0xffffffff /begin IF_DATA ASAP1B_ADDRESS KP_BLOB 0xe10e /end IF_DATA /end MEASUREMENT
/begin MEASUREMENT tallfs_ad "TALLFS_AD" SWORD TALLFS_NEG_POS_SI 2 2.0 -200.0 199.9938 BIT_MASK 0xffffffff /begin IF_DATA ASAP1B_ADDRESS KP_BLOB 0xe142 /end IF_DATA /end MEASUREMENT
/begin MEASUREMENT tallfs_ad_gmw_ll "TALLFS_AD_GMW_LL" SWORD LINEAR_______50_000000__FFFF8961 2 2.0 -50.0 49.998501 BIT_MASK 0xffffffff /begin IF_DATA ASAP1B_ADDRESS KP_BLOB 0xe148 /end IF_DATA /end MEASUREMENT
/begin MEASUREMENT tallfs_ad_kor_ll "TALLFS_AD_KOR_LL" SWORD LINEAR_______50_000000__FFFF8961 2 2.0 -50.0 49.998501 BIT_MASK 0xffffffff /begin IF_DATA ASAP1B_ADDRESS KP_BLOB 0xe14e /end IF_DATA /end MEASUREMENT
/begin MEASUREMENT tallfs_ad_ll "TALLFS_AD_LL" SWORD LINEAR_______50_000004__FFFF1004 2 2.0 -50.000004 49.998489 BIT_MASK 0xffffffff /begin IF_DATA ASAP1B_ADDRESS KP_BLOB 0xe146 /end IF_DATA /end MEASUREMENT
/begin MEASUREMENT tallfs_add_ll "Leerlaufregler" SWORD LINEAR_______50_000000__FFFF1005 2 2.0 -50.0 49.998501 BIT_MASK 0xffffffff /begin IF_DATA ASAP1B_ADDRESS KP_BLOB 0xe144 /end IF_DATA /end MEASUREMENT
/begin MEASUREMENT tallfs_bg "TALLFS (Begr.Dyn.)" UWORD RANGE________TALLFS___1H__1H____ 2 2.0 0 65535 BIT_MASK 0x20 /begin IF_DATA ASAP1B_ADDRESS KP_BLOB 0xfd5e /end IF_DATA /end MEASUREMENT
/begin MEASUREMENT tallfs_d_ll "TALLFS_D_LL" SWORD LINEAR_______50_000000__FFFF8961 2 2.0 -50.0 49.998501 BIT_MASK 0xffffffff /begin IF_DATA ASAP1B_ADDRESS KP_BLOB 0xe156 /end IF_DATA /end MEASUREMENT
/begin MEASUREMENT tallfs_fs_ad_gmw_ll "TALLFS_FS_AD_GMW_LL" SWORD LINEAR_______50_000000__FFFF1006 2 2.0 -50.0 49.998501 BIT_MASK 0xffffffff /begin IF_DATA ASAP1B_ADDRESS KP_BLOB 0xe14a /end IF_DATA /end MEASUREMENT
/begin MEASUREMENT tallfs_gmw "TALLFS_GMW" UWORD LINEAR______0_000000__0H___99_99 2 2.0 0.0 99.998001 BIT_MASK 0xffffffff /begin IF_DATA ASAP1B_ADDRESS KP_BLOB 0xe13e /end IF_DATA /end MEASUREMENT
/begin MEASUREMENT tallfs_gmw_ll "TALLFS_GMW_LL" SWORD LINEAR_______50_000004__FFFF1007 2 2.0 -50.000004 49.998489 BIT_MASK 0xffffffff /begin IF_DATA ASAP1B_ADDRESS KP_BLOB 0xe150 /end IF_DATA /end MEASUREMENT
/begin MEASUREMENT tallfs_kk_ad_gmw_ll "TALLFS_KK_AD_GMW_LL" SWORD LINEAR_______50_000000__FFFF1006 2 2.0 -50.0 49.998501 BIT_MASK 0xffffffff /begin IF_DATA ASAP1B_ADDRESS KP_BLOB 0xe14c /end IF_DATA /end MEASUREMENT
/begin MEASUREMENT tallfs_last_1 "TALLFS_LAST_1" UWORD TALLFS 2 2.0 0.0 399.9938 BIT_MASK 0xffffffff /begin IF_DATA ASAP1B_ADDRESS KP_BLOB 0xe12e /end IF_DATA /end MEASUREMENT
/begin MEASUREMENT tallfs_last_aebg "TALLFS_LAST_AEBG" SWORD TALLFS_NEG_POS_SI 2 2.0 -200.0 199.9938 BIT_MASK 0xffffffff /begin IF_DATA ASAP1B_ADDRESS KP_BLOB 0xe152 /end IF_DATA /end MEASUREMENT
/begin MEASUREMENT tallfs_last_ges "TALLFS_LAST_GES" UWORD TALLFS 2 2.0 0.0 399.9938 BIT_MASK 0xffffffff /begin IF_DATA ASAP1B_ADDRESS KP_BLOB 0xe12c /end IF_DATA /end MEASUREMENT
/begin MEASUREMENT tallfs_last_ges_o_kk "TALLFS_LAST_GES_O_KK" UWORD TALLFS 2 2.0 0.0 399.9938 BIT_MASK 0xffffffff /begin IF_DATA ASAP1B_ADDRESS KP_BLOB 0xe118 /end IF_DATA /end MEASUREMENT
/begin MEASUREMENT tallfs_last_ges_o_kk_kor "TALLFS_LAST_GES_O_KK_KOR" UWORD TALLFS 2 2.0 0.0 399.9938 BIT_MASK 0xffffffff /begin IF_DATA ASAP1B_ADDRESS KP_BLOB 0xe11a /end IF_DATA /end MEASUREMENT
/begin MEASUREMENT tallfs_last_kk "TALLFS_LAST_KK" UWORD TALLFS 2 2.0 0.0 399.9938 BIT_MASK 0xffffffff /begin IF_DATA ASAP1B_ADDRESS KP_BLOB 0xe11c /end IF_DATA /end MEASUREMENT
/begin MEASUREMENT tallfs_last_kk_inst "TALLFS_LAST_KK_INST" SWORD TALLFS_NEG_POS_SI 2 2.0 -200.0 199.9938 BIT_MASK 0xffffffff /begin IF_DATA ASAP1B_ADDRESS KP_BLOB 0xe15a /end IF_DATA /end MEASUREMENT
/begin MEASUREMENT tallfs_last_kk_stat "TALLFS_LAST_KK_STAT" UWORD TALLFS 2 2.0 0.0 399.9938 BIT_MASK 0xffffffff /begin IF_DATA ASAP1B_ADDRESS KP_BLOB 0xe11e /end IF_DATA /end MEASUREMENT
/begin MEASUREMENT tallfs_last_ohne_kk "TALLFS_LAST_OHNE_KK" UWORD TALLFS 2 2.0 0.0 399.9938 BIT_MASK 0xffffffff /begin IF_DATA ASAP1B_ADDRESS KP_BLOB 0xe116 /end IF_DATA /end MEASUREMENT
/begin MEASUREMENT tallfs_llfs "TALLFS_LLFS" UWORD LINEAR______0_000000__0H___99_99 2 2.0 0.0 99.998001 BIT_MASK 0xffffffff /begin IF_DATA ASAP1B_ADDRESS KP_BLOB 0xe114 /end IF_DATA /end MEASUREMENT
/begin MEASUREMENT tallfs_p_ll "TALLFS_P_LL" SWORD LINEAR_______50_000000__FFFF8961 2 2.0 -50.0 49.998501 BIT_MASK 0xffffffff /begin IF_DATA ASAP1B_ADDRESS KP_BLOB 0xe154 /end IF_DATA /end MEASUREMENT
/begin MEASUREMENT tallfs_t_ad_ll_fl "TALLFS_T_AD_LL_FL" UWORD RANGE________TALLFS_T_AD_LL___1H 2 2.0 0 65535 BIT_MASK 0x2 /begin IF_DATA ASAP1B_ADDRESS KP_BLOB 0xfd5e /end IF_DATA /end MEASUREMENT
/begin MEASUREMENT tamdk_dir "TAMDK_DIR" UWORD RANGE________SCHLIESSEN___0H__0H 2 2.0 0 65535 BIT_MASK 0x40 /begin IF_DATA ASAP1B_ADDRESS KP_BLOB 0xfd58 /end IF_DATA /end MEASUREMENT
/begin MEASUREMENT tamdk_ges "TAMDK_GES" SWORD MTC_PWM_2CO_16_RES1008 2 2.0 -100.0 99.997 BIT_MASK 0xffffffff /begin IF_DATA ASAP1B_ADDRESS KP_BLOB 0xe0f4 /end IF_DATA /end MEASUREMENT
/begin MEASUREMENT tamdk_output "TAMDK" UWORD LINEAR______0_000000__0H___11009 2 2.0 0.0 100.0 BIT_MASK 0xffffffff /begin IF_DATA ASAP1B_ADDRESS KP_BLOB 0xe0f6 /end IF_DATA /end MEASUREMENT
/begin MEASUREMENT tamdk_output_ubatt "TAMDK_UBATT" UWORD LINEAR______0_000000__0H___11010 2 2.0 0.0 100.0 BIT_MASK 0xffffffff /begin IF_DATA ASAP1B_ADDRESS KP_BLOB 0xfab2 /end IF_DATA /end MEASUREMENT
/begin MEASUREMENT tate "Tankentlüftung" UWORD LINEAR______0_000000__0H___99852 2 2.0 0.0 99.97559 BIT_MASK 0xffffffff /begin IF_DATA ASAP1B_ADDRESS KP_BLOB 0xe24e /end IF_DATA /end MEASUREMENT
/begin MEASUREMENT tate_ber "TATE_BER" UWORD LINEAR______0_000000__0H___800_0 2 2.0 0.0 800.0 BIT_MASK 0xffffffff /begin IF_DATA ASAP1B_ADDRESS KP_BLOB 0xe244 /end IF_DATA /end MEASUREMENT
/begin MEASUREMENT tate_max_kor "TATE_MAX_KOR" UWORD LINEAR______0_000000__0H___800_0 2 2.0 0.0 800.0 BIT_MASK 0xffffffff /begin IF_DATA ASAP1B_ADDRESS KP_BLOB 0xe248 /end IF_DATA /end MEASUREMENT
/begin MEASUREMENT tco_ex "TKA" UBYTE LINEAR_______48_000000__0H___189 2 2.0 -48.0 142.5 BIT_MASK 0xffffffff /begin IF_DATA ASAP1B_ADDRESS KP_BLOB 0xc31c /end IF_DATA /end MEASUREMENT
/begin MEASUREMENT td_ctl_facC0Dvword "ZSI_FAK_1" UWORD LINEAR______0_000000__0H___11011 2 2.0 0.0 1.99997 BIT_MASK 0xffffffff /begin IF_DATA ASAP1B_ADDRESS KP_BLOB 0xfbfe /end IF_DATA /end MEASUREMENT
/begin MEASUREMENT td_ctl_facC1Dvword "ZSI_FAK_5" UWORD LINEAR______0_000000__0H___11011 2 2.0 0.0 1.99997 BIT_MASK 0xffffffff /begin IF_DATA ASAP1B_ADDRESS KP_BLOB 0xfc00 /end IF_DATA /end MEASUREMENT
/begin MEASUREMENT td_ctl_facC2Dvword "ZSI_FAK_3" UWORD LINEAR______0_000000__0H___11011 2 2.0 0.0 1.99997 BIT_MASK 0xffffffff /begin IF_DATA ASAP1B_ADDRESS KP_BLOB 0xfc02 /end IF_DATA /end MEASUREMENT
/begin MEASUREMENT td_ctl_facC3Dvword "ZSI_FAK_6" UWORD LINEAR______0_000000__0H___11011 2 2.0 0.0 1.99997 BIT_MASK 0xffffffff /begin IF_DATA ASAP1B_ADDRESS KP_BLOB 0xfc04 /end IF_DATA /end MEASUREMENT
/begin MEASUREMENT td_ctl_facC4Dvword "ZSI_FAK_2" UWORD LINEAR______0_000000__0H___11011 2 2.0 0.0 1.99997 BIT_MASK 0xffffffff /begin IF_DATA ASAP1B_ADDRESS KP_BLOB 0xfc06 /end IF_DATA /end MEASUREMENT
/begin MEASUREMENT td_ctl_facC5Dvword "ZSI_FAK_4" UWORD LINEAR______0_000000__0H___11011 2 2.0 0.0 1.99997 BIT_MASK 0xffffffff /begin IF_DATA ASAP1B_ADDRESS KP_BLOB 0xfc08 /end IF_DATA /end MEASUREMENT
/begin MEASUREMENT temp_ers_kat "TEMP_ERS_KAT" UBYTE LINEAR_______33_000000__0H___990 2 2.0 -33.0 990.0 BIT_MASK 0xffffffff /begin IF_DATA ASAP1B_ADDRESS KP_BLOB 0xc1fa /end IF_DATA /end MEASUREMENT
/begin MEASUREMENT temp_ers_kat_el "TEMP_ERS_KAT_EL" UBYTE LINEAR_______33_000000__0H___987 2 2.0 -33.0 987.0 BIT_MASK 0xffffffff /begin IF_DATA ASAP1B_ADDRESS KP_BLOB 0xc324 /end IF_DATA /end MEASUREMENT
/begin MEASUREMENT temp_gmw_ers_kat "TEMP_GMW_ERS_KAT" UWORD LINEAR_______33_000000__0H___144 2 2.0 -33.0 990.0 BIT_MASK 0xffffffff /begin IF_DATA ASAP1B_ADDRESS KP_BLOB 0xe272 /end IF_DATA /end MEASUREMENT
/begin MEASUREMENT temp_gmw_ers_kat_elvbyteC1D "TEMP_GMW_ERS_KAT_EL" UBYTE LINEAR_______33_000000__0H___987 2 2.0 -33.0 987.0 BIT_MASK 0xffffffff /begin IF_DATA ASAP1B_ADDRESS KP_BLOB 0xce2f /end IF_DATA /end MEASUREMENT
/begin MEASUREMENT temp_gmw_ers_kat_el_stop "TEMP_GMW_ERS_KAT_EL_STOP" UBYTE LINEAR_______33_000000__0H___987 2 2.0 -33.0 987.0 BIT_MASK 0xffffffff /begin IF_DATA ASAP1B_ADDRESS KP_BLOB 0xc325 /end IF_DATA /end MEASUREMENT
/begin MEASUREMENT temp_sond_ersvbyteC1D "TEMP_SOND_ERS" UBYTE LINEAR_______48_000000__0H___100 2 2.0 -48.0 142.5 BIT_MASK 0xffffffff /begin IF_DATA ASAP1B_ADDRESS KP_BLOB 0xcedb /end IF_DATA /end MEASUREMENT
/begin MEASUREMENT tev_flags "" UWORD LINEAR______0_000000__0H___65904 2 2.0 0.0 65535.0 BIT_MASK 0xffffffff /begin IF_DATA ASAP1B_ADDRESS KP_BLOB 0xfd4c /end IF_DATA /end MEASUREMENT
/begin MEASUREMENT ti_add_dly "KF_TI_ADD_TOTZ" UWORD LINEAR______0_000000__0H___81012 2 2.0 0.0 8.16 BIT_MASK 0xffffffff /begin IF_DATA ASAP1B_ADDRESS KP_BLOB 0xfc2a /end IF_DATA /end MEASUREMENT
/begin MEASUREMENT ti_add_reac_sccC0D "TI_ADD_REAC_SCC_1" SWORD TI_2co_SGN_16_RES1013 2 2.0 -131.072 131.068 BIT_MASK 0xffffffff /begin IF_DATA ASAP1B_ADDRESS KP_BLOB 0xfc40 /end IF_DATA /end MEASUREMENT
/begin MEASUREMENT ti_add_reac_sccC1D "TI_ADD_REAC_SCC_2" SWORD TI_2co_SGN_16_RES1013 2 2.0 -131.072 131.068 BIT_MASK 0xffffffff /begin IF_DATA ASAP1B_ADDRESS KP_BLOB 0xfc42 /end IF_DATA /end MEASUREMENT
/begin MEASUREMENT ti_add_reac_sccC2D "TI_ADD_REAC_SCC_3" SWORD TI_2co_SGN_16_RES1013 2 2.0 -131.072 131.068 BIT_MASK 0xffffffff /begin IF_DATA ASAP1B_ADDRESS KP_BLOB 0xfc44 /end IF_DATA /end MEASUREMENT
/begin MEASUREMENT ti_add_reac_sccC3D "TI_ADD_REAC_SCC_4" SWORD TI_2co_SGN_16_RES1013 2 2.0 -131.072 131.068 BIT_MASK 0xffffffff /begin IF_DATA ASAP1B_ADDRESS KP_BLOB 0xfc46 /end IF_DATA /end MEASUREMENT
/begin MEASUREMENT ti_add_reac_sccC4D "TI_ADD_REAC_SCC_5" SWORD TI_2co_SGN_16_RES1013 2 2.0 -131.072 131.068 BIT_MASK 0xffffffff /begin IF_DATA ASAP1B_ADDRESS KP_BLOB 0xfc48 /end IF_DATA /end MEASUREMENT
/begin MEASUREMENT ti_add_reac_sccC5D "TI_ADD_REAC_SCC_6" SWORD TI_2co_SGN_16_RES1013 2 2.0 -131.072 131.068 BIT_MASK 0xffffffff /begin IF_DATA ASAP1B_ADDRESS KP_BLOB 0xfc4a /end IF_DATA /end MEASUREMENT
/begin MEASUREMENT ti_add_wf "TI_ADD_WF" SWORD TI_2co_SGN_16_RES1013 2 2.0 -131.072 131.068 BIT_MASK 0xffffffff /begin IF_DATA ASAP1B_ADDRESS KP_BLOB 0xe200 /end IF_DATA /end MEASUREMENT
/begin MEASUREMENT ti_dif_sav "TI_DIF" SWORD TI_2co_SGN_16_RES1013 2 2.0 -131.072 131.068 BIT_MASK 0xffffffff /begin IF_DATA ASAP1B_ADDRESS KP_BLOB 0xe1f8 /end IF_DATA /end MEASUREMENT
/begin MEASUREMENT ti_dif_wf "TI_DIF_WF" UWORD LINEAR______0_000000__0H___26963 2 2.0 0.0 262.144 BIT_MASK 0xffffffff /begin IF_DATA ASAP1B_ADDRESS KP_BLOB 0xfc36 /end IF_DATA /end MEASUREMENT
/begin MEASUREMENT ti_dk_dif_wf_sav "TI_DIF_DK_WF" SWORD TI_2co_SGN_16_RES1013 2 2.0 -131.072 131.068 BIT_MASK 0xffffffff /begin IF_DATA ASAP1B_ADDRESS KP_BLOB 0xe1fa /end IF_DATA /end MEASUREMENT
/begin MEASUREMENT ti_dk_wf_sav "TI_DK_WF" SWORD TI_2co_SGN_16_RES1013 2 2.0 -131.072 131.068 BIT_MASK 0xffffffff /begin IF_DATA ASAP1B_ADDRESS KP_BLOB 0xe1f6 /end IF_DATA /end MEASUREMENT
/begin MEASUREMENT ti_flags "" UWORD LINEAR______0_000000__0H___65904 2 2.0 0.0 65535.0 BIT_MASK 0xffffffff /begin IF_DATA ASAP1B_ADDRESS KP_BLOB 0xfd46 /end IF_DATA /end MEASUREMENT
/begin MEASUREMENT ti_ges "Einspritzdauer" UWORD TI_BAS_16_RES1014 2 2.0 0.0 262.14 BIT_MASK 0xffffffff /begin IF_DATA ASAP1B_ADDRESS KP_BLOB 0xe30c /end IF_DATA /end MEASUREMENT
/begin MEASUREMENT ti_ks_bk1 "TI_KS_BK1" UWORD LINEAR______0_000000__0H___16941 2 2.0 0.0 16.0 BIT_MASK 0xffffffff /begin IF_DATA ASAP1B_ADDRESS KP_BLOB 0xe1e4 /end IF_DATA /end MEASUREMENT
/begin MEASUREMENT ti_ks_bk2 "TI_KS_BK2" UWORD LINEAR______0_000000__0H___16941 2 2.0 0.0 16.0 BIT_MASK 0xffffffff /begin IF_DATA ASAP1B_ADDRESS KP_BLOB 0xe1ec /end IF_DATA /end MEASUREMENT
/begin MEASUREMENT ti_ks2_add_bk1 "TI_KS2_ADD_BK1" UWORD LINEAR______0_000000__0H___16941 2 2.0 0.0 16.0 BIT_MASK 0xffffffff /begin IF_DATA ASAP1B_ADDRESS KP_BLOB 0xe1e6 /end IF_DATA /end MEASUREMENT
/begin MEASUREMENT ti_ks2_add_bk2 "TI_KS2_ADD_BK2" UWORD LINEAR______0_000000__0H___16941 2 2.0 0.0 16.0 BIT_MASK 0xffffffff /begin IF_DATA ASAP1B_ADDRESS KP_BLOB 0xe1ee /end IF_DATA /end MEASUREMENT
/begin MEASUREMENT ti_lwf_sav "TI_LWF" SWORD TI_2co_SGN_16_RES1013 2 2.0 -131.072 131.068 BIT_MASK 0xffffffff /begin IF_DATA ASAP1B_ADDRESS KP_BLOB 0xe1f4 /end IF_DATA /end MEASUREMENT
/begin MEASUREMENT ti_ns "TI_NS" UWORD LINEAR______0_000000__0H___11015 2 2.0 0.0 16.0 BIT_MASK 0xffffffff /begin IF_DATA ASAP1B_ADDRESS KP_BLOB 0xceb0 /end IF_DATA /end MEASUREMENT
/begin MEASUREMENT ti_reac_wf "TI_REAC_WF" UWORD LINEAR______0_000000__0H___26963 2 2.0 0.0 262.144 BIT_MASK 0xffffffff /begin IF_DATA ASAP1B_ADDRESS KP_BLOB 0xfc38 /end IF_DATA /end MEASUREMENT
/begin MEASUREMENT ti_swf_sav "TI_SWF" SWORD TI_2co_SGN_16_RES1013 2 2.0 -131.072 131.068 BIT_MASK 0xffffffff /begin IF_DATA ASAP1B_ADDRESS KP_BLOB 0xe1f2 /end IF_DATA /end MEASUREMENT
/begin MEASUREMENT ti_vl "TI_VL" UWORD LINEAR______0_000000__0H___11015 2 2.0 0.0 16.0 BIT_MASK 0xffffffff /begin IF_DATA ASAP1B_ADDRESS KP_BLOB 0xe310 /end IF_DATA /end MEASUREMENT
/begin MEASUREMENT ti_wl "TI_WL" UWORD LINEAR______0_000000__0H___11015 2 2.0 0.0 16.0 BIT_MASK 0xffffffff /begin IF_DATA ASAP1B_ADDRESS KP_BLOB 0xe312 /end IF_DATA /end MEASUREMENT
/begin MEASUREMENT tipr "TI_VORAB" UWORD LINEAR______0_000000__0H___21016 2 2.0 0.0 262.144 BIT_MASK 0xffffffff /begin IF_DATA ASAP1B_ADDRESS KP_BLOB 0xfc28 /end IF_DATA /end MEASUREMENT
/begin MEASUREMENT tkw "TKW" UBYTE LINEAR_______48_000000__0H___189 2 2.0 -48.0 142.5 BIT_MASK 0xffffffff /begin IF_DATA ASAP1B_ADDRESS KP_BLOB 0xc412 /end IF_DATA /end MEASUREMENT
/begin MEASUREMENT tkw_can "TKW_CAN" UBYTE LINEAR_______48_000000__0H___189 2 2.0 -48.0 142.5 BIT_MASK 0xffffffff /begin IF_DATA ASAP1B_ADDRESS KP_BLOB 0xc367 /end IF_DATA /end MEASUREMENT
/begin MEASUREMENT tkw_ers "TKW_ERS" UBYTE LINEAR_______48_000000__0H___189 2 2.0 -48.0 142.5 BIT_MASK 0xffffffff /begin IF_DATA ASAP1B_ADDRESS KP_BLOB 0xc185 /end IF_DATA /end MEASUREMENT
/begin MEASUREMENT tkw_lam_ers "TKW_LAM_ERS" UBYTE LINEAR_______48_000000__0H___189 2 2.0 -48.0 142.5 BIT_MASK 0xffffffff /begin IF_DATA ASAP1B_ADDRESS KP_BLOB 0xc2d1 /end IF_DATA /end MEASUREMENT
/begin MEASUREMENT tkw_ns "TKW_NS" UBYTE LINEAR_______48_000000__0H___189 2 2.0 -48.0 142.5 BIT_MASK 0xffffffff /begin IF_DATA ASAP1B_ADDRESS KP_BLOB 0xc186 /end IF_DATA /end MEASUREMENT
/begin MEASUREMENT tkw_soll "TKW_SOLL" UBYTE LINEAR_______48_000000__0H___189 2 2.0 -48.0 142.5 BIT_MASK 0xffffffff /begin IF_DATA ASAP1B_ADDRESS KP_BLOB 0xc31a /end IF_DATA /end MEASUREMENT
/begin MEASUREMENT tkw_st "TKW_ST" UBYTE LINEAR_______48_000000__0H___189 2 2.0 -48.0 142.5 BIT_MASK 0xffffffff /begin IF_DATA ASAP1B_ADDRESS KP_BLOB 0xc187 /end IF_DATA /end MEASUREMENT
/begin MEASUREMENT tkw_stop "TKW_STOP" UBYTE LINEAR_______48_000000__0H___189 2 2.0 -48.0 142.5 BIT_MASK 0xffffffff /begin IF_DATA ASAP1B_ADDRESS KP_BLOB 0xc17f /end IF_DATA /end MEASUREMENT
/begin MEASUREMENT tmdk "TMDK" UWORD LINEAR_______48_000000__0H__1017 2 2.0 -48.0 142.5 BIT_MASK 0xffffffff /begin IF_DATA ASAP1B_ADDRESS KP_BLOB 0xe100 /end IF_DATA /end MEASUREMENT
/begin MEASUREMENT tn_grd "TN_GRD" SWORD LINEAR_______0_125000__FFFF8000H 2 2.0 -0.125 0.12499 BIT_MASK 0xffffffff /begin IF_DATA ASAP1B_ADDRESS KP_BLOB 0xe09c /end IF_DATA /end MEASUREMENT
/begin MEASUREMENT tn_grd_end_schw "TN_GRD_END_SCHW" SWORD LINEAR_______0_125000__FFFF8000H 2 2.0 -0.125 0.12499 BIT_MASK 0xffffffff /begin IF_DATA ASAP1B_ADDRESS KP_BLOB 0xe0a0 /end IF_DATA /end MEASUREMENT
/begin MEASUREMENT tn_grd_st_schw "TN_GRD_ST_SCHW" SWORD LINEAR_______0_125000__FFFF8000H 2 2.0 -0.125 0.12499 BIT_MASK 0xffffffff /begin IF_DATA ASAP1B_ADDRESS KP_BLOB 0xe09e /end IF_DATA /end MEASUREMENT
/begin MEASUREMENT tn_korr_lu_ad "TN_KORR_LU_AD" UWORD LINEAR______0_000000__0H___11018 2 2.0 0.0 1.0 BIT_MASK 0xffffffff /begin IF_DATA ASAP1B_ADDRESS KP_BLOB 0xe2ec /end IF_DATA /end MEASUREMENT
/begin MEASUREMENT tn_lu_1_6 "TN_LU_1_6" UWORD LINEAR______0_000000__0H___61019 2 2.0 0.0 65535.0 BIT_MASK 0xffffffff /begin IF_DATA ASAP1B_ADDRESS KP_BLOB 0xe308 /end IF_DATA /end MEASUREMENT
/begin MEASUREMENT toel "TOEL" UBYTE LINEAR_______48_000000__0H___156 2 2.0 -48.0 155.0 BIT_MASK 0xffffffff /begin IF_DATA ASAP1B_ADDRESS KP_BLOB 0xc415 /end IF_DATA /end MEASUREMENT
/begin MEASUREMENT toel_stop "TOEL_STOP" UBYTE LINEAR_______48_000000__0H___156 2 2.0 -48.0 155.0 BIT_MASK 0xffffffff /begin IF_DATA ASAP1B_ADDRESS KP_BLOB 0xc323 /end IF_DATA /end MEASUREMENT
/begin MEASUREMENT toil_max "TOIL_MAX" UBYTE LINEAR_______48_000000__0H___156 2 2.0 -48.0 155.0 BIT_MASK 0xffffffff /begin IF_DATA ASAP1B_ADDRESS KP_BLOB 0xc182 /end IF_DATA /end MEASUREMENT
/begin MEASUREMENT tumg "TUMG" SBYTE LINEAR_______128_000000__FFFF870 2 2.0 -128.0 127.0 BIT_MASK 0xffffffff /begin IF_DATA ASAP1B_ADDRESS KP_BLOB 0xc368 /end IF_DATA /end MEASUREMENT
/begin MEASUREMENT tv_dif "TV_DIF" SWORD LINEAR_______256_000000__FFFF800 2 2.0 -256.0 255.9921 BIT_MASK 0xffffffff /begin IF_DATA ASAP1B_ADDRESS KP_BLOB 0xcf10 /end IF_DATA /end MEASUREMENT
/begin MEASUREMENT u_comp_wg "U_COMP_WG" SWORD LINEAR_______0_006100__FFFF8000H 2 2.0 -0.0061 0.0061 BIT_MASK 0xffffffff /begin IF_DATA ASAP1B_ADDRESS KP_BLOB 0xe04e /end IF_DATA /end MEASUREMENT
/begin MEASUREMENT ubat_gmw "UB_GMW" UWORD LINEAR______0_000000__0H___21020 2 2.0 0.0 26.0 BIT_MASK 0xffffffff /begin IF_DATA ASAP1B_ADDRESS KP_BLOB 0xe196 /end IF_DATA /end MEASUREMENT
/begin MEASUREMENT ubatt "UB" UBYTE LINEAR______0_000000__0H___26_82 2 2.0 0.0 26.0 BIT_MASK 0xffffffff /begin IF_DATA ASAP1B_ADDRESS KP_BLOB 0xc410 /end IF_DATA /end MEASUREMENT
/begin MEASUREMENT uls_freq_diag_end_1 "ULS_FREQ_DIAG_END_1" UWORD RANGE________JA___1H__1H____N897 2 2.0 0 65535 BIT_MASK 0x400 /begin IF_DATA ASAP1B_ADDRESS KP_BLOB 0xe34a /end IF_DATA /end MEASUREMENT
/begin MEASUREMENT uls_freq_diag_end_2 "ULS_FREQ_DIAG_END_2" UWORD RANGE________JA___1H__1H____N897 2 2.0 0 65535 BIT_MASK 0x400 /begin IF_DATA ASAP1B_ADDRESS KP_BLOB 0xe434 /end IF_DATA /end MEASUREMENT
/begin MEASUREMENT uls_sprung_diag_end_1 "ULS_SPRUNG_DIAG_END_1" UWORD RANGE________JA___1H__1H____N897 2 2.0 0 65535 BIT_MASK 0x200 /begin IF_DATA ASAP1B_ADDRESS KP_BLOB 0xe34a /end IF_DATA /end MEASUREMENT
/begin MEASUREMENT uls_sprung_diag_end_2 "ULS_SPRUNG_DIAG_END_2" UWORD RANGE________JA___1H__1H____N897 2 2.0 0 65535 BIT_MASK 0x200 /begin IF_DATA ASAP1B_ADDRESS KP_BLOB 0xe434 /end IF_DATA /end MEASUREMENT
/begin MEASUREMENT v_aebg_fak_fgr "V_AEBG_FAK_FGR" UBYTE LINEAR______0_000000__0H___0_998 2 2.0 0.0 0.9984 BIT_MASK 0xffffffff /begin IF_DATA ASAP1B_ADDRESS KP_BLOB 0xce09 /end IF_DATA /end MEASUREMENT
/begin MEASUREMENT v_anst_fak_fgr "V_ANST_FAK_FGR" UBYTE LINEAR______0_000000__0H___1_992 2 2.0 0.0 1.9922 BIT_MASK 0xffffffff /begin IF_DATA ASAP1B_ADDRESS KP_BLOB 0xce0a /end IF_DATA /end MEASUREMENT
/begin MEASUREMENT v_curr_igcC0D "V_CURR_IGC_1" UBYTE LINEAR______0_000000__0H___11021 2 2.0 0.0 131.0 BIT_MASK 0xffffffff /begin IF_DATA ASAP1B_ADDRESS KP_BLOB 0xe530 /end IF_DATA /end MEASUREMENT
/begin MEASUREMENT v_curr_igcC1D "V_CURR_IGC_5" UBYTE LINEAR______0_000000__0H___11021 2 2.0 0.0 131.0 BIT_MASK 0xffffffff /begin IF_DATA ASAP1B_ADDRESS KP_BLOB 0xe531 /end IF_DATA /end MEASUREMENT
/begin MEASUREMENT v_curr_igcC2D "V_CURR_IGC_3" UBYTE LINEAR______0_000000__0H___11021 2 2.0 0.0 131.0 BIT_MASK 0xffffffff /begin IF_DATA ASAP1B_ADDRESS KP_BLOB 0xe532 /end IF_DATA /end MEASUREMENT
/begin MEASUREMENT v_curr_igcC3D "V_CURR_IGC_6" UBYTE LINEAR______0_000000__0H___11021 2 2.0 0.0 131.0 BIT_MASK 0xffffffff /begin IF_DATA ASAP1B_ADDRESS KP_BLOB 0xe533 /end IF_DATA /end MEASUREMENT
/begin MEASUREMENT v_curr_igcC4D "V_CURR_IGC_2" UBYTE LINEAR______0_000000__0H___11021 2 2.0 0.0 131.0 BIT_MASK 0xffffffff /begin IF_DATA ASAP1B_ADDRESS KP_BLOB 0xe534 /end IF_DATA /end MEASUREMENT
/begin MEASUREMENT v_curr_igcC5D "V_CURR_IGC_4" UBYTE LINEAR______0_000000__0H___11021 2 2.0 0.0 131.0 BIT_MASK 0xffffffff /begin IF_DATA ASAP1B_ADDRESS KP_BLOB 0xe535 /end IF_DATA /end MEASUREMENT
/begin MEASUREMENT v_dif_fgr "V_DIF_FGR" SWORD V_2co_SGN_16_RES 2 2.0 -256.0 255.99218 BIT_MASK 0xffffffff /begin IF_DATA ASAP1B_ADDRESS KP_BLOB 0xe1b4 /end IF_DATA /end MEASUREMENT
/begin MEASUREMENT v_dif_i_fgr "V_DIF_I_FGR" SWORD LINEAR_______4096_000000__FFFF80 2 2.0 -4096.0 4095.875 BIT_MASK 0xffffffff /begin IF_DATA ASAP1B_ADDRESS KP_BLOB 0xe1b6 /end IF_DATA /end MEASUREMENT
/begin MEASUREMENT v_dur_igcC0D "V_DUR_IGC_1" UWORD LINEAR______0_000000__0H___11022 2 2.0 0.0 131.068 BIT_MASK 0xffffffff /begin IF_DATA ASAP1B_ADDRESS KP_BLOB 0xfc0a /end IF_DATA /end MEASUREMENT
/begin MEASUREMENT v_dur_igcC1D "V_DUR_IGC_5" UWORD LINEAR______0_000000__0H___11022 2 2.0 0.0 131.068 BIT_MASK 0xffffffff /begin IF_DATA ASAP1B_ADDRESS KP_BLOB 0xfc0c /end IF_DATA /end MEASUREMENT
/begin MEASUREMENT v_dur_igcC2D "V_DUR_IGC_3" UWORD LINEAR______0_000000__0H___11022 2 2.0 0.0 131.068 BIT_MASK 0xffffffff /begin IF_DATA ASAP1B_ADDRESS KP_BLOB 0xfc0e /end IF_DATA /end MEASUREMENT
/begin MEASUREMENT v_dur_igcC3D "V_DUR_IGC_6" UWORD LINEAR______0_000000__0H___11022 2 2.0 0.0 131.068 BIT_MASK 0xffffffff /begin IF_DATA ASAP1B_ADDRESS KP_BLOB 0xfc10 /end IF_DATA /end MEASUREMENT
/begin MEASUREMENT v_dur_igcC4D "V_DUR_IGC_2" UWORD LINEAR______0_000000__0H___11022 2 2.0 0.0 131.068 BIT_MASK 0xffffffff /begin IF_DATA ASAP1B_ADDRESS KP_BLOB 0xfc12 /end IF_DATA /end MEASUREMENT
/begin MEASUREMENT v_dur_igcC5D "V_DUR_IGC_4" UWORD LINEAR______0_000000__0H___11022 2 2.0 0.0 131.068 BIT_MASK 0xffffffff /begin IF_DATA ASAP1B_ADDRESS KP_BLOB 0xfc14 /end IF_DATA /end MEASUREMENT
/begin MEASUREMENT v_fil "V_FIL" UWORD LINEAR______0_000000__0H___511_9 2 2.0 0.0 511.99218 BIT_MASK 0xffffffff /begin IF_DATA ASAP1B_ADDRESS KP_BLOB 0xfa58 /end IF_DATA /end MEASUREMENT
/begin MEASUREMENT v_fw_mean "V_FW_MEAN" UWORD LINEAR______0_000000__0H___51023 2 2.0 0.0 511.99218 BIT_MASK 0xffffffff /begin IF_DATA ASAP1B_ADDRESS KP_BLOB 0xe072 /end IF_DATA /end MEASUREMENT
/begin MEASUREMENT v_soll_0_fgr "V_SOLL_0_FGR" UWORD LINEAR______0_000000__0H___511_9 2 2.0 0.0 511.99218 BIT_MASK 0xffffffff /begin IF_DATA ASAP1B_ADDRESS KP_BLOB 0xe1a8 /end IF_DATA /end MEASUREMENT
/begin MEASUREMENT v_soll_dif_fgr "V_SOLL_DIF_FGR" SWORD V_2co_SGN_16_RES 2 2.0 -256.0 255.99218 BIT_MASK 0xffffffff /begin IF_DATA ASAP1B_ADDRESS KP_BLOB 0xe1b8 /end IF_DATA /end MEASUREMENT
/begin MEASUREMENT v_soll_fgr "V_SOLL_FGR" UWORD LINEAR______0_000000__0H___511_9 2 2.0 0.0 511.99218 BIT_MASK 0xffffffff /begin IF_DATA ASAP1B_ADDRESS KP_BLOB 0xe1a6 /end IF_DATA /end MEASUREMENT
/begin MEASUREMENT vl "VL" UWORD RANGE________VL___1H__1H________ 2 2.0 0 65535 BIT_MASK 0x400 /begin IF_DATA ASAP1B_ADDRESS KP_BLOB 0xfd3c /end IF_DATA /end MEASUREMENT
/begin MEASUREMENT vue "VUE" UWORD LINEAR______0_000000__0H___150_7 2 2.0 0.0 150.70979 BIT_MASK 0xffffffff /begin IF_DATA ASAP1B_ADDRESS KP_BLOB 0xd284 /end IF_DATA /end MEASUREMENT
/begin MEASUREMENT vue_soll "VUE_SOLL" UWORD LINEAR______0_000000__0H___150_7 2 2.0 0.0 150.70979 BIT_MASK 0xffffffff /begin IF_DATA ASAP1B_ADDRESS KP_BLOB 0xcfae /end IF_DATA /end MEASUREMENT
/begin MEASUREMENT we "WE" UWORD RANGE________WE___1H__1H________ 2 2.0 0 65535 BIT_MASK 0x1000 /begin IF_DATA ASAP1B_ADDRESS KP_BLOB 0xfd3c /end IF_DATA /end MEASUREMENT
/begin MEASUREMENT wf_wg "WF_WG" UWORD LINEAR______0_000000__0H___7680_ 2 2.0 0.0 7680.0 BIT_MASK 0xffffffff /begin IF_DATA ASAP1B_ADDRESS KP_BLOB 0xfaf8 /end IF_DATA /end MEASUREMENT
/begin MEASUREMENT wheel_grd_mmv "RAD_GRD_GMW" UWORD LINEAR______0_000000__0H___21024 2 2.0 0.0 255.0 BIT_MASK 0xffffffff /begin IF_DATA ASAP1B_ADDRESS KP_BLOB 0xcf20 /end IF_DATA /end MEASUREMENT
/begin MEASUREMENT wheel_grd_mmv_thd "KF_SCHW_RAD_GRD_SWS" UWORD LINEAR______0_000000__0H___21024 2 2.0 0.0 255.0 BIT_MASK 0xffffffff /begin IF_DATA ASAP1B_ADDRESS KP_BLOB 0xcf22 /end IF_DATA /end MEASUREMENT
/begin MEASUREMENT wl "WL" UWORD RANGE________WL___1H__1H________ 2 2.0 0 65535 BIT_MASK 0x10 /begin IF_DATA ASAP1B_ADDRESS KP_BLOB 0xfd3c /end IF_DATA /end MEASUREMENT
/begin MEASUREMENT zeit_nach_start "T_NS" UWORD LINEAR______0_000000__0H___6553_ 2 2.0 0.0 6553.5 BIT_MASK 0xffffffff /begin IF_DATA ASAP1B_ADDRESS KP_BLOB 0xf970 /end IF_DATA /end MEASUREMENT
/begin MEASUREMENT zsi_korC0Dvword "ZSI_KOR_1" UWORD LINEAR______0_000000__0H___11011 2 2.0 0.0 1.99997 BIT_MASK 0xffffffff /begin IF_DATA ASAP1B_ADDRESS KP_BLOB 0xfa90 /end IF_DATA /end MEASUREMENT
/begin MEASUREMENT zsi_korC1Dvword "ZSI_KOR_5" UWORD LINEAR______0_000000__0H___11011 2 2.0 0.0 1.99997 BIT_MASK 0xffffffff /begin IF_DATA ASAP1B_ADDRESS KP_BLOB 0xfa92 /end IF_DATA /end MEASUREMENT
/begin MEASUREMENT zsi_korC2Dvword "ZSI_KOR_3" UWORD LINEAR______0_000000__0H___11011 2 2.0 0.0 1.99997 BIT_MASK 0xffffffff /begin IF_DATA ASAP1B_ADDRESS KP_BLOB 0xfa94 /end IF_DATA /end MEASUREMENT
/begin MEASUREMENT zsi_korC3Dvword "ZSI_KOR_6" UWORD LINEAR______0_000000__0H___11011 2 2.0 0.0 1.99997 BIT_MASK 0xffffffff /begin IF_DATA ASAP1B_ADDRESS KP_BLOB 0xfa96 /end IF_DATA /end MEASUREMENT
/begin MEASUREMENT zsi_korC4Dvword "ZSI_KOR_2" UWORD LINEAR______0_000000__0H___11011 2 2.0 0.0 1.99997 BIT_MASK 0xffffffff /begin IF_DATA ASAP1B_ADDRESS KP_BLOB 0xfa98 /end IF_DATA /end MEASUREMENT
/begin MEASUREMENT zsi_korC5Dvword "ZSI_KOR_4" UWORD LINEAR______0_000000__0H___11011 2 2.0 0.0 1.99997 BIT_MASK 0xffffffff /begin IF_DATA ASAP1B_ADDRESS KP_BLOB 0xfa9a /end IF_DATA /end MEASUREMENT
/begin MEASUREMENT zuendwinkelvbyteC1D "ZUENDWINKEL_HIGH" UBYTE LINEAR_______23_625000__0H___126 2 2.0 -23.625 72.0 BIT_MASK 0xffffffff /begin IF_DATA ASAP1B_ADDRESS KP_BLOB 0xfa5b /end IF_DATA /end MEASUREMENT
/begin MEASUREMENT zust_wst_ldp "ZUST_WST_LDP" UBYTE DRUCKLOS_RANGE 2 2.0 0 255 BIT_MASK 0xffffffff /begin IF_DATA ASAP1B_ADDRESS KP_BLOB 0xc1fe /end IF_DATA /end MEASUREMENT
/begin MEASUREMENT zust1_l_sams "Motorzustand stat." UWORD RANGE_____00000017 2 2.0 0 65535 BIT_MASK 0x7 /begin IF_DATA ASAP1B_ADDRESS KP_BLOB 0xfd3c /end IF_DATA /end MEASUREMENT
/begin MEASUREMENT zw_best "ZW_BEST" UBYTE LINEAR_______23_625000__0H___126 2 2.0 -23.625 72.0 BIT_MASK 0xffffffff /begin IF_DATA ASAP1B_ADDRESS KP_BLOB 0xc441 /end IF_DATA /end MEASUREMENT
/begin MEASUREMENT zw_dif_bk1 "ZW_DIF_BK1" UBYTE LINEAR______0_000000__0H___91025 2 2.0 0.0 95.625 BIT_MASK 0xffffffff /begin IF_DATA ASAP1B_ADDRESS KP_BLOB 0xc445 /end IF_DATA /end MEASUREMENT
/begin MEASUREMENT zw_dif_bk2 "ZW_DIF_BK2" UBYTE LINEAR______0_000000__0H___91025 2 2.0 0.0 95.625 BIT_MASK 0xffffffff /begin IF_DATA ASAP1B_ADDRESS KP_BLOB 0xc446 /end IF_DATA /end MEASUREMENT
/begin MEASUREMENT zw_flags "ZW_FLAGS" UWORD LINEAR______0_000000__0H___65904 2 2.0 0.0 65535.0 BIT_MASK 0xffffffff /begin IF_DATA ASAP1B_ADDRESS KP_BLOB 0xfd52 /end IF_DATA /end MEASUREMENT
/begin MEASUREMENT zw_inst_kr "ZW_INST_KR" UBYTE LINEAR_______48_000000__0H___170 2 2.0 -48.0 47.625 BIT_MASK 0xffffffff /begin IF_DATA ASAP1B_ADDRESS KP_BLOB 0xc44e /end IF_DATA /end MEASUREMENT
/begin MEASUREMENT zw_kat "ZW_KAT" UBYTE LINEAR_______48_000000__0H___170 2 2.0 -48.0 47.625 BIT_MASK 0xffffffff /begin IF_DATA ASAP1B_ADDRESS KP_BLOB 0xc447 /end IF_DATA /end MEASUREMENT
/begin MEASUREMENT zw_kat2 "ZW_KAT2" UBYTE LINEAR_______48_000000__0H___170 2 2.0 -48.0 47.625 BIT_MASK 0xffffffff /begin IF_DATA ASAP1B_ADDRESS KP_BLOB 0xc448 /end IF_DATA /end MEASUREMENT
/begin MEASUREMENT zw_kat3 "ZW_KAT3" UBYTE LINEAR_______48_000000__0H___170 2 2.0 -48.0 47.625 BIT_MASK 0xffffffff /begin IF_DATA ASAP1B_ADDRESS KP_BLOB 0xc449 /end IF_DATA /end MEASUREMENT
/begin MEASUREMENT zw_korr_ar "ZW_KORR_AR" SBYTE LINEAR_______48_000000__FFFF1026 2 2.0 -48.0 47.625 BIT_MASK 0xffffffff /begin IF_DATA ASAP1B_ADDRESS KP_BLOB 0xcded /end IF_DATA /end MEASUREMENT
/begin MEASUREMENT zw_krC0D "ZW_KR_ZYL_1" UBYTE LINEAR_______48_000000__0H___887 2 2.0 -48.0 0.0 BIT_MASK 0xffffffff /begin IF_DATA ASAP1B_ADDRESS KP_BLOB 0xc451 /end IF_DATA /end MEASUREMENT
/begin MEASUREMENT zw_krC1D "ZW_KR_ZYL_5" UBYTE LINEAR_______48_000000__0H___887 2 2.0 -48.0 0.0 BIT_MASK 0xffffffff /begin IF_DATA ASAP1B_ADDRESS KP_BLOB 0xc452 /end IF_DATA /end MEASUREMENT
/begin MEASUREMENT zw_krC2D "ZW_KR_ZYL_3" UBYTE LINEAR_______48_000000__0H___887 2 2.0 -48.0 0.0 BIT_MASK 0xffffffff /begin IF_DATA ASAP1B_ADDRESS KP_BLOB 0xc453 /end IF_DATA /end MEASUREMENT
/begin MEASUREMENT zw_krC3D "ZW_KR_ZYL_6" UBYTE LINEAR_______48_000000__0H___887 2 2.0 -48.0 0.0 BIT_MASK 0xffffffff /begin IF_DATA ASAP1B_ADDRESS KP_BLOB 0xc454 /end IF_DATA /end MEASUREMENT
/begin MEASUREMENT zw_krC4D "ZW_KR_ZYL_2" UBYTE LINEAR_______48_000000__0H___887 2 2.0 -48.0 0.0 BIT_MASK 0xffffffff /begin IF_DATA ASAP1B_ADDRESS KP_BLOB 0xc455 /end IF_DATA /end MEASUREMENT
/begin MEASUREMENT zw_krC5D "ZW_KR_ZYL_4" UBYTE LINEAR_______48_000000__0H___887 2 2.0 -48.0 0.0 BIT_MASK 0xffffffff /begin IF_DATA ASAP1B_ADDRESS KP_BLOB 0xc456 /end IF_DATA /end MEASUREMENT
/begin MEASUREMENT zw_kr_ad_roz "ZW_KR_AD_ROZ" UWORD LINEAR______0_000000__0H___01027 2 2.0 0.0 0.99998474 BIT_MASK 0xffffffff /begin IF_DATA ASAP1B_ADDRESS KP_BLOB 0xfa8e /end IF_DATA /end MEASUREMENT
/begin MEASUREMENT zw_kr_zyl_1_6 "ZW_KR_ZYL 1 .. 6" UBYTE LINEAR_______48_000000__0H___887 2 2.0 -48.0 0.0 BIT_MASK 0xffffffff /begin IF_DATA ASAP1B_ADDRESS KP_BLOB 0xc471 /end IF_DATA /end MEASUREMENT
/begin MEASUREMENT zw_kup_swi_ll "ZW_KUP_SWI_LL" UWORD LINEAR_______48_000000__0H__1028 2 2.0 -48.0 0.0 BIT_MASK 0xffffffff /begin IF_DATA ASAP1B_ADDRESS KP_BLOB 0xe07c /end IF_DATA /end MEASUREMENT
/begin MEASUREMENT zw_mw_bk1 "ZW_MW_BK1" UBYTE LINEAR_______23_625000__0H___126 2 2.0 -23.625 72.0 BIT_MASK 0xffffffff /begin IF_DATA ASAP1B_ADDRESS KP_BLOB 0xc1a3 /end IF_DATA /end MEASUREMENT
/begin MEASUREMENT zw_mw_bk2 "ZW_MW_BK2" UBYTE LINEAR_______23_625000__0H___126 2 2.0 -23.625 72.0 BIT_MASK 0xffffffff /begin IF_DATA ASAP1B_ADDRESS KP_BLOB 0xc1a4 /end IF_DATA /end MEASUREMENT
/begin MEASUREMENT zw_mw_kr "ZW_MW_KR" UBYTE LINEAR_______48_000000__0H___170 2 2.0 -48.0 47.625 BIT_MASK 0xffffffff /begin IF_DATA ASAP1B_ADDRESS KP_BLOB 0xc44f /end IF_DATA /end MEASUREMENT
/begin MEASUREMENT zw_tal_tkw "ZW_TAL_TKW" UBYTE LINEAR_______48_000000__0H___170 2 2.0 -48.0 47.625 BIT_MASK 0xffffffff /begin IF_DATA ASAP1B_ADDRESS KP_BLOB 0xc43e /end IF_DATA /end MEASUREMENT
/begin MEASUREMENT zw_tal_tkw_ll "ZW_TAL_TKW_LL" UBYTE LINEAR_______48_000000__0H___170 2 2.0 -48.0 47.625 BIT_MASK 0xffffffff /begin IF_DATA ASAP1B_ADDRESS KP_BLOB 0xcde7 /end IF_DATA /end MEASUREMENT
/begin MEASUREMENT zw_tallfs_aebgvbyteC1D "ZW_TALLFS_AEBG" UBYTE LINEAR_______48_000000__0H___134 2 2.0 -48.0 0.0 BIT_MASK 0xffffffff /begin IF_DATA ASAP1B_ADDRESS KP_BLOB 0xe083 /end IF_DATA /end MEASUREMENT
/begin MEASUREMENT zw_vanos "ZW_VANOS" UBYTE LINEAR_______23_625000__0H___126 2 2.0 -23.625 72.0 BIT_MASK 0xffffffff /begin IF_DATA ASAP1B_ADDRESS KP_BLOB 0xc43d /end IF_DATA /end MEASUREMENT
/begin MEASUREMENT zw_zyka_inst_kr "ZW_ZYKA_INST_KR" UBYTE LINEAR______0_000000__0H___21029 2 2.0 0.0 255.0 BIT_MASK 0xffffffff /begin IF_DATA ASAP1B_ADDRESS KP_BLOB 0xc44d /end IF_DATA /end MEASUREMENT
/begin MEASUREMENT zyka_kw_auss_a "ZYKA_KW_AUSS_A" UWORD LINEAR______0_000000__0H___65163 2 2.0 0.0 65535.0 BIT_MASK 0xffffffff /begin IF_DATA ASAP1B_ADDRESS KP_BLOB 0xe2b0 /end IF_DATA /end MEASUREMENT
/begin MEASUREMENT zyka_kw_auss_b "ZYKA_KW_AUSS_B" UWORD LINEAR______0_000000__0H___65163 2 2.0 0.0 65535.0 BIT_MASK 0xffffffff /begin IF_DATA ASAP1B_ADDRESS KP_BLOB 0xe2b2 /end IF_DATA /end MEASUREMENT
/begin MEASUREMENT zyka_ll "ZYKA_LL" UWORD RANGE________ZYKA_LL___1H__1H___ 2 2.0 0 65535 BIT_MASK 0x1 /begin IF_DATA ASAP1B_ADDRESS KP_BLOB 0xfd5e /end IF_DATA /end MEASUREMENT
/begin MEASUREMENT zyka_sa "ZYKA_SA" UWORD LINEAR______0_000000__0H___61030 2 2.0 0.0 65535.0 BIT_MASK 0xffffffff /begin IF_DATA ASAP1B_ADDRESS KP_BLOB 0xfa22 /end IF_DATA /end MEASUREMENT
/begin MEASUREMENT zyka_st "ZYKA_ST" UWORD LINEAR______0_000000__0H___61030 2 2.0 0.0 65535.0 BIT_MASK 0xffffffff /begin IF_DATA ASAP1B_ADDRESS KP_BLOB 0xceb2 /end IF_DATA /end MEASUREMENT
/begin MEASUREMENT zyka_stns "ZYKA_STNS" UWORD LINEAR______0_000000__0H___61030 2 2.0 0.0 65535.0 BIT_MASK 0xffffffff /begin IF_DATA ASAP1B_ADDRESS KP_BLOB 0xceb4 /end IF_DATA /end MEASUREMENT
/begin MEASUREMENT zyka_totz_lu "ZYKA_TOTZ_LU" UBYTE LINEAR______0_000000__0H___25142 2 2.0 0.0 255.0 BIT_MASK 0xffffffff /begin IF_DATA ASAP1B_ADDRESS KP_BLOB 0xc605 /end IF_DATA /end MEASUREMENT
/begin MEASUREMENT zyl_id_neu_sam "ZYL_ID_NEU_SAM" UBYTE ZYL_ID 2 2.0 1.0 6.0 BIT_MASK 0xffffffff /begin IF_DATA ASAP1B_ADDRESS KP_BLOB 0xe50f /end IF_DATA /end MEASUREMENT
/begin MEASUREMENT zyl_id_nr "ZYL_ID_NR" UBYTE ZYL_ID 2 2.0 1.0 6.0 BIT_MASK 0xffffffff /begin IF_DATA ASAP1B_ADDRESS KP_BLOB 0xe618 /end IF_DATA /end MEASUREMENT
/begin MEASUREMENT lm_fc_end "LM_FC_END" UWORD MAF_16_RES46 2 2.0 0.0 1389.0 BIT_MASK 0xffffffff /begin IF_DATA ASAP1B_ADDRESS KP_BLOB 0xe25c /end IF_DATA /end MEASUREMENT
/begin MEASUREMENT lammw_dif_te_alt "LAMMW_DIF_TE_ALT" UWORD MAF_16_RES46 2 2.0 0.0 1389.0 BIT_MASK 0xffffffff /begin IF_DATA ASAP1B_ADDRESS KP_BLOB 0xe230 /end IF_DATA /end MEASUREMENT
/begin MEASUREMENT lm_gem_rohvword "LM_GEM_ROH" UWORD MAF_16_RES46 2 2.0 0.0 1389.0 BIT_MASK 0xffffffff /begin IF_DATA ASAP1B_ADDRESS KP_BLOB 0xfa24 /end IF_DATA /end MEASUREMENT
/begin MEASUREMENT lm_kg_h_gem_roh "LM_KG_H_GEM_ROH" UWORD MAF_KGH_16_RES117 2 2.0 0.0 16383.75 BIT_MASK 0xffffffff /begin IF_DATA ASAP1B_ADDRESS KP_BLOB 0xfa48 /end IF_DATA /end MEASUREMENT
/begin MEASUREMENT t_per_ldp_sae "T_PER_LDP_SAE" UWORD LINEAR______0_000000__0H___61031 2 2.0 0.0 65535.0 BIT_MASK 0xffffffff /begin IF_DATA ASAP1B_ADDRESS KP_BLOB 0xcf04 /end IF_DATA /end MEASUREMENT
/begin COMPU_METHOD ES_8_RES "" FORM "%4.0" "[1/min]" FORMULA "32.0*X" FORMULA_INV "0.03125*X" /end COMPU_METHOD
/begin COMPU_METHOD MTC_NORM_16_RES "" FORM "%5.1" "[°DK]" FORMULA "0.0018310547*X" FORMULA_INV "546.13333*X" /end COMPU_METHOD
/begin COMPU_METHOD LINEAR______0_000000__0H___99_61 "" FORM "%4.1" "[%]" FORMULA "0.39062745*X" FORMULA_INV "2.5599839*X" /end COMPU_METHOD
/begin COMPU_METHOD LINEAR_______33_000000__0H___987 "" FORM "%5.1" "[°C]" FORMULA "4.0*X-33.0" FORMULA_INV "0.25*X+8.25" /end COMPU_METHOD
/begin COMPU_METHOD LINEAR_______48_000000__0H___156 "" FORM "%3.0" "[°C]" FORMULA "0.79607843*X-48.0" FORMULA_INV "1.2561576*X+60.295567" /end COMPU_METHOD
/begin COMPU_METHOD LINEAR______0_000000__0H___1_992 "" FORM "%5.3" "[-]" FORMULA "0.0078125491*X" FORMULA_INV "127.9992*X" /end COMPU_METHOD
/begin COMPU_METHOD MTC_NORM_16_RES10 "" FORM "%6.2" "[°DK]" FORMULA "0.0018310547*X" FORMULA_INV "546.13333*X" /end COMPU_METHOD
/begin COMPU_METHOD LINEAR______0_000000__0H___255_9 "" FORM "%7.3" "[-]" FORMULA "0.0039062486*X" FORMULA_INV "256.00009*X" /end COMPU_METHOD
/begin COMPU_METHOD ES_8_RES17 "" FORM "%4.0" "[U/min]" FORMULA "32.0*X" FORMULA_INV "0.03125*X" /end COMPU_METHOD
/begin COMPU_METHOD LINEAR______0_000000__0H___0_996 "" FORM "%5.3" "[-]" FORMULA "0.0039062745*X" FORMULA_INV "255.99839*X" /end COMPU_METHOD
/begin COMPU_METHOD LINEAR______0_000000__0H___0_920 "" FORM "%5.3" "[-]" FORMULA "0.0039058823*X" FORMULA_INV "256.0241*X" /end COMPU_METHOD
/begin COMPU_METHOD LINEAR______0_000000__0H___99_99 "" FORM "%4.1" "[%]" FORMULA "0.0015258717*X" FORMULA_INV "655.3631*X" /end COMPU_METHOD
/begin COMPU_METHOD LINEAR______0_000000__0H___15_94 "" FORM "%5.2" "[-]" FORMULA "0.062509802*X" FORMULA_INV "15.997491*X" /end COMPU_METHOD
/begin COMPU_METHOD LINEAR______0_000000__0H___0_923 "" FORM "%4.3" "[-]" FORMULA "0.0039062745*X" FORMULA_INV "255.99839*X" /end COMPU_METHOD
/begin COMPU_METHOD LINEAR_______50_000000__0H___49_ "" FORM "%4.1" "[%]" FORMULA "0.0015258793*X-50.0" FORMULA_INV "655.35983*X+32767.991" /end COMPU_METHOD
/begin COMPU_METHOD LINEAR______0_000000__0H___2550_ "" FORM "%4.0" "[ms]" FORMULA "10.0*X" FORMULA_INV "0.1*X" /end COMPU_METHOD
/begin COMPU_METHOD LINEAR______0_000000__0H___1000_ "" FORM "%7.2" "[1/min]" FORMULA "0.25*X" FORMULA_INV "4.0*X" /end COMPU_METHOD
/begin COMPU_METHOD MAF_8_RES37 "" FORM "%4.0" "[mg/Hub]" FORMULA "5.4470588*X" FORMULA_INV "0.18358531*X" /end COMPU_METHOD
/begin COMPU_METHOD LINEAR______0_000000__0H___511_9 "" FORM "%6.2" "[km/h]" FORMULA "0.0078124999*X" FORMULA_INV "128.0*X" /end COMPU_METHOD
/begin COMPU_METHOD MAF_16_RES46 "" FORM "%4.0" "[mg/Hub]" FORMULA "0.021194781*X" FORMULA_INV "47.181425*X" /end COMPU_METHOD
/begin COMPU_METHOD LINEAR______0_000000__0H___1023_ "" FORM "%4.0" "[Nm]" FORMULA "1.0*X" FORMULA_INV "1.0*X" /end COMPU_METHOD
/begin COMPU_METHOD MTC_NORM_16_RES51 "" FORM "%7.3" "[°DK]" FORMULA "0.0018310547*X" FORMULA_INV "546.13333*X" /end COMPU_METHOD
/begin COMPU_METHOD LINEAR_______33_000000__0H___990 "" FORM "%5.1" "[°C]" FORMULA "4.0117647*X-33.0" FORMULA_INV "0.24926686*X+8.2258065" /end COMPU_METHOD
/begin COMPU_METHOD LINEAR______1_000000__100H___5_0 "" FORM "%3.2" "[-]" FORMULA "0.00390625*X" FORMULA_INV "256.0*X" /end COMPU_METHOD
/begin COMPU_METHOD LINEAR______0_000000__0H___0_965 "" FORM "%5.3" "[-]" FORMULA "0.00390625*X" FORMULA_INV "256.0*X" /end COMPU_METHOD
/begin COMPU_METHOD LINEAR______0_000000__0H___1_275 "" FORM "%5.3" "[V]" FORMULA "0.005*X" FORMULA_INV "200.0*X" /end COMPU_METHOD
/begin COMPU_METHOD MTC_NORM_16_RES68 "" FORM "%6.3" "[°DK]" FORMULA "0.0018310547*X" FORMULA_INV "546.13333*X" /end COMPU_METHOD
/begin COMPU_METHOD TALLFS "" FORM "%7.3" "[%]" FORMULA "0.0061035142*X" FORMULA_INV "163.84004*X" /end COMPU_METHOD
/begin COMPU_METHOD IS_13_RES78 "" FORM "%4.0" "[1/min]" FORMULA "1.0*X" FORMULA_INV "1.0*X" /end COMPU_METHOD
/begin COMPU_METHOD LINEAR______0_000000__0H___25580 "" FORM "%3.0" "[%]" FORMULA "0.015203911*X" FORMULA_INV "65.772549*X" /end COMPU_METHOD
/begin COMPU_METHOD LINEAR______0_000000__0H___1275_ "" FORM "%4.0" "[ms]" FORMULA "5.0*X" FORMULA_INV "0.2*X" /end COMPU_METHOD
/begin COMPU_METHOD LINEAR______0_000000__0H___26_82 "" FORM "%3.1" "[V]" FORMULA "0.10196078*X" FORMULA_INV "9.8076923*X" /end COMPU_METHOD
/begin COMPU_METHOD LINEAR______0_000000__0H___10088 "" FORM "%5.1" "[%]" FORMULA "0.39215686*X" FORMULA_INV "2.55*X" /end COMPU_METHOD
/begin COMPU_METHOD LINEAR_______48_000000__0H___189 "" FORM "%3.0" "[°C]" FORMULA "0.75*X-48.0" FORMULA_INV "1.3333333*X+64.0" /end COMPU_METHOD
/begin COMPU_METHOD LINEAR_______256_000000__0___254 "" FORM "%3.0" "[1/min]" FORMULA "2.0*X-256.0" FORMULA_INV "0.5*X+128.0" /end COMPU_METHOD
/begin COMPU_METHOD LINEAR_______48_000000__0H___100 "" FORM "%5.2" "[°C]" FORMULA "0.75*X-48.0" FORMULA_INV "1.3333333*X+64.0" /end COMPU_METHOD
/begin COMPU_METHOD LINEAR______0_000000__0H___800_0 "" FORM "%6.2" "[%]" FORMULA "0.024414063*X" FORMULA_INV "40.96*X" /end COMPU_METHOD
/begin COMPU_METHOD LINEAR______0_000000__0H___6553_ "" FORM "%6.1" "[s]" FORMULA "0.1*X" FORMULA_INV "10.0*X" /end COMPU_METHOD
/begin COMPU_METHOD MAF_KGH_16_RES117 "" FORM "%6.1" "[kg/h]" FORMULA "0.25*X" FORMULA_INV "4.0*X" /end COMPU_METHOD
/begin COMPU_METHOD LINEAR______0_000000__0H___25119 "" FORM "%5.0" "[ms]" FORMULA "10.0*X" FORMULA_INV "0.1*X" /end COMPU_METHOD
/begin COMPU_METHOD LINEAR_______23_625000__0H___126 "" FORM "%5.1" "[°KW]" FORMULA "0.375*X-23.625" FORMULA_INV "2.6666667*X+63.0" /end COMPU_METHOD
/begin COMPU_METHOD LINEAR_______48_000000__0H___134 "" FORM "%6.2" "[°KW]" FORMULA "0.375*X-48.0" FORMULA_INV "2.6666667*X+128.0" /end COMPU_METHOD
/begin COMPU_METHOD LINEAR______0_000000__0H___25142 "" FORM "%3.0" "[-]" FORMULA "1.0*X" FORMULA_INV "1.0*X" /end COMPU_METHOD
/begin COMPU_METHOD LINEAR______0_000000__0H___655_3 "" FORM "%6.2" "[s]" FORMULA "0.0099999996*X" FORMULA_INV "100.0*X" /end COMPU_METHOD
/begin COMPU_METHOD LINEAR_______33_000000__0H___144 "" FORM "%5.1" "[°C]" FORMULA "0.015609979*X-33.0" FORMULA_INV "64.061584*X+2114.0323" /end COMPU_METHOD
/begin COMPU_METHOD LINEAR______0_000000__0H___16320 "" FORM "%5.0" "[min-1/ km/h]" FORMULA "2.0*X" FORMULA_INV "0.5*X" /end COMPU_METHOD
/begin COMPU_METHOD LINEAR_______48_000000__0H___150 "" FORM "%4.0" "[°C]" FORMULA "0.79607843*X-48.0" FORMULA_INV "1.2561576*X+60.295567" /end COMPU_METHOD
/begin COMPU_METHOD LINEAR______0_000000__0H___1_155 "" FORM "%5.3" "[-]" FORMULA "0.0078278431*X" FORMULA_INV "127.74911*X" /end COMPU_METHOD
/begin COMPU_METHOD LINEAR_______5434_259766__FFFF80 "" FORM "%6.1" "[hPa/480°KW]" FORMULA "0.16584171*X+0.041460356" FORMULA_INV "6.0298461*X-0.24999957" /end COMPU_METHOD
/begin COMPU_METHOD LINEAR______0_000000__0H___65163 "" FORM "%5.0" "[-]" FORMULA "1.0*X" FORMULA_INV "1.0*X" /end COMPU_METHOD
/begin COMPU_METHOD LINEAR______0_000000__0H___0_998 "" FORM "%5.3" "[-]" FORMULA "0.0039152941*X" FORMULA_INV "255.40865*X" /end COMPU_METHOD
/begin COMPU_METHOD LINEAR_______48_000000__0H___170 "" FORM "%6.2" "[°KW]" FORMULA "0.375*X-48.0" FORMULA_INV "2.6666667*X+128.0" /end COMPU_METHOD
/begin COMPU_METHOD LINEAR______0_000000__0H___42949 "" FORM "%11.0" "[-]" FORMULA "65537.0*X" FORMULA_INV "1.5258556e-005*X" /end COMPU_METHOD
/begin COMPU_METHOD LINEAR______0_000000__0H___25182 "" FORM "%4.0" "[-]" FORMULA "1.0*X" FORMULA_INV "1.0*X" /end COMPU_METHOD
/begin COMPU_METHOD LINEAR______0_000000__0H___25188 "" FORM "%3.0" "[Zyklen]" FORMULA "1.0*X" FORMULA_INV "1.0*X" /end COMPU_METHOD
/begin COMPU_METHOD MTC_IN_DK_16_RES "" FORM "%6.2" "[°DK]" FORMULA "0.0036621094*X" FORMULA_INV "273.06667*X" /end COMPU_METHOD
/begin COMPU_METHOD LINEAR______0_000000__0H___0_203 "" FORM "%4.2" "[-]" FORMULA "0.0039058823*X" FORMULA_INV "256.0241*X" /end COMPU_METHOD
/begin COMPU_METHOD LINEAR______0_000000__0H___76791 "" FORM "%6.0" "[°DK/sec]" FORMULA "11.717647*X" FORMULA_INV "0.085341365*X" /end COMPU_METHOD
/begin COMPU_METHOD LM_INT_SA_RANGE731 "" FORM "%5.0" "[g]" FORMULA "0.027777829*X" FORMULA_INV "35.999934*X" /end COMPU_METHOD
/begin COMPU_METHOD LM_INT_SA_RANGE733 "" FORM "%7.2" "[g]" FORMULA "0.027777829*X" FORMULA_INV "35.999934*X" /end COMPU_METHOD
/begin COMPU_METHOD LINEAR______0_000000__0H___25735 "" FORM "%4.1" "[s]" FORMULA "0.1*X" FORMULA_INV "10.0*X" /end COMPU_METHOD
/begin COMPU_METHOD LINEAR_______640_020000__FFFF800 "" FORM "%7.2" "[ms]" FORMULA "0.019531548*X-0.010234226" FORMULA_INV "51.199219*X+0.52398437" /end COMPU_METHOD
/begin COMPU_METHOD LINEAR______0_000000__0H___51740 "" FORM "%4.0" "[ms]" FORMULA "20.0*X" FORMULA_INV "0.05*X" /end COMPU_METHOD
/begin COMPU_METHOD LINEAR______0_000000__0H___25741 "" FORM "%7.3" "[-]" FORMULA "0.0039062486*X" FORMULA_INV "256.00009*X" /end COMPU_METHOD
/begin COMPU_METHOD LINEAR______0_000000__0H___25764 "" FORM "%4.0" "[* 20ms]" FORMULA "1.0*X" FORMULA_INV "1.0*X" /end COMPU_METHOD
/begin COMPU_METHOD LINEAR______0_000000__0H___65769 "" FORM "%6.0" "[* 20ms]" FORMULA "1.0*X" FORMULA_INV "1.0*X" /end COMPU_METHOD
/begin COMPU_METHOD LINEAR______0_000000__0H___81793 "" FORM "%4.0" "[U/min]" FORMULA "1.0*X" FORMULA_INV "1.0*X" /end COMPU_METHOD
/begin COMPU_METHOD LINEAR______0_000000__0H___54805 "" FORM "%6.1" "[hPa]" FORMULA "0.082921489*X" FORMULA_INV "12.0596*X" /end COMPU_METHOD
/begin COMPU_METHOD LINEAR______0_000000__0H___25808 "" FORM "%7.3" "[Ohm]" FORMULA "0.0039062486*X" FORMULA_INV "256.00009*X" /end COMPU_METHOD
/begin COMPU_METHOD LINEAR______0_000000__0H___65829 "" FORM "%5.0" "[s]" FORMULA "1.0*X" FORMULA_INV "1.0*X" /end COMPU_METHOD
/begin COMPU_METHOD LINEAR______0_000000__0H___65837 "" FORM "%4.0" "[s]" FORMULA "0.1*X" FORMULA_INV "10.0*X" /end COMPU_METHOD
/begin COMPU_METHOD LINEAR_______50_000000__FFFFFF80 "" FORM "%5.1" "[%]" FORMULA "0.39062745*X+0.00031403169" FORMULA_INV "2.5599839*X-0.00080391607" /end COMPU_METHOD
/begin COMPU_METHOD LINEAR______0_000000__0H___65842 "" FORM "%5.2" "[s]" FORMULA "0.0099999996*X" FORMULA_INV "100.0*X" /end COMPU_METHOD
/begin COMPU_METHOD LINEAR______0_000000__0H___99852 "" FORM "%5.2" "[%]" FORMULA "0.024414063*X" FORMULA_INV "40.959998*X" /end COMPU_METHOD
/begin COMPU_METHOD LINEAR_______128_000000__FFFF870 "" FORM "%4.0" "[°C]" FORMULA "1.0*X" FORMULA_INV "1.0*X" /end COMPU_METHOD
/begin COMPU_METHOD LINEAR______0_000000__0H___1_873 "" FORM "%4.2" "[V]" FORMULA "0.005*X" FORMULA_INV "200.0*X" /end COMPU_METHOD
/begin COMPU_METHOD V_2co_SGN_16_RES "" FORM "%7.2" "[km/h]" FORMULA "0.0078124999*X-3.7500572e-006" FORMULA_INV "128.0*X+0.00048000733" /end COMPU_METHOD
/begin COMPU_METHOD LINEAR_______48_000000__0H___887 "" FORM "%4.1" "[°KW]" FORMULA "0.375*X-48.0" FORMULA_INV "2.6666667*X+128.0" /end COMPU_METHOD
/begin COMPU_METHOD RANGE________aktiv___1H__1H__895 "" TAB_VERB "%8.4" "[-]" COMPU_TAB_REF RANGE________aktiv___1H__1H__895 /end COMPU_METHOD
/begin COMPU_METHOD RANGE________JA___1H__1H____NEIN "" TAB_VERB "%8.4" "[-]" COMPU_TAB_REF RANGE________JA___1H__1H____NEIN /end COMPU_METHOD
/begin COMPU_METHOD RANGE________aktiv___1H__1H_____ "" TAB_VERB "%8.4" "[-]" COMPU_TAB_REF RANGE________aktiv___1H__1H_____ /end COMPU_METHOD
/begin COMPU_METHOD RANGE________JA___1H__1H____N897 "" TAB_VERB "%8.4" "" COMPU_TAB_REF RANGE________JA___1H__1H____N897 /end COMPU_METHOD
/begin COMPU_METHOD RANGE________0___0H__0H____1___1 "" TAB_VERB "%8.4" "[-]" COMPU_TAB_REF RANGE________0___0H__0H____1___1 /end COMPU_METHOD
/begin COMPU_METHOD RANGE________JA___1H__1H____N902 "" TAB_VERB "%8.4" "[-]" COMPU_TAB_REF RANGE________JA___1H__1H____N902 /end COMPU_METHOD
/begin COMPU_METHOD LINEAR______0_000000__0H___65904 "" FORM "%8.4" "[Hex]" FORMULA "1.0*X" FORMULA_INV "1.0*X" /end COMPU_METHOD
/begin COMPU_METHOD LINEAR______0_000000__0H___25905 "" FORM "%8.4" "[Hex]" FORMULA "1.0*X" FORMULA_INV "1.0*X" /end COMPU_METHOD
/begin COMPU_METHOD FGR_RANGE "" TAB_VERB "%8.4" "[-]" COMPU_TAB_REF FGR_RANGE_TAB_NAME /end COMPU_METHOD
/begin COMPU_METHOD TI_BAS_16_RES910 "" FORM "%4.1" "[ms]" FORMULA "0.004*X" FORMULA_INV "250.0*X" /end COMPU_METHOD
/begin COMPU_METHOD LINEAR______0_000000__0H___26911 "" FORM "%5.1" "[ms]" FORMULA "0.004000061*X" FORMULA_INV "249.99619*X" /end COMPU_METHOD
/begin COMPU_METHOD RANGE________aktiv___1H__1H__913 "" TAB_VERB "%8.4" "" COMPU_TAB_REF RANGE________aktiv___1H__1H__913 /end COMPU_METHOD
/begin COMPU_METHOD LINEAR______0_000000__0H___6400_ "" FORM "%7.2" "[%]" FORMULA "0.097751711*X" FORMULA_INV "10.23*X" /end COMPU_METHOD
/begin COMPU_METHOD LINEAR______0_000000__0H___26921 "" FORM "%4.3" "[ms]" FORMULA "0.004000061*X" FORMULA_INV "249.99619*X" /end COMPU_METHOD
/begin COMPU_METHOD LINEAR______0_000000__0H___65929 "" FORM "%8.4" "" FORMULA "1.0*X" FORMULA_INV "1.0*X" /end COMPU_METHOD
/begin COMPU_METHOD RANGE________aktiv___1H__1H__932 "" TAB_VERB "%8.4" "" COMPU_TAB_REF RANGE________aktiv___1H__1H__932 /end COMPU_METHOD
/begin COMPU_METHOD LINEAR_______1024_000000__FFFFFC "" FORM "%5.0" "[Nm]" FORMULA "1.0*X" FORMULA_INV "1.0*X" /end COMPU_METHOD
/begin COMPU_METHOD LINEAR______0_000000__0H___16941 "" FORM "%6.3" "[-]" FORMULA "0.00024414435*X" FORMULA_INV "4095.9375*X" /end COMPU_METHOD
/begin COMPU_METHOD RANGE________aktiv___1H__1H__944 "" TAB_VERB "%8.4" "[-]" COMPU_TAB_REF RANGE________aktiv___1H__1H__944 /end COMPU_METHOD
/begin COMPU_METHOD RANGE________EIN___1H__1H____AUS "" TAB_VERB "%8.4" "" COMPU_TAB_REF RANGE________EIN___1H__1H____AUS /end COMPU_METHOD
/begin COMPU_METHOD LINEAR_______50_000000__0H___947 "" FORM "%5.1" "[%]" FORMULA "0.0015258793*X-50.0" FORMULA_INV "655.35983*X+32767.991" /end COMPU_METHOD
/begin COMPU_METHOD RANGE________JA___1H__1H____N948 "" TAB_VERB "%8.4" "" COMPU_TAB_REF RANGE________JA___1H__1H____N948 /end COMPU_METHOD
/begin COMPU_METHOD RANGE________fett___1H__1H____ma "" TAB_VERB "%8.4" "" COMPU_TAB_REF RANGE________fett___1H__1H____ma /end COMPU_METHOD
/begin COMPU_METHOD LINEAR______0_000000__0H___5_120 "" FORM "%2.1" "[* 20ms]" FORMULA "0.020078431*X" FORMULA_INV "49.804688*X" /end COMPU_METHOD
/begin COMPU_METHOD LINEAR______0_000000__0H___76953 "" FORM "%6.1" "[°DK/sec]" FORMULA "11.717647*X" FORMULA_INV "0.085341365*X" /end COMPU_METHOD
/begin COMPU_METHOD LINEAR______0_000000__0H___1_955 "" FORM "%5.4" "[s]" FORMULA "7.8123665e-005*X" FORMULA_INV "12800.219*X" /end COMPU_METHOD
/begin COMPU_METHOD LINEAR_______50_000000__0H___956 "" FORM "%5.1" "[%]" FORMULA "0.39062353*X-50.0" FORMULA_INV "2.5600096*X+128.00048" /end COMPU_METHOD
/begin COMPU_METHOD LINEAR_______50_000000__0H___957 "" FORM "%4.1" "[%]" FORMULA "0.39062353*X-50.0" FORMULA_INV "2.5600096*X+128.00048" /end COMPU_METHOD
/begin COMPU_METHOD LINEAR______0_000000__0H___1_989 "" FORM "%5.3" "[-]" FORMULA "0.0039*X" FORMULA_INV "256.41026*X" /end COMPU_METHOD
/begin COMPU_METHOD LINEAR______0_000000__0H___25958 "" FORM "%8.4" "[-]" FORMULA "1.0*X" FORMULA_INV "1.0*X" /end COMPU_METHOD
/begin COMPU_METHOD LINEAR______0_000000__0H___25959 "" FORM "%6.3" "[-]" FORMULA "0.0039062486*X" FORMULA_INV "256.00009*X" /end COMPU_METHOD
/begin COMPU_METHOD LINEAR______0_000000__0H___13960 "" FORM "%6.1" "[s]" FORMULA "0.019999999*X" FORMULA_INV "50.000002*X" /end COMPU_METHOD
/begin COMPU_METHOD LINEAR_______1280_000000__FFFFC0 "" FORM "%7.2" "[ms]" FORMULA "0.078124332*X-0.010937834" FORMULA_INV "12.800109*X+0.14000547" /end COMPU_METHOD
/begin COMPU_METHOD LINEAR______0_000000__0H___5_119 "" FORM "%6.4" "[s]" FORMULA "7.8120089e-005*X" FORMULA_INV "12800.805*X" /end COMPU_METHOD
/begin COMPU_METHOD TI_SGN_16_RES "" FORM "%6.2" "[ms]" FORMULA "0.004*X-131.072" FORMULA_INV "250.0*X+32768.0" /end COMPU_METHOD
/begin COMPU_METHOD TI_2co_SGN_16_RES "" FORM "%6.2" "[ms]" FORMULA "0.004*X" FORMULA_INV "250.0*X" /end COMPU_METHOD
/begin COMPU_METHOD LINEAR_______50_000000__FFFF8961 "" FORM "%5.1" "[%]" FORMULA "0.0015258793*X+1.3349657e-005" FORMULA_INV "655.35983*X-0.0087488288" /end COMPU_METHOD
/begin COMPU_METHOD LINEAR______0_000000__0H___15962 "" FORM "%6.3" "[-]" FORMULA "0.00024414054*X" FORMULA_INV "4096.0015*X" /end COMPU_METHOD
/begin COMPU_METHOD LINEAR_______100_00000__0H___100 "" FORM "%4.1" "[%]" FORMULA "0.024414063*X-100.0" FORMULA_INV "40.96*X+4096.0" /end COMPU_METHOD
/begin COMPU_METHOD LINEAR______0_000000__0H___26963 "" FORM "%4.1" "[ms]" FORMULA "0.004000061*X" FORMULA_INV "249.99619*X" /end COMPU_METHOD
/begin COMPU_METHOD LINEAR______0_000000__0H___10964 "" FORM "%5.0" "[°C]" FORMULA "1.0*X" FORMULA_INV "1.0*X" /end COMPU_METHOD
/begin COMPU_METHOD LINEAR_______0_637500__0H___0965 "" FORM "%5.3" "[V]" FORMULA "0.005*X-0.6375" FORMULA_INV "200.0*X+127.5" /end COMPU_METHOD
/begin COMPU_METHOD LINEAR______0_000000__0H___13966 "" FORM "%8.3" "[s]" FORMULA "0.019999999*X" FORMULA_INV "50.000002*X" /end COMPU_METHOD
/begin COMPU_METHOD UNSIGNED_LONG967 "" FORM "%11.0" "[-]" FORMULA "1.0*X" FORMULA_INV "1.0*X" /end COMPU_METHOD
/begin COMPU_METHOD LINEAR______0_000000__0H___509_0 "" FORM "%7.3" "[-]" FORMULA "0.0077669261*X" FORMULA_INV "128.75106*X" /end COMPU_METHOD
/begin COMPU_METHOD LINEAR______0_000000__0H___65968 "" FORM "%6.0" "[* 10ms]" FORMULA "1.0*X" FORMULA_INV "1.0*X" /end COMPU_METHOD
/begin COMPU_METHOD LINEAR______0_000000__0H___13969 "" FORM "%7.3" "[s]" FORMULA "0.019999999*X" FORMULA_INV "50.000002*X" /end COMPU_METHOD
/begin COMPU_METHOD LINEAR______0_000000__0H___25970 "" FORM "%6.2" "[-]" FORMULA "0.0039062486*X" FORMULA_INV "256.00009*X" /end COMPU_METHOD
/begin COMPU_METHOD LINEAR______0_000000__0H___65971 "" FORM "%5.0" "[* 10ms]" FORMULA "1.0*X" FORMULA_INV "1.0*X" /end COMPU_METHOD
/begin COMPU_METHOD RANGE________aktiv___1H__1H__972 "" TAB_VERB "%8.4" "" COMPU_TAB_REF RANGE________aktiv___1H__1H__972 /end COMPU_METHOD
/begin COMPU_METHOD RANGE________aktiv___1H__1H__973 "" TAB_VERB "%8.4" "" COMPU_TAB_REF RANGE________aktiv___1H__1H__973 /end COMPU_METHOD
/begin COMPU_METHOD LINEAR______0_000000__0H___4_995 "" FORM "%7.5" "[A]" FORMULA "0.0076145072*X" FORMULA_INV "131.32826*X" /end COMPU_METHOD
/begin COMPU_METHOD LINEAR______0_000000__0H___99974 "" FORM "%3.0" "[%]" FORMULA "0.39062745*X" FORMULA_INV "2.5599839*X" /end COMPU_METHOD
/begin COMPU_METHOD LSH_CONV "" TAB_VERB "%8.4" "[-]" COMPU_TAB_REF LSH_CONV_TAB_NAME /end COMPU_METHOD
/begin COMPU_METHOD LINEAR_______32768_000000__FF975 "" FORM "%6.0" "[us]" FORMULA "1.0*X" FORMULA_INV "1.0*X" /end COMPU_METHOD
/begin COMPU_METHOD LINEAR_______7_812500__FFFF8040H "" FORM "%5.2" "[%.]" FORMULA "0.00023888515*X" FORMULA_INV "4186.112*X" /end COMPU_METHOD
/begin COMPU_METHOD LINEAR_______8_000000__FFFF8000H "" FORM "%5.2" "[-]" FORMULA "0.0002441413*X+2.2070649e-005" FORMULA_INV "4095.9887*X-0.09040113" /end COMPU_METHOD
/begin COMPU_METHOD LINEAR______0_000000__0H___1_976 "" FORM "%8.4" "[Hex]" FORMULA "1.0*X" FORMULA_INV "1.0*X" /end COMPU_METHOD
/begin COMPU_METHOD LINEAR______0_000000__0H___65977 "" FORM "%5.1" "[-]" FORMULA "0.0099999996*X" FORMULA_INV "100.0*X" /end COMPU_METHOD
/begin COMPU_METHOD RANGE________0___0H__0H____1_978 "" TAB_VERB "%8.4" "" COMPU_TAB_REF RANGE________0___0H__0H____1_978 /end COMPU_METHOD
/begin COMPU_METHOD RANGE________AUS___0H__0H____EIN "" TAB_VERB "%8.4" "" COMPU_TAB_REF RANGE________AUS___0H__0H____EIN /end COMPU_METHOD
/begin COMPU_METHOD RANGE________OFFEN___0H__0H____G "" TAB_VERB "%8.4" "" COMPU_TAB_REF RANGE________OFFEN___0H__0H____G /end COMPU_METHOD
/begin COMPU_METHOD RANGE________0___0H__0H____1_979 "" TAB_VERB "%8.4" "[-]" COMPU_TAB_REF RANGE________0___0H__0H____1_979 /end COMPU_METHOD
/begin COMPU_METHOD RANGE____________0H__0H_____Verm "" TAB_VERB "%8.4" "" COMPU_TAB_REF RANGE____________0H__0H_____Verm /end COMPU_METHOD
/begin COMPU_METHOD RANGE____________0H__0H____Verm_ "" TAB_VERB "%8.4" "" COMPU_TAB_REF RANGE____________0H__0H____Verm_ /end COMPU_METHOD
/begin COMPU_METHOD LINEAR_______1024_000000__FFF980 "" FORM "%4.0" "[Nm]" FORMULA "1.0*X" FORMULA_INV "1.0*X" /end COMPU_METHOD
/begin COMPU_METHOD LINEAR______0_000000__0H___10981 "" FORM "%4.1" "[%]" FORMULA "0.39215686*X" FORMULA_INV "2.55*X" /end COMPU_METHOD
/begin COMPU_METHOD RANGE____________0H__0H____1___1 "" TAB_VERB "%8.4" "" COMPU_TAB_REF RANGE____________0H__0H____1___1 /end COMPU_METHOD
/begin COMPU_METHOD MTC_IN_DK_16_RES982 "" FORM "%7.3" "[°DK]" FORMULA "0.0036621094*X" FORMULA_INV "273.06667*X" /end COMPU_METHOD
/begin COMPU_METHOD LINEAR______0_000000__0H___12_95 "" FORM "%5.2" "[V]" FORMULA "0.00019798801*X" FORMULA_INV "5050.8108*X" /end COMPU_METHOD
/begin COMPU_METHOD LINEAR______0_000000__0H___10983 "" FORM "%4.0" "[%]" FORMULA "0.39215686*X" FORMULA_INV "2.55*X" /end COMPU_METHOD
/begin COMPU_METHOD RANGE________MSR___1H__1H_______ "" TAB_VERB "%8.4" "" COMPU_TAB_REF RANGE________MSR___1H__1H_______ /end COMPU_METHOD
/begin COMPU_METHOD MDK_STATUS "" TAB_VERB "%8.4" "" COMPU_TAB_REF MDK_STATUS_TAB_NAME /end COMPU_METHOD
/begin COMPU_METHOD RANGE________N_BEG___1H__1H_____ "" TAB_VERB "%8.4" "[-]" COMPU_TAB_REF RANGE________N_BEG___1H__1H_____ /end COMPU_METHOD
/begin COMPU_METHOD RANGE________N___1H__1H________0 "" TAB_VERB "%8.4" "[-]" COMPU_TAB_REF RANGE________N___1H__1H________0 /end COMPU_METHOD
/begin COMPU_METHOD ES_2co_16_RES "" FORM "%6.0" "[1/min]" FORMULA "1.0*X" FORMULA_INV "1.0*X" /end COMPU_METHOD
/begin COMPU_METHOD ES_2co_16_RES984 "" FORM "%6.0" "[U/min]" FORMULA "1.0*X" FORMULA_INV "1.0*X" /end COMPU_METHOD
/begin COMPU_METHOD ES_8_RES985 "" FORM "%4.0" "[min-1]" FORMULA "32.0*X" FORMULA_INV "0.03125*X" /end COMPU_METHOD
/begin COMPU_METHOD RANGE________Normal___0H__0H____ "" TAB_VERB "%8.4" "" COMPU_TAB_REF RANGE________Normal___0H__0H____ /end COMPU_METHOD
/begin COMPU_METHOD LINEAR_______4096_000000__FFF986 "" FORM "%5.0" "[1/min/s]" FORMULA "32.0*X" FORMULA_INV "0.03125*X" /end COMPU_METHOD
/begin COMPU_METHOD LINEAR______0_000000__0H___81987 "" FORM "%8.3" "[1/min]" FORMULA "0.125*X" FORMULA_INV "8.0*X" /end COMPU_METHOD
/begin COMPU_METHOD RANGE________NS___1H__1H________ "" TAB_VERB "%8.4" "[-]" COMPU_TAB_REF RANGE________NS___1H__1H________ /end COMPU_METHOD
/begin COMPU_METHOD LINEAR_______8192_000000__FFFF80 "" FORM "%5.0" "[1/min]" FORMULA "0.25*X" FORMULA_INV "4.0*X" /end COMPU_METHOD
/begin COMPU_METHOD IS_13_RES988 "" FORM "%4.0" "[min-1]" FORMULA "1.0*X" FORMULA_INV "1.0*X" /end COMPU_METHOD
/begin COMPU_METHOD LINEAR_______95_625000__FFFFF989 "" FORM "%7.3" "[°KW/720°KW]" FORMULA "0.375*X" FORMULA_INV "2.6666667*X" /end COMPU_METHOD
/begin COMPU_METHOD LINEAR_______155_996700__FFFFH__ "" FORM "%5.1" "[°KW]" FORMULA "-0.0014648157*X-60.0" FORMULA_INV "-682.67972*X-40960.783" /end COMPU_METHOD
/begin COMPU_METHOD LINEAR______60_000000__0H___1990 "" FORM "%5.1" "[°KW]" FORMULA "0.0014648157*X+60.0" FORMULA_INV "682.67972*X-40960.783" /end COMPU_METHOD
/begin COMPU_METHOD NW_VERST_SP "" TAB_VERB "%8.4" "" COMPU_TAB_REF NW_VERST_SP_TAB_NAME /end COMPU_METHOD
/begin COMPU_METHOD NW_VERST_FR "" TAB_VERB "%8.4" "" COMPU_TAB_REF NW_VERST_FR_TAB_NAME /end COMPU_METHOD
/begin COMPU_METHOD LINEAR_______48_000000__0H___991 "" FORM "%6.2" "[°KW]" FORMULA "0.375*X-48.0" FORMULA_INV "2.6666667*X+128.0" /end COMPU_METHOD
/begin COMPU_METHOD LINEAR______0_000000__0H___1_993 "" FORM "%4.2" "[-]" FORMULA "0.0039215686*X" FORMULA_INV "255.0*X" /end COMPU_METHOD
/begin COMPU_METHOD LINEAR______0_000000__0H___1_994 "" FORM "%4.2" "[-]" FORMULA "3.0399023e-005*X" FORMULA_INV "32895.794*X" /end COMPU_METHOD
/begin COMPU_METHOD PVS_NORM_2co_16_RES "" FORM "%6.2" "[°DK]" FORMULA "0.001824979*X+0.00091248951" FORMULA_INV "547.95151*X-0.5" /end COMPU_METHOD
/begin COMPU_METHOD MTC_IN_DK_16_RES995 "" FORM "%6.3" "[°DK]" FORMULA "0.0036621094*X" FORMULA_INV "273.06667*X" /end COMPU_METHOD
/begin COMPU_METHOD MTC_PWM_2CO_16_RES "" FORM "%7.4" "[%]" FORMULA "0.0030517586*X+2.5879301e-005" FORMULA_INV "327.67992*X-0.0084801272" /end COMPU_METHOD
/begin COMPU_METHOD RANGE________AUF___0H__0H____ZU_ "" TAB_VERB "%8.4" "[-]" COMPU_TAB_REF RANGE________AUF___0H__0H____ZU_ /end COMPU_METHOD
/begin COMPU_METHOD RANGE________0___0H__0H____1_996 "" TAB_VERB "%8.4" "[]" COMPU_TAB_REF RANGE________0___0H__0H____1_996 /end COMPU_METHOD
/begin COMPU_METHOD S_WK_RANGE "" TAB_VERB "%8.4" "[-]" COMPU_TAB_REF S_WK_RANGE_TAB_NAME /end COMPU_METHOD
/begin COMPU_METHOD SA_DIAG_CND_RANGE "" TAB_VERB "%8.4" "[-]" COMPU_TAB_REF SA_DIAG_CND_RANGE_TAB_NAME /end COMPU_METHOD
/begin COMPU_METHOD RANGE________NEIN___0H__0H____JA "" TAB_VERB "%8.4" "[-]" COMPU_TAB_REF RANGE________NEIN___0H__0H____JA /end COMPU_METHOD
/begin COMPU_METHOD SAV_DIAG_CND_RANGE "" TAB_VERB "%8.4" "[-]" COMPU_TAB_REF SAV_DIAG_CND_RANGE_TAB_NAME /end COMPU_METHOD
/begin COMPU_METHOD LINEAR_______180_000000__0H__997 "" FORM "%4.0" "[°KW]" FORMULA "6.0*X-180.0" FORMULA_INV "0.16666667*X+30.0" /end COMPU_METHOD
/begin COMPU_METHOD STATE_MD_RANGE "" TAB_VERB "%8.4" "" COMPU_TAB_REF STATE_MD_RANGE_TAB_NAME /end COMPU_METHOD
/begin COMPU_METHOD STATE_EKP_CRASH_RANGE "" TAB_VERB "%8.4" "[-]" COMPU_TAB_REF STATE_EKP_CRASH_RANGE_TAB_NAME /end COMPU_METHOD
/begin COMPU_METHOD STATE_VARIANTEN "" TAB_VERB "%8.4" "[-]" COMPU_TAB_REF STATE_VARIANTEN_TAB_NAME /end COMPU_METHOD
/begin COMPU_METHOD STATE_IVVT "" TAB_VERB "%8.4" "" COMPU_TAB_REF STATE_IVVT_TAB_NAME /end COMPU_METHOD
/begin COMPU_METHOD LINEAR______0_000000__0H___8_998 "" FORM "%6.3" "[s]" FORMULA "0.000128*X" FORMULA_INV "7812.5*X" /end COMPU_METHOD
/begin COMPU_METHOD LINEAR______0_000000__0H___20999 "" FORM "%5.0" "[ms]" FORMULA "0.032*X" FORMULA_INV "31.25*X" /end COMPU_METHOD
/begin COMPU_METHOD LINEAR______0_000000__0H___21000 "" FORM "%4.2" "[s]" FORMULA "0.0099999998*X" FORMULA_INV "100.0*X" /end COMPU_METHOD
/begin COMPU_METHOD LINEAR______0_000000__0H___61001 "" FORM "%5.1" "[s]" FORMULA "0.1*X" FORMULA_INV "10.0*X" /end COMPU_METHOD
/begin COMPU_METHOD LINEAR______0_000000__0H___11002 "" FORM "%6.1" "[%]" FORMULA "0.39215686*X" FORMULA_INV "2.55*X" /end COMPU_METHOD
/begin COMPU_METHOD LINEAR_______50_000000__FFFF1003 "" FORM "%6.1" "[%]" FORMULA "0.0015197986*X-0.1992401" FORMULA_INV "657.98193*X+131.09639" /end COMPU_METHOD
/begin COMPU_METHOD LINEAR_______48_000000__0H___143 "" FORM "%5.1" "[°C]" FORMULA "0.75*X-48.0" FORMULA_INV "1.3333333*X+64.0" /end COMPU_METHOD
/begin COMPU_METHOD LINEAR_______256_000000__FFFF800 "" FORM "%6.2" "[km/h]" FORMULA "0.0078124987*X-4.3750668e-005" FORMULA_INV "128.00002*X+0.0056000864" /end COMPU_METHOD
/begin COMPU_METHOD TALLFS_NEG_POS_SI "" FORM "%8.3" "[%]" FORMULA "0.0061035142*X-4.8242924e-005" FORMULA_INV "163.84004*X+0.0079041225" /end COMPU_METHOD
/begin COMPU_METHOD LINEAR_______50_000004__FFFF1004 "" FORM "%5.1" "[%]" FORMULA "0.0015258792*X+5.7245986e-006" FORMULA_INV "655.35988*X-0.0037516722" /end COMPU_METHOD
/begin COMPU_METHOD LINEAR_______50_000000__FFFF1005 "" FORM "%5.2" "[%]" FORMULA "0.0015258793*X+1.3349657e-005" FORMULA_INV "655.35983*X-0.0087488288" /end COMPU_METHOD
/begin COMPU_METHOD RANGE________TALLFS___1H__1H____ "" TAB_VERB "%8.4" "[-]" COMPU_TAB_REF RANGE________TALLFS___1H__1H____ /end COMPU_METHOD
/begin COMPU_METHOD LINEAR_______50_000000__FFFF1006 "" FORM "%6.2" "[%]" FORMULA "0.0015258793*X+1.3349657e-005" FORMULA_INV "655.35983*X-0.0087488288" /end COMPU_METHOD
/begin COMPU_METHOD LINEAR_______50_000004__FFFF1007 "" FORM "%3.1" "[%]" FORMULA "0.0015258792*X+5.7245986e-006" FORMULA_INV "655.35988*X-0.0037516722" /end COMPU_METHOD
/begin COMPU_METHOD RANGE________TALLFS_T_AD_LL___1H "" TAB_VERB "%8.4" "[-]" COMPU_TAB_REF RANGE________TALLFS_T_AD_LL___1H /end COMPU_METHOD
/begin COMPU_METHOD RANGE________SCHLIESSEN___0H__0H "" TAB_VERB "%8.4" "" COMPU_TAB_REF RANGE________SCHLIESSEN___0H__0H /end COMPU_METHOD
/begin COMPU_METHOD MTC_PWM_2CO_16_RES1008 "" FORM "%8.3" "[%]" FORMULA "0.0030517586*X+2.5879301e-005" FORMULA_INV "327.67992*X-0.0084801272" /end COMPU_METHOD
/begin COMPU_METHOD LINEAR______0_000000__0H___11009 "" FORM "%4.0" "[%PWM]" FORMULA "0.0015259022*X" FORMULA_INV "655.35*X" /end COMPU_METHOD
/begin COMPU_METHOD LINEAR______0_000000__0H___11010 "" FORM "%7.3" "[%PWM]" FORMULA "0.0015259022*X" FORMULA_INV "655.35*X" /end COMPU_METHOD
/begin COMPU_METHOD LINEAR______0_000000__0H___11011 "" FORM "%4.2" "[-]" FORMULA "3.0517585e-005*X" FORMULA_INV "32767.992*X" /end COMPU_METHOD
/begin COMPU_METHOD LINEAR______0_000000__0H___81012 "" FORM "%5.2" "[ms]" FORMULA "0.004*X" FORMULA_INV "250.0*X" /end COMPU_METHOD
/begin COMPU_METHOD TI_2co_SGN_16_RES1013 "" FORM "%7.2" "[ms]" FORMULA "0.004*X" FORMULA_INV "250.0*X" /end COMPU_METHOD
/begin COMPU_METHOD TI_BAS_16_RES1014 "" FORM "%6.3" "[ms]" FORMULA "0.004*X" FORMULA_INV "250.0*X" /end COMPU_METHOD
/begin COMPU_METHOD LINEAR______0_000000__0H___11015 "" FORM "%3.2" "[-]" FORMULA "0.00024414435*X" FORMULA_INV "4095.9375*X" /end COMPU_METHOD
/begin COMPU_METHOD LINEAR______0_000000__0H___21016 "" FORM "%5.1" "[-]" FORMULA "0.004000061*X" FORMULA_INV "249.99619*X" /end COMPU_METHOD
/begin COMPU_METHOD LINEAR_______48_000000__0H__1017 "" FORM "%5.1" "[°C]" FORMULA "0.0029296875*X-48.0" FORMULA_INV "341.33333*X+16384.0" /end COMPU_METHOD
/begin COMPU_METHOD LINEAR_______0_125000__FFFF8000H "" FORM "%6.3" "[-]" FORMULA "3.8146029e-006*X-3.0926986e-006" FORMULA_INV "262150.49*X+0.81075243" /end COMPU_METHOD
/begin COMPU_METHOD LINEAR______0_000000__0H___11018 "" FORM "%4.2" "[-]" FORMULA "1.5259022e-005*X" FORMULA_INV "65535.0*X" /end COMPU_METHOD
/begin COMPU_METHOD LINEAR______0_000000__0H___61019 "" FORM "%5.0" "[us]" FORMULA "1.0*X" FORMULA_INV "1.0*X" /end COMPU_METHOD
/begin COMPU_METHOD LINEAR_______0_006100__FFFF8000H "" FORM "%7.4" "[%PWM]" FORMULA "1.8616007e-007*X+9.3080034e-008" FORMULA_INV "5371721.3*X-0.5" /end COMPU_METHOD
/begin COMPU_METHOD LINEAR______0_000000__0H___21020 "" FORM "%3.1" "[V]" FORMULA "0.00039828431*X" FORMULA_INV "2510.7692*X" /end COMPU_METHOD
/begin COMPU_METHOD LINEAR______0_000000__0H___11021 "" FORM "%5.1" "[mA]" FORMULA "0.51372549*X" FORMULA_INV "1.9465649*X" /end COMPU_METHOD
/begin COMPU_METHOD LINEAR_______4096_000000__FFFF80 "" FORM "%6.0" "[km/h]" FORMULA "0.125*X" FORMULA_INV "8.0*X" /end COMPU_METHOD
/begin COMPU_METHOD LINEAR______0_000000__0H___11022 "" FORM "%5.1" "[ms]" FORMULA "0.004*X" FORMULA_INV "250.0*X" /end COMPU_METHOD
/begin COMPU_METHOD LINEAR______0_000000__0H___51023 "" FORM "%6.2" "[km/h]" FORMULA "0.062506676*X" FORMULA_INV "15.998291*X" /end COMPU_METHOD
/begin COMPU_METHOD RANGE________VL___1H__1H________ "" TAB_VERB "%8.4" "[-]" COMPU_TAB_REF RANGE________VL___1H__1H________ /end COMPU_METHOD
/begin COMPU_METHOD LINEAR______0_000000__0H___150_7 "" FORM "%5.1" "[°KW]" FORMULA "0.37489998*X" FORMULA_INV "2.6673781*X" /end COMPU_METHOD
/begin COMPU_METHOD RANGE________WE___1H__1H________ "" TAB_VERB "%8.4" "[-]" COMPU_TAB_REF RANGE________WE___1H__1H________ /end COMPU_METHOD
/begin COMPU_METHOD LINEAR______0_000000__0H___7680_ "" FORM "%6.2" "[°DK]" FORMULA "0.11718929*X" FORMULA_INV "8.5332031*X" /end COMPU_METHOD
/begin COMPU_METHOD LINEAR______0_000000__0H___21024 "" FORM "%3.0" "[%.]" FORMULA "0.015203911*X" FORMULA_INV "65.772549*X" /end COMPU_METHOD
/begin COMPU_METHOD RANGE________WL___1H__1H________ "" TAB_VERB "%8.4" "[-]" COMPU_TAB_REF RANGE________WL___1H__1H________ /end COMPU_METHOD
/begin COMPU_METHOD DRUCKLOS_RANGE "" TAB_VERB "%8.4" "" COMPU_TAB_REF DRUCKLOS_RANGE_TAB_NAME /end COMPU_METHOD
/begin COMPU_METHOD RANGE_____00000017 "" TAB_VERB "%8.4" "[-]" COMPU_TAB_REF RANGE_____00000017_TAB_NAME /end COMPU_METHOD
/begin COMPU_METHOD LINEAR______0_000000__0H___91025 "" FORM "%4.1" "[°KW]" FORMULA "0.375*X" FORMULA_INV "2.6666667*X" /end COMPU_METHOD
/begin COMPU_METHOD LINEAR_______48_000000__FFFF1026 "" FORM "%6.2" "[°KW]" FORMULA "0.375*X" FORMULA_INV "2.6666667*X" /end COMPU_METHOD
/begin COMPU_METHOD LINEAR______0_000000__0H___01027 "" FORM "%8.5" "[-]" FORMULA "1.5258789e-005*X" FORMULA_INV "65536.0*X" /end COMPU_METHOD
/begin COMPU_METHOD LINEAR_______48_000000__0H__1028 "" FORM "%6.2" "[°KW]" FORMULA "0.0014648438*X-48.0" FORMULA_INV "682.66667*X+32768.0" /end COMPU_METHOD
/begin COMPU_METHOD LINEAR______0_000000__0H___21029 "" FORM "%4.1" "[* 120°KW]" FORMULA "1.0*X" FORMULA_INV "1.0*X" /end COMPU_METHOD
/begin COMPU_METHOD RANGE________ZYKA_LL___1H__1H___ "" TAB_VERB "%8.4" "[-]" COMPU_TAB_REF RANGE________ZYKA_LL___1H__1H___ /end COMPU_METHOD
/begin COMPU_METHOD LINEAR______0_000000__0H___61030 "" FORM "%5.0" "[* 120°KW]" FORMULA "1.0*X" FORMULA_INV "1.0*X" /end COMPU_METHOD
/begin COMPU_METHOD ZYL_ID "" FORM "%2.0" "[-]" FORMULA "1.0*X+1.0" FORMULA_INV "1.0*X-1.0" /end COMPU_METHOD
/begin COMPU_METHOD LINEAR______0_000000__0H___61031 "" FORM "%5.0" "[10ms]" FORMULA "1.0*X" FORMULA_INV "1.0*X" /end COMPU_METHOD
/begin COMPU_VTAB RANGE________aktiv___1H__1H__895 "" TAB_VERB 2 0x0 "passiv" 0x1 "aktiv" /end COMPU_VTAB
/begin COMPU_VTAB RANGE________JA___1H__1H____NEIN "" TAB_VERB 2 0x0 "NEIN" 0x1 "JA" /end COMPU_VTAB
/begin COMPU_VTAB RANGE________aktiv___1H__1H_____ "" TAB_VERB 2 0x0 " passiv" 0x1 "aktiv" /end COMPU_VTAB
/begin COMPU_VTAB RANGE________JA___1H__1H____N897 "" TAB_VERB 2 0x0 "NEIN" 0x1 "JA" /end COMPU_VTAB
/begin COMPU_VTAB RANGE________0___0H__0H____1___1 "" TAB_VERB 2 0x0 "0" 0x1 "1" /end COMPU_VTAB
/begin COMPU_VTAB RANGE________JA___1H__1H____N902 "" TAB_VERB 2 0x0 "NEIN" 0x1 "JA" /end COMPU_VTAB
/begin COMPU_VTAB FGR_RANGE_TAB_NAME "" TAB_VERB 9 0x0 "HART AUS" 0x1 "AUS" 0x2 "TIP UP" 0x3 "TIP DOWN" 0x4 "BESCHL" 0x5 "WA" 0x6 "VERZ" 0x7 "RUHE" 0x8 "" /end COMPU_VTAB
/begin COMPU_VTAB RANGE________aktiv___1H__1H__913 "" TAB_VERB 2 0x0 " passiv" 0x1 "aktiv" /end COMPU_VTAB
/begin COMPU_VTAB RANGE________aktiv___1H__1H__932 "" TAB_VERB 2 0x0 "passiv" 0x1 "aktiv" /end COMPU_VTAB
/begin COMPU_VTAB RANGE________aktiv___1H__1H__944 "" TAB_VERB 2 0x0 " passiv" 0x1 "aktiv" /end COMPU_VTAB
/begin COMPU_VTAB RANGE________EIN___1H__1H____AUS "" TAB_VERB 2 0x0 "AUS" 0x1 "EIN" /end COMPU_VTAB
/begin COMPU_VTAB RANGE________JA___1H__1H____N948 "" TAB_VERB 2 0x0 "NEIN" 0x1 "JA" /end COMPU_VTAB
/begin COMPU_VTAB RANGE________fett___1H__1H____ma "" TAB_VERB 2 0x0 "mager" 0x1 "fett" /end COMPU_VTAB
/begin COMPU_VTAB RANGE________aktiv___1H__1H__972 "" TAB_VERB 2 0x0 "passiv" 0x1 "aktiv" /end COMPU_VTAB
/begin COMPU_VTAB RANGE________aktiv___1H__1H__973 "" TAB_VERB 2 0x0 " passiv" 0x1 "aktiv" /end COMPU_VTAB
/begin COMPU_VTAB LSH_CONV_TAB_NAME "" TAB_VERB 6 0x0 "LSH_START" 0x1 "LSH_PAS" 0x2 "LSH_HIGH" 0x3 "LSH_RED" 0x4 "LSH_MAX" 0x5 "LSH_NORM" /end COMPU_VTAB
/begin COMPU_VTAB RANGE________0___0H__0H____1_978 "" TAB_VERB 2 0x0 "0" 0x1 "1" /end COMPU_VTAB
/begin COMPU_VTAB RANGE________AUS___0H__0H____EIN "" TAB_VERB 2 0x0 "AUS" 0x1 "EIN" /end COMPU_VTAB
/begin COMPU_VTAB RANGE________OFFEN___0H__0H____G "" TAB_VERB 2 0x0 "OFFEN" 0x1 "GESCHLOSSEN" /end COMPU_VTAB
/begin COMPU_VTAB RANGE________0___0H__0H____1_979 "" TAB_VERB 2 0x0 "0" 0x1 "1" /end COMPU_VTAB
/begin COMPU_VTAB RANGE____________0H__0H_____Verm "" TAB_VERB 2 0x0 "" 0x1 " Verm. LB NKAT1" /end COMPU_VTAB
/begin COMPU_VTAB RANGE____________0H__0H____Verm_ "" TAB_VERB 2 0x0 "" 0x1 "Verm. LB NKAT2 " /end COMPU_VTAB
/begin COMPU_VTAB RANGE____________0H__0H____1___1 "" TAB_VERB 2 0x0 "-" 0x1 "1" /end COMPU_VTAB
/begin COMPU_VTAB RANGE________MSR___1H__1H_______ "" TAB_VERB 2 0x0 "" 0x1 "MSR" /end COMPU_VTAB
/begin COMPU_VTAB MDK_STATUS_TAB_NAME "" TAB_VERB 7 0x0 "PREDRIVE" 0x1 "STROMLOS" 0x2 "FREIRÜTTELN" 0x3 "ZUDRÜCKEN" 0x4 "OBERER_PWG" 0x5 "LAGEREGLER" 0x6 "ABGESCHALTET" /end COMPU_VTAB
/begin COMPU_VTAB RANGE________N_BEG___1H__1H_____ "" TAB_VERB 2 0x0 "" 0x1 "N_BEG" /end COMPU_VTAB
/begin COMPU_VTAB RANGE________N___1H__1H________0 "" TAB_VERB 2 0x0 "" 0x1 "N" /end COMPU_VTAB
/begin COMPU_VTAB RANGE________Normal___0H__0H____ "" TAB_VERB 2 0x0 "Normal" 0x1 "Diagnose" /end COMPU_VTAB
/begin COMPU_VTAB RANGE________NS___1H__1H________ "" TAB_VERB 2 0x0 "" 0x1 "NS" /end COMPU_VTAB
/begin COMPU_VTAB NW_VERST_SP_TAB_NAME "" TAB_VERB 4 0x0 "" 0x1 "   SP" 0x2 "FR" 0x4 "  H" /end COMPU_VTAB
/begin COMPU_VTAB NW_VERST_FR_TAB_NAME "" TAB_VERB 4 0x0 "" 0x1 "FR" 0x2 "   SP" 0x4 "  H" /end COMPU_VTAB
/begin COMPU_VTAB RANGE________AUF___0H__0H____ZU_ "" TAB_VERB 2 0x0 "AUF" 0x1 "ZU" /end COMPU_VTAB
/begin COMPU_VTAB RANGE________0___0H__0H____1_996 "" TAB_VERB 2 0x0 "0" 0x1 "1" /end COMPU_VTAB
/begin COMPU_VTAB S_WK_RANGE_TAB_NAME "" TAB_VERB 10 0x0 "WK ausgekuppelt" 0x1 "WK geregelt" 0x2 "WK geschlossen" 0x3 "nicht definiert" 0x4 "nicht definiert" 0x5 "nicht definiert" 0x6 "nicht definiert" 0x7 "nicht definiert" 0x8 "nicht definiert" 0x9 "nicht definiert" /end COMPU_VTAB
/begin COMPU_VTAB SA_DIAG_CND_RANGE_TAB_NAME "" TAB_VERB 16 0x0 "ACTIVE" 0x1 "SAWUP" 0x2 "T_WAIT" 0x3 "T_DIAG_SA" 0x4 "TCO" 0x5 "SAP" 0x6 "N_MAX" 0x7 "KF_N_MIN" 0x8 "KF_LM_KGH_MAX" 0x9 "KF_LM_MIN" 0xa "TI_ADD_WF_MAX" 0xb "TI_ADD_WF_MIN" 0xc "KF_LM_MAX" 0xd "ULS_BRE_VKAT" 0xe "ULS_BRE_NKAT" 0xf "UNDEFINED" /end COMPU_VTAB
/begin COMPU_VTAB RANGE________NEIN___0H__0H____JA "" TAB_VERB 2 0x0 "NEIN" 0x1 "JA" /end COMPU_VTAB
/begin COMPU_VTAB SAV_DIAG_CND_RANGE_TAB_NAME "" TAB_VERB 8 0x0 "ACTIVE" 0x1 "LL_TL" 0x2 "N_MAX" 0x3 "KF_LM_KGH_MAX" 0x4 "TI_ADD_WF_MAX" 0x5 "TI_ADD_WF_MIN" 0x6 "BEP_LL" 0x7 "TKW_TI_AD_MIN" /end COMPU_VTAB
/begin COMPU_VTAB STATE_MD_RANGE_TAB_NAME "" TAB_VERB 4 0x0 "Status OK" 0x1 "ZW-Rest" 0x2 "Füllungsrest" 0x3 "DME-Fehler" /end COMPU_VTAB
/begin COMPU_VTAB STATE_EKP_CRASH_RANGE_TAB_NAME "" TAB_VERB 3 0x0 "INAKTIV" 0x1 "ARMING" 0x2 "EKP-ABSCHALTUNG" /end COMPU_VTAB
/begin COMPU_VTAB STATE_VARIANTEN_TAB_NAME "" TAB_VERB 64 0x0 "............................................" 0x1 ".......................................EGS" 0x2 "............................KOMBI......." 0x3 "............................KOMBI.EGS" 0x4 ".....................ASC................." 0x5 ".....................ASC............EGS" 0x6 ".....................ASC.KOMBI......." 0x7 ".....................ASC.KOMBI.EGS" 0x8 "..............KAT........................" 0x9 "..............KAT...................EGS" 0xa "..............KAT........KOMBI......." 0xb "..............KAT........KOMBI.EGS" 0xc "..............KAT.ASC................." 0xd "..............KAT.ASC............EGS" 0xe "..............KAT.ASC.KOMBI......." 0xf "..............KAT.ASC.KOMBI.EGS" 0x10 ".......ACE..............................." 0x11 ".......ACE..........................EGS" 0x12 ".......ACE...............KOMBI......." 0x13 ".......ACE...............KOMBI.EGS" 0x14 ".......ACE........ASC................." 0x15 ".......ACE........ASC............EGS" 0x16 ".......ACE........ASC.KOMBI......." 0x17 ".......ACE........ASC.KOMBI.EGS" 0x18 ".......ACE.KAT........................" 0x19 ".......ACE.KAT...................EGS" 0x1a ".......ACE.KAT........KOMBI......." 0x1b ".......ACE.KAT........KOMBI.EGS" 0x1c ".......ACE.KAT.ASC................." 0x1d ".......ACE.KAT.ASC............EGS" 0x1e ".......ACE.KAT.ASC.KOMBI......." 0x1f ".......ACE.KAT.ASC.KOMBI.EGS" 0x20 "MFL......................................" 0x21 "MFL.................................EGS" 0x22 "MFL......................KOMBI......." 0x23 "MFL......................KOMBI.EGS" 0x24 "MFL...............ASC................." 0x25 "MFL...............ASC............EGS" 0x26 "MFL...............ASC.KOMBI......." 0x27 "MFL...............ASC.KOMBI.EGS" 0x28 "MFL........KAT........................" 0x29 "MFL........KAT...................EGS" 0x2a "MFL........KAT........KOMBI......." 0x2b "MFL........KAT........KOMBI.EGS" 0x2c "MFL........KAT.ASC................." 0x2d "MFL........KAT.ASC............EGS" 0x2e "MFL........KAT.ASC.KOMBI......." 0x2f "MFL........KAT.ASC.KOMBI.EGS" 0x30 "MFL.ACE.............................." 0x31 "MFL.ACE...........................EGS" 0x32 "MFL.ACE...............KOMBI......." 0x33 "MFL.ACE...............KOMBI.EGS" 0x34 "MFL.ACE........ASC................." 0x35 "MFL.ACE........ASC............EGS" 0x36 "MFL.ACE........ASC.KOMBI......." 0x37 "MFL.ACE........ASC.KOMBI.EGS" 0x38 "MFL.ACE.KAT........................." 0x39 "MFL.ACE.KAT...................EGS" 0x3a "MFL.ACE.KAT........KOMBI......." 0x3b "MFL.ACE.KAT........KOMBI.EGS" 0x3c "MFL.ACE.KAT.ASC.................." 0x3d "MFL.ACE.KAT.ASC............EGS" 0x3e "MFL.ACE.KAT.ASC.KOMBI......." 0x3f "MFL.ACE.KAT.ASC.KOMBI.EGS" /end COMPU_VTAB
/begin COMPU_VTAB STATE_IVVT_TAB_NAME "" TAB_VERB 4 0x0 "RV-PASSIV" 0x1 "RV-BEREITSCHAFT" 0x2 "RV-AKTIV" 0x3 "RV-NOTLAUF" /end COMPU_VTAB
/begin COMPU_VTAB RANGE________TALLFS___1H__1H____ "" TAB_VERB 2 0x0 "" 0x1 "TALLFS" /end COMPU_VTAB
/begin COMPU_VTAB RANGE________TALLFS_T_AD_LL___1H "" TAB_VERB 2 0x0 "" 0x1 "TALLFS_T_AD_LL" /end COMPU_VTAB
/begin COMPU_VTAB RANGE________SCHLIESSEN___0H__0H "" TAB_VERB 2 0x0 "SCHLIESSEN" 0x1 "ÖFFNEN" /end COMPU_VTAB
/begin COMPU_VTAB RANGE________VL___1H__1H________ "" TAB_VERB 2 0x0 "" 0x1 "VL" /end COMPU_VTAB
/begin COMPU_VTAB RANGE________WE___1H__1H________ "" TAB_VERB 2 0x0 "" 0x1 "WE" /end COMPU_VTAB
/begin COMPU_VTAB RANGE________WL___1H__1H________ "" TAB_VERB 2 0x0 "" 0x1 "WL" /end COMPU_VTAB
/begin COMPU_VTAB DRUCKLOS_RANGE_TAB_NAME "" TAB_VERB 2 0x0 "nicht drucklos" 0x7 "drucklos" /end COMPU_VTAB
/begin COMPU_VTAB RANGE_____00000017_TAB_NAME "" TAB_VERB 8 0x0 "MS" 0x1 "ST" 0x2 "LL" 0x3 "TL" 0x4 "S" 0x5 "SA" 0x6 "" 0x7 "" /end COMPU_VTAB
/begin COMPU_VTAB RANGE________ZYKA_LL___1H__1H___ "" TAB_VERB 2 0x0 "" 0x1 "ZYKA_LL" /end COMPU_VTAB
/end MODULE
/end PROJECT
