ASAP2_VERSION 1 2
/begin PROJECT Z42D "011"
/begin HEADER "" VERSION "0AD.03" PROJECT_NO Z011 /end HEADER
/begin MODULE BMW-EASY ""
/begin MOD_COMMON "common attributes" DEPOSIT ABSOLUT BYTE_ORDER BIG_ENDIAN /end MOD_COMMON
/begin CHARACTERISTIC tkw_ad_max_ll "TKW_AD_MAX_LL" VALUE 0x48385 a_173 15 LINEAR_______48_000000__0H___121 -48.0 142.5 BIT_MASK 0xffffffff /end CHARACTERISTIC
/begin CHARACTERISTIC tkw_ad_min_kr "TKW_AD_MIN_KR" VALUE 0x48386 a_173 15 LINEAR_______48_000000__0H___121 -48.0 142.5 BIT_MASK 0xffffffff /end CHARACTERISTIC
/begin CHARACTERISTIC tkw_ad_min_ll "TKW_AD_MIN_LL" VALUE 0x48387 a_173 15 LINEAR_______48_000000__0H___121 -48.0 142.5 BIT_MASK 0xffffffff /end CHARACTERISTIC
/begin CHARACTERISTIC tkw_ad_min_ll_kk "TKW_AD_MIN_LL_KK" VALUE 0x48388 a_173 15 LINEAR_______48_000000__0H___121 -48.0 142.5 BIT_MASK 0xffffffff /end CHARACTERISTIC
/begin CHARACTERISTIC tkw_co "TKW_CO" VALUE 0x48389 a_173 20 LINEAR_______48_000000__0H___121 -48.0 142.5 BIT_MASK 0xffffffff /end CHARACTERISTIC
/begin CHARACTERISTIC tkw_diag "TKW_DIAG" VALUE 0x4838a a_173 15 LINEAR_______48_000000__0H___142 -48.0 142.5 BIT_MASK 0xffffffff /end CHARACTERISTIC
/begin CHARACTERISTIC tkw_dif_max_wst "TKW_DIF_MAX_WST" VALUE 0x4838b a_173 1 LINEAR______0_000000__0H___60_00 0.0 60.0 BIT_MASK 0xffffffff /end CHARACTERISTIC
/begin CHARACTERISTIC tkw_dif_min_ldp "TKW_DIF_MIN_LDP" VALUE 0x4838c a_173 100 LINEAR_______48_000000__0H___142 -48.0 142.5 BIT_MASK 0xffffffff /end CHARACTERISTIC
/begin CHARACTERISTIC tkw_dif_min_sl "TKW_DIF_MIN_SL" VALUE 0x4838d a_173 1 LINEAR______0_000000__0H___19863 0.0 190.5 BIT_MASK 0xffffffff /end CHARACTERISTIC
/begin CHARACTERISTIC tkw_ers_ob "TKW_ERS_OB" VALUE 0x4838e a_173 15 LINEAR_______48_000000__0H___142 -48.0 142.5 BIT_MASK 0xffffffff /end CHARACTERISTIC
/begin CHARACTERISTIC tkw_ers_unt1 "TKW_ERS_UNT1" VALUE 0x4838f a_173 15 LINEAR_______48_000000__0H___142 -48.0 142.5 BIT_MASK 0xffffffff /end CHARACTERISTIC
/begin CHARACTERISTIC tkw_ers_unt2 "TKW_ERS_UNT2" VALUE 0x48390 a_173 15 LINEAR_______48_000000__0H___142 -48.0 142.5 BIT_MASK 0xffffffff /end CHARACTERISTIC
/begin CHARACTERISTIC tkw_grd_max_diag "TKW_GRD_MAX_DIAG" VALUE 0x48391 a_173 20 LINEAR______0_000000__0H___190_5 0.0 190.5 BIT_MASK 0xffffffff /end CHARACTERISTIC
/begin CHARACTERISTIC tkw_hys_kat "TKW_HYS_KAT" VALUE 0x48392 a_173 1 LINEAR______0_000000__0H___60_00 0.0 60.0 BIT_MASK 0xffffffff /end CHARACTERISTIC
/begin CHARACTERISTIC tkw_max_diag "TKW_MAX_DIAG" VALUE 0x48393 a_173 15 LINEAR_______48_000000__0H___142 -48.0 142.5 BIT_MASK 0xffffffff /end CHARACTERISTIC
/begin CHARACTERISTIC tkw_max_diag_sl "TKW_MAX_DIAG_SL" VALUE 0x48394 a_173 10 LINEAR_______48_000000__0H___142 -48.0 142.5 BIT_MASK 0xffffffff /end CHARACTERISTIC
/begin CHARACTERISTIC tkw_max_ldp "TKW_MAX_LDP" VALUE 0x48395 a_173 100 LINEAR_______48_000000__0H___142 -48.0 142.5 BIT_MASK 0xffffffff /end CHARACTERISTIC
/begin CHARACTERISTIC tkw_max_mz "TKW_MAX_MZ" VALUE 0x48396 a_173 15 LINEAR_______48_000000__0H___121 -48.0 142.5 BIT_MASK 0xffffffff /end CHARACTERISTIC
/begin CHARACTERISTIC tkw_max_toel_diag "TKW_MAX_TOEL_DIAG" VALUE 0x48397 a_173 15 LINEAR_______48_000000__0H___155 -48.0 155.0 BIT_MASK 0xffffffff /end CHARACTERISTIC
/begin CHARACTERISTIC tkw_min_ar "TKW_MIN_AR" VALUE 0x48398 a_173 100 LINEAR_______48_000000__0H___142 -48.0 142.5 BIT_MASK 0xffffffff /end CHARACTERISTIC
/begin CHARACTERISTIC tkw_min_diag "TKW_MIN_DIAG" VALUE 0x48399 a_173 15 LINEAR_______48_000000__0H___142 -48.0 142.5 BIT_MASK 0xffffffff /end CHARACTERISTIC
/begin CHARACTERISTIC tkw_min_diag_sl "TKW_MIN_DIAG_SL" VALUE 0x4839a a_173 10 LINEAR_______48_000000__0H___142 -48.0 142.5 BIT_MASK 0xffffffff /end CHARACTERISTIC
/begin CHARACTERISTIC tkw_min_fc "TKW_MIN_FC" VALUE 0x4839b a_173 15 LINEAR_______48_000000__0H___121 -48.0 142.5 BIT_MASK 0xffffffff /end CHARACTERISTIC
/begin CHARACTERISTIC tkw_min_kat3 "TKW_MIN_KAT3" VALUE 0x4839c a_173 100 LINEAR_______48_000000__0H___142 -48.0 142.5 BIT_MASK 0xffffffff /end CHARACTERISTIC
/begin CHARACTERISTIC tkw_min_kat3_katv "TKW_MIN_KAT3_KATV" VALUE 0x4839d a_173 100 LINEAR_______48_000000__0H___142 -48.0 142.5 BIT_MASK 0xffffffff /end CHARACTERISTIC
/begin CHARACTERISTIC tkw_min_kfk "TKW_MIN_KFK" VALUE 0x4839e a_173 25 LINEAR_______48_000000__0H___197 -48.0 142.5 BIT_MASK 0xffffffff /end CHARACTERISTIC
/begin CHARACTERISTIC tkw_min_ldp "TKW_MIN_LDP" VALUE 0x4839f a_173 100 LINEAR_______48_000000__0H___142 -48.0 142.5 BIT_MASK 0xffffffff /end CHARACTERISTIC
/begin CHARACTERISTIC tkw_min_nsoll_add_ss "TKW_MIN_NSOLL_ADD_SS" VALUE 0x483a0 a_173 100 LINEAR_______48_000000__0H___142 -48.0 142.5 BIT_MASK 0xffffffff /end CHARACTERISTIC
/begin CHARACTERISTIC tkw_min_s "TKW_MIN_S" VALUE 0x483a1 a_173 15 LINEAR_______48_000000__0H___121 -48.0 142.5 BIT_MASK 0xffffffff /end CHARACTERISTIC
/begin CHARACTERISTIC tkw_min_sa_st "TKW_MIN_SA_ST" VALUE 0x483a2 a_173 15 LINEAR_______48_000000__0H___121 -48.0 142.5 BIT_MASK 0xffffffff /end CHARACTERISTIC
/begin CHARACTERISTIC tkw_min_slow_s "TKW_MIN_SLOW_S" VALUE 0x483a3 a_173 15 LINEAR_______48_000000__0H___121 -48.0 142.5 BIT_MASK 0xffffffff /end CHARACTERISTIC
/begin CHARACTERISTIC tkw_min_ssp "TKW_MIN_SSP" VALUE 0x483a4 a_173 100 LINEAR_______48_000000__0H___142 -48.0 142.5 BIT_MASK 0xffffffff /end CHARACTERISTIC
/begin CHARACTERISTIC tkw_min_te "TKW_MIN_TE" VALUE 0x483a5 a_173 15 LINEAR_______48_000000__0H___121 -48.0 142.5 BIT_MASK 0xffffffff /end CHARACTERISTIC
/begin CHARACTERISTIC tkw_min_ti_asc "TKW_MIN_TI_ASC" VALUE 0x483a6 a_173 100 LINEAR_______48_000000__0H___142 -48.0 142.5 BIT_MASK 0xffffffff /end CHARACTERISTIC
/begin CHARACTERISTIC tkw_min_vl "TKW_MIN_VL" VALUE 0x483a7 a_173 15 LINEAR_______48_000000__0H___121 -48.0 142.5 BIT_MASK 0xffffffff /end CHARACTERISTIC
/begin CHARACTERISTIC tkw_min_zsr "TKW_MIN_ZSR" VALUE 0x483a8 a_173 15 LINEAR_______48_000000__0H___142 -48.0 142.5 BIT_MASK 0xffffffff /end CHARACTERISTIC
/begin CHARACTERISTIC tkw_min_zw_kor_nw_dif "TKW_MIN_ZW_KOR_NW_DIF" VALUE 0x483a9 a_173 100 LINEAR_______48_000000__0H___142 -48.0 142.5 BIT_MASK 0xffffffff /end CHARACTERISTIC
/begin CHARACTERISTIC tkw_roz_fak_max "TKW_ROZ_FAK_MAX" VALUE 0x483aa a_173 15 LINEAR_______48_000000__0H___142 -48.0 142.5 BIT_MASK 0xffffffff /end CHARACTERISTIC
/begin CHARACTERISTIC tkw_roz_fak_min "TKW_ROZ_FAK_MIN" VALUE 0x483ab a_173 15 LINEAR_______48_000000__0H___142 -48.0 142.5 BIT_MASK 0xffffffff /end CHARACTERISTIC
/begin CHARACTERISTIC tkw_soll_tal_max "TKW_SOLL_TAL_MAX" VALUE 0x483ac a_173 15 LINEAR_______48_000000__0H___142 -48.0 142.5 BIT_MASK 0xffffffff /end CHARACTERISTIC
/begin CHARACTERISTIC tkw_soll_tka_max "TKW_SOLL_TKA_MAX" VALUE 0x483ad a_173 15 LINEAR_______48_000000__0H___142 -48.0 142.5 BIT_MASK 0xffffffff /end CHARACTERISTIC
/begin CHARACTERISTIC tkw_soll_toel_min "TKW_SOLL_TOEL_MIN" VALUE 0x483ae a_173 15 LINEAR_______48_000000__0H___142 -48.0 142.5 BIT_MASK 0xffffffff /end CHARACTERISTIC
/begin CHARACTERISTIC tkw_swi_wl "TKW_SWI_WL" VALUE 0x483af a_173 100 LINEAR_______48_000000__0H___121 -48.0 142.5 BIT_MASK 0xffffffff /end CHARACTERISTIC
/begin CHARACTERISTIC tkw_ti_ad_min "TKW_TI_AD_MIN" VALUE 0x483b0 a_173 15 LINEAR_______48_000000__0H___121 -48.0 142.5 BIT_MASK 0xffffffff /end CHARACTERISTIC
/begin CHARACTERISTIC tkw_tmot_sta "TKW_TMOT_STA" VALUE 0x483b1 a_173 100 LINEAR_______48_000000__0H___142 -48.0 142.5 BIT_MASK 0xffffffff /end CHARACTERISTIC
/begin CHARACTERISTIC tkw_unt_kfk "TKW_UNT_KFK" VALUE 0x483b2 a_173 100 LINEAR_______48_000000__0H___197 -48.0 142.5 BIT_MASK 0xffffffff /end CHARACTERISTIC
/begin CHARACTERISTIC tkw_vti_sync "TKW_VTI_SYNC" VALUE 0x483b3 a_173 15 LINEAR_______48_000000__0H___121 -48.0 142.5 BIT_MASK 0xffffffff /end CHARACTERISTIC
/begin CHARACTERISTIC tmdk_min_diag_mdk "TMDK_MIN_DIAG_MDK" VALUE 0x483b4 a_173 100 LINEAR_______48_000000__0H___142 -48.0 142.5 BIT_MASK 0xffffffff /end CHARACTERISTIC
/begin CHARACTERISTIC tmdk_mitko "TMDK_MITKO" VALUE 0x487a0 a_174 100 LINEAR______0_000000__0H___1_809 0.0 1.0 BIT_MASK 0xffffffff /end CHARACTERISTIC
/begin CHARACTERISTIC tmot_anz_hys "TMOT_ANZ_HYS" VALUE 0x483b5 a_173 100 LINEAR______0_000000__0H___19864 0.0 190.5 BIT_MASK 0xffffffff /end CHARACTERISTIC
/begin CHARACTERISTIC tn_ad_mitko_lu "TN_AD_MITKO_LU" VALUE 0x487a2 a_174 5 LINEAR______0_000000__0H___0_865 0.0 0.99998474 BIT_MASK 0xffffffff /end CHARACTERISTIC
/begin CHARACTERISTIC toel_ers_diag "TOEL_ERS_DIAG" VALUE 0x483b6 a_173 15 LINEAR_______48_000000__0H___155 -48.0 155.0 BIT_MASK 0xffffffff /end CHARACTERISTIC
/begin CHARACTERISTIC toel_grd_max_diag "TOEL_GRD_MAX_DIAG" VALUE 0x483b7 a_173 20 LINEAR______0_000000__0H___203_0 0.0 203.0 BIT_MASK 0xffffffff /end CHARACTERISTIC
/begin CHARACTERISTIC toel_hys_kat "TOEL_HYS_KAT" VALUE 0x483b8 a_173 1 LINEAR______0_000000__0H___60_00 0.0 60.0 BIT_MASK 0xffffffff /end CHARACTERISTIC
/begin CHARACTERISTIC toel_hys_max "TOEL_HYS_MAX" VALUE 0x483b9 a_173 15 LINEAR______0_000000__0H___101_5 0.0 101.5 BIT_MASK 0xffffffff /end CHARACTERISTIC
/begin CHARACTERISTIC toel_hys_vanos "TOEL_HYS_VANOS" VALUE 0x483ba a_173 100 LINEAR______0_000000__0H___20866 0.0 203.0 BIT_MASK 0xffffffff /end CHARACTERISTIC
/begin CHARACTERISTIC toel_kfk_hys "TOEL_KFK_HYS" VALUE 0x483bb a_173 15 LINEAR______0_000000__0H___20866 0.0 203.0 BIT_MASK 0xffffffff /end CHARACTERISTIC
/begin CHARACTERISTIC toel_kfk_max "TOEL_KFK_MAX" VALUE 0x483bc a_173 15 LINEAR_______48_000000__0H___155 -48.0 155.0 BIT_MASK 0xffffffff /end CHARACTERISTIC
/begin CHARACTERISTIC toel_kfk_min "TOEL_KFK_MIN" VALUE 0x483bd a_173 15 LINEAR_______48_000000__0H___155 -48.0 155.0 BIT_MASK 0xffffffff /end CHARACTERISTIC
/begin CHARACTERISTIC toel_max "TOEL_MAX" VALUE 0x483be a_173 15 LINEAR_______48_000000__0H___155 -48.0 155.0 BIT_MASK 0xffffffff /end CHARACTERISTIC
/begin CHARACTERISTIC toel_max_diag "TOEL_MAX_DIAG" VALUE 0x483bf a_173 15 LINEAR_______48_000000__0H___155 -48.0 155.0 BIT_MASK 0xffffffff /end CHARACTERISTIC
/begin CHARACTERISTIC toel_min_diag "TOEL_MIN_DIAG" VALUE 0x483c0 a_173 15 LINEAR_______48_000000__0H___155 -48.0 155.0 BIT_MASK 0xffffffff /end CHARACTERISTIC
/begin CHARACTERISTIC toel_min_vanos "TOEL_MIN_VANOS" VALUE 0x483c1 a_173 100 LINEAR_______48_000000__0H___867 -48.0 155.0 BIT_MASK 0xffffffff /end CHARACTERISTIC
/begin CHARACTERISTIC totz_kk_lu "TOTZ_KK_LU" VALUE 0x487a4 a_174 5 LINEAR______0_010000__1H___65768 0.01 655.34998 BIT_MASK 0xffffffff /end CHARACTERISTIC
/begin CHARACTERISTIC totz_lu_sws "TOTZ_LU_SWS" VALUE 0x487a6 a_174 100 LINEAR______0_000000__0H___10000 0.0 10000.0 BIT_MASK 0xffffffff /end CHARACTERISTIC
/begin CHARACTERISTIC totz_st_lu "TOTZ_ST_LU" VALUE 0x487a8 a_174 5 LINEAR______0_010000__1H___65768 0.01 655.34998 BIT_MASK 0xffffffff /end CHARACTERISTIC
/begin CHARACTERISTIC TSWING_1 "TSWING_1" VALUE 0x483c2 a_173 100 LINEAR______0_000000__0H___25182 0.0 255.0 BIT_MASK 0xffffffff /end CHARACTERISTIC
/begin CHARACTERISTIC TSWING_2 "TSWING_2" VALUE 0x483c3 a_173 100 LINEAR______0_000000__0H___25182 0.0 255.0 BIT_MASK 0xffffffff /end CHARACTERISTIC
/begin CHARACTERISTIC TSWING_3 "TSWING_3" VALUE 0x483c4 a_173 100 LINEAR______0_000000__0H___25182 0.0 255.0 BIT_MASK 0xffffffff /end CHARACTERISTIC
/begin CHARACTERISTIC TSWING_4 "TSWING_4" VALUE 0x483c5 a_173 100 LINEAR______0_000000__0H___25182 0.0 255.0 BIT_MASK 0xffffffff /end CHARACTERISTIC
/begin CHARACTERISTIC TSWING_5 "TSWING_5" VALUE 0x483c6 a_173 100 LINEAR______0_000000__0H___25182 0.0 255.0 BIT_MASK 0xffffffff /end CHARACTERISTIC
/begin CHARACTERISTIC TTS_1 "TTS_1" VALUE 0x48120 a_172 100 LINEAR_______32768_000000__FF180 -32768.0 32767.0 BIT_MASK 0xffffffff /end CHARACTERISTIC
/begin CHARACTERISTIC TTS_3 "TTS_3" VALUE 0x48122 a_172 100 LINEAR_______32768_000000__FF180 -32768.0 32767.0 BIT_MASK 0xffffffff /end CHARACTERISTIC
/begin CHARACTERISTIC tumg_ers "TUMG_ERS" VALUE 0x487f8 a_175 100 LINEAR_______128_000000__FFFF868 -128.0 127.0 BIT_MASK 0xffffffff /end CHARACTERISTIC
/begin CHARACTERISTIC tumg_hys "TUMG_HYS" VALUE 0x483c7 a_173 100 LINEAR______0_000000__0H___25869 0.0 255.0 BIT_MASK 0xffffffff /end CHARACTERISTIC
/begin CHARACTERISTIC tumg_max_ldp "TUMG_MAX_LDP" VALUE 0x487f9 a_175 10 LINEAR_______128_000000__FFFF870 -128.0 127.0 BIT_MASK 0xffffffff /end CHARACTERISTIC
/begin CHARACTERISTIC tumg_min_ldp "TUMG_MIN_LDP" VALUE 0x487fa a_175 10 LINEAR_______128_000000__FFFF870 -128.0 127.0 BIT_MASK 0xffffffff /end CHARACTERISTIC
/begin CHARACTERISTIC tumg_nsoll_add_heiz "TUMG_NSOLL_ADD_HEIZ" VALUE 0x487fb a_175 100 LINEAR_______128_000000__FFFF868 -128.0 127.0 BIT_MASK 0xffffffff /end CHARACTERISTIC
/begin CHARACTERISTIC tv_fak "TV_FAK" VALUE 0x487aa a_174 10 LINEAR______1000_000000__3E8H___ 1000.0 30000.0 BIT_MASK 0xffffffff /end CHARACTERISTIC
/begin CHARACTERISTIC tv_max_ar "TV_MAX_AR" VALUE 0x483c8 a_173 100 LINEAR______0_000000__0H___25738 0.0 255.0 BIT_MASK 0xffffffff /end CHARACTERISTIC
/begin CHARACTERISTIC tv_max_ctc "TV_MAX_CTC" VALUE 0x483c9 a_173 100 LINEAR______0_000000__0H___25738 0.0 255.0 BIT_MASK 0xffffffff /end CHARACTERISTIC
/begin CHARACTERISTIC tv_max_kat2 "TV_MAX_KAT2" VALUE 0x483ca a_173 100 LINEAR______0_000000__0H___25738 0.0 255.0 BIT_MASK 0xffffffff /end CHARACTERISTIC
/begin CHARACTERISTIC tv_max_kat3 "TV_MAX_KAT3" VALUE 0x483cb a_173 100 LINEAR______0_000000__0H___25738 0.0 255.0 BIT_MASK 0xffffffff /end CHARACTERISTIC
/begin CHARACTERISTIC tv_max_kk "TV_MAX_KK" VALUE 0x483cc a_173 10 LINEAR______0_000000__0H___25738 0.0 255.0 BIT_MASK 0xffffffff /end CHARACTERISTIC
/begin CHARACTERISTIC tv_max_sws "TV_MAX_SWS" VALUE 0x483cd a_173 100 LINEAR______0_000000__0H___25558 0.0 255.0 BIT_MASK 0xffffffff /end CHARACTERISTIC
/begin CHARACTERISTIC tv_max_vl "TV_MAX_VL" VALUE 0x483ce a_173 100 LINEAR______0_000000__0H___25558 0.0 255.0 BIT_MASK 0xffffffff /end CHARACTERISTIC
/begin CHARACTERISTIC tv_min_ak "TV_MIN_AK" VALUE 0x483cf a_173 100 LINEAR______0_000000__0H___25738 0.0 255.0 BIT_MASK 0xffffffff /end CHARACTERISTIC
/begin CHARACTERISTIC tv_min_ar "TV_MIN_AR" VALUE 0x483d0 a_173 100 LINEAR______0_000000__0H___25738 0.0 255.0 BIT_MASK 0xffffffff /end CHARACTERISTIC
/begin CHARACTERISTIC tv_min_slow_s "TV_MIN_SLOW_S" VALUE 0x483d1 a_173 10 LINEAR______0_000000__0H___25738 0.0 255.0 BIT_MASK 0xffffffff /end CHARACTERISTIC
/begin CHARACTERISTIC tv_min_sws "TV_MIN_SWS" VALUE 0x483d2 a_173 100 LINEAR______0_000000__0H___25558 0.0 255.0 BIT_MASK 0xffffffff /end CHARACTERISTIC
/begin CHARACTERISTIC tv_min_vl "TV_MIN_VL" VALUE 0x483d3 a_173 10 LINEAR______0_000000__0H___25738 0.0 255.0 BIT_MASK 0xffffffff /end CHARACTERISTIC
/begin CHARACTERISTIC tv_n_end_ll "TV_N_END_LL" VALUE 0x483d4 a_173 10 LINEAR______0_000000__0H___25738 0.0 255.0 BIT_MASK 0xffffffff /end CHARACTERISTIC
/begin CHARACTERISTIC u_dif_poti "U_DIF_POTI" VALUE 0x483d5 a_173 100 LINEAR______0_024412__1H___6_225 0.02441176 6.2249999 BIT_MASK 0xffffffff /end CHARACTERISTIC
/begin CHARACTERISTIC ub_el "UB_EL" VALUE 0x483d6 a_173 100 LINEAR______0_000000__0H___26_82 0.0 26.0 BIT_MASK 0xffffffff /end CHARACTERISTIC
/begin CHARACTERISTIC ub_max_vanos "UB_MAX_VANOS" VALUE 0x483d7 a_173 100 LINEAR______0_000000__0H___26_82 0.0 26.0 BIT_MASK 0xffffffff /end CHARACTERISTIC
/begin CHARACTERISTIC ub_min_can_diag "UB_MIN_CAN_DIAG" VALUE 0x483d8 a_173 100 LINEAR______0_000000__0H___26871 0.0 26.0 BIT_MASK 0xffffffff /end CHARACTERISTIC
/begin CHARACTERISTIC ub_min_diag "UB_MIN_DIAG" VALUE 0x483d9 a_173 30 LINEAR______0_000000__0H___26_00 0.0 26.0 BIT_MASK 0xffffffff /end CHARACTERISTIC
/begin CHARACTERISTIC ub_min_jump "UB_MIN_JUMP" VALUE 0x483da a_173 30 LINEAR______0_000000__0H___26_00 0.0 26.0 BIT_MASK 0xffffffff /end CHARACTERISTIC
/begin CHARACTERISTIC ub_min_mfl_diag "UB_MIN_MFL_DIAG" VALUE 0x483db a_173 30 LINEAR______0_000000__0H___26_00 0.0 26.0 BIT_MASK 0xffffffff /end CHARACTERISTIC
/begin CHARACTERISTIC ub_min_sync "UB_MIN_SYNC" VALUE 0x483dc a_173 100 LINEAR______0_000000__0H___26_00 0.0 26.0 BIT_MASK 0xffffffff /end CHARACTERISTIC
/begin CHARACTERISTIC ub_min_vanos "UB_MIN_VANOS" VALUE 0x483dd a_173 100 LINEAR______0_000000__0H___26_82 0.0 26.0 BIT_MASK 0xffffffff /end CHARACTERISTIC
/begin CHARACTERISTIC ub_vanos_diag "UB_VANOS_DIAG" VALUE 0x483de a_173 100 LINEAR______0_000000__0H___26_82 0.0 26.0 BIT_MASK 0xffffffff /end CHARACTERISTIC
/begin CHARACTERISTIC ubel_grd_max "UBEL_GRD_MAX" VALUE 0x483df a_173 100 LINEAR______0_000000__0H___26_82 0.0 26.0 BIT_MASK 0xffffffff /end CHARACTERISTIC
/begin CHARACTERISTIC uls_anz_min_diag "ULS_ANZ_MIN_DIAG" VALUE 0x487ac a_174 100 LINEAR______0_000000__0H___65872 0.0 65534.0 BIT_MASK 0xffffffff /end CHARACTERISTIC
/begin CHARACTERISTIC uls_dif_max_min_diag "ULS_DIF_MAX_MIN_DIAG" VALUE 0x483e0 a_173 100 LINEAR______0_000000__0H___1_873 0.0 1.275 BIT_MASK 0xffffffff /end CHARACTERISTIC
/begin CHARACTERISTIC uls_fett_bre_sl_diag "ULS_FETT_BRE_SL_DIAG" VALUE 0x483e1 a_173 100 LINEAR______0_000000__0H___1_873 0.0 1.275 BIT_MASK 0xffffffff /end CHARACTERISTIC
/begin CHARACTERISTIC uls_fett_nkat_bre "ULS_FETT_NKAT_BRE" VALUE 0x483e2 a_173 100 LINEAR______0_000000__0H___1_873 0.0 1.275 BIT_MASK 0xffffffff /end CHARACTERISTIC
/begin CHARACTERISTIC uls_fett_vkat_bre "ULS_FETT_VKAT_BRE" VALUE 0x483e3 a_173 100 LINEAR______0_000000__0H___1_873 0.0 1.275 BIT_MASK 0xffffffff /end CHARACTERISTIC
/begin CHARACTERISTIC uls_gmw_hys "ULS_GMW_HYS" VALUE 0x483e4 a_173 10 LINEAR______0_000000__0H___1_873 0.0 1.275 BIT_MASK 0xffffffff /end CHARACTERISTIC
/begin CHARACTERISTIC uls_hys "ULS_HYS" VALUE 0x483e5 a_173 100 LINEAR______0_000000__0H___4_980 0.0 4.9805002 BIT_MASK 0xffffffff /end CHARACTERISTIC
/begin CHARACTERISTIC uls_hys_kat "ULS_HYS_KAT" VALUE 0x483e6 a_173 100 LINEAR______0_000000__0H___1_275 0.0 1.275 BIT_MASK 0xffffffff /end CHARACTERISTIC
/begin CHARACTERISTIC uls_ini_max "ULS_INI_MAX" VALUE 0x483e7 a_173 10 LINEAR______0_000000__0H___1_873 0.0 1.275 BIT_MASK 0xffffffff /end CHARACTERISTIC
/begin CHARACTERISTIC uls_ini_min "ULS_INI_MIN" VALUE 0x483e8 a_173 10 LINEAR______0_000000__0H___1_873 0.0 1.275 BIT_MASK 0xffffffff /end CHARACTERISTIC
/begin CHARACTERISTIC uls_lam_fett "ULS_LAM_FETT" VALUE 0x483e9 a_173 100 LINEAR______0_000000__0H___1_873 0.0 1.275 BIT_MASK 0xffffffff /end CHARACTERISTIC
/begin CHARACTERISTIC uls_lam_mager "ULS_LAM_MAGER" VALUE 0x483ea a_173 100 LINEAR______0_000000__0H___1_873 0.0 1.275 BIT_MASK 0xffffffff /end CHARACTERISTIC
/begin CHARACTERISTIC uls_mager_bre_sl_diag "ULS_MAGER_BRE_SL_DIAG" VALUE 0x483eb a_173 100 LINEAR______0_000000__0H___1_873 0.0 1.275 BIT_MASK 0xffffffff /end CHARACTERISTIC
/begin CHARACTERISTIC uls_mager_nkat_bre "ULS_MAGER_NKAT_BRE" VALUE 0x483ec a_173 100 LINEAR______0_000000__0H___1_873 0.0 1.275 BIT_MASK 0xffffffff /end CHARACTERISTIC
/begin CHARACTERISTIC uls_mager_vkat_bre "ULS_MAGER_VKAT_BRE" VALUE 0x483ed a_173 100 LINEAR______0_000000__0H___1_873 0.0 1.275 BIT_MASK 0xffffffff /end CHARACTERISTIC
/begin CHARACTERISTIC uls_max_nkat_diag "ULS_MAX_NKAT_DIAG" VALUE 0x483ee a_173 100 LINEAR______0_000000__0H___1_873 0.0 1.275 BIT_MASK 0xffffffff /end CHARACTERISTIC
/begin CHARACTERISTIC uls_max_vkat_diag "ULS_MAX_VKAT_DIAG" VALUE 0x483ef a_173 100 LINEAR______0_000000__0H___1_873 0.0 1.275 BIT_MASK 0xffffffff /end CHARACTERISTIC
/begin CHARACTERISTIC uls_min_diag "ULS_MIN_DIAG" VALUE 0x483f0 a_173 10 LINEAR______0_000000__0H___1_873 0.0 1.275 BIT_MASK 0xffffffff /end CHARACTERISTIC
/begin CHARACTERISTIC uls_mitko "ULS_MITKO" VALUE 0x483f1 a_173 10 LINEAR______0_000000__0H___0_996 0.0 0.99610001 BIT_MASK 0xffffffff /end CHARACTERISTIC
/begin CHARACTERISTIC uls_nkat_min_diag "ULS_NKAT_MIN_DIAG" VALUE 0x483f2 a_173 10 LINEAR______0_000000__0H___1_873 0.0 1.275 BIT_MASK 0xffffffff /end CHARACTERISTIC
/begin CHARACTERISTIC uls_nkat_ob_auf_diag "ULS_NKAT_OB_AUF_DIAG" VALUE 0x483f3 a_173 100 LINEAR______0_000000__0H___1_873 0.0 1.275 BIT_MASK 0xffffffff /end CHARACTERISTIC
/begin CHARACTERISTIC uls_nkat_unt_auf_diag "ULS_NKAT_UNT_AUF_DIAG" VALUE 0x483f4 a_173 100 LINEAR______0_000000__0H___1_873 0.0 1.275 BIT_MASK 0xffffffff /end CHARACTERISTIC
/begin CHARACTERISTIC uls_ob_auf_diag "ULS_OB_AUF_DIAG" VALUE 0x483f5 a_173 100 LINEAR______0_000000__0H___1_873 0.0 1.275 BIT_MASK 0xffffffff /end CHARACTERISTIC
/begin CHARACTERISTIC uls_unt_auf_diag "ULS_UNT_AUF_DIAG" VALUE 0x483f6 a_173 100 LINEAR______0_000000__0H___1_873 0.0 1.275 BIT_MASK 0xffffffff /end CHARACTERISTIC
/begin CHARACTERISTIC US "US" VALUE 0x48124 a_172 100 LINEAR_______32768_000000__FFFF8 -32768.0 32767.0 BIT_MASK 0xffffffff /end CHARACTERISTIC
/begin CHARACTERISTIC v_a_dif_max_fgr "V_A_DIF_MAX_FGR" VALUE 0x48126 a_172 10 V_2co_SGN_16_RES -256.0 255.99218 BIT_MASK 0xffffffff /end CHARACTERISTIC
/begin CHARACTERISTIC v_a_dif_min_fgr "V_A_DIF_MIN_FGR" VALUE 0x48128 a_172 10 V_2co_SGN_16_RES -256.0 255.99218 BIT_MASK 0xffffffff /end CHARACTERISTIC
/begin CHARACTERISTIC v_a_max_fgr "V_A_MAX_FGR" VALUE 0x483f7 a_173 10 LINEAR______0_000000__0H___25874 0.0 255.0 BIT_MASK 0xffffffff /end CHARACTERISTIC
/begin CHARACTERISTIC v_a_min_fgr "V_A_MIN_FGR" VALUE 0x483f8 a_173 10 LINEAR______0_000000__0H___25874 0.0 255.0 BIT_MASK 0xffffffff /end CHARACTERISTIC
/begin CHARACTERISTIC v_dif_delta_i "V_DIF_DELTA_I" VALUE 0x483f9 a_173 10 LINEAR______0_000000__0H___63875 0.0 63.75 BIT_MASK 0xffffffff /end CHARACTERISTIC
/begin CHARACTERISTIC v_dif_ll_max_fgr "V_DIF_LL_MAX_FGR" VALUE 0x4812a a_172 10 V_2co_SGN_16_RES -256.0 255.99218 BIT_MASK 0xffffffff /end CHARACTERISTIC
/begin CHARACTERISTIC v_dif_ll_min_fgr "V_DIF_LL_MIN_FGR" VALUE 0x4812c a_172 10 V_2co_SGN_16_RES -256.0 255.99218 BIT_MASK 0xffffffff /end CHARACTERISTIC
/begin CHARACTERISTIC v_dif_max_fgr "V_DIF_MAX_FGR" VALUE 0x483fa a_173 10 LINEAR______0_000000__0H___31_87 0.0 31.875 BIT_MASK 0xffffffff /end CHARACTERISTIC
/begin CHARACTERISTIC v_dif_totb_fak_fgr "V_DIF_TOTB_FAK_FGR" VALUE 0x483fb a_173 10 LINEAR______0_000000__0H___0_965 0.0 0.99609375 BIT_MASK 0xffffffff /end CHARACTERISTIC
/begin CHARACTERISTIC v_dif_totb_fgr "V_DIF_TOTB_FGR" VALUE 0x487ae a_174 10 LINEAR______0_000000__0H___511_9 0.0 511.99218 BIT_MASK 0xffffffff /end CHARACTERISTIC
/begin CHARACTERISTIC v_dif_totz_fgr "V_DIF_TOTZ_FGR" VALUE 0x487b0 a_174 100 V_BAS_16_RES 0.0 255.99218 BIT_MASK 0xffffffff /end CHARACTERISTIC
/begin CHARACTERISTIC v_fzg_max_ldp "V_FZG_MAX_LDP" VALUE 0x483fc a_173 100 LINEAR______0_000000__0H___25738 0.0 255.0 BIT_MASK 0xffffffff /end CHARACTERISTIC
/begin CHARACTERISTIC v_fzg_min_bab "V_FZG_MIN_BAB" VALUE 0x487b2 a_174 10 LINEAR______0_000000__0H___511_9 0.0 511.99218 BIT_MASK 0xffffffff /end CHARACTERISTIC
/begin CHARACTERISTIC v_fzg_min_tal_ref "V_FZG_MIN_TAL_REF" VALUE 0x483fd a_173 10 LINEAR______0_000000__0H___25738 0.0 255.0 BIT_MASK 0xffffffff /end CHARACTERISTIC
/begin CHARACTERISTIC v_i_a_max_fgr "V_I_A_MAX_FGR" VALUE 0x487b4 a_174 100 LINEAR______0_000000__0H___7110_ 0.0 7110.8941 BIT_MASK 0xffffffff /end CHARACTERISTIC
/begin CHARACTERISTIC v_i_fak_max_fgr "V_I_FAK_MAX_FGR" VALUE 0x483fe a_173 10 LINEAR______0_000000__0H___1_992 0.0 1.9922 BIT_MASK 0xffffffff /end CHARACTERISTIC
/begin CHARACTERISTIC v_i_fak_max_fgr_vbeg "V_I_FAK_MAX_FGR_VBEG" VALUE 0x483ff a_173 10 LINEAR______0_000000__0H___1_992 0.0 1.9922 BIT_MASK 0xffffffff /end CHARACTERISTIC
/begin CHARACTERISTIC v_max_diag "V_MAX_DIAG" VALUE 0x487b6 a_174 100 V_BAS_16_RES 0.0 255.99218 BIT_MASK 0xffffffff /end CHARACTERISTIC
/begin CHARACTERISTIC v_max_pwg_fak "V_MAX_PWG_FAK" VALUE 0x487b8 a_174 100 LINEAR______0_000000__0H___511_9 0.0 511.99218 BIT_MASK 0xffffffff /end CHARACTERISTIC
/begin CHARACTERISTIC v_min_fgr "V_MIN_FGR" VALUE 0x487ba a_174 100 LINEAR______0_000000__0H___511_9 0.0 511.99218 BIT_MASK 0xffffffff /end CHARACTERISTIC
/begin CHARACTERISTIC v_min_plaus_fgr "V_MIN_PLAUS_FGR" VALUE 0x487bc a_174 100 LINEAR______0_000000__0H___51174 0.0 511.99218 BIT_MASK 0xffffffff /end CHARACTERISTIC
/begin CHARACTERISTIC VDF "VDF" VALUE 0x4812e a_172 100 LINEAR_______32768_000000__FFFF8 -32768.0 32767.0 BIT_MASK 0xffffffff /end CHARACTERISTIC
/begin CHARACTERISTIC vmax_1 "VMAX_1" VALUE 0x48400 a_173 10 LINEAR______0_000000__0H___25874 0.0 255.0 BIT_MASK 0xffffffff /end CHARACTERISTIC
/begin CHARACTERISTIC vmax_add "VMAX_ADD" VALUE 0x48401 a_173 10 LINEAR______0_000000__0H___31_87 0.0 31.875 BIT_MASK 0xffffffff /end CHARACTERISTIC
/begin CHARACTERISTIC vmax_diag_bdyn "VMAX_DIAG_BDYN" VALUE 0x48402 a_173 10 LINEAR______0_000000__0H___25876 0.0 255.0 BIT_MASK 0xffffffff /end CHARACTERISTIC
/begin CHARACTERISTIC vmax_diag_mdk "VMAX_DIAG_MDK" VALUE 0x48403 a_173 10 LINEAR______0_000000__0H___25876 0.0 255.0 BIT_MASK 0xffffffff /end CHARACTERISTIC
/begin CHARACTERISTIC vmax_hys "VMAX_HYS" VALUE 0x48404 a_173 2 LINEAR______0_000000__0H___25738 0.0 255.0 BIT_MASK 0xffffffff /end CHARACTERISTIC
/begin CHARACTERISTIC vmax_hys_1 "VMAX_HYS_1" VALUE 0x48405 a_173 10 LINEAR______0_000000__0H___31_87 0.0 31.875 BIT_MASK 0xffffffff /end CHARACTERISTIC
/begin CHARACTERISTIC vmax_toel_max "VMAX_TOEL_MAX" VALUE 0x48406 a_173 10 LINEAR______0_000000__0H___25874 0.0 255.0 BIT_MASK 0xffffffff /end CHARACTERISTIC
/begin CHARACTERISTIC vmax_zyka "VMAX_ZYKA" VALUE 0x48407 a_173 2 LINEAR______0_000000__0H___25877 0.0 255.0 BIT_MASK 0xffffffff /end CHARACTERISTIC
/begin CHARACTERISTIC vsoll_dif_max_fgr "VSOLL_DIF_MAX_FGR" VALUE 0x48130 a_172 100 V_2co_SGN_16_RES878 -256.0 255.99218 BIT_MASK 0xffffffff /end CHARACTERISTIC
/begin CHARACTERISTIC vsoll_dif_min_fgr "VSOLL_DIF_MIN_FGR" VALUE 0x48132 a_172 100 V_2co_SGN_16_RES878 -256.0 255.99218 BIT_MASK 0xffffffff /end CHARACTERISTIC
/begin CHARACTERISTIC w_fpdk_diag "W_FPDK_DIAG" VALUE 0x48408 a_173 5 LINEAR______0_000000__0H___99_21 0.0 99.21875 BIT_MASK 0xffffffff /end CHARACTERISTIC
/begin CHARACTERISTIC Z_CROSS_TOL_MINUS "Z_CROSS_TOL_MINUS" VALUE 0x48134 a_172 100 LINEAR_______32768_000000__FFFF8 -32768.0 32767.0 BIT_MASK 0xffffffff /end CHARACTERISTIC
/begin CHARACTERISTIC Z_CROSS_TOL_PLUS "Z_CROSS_TOL_PLUS" VALUE 0x48136 a_172 100 LINEAR_______32768_000000__FFFF8 -32768.0 32767.0 BIT_MASK 0xffffffff /end CHARACTERISTIC
/begin CHARACTERISTIC zsi_dec "ZSI_DEC" VALUE 0x487be a_174 5 LINEAR______0_000000__0H___1_879 0.0 1.0 BIT_MASK 0xffffffff /end CHARACTERISTIC
/begin CHARACTERISTIC zsi_fak_max "ZSI_FAK_MAX" VALUE 0x487c0 a_174 10 LINEAR______1_000000__8000H___1_ 1.0 1.5 BIT_MASK 0xffffffff /end CHARACTERISTIC
/begin CHARACTERISTIC zsi_fak_min "ZSI_FAK_MIN" VALUE 0x487c2 a_174 10 LINEAR______0_500000__4000H___1_ 0.5 1.0 BIT_MASK 0xffffffff /end CHARACTERISTIC
/begin CHARACTERISTIC zsi_inc "ZSI_INC" VALUE 0x487c4 a_174 5 LINEAR______0_000000__0H___1_879 0.0 1.0 BIT_MASK 0xffffffff /end CHARACTERISTIC
/begin CHARACTERISTIC zsi_max_diag "ZSI_MAX_DIAG" VALUE 0x48409 a_173 10 LINEAR______0_000000__0H___14880 0.0 143.8 BIT_MASK 0xffffffff /end CHARACTERISTIC
/begin CHARACTERISTIC zsi_zyka "ZSI_ZYKA" VALUE 0x4840a a_173 2 LINEAR______1_000000__1H___25881 1.0 255.0 BIT_MASK 0xffffffff /end CHARACTERISTIC
/begin CHARACTERISTIC zw_ad_dif_max "ZW_AD_DIF_MAX" VALUE 0x4840b a_173 10 LINEAR______0_000000__0H___47882 0.0 47.625 BIT_MASK 0xffffffff /end CHARACTERISTIC
/begin CHARACTERISTIC zw_aebg_1 "ZW_AEBG_1" VALUE 0x487c6 a_174 10 LINEAR______0_001460__1H___47168 0.00146 47.998501 BIT_MASK 0xffffffff /end CHARACTERISTIC
/begin CHARACTERISTIC zw_aebg_2 "ZW_AEBG_2" VALUE 0x487c8 a_174 10 LINEAR______0_001460__1H___47168 0.00146 47.998501 BIT_MASK 0xffffffff /end CHARACTERISTIC
/begin CHARACTERISTIC zw_aebg_3 "ZW_AEBG_3" VALUE 0x487ca a_174 10 LINEAR______0_001460__1H___47168 0.00146 47.998501 BIT_MASK 0xffffffff /end CHARACTERISTIC
/begin CHARACTERISTIC zw_aebg_fak_kat "ZW_AEBG_FAK_KAT" VALUE 0x487cc a_174 100 LINEAR______0_000000__0H___1_883 0.0 1.0 BIT_MASK 0xffffffff /end CHARACTERISTIC
/begin CHARACTERISTIC zw_aebg_fak_kat2 "ZW_AEBG_FAK_KAT2" VALUE 0x487ce a_174 100 LINEAR______0_000000__0H___1_883 0.0 1.0 BIT_MASK 0xffffffff /end CHARACTERISTIC
/begin CHARACTERISTIC zw_aebg_kat "ZW_AEBG_KAT" VALUE 0x487d0 a_174 10 LINEAR______0_001460__1H___47884 0.00146 47.998501 BIT_MASK 0xffffffff /end CHARACTERISTIC
/begin CHARACTERISTIC zw_aebg_kup_swi_ll "ZW_AEBG_KUP_SWI_LL" VALUE 0x487d2 a_174 100 LINEAR______0_001465__1H___47_99 0.001465 47.99854 BIT_MASK 0xffffffff /end CHARACTERISTIC
/begin CHARACTERISTIC zw_aebg_tl_kat3 "ZW_AEBG_TL_KAT3" VALUE 0x487d4 a_174 100 LINEAR______0_001460__1H___47884 0.00146 47.998501 BIT_MASK 0xffffffff /end CHARACTERISTIC
/begin CHARACTERISTIC zw_as_0 "ZW_AS_1" VALUE 0xe5a5 a_175 5 LINEAR_______48_000000__FFFFFF80 -48.0 47.625 BIT_MASK 0xffffffff /end CHARACTERISTIC
/begin CHARACTERISTIC zw_as_1 "ZW_AS_5" VALUE 0xe5a6 a_175 5 LINEAR_______48_000000__FFFFFF80 -48.0 47.625 BIT_MASK 0xffffffff /end CHARACTERISTIC
/begin CHARACTERISTIC zw_as_2 "ZW_AS_3" VALUE 0xe5a7 a_175 5 LINEAR_______48_000000__FFFFFF80 -48.0 47.625 BIT_MASK 0xffffffff /end CHARACTERISTIC
/begin CHARACTERISTIC zw_as_3 "ZW_AS_6" VALUE 0xe5a8 a_175 5 LINEAR_______48_000000__FFFFFF80 -48.0 47.625 BIT_MASK 0xffffffff /end CHARACTERISTIC
/begin CHARACTERISTIC zw_as_4 "ZW_AS_2" VALUE 0xe5a9 a_175 5 LINEAR_______48_000000__FFFFFF80 -48.0 47.625 BIT_MASK 0xffffffff /end CHARACTERISTIC
/begin CHARACTERISTIC zw_as_5 "ZW_AS_4" VALUE 0xe5aa a_175 5 LINEAR_______48_000000__FFFFFF80 -48.0 47.625 BIT_MASK 0xffffffff /end CHARACTERISTIC
/begin CHARACTERISTIC zw_dif_max_lu "ZW_DIF_MAX_LU" VALUE 0x4840c a_173 5 LINEAR______0_000000__0H___95885 0.0 95.625 BIT_MASK 0xffffffff /end CHARACTERISTIC
/begin CHARACTERISTIC zw_inc_ad "ZW_INC_AD" VALUE 0x4840d a_173 100 LINEAR______0_000000__0H___6_886 0.0 6.0 BIT_MASK 0xffffffff /end CHARACTERISTIC
/begin CHARACTERISTIC zw_kat3_fak "ZW_KAT3_FAK" VALUE 0x4840e a_173 100 LINEAR______0_000000__0H___0_129 0.0 0.99599999 BIT_MASK 0xffffffff /end CHARACTERISTIC
/begin CHARACTERISTIC zw_kr_ad_max "ZW_KR_AD_MAX" VALUE 0x4840f a_173 10 LINEAR_______48_000000__0H___887 -48.0 0.0 BIT_MASK 0xffffffff /end CHARACTERISTIC
/begin CHARACTERISTIC zw_kr_dif_max_min "ZW_KR_DIF_MAX_MIN" VALUE 0x48410 a_173 10 LINEAR______0_000000__0H___48888 0.0 48.0 BIT_MASK 0xffffffff /end CHARACTERISTIC
/begin CHARACTERISTIC zw_kw_diag_inc "ZW_KW_DIAG_INC" VALUE 0x487d6 a_174 10 LINEAR______0_001460__1H___47168 0.00146 47.998501 BIT_MASK 0xffffffff /end CHARACTERISTIC
/begin CHARACTERISTIC zw_lm_aebg "ZW_LM_AEBG" VALUE 0x48411 a_173 5 LINEAR______5_440000__1H___1389_ 5.4400001 1389.0 BIT_MASK 0xffffffff /end CHARACTERISTIC
/begin CHARACTERISTIC zw_max_ad "ZW_MAX_AD" VALUE 0x48412 a_173 10 LINEAR_______48_000000__0H___0_0 -48.0 0.0 BIT_MASK 0xffffffff /end CHARACTERISTIC
/begin CHARACTERISTIC zw_min_ad "ZW_MIN_AD" VALUE 0x48413 a_173 10 LINEAR_______48_000000__0H___0_0 -48.0 0.0 BIT_MASK 0xffffffff /end CHARACTERISTIC
/begin CHARACTERISTIC zw_n_aebg "ZW_N_AEBG" VALUE 0x487d8 a_174 10 LINEAR______1_000000__1H___8160_ 1.0 8160.0 BIT_MASK 0xffffffff /end CHARACTERISTIC
/begin CHARACTERISTIC zw_tallfs_min_ll_aebg "ZW_TALLFS_MIN_LL_AEBG" VALUE 0x487da a_174 10 LINEAR______0_001460__1H___47168 0.00146 47.998501 BIT_MASK 0xffffffff /end CHARACTERISTIC
/begin CHARACTERISTIC zyka_ad_fr_kr "ZYKA_AD_FR_KR" VALUE 0x487dc a_174 1 LINEAR______0_000000__0H___65889 0.0 65535.0 BIT_MASK 0xffffffff /end CHARACTERISTIC
/begin CHARACTERISTIC zyka_ad_sp_kr "ZYKA_AD_SP_KR" VALUE 0x487de a_174 1 LINEAR______0_000000__0H___65889 0.0 65535.0 BIT_MASK 0xffffffff /end CHARACTERISTIC
/begin CHARACTERISTIC zyka_dyf_ll "ZYKA_DYF_LL" VALUE 0x48414 a_173 10 LINEAR______1_000000__1H___25890 1.0 255.0 BIT_MASK 0xffffffff /end CHARACTERISTIC
/begin CHARACTERISTIC zyka_hys_sa "ZYKA_HYS_SA" VALUE 0x487e0 a_174 1 LINEAR______0_000000__0H___65891 0.0 65535.0 BIT_MASK 0xffffffff /end CHARACTERISTIC
/begin CHARACTERISTIC zyka_hys_sa_st "ZYKA_HYS_SA_ST" VALUE 0x487e2 a_174 1 LINEAR______0_000000__0H___65891 0.0 65535.0 BIT_MASK 0xffffffff /end CHARACTERISTIC
/begin CHARACTERISTIC zyka_roz_fak "ZYKA_ROZ_FAK" VALUE 0x48415 a_173 5 LINEAR______1_000000__1H___255_0 1.0 255.0 BIT_MASK 0xffffffff /end CHARACTERISTIC
/begin CHARACTERISTIC zyka_zw_dif_lu "ZYKA_ZW_DIF_LU" VALUE 0x48416 a_173 5 LINEAR______0_000000__0H___25185 0.0 255.0 BIT_MASK 0xffffffff /end CHARACTERISTIC
/begin MEASUREMENT a_fgr "A_FGR" SWORD LINEAR_______7111_111000__FFFF80 2 2.0 -7111.111 7110.8941 BIT_MASK 0xffffffff /begin IF_DATA ASAP1B_ADDRESS KP_BLOB 0xe1ba /end IF_DATA /end MEASUREMENT
/begin MEASUREMENT abf "ABF" UWORD RANGE________ABF___1H__1H_______ 2 2.0 0 65535 BIT_MASK 0x800 /begin IF_DATA ASAP1B_ADDRESS KP_BLOB 0xfd3c /end IF_DATA /end MEASUREMENT
/begin MEASUREMENT abf_we "ABF_WE" UWORD RANGE_____00000010 2 2.0 0 65535 BIT_MASK 0x1800 /begin IF_DATA ASAP1B_ADDRESS KP_BLOB 0xfd3c /end IF_DATA /end MEASUREMENT
/begin MEASUREMENT ad_gmw_llfs "AD_GMW_LLFS" UWORD LINEAR______0_000000__0H___3_894 2 2.0 0.0 3.984375 BIT_MASK 0xffffffff /begin IF_DATA ASAP1B_ADDRESS KP_BLOB 0xe166 /end IF_DATA /end MEASUREMENT
/begin MEASUREMENT ad_llfs "AD_LLFS" UWORD LINEAR______0_000000__0H___3_894 2 2.0 0.0 3.984375 BIT_MASK 0xffffffff /begin IF_DATA ASAP1B_ADDRESS KP_BLOB 0xe168 /end IF_DATA /end MEASUREMENT
/begin MEASUREMENT ad_s "AD_S" UWORD RANGE________AD_S___1H__1H______ 2 2.0 0 65535 BIT_MASK 0x4 /begin IF_DATA ASAP1B_ADDRESS KP_BLOB 0xfd5e /end IF_DATA /end MEASUREMENT
/begin MEASUREMENT adaption_1 "ADAPTION_1" UBYTE RANGE________aktiv___1H__1H____p 2 2.0 0 255 BIT_MASK 0x8 /begin IF_DATA ASAP1B_ADDRESS KP_BLOB 0xe326 /end IF_DATA /end MEASUREMENT
/begin MEASUREMENT adaption_2 "ADAPTION_2" UBYTE RANGE________aktiv___1H__1H____p 2 2.0 0 255 BIT_MASK 0x8 /begin IF_DATA ASAP1B_ADDRESS KP_BLOB 0xe410 /end IF_DATA /end MEASUREMENT
/begin MEASUREMENT adaptk1_mz4 "Adaptionskreis 1" UWORD RANGE________aktiv___1H__1H__895 2 2.0 0 65535 BIT_MASK 0x400 /begin IF_DATA ASAP1B_ADDRESS KP_BLOB 0xfd42 /end IF_DATA /end MEASUREMENT
/begin MEASUREMENT adaptk2_mz4 "Adaption ROZ-Faktor" UWORD RANGE________aktiv___1H__1H__895 2 2.0 0 65535 BIT_MASK 0x800 /begin IF_DATA ASAP1B_ADDRESS KP_BLOB 0xfd42 /end IF_DATA /end MEASUREMENT
/begin MEASUREMENT add_adap_1_eingeschwungen "add_adap_1_eingeschwungen" UBYTE RANGE________JA___1H__1H____NEIN 2 2.0 0 255 BIT_MASK 0x80 /begin IF_DATA ASAP1B_ADDRESS KP_BLOB 0xe326 /end IF_DATA /end MEASUREMENT
/begin MEASUREMENT add_adap_2_eingeschwungen "add_adap_2_eingeschwungen" UBYTE RANGE________JA___1H__1H____NEIN 2 2.0 0 255 BIT_MASK 0x80 /begin IF_DATA ASAP1B_ADDRESS KP_BLOB 0xe410 /end IF_DATA /end MEASUREMENT
/begin MEASUREMENT anz_diag_fc "ANZ_DIAG_FC" UBYTE LINEAR______0_000000__0H___25142 2 2.0 0.0 255.0 BIT_MASK 0xffffffff /begin IF_DATA ASAP1B_ADDRESS KP_BLOB 0xc1d8 /end IF_DATA /end MEASUREMENT
/begin MEASUREMENT anz_diag_ramvanz_auss_b "ANZ_AUSS_B" UBYTE LINEAR______0_000000__0H___25142 2 2.0 0.0 255.0 BIT_MASK 0xffffffff /begin IF_DATA ASAP1B_ADDRESS KP_BLOB 0xc2ce /end IF_DATA /end MEASUREMENT
/begin MEASUREMENT anz_diag_ramvanz_diag_katw_1 "ANZ_DIAG_KATW_1" UBYTE LINEAR______0_000000__0H___25142 2 2.0 0.0 255.0 BIT_MASK 0xffffffff /begin IF_DATA ASAP1B_ADDRESS KP_BLOB 0xc2c8 /end IF_DATA /end MEASUREMENT
/begin MEASUREMENT anz_diag_ramvanz_diag_katw_2 "ANZ_DIAG_KATW_2" UBYTE LINEAR______0_000000__0H___25142 2 2.0 0.0 255.0 BIT_MASK 0xffffffff /begin IF_DATA ASAP1B_ADDRESS KP_BLOB 0xc2c9 /end IF_DATA /end MEASUREMENT
/begin MEASUREMENT anz_diag_ramvanz_diag_ldp "ANZ_DIAG_LDP" UBYTE LINEAR______0_000000__0H___25142 2 2.0 0.0 255.0 BIT_MASK 0xffffffff /begin IF_DATA ASAP1B_ADDRESS KP_BLOB 0xc2cd /end IF_DATA /end MEASUREMENT
/begin MEASUREMENT anz_diag_ramvanz_diag_sl_1 "ANZ_DIAG_SL_1" UBYTE LINEAR______0_000000__0H___25142 2 2.0 0.0 255.0 BIT_MASK 0xffffffff /begin IF_DATA ASAP1B_ADDRESS KP_BLOB 0xc2ca /end IF_DATA /end MEASUREMENT
/begin MEASUREMENT anz_diag_ramvanz_diag_sl_2 "ANZ_DIAG_SL_2" UBYTE LINEAR______0_000000__0H___25142 2 2.0 0.0 255.0 BIT_MASK 0xffffffff /begin IF_DATA ASAP1B_ADDRESS KP_BLOB 0xc2cb /end IF_DATA /end MEASUREMENT
/begin MEASUREMENT anz_ev_off_auss "ANZ_EV_OFF_AUSS" UBYTE LINEAR______0_000000__0H___25142 2 2.0 0.0 255.0 BIT_MASK 0xffffffff /begin IF_DATA ASAP1B_ADDRESS KP_BLOB 0xc20f /end IF_DATA /end MEASUREMENT
/begin MEASUREMENT anz_hfm "ANZ_HFM" UBYTE LINEAR______0_000000__0H___25896 2 2.0 0.0 255.0 BIT_MASK 0xffffffff /begin IF_DATA ASAP1B_ADDRESS KP_BLOB 0xc2d8 /end IF_DATA /end MEASUREMENT
/begin MEASUREMENT anz_hfm_diag "ANZ_HFM_DIAG" UBYTE LINEAR______0_000000__0H___25896 2 2.0 0.0 255.0 BIT_MASK 0xffffffff /begin IF_DATA ASAP1B_ADDRESS KP_BLOB 0xc2d9 /end IF_DATA /end MEASUREMENT
/begin MEASUREMENT anz_hz_gkk_rul "ANZ_HZ_GKK_RUL" UBYTE LINEAR______0_000000__0H___25142 2 2.0 0.0 255.0 BIT_MASK 0xffffffff /begin IF_DATA ASAP1B_ADDRESS KP_BLOB 0xc32f /end IF_DATA /end MEASUREMENT
/begin MEASUREMENT anz_mdk_dif_diag "ANZ_MDK_DIF_DIAG" UBYTE LINEAR______0_000000__0H___25182 2 2.0 0.0 255.0 BIT_MASK 0xffffffff /begin IF_DATA ASAP1B_ADDRESS KP_BLOB 0xc2fb /end IF_DATA /end MEASUREMENT
/begin MEASUREMENT anz_nw_ad_a "ANZ_NW_AD_A" UBYTE LINEAR______0_000000__0H___25142 2 2.0 0.0 255.0 BIT_MASK 0xffffffff /begin IF_DATA ASAP1B_ADDRESS KP_BLOB 0xc311 /end IF_DATA /end MEASUREMENT
/begin MEASUREMENT anz_nw_ad_e "ANZ_NW_AD_E" UBYTE LINEAR______0_000000__0H___25142 2 2.0 0.0 255.0 BIT_MASK 0xffffffff /begin IF_DATA ASAP1B_ADDRESS KP_BLOB 0xc309 /end IF_DATA /end MEASUREMENT
/begin MEASUREMENT anz_p_diag_slv "ANZ_P_DIAG_SLV" UBYTE LINEAR______0_000000__0H___25142 2 2.0 0.0 255.0 BIT_MASK 0xffffffff /begin IF_DATA ASAP1B_ADDRESS KP_BLOB 0xc337 /end IF_DATA /end MEASUREMENT
/begin MEASUREMENT anz_sa_auss "ANZ_SA_AUSS" UBYTE LINEAR______0_000000__0H___25142 2 2.0 0.0 255.0 BIT_MASK 0xffffffff /begin IF_DATA ASAP1B_ADDRESS KP_BLOB 0xc20e /end IF_DATA /end MEASUREMENT
/begin MEASUREMENT anz_tate_fc "ANZ_TATE_FC" UBYTE LINEAR______0_000000__0H___25142 2 2.0 0.0 255.0 BIT_MASK 0xffffffff /begin IF_DATA ASAP1B_ADDRESS KP_BLOB 0xc1d7 /end IF_DATA /end MEASUREMENT
/begin MEASUREMENT anz_tate_wst_ldp "ANZ_TATE_WST_LDP" UWORD LINEAR______0_000000__0H___171_3 2 2.0 0.0 171.33 BIT_MASK 0xffffffff /begin IF_DATA ASAP1B_ADDRESS KP_BLOB 0xcf0c /end IF_DATA /end MEASUREMENT
/begin MEASUREMENT anz_wst_ldp "ANZ_WST_LDP" UBYTE LINEAR______0_000000__0H___25142 2 2.0 0.0 255.0 BIT_MASK 0xffffffff /begin IF_DATA ASAP1B_ADDRESS KP_BLOB 0xc201 /end IF_DATA /end MEASUREMENT
/begin MEASUREMENT ar_aktiv "AR_AKTIV" UBYTE RANGE________AR___1H__1H________ 2 2.0 0 255 BIT_MASK 0x40 /begin IF_DATA ASAP1B_ADDRESS KP_BLOB 0xfd0f /end IF_DATA /end MEASUREMENT
/begin MEASUREMENT ar_trig "AR_TRIG" UBYTE LINEAR______0_000000__0H___25142 2 2.0 0.0 255.0 BIT_MASK 0xffffffff /begin IF_DATA ASAP1B_ADDRESS KP_BLOB 0xcdee /end IF_DATA /end MEASUREMENT
/begin MEASUREMENT ar_zw_abr "AR_ZW_ABR" UBYTE RANGE________AR_ABR___1H__1H____ 2 2.0 0 255 BIT_MASK 0x1 /begin IF_DATA ASAP1B_ADDRESS KP_BLOB 0xfd10 /end IF_DATA /end MEASUREMENT
/begin MEASUREMENT asc "ASC" UWORD RANGE________ASC___1H__1H_______ 2 2.0 0 65535 BIT_MASK 0x200 /begin IF_DATA ASAP1B_ADDRESS KP_BLOB 0xfd56 /end IF_DATA /end MEASUREMENT
/begin MEASUREMENT asc_iga_corr_active "ASC_IGA_CORR_ACTIVE" UBYTE RANGE________aktiv___1H__1H_____ 2 2.0 0 255 BIT_MASK 0x20 /begin IF_DATA ASAP1B_ADDRESS KP_BLOB 0xfd21 /end IF_DATA /end MEASUREMENT
/begin MEASUREMENT asc_iga_inv_dyn "DYN_ZW_EINGRIFF" UBYTE RANGE________aktiv___1H__1H_____ 2 2.0 0 255 BIT_MASK 0x8 /begin IF_DATA ASAP1B_ADDRESS KP_BLOB 0xfd21 /end IF_DATA /end MEASUREMENT
/begin MEASUREMENT asc_iga_inv_stat "STAT_ZW_EINGRIFF" UBYTE RANGE________aktiv___1H__1H_____ 2 2.0 0 255 BIT_MASK 0x10 /begin IF_DATA ASAP1B_ADDRESS KP_BLOB 0xfd21 /end IF_DATA /end MEASUREMENT
/begin MEASUREMENT auss_aC0D "AUSS_A_1" UWORD LINEAR______0_000000__0H___65163 2 2.0 0.0 65535.0 BIT_MASK 0xffffffff /begin IF_DATA ASAP1B_ADDRESS KP_BLOB 0xe288 /end IF_DATA /end MEASUREMENT
/begin MEASUREMENT auss_aC1D "AUSS_A_5" UWORD LINEAR______0_000000__0H___65163 2 2.0 0.0 65535.0 BIT_MASK 0xffffffff /begin IF_DATA ASAP1B_ADDRESS KP_BLOB 0xe28a /end IF_DATA /end MEASUREMENT
/begin MEASUREMENT auss_aC2D "AUSS_A_3" UWORD LINEAR______0_000000__0H___65163 2 2.0 0.0 65535.0 BIT_MASK 0xffffffff /begin IF_DATA ASAP1B_ADDRESS KP_BLOB 0xe28c /end IF_DATA /end MEASUREMENT
/begin MEASUREMENT auss_aC3D "AUSS_A_6" UWORD LINEAR______0_000000__0H___65163 2 2.0 0.0 65535.0 BIT_MASK 0xffffffff /begin IF_DATA ASAP1B_ADDRESS KP_BLOB 0xe28e /end IF_DATA /end MEASUREMENT
/begin MEASUREMENT auss_aC4D "AUSS_A_2" UWORD LINEAR______0_000000__0H___65163 2 2.0 0.0 65535.0 BIT_MASK 0xffffffff /begin IF_DATA ASAP1B_ADDRESS KP_BLOB 0xe290 /end IF_DATA /end MEASUREMENT
/begin MEASUREMENT auss_aC5D "AUSS_A_4" UWORD LINEAR______0_000000__0H___65163 2 2.0 0.0 65535.0 BIT_MASK 0xffffffff /begin IF_DATA ASAP1B_ADDRESS KP_BLOB 0xe292 /end IF_DATA /end MEASUREMENT
/begin MEASUREMENT auss_a_fenstervlm_ob "AUSS_A_FENSTER.LM_OB" UBYTE MAF_8_RES37 2 2.0 0.0 1389.0 BIT_MASK 0xffffffff /begin IF_DATA ASAP1B_ADDRESS KP_BLOB 0xc615 /end IF_DATA /end MEASUREMENT
/begin MEASUREMENT auss_a_fenstervlm_unt "AUSS_A_FENSTER.LM_UNT" UBYTE MAF_8_RES37 2 2.0 0.0 1389.0 BIT_MASK 0xffffffff /begin IF_DATA ASAP1B_ADDRESS KP_BLOB 0xc613 /end IF_DATA /end MEASUREMENT
/begin MEASUREMENT auss_a_fenstervn_32_ob "AUSS_A_FENSTER.N_32_OB" UBYTE ES_8_RES 2 2.0 0.0 8160.0 BIT_MASK 0xffffffff /begin IF_DATA ASAP1B_ADDRESS KP_BLOB 0xc614 /end IF_DATA /end MEASUREMENT
/begin MEASUREMENT auss_a_fenstervn_32_unt "AUSS_A_FENSTER.N_32_UNT" UBYTE ES_8_RES 2 2.0 0.0 8160.0 BIT_MASK 0xffffffff /begin IF_DATA ASAP1B_ADDRESS KP_BLOB 0xc612 /end IF_DATA /end MEASUREMENT
/begin MEASUREMENT auss_bC0D "AUSS_B_1" UWORD LINEAR______0_000000__0H___65163 2 2.0 0.0 65535.0 BIT_MASK 0xffffffff /begin IF_DATA ASAP1B_ADDRESS KP_BLOB 0xe294 /end IF_DATA /end MEASUREMENT
/begin MEASUREMENT auss_bC1D "AUSS_B_5" UWORD LINEAR______0_000000__0H___65163 2 2.0 0.0 65535.0 BIT_MASK 0xffffffff /begin IF_DATA ASAP1B_ADDRESS KP_BLOB 0xe296 /end IF_DATA /end MEASUREMENT
/begin MEASUREMENT auss_bC2D "AUSS_B_3" UWORD LINEAR______0_000000__0H___65163 2 2.0 0.0 65535.0 BIT_MASK 0xffffffff /begin IF_DATA ASAP1B_ADDRESS KP_BLOB 0xe298 /end IF_DATA /end MEASUREMENT
/begin MEASUREMENT auss_bC3D "AUSS_B_6" UWORD LINEAR______0_000000__0H___65163 2 2.0 0.0 65535.0 BIT_MASK 0xffffffff /begin IF_DATA ASAP1B_ADDRESS KP_BLOB 0xe29a /end IF_DATA /end MEASUREMENT
/begin MEASUREMENT auss_bC4D "AUSS_B_2" UWORD LINEAR______0_000000__0H___65163 2 2.0 0.0 65535.0 BIT_MASK 0xffffffff /begin IF_DATA ASAP1B_ADDRESS KP_BLOB 0xe29c /end IF_DATA /end MEASUREMENT
/begin MEASUREMENT auss_bC5D "AUSS_B_4" UWORD LINEAR______0_000000__0H___65163 2 2.0 0.0 65535.0 BIT_MASK 0xffffffff /begin IF_DATA ASAP1B_ADDRESS KP_BLOB 0xe29e /end IF_DATA /end MEASUREMENT
/begin MEASUREMENT auss_b_fenstervlm_ob "AUSS_B_FENSTER.LM_OB" UBYTE MAF_8_RES37 2 2.0 0.0 1389.0 BIT_MASK 0xffffffff /begin IF_DATA ASAP1B_ADDRESS KP_BLOB 0xc619 /end IF_DATA /end MEASUREMENT
/begin MEASUREMENT auss_b_fenstervlm_unt "AUSS_B_FENSTER.LM_UNT" UBYTE MAF_8_RES37 2 2.0 0.0 1389.0 BIT_MASK 0xffffffff /begin IF_DATA ASAP1B_ADDRESS KP_BLOB 0xc617 /end IF_DATA /end MEASUREMENT
/begin MEASUREMENT auss_b_fenstervn_32_ob "AUSS_B_FENSTER.N_32_OB" UBYTE ES_8_RES 2 2.0 0.0 8160.0 BIT_MASK 0xffffffff /begin IF_DATA ASAP1B_ADDRESS KP_BLOB 0xc618 /end IF_DATA /end MEASUREMENT
/begin MEASUREMENT auss_b_fenstervn_32_unt "AUSS_B_FENSTER.N_32_UNT" UBYTE ES_8_RES 2 2.0 0.0 8160.0 BIT_MASK 0xffffffff /begin IF_DATA ASAP1B_ADDRESS KP_BLOB 0xc616 /end IF_DATA /end MEASUREMENT
/begin MEASUREMENT auss_b_sum "AUSS_B_SUM" UWORD LINEAR______0_000000__0H___65163 2 2.0 0.0 65535.0 BIT_MASK 0xffffffff /begin IF_DATA ASAP1B_ADDRESS KP_BLOB 0xe2ac /end IF_DATA /end MEASUREMENT
/begin MEASUREMENT aussetz_erkvlongword "AUSSETZ_ERK" ULONG UNSIGNED_LONG 2 2.0 0.0 4.2949673e+009 BIT_MASK 0xffffffff /begin IF_DATA ASAP1B_ADDRESS KP_BLOB 0xe2b4 /end IF_DATA /end MEASUREMENT
/begin MEASUREMENT aussetz_tabC0D "AUSSETZ_TAB_1" UWORD LINEAR______0_000000__0H___65163 2 2.0 0.0 65535.0 BIT_MASK 0xffffffff /begin IF_DATA ASAP1B_ADDRESS KP_BLOB 0xe2a0 /end IF_DATA /end MEASUREMENT
/begin MEASUREMENT aussetz_tabC1D "AUSSETZ_TAB_5" UWORD LINEAR______0_000000__0H___65163 2 2.0 0.0 65535.0 BIT_MASK 0xffffffff /begin IF_DATA ASAP1B_ADDRESS KP_BLOB 0xe2a2 /end IF_DATA /end MEASUREMENT
/begin MEASUREMENT aussetz_tabC2D "AUSSETZ_TAB_3" UWORD LINEAR______0_000000__0H___65163 2 2.0 0.0 65535.0 BIT_MASK 0xffffffff /begin IF_DATA ASAP1B_ADDRESS KP_BLOB 0xe2a4 /end IF_DATA /end MEASUREMENT
/begin MEASUREMENT aussetz_tabC3D "AUSSETZ_TAB_6" UWORD LINEAR______0_000000__0H___65163 2 2.0 0.0 65535.0 BIT_MASK 0xffffffff /begin IF_DATA ASAP1B_ADDRESS KP_BLOB 0xe2a6 /end IF_DATA /end MEASUREMENT
/begin MEASUREMENT aussetz_tabC4D "AUSSETZ_TAB_2" UWORD LINEAR______0_000000__0H___65163 2 2.0 0.0 65535.0 BIT_MASK 0xffffffff /begin IF_DATA ASAP1B_ADDRESS KP_BLOB 0xe2a8 /end IF_DATA /end MEASUREMENT
/begin MEASUREMENT aussetz_tabC5D "AUSSETZ_TAB_4" UWORD LINEAR______0_000000__0H___65163 2 2.0 0.0 65535.0 BIT_MASK 0xffffffff /begin IF_DATA ASAP1B_ADDRESS KP_BLOB 0xe2aa /end IF_DATA /end MEASUREMENT
/begin MEASUREMENT aussetz_zyl_0 "AUSSETZ_ZYL_1" UBYTE RANGE________JA___1H__1H____NEIN 2 2.0 0 255 BIT_MASK 0x1 /begin IF_DATA ASAP1B_ADDRESS KP_BLOB 0xc60d /end IF_DATA /end MEASUREMENT
/begin MEASUREMENT aussetz_zyl_1 "AUSSETZ_ZYL_5" UBYTE RANGE________JA___1H__1H____NEIN 2 2.0 0 255 BIT_MASK 0x2 /begin IF_DATA ASAP1B_ADDRESS KP_BLOB 0xc60d /end IF_DATA /end MEASUREMENT
/begin MEASUREMENT aussetz_zyl_2 "AUSSETZ_ZYL_3" UBYTE RANGE________JA___1H__1H____NEIN 2 2.0 0 255 BIT_MASK 0x4 /begin IF_DATA ASAP1B_ADDRESS KP_BLOB 0xc60d /end IF_DATA /end MEASUREMENT
/begin MEASUREMENT aussetz_zyl_3 "AUSSETZ_ZYL_6" UBYTE RANGE________JA___1H__1H____NEIN 2 2.0 0 255 BIT_MASK 0x8 /begin IF_DATA ASAP1B_ADDRESS KP_BLOB 0xc60d /end IF_DATA /end MEASUREMENT
/begin MEASUREMENT aussetz_zyl_4 "AUSSETZ_ZYL_2" UBYTE RANGE________JA___1H__1H____NEIN 2 2.0 0 255 BIT_MASK 0x10 /begin IF_DATA ASAP1B_ADDRESS KP_BLOB 0xc60d /end IF_DATA /end MEASUREMENT
/begin MEASUREMENT aussetz_zyl_5 "AUSSETZ_ZYL_4" UBYTE RANGE________JA___1H__1H____NEIN 2 2.0 0 255 BIT_MASK 0x20 /begin IF_DATA ASAP1B_ADDRESS KP_BLOB 0xc60d /end IF_DATA /end MEASUREMENT
/begin MEASUREMENT bdyn_kat_1 "BDYN_KAT_1" UBYTE RANGE________JA___1H__1H____NEIN 2 2.0 0 255 BIT_MASK 0x1 /begin IF_DATA ASAP1B_ADDRESS KP_BLOB 0xc1e5 /end IF_DATA /end MEASUREMENT
/begin MEASUREMENT bdyn_kat_2 "BDYN_KAT_2" UBYTE RANGE________JA___1H__1H____NEIN 2 2.0 0 255 BIT_MASK 0x2 /begin IF_DATA ASAP1B_ADDRESS KP_BLOB 0xc1e5 /end IF_DATA /end MEASUREMENT
/begin MEASUREMENT bdyn_zust1_sam "" UBYTE LINEAR______0_000000__0H___25147 2 2.0 0.0 255.0 BIT_MASK 0xffffffff /begin IF_DATA ASAP1B_ADDRESS KP_BLOB 0xc1e5 /end IF_DATA /end MEASUREMENT
/begin MEASUREMENT bed_kat_diag_1 "BED_KAT_DIAG_1" UWORD RANGE________JA___1H__1H____N897 2 2.0 0 65535 BIT_MASK 0x4 /begin IF_DATA ASAP1B_ADDRESS KP_BLOB 0xe34a /end IF_DATA /end MEASUREMENT
/begin MEASUREMENT bed_kat_diag_2 "BED_KAT_DIAG_2" UWORD RANGE________JA___1H__1H____N897 2 2.0 0 65535 BIT_MASK 0x4 /begin IF_DATA ASAP1B_ADDRESS KP_BLOB 0xe434 /end IF_DATA /end MEASUREMENT
/begin MEASUREMENT bed_sl_diag "BED_SL_DIAG" UWORD RANGE________0___0H__0H____1___1 2 2.0 0 65535 BIT_MASK 0x200 /begin IF_DATA ASAP1B_ADDRESS KP_BLOB 0xfd68 /end IF_DATA /end MEASUREMENT
/begin MEASUREMENT bed_slv_diag_schw "BED_SLV_DIAG_SCHW" UWORD RANGE________0___0H__0H____1___1 2 2.0 0 65535 BIT_MASK 0x4000 /begin IF_DATA ASAP1B_ADDRESS KP_BLOB 0xfd68 /end IF_DATA /end MEASUREMENT
/begin MEASUREMENT bed_t_diag_sl "BED_T_DIAG_SL" UWORD RANGE________0___0H__0H____1___1 2 2.0 0 65535 BIT_MASK 0x400 /begin IF_DATA ASAP1B_ADDRESS KP_BLOB 0xfd68 /end IF_DATA /end MEASUREMENT
/begin MEASUREMENT begr_dyn_lam1 "BEGR_DYN_LAM1" UBYTE RANGE________passiv___0H__0H____ 2 2.0 0 255 BIT_MASK 0x4 /begin IF_DATA ASAP1B_ADDRESS KP_BLOB 0xe327 /end IF_DATA /end MEASUREMENT
/begin MEASUREMENT begr_dyn_lam2 "BEGR_DYN_LAM2" UBYTE RANGE________passiv___0H__0H____ 2 2.0 0 255 BIT_MASK 0x4 /begin IF_DATA ASAP1B_ADDRESS KP_BLOB 0xe411 /end IF_DATA /end MEASUREMENT
/begin MEASUREMENT begr_dyn_lammw_zv_1 "BEGR_DYN_LAMMW_ZV_1" UWORD RANGE________passiv___0H__0H_898 2 2.0 0 65535 BIT_MASK 0x1000 /begin IF_DATA ASAP1B_ADDRESS KP_BLOB 0xe34a /end IF_DATA /end MEASUREMENT
/begin MEASUREMENT begr_dyn_lammw_zv_2 "BEGR_DYN_LAMMW_ZV_2" UWORD RANGE________passiv___0H__0H_898 2 2.0 0 65535 BIT_MASK 0x1000 /begin IF_DATA ASAP1B_ADDRESS KP_BLOB 0xe434 /end IF_DATA /end MEASUREMENT
/begin MEASUREMENT begr_dyn_lm_zv "BEGR_DYN_LM_ZV" UWORD RANGE________passiv___0H__0H_899 2 2.0 0 65535 BIT_MASK 0x200 /begin IF_DATA ASAP1B_ADDRESS KP_BLOB 0xfd48 /end IF_DATA /end MEASUREMENT
/begin MEASUREMENT begr_dyn_n_lm1 "BEGR_DYN_N_LM1" UBYTE RANGE________passiv___0H__0H_900 2 2.0 0 255 BIT_MASK 0x8 /begin IF_DATA ASAP1B_ADDRESS KP_BLOB 0xe327 /end IF_DATA /end MEASUREMENT
/begin MEASUREMENT begr_dyn_n_lm2 "BEGR_DYN_N_LM2" UBYTE RANGE________passiv___0H__0H_900 2 2.0 0 255 BIT_MASK 0x8 /begin IF_DATA ASAP1B_ADDRESS KP_BLOB 0xe411 /end IF_DATA /end MEASUREMENT
/begin MEASUREMENT begr_dyn_n_zv "BEGR_DYN_N_ZV" UWORD RANGE________passiv___0H__0H_901 2 2.0 0 65535 BIT_MASK 0x4 /begin IF_DATA ASAP1B_ADDRESS KP_BLOB 0xfd48 /end IF_DATA /end MEASUREMENT
/begin MEASUREMENT beladung "Beladungsermittlung" UWORD RANGE________Beladungsermittlung 2 2.0 0 65535 BIT_MASK 0x8 /begin IF_DATA ASAP1B_ADDRESS KP_BLOB 0xfd4c /end IF_DATA /end MEASUREMENT
/begin MEASUREMENT bergabfahrt "Bergabfahrt" UWORD RANGE________JA___1H__1H____N902 2 2.0 0 65535 BIT_MASK 0x200 /begin IF_DATA ASAP1B_ADDRESS KP_BLOB 0xfd78 /end IF_DATA /end MEASUREMENT
/begin MEASUREMENT bsz "BSZ" UWORD LINEAR______0_000000__0H___65903 2 2.0 0.0 6553.5 BIT_MASK 0xffffffff /begin IF_DATA ASAP1B_ADDRESS KP_BLOB 0xce94 /end IF_DATA /end MEASUREMENT
/begin MEASUREMENT carb "CARBFEHLER" UWORD RANGE____________0H__0H____CARB_ 2 2.0 0 65535 BIT_MASK 0x2 /begin IF_DATA ASAP1B_ADDRESS KP_BLOB 0xfd42 /end IF_DATA /end MEASUREMENT
/begin MEASUREMENT cnt_imm "CNT_IMM" UBYTE LINEAR______0_000000__0H___25182 2 2.0 0.0 255.0 BIT_MASK 0xffffffff /begin IF_DATA ASAP1B_ADDRESS KP_BLOB 0xf915 /end IF_DATA /end MEASUREMENT
/begin MEASUREMENT cru_active "FGR" UWORD RANGE________aktiv___1H__1H__895 2 2.0 0 65535 BIT_MASK 0x80 /begin IF_DATA ASAP1B_ADDRESS KP_BLOB 0xfd60 /end IF_DATA /end MEASUREMENT
/begin MEASUREMENT cru_diag_main_swi "FGR_SWI" UWORD RANGE________AN___1H__1H____AUS_ 2 2.0 0 65535 BIT_MASK 0x8 /begin IF_DATA ASAP1B_ADDRESS KP_BLOB 0xfd60 /end IF_DATA /end MEASUREMENT
/begin MEASUREMENT cru_diag_vplaus "FGR_V_ERROR" UWORD RANGE________vorhanden___1H__1H_ 2 2.0 0 65535 BIT_MASK 0x40 /begin IF_DATA ASAP1B_ADDRESS KP_BLOB 0xfd60 /end IF_DATA /end MEASUREMENT
/begin MEASUREMENT cru_fatal_err "FGR_ERROR" UWORD RANGE________vorhanden___1H__1H_ 2 2.0 0 65535 BIT_MASK 0x1 /begin IF_DATA ASAP1B_ADDRESS KP_BLOB 0xfd60 /end IF_DATA /end MEASUREMENT
/begin MEASUREMENT cru_flags "" UWORD LINEAR______0_000000__0H___65904 2 2.0 0.0 65535.0 BIT_MASK 0xffffffff /begin IF_DATA ASAP1B_ADDRESS KP_BLOB 0xfd60 /end IF_DATA /end MEASUREMENT
/begin MEASUREMENT cru_overt_active "FGR_UEBERHOL" UWORD RANGE________aktiv___1H__1H__895 2 2.0 0 65535 BIT_MASK 0x4 /begin IF_DATA ASAP1B_ADDRESS KP_BLOB 0xfd60 /end IF_DATA /end MEASUREMENT
/begin MEASUREMENT cru_request "" UBYTE LINEAR______0_000000__0H___25905 2 2.0 0.0 255.0 BIT_MASK 0xffffffff /begin IF_DATA ASAP1B_ADDRESS KP_BLOB 0xce0d /end IF_DATA /end MEASUREMENT
/begin MEASUREMENT cru_request_sams "FGR_ANF" UBYTE FGR_RANGE 2 2.0 0 255 BIT_MASK 0xf /begin IF_DATA ASAP1B_ADDRESS KP_BLOB 0xce0d /end IF_DATA /end MEASUREMENT
/begin MEASUREMENT cru_set_point_sams "FGR_FKT" UBYTE CRU_SET_POINT_RANGE 2 2.0 0 255 BIT_MASK 0x7 /begin IF_DATA ASAP1B_ADDRESS KP_BLOB 0xce10 /end IF_DATA /end MEASUREMENT
/begin MEASUREMENT cru_set_point_state "" UBYTE LINEAR______0_000000__0H___25905 2 2.0 0.0 255.0 BIT_MASK 0xffffffff /begin IF_DATA ASAP1B_ADDRESS KP_BLOB 0xce10 /end IF_DATA /end MEASUREMENT
/begin MEASUREMENT cru_vlimit_active "V_BEG_FGR" UWORD RANGE________aktiv___1H__1H__895 2 2.0 0 65535 BIT_MASK 0x2 /begin IF_DATA ASAP1B_ADDRESS KP_BLOB 0xfd60 /end IF_DATA /end MEASUREMENT
/begin MEASUREMENT ctr_t_ks2_bk1 "CTR_T_KS2_BK1" UBYTE LINEAR______0_000000__0H___25108 2 2.0 0.0 255.0 BIT_MASK 0xffffffff /begin IF_DATA ASAP1B_ADDRESS KP_BLOB 0xc198 /end IF_DATA /end MEASUREMENT
/begin MEASUREMENT ctr_t_ks2_bk2 "CTR_T_KS2_BK2" UBYTE LINEAR______0_000000__0H___25108 2 2.0 0.0 255.0 BIT_MASK 0xffffffff /begin IF_DATA ASAP1B_ADDRESS KP_BLOB 0xc199 /end IF_DATA /end MEASUREMENT
/begin MEASUREMENT delta_tn_korr_lu_ad "DELTA_TN_KORR_LU_AD" UWORD LINEAR______0_000000__0H___1_906 2 2.0 0.0 1.0 BIT_MASK 0xffffffff /begin IF_DATA ASAP1B_ADDRESS KP_BLOB 0xe2ee /end IF_DATA /end MEASUREMENT
/begin MEASUREMENT diag "DIAGFEHLER" UWORD RANGE____________0H__0H____DIAG_ 2 2.0 0 65535 BIT_MASK 0x1 /begin IF_DATA ASAP1B_ADDRESS KP_BLOB 0xfd42 /end IF_DATA /end MEASUREMENT
/begin MEASUREMENT diag_stat_kr "DIAG_STAT__KR" UBYTE LINEAR______0_000000__0H___25907 2 2.0 0.0 255.0 BIT_MASK 0xffffffff /begin IF_DATA ASAP1B_ADDRESS KP_BLOB 0xcdeb /end IF_DATA /end MEASUREMENT
/begin MEASUREMENT diag_tev_flags "DIAG_TEV_FLAGS" UWORD LINEAR______0_000000__0H___65163 2 2.0 0.0 65535.0 BIT_MASK 0xffffffff /begin IF_DATA ASAP1B_ADDRESS KP_BLOB 0xfd50 /end IF_DATA /end MEASUREMENT
/begin MEASUREMENT diag_tldp_flags "" UWORD LINEAR______0_000000__0H___65904 2 2.0 0.0 65535.0 BIT_MASK 0xffffffff /begin IF_DATA ASAP1B_ADDRESS KP_BLOB 0xfd78 /end IF_DATA /end MEASUREMENT
/begin MEASUREMENT dk "DK-Winkel" UBYTE PVS_NORM_8_RES908 2 2.0 0.0 119.5 BIT_MASK 0xffffffff /begin IF_DATA ASAP1B_ADDRESS KP_BLOB 0xc5f6 /end IF_DATA /end MEASUREMENT
/begin MEASUREMENT dk_abst "DK_ABST" UWORD MTC_NORM_16_RES 2 2.0 0.0 119.99817 BIT_MASK 0xffffffff /begin IF_DATA ASAP1B_ADDRESS KP_BLOB 0xe0ea /end IF_DATA /end MEASUREMENT
/begin MEASUREMENT dk_ek_wgC0D "DK_EK_WG[0]" SWORD LINEAR_______3840_020000__FF8000 2 2.0 -3840.02 3840.02 BIT_MASK 0xffffffff /begin IF_DATA ASAP1B_ADDRESS KP_BLOB 0xfae8 /end IF_DATA /end MEASUREMENT
/begin MEASUREMENT dk_grd "DK_GRD" UWORD LINEAR______0_000000__0H___29909 2 2.0 0.0 2988.0 BIT_MASK 0xffffffff /begin IF_DATA ASAP1B_ADDRESS KP_BLOB 0xfaaa /end IF_DATA /end MEASUREMENT
/begin MEASUREMENT dk_stat "" UWORD LINEAR______0_000000__0H___65904 2 2.0 0.0 65535.0 BIT_MASK 0xffffffff /begin IF_DATA ASAP1B_ADDRESS KP_BLOB 0xfd56 /end IF_DATA /end MEASUREMENT
/begin MEASUREMENT dmdk "DMDK" UWORD MTC_NORM_16_RES51 2 2.0 0.0 119.99817 BIT_MASK 0xffffffff /begin IF_DATA ASAP1B_ADDRESS KP_BLOB 0xfab0 /end IF_DATA /end MEASUREMENT
/begin MEASUREMENT dmdk_max_ad "DMDK_MAX_AD" UWORD MTC_NORM_16_RES 2 2.0 0.0 119.99817 BIT_MASK 0xffffffff /begin IF_DATA ASAP1B_ADDRESS KP_BLOB 0xe0ec /end IF_DATA /end MEASUREMENT
/begin MEASUREMENT dp "Schließdauer" UWORD TI_BAS_16_RES910 2 2.0 0.0 262.14 BIT_MASK 0xffffffff /begin IF_DATA ASAP1B_ADDRESS KP_BLOB 0xfbd6 /end IF_DATA /end MEASUREMENT
/begin MEASUREMENT dp_mpl "SCHLIESSZEIT_FF" UWORD LINEAR______0_000000__0H___26911 2 2.0 0.0 262.144 BIT_MASK 0xffffffff /begin IF_DATA ASAP1B_ADDRESS KP_BLOB 0xfbdc /end IF_DATA /end MEASUREMENT
/begin MEASUREMENT drehz_d_mz4 "Drehzahldynamik" UWORD RANGE________aktiv___1H__1H__895 2 2.0 0 65535 BIT_MASK 0x100 /begin IF_DATA ASAP1B_ADDRESS KP_BLOB 0xfd42 /end IF_DATA /end MEASUREMENT
/begin MEASUREMENT drehzahl "Drehzahl" UWORD IS_13_RES78 2 2.0 0.0 8160.0 BIT_MASK 0xffffffff /begin IF_DATA ASAP1B_ADDRESS KP_BLOB 0xfa20 /end IF_DATA /end MEASUREMENT
/begin MEASUREMENT dummy "" UBYTE LINEAR______0_000000__0H___25912 2 2.0 0.0 255.0 BIT_MASK 0xffffffff /begin IF_DATA ASAP1B_ADDRESS KP_BLOB 0xc33a /end IF_DATA /end MEASUREMENT
/begin MEASUREMENT dyn_limit "Begr.Dynamik" UWORD RANGE________aktiv___1H__1H__913 2 2.0 0 65535 BIT_MASK 0x4000 /begin IF_DATA ASAP1B_ADDRESS KP_BLOB 0xfd5a /end IF_DATA /end MEASUREMENT
/begin MEASUREMENT epz_bls_ctr "EPZ_BLS" UBYTE LINEAR______0_000000__0H___25182 2 2.0 0.0 255.0 BIT_MASK 0xffffffff /begin IF_DATA ASAP1B_ADDRESS KP_BLOB 0xc1dd /end IF_DATA /end MEASUREMENT
/begin MEASUREMENT epz_bts_ctr "EPZ_BTS" SBYTE LINEAR_______128_000000__FFFF914 2 2.0 -128.0 127.0 BIT_MASK 0xffffffff /begin IF_DATA ASAP1B_ADDRESS KP_BLOB 0xc1df /end IF_DATA /end MEASUREMENT
/begin MEASUREMENT epz_ctoc "EPZ_CTOC" UBYTE LINEAR______0_000000__0H___25185 2 2.0 0.0 255.0 BIT_MASK 0xffffffff /begin IF_DATA ASAP1B_ADDRESS KP_BLOB 0xc207 /end IF_DATA /end MEASUREMENT
/begin MEASUREMENT epz_mdk_mech "EPZ_MDK_MECH" UBYTE LINEAR______0_000000__0H___25182 2 2.0 0.0 255.0 BIT_MASK 0xffffffff /begin IF_DATA ASAP1B_ADDRESS KP_BLOB 0xc2e7 /end IF_DATA /end MEASUREMENT
/begin MEASUREMENT epz_mdk_mech_lm "EPZ_MDK_MECH_LM" UBYTE LINEAR______0_000000__0H___25182 2 2.0 0.0 255.0 BIT_MASK 0xffffffff /begin IF_DATA ASAP1B_ADDRESS KP_BLOB 0xc2e8 /end IF_DATA /end MEASUREMENT
/begin MEASUREMENT epz_tamdk_ctr "EPZ_TAMDK_CTR" UBYTE LINEAR______0_000000__0H___25182 2 2.0 0.0 255.0 BIT_MASK 0xffffffff /begin IF_DATA ASAP1B_ADDRESS KP_BLOB 0xc2e1 /end IF_DATA /end MEASUREMENT
/begin MEASUREMENT ev_off_count_luC0D "EV_OFF_COUNT_LU_1" UBYTE LINEAR______0_000000__0H___25142 2 2.0 0.0 255.0 BIT_MASK 0xffffffff /begin IF_DATA ASAP1B_ADDRESS KP_BLOB 0xc606 /end IF_DATA /end MEASUREMENT
/begin MEASUREMENT ev_off_count_luC1D "EV_OFF_COUNT_LU_5" UBYTE LINEAR______0_000000__0H___25142 2 2.0 0.0 255.0 BIT_MASK 0xffffffff /begin IF_DATA ASAP1B_ADDRESS KP_BLOB 0xc607 /end IF_DATA /end MEASUREMENT
/begin MEASUREMENT ev_off_count_luC2D "EV_OFF_COUNT_LU_3" UBYTE LINEAR______0_000000__0H___25142 2 2.0 0.0 255.0 BIT_MASK 0xffffffff /begin IF_DATA ASAP1B_ADDRESS KP_BLOB 0xc608 /end IF_DATA /end MEASUREMENT
/begin MEASUREMENT ev_off_count_luC3D "EV_OFF_COUNT_LU_6" UBYTE LINEAR______0_000000__0H___25142 2 2.0 0.0 255.0 BIT_MASK 0xffffffff /begin IF_DATA ASAP1B_ADDRESS KP_BLOB 0xc609 /end IF_DATA /end MEASUREMENT
/begin MEASUREMENT ev_off_count_luC4D "EV_OFF_COUNT_LU_2" UBYTE LINEAR______0_000000__0H___25142 2 2.0 0.0 255.0 BIT_MASK 0xffffffff /begin IF_DATA ASAP1B_ADDRESS KP_BLOB 0xc60a /end IF_DATA /end MEASUREMENT
/begin MEASUREMENT ev_off_count_luC5D "EV_OFF_COUNT_LU_4" UBYTE LINEAR______0_000000__0H___25142 2 2.0 0.0 255.0 BIT_MASK 0xffffffff /begin IF_DATA ASAP1B_ADDRESS KP_BLOB 0xc60b /end IF_DATA /end MEASUREMENT
/begin MEASUREMENT f_anz "Anzahl der Fehler im FSP" UBYTE LINEAR______0_000000__0H___25142 2 2.0 0.0 255.0 BIT_MASK 0xffffffff /begin IF_DATA ASAP1B_ADDRESS KP_BLOB 0xc61b /end IF_DATA /end MEASUREMENT
/begin MEASUREMENT fak_kup_swi_t "FAK_KUP_SWI_T" UWORD LINEAR______0_000000__0H___1_809 2 2.0 0.0 1.0 BIT_MASK 0xffffffff /begin IF_DATA ASAP1B_ADDRESS KP_BLOB 0xe104 /end IF_DATA /end MEASUREMENT
/begin MEASUREMENT fak_md_egs "FAK_MD_EGS" UWORD LINEAR______0_000000__0H___99915 2 2.0 0.0 99.998474 BIT_MASK 0xffffffff /begin IF_DATA ASAP1B_ADDRESS KP_BLOB 0xfb24 /end IF_DATA /end MEASUREMENT
/begin MEASUREMENT fak_md_kat "FAK_MD_KAT" UWORD LINEAR______0_000000__0H___0_918 2 2.0 0.0 0.99998474 BIT_MASK 0xffffffff /begin IF_DATA ASAP1B_ADDRESS KP_BLOB 0xfb30 /end IF_DATA /end MEASUREMENT
/begin MEASUREMENT fak_md_mdk "FAK_MD_MDK" UWORD LINEAR______0_000000__0H___6400_ 2 2.0 0.0 6400.0 BIT_MASK 0xffffffff /begin IF_DATA ASAP1B_ADDRESS KP_BLOB 0xfb26 /end IF_DATA /end MEASUREMENT
/begin MEASUREMENT fak_md_mdk_ges "FAK_MD_MDK_GES" UWORD LINEAR______0_000000__0H___6400_ 2 2.0 0.0 6400.0 BIT_MASK 0xffffffff /begin IF_DATA ASAP1B_ADDRESS KP_BLOB 0xfb2c /end IF_DATA /end MEASUREMENT
/begin MEASUREMENT fak_md_mdk_kor "FAK_MD_MDK_KOR" UWORD LINEAR______0_000000__0H___6400_ 2 2.0 0.0 6400.0 BIT_MASK 0xffffffff /begin IF_DATA ASAP1B_ADDRESS KP_BLOB 0xfb28 /end IF_DATA /end MEASUREMENT
/begin MEASUREMENT fak_md_mdk_lm "FAK_MD_MDK_LM" UWORD LINEAR______0_000000__0H___6400_ 2 2.0 0.0 6400.0 BIT_MASK 0xffffffff /begin IF_DATA ASAP1B_ADDRESS KP_BLOB 0xfb2a /end IF_DATA /end MEASUREMENT
/begin MEASUREMENT fak_md_mdk_min "FAK_MD_MDK_MIN" UWORD LINEAR______0_000000__0H___6400_ 2 2.0 0.0 6400.0 BIT_MASK 0xffffffff /begin IF_DATA ASAP1B_ADDRESS KP_BLOB 0xfb2e /end IF_DATA /end MEASUREMENT
/begin MEASUREMENT fak_md_zw_asc "FAK_MD_ZW_ASC" UWORD LINEAR______0_000000__0H___99915 2 2.0 0.0 99.998474 BIT_MASK 0xffffffff /begin IF_DATA ASAP1B_ADDRESS KP_BLOB 0xfb22 /end IF_DATA /end MEASUREMENT
/begin MEASUREMENT fak_pu "FAK_PU" UWORD LINEAR______0_000000__0H___2_916 2 2.0 0.0 2.0 BIT_MASK 0xffffffff /begin IF_DATA ASAP1B_ADDRESS KP_BLOB 0xfa34 /end IF_DATA /end MEASUREMENT
/begin MEASUREMENT fak_te "FAK_TE" UWORD LINEAR______0_000000__0H___0_955 2 2.0 0.0 0.99998474 BIT_MASK 0xffffffff /begin IF_DATA ASAP1B_ADDRESS KP_BLOB 0xe222 /end IF_DATA /end MEASUREMENT
/begin MEASUREMENT fak_zw_mdz "FAK_ZW_MDZ" UWORD LINEAR______0_000000__0H___99915 2 2.0 0.0 99.998474 BIT_MASK 0xffffffff /begin IF_DATA ASAP1B_ADDRESS KP_BLOB 0xfb1e /end IF_DATA /end MEASUREMENT
/begin MEASUREMENT fak_zw_mdz_ne "FAK_ZW_MDZ_NE" UWORD LINEAR______0_000000__0H___99915 2 2.0 0.0 99.998474 BIT_MASK 0xffffffff /begin IF_DATA ASAP1B_ADDRESS KP_BLOB 0xfb20 /end IF_DATA /end MEASUREMENT
/begin MEASUREMENT fs "FS" UWORD RANGE________FS___1H__1H________ 2 2.0 0 65535 BIT_MASK 0x100 /begin IF_DATA ASAP1B_ADDRESS KP_BLOB 0xfd3e /end IF_DATA /end MEASUREMENT
/begin MEASUREMENT fwl "FWL" UWORD RANGE________FWL___1H__1H_______ 2 2.0 0 65535 BIT_MASK 0x80 /begin IF_DATA ASAP1B_ADDRESS KP_BLOB 0xfd3c /end IF_DATA /end MEASUREMENT
/begin MEASUREMENT g_beg "G_BEG" UWORD RANGE________G_BEG___1H__1H_____ 2 2.0 0 65535 BIT_MASK 0x4000 /begin IF_DATA ASAP1B_ADDRESS KP_BLOB 0xfd3c /end IF_DATA /end MEASUREMENT
/begin MEASUREMENT gang "GANG" UBYTE LINEAR______0_000000__0H___6_917 2 2.0 0.0 6.0 BIT_MASK 0xffffffff /begin IF_DATA ASAP1B_ADDRESS KP_BLOB 0xc361 /end IF_DATA /end MEASUREMENT
/begin MEASUREMENT gang_ak "GANG_AK" UBYTE LINEAR______0_000000__0H___6_917 2 2.0 0.0 6.0 BIT_MASK 0xffffffff /begin IF_DATA ASAP1B_ADDRESS KP_BLOB 0xc362 /end IF_DATA /end MEASUREMENT
/begin MEASUREMENT gang_ar "GANG_AR" UBYTE LINEAR______0_000000__0H___6_917 2 2.0 0.0 6.0 BIT_MASK 0xffffffff /begin IF_DATA ASAP1B_ADDRESS KP_BLOB 0xc363 /end IF_DATA /end MEASUREMENT
/begin MEASUREMENT gang_inf "GANG_INF" UBYTE LINEAR______0_000000__0H___7_918 2 2.0 0.0 7.0 BIT_MASK 0xffffffff /begin IF_DATA ASAP1B_ADDRESS KP_BLOB 0xc360 /end IF_DATA /end MEASUREMENT
/begin MEASUREMENT gang_inf_txt "GANG_INF_TXT" UBYTE GANG_INF 2 2.0 0 255 BIT_MASK 0x7 /begin IF_DATA ASAP1B_ADDRESS KP_BLOB 0xc360 /end IF_DATA /end MEASUREMENT
/begin MEASUREMENT gang_txt "GANG_TXT" UBYTE GANG_CONV 2 2.0 0 255 BIT_MASK 0x7 /begin IF_DATA ASAP1B_ADDRESS KP_BLOB 0xc361 /end IF_DATA /end MEASUREMENT
/begin MEASUREMENT gang_whl "GANG_WHL" UBYTE LINEAR______0_000000__0H___25142 2 2.0 0.0 255.0 BIT_MASK 0xffffffff /begin IF_DATA ASAP1B_ADDRESS KP_BLOB 0xc35f /end IF_DATA /end MEASUREMENT
/begin MEASUREMENT geschwind "Geschwindigkeit" UBYTE LINEAR______0_000000__0H___25558 2 2.0 0.0 255.0 BIT_MASK 0xffffffff /begin IF_DATA ASAP1B_ADDRESS KP_BLOB 0xc430 /end IF_DATA /end MEASUREMENT
/begin MEASUREMENT gwC0D "Geräuschwert 1" UWORD GW_16 2 2.0 0.0 5.1 BIT_MASK 0xffffffff /begin IF_DATA ASAP1B_ADDRESS KP_BLOB 0xfa74 /end IF_DATA /end MEASUREMENT
/begin MEASUREMENT gwC1D "Geräuschwert 5" UWORD GW_16 2 2.0 0.0 5.1 BIT_MASK 0xffffffff /begin IF_DATA ASAP1B_ADDRESS KP_BLOB 0xfa76 /end IF_DATA /end MEASUREMENT
/begin MEASUREMENT gwC2D "Geräuschwert 3" UWORD GW_16 2 2.0 0.0 5.1 BIT_MASK 0xffffffff /begin IF_DATA ASAP1B_ADDRESS KP_BLOB 0xfa78 /end IF_DATA /end MEASUREMENT
/begin MEASUREMENT gwC3D "Geräuschwert 6" UWORD GW_16 2 2.0 0.0 5.1 BIT_MASK 0xffffffff /begin IF_DATA ASAP1B_ADDRESS KP_BLOB 0xfa7a /end IF_DATA /end MEASUREMENT
/begin MEASUREMENT gwC4D "Geräuschwert 2" UWORD GW_16 2 2.0 0.0 5.1 BIT_MASK 0xffffffff /begin IF_DATA ASAP1B_ADDRESS KP_BLOB 0xfa7c /end IF_DATA /end MEASUREMENT
/begin MEASUREMENT gwC5D "Geräuschwert 4" UWORD GW_16 2 2.0 0.0 5.1 BIT_MASK 0xffffffff /begin IF_DATA ASAP1B_ADDRESS KP_BLOB 0xfa7e /end IF_DATA /end MEASUREMENT
/begin MEASUREMENT gw_fak_gmw "GW_FAK_GMW" UWORD LINEAR______0_000000__0H___2_000 2 2.0 0.0 2.0 BIT_MASK 0xffffffff /begin IF_DATA ASAP1B_ADDRESS KP_BLOB 0xfa80 /end IF_DATA /end MEASUREMENT
/begin MEASUREMENT gw_tab_1_6 "Geräuschwert 1 .. 6" UWORD GW_16 2 2.0 0.0 5.1 BIT_MASK 0xffffffff /begin IF_DATA ASAP1B_ADDRESS KP_BLOB 0xe09a /end IF_DATA /end MEASUREMENT
/begin MEASUREMENT gws_thermo "GWS" UWORD LINEAR______0_000000__0H___65919 2 2.0 0.0 65535.0 BIT_MASK 0xffffffff /begin IF_DATA ASAP1B_ADDRESS KP_BLOB 0xce28 /end IF_DATA /end MEASUREMENT
/begin MEASUREMENT i_lsh_phC0D "ILSH_HOCH_FRQ_VKAT1" UBYTE LINEAR______0_000000__0H___5_920 2 2.0 0.0 5.0 BIT_MASK 0xffffffff /begin IF_DATA ASAP1B_ADDRESS KP_BLOB 0xe580 /end IF_DATA /end MEASUREMENT
/begin MEASUREMENT i_lsh_phC1D "ILSH_HOCH_FRQ_VKAT2" UBYTE LINEAR______0_000000__0H___5_920 2 2.0 0.0 5.0 BIT_MASK 0xffffffff /begin IF_DATA ASAP1B_ADDRESS KP_BLOB 0xe581 /end IF_DATA /end MEASUREMENT
/begin MEASUREMENT i_part_sam "I_PART_SAM" SWORD LINEAR______400_000000__7FFFH___ 2 2.0 -400.0 400.0 BIT_MASK 0xffffffff /begin IF_DATA ASAP1B_ADDRESS KP_BLOB 0xe0fa /end IF_DATA /end MEASUREMENT
/begin MEASUREMENT i_part_sam_dk_dif "I_PART_SAM_DK_DIF" SWORD LINEAR______400_000000__7FFFH___ 2 2.0 -400.0 400.0 BIT_MASK 0xffffffff /begin IF_DATA ASAP1B_ADDRESS KP_BLOB 0xe0fc /end IF_DATA /end MEASUREMENT
/begin MEASUREMENT id_ti_dec_wf "ID_TI_DEC_WF" UWORD LINEAR______0_000000__0H___26921 2 2.0 0.0 262.144 BIT_MASK 0xffffffff /begin IF_DATA ASAP1B_ADDRESS KP_BLOB 0xfc3c /end IF_DATA /end MEASUREMENT
/begin MEASUREMENT id_ti_inc_wf "ID_TI_INC_WF" UWORD LINEAR______0_000000__0H___26921 2 2.0 0.0 262.144 BIT_MASK 0xffffffff /begin IF_DATA ASAP1B_ADDRESS KP_BLOB 0xfc3a /end IF_DATA /end MEASUREMENT
/begin MEASUREMENT iga_asc "IGA_ASC" UBYTE LINEAR_______23_625000__0H___922 2 2.0 -23.625 72.0 BIT_MASK 0xffffffff /begin IF_DATA ASAP1B_ADDRESS KP_BLOB 0xc43b /end IF_DATA /end MEASUREMENT
/begin MEASUREMENT iga_ch_offsetvbyteC1D "IGA_CH_OFFSET_HIGH" UBYTE LINEAR_______48_000000__0H___170 2 2.0 -48.0 47.625 BIT_MASK 0xffffffff /begin IF_DATA ASAP1B_ADDRESS KP_BLOB 0xfa5f /end IF_DATA /end MEASUREMENT
/begin MEASUREMENT iga_end_mw_knk "IGA_FAK_ZW_MDZ" UBYTE LINEAR_______23_625000__0H___922 2 2.0 -23.625 72.0 BIT_MASK 0xffffffff /begin IF_DATA ASAP1B_ADDRESS KP_BLOB 0xc439 /end IF_DATA /end MEASUREMENT
/begin MEASUREMENT iga_igcC0D "Zündwinkel 1" UBYTE LINEAR_______23_625000__FFH___72 2 2.0 -23.625 72.0 BIT_MASK 0xffffffff /begin IF_DATA ASAP1B_ADDRESS KP_BLOB 0xe524 /end IF_DATA /end MEASUREMENT
/begin MEASUREMENT iga_igcC1D "Zündwinkel 5" UBYTE LINEAR_______23_625000__FFH___72 2 2.0 -23.625 72.0 BIT_MASK 0xffffffff /begin IF_DATA ASAP1B_ADDRESS KP_BLOB 0xe525 /end IF_DATA /end MEASUREMENT
/begin MEASUREMENT iga_igcC2D "Zündwinkel 3" UBYTE LINEAR_______23_625000__FFH___72 2 2.0 -23.625 72.0 BIT_MASK 0xffffffff /begin IF_DATA ASAP1B_ADDRESS KP_BLOB 0xe526 /end IF_DATA /end MEASUREMENT
/begin MEASUREMENT iga_igcC3D "Zündwinkel 6" UBYTE LINEAR_______23_625000__FFH___72 2 2.0 -23.625 72.0 BIT_MASK 0xffffffff /begin IF_DATA ASAP1B_ADDRESS KP_BLOB 0xe527 /end IF_DATA /end MEASUREMENT
/begin MEASUREMENT iga_igcC4D "Zündwinkel 2" UBYTE LINEAR_______23_625000__FFH___72 2 2.0 -23.625 72.0 BIT_MASK 0xffffffff /begin IF_DATA ASAP1B_ADDRESS KP_BLOB 0xe528 /end IF_DATA /end MEASUREMENT
/begin MEASUREMENT iga_igcC5D "Zündwinkel 4" UBYTE LINEAR_______23_625000__FFH___72 2 2.0 -23.625 72.0 BIT_MASK 0xffffffff /begin IF_DATA ASAP1B_ADDRESS KP_BLOB 0xe529 /end IF_DATA /end MEASUREMENT
/begin MEASUREMENT iga_igc_1_6 "Zündwinkel 1 .. 6" UBYTE LINEAR_______23_625000__FFH___72 2 2.0 -23.625 72.0 BIT_MASK 0xffffffff /begin IF_DATA ASAP1B_ADDRESS KP_BLOB 0xc437 /end IF_DATA /end MEASUREMENT
/begin MEASUREMENT iga_lim "IGA_LIM" UBYTE LINEAR_______23_625000__0H___922 2 2.0 -23.625 72.0 BIT_MASK 0xffffffff /begin IF_DATA ASAP1B_ADDRESS KP_BLOB 0xc438 /end IF_DATA /end MEASUREMENT
/begin MEASUREMENT iga_limp_home_kr "KR_NOTLAUF_ZW" UBYTE LINEAR_______23_625000__0H___126 2 2.0 -23.625 72.0 BIT_MASK 0xffffffff /begin IF_DATA ASAP1B_ADDRESS KP_BLOB 0xc44b /end IF_DATA /end MEASUREMENT
/begin MEASUREMENT im_P3 "" UWORD LINEAR______0_000000__0H___65904 2 2.0 0.0 65535.0 BIT_MASK 0xffffffff /begin IF_DATA ASAP1B_ADDRESS KP_BLOB 0xfd9a /end IF_DATA /end MEASUREMENT
/begin MEASUREMENT im_port_oct "" UWORD LINEAR______0_000000__0H___65904 2 2.0 0.0 65535.0 BIT_MASK 0xffffffff /begin IF_DATA ASAP1B_ADDRESS KP_BLOB 0xfda2 /end IF_DATA /end MEASUREMENT
/begin MEASUREMENT inh_iv "EV_ABSCHALTEN" UWORD LINEAR______0_000000__0H___65163 2 2.0 0.0 65535.0 BIT_MASK 0xffffffff /begin IF_DATA ASAP1B_ADDRESS KP_BLOB 0xe54e /end IF_DATA /end MEASUREMENT
/begin MEASUREMENT inh_swi_iv "INH_SWI_IV" UWORD LINEAR______0_000000__0H___65163 2 2.0 0.0 65535.0 BIT_MASK 0xffffffff /begin IF_DATA ASAP1B_ADDRESS KP_BLOB 0xfc30 /end IF_DATA /end MEASUREMENT
/begin MEASUREMENT ivvt_ivpos_act "NWIST_E" UBYTE LINEAR______60_000000__0H___1923 2 2.0 60.0 155.625 BIT_MASK 0xffffffff /begin IF_DATA ASAP1B_ADDRESS KP_BLOB 0xcffc /end IF_DATA /end MEASUREMENT
/begin MEASUREMENT ivvt_ivpos_act_ad_edgevbyteC1D "NW_AD_E" SBYTE LINEAR_______48_000000__FFFFF924 2 2.0 -48.0 47.625 BIT_MASK 0xffffffff /begin IF_DATA ASAP1B_ADDRESS KP_BLOB 0xcfdb /end IF_DATA /end MEASUREMENT
/begin MEASUREMENT ivvt_ivpos_act_dif "NW_DIF_REG_E" SBYTE LINEAR_______48_000000__FFFFF925 2 2.0 -48.0 47.625 BIT_MASK 0xffffffff /begin IF_DATA ASAP1B_ADDRESS KP_BLOB 0xd117 /end IF_DATA /end MEASUREMENT
/begin MEASUREMENT ivvt_ivpos_act_raw "NWIST_E_ROH" UBYTE LINEAR______60_000000__0H___1926 2 2.0 60.0 155.625 BIT_MASK 0xffffffff /begin IF_DATA ASAP1B_ADDRESS KP_BLOB 0xcffd /end IF_DATA /end MEASUREMENT
/begin MEASUREMENT ivvt_ivpos_dif "NW_DIF_E" SBYTE LINEAR_______48_000000__FFFFFF80 2 2.0 -48.0 47.625 BIT_MASK 0xffffffff /begin IF_DATA ASAP1B_ADDRESS KP_BLOB 0xd118 /end IF_DATA /end MEASUREMENT
/begin MEASUREMENT ivvt_ivpos_nom "NWSOLL_E" UBYTE LINEAR______60_000000__0H___1927 2 2.0 60.0 155.625 BIT_MASK 0xffffffff /begin IF_DATA ASAP1B_ADDRESS KP_BLOB 0xcffa /end IF_DATA /end MEASUREMENT
/begin MEASUREMENT ivvt_ivpos_nom_dif "NWSOLL_DIF_E" SBYTE LINEAR_______48_000000__FFFFFF80 2 2.0 -48.0 47.625 BIT_MASK 0xffffffff /begin IF_DATA ASAP1B_ADDRESS KP_BLOB 0xd119 /end IF_DATA /end MEASUREMENT
/begin MEASUREMENT ivvt_ivpos_nom_modvbyteC1D "NW_MOD_O_TOTZ_E" UBYTE LINEAR______60_000000__0H___1923 2 2.0 60.0 155.625 BIT_MASK 0xffffffff /begin IF_DATA ASAP1B_ADDRESS KP_BLOB 0xcfdd /end IF_DATA /end MEASUREMENT
/begin MEASUREMENT ivvt_ivpos_nom_mod_dlyvbyteC1D "NW_MOD_E" UBYTE LINEAR______60_000000__0H___1923 2 2.0 60.0 155.625 BIT_MASK 0xffffffff /begin IF_DATA ASAP1B_ADDRESS KP_BLOB 0xcfdf /end IF_DATA /end MEASUREMENT
/begin MEASUREMENT ivvt_ivpwm_vb "TA_VANOS_E" UBYTE LINEAR______0_000000__0H___99928 2 2.0 0.0 99.599998 BIT_MASK 0xffffffff /begin IF_DATA ASAP1B_ADDRESS KP_BLOB 0xd103 /end IF_DATA /end MEASUREMENT
/begin MEASUREMENT ivvt_ivstate_active "RVANOS_STATE_ACTIVE_E" UBYTE RVANOS_STATE_ACTIVE_RANGE 2 2.0 0 255 BIT_MASK 0xffffffff /begin IF_DATA ASAP1B_ADDRESS KP_BLOB 0xcff0 /end IF_DATA /end MEASUREMENT
/begin MEASUREMENT ivvt_ivt_adj "T_VAN_SUM_E" SWORD LINEAR_______20480_00000__FFFF80 2 2.0 -20480.0 20479.375 BIT_MASK 0xffffffff /begin IF_DATA ASAP1B_ADDRESS KP_BLOB 0xcfe4 /end IF_DATA /end MEASUREMENT
/begin MEASUREMENT ivvt_ivt_adj_con "T_VAN_REG_E" SWORD LINEAR_______20480_00000__FFFF80 2 2.0 -20480.0 20479.375 BIT_MASK 0xffffffff /begin IF_DATA ASAP1B_ADDRESS KP_BLOB 0xcfe6 /end IF_DATA /end MEASUREMENT
/begin MEASUREMENT ivvt_ivt_adj_con_int "T_VAN_REG_INT_E" SWORD LINEAR_______20480_00000__FFFF80 2 2.0 -20480.0 20479.375 BIT_MASK 0xffffffff /begin IF_DATA ASAP1B_ADDRESS KP_BLOB 0xcfec /end IF_DATA /end MEASUREMENT
/begin MEASUREMENT ivvt_ivt_adj_dly "T_VAN_TOTZ_ADD_E" SWORD LINEAR_______20480_00000__FFFF80 2 2.0 -20480.0 20479.375 BIT_MASK 0xffffffff /begin IF_DATA ASAP1B_ADDRESS KP_BLOB 0xcfea /end IF_DATA /end MEASUREMENT
/begin MEASUREMENT ivvt_ivt_adj_mod "T_VAN_E" SWORD LINEAR_______20480_00000__FFFF80 2 2.0 -20480.0 20479.375 BIT_MASK 0xffffffff /begin IF_DATA ASAP1B_ADDRESS KP_BLOB 0xcfe8 /end IF_DATA /end MEASUREMENT
/begin MEASUREMENT ivvt_ivt_dly "TOTZ_VANOS_E" UBYTE LINEAR______0_000000__0H___2550_ 2 2.0 0.0 2550.0 BIT_MASK 0xffffffff /begin IF_DATA ASAP1B_ADDRESS KP_BLOB 0xcff1 /end IF_DATA /end MEASUREMENT
/begin MEASUREMENT ivvt_ivt_dly_act "TOTZ_VANOS_GEM_E" UBYTE LINEAR______0_000000__0H___2550_ 2 2.0 0.0 2550.0 BIT_MASK 0xffffffff /begin IF_DATA ASAP1B_ADDRESS KP_BLOB 0xcff2 /end IF_DATA /end MEASUREMENT
/begin MEASUREMENT ivvt_ivvel_drift_hld "V_DRIFT_TAH_VANOS_E" SWORD LINEAR_______95_625000__FFFFFF01 2 2.0 -95.625 95.625 BIT_MASK 0xffffffff /begin IF_DATA ASAP1B_ADDRESS KP_BLOB 0xcfe0 /end IF_DATA /end MEASUREMENT
/begin MEASUREMENT ivvt_i_flags "" UWORD LINEAR______0_000000__0H___65929 2 2.0 0.0 65535.0 BIT_MASK 0xffffffff /begin IF_DATA ASAP1B_ADDRESS KP_BLOB 0xfd64 /end IF_DATA /end MEASUREMENT
/begin MEASUREMENT ivvt_ovpos_act "NWIST_A" UBYTE LINEAR_______155_625000__FFH_930 2 2.0 -155.625 -60.0 BIT_MASK 0xffffffff /begin IF_DATA ASAP1B_ADDRESS KP_BLOB 0xd166 /end IF_DATA /end MEASUREMENT
/begin MEASUREMENT ivvt_ovpos_act_ad_edgevbyteC1D "NW_AD_A" SBYTE LINEAR_______48_000000__FFFFF924 2 2.0 -48.0 47.625 BIT_MASK 0xffffffff /begin IF_DATA ASAP1B_ADDRESS KP_BLOB 0xd145 /end IF_DATA /end MEASUREMENT
/begin MEASUREMENT ivvt_ovpos_act_dif "NW_DIF_REG_A" SBYTE LINEAR_______48_000000__FFFFF925 2 2.0 -48.0 47.625 BIT_MASK 0xffffffff /begin IF_DATA ASAP1B_ADDRESS KP_BLOB 0xd281 /end IF_DATA /end MEASUREMENT
/begin MEASUREMENT ivvt_ovpos_act_raw "NWIST_A_ROH" UBYTE LINEAR_______155_625000__FFH_930 2 2.0 -155.625 -60.0 BIT_MASK 0xffffffff /begin IF_DATA ASAP1B_ADDRESS KP_BLOB 0xd167 /end IF_DATA /end MEASUREMENT
/begin MEASUREMENT ivvt_ovpos_dif "NW_DIF_A" SBYTE LINEAR_______48_000000__FFFFFF80 2 2.0 -48.0 47.625 BIT_MASK 0xffffffff /begin IF_DATA ASAP1B_ADDRESS KP_BLOB 0xd282 /end IF_DATA /end MEASUREMENT
/begin MEASUREMENT ivvt_ovpos_nom "NWSOLL_A" UBYTE LINEAR_______155_625000__FFH_931 2 2.0 -155.625 -60.0 BIT_MASK 0xffffffff /begin IF_DATA ASAP1B_ADDRESS KP_BLOB 0xd164 /end IF_DATA /end MEASUREMENT
/begin MEASUREMENT ivvt_ovpos_nom_dif "NWSOLL_DIF_A" SBYTE LINEAR_______48_000000__FFFFFF80 2 2.0 -48.0 47.625 BIT_MASK 0xffffffff /begin IF_DATA ASAP1B_ADDRESS KP_BLOB 0xd283 /end IF_DATA /end MEASUREMENT
/begin MEASUREMENT ivvt_ovpos_nom_modvbyteC1D "NW_MOD_O_TOTZ_A" UBYTE LINEAR_______155_625000__FFH_930 2 2.0 -155.625 -60.0 BIT_MASK 0xffffffff /begin IF_DATA ASAP1B_ADDRESS KP_BLOB 0xd147 /end IF_DATA /end MEASUREMENT
/begin MEASUREMENT ivvt_ovpos_nom_mod_dlyvbyteC1D "NW_MOD_A" UBYTE LINEAR_______155_625000__FFH_930 2 2.0 -155.625 -60.0 BIT_MASK 0xffffffff /begin IF_DATA ASAP1B_ADDRESS KP_BLOB 0xd149 /end IF_DATA /end MEASUREMENT
/begin MEASUREMENT ivvt_ovpwm_vb "TA_VANOS_A" UBYTE LINEAR______0_000000__0H___99928 2 2.0 0.0 99.599998 BIT_MASK 0xffffffff /begin IF_DATA ASAP1B_ADDRESS KP_BLOB 0xd26d /end IF_DATA /end MEASUREMENT
/begin MEASUREMENT ivvt_ovstate_active "RVANOS_STATE_ACTIVE_A" UBYTE RVANOS_STATE_ACTIVE_RANGE 2 2.0 0 255 BIT_MASK 0xffffffff /begin IF_DATA ASAP1B_ADDRESS KP_BLOB 0xd15a /end IF_DATA /end MEASUREMENT
/begin MEASUREMENT ivvt_ovt_adj "T_VAN_SUM_A" SWORD LINEAR_______20480_00000__FFFF80 2 2.0 -20480.0 20479.375 BIT_MASK 0xffffffff /begin IF_DATA ASAP1B_ADDRESS KP_BLOB 0xd14e /end IF_DATA /end MEASUREMENT
/begin MEASUREMENT ivvt_ovt_adj_con "T_VAN_REG_A" SWORD LINEAR_______20480_00000__FFFF80 2 2.0 -20480.0 20479.375 BIT_MASK 0xffffffff /begin IF_DATA ASAP1B_ADDRESS KP_BLOB 0xd150 /end IF_DATA /end MEASUREMENT
/begin MEASUREMENT ivvt_ovt_adj_con_int "T_VAN_REG_INT_A" SWORD LINEAR_______20480_00000__FFFF80 2 2.0 -20480.0 20479.375 BIT_MASK 0xffffffff /begin IF_DATA ASAP1B_ADDRESS KP_BLOB 0xd156 /end IF_DATA /end MEASUREMENT
/begin MEASUREMENT ivvt_ovt_adj_dly "T_VAN_TOTZ_ADD_A" SWORD LINEAR_______20480_00000__FFFF80 2 2.0 -20480.0 20479.375 BIT_MASK 0xffffffff /begin IF_DATA ASAP1B_ADDRESS KP_BLOB 0xd154 /end IF_DATA /end MEASUREMENT
/begin MEASUREMENT ivvt_ovt_adj_mod "T_VAN_A" SWORD LINEAR_______20480_00000__FFFF80 2 2.0 -20480.0 20479.375 BIT_MASK 0xffffffff /begin IF_DATA ASAP1B_ADDRESS KP_BLOB 0xd152 /end IF_DATA /end MEASUREMENT
/begin MEASUREMENT ivvt_ovt_dly "TOTZ_VANOS_A" UBYTE LINEAR______0_000000__0H___2550_ 2 2.0 0.0 2550.0 BIT_MASK 0xffffffff /begin IF_DATA ASAP1B_ADDRESS KP_BLOB 0xd15b /end IF_DATA /end MEASUREMENT
/begin MEASUREMENT ivvt_ovt_dly_act "TOTZ_VANOS_GEM_A" UBYTE LINEAR______0_000000__0H___2550_ 2 2.0 0.0 2550.0 BIT_MASK 0xffffffff /begin IF_DATA ASAP1B_ADDRESS KP_BLOB 0xd15c /end IF_DATA /end MEASUREMENT
/begin MEASUREMENT ivvt_ovvel_drift_hld "V_DRIFT_TAH_VANOS_A" SWORD LINEAR______95_625000__FFFFFF01H 2 2.0 -95.625 95.625 BIT_MASK 0xffffffff /begin IF_DATA ASAP1B_ADDRESS KP_BLOB 0xd14a /end IF_DATA /end MEASUREMENT
/begin MEASUREMENT ivvt_o_flags "" UWORD LINEAR______0_000000__0H___65929 2 2.0 0.0 65535.0 BIT_MASK 0xffffffff /begin IF_DATA ASAP1B_ADDRESS KP_BLOB 0xfd66 /end IF_DATA /end MEASUREMENT
/begin MEASUREMENT ka "KA" UWORD RANGE________KA___1H__1H________ 2 2.0 0 65535 BIT_MASK 0x40 /begin IF_DATA ASAP1B_ADDRESS KP_BLOB 0xfd3e /end IF_DATA /end MEASUREMENT
/begin MEASUREMENT kat_anf_hst_1 "KAT-ANFETTUNG NACH HST1" UBYTE RANGE________aktiv___1H__1H__932 2 2.0 0 255 BIT_MASK 0x1 /begin IF_DATA ASAP1B_ADDRESS KP_BLOB 0xfd0b /end IF_DATA /end MEASUREMENT
/begin MEASUREMENT kat_anf_hst_2 "KAT-ANFETTUNG NACH HST2" UBYTE RANGE________aktiv___1H__1H__932 2 2.0 0 255 BIT_MASK 0x8 /begin IF_DATA ASAP1B_ADDRESS KP_BLOB 0xfd0b /end IF_DATA /end MEASUREMENT
/begin MEASUREMENT kat_anf_kh_1 "KAT-ANFETTUNG NACH KH1" UBYTE RANGE________aktiv___1H__1H__932 2 2.0 0 255 BIT_MASK 0x80 /begin IF_DATA ASAP1B_ADDRESS KP_BLOB 0xfd0a /end IF_DATA /end MEASUREMENT
/begin MEASUREMENT kat_anf_kh_2 "KAT-ANFETTUNG NACH KH2" UBYTE RANGE________aktiv___1H__1H__932 2 2.0 0 255 BIT_MASK 0x4 /begin IF_DATA ASAP1B_ADDRESS KP_BLOB 0xfd0b /end IF_DATA /end MEASUREMENT
/begin MEASUREMENT kat_anf_sa_1 "KAT-ANFETTUNG NACH SA1" UBYTE RANGE________aktiv___1H__1H__932 2 2.0 0 255 BIT_MASK 0x10 /begin IF_DATA ASAP1B_ADDRESS KP_BLOB 0xfd0b /end IF_DATA /end MEASUREMENT
/begin MEASUREMENT kat_anf_sa_2 "KAT-ANFETTUNG NACH SA2" UBYTE RANGE________aktiv___1H__1H__932 2 2.0 0 255 BIT_MASK 0x20 /begin IF_DATA ASAP1B_ADDRESS KP_BLOB 0xfd0b /end IF_DATA /end MEASUREMENT
/begin MEASUREMENT kat_anf_slp_1 "KAT-ANFETTUNG NACH SL1" UBYTE RANGE________aktiv___1H__1H__932 2 2.0 0 255 BIT_MASK 0x40 /begin IF_DATA ASAP1B_ADDRESS KP_BLOB 0xfd0a /end IF_DATA /end MEASUREMENT
/begin MEASUREMENT kat_anf_slp_2 "KAT-ANFETTUNG NACH SL2" UBYTE RANGE________aktiv___1H__1H__932 2 2.0 0 255 BIT_MASK 0x2 /begin IF_DATA ASAP1B_ADDRESS KP_BLOB 0xfd0b /end IF_DATA /end MEASUREMENT
/begin MEASUREMENT KAT_ANFETTUNG_1 "KAT_ANFETTUNG_1" UBYTE RANGE________aktiv___1H__1H____p 2 2.0 0 255 BIT_MASK 0x10 /begin IF_DATA ASAP1B_ADDRESS KP_BLOB 0xe326 /end IF_DATA /end MEASUREMENT
/begin MEASUREMENT KAT_ANFETTUNG_2 "KAT_ANFETTUNG_2" UBYTE RANGE________aktiv___1H__1H____p 2 2.0 0 255 BIT_MASK 0x10 /begin IF_DATA ASAP1B_ADDRESS KP_BLOB 0xe410 /end IF_DATA /end MEASUREMENT
/begin MEASUREMENT katw_diag_end_1 "KATW_DIAG_END_1" UWORD RANGE________JA___1H__1H____N897 2 2.0 0 65535 BIT_MASK 0x8 /begin IF_DATA ASAP1B_ADDRESS KP_BLOB 0xe34a /end IF_DATA /end MEASUREMENT
/begin MEASUREMENT katw_diag_end_2 "KATW_DIAG_END_2" UWORD RANGE________JA___1H__1H____N897 2 2.0 0 65535 BIT_MASK 0x8 /begin IF_DATA ASAP1B_ADDRESS KP_BLOB 0xe434 /end IF_DATA /end MEASUREMENT
/begin MEASUREMENT kennfeldwert "Kennfeldwert (Saugrohrmodell)" UWORD LINEAR______1_000000__100H___8_0 2 2.0 1.0 8.0 BIT_MASK 0xffffffff /begin IF_DATA ASAP1B_ADDRESS KP_BLOB 0xfa4c /end IF_DATA /end MEASUREMENT
/begin MEASUREMENT kf_ad_gmw_max_llfs_diag "KF_AD_GMW_MAX_LLFS_DIAG" UBYTE LINEAR______0_000000__0H___3_933 2 2.0 0.0 3.984675 BIT_MASK 0xffffffff /begin IF_DATA ASAP1B_ADDRESS KP_BLOB 0xcdf8 /end IF_DATA /end MEASUREMENT
/begin MEASUREMENT kf_ad_gmw_min_llfs_diag "KF_AD_GMW_MIN_LLFS_DIAG" UBYTE LINEAR______0_000000__0H___3_933 2 2.0 0.0 3.984675 BIT_MASK 0xffffffff /begin IF_DATA ASAP1B_ADDRESS KP_BLOB 0xcdf7 /end IF_DATA /end MEASUREMENT
/begin MEASUREMENT kf_fak_ramp_te "KF_FAK_RAMP_TE" UBYTE LINEAR______0_000000__0H___15934 2 2.0 0.0 15.94 BIT_MASK 0xffffffff /begin IF_DATA ASAP1B_ADDRESS KP_BLOB 0xc1d3 /end IF_DATA /end MEASUREMENT
/begin MEASUREMENT kf_fak_schw_lu "KF_FAK_SCHW_LU" UWORD LINEAR______1_000000__100H___935 2 2.0 1.0 1.9961 BIT_MASK 0xffffffff /begin IF_DATA ASAP1B_ADDRESS KP_BLOB 0xe2b8 /end IF_DATA /end MEASUREMENT
/begin MEASUREMENT kf_fak_tal_tkw "KF_FAK_TAL_TKW" UBYTE LINEAR______0_000000__0H___0_920 2 2.0 0.0 0.99599999 BIT_MASK 0xffffffff /begin IF_DATA ASAP1B_ADDRESS KP_BLOB 0xc432 /end IF_DATA /end MEASUREMENT
/begin MEASUREMENT kf_fak_tal_tkw_ll "KF_FAK_TAL_TKW_LL" UBYTE LINEAR______0_000000__0H___0_920 2 2.0 0.0 0.99599999 BIT_MASK 0xffffffff /begin IF_DATA ASAP1B_ADDRESS KP_BLOB 0xcde6 /end IF_DATA /end MEASUREMENT
/begin MEASUREMENT kf_fs_ka_nsoll_ll "KF_FS_KA_NSOLL_LL" UWORD IS_13_RES78 2 2.0 0.0 8160.0 BIT_MASK 0xffffffff /begin IF_DATA ASAP1B_ADDRESS KP_BLOB 0xe17a /end IF_DATA /end MEASUREMENT
/begin MEASUREMENT kf_fs_nsoll_ll "KF_FS_NSOLL_LL" UWORD IS_13_RES78 2 2.0 0.0 8160.0 BIT_MASK 0xffffffff /begin IF_DATA ASAP1B_ADDRESS KP_BLOB 0xe176 /end IF_DATA /end MEASUREMENT
/begin MEASUREMENT kf_ka_nsoll_ll "KF_KA_NSOLL_LL" UWORD IS_13_RES78 2 2.0 0.0 8160.0 BIT_MASK 0xffffffff /begin IF_DATA ASAP1B_ADDRESS KP_BLOB 0xe178 /end IF_DATA /end MEASUREMENT
/begin MEASUREMENT kf_m_ldp_schw "KF_M_LDP_SCHW" SWORD LINEAR_______1024_000000__FFFFFC 2 2.0 -1024.0 1024.0 BIT_MASK 0xffffffff /begin IF_DATA ASAP1B_ADDRESS KP_BLOB 0xcf18 /end IF_DATA /end MEASUREMENT
/begin MEASUREMENT kf_nsoll_ll "KF_NSOLL_LL" UWORD IS_13_RES78 2 2.0 0.0 8160.0 BIT_MASK 0xffffffff /begin IF_DATA ASAP1B_ADDRESS KP_BLOB 0xe174 /end IF_DATA /end MEASUREMENT
/begin MEASUREMENT kf_pwg_min_ak "KF_PWG_MIN_AK" UBYTE MTC_NORM_8_RES 2 2.0 0.0 119.53125 BIT_MASK 0xffffffff /begin IF_DATA ASAP1B_ADDRESS KP_BLOB 0xc331 /end IF_DATA /end MEASUREMENT
/begin MEASUREMENT kf_tallfs "KF_TALLFS" UWORD TALLFS936 2 2.0 0.0 399.9938 BIT_MASK 0xffffffff /begin IF_DATA ASAP1B_ADDRESS KP_BLOB 0xe122 /end IF_DATA /end MEASUREMENT
/begin MEASUREMENT kf_tallfs_fs "KF_TALLFS_FS" UWORD TALLFS936 2 2.0 0.0 399.9938 BIT_MASK 0xffffffff /begin IF_DATA ASAP1B_ADDRESS KP_BLOB 0xe124 /end IF_DATA /end MEASUREMENT
/begin MEASUREMENT kf_tallfs_fs_aebg_dec "KF_TALLFS_FS_AEBG_DEC" UWORD TALLFS_IN_10MS937 2 2.0 0.0061 24.9938 BIT_MASK 0xffffffff /begin IF_DATA ASAP1B_ADDRESS KP_BLOB 0xe15e /end IF_DATA /end MEASUREMENT
/begin MEASUREMENT kf_tallfs_fs_aebg_inc "KF_TALLFS_FS_AEBG_INC" UWORD TALLFS_IN_10MS937 2 2.0 0.0061 24.9938 BIT_MASK 0xffffffff /begin IF_DATA ASAP1B_ADDRESS KP_BLOB 0xe160 /end IF_DATA /end MEASUREMENT
/begin MEASUREMENT kf_tallfs_fs_ka "KF_TALLFS_FS_KA" UWORD TALLFS936 2 2.0 0.0 399.9938 BIT_MASK 0xffffffff /begin IF_DATA ASAP1B_ADDRESS KP_BLOB 0xe128 /end IF_DATA /end MEASUREMENT
/begin MEASUREMENT kf_tallfs_ini_i_st "KF_TALLFS_INI_I_ST" SWORD LINEAR_______50_000000__FFFF8938 2 2.0 -50.0 49.998501 BIT_MASK 0xffffffff /begin IF_DATA ASAP1B_ADDRESS KP_BLOB 0xe162 /end IF_DATA /end MEASUREMENT
/begin MEASUREMENT kf_tallfs_ka "KF_TALLFS_KA" UWORD TALLFS936 2 2.0 0.0 399.9938 BIT_MASK 0xffffffff /begin IF_DATA ASAP1B_ADDRESS KP_BLOB 0xe126 /end IF_DATA /end MEASUREMENT
/begin MEASUREMENT kf_tallfs_ssp "KF_TALLFS_SSP" SWORD TALLFS_NEG_SI 2 2.0 -200.0 0.0 BIT_MASK 0xffffffff /begin IF_DATA ASAP1B_ADDRESS KP_BLOB 0xe19a /end IF_DATA /end MEASUREMENT
/begin MEASUREMENT kf_tallfs_tal_fak "KF_TALLFS_TAL_FAK" UWORD LINEAR______0_000000__0H___1_999 2 2.0 0.0 1.99997 BIT_MASK 0xffffffff /begin IF_DATA ASAP1B_ADDRESS KP_BLOB 0xe18a /end IF_DATA /end MEASUREMENT
/begin MEASUREMENT kf_tallfs_tkw_fak_ll "KF_TALLFS_TKW_FAK_LL" UBYTE LINEAR______0_000000__0H___1_939 2 2.0 0.0 1.9922 BIT_MASK 0xffffffff /begin IF_DATA ASAP1B_ADDRESS KP_BLOB 0xcdf2 /end IF_DATA /end MEASUREMENT
/begin MEASUREMENT kf_ti_abr_kst "KF_TI_ABR_KST" UBYTE LINEAR______0_000000__0H___0_940 2 2.0 0.0 0.99610001 BIT_MASK 0xffffffff /begin IF_DATA ASAP1B_ADDRESS KP_BLOB 0xc195 /end IF_DATA /end MEASUREMENT
/begin MEASUREMENT kf_ti_fak_fwl "KF_TI_FAK_FWL" UWORD LINEAR______0_000000__0H___16941 2 2.0 0.0 16.0 BIT_MASK 0xffffffff /begin IF_DATA ASAP1B_ADDRESS KP_BLOB 0xceb8 /end IF_DATA /end MEASUREMENT
/begin MEASUREMENT kf_ti_fak_kat "KF_TI_FAK_KAT" UWORD LINEAR______0_000000__0H___16941 2 2.0 0.0 16.0 BIT_MASK 0xffffffff /begin IF_DATA ASAP1B_ADDRESS KP_BLOB 0xceb6 /end IF_DATA /end MEASUREMENT
/begin MEASUREMENT kf_ti_kns "KF_TI_KNS" UBYTE LINEAR______0_000000__0H___3_942 2 2.0 0.0 3.984 BIT_MASK 0xffffffff /begin IF_DATA ASAP1B_ADDRESS KP_BLOB 0xc196 /end IF_DATA /end MEASUREMENT
/begin MEASUREMENT kf_ti_kns_wst "KF_TI_KNS_WST" UBYTE LINEAR______0_000000__0H___0_996 2 2.0 0.0 0.99610001 BIT_MASK 0xffffffff /begin IF_DATA ASAP1B_ADDRESS KP_BLOB 0xc197 /end IF_DATA /end MEASUREMENT
/begin MEASUREMENT kf_ti_ks_bk1 "KF_TI_KS_BK1" UWORD LINEAR______0_000000__0H___16941 2 2.0 0.0 16.0 BIT_MASK 0xffffffff /begin IF_DATA ASAP1B_ADDRESS KP_BLOB 0xe1e2 /end IF_DATA /end MEASUREMENT
/begin MEASUREMENT kf_ti_ks_bk2 "KF_TI_KS_BK2" UWORD LINEAR______0_000000__0H___16941 2 2.0 0.0 16.0 BIT_MASK 0xffffffff /begin IF_DATA ASAP1B_ADDRESS KP_BLOB 0xe1ea /end IF_DATA /end MEASUREMENT
/begin MEASUREMENT kf_ti_pu_kor "KF_TI_PU_KOR" UWORD LINEAR______0_000000__0H___2_111 2 2.0 0.0 2.0 BIT_MASK 0xffffffff /begin IF_DATA ASAP1B_ADDRESS KP_BLOB 0xe1f0 /end IF_DATA /end MEASUREMENT
/begin MEASUREMENT kf_ti_tkw_fwl "KF_TI_TKW_FWL" UBYTE LINEAR______0_000000__0H___1_992 2 2.0 0.0 1.9922 BIT_MASK 0xffffffff /begin IF_DATA ASAP1B_ADDRESS KP_BLOB 0xc1a1 /end IF_DATA /end MEASUREMENT
/begin MEASUREMENT kf_ti_tkw_fwl_ll "KF_TI_TKW_FWL_LL" UBYTE LINEAR______0_000000__0H___1_992 2 2.0 0.0 1.9922 BIT_MASK 0xffffffff /begin IF_DATA ASAP1B_ADDRESS KP_BLOB 0xc1a2 /end IF_DATA /end MEASUREMENT
/begin MEASUREMENT kf_ti_tkw_kat "KF_TI_TKW_KAT" UBYTE LINEAR______0_000000__0H___1_992 2 2.0 0.0 1.9922 BIT_MASK 0xffffffff /begin IF_DATA ASAP1B_ADDRESS KP_BLOB 0xc19f /end IF_DATA /end MEASUREMENT
/begin MEASUREMENT kf_ti_tkw_kat_ll "KF_TI_TKW_KAT_LL" UBYTE LINEAR______0_000000__0H___1_992 2 2.0 0.0 1.9922 BIT_MASK 0xffffffff /begin IF_DATA ASAP1B_ADDRESS KP_BLOB 0xc1a0 /end IF_DATA /end MEASUREMENT
/begin MEASUREMENT kf_ti_tkw_wl "KF_TI_TKW_WL" UBYTE LINEAR______0_000000__0H___1_992 2 2.0 0.0 1.9922 BIT_MASK 0xffffffff /begin IF_DATA ASAP1B_ADDRESS KP_BLOB 0xc19e /end IF_DATA /end MEASUREMENT
/begin MEASUREMENT kf_tv_bab_max_ll "KF_TV_BAB_MAX_LL" UWORD LINEAR______0_000000__0H___511_9 2 2.0 0.0 511.99218 BIT_MASK 0xffffffff /begin IF_DATA ASAP1B_ADDRESS KP_BLOB 0xcf1a /end IF_DATA /end MEASUREMENT
/begin MEASUREMENT kf_zw_fak_ll "KF_ZW_FAK_LL" UBYTE LINEAR______0_000000__0H___0_996 2 2.0 0.0 0.99610001 BIT_MASK 0xffffffff /begin IF_DATA ASAP1B_ADDRESS KP_BLOB 0xe080 /end IF_DATA /end MEASUREMENT
/begin MEASUREMENT kf_zw_tkw_kat "KF_ZW_TKW_KAT" UBYTE LINEAR______0_000000__0H___0_996 2 2.0 0.0 0.99610001 BIT_MASK 0xffffffff /begin IF_DATA ASAP1B_ADDRESS KP_BLOB 0xfa60 /end IF_DATA /end MEASUREMENT
/begin MEASUREMENT kf_zw_tkw_st "KF_ZW_TKW_ST" UBYTE LINEAR_______48_000000__0H___170 2 2.0 -48.0 47.625 BIT_MASK 0xffffffff /begin IF_DATA ASAP1B_ADDRESS KP_BLOB 0xcde9 /end IF_DATA /end MEASUREMENT
/begin MEASUREMENT kf_zwb_fr "KF_ZWB_FR" UBYTE LINEAR_______23_625000__0H___126 2 2.0 -23.625 72.0 BIT_MASK 0xffffffff /begin IF_DATA ASAP1B_ADDRESS KP_BLOB 0xc435 /end IF_DATA /end MEASUREMENT
/begin MEASUREMENT kh "KH" UWORD RANGE________KH___1H__1H________ 2 2.0 0 65535 BIT_MASK 0x20 /begin IF_DATA ASAP1B_ADDRESS KP_BLOB 0xfd3c /end IF_DATA /end MEASUREMENT
/begin MEASUREMENT kh2 "KH2" UWORD RANGE________KH2___1H__1H_______ 2 2.0 0 65535 BIT_MASK 0x8 /begin IF_DATA ASAP1B_ADDRESS KP_BLOB 0xfd42 /end IF_DATA /end MEASUREMENT
/begin MEASUREMENT kh3 "KH3" UWORD RANGE________KH3___1H__1H_______ 2 2.0 0 65535 BIT_MASK 0x10 /begin IF_DATA ASAP1B_ADDRESS KP_BLOB 0xfd42 /end IF_DATA /end MEASUREMENT
/begin MEASUREMENT kk "KK" UWORD RANGE________KK___1H__1H________ 2 2.0 0 65535 BIT_MASK 0x80 /begin IF_DATA ASAP1B_ADDRESS KP_BLOB 0xfd3e /end IF_DATA /end MEASUREMENT
/begin MEASUREMENT kk_last_can "Lastmoment KK" UBYTE LINEAR______0_000000__0H___31_00 2 2.0 0.0 31.0 BIT_MASK 0xffffffff /begin IF_DATA ASAP1B_ADDRESS KP_BLOB 0xcdf6 /end IF_DATA /end MEASUREMENT
/begin MEASUREMENT kk_relais "KK_RELAIS" UWORD RANGE________KK_RELAIS___1H__1H_ 2 2.0 0 65535 BIT_MASK 0x2000 /begin IF_DATA ASAP1B_ADDRESS KP_BLOB 0xfd3e /end IF_DATA /end MEASUREMENT
/begin MEASUREMENT klopf_tab_1_6 "Klopfwert 1 .. 6" UBYTE LINEAR______0_000000__0H___5_943 2 2.0 0.0 5.0999999 BIT_MASK 0xffffffff /begin IF_DATA ASAP1B_ADDRESS KP_BLOB 0xc472 /end IF_DATA /end MEASUREMENT
/begin MEASUREMENT knk_limp_home "KR_NOTLAUF" UWORD RANGE_NOTLAUF 2 2.0 0 65535 BIT_MASK 0x2000 /begin IF_DATA ASAP1B_ADDRESS KP_BLOB 0xfd42 /end IF_DATA /end MEASUREMENT
/begin MEASUREMENT knksC0D "Klopfwert 1" UBYTE LINEAR______0_000000__0H___5_943 2 2.0 0.0 5.0999999 BIT_MASK 0xffffffff /begin IF_DATA ASAP1B_ADDRESS KP_BLOB 0xe542 /end IF_DATA /end MEASUREMENT
/begin MEASUREMENT knksC1D "Klopfwert 5" UBYTE LINEAR______0_000000__0H___5_943 2 2.0 0.0 5.0999999 BIT_MASK 0xffffffff /begin IF_DATA ASAP1B_ADDRESS KP_BLOB 0xe543 /end IF_DATA /end MEASUREMENT
/begin MEASUREMENT knksC2D "Klopfwert 3" UBYTE LINEAR______0_000000__0H___5_943 2 2.0 0.0 5.0999999 BIT_MASK 0xffffffff /begin IF_DATA ASAP1B_ADDRESS KP_BLOB 0xe544 /end IF_DATA /end MEASUREMENT
/begin MEASUREMENT knksC3D "Klopfwert 6" UBYTE LINEAR______0_000000__0H___5_943 2 2.0 0.0 5.0999999 BIT_MASK 0xffffffff /begin IF_DATA ASAP1B_ADDRESS KP_BLOB 0xe545 /end IF_DATA /end MEASUREMENT
/begin MEASUREMENT knksC4D "Klopfwert 2" UBYTE LINEAR______0_000000__0H___5_943 2 2.0 0.0 5.0999999 BIT_MASK 0xffffffff /begin IF_DATA ASAP1B_ADDRESS KP_BLOB 0xe546 /end IF_DATA /end MEASUREMENT
/begin MEASUREMENT knksC5D "Klopfwert 4" UBYTE LINEAR______0_000000__0H___5_943 2 2.0 0.0 5.0999999 BIT_MASK 0xffffffff /begin IF_DATA ASAP1B_ADDRESS KP_BLOB 0xe547 /end IF_DATA /end MEASUREMENT
/begin MEASUREMENT komp "KOMP" SLONG LINEAR_______24800_000000__FF800 2 2.0 -24800.0 24800.0 BIT_MASK 0xffffffff /begin IF_DATA ASAP1B_ADDRESS KP_BLOB 0xfaf4 /end IF_DATA /end MEASUREMENT
/begin MEASUREMENT kr "KR" UWORD RANGE________aktiv___1H__1H__944 2 2.0 0 65535 BIT_MASK 0x4 /begin IF_DATA ASAP1B_ADDRESS KP_BLOB 0xfd42 /end IF_DATA /end MEASUREMENT
/begin MEASUREMENT kr_pwm "KR_PWM" UWORD LINEAR______0_000000__0H___99945 2 2.0 0.0 99.998001 BIT_MASK 0xffffffff /begin IF_DATA ASAP1B_ADDRESS KP_BLOB 0xe094 /end IF_DATA /end MEASUREMENT
/begin MEASUREMENT ks_aufst_bk1 "KS_AUFST_BK1" UWORD RANGE________0___0H__0H____1___1 2 2.0 0 65535 BIT_MASK 0x800 /begin IF_DATA ASAP1B_ADDRESS KP_BLOB 0xfd46 /end IF_DATA /end MEASUREMENT
/begin MEASUREMENT ks_aufst_bk2 "KS_AUFST_BK2" UWORD RANGE________0___0H__0H____1___1 2 2.0 0 65535 BIT_MASK 0x1000 /begin IF_DATA ASAP1B_ADDRESS KP_BLOB 0xfd46 /end IF_DATA /end MEASUREMENT
/begin MEASUREMENT ks_bk1 "KS_BK1" UWORD RANGE________KS___1H__1H________ 2 2.0 0 65535 BIT_MASK 0x40 /begin IF_DATA ASAP1B_ADDRESS KP_BLOB 0xfd3c /end IF_DATA /end MEASUREMENT
/begin MEASUREMENT ks_bk2 "KS_BK2" UWORD RANGE________KS___1H__1H________ 2 2.0 0 65535 BIT_MASK 0x200 /begin IF_DATA ASAP1B_ADDRESS KP_BLOB 0xfd3c /end IF_DATA /end MEASUREMENT
/begin MEASUREMENT ks_rst_bk1 "KS_RST_BK1" UWORD RANGE________0___0H__0H____1___1 2 2.0 0 65535 BIT_MASK 0x200 /begin IF_DATA ASAP1B_ADDRESS KP_BLOB 0xfd46 /end IF_DATA /end MEASUREMENT
/begin MEASUREMENT ks_rst_bk2 "KS_RST_BK2" UWORD RANGE________0___0H__0H____1___1 2 2.0 0 65535 BIT_MASK 0x400 /begin IF_DATA ASAP1B_ADDRESS KP_BLOB 0xfd46 /end IF_DATA /end MEASUREMENT
/begin MEASUREMENT ks_time_counter_bk1 "KS_TIME_COUNTER_BK1" UBYTE LINEAR______0_000000__0H___25108 2 2.0 0.0 255.0 BIT_MASK 0xffffffff /begin IF_DATA ASAP1B_ADDRESS KP_BLOB 0xc1aa /end IF_DATA /end MEASUREMENT
/begin MEASUREMENT ks_time_counter_bk2 "KS_TIME_COUNTER_BK2" UBYTE LINEAR______0_000000__0H___25108 2 2.0 0.0 255.0 BIT_MASK 0xffffffff /begin IF_DATA ASAP1B_ADDRESS KP_BLOB 0xc1ab /end IF_DATA /end MEASUREMENT
/begin MEASUREMENT KSD_GESPERRT "KSD_GESPERRT" UWORD RANGE________JA___1H__1H____N902 2 2.0 0 65535 BIT_MASK 0x20 /begin IF_DATA ASAP1B_ADDRESS KP_BLOB 0xfd48 /end IF_DATA /end MEASUREMENT
/begin MEASUREMENT kva_can "VERBRAUCH" UWORD LINEAR______0_000000__0H___65946 2 2.0 0.0 65535.0 BIT_MASK 0xffffffff /begin IF_DATA ASAP1B_ADDRESS KP_BLOB 0xd2a0 /end IF_DATA /end MEASUREMENT
/begin MEASUREMENT l_key_on "l_key_on" UBYTE RANGE________EIN___1H__1H____AUS 2 2.0 0 255 BIT_MASK 0x8 /begin IF_DATA ASAP1B_ADDRESS KP_BLOB 0xfd22 /end IF_DATA /end MEASUREMENT
/begin MEASUREMENT l_mil_on "LV_MIL" UBYTE RANGE________EIN___1H__1H____AUS 2 2.0 0 255 BIT_MASK 0x20 /begin IF_DATA ASAP1B_ADDRESS KP_BLOB 0xfd19 /end IF_DATA /end MEASUREMENT
/begin MEASUREMENT lam_diag_slv_max "LAM_DIAG_SLV_MAX" UWORD LINEAR_______50_000000__0H___947 2 2.0 -50.0 49.998501 BIT_MASK 0xffffffff /begin IF_DATA ASAP1B_ADDRESS KP_BLOB 0xd28c /end IF_DATA /end MEASUREMENT
/begin MEASUREMENT Lambdaregler1 "Lambdaregler1" UBYTE RANGE________aktiv___1H__1H__932 2 2.0 0 255 BIT_MASK 0x8 /begin IF_DATA ASAP1B_ADDRESS KP_BLOB 0xe324 /end IF_DATA /end MEASUREMENT
/begin MEASUREMENT Lambdaregler2 "Lambdaregler2" UBYTE RANGE________aktiv___1H__1H__932 2 2.0 0 255 BIT_MASK 0x8 /begin IF_DATA ASAP1B_ADDRESS KP_BLOB 0xe40e /end IF_DATA /end MEASUREMENT
/begin MEASUREMENT Lambdaregleranschlag1 "Lambdaregleranschlag1" UBYTE RANGE________JA___1H__1H____N948 2 2.0 0 255 BIT_MASK 0x2 /begin IF_DATA ASAP1B_ADDRESS KP_BLOB 0xe324 /end IF_DATA /end MEASUREMENT
/begin MEASUREMENT Lambdaregleranschlag2 "Lambdaregleranschlag2" UBYTE RANGE________JA___1H__1H____N948 2 2.0 0 255 BIT_MASK 0x2 /begin IF_DATA ASAP1B_ADDRESS KP_BLOB 0xe40e /end IF_DATA /end MEASUREMENT
/begin MEASUREMENT Lambdareglerzustand1 "Lambdareglerzustand1" UBYTE RANGE________EIN___1H__1H____AUS 2 2.0 0 255 BIT_MASK 0x1 /begin IF_DATA ASAP1B_ADDRESS KP_BLOB 0xe324 /end IF_DATA /end MEASUREMENT
/begin MEASUREMENT Lambdareglerzustand2 "Lambdareglerzustand2" UBYTE RANGE________EIN___1H__1H____AUS 2 2.0 0 255 BIT_MASK 0x1 /begin IF_DATA ASAP1B_ADDRESS KP_BLOB 0xe40e /end IF_DATA /end MEASUREMENT
/begin MEASUREMENT Lambdasonde_NKAT1 "Lambdasonde_NKAT1" UBYTE RANGE________bereit___1H__1H____ 2 2.0 0 255 BIT_MASK 0x40 /begin IF_DATA ASAP1B_ADDRESS KP_BLOB 0xe324 /end IF_DATA /end MEASUREMENT
/begin MEASUREMENT Lambdasonde_NKAT2 "Lambdasonde_NKAT2" UBYTE RANGE________bereit___1H__1H____ 2 2.0 0 255 BIT_MASK 0x40 /begin IF_DATA ASAP1B_ADDRESS KP_BLOB 0xe40e /end IF_DATA /end MEASUREMENT
/begin MEASUREMENT Lambdasonde_VKAT1 "Lambdasonde_VKAT1" UBYTE RANGE________bereit___1H__1H____ 2 2.0 0 255 BIT_MASK 0x20 /begin IF_DATA ASAP1B_ADDRESS KP_BLOB 0xe324 /end IF_DATA /end MEASUREMENT
/begin MEASUREMENT Lambdasonde_VKAT2 "Lambdasonde_VKAT2" UBYTE RANGE________bereit___1H__1H____ 2 2.0 0 255 BIT_MASK 0x20 /begin IF_DATA ASAP1B_ADDRESS KP_BLOB 0xe40e /end IF_DATA /end MEASUREMENT
/begin MEASUREMENT Lambdazustand1 "Lambdazustand1" UBYTE RANGE________fett___1H__1H____ma 2 2.0 0 255 BIT_MASK 0x4 /begin IF_DATA ASAP1B_ADDRESS KP_BLOB 0xe325 /end IF_DATA /end MEASUREMENT
/begin MEASUREMENT Lambdazustand2 "Lambdazustand2" UBYTE RANGE________fett___1H__1H____ma 2 2.0 0 255 BIT_MASK 0x4 /begin IF_DATA ASAP1B_ADDRESS KP_BLOB 0xe40f /end IF_DATA /end MEASUREMENT
/begin MEASUREMENT lammw_dif_te_kor "LAMMW_DIF_TE_KOR" UWORD LINEAR_______50_000000__0H___947 2 2.0 -50.0 49.998501 BIT_MASK 0xffffffff /begin IF_DATA ASAP1B_ADDRESS KP_BLOB 0xe236 /end IF_DATA /end MEASUREMENT
/begin MEASUREMENT lammw_gmw "LAMMW_GMW_SAM" UWORD LINEAR_______50_000000__0H___49_ 2 2.0 -50.0 49.998501 BIT_MASK 0xffffffff /begin IF_DATA ASAP1B_ADDRESS KP_BLOB 0xe228 /end IF_DATA /end MEASUREMENT
/begin MEASUREMENT lammw_gmw_dif "LAMMW_GMW_DIF" UWORD LINEAR_______50_000000__0H___947 2 2.0 -50.0 49.998501 BIT_MASK 0xffffffff /begin IF_DATA ASAP1B_ADDRESS KP_BLOB 0xe22a /end IF_DATA /end MEASUREMENT
/begin MEASUREMENT lammw_te_start "LAMMW_TE_VERS" UWORD LINEAR_______50_000000__0H___947 2 2.0 -50.0 49.998501 BIT_MASK 0xffffffff /begin IF_DATA ASAP1B_ADDRESS KP_BLOB 0xe234 /end IF_DATA /end MEASUREMENT
/begin MEASUREMENT last_d_kr_mz4 "Lastdynamik KR" UWORD RANGE________aktiv___1H__1H__895 2 2.0 0 65535 BIT_MASK 0x200 /begin IF_DATA ASAP1B_ADDRESS KP_BLOB 0xfd42 /end IF_DATA /end MEASUREMENT
/begin MEASUREMENT last_d_zw_mz4 "Lastdynamik ZW" UWORD RANGE________aktiv___1H__1H__895 2 2.0 0 65535 BIT_MASK 0x10 /begin IF_DATA ASAP1B_ADDRESS KP_BLOB 0xfd52 /end IF_DATA /end MEASUREMENT
/begin MEASUREMENT ldp_ventil "LDP_VENTIL" UWORD RANGE________EIN___1H__1H____949 2 2.0 0 65535 BIT_MASK 0x400 /begin IF_DATA ASAP1B_ADDRESS KP_BLOB 0xfda2 /end IF_DATA /end MEASUREMENT
/begin MEASUREMENT lecktest_state "LECKTEST_STATE" SBYTE LINEAR_______128_000000__FFFF950 2 2.0 -128.0 127.0 BIT_MASK 0xffffffff /begin IF_DATA ASAP1B_ADDRESS KP_BLOB 0xc1fb /end IF_DATA /end MEASUREMENT
/begin MEASUREMENT lecktest_status "LECKTEST_STATUS" SBYTE LECKTEST_RANGE 2 2.0 -128 127 BIT_MASK 0xffffffff /begin IF_DATA ASAP1B_ADDRESS KP_BLOB 0xc1fb /end IF_DATA /end MEASUREMENT
/begin MEASUREMENT ll_ad_flags "" UWORD LINEAR______0_000000__0H___65904 2 2.0 0.0 65535.0 BIT_MASK 0xffffffff /begin IF_DATA ASAP1B_ADDRESS KP_BLOB 0xfd5e /end IF_DATA /end MEASUREMENT
/begin MEASUREMENT llfs_limphome "LLFS_Notlauf" UWORD RANGE________aktiv___1H__1H__913 2 2.0 0 65535 BIT_MASK 0x100 /begin IF_DATA ASAP1B_ADDRESS KP_BLOB 0xfd5a /end IF_DATA /end MEASUREMENT
/begin MEASUREMENT lm "Luftmasse_mg/Hub " UWORD MAF_16_RES46 2 2.0 0.0 1389.0 BIT_MASK 0xffffffff /begin IF_DATA ASAP1B_ADDRESS KP_BLOB 0xfa42 /end IF_DATA /end MEASUREMENT
/begin MEASUREMENT lm_add "LM_ADD" SWORD LINEAR_______694_680000__FFFF800 2 2.0 -694.68 694.66 BIT_MASK 0xffffffff /begin IF_DATA ASAP1B_ADDRESS KP_BLOB 0xe22c /end IF_DATA /end MEASUREMENT
/begin MEASUREMENT lm_add_kor "LM_ADD_KOR" UBYTE MAF_8_RES37 2 2.0 0.0 1389.0 BIT_MASK 0xffffffff /begin IF_DATA ASAP1B_ADDRESS KP_BLOB 0xc1cc /end IF_DATA /end MEASUREMENT
/begin MEASUREMENT lm_add_llfs_ers_diag "LM_ADD_LLFS_ERS_DIAG" UWORD MAF_16_RES146 2 2.0 0.0 1389.0 BIT_MASK 0xffffffff /begin IF_DATA ASAP1B_ADDRESS KP_BLOB 0xfa2c /end IF_DATA /end MEASUREMENT
/begin MEASUREMENT lm_ers_diag "LM_ERS_DIAG" UWORD MAF_16_RES146 2 2.0 0.0 1389.0 BIT_MASK 0xffffffff /begin IF_DATA ASAP1B_ADDRESS KP_BLOB 0xfa50 /end IF_DATA /end MEASUREMENT
/begin MEASUREMENT lm_ers_van "LM_ERS_VAN" UBYTE MAF_8_RES37 2 2.0 0.0 1389.0 BIT_MASK 0xffffffff /begin IF_DATA ASAP1B_ADDRESS KP_BLOB 0xc425 /end IF_DATA /end MEASUREMENT
/begin MEASUREMENT lm_fc "LM_FC" UWORD MAF_16_RES46 2 2.0 0.0 1389.0 BIT_MASK 0xffffffff /begin IF_DATA ASAP1B_ADDRESS KP_BLOB 0xe25a /end IF_DATA /end MEASUREMENT
/begin MEASUREMENT lm_gem "LM_GEM" UWORD MAF_16_RES46 2 2.0 0.0 1389.0 BIT_MASK 0xffffffff /begin IF_DATA ASAP1B_ADDRESS KP_BLOB 0xfa3c /end IF_DATA /end MEASUREMENT
/begin MEASUREMENT lm_gmw "LM_GMW" UWORD MAF_16_RES46 2 2.0 0.0 1389.0 BIT_MASK 0xffffffff /begin IF_DATA ASAP1B_ADDRESS KP_BLOB 0xfa3e /end IF_DATA /end MEASUREMENT
/begin MEASUREMENT lm_gmw_dif "LM_GMW_DIF" UWORD MAF_16_RES46 2 2.0 0.0 1389.0 BIT_MASK 0xffffffff /begin IF_DATA ASAP1B_ADDRESS KP_BLOB 0xfa40 /end IF_DATA /end MEASUREMENT
/begin MEASUREMENT lm_gmw_katvwordC1D "LM_GMW_KAT" UWORD MAF_16_RES46 2 2.0 0.0 1389.0 BIT_MASK 0xffffffff /begin IF_DATA ASAP1B_ADDRESS KP_BLOB 0xe270 /end IF_DATA /end MEASUREMENT
/begin MEASUREMENT lm_int_mon_pr_nsa "LM_INT_NKAT_NSA" UWORD LM_INT_SA_RANGE733 2 2.0 0.0 1820.42 BIT_MASK 0xffffffff /begin IF_DATA ASAP1B_ADDRESS KP_BLOB 0xe1d2 /end IF_DATA /end MEASUREMENT
/begin MEASUREMENT lm_int_mon_pr_sa "LM_INT_NKAT_SA" UWORD LM_INT_SA_RANGE733 2 2.0 0.0 1820.42 BIT_MASK 0xffffffff /begin IF_DATA ASAP1B_ADDRESS KP_BLOB 0xe1d0 /end IF_DATA /end MEASUREMENT
/begin MEASUREMENT lm_int_sa "LM_INT_SA" UWORD LM_INT_SA_RANGE733 2 2.0 0.0 1820.42 BIT_MASK 0xffffffff /begin IF_DATA ASAP1B_ADDRESS KP_BLOB 0xe206 /end IF_DATA /end MEASUREMENT
/begin MEASUREMENT lm_int_zv_hst "LM_INT_ZV_HST" UWORD LM_INT_SA_RANGE733 2 2.0 0.0 1820.42 BIT_MASK 0xffffffff /begin IF_DATA ASAP1B_ADDRESS KP_BLOB 0xe20c /end IF_DATA /end MEASUREMENT
/begin MEASUREMENT lm_int_zv_sa "LM_INT_ZV_SA" UWORD LM_INT_SA_RANGE733 2 2.0 0.0 1820.42 BIT_MASK 0xffffffff /begin IF_DATA ASAP1B_ADDRESS KP_BLOB 0xe208 /end IF_DATA /end MEASUREMENT
/begin MEASUREMENT lm_int_zv_slp_kh "LM_INT_ZV_SLP_KH" UWORD LM_INT_SA_RANGE733 2 2.0 0.0 1820.42 BIT_MASK 0xffffffff /begin IF_DATA ASAP1B_ADDRESS KP_BLOB 0xe20a /end IF_DATA /end MEASUREMENT
/begin MEASUREMENT lm_kg_h "Luftmasse_kg/h" UWORD MAF_KGH_16_RES117 2 2.0 0.0 16383.75 BIT_MASK 0xffffffff /begin IF_DATA ASAP1B_ADDRESS KP_BLOB 0xfa46 /end IF_DATA /end MEASUREMENT
/begin MEASUREMENT lm_kg_h_diag "LM_KG_H_DIAG" UWORD MAF_KGH_16_RES117 2 2.0 0.0 16383.75 BIT_MASK 0xffffffff /begin IF_DATA ASAP1B_ADDRESS KP_BLOB 0xfa52 /end IF_DATA /end MEASUREMENT
/begin MEASUREMENT lm_kr "Luftmasse KR" UBYTE MAF_8_RES37 2 2.0 0.0 1389.0 BIT_MASK 0xffffffff /begin IF_DATA ASAP1B_ADDRESS KP_BLOB 0xc468 /end IF_DATA /end MEASUREMENT
/begin MEASUREMENT lm_soll_llfs_kgh "LM_SOLL_LLFS_KGH" UWORD MAF_KGH_16_RES951 2 2.0 0.0 16383.75 BIT_MASK 0xffffffff /begin IF_DATA ASAP1B_ADDRESS KP_BLOB 0xe16a /end IF_DATA /end MEASUREMENT
/begin MEASUREMENT lm_van "Vanos_Luftmasse_mg/Hub" UWORD MAF_16_RES46 2 2.0 0.0 1389.0 BIT_MASK 0xffffffff /begin IF_DATA ASAP1B_ADDRESS KP_BLOB 0xfa44 /end IF_DATA /end MEASUREMENT
/begin MEASUREMENT lm_zdg "LM_ZDG" UWORD MAF_16_RES46 2 2.0 0.0 1389.0 BIT_MASK 0xffffffff /begin IF_DATA ASAP1B_ADDRESS KP_BLOB 0xfa28 /end IF_DATA /end MEASUREMENT
/begin MEASUREMENT lm_zw "LM_ZW" UWORD MAF_16_RES46 2 2.0 0.0 1389.0 BIT_MASK 0xffffffff /begin IF_DATA ASAP1B_ADDRESS KP_BLOB 0xfa26 /end IF_DATA /end MEASUREMENT
/begin MEASUREMENT lrvanz_lam_bank "ANZ_LAM_BANK" UBYTE LINEAR______0_000000__0H___25142 2 2.0 0.0 255.0 BIT_MASK 0xffffffff /begin IF_DATA ASAP1B_ADDRESS KP_BLOB 0xe4fe /end IF_DATA /end MEASUREMENT
/begin MEASUREMENT lrvksd_sperr "KSD_SPERR" UBYTE LINEAR______0_000000__0H___25142 2 2.0 0.0 255.0 BIT_MASK 0xffffffff /begin IF_DATA ASAP1B_ADDRESS KP_BLOB 0xe4ff /end IF_DATA /end MEASUREMENT
/begin MEASUREMENT lrvlam_inst "LAM_INST" UWORD LINEAR_______50_000000__0H___49_ 2 2.0 -50.0 49.998501 BIT_MASK 0xffffffff /begin IF_DATA ASAP1B_ADDRESS KP_BLOB 0xe4fc /end IF_DATA /end MEASUREMENT
/begin MEASUREMENT lrvlammw_dif_te "LAMMW_DIF_TE" UWORD LINEAR_______50_000000__0H___49_ 2 2.0 -50.0 49.998501 BIT_MASK 0xffffffff /begin IF_DATA ASAP1B_ADDRESS KP_BLOB 0xe4f8 /end IF_DATA /end MEASUREMENT
/begin MEASUREMENT lrvlammw_dif_te_be "LAMMW_DIF_TE_BE" UWORD LINEAR_______50_000000__0H___49_ 2 2.0 -50.0 49.998501 BIT_MASK 0xffffffff /begin IF_DATA ASAP1B_ADDRESS KP_BLOB 0xe4fa /end IF_DATA /end MEASUREMENT
/begin MEASUREMENT lr_abw1 "LR_ABW1" UWORD LINEAR_______31_250000__3000H952 2 2.0 -31.25 31.25 BIT_MASK 0xffffffff /begin IF_DATA ASAP1B_ADDRESS KP_BLOB 0xe204 /end IF_DATA /end MEASUREMENT
/begin MEASUREMENT lr_abw2 "LR_ABW2" UWORD LINEAR_______31_250000__3000H952 2 2.0 -31.25 31.25 BIT_MASK 0xffffffff /begin IF_DATA ASAP1B_ADDRESS KP_BLOB 0xe220 /end IF_DATA /end MEASUREMENT
/begin MEASUREMENT LR_BANK "LR_BANK" UWORD RANGE________Bank1___0H__0H____B 2 2.0 0 65535 BIT_MASK 0x400 /begin IF_DATA ASAP1B_ADDRESS KP_BLOB 0xfd48 /end IF_DATA /end MEASUREMENT
/begin MEASUREMENT lr_bank1vanz_fett "ANZ_FETT_MAGER_1" UWORD LINEAR______0_000000__0H___65163 2 2.0 0.0 65535.0 BIT_MASK 0xffffffff /begin IF_DATA ASAP1B_ADDRESS KP_BLOB 0xe37c /end IF_DATA /end MEASUREMENT
/begin MEASUREMENT lr_bank1vanz_frq_diag "ANZ_FRQ_DIAG_1" UWORD LINEAR______0_000000__0H___65163 2 2.0 0.0 65535.0 BIT_MASK 0xffffffff /begin IF_DATA ASAP1B_ADDRESS KP_BLOB 0xe3c0 /end IF_DATA /end MEASUREMENT
/begin MEASUREMENT lr_bank1vanz_gem_zust_wechsel "lr_bank1^anz_gem_zust_wechsel" UBYTE LINEAR______0_000000__0H___25182 2 2.0 0.0 255.0 BIT_MASK 0xffffffff /begin IF_DATA ASAP1B_ADDRESS KP_BLOB 0xe3f2 /end IF_DATA /end MEASUREMENT
/begin MEASUREMENT lr_bank1vanz_kat_diag "ANZ_KAT_DIAG_1" UWORD LINEAR______0_000000__0H___65163 2 2.0 0.0 65535.0 BIT_MASK 0xffffffff /begin IF_DATA ASAP1B_ADDRESS KP_BLOB 0xe3be /end IF_DATA /end MEASUREMENT
/begin MEASUREMENT lr_bank1vanz_lam_p "ANZ_LAM_P_1" UBYTE LINEAR______0_000000__0H___25182 2 2.0 0.0 255.0 BIT_MASK 0xffffffff /begin IF_DATA ASAP1B_ADDRESS KP_BLOB 0xe3e0 /end IF_DATA /end MEASUREMENT
/begin MEASUREMENT lr_bank1vanz_mager "ANZ_MAGER_FETT_1" UWORD LINEAR______0_000000__0H___65163 2 2.0 0.0 65535.0 BIT_MASK 0xffffffff /begin IF_DATA ASAP1B_ADDRESS KP_BLOB 0xe37a /end IF_DATA /end MEASUREMENT
/begin MEASUREMENT lr_bank1vanz_mager_uls_sl_diag "ANZ_MAGER_ULS_SL_DIAG_1" UWORD LINEAR______0_000000__0H___65163 2 2.0 0.0 65535.0 BIT_MASK 0xffffffff /begin IF_DATA ASAP1B_ADDRESS KP_BLOB 0xe35e /end IF_DATA /end MEASUREMENT
/begin MEASUREMENT lr_bank1vanz_p_begr_dyn "lr_bank1^anz_p_begr_dyn" UBYTE LINEAR______0_000000__0H___25182 2 2.0 0.0 255.0 BIT_MASK 0xffffffff /begin IF_DATA ASAP1B_ADDRESS KP_BLOB 0xe3f6 /end IF_DATA /end MEASUREMENT
/begin MEASUREMENT lr_bank1vanz_p_kat "ANZ_P_KAT_1" UBYTE LINEAR______0_000000__0H___25182 2 2.0 0.0 255.0 BIT_MASK 0xffffffff /begin IF_DATA ASAP1B_ADDRESS KP_BLOB 0xe3f0 /end IF_DATA /end MEASUREMENT
/begin MEASUREMENT lr_bank1vanz_p_lr_anschl "lr_bank1^anz_p_lr_anschl" UBYTE LINEAR______0_000000__0H___25182 2 2.0 0.0 255.0 BIT_MASK 0xffffffff /begin IF_DATA ASAP1B_ADDRESS KP_BLOB 0xe3f5 /end IF_DATA /end MEASUREMENT
/begin MEASUREMENT lr_bank1vanz_p_ls_diag "lr_bank1^anz_p_ls_diag" UBYTE LINEAR______0_000000__0H___25182 2 2.0 0.0 255.0 BIT_MASK 0xffffffff /begin IF_DATA ASAP1B_ADDRESS KP_BLOB 0xe3fc /end IF_DATA /end MEASUREMENT
/begin MEASUREMENT lr_bank1vanz_p_ra_untbr "lr_bank1^anz_p_ra_untbr" UBYTE LINEAR______0_000000__0H___25182 2 2.0 0.0 255.0 BIT_MASK 0xffffffff /begin IF_DATA ASAP1B_ADDRESS KP_BLOB 0xe3f4 /end IF_DATA /end MEASUREMENT
/begin MEASUREMENT lr_bank1vanz_p_spr "lr_bank1^anz_p_spr" UBYTE LINEAR______0_000000__0H___25182 2 2.0 0.0 255.0 BIT_MASK 0xffffffff /begin IF_DATA ASAP1B_ADDRESS KP_BLOB 0xe3f3 /end IF_DATA /end MEASUREMENT
/begin MEASUREMENT lr_bank1vanz_p_te "ANZ_P_TE_1" UBYTE LINEAR______0_000000__0H___25182 2 2.0 0.0 255.0 BIT_MASK 0xffffffff /begin IF_DATA ASAP1B_ADDRESS KP_BLOB 0xe3e1 /end IF_DATA /end MEASUREMENT
/begin MEASUREMENT lr_bank1vanz_uls_kat_diag "ANZ_ULS_KAT_DIAG_1" UBYTE LINEAR______0_000000__0H___25142 2 2.0 0.0 255.0 BIT_MASK 0xffffffff /begin IF_DATA ASAP1B_ADDRESS KP_BLOB 0xe403 /end IF_DATA /end MEASUREMENT
/begin MEASUREMENT lr_bank1vdk_grd_dec_ctr "lr_bank1^dk_grd_dec_ctr" UBYTE LINEAR______0_000000__0H___5_120 2 2.0 0.0 5.12 BIT_MASK 0xffffffff /begin IF_DATA ASAP1B_ADDRESS KP_BLOB 0xe3d7 /end IF_DATA /end MEASUREMENT
/begin MEASUREMENT lr_bank1vdk_grd_sum "DK_GRD_SUM_1" UWORD LINEAR______0_000000__0H___76791 2 2.0 0.0 767916.0 BIT_MASK 0xffffffff /begin IF_DATA ASAP1B_ADDRESS KP_BLOB 0xe390 /end IF_DATA /end MEASUREMENT
/begin MEASUREMENT lr_bank1vdk_grd_sum_zv "DK_GRD_SUM_ZV_1" UWORD LINEAR______0_000000__0H___76953 2 2.0 0.0 767916.0 BIT_MASK 0xffffffff /begin IF_DATA ASAP1B_ADDRESS KP_BLOB 0xe392 /end IF_DATA /end MEASUREMENT
/begin MEASUREMENT lr_bank1vdrehzahl_mwvword "N_MW1" UWORD LINEAR______1_000000__1H___81954 2 2.0 1.0 8160.0 BIT_MASK 0xffffffff /begin IF_DATA ASAP1B_ADDRESS KP_BLOB 0xe342 /end IF_DATA /end MEASUREMENT
/begin MEASUREMENT lr_bank1vkat_diag "KAT_DIAG_1" UWORD LINEAR______0_000000__0H___255_9 2 2.0 0.0 255.996 BIT_MASK 0xffffffff /begin IF_DATA ASAP1B_ADDRESS KP_BLOB 0xe3c2 /end IF_DATA /end MEASUREMENT
/begin MEASUREMENT lr_bank1vkat_diag_bk_flags "KAT_DIAG_BK_FLAGS_1" UWORD LINEAR______0_000000__0H___65904 2 2.0 0.0 65535.0 BIT_MASK 0xffffffff /begin IF_DATA ASAP1B_ADDRESS KP_BLOB 0xe34a /end IF_DATA /end MEASUREMENT
/begin MEASUREMENT lr_bank1vkat_diag_err "KAT_DIAG_ERR_1" UBYTE LINEAR______0_000000__0H___25182 2 2.0 0.0 255.0 BIT_MASK 0xffffffff /begin IF_DATA ASAP1B_ADDRESS KP_BLOB 0xe3e9 /end IF_DATA /end MEASUREMENT
/begin MEASUREMENT lr_bank1vkf_t_zv_lr_neg "KF_T_ZV_LR_NEG_1" UWORD LINEAR______0_000000__0H___1_955 2 2.0 0.0 1.2799 BIT_MASK 0xffffffff /begin IF_DATA ASAP1B_ADDRESS KP_BLOB 0xe3b6 /end IF_DATA /end MEASUREMENT
/begin MEASUREMENT lr_bank1vkf_t_zv_lr_pos "KF_T_ZV_LR_POS_1" UWORD LINEAR______0_000000__0H___1_955 2 2.0 0.0 1.2799 BIT_MASK 0xffffffff /begin IF_DATA ASAP1B_ADDRESS KP_BLOB 0xe3b4 /end IF_DATA /end MEASUREMENT
/begin MEASUREMENT lr_bank1vkf_ti_ad_add_fak "KF_TI_AD_ADD_FAK_1" UBYTE LINEAR______0_000000__0H___0_923 2 2.0 0.0 0.99610001 BIT_MASK 0xffffffff /begin IF_DATA ASAP1B_ADDRESS KP_BLOB 0xe3e3 /end IF_DATA /end MEASUREMENT
/begin MEASUREMENT lr_bank1vkf_ti_ad_fak_fak "KF_TI_AD_FAK_FAK_1" UBYTE LINEAR______0_000000__0H___0_923 2 2.0 0.0 0.99610001 BIT_MASK 0xffffffff /begin IF_DATA ASAP1B_ADDRESS KP_BLOB 0xe3e2 /end IF_DATA /end MEASUREMENT
/begin MEASUREMENT lr_bank1vlam_i "LAM_I_1" UWORD LINEAR_______50_000000__0H___49_ 2 2.0 -50.0 49.998501 BIT_MASK 0xffffffff /begin IF_DATA ASAP1B_ADDRESS KP_BLOB 0xe32c /end IF_DATA /end MEASUREMENT
/begin MEASUREMENT lr_bank1vlambda_intvbyteC1D "Lambda_Int_1" UBYTE LINEAR_______50_000000__0H___956 2 2.0 -50.0 49.609001 BIT_MASK 0xffffffff /begin IF_DATA ASAP1B_ADDRESS KP_BLOB 0xe33d /end IF_DATA /end MEASUREMENT
/begin MEASUREMENT lr_bank1vlammwvbyteC1D "LAMMW_1" UBYTE LINEAR_______50_000000__0H___957 2 2.0 -50.0 49.609001 BIT_MASK 0xffffffff /begin IF_DATA ASAP1B_ADDRESS KP_BLOB 0xe341 /end IF_DATA /end MEASUREMENT
/begin MEASUREMENT lr_bank1vlammw_gmw_katvwordC1D "LAMMW_GMW_KAT_1" UWORD LINEAR_______50_000000__0H___947 2 2.0 -50.0 49.998501 BIT_MASK 0xffffffff /begin IF_DATA ASAP1B_ADDRESS KP_BLOB 0xe352 /end IF_DATA /end MEASUREMENT
/begin MEASUREMENT lr_bank1vlammw_mwvbyteC1D "LAMMW_MW_1" UBYTE LINEAR_______50_000000__0H___957 2 2.0 -50.0 49.609001 BIT_MASK 0xffffffff /begin IF_DATA ASAP1B_ADDRESS KP_BLOB 0xe33f /end IF_DATA /end MEASUREMENT
/begin MEASUREMENT lr_bank1vlm_int_kat "LM_INT_KAT_1" UWORD LM_INT_SA_RANGE731 2 2.0 0.0 1820.42 BIT_MASK 0xffffffff /begin IF_DATA ASAP1B_ADDRESS KP_BLOB 0xe3c6 /end IF_DATA /end MEASUREMENT
/begin MEASUREMENT lr_bank1vlm_int_zv "LM_INT_ZV_1" UWORD LM_INT_SA_RANGE733 2 2.0 0.0 1820.42 BIT_MASK 0xffffffff /begin IF_DATA ASAP1B_ADDRESS KP_BLOB 0xe3a6 /end IF_DATA /end MEASUREMENT
/begin MEASUREMENT lr_bank1vlm_int_zv_pi "LM_INT_ZV_PI_1" UWORD LM_INT_SA_RANGE733 2 2.0 0.0 1820.42 BIT_MASK 0xffffffff /begin IF_DATA ASAP1B_ADDRESS KP_BLOB 0xe3a8 /end IF_DATA /end MEASUREMENT
/begin MEASUREMENT lr_bank1vlm_mwvbyteC1D "LM_MW1" UBYTE MAF_8_RES37 2 2.0 0.0 1389.0 BIT_MASK 0xffffffff /begin IF_DATA ASAP1B_ADDRESS KP_BLOB 0xe345 /end IF_DATA /end MEASUREMENT
/begin MEASUREMENT lr_bank1vlr_fak "LAM_1" UWORD LINEAR_______50_000000__0H___49_ 2 2.0 -50.0 49.998501 BIT_MASK 0xffffffff /begin IF_DATA ASAP1B_ADDRESS KP_BLOB 0xe328 /end IF_DATA /end MEASUREMENT
/begin MEASUREMENT lr_bank1vlr_fak_alt "LAM_ALT_1" UWORD LINEAR_______50_000000__0H___49_ 2 2.0 -50.0 49.998501 BIT_MASK 0xffffffff /begin IF_DATA ASAP1B_ADDRESS KP_BLOB 0xe32a /end IF_DATA /end MEASUREMENT
/begin MEASUREMENT lr_bank1vlr_grz_fett "LR_GRZ_FETT_1" UWORD LINEAR_______50_000000__0H___49_ 2 2.0 -50.0 49.998501 BIT_MASK 0xffffffff /begin IF_DATA ASAP1B_ADDRESS KP_BLOB 0xe330 /end IF_DATA /end MEASUREMENT
/begin MEASUREMENT lr_bank1vlr_grz_mager "LR_GRZ_MAGER_1" UWORD LINEAR_______50_000000__0H___49_ 2 2.0 -50.0 49.998501 BIT_MASK 0xffffffff /begin IF_DATA ASAP1B_ADDRESS KP_BLOB 0xe32e /end IF_DATA /end MEASUREMENT
/begin MEASUREMENT lr_bank1vlr_zustvbyteC0D "" UBYTE LINEAR______0_000000__0H___25905 2 2.0 0.0 255.0 BIT_MASK 0xffffffff /begin IF_DATA ASAP1B_ADDRESS KP_BLOB 0xe324 /end IF_DATA /end MEASUREMENT
/begin MEASUREMENT lr_bank1vlr_zustvbyteC1D "" UBYTE LINEAR______0_000000__0H___25905 2 2.0 0.0 255.0 BIT_MASK 0xffffffff /begin IF_DATA ASAP1B_ADDRESS KP_BLOB 0xe325 /end IF_DATA /end MEASUREMENT
/begin MEASUREMENT lr_bank1vlr1vbyteC0D "" UBYTE LINEAR______0_000000__0H___25905 2 2.0 0.0 255.0 BIT_MASK 0xffffffff /begin IF_DATA ASAP1B_ADDRESS KP_BLOB 0xe326 /end IF_DATA /end MEASUREMENT
/begin MEASUREMENT lr_bank1vlr1vbyteC1D "" UBYTE LINEAR______0_000000__0H___25905 2 2.0 0.0 255.0 BIT_MASK 0xffffffff /begin IF_DATA ASAP1B_ADDRESS KP_BLOB 0xe327 /end IF_DATA /end MEASUREMENT
/begin MEASUREMENT lr_bank1vo2_kat "O2_KAT1" UBYTE LINEAR______0_000000__0H___0_965 2 2.0 0.0 0.99609375 BIT_MASK 0xffffffff /begin IF_DATA ASAP1B_ADDRESS KP_BLOB 0xe3d4 /end IF_DATA /end MEASUREMENT
/begin MEASUREMENT lr_bank1vo2_kat_dif_sum "O2_KAT_DIF_SUM_1" UWORD LINEAR______0_000000__0H___25741 2 2.0 0.0 255.996 BIT_MASK 0xffffffff /begin IF_DATA ASAP1B_ADDRESS KP_BLOB 0xe3b8 /end IF_DATA /end MEASUREMENT
/begin MEASUREMENT lr_bank1vo2_kat_int "O2_KAT_INT_1" UBYTE LINEAR______0_000000__0H___0_965 2 2.0 0.0 0.99609375 BIT_MASK 0xffffffff /begin IF_DATA ASAP1B_ADDRESS KP_BLOB 0xe3d1 /end IF_DATA /end MEASUREMENT
/begin MEASUREMENT lr_bank1vo2_kat_mw "O2_KAT_MW_1" UBYTE LINEAR______0_000000__0H___0_965 2 2.0 0.0 0.99609375 BIT_MASK 0xffffffff /begin IF_DATA ASAP1B_ADDRESS KP_BLOB 0xe3d0 /end IF_DATA /end MEASUREMENT
/begin MEASUREMENT lr_bank1vo2_kat_mw_alt "O2_KAT_MW_ALT_1" UBYTE LINEAR______0_000000__0H___0_965 2 2.0 0.0 0.99609375 BIT_MASK 0xffffffff /begin IF_DATA ASAP1B_ADDRESS KP_BLOB 0xe3d2 /end IF_DATA /end MEASUREMENT
/begin MEASUREMENT lr_bank1vo2_kat_quo "O2_KAT_QUO_1" UWORD LINEAR______0_000000__0H___1_989 2 2.0 0.0 1.989 BIT_MASK 0xffffffff /begin IF_DATA ASAP1B_ADDRESS KP_BLOB 0xe3c4 /end IF_DATA /end MEASUREMENT
/begin MEASUREMENT lr_bank1vo2_kat_quo_sum "O2_KAT_QUO_SUM_1" UWORD LINEAR______0_000000__0H___255_9 2 2.0 0.0 255.996 BIT_MASK 0xffffffff /begin IF_DATA ASAP1B_ADDRESS KP_BLOB 0xe3bc /end IF_DATA /end MEASUREMENT
/begin MEASUREMENT lr_bank1vo2_kat_sum "O2_KAT_SUM_1" UWORD LINEAR______0_000000__0H___25741 2 2.0 0.0 255.996 BIT_MASK 0xffffffff /begin IF_DATA ASAP1B_ADDRESS KP_BLOB 0xe3ba /end IF_DATA /end MEASUREMENT
/begin MEASUREMENT lr_bank1vsl_diag_flags "SL_DIAG_FLAGS_1" UBYTE LINEAR______0_000000__0H___25142 2 2.0 0.0 255.0 BIT_MASK 0xffffffff /begin IF_DATA ASAP1B_ADDRESS KP_BLOB 0xe35c /end IF_DATA /end MEASUREMENT
/begin MEASUREMENT lr_bank1vstate_nkat_diag "STATE_NKAT_DIAG_1" UBYTE LINEAR______0_000000__0H___25958 2 2.0 0.0 255.0 BIT_MASK 0xffffffff /begin IF_DATA ASAP1B_ADDRESS KP_BLOB 0xe402 /end IF_DATA /end MEASUREMENT
/begin MEASUREMENT lr_bank1vsum_mitko_ti_ad_add_ber "SUM_MITKO_TI_AD_ADD_BER_1" UWORD LINEAR______0_000000__0H___25959 2 2.0 0.0 255.996 BIT_MASK 0xffffffff /begin IF_DATA ASAP1B_ADDRESS KP_BLOB 0xe3f8 /end IF_DATA /end MEASUREMENT
/begin MEASUREMENT lr_bank1vsum_mitko_ti_ad_fak_ber "SUM_MITKO_TI_AD_FAK_BER_1" UWORD LINEAR______0_000000__0H___25959 2 2.0 0.0 255.996 BIT_MASK 0xffffffff /begin IF_DATA ASAP1B_ADDRESS KP_BLOB 0xe3fa /end IF_DATA /end MEASUREMENT
/begin MEASUREMENT lr_bank1vt_ksd_sum_max "T_KSD_SUM_MAX_1" UWORD LINEAR______0_000000__0H___13960 2 2.0 0.0 1310.7 BIT_MASK 0xffffffff /begin IF_DATA ASAP1B_ADDRESS KP_BLOB 0xe388 /end IF_DATA /end MEASUREMENT
/begin MEASUREMENT lr_bank1vt_ksd_sum_min "T_KSD_SUM_MIN_1" UWORD LINEAR______0_000000__0H___13960 2 2.0 0.0 1310.7 BIT_MASK 0xffffffff /begin IF_DATA ASAP1B_ADDRESS KP_BLOB 0xe38a /end IF_DATA /end MEASUREMENT
/begin MEASUREMENT lr_bank1vt_zv_ad "T_ZV_LAM_AD_1" SWORD LINEAR_______640_020000__FFFF800 2 2.0 -640.02 639.98 BIT_MASK 0xffffffff /begin IF_DATA ASAP1B_ADDRESS KP_BLOB 0xe3a0 /end IF_DATA /end MEASUREMENT
/begin MEASUREMENT lr_bank1vt_zv_ad_gmw "T_ZV_LAM_AD_GMW_1" SWORD LINEAR_______640_020000__FFFF800 2 2.0 -640.02 639.98 BIT_MASK 0xffffffff /begin IF_DATA ASAP1B_ADDRESS KP_BLOB 0xe3a2 /end IF_DATA /end MEASUREMENT
/begin MEASUREMENT lr_bank1vt_zv_ivwordC1D "T_ZV_LAM_I_1" SWORD LINEAR_______640_020000__FFFF800 2 2.0 -640.02 639.98 BIT_MASK 0xffffffff /begin IF_DATA ASAP1B_ADDRESS KP_BLOB 0xe39e /end IF_DATA /end MEASUREMENT
/begin MEASUREMENT lr_bank1vt_zv_lam "T_ZV_LAM_1" SWORD LINEAR_______1280_000000__FFFFC0 2 2.0 -1280.0 1279.9 BIT_MASK 0xffffffff /begin IF_DATA ASAP1B_ADDRESS KP_BLOB 0xe3a4 /end IF_DATA /end MEASUREMENT
/begin MEASUREMENT lr_bank1vt_zv_lam_neg "T_ZV_LAM_NEG_1" UWORD LINEAR______0_000000__0H___5_119 2 2.0 0.0 5.1196 BIT_MASK 0xffffffff /begin IF_DATA ASAP1B_ADDRESS KP_BLOB 0xe398 /end IF_DATA /end MEASUREMENT
/begin MEASUREMENT lr_bank1vt_zv_lam_pos "T_ZV_LAM_POS_1" UWORD LINEAR______0_000000__0H___5_119 2 2.0 0.0 5.1196 BIT_MASK 0xffffffff /begin IF_DATA ASAP1B_ADDRESS KP_BLOB 0xe396 /end IF_DATA /end MEASUREMENT
/begin MEASUREMENT lr_bank1vt_zv_p "T_ZV_LAM_P_1" SWORD LINEAR_______640_020000__FFFF800 2 2.0 -640.02 639.98 BIT_MASK 0xffffffff /begin IF_DATA ASAP1B_ADDRESS KP_BLOB 0xe39a /end IF_DATA /end MEASUREMENT
/begin MEASUREMENT lr_bank1vti_ad_add_gmw "TI_AD_ADD_GMW_1" UWORD TI_SGN_16_RES 2 2.0 -131.072 131.068 BIT_MASK 0xffffffff /begin IF_DATA ASAP1B_ADDRESS KP_BLOB 0xe332 /end IF_DATA /end MEASUREMENT
/begin MEASUREMENT lr_bank1vti_ad_add_gmw_ms "TI_AD_ADD_GMW_MS_1" SWORD TI_2co_SGN_16_RES 2 2.0 -131.072 131.068 BIT_MASK 0xffffffff /begin IF_DATA ASAP1B_ADDRESS KP_BLOB 0xe334 /end IF_DATA /end MEASUREMENT
/begin MEASUREMENT lr_bank1vti_ad_add_gmw_pr "TI_AD_ADD_GMW_PR_1" SWORD LINEAR_______50_000000__FFFF8961 2 2.0 -50.0 49.998501 BIT_MASK 0xffffffff /begin IF_DATA ASAP1B_ADDRESS KP_BLOB 0xe336 /end IF_DATA /end MEASUREMENT
/begin MEASUREMENT lr_bank1vti_ad_fak_gmw "TI_AD_FAK_GMW_1" UWORD LINEAR_______50_000000__0H___947 2 2.0 -50.0 49.998501 BIT_MASK 0xffffffff /begin IF_DATA ASAP1B_ADDRESS KP_BLOB 0xe338 /end IF_DATA /end MEASUREMENT
/begin MEASUREMENT lr_bank1vti_ks "TI_KS_1" UWORD LINEAR______0_000000__0H___15962 2 2.0 0.0 15.99975 BIT_MASK 0xffffffff /begin IF_DATA ASAP1B_ADDRESS KP_BLOB 0xe384 /end IF_DATA /end MEASUREMENT
/begin MEASUREMENT lr_bank1vti_lam "TI_LAM_1" UWORD LINEAR_______100_00000__0H___100 2 2.0 -100.0 100.0 BIT_MASK 0xffffffff /begin IF_DATA ASAP1B_ADDRESS KP_BLOB 0xe33a /end IF_DATA /end MEASUREMENT
/begin MEASUREMENT lr_bank1vti_ohne_totz "TI_OHNE_TOTZ_1" UWORD LINEAR______0_000000__0H___26921 2 2.0 0.0 262.144 BIT_MASK 0xffffffff /begin IF_DATA ASAP1B_ADDRESS KP_BLOB 0xe386 /end IF_DATA /end MEASUREMENT
/begin MEASUREMENT lr_bank1vtib "TIB_1" UWORD LINEAR______0_000000__0H___26963 2 2.0 0.0 262.144 BIT_MASK 0xffffffff /begin IF_DATA ASAP1B_ADDRESS KP_BLOB 0xe382 /end IF_DATA /end MEASUREMENT
/begin MEASUREMENT lr_bank1vtkat "TKAT_1" UWORD LINEAR______0_000000__0H___10964 2 2.0 0.0 1023.0 BIT_MASK 0xffffffff /begin IF_DATA ASAP1B_ADDRESS KP_BLOB 0xe360 /end IF_DATA /end MEASUREMENT
/begin MEASUREMENT lr_bank1vuls "ULS_VKAT_1_NDIAG" UBYTE LINEAR______0_000000__0H___1_873 2 2.0 0.0 1.275 BIT_MASK 0xffffffff /begin IF_DATA ASAP1B_ADDRESS KP_BLOB 0xe3d9 /end IF_DATA /end MEASUREMENT
/begin MEASUREMENT lr_bank1vuls_10ms "ULS_VKAT_1_VDIAG_10MS" UBYTE LINEAR______0_000000__0H___1_873 2 2.0 0.0 1.275 BIT_MASK 0xffffffff /begin IF_DATA ASAP1B_ADDRESS KP_BLOB 0xe3e4 /end IF_DATA /end MEASUREMENT
/begin MEASUREMENT lr_bank1vuls_alt "ULS_VKAT_1_VDIAG_ALT" UBYTE LINEAR______0_000000__0H___1_873 2 2.0 0.0 1.275 BIT_MASK 0xffffffff /begin IF_DATA ASAP1B_ADDRESS KP_BLOB 0xe3e6 /end IF_DATA /end MEASUREMENT
/begin MEASUREMENT lr_bank1vuls_diag_zust "ULS_DIAG_ZUST_1" UBYTE LINEAR______0_000000__0H___25142 2 2.0 0.0 255.0 BIT_MASK 0xffffffff /begin IF_DATA ASAP1B_ADDRESS KP_BLOB 0xe3e5 /end IF_DATA /end MEASUREMENT
/begin MEASUREMENT lr_bank1vuls_dif_zv "ULS_DIF_ZV_1" UBYTE LINEAR_______0_637500__0H___0965 2 2.0 -0.6375 0.6375 BIT_MASK 0xffffffff /begin IF_DATA ASAP1B_ADDRESS KP_BLOB 0xe3fd /end IF_DATA /end MEASUREMENT
/begin MEASUREMENT lr_bank1vuls_fett_zyka "ULS_FETT_ZYKA_1" UWORD LINEAR______0_000000__0H___13966 2 2.0 0.0 1310.7 BIT_MASK 0xffffffff /begin IF_DATA ASAP1B_ADDRESS KP_BLOB 0xe354 /end IF_DATA /end MEASUREMENT
/begin MEASUREMENT lr_bank1vuls_fett_zyka_kat "ULS_FETT_ZYKA_NKAT_1" UWORD LINEAR______0_000000__0H___65842 2 2.0 0.0 655.34998 BIT_MASK 0xffffffff /begin IF_DATA ASAP1B_ADDRESS KP_BLOB 0xe358 /end IF_DATA /end MEASUREMENT
/begin MEASUREMENT lr_bank1vuls_frq_fett_quo "ULS_FRQ_FETT_QUO_1" UWORD LINEAR______0_000000__0H___255_9 2 2.0 0.0 255.996 BIT_MASK 0xffffffff /begin IF_DATA ASAP1B_ADDRESS KP_BLOB 0xe36a /end IF_DATA /end MEASUREMENT
/begin MEASUREMENT lr_bank1vuls_frq_mager_quo "ULS_FRQ_MAGER_QUO_1" UWORD LINEAR______0_000000__0H___255_9 2 2.0 0.0 255.996 BIT_MASK 0xffffffff /begin IF_DATA ASAP1B_ADDRESS KP_BLOB 0xe36c /end IF_DATA /end MEASUREMENT
/begin MEASUREMENT lr_bank1vuls_gmw_maxvbyteC1D "ULS_GMW_MAX_VKAT_1" UBYTE LINEAR______0_000000__0H___1_873 2 2.0 0.0 1.275 BIT_MASK 0xffffffff /begin IF_DATA ASAP1B_ADDRESS KP_BLOB 0xe347 /end IF_DATA /end MEASUREMENT
/begin MEASUREMENT lr_bank1vuls_gmw_minvbyteC1D "ULS_GMW_MIN_VKAT_1" UBYTE LINEAR______0_000000__0H___1_873 2 2.0 0.0 1.275 BIT_MASK 0xffffffff /begin IF_DATA ASAP1B_ADDRESS KP_BLOB 0xe349 /end IF_DATA /end MEASUREMENT
/begin MEASUREMENT lr_bank1vuls_kat "ULS_KAT_1" UBYTE LINEAR______0_000000__0H___1_873 2 2.0 0.0 1.275 BIT_MASK 0xffffffff /begin IF_DATA ASAP1B_ADDRESS KP_BLOB 0xe3ec /end IF_DATA /end MEASUREMENT
/begin MEASUREMENT lr_bank1vuls_kat_entry_sa "ULS_KAT_ENTRY_SA_1" UBYTE LINEAR______0_000000__0H___1_873 2 2.0 0.0 1.275 BIT_MASK 0xffffffff /begin IF_DATA ASAP1B_ADDRESS KP_BLOB 0xe404 /end IF_DATA /end MEASUREMENT
/begin MEASUREMENT lr_bank1vuls_kat_exit_sa "ULS_KAT_EXIT_SA_1" UBYTE LINEAR______0_000000__0H___1_873 2 2.0 0.0 1.275 BIT_MASK 0xffffffff /begin IF_DATA ASAP1B_ADDRESS KP_BLOB 0xe405 /end IF_DATA /end MEASUREMENT
/begin MEASUREMENT lr_bank1vuls_kat_gmwvbyteC1D "ULS_DOWN_GMW_1" UBYTE LINEAR______0_000000__0H___1_275 2 2.0 0.0 1.275 BIT_MASK 0xffffffff /begin IF_DATA ASAP1B_ADDRESS KP_BLOB 0xe3ef /end IF_DATA /end MEASUREMENT
/begin MEASUREMENT lr_bank1vuls_kat_o2_sumvlongword "ULS_KAT1_O2_SUM_LONG" ULONG UNSIGNED_LONG967 2 2.0 0.0 4.2949673e+009 BIT_MASK 0xffffffff /begin IF_DATA ASAP1B_ADDRESS KP_BLOB 0xe3cc /end IF_DATA /end MEASUREMENT
/begin MEASUREMENT lr_bank1vuls_kat_o2_sumvwordC1D "ULS_KAT1_O2_SUM_HIGH_WORD" UWORD LINEAR______0_000000__0H___42949 2 2.0 0.0 4.2949673e+009 BIT_MASK 0xffffffff /begin IF_DATA ASAP1B_ADDRESS KP_BLOB 0xe3ce /end IF_DATA /end MEASUREMENT
/begin MEASUREMENT lr_bank1vuls_kat_roh "ULS_DOWN_1" UBYTE LINEAR______0_000000__0H___1_873 2 2.0 0.0 1.275 BIT_MASK 0xffffffff /begin IF_DATA ASAP1B_ADDRESS KP_BLOB 0xe3eb /end IF_DATA /end MEASUREMENT
/begin MEASUREMENT lr_bank1vuls_kat_zyka "ULS_KAT_ZYKA_1" UBYTE LINEAR______0_000000__0H___1_155 2 2.0 0.0 1.9961 BIT_MASK 0xffffffff /begin IF_DATA ASAP1B_ADDRESS KP_BLOB 0xe407 /end IF_DATA /end MEASUREMENT
/begin MEASUREMENT lr_bank1vuls_kat_zyka_akt "ULS_KAT_ZYKA_AKT_1" UBYTE LINEAR______0_000000__0H___51740 2 2.0 0.0 5100.0 BIT_MASK 0xffffffff /begin IF_DATA ASAP1B_ADDRESS KP_BLOB 0xe408 /end IF_DATA /end MEASUREMENT
/begin MEASUREMENT lr_bank1vuls_kat_zyka_quo_sum "ULS_KAT_ZYKA_QUO_SUM_1" UWORD LINEAR______0_000000__0H___509_0 2 2.0 0.0 509.0055 BIT_MASK 0xffffffff /begin IF_DATA ASAP1B_ADDRESS KP_BLOB 0xe40a /end IF_DATA /end MEASUREMENT
/begin MEASUREMENT lr_bank1vuls_km_diag_cnt "ULS_KM_DIAG_CNT_1" UWORD LINEAR______0_000000__0H___65968 2 2.0 0.0 65535.0 BIT_MASK 0xffffffff /begin IF_DATA ASAP1B_ADDRESS KP_BLOB 0xe38e /end IF_DATA /end MEASUREMENT
/begin MEASUREMENT lr_bank1vuls_km_nkat_diag_cnt "ULS_KM_NKAT_DIAG_CNT_1" UWORD LINEAR______0_000000__0H___65769 2 2.0 0.0 65535.0 BIT_MASK 0xffffffff /begin IF_DATA ASAP1B_ADDRESS KP_BLOB 0xe3ca /end IF_DATA /end MEASUREMENT
/begin MEASUREMENT lr_bank1vuls_lb_diag_cnt "ULS_LB_DIAG_CNT_1" UWORD LINEAR______0_000000__0H___65968 2 2.0 0.0 65535.0 BIT_MASK 0xffffffff /begin IF_DATA ASAP1B_ADDRESS KP_BLOB 0xe38c /end IF_DATA /end MEASUREMENT
/begin MEASUREMENT lr_bank1vuls_lb_nkat_diag_cnt "ULS_LB_NKAT_DIAG_CNT_1" UWORD LINEAR______0_000000__0H___65769 2 2.0 0.0 65535.0 BIT_MASK 0xffffffff /begin IF_DATA ASAP1B_ADDRESS KP_BLOB 0xe3c8 /end IF_DATA /end MEASUREMENT
/begin MEASUREMENT lr_bank1vuls_mager_zyka "ULS_MAGER_ZYKA_1" UWORD LINEAR______0_000000__0H___13966 2 2.0 0.0 1310.7 BIT_MASK 0xffffffff /begin IF_DATA ASAP1B_ADDRESS KP_BLOB 0xe356 /end IF_DATA /end MEASUREMENT
/begin MEASUREMENT lr_bank1vuls_mager_zyka_kat "ULS_MAGER_ZYKA_NKAT_1" UWORD LINEAR______0_000000__0H___65842 2 2.0 0.0 655.34998 BIT_MASK 0xffffffff /begin IF_DATA ASAP1B_ADDRESS KP_BLOB 0xe35a /end IF_DATA /end MEASUREMENT
/begin MEASUREMENT lr_bank1vuls_max_zyka "lr_bank1^uls_max_zyka" UBYTE LINEAR______0_000000__0H___1_873 2 2.0 0.0 1.275 BIT_MASK 0xffffffff /begin IF_DATA ASAP1B_ADDRESS KP_BLOB 0xe3e7 /end IF_DATA /end MEASUREMENT
/begin MEASUREMENT lr_bank1vuls_max_zyka_f "ULS_MAX_ZYKA_F_1" UWORD LINEAR______0_000000__0H___13969 2 2.0 0.0 1310.7 BIT_MASK 0xffffffff /begin IF_DATA ASAP1B_ADDRESS KP_BLOB 0xe368 /end IF_DATA /end MEASUREMENT
/begin MEASUREMENT lr_bank1vuls_max_zyka_fett "ULS_MAX_ZYKA_FETT_1" UWORD LINEAR______0_000000__0H___65842 2 2.0 0.0 655.34998 BIT_MASK 0xffffffff /begin IF_DATA ASAP1B_ADDRESS KP_BLOB 0xe380 /end IF_DATA /end MEASUREMENT
/begin MEASUREMENT lr_bank1vuls_max_zyka_m "ULS_MAX_ZYKA_M_1" UWORD LINEAR______0_000000__0H___13969 2 2.0 0.0 1310.7 BIT_MASK 0xffffffff /begin IF_DATA ASAP1B_ADDRESS KP_BLOB 0xe366 /end IF_DATA /end MEASUREMENT
/begin MEASUREMENT lr_bank1vuls_max_zyka_mager "ULS_MAX_ZYKA_MAGER_1" UWORD LINEAR______0_000000__0H___65842 2 2.0 0.0 655.34998 BIT_MASK 0xffffffff /begin IF_DATA ASAP1B_ADDRESS KP_BLOB 0xe37e /end IF_DATA /end MEASUREMENT
/begin MEASUREMENT lr_bank1vuls_min_zyka "lr_bank1^uls_min_zyka" UBYTE LINEAR______0_000000__0H___1_873 2 2.0 0.0 1.275 BIT_MASK 0xffffffff /begin IF_DATA ASAP1B_ADDRESS KP_BLOB 0xe3e8 /end IF_DATA /end MEASUREMENT
/begin MEASUREMENT lr_bank1vuls_ob "ULS_OB_VKAT_1" UBYTE LINEAR______0_000000__0H___1_873 2 2.0 0.0 1.275 BIT_MASK 0xffffffff /begin IF_DATA ASAP1B_ADDRESS KP_BLOB 0xe3db /end IF_DATA /end MEASUREMENT
/begin MEASUREMENT lr_bank1vuls_roh "ULS_VKAT_1_VDIAG" UBYTE LINEAR______0_000000__0H___1_873 2 2.0 0.0 1.275 BIT_MASK 0xffffffff /begin IF_DATA ASAP1B_ADDRESS KP_BLOB 0xe3da /end IF_DATA /end MEASUREMENT
/begin MEASUREMENT lr_bank1vuls_unt "ULS_UNT_VKAT_1" UBYTE LINEAR______0_000000__0H___1_873 2 2.0 0.0 1.275 BIT_MASK 0xffffffff /begin IF_DATA ASAP1B_ADDRESS KP_BLOB 0xe3dc /end IF_DATA /end MEASUREMENT
/begin MEASUREMENT lr_bank1vuls_zyka_f_s "ULS_ZYKA_F_S_1" UWORD LINEAR______0_000000__0H___13969 2 2.0 0.0 1310.7 BIT_MASK 0xffffffff /begin IF_DATA ASAP1B_ADDRESS KP_BLOB 0xe364 /end IF_DATA /end MEASUREMENT
/begin MEASUREMENT lr_bank1vuls_zyka_fett "ULS_ZYKA_FETT_1" UWORD LINEAR______0_000000__0H___25959 2 2.0 0.0 255.996 BIT_MASK 0xffffffff /begin IF_DATA ASAP1B_ADDRESS KP_BLOB 0xe370 /end IF_DATA /end MEASUREMENT
/begin MEASUREMENT lr_bank1vuls_zyka_fett_quo "ULS_ZYKA_FETT_QUO_1" UWORD LINEAR______0_000000__0H___25970 2 2.0 0.0 255.996 BIT_MASK 0xffffffff /begin IF_DATA ASAP1B_ADDRESS KP_BLOB 0xe374 /end IF_DATA /end MEASUREMENT
/begin MEASUREMENT lr_bank1vuls_zyka_fett_quo_sum "ULS_ZYKA_FETT_QUO_SUM_1" UWORD LINEAR______0_000000__0H___25970 2 2.0 0.0 255.996 BIT_MASK 0xffffffff /begin IF_DATA ASAP1B_ADDRESS KP_BLOB 0xe378 /end IF_DATA /end MEASUREMENT
/begin MEASUREMENT lr_bank1vuls_zyka_fm "ULS_ZYKA_FM_1" UWORD LINEAR______0_000000__0H___655_3 2 2.0 0.0 655.34998 BIT_MASK 0xffffffff /begin IF_DATA ASAP1B_ADDRESS KP_BLOB 0xe34e /end IF_DATA /end MEASUREMENT
/begin MEASUREMENT lr_bank1vuls_zyka_m_s "ULS_ZYKA_M_S_1" UWORD LINEAR______0_000000__0H___13969 2 2.0 0.0 1310.7 BIT_MASK 0xffffffff /begin IF_DATA ASAP1B_ADDRESS KP_BLOB 0xe362 /end IF_DATA /end MEASUREMENT
/begin MEASUREMENT lr_bank1vuls_zyka_mager "ULS_ZYKA_MAGER_1" UWORD LINEAR______0_000000__0H___255_9 2 2.0 0.0 255.996 BIT_MASK 0xffffffff /begin IF_DATA ASAP1B_ADDRESS KP_BLOB 0xe36e /end IF_DATA /end MEASUREMENT
/begin MEASUREMENT lr_bank1vuls_zyka_mager_quo "ULS_ZYKA_MAGER_QUO_1" UWORD LINEAR______0_000000__0H___25970 2 2.0 0.0 255.996 BIT_MASK 0xffffffff /begin IF_DATA ASAP1B_ADDRESS KP_BLOB 0xe372 /end IF_DATA /end MEASUREMENT
/begin MEASUREMENT lr_bank1vuls_zyka_mager_quo_sum "ULS_ZYKA_MAGER_QUO_SUM_1" UWORD LINEAR______0_000000__0H___25970 2 2.0 0.0 255.996 BIT_MASK 0xffffffff /begin IF_DATA ASAP1B_ADDRESS KP_BLOB 0xe376 /end IF_DATA /end MEASUREMENT
/begin MEASUREMENT lr_bank1vuls_zyka_mf "ULS_ZYKA_MF_1" UWORD LINEAR______0_000000__0H___655_3 2 2.0 0.0 655.34998 BIT_MASK 0xffffffff /begin IF_DATA ASAP1B_ADDRESS KP_BLOB 0xe34c /end IF_DATA /end MEASUREMENT
/begin MEASUREMENT lr_bank1vz_katw_diag "lr_bank1^Z_KATW_DIAG" UBYTE LINEAR______0_000000__0H___25182 2 2.0 0.0 255.0 BIT_MASK 0xffffffff /begin IF_DATA ASAP1B_ADDRESS KP_BLOB 0xe3ea /end IF_DATA /end MEASUREMENT
/begin MEASUREMENT lr_bank1vz_lam_anz_p_ll "Z_LAM_ANZ_P_LL_1" UBYTE LINEAR______0_000000__0H___25142 2 2.0 0.0 255.0 BIT_MASK 0xffffffff /begin IF_DATA ASAP1B_ADDRESS KP_BLOB 0xe3dd /end IF_DATA /end MEASUREMENT
/begin MEASUREMENT lr_bank1vz_lam_max_zyka "lr_bank1^z_lam_max_zyka" UBYTE LINEAR______0_000000__0H___25764 2 2.0 0.0 255.0 BIT_MASK 0xffffffff /begin IF_DATA ASAP1B_ADDRESS KP_BLOB 0xe3de /end IF_DATA /end MEASUREMENT
/begin MEASUREMENT lr_bank1vz_lam_wechsel "Z_LAM_WECHSEL_1" UBYTE LINEAR______0_000000__0H___25182 2 2.0 0.0 255.0 BIT_MASK 0xffffffff /begin IF_DATA ASAP1B_ADDRESS KP_BLOB 0xe3df /end IF_DATA /end MEASUREMENT
/begin MEASUREMENT lr_bank1vz_lam_zyka_diag "lr_bank1^z_lam_zyka_diag" UWORD LINEAR______0_000000__0H___65163 2 2.0 0.0 65535.0 BIT_MASK 0xffffffff /begin IF_DATA ASAP1B_ADDRESS KP_BLOB 0xe322 /end IF_DATA /end MEASUREMENT
/begin MEASUREMENT lr_bank1vzv_counter "lr_bank1^zv_counter" UWORD LINEAR______0_000000__0H___65971 2 2.0 0.0 65535.0 BIT_MASK 0xffffffff /begin IF_DATA ASAP1B_ADDRESS KP_BLOB 0xe394 /end IF_DATA /end MEASUREMENT
/begin MEASUREMENT lr_bank2vanz_fett "ANZ_FETT_MAGER_2" UWORD LINEAR______0_000000__0H___65163 2 2.0 0.0 65535.0 BIT_MASK 0xffffffff /begin IF_DATA ASAP1B_ADDRESS KP_BLOB 0xe466 /end IF_DATA /end MEASUREMENT
/begin MEASUREMENT lr_bank2vanz_frq_diag "ANZ_FRQ_DIAG_2" UWORD LINEAR______0_000000__0H___65163 2 2.0 0.0 65535.0 BIT_MASK 0xffffffff /begin IF_DATA ASAP1B_ADDRESS KP_BLOB 0xe4aa /end IF_DATA /end MEASUREMENT
/begin MEASUREMENT lr_bank2vanz_gem_zust_wechsel "lr_bank2^anz_gem_zust_wechsel" UBYTE LINEAR______0_000000__0H___25182 2 2.0 0.0 255.0 BIT_MASK 0xffffffff /begin IF_DATA ASAP1B_ADDRESS KP_BLOB 0xe4dc /end IF_DATA /end MEASUREMENT
/begin COMPU_METHOD ES_8_RES "" FORM "%4.0" "[1/min]" FORMULA "32.0*X" FORMULA_INV "0.03125*X" /end COMPU_METHOD
/begin COMPU_METHOD MTC_NORM_16_RES "" FORM "%5.1" "[°DK]" FORMULA "0.0018310547*X" FORMULA_INV "546.13333*X" /end COMPU_METHOD
/begin COMPU_METHOD LINEAR_______48_000000__0H___155 "" FORM "%5.1" "[°C]" FORMULA "0.79607843*X-48.0" FORMULA_INV "1.2561576*X+60.295567" /end COMPU_METHOD
/begin COMPU_METHOD LINEAR______0_000000__0H___31_00 "" FORM "%3.0" "[Nm]" FORMULA "1.0*X" FORMULA_INV "1.0*X" /end COMPU_METHOD
/begin COMPU_METHOD LINEAR______0_000000__0H___1_992 "" FORM "%5.3" "[-]" FORMULA "0.0078125491*X" FORMULA_INV "127.9992*X" /end COMPU_METHOD
/begin COMPU_METHOD MTC_NORM_8_RES "" FORM "%5.1" "[°DK]" FORMULA "0.46875*X" FORMULA_INV "2.1333333*X" /end COMPU_METHOD
/begin COMPU_METHOD LINEAR_______48_000000__0H___142 "" FORM "%5.1" "[°C]" FORMULA "0.75*X-48.0" FORMULA_INV "1.3333333*X+64.0" /end COMPU_METHOD
/begin COMPU_METHOD LINEAR______0_000000__0H___255_9 "" FORM "%7.3" "[-]" FORMULA "0.0039062486*X" FORMULA_INV "256.00009*X" /end COMPU_METHOD
/begin COMPU_METHOD LINEAR______0_000000__0H___0_996 "" FORM "%5.3" "[-]" FORMULA "0.0039062745*X" FORMULA_INV "255.99839*X" /end COMPU_METHOD
/begin COMPU_METHOD LINEAR______0_000000__0H___0_918 "" FORM "%6.4" "[-]" FORMULA "1.5258789e-005*X" FORMULA_INV "65536.0*X" /end COMPU_METHOD
/begin COMPU_METHOD LINEAR______0_000000__0H___0_920 "" FORM "%5.3" "[-]" FORMULA "0.0039058823*X" FORMULA_INV "256.0241*X" /end COMPU_METHOD
/begin COMPU_METHOD LINEAR_______48_000000__0H___121 "" FORM "%4.0" "[°C]" FORMULA "0.75*X-48.0" FORMULA_INV "1.3333333*X+64.0" /end COMPU_METHOD
/begin COMPU_METHOD LINEAR______0_000000__0H___0_923 "" FORM "%4.3" "[-]" FORMULA "0.0039062745*X" FORMULA_INV "255.99839*X" /end COMPU_METHOD
/begin COMPU_METHOD LINEAR_______50_000000__0H___49_ "" FORM "%4.1" "[%]" FORMULA "0.0015258793*X-50.0" FORMULA_INV "655.35983*X+32767.991" /end COMPU_METHOD
/begin COMPU_METHOD LINEAR_______48_000000__0H___0_0 "" FORM "%5.1" "[°KW]" FORMULA "0.375*X-48.0" FORMULA_INV "2.6666667*X+128.0" /end COMPU_METHOD
/begin COMPU_METHOD LINEAR______0_000000__0H___1_999 "" FORM "%7.5" "[-]" FORMULA "3.0517585e-005*X" FORMULA_INV "32767.992*X" /end COMPU_METHOD
/begin COMPU_METHOD LINEAR______0_000000__0H___2550_ "" FORM "%4.0" "[ms]" FORMULA "10.0*X" FORMULA_INV "0.1*X" /end COMPU_METHOD
/begin COMPU_METHOD LINEAR______0_000000__0H___26_00 "" FORM "%4.1" "[V]" FORMULA "0.10196078*X" FORMULA_INV "9.8076923*X" /end COMPU_METHOD
/begin COMPU_METHOD LINEAR______1_000000__1H___255_0 "" FORM "%4.0" "[-]" FORMULA "1.0*X" FORMULA_INV "1.0*X" /end COMPU_METHOD
/begin COMPU_METHOD MAF_8_RES37 "" FORM "%4.0" "[mg/Hub]" FORMULA "5.4470588*X" FORMULA_INV "0.18358531*X" /end COMPU_METHOD
/begin COMPU_METHOD LINEAR______0_000000__0H___511_9 "" FORM "%6.2" "[km/h]" FORMULA "0.0078124999*X" FORMULA_INV "128.0*X" /end COMPU_METHOD
/begin COMPU_METHOD LINEAR______0_000000__0H___2_000 "" FORM "%5.3" "[-]" FORMULA "3.0518044e-005*X" FORMULA_INV "32767.5*X" /end COMPU_METHOD
/begin COMPU_METHOD MAF_16_RES46 "" FORM "%4.0" "[mg/Hub]" FORMULA "0.021194781*X" FORMULA_INV "47.181425*X" /end COMPU_METHOD
/begin COMPU_METHOD MTC_NORM_16_RES51 "" FORM "%7.3" "[°DK]" FORMULA "0.0018310547*X" FORMULA_INV "546.13333*X" /end COMPU_METHOD
/begin COMPU_METHOD LINEAR______0_000000__0H___0_955 "" FORM "%4.3" "[-]" FORMULA "1.5258789e-005*X" FORMULA_INV "65536.0*X" /end COMPU_METHOD
/begin COMPU_METHOD LINEAR______0_000000__0H___25558 "" FORM "%3.0" "[km/h]" FORMULA "1.0*X" FORMULA_INV "1.0*X" /end COMPU_METHOD
/begin COMPU_METHOD LINEAR______1_000000__100H___8_0 "" FORM "%3.1" "[-]" FORMULA "0.00390625*X" FORMULA_INV "256.0*X" /end COMPU_METHOD
/begin COMPU_METHOD LINEAR______0_000000__0H___0_965 "" FORM "%5.3" "[-]" FORMULA "0.00390625*X" FORMULA_INV "256.0*X" /end COMPU_METHOD
/begin COMPU_METHOD LINEAR______0_000000__0H___1_275 "" FORM "%5.3" "[V]" FORMULA "0.005*X" FORMULA_INV "200.0*X" /end COMPU_METHOD
/begin COMPU_METHOD LINEAR______0_000000__0H___51174 "" FORM "%5.1" "[km/h]" FORMULA "0.0078124999*X" FORMULA_INV "128.0*X" /end COMPU_METHOD
/begin COMPU_METHOD IS_13_RES78 "" FORM "%4.0" "[1/min]" FORMULA "1.0*X" FORMULA_INV "1.0*X" /end COMPU_METHOD
/begin COMPU_METHOD LINEAR______0_000000__0H___26_82 "" FORM "%3.1" "[V]" FORMULA "0.10196078*X" FORMULA_INV "9.8076923*X" /end COMPU_METHOD
/begin COMPU_METHOD LINEAR_______48_000000__0H___197 "" FORM "%4.1" "[°C]" FORMULA "0.75*X-48.0" FORMULA_INV "1.3333333*X+64.0" /end COMPU_METHOD
/begin COMPU_METHOD LINEAR______0_000000__0H___25108 "" FORM "%3.0" "[s]" FORMULA "1.0*X" FORMULA_INV "1.0*X" /end COMPU_METHOD
/begin COMPU_METHOD LINEAR______0_000000__0H___2_111 "" FORM "%7.5" "[-]" FORMULA "3.0518044e-005*X" FORMULA_INV "32767.5*X" /end COMPU_METHOD
/begin COMPU_METHOD MAF_KGH_16_RES117 "" FORM "%6.1" "[kg/h]" FORMULA "0.25*X" FORMULA_INV "4.0*X" /end COMPU_METHOD
/begin COMPU_METHOD LINEAR_______23_625000__0H___126 "" FORM "%5.1" "[°KW]" FORMULA "0.375*X-23.625" FORMULA_INV "2.6666667*X+63.0" /end COMPU_METHOD
/begin COMPU_METHOD LINEAR______0_000000__0H___0_129 "" FORM "%5.3" "[]" FORMULA "0.0039058823*X" FORMULA_INV "256.0241*X" /end COMPU_METHOD
/begin COMPU_METHOD LINEAR______0_000000__0H___25142 "" FORM "%3.0" "[-]" FORMULA "1.0*X" FORMULA_INV "1.0*X" /end COMPU_METHOD
/begin COMPU_METHOD LINEAR______0_000000__0H___655_3 "" FORM "%6.2" "[s]" FORMULA "0.0099999996*X" FORMULA_INV "100.0*X" /end COMPU_METHOD
/begin COMPU_METHOD MAF_16_RES146 "" FORM "%6.2" "[mg/Hub]" FORMULA "0.021194781*X" FORMULA_INV "47.181425*X" /end COMPU_METHOD
/begin COMPU_METHOD LINEAR______0_000000__0H___25147 "" FORM "%4.0" "" FORMULA "1.0*X" FORMULA_INV "1.0*X" /end COMPU_METHOD
/begin COMPU_METHOD LINEAR______0_000000__0H___1_155 "" FORM "%5.3" "[-]" FORMULA "0.0078278431*X" FORMULA_INV "127.74911*X" /end COMPU_METHOD
/begin COMPU_METHOD LINEAR______0_000000__0H___65163 "" FORM "%5.0" "[-]" FORMULA "1.0*X" FORMULA_INV "1.0*X" /end COMPU_METHOD
/begin COMPU_METHOD LINEAR______0_001460__1H___47168 "" FORM "%6.3" "[°KW/120°KW]" FORMULA "0.0014648428*X-4.8428499e-006" FORMULA_INV "682.66709*X+0.0033060542" /end COMPU_METHOD
/begin COMPU_METHOD LINEAR_______48_000000__0H___170 "" FORM "%6.2" "[°KW]" FORMULA "0.375*X-48.0" FORMULA_INV "2.6666667*X+128.0" /end COMPU_METHOD
/begin COMPU_METHOD LINEAR______0_000000__0H___42949 "" FORM "%11.0" "[-]" FORMULA "65537.0*X" FORMULA_INV "1.5258556e-005*X" /end COMPU_METHOD
/begin COMPU_METHOD LINEAR_______32768_000000__FFFF8 "" FORM "%6.0" "" FORMULA "1.0*X" FORMULA_INV "1.0*X" /end COMPU_METHOD
/begin COMPU_METHOD LINEAR______0_000000__0H___7110_ "" FORM "%7.2" "[m/s^2]" FORMULA "0.21701389*X" FORMULA_INV "4.608*X" /end COMPU_METHOD
/begin COMPU_METHOD LINEAR_______32768_000000__FF180 "" FORM "%6.0" "[-]" FORMULA "1.0*X" FORMULA_INV "1.0*X" /end COMPU_METHOD
/begin COMPU_METHOD LINEAR______0_000000__0H___25182 "" FORM "%4.0" "[-]" FORMULA "1.0*X" FORMULA_INV "1.0*X" /end COMPU_METHOD
/begin COMPU_METHOD LINEAR______0_000000__0H___25185 "" FORM "%4.0" "[]" FORMULA "1.0*X" FORMULA_INV "1.0*X" /end COMPU_METHOD
/begin COMPU_METHOD LINEAR______0_000000__0H___171_3 "" FORM "%7.3" "[%*min]" FORMULA "0.0026143282*X" FORMULA_INV "382.50744*X" /end COMPU_METHOD
/begin COMPU_METHOD LINEAR______0_000000__0H___76791 "" FORM "%6.0" "[°DK/sec]" FORMULA "11.717647*X" FORMULA_INV "0.085341365*X" /end COMPU_METHOD
/begin COMPU_METHOD LM_INT_SA_RANGE731 "" FORM "%5.0" "[g]" FORMULA "0.027777829*X" FORMULA_INV "35.999934*X" /end COMPU_METHOD
/begin COMPU_METHOD LM_INT_SA_RANGE733 "" FORM "%7.2" "[g]" FORMULA "0.027777829*X" FORMULA_INV "35.999934*X" /end COMPU_METHOD
/begin COMPU_METHOD LINEAR_______640_020000__FFFF800 "" FORM "%7.2" "[ms]" FORMULA "0.019531548*X-0.010234226" FORMULA_INV "51.199219*X+0.52398437" /end COMPU_METHOD
/begin COMPU_METHOD LINEAR______0_000000__0H___25738 "" FORM "%4.0" "[km/h]" FORMULA "1.0*X" FORMULA_INV "1.0*X" /end COMPU_METHOD
/begin COMPU_METHOD LINEAR______0_000000__0H___51740 "" FORM "%4.0" "[ms]" FORMULA "20.0*X" FORMULA_INV "0.05*X" /end COMPU_METHOD
/begin COMPU_METHOD LINEAR______0_000000__0H___25741 "" FORM "%7.3" "[-]" FORMULA "0.0039062486*X" FORMULA_INV "256.00009*X" /end COMPU_METHOD
/begin COMPU_METHOD LINEAR______0_000000__0H___25764 "" FORM "%4.0" "[* 20ms]" FORMULA "1.0*X" FORMULA_INV "1.0*X" /end COMPU_METHOD
/begin COMPU_METHOD LINEAR______0_010000__1H___65768 "" FORM "%6.2" "[s]" FORMULA "0.0099999996*X+3.7247841e-010" FORMULA_INV "100.0*X-3.7247842e-008" /end COMPU_METHOD
/begin COMPU_METHOD LINEAR______0_000000__0H___65769 "" FORM "%6.0" "[* 20ms]" FORMULA "1.0*X" FORMULA_INV "1.0*X" /end COMPU_METHOD
/begin COMPU_METHOD LINEAR______1_000000__1H___8160_ "" FORM "%5.0" "[U/min]" FORMULA "1.0*X" FORMULA_INV "1.0*X" /end COMPU_METHOD
/begin COMPU_METHOD LINEAR_______48_000000__FFFFFF80 "" FORM "%5.1" "[°KW]" FORMULA "0.375*X" FORMULA_INV "2.6666667*X" /end COMPU_METHOD
/begin COMPU_METHOD LINEAR______0_000000__0H___1_809 "" FORM "%5.3" "[-]" FORMULA "1.5259022e-005*X" FORMULA_INV "65535.0*X" /end COMPU_METHOD
/begin COMPU_METHOD LINEAR______0_000000__0H___65842 "" FORM "%5.2" "[s]" FORMULA "0.0099999996*X" FORMULA_INV "100.0*X" /end COMPU_METHOD
/begin COMPU_METHOD LINEAR______0_000000__0H___190_5 "" FORM "%5.1" "[°C/500ms]" FORMULA "0.75*X" FORMULA_INV "1.3333333*X" /end COMPU_METHOD
/begin COMPU_METHOD LINEAR______0_000000__0H___60_00 "" FORM "%4.1" "[°C]" FORMULA "0.75*X" FORMULA_INV "1.3333333*X" /end COMPU_METHOD
/begin COMPU_METHOD LINEAR______0_000000__0H___19863 "" FORM "%5.1" "[[°C]]" FORMULA "0.75*X" FORMULA_INV "1.3333333*X" /end COMPU_METHOD
/begin COMPU_METHOD LINEAR______0_000000__0H___19864 "" FORM "%5.1" "[°C]" FORMULA "0.75*X" FORMULA_INV "1.3333333*X" /end COMPU_METHOD
/begin COMPU_METHOD LINEAR______0_000000__0H___0_865 "" FORM "%6.4" "[]" FORMULA "1.5258789e-005*X" FORMULA_INV "65536.0*X" /end COMPU_METHOD
/begin COMPU_METHOD LINEAR______0_000000__0H___203_0 "" FORM "%5.1" "[°C/500ms]" FORMULA "0.79607843*X" FORMULA_INV "1.2561576*X" /end COMPU_METHOD
/begin COMPU_METHOD LINEAR______0_000000__0H___101_5 "" FORM "%5.1" "[°C]" FORMULA "0.79296875*X" FORMULA_INV "1.2610837*X" /end COMPU_METHOD
/begin COMPU_METHOD LINEAR______0_000000__0H___20866 "" FORM "%5.1" "[°C]" FORMULA "0.79607843*X" FORMULA_INV "1.2561576*X" /end COMPU_METHOD
/begin COMPU_METHOD LINEAR_______48_000000__0H___867 "" FORM "%5.1" "[_C]" FORMULA "0.79607843*X-48.0" FORMULA_INV "1.2561576*X+60.295567" /end COMPU_METHOD
/begin COMPU_METHOD LINEAR______0_000000__0H___10000 "" FORM "%6.0" "[ms]" FORMULA "10.0*X" FORMULA_INV "0.1*X" /end COMPU_METHOD
/begin COMPU_METHOD LINEAR_______128_000000__FFFF868 "" FORM "%6.1" "[°C]" FORMULA "1.0*X" FORMULA_INV "1.0*X" /end COMPU_METHOD
/begin COMPU_METHOD LINEAR______0_000000__0H___25869 "" FORM "%6.2" "[°C]" FORMULA "1.0*X" FORMULA_INV "1.0*X" /end COMPU_METHOD
/begin COMPU_METHOD LINEAR_______128_000000__FFFF870 "" FORM "%4.0" "[°C]" FORMULA "1.0*X" FORMULA_INV "1.0*X" /end COMPU_METHOD
/begin COMPU_METHOD LINEAR______1000_000000__3E8H___ "" FORM "%6.0" "[Impulse/km]" FORMULA "1.0*X" FORMULA_INV "1.0*X" /end COMPU_METHOD
/begin COMPU_METHOD LINEAR______0_024412__1H___6_225 "" FORM "%5.3" "[V]" FORMULA "0.024411764*X-4.3307087e-009" FORMULA_INV "40.963856*X+1.7740253e-007" /end COMPU_METHOD
/begin COMPU_METHOD LINEAR______0_000000__0H___26871 "" FORM "%4.0" "[V]" FORMULA "0.10196078*X" FORMULA_INV "9.8076923*X" /end COMPU_METHOD
/begin COMPU_METHOD LINEAR______0_000000__0H___65872 "" FORM "%6.0" "[]" FORMULA "1.0*X" FORMULA_INV "1.0*X" /end COMPU_METHOD
/begin COMPU_METHOD LINEAR______0_000000__0H___1_873 "" FORM "%4.2" "[V]" FORMULA "0.005*X" FORMULA_INV "200.0*X" /end COMPU_METHOD
/begin COMPU_METHOD LINEAR______0_000000__0H___4_980 "" FORM "%4.2" "[V]" FORMULA "0.019531373*X" FORMULA_INV "51.199676*X" /end COMPU_METHOD
/begin COMPU_METHOD V_2co_SGN_16_RES "" FORM "%7.2" "[km/h]" FORMULA "0.0078124999*X-3.7500572e-006" FORMULA_INV "128.0*X+0.00048000733" /end COMPU_METHOD
/begin COMPU_METHOD LINEAR______0_000000__0H___25874 "" FORM "%6.2" "[km/h]" FORMULA "1.0*X" FORMULA_INV "1.0*X" /end COMPU_METHOD
/begin COMPU_METHOD LINEAR______0_000000__0H___63875 "" FORM "%5.2" "[km/h]" FORMULA "0.25*X" FORMULA_INV "4.0*X" /end COMPU_METHOD
/begin COMPU_METHOD LINEAR______0_000000__0H___31_87 "" FORM "%5.2" "[km/h]" FORMULA "0.125*X" FORMULA_INV "8.0*X" /end COMPU_METHOD
/begin COMPU_METHOD V_BAS_16_RES "" FORM "%6.2" "[km/h]" FORMULA "0.0078124998*X" FORMULA_INV "128.0*X" /end COMPU_METHOD
/begin COMPU_METHOD LINEAR______0_000000__0H___25876 "" FORM "%5.1" "[km/h]" FORMULA "1.0*X" FORMULA_INV "1.0*X" /end COMPU_METHOD
/begin COMPU_METHOD LINEAR______0_000000__0H___25877 "" FORM "%4.0" "[1 s]" FORMULA "1.0*X" FORMULA_INV "1.0*X" /end COMPU_METHOD
/begin COMPU_METHOD V_2co_SGN_16_RES878 "" FORM "%6.2" "[km/h]" FORMULA "0.0078124999*X-3.7500572e-006" FORMULA_INV "128.0*X+0.00048000733" /end COMPU_METHOD
/begin COMPU_METHOD LINEAR______0_000000__0H___99_21 "" FORM "%5.2" "[%]" FORMULA "0.390625*X" FORMULA_INV "2.56*X" /end COMPU_METHOD
/begin COMPU_METHOD LINEAR______0_000000__0H___1_879 "" FORM "%8.5" "[-]" FORMULA "3.0517578e-005*X" FORMULA_INV "32768.0*X" /end COMPU_METHOD
/begin COMPU_METHOD LINEAR______1_000000__8000H___1_ "" FORM "%5.3" "[-]" FORMULA "3.0517578e-005*X" FORMULA_INV "32768.0*X" /end COMPU_METHOD
/begin COMPU_METHOD LINEAR______0_500000__4000H___1_ "" FORM "%5.3" "[-]" FORMULA "3.0517578e-005*X" FORMULA_INV "32768.0*X" /end COMPU_METHOD
/begin COMPU_METHOD LINEAR______0_000000__0H___14880 "" FORM "%5.1" "[mA]" FORMULA "0.56392158*X" FORMULA_INV "1.7732962*X" /end COMPU_METHOD
/begin COMPU_METHOD LINEAR______1_000000__1H___25881 "" FORM "%4.0" "[720°KW]" FORMULA "1.0*X" FORMULA_INV "1.0*X" /end COMPU_METHOD
/begin COMPU_METHOD LINEAR______0_000000__0H___47882 "" FORM "%4.1" "[°KW]" FORMULA "0.375*X" FORMULA_INV "2.6666667*X" /end COMPU_METHOD
/begin COMPU_METHOD LINEAR______0_000000__0H___1_883 "" FORM "%7.5" "[-/720°KW]" FORMULA "1.5259022e-005*X" FORMULA_INV "65535.0*X" /end COMPU_METHOD
/begin COMPU_METHOD LINEAR______0_001460__1H___47884 "" FORM "%6.3" "[°KW/720°KW]" FORMULA "0.0014648428*X-4.8428499e-006" FORMULA_INV "682.66709*X+0.0033060542" /end COMPU_METHOD
/begin COMPU_METHOD LINEAR______0_001465__1H___47_99 "" FORM "%6.3" "[°KW/120°KW]" FORMULA "0.0014648439*X+1.5610694e-007" FORMULA_INV "682.6666*X-0.00010656899" /end COMPU_METHOD
/begin COMPU_METHOD LINEAR______0_000000__0H___95885 "" FORM "%5.1" "[°KW]" FORMULA "0.375*X" FORMULA_INV "2.6666667*X" /end COMPU_METHOD
/begin COMPU_METHOD LINEAR______0_000000__0H___6_886 "" FORM "%3.1" "[°KW]" FORMULA "0.375*X" FORMULA_INV "2.6666667*X" /end COMPU_METHOD
/begin COMPU_METHOD LINEAR_______48_000000__0H___887 "" FORM "%4.1" "[°KW]" FORMULA "0.375*X-48.0" FORMULA_INV "2.6666667*X+128.0" /end COMPU_METHOD
/begin COMPU_METHOD LINEAR______0_000000__0H___48888 "" FORM "%4.1" "[°KW]" FORMULA "0.375*X" FORMULA_INV "2.6666667*X" /end COMPU_METHOD
/begin COMPU_METHOD LINEAR______5_440000__1H___1389_ "" FORM "%5.0" "[mg/Hub]" FORMULA "5.4470866*X-0.0070865539" FORMULA_INV "0.18358438*X+0.0013009806" /end COMPU_METHOD
/begin COMPU_METHOD LINEAR______0_000000__0H___65889 "" FORM "%6.0" "[* 720°KW]" FORMULA "1.0*X" FORMULA_INV "1.0*X" /end COMPU_METHOD
/begin COMPU_METHOD LINEAR______1_000000__1H___25890 "" FORM "%4.0" "[* 40ms]" FORMULA "1.0*X" FORMULA_INV "1.0*X" /end COMPU_METHOD
/begin COMPU_METHOD LINEAR______0_000000__0H___65891 "" FORM "%6.0" "[* 120°KW]" FORMULA "1.0*X" FORMULA_INV "1.0*X" /end COMPU_METHOD
/begin COMPU_METHOD LINEAR_______7111_111000__FFFF80 "" FORM "%8.2" "[m/s^2]" FORMULA "0.21701389*X+4.0943373e-005" FORMULA_INV "4.608*X-0.00018866707" /end COMPU_METHOD
/begin COMPU_METHOD RANGE________ABF___1H__1H_______ "" TAB_VERB "%8.4" "[-]" COMPU_TAB_REF RANGE________ABF___1H__1H_______ /end COMPU_METHOD
/begin COMPU_METHOD RANGE_____00000010 "" TAB_VERB "%8.4" "[-]" COMPU_TAB_REF RANGE_____00000010_TAB_NAME /end COMPU_METHOD
/begin COMPU_METHOD LINEAR______0_000000__0H___3_894 "" FORM "%4.2" "[-]" FORMULA "6.0797665e-005*X" FORMULA_INV "16448.0*X" /end COMPU_METHOD
/begin COMPU_METHOD RANGE________AD_S___1H__1H______ "" TAB_VERB "%8.4" "[-]" COMPU_TAB_REF RANGE________AD_S___1H__1H______ /end COMPU_METHOD
/begin COMPU_METHOD RANGE________aktiv___1H__1H____p "" TAB_VERB "%8.4" "[-]" COMPU_TAB_REF RANGE________aktiv___1H__1H____p /end COMPU_METHOD
/begin COMPU_METHOD RANGE________aktiv___1H__1H__895 "" TAB_VERB "%8.4" "[-]" COMPU_TAB_REF RANGE________aktiv___1H__1H__895 /end COMPU_METHOD
/begin COMPU_METHOD RANGE________JA___1H__1H____NEIN "" TAB_VERB "%8.4" "[-]" COMPU_TAB_REF RANGE________JA___1H__1H____NEIN /end COMPU_METHOD
/begin COMPU_METHOD LINEAR______0_000000__0H___25896 "" FORM "%4.0" "[s]" FORMULA "1.0*X" FORMULA_INV "1.0*X" /end COMPU_METHOD
/begin COMPU_METHOD RANGE________AR___1H__1H________ "" TAB_VERB "%8.4" "[-]" COMPU_TAB_REF RANGE________AR___1H__1H________ /end COMPU_METHOD
/begin COMPU_METHOD RANGE________AR_ABR___1H__1H____ "" TAB_VERB "%8.4" "[-]" COMPU_TAB_REF RANGE________AR_ABR___1H__1H____ /end COMPU_METHOD
/begin COMPU_METHOD RANGE________ASC___1H__1H_______ "" TAB_VERB "%8.4" "[-]" COMPU_TAB_REF RANGE________ASC___1H__1H_______ /end COMPU_METHOD
/begin COMPU_METHOD RANGE________aktiv___1H__1H_____ "" TAB_VERB "%8.4" "[-]" COMPU_TAB_REF RANGE________aktiv___1H__1H_____ /end COMPU_METHOD
/begin COMPU_METHOD UNSIGNED_LONG "" FORM "%10.0" "[-]" FORMULA "1.0*X" FORMULA_INV "1.0*X" /end COMPU_METHOD
/begin COMPU_METHOD RANGE________JA___1H__1H____N897 "" TAB_VERB "%8.4" "" COMPU_TAB_REF RANGE________JA___1H__1H____N897 /end COMPU_METHOD
/begin COMPU_METHOD RANGE________0___0H__0H____1___1 "" TAB_VERB "%8.4" "[-]" COMPU_TAB_REF RANGE________0___0H__0H____1___1 /end COMPU_METHOD
/begin COMPU_METHOD RANGE________passiv___0H__0H____ "" TAB_VERB "%8.4" "[-]" COMPU_TAB_REF RANGE________passiv___0H__0H____ /end COMPU_METHOD
/begin COMPU_METHOD RANGE________passiv___0H__0H_898 "" TAB_VERB "%8.4" "" COMPU_TAB_REF RANGE________passiv___0H__0H_898 /end COMPU_METHOD
/begin COMPU_METHOD RANGE________passiv___0H__0H_899 "" TAB_VERB "%8.4" "[-]" COMPU_TAB_REF RANGE________passiv___0H__0H_899 /end COMPU_METHOD
/begin COMPU_METHOD RANGE________passiv___0H__0H_900 "" TAB_VERB "%8.4" "[-]" COMPU_TAB_REF RANGE________passiv___0H__0H_900 /end COMPU_METHOD
/begin COMPU_METHOD RANGE________passiv___0H__0H_901 "" TAB_VERB "%8.4" "[-]" COMPU_TAB_REF RANGE________passiv___0H__0H_901 /end COMPU_METHOD
/begin COMPU_METHOD RANGE________Beladungsermittlung "" TAB_VERB "%8.4" "[-]" COMPU_TAB_REF RANGE________Beladungsermittlung /end COMPU_METHOD
/begin COMPU_METHOD RANGE________JA___1H__1H____N902 "" TAB_VERB "%8.4" "[-]" COMPU_TAB_REF RANGE________JA___1H__1H____N902 /end COMPU_METHOD
/begin COMPU_METHOD LINEAR______0_000000__0H___65903 "" FORM "%4.1" "[h]" FORMULA "0.1*X" FORMULA_INV "10.0*X" /end COMPU_METHOD
/begin COMPU_METHOD RANGE____________0H__0H____CARB_ "" TAB_VERB "%8.4" "[-]" COMPU_TAB_REF RANGE____________0H__0H____CARB_ /end COMPU_METHOD
/begin COMPU_METHOD RANGE________AN___1H__1H____AUS_ "" TAB_VERB "%8.4" "[-]" COMPU_TAB_REF RANGE________AN___1H__1H____AUS_ /end COMPU_METHOD
/begin COMPU_METHOD RANGE________vorhanden___1H__1H_ "" TAB_VERB "%8.4" "[-]" COMPU_TAB_REF RANGE________vorhanden___1H__1H_ /end COMPU_METHOD
/begin COMPU_METHOD LINEAR______0_000000__0H___65904 "" FORM "%8.4" "[Hex]" FORMULA "1.0*X" FORMULA_INV "1.0*X" /end COMPU_METHOD
/begin COMPU_METHOD LINEAR______0_000000__0H___25905 "" FORM "%8.4" "[Hex]" FORMULA "1.0*X" FORMULA_INV "1.0*X" /end COMPU_METHOD
/begin COMPU_METHOD FGR_RANGE "" TAB_VERB "%8.4" "[-]" COMPU_TAB_REF FGR_RANGE_TAB_NAME /end COMPU_METHOD
/begin COMPU_METHOD CRU_SET_POINT_RANGE "" TAB_VERB "%8.4" "" COMPU_TAB_REF CRU_SET_POINT_RANGE_TAB_NAME /end COMPU_METHOD
/begin COMPU_METHOD LINEAR______0_000000__0H___1_906 "" FORM "%5.1" "[-]" FORMULA "1.5259022e-005*X" FORMULA_INV "65535.0*X" /end COMPU_METHOD
/begin COMPU_METHOD RANGE____________0H__0H____DIAG_ "" TAB_VERB "%8.4" "[-]" COMPU_TAB_REF RANGE____________0H__0H____DIAG_ /end COMPU_METHOD
/begin COMPU_METHOD LINEAR______0_000000__0H___25907 "" FORM "%4.0" "[Hex]" FORMULA "1.0*X" FORMULA_INV "1.0*X" /end COMPU_METHOD
/begin COMPU_METHOD PVS_NORM_8_RES908 "" FORM "%4.1" "[°DK]" FORMULA "0.46862745*X" FORMULA_INV "2.1338912*X" /end COMPU_METHOD
/begin COMPU_METHOD LINEAR_______3840_020000__FF8000 "" FORM "%8.2" "[°DK]" FORMULA "0.1171899*X+0.058594949" FORMULA_INV "8.5331587*X-0.5" /end COMPU_METHOD
/begin COMPU_METHOD LINEAR______0_000000__0H___29909 "" FORM "%5.1" "[°DK/sec]" FORMULA "0.045593957*X" FORMULA_INV "21.932731*X" /end COMPU_METHOD
/begin COMPU_METHOD TI_BAS_16_RES910 "" FORM "%4.1" "[ms]" FORMULA "0.004*X" FORMULA_INV "250.0*X" /end COMPU_METHOD
/begin COMPU_METHOD LINEAR______0_000000__0H___26911 "" FORM "%5.1" "[ms]" FORMULA "0.004000061*X" FORMULA_INV "249.99619*X" /end COMPU_METHOD
/begin COMPU_METHOD LINEAR______0_000000__0H___25912 "" FORM "%8.0" "[-]" FORMULA "1.0*X" FORMULA_INV "1.0*X" /end COMPU_METHOD
/begin COMPU_METHOD RANGE________aktiv___1H__1H__913 "" TAB_VERB "%8.4" "" COMPU_TAB_REF RANGE________aktiv___1H__1H__913 /end COMPU_METHOD
/begin COMPU_METHOD LINEAR_______128_000000__FFFF914 "" FORM "%4.0" "[-]" FORMULA "1.0*X" FORMULA_INV "1.0*X" /end COMPU_METHOD
/begin COMPU_METHOD LINEAR______0_000000__0H___99915 "" FORM "%4.1" "[%]" FORMULA "0.0015258789*X" FORMULA_INV "655.36*X" /end COMPU_METHOD
/begin COMPU_METHOD LINEAR______0_000000__0H___6400_ "" FORM "%7.2" "[%]" FORMULA "0.097751711*X" FORMULA_INV "10.23*X" /end COMPU_METHOD
/begin COMPU_METHOD LINEAR______0_000000__0H___2_916 "" FORM "%6.4" "[-]" FORMULA "3.0518044e-005*X" FORMULA_INV "32767.5*X" /end COMPU_METHOD
/begin COMPU_METHOD RANGE________FS___1H__1H________ "" TAB_VERB "%8.4" "[-]" COMPU_TAB_REF RANGE________FS___1H__1H________ /end COMPU_METHOD
/begin COMPU_METHOD RANGE________FWL___1H__1H_______ "" TAB_VERB "%8.4" "[-]" COMPU_TAB_REF RANGE________FWL___1H__1H_______ /end COMPU_METHOD
/begin COMPU_METHOD RANGE________G_BEG___1H__1H_____ "" TAB_VERB "%8.4" "[-]" COMPU_TAB_REF RANGE________G_BEG___1H__1H_____ /end COMPU_METHOD
/begin COMPU_METHOD LINEAR______0_000000__0H___6_917 "" FORM "%2.0" "[Gang]" FORMULA "1.0*X" FORMULA_INV "1.0*X" /end COMPU_METHOD
/begin COMPU_METHOD LINEAR______0_000000__0H___7_918 "" FORM "%2.0" "[Gang]" FORMULA "1.0*X" FORMULA_INV "1.0*X" /end COMPU_METHOD
/begin COMPU_METHOD GANG_INF "" TAB_VERB "%8.4" "[Gang]" COMPU_TAB_REF GANG_INF_TAB_NAME /end COMPU_METHOD
/begin COMPU_METHOD GANG_CONV "" TAB_VERB "%8.4" "[Gang]" COMPU_TAB_REF GANG_CONV_TAB_NAME /end COMPU_METHOD
/begin COMPU_METHOD GW_16 "" FORM "%4.2" "[V]" FORMULA "7.7821012e-005*X" FORMULA_INV "12850.0*X" /end COMPU_METHOD
/begin COMPU_METHOD LINEAR______0_000000__0H___65919 "" FORM "%5.0" "[m]" FORMULA "1.0*X" FORMULA_INV "1.0*X" /end COMPU_METHOD
/begin COMPU_METHOD LINEAR______0_000000__0H___5_920 "" FORM "%6.4" "[A]" FORMULA "0.032258065*X" FORMULA_INV "31.0*X" /end COMPU_METHOD
/begin COMPU_METHOD LINEAR______400_000000__7FFFH___ "" FORM "%7.2" "[%PWM]" FORMULA "0.012207218*X+0.0061036088" FORMULA_INV "81.91875*X-0.5" /end COMPU_METHOD
/begin COMPU_METHOD LINEAR______0_000000__0H___26921 "" FORM "%4.3" "[ms]" FORMULA "0.004000061*X" FORMULA_INV "249.99619*X" /end COMPU_METHOD
/begin COMPU_METHOD LINEAR_______23_625000__0H___922 "" FORM "%6.2" "[°KW]" FORMULA "0.375*X-23.625" FORMULA_INV "2.6666667*X+63.0" /end COMPU_METHOD
/begin COMPU_METHOD LINEAR_______23_625000__FFH___72 "" FORM "%5.1" "[°KW]" FORMULA "-0.375*X+72.0" FORMULA_INV "-2.6666667*X+192.0" /end COMPU_METHOD
/begin COMPU_METHOD LINEAR______60_000000__0H___1923 "" FORM "%8.3" "[°KW]" FORMULA "0.375*X+60.0" FORMULA_INV "2.6666667*X-160.0" /end COMPU_METHOD
/begin COMPU_METHOD LINEAR_______48_000000__FFFFF924 "" FORM "%6.3" "[°KW]" FORMULA "0.375*X" FORMULA_INV "2.6666667*X" /end COMPU_METHOD
/begin COMPU_METHOD LINEAR_______48_000000__FFFFF925 "" FORM "%8.3" "[°KW]" FORMULA "0.375*X" FORMULA_INV "2.6666667*X" /end COMPU_METHOD
/begin COMPU_METHOD LINEAR______60_000000__0H___1926 "" FORM "%7.3" "[°KW]" FORMULA "0.375*X+60.0" FORMULA_INV "2.6666667*X-160.0" /end COMPU_METHOD
/begin COMPU_METHOD LINEAR______60_000000__0H___1927 "" FORM "%4.1" "[°KW]" FORMULA "0.375*X+60.0" FORMULA_INV "2.6666667*X-160.0" /end COMPU_METHOD
/begin COMPU_METHOD LINEAR______0_000000__0H___99928 "" FORM "%3.1" "[%]" FORMULA "0.39058823*X" FORMULA_INV "2.560241*X" /end COMPU_METHOD
/begin COMPU_METHOD RVANOS_STATE_ACTIVE_RANGE "" TAB_VERB "%8.4" "[-]" COMPU_TAB_REF RVANOS_STATE_ACTIVE_RANGE_TN /end COMPU_METHOD
/begin COMPU_METHOD LINEAR_______20480_00000__FFFF80 "" FORM "%8.1" "[ms]" FORMULA "0.625*X" FORMULA_INV "1.6*X" /end COMPU_METHOD
/begin COMPU_METHOD LINEAR_______95_625000__FFFFFF01 "" FORM "%5.1" "[°KW/s]" FORMULA "0.375*X" FORMULA_INV "2.6666667*X" /end COMPU_METHOD
/begin COMPU_METHOD LINEAR______0_000000__0H___65929 "" FORM "%8.4" "" FORMULA "1.0*X" FORMULA_INV "1.0*X" /end COMPU_METHOD
/begin COMPU_METHOD LINEAR_______155_625000__FFH_930 "" FORM "%8.3" "[°KW]" FORMULA "-0.375*X-60.0" FORMULA_INV "-2.6666667*X-160.0" /end COMPU_METHOD
/begin COMPU_METHOD LINEAR_______155_625000__FFH_931 "" FORM "%5.1" "[°KW]" FORMULA "-0.375*X-60.0" FORMULA_INV "-2.6666667*X-160.0" /end COMPU_METHOD
/begin COMPU_METHOD LINEAR______95_625000__FFFFFF01H "" FORM "%5.1" "[°KW/s]" FORMULA "-0.375*X" FORMULA_INV "-2.6666667*X" /end COMPU_METHOD
/begin COMPU_METHOD RANGE________KA___1H__1H________ "" TAB_VERB "%8.4" "[-]" COMPU_TAB_REF RANGE________KA___1H__1H________ /end COMPU_METHOD
/begin COMPU_METHOD RANGE________aktiv___1H__1H__932 "" TAB_VERB "%8.4" "" COMPU_TAB_REF RANGE________aktiv___1H__1H__932 /end COMPU_METHOD
/begin COMPU_METHOD LINEAR______0_000000__0H___3_933 "" FORM "%4.2" "[-]" FORMULA "0.015626176*X" FORMULA_INV "63.995182*X" /end COMPU_METHOD
/begin COMPU_METHOD LINEAR______0_000000__0H___15934 "" FORM "%5.3" "[-]" FORMULA "0.062509802*X" FORMULA_INV "15.997491*X" /end COMPU_METHOD
/begin COMPU_METHOD LINEAR______1_000000__100H___935 "" FORM "%5.3" "[-]" FORMULA "0.0039062743*X-6.2243137e-006" FORMULA_INV "255.99841*X+0.0015934144" /end COMPU_METHOD
/begin COMPU_METHOD LINEAR_______1024_000000__FFFFFC "" FORM "%5.0" "[Nm]" FORMULA "1.0*X" FORMULA_INV "1.0*X" /end COMPU_METHOD
/begin COMPU_METHOD TALLFS936 "" FORM "%4.1" "[%]" FORMULA "0.0061035142*X" FORMULA_INV "163.84004*X" /end COMPU_METHOD
/begin COMPU_METHOD TALLFS_IN_10MS937 "" FORM "%7.2" "[%/10ms]" FORMULA "0.0061034929*X-3.4929165e-006" FORMULA_INV "163.84061*X+0.00057228156" /end COMPU_METHOD
/begin COMPU_METHOD LINEAR_______50_000000__FFFF8938 "" FORM "%4.1" "[%]" FORMULA "0.0015258793*X+1.3349657e-005" FORMULA_INV "655.35983*X-0.0087488288" /end COMPU_METHOD
/begin COMPU_METHOD TALLFS_NEG_SI "" FORM "%7.2" "[%]" FORMULA "0.0061035156*X" FORMULA_INV "163.84*X" /end COMPU_METHOD
/begin COMPU_METHOD LINEAR______0_000000__0H___1_939 "" FORM "%4.2" "[-]" FORMULA "0.0078125491*X" FORMULA_INV "127.9992*X" /end COMPU_METHOD
/begin COMPU_METHOD LINEAR______0_000000__0H___0_940 "" FORM "%4.2" "[ms]" FORMULA "0.0039062745*X" FORMULA_INV "255.99839*X" /end COMPU_METHOD
/begin COMPU_METHOD LINEAR______0_000000__0H___16941 "" FORM "%6.3" "[-]" FORMULA "0.00024414435*X" FORMULA_INV "4095.9375*X" /end COMPU_METHOD
/begin COMPU_METHOD LINEAR______0_000000__0H___3_942 "" FORM "%5.3" "[-]" FORMULA "0.015623529*X" FORMULA_INV "64.006025*X" /end COMPU_METHOD
/begin COMPU_METHOD RANGE________KH___1H__1H________ "" TAB_VERB "%8.4" "[-]" COMPU_TAB_REF RANGE________KH___1H__1H________ /end COMPU_METHOD
/begin COMPU_METHOD RANGE________KH2___1H__1H_______ "" TAB_VERB "%8.4" "[-]" COMPU_TAB_REF RANGE________KH2___1H__1H_______ /end COMPU_METHOD
/begin COMPU_METHOD RANGE________KH3___1H__1H_______ "" TAB_VERB "%8.4" "[-]" COMPU_TAB_REF RANGE________KH3___1H__1H_______ /end COMPU_METHOD
/begin COMPU_METHOD RANGE________KK___1H__1H________ "" TAB_VERB "%8.4" "[-]" COMPU_TAB_REF RANGE________KK___1H__1H________ /end COMPU_METHOD
/begin COMPU_METHOD RANGE________KK_RELAIS___1H__1H_ "" TAB_VERB "%8.4" "[-]" COMPU_TAB_REF RANGE________KK_RELAIS___1H__1H_ /end COMPU_METHOD
/begin COMPU_METHOD LINEAR______0_000000__0H___5_943 "" FORM "%4.2" "[V]" FORMULA "0.02*X" FORMULA_INV "50.000001*X" /end COMPU_METHOD
/begin COMPU_METHOD RANGE_NOTLAUF "" TAB_VERB "%8.4" "[-]" COMPU_TAB_REF RANGE_NOTLAUF_TAB_NAME /end COMPU_METHOD
/begin COMPU_METHOD LINEAR_______24800_000000__FF800 "" FORM "%6.0" "[%PWM]" FORMULA "2.3006929e-005*X-24607.004" FORMULA_INV "43465.166*X+1.0695475e+009" /end COMPU_METHOD
/begin COMPU_METHOD RANGE________aktiv___1H__1H__944 "" TAB_VERB "%8.4" "[-]" COMPU_TAB_REF RANGE________aktiv___1H__1H__944 /end COMPU_METHOD
/begin COMPU_METHOD LINEAR______0_000000__0H___99945 "" FORM "%5.1" "[-]" FORMULA "0.0015258717*X" FORMULA_INV "655.3631*X" /end COMPU_METHOD
/begin COMPU_METHOD RANGE________KS___1H__1H________ "" TAB_VERB "%8.4" "[-]" COMPU_TAB_REF RANGE________KS___1H__1H________ /end COMPU_METHOD
/begin COMPU_METHOD LINEAR______0_000000__0H___65946 "" FORM "%5.0" "[ul]" FORMULA "1.0*X" FORMULA_INV "1.0*X" /end COMPU_METHOD
/begin COMPU_METHOD RANGE________EIN___1H__1H____AUS "" TAB_VERB "%8.4" "" COMPU_TAB_REF RANGE________EIN___1H__1H____AUS /end COMPU_METHOD
/begin COMPU_METHOD LINEAR_______50_000000__0H___947 "" FORM "%5.1" "[%]" FORMULA "0.0015258793*X-50.0" FORMULA_INV "655.35983*X+32767.991" /end COMPU_METHOD
/begin COMPU_METHOD RANGE________JA___1H__1H____N948 "" TAB_VERB "%8.4" "" COMPU_TAB_REF RANGE________JA___1H__1H____N948 /end COMPU_METHOD
/begin COMPU_METHOD RANGE________bereit___1H__1H____ "" TAB_VERB "%8.4" "" COMPU_TAB_REF RANGE________bereit___1H__1H____ /end COMPU_METHOD
/begin COMPU_METHOD RANGE________fett___1H__1H____ma "" TAB_VERB "%8.4" "" COMPU_TAB_REF RANGE________fett___1H__1H____ma /end COMPU_METHOD
/begin COMPU_METHOD RANGE________EIN___1H__1H____949 "" TAB_VERB "%8.4" "[-]" COMPU_TAB_REF RANGE________EIN___1H__1H____949 /end COMPU_METHOD
/begin COMPU_METHOD LINEAR_______128_000000__FFFF950 "" FORM "%8.4" "[Hex]" FORMULA "1.0*X" FORMULA_INV "1.0*X" /end COMPU_METHOD
/begin COMPU_METHOD LECKTEST_RANGE "" TAB_VERB "%8.4" "" COMPU_TAB_REF LECKTEST_RANGE_TAB_NAME /end COMPU_METHOD
/begin COMPU_METHOD LINEAR_______694_680000__FFFF800 "" FORM "%4.0" "[mg/Hub]" FORMULA "0.021199969*X+0.00059998474" FORMULA_INV "47.169879*X-0.028301208" /end COMPU_METHOD
/begin COMPU_METHOD MAF_KGH_16_RES951 "" FORM "%4.1" "[kg/h]" FORMULA "0.25*X" FORMULA_INV "4.0*X" /end COMPU_METHOD
/begin COMPU_METHOD LINEAR_______31_250000__3000H952 "" FORM "%5.1" "[%]" FORMULA "0.0015258789*X-50.0" FORMULA_INV "655.36*X+32768.0" /end COMPU_METHOD
/begin COMPU_METHOD RANGE________Bank1___0H__0H____B "" TAB_VERB "%8.4" "[-]" COMPU_TAB_REF RANGE________Bank1___0H__0H____B /end COMPU_METHOD
/begin COMPU_METHOD LINEAR______0_000000__0H___5_120 "" FORM "%2.1" "[* 20ms]" FORMULA "0.020078431*X" FORMULA_INV "49.804688*X" /end COMPU_METHOD
/begin COMPU_METHOD LINEAR______0_000000__0H___76953 "" FORM "%6.1" "[°DK/sec]" FORMULA "11.717647*X" FORMULA_INV "0.085341365*X" /end COMPU_METHOD
/begin COMPU_METHOD LINEAR______1_000000__1H___81954 "" FORM "%4.0" "[U/min]" FORMULA "1.0*X" FORMULA_INV "1.0*X" /end COMPU_METHOD
/begin COMPU_METHOD LINEAR______0_000000__0H___1_955 "" FORM "%5.4" "[s]" FORMULA "7.8123665e-005*X" FORMULA_INV "12800.219*X" /end COMPU_METHOD
/begin COMPU_METHOD LINEAR_______50_000000__0H___956 "" FORM "%5.1" "[%]" FORMULA "0.39062353*X-50.0" FORMULA_INV "2.5600096*X+128.00048" /end COMPU_METHOD
/begin COMPU_METHOD LINEAR_______50_000000__0H___957 "" FORM "%4.1" "[%]" FORMULA "0.39062353*X-50.0" FORMULA_INV "2.5600096*X+128.00048" /end COMPU_METHOD
/begin COMPU_METHOD LINEAR______0_000000__0H___1_989 "" FORM "%5.3" "[-]" FORMULA "0.0039*X" FORMULA_INV "256.41026*X" /end COMPU_METHOD
/begin COMPU_METHOD LINEAR______0_000000__0H___25958 "" FORM "%8.4" "[-]" FORMULA "1.0*X" FORMULA_INV "1.0*X" /end COMPU_METHOD
/begin COMPU_METHOD LINEAR______0_000000__0H___25959 "" FORM "%6.3" "[-]" FORMULA "0.0039062486*X" FORMULA_INV "256.00009*X" /end COMPU_METHOD
/begin COMPU_METHOD LINEAR______0_000000__0H___13960 "" FORM "%6.1" "[s]" FORMULA "0.019999999*X" FORMULA_INV "50.000002*X" /end COMPU_METHOD
/begin COMPU_METHOD LINEAR_______1280_000000__FFFFC0 "" FORM "%7.2" "[ms]" FORMULA "0.078124332*X-0.010937834" FORMULA_INV "12.800109*X+0.14000547" /end COMPU_METHOD
/begin COMPU_METHOD LINEAR______0_000000__0H___5_119 "" FORM "%6.4" "[s]" FORMULA "7.8120089e-005*X" FORMULA_INV "12800.805*X" /end COMPU_METHOD
/begin COMPU_METHOD TI_SGN_16_RES "" FORM "%6.2" "[ms]" FORMULA "0.004*X-131.072" FORMULA_INV "250.0*X+32768.0" /end COMPU_METHOD
/begin COMPU_METHOD TI_2co_SGN_16_RES "" FORM "%6.2" "[ms]" FORMULA "0.004*X" FORMULA_INV "250.0*X" /end COMPU_METHOD
/begin COMPU_METHOD LINEAR_______50_000000__FFFF8961 "" FORM "%5.1" "[%]" FORMULA "0.0015258793*X+1.3349657e-005" FORMULA_INV "655.35983*X-0.0087488288" /end COMPU_METHOD
/begin COMPU_METHOD LINEAR______0_000000__0H___15962 "" FORM "%6.3" "[-]" FORMULA "0.00024414054*X" FORMULA_INV "4096.0015*X" /end COMPU_METHOD
/begin COMPU_METHOD LINEAR_______100_00000__0H___100 "" FORM "%4.1" "[%]" FORMULA "0.024414063*X-100.0" FORMULA_INV "40.96*X+4096.0" /end COMPU_METHOD
/begin COMPU_METHOD LINEAR______0_000000__0H___26963 "" FORM "%4.1" "[ms]" FORMULA "0.004000061*X" FORMULA_INV "249.99619*X" /end COMPU_METHOD
/begin COMPU_METHOD LINEAR______0_000000__0H___10964 "" FORM "%5.0" "[°C]" FORMULA "1.0*X" FORMULA_INV "1.0*X" /end COMPU_METHOD
/begin COMPU_METHOD LINEAR_______0_637500__0H___0965 "" FORM "%5.3" "[V]" FORMULA "0.005*X-0.6375" FORMULA_INV "200.0*X+127.5" /end COMPU_METHOD
/begin COMPU_METHOD LINEAR______0_000000__0H___13966 "" FORM "%8.3" "[s]" FORMULA "0.019999999*X" FORMULA_INV "50.000002*X" /end COMPU_METHOD
/begin COMPU_METHOD UNSIGNED_LONG967 "" FORM "%11.0" "[-]" FORMULA "1.0*X" FORMULA_INV "1.0*X" /end COMPU_METHOD
/begin COMPU_METHOD LINEAR______0_000000__0H___509_0 "" FORM "%7.3" "[-]" FORMULA "0.0077669261*X" FORMULA_INV "128.75106*X" /end COMPU_METHOD
/begin COMPU_METHOD LINEAR______0_000000__0H___65968 "" FORM "%6.0" "[* 10ms]" FORMULA "1.0*X" FORMULA_INV "1.0*X" /end COMPU_METHOD
/begin COMPU_METHOD LINEAR______0_000000__0H___13969 "" FORM "%7.3" "[s]" FORMULA "0.019999999*X" FORMULA_INV "50.000002*X" /end COMPU_METHOD
/begin COMPU_METHOD LINEAR______0_000000__0H___25970 "" FORM "%6.2" "[-]" FORMULA "0.0039062486*X" FORMULA_INV "256.00009*X" /end COMPU_METHOD
/begin COMPU_METHOD LINEAR______0_000000__0H___65971 "" FORM "%5.0" "[* 10ms]" FORMULA "1.0*X" FORMULA_INV "1.0*X" /end COMPU_METHOD
/begin COMPU_VTAB RANGE________ABF___1H__1H_______ "" TAB_VERB 2 0x0 "" 0x1 "ABF" /end COMPU_VTAB
/begin COMPU_VTAB RANGE_____00000010_TAB_NAME "" TAB_VERB 4 0x0 "" 0x1 "ABF" 0x2 "WE" 0x3 "" /end COMPU_VTAB
/begin COMPU_VTAB RANGE________AD_S___1H__1H______ "" TAB_VERB 2 0x0 "" 0x1 "AD_S" /end COMPU_VTAB
/begin COMPU_VTAB RANGE________aktiv___1H__1H____p "" TAB_VERB 2 0x0 "passiv" 0x1 "aktiv" /end COMPU_VTAB
/begin COMPU_VTAB RANGE________aktiv___1H__1H__895 "" TAB_VERB 2 0x0 "passiv" 0x1 "aktiv" /end COMPU_VTAB
/begin COMPU_VTAB RANGE________JA___1H__1H____NEIN "" TAB_VERB 2 0x0 "NEIN" 0x1 "JA" /end COMPU_VTAB
/begin COMPU_VTAB RANGE________AR___1H__1H________ "" TAB_VERB 2 0x0 "" 0x1 "AR" /end COMPU_VTAB
/begin COMPU_VTAB RANGE________AR_ABR___1H__1H____ "" TAB_VERB 2 0x0 "" 0x1 "AR_ABR" /end COMPU_VTAB
/begin COMPU_VTAB RANGE________ASC___1H__1H_______ "" TAB_VERB 2 0x0 "" 0x1 "ASC" /end COMPU_VTAB
/begin COMPU_VTAB RANGE________aktiv___1H__1H_____ "" TAB_VERB 2 0x0 " passiv" 0x1 "aktiv" /end COMPU_VTAB
/begin COMPU_VTAB RANGE________JA___1H__1H____N897 "" TAB_VERB 2 0x0 "NEIN" 0x1 "JA" /end COMPU_VTAB
/begin COMPU_VTAB RANGE________0___0H__0H____1___1 "" TAB_VERB 2 0x0 "0" 0x1 "1" /end COMPU_VTAB
/begin COMPU_VTAB RANGE________passiv___0H__0H____ "" TAB_VERB 2 0x0 "passiv" 0x1 "LAM" /end COMPU_VTAB
/begin COMPU_VTAB RANGE________passiv___0H__0H_898 "" TAB_VERB 2 0x0 "passiv" 0x1 "LAMMW_ZV" /end COMPU_VTAB
/begin COMPU_VTAB RANGE________passiv___0H__0H_899 "" TAB_VERB 2 0x0 "passiv" 0x1 "LM_ZV" /end COMPU_VTAB
/begin COMPU_VTAB RANGE________passiv___0H__0H_900 "" TAB_VERB 2 0x0 "passiv" 0x1 "N/LM" /end COMPU_VTAB
/begin COMPU_VTAB RANGE________passiv___0H__0H_901 "" TAB_VERB 2 0x0 "passiv" 0x1 "N_ZV" /end COMPU_VTAB
/begin COMPU_VTAB RANGE________Beladungsermittlung "" TAB_VERB 2 0x0 "" 0x1 "Beladungsermittlung" /end COMPU_VTAB
/begin COMPU_VTAB RANGE________JA___1H__1H____N902 "" TAB_VERB 2 0x0 "NEIN" 0x1 "JA" /end COMPU_VTAB
/begin COMPU_VTAB RANGE____________0H__0H____CARB_ "" TAB_VERB 2 0x0 "" 0x1 "CARB-Fehler" /end COMPU_VTAB
/begin COMPU_VTAB RANGE________AN___1H__1H____AUS_ "" TAB_VERB 2 0x0 "AUS" 0x1 "AN" /end COMPU_VTAB
/begin COMPU_VTAB RANGE________vorhanden___1H__1H_ "" TAB_VERB 2 0x0 "" 0x1 "vorhanden" /end COMPU_VTAB
/begin COMPU_VTAB FGR_RANGE_TAB_NAME "" TAB_VERB 9 0x0 "HART AUS" 0x1 "AUS" 0x2 "TIP UP" 0x3 "TIP DOWN" 0x4 "BESCHL" 0x5 "WA" 0x6 "VERZ" 0x7 "RUHE" 0x8 "" /end COMPU_VTAB
/begin COMPU_VTAB CRU_SET_POINT_RANGE_TAB_NAME "" TAB_VERB 6 0x0 "PASSIV" 0x1 "KONST" 0x2 "TIP" 0x3 "S / B" 0x4 "WA" 0x5 "VE" /end COMPU_VTAB
/begin COMPU_VTAB RANGE____________0H__0H____DIAG_ "" TAB_VERB 2 0x0 "" 0x1 "DIAG-Fehler" /end COMPU_VTAB
/begin COMPU_VTAB RANGE________aktiv___1H__1H__913 "" TAB_VERB 2 0x0 " passiv" 0x1 "aktiv" /end COMPU_VTAB
/begin COMPU_VTAB RANGE________FS___1H__1H________ "" TAB_VERB 2 0x0 "" 0x1 "FS" /end COMPU_VTAB
/begin COMPU_VTAB RANGE________FWL___1H__1H_______ "" TAB_VERB 2 0x0 "" 0x1 "FWL" /end COMPU_VTAB
/begin COMPU_VTAB RANGE________G_BEG___1H__1H_____ "" TAB_VERB 2 0x0 "" 0x1 "G_BEG" /end COMPU_VTAB
/begin COMPU_VTAB GANG_INF_TAB_NAME "" TAB_VERB 8 0x0 "kein" 0x1 "1" 0x2 "2" 0x3 "3" 0x4 "4" 0x5 "5" 0x6 "6" 0x7 "Rückwärts" /end COMPU_VTAB
/begin COMPU_VTAB GANG_CONV_TAB_NAME "" TAB_VERB 7 0x0 "KEIN" 0x1 "1" 0x2 "2" 0x3 "3" 0x4 "4" 0x5 "5" 0x6 "6" /end COMPU_VTAB
/begin COMPU_VTAB RVANOS_STATE_ACTIVE_RANGE_TN "" TAB_VERB 5 0x0 "INIT" 0x1 "HALTEN_TOTZ" 0x2 "HALTEN_ADAP" 0x3 "VERST" 0x4 "END_POS" /end COMPU_VTAB
/begin COMPU_VTAB RANGE________KA___1H__1H________ "" TAB_VERB 2 0x0 "" 0x1 "KA" /end COMPU_VTAB
/begin COMPU_VTAB RANGE________aktiv___1H__1H__932 "" TAB_VERB 2 0x0 "passiv" 0x1 "aktiv" /end COMPU_VTAB
/begin COMPU_VTAB RANGE________KH___1H__1H________ "" TAB_VERB 2 0x0 "" 0x1 "KH" /end COMPU_VTAB
/begin COMPU_VTAB RANGE________KH2___1H__1H_______ "" TAB_VERB 2 0x0 "" 0x1 "KH2" /end COMPU_VTAB
/begin COMPU_VTAB RANGE________KH3___1H__1H_______ "" TAB_VERB 2 0x0 "" 0x1 "KH3" /end COMPU_VTAB
/begin COMPU_VTAB RANGE________KK___1H__1H________ "" TAB_VERB 2 0x0 "" 0x1 "KK" /end COMPU_VTAB
/begin COMPU_VTAB RANGE________KK_RELAIS___1H__1H_ "" TAB_VERB 2 0x0 "" 0x1 "KK_RELAIS" /end COMPU_VTAB
/begin COMPU_VTAB RANGE_NOTLAUF_TAB_NAME "" TAB_VERB 2 0x0 "" 0x1 "Notlauf" /end COMPU_VTAB
/begin COMPU_VTAB RANGE________aktiv___1H__1H__944 "" TAB_VERB 2 0x0 " passiv" 0x1 "aktiv" /end COMPU_VTAB
/begin COMPU_VTAB RANGE________KS___1H__1H________ "" TAB_VERB 2 0x0 "" 0x1 "KS" /end COMPU_VTAB
/begin COMPU_VTAB RANGE________EIN___1H__1H____AUS "" TAB_VERB 2 0x0 "AUS" 0x1 "EIN" /end COMPU_VTAB
/begin COMPU_VTAB RANGE________JA___1H__1H____N948 "" TAB_VERB 2 0x0 "NEIN" 0x1 "JA" /end COMPU_VTAB
/begin COMPU_VTAB RANGE________bereit___1H__1H____ "" TAB_VERB 2 0x0 "" 0x1 "bereit" /end COMPU_VTAB
/begin COMPU_VTAB RANGE________fett___1H__1H____ma "" TAB_VERB 2 0x0 "mager" 0x1 "fett" /end COMPU_VTAB
/begin COMPU_VTAB RANGE________EIN___1H__1H____949 "" TAB_VERB 2 0x0 "AUS" 0x1 "EIN" /end COMPU_VTAB
/begin COMPU_VTAB LECKTEST_RANGE_TAB_NAME "" TAB_VERB 55 -0x40 "ENDG.ABBRUCH" -0x3f "ENDG.ABBRUCH" -0x3e "ENDG.ABBRUCH" -0x3d "ENDG.ABBRUCH" -0x3c "ENDG.ABBRUCH" -0x3b "ENDG.ABBRUCH" -0x3a "ENDG.ABBRUCH" -0x39 "ENDG.ABBRUCH" -0x38 "ENDG.ABBRUCH" -0x37 "ENDG.ABBRUCH" -0x36 "ENDG.ABBRUCH" -0x35 "ENDG.ABBRUCH" -0x34 "ENDG.ABBRUCH" -0x33 "ENDG.ABBRUCH" -0x32 "ENDG.ABBRUCH" -0x31 "ENDG.ABBRUCH" -0x30 "ENDG.ABBRUCH" -0x2f "ENDG.ABBRUCH" -0x2e "ENDG.ABBRUCH" -0x2d "ENDG.ABBRUCH" -0x2c "ENDG.ABBRUCH" -0x2b "ENDG.ABBRUCH" -0x2a "ENDG.ABBRUCH" -0x29 "ENDG.ABBRUCH" -0x28 "ENDG.ABBRUCH" -0x27 "ENDG.ABBRUCH" -0x26 "ENDG.ABBRUCH" -0x25 "ENDG.ABBRUCH" -0x24 "ENDG.ABBRUCH" -0x23 "ENDG.ABBRUCH" -0x22 "ENDG.ABBRUCH" -0x21 "ENDG.ABBRUCH" -0x20 "ENDG.ABBRUCH" -0x1f "ENDG.ABBRUCH" -0x1e "ENDG.ABBRUCH" -0x1d "ENDG.ABBRUCH" -0x1c "ENDG.ABBRUCH" -0x1b "ENDG.ABBRUCH" -0x1a "ENDG.ABBRUCH" -0x19 "ENDG.ABBRUCH" -0x18 "ENDG.ABBRUCH" -0x16 "FEHLER/ABBRUCH" -0x14 "BEENDET/FEHLER" -0x10 "BEENDET OHNE FEHLER" -0x8 "LDP-FEHLER VERMUTET" 0x0 "WARTESTELLUNG 1.START" 0x8 "WARTESTELLUNG WST" 0xc "TEVSCHLIESSEN" 0x10 "RS C_CHECK" 0x18 "RS C_O_CHECK" 0x20 "RS O_C_CHECK" 0x28 "RS CT_CHECK" 0x30 "FP" 0x38 "NF" 0x40 "MEASUREMENT" /end COMPU_VTAB
/begin COMPU_VTAB RANGE________Bank1___0H__0H____B "" TAB_VERB 2 0x0 "Bank1" 0x1 "Bank2" /end COMPU_VTAB
/begin RECORD_LAYOUT a_172 FNC_VALUES 1 SWORD ROW_DIR DIRECT /end RECORD_LAYOUT
/begin RECORD_LAYOUT a_173 FNC_VALUES 1 UBYTE ROW_DIR DIRECT /end RECORD_LAYOUT
/begin RECORD_LAYOUT a_174 FNC_VALUES 1 UWORD ROW_DIR DIRECT /end RECORD_LAYOUT
/begin RECORD_LAYOUT a_175 FNC_VALUES 1 SBYTE ROW_DIR DIRECT /end RECORD_LAYOUT
/end MODULE
/end PROJECT
