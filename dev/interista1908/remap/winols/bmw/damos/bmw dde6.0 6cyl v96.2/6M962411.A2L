ASAP2_VERSION 1 3
/begin PROJECT P411 "BMW DDE6.0 6-Zylinder V96.2 14.10.2004"
/begin HEADER "" VERSION "V96.2_6Z" PROJECT_NO P411 /end HEADER
/begin MODULE DIM ""
/begin MOD_COMMON "" BYTE_ORDER MSB_FIRST ALIGNMENT_BYTE 1 ALIGNMENT_WORD 2 ALIGNMENT_LONG 4 ALIGNMENT_FLOAT32_IEEE 4 /end MOD_COMMON
/begin CHARACTERISTIC ANZMRKAUS "wie oft die anzeige ausgeschalten wird" VALUE 0xC05C0 KwWU8 255.0 dez 0.00 255.0 FORMAT "%5.1" /end CHARACTERISTIC
/begin CHARACTERISTIC ANZMRKMX "max. zulässige anzahl von geschwindigkeits- marken beim stufentempomat" VALUE 0xC05C1 KwWU8 255.0 dez 0.00 255.0 FORMAT "%5.1" /end CHARACTERISTIC
/begin CHARACTERISTIC CoEng_dnOvrFulMin_C "untere Hysteresegrenze für Overfueling Drehzahlgradienten" VALUE 0xCA138 Kw_Ws16 655350.0 dn_dZ20 -327680.0 327670.0 FORMAT "%8.1" /end CHARACTERISTIC
/begin CHARACTERISTIC CoEng_dnOvrFulMax_C "obere Hysteresegrenze für Overfueling Drehzahlgradienten" VALUE 0xCA13A Kw_Ws16 655350.0 dn_dZ20 -327680.0 327670.0 FORMAT "%8.1" /end CHARACTERISTIC
/begin CHARACTERISTIC CoEng_stdnOvrFulLow_C "Status für Overfueling Drehzahlgradienten Hysterese aus" VALUE 0xCA13C Kw_Ws16 65535.00 OneToOne -32768.00 32767.00 FORMAT "%8.2" READ_ONLY /end CHARACTERISTIC
/begin CHARACTERISTIC CoEng_stdnOvrFulHigh_C "Status für Overfueling Drehzahlgradienten Hysterese ein" VALUE 0xCA13E Kw_Ws16 65535.00 OneToOne -32768.00 32767.00 FORMAT "%8.2" READ_ONLY /end CHARACTERISTIC
/begin CHARACTERISTIC CoEng_dtrqEngPrtRgnMonUp_C "Steigung zur Aufwärtsrampung im Fehlerfall" VALUE 0xCA140 Kw_Wu32 6553599.99847 RmpTrq 0.00 6553599.99847 FORMAT "%13.5" /end CHARACTERISTIC
/begin CHARACTERISTIC CoEng_dtrqEngPrtRgnMonDwn_C "Steigung zur Abwärtsrampung im Fehlerfall" VALUE 0xCA144 Kw_Wu32 6553599.99847 RmpTrq 0.00 6553599.99847 FORMAT "%13.5" /end CHARACTERISTIC
/begin CHARACTERISTIC CoEng_dtrqLimUp_C "#SSD pos. Rampenanstieg bei Umschaltung auf Begrenzungsmoment bei Systemfehler" VALUE 0xCA148 Kw_Wu32 6553599.99847 RmpTrq 0.00 6553599.99847 FORMAT "%13.5" /end CHARACTERISTIC
/begin CHARACTERISTIC CoEng_dtrqLimDwn_C "neg. Rampenanstieg bei Rückkehr von dem Begrenzungsmoment bei Systemfehler" VALUE 0xCA14C Kw_Wu32 6553599.99847 RmpTrq 0.00 6553599.99847 FORMAT "%13.5" /end CHARACTERISTIC
/begin CHARACTERISTIC CoEng_dtrqLimUp1_C "#SSD positive Rampensteigung für Rampenschalter" VALUE 0xCA150 Kw_Wu32 6553599.99847 RmpTrq 0.00 6553599.99847 FORMAT "%13.5" /end CHARACTERISTIC
/begin CHARACTERISTIC CoEng_dtrqLimDwn1_C "negative Steigung für einen Rampenschalter" VALUE 0xCA154 Kw_Wu32 6553599.99847 RmpTrq 0.00 6553599.99847 FORMAT "%13.5" /end CHARACTERISTIC
/begin CHARACTERISTIC CoEng_dtrqLimUp2_C "#SSD positive Steigung für Rampenschalter 2" VALUE 0xCA158 Kw_Wu32 6553599.99847 RmpTrq 0.00 6553599.99847 FORMAT "%13.5" /end CHARACTERISTIC
/begin CHARACTERISTIC CoEng_dtrqLimDwn2_C "negative Steigung für Rampenschalter 2" VALUE 0xCA15C Kw_Wu32 6553599.99847 RmpTrq 0.00 6553599.99847 FORMAT "%13.5" /end CHARACTERISTIC
/begin CHARACTERISTIC CoEng_dtrqLimUp3_C "positive Rampensteigung für Rampenschalter" VALUE 0xCA160 Kw_Wu32 6553599.99847 RmpTrq 0.00 6553599.99847 FORMAT "%13.5" /end CHARACTERISTIC
/begin CHARACTERISTIC CoEng_dtrqLimDwn3_C "negative Rampensteigung für Rampenschalter" VALUE 0xCA164 Kw_Wu32 6553599.99847 RmpTrq 0.00 6553599.99847 FORMAT "%13.5" /end CHARACTERISTIC
/begin CHARACTERISTIC CoEng_dtrqLimUp4_C "positive Rampensteigung für Rampenschalter" VALUE 0xCA168 Kw_Wu32 6553599.99847 RmpTrq 0.00 6553599.99847 FORMAT "%13.5" /end CHARACTERISTIC
/begin CHARACTERISTIC CoEng_dtrqLimDwn4_C "negative Rampensteigung für Rampenschalter" VALUE 0xCA16C Kw_Wu32 6553599.99847 RmpTrq 0.00 6553599.99847 FORMAT "%13.5" /end CHARACTERISTIC
/begin CHARACTERISTIC CoEng_dtrqPFltOvldUp_C "Steigung für Partikelfilter uberladen Rampe(up)" VALUE 0xCA170 Kw_Wu32 6553599.99847 RmpTrq 0.00 6553599.99847 FORMAT "%13.5" /end CHARACTERISTIC
/begin CHARACTERISTIC CoEng_dtrqPFltOvldDwn_C "Steigung für Partikelfilter uberladen Rampe(down)" VALUE 0xCA174 Kw_Wu32 6553599.99847 RmpTrq 0.00 6553599.99847 FORMAT "%13.5" /end CHARACTERISTIC
/begin CHARACTERISTIC CoEng_tiOvrFulDT1_C "Zeit für Overfueling DT1" VALUE 0xCA178 Kw_Wu32 4294.9673 TimeDelay_s 0.0000010000000 4294.9673 FORMAT "%9.4" /end CHARACTERISTIC
/begin CHARACTERISTIC CoEng_facOvrFulDKd_C "Kd für overfueling DT1" VALUE 0xCA17C Kw_Ws32 32767.9999924 Kd_rpm2dndt -16384.0000000 16383.9999924 FORMAT "%13.7" /end CHARACTERISTIC
/begin CHARACTERISTIC CoEng_facAdjDfl_C "Defaultwert für Abgleich Momentenbegrenzung" VALUE 0xCA180 Kw_Ws16 2.000000 Fact 0.00 2.000000 FORMAT "%8.6" EXTENDED_LIMITS -4.000000 3.999878 /end CHARACTERISTIC
/begin CHARACTERISTIC CoEng_facAdjMax_C "#SSD Maximaler Abgleichwert für Abgleich Momentenbegrenzung" VALUE 0xCA182 Kw_Ws16 7.999878 Fact -4.000000 3.999878 FORMAT "%8.6" /end CHARACTERISTIC
/begin CHARACTERISTIC CoEng_facAdjMin_C "Minimaler Abgleichwert für Abgleich Momentenbegrenzung" VALUE 0xCA184 Kw_Ws16 7.999878 Fact -4.000000 3.999878 FORMAT "%8.6" /end CHARACTERISTIC
/begin CHARACTERISTIC CoEng_nOvrFulMax_C "obere Hysteresegrenze für Overfueling Motordrehzahl" VALUE 0xCA186 Kw_Ws16 5960.000 EngN 40.00000 6000.000 FORMAT "%8.3" EXTENDED_LIMITS -32768.00 32767.00 /end CHARACTERISTIC
/begin CHARACTERISTIC CoEng_nOvrFulMin_C "untere Hysteresegrenze für Overfueling Motordrehzahl" VALUE 0xCA188 Kw_Ws16 5960.000 EngN 40.00000 6000.000 FORMAT "%8.3" EXTENDED_LIMITS -32768.00 32767.00 /end CHARACTERISTIC
/begin CHARACTERISTIC CoEng_nSlpLimMin_C "Drehzahlschwelle f. Aktivierung Tuboschubbegrenzung" VALUE 0xCA560 Kw_Ws16 32767.00 EngN 0.00 32767.00 FORMAT "%8.2" EXTENDED_LIMITS -32768.00 32767.00 /end CHARACTERISTIC
/begin CHARACTERISTIC CoEng_dtrqRmpUp_C "Rampensteigung aufwärts für Schubabschaltung( nicht applizierbar da nie in Gebrauch)" VALUE 0xCA0DC Kw_Wu32 6553584.99908 RmpTrq 14.9993896484 6553599.99847 FORMAT "%13.5" EXTENDED_LIMITS 0.00 6553599.99847 READ_ONLY /end CHARACTERISTIC
/begin CHARACTERISTIC CoEng_dtrqRmpDwn_C "Rampensteigung bei Schubabschaltung" VALUE 0xCA0E0 Kw_Wu32 6553584.99908 RmpTrq 14.9993896484 6553599.99847 FORMAT "%13.5" EXTENDED_LIMITS 0.00 6553599.99847 /end CHARACTERISTIC
/begin CHARACTERISTIC CoEng_tiPFltdVolPT1_C "Filterzeitkonstante für Volumenstrom" VALUE 0xCA18C Kw_Wu32 4294.9673 TimeDelay_s 0.0000010000000 4294.9673 FORMAT "%9.4" /end CHARACTERISTIC
/begin CHARACTERISTIC CoEng_tiPFltResFlowPT1_C "Filterzeitkonstante für Strömungswiderstand" VALUE 0xCA190 Kw_Wu32 4294.9673 TimeDelay_s 0.0000010000000 4294.9673 FORMAT "%9.4" /end CHARACTERISTIC
/begin CHARACTERISTIC CoEng_dtrqOvrFulUp_C "Steigung des Drehmoments (Nm/s) für Overfueling ramp switch" VALUE 0xCA194 Kw_Wu32 6553594.99817 RmpTrq 5.00030517578 6553599.99847 FORMAT "%13.5" EXTENDED_LIMITS 0.00 6553599.99847 /end CHARACTERISTIC
/begin CHARACTERISTIC CoEng_dtrqOvrFulDown_C "Steigung des Drehmoments (Nm/s) für Overfueling ramp switch" VALUE 0xCA198 Kw_Wu32 6553594.99817 RmpTrq 5.00030517578 6553599.99847 FORMAT "%13.5" EXTENDED_LIMITS 0.00 6553599.99847 /end CHARACTERISTIC
/begin CHARACTERISTIC CoEng_rOvrFulMin_C "untere Hysteresegrenze für Overfueling Gaspedalposition" VALUE 0xCA19C Kw_Ws16 100.0000 Prc 0.00 100.0000 FORMAT "%8.4" EXTENDED_LIMITS -400.0000 399.9878 /end CHARACTERISTIC
/begin CHARACTERISTIC CoEng_rOvrFulMax_C "obere Hysteresegrenze für Overfueling Gaspedalposition" VALUE 0xCA19E Kw_Ws16 100.0000 Prc 0.00 100.0000 FORMAT "%8.4" EXTENDED_LIMITS -400.0000 399.9878 /end CHARACTERISTIC
/begin CHARACTERISTIC CoEng_strOvrFulLow_C "status for overfueling acceleration pedale position hysteresis off" VALUE 0xCA1A0 Kw_Ws16 65535.00 OneToOne -32768.00 32767.00 FORMAT "%8.2" READ_ONLY /end CHARACTERISTIC
/begin CHARACTERISTIC CoEng_strOvrFulHigh_C "status for overfueling acceleration pedale position hysteresis on" VALUE 0xCA1A2 Kw_Ws16 65535.00 OneToOne -32768.00 32767.00 FORMAT "%8.2" READ_ONLY /end CHARACTERISTIC
/begin CHARACTERISTIC CoEng_dtrqSlpLimUpdef_C "Anstiegsbegrenzung f. Rauchgrenze ""Turboschubbegrenzung"" bei unbekannter Ganginformation" VALUE 0xCA564 Kw_Wu32 6553599.99847 RmpTrq 0.00 6553599.99847 FORMAT "%13.5" /end CHARACTERISTIC
/begin CHARACTERISTIC CoEng_dtrqSlpLimDwndef_C "Abwärts-Momentenbegrenzung für Rauchbegrenzung/Turboschubbegrenzung (fest auf maximalem Abstieg) bei unbekannter Ganginformation" VALUE 0xCA568 Kw_Wu32 6553599.99847 RmpTrq 0.00 6553599.99847 FORMAT "%13.5" READ_ONLY /end CHARACTERISTIC
/begin CHARACTERISTIC CoEng_dtrqSlpLimUp1_C "Anstiegsbegrenzung f. Rauchgrenze ""Turboschubbegrenzung"" bei Gang 1" VALUE 0xCA56C Kw_Wu32 6553599.99847 RmpTrq 0.00 6553599.99847 FORMAT "%13.5" /end CHARACTERISTIC
/begin CHARACTERISTIC CoEng_dtrqSlpLimDwn1_C "Abwärts-Momentenbegrenzung für Rauchbegrenzung/Turboschubbegrenzung (fest auf maximalem Abstieg) bei Gang 1" VALUE 0xCA570 Kw_Wu32 6553599.99847 RmpTrq 0.00 6553599.99847 FORMAT "%13.5" READ_ONLY /end CHARACTERISTIC
/begin CHARACTERISTIC CoEng_dtrqSlpLimUp2_C "Anstiegsbegrenzung f. Rauchgrenze ""Turboschubbegrenzung"" bei Gang 2" VALUE 0xCA574 Kw_Wu32 6553599.99847 RmpTrq 0.00 6553599.99847 FORMAT "%13.5" /end CHARACTERISTIC
/begin CHARACTERISTIC CoEng_dtrqSlpLimDwn2_C "Abwärts-Momentenbegrenzung für Rauchbegrenzung/Turboschubbegrenzung (fest auf maximalem Abstieg) bei Gang 2" VALUE 0xCA578 Kw_Wu32 6553599.99847 RmpTrq 0.00 6553599.99847 FORMAT "%13.5" READ_ONLY /end CHARACTERISTIC
/begin CHARACTERISTIC CoEng_dtrqSlpLimUp3_C "Anstiegsbegrenzung f. Rauchgrenze ""Turboschubbegrenzung"" bei Gang 3" VALUE 0xCA57C Kw_Wu32 6553599.99847 RmpTrq 0.00 6553599.99847 FORMAT "%13.5" /end CHARACTERISTIC
/begin CHARACTERISTIC CoEng_dtrqSlpLimDwn3_C "Abwärts-Momentenbegrenzung für Rauchbegrenzung/Turboschubbegrenzung (fest auf maximalem Abstieg) bei Gang 3" VALUE 0xCA580 Kw_Wu32 6553599.99847 RmpTrq 0.00 6553599.99847 FORMAT "%13.5" READ_ONLY /end CHARACTERISTIC
/begin CHARACTERISTIC CoEng_dtrqSlpLimUp4_C "Anstiegsbegrenzung f. Rauchgrenze ""Turboschubbegrenzung"" bei Gang 4" VALUE 0xCA584 Kw_Wu32 6553599.99847 RmpTrq 0.00 6553599.99847 FORMAT "%13.5" /end CHARACTERISTIC
/begin CHARACTERISTIC CoEng_dtrqSlpLimDwn4_C "Abwärts-Momentenbegrenzung für Rauchbegrenzung/Turboschubbegrenzung (fest auf maximalem Abstieg) bei Gang 4" VALUE 0xCA588 Kw_Wu32 6553599.99847 RmpTrq 0.00 6553599.99847 FORMAT "%13.5" READ_ONLY /end CHARACTERISTIC
/begin CHARACTERISTIC CoEng_dtrqSlpLimUp5_C "Anstiegsbegrenzung f. Rauchgrenze ""Turboschubbegrenzung"" bei Gang 5" VALUE 0xCA58C Kw_Wu32 6553599.99847 RmpTrq 0.00 6553599.99847 FORMAT "%13.5" /end CHARACTERISTIC
/begin CHARACTERISTIC CoEng_dtrqSlpLimDwn5_C "Abwärts-Momentenbegrenzung für Rauchbegrenzung/Turboschubbegrenzung (fest auf maximalem Abstieg) bei Gang 5" VALUE 0xCA590 Kw_Wu32 6553599.99847 RmpTrq 0.00 6553599.99847 FORMAT "%13.5" READ_ONLY /end CHARACTERISTIC
/begin CHARACTERISTIC CoEng_dtrqSlpLimUp6_C "Anstiegsbegrenzung f. Rauchgrenze ""Turboschubbegrenzung"" bei Gang 6" VALUE 0xCA594 Kw_Wu32 6553599.99847 RmpTrq 0.00 6553599.99847 FORMAT "%13.5" /end CHARACTERISTIC
/begin CHARACTERISTIC CoEng_dtrqSlpLimDwn6_C "Abwärts-Momentenbegrenzung für Rauchbegrenzung/Turboschubbegrenzung (fest auf maximalem Abstieg) bei Gang 6" VALUE 0xCA598 Kw_Wu32 6553599.99847 RmpTrq 0.00 6553599.99847 FORMAT "%13.5" READ_ONLY /end CHARACTERISTIC
/begin CHARACTERISTIC CoEng_dtrqSlpLimUpREV_C "Anstiegsbegrenzung f. Rauchgrenze ""Turboschubbegrenzung"" bei Rückwärtsgang" VALUE 0xCA59C Kw_Wu32 6553599.99847 RmpTrq 0.00 6553599.99847 FORMAT "%13.5" /end CHARACTERISTIC
/begin CHARACTERISTIC CoEng_dtrqSlpLimDwnREV_C "Abwärts-Momentenbegrenzung für Rauchbegrenzung/Turboschubbegrenzung (fest auf maximalem Abstieg) bei Rückwärtsgang" VALUE 0xCA5A0 Kw_Wu32 6553599.99847 RmpTrq 0.00 6553599.99847 FORMAT "%13.5" READ_ONLY /end CHARACTERISTIC
/begin CHARACTERISTIC CoEng_stPFltLimMsk_C "Bitmaske zur selektiven Ausblendung von Bits in EGT_st" VALUE 0xCA1A4 Kw_Wu32 4294967295.00 OneToOne 0.00 4294967295.00 FORMAT "%13.2" /end CHARACTERISTIC
/begin CHARACTERISTIC CoEng_swtPPreCat_C "Schalter zur Auswahl zwischen Drücken" VALUE 0xCA1A8 Kw_Wu8 1.000 OneToOne 0.00 1.000 FORMAT "%5.3" EXTENDED_LIMITS 0.00 255.0 /end CHARACTERISTIC
/begin CHARACTERISTIC CoEng_swtSelOvRMonSync_C "Schalter zur Auswahl der Aktivierungsbedingung der Schubüberwachung" VALUE 0xCA0E4 Kw_Wu8 1.000 OneToOne 0.00 1.000 FORMAT "%5.3" EXTENDED_LIMITS 0.00 255.0 /end CHARACTERISTIC
/begin CHARACTERISTIC CoEng_tiPFltOvldOk_C "Wert während der debounce Zeit, zum O.K. zu ändern" VALUE 0xCA1AA Kw_Wu16 655350.0 TimeDeb 0.00 655350.0 FORMAT "%8.1" /end CHARACTERISTIC
/begin CHARACTERISTIC CoEng_tiRepOvrFul_C "Sperrzeit für Overfueling timer" VALUE 0xCA1AC Kw_Wu32 21474836.4700 Time_s 0.00 21474836.4700 FORMAT "%13.4" EXTENDED_LIMITS 0.00 42949672.9500 /end CHARACTERISTIC
/begin CHARACTERISTIC CoEng_tiRmpStrtDfl_C "Default Wartezeit nach Schuberkennung bis Rampe startet" VALUE 0xCA0E6 Kw_Wu16 655350.0 Time_ms 0.00 655350.0 FORMAT "%8.1" /end CHARACTERISTIC
/begin CHARACTERISTIC CoEng_tiRmpStrt_CUR "Wartezeit nach Schuberkennung bei Grip bis Rampe startet" CURVE 0xCA0E8 Kl_Xs16_Ws16 10000.00 Time_ms 0.00 10000.00 FORMAT "%8.2" EXTENDED_LIMITS -327680.0 327670.0
 /begin AXIS_DESCR STD_AXIS DrvTrn_rTransDT TransR 7 0.00 10.00000 FORMAT "%8.5" EXTENDED_LIMITS -327.6800 327.6700 DEPOSIT ABSOLUTE /end AXIS_DESCR
/end CHARACTERISTIC
/begin CHARACTERISTIC CoEng_tiSwtOffDfl_C "Default Wartezeit nach Schuberkennung bis Abschaltung" VALUE 0xCA106 Kw_Wu16 655350.0 Time_ms 0.00 655350.0 FORMAT "%8.1" /end CHARACTERISTIC
/begin CHARACTERISTIC CoEng_tiSwtOff_CUR "Wartezeit nach Schuberkennung bei Grip bis Abschaltung" CURVE 0xCA108 Kl_Xs16_Ws16 10000.00 Time_ms 0.00 10000.00 FORMAT "%8.2" EXTENDED_LIMITS -327680.0 327670.0
 /begin AXIS_DESCR STD_AXIS DrvTrn_rTransDT TransR 7 0.00 10.00000 FORMAT "%8.5" EXTENDED_LIMITS -327.6800 327.6700 DEPOSIT ABSOLUTE /end AXIS_DESCR
/end CHARACTERISTIC
/begin CHARACTERISTIC CoEng_tiTstMax_C "Maximale Zeit zwischen zwei Testanforderungen" VALUE 0xCA5A4 Kw_Wu16 655350.0 Time_ms 0.00 655350.0 FORMAT "%8.1" /end CHARACTERISTIC
/begin CHARACTERISTIC CoEng_tPFltPreLim_C "Grenzwert für PFlt_tPre" VALUE 0xCA1B0 Kw_Ws16 950.000 Temp_Cels -50.140 899.860 FORMAT "%8.3" EXTENDED_LIMITS -3549.940 3003.560 /end CHARACTERISTIC
/begin CHARACTERISTIC CoEng_trqCorGearbxRgn_CUR "Kennlinie zur Korrektur der Getriebeschaltschwellen während der Regeneration, drehzahlabhängig ( weniger Moment zur Verfügung )" CURVE 0xCA1B2 Kl_Xs16_Ws16 1000.000 Trq 0.00 1000.000 FORMAT "%8.3" EXTENDED_LIMITS -3276.800 3276.700
 /begin AXIS_DESCR STD_AXIS Eng_nAvrg EngN 16 0.00 6000.000 FORMAT "%8.3" EXTENDED_LIMITS -32768.00 32767.00 DEPOSIT ABSOLUTE /end AXIS_DESCR
/end CHARACTERISTIC
/begin CHARACTERISTIC CoEng_trqInrSetLim_CUR "Sollwert des inneren Moments wenn Schub erkannt wurde und die Schubüberwachung aktiv ist" CURVE 0xCA126 Kl_Xs16_Ws16 3276.700 Trq 0.00 3276.700 FORMAT "%8.3" EXTENDED_LIMITS -3276.800 3276.700
 /begin AXIS_DESCR STD_AXIS CoEng_tiOvRMon_mp Time_ms 3 0.00 327670.0 FORMAT "%8.1" EXTENDED_LIMITS -327680.0 327670.0 DEPOSIT ABSOLUTE /end AXIS_DESCR
/end CHARACTERISTIC
/begin CHARACTERISTIC CoEng_trqLimErr1_CUR "Kennlinie für Begrenzungsmoment abhängig von der Drehzahl im Fehlerfall" CURVE 0xCA1F4 Kl_Xs16_Ws16 1000.000 Trq 0.00 1000.000 FORMAT "%8.3" EXTENDED_LIMITS -3276.800 3276.700
 /begin AXIS_DESCR STD_AXIS Eng_nAvrg EngN 10 0.00 6000.000 FORMAT "%8.3" EXTENDED_LIMITS -32768.00 32767.00 DEPOSIT ABSOLUTE /end AXIS_DESCR
/end CHARACTERISTIC
/begin CHARACTERISTIC CoEng_trqLimErr2_CUR "Kennlinie für Begrenzungsmoment abhängig von der Drehzahl im Fehlerfall 2" CURVE 0xCA21E Kl_Xs16_Ws16 1000.000 Trq 0.00 1000.000 FORMAT "%8.3" EXTENDED_LIMITS -3276.800 3276.700
 /begin AXIS_DESCR STD_AXIS Eng_nAvrg EngN 10 0.00 6000.000 FORMAT "%8.3" EXTENDED_LIMITS -32768.00 32767.00 DEPOSIT ABSOLUTE /end AXIS_DESCR
/end CHARACTERISTIC
/begin CHARACTERISTIC CoEng_trqLimErr3_CUR "Kennlinie für Begrenzungsmoment abhängig von der Drehzahl im Fehlerfall 3" CURVE 0xCA248 Kl_Xs16_Ws16 1000.000 Trq 0.00 1000.000 FORMAT "%8.3" EXTENDED_LIMITS -3276.800 3276.700
 /begin AXIS_DESCR STD_AXIS Eng_nAvrg EngN 10 0.00 6000.000 FORMAT "%8.3" EXTENDED_LIMITS -32768.00 32767.00 DEPOSIT ABSOLUTE /end AXIS_DESCR
/end CHARACTERISTIC
/begin CHARACTERISTIC CoEng_trqLimErr4_CUR "Kennlinie für Begrenzungsmoment abhängig von der Drehzahl im Fehlerfall 4" CURVE 0xCA272 Kl_Xs16_Ws16 1000.000 Trq 0.00 1000.000 FORMAT "%8.3" EXTENDED_LIMITS -3276.800 3276.700
 /begin AXIS_DESCR STD_AXIS Eng_nAvrg EngN 10 0.00 6000.000 FORMAT "%8.3" EXTENDED_LIMITS -32768.00 32767.00 DEPOSIT ABSOLUTE /end AXIS_DESCR
/end CHARACTERISTIC
/begin CHARACTERISTIC CoEng_trqLimErr_CUR "Kennlinie für das Begrenzungsmoment bei Systemfehlern" CURVE 0xCA29C Kl_Xs16_Ws16 1000.000 Trq 0.00 1000.000 FORMAT "%8.3" EXTENDED_LIMITS -3276.800 3276.700
 /begin AXIS_DESCR STD_AXIS Eng_nAvrg EngN 10 0.00 6000.000 FORMAT "%8.3" EXTENDED_LIMITS -32768.00 32767.00 DEPOSIT ABSOLUTE /end AXIS_DESCR
/end CHARACTERISTIC
/begin CHARACTERISTIC CoEng_trqLimPDiff1_CUR "Begrenzunsmoment aufgrund abasgegendruck" CURVE 0xCA2C6 Kl_Xs16_Ws16 1500.000 Trq -500.0000 1000.000 FORMAT "%8.3" EXTENDED_LIMITS -3276.800 3276.700
 /begin AXIS_DESCR STD_AXIS PFlt_pDiff Pres_hPa 8 0.00 5000.000 FORMAT "%8.3" EXTENDED_LIMITS -32768.00 32767.00 DEPOSIT ABSOLUTE /end AXIS_DESCR
/end CHARACTERISTIC
/begin CHARACTERISTIC CoEng_trqLimPDiffNOffs_CUR "Begrenzungswert im Fall des pflt-Systemfehlers, Startmoment ansteigen" CURVE 0xCA2E8 Kl_Xs16_Ws16 1000.000 Trq 0.00 1000.000 FORMAT "%8.3" EXTENDED_LIMITS -3276.800 3276.700
 /begin AXIS_DESCR STD_AXIS Eng_nAvrg EngN 16 0.00 6000.000 FORMAT "%8.3" EXTENDED_LIMITS -32768.00 32767.00 DEPOSIT ABSOLUTE /end AXIS_DESCR
/end CHARACTERISTIC
/begin CHARACTERISTIC CoEng_trqLimPDiff_MAP "Limit für differentialdruck des Partikelfilters" MAP 0xCA32A Kf_Xs16_Ys16_Ws16 1500.000 Trq -500.0000 1000.000 FORMAT "%8.3" EXTENDED_LIMITS -3276.800 3276.700
 /begin AXIS_DESCR STD_AXIS CoEng_pDiffPFltPrdc2_mp Pres_hPa 16 0.00 3500.000 FORMAT "%8.3" EXTENDED_LIMITS -32768.00 32767.00 DEPOSIT ABSOLUTE /end AXIS_DESCR
 /begin AXIS_DESCR STD_AXIS Eng_nAvrg EngN 8 0.00 6000.000 FORMAT "%8.3" EXTENDED_LIMITS -32768.00 32767.00 DEPOSIT ABSOLUTE /end AXIS_DESCR
/end CHARACTERISTIC
/begin CHARACTERISTIC CoEng_trqLimPFltOvld_MAP "Begrenzungsmoment aufgrund von CSf Überladung" MAP 0xCA45E Kf_Xs16_Ys16_Ws16 1500.000 Trq -500.0000 1000.000 FORMAT "%8.3" EXTENDED_LIMITS -3276.800 3276.700
 /begin AXIS_DESCR STD_AXIS Eng_nAvrg EngN 10 0.00 6000.000 FORMAT "%8.3" EXTENDED_LIMITS -32768.00 32767.00 DEPOSIT ABSOLUTE /end AXIS_DESCR
 /begin AXIS_DESCR STD_AXIS CoEng_tPFltCDMax_mp Temp_Cels 10 -50.140 899.860 FORMAT "%8.3" EXTENDED_LIMITS -3549.940 3003.560 DEPOSIT ABSOLUTE /end AXIS_DESCR
/end CHARACTERISTIC
/begin CHARACTERISTIC CoEng_trqOffs_C "Offset auf Begrenzungsmoment, um Arbeitsbereich f. ARDsr zu schaffen" VALUE 0xCA134 Kw_Ws16 100.0000 Trq 0.00 100.0000 FORMAT "%8.4" EXTENDED_LIMITS -3276.800 3276.700 /end CHARACTERISTIC
/begin CHARACTERISTIC CoEng_trqOvrFulMax_C "oberer Wert für Overfueling Rampe" VALUE 0xCA552 Kw_Ws16 1000.000 Trq 0.00 1000.000 FORMAT "%8.3" EXTENDED_LIMITS -3276.800 3276.700 /end CHARACTERISTIC
/begin CHARACTERISTIC CoEng_trqOvrFulMin_C "unterer Wert für Overfueling Rampe" VALUE 0xCA554 Kw_Ws16 1000.000 Trq 0.00 1000.000 FORMAT "%8.3" EXTENDED_LIMITS -3276.800 3276.700 /end CHARACTERISTIC
/begin CHARACTERISTIC CoEng_trqOvrRunThres_C "#SSD Momentenschwelle zur Schuberkennung" VALUE 0xCA136 Kw_Ws16 10.00000 Trq 0.00 10.00000 FORMAT "%8.5" EXTENDED_LIMITS -3276.800 3276.700 /end CHARACTERISTIC
/begin CHARACTERISTIC CoEng_trqSlpLim_Vector "#SSD Bypass Label for CoEng_trqSlpLim (nicht verändern !)" VALUE 0xC3930 Kw_Wu8 255.0 OneToOne 0.00 255.0 FORMAT "%5.1" /end CHARACTERISTIC
/begin CHARACTERISTIC CoEng_trqSlpLim_Channel "#SSD Bypass Label für CoEng_trqSlpLim (nicht verändern !)" VALUE 0xC3931 Kw_Wu8 255.0 OneToOne 0.00 255.0 FORMAT "%5.1" /end CHARACTERISTIC
/begin CHARACTERISTIC CoEng_vOvrFulMin_C "untere Hysteresegrenze für Overfueling Fahrgeschwindigkeit" VALUE 0xCA556 Kw_Ws16 300.0000 Vel 0.00 300.0000 FORMAT "%8.4" EXTENDED_LIMITS -327.6800 327.6700 /end CHARACTERISTIC
/begin CHARACTERISTIC CoEng_vOvrFulMax_C "obere Hysteresegrenze für Overfueling Fahrgeschwindigkeit" VALUE 0xCA558 Kw_Ws16 300.0000 Vel 0.00 300.0000 FORMAT "%8.4" EXTENDED_LIMITS -327.6800 327.6700 /end CHARACTERISTIC
/begin CHARACTERISTIC CoEng_stvOvrFulLow_C "Status für Overfueling Fahrgeschwindigkeit Hysterese aus" VALUE 0xCA55A Kw_Ws16 65535.00 OneToOne -32768.00 32767.00 FORMAT "%8.2" READ_ONLY /end CHARACTERISTIC
/begin CHARACTERISTIC CoEng_stvOvrFulHigh_C "Status für Overfueling Fahrgeschwindigkeit Hysterese ein" VALUE 0xCA55C Kw_Ws16 65535.00 OneToOne -32768.00 32767.00 FORMAT "%8.2" READ_ONLY /end CHARACTERISTIC
/begin CHARACTERISTIC ConvCD_DebPlaDef_C "Zählerwert zur Defektentprellung (PLA)" VALUE 0xCA5A6 Kw_Wu16 65535.00 OneToOne 0.00 65535.00 FORMAT "%8.2" /end CHARACTERISTIC
/begin CHARACTERISTIC ConvCD_DebPlaOk_C "Zählerwert zur Heilungsentprellung (PLA)" VALUE 0xCA5A8 Kw_Wu16 65535.00 OneToOne 0.00 65535.00 FORMAT "%8.2" /end CHARACTERISTIC
/begin CHARACTERISTIC ConvCD_tiDebPos_C "Entprellzeit für pos. Flanke des Kupplungssignals" VALUE 0xCA5AA Kw_Wu16 2000.000 TimeDeb 0.00 2000.000 FORMAT "%8.3" EXTENDED_LIMITS 0.00 655350.0 /end CHARACTERISTIC
/begin CHARACTERISTIC ConvCD_tiDebNeg_C "Entprellzeit für neg. Flanke des Kupplungssignals." VALUE 0xCA5AC Kw_Wu16 2000.000 TimeDeb 0.00 2000.000 FORMAT "%8.3" EXTENDED_LIMITS 0.00 655350.0 /end CHARACTERISTIC
/begin CHARACTERISTIC ConvCD_DebSigDef_C "Entprellzeit bis CAN-Botschaftsfehler defekt" VALUE 0xCA5AE Kw_Wu16 655350.0 Time_ms 0.00 655350.0 FORMAT "%8.1" /end CHARACTERISTIC
/begin CHARACTERISTIC ConvCD_DebSigOk_C "Entprellzeit bis CAN-Botschaftsfehler geheilt" VALUE 0xCA5B0 Kw_Wu16 655350.0 Time_ms 0.00 655350.0 FORMAT "%8.1" /end CHARACTERISTIC
/begin CHARACTERISTIC ConvCD_nNoGearShftDet_C "Grenzwert unter dem die Gangerkennung für die Plausibilitätsprüfung abgeschaltet werden muss" VALUE 0xCA5B2 Kw_Ws16 6000.000 EngN 0.00 6000.000 FORMAT "%8.3" EXTENDED_LIMITS -32768.00 32767.00 /end CHARACTERISTIC
/begin CHARACTERISTIC ConvCD_numDioIn_C "#SSD Applikationsparameter für den Pin des Kupplungssignals" VALUE 0xCA5B4 Kw_Wu8 14.0000000000 NumPinDioIn 0.00 14.0000000000 FORMAT "%13.10" /end CHARACTERISTIC
/begin CHARACTERISTIC ConvCD_numStepDef_C "Zählschrittweite für Aufwärtszählen zur Defektentprellung" VALUE 0xCA5B5 Kw_Wu8 3.000 OneToOne 0.00 3.000 FORMAT "%5.3" EXTENDED_LIMITS 0.00 255.0 /end CHARACTERISTIC
/begin CHARACTERISTIC ConvCD_numStepOK_C "Zählschrittweite für Abwärtszählen zur Heilungsentprellung" VALUE 0xCA5B6 Kw_Wu8 3.000 OneToOne 0.00 3.000 FORMAT "%5.3" EXTENDED_LIMITS 0.00 255.0 /end CHARACTERISTIC
/begin CHARACTERISTIC ConvCD_stDflVal_C "Kupplungssignal Vorgabewert" VALUE 0xCA5B7 Kw_Wu8 1.000 OneToOne 0.00 1.000 FORMAT "%5.3" EXTENDED_LIMITS 0.00 255.0 /end CHARACTERISTIC
/begin CHARACTERISTIC ConvCD_stGripCtlAST_C "Vorgabewert für autom. Schaltgetriebe bei fehlendem Kraftschluß (""rutschende Kupplung"")" VALUE 0xCA5B8 Kw_Wu8 1.000 OneToOne 0.00 1.000 FORMAT "%5.3" EXTENDED_LIMITS 0.00 255.0 /end CHARACTERISTIC
/begin CHARACTERISTIC ConvCD_swtInv_C "Schalter zum invertieren  des Kupplungsignals (0=nichtinvertiert,1=invertiert), Einfluss auf Digitaleingang und CAN" VALUE 0xCA5B9 Kw_Wu8 1.000 OneToOne 0.00 1.000 FORMAT "%5.3" EXTENDED_LIMITS 0.00 255.0 /end CHARACTERISTIC
/begin CHARACTERISTIC ConvCD_swtSigVal_C "Schalter für Signalquellenauswahl (0=HW-Eingang, 1=CAN)" VALUE 0xCA5BA Kw_Wu8 2.000 OneToOne 0.00 2.000 FORMAT "%5.3" EXTENDED_LIMITS 0.00 255.0 /end CHARACTERISTIC
/begin CHARACTERISTIC ConvCD_tiGearShft_C "Zeit für Entprellung zum Gangwechsel Erkennung." VALUE 0xCA5BC Kw_Wu16 655350.0 Time_ms 0.00 655350.0 FORMAT "%8.1" /end CHARACTERISTIC
/begin CHARACTERISTIC ConvCD_vNoGearShftDet_C "Grenzwert unter dem die Gangerkennung für die Plausibilitätsprüfung abgeschaltet werden muss" VALUE 0xCA5BE Kw_Ws16 300.0000 Vel 0.00 300.0000 FORMAT "%8.4" EXTENDED_LIMITS -327.6800 327.6700 /end CHARACTERISTIC
/begin CHARACTERISTIC CoVeh_dnLI_C "unterer Schwellenwert der Motordrehzahl die zur Leistung/Moment Umrechnung verwendet wird" VALUE 0xCA5C0 Kw_Ws16 1000.000 EngN 0.00 1000.000 FORMAT "%8.3" EXTENDED_LIMITS -32768.00 32767.00 /end CHARACTERISTIC
/begin CHARACTERISTIC CoVeh_dtrqLimDwn_C "Rampe für Systemfehler Drehmoment" VALUE 0xCA5C2 Kw_Ws16 327660.0 dTrqPrp_20ms 10.00000 327670.0 FORMAT "%8.1" EXTENDED_LIMITS -327680.0 327670.0 /end CHARACTERISTIC
/begin CHARACTERISTIC CoVeh_dtrqLimUp_C "Rampe für Heilung Systemfehler Drehmoment" VALUE 0xCA5C4 Kw_Ws16 327660.0 dTrqPrp_20ms 10.00000 327670.0 FORMAT "%8.1" EXTENDED_LIMITS -327680.0 327670.0 /end CHARACTERISTIC
/begin CHARACTERISTIC CoVeh_trqLim_CUR "Begrenzungswert bei Systemfehler Drehmoment" CURVE 0xCA5C6 Kl_Xs16_Ws16 11000.00 TrqPrp -5000.000 6000.000 FORMAT "%8.3" EXTENDED_LIMITS -6553.600 6553.400
 /begin AXIS_DESCR STD_AXIS Eng_nAvrg EngN 10 0.00 6000.000 FORMAT "%8.3" EXTENDED_LIMITS -32768.00 32767.00 DEPOSIT ABSOLUTE /end AXIS_DESCR
/end CHARACTERISTIC
/begin CHARACTERISTIC CoVeh_trqPrpDes_Vector "#SSD Bypass-Label für CoVeh_trqPrpDes (Nicht verstellen!)" VALUE 0xC3932 Kw_Wu8 255.0 OneToOne 0.00 255.0 FORMAT "%5.1" /end CHARACTERISTIC
/begin CHARACTERISTIC CoVeh_trqPrpDes_Channel "#SSD Bypass label, nicht editieren" VALUE 0xC3933 Kw_Wu8 255.0 OneToOne 0.00 255.0 FORMAT "%5.1" /end CHARACTERISTIC
/begin CHARACTERISTIC CoVeh_trqPrpLead_Vector "#SSD Bypass label, nicht editieren!" VALUE 0xC3934 Kw_Wu8 255.0 OneToOne 0.00 255.0 FORMAT "%5.1" /end CHARACTERISTIC
/begin CHARACTERISTIC CoVeh_trqPrpLead_Channel "#SSD Bypass label, nicht editieren!" VALUE 0xC3935 Kw_Wu8 255.0 OneToOne 0.00 255.0 FORMAT "%5.1" /end CHARACTERISTIC
/begin CHARACTERISTIC CoVM_amMAX_C "#SSD Grenzwert zur Erkennung der physikalischen Unplausibilität des MSR (DCS) Eingriffs" VALUE 0xCA5F0 Kw_Wu16 327675.0 TrqPrpDT 0.00 327675.0 FORMAT "%8.1" /end CHARACTERISTIC
/begin CHARACTERISTIC CoVM_dtrqLeadCorUp_C "Rampe zum Aufbau ASR-Vorhalt" VALUE 0xCA5FC Kw_Wu32 13107199.9969 RmpTrqPrp 0.00 13107199.9969 FORMAT "%13.4" /end CHARACTERISTIC
/begin CHARACTERISTIC CoVM_dtrqLeadCorDwn_C "Rampe zum Abbau ASR-Vorhalt" VALUE 0xCA600 Kw_Wu32 13107199.9969 RmpTrqPrp 0.00 13107199.9969 FORMAT "%13.4" /end CHARACTERISTIC
/begin CHARACTERISTIC CoVM_swtIntvPrio_C "Priorisierung der Fahrdynamikeingriffe über die Getriebeeingriffe (1:keine Begrenzung der Getriebeeingriffe, 0: Begrenzung)" VALUE 0xCA604 Kw_Wu8 1.000 OneToOne 0.00 1.000 FORMAT "%5.3" EXTENDED_LIMITS 0.00 255.0 /end CHARACTERISTIC
/begin CHARACTERISTIC CoVM_swtPlausChkVal_C "#SSD Konfigurationsschalter MSR-Momentenüberschussintegral (1: ein/ 0:aus)." VALUE 0xCA5F2 Kw_Wu8 1.000 OneToOne 0.00 1.000 FORMAT "%5.3" EXTENDED_LIMITS 0.00 255.0 /end CHARACTERISTIC
/begin CHARACTERISTIC CoVM_swtPlausChkType_C "#SSD Softwareschalter Type für CoVM_swtSlipCtlVal_C" VALUE 0xCA5F3 Kw_Wu8 2.000 OneToOne 0.00 2.000 FORMAT "%5.3" EXTENDED_LIMITS 0.00 255.0 /end CHARACTERISTIC
/begin CHARACTERISTIC CoVM_swtSlipCtlVal_C "Fahrdynamik-Konfiguration (0: ASR aus & MSR aus; 1: ASR an & MSR aus;  2: ASR aus & MSR an;  3: ASR an & MSR an)" VALUE 0xCA5F4 Kw_Wu8 3.000 OneToOne 0.00 3.000 FORMAT "%5.3" EXTENDED_LIMITS 0.00 255.0 /end CHARACTERISTIC
/begin CHARACTERISTIC CoVM_swtSlipCtlType_C "Softwareschalter Type für CoVM_swtSlipCtlVal_C" VALUE 0xCA5F5 Kw_Wu8 2.000 OneToOne 0.00 2.000 FORMAT "%5.3" EXTENDED_LIMITS 0.00 255.0 /end CHARACTERISTIC
/begin CHARACTERISTIC CoVM_swtTrqDesSel_C "Schalter zur Auswahl des Wunschdrehmoments über CAN bei Max. Geschwindigkeitsbegrenzung" VALUE 0xCA605 Kw_Wu8 1.000 OneToOne 0.00 1.000 FORMAT "%5.3" EXTENDED_LIMITS 0.00 255.0 /end CHARACTERISTIC
/begin CHARACTERISTIC CoVM_swttrqDVCH_C "Schalter zur Korrektur von CoVM_trqDVCH mit Gearbx_trqFrc (1 = Korrektur, 0 = keine Korrektur)" VALUE 0xCA606 Kw_Wu8 255.0 OneToOne 0.00 255.0 FORMAT "%5.1" /end CHARACTERISTIC
/begin CHARACTERISTIC CoVM_tiDebMaxOk_C "Heilungsentprellzeit der physikalischen Unplausibilität" VALUE 0xCA5F6 Kw_Wu16 655350.0 TimeDeb 0.00 655350.0 FORMAT "%8.1" /end CHARACTERISTIC
/begin CHARACTERISTIC CoVM_tiDebMaxDef_C "Fehlerentprellzeit der physikalischen Unplausibilität" VALUE 0xCA5F8 Kw_Wu16 655350.0 TimeDeb 0.00 655350.0 FORMAT "%8.1" /end CHARACTERISTIC
/begin CHARACTERISTIC CoVM_tiTrqRedMax_C "Zeitschwelle für ""langen"" ASR-Eingriff" VALUE 0xCA608 Kw_Wu16 655.3500 Time_s 0.00 655.3500 FORMAT "%8.4" /end CHARACTERISTIC
/begin CHARACTERISTIC CoVM_trqDecMax_C "#SSD Maximum replacement value for torque decrement" VALUE 0xCA60C Kw_Ws16 1000.000 TrqPrp -500.0000 500.0000 FORMAT "%8.4" EXTENDED_LIMITS -6553.600 6553.400 /end CHARACTERISTIC
/begin CHARACTERISTIC CoVM_dtrqLimUpDec_C "torque ramp up at decrease in torque" VALUE 0xCA610 Kw_Wu32 13107199.9969 RmpTrqPrp 0.00 13107199.9969 FORMAT "%13.4" /end CHARACTERISTIC
/begin CHARACTERISTIC CoVM_dtrqLimDwnDec_C "torque ramp down at decrease in torque" VALUE 0xCA614 Kw_Wu32 13107199.9969 RmpTrqPrp 0.00 13107199.9969 FORMAT "%13.4" /end CHARACTERISTIC
/begin CHARACTERISTIC CoVM_trqDSCMax_C "Maximale Momentenerhöhung vom DSC Steuergerät" VALUE 0xCA618 Kw_Ws16 1500.000 Trq -500.0000 1000.000 FORMAT "%8.3" EXTENDED_LIMITS -3276.800 3276.700 /end CHARACTERISTIC
/begin CHARACTERISTIC CoVM_trqIncMin_C "#SSD Replacement value for torque increment" VALUE 0xCA61A Kw_Ws16 1000.000 TrqPrp -500.0000 500.0000 FORMAT "%8.4" EXTENDED_LIMITS -6553.600 6553.400 /end CHARACTERISTIC
/begin CHARACTERISTIC CoVM_dtrqLimUpInc_C "torque ramp up for increase in torque" VALUE 0xCA61C Kw_Wu32 13107199.9969 RmpTrqPrp 0.00 13107199.9969 FORMAT "%13.4" /end CHARACTERISTIC
/begin CHARACTERISTIC CoVM_dtrqLimDwnInc_C "torque ramp down increase in torque" VALUE 0xCA620 Kw_Wu32 13107199.9969 RmpTrqPrp 0.00 13107199.9969 FORMAT "%13.4" /end CHARACTERISTIC
/begin CHARACTERISTIC CpBVlv_numGear_C "Gang schwellwert" VALUE 0xCA624 Kw_Ws8 7.000 OneToOne -1.000 6.000 FORMAT "%5.3" EXTENDED_LIMITS -128.0 127.0 /end CHARACTERISTIC
/begin CHARACTERISTIC CpBVlv_qCloseRgn_MAP "Kennfeld für unteren Schwellwert der Kraftstoffmenge bei Regeneration" MAP 0xCA626 Kf_Xs16_Ys16_Ws16 327.6700 InjMass 0.00 327.6700 FORMAT "%8.4" EXTENDED_LIMITS -327.6800 327.6700
 /begin AXIS_DESCR STD_AXIS Eng_nAvrg EngN 12 0.00 6000.000 FORMAT "%8.3" EXTENDED_LIMITS -32768.00 32767.00 DEPOSIT ABSOLUTE /end AXIS_DESCR
 /begin AXIS_DESCR STD_AXIS APSCD_pVal Pres_hPa 6 0.00 3500.000 FORMAT "%8.3" EXTENDED_LIMITS -32768.00 32767.00 DEPOSIT ABSOLUTE /end AXIS_DESCR
/end CHARACTERISTIC
/begin CHARACTERISTIC CpBVlv_qClose_MAP "MAP unterer schwellwert Kraftstoffmenge" MAP 0xCA6DE Kf_Xs16_Ys16_Ws16 327.6700 InjMass 0.00 327.6700 FORMAT "%8.4" EXTENDED_LIMITS -327.6800 327.6700
 /begin AXIS_DESCR STD_AXIS Eng_nAvrg EngN 12 0.00 6000.000 FORMAT "%8.3" EXTENDED_LIMITS -32768.00 32767.00 DEPOSIT ABSOLUTE /end AXIS_DESCR
 /begin AXIS_DESCR STD_AXIS APSCD_pVal Pres_hPa 6 0.00 3500.000 FORMAT "%8.3" EXTENDED_LIMITS -32768.00 32767.00 DEPOSIT ABSOLUTE /end AXIS_DESCR
/end CHARACTERISTIC
/begin CHARACTERISTIC CpBVlv_qOpnRgn_MAP "Kennfeld für einen höheren Schwellenwert der Kraftstoffmenge" MAP 0xCA796 Kf_Xs16_Ys16_Ws16 327.6700 InjMass 0.00 327.6700 FORMAT "%8.4" EXTENDED_LIMITS -327.6800 327.6700
 /begin AXIS_DESCR STD_AXIS Eng_nAvrg EngN 12 0.00 6000.000 FORMAT "%8.3" EXTENDED_LIMITS -32768.00 32767.00 DEPOSIT ABSOLUTE /end AXIS_DESCR
 /begin AXIS_DESCR STD_AXIS APSCD_pVal Pres_hPa 6 0.00 3500.000 FORMAT "%8.3" EXTENDED_LIMITS -32768.00 32767.00 DEPOSIT ABSOLUTE /end AXIS_DESCR
/end CHARACTERISTIC
/begin CHARACTERISTIC CpBVlv_qOpn_MAP "MAP oberer schwellwert Kraftstoffmenge" MAP 0xCA84E Kf_Xs16_Ys16_Ws16 327.6700 InjMass 0.00 327.6700 FORMAT "%8.4" EXTENDED_LIMITS -327.6800 327.6700
 /begin AXIS_DESCR STD_AXIS Eng_nAvrg EngN 12 0.00 6000.000 FORMAT "%8.3" EXTENDED_LIMITS -32768.00 32767.00 DEPOSIT ABSOLUTE /end AXIS_DESCR
 /begin AXIS_DESCR STD_AXIS APSCD_pVal Pres_hPa 6 0.00 3500.000 FORMAT "%8.3" EXTENDED_LIMITS -32768.00 32767.00 DEPOSIT ABSOLUTE /end AXIS_DESCR
/end CHARACTERISTIC
/begin CHARACTERISTIC CpBVlv_stClose_C "Kompressor-Bypassventil geschlossen" VALUE 0xCA906 Kw_Wu8 1.000 OneToOne 0.00 1.000 FORMAT "%5.3" EXTENDED_LIMITS 0.00 255.0 /end CHARACTERISTIC
/begin CHARACTERISTIC CpBVlv_stOpn_C "Kompressor-Bypassventil offen" VALUE 0xCA907 Kw_Wu8 1.000 OneToOne 0.00 1.000 FORMAT "%5.3" EXTENDED_LIMITS 0.00 255.0 /end CHARACTERISTIC
/begin CHARACTERISTIC CpBVlv_stRgnMsk_C "Bit mask for switching off at regeneration" VALUE 0xCA908 Kw_Wu32 4294967295.00 OneToOne 0.00 4294967295.00 FORMAT "%13.2" /end CHARACTERISTIC
/begin CHARACTERISTIC CpBVlv_swtErrOff_C "mask für shutoff" VALUE 0xCA90C Kw_Wu8 255.0 OneToOne 0.00 255.0 FORMAT "%5.1" /end CHARACTERISTIC
/begin CHARACTERISTIC CpBVlv_swtQDesVal_C "Auswahlschalter Mengenreferenz (0: derzeitige Menge, 1: Rohmenge)" VALUE 0xCA90D Kw_Wu8 1.000 OneToOne 0.00 1.000 FORMAT "%5.3" EXTENDED_LIMITS 0.00 255.0 /end CHARACTERISTIC
/begin CHARACTERISTIC CpBVlv_tiRmpSlp_C "Neigungswert für Rampe" VALUE 0xCA910 Kw_Wu32 31.775030303030302 TimeEGTRmp 0.99296969696969695 32.768000000000001 FORMAT "%19.16" EXTENDED_LIMITS 0.000000015258789066052715 65.536000000000001 /end CHARACTERISTIC
/begin CHARACTERISTIC CrCCD_tiDebMaxMFLDef_C "Defektentprellung Togglebittimeout" VALUE 0xCA914 Kw_Wu16 655350.0 Time_ms 0.00 655350.0 FORMAT "%8.1" /end CHARACTERISTIC
/begin CHARACTERISTIC CrCCD_tiDebMaxMFLOk_C "Heilentprellung Togglebittimeout" VALUE 0xCA916 Kw_Wu16 655350.0 Time_ms 0.00 655350.0 FORMAT "%8.1" /end CHARACTERISTIC
/begin CHARACTERISTIC CrCCD_tiDebMinMFLDef_C "Defektentprellung Framelänge außerhalb der Toleranz" VALUE 0xCA918 Kw_Wu16 655350.0 Time_ms 0.00 655350.0 FORMAT "%8.1" /end CHARACTERISTIC
/begin CHARACTERISTIC CrCCD_tiDebMinMFLOk_C "Heilentprellung Framelänge außerhalb der Toleranz" VALUE 0xCA91A Kw_Wu16 655350.0 Time_ms 0.00 655350.0 FORMAT "%8.1" /end CHARACTERISTIC
/begin CHARACTERISTIC CrCCD_tiDebNplMFLDef_C "Defektentprellung MFL-Signal nicht plausibel (Biterror)" VALUE 0xCA91C Kw_Wu16 655350.0 Time_ms 0.00 655350.0 FORMAT "%8.1" /end CHARACTERISTIC
/begin CHARACTERISTIC CrCCD_tiDebNplMFLOk_C "Heilentprellung MFL-Signal nicht plausibel (Biterror)" VALUE 0xCA91E Kw_Wu16 655350.0 Time_ms 0.00 655350.0 FORMAT "%8.1" /end CHARACTERISTIC
/begin CHARACTERISTIC CrCCD_tiDebSigMFLDef_C "Defektentprellung MFL-Signal Timeout" VALUE 0xCA920 Kw_Wu16 655350.0 Time_ms 0.00 655350.0 FORMAT "%8.1" /end CHARACTERISTIC
/begin CHARACTERISTIC CrCCD_tiDebSigMFLOk_C "Heilentprellung MFL-Signal Timeout" VALUE 0xCA922 Kw_Wu16 655350.0 Time_ms 0.00 655350.0 FORMAT "%8.1" /end CHARACTERISTIC
/begin CHARACTERISTIC CrCCD_stMSWModeAdjMax_C "Maximalwert vom Abgleichwert Mainswitch Mode" VALUE 0xCA924 Kw_Wu8 1.000 OneToOne 0.00 1.000 FORMAT "%5.3" EXTENDED_LIMITS 0.00 255.0 /end CHARACTERISTIC
/begin CHARACTERISTIC CrCCD_stMSWModeAdjMin_C "Minimalwert vom Abgleichwert Mainswitch Mode" VALUE 0xCA925 Kw_Wu8 1.000 OneToOne 0.00 1.000 FORMAT "%5.3" EXTENDED_LIMITS 0.00 255.0 /end CHARACTERISTIC
/begin CHARACTERISTIC CrCCD_stMSWModeDflt_C "Vorgabewert für Abgleichwert Mainswitch Mode bei fehlgeschlagener EEPROM Kommunikation" VALUE 0xCA926 Kw_Wu8 1.000 OneToOne 0.00 1.000 FORMAT "%5.3" EXTENDED_LIMITS 0.00 255.0 /end CHARACTERISTIC
/begin CHARACTERISTIC CrCCD_swtDevType_C "SW-Schalter Typ für CrCCD_swtDev" VALUE 0xCA927 Kw_Wu8 1.000 OneToOne 0.00 1.000 FORMAT "%5.3" EXTENDED_LIMITS 0.00 255.0 /end CHARACTERISTIC
/begin CHARACTERISTIC CrCCD_swtDevVal_C "Datensatzwert für SW-Schalter CrCCD_swtDev, eingebauter FGR-Bedienteiltyp (0: kein bedienteil, 1: TPU, 2: CAN)" VALUE 0xCA928 Kw_Wu8 2.000 OneToOne 0.00 2.000 FORMAT "%5.3" EXTENDED_LIMITS 0.00 255.0 /end CHARACTERISTIC
/begin CHARACTERISTIC CrCCD_swtMSWType_C "MSW Mode vom EEPROM (1) oder Applikation (0)" VALUE 0xCA929 Kw_Wu8 1.000 OneToOne 0.00 1.000 FORMAT "%5.3" EXTENDED_LIMITS 0.00 255.0 /end CHARACTERISTIC
/begin CHARACTERISTIC CrCCD_swtMSWVal_C "MSW Mode von der Applikation (1: MSW aktiviert, 0: MSW deaktiviert)" VALUE 0xCA92A Kw_Wu8 1.000 OneToOne 0.00 1.000 FORMAT "%5.3" EXTENDED_LIMITS 0.00 255.0 /end CHARACTERISTIC
/begin CHARACTERISTIC CrCCD_tiDebSetMn_C "time for SET- detection" VALUE 0xCA92C Kw_Wu16 1500.000 Time_ms 0.00 1500.000 FORMAT "%8.3" EXTENDED_LIMITS 0.00 655350.0 /end CHARACTERISTIC
/begin CHARACTERISTIC CrCCD_tiDebSetPl_C "time for SET+ detection" VALUE 0xCA92E Kw_Wu16 1500.000 Time_ms 0.00 1500.000 FORMAT "%8.3" EXTENDED_LIMITS 0.00 655350.0 /end CHARACTERISTIC
/begin CHARACTERISTIC CrCCD_tiToggleMax_C "Maximalzeit bis Togglebitwechsel erfolgt sein muß" VALUE 0xCA930 Kw_Wu16 1500.000 Time_ms 0.00 1500.000 FORMAT "%8.3" EXTENDED_LIMITS 0.00 655350.0 /end CHARACTERISTIC
/begin CHARACTERISTIC CrCtl_aAccLim_C "Minimal erlaubte Fahrzeugbeschleunigung für Übergang von SET+ zu HOLD" VALUE 0xCA96C Kw_Ws16 10.00000 Acc 0.00 10.00000 FORMAT "%8.5" EXTENDED_LIMITS -32.76800 32.76700 /end CHARACTERISTIC
/begin CHARACTERISTIC CrCtl_aAccMax_C "Fahrzeugbeschleunigungsschwelle für CrCtl-Abschaltbedingung ""zu große Fahrzeugbeschleunigung""" VALUE 0xCA934 Kw_Ws16 42.76800 Acc -32.76800 10.00000 FORMAT "%8.5" EXTENDED_LIMITS -32.76800 32.76700 /end CHARACTERISTIC
/begin CHARACTERISTIC CrCtl_AccGear2PKp_C "P-Reglerparametersatz für Beschleunigung 2.Gang" VALUE 0xCA970 Kw_Wu32 1310719.99969 Kp_Vel2TrqPrp 0.00 1310719.99969 FORMAT "%13.5" /end CHARACTERISTIC
/begin CHARACTERISTIC CrCtl_AccGear2PKpPos_C "P-Reglerparametersatz für Beschleunigung 2.Gang" VALUE 0xCA974 Kw_Wu32 1310719.99969 Kp_Vel2TrqPrp 0.00 1310719.99969 FORMAT "%13.5" /end CHARACTERISTIC
/begin CHARACTERISTIC CrCtl_AccGear2PKpNeg_C "P-Reglerparametersatz für Beschleunigung 2.Gang" VALUE 0xCA978 Kw_Wu32 1310719.99969 Kp_Vel2TrqPrp 0.00 1310719.99969 FORMAT "%13.5" /end CHARACTERISTIC
/begin CHARACTERISTIC CrCtl_vAccGear2PWinPos_C "P-Reglerparametersatz für Beschleunigung 2.Gang" VALUE 0xCA97C Kw_Ws16 300.0000 Vel 0.00 300.0000 FORMAT "%8.4" EXTENDED_LIMITS -327.6800 327.6700 /end CHARACTERISTIC
/begin CHARACTERISTIC CrCtl_vAccGear2PWinNeg_C "P-Reglerparametersatz für Beschleunigung 2.Gang" VALUE 0xCA97E Kw_Ws16 300.0000 Vel -300.0000 0.00 FORMAT "%8.4" EXTENDED_LIMITS -327.6800 327.6700 /end CHARACTERISTIC
/begin CHARACTERISTIC CrCtl_AccGear3PKp_C "P-Reglerparametersatz für Beschleunigung 3.Gang" VALUE 0xCA980 Kw_Wu32 1310719.99969 Kp_Vel2TrqPrp 0.00 1310719.99969 FORMAT "%13.5" /end CHARACTERISTIC
/begin CHARACTERISTIC CrCtl_AccGear3PKpPos_C "P-Reglerparametersatz für Beschleunigung 3.Gang" VALUE 0xCA984 Kw_Wu32 1310719.99969 Kp_Vel2TrqPrp 0.00 1310719.99969 FORMAT "%13.5" /end CHARACTERISTIC
/begin CHARACTERISTIC CrCtl_AccGear3PKpNeg_C "P-Reglerparametersatz für Beschleunigung 3.Gang" VALUE 0xCA988 Kw_Wu32 1310719.99969 Kp_Vel2TrqPrp 0.00 1310719.99969 FORMAT "%13.5" /end CHARACTERISTIC
/begin CHARACTERISTIC CrCtl_vAccGear3PWinPos_C "P-Reglerparametersatz für Beschleunigung 3.Gang" VALUE 0xCA98C Kw_Ws16 300.0000 Vel 0.00 300.0000 FORMAT "%8.4" EXTENDED_LIMITS -327.6800 327.6700 /end CHARACTERISTIC
/begin CHARACTERISTIC CrCtl_vAccGear3PWinNeg_C "P-Reglerparametersatz für Beschleunigung 3.Gang" VALUE 0xCA98E Kw_Ws16 300.0000 Vel -300.0000 0.00 FORMAT "%8.4" EXTENDED_LIMITS -327.6800 327.6700 /end CHARACTERISTIC
/begin CHARACTERISTIC CrCtl_AccGear4PKp_C "P-Reglerparametersatz für Beschleunigung 4.Gang" VALUE 0xCA990 Kw_Wu32 1310719.99969 Kp_Vel2TrqPrp 0.00 1310719.99969 FORMAT "%13.5" /end CHARACTERISTIC
/begin CHARACTERISTIC CrCtl_AccGear4PKpPos_C "P-Reglerparametersatz für Beschleunigung 4.Gang" VALUE 0xCA994 Kw_Wu32 1310719.99969 Kp_Vel2TrqPrp 0.00 1310719.99969 FORMAT "%13.5" /end CHARACTERISTIC
/begin CHARACTERISTIC CrCtl_AccGear4PKpNeg_C "P-Reglerparametersatz für Beschleunigung 4.Gang" VALUE 0xCA998 Kw_Wu32 1310719.99969 Kp_Vel2TrqPrp 0.00 1310719.99969 FORMAT "%13.5" /end CHARACTERISTIC
/begin CHARACTERISTIC CrCtl_vAccGear4PWinPos_C "P-Reglerparametersatz für Beschleunigung 4.Gang" VALUE 0xCA99C Kw_Ws16 300.0000 Vel 0.00 300.0000 FORMAT "%8.4" EXTENDED_LIMITS -327.6800 327.6700 /end CHARACTERISTIC
/begin CHARACTERISTIC CrCtl_vAccGear4PWinNeg_C "P-Reglerparametersatz für Beschleunigung 4.Gang" VALUE 0xCA99E Kw_Ws16 300.0000 Vel -300.0000 0.00 FORMAT "%8.4" EXTENDED_LIMITS -327.6800 327.6700 /end CHARACTERISTIC
/begin CHARACTERISTIC CrCtl_AccGear5PKp_C "P-Reglerparametersatz für Beschleunigung 5.Gang" VALUE 0xCA9A0 Kw_Wu32 1310719.99969 Kp_Vel2TrqPrp 0.00 1310719.99969 FORMAT "%13.5" /end CHARACTERISTIC
/begin CHARACTERISTIC CrCtl_AccGear5PKpPos_C "P-Reglerparametersatz für Beschleunigung 5.Gang" VALUE 0xCA9A4 Kw_Wu32 1310719.99969 Kp_Vel2TrqPrp 0.00 1310719.99969 FORMAT "%13.5" /end CHARACTERISTIC
/begin CHARACTERISTIC CrCtl_AccGear5PKpNeg_C "P-Reglerparametersatz für Beschleunigung 5.Gang" VALUE 0xCA9A8 Kw_Wu32 1310719.99969 Kp_Vel2TrqPrp 0.00 1310719.99969 FORMAT "%13.5" /end CHARACTERISTIC
/begin CHARACTERISTIC CrCtl_vAccGear5PWinPos_C "P-Reglerparametersatz für Beschleunigung 5.Gang" VALUE 0xCA9AC Kw_Ws16 300.0000 Vel 0.00 300.0000 FORMAT "%8.4" EXTENDED_LIMITS -327.6800 327.6700 /end CHARACTERISTIC
/begin CHARACTERISTIC CrCtl_vAccGear5PWinNeg_C "P-Reglerparametersatz für Beschleunigung 5.Gang" VALUE 0xCA9AE Kw_Ws16 300.0000 Vel -300.0000 0.00 FORMAT "%8.4" EXTENDED_LIMITS -327.6800 327.6700 /end CHARACTERISTIC
/begin CHARACTERISTIC CrCtl_AccGear6PKp_C "P-Reglerparametersatz für Beschleunigung 6.Gang" VALUE 0xCA9B0 Kw_Wu32 1310719.99969 Kp_Vel2TrqPrp 0.00 1310719.99969 FORMAT "%13.5" /end CHARACTERISTIC
/begin CHARACTERISTIC CrCtl_AccGear6PKpPos_C "P-Reglerparametersatz für Beschleunigung 6.Gang" VALUE 0xCA9B4 Kw_Wu32 1310719.99969 Kp_Vel2TrqPrp 0.00 1310719.99969 FORMAT "%13.5" /end CHARACTERISTIC
/begin CHARACTERISTIC CrCtl_AccGear6PKpNeg_C "P-Reglerparametersatz für Beschleunigung 6.Gang" VALUE 0xCA9B8 Kw_Wu32 1310719.99969 Kp_Vel2TrqPrp 0.00 1310719.99969 FORMAT "%13.5" /end CHARACTERISTIC
/begin CHARACTERISTIC CrCtl_vAccGear6PWinPos_C "P-Reglerparametersatz für Beschleunigung 6.Gang" VALUE 0xCA9BC Kw_Ws16 300.0000 Vel 0.00 300.0000 FORMAT "%8.4" EXTENDED_LIMITS -327.6800 327.6700 /end CHARACTERISTIC
/begin CHARACTERISTIC CrCtl_vAccGear6PWinNeg_C "P-Reglerparametersatz für Beschleunigung 6.Gang" VALUE 0xCA9BE Kw_Ws16 300.0000 Vel -300.0000 0.00 FORMAT "%8.4" EXTENDED_LIMITS -327.6800 327.6700 /end CHARACTERISTIC
/begin CHARACTERISTIC CrCtl_aDeclLim_C "neg. Beschleunigungsschwelle Übergang EIN- zu HALTEN" VALUE 0xCA9C0 Kw_Ws16 10.00000 Acc -10.00000 0.00 FORMAT "%8.5" EXTENDED_LIMITS -32.76800 32.76700 /end CHARACTERISTIC
/begin CHARACTERISTIC CrCtl_aDecMax_C "max. zulässige neg. Beschleunigung für Abschaltung FGR" VALUE 0xCA936 Kw_Ws16 32.76800 Acc -32.76800 0.00 FORMAT "%8.5" EXTENDED_LIMITS -32.76800 32.76700 /end CHARACTERISTIC
/begin CHARACTERISTIC CrCtl_ctMaxTip_C "Maximal erlaubte Tipanzahl ohne Erreichen der Sollgeschwindigkeit" VALUE 0xCA9C2 Kw_Wu8 100.0 OneToOne 0.00 100.0 FORMAT "%5.1" EXTENDED_LIMITS 0.00 255.0 /end CHARACTERISTIC
/begin CHARACTERISTIC CrCtl_DebToVCrCtlDef_C "dfhjdghkj" VALUE 0xCAED4 Kw_Wu16 65535.00 OneToOne 0.00 65535.00 FORMAT "%8.2" /end CHARACTERISTIC
/begin CHARACTERISTIC CrCtl_DebToVCrCtlOk_C " Healing time for CrCtl_-messages Timeout" VALUE 0xCAED6 Kw_Wu16 65535.00 OneToOne 0.00 65535.00 FORMAT "%8.2" /end CHARACTERISTIC
/begin CHARACTERISTIC CrCtl_DeclGear2PKp_C "P-Reglerparametersatz für Verzögerung 2.Gang" VALUE 0xCA9C4 Kw_Wu32 1310719.99969 Kp_Vel2TrqPrp 0.00 1310719.99969 FORMAT "%13.5" /end CHARACTERISTIC
/begin CHARACTERISTIC CrCtl_DeclGear2PKpPos_C "P-Reglerparametersatz für Verzögerung 2.Gang" VALUE 0xCA9C8 Kw_Wu32 1310719.99969 Kp_Vel2TrqPrp 0.00 1310719.99969 FORMAT "%13.5" /end CHARACTERISTIC
/begin CHARACTERISTIC CrCtl_DeclGear2PKpNeg_C "P-Reglerparametersatz für Verzögerung 2.Gang" VALUE 0xCA9CC Kw_Wu32 1310719.99969 Kp_Vel2TrqPrp 0.00 1310719.99969 FORMAT "%13.5" /end CHARACTERISTIC
/begin CHARACTERISTIC CrCtl_vDeclGear2PWinPos_C "P-Reglerparametersatz für Verzögerung 2.Gang" VALUE 0xCA9D0 Kw_Ws16 300.0000 Vel 0.00 300.0000 FORMAT "%8.4" EXTENDED_LIMITS -327.6800 327.6700 /end CHARACTERISTIC
/begin CHARACTERISTIC CrCtl_vDeclGear2PWinNeg_C "P-Reglerparametersatz für Verzögerung 2.Gang" VALUE 0xCA9D2 Kw_Ws16 300.0000 Vel -300.0000 0.00 FORMAT "%8.4" EXTENDED_LIMITS -327.6800 327.6700 /end CHARACTERISTIC
/begin CHARACTERISTIC CrCtl_DeclGear3PKp_C "P-Reglerparametersatz für Verzögerung 3.Gang" VALUE 0xCA9D4 Kw_Wu32 1310719.99969 Kp_Vel2TrqPrp 0.00 1310719.99969 FORMAT "%13.5" /end CHARACTERISTIC
/begin CHARACTERISTIC CrCtl_DeclGear3PKpPos_C "P-Reglerparametersatz für Verzögerung 3.Gang" VALUE 0xCA9D8 Kw_Wu32 1310719.99969 Kp_Vel2TrqPrp 0.00 1310719.99969 FORMAT "%13.5" /end CHARACTERISTIC
/begin CHARACTERISTIC CrCtl_DeclGear3PKpNeg_C "P-Reglerparametersatz für Verzögerung 3.Gang" VALUE 0xCA9DC Kw_Wu32 1310719.99969 Kp_Vel2TrqPrp 0.00 1310719.99969 FORMAT "%13.5" /end CHARACTERISTIC
/begin CHARACTERISTIC CrCtl_vDeclGear3PWinPos_C "P-Reglerparametersatz für Verzögerung 3.Gang" VALUE 0xCA9E0 Kw_Ws16 300.0000 Vel 0.00 300.0000 FORMAT "%8.4" EXTENDED_LIMITS -327.6800 327.6700 /end CHARACTERISTIC
/begin CHARACTERISTIC CrCtl_vDeclGear3PWinNeg_C "P-Reglerparametersatz für Verzögerung 3.Gang" VALUE 0xCA9E2 Kw_Ws16 300.0000 Vel -300.0000 0.00 FORMAT "%8.4" EXTENDED_LIMITS -327.6800 327.6700 /end CHARACTERISTIC
/begin CHARACTERISTIC CrCtl_DeclGear4PKp_C "P-Reglerparametersatz für Verzögerung 4.Gang" VALUE 0xCA9E4 Kw_Wu32 1310719.99969 Kp_Vel2TrqPrp 0.00 1310719.99969 FORMAT "%13.5" /end CHARACTERISTIC
/begin CHARACTERISTIC CrCtl_DeclGear4PKpPos_C "P-Reglerparametersatz für Verzögerung 4.Gang" VALUE 0xCA9E8 Kw_Wu32 1310719.99969 Kp_Vel2TrqPrp 0.00 1310719.99969 FORMAT "%13.5" /end CHARACTERISTIC
/begin CHARACTERISTIC CrCtl_DeclGear4PKpNeg_C "P-Reglerparametersatz für Verzögerung 4.Gang" VALUE 0xCA9EC Kw_Wu32 1310719.99969 Kp_Vel2TrqPrp 0.00 1310719.99969 FORMAT "%13.5" /end CHARACTERISTIC
/begin CHARACTERISTIC CrCtl_vDeclGear4PWinPos_C "P-Reglerparametersatz für Verzögerung 4.Gang" VALUE 0xCA9F0 Kw_Ws16 300.0000 Vel 0.00 300.0000 FORMAT "%8.4" EXTENDED_LIMITS -327.6800 327.6700 /end CHARACTERISTIC
/begin CHARACTERISTIC CrCtl_vDeclGear4PWinNeg_C "P-Reglerparametersatz für Verzögerung 4.Gang" VALUE 0xCA9F2 Kw_Ws16 300.0000 Vel -300.0000 0.00 FORMAT "%8.4" EXTENDED_LIMITS -327.6800 327.6700 /end CHARACTERISTIC
/begin CHARACTERISTIC CrCtl_DeclGear5PKp_C "P-Reglerparametersatz für Verzögerung 5.Gang" VALUE 0xCA9F4 Kw_Wu32 1310719.99969 Kp_Vel2TrqPrp 0.00 1310719.99969 FORMAT "%13.5" /end CHARACTERISTIC
/begin CHARACTERISTIC CrCtl_DeclGear5PKpPos_C "P-Reglerparametersatz für Verzögerung 5.Gang" VALUE 0xCA9F8 Kw_Wu32 1310719.99969 Kp_Vel2TrqPrp 0.00 1310719.99969 FORMAT "%13.5" /end CHARACTERISTIC
/begin CHARACTERISTIC CrCtl_DeclGear5PKpNeg_C "P-Reglerparametersatz für Verzögerung 5.Gang" VALUE 0xCA9FC Kw_Wu32 1310719.99969 Kp_Vel2TrqPrp 0.00 1310719.99969 FORMAT "%13.5" /end CHARACTERISTIC
/begin CHARACTERISTIC CrCtl_vDeclGear5PWinPos_C "P-Reglerparametersatz für Verzögerung 5.Gang" VALUE 0xCAA00 Kw_Ws16 300.0000 Vel 0.00 300.0000 FORMAT "%8.4" EXTENDED_LIMITS -327.6800 327.6700 /end CHARACTERISTIC
/begin CHARACTERISTIC CrCtl_vDeclGear5PWinNeg_C "P-Reglerparametersatz für Verzögerung 5.Gang" VALUE 0xCAA02 Kw_Ws16 300.0000 Vel -300.0000 0.00 FORMAT "%8.4" EXTENDED_LIMITS -327.6800 327.6700 /end CHARACTERISTIC
/begin CHARACTERISTIC CrCtl_DeclGear6PKp_C "P-Reglerparametersatz für Verzögerung 6.Gang" VALUE 0xCAA04 Kw_Wu32 1310719.99969 Kp_Vel2TrqPrp 0.00 1310719.99969 FORMAT "%13.5" /end CHARACTERISTIC
/begin CHARACTERISTIC CrCtl_DeclGear6PKpPos_C "P-Reglerparametersatz für Verzögerung 6.Gang" VALUE 0xCAA08 Kw_Wu32 1310719.99969 Kp_Vel2TrqPrp 0.00 1310719.99969 FORMAT "%13.5" /end CHARACTERISTIC
/begin CHARACTERISTIC CrCtl_DeclGear6PKpNeg_C "P-Reglerparametersatz für Verzögerung 6.Gang" VALUE 0xCAA0C Kw_Wu32 1310719.99969 Kp_Vel2TrqPrp 0.00 1310719.99969 FORMAT "%13.5" /end CHARACTERISTIC
/begin CHARACTERISTIC CrCtl_vDeclGear6PWinPos_C "P-Reglerparametersatz für Verzögerung 6.Gang" VALUE 0xCAA10 Kw_Ws16 300.0000 Vel 0.00 300.0000 FORMAT "%8.4" EXTENDED_LIMITS -327.6800 327.6700 /end CHARACTERISTIC
/begin CHARACTERISTIC CrCtl_vDeclGear6PWinNeg_C "P-Reglerparametersatz für Verzögerung 6.Gang" VALUE 0xCAA12 Kw_Ws16 300.0000 Vel -300.0000 0.00 FORMAT "%8.4" EXTENDED_LIMITS -327.6800 327.6700 /end CHARACTERISTIC
/begin CHARACTERISTIC CrCtl_tiDT1vCurr_C "Zeitkonstante des DT1-Gliedes zur Filterung von v_Curr für die Berechnung der Momentenreduzierung im Zustand HOLD." VALUE 0xCAA14 Kw_Wu32 4294.9673 TimeDelay_s 0.0000010000000 4294.9673 FORMAT "%9.4" /end CHARACTERISTIC
/begin CHARACTERISTIC CrCtl_kdDT1vCurr_C "Verstärkung des DT1-Gliedes zur Filterung von v_Curr für die Berechnung der Momentenreduzierung im Zustand HOLD." VALUE 0xCAA18 Kw_Ws32 1310719.99969 Kd_Vel2TrqPrp -655360.000000 655359.999695 FORMAT "%13.6" /end CHARACTERISTIC
/begin CHARACTERISTIC CrCtl_dtrqAccDwn_C "FGR: EIN+: Anstieg Momentenverringerung nach Loslassen EIN+ Taste" VALUE 0xCAA1C Kw_Ws16 327670.0 dTrqPrp_20ms 0.00 327670.0 FORMAT "%8.1" EXTENDED_LIMITS -327680.0 327670.0 /end CHARACTERISTIC
/begin CHARACTERISTIC CrCtl_dtrqDeclUp_C "FGR, EIN-: Momentenanstieg nach Loslassen EIN- Taste" VALUE 0xCAA1E Kw_Ws16 327670.0 dTrqPrp_20ms 0.00 327670.0 FORMAT "%8.1" EXTENDED_LIMITS -327680.0 327670.0 /end CHARACTERISTIC
/begin CHARACTERISTIC CrCtl_dtrqOffComf1_C "Rampensteigung 1 Komfortabschaltung" VALUE 0xCAA20 Kw_Ws16 327670.0 dTrqPrp_20ms 0.00 327670.0 FORMAT "%8.1" EXTENDED_LIMITS -327680.0 327670.0 /end CHARACTERISTIC
/begin CHARACTERISTIC CrCtl_dtrqOffComf2_C "Rampensteigung 2 Komfortabschaltung" VALUE 0xCAA22 Kw_Ws16 327670.0 dTrqPrp_20ms 0.00 327670.0 FORMAT "%8.1" EXTENDED_LIMITS -327680.0 327670.0 /end CHARACTERISTIC
/begin CHARACTERISTIC CrCtl_dtrqOffFast1_CUR "Kurve für erste Rampe bei Schnellabschaltung" CURVE 0xCAA24 Kl_Xs16_Ws16 327670.0 dTrqPrp_20ms 0.00 327670.0 FORMAT "%8.1" EXTENDED_LIMITS -327680.0 327670.0
 /begin AXIS_DESCR STD_AXIS Gearbx_stGear OneToOne 8 -1.000 6.000 FORMAT "%5.3" EXTENDED_LIMITS -128.0 127.0 DEPOSIT ABSOLUTE /end AXIS_DESCR
/end CHARACTERISTIC
/begin CHARACTERISTIC CrCtl_dtrqOffFast2_CUR "Kurve für zweite Rampe bei Schnellabschaltung" CURVE 0xCAA46 Kl_Xs16_Ws16 327670.0 dTrqPrp_20ms 0.00 327670.0 FORMAT "%8.1" EXTENDED_LIMITS -327680.0 327670.0
 /begin AXIS_DESCR STD_AXIS Gearbx_stGear OneToOne 8 -1.000 6.000 FORMAT "%5.3" EXTENDED_LIMITS -128.0 127.0 DEPOSIT ABSOLUTE /end AXIS_DESCR
/end CHARACTERISTIC
/begin CHARACTERISTIC CrCtl_dtrqOffFast3_CUR "Kennfled für dritte Rampe bei Schnellabschaltung" CURVE 0xCAA68 Kl_Xs16_Ws16 327670.0 dTrqPrp_20ms 0.00 327670.0 FORMAT "%8.1" EXTENDED_LIMITS -327680.0 327670.0
 /begin AXIS_DESCR STD_AXIS Gearbx_stGear OneToOne 8 -1.000 6.000 FORMAT "%5.3" EXTENDED_LIMITS -128.0 127.0 DEPOSIT ABSOLUTE /end AXIS_DESCR
/end CHARACTERISTIC
/begin CHARACTERISTIC CrCtl_dvAccFDCG3_CUR "Curve for slope of ramp speed in acceleration <= 3th gear" CURVE 0xCAA8A Kl_Xs16_Ws16 16383.50 dVel_20ms 0.00 16383.50 FORMAT "%8.2" EXTENDED_LIMITS -16384.00 16383.50
 /begin AXIS_DESCR STD_AXIS CrCtl_vBeg Vel 3 0.00 300.0000 FORMAT "%8.4" EXTENDED_LIMITS -327.6800 327.6700 DEPOSIT ABSOLUTE /end AXIS_DESCR
/end CHARACTERISTIC
/begin CHARACTERISTIC CrCtl_dvAccFDCG4_CUR "Curve for slope of ramp speed in acceleration (EIN+), 4th gear" CURVE 0xCAA98 Kl_Xs16_Ws16 16383.50 dVel_20ms 0.00 16383.50 FORMAT "%8.2" EXTENDED_LIMITS -16384.00 16383.50
 /begin AXIS_DESCR STD_AXIS CrCtl_vBeg Vel 3 0.00 300.0000 FORMAT "%8.4" EXTENDED_LIMITS -327.6800 327.6700 DEPOSIT ABSOLUTE /end AXIS_DESCR
/end CHARACTERISTIC
/begin CHARACTERISTIC CrCtl_dvAccFDCG5_CUR "Curve for slope of ramp speed in acceleration (EIN+), 5th gear" CURVE 0xCAAA6 Kl_Xs16_Ws16 16383.50 dVel_20ms 0.00 16383.50 FORMAT "%8.2" EXTENDED_LIMITS -16384.00 16383.50
 /begin AXIS_DESCR STD_AXIS CrCtl_vBeg Vel 3 0.00 300.0000 FORMAT "%8.4" EXTENDED_LIMITS -327.6800 327.6700 DEPOSIT ABSOLUTE /end AXIS_DESCR
/end CHARACTERISTIC
/begin CHARACTERISTIC CrCtl_dvAccFDCG6_CUR "Curve for slope of ramp speed in acceleration (EIN+), >= 6th gear" CURVE 0xCAAB4 Kl_Xs16_Ws16 16383.50 dVel_20ms 0.00 16383.50 FORMAT "%8.2" EXTENDED_LIMITS -16384.00 16383.50
 /begin AXIS_DESCR STD_AXIS CrCtl_vBeg Vel 3 0.00 300.0000 FORMAT "%8.4" EXTENDED_LIMITS -327.6800 327.6700 DEPOSIT ABSOLUTE /end AXIS_DESCR
/end CHARACTERISTIC
/begin CHARACTERISTIC CrCtl_dvAccG3_CUR "KL Anstieg FGR Rampengeschwindigkeit bei EIN+ für Gang <= 3" CURVE 0xCAAC2 Kl_Xs16_Ws16 16383.50 dVel_20ms 0.00 16383.50 FORMAT "%8.2" EXTENDED_LIMITS -16384.00 16383.50
 /begin AXIS_DESCR STD_AXIS CrCtl_vBeg Vel 3 0.00 300.0000 FORMAT "%8.4" EXTENDED_LIMITS -327.6800 327.6700 DEPOSIT ABSOLUTE /end AXIS_DESCR
/end CHARACTERISTIC
/begin CHARACTERISTIC CrCtl_dvAccG4_CUR "KL Anstieg FGR Rampengeschwindigkeit bei EIN+ für 4. Gang" CURVE 0xCAAD0 Kl_Xs16_Ws16 16383.50 dVel_20ms 0.00 16383.50 FORMAT "%8.2" EXTENDED_LIMITS -16384.00 16383.50
 /begin AXIS_DESCR STD_AXIS CrCtl_vBeg Vel 3 0.00 300.0000 FORMAT "%8.4" EXTENDED_LIMITS -327.6800 327.6700 DEPOSIT ABSOLUTE /end AXIS_DESCR
/end CHARACTERISTIC
/begin CHARACTERISTIC CrCtl_dvAccG5_CUR "KL Anstieg FGR Rampengeschwindigkeit bei EIN+ für 5. Gang" CURVE 0xCAADE Kl_Xs16_Ws16 16383.50 dVel_20ms 0.00 16383.50 FORMAT "%8.2" EXTENDED_LIMITS -16384.00 16383.50
 /begin AXIS_DESCR STD_AXIS CrCtl_vBeg Vel 3 0.00 300.0000 FORMAT "%8.4" EXTENDED_LIMITS -327.6800 327.6700 DEPOSIT ABSOLUTE /end AXIS_DESCR
/end CHARACTERISTIC
/begin CHARACTERISTIC CrCtl_dvAccG6_CUR "KL Anstieg FGR Rampengeschwindigkeit bei EIN+ für 6. Gang" CURVE 0xCAAEC Kl_Xs16_Ws16 16383.50 dVel_20ms 0.00 16383.50 FORMAT "%8.2" EXTENDED_LIMITS -16384.00 16383.50
 /begin AXIS_DESCR STD_AXIS CrCtl_vBeg Vel 3 0.00 300.0000 FORMAT "%8.4" EXTENDED_LIMITS -327.6800 327.6700 DEPOSIT ABSOLUTE /end AXIS_DESCR
/end CHARACTERISTIC
/begin CHARACTERISTIC CrCtl_dvDeclFDCG3_CUR "Curve for slope of ramp speed in acceleration (EIN+), >= 3rd gear" CURVE 0xCAAFA Kl_Xs16_Ws16 16383.50 dVel_20ms 0.00 16383.50 FORMAT "%8.2" EXTENDED_LIMITS -16384.00 16383.50
 /begin AXIS_DESCR STD_AXIS CrCtl_vBeg Vel 3 0.00 300.0000 FORMAT "%8.4" EXTENDED_LIMITS -327.6800 327.6700 DEPOSIT ABSOLUTE /end AXIS_DESCR
/end CHARACTERISTIC
/begin CHARACTERISTIC CrCtl_dvDeclFDCG4_CUR "Curve for slope of ramp speed in deceleration (EIN-), 4th gear" CURVE 0xCAB08 Kl_Xs16_Ws16 16383.50 dVel_20ms 0.00 16383.50 FORMAT "%8.2" EXTENDED_LIMITS -16384.00 16383.50
 /begin AXIS_DESCR STD_AXIS CrCtl_vBeg Vel 3 0.00 300.0000 FORMAT "%8.4" EXTENDED_LIMITS -327.6800 327.6700 DEPOSIT ABSOLUTE /end AXIS_DESCR
/end CHARACTERISTIC
/begin CHARACTERISTIC CrCtl_dvDeclFDCG5_CUR "curve for ramp slope SET+ 5th gear for sport mode" CURVE 0xCAB16 Kl_Xs16_Ws16 16383.50 dVel_20ms 0.00 16383.50 FORMAT "%8.2" EXTENDED_LIMITS -16384.00 16383.50
 /begin AXIS_DESCR STD_AXIS CrCtl_vBeg Vel 3 0.00 300.0000 FORMAT "%8.4" EXTENDED_LIMITS -327.6800 327.6700 DEPOSIT ABSOLUTE /end AXIS_DESCR
/end CHARACTERISTIC
/begin CHARACTERISTIC CrCtl_dvDeclFDCG6_CUR "Curve for slope of ramp speed in deceleration (EIN-), >= 6th gear" CURVE 0xCAB24 Kl_Xs16_Ws16 16383.50 dVel_20ms 0.00 16383.50 FORMAT "%8.2" EXTENDED_LIMITS -16384.00 16383.50
 /begin AXIS_DESCR STD_AXIS CrCtl_vBeg Vel 3 0.00 300.0000 FORMAT "%8.4" EXTENDED_LIMITS -327.6800 327.6700 DEPOSIT ABSOLUTE /end AXIS_DESCR
/end CHARACTERISTIC
/begin CHARACTERISTIC CrCtl_dvDeclG3_CUR "KL Abstieg FGR Rampengeschwindigkeit bei EIN- für Gang <= 3" CURVE 0xCAB32 Kl_Xs16_Ws16 16383.50 dVel_20ms 0.00 16383.50 FORMAT "%8.2" EXTENDED_LIMITS -16384.00 16383.50
 /begin AXIS_DESCR STD_AXIS CrCtl_vBeg Vel 3 0.00 300.0000 FORMAT "%8.4" EXTENDED_LIMITS -327.6800 327.6700 DEPOSIT ABSOLUTE /end AXIS_DESCR
/end CHARACTERISTIC
/begin CHARACTERISTIC CrCtl_dvDeclG4_CUR "KL Abstieg FGR Rampengeschwindigkeit bei EIN- für 4. Gang" CURVE 0xCAB40 Kl_Xs16_Ws16 16383.50 dVel_20ms 0.00 16383.50 FORMAT "%8.2" EXTENDED_LIMITS -16384.00 16383.50
 /begin AXIS_DESCR STD_AXIS CrCtl_vBeg Vel 3 0.00 300.0000 FORMAT "%8.4" EXTENDED_LIMITS -327.6800 327.6700 DEPOSIT ABSOLUTE /end AXIS_DESCR
/end CHARACTERISTIC
/begin CHARACTERISTIC CrCtl_dvDeclG5_CUR "KL Abstieg FGR Rampengeschwindigkeit bei EIN- für 5. Gang" CURVE 0xCAB4E Kl_Xs16_Ws16 16383.50 dVel_20ms 0.00 16383.50 FORMAT "%8.2" EXTENDED_LIMITS -16384.00 16383.50
 /begin AXIS_DESCR STD_AXIS CrCtl_vBeg Vel 3 0.00 300.0000 FORMAT "%8.4" EXTENDED_LIMITS -327.6800 327.6700 DEPOSIT ABSOLUTE /end AXIS_DESCR
/end CHARACTERISTIC
/begin CHARACTERISTIC CrCtl_dvDeclG6_CUR "KL Abstieg FGR Rampengeschwindigkeit bei EIN- für 6. Gang" CURVE 0xCAB5C Kl_Xs16_Ws16 16383.50 dVel_20ms 0.00 16383.50 FORMAT "%8.2" EXTENDED_LIMITS -16384.00 16383.50
 /begin AXIS_DESCR STD_AXIS CrCtl_vBeg Vel 3 0.00 300.0000 FORMAT "%8.4" EXTENDED_LIMITS -327.6800 327.6700 DEPOSIT ABSOLUTE /end AXIS_DESCR
/end CHARACTERISTIC
/begin CHARACTERISTIC CrCtl_dvResAbvFDCG3_CUR "Curve for slope of set speed ramp RESUME ABOVE, >=3th gear" CURVE 0xCAB6A Kl_Xs16_Ws16 16383.50 dVel_20ms 0.00 16383.50 FORMAT "%8.2" EXTENDED_LIMITS -16384.00 16383.50
 /begin AXIS_DESCR STD_AXIS CrCtl_vBeg Vel 3 0.00 300.0000 FORMAT "%8.4" EXTENDED_LIMITS -327.6800 327.6700 DEPOSIT ABSOLUTE /end AXIS_DESCR
/end CHARACTERISTIC
/begin CHARACTERISTIC CrCtl_dvResAbvFDCG4_CUR "Curve for slope of set speed ramp RESUME ABOVE, >=4th gear" CURVE 0xCAB78 Kl_Xs16_Ws16 16383.50 dVel_20ms 0.00 16383.50 FORMAT "%8.2" EXTENDED_LIMITS -16384.00 16383.50
 /begin AXIS_DESCR STD_AXIS CrCtl_vBeg Vel 3 0.00 300.0000 FORMAT "%8.4" EXTENDED_LIMITS -327.6800 327.6700 DEPOSIT ABSOLUTE /end AXIS_DESCR
/end CHARACTERISTIC
/begin CHARACTERISTIC CrCtl_dvResAbvFDCG5_CUR "Curve for slope of set speed ramp RESUME ABOVE, >=5th gear" CURVE 0xCAB86 Kl_Xs16_Ws16 16383.50 dVel_20ms 0.00 16383.50 FORMAT "%8.2" EXTENDED_LIMITS -16384.00 16383.50
 /begin AXIS_DESCR STD_AXIS CrCtl_vBeg Vel 3 0.00 300.0000 FORMAT "%8.4" EXTENDED_LIMITS -327.6800 327.6700 DEPOSIT ABSOLUTE /end AXIS_DESCR
/end CHARACTERISTIC
/begin CHARACTERISTIC CrCtl_dvResAbvFDCG6_CUR "Curve for slope of set speed ramp RESUME ABOVE, >=6th gear" CURVE 0xCAB94 Kl_Xs16_Ws16 16383.50 dVel_20ms 0.00 16383.50 FORMAT "%8.2" EXTENDED_LIMITS -16384.00 16383.50
 /begin AXIS_DESCR STD_AXIS CrCtl_vBeg Vel 3 0.00 300.0000 FORMAT "%8.4" EXTENDED_LIMITS -327.6800 327.6700 DEPOSIT ABSOLUTE /end AXIS_DESCR
/end CHARACTERISTIC
/begin CHARACTERISTIC CrCtl_dvResAbvG3_MAP "KF Abstieg FGR Rampengeschwindigkeit bei WA von oben für Gang <= 3" MAP 0xCABA2 Kf_Xs16_Ys16_Ws16 16383.50 dVel_20ms 0.00 16383.50 FORMAT "%8.2" EXTENDED_LIMITS -16384.00 16383.50
 /begin AXIS_DESCR STD_AXIS CrCtl_vBeg Vel 3 0.00 300.0000 FORMAT "%8.4" EXTENDED_LIMITS -327.6800 327.6700 DEPOSIT ABSOLUTE /end AXIS_DESCR
 /begin AXIS_DESCR STD_AXIS CrCtl_vDiff_mp Vel 1 0.00 300.0000 FORMAT "%8.4" EXTENDED_LIMITS -327.6800 327.6700 DEPOSIT ABSOLUTE /end AXIS_DESCR
/end CHARACTERISTIC
/begin CHARACTERISTIC CrCtl_dvResAbvG4_MAP "KF Abstieg FGR Rampengeschwindigkeit bei WA von oben für 4. Gang" MAP 0xCABB4 Kf_Xs16_Ys16_Ws16 16383.50 dVel_20ms 0.00 16383.50 FORMAT "%8.2" EXTENDED_LIMITS -16384.00 16383.50
 /begin AXIS_DESCR STD_AXIS CrCtl_vBeg Vel 3 0.00 300.0000 FORMAT "%8.4" EXTENDED_LIMITS -327.6800 327.6700 DEPOSIT ABSOLUTE /end AXIS_DESCR
 /begin AXIS_DESCR STD_AXIS CrCtl_vDiff_mp Vel 1 0.00 300.0000 FORMAT "%8.4" EXTENDED_LIMITS -327.6800 327.6700 DEPOSIT ABSOLUTE /end AXIS_DESCR
/end CHARACTERISTIC
/begin CHARACTERISTIC CrCtl_dvResAbvG5_MAP "KF Abstieg FGR Rampengeschwindigkeit bei WA von oben für 5. Gang" MAP 0xCABC6 Kf_Xs16_Ys16_Ws16 16383.50 dVel_20ms 0.00 16383.50 FORMAT "%8.2" EXTENDED_LIMITS -16384.00 16383.50
 /begin AXIS_DESCR STD_AXIS CrCtl_vBeg Vel 3 0.00 300.0000 FORMAT "%8.4" EXTENDED_LIMITS -327.6800 327.6700 DEPOSIT ABSOLUTE /end AXIS_DESCR
 /begin AXIS_DESCR STD_AXIS CrCtl_vDiff_mp Vel 1 0.00 300.0000 FORMAT "%8.4" EXTENDED_LIMITS -327.6800 327.6700 DEPOSIT ABSOLUTE /end AXIS_DESCR
/end CHARACTERISTIC
/begin CHARACTERISTIC CrCtl_dvResAbvG6_MAP "KF Abstieg FGR Rampengeschwindigkeit bei WA von oben für 6. Gang" MAP 0xCABD8 Kf_Xs16_Ys16_Ws16 16383.50 dVel_20ms 0.00 16383.50 FORMAT "%8.2" EXTENDED_LIMITS -16384.00 16383.50
 /begin AXIS_DESCR STD_AXIS CrCtl_vBeg Vel 3 0.00 300.0000 FORMAT "%8.4" EXTENDED_LIMITS -327.6800 327.6700 DEPOSIT ABSOLUTE /end AXIS_DESCR
 /begin AXIS_DESCR STD_AXIS CrCtl_vDiff_mp Vel 1 0.00 300.0000 FORMAT "%8.4" EXTENDED_LIMITS -327.6800 327.6700 DEPOSIT ABSOLUTE /end AXIS_DESCR
/end CHARACTERISTIC
/begin CHARACTERISTIC CrCtl_dvResBlwFDCG3_CUR "Curve for slope of set speed ramp RESUME BELOW, <= 3th gear" CURVE 0xCABEA Kl_Xs16_Ws16 16383.50 dVel_20ms 0.00 16383.50 FORMAT "%8.2" EXTENDED_LIMITS -16384.00 16383.50
 /begin AXIS_DESCR STD_AXIS CrCtl_vBeg Vel 3 0.00 300.0000 FORMAT "%8.4" EXTENDED_LIMITS -327.6800 327.6700 DEPOSIT ABSOLUTE /end AXIS_DESCR
/end CHARACTERISTIC
/begin CHARACTERISTIC CrCtl_dvResBlwFDCG4_CUR "Curve for slope of set speed ramp RESUME BELOW, <= 4th gear" CURVE 0xCABF8 Kl_Xs16_Ws16 16383.50 dVel_20ms 0.00 16383.50 FORMAT "%8.2" EXTENDED_LIMITS -16384.00 16383.50
 /begin AXIS_DESCR STD_AXIS CrCtl_vBeg Vel 3 0.00 300.0000 FORMAT "%8.4" EXTENDED_LIMITS -327.6800 327.6700 DEPOSIT ABSOLUTE /end AXIS_DESCR
/end CHARACTERISTIC
/begin CHARACTERISTIC CrCtl_dvResBlwFDCG5_CUR "Curve for slope of set speed ramp RESUME BELOW, <= 5th gear" CURVE 0xCAC06 Kl_Xs16_Ws16 16383.50 dVel_20ms 0.00 16383.50 FORMAT "%8.2" EXTENDED_LIMITS -16384.00 16383.50
 /begin AXIS_DESCR STD_AXIS CrCtl_vBeg Vel 3 0.00 300.0000 FORMAT "%8.4" EXTENDED_LIMITS -327.6800 327.6700 DEPOSIT ABSOLUTE /end AXIS_DESCR
/end CHARACTERISTIC
/begin CHARACTERISTIC CrCtl_dvResBlwFDCG6_CUR "Curve for slope of set speed ramp RESUME BELOW, >=6th gear" CURVE 0xCAC14 Kl_Xs16_Ws16 16383.50 dVel_20ms 0.00 16383.50 FORMAT "%8.2" EXTENDED_LIMITS -16384.00 16383.50
 /begin AXIS_DESCR STD_AXIS CrCtl_vBeg Vel 3 0.00 300.0000 FORMAT "%8.4" EXTENDED_LIMITS -327.6800 327.6700 DEPOSIT ABSOLUTE /end AXIS_DESCR
/end CHARACTERISTIC
/begin CHARACTERISTIC CrCtl_dvResBlwG3_MAP "KF Anstieg FGR Rampengeschwindigkeit bei WA von unten für Gang <= 3" MAP 0xCAC22 Kf_Xs16_Ys16_Ws16 16383.50 dVel_20ms 0.00 16383.50 FORMAT "%8.2" EXTENDED_LIMITS -16384.00 16383.50
 /begin AXIS_DESCR STD_AXIS CrCtl_vBeg Vel 3 0.00 300.0000 FORMAT "%8.4" EXTENDED_LIMITS -327.6800 327.6700 DEPOSIT ABSOLUTE /end AXIS_DESCR
 /begin AXIS_DESCR STD_AXIS CrCtl_vDiff_mp Vel 1 0.00 300.0000 FORMAT "%8.4" EXTENDED_LIMITS -327.6800 327.6700 DEPOSIT ABSOLUTE /end AXIS_DESCR
/end CHARACTERISTIC
/begin CHARACTERISTIC CrCtl_dvResBlwG4_MAP "KF Anstieg FGR Rampengeschwindigkeit bei WA von unten für 4. Gang" MAP 0xCAC34 Kf_Xs16_Ys16_Ws16 16383.50 dVel_20ms 0.00 16383.50 FORMAT "%8.2" EXTENDED_LIMITS -16384.00 16383.50
 /begin AXIS_DESCR STD_AXIS CrCtl_vBeg Vel 3 0.00 300.0000 FORMAT "%8.4" EXTENDED_LIMITS -327.6800 327.6700 DEPOSIT ABSOLUTE /end AXIS_DESCR
 /begin AXIS_DESCR STD_AXIS CrCtl_vDiff_mp Vel 1 0.00 300.0000 FORMAT "%8.4" EXTENDED_LIMITS -327.6800 327.6700 DEPOSIT ABSOLUTE /end AXIS_DESCR
/end CHARACTERISTIC
/begin CHARACTERISTIC CrCtl_dvResBlwG5_MAP "KF Anstieg FGR Rampengeschwindigkeit bei WA von unten für 5. Gang" MAP 0xCAC46 Kf_Xs16_Ys16_Ws16 16383.50 dVel_20ms 0.00 16383.50 FORMAT "%8.2" EXTENDED_LIMITS -16384.00 16383.50
 /begin AXIS_DESCR STD_AXIS CrCtl_vBeg Vel 3 0.00 300.0000 FORMAT "%8.4" EXTENDED_LIMITS -327.6800 327.6700 DEPOSIT ABSOLUTE /end AXIS_DESCR
 /begin AXIS_DESCR STD_AXIS CrCtl_vDiff_mp Vel 1 0.00 300.0000 FORMAT "%8.4" EXTENDED_LIMITS -327.6800 327.6700 DEPOSIT ABSOLUTE /end AXIS_DESCR
/end CHARACTERISTIC
/begin CHARACTERISTIC CrCtl_dvResBlwG6_MAP "KF Anstieg FGR Rampengeschwindigkeit bei WA von unten für 6. Gang" MAP 0xCAC58 Kf_Xs16_Ys16_Ws16 16383.50 dVel_20ms 0.00 16383.50 FORMAT "%8.2" EXTENDED_LIMITS -16384.00 16383.50
 /begin AXIS_DESCR STD_AXIS CrCtl_vBeg Vel 3 0.00 300.0000 FORMAT "%8.4" EXTENDED_LIMITS -327.6800 327.6700 DEPOSIT ABSOLUTE /end AXIS_DESCR
 /begin AXIS_DESCR STD_AXIS CrCtl_vDiff_mp Vel 1 0.00 300.0000 FORMAT "%8.4" EXTENDED_LIMITS -327.6800 327.6700 DEPOSIT ABSOLUTE /end AXIS_DESCR
/end CHARACTERISTIC
/begin CHARACTERISTIC CrCtl_facIncSlope_CUR "Überhöhungskennlinie für SET+, SET-, WA+, WA-" CURVE 0xCAC6A Kl_Xs16_Ws16 7800.049 Prc_1000 -3900.024 3900.024 FORMAT "%8.3" EXTENDED_LIMITS -4000.000 3999.878
 /begin AXIS_DESCR STD_AXIS Rail_tiThresMonEna Time_ms 6 0.00 655350.0 FORMAT "%8.1" DEPOSIT ABSOLUTE /end AXIS_DESCR
/end CHARACTERISTIC
/begin CHARACTERISTIC CrCtl_facPropAcc_C "Proportionalfaktor für Initialmoment von Fahrgeschwindigkeit in EIN+/WAU des FGR" VALUE 0xCAC84 Kw_Ws16 79.99756 Vel2TrqPrp 0.00 79.99756 FORMAT "%8.5" EXTENDED_LIMITS -80.00000 79.99756 /end CHARACTERISTIC
/begin CHARACTERISTIC CrCtl_facPropDecl_C "Proportionalfaktor für Offset von Fahrgeschwindigkeit zur Momentenerhöhung nach EIN-" VALUE 0xCAC86 Kw_Ws16 79.99756 Vel2TrqPrp 0.00 79.99756 FORMAT "%8.5" EXTENDED_LIMITS -80.00000 79.99756 /end CHARACTERISTIC
/begin CHARACTERISTIC CrCtl_facRedDecl_C "Faktor zur Momentenreduzierung bei Übergang HALTEN zu EIN- nach Ablauf TIP-Erkennung" VALUE 0xCAC88 Kw_Ws16 100.0000 Prc 0.00 100.0000 FORMAT "%8.4" EXTENDED_LIMITS -400.0000 399.9878 /end CHARACTERISTIC
/begin CHARACTERISTIC CrCtl_facRedHi_C "höherer Faktor Reduzierung FGR Moment bei Loslassen EIN+ (FGR-Moment > Schwelle)" VALUE 0xCAC8A Kw_Ws16 100.0000 Prc 0.00 100.0000 FORMAT "%8.4" EXTENDED_LIMITS -400.0000 399.9878 /end CHARACTERISTIC
/begin CHARACTERISTIC CrCtl_facRedLo_C "niederer Faktor Reduzierung FGR-Moment bei Loslassen EIN+ (FGR-Moment <= Schwelle)" VALUE 0xCAC8C Kw_Ws16 100.0000 Prc 0.00 100.0000 FORMAT "%8.4" EXTENDED_LIMITS -400.0000 399.9878 /end CHARACTERISTIC
/begin CHARACTERISTIC CrCtl_facResAbvFDC_CUR "Curve for reducing the slope of ramp speed in WA- and Tip- at the end of the ramp" CURVE 0xCAC8E Kl_Xs16_Ws16 99.97559 Prc_1000 0.00 99.97559 FORMAT "%8.4" EXTENDED_LIMITS -4000.000 3999.878
 /begin AXIS_DESCR STD_AXIS CrCtl_vDiffRed_mp Vel 6 -327.6800 327.6700 FORMAT "%8.4" DEPOSIT ABSOLUTE /end AXIS_DESCR
/end CHARACTERISTIC
/begin CHARACTERISTIC CrCtl_facResAbv_CUR "Abflachungskennlinie für WA-" CURVE 0xCACA8 Kl_Xs16_Ws16 99.97559 Prc_1000 0.00 99.97559 FORMAT "%8.4" EXTENDED_LIMITS -4000.000 3999.878
 /begin AXIS_DESCR STD_AXIS CrCtl_vDiffRed_mp Vel 3 -327.6800 327.6700 FORMAT "%8.4" DEPOSIT ABSOLUTE /end AXIS_DESCR
/end CHARACTERISTIC
/begin CHARACTERISTIC CrCtl_facResBlwFDC_CUR " Curve for reducing the slope of ramp speed in WA+ and Tip+ at the end of the ramp" CURVE 0xCACB6 Kl_Xs16_Ws16 99.97559 Prc_1000 0.00 99.97559 FORMAT "%8.4" EXTENDED_LIMITS -4000.000 3999.878
 /begin AXIS_DESCR STD_AXIS CrCtl_vDiffRed_mp Vel 6 -327.6800 327.6700 FORMAT "%8.4" DEPOSIT ABSOLUTE /end AXIS_DESCR
/end CHARACTERISTIC
/begin CHARACTERISTIC CrCtl_facResBlw_CUR "Abflachungskennlinie für WA+" CURVE 0xCACD0 Kl_Xs16_Ws16 99.97559 Prc_1000 0.00 99.97559 FORMAT "%8.4" EXTENDED_LIMITS -4000.000 3999.878
 /begin AXIS_DESCR STD_AXIS CrCtl_vDiffRed_mp Vel 3 -327.6800 327.6700 FORMAT "%8.4" DEPOSIT ABSOLUTE /end AXIS_DESCR
/end CHARACTERISTIC
/begin CHARACTERISTIC CrCtl_facRmpRes_C "Faktor für Rampensteigung FGR-Geschwindigkeit WA (Endphase WA-Rampe)" VALUE 0xCACDE Kw_Ws16 1.000000 Fact 0.00 1.000000 FORMAT "%8.6" EXTENDED_LIMITS -4.000000 3.999878 /end CHARACTERISTIC
/begin CHARACTERISTIC CrCtl_HoldGear2IKi_C "Integralverstärkung Ki Kleinsignalbereich in HALTEN für 2. Gang" VALUE 0xCACE0 Kw_Wu32 19999999.9953 Ki_Vel2TrqPrp 0.00 19999999.9953 FORMAT "%13.4" /end CHARACTERISTIC
/begin CHARACTERISTIC CrCtl_HoldGear2IKiPos_C "Integralverstärkung Ki pos. Großsignalbereich in HALTEN für 2. Gang" VALUE 0xCACE4 Kw_Wu32 19999999.9953 Ki_Vel2TrqPrp 0.00 19999999.9953 FORMAT "%13.4" /end CHARACTERISTIC
/begin CHARACTERISTIC CrCtl_HoldGear2IKiNeg_C "Integralverstärkung Ki neg. Großsignalbereich in HALTEN für 2. Gang" VALUE 0xCACE8 Kw_Wu32 19999999.9953 Ki_Vel2TrqPrp 0.00 19999999.9953 FORMAT "%13.4" /end CHARACTERISTIC
/begin CHARACTERISTIC CrCtl_vHoldGear2IWinPos_C "obere Grenze Kleinsignalbereich I-Anteil in HALTEN, 2. Gang" VALUE 0xCACEC Kw_Ws16 300.0000 Vel 0.00 300.0000 FORMAT "%8.4" EXTENDED_LIMITS -327.6800 327.6700 /end CHARACTERISTIC
/begin CHARACTERISTIC CrCtl_vHoldGear2IWinNeg_C "untere Grenze Kleinsignalbereich I-Anteil in HALTEN, 2. Gang" VALUE 0xCACEE Kw_Ws16 300.0000 Vel -300.0000 0.00 FORMAT "%8.4" EXTENDED_LIMITS -327.6800 327.6700 /end CHARACTERISTIC
/begin CHARACTERISTIC CrCtl_HoldGear2PKp_C "Proportionalverstärkung Kp Kleinsignalbereich in HALTEN, 2. Gang" VALUE 0xCACF0 Kw_Wu32 1310719.99969 Kp_Vel2TrqPrp 0.00 1310719.99969 FORMAT "%13.5" /end CHARACTERISTIC
/begin CHARACTERISTIC CrCtl_HoldGear2PKpPos_C "Proportionalverstärkung Kp pos. Großsignalbereich in HALTEN, 2. Gang" VALUE 0xCACF4 Kw_Wu32 1310719.99969 Kp_Vel2TrqPrp 0.00 1310719.99969 FORMAT "%13.5" /end CHARACTERISTIC
/begin CHARACTERISTIC CrCtl_HoldGear2PKpNeg_C "Proportionalverstärkung Kp neg. Großsignalbereich in HALTEN, 2. Gang" VALUE 0xCACF8 Kw_Wu32 1310719.99969 Kp_Vel2TrqPrp 0.00 1310719.99969 FORMAT "%13.5" /end CHARACTERISTIC
/begin CHARACTERISTIC CrCtl_vHoldGear2PWinPos_C "obere Grenze Kleinsignalbereich P-Anteil in HALTEN, 2. Gang" VALUE 0xCACFC Kw_Ws16 300.0000 Vel 0.00 300.0000 FORMAT "%8.4" EXTENDED_LIMITS -327.6800 327.6700 /end CHARACTERISTIC
/begin CHARACTERISTIC CrCtl_vHoldGear2PWinNeg_C "untere Grenze Kleinsignalbereich P-Anteil in HALTEN, 2. Gang" VALUE 0xCACFE Kw_Ws16 300.0000 Vel -300.0000 0.00 FORMAT "%8.4" EXTENDED_LIMITS -327.6800 327.6700 /end CHARACTERISTIC
/begin CHARACTERISTIC CrCtl_HoldGear3IKi_C "Integralverstärkung Kleinsignalbereich in HALTEN, 3. Gang" VALUE 0xCAD00 Kw_Wu32 19999999.9953 Ki_Vel2TrqPrp 0.00 19999999.9953 FORMAT "%13.4" /end CHARACTERISTIC
/begin CHARACTERISTIC CrCtl_HoldGear3IKiPos_C "Integralverstärkung Ki pos. Großsignalbereich in HALTEN, 3. Gang" VALUE 0xCAD04 Kw_Wu32 19999999.9953 Ki_Vel2TrqPrp 0.00 19999999.9953 FORMAT "%13.4" /end CHARACTERISTIC
/begin CHARACTERISTIC CrCtl_HoldGear3IKiNeg_C "Integralverstärkung Ki neg. Großsignalbereich in HALTEN, 3. Gang" VALUE 0xCAD08 Kw_Wu32 19999999.9953 Ki_Vel2TrqPrp 0.00 19999999.9953 FORMAT "%13.4" /end CHARACTERISTIC
/begin CHARACTERISTIC CrCtl_vHoldGear3IWinPos_C "obere Grenze Kleinsignalbereich I-Anteil in HALTEN, 3. Gang" VALUE 0xCAD0C Kw_Ws16 300.0000 Vel 0.00 300.0000 FORMAT "%8.4" EXTENDED_LIMITS -327.6800 327.6700 /end CHARACTERISTIC
/begin CHARACTERISTIC CrCtl_vHoldGear3IWinNeg_C "untere Grenze Kleinsignalbereich I-Anteil in HALTEN, 3. Gang" VALUE 0xCAD0E Kw_Ws16 300.0000 Vel -300.0000 0.00 FORMAT "%8.4" EXTENDED_LIMITS -327.6800 327.6700 /end CHARACTERISTIC
/begin CHARACTERISTIC CrCtl_HoldGear3PKp_C "Proportionalverstärkung Kp Kleinsignalbereich in HALTEN, 3. Gang" VALUE 0xCAD10 Kw_Wu32 1310719.99969 Kp_Vel2TrqPrp 0.00 1310719.99969 FORMAT "%13.5" /end CHARACTERISTIC
/begin CHARACTERISTIC CrCtl_HoldGear3PKpPos_C "Proportionalverstärkung Kp pos. Großsignalbereich in HALTEN, 3. Gang" VALUE 0xCAD14 Kw_Wu32 1310719.99969 Kp_Vel2TrqPrp 0.00 1310719.99969 FORMAT "%13.5" /end CHARACTERISTIC
/begin CHARACTERISTIC CrCtl_HoldGear3PKpNeg_C "Proportionalverstärkung Kp neg. Großsignalbereich in HALTEN, 3. Gang" VALUE 0xCAD18 Kw_Wu32 1310719.99969 Kp_Vel2TrqPrp 0.00 1310719.99969 FORMAT "%13.5" /end CHARACTERISTIC
/begin CHARACTERISTIC CrCtl_vHoldGear3PWinPos_C "obere Grenze Kleinsignalbereich P-Anteil in HALTEN, 3. Gang" VALUE 0xCAD1C Kw_Ws16 300.0000 Vel 0.00 300.0000 FORMAT "%8.4" EXTENDED_LIMITS -327.6800 327.6700 /end CHARACTERISTIC
/begin CHARACTERISTIC CrCtl_vHoldGear3PWinNeg_C "untere Grenze Kleinsignalbereich P-Anteil in HALTEN, 3. Gang" VALUE 0xCAD1E Kw_Ws16 300.0000 Vel -300.0000 0.00 FORMAT "%8.4" EXTENDED_LIMITS -327.6800 327.6700 /end CHARACTERISTIC
/begin CHARACTERISTIC CrCtl_HoldGear4IKi_C "Integralverstärkung Kleinsignalbereich in HALTEN, 4. Gang" VALUE 0xCAD20 Kw_Wu32 19999999.9953 Ki_Vel2TrqPrp 0.00 19999999.9953 FORMAT "%13.4" /end CHARACTERISTIC
/begin CHARACTERISTIC CrCtl_HoldGear4IKiPos_C "Integralverstärkung Ki pos. Großsignalbereich in HALTEN, 4. Gang" VALUE 0xCAD24 Kw_Wu32 19999999.9953 Ki_Vel2TrqPrp 0.00 19999999.9953 FORMAT "%13.4" /end CHARACTERISTIC
/begin CHARACTERISTIC CrCtl_HoldGear4IKiNeg_C "Integralverstärkung Ki neg. Großsignalbereich in HALTEN, 4. Gang" VALUE 0xCAD28 Kw_Wu32 19999999.9953 Ki_Vel2TrqPrp 0.00 19999999.9953 FORMAT "%13.4" /end CHARACTERISTIC
/begin CHARACTERISTIC CrCtl_vHoldGear4IWinPos_C "obere Grenze Kleinsignalbereich I-Anteil in HALTEN, 4. Gang" VALUE 0xCAD2C Kw_Ws16 300.0000 Vel 0.00 300.0000 FORMAT "%8.4" EXTENDED_LIMITS -327.6800 327.6700 /end CHARACTERISTIC
/begin CHARACTERISTIC CrCtl_vHoldGear4IWinNeg_C "untere Grenze Kleinsignalbereich I-Anteil in HALTEN, 4. Gang" VALUE 0xCAD2E Kw_Ws16 300.0000 Vel -300.0000 0.00 FORMAT "%8.4" EXTENDED_LIMITS -327.6800 327.6700 /end CHARACTERISTIC
/begin CHARACTERISTIC CrCtl_HoldGear4PKp_C "Proportionalverstärkung Kp Kleinsignalbereich in HALTEN, 4 Gang" VALUE 0xCAD30 Kw_Wu32 1310719.99969 Kp_Vel2TrqPrp 0.00 1310719.99969 FORMAT "%13.5" /end CHARACTERISTIC
/begin CHARACTERISTIC CrCtl_HoldGear4PKpPos_C "Proportionalverstärkung Kp pos. Großsignalbereich in HALTEN, 4. Gang" VALUE 0xCAD34 Kw_Wu32 1310719.99969 Kp_Vel2TrqPrp 0.00 1310719.99969 FORMAT "%13.5" /end CHARACTERISTIC
/begin CHARACTERISTIC CrCtl_HoldGear4PKpNeg_C "Proportionalverstärkung Kp neg. Großsignalbereich in HALTEN, 4. Gang" VALUE 0xCAD38 Kw_Wu32 1310719.99969 Kp_Vel2TrqPrp 0.00 1310719.99969 FORMAT "%13.5" /end CHARACTERISTIC
/begin CHARACTERISTIC CrCtl_vHoldGear4PWinPos_C "obere Grenze Kleinsignalbereich P-Anteil in HALTEN, 4. Gang" VALUE 0xCAD3C Kw_Ws16 300.0000 Vel 0.00 300.0000 FORMAT "%8.4" EXTENDED_LIMITS -327.6800 327.6700 /end CHARACTERISTIC
/begin CHARACTERISTIC CrCtl_vHoldGear4PWinNeg_C "untere Grenze Kleinsignalbereich P-Anteil in HALTEN, 4. Gang" VALUE 0xCAD3E Kw_Ws16 300.0000 Vel -300.0000 0.00 FORMAT "%8.4" EXTENDED_LIMITS -327.6800 327.6700 /end CHARACTERISTIC
/begin CHARACTERISTIC CrCtl_HoldGear5IKi_C "Integralverstärkung Kleinsignalbereich in HALTEN, 5. Gang" VALUE 0xCAD40 Kw_Wu32 19999999.9953 Ki_Vel2TrqPrp 0.00 19999999.9953 FORMAT "%13.4" /end CHARACTERISTIC
/begin CHARACTERISTIC CrCtl_HoldGear5IKiPos_C "Integralverstärkung Ki pos. Großsignalbereich in HALTEN, 5. Gang" VALUE 0xCAD44 Kw_Wu32 19999999.9953 Ki_Vel2TrqPrp 0.00 19999999.9953 FORMAT "%13.4" /end CHARACTERISTIC
/begin CHARACTERISTIC CrCtl_HoldGear5IKiNeg_C "Integralverstärkung Ki neg. Großsignalbereich in HALTEN, 5. Gang" VALUE 0xCAD48 Kw_Wu32 19999999.9953 Ki_Vel2TrqPrp 0.00 19999999.9953 FORMAT "%13.4" /end CHARACTERISTIC
/begin CHARACTERISTIC CrCtl_vHoldGear5IWinPos_C "obere Grenze Kleinsignalbereich I-Anteil in HALTEN, 5. Gang" VALUE 0xCAD4C Kw_Ws16 300.0000 Vel 0.00 300.0000 FORMAT "%8.4" EXTENDED_LIMITS -327.6800 327.6700 /end CHARACTERISTIC
/begin CHARACTERISTIC CrCtl_vHoldGear5IWinNeg_C "untere Grenze Kleinsignalbereich I-Anteil in HALTEN, 5. Gang" VALUE 0xCAD4E Kw_Ws16 300.0000 Vel -300.0000 0.00 FORMAT "%8.4" EXTENDED_LIMITS -327.6800 327.6700 /end CHARACTERISTIC
/begin CHARACTERISTIC CrCtl_HoldGear5PKp_C "Proportionalverstärkung Kp Kleinsignalbereich in HALTEN, 5 Gang" VALUE 0xCAD50 Kw_Wu32 1310719.99969 Kp_Vel2TrqPrp 0.00 1310719.99969 FORMAT "%13.5" /end CHARACTERISTIC
/begin CHARACTERISTIC CrCtl_HoldGear5PKpPos_C "Proportionalverstärkung Kp pos. Großsignalbereich in HALTEN, 5. Gang" VALUE 0xCAD54 Kw_Wu32 1310719.99969 Kp_Vel2TrqPrp 0.00 1310719.99969 FORMAT "%13.5" /end CHARACTERISTIC
/begin CHARACTERISTIC CrCtl_HoldGear5PKpNeg_C "Proportionalverstärkung Kp neg. Großsignalbereich in HALTEN, 5. Gang" VALUE 0xCAD58 Kw_Wu32 1310719.99969 Kp_Vel2TrqPrp 0.00 1310719.99969 FORMAT "%13.5" /end CHARACTERISTIC
/begin CHARACTERISTIC CrCtl_vHoldGear5PWinPos_C "obere Grenze Kleinsignalbereich P-Anteil in HALTEN, 5. Gang" VALUE 0xCAD5C Kw_Ws16 300.0000 Vel 0.00 300.0000 FORMAT "%8.4" EXTENDED_LIMITS -327.6800 327.6700 /end CHARACTERISTIC
/begin CHARACTERISTIC CrCtl_vHoldGear5PWinNeg_C "untere Grenze Kleinsignalbereich P-Anteil in HALTEN, 5. Gang" VALUE 0xCAD5E Kw_Ws16 300.0000 Vel -300.0000 0.00 FORMAT "%8.4" EXTENDED_LIMITS -327.6800 327.6700 /end CHARACTERISTIC
/begin CHARACTERISTIC CrCtl_HoldGear6IKi_C "Integralverstärkung Kleinsignalbereich in HALTEN, 6. Gang" VALUE 0xCAD60 Kw_Wu32 19999999.9953 Ki_Vel2TrqPrp 0.00 19999999.9953 FORMAT "%13.4" /end CHARACTERISTIC
/begin CHARACTERISTIC CrCtl_HoldGear6IKiPos_C "Integralverstärkung Ki neg. Großsignalbereich in HALTEN, 6. Gang" VALUE 0xCAD64 Kw_Wu32 19999999.9953 Ki_Vel2TrqPrp 0.00 19999999.9953 FORMAT "%13.4" /end CHARACTERISTIC
/begin CHARACTERISTIC CrCtl_HoldGear6IKiNeg_C "Integralverstärkung Ki neg. Großsignalbereich in HALTEN, 6. Gang" VALUE 0xCAD68 Kw_Wu32 19999999.9953 Ki_Vel2TrqPrp 0.00 19999999.9953 FORMAT "%13.4" /end CHARACTERISTIC
/begin CHARACTERISTIC CrCtl_vHoldGear6IWinPos_C "obere Grenze Kleinsignalbereich I-Anteil in HALTEN, 6. Gang" VALUE 0xCAD6C Kw_Ws16 300.0000 Vel 0.00 300.0000 FORMAT "%8.4" EXTENDED_LIMITS -327.6800 327.6700 /end CHARACTERISTIC
/begin CHARACTERISTIC CrCtl_vHoldGear6IWinNeg_C "untere Grenze Kleinsignalbereich I-Anteil in HALTEN, 6. Gang" VALUE 0xCAD6E Kw_Ws16 300.0000 Vel -300.0000 0.00 FORMAT "%8.4" EXTENDED_LIMITS -327.6800 327.6700 /end CHARACTERISTIC
/begin CHARACTERISTIC CrCtl_HoldGear6PKp_C "Proportionalverstärkung Kp Kleinsignalbereich in HALTEN, 6 Gang" VALUE 0xCAD70 Kw_Wu32 1310719.99969 Kp_Vel2TrqPrp 0.00 1310719.99969 FORMAT "%13.5" /end CHARACTERISTIC
/begin CHARACTERISTIC CrCtl_HoldGear6PKpPos_C "Proportionalverstärkung Kp pos. Großsignalbereich in HALTEN, 6. Gang" VALUE 0xCAD74 Kw_Wu32 1310719.99969 Kp_Vel2TrqPrp 0.00 1310719.99969 FORMAT "%13.5" /end CHARACTERISTIC
/begin CHARACTERISTIC CrCtl_HoldGear6PKpNeg_C "Proportionalverstärkung Kp neg. Großsignalbereich in HALTEN, 6. Gang" VALUE 0xCAD78 Kw_Wu32 1310719.99969 Kp_Vel2TrqPrp 0.00 1310719.99969 FORMAT "%13.5" /end CHARACTERISTIC
/begin CHARACTERISTIC CrCtl_vHoldGear6PWinPos_C "obere Grenze Kleinsignalbereich P-Anteil in HALTEN, 6. Gang" VALUE 0xCAD7C Kw_Ws16 300.0000 Vel 0.00 300.0000 FORMAT "%8.4" EXTENDED_LIMITS -327.6800 327.6700 /end CHARACTERISTIC
/begin CHARACTERISTIC CrCtl_vHoldGear6PWinNeg_C "untere Grenze Kleinsignalbereich P-Anteil in HALTEN, 6. Gang" VALUE 0xCAD7E Kw_Ws16 300.0000 Vel -300.0000 0.00 FORMAT "%8.4" EXTENDED_LIMITS -327.6800 327.6700 /end CHARACTERISTIC
/begin CHARACTERISTIC CrCtl_nMaxAlw_C "Obere Drehzahlschwelle Abschaltung FGR" VALUE 0xCA938 Kw_Ws16 6000.000 EngN 0.00 6000.000 FORMAT "%8.3" EXTENDED_LIMITS -32768.00 32767.00 /end CHARACTERISTIC
/begin CHARACTERISTIC CrCtl_nMinAlw_C "untere Drehzahlschwelle Abschaltung FGR" VALUE 0xCA93A Kw_Ws16 6000.000 EngN 0.00 6000.000 FORMAT "%8.3" EXTENDED_LIMITS -32768.00 32767.00 /end CHARACTERISTIC
/begin CHARACTERISTIC CrCtl_rAccPedVelMin_C "Minimum acc per ratio for cruise control" VALUE 0xCAED8 Kw_Ws16 799.9878 Prc -400.0000 399.9878 FORMAT "%8.4" /end CHARACTERISTIC
/begin CHARACTERISTIC CrCtl_tiResAbvGear2DT1_C "DT1 Zeitkonstante T1 Endphase WA oben für 2. Gang" VALUE 0xCAD80 Kw_Wu32 4294.9673 TimeDelay_s 0.0000010000000 4294.9673 FORMAT "%9.4" /end CHARACTERISTIC
/begin CHARACTERISTIC CrCtl_ResAbvGear2DT1Kd_C "Differentialverstärkung Endphase WA oben 2. Gang" VALUE 0xCAD84 Kw_Ws32 1310719.99969 Kd_Vel2TrqPrp -655360.000000 655359.999695 FORMAT "%13.6" /end CHARACTERISTIC
/begin CHARACTERISTIC CrCtl_tiResAbvGear3DT1_C "DT1 Zeitkonstante T1 Endphase WA oben für 3. Gang" VALUE 0xCAD88 Kw_Wu32 4294.9673 TimeDelay_s 0.0000010000000 4294.9673 FORMAT "%9.4" /end CHARACTERISTIC
/begin CHARACTERISTIC CrCtl_ResAbvGear3DT1Kd_C "Differentialverstärkung Endphase WA oben 3. Gang" VALUE 0xCAD8C Kw_Ws32 1310719.99969 Kd_Vel2TrqPrp -655360.000000 655359.999695 FORMAT "%13.6" /end CHARACTERISTIC
/begin CHARACTERISTIC CrCtl_tiResAbvGear4DT1_C "DT1 Zeitkonstante T1 Endphase WA oben für 4. Gang" VALUE 0xCAD90 Kw_Wu32 4294.9673 TimeDelay_s 0.0000010000000 4294.9673 FORMAT "%9.4" /end CHARACTERISTIC
/begin CHARACTERISTIC CrCtl_ResAbvGear4DT1Kd_C "Differentialverstärkung Endphase WA oben 4. Gang" VALUE 0xCAD94 Kw_Ws32 1310719.99969 Kd_Vel2TrqPrp -655360.000000 655359.999695 FORMAT "%13.6" /end CHARACTERISTIC
/begin CHARACTERISTIC CrCtl_tiResAbvGear5DT1_C "DT1 Zeitkonstante T1 Endphase WA oben für 5. Gang" VALUE 0xCAD98 Kw_Wu32 4294.9673 TimeDelay_s 0.0000010000000 4294.9673 FORMAT "%9.4" /end CHARACTERISTIC
/begin CHARACTERISTIC CrCtl_ResAbvGear5DT1Kd_C "Differentialverstärkung Endphase WA oben 5. Gang" VALUE 0xCAD9C Kw_Ws32 1310719.99969 Kd_Vel2TrqPrp -655360.000000 655359.999695 FORMAT "%13.6" /end CHARACTERISTIC
/begin CHARACTERISTIC CrCtl_tiResAbvGear6DT1_C "DT1 Zeitkonstante T1 Endphase WA oben für 6. Gang" VALUE 0xCADA0 Kw_Wu32 4294.9673 TimeDelay_s 0.0000010000000 4294.9673 FORMAT "%9.4" /end CHARACTERISTIC
/begin CHARACTERISTIC CrCtl_ResAbvGear6DT1Kd_C "Differentialverstärkung Endphase WA oben 6. Gang" VALUE 0xCADA4 Kw_Ws32 1310719.99969 Kd_Vel2TrqPrp -655360.000000 655359.999695 FORMAT "%13.6" /end CHARACTERISTIC
/begin CHARACTERISTIC CrCtl_ResBlwGear2IKi_C "PI-Reglerparametersatz für WA+ 2.Gang" VALUE 0xCADA8 Kw_Wu32 19999999.9953 Ki_Vel2TrqPrp 0.00 19999999.9953 FORMAT "%13.4" /end CHARACTERISTIC
/begin CHARACTERISTIC CrCtl_ResBlwGear2IKiPos_C "PI-Reglerparametersatz für WA+ 2.Gang" VALUE 0xCADAC Kw_Wu32 19999999.9953 Ki_Vel2TrqPrp 0.00 19999999.9953 FORMAT "%13.4" /end CHARACTERISTIC
/begin CHARACTERISTIC CrCtl_ResBlwGear2IKiNeg_C "PI-Reglerparametersatz für WA+ 2.Gang" VALUE 0xCADB0 Kw_Wu32 19999999.9953 Ki_Vel2TrqPrp 0.00 19999999.9953 FORMAT "%13.4" /end CHARACTERISTIC
/begin CHARACTERISTIC CrCtl_vResBlwGear2IWinPos_C "PI-Reglerparametersatz für WA+ 2.Gang" VALUE 0xCADB4 Kw_Ws16 300.0000 Vel 0.00 300.0000 FORMAT "%8.4" EXTENDED_LIMITS -327.6800 327.6700 /end CHARACTERISTIC
/begin CHARACTERISTIC CrCtl_vResBlwGear2IWinNeg_C "PI-Reglerparametersatz für WA+ 2.Gang" VALUE 0xCADB6 Kw_Ws16 300.0000 Vel -300.0000 0.00 FORMAT "%8.4" EXTENDED_LIMITS -327.6800 327.6700 /end CHARACTERISTIC
/begin CHARACTERISTIC CrCtl_ResBlwGear2PKp_C "PI-Reglerparametersatz für WA+ 2.Gang" VALUE 0xCADB8 Kw_Wu32 1310719.99969 Kp_Vel2TrqPrp 0.00 1310719.99969 FORMAT "%13.5" /end CHARACTERISTIC
/begin CHARACTERISTIC CrCtl_ResBlwGear2PKpPos_C "PI-Reglerparametersatz für WA+ 2.Gang" VALUE 0xCADBC Kw_Wu32 1310719.99969 Kp_Vel2TrqPrp 0.00 1310719.99969 FORMAT "%13.5" /end CHARACTERISTIC
/begin CHARACTERISTIC CrCtl_ResBlwGear2PKpNeg_C "PI-Reglerparametersatz für WA+ 2.Gang" VALUE 0xCADC0 Kw_Wu32 1310719.99969 Kp_Vel2TrqPrp 0.00 1310719.99969 FORMAT "%13.5" /end CHARACTERISTIC
/begin CHARACTERISTIC CrCtl_vResBlwGear2PWinPos_C "PI-Reglerparametersatz für WA+ 2.Gang" VALUE 0xCADC4 Kw_Ws16 300.0000 Vel 0.00 300.0000 FORMAT "%8.4" EXTENDED_LIMITS -327.6800 327.6700 /end CHARACTERISTIC
/begin CHARACTERISTIC CrCtl_vResBlwGear2PWinNeg_C "PI-Reglerparametersatz für WA+ 2.Gang" VALUE 0xCADC6 Kw_Ws16 300.0000 Vel -300.0000 0.00 FORMAT "%8.4" EXTENDED_LIMITS -327.6800 327.6700 /end CHARACTERISTIC
/begin CHARACTERISTIC CrCtl_ResBlwGear3IKi_C "PI-Reglerparametersatz für WA+ 3.Gang" VALUE 0xCADC8 Kw_Wu32 19999999.9953 Ki_Vel2TrqPrp 0.00 19999999.9953 FORMAT "%13.4" /end CHARACTERISTIC
/begin CHARACTERISTIC CrCtl_ResBlwGear3IKiPos_C "PI-Reglerparametersatz für WA+ 3.Gang" VALUE 0xCADCC Kw_Wu32 19999999.9953 Ki_Vel2TrqPrp 0.00 19999999.9953 FORMAT "%13.4" /end CHARACTERISTIC
/begin CHARACTERISTIC CrCtl_ResBlwGear3IKiNeg_C "PI-Reglerparametersatz für WA+ 3.Gang" VALUE 0xCADD0 Kw_Wu32 19999999.9953 Ki_Vel2TrqPrp 0.00 19999999.9953 FORMAT "%13.4" /end CHARACTERISTIC
/begin CHARACTERISTIC CrCtl_vResBlwGear3IWinPos_C "PI-Reglerparametersatz für WA+ 3.Gang" VALUE 0xCADD4 Kw_Ws16 300.0000 Vel 0.00 300.0000 FORMAT "%8.4" EXTENDED_LIMITS -327.6800 327.6700 /end CHARACTERISTIC
/begin CHARACTERISTIC CrCtl_vResBlwGear3IWinNeg_C "PI-Reglerparametersatz für WA+ 3.Gang" VALUE 0xCADD6 Kw_Ws16 300.0000 Vel -300.0000 0.00 FORMAT "%8.4" EXTENDED_LIMITS -327.6800 327.6700 /end CHARACTERISTIC
/begin CHARACTERISTIC CrCtl_ResBlwGear3PKp_C "PI-Reglerparametersatz für WA+ 3.Gang" VALUE 0xCADD8 Kw_Wu32 1310719.99969 Kp_Vel2TrqPrp 0.00 1310719.99969 FORMAT "%13.5" /end CHARACTERISTIC
/begin CHARACTERISTIC CrCtl_ResBlwGear3PKpPos_C "PI-Reglerparametersatz für WA+ 3.Gang" VALUE 0xCADDC Kw_Wu32 1310719.99969 Kp_Vel2TrqPrp 0.00 1310719.99969 FORMAT "%13.5" /end CHARACTERISTIC
/begin CHARACTERISTIC CrCtl_ResBlwGear3PKpNeg_C "PI-Reglerparametersatz für WA+ 3.Gang" VALUE 0xCADE0 Kw_Wu32 1310719.99969 Kp_Vel2TrqPrp 0.00 1310719.99969 FORMAT "%13.5" /end CHARACTERISTIC
/begin CHARACTERISTIC CrCtl_vResBlwGear3PWinPos_C "PI-Reglerparametersatz für WA+ 3.Gang" VALUE 0xCADE4 Kw_Ws16 300.0000 Vel 0.00 300.0000 FORMAT "%8.4" EXTENDED_LIMITS -327.6800 327.6700 /end CHARACTERISTIC
/begin CHARACTERISTIC CrCtl_vResBlwGear3PWinNeg_C "PI-Reglerparametersatz für WA+ 3.Gang" VALUE 0xCADE6 Kw_Ws16 300.0000 Vel -300.0000 0.00 FORMAT "%8.4" EXTENDED_LIMITS -327.6800 327.6700 /end CHARACTERISTIC
/begin CHARACTERISTIC CrCtl_ResBlwGear4IKi_C "PI-Reglerparametersatz für WA+ 4.Gang" VALUE 0xCADE8 Kw_Wu32 19999999.9953 Ki_Vel2TrqPrp 0.00 19999999.9953 FORMAT "%13.4" /end CHARACTERISTIC
/begin CHARACTERISTIC CrCtl_ResBlwGear4IKiPos_C "PI-Reglerparametersatz für WA+ 4.Gang" VALUE 0xCADEC Kw_Wu32 19999999.9953 Ki_Vel2TrqPrp 0.00 19999999.9953 FORMAT "%13.4" /end CHARACTERISTIC
/begin CHARACTERISTIC CrCtl_ResBlwGear4IKiNeg_C "PI-Reglerparametersatz für WA+ 4.Gang" VALUE 0xCADF0 Kw_Wu32 19999999.9953 Ki_Vel2TrqPrp 0.00 19999999.9953 FORMAT "%13.4" /end CHARACTERISTIC
/begin CHARACTERISTIC CrCtl_vResBlwGear4IWinPos_C "PI-Reglerparametersatz für WA+ 4.Gang" VALUE 0xCADF4 Kw_Ws16 300.0000 Vel 0.00 300.0000 FORMAT "%8.4" EXTENDED_LIMITS -327.6800 327.6700 /end CHARACTERISTIC
/begin CHARACTERISTIC CrCtl_vResBlwGear4IWinNeg_C "PI-Reglerparametersatz für WA+ 4.Gang" VALUE 0xCADF6 Kw_Ws16 300.0000 Vel -300.0000 0.00 FORMAT "%8.4" EXTENDED_LIMITS -327.6800 327.6700 /end CHARACTERISTIC
/begin CHARACTERISTIC CrCtl_ResBlwGear4PKp_C "PI-Reglerparametersatz für WA+ 4.Gang" VALUE 0xCADF8 Kw_Wu32 1310719.99969 Kp_Vel2TrqPrp 0.00 1310719.99969 FORMAT "%13.5" /end CHARACTERISTIC
/begin CHARACTERISTIC CrCtl_ResBlwGear4PKpPos_C "PI-Reglerparametersatz für WA+ 4.Gang" VALUE 0xCADFC Kw_Wu32 1310719.99969 Kp_Vel2TrqPrp 0.00 1310719.99969 FORMAT "%13.5" /end CHARACTERISTIC
/begin CHARACTERISTIC CrCtl_ResBlwGear4PKpNeg_C "PI-Reglerparametersatz für WA+ 4.Gang" VALUE 0xCAE00 Kw_Wu32 1310719.99969 Kp_Vel2TrqPrp 0.00 1310719.99969 FORMAT "%13.5" /end CHARACTERISTIC
/begin CHARACTERISTIC CrCtl_vResBlwGear4PWinPos_C "PI-Reglerparametersatz für WA+ 4.Gang" VALUE 0xCAE04 Kw_Ws16 300.0000 Vel 0.00 300.0000 FORMAT "%8.4" EXTENDED_LIMITS -327.6800 327.6700 /end CHARACTERISTIC
/begin CHARACTERISTIC CrCtl_vResBlwGear4PWinNeg_C "PI-Reglerparametersatz für WA+ 4.Gang" VALUE 0xCAE06 Kw_Ws16 300.0000 Vel -300.0000 0.00 FORMAT "%8.4" EXTENDED_LIMITS -327.6800 327.6700 /end CHARACTERISTIC
/begin CHARACTERISTIC CrCtl_ResBlwGear5IKi_C "PI-Reglerparametersatz für WA+ 5.Gang" VALUE 0xCAE08 Kw_Wu32 19999999.9953 Ki_Vel2TrqPrp 0.00 19999999.9953 FORMAT "%13.4" /end CHARACTERISTIC
/begin CHARACTERISTIC CrCtl_ResBlwGear5IKiPos_C "PI-Reglerparametersatz für WA+ 5.Gang" VALUE 0xCAE0C Kw_Wu32 19999999.9953 Ki_Vel2TrqPrp 0.00 19999999.9953 FORMAT "%13.4" /end CHARACTERISTIC
/begin CHARACTERISTIC CrCtl_ResBlwGear5IKiNeg_C "PI-Reglerparametersatz für WA+ 5.Gang" VALUE 0xCAE10 Kw_Wu32 19999999.9953 Ki_Vel2TrqPrp 0.00 19999999.9953 FORMAT "%13.4" /end CHARACTERISTIC
/begin CHARACTERISTIC CrCtl_vResBlwGear5IWinPos_C "PI-Reglerparametersatz für WA+ 5.Gang" VALUE 0xCAE14 Kw_Ws16 300.0000 Vel 0.00 300.0000 FORMAT "%8.4" EXTENDED_LIMITS -327.6800 327.6700 /end CHARACTERISTIC
/begin CHARACTERISTIC CrCtl_vResBlwGear5IWinNeg_C "PI-Reglerparametersatz für WA+ 5.Gang" VALUE 0xCAE16 Kw_Ws16 300.0000 Vel -300.0000 0.00 FORMAT "%8.4" EXTENDED_LIMITS -327.6800 327.6700 /end CHARACTERISTIC
/begin CHARACTERISTIC CrCtl_ResBlwGear5PKp_C "PI-Reglerparametersatz für WA+ 5.Gang" VALUE 0xCAE18 Kw_Wu32 1310719.99969 Kp_Vel2TrqPrp 0.00 1310719.99969 FORMAT "%13.5" /end CHARACTERISTIC
/begin CHARACTERISTIC CrCtl_ResBlwGear5PKpPos_C "PI-Reglerparametersatz für WA+ 5.Gang" VALUE 0xCAE1C Kw_Wu32 1310719.99969 Kp_Vel2TrqPrp 0.00 1310719.99969 FORMAT "%13.5" /end CHARACTERISTIC
/begin CHARACTERISTIC CrCtl_ResBlwGear5PKpNeg_C "PI-Reglerparametersatz für WA+ 5.Gang" VALUE 0xCAE20 Kw_Wu32 1310719.99969 Kp_Vel2TrqPrp 0.00 1310719.99969 FORMAT "%13.5" /end CHARACTERISTIC
/begin CHARACTERISTIC CrCtl_vResBlwGear5PWinPos_C "PI-Reglerparametersatz für WA+ 5.Gang" VALUE 0xCAE24 Kw_Ws16 300.0000 Vel 0.00 300.0000 FORMAT "%8.4" EXTENDED_LIMITS -327.6800 327.6700 /end CHARACTERISTIC
/begin CHARACTERISTIC CrCtl_vResBlwGear5PWinNeg_C "PI-Reglerparametersatz für WA+ 5.Gang" VALUE 0xCAE26 Kw_Ws16 300.0000 Vel -300.0000 0.00 FORMAT "%8.4" EXTENDED_LIMITS -327.6800 327.6700 /end CHARACTERISTIC
/begin CHARACTERISTIC CrCtl_ResBlwGear6IKi_C "PI-Reglerparametersatz für WA+ 6.Gang" VALUE 0xCAE28 Kw_Wu32 19999999.9953 Ki_Vel2TrqPrp 0.00 19999999.9953 FORMAT "%13.4" /end CHARACTERISTIC
/begin CHARACTERISTIC CrCtl_ResBlwGear6IKiPos_C "PI-Reglerparametersatz für WA+ 6.Gang" VALUE 0xCAE2C Kw_Wu32 19999999.9953 Ki_Vel2TrqPrp 0.00 19999999.9953 FORMAT "%13.4" /end CHARACTERISTIC
/begin CHARACTERISTIC CrCtl_ResBlwGear6IKiNeg_C "PI-Reglerparametersatz für WA+ 6.Gang" VALUE 0xCAE30 Kw_Wu32 19999999.9953 Ki_Vel2TrqPrp 0.00 19999999.9953 FORMAT "%13.4" /end CHARACTERISTIC
/begin CHARACTERISTIC CrCtl_vResBlwGear6IWinPos_C "PI-Reglerparametersatz für WA+ 6.Gang" VALUE 0xCAE34 Kw_Ws16 300.0000 Vel 0.00 300.0000 FORMAT "%8.4" EXTENDED_LIMITS -327.6800 327.6700 /end CHARACTERISTIC
/begin CHARACTERISTIC CrCtl_vResBlwGear6IWinNeg_C "PI-Reglerparametersatz für WA+ 6.Gang" VALUE 0xCAE36 Kw_Ws16 300.0000 Vel -300.0000 0.00 FORMAT "%8.4" EXTENDED_LIMITS -327.6800 327.6700 /end CHARACTERISTIC
/begin CHARACTERISTIC CrCtl_ResBlwGear6PKp_C "PI-Reglerparametersatz für WA+ 6.Gang" VALUE 0xCAE38 Kw_Wu32 1310719.99969 Kp_Vel2TrqPrp 0.00 1310719.99969 FORMAT "%13.5" /end CHARACTERISTIC
/begin CHARACTERISTIC CrCtl_ResBlwGear6PKpPos_C "PI-Reglerparametersatz für WA+ 6.Gang" VALUE 0xCAE3C Kw_Wu32 1310719.99969 Kp_Vel2TrqPrp 0.00 1310719.99969 FORMAT "%13.5" /end CHARACTERISTIC
/begin CHARACTERISTIC CrCtl_ResBlwGear6PKpNeg_C "PI-Reglerparametersatz für WA+ 6.Gang" VALUE 0xCAE40 Kw_Wu32 1310719.99969 Kp_Vel2TrqPrp 0.00 1310719.99969 FORMAT "%13.5" /end CHARACTERISTIC
/begin CHARACTERISTIC CrCtl_vResBlwGear6PWinPos_C "PI-Reglerparametersatz für WA+ 6.Gang" VALUE 0xCAE44 Kw_Ws16 300.0000 Vel 0.00 300.0000 FORMAT "%8.4" EXTENDED_LIMITS -327.6800 327.6700 /end CHARACTERISTIC
/begin CHARACTERISTIC CrCtl_vResBlwGear6PWinNeg_C "PI-Reglerparametersatz für WA+ 6.Gang" VALUE 0xCAE46 Kw_Ws16 300.0000 Vel -300.0000 0.00 FORMAT "%8.4" EXTENDED_LIMITS -327.6800 327.6700 /end CHARACTERISTIC
/begin CHARACTERISTIC CrCtl_ResRmpGear2PKp_C "P-Reglerparametersatz für WA 2.Gang" VALUE 0xCAE48 Kw_Wu32 1310719.99969 Kp_Vel2TrqPrp 0.00 1310719.99969 FORMAT "%13.5" /end CHARACTERISTIC
/begin CHARACTERISTIC CrCtl_ResRmpGear2PKpPos_C "P-Reglerparametersatz für WA 2.Gang" VALUE 0xCAE4C Kw_Wu32 1310719.99969 Kp_Vel2TrqPrp 0.00 1310719.99969 FORMAT "%13.5" /end CHARACTERISTIC
/begin CHARACTERISTIC CrCtl_ResRmpGear2PKpNeg_C "P-Reglerparametersatz für WA 2.Gang" VALUE 0xCAE50 Kw_Wu32 1310719.99969 Kp_Vel2TrqPrp 0.00 1310719.99969 FORMAT "%13.5" /end CHARACTERISTIC
/begin CHARACTERISTIC CrCtl_vResRmpGear2PWinPos_C "P-Reglerparametersatz für WA 2.Gang" VALUE 0xCAE54 Kw_Ws16 300.0000 Vel 0.00 300.0000 FORMAT "%8.4" EXTENDED_LIMITS -327.6800 327.6700 /end CHARACTERISTIC
/begin CHARACTERISTIC CrCtl_vResRmpGear2PWinNeg_C "P-Reglerparametersatz für WA 2.Gang" VALUE 0xCAE56 Kw_Ws16 300.0000 Vel -300.0000 0.00 FORMAT "%8.4" EXTENDED_LIMITS -327.6800 327.6700 /end CHARACTERISTIC
/begin CHARACTERISTIC CrCtl_ResRmpGear3PKp_C "P-Reglerparametersatz für WA 3.Gang" VALUE 0xCAE58 Kw_Wu32 1310719.99969 Kp_Vel2TrqPrp 0.00 1310719.99969 FORMAT "%13.5" /end CHARACTERISTIC
/begin CHARACTERISTIC CrCtl_ResRmpGear3PKpPos_C "P-Reglerparametersatz für WA 3.Gang" VALUE 0xCAE5C Kw_Wu32 1310719.99969 Kp_Vel2TrqPrp 0.00 1310719.99969 FORMAT "%13.5" /end CHARACTERISTIC
/begin CHARACTERISTIC CrCtl_ResRmpGear3PKpNeg_C "P-Reglerparametersatz für WA 3.Gang" VALUE 0xCAE60 Kw_Wu32 1310719.99969 Kp_Vel2TrqPrp 0.00 1310719.99969 FORMAT "%13.5" /end CHARACTERISTIC
/begin CHARACTERISTIC CrCtl_vResRmpGear3PWinPos_C "P-Reglerparametersatz für WA 3.Gang" VALUE 0xCAE64 Kw_Ws16 300.0000 Vel 0.00 300.0000 FORMAT "%8.4" EXTENDED_LIMITS -327.6800 327.6700 /end CHARACTERISTIC
/begin CHARACTERISTIC CrCtl_vResRmpGear3PWinNeg_C "P-Reglerparametersatz für WA 3.Gang" VALUE 0xCAE66 Kw_Ws16 300.0000 Vel -300.0000 0.00 FORMAT "%8.4" EXTENDED_LIMITS -327.6800 327.6700 /end CHARACTERISTIC
/begin CHARACTERISTIC CrCtl_ResRmpGear4PKp_C "P-Reglerparametersatz für WA 4.Gang" VALUE 0xCAE68 Kw_Wu32 1310719.99969 Kp_Vel2TrqPrp 0.00 1310719.99969 FORMAT "%13.5" /end CHARACTERISTIC
/begin CHARACTERISTIC CrCtl_ResRmpGear4PKpPos_C "P-Reglerparametersatz für WA 4.Gang" VALUE 0xCAE6C Kw_Wu32 1310719.99969 Kp_Vel2TrqPrp 0.00 1310719.99969 FORMAT "%13.5" /end CHARACTERISTIC
/begin CHARACTERISTIC CrCtl_ResRmpGear4PKpNeg_C "P-Reglerparametersatz für WA 4.Gang" VALUE 0xCAE70 Kw_Wu32 1310719.99969 Kp_Vel2TrqPrp 0.00 1310719.99969 FORMAT "%13.5" /end CHARACTERISTIC
/begin CHARACTERISTIC CrCtl_vResRmpGear4PWinPos_C "P-Reglerparametersatz für WA 4.Gang" VALUE 0xCAE74 Kw_Ws16 300.0000 Vel 0.00 300.0000 FORMAT "%8.4" EXTENDED_LIMITS -327.6800 327.6700 /end CHARACTERISTIC
/begin CHARACTERISTIC CrCtl_vResRmpGear4PWinNeg_C "P-Reglerparametersatz für WA 4.Gang" VALUE 0xCAE76 Kw_Ws16 300.0000 Vel -300.0000 0.00 FORMAT "%8.4" EXTENDED_LIMITS -327.6800 327.6700 /end CHARACTERISTIC
/begin CHARACTERISTIC CrCtl_ResRmpGear5PKp_C "P-Reglerparametersatz für WA 5.Gang" VALUE 0xCAE78 Kw_Wu32 1310719.99969 Kp_Vel2TrqPrp 0.00 1310719.99969 FORMAT "%13.5" /end CHARACTERISTIC
/begin CHARACTERISTIC CrCtl_ResRmpGear5PKpPos_C "P-Reglerparametersatz für WA 5.Gang" VALUE 0xCAE7C Kw_Wu32 1310719.99969 Kp_Vel2TrqPrp 0.00 1310719.99969 FORMAT "%13.5" /end CHARACTERISTIC
/begin CHARACTERISTIC CrCtl_ResRmpGear5PKpNeg_C "P-Reglerparametersatz für WA 5.Gang" VALUE 0xCAE80 Kw_Wu32 1310719.99969 Kp_Vel2TrqPrp 0.00 1310719.99969 FORMAT "%13.5" /end CHARACTERISTIC
/begin CHARACTERISTIC CrCtl_vResRmpGear5PWinPos_C "P-Reglerparametersatz für WA 5.Gang" VALUE 0xCAE84 Kw_Ws16 300.0000 Vel 0.00 300.0000 FORMAT "%8.4" EXTENDED_LIMITS -327.6800 327.6700 /end CHARACTERISTIC
/begin CHARACTERISTIC CrCtl_vResRmpGear5PWinNeg_C "P-Reglerparametersatz für WA 5.Gang" VALUE 0xCAE86 Kw_Ws16 300.0000 Vel -300.0000 0.00 FORMAT "%8.4" EXTENDED_LIMITS -327.6800 327.6700 /end CHARACTERISTIC
/begin CHARACTERISTIC CrCtl_ResRmpGear6PKp_C "P-Reglerparametersatz für WA 6.Gang" VALUE 0xCAE88 Kw_Wu32 1310719.99969 Kp_Vel2TrqPrp 0.00 1310719.99969 FORMAT "%13.5" /end CHARACTERISTIC
/begin CHARACTERISTIC CrCtl_ResRmpGear6PKpPos_C "P-Reglerparametersatz für WA 6.Gang" VALUE 0xCAE8C Kw_Wu32 1310719.99969 Kp_Vel2TrqPrp 0.00 1310719.99969 FORMAT "%13.5" /end CHARACTERISTIC
/begin CHARACTERISTIC CrCtl_ResRmpGear6PKpNeg_C "P-Reglerparametersatz für WA 6.Gang" VALUE 0xCAE90 Kw_Wu32 1310719.99969 Kp_Vel2TrqPrp 0.00 1310719.99969 FORMAT "%13.5" /end CHARACTERISTIC
/begin CHARACTERISTIC CrCtl_vResRmpGear6PWinPos_C "P-Reglerparametersatz für WA 6.Gang" VALUE 0xCAE94 Kw_Ws16 300.0000 Vel 0.00 300.0000 FORMAT "%8.4" EXTENDED_LIMITS -327.6800 327.6700 /end CHARACTERISTIC
/begin CHARACTERISTIC CrCtl_vResRmpGear6PWinNeg_C "P-Reglerparametersatz für WA 6.Gang" VALUE 0xCAE96 Kw_Ws16 300.0000 Vel -300.0000 0.00 FORMAT "%8.4" EXTENDED_LIMITS -327.6800 327.6700 /end CHARACTERISTIC
/begin CHARACTERISTIC CrCtl_rVnDvtShutOff_C "Abweichung v/n-Verhältnis Abschalten FGR" VALUE 0xCA93C Kw_Ws16 0.3276700 VelToN 0.00 0.3276700 FORMAT "%9.7" EXTENDED_LIMITS -0.3276800 0.3276700 /end CHARACTERISTIC
/begin CHARACTERISTIC CrCtl_stShutOffCodeMsk_C "#SSD Bitmaske zum Ausmaskieren von FGR-Abschaltbedingungen" VALUE 0xCA940 Kw_Wu32 4294967295.00 OneToOne 0.00 4294967295.00 FORMAT "%13.2" /end CHARACTERISTIC
/begin CHARACTERISTIC CrCtl_stShutOffHDC_C "Shutoff of Hill descent Control" VALUE 0xCA944 Kw_Wu8 255.0 OneToOne 0.00 255.0 FORMAT "%5.1" /end CHARACTERISTIC
/begin CHARACTERISTIC CrCtl_stShutOffInfoLR_C "informationswert zum ausschalten bei zu geringem abstand" VALUE 0xCA945 Kw_Wu8 255.0 OneToOne 0.00 255.0 FORMAT "%5.1" /end CHARACTERISTIC
/begin CHARACTERISTIC CrCtl_stShutOffLR_C "Application data for shutoff of LR" VALUE 0xCA946 Kw_Wu8 255.0 OneToOne 0.00 255.0 FORMAT "%5.1" /end CHARACTERISTIC
/begin CHARACTERISTIC CrCtl_swtCrCtlType_C "Schalter um Typ des Tempomats auszuwählen (1: herkömmlicher Tempomat, 2: Stufentempomat)" VALUE 0xCAEDA Kw_Wu8 255.0 OneToOne 0.00 255.0 FORMAT "%5.1" /end CHARACTERISTIC
/begin CHARACTERISTIC CrCtl_swtOffset_C "Umschaltung zwischen gesendeter und berechneter Anzeigegeschwindigkeit (1: berechnete, 0: gesendete)" VALUE 0xCAEDB Kw_Wu8 255.0 OneToOne 0.00 255.0 FORMAT "%5.1" /end CHARACTERISTIC
/begin CHARACTERISTIC CrCtl_swtResOff_C "0...keine Wiederaufnahme im Stufentemp. Zustand OFF; 1...Wiederaufnahme im Stufentempomat-Zustand OFF erlaubt" VALUE 0xCAE98 Kw_Wu8 255.0 OneToOne 0.00 255.0 FORMAT "%5.1" /end CHARACTERISTIC
/begin CHARACTERISTIC CrCtl_swtSelKombi_C "Schalter zur Auswahl des Kombi-Typs (1: standard, 0: alte version)" VALUE 0xCA947 Kw_Wu8 255.0 OneToOne 0.00 255.0 FORMAT "%5.1" /end CHARACTERISTIC
/begin CHARACTERISTIC CrCtl_swtShutOffOpt_C "Optionen Abschaltung FGR (bit 0: 1: Ansteuerung der Bremse vor Fahrgeschwindigkeitstest, 0: kein Ansteuern; bit1-7: ungebraucht)" VALUE 0xCA948 Kw_Wu8 255.0 OneToOne 0.00 255.0 FORMAT "%5.1" /end CHARACTERISTIC
/begin CHARACTERISTIC CrCtl_swtVSSFil_C "Schalter zur Auswahl zwischen gefilterter und ungefilterter Fahrzeug-Ist-Geschwindigkeit (1: gefiltert 0: ungefiltert)" VALUE 0xCAEDC Kw_Wu8 255.0 OneToOne 0.00 255.0 FORMAT "%5.1" /end CHARACTERISTIC
/begin CHARACTERISTIC CrCtl_tiAcc_C "Maximalzeit für Abschaltbedingung ""zu große Beschleunigung""" VALUE 0xCA94A Kw_Wu16 655350.0 TimeDeb 0.00 655350.0 FORMAT "%8.1" /end CHARACTERISTIC
/begin CHARACTERISTIC CrCtl_tiAqpl_C "Maximalzeit für Aquaplaningerkennung" VALUE 0xCA94C Kw_Wu16 655350.0 TimeDeb 0.00 655350.0 FORMAT "%8.1" /end CHARACTERISTIC
/begin CHARACTERISTIC CrCtl_tiClCtrDelayABS_C "Entprellung der FGR-Abschaltung bei ABS-Eingriff" VALUE 0xCA94E Kw_Wu16 655350.0 TimeDeb 0.00 655350.0 FORMAT "%8.1" /end CHARACTERISTIC
/begin CHARACTERISTIC CrCtl_tiClCtrDelayASC_C "debounce time for ASC intervention" VALUE 0xCA950 Kw_Wu16 655350.0 TimeDeb 0.00 655350.0 FORMAT "%8.1" /end CHARACTERISTIC
/begin CHARACTERISTIC CrCtl_tiClCtrDelayDSC_C "debounce time for DSC intervention" VALUE 0xCA952 Kw_Wu16 655350.0 TimeDeb 0.00 655350.0 FORMAT "%8.1" /end CHARACTERISTIC
/begin CHARACTERISTIC CrCtl_tiClCtrDelayEBV_C "Entprellung der FGR-Abschaltung bei EBV-Eingriff" VALUE 0xCA954 Kw_Wu16 655350.0 TimeDeb 0.00 655350.0 FORMAT "%8.1" /end CHARACTERISTIC
/begin CHARACTERISTIC CrCtl_tiClCtrDelayHBA_C "Entprellung der FGR-Abschaltung bei HBA-Eingriff" VALUE 0xCA956 Kw_Wu16 655350.0 TimeDeb 0.00 655350.0 FORMAT "%8.1" /end CHARACTERISTIC
/begin CHARACTERISTIC CrCtl_tiClCtrDelayMSR_C "debounce time for MSR intervention" VALUE 0xCA958 Kw_Wu16 655350.0 TimeDeb 0.00 655350.0 FORMAT "%8.1" /end CHARACTERISTIC
/begin CHARACTERISTIC CrCtl_tiDec_C "Entprellzeit zu große Fahrzeugverzögerung für Abschaltung FGR" VALUE 0xCA95A Kw_Wu16 655350.0 TimeDeb 0.00 655350.0 FORMAT "%8.1" /end CHARACTERISTIC
/begin CHARACTERISTIC CrCtl_tiDisableDiagVCrCtl_C "Time to disable cruise control diagnostics" VALUE 0xCAEE0 Kw_Wu32 42949672950.0 Time_ms 0.00 42949672950.0 FORMAT "%13.1" /end CHARACTERISTIC
/begin CHARACTERISTIC CrCtl_tiDispOffFil_C "time delay for tracking speed set point" VALUE 0xCAEE4 Kw_Wu32 4294.9673 TimeDelay_s 0.0000010000000 4294.9673 FORMAT "%9.4" /end CHARACTERISTIC
/begin CHARACTERISTIC CrCtl_tiGearDeb_C "Entprellzeit neuer Gang für FGR" VALUE 0xCA95C Kw_Wu16 655350.0 TimeDeb 0.00 655350.0 FORMAT "%8.1" /end CHARACTERISTIC
/begin CHARACTERISTIC CrCtl_tiNegDvtTi_C "Entprellzeit zu große neg. Geschwindigkeitsabweichung für Abschaltung FGR" VALUE 0xCA95E Kw_Wu16 655350.0 TimeDeb 0.00 655350.0 FORMAT "%8.1" /end CHARACTERISTIC
/begin CHARACTERISTIC CrCtl_tiOff_C "Dauer zum niederrampen zum gewünschten Drehmoment" VALUE 0xCAE9A Kw_Wu16 655350.0 TimeDeb 0.00 655350.0 FORMAT "%8.1" /end CHARACTERISTIC
/begin CHARACTERISTIC CrCtl_tiTipUpDn_C "Erkennungszeit TIP-UP/DOWN" VALUE 0xCAE9C Kw_Wu16 655350.0 Time_ms 0.00 655350.0 FORMAT "%8.1" /end CHARACTERISTIC
/begin CHARACTERISTIC CrCtl_tiVSSFil2_C "" VALUE 0xCAEE8 Kw_Wu32 4294.9673 TimeDelay_s 0.0000010000000 4294.9673 FORMAT "%9.4" /end CHARACTERISTIC
/begin CHARACTERISTIC CrCtl_tiVSSFil_C "time delay for tracking speed set point" VALUE 0xCAEEC Kw_Wu32 4294.9673 TimeDelay_s 0.0000010000000 4294.9673 FORMAT "%9.4" /end CHARACTERISTIC
/begin CHARACTERISTIC CrCtl_trqDesThres_C "Momentenschwelle zur Entscheidung der Momentenrampensteigung zur Momentenreduzierung nach SET+" VALUE 0xCAE9E Kw_Ws16 500.0000 TrqPrp 0.00 500.0000 FORMAT "%8.4" EXTENDED_LIMITS -6553.600 6553.400 /end CHARACTERISTIC
/begin CHARACTERISTIC CrCtl_trqDes_Vector "#SSD Bypass label, nicht editieren!" VALUE 0xC3936 Kw_Wu8 255.0 OneToOne 0.00 255.0 FORMAT "%5.1" /end CHARACTERISTIC
/begin CHARACTERISTIC CrCtl_trqDes_Channel "#SSD Bypass label, nicht editieren!" VALUE 0xC3937 Kw_Wu8 255.0 OneToOne 0.00 255.0 FORMAT "%5.1" /end CHARACTERISTIC
/begin CHARACTERISTIC CrCtl_trqLead_Vector "#SSD Bypass label, nicht editieren!" VALUE 0xC3938 Kw_Wu8 255.0 OneToOne 0.00 255.0 FORMAT "%5.1" /end CHARACTERISTIC
/begin CHARACTERISTIC CrCtl_trqLead_Channel "#SSD Bypass label, nicht editieren!" VALUE 0xC3939 Kw_Wu8 255.0 OneToOne 0.00 255.0 FORMAT "%5.1" /end CHARACTERISTIC
/begin CHARACTERISTIC CrCtl_trqMaxOfs_C "Offset auf maximales Moment CoDT_trqMax" VALUE 0xCAEA0 Kw_Ws16 500.0000 TrqPrp 0.00 500.0000 FORMAT "%8.4" EXTENDED_LIMITS -6553.600 6553.400 /end CHARACTERISTIC
/begin CHARACTERISTIC CrCtl_trqOffComf_C "Momentenschwelle für Umschaltung der Rampensteigung bei Komfortabschaltung" VALUE 0xCAEA2 Kw_Ws16 11000.00 TrqPrp -5000.000 6000.000 FORMAT "%8.3" EXTENDED_LIMITS -6553.600 6553.400 /end CHARACTERISTIC
/begin CHARACTERISTIC CrCtl_trqOffFast12_C "Umschaltschwelle von Rampe 1 auf Rampe 2" VALUE 0xCAEA4 Kw_Ws16 11000.00 TrqPrp -5000.000 6000.000 FORMAT "%8.3" EXTENDED_LIMITS -6553.600 6553.400 /end CHARACTERISTIC
/begin CHARACTERISTIC CrCtl_trqOffFast23_C "Umschaltschwelle von Rampe 2 auf Rampe 3" VALUE 0xCAEA6 Kw_Ws16 11000.00 TrqPrp -5000.000 6000.000 FORMAT "%8.3" EXTENDED_LIMITS -6553.600 6553.400 /end CHARACTERISTIC
/begin CHARACTERISTIC CrCtl_uBattMin_C "min batteriespannung" VALUE 0xCAEF0 Kw_Ws16 1281232. Volt_Batt -640625.6 640606.1 FORMAT "%8.1" /end CHARACTERISTIC
/begin CHARACTERISTIC CrCtl_vAccSet_C "Setzwertkorrektur nach SET+" VALUE 0xCAEA8 Kw_Ws16 300.0000 Vel 0.00 300.0000 FORMAT "%8.4" EXTENDED_LIMITS -327.6800 327.6700 /end CHARACTERISTIC
/begin CHARACTERISTIC CrCtl_vAlwDvtThres_C "zulässige Regelabweichung für TIP-UP/DOWN FGR" VALUE 0xCAEAA Kw_Ws16 300.0000 Vel 0.00 300.0000 FORMAT "%8.4" EXTENDED_LIMITS -327.6800 327.6700 /end CHARACTERISTIC
/begin CHARACTERISTIC CrCtl_vAlwMaxKm_C "maximal erlaubte FGR-geschw." VALUE 0xCAEF2 Kw_Ws16 300.0000 Vel 0.00 300.0000 FORMAT "%8.4" EXTENDED_LIMITS -327.6800 327.6700 /end CHARACTERISTIC
/begin CHARACTERISTIC CrCtl_vAlwMaxMPH_C "max. erlaubte FGR-Geschwindigkeit bei mph-Kodierung" VALUE 0xCAEF4 Kw_Ws16 300.0000 Vel 0.00 300.0000 FORMAT "%8.4" EXTENDED_LIMITS -327.6800 327.6700 /end CHARACTERISTIC
/begin CHARACTERISTIC CrCtl_vAlwMinKm_C "min. erlaubte FGR-geschwindigkeit" VALUE 0xCAEF6 Kw_Ws16 300.0000 Vel 0.00 300.0000 FORMAT "%8.4" EXTENDED_LIMITS -327.6800 327.6700 /end CHARACTERISTIC
/begin CHARACTERISTIC CrCtl_vAlwMinMPH_C "min. erlaubte FGR-Geschwindigkeit bei mph-Kodierung" VALUE 0xCAEF8 Kw_Ws16 300.0000 Vel 0.00 300.0000 FORMAT "%8.4" EXTENDED_LIMITS -327.6800 327.6700 /end CHARACTERISTIC
/begin CHARACTERISTIC CrCtl_vDeclSet_C "Setzwertkorrektur nach SET-" VALUE 0xCAEAC Kw_Ws16 300.0000 Vel 0.00 300.0000 FORMAT "%8.4" EXTENDED_LIMITS -327.6800 327.6700 /end CHARACTERISTIC
/begin CHARACTERISTIC CrCtl_vDiffAccMax_C "Geschwindigkeitsschwelle für Setzwertkorrektur nach SET+" VALUE 0xCAEAE Kw_Ws16 300.0000 Vel 0.00 300.0000 FORMAT "%8.4" EXTENDED_LIMITS -327.6800 327.6700 /end CHARACTERISTIC
/begin CHARACTERISTIC CrCtl_vDiffAcc_C "Geschwindigkeitsoffset für doppelte Momentenrampensteigung bei Übergang EIN+ zu HALTEN des FGR" VALUE 0xCAEB0 Kw_Ws16 300.0000 Vel 0.00 300.0000 FORMAT "%8.4" EXTENDED_LIMITS -327.6800 327.6700 /end CHARACTERISTIC
/begin CHARACTERISTIC CrCtl_vDiffActvTrqDecHi_C "Grenze für die Regelabweichung, ab der die Momentenreduzierung aktiviert wird." VALUE 0xCAEB2 Kw_Ws16 300.0000 Vel 0.00 300.0000 FORMAT "%8.4" EXTENDED_LIMITS -327.6800 327.6700 /end CHARACTERISTIC
/begin CHARACTERISTIC CrCtl_vDiffActvTrqDecLo_C "Grenze für die Regelabweichung, ab der die Momentenreduzierung deaktiviert wird." VALUE 0xCAEB4 Kw_Ws16 300.0000 Vel 0.00 300.0000 FORMAT "%8.4" EXTENDED_LIMITS -327.6800 327.6700 /end CHARACTERISTIC
/begin CHARACTERISTIC CrCtl_vDiffAqpl_C "Geschwindigkeitsdifferenz für Aquaplaningerkennung" VALUE 0xCA960 Kw_Ws16 300.0000 Vel 0.00 300.0000 FORMAT "%8.4" EXTENDED_LIMITS -327.6800 327.6700 /end CHARACTERISTIC
/begin CHARACTERISTIC CrCtl_vDiffDeclMax_C "Geschwindigkeitsschwelle für Setzwertkorrektur nach SET-" VALUE 0xCAEB6 Kw_Ws16 300.0000 Vel 0.00 300.0000 FORMAT "%8.4" EXTENDED_LIMITS -327.6800 327.6700 /end CHARACTERISTIC
/begin CHARACTERISTIC CrCtl_vDiffDecl_C "Geschwindigkeitsoffset für doppelte Momentenrampensteigung bei Übergang EIN- zu HALTEN des FGR" VALUE 0xCAEB8 Kw_Ws16 300.0000 Vel 0.00 300.0000 FORMAT "%8.4" EXTENDED_LIMITS -327.6800 327.6700 /end CHARACTERISTIC
/begin CHARACTERISTIC CrCtl_vDiffResAbv_C "Schwelle Differenz Ist- und Sollgeschwindigkeit für Reduzierung Zielgeschwindigkeitsrampe bei WA von oben" VALUE 0xCAEBA Kw_Ws16 300.0000 Vel 0.00 300.0000 FORMAT "%8.4" EXTENDED_LIMITS -327.6800 327.6700 /end CHARACTERISTIC
/begin CHARACTERISTIC CrCtl_vDiffResBlw_C "Schwelle Differenz Ist- und Sollgeschwindigkeit für Reduzierung Zielgeschwindigkeitsrampe bei WA von unten" VALUE 0xCAEBC Kw_Ws16 300.0000 Vel 0.00 300.0000 FORMAT "%8.4" EXTENDED_LIMITS -327.6800 327.6700 /end CHARACTERISTIC
/begin CHARACTERISTIC CrCtl_vDvtNegSwtToResAbv_C "Größte  zulässige negative Regelabweichung bevor Umschaltung in Zustand RESUME from above statt findet." VALUE 0xCAEBE Kw_Ws16 300.0000 Vel 0.00 300.0000 FORMAT "%8.4" EXTENDED_LIMITS -327.6800 327.6700 /end CHARACTERISTIC
/begin CHARACTERISTIC CrCtl_vDvtNegTipDwn_C "FGR: zulässige negative Regelabweichung TIP-DWN" VALUE 0xCAEC0 Kw_Ws16 300.0000 Vel 0.00 300.0000 FORMAT "%8.4" EXTENDED_LIMITS -327.6800 327.6700 /end CHARACTERISTIC
/begin CHARACTERISTIC CrCtl_vDvtNegTipUp_C "FGR: zulässige negative Regelabweichung TIP-UP" VALUE 0xCAEC2 Kw_Ws16 300.0000 Vel 0.00 300.0000 FORMAT "%8.4" EXTENDED_LIMITS -327.6800 327.6700 /end CHARACTERISTIC
/begin CHARACTERISTIC CrCtl_vDvtPosTipDwn_C "FGR: zulässige positive Regelabweichung TIP-DWN" VALUE 0xCAEC4 Kw_Ws16 300.0000 Vel 0.00 300.0000 FORMAT "%8.4" EXTENDED_LIMITS -327.6800 327.6700 /end CHARACTERISTIC
/begin CHARACTERISTIC CrCtl_vHypDenom_C "Nenner-Summand des hyperbolischen Faktors zur Abschwächung des Reduktionsmomentes im Zustand HOLD." VALUE 0xCAEC6 Kw_Ws16 300.0000 Vel 0.00 300.0000 FORMAT "%8.4" EXTENDED_LIMITS -327.6800 327.6700 /end CHARACTERISTIC
/begin CHARACTERISTIC CrCtl_vHypNum_C "Zähler des hyperbolischen Faktors zur Abschwächung des Reduktionsmomentes im Zustand HOLD." VALUE 0xCAEC8 Kw_Ws16 300.0000 Vel 0.00 300.0000 FORMAT "%8.4" EXTENDED_LIMITS -327.6800 327.6700 /end CHARACTERISTIC
/begin CHARACTERISTIC CrCtl_vMaxShutOff_C "obere Grenze Fahrgeschwindigkeit Abschaltung FGR" VALUE 0xCA962 Kw_Ws16 300.0000 Vel 0.00 300.0000 FORMAT "%8.4" EXTENDED_LIMITS -327.6800 327.6700 /end CHARACTERISTIC
/begin CHARACTERISTIC CrCtl_vMinShutOff_C "untere Grenze Fahrgeschwindigkeit Abschaltung FGR" VALUE 0xCA964 Kw_Ws16 300.0000 Vel 0.00 300.0000 FORMAT "%8.4" EXTENDED_LIMITS -327.6800 327.6700 /end CHARACTERISTIC
/begin CHARACTERISTIC CrCtl_vNegDvtTi_C "negative Geschwindigkeitsabweichung Abschaltung FGR nach Entprellzeit" VALUE 0xCA966 Kw_Ws16 300.0000 Vel 0.00 300.0000 FORMAT "%8.4" EXTENDED_LIMITS -327.6800 327.6700 /end CHARACTERISTIC
/begin CHARACTERISTIC CrCtl_vNegDvt_C "negative Geschwindigkeitsabweichung Abschaltung FGR" VALUE 0xCA968 Kw_Ws16 300.0000 Vel 0.00 300.0000 FORMAT "%8.4" EXTENDED_LIMITS -327.6800 327.6700 /end CHARACTERISTIC
/begin CHARACTERISTIC CrCtl_vOffMax_C "Maximum velocity of cruise control" VALUE 0xCAEFA Kw_Ws16 300.0000 Vel 0.00 300.0000 FORMAT "%8.4" EXTENDED_LIMITS -327.6800 327.6700 /end CHARACTERISTIC
/begin CHARACTERISTIC CrCtl_vOfsDecl_C "neg. Offset für Sollgeschwindigkeit für Übergang EIN- zu HALTEN des FGR" VALUE 0xCAECA Kw_Ws16 300.0000 Vel 0.00 300.0000 FORMAT "%8.4" EXTENDED_LIMITS -327.6800 327.6700 /end CHARACTERISTIC
/begin CHARACTERISTIC CrCtl_vOfsResBlw_C "Geschwindigkeitsoffset für Übergang WA+ --> Konstantfahrt" VALUE 0xCAECC Kw_Ws16 300.0000 Vel 0.00 300.0000 FORMAT "%8.4" EXTENDED_LIMITS -327.6800 327.6700 /end CHARACTERISTIC
/begin CHARACTERISTIC CrCtl_vOfsRes_C "Offset FGR-Sollgeschwindigkeit für Übergang WA zu HALTEN" VALUE 0xCAECE Kw_Ws16 300.0000 Vel 0.00 300.0000 FORMAT "%8.4" EXTENDED_LIMITS -327.6800 327.6700 /end CHARACTERISTIC
/begin CHARACTERISTIC CrCtl_vPosDvt_C "positive Geschwindigkeitsabweichung Abschaltung FGR" VALUE 0xCA96A Kw_Ws16 300.0000 Vel 0.00 300.0000 FORMAT "%8.4" EXTENDED_LIMITS -327.6800 327.6700 /end CHARACTERISTIC
/begin CHARACTERISTIC CrCtl_vRlsOfsI_C "FGR, Offset-Schwellwert für Freigabe Integrator" VALUE 0xCAED0 Kw_Ws16 300.0000 Vel 0.00 300.0000 FORMAT "%8.4" EXTENDED_LIMITS -327.6800 327.6700 /end CHARACTERISTIC
/begin CHARACTERISTIC CrCtl_vTipStep_C "#SSD FGR TIP-UP/DOWN Geschwindigkeitsschritt" VALUE 0xCAED2 Kw_Ws16 300.0000 Vel 0.00 300.0000 FORMAT "%8.4" EXTENDED_LIMITS -327.6800 327.6700 /end CHARACTERISTIC
/begin CHARACTERISTIC CrSCD_ctGapIncs_C "#SSD Kurbelwellenkonfiguration: Anzahl der fehlenden Inkremente in der Lücke (virtuelle Inkremente)" VALUE 0xC05F2 Kw_Wu8 0.00 OneToOne 2.000 2.000 FORMAT "%5.3" EXTENDED_LIMITS 0.00 255.0 /end CHARACTERISTIC
/begin CHARACTERISTIC CrSCD_ctGaps_C "#SSD Kurbelwellenkonfiguration: Anzahl der Lücken auf dem Inkrementgeberrad" VALUE 0xC05F3 Kw_Wu8 3.000 OneToOne 1.000 4.000 FORMAT "%5.3" EXTENDED_LIMITS 0.00 255.0 /end CHARACTERISTIC
/begin CHARACTERISTIC CrSCD_ctIncs_C "#SSD Kurbelwellenkonfiguration: Anzahl der Inkremente einschließlich virtueller Lückenzähne" VALUE 0xC05F4 Kw_Wu8 110.0 OneToOne 10.00 120.0 FORMAT "%5.1" EXTENDED_LIMITS 0.00 255.0 /end CHARACTERISTIC
/begin CHARACTERISTIC CrSCD_ctThresCtlMin_C "#SSD Kleinste Schwelle der dyn. Schwellennachführung des Kurbelwellensignals" VALUE 0xC05EC Kw_Wu8 7.000 OneToOne 0.00 7.000 FORMAT "%5.3" EXTENDED_LIMITS 0.00 255.0 /end CHARACTERISTIC
/begin CHARACTERISTIC CrSCD_ctTurns_C "#SSD Anzahl der Kurbelwellenumdrehungen pro Nockenwellenumdrehung (1 = 2 Takter, 2 = 4 Takter)" VALUE 0xC05DA Kw_Wu8 1.000 OneToOne 1.000 2.000 FORMAT "%5.3" EXTENDED_LIMITS 0.00 255.0 /end CHARACTERISTIC
/begin CHARACTERISTIC CrSCD_facGapPlausHigh_CUR "#SSD Verhältnis zur Bestimmung der oberen Grenze des Fensters zur Lückenplausibilisierung des Inkrementsignals" CURVE 0xCAF3C Kl_Xs16_Ws16 3.000000 Fact_Inc 3.000000 6.000000 FORMAT "%8.6" EXTENDED_LIMITS -128.0000 127.9961
 /begin AXIS_DESCR STD_AXIS CrSCD_tiIncr TimeDT 10 100.0000 32767.00 FORMAT "%8.2" EXTENDED_LIMITS 0.00 65535.00 DEPOSIT ABSOLUTE /end AXIS_DESCR
/end CHARACTERISTIC
/begin CHARACTERISTIC CrSCD_facGapPlausLow_CUR "#SSD Verhältnis zur Bestimmung der unteren Grenze des Fensters zur Lückenplausibilisierung des Inkrementsignals" CURVE 0xCAF66 Kl_Xs16_Ws16 3.000000 Fact_Inc 0.00 3.000000 FORMAT "%8.6" EXTENDED_LIMITS -128.0000 127.9961
 /begin AXIS_DESCR STD_AXIS CrSCD_tiIncr TimeDT 10 100.0000 32767.00 FORMAT "%8.2" EXTENDED_LIMITS 0.00 65535.00 DEPOSIT ABSOLUTE /end AXIS_DESCR
/end CHARACTERISTIC
/begin CHARACTERISTIC CrSCD_facIncPlausHigh_CUR "#SSD Verhältnis zur Bestimmung der obere Grenze des Fensters zur Plausibilisierung des Inkrementsignals" CURVE 0xCAF90 Kl_Xs16_Ws16 1.000000 Fact_Inc 1.000000 2.000000 FORMAT "%8.6" EXTENDED_LIMITS -128.0000 127.9961
 /begin AXIS_DESCR STD_AXIS CrSCD_tiIncr TimeDT 10 100.0000 32767.00 FORMAT "%8.2" EXTENDED_LIMITS 0.00 65535.00 DEPOSIT ABSOLUTE /end AXIS_DESCR
/end CHARACTERISTIC
/begin CHARACTERISTIC CrSCD_facIncPlausLow_CUR "#SSD Verhältnis zur Bestimmung der unteren Grenze des Fensters zur Plausibilisierung des Inkrementsignals" CURVE 0xCAFBA Kl_Xs16_Ws16 1.000000 Fact_Inc 0.00 1.000000 FORMAT "%8.6" EXTENDED_LIMITS -128.0000 127.9961
 /begin AXIS_DESCR STD_AXIS CrSCD_tiIncr TimeDT 10 100.0000 32767.00 FORMAT "%8.2" EXTENDED_LIMITS 0.00 65535.00 DEPOSIT ABSOLUTE /end AXIS_DESCR
/end CHARACTERISTIC
/begin CHARACTERISTIC CrSCD_nFast_C "#SSD Frequenz für das winkelsynchrone Interruptsystem, wenn kein Inkrementsignal vorhanden" VALUE 0xC05DC Kw_Ws16 8000.000 EngN 0.00 8000.000 FORMAT "%8.3" EXTENDED_LIMITS -32768.00 32767.00 /end CHARACTERISTIC
/begin CHARACTERISTIC CrSCD_nMax_C "#SSD Größte zulässige Frequenz des Inkrementsignals" VALUE 0xC05DE Kw_Ws16 2000.000 EngN 5000.000 7000.000 FORMAT "%8.3" EXTENDED_LIMITS -32768.00 32767.00 /end CHARACTERISTIC
/begin CHARACTERISTIC CrSCD_nMin_C "#SSD Kleinste zulässige Frequenz des Inkrementsignals" VALUE 0xC05E0 Kw_Ws16 480.0000 EngN 20.00000 500.0000 FORMAT "%8.4" EXTENDED_LIMITS -32768.00 32767.00 /end CHARACTERISTIC
/begin CHARACTERISTIC CrSCD_nSlowHigh_C "#SSD Obere Drehzahlschwelle ab der das Slow-Bit für die Diahnose zurückgesetzt wird" VALUE 0xC05E2 Kw_Ws16 3000.000 EngN 0.00 3000.000 FORMAT "%8.3" EXTENDED_LIMITS -32768.00 32767.00 /end CHARACTERISTIC
/begin CHARACTERISTIC CrSCD_nSlow_C "#SSD Schwelle ab der Unterdrehzahl gemeldet wird" VALUE 0xC05E4 Kw_Ws16 1000.000 EngN 0.00 1000.000 FORMAT "%8.3" EXTENDED_LIMITS -32768.00 32767.00 /end CHARACTERISTIC
/begin CHARACTERISTIC CrSCD_nThresCtlHigh_C "#SSD Obere Schwelle zur Aktiviereung der dyn. Schwellennachführung" VALUE 0xC05EE Kw_Ws16 65535.00 EngN -32768.00 32767.00 FORMAT "%8.2" /end CHARACTERISTIC
/begin CHARACTERISTIC CrSCD_nThresCtlLow_C "#SSD Untere Schwelle zur Aktivierung der dyn. Schwellennachführung" VALUE 0xC05F0 Kw_Ws16 65535.00 EngN -32768.00 32767.00 FORMAT "%8.2" /end CHARACTERISTIC
/begin CHARACTERISTIC CrSCD_numFBCSeg_C "#SSD Anzahl der FBC segmente" VALUE 0xC05F5 Kw_Wu8 7.000 OneToOne 1.000 8.000 FORMAT "%5.3" EXTENDED_LIMITS 0.00 255.0 /end CHARACTERISTIC
/begin CHARACTERISTIC CrSCD_numShftMisf_C "#SSD Phasenverschiebung Segmentsystem für Aussetzererkennung (in MAR-Segmenten)" VALUE 0xC05E6 Kw_Wu8 1.000 OneToOne 0.00 1.000 FORMAT "%5.3" EXTENDED_LIMITS 0.00 255.0 /end CHARACTERISTIC
/begin CHARACTERISTIC CrSCD_numTDCSeg_C "#SSD Anzahl der Segment pro OT" VALUE 0xC05F6 Kw_Wu8 0.00 OneToOne 2.000 2.000 FORMAT "%5.3" EXTENDED_LIMITS 0.00 255.0 READ_ONLY /end CHARACTERISTIC
/begin CHARACTERISTIC CrSCD_phiGap2Zero_C "#SSD Winkel zwischen Lücke und physikalischer Nullposition" VALUE 0xC05F8 Kw_Ws16 720.0000 AngleCrS 0.00 720.0000 FORMAT "%8.4" EXTENDED_LIMITS -768.0000 767.9766 /end CHARACTERISTIC
/begin CHARACTERISTIC CrSCD_phiIncCor_CUR "#SSD Phasenkorrekturkennlinie des Inkrementsystems der Kurbelwelle" CURVE 0xCAF0A Kl_Xs16_Ws16 50.01562 AngleCrS -25.00781 25.00781 FORMAT "%8.5" EXTENDED_LIMITS -768.0000 767.9766
 /begin AXIS_DESCR STD_AXIS CrSCD_nAvrg EngN 12 0.00 6000.000 FORMAT "%8.3" EXTENDED_LIMITS -32768.00 32767.00 DEPOSIT ABSOLUTE /end AXIS_DESCR
/end CHARACTERISTIC
/begin CHARACTERISTIC CrSCD_phiSegLength_C "#SSD Kurbelwellenkonfiguration: Segementlänge" VALUE 0xC05E8 Kw_Ws16 90.00000 AngleCrS 30.00000 120.0000 FORMAT "%8.4" EXTENDED_LIMITS -768.0000 767.9766 /end CHARACTERISTIC
/begin CHARACTERISTIC CrSCD_phiSegPhase_C "#SSD Phasenlage der Drehzahlsegmente zum OT" VALUE 0xC05EA Kw_Ws16 720.0000 AngleCrS 0.00 720.0000 FORMAT "%8.4" EXTENDED_LIMITS -768.0000 767.9766 /end CHARACTERISTIC
/begin CHARACTERISTIC CrSCD_tiPlausCalcOff_C "#SSD Schwelle zum Abschalten der Berechnung der Plausibilitätsfenster" VALUE 0xC05FA Kw_Ws16 32767.00 TimeDT 0.00 32767.00 FORMAT "%8.2" EXTENDED_LIMITS -32768.00 32767.00 /end CHARACTERISTIC
/begin CHARACTERISTIC CWBGSTUT "0: Programmiermodus gesperrt, 1: Programmiermodus verfügbar" VALUE 0xC05C2 KwWU8 255.0 dez 0.00 255.0 FORMAT "%5.1" /end CHARACTERISTIC
/begin CHARACTERISTIC DVMARK "Mindestabstand von Geschwindigkeits-Marken beim Stufentempomat" VALUE 0xC05B0 KwWU16 655.3500 Vel 0.00 655.3500 FORMAT "%8.4" /end CHARACTERISTIC
/begin CHARACTERISTIC DVMARKMI "dvmark_w für mph-Tachometer" VALUE 0xC05B2 KwWU16 655.3500 Vel 0.00 655.3500 FORMAT "%8.4" /end CHARACTERISTIC
/begin CHARACTERISTIC DVPRG "Schrittweite bei Anzeige der Regelgeschwindigkeit im Programmiermodus" VALUE 0xC05B4 KwWU16 655.3500 Vel 0.00 655.3500 FORMAT "%8.4" /end CHARACTERISTIC
/begin CHARACTERISTIC DVPRGMI "dvprg_w für mph-Tachometer" VALUE 0xC05B6 KwWU16 655.3500 Vel 0.00 655.3500 FORMAT "%8.4" /end CHARACTERISTIC
/begin CHARACTERISTIC DVSTUTOM "Schrittweite f ür Verstellung der Zielgeschwindigkeit ohne programmierte Marken" VALUE 0xC05B8 KwWU16 655.3500 Vel 0.00 655.3500 FORMAT "%8.4" /end CHARACTERISTIC
/begin CHARACTERISTIC DVSTUTOMMI "dvstutom_w für mph - tacho" VALUE 0xC05BA KwWU16 655.3500 Vel 0.00 655.3500 FORMAT "%8.4" /end CHARACTERISTIC
/begin CHARACTERISTIC TFGRTP "Zeit für Tip-Erkennung bei FGR-Bedientasten" VALUE 0xC05C3 KwWU8 5.100 t20msxs_ub_b5p1 0.00 5.100 FORMAT "%5.3" /end CHARACTERISTIC
/begin CHARACTERISTIC TMARK "Verzögerungszeit f ür Ein- und Ausblenden der Marken mit Tipschalter Aus" VALUE 0xC05C4 KwWU8 5.100 t20msxs_ub_b5p1 0.00 5.100 FORMAT "%5.3" /end CHARACTERISTIC
/begin CHARACTERISTIC TMRKBLI "Zeit für Ein- und Ausschaltung beim Blinken der Markenanzeige" VALUE 0xC05C5 KwWU8 5.100 t20msxs_ub_b5p1 0.00 5.100 FORMAT "%5.3" /end CHARACTERISTIC
/begin CHARACTERISTIC TMSGSGTMN "min zeit zwischen zwei botschaften" VALUE 0xC05AE KwWU8 5.100 t20msxs_ub_b5p1 0.00 5.100 FORMAT "%5.3" /end CHARACTERISTIC
/begin CHARACTERISTIC TSELO "Verzögerungszeit für das Setzen und Löschen von Marken" VALUE 0xC05C6 KwWU8 5.100 t20msxs_ub_b5p1 0.00 5.100 FORMAT "%5.3" /end CHARACTERISTIC
/begin CHARACTERISTIC TVSTUTK "Verzögerungszeit kurz für Verstellung bei gehaltener Taste" VALUE 0xC05C7 KwWU8 5.100 t20msxs_ub_b5p1 0.00 5.100 FORMAT "%5.3" /end CHARACTERISTIC
/begin CHARACTERISTIC TVSTUTL "Verzögerungszeit lang für Verstellung bei gehaltener Taste" VALUE 0xC05C8 KwWU8 5.100 t20msxs_ub_b5p1 0.00 5.100 FORMAT "%5.3" /end CHARACTERISTIC
/begin CHARACTERISTIC VFGRPRG "Geschindigkeitsschwelle zum Abschalten des FGR Programmiermodus" VALUE 0xC05BC KwWU16 655.3500 Vel 0.00 655.3500 FORMAT "%8.4" /end CHARACTERISTIC
/begin CHARACTERISTIC VVEMOFS "Offset zur eingefrorenen vIst bei verzögern, ab der die v-Marke wieder zum Schleppzeiger wird" VALUE 0xC05BE KwWU16 655.3500 Vel 0.00 655.3500 FORMAT "%8.4" /end CHARACTERISTIC
/begin MEASUREMENT anzmark "Anzahl Geschwindigkeits-Marken Stufentempomat" UBYTE dez 1 100 0.00 255.0 FORMAT "%5.1" ECU_ADDRESS 0x7F89FA /end MEASUREMENT
/begin MEASUREMENT BGSTUTlokbits0 "keine Funktion" UWORD dez 1 100 0.00 65535.00 FORMAT "%8.2" ECU_ADDRESS 0x7F8AFA /end MEASUREMENT
/begin MEASUREMENT B_acc "Bedingung ACC-Steuergerät vorhanden" UBYTE B_TRUE 1 100 0.00 1.00000000000 BIT_MASK 0x1 FORMAT "%13.11" ECU_ADDRESS 0x7F87E5 /end MEASUREMENT
/begin MEASUREMENT B_acmsggts "Bed. Min. Zeit in der keine Bit gesendet wurde ist verstrichen + Ereignis aufgetreten" UBYTE B_TRUE 1 100 0.00 1.00000000000 BIT_MASK 0x1 FORMAT "%13.11" ECU_ADDRESS 0x7F87E6 /end MEASUREMENT
/begin MEASUREMENT B_besch "Bedingung FGR im Zustand Beschleunigen" UBYTE B_TRUE 1 100 0.00 1.00000000000 BIT_MASK 0x1 FORMAT "%13.11" ECU_ADDRESS 0x7F87E7 /end MEASUREMENT
/begin MEASUREMENT B_beveh "Bedingung Halten der Beschleunigen- oder Verzögerungs-Taste" UBYTE B_TRUE 1 100 0.00 1.00000000000 FORMAT "%13.11" ECU_ADDRESS 0x7F87E8 /end MEASUREMENT
/begin MEASUREMENT B_bv1 "Bedingung Bediensignal Stufentempomat Beschleunigen oder Verzögern 1. Stufe" UBYTE B_TRUE 1 100 0.00 1.00000000000 FORMAT "%13.11" ECU_ADDRESS 0x7F87E9 /end MEASUREMENT
/begin MEASUREMENT B_bv2 "Bedingung Bediensignal Stufentempomat Beschleunigen oder Verzögern 2. Stufe" UBYTE B_TRUE 1 100 0.00 1.00000000000 FORMAT "%13.11" ECU_ADDRESS 0x7F87EA /end MEASUREMENT
/begin MEASUREMENT B_cmsggts "Trigger Bit zum Senden der Botschaft" UBYTE B_TRUE 1 100 0.00 1.00000000000 BIT_MASK 0x1 FORMAT "%13.11" ECU_ADDRESS 0x7F87EB /end MEASUREMENT
/begin MEASUREMENT B_envtwa "Bedingung FGR aktiv vor Betätigung der Wiederaufnahme-Taste" UBYTE B_TRUE 1 100 0.00 1.00000000000 FORMAT "%13.11" ECU_ADDRESS 0x7F87EC /end MEASUREMENT
/begin MEASUREMENT B_ergacgt "Bedingung Ereignis (Änderung) bei Stufentempomat aufgetreten" UBYTE B_TRUE 1 100 0.00 1.00000000000 BIT_MASK 0x1 FORMAT "%13.11" ECU_ADDRESS 0x7F87ED /end MEASUREMENT
/begin MEASUREMENT B_fgrat "Bedingung: Tip-Schalter Aus am FGR-Bedienteil betätigt" UBYTE B_TRUE 1 100 0.00 1.00000000000 BIT_MASK 0x1 FORMAT "%13.11" ECU_ADDRESS 0x7F87EE /end MEASUREMENT
/begin MEASUREMENT B_fgren "Bedingung Fahrgeschwindigkeitsregelung aktiv (Enable)" UBYTE B_TRUE 1 100 0.00 1.00000000000 BIT_MASK 0x1 FORMAT "%13.11" ECU_ADDRESS 0x7F87EF /end MEASUREMENT
/begin MEASUREMENT B_fgrepa "Status in Cruise control" UBYTE B_TRUE 1 100 0.00 1.00000000000 FORMAT "%13.11" ECU_ADDRESS 0x7F87F0 /end MEASUREMENT
/begin MEASUREMENT B_fgresv "Layer" UBYTE B_TRUE 1 100 0.00 1.00000000000 BIT_MASK 0x1 FORMAT "%13.11" ECU_ADDRESS 0x7F87F1 /end MEASUREMENT
/begin MEASUREMENT B_fgrtb2 "Bedingung FGR-Taste Auswahl der nächsthöheren Zielgeschwindigkeit" UBYTE B_TRUE 1 100 0.00 1.00000000000 BIT_MASK 0x1 FORMAT "%13.11" ECU_ADDRESS 0x7F87F2 /end MEASUREMENT
/begin MEASUREMENT B_fgrtbe "Bedingung FGR-Taste Beschleunigen" UBYTE B_TRUE 1 100 0.00 1.00000000000 BIT_MASK 0x1 FORMAT "%13.11" ECU_ADDRESS 0x7F87F3 /end MEASUREMENT
/begin MEASUREMENT B_fgrtv2 "Bedingung FGR-Taste Auswahl der nächstniederen Zielgeschwindigkeit" UBYTE B_TRUE 1 100 0.00 1.00000000000 BIT_MASK 0x1 FORMAT "%13.11" ECU_ADDRESS 0x7F87F4 /end MEASUREMENT
/begin MEASUREMENT B_fgrtve "Bedingung FGR-Taste Verzöägern" UBYTE B_TRUE 1 100 0.00 1.00000000000 BIT_MASK 0x1 FORMAT "%13.11" ECU_ADDRESS 0x7F87F5 /end MEASUREMENT
/begin MEASUREMENT B_fgrtwa "Bedingung FGR-Taste Wiederaufnahme" UBYTE B_TRUE 1 100 0.00 1.00000000000 BIT_MASK 0x1 FORMAT "%13.11" ECU_ADDRESS 0x7F87F6 /end MEASUREMENT
/begin MEASUREMENT B_fgrvem "Bedingung: FGR im Zustand Verzögern (aus ME)" UBYTE B_TRUE 1 100 0.00 1.00000000000 BIT_MASK 0x1 FORMAT "%13.11" ECU_ADDRESS 0x7F87F7 /end MEASUREMENT
/begin MEASUREMENT B_insfgre "Bedingung Fehler im INST-Kombi, FGR muss abgeschaltet werden" UBYTE B_TRUE 1 100 0.00 1.00000000000 BIT_MASK 0x1 FORMAT "%13.11" ECU_ADDRESS 0x7F87F8 /end MEASUREMENT
/begin MEASUREMENT B_kl15 "Bedingung Klemme 15" UBYTE B_TRUE 1 100 0.00 1.00000000000 BIT_MASK 0x1 FORMAT "%13.11" ECU_ADDRESS 0x7F87F9 /end MEASUREMENT
/begin MEASUREMENT B_km "Bedingung CAN-Kombi-Kodierung in km/h" UBYTE B_TRUE 1 100 0.00 1.00000000000 BIT_MASK 0x1 FORMAT "%13.11" ECU_ADDRESS 0x7F87FA /end MEASUREMENT
/begin MEASUREMENT B_mmiena "Status bit" UBYTE B_TRUE 1 100 0.00 1.00000000000 BIT_MASK 0x1 FORMAT "%13.11" ECU_ADDRESS 0x7F87FB /end MEASUREMENT
/begin MEASUREMENT B_mrkbli "Bedingung Blinken der Markenanzeige" UBYTE B_TRUE 1 100 0.00 1.00000000000 FORMAT "%13.11" ECU_ADDRESS 0x7F87FC /end MEASUREMENT
/begin MEASUREMENT B_mrkein "Bedingung Anzeige Geschwindigkeits-Marken im Kombi ein" UBYTE B_TRUE 1 100 0.00 1.00000000000 BIT_MASK 0x1 FORMAT "%13.11" ECU_ADDRESS 0x7F87FD /end MEASUREMENT
/begin MEASUREMENT B_mrkv "Bedingung Veränderung der Geschwindigkeits-Marken Stufentempomat" UBYTE B_TRUE 1 100 0.00 1.00000000000 BIT_MASK 0x1 FORMAT "%13.11" ECU_ADDRESS 0x7F87FE /end MEASUREMENT
/begin MEASUREMENT B_mrkvff "Bedingung Merker das B:_mrkv (Marker Veränderung) gesetzt war" UBYTE B_TRUE 1 100 0.00 1.00000000000 BIT_MASK 0x1 FORMAT "%13.11" ECU_ADDRESS 0x7F87FF /end MEASUREMENT
/begin MEASUREMENT B_prgmod "Bedingung Programmiermodus Stufentempomat" UBYTE B_TRUE 1 100 0.00 1.00000000000 FORMAT "%13.11" ECU_ADDRESS 0x7F8800 /end MEASUREMENT
/begin MEASUREMENT B_tmark "Bedingung Taste Aus für die Zeit TMARK betätigt" UBYTE B_TRUE 1 100 0.00 1.00000000000 FORMAT "%13.11" ECU_ADDRESS 0x7F8801 /end MEASUREMENT
/begin MEASUREMENT B_tmrkbli "Bedingung"" Blinken der Markenanzeige""" UBYTE B_TRUE 1 100 0.00 1.00000000000 FORMAT "%13.11" ECU_ADDRESS 0x7F8802 /end MEASUREMENT
/begin MEASUREMENT B_vziels "Bedingung Übernahme berechnete Zielgeschwindigkeit" UBYTE B_TRUE 1 100 0.00 1.00000000000 BIT_MASK 0x1 FORMAT "%13.11" ECU_ADDRESS 0x7F8803 /end MEASUREMENT
/begin MEASUREMENT canzbl "Zähler für Aus-/Ein-Schaltungen beim Blinken der Markenanzeige" UBYTE dez 1 100 0.00 255.0 FORMAT "%5.1" ECU_ADDRESS 0x7F89FB /end MEASUREMENT
/begin MEASUREMENT CoEng_ctUnpla "Zähler für Überwachungsebene 1 und 2 Unplausibilität" UBYTE OneToOne 1 100 0.00 255.0 FORMAT "%5.1" ECU_ADDRESS 0x7F8816 /end MEASUREMENT
/begin MEASUREMENT CoEng_dnEngnAvrg_mp "Meßpunkt für Overfueling Drehzahlgradienten" SWORD dn_dZ20 1 100 -327680.0 327670.0 FORMAT "%8.1" ECU_ADDRESS 0x8FE628 /end MEASUREMENT
/begin MEASUREMENT CoEng_dVolFlt_mp "Gefilterter Volumenstrom für Berechnung" SWORD CubMtrPerHr 1 100 -3276.800 3276.700 FORMAT "%8.3" ECU_ADDRESS 0x8FE62A /end MEASUREMENT
/begin MEASUREMENT CoEng_pDiffPFltPrdc2_mp "Vorhergesagter Differenzdruck über Partikelfilter oder OxiCat" SWORD Pres_hPa 1 100 -32768.00 32767.00 FORMAT "%8.2" ECU_ADDRESS 0x8FE62C /end MEASUREMENT
/begin MEASUREMENT CoEng_pDiffPFltPrdc_mp "Vorhergesagter Differenzdruck über Partikelfilter" SWORD Pres_hPa 1 100 -32768.00 32767.00 FORMAT "%8.2" ECU_ADDRESS 0x8FE62E /end MEASUREMENT
/begin MEASUREMENT CoEng_resFlowFlt_mp "Gefilterter Strömungswiderstand für Berechnung" SWORD Res_hPaHrPerCM 1 100 -32.76800 32.76700 FORMAT "%8.5" ECU_ADDRESS 0x8FE630 /end MEASUREMENT
/begin MEASUREMENT CoEng_stLayer12 "Indikator für Ebene 1 und 2 Unplausibilität" UBYTE OneToOne 1 100 0.00 255.0 FORMAT "%5.1" ECU_ADDRESS 0x7F881E /end MEASUREMENT
/begin MEASUREMENT CoEng_stRmp_mp "Status: Rampe der Schubabschaltung, 0: inaktiv, 1: aktiv" UBYTE OneToOne 1 100 0.00 255.0 FORMAT "%5.1" ECU_ADDRESS 0x8FE60A /end MEASUREMENT
/begin MEASUREMENT CoEng_stTst "Zustand des Motortestkoordinators (= aktiver Testmodus)" UBYTE OneToOne 1 100 0.00 255.0 FORMAT "%5.1" ECU_ADDRESS 0x7F8831 /end MEASUREMENT
/begin MEASUREMENT CoEng_tiOvRMon_mp "Zeit seit Schub erkannt wurde und die Schubüberwachung aktiv ist" SWORD Time_ms 1 100 -327680.0 327670.0 FORMAT "%8.1" ECU_ADDRESS 0x8FE60C /end MEASUREMENT
/begin MEASUREMENT CoEng_tiRmpStrt "Time for Ramp Start" UWORD Time_ms 1 100 0.00 655350.0 FORMAT "%8.1" ECU_ADDRESS 0x7F8B78 /end MEASUREMENT
/begin MEASUREMENT CoEng_tiSwtOff "Time for Switch Off" UWORD Time_ms 1 100 0.00 655350.0 FORMAT "%8.1" ECU_ADDRESS 0x7F8B7C /end MEASUREMENT
/begin MEASUREMENT CoEng_tPFltCDMax_mp "Maximalwert von Abgastemp. vor Partikelfilter erster sensor" SWORD Temp_Cels 1 100 -50.140 899.860 FORMAT "%8.3" ECU_ADDRESS 0x8FE632 /end MEASUREMENT
/begin MEASUREMENT CoEng_tPreMax_mp "Maximalwert von Abgastemp. vor  PFltCD_tPreB1 und PFltCD_tPreB2" SWORD Temp_Cels 1 100 -50.140 899.860 FORMAT "%8.3" ECU_ADDRESS 0x8FE634 /end MEASUREMENT
/begin MEASUREMENT CoEng_trqASDdcInit "Initialisierungswert  Störungsregler bei Aufhebung Schubabschaltung" SWORD Trq 1 100 -3276.800 3276.700 FORMAT "%8.3" ECU_ADDRESS 0x7F8B80 /end MEASUREMENT
/begin MEASUREMENT CoEng_trqASDrfInit "Initialisierungswert  Führungsformer bei Aufhebung Schubabschaltung" SWORD Trq 1 100 -3276.800 3276.700 FORMAT "%8.3" ECU_ADDRESS 0x7F8B82 /end MEASUREMENT
/begin MEASUREMENT CoEng_trqBefRmp_mp "Sollmoment nach zweiter Begrenzung, vor Schubabschaltung in CoEng (als inneres Motormoment)" SWORD Trq 1 100 -3276.800 3276.700 FORMAT "%8.3" ECU_ADDRESS 0x8FE60E /end MEASUREMENT
/begin MEASUREMENT CoEng_trqInrCurrFastBase_mp "inneres schnelles Wunschmoment im Curr-Pfad" SWORD Trq 1 100 -3276.800 3276.700 FORMAT "%8.3" ECU_ADDRESS 0x8FE622 /end MEASUREMENT
/begin MEASUREMENT CoEng_trqInrCurrPre_mp "aktuelles inneres Moment ahne Leerlaufreglerstellgrösse" SWORD Trq 1 100 -3276.800 3276.700 FORMAT "%8.3" ECU_ADDRESS 0x8FE610 /end MEASUREMENT
/begin MEASUREMENT CoEng_trqInrDesFastBase_mp "inneres schnelles Wunschmoment ohne Veränderung" SWORD Trq 1 100 -3276.800 3276.700 FORMAT "%8.3" ECU_ADDRESS 0x8FE624 /end MEASUREMENT
/begin MEASUREMENT CoEng_trqInrDesFastUnLim_mp "inneres schnelles Wunschmoment vor Begrenzung" SWORD Trq 1 100 -3276.800 3276.700 FORMAT "%8.3" ECU_ADDRESS 0x8FE626 /end MEASUREMENT
/begin MEASUREMENT CoEng_trqInrDesSlowBase_mp "inneres langsames Wunschmoment ohne Veränderung" SWORD Trq 1 100 -3276.800 3276.700 FORMAT "%8.3" ECU_ADDRESS 0x8FE612 /end MEASUREMENT
/begin MEASUREMENT CoEng_trqInrDesSlowUnLim_mp "inneres langsames Wunschmoment vor Begrenzung" SWORD Trq 1 100 -3276.800 3276.700 FORMAT "%8.3" ECU_ADDRESS 0x8FE614 /end MEASUREMENT
/begin MEASUREMENT CoEng_trqInrLiDesSlw "Momentenführungswert mit LiGov Ausgngswert beaufschlagt" SWORD Trq 1 100 -3276.800 3276.700 FORMAT "%8.3" ECU_ADDRESS 0x7F8B94 /end MEASUREMENT
/begin MEASUREMENT CoEng_trqInrLimLead0_mp "Torque lead limitation after error condition #0" SWORD Trq 1 100 -3276.800 3276.700 FORMAT "%8.3" ECU_ADDRESS 0x8FE636 /end MEASUREMENT
/begin MEASUREMENT CoEng_trqInrLimLead1_mp "Torque lead limitation after error condition #1" SWORD Trq 1 100 -3276.800 3276.700 FORMAT "%8.3" ECU_ADDRESS 0x8FE638 /end MEASUREMENT
/begin MEASUREMENT CoEng_trqInrLimLead2_mp "Torque lead limitation after error condition #2" SWORD Trq 1 100 -3276.800 3276.700 FORMAT "%8.3" ECU_ADDRESS 0x8FE63A /end MEASUREMENT
/begin MEASUREMENT CoEng_trqInrRawPre_mp "Rohwet inneres Moment ohne Leerlaufreglerstellgrösse" SWORD Trq 1 100 -3276.800 3276.700 FORMAT "%8.3" ECU_ADDRESS 0x8FE616 /end MEASUREMENT
/begin MEASUREMENT CoEng_trqInrSetLim_mp "Begrenzter Sollwert des inneren Moments, wenn Schub erkannt wurde und die Schubüberwachung aktiv ist" SWORD Trq 1 100 -3276.800 3276.700 FORMAT "%8.3" ECU_ADDRESS 0x8FE618 /end MEASUREMENT
/begin MEASUREMENT CoEng_trqInrSetUnLtd_mp "Unbegrenzter Sollwert des inneren Moments bei erkanntem Schub" SWORD Trq 1 100 -3276.800 3276.700 FORMAT "%8.3" ECU_ADDRESS 0x8FE61A /end MEASUREMENT
/begin MEASUREMENT CoEng_trqLimMinEEPVal_mp "Stored in EEPROM in case of errors in particle filter" SWORD Trq 1 100 -3276.800 3276.700 FORMAT "%8.3" ECU_ADDRESS 0x8FE63C /end MEASUREMENT
/begin MEASUREMENT CoEng_trqLimMin_mp "Begrenzungsmoment, falls kein momentenbegrenzender Systemfehler vorliegt (Minimum aus Rauchgrenze un Motormech.schutz)" SWORD Trq 1 100 -3276.800 3276.700 FORMAT "%8.3" ECU_ADDRESS 0x6F800E /end MEASUREMENT
/begin MEASUREMENT CoEng_trqLimOffs "current torque limitation with offset for ASDdc" SWORD Trq 1 100 -3276.800 3276.700 FORMAT "%8.3" ECU_ADDRESS 0x7F8BAE /end MEASUREMENT
/begin MEASUREMENT CoEng_trqLimOffs_mp "aktueller Momentgrenzwert mit Offset f. ARD" SWORD Trq 1 100 -3276.800 3276.700 FORMAT "%8.3" ECU_ADDRESS 0x8FE61C /end MEASUREMENT
/begin MEASUREMENT CoEng_trqLimPDiffNOffs_mp "n-Teil des Moments zur Verbesserung des Motorstarts" SWORD Trq 1 100 -3276.800 3276.700 FORMAT "%8.3" ECU_ADDRESS 0x8FE63E /end MEASUREMENT
/begin MEASUREMENT CoEng_trqLimPFlt1_mp "Pressure difference conversion to torque" SWORD Trq 1 100 -3276.800 3276.700 FORMAT "%8.3" ECU_ADDRESS 0x8FE640 /end MEASUREMENT
/begin MEASUREMENT CoEng_trqLimPFltOvld_mp "Begrenzungsmoment aufgrund von CSf Überladung" SWORD Trq 1 100 -3276.800 3276.700 FORMAT "%8.3" ECU_ADDRESS 0x8FE642 /end MEASUREMENT
/begin MEASUREMENT CoEng_trqLimSwt1_mp "Begrenzungsmoment im Fehlerfall" SWORD Trq 1 100 -3276.800 3276.700 FORMAT "%8.3" ECU_ADDRESS 0x8FE644 /end MEASUREMENT
/begin MEASUREMENT CoEng_trqLimSwt2_mp "Begrenzungsmoment im Fehlerfall 2" SWORD Trq 1 100 -3276.800 3276.700 FORMAT "%8.3" ECU_ADDRESS 0x8FE646 /end MEASUREMENT
/begin MEASUREMENT CoEng_trqLimSwt3_mp "Begrenzungsmoment im Fehlerfall" SWORD Trq 1 100 -3276.800 3276.700 FORMAT "%8.3" ECU_ADDRESS 0x8FE648 /end MEASUREMENT
/begin MEASUREMENT CoEng_trqLimSwt4_mp "Begrenzungsmoment im Fehlerfall" SWORD Trq 1 100 -3276.800 3276.700 FORMAT "%8.3" ECU_ADDRESS 0x8FE64A /end MEASUREMENT
/begin MEASUREMENT CoEng_trqRmp_mp "Ausgangsmoment Rampe der Schubabschaltung" SWORD Trq 1 100 -3276.800 3276.700 FORMAT "%8.3" ECU_ADDRESS 0x8FE61E /end MEASUREMENT
/begin MEASUREMENT CoEng_trqSetASDdc_mp "Sollmoment nach Eingriff Ruckeldämfer vor zweiter Begrenzung (mit Offset)" SWORD Trq 1 100 -3276.800 3276.700 FORMAT "%8.3" ECU_ADDRESS 0x8FE620 /end MEASUREMENT
/begin MEASUREMENT ComBas_stDiaReq "Message: Antwort von der Diagnose-Schnittstelle" UBYTE OneToOne 1 100 0.00 255.0 FORMAT "%5.1" ECU_ADDRESS 0x7F883B /end MEASUREMENT
/begin MEASUREMENT ConvCD_ctClutchDfct_mp "Defektzähler von Plausibitätfehler des Kupplungssignals" UWORD OneToOne 1 100 0.00 65535.00 FORMAT "%8.2" ECU_ADDRESS 0x8FE64C /end MEASUREMENT
/begin MEASUREMENT ConvCD_stClth "Kupplungszustand" UBYTE OneToOne 1 100 0.00 255.0 FORMAT "%5.1" ECU_ADDRESS 0x7F883C /end MEASUREMENT
/begin MEASUREMENT ConvCD_stClthRaw "Kupplungszustand nicht überwacht" UBYTE OneToOne 1 100 0.00 255.0 FORMAT "%5.1" ECU_ADDRESS 0x7F883D /end MEASUREMENT
/begin MEASUREMENT ConvCD_stClutchRecord "Message zur Kupplungsstatus Wechsel ( 0 --> 1)" UBYTE OneToOne 1 100 0.00 255.0 FORMAT "%5.1" ECU_ADDRESS 0x7F883E /end MEASUREMENT
/begin MEASUREMENT ConvCD_stDebVal "entprelltes Kupplungssignal" UBYTE OneToOne 1 100 0.00 255.0 FORMAT "%5.1" ECU_ADDRESS 0x7F883F /end MEASUREMENT
/begin MEASUREMENT ConvCD_stIntDebVal "Entprellt Kupplung Status zur internen Verwendung" UBYTE OneToOne 1 100 0.00 255.0 FORMAT "%5.1" ECU_ADDRESS 0x7F8840 /end MEASUREMENT
/begin MEASUREMENT ConvCD_stLastDebVal "Letzter Kupplungssignalstatus." UBYTE OneToOne 1 100 0.00 255.0 FORMAT "%5.1" ECU_ADDRESS 0x7F8841 /end MEASUREMENT
/begin MEASUREMENT ConvCD_stLastGear "Gang von den letzten Zyklus" SBYTE OneToOne 1 100 -128.0 127.0 FORMAT "%5.1" ECU_ADDRESS 0x7F8842 /end MEASUREMENT
/begin MEASUREMENT ConvCD_stOldGear "Letzte gültigen Gang" SBYTE OneToOne 1 100 -128.0 127.0 FORMAT "%5.1" ECU_ADDRESS 0x7F8843 /end MEASUREMENT
/begin MEASUREMENT ConvCD_stRawVal "Kupplungssignal Rohwert" UBYTE OneToOne 1 100 0.00 255.0 FORMAT "%5.1" ECU_ADDRESS 0x7F8844 /end MEASUREMENT
/begin MEASUREMENT ConvCD_swtSig "Schalter für Kupplungssignalquelle (DIO/CAN)." UBYTE OneToOne 1 100 0.00 255.0 FORMAT "%5.1" ECU_ADDRESS 0x7F8845 /end MEASUREMENT
/begin MEASUREMENT Conv_rTrans "Übertragungsverhältins Momentenwandler (Kupplung)" SWORD TransR 1 100 -327.6800 327.6700 FORMAT "%8.4" ECU_ADDRESS 0x7F8BEE /end MEASUREMENT
/begin MEASUREMENT CoVeh_nAcsMax "maximale Drehzahl Nebenaggregate" SWORD EngN 1 100 -32768.00 32767.00 FORMAT "%8.2" ECU_ADDRESS 0x7F8BD0 /end MEASUREMENT
/begin MEASUREMENT CoVeh_nAcsMin "minimale Drehzahl Nebenaggregate" SWORD EngN 1 100 -32768.00 32767.00 FORMAT "%8.2" ECU_ADDRESS 0x7F8BD2 /end MEASUREMENT
/begin MEASUREMENT CoVeh_nLimEngSpd "limitierte Motordrehzahl für die Drehmomentenberechnung" SWORD EngN 1 100 -32768.00 32767.00 FORMAT "%8.2" ECU_ADDRESS 0x7F8BD4 /end MEASUREMENT
/begin MEASUREMENT CoVeh_nMax "Auftrag maximale Motordrehzahl" SWORD EngN 1 100 -32768.00 32767.00 FORMAT "%8.2" ECU_ADDRESS 0x7F8BD6 /end MEASUREMENT
/begin MEASUREMENT CoVeh_nMin "Auftrag minimale Motordrehzahl" SWORD EngN 1 100 -32768.00 32767.00 FORMAT "%8.2" ECU_ADDRESS 0x7F8BD8 /end MEASUREMENT
/begin MEASUREMENT CoVeh_pwrAcsDes "Nebenaggregatleistung Auftrag" SWORD Pwr 1 100 -308831.1 308821.7 FORMAT "%8.1" ECU_ADDRESS 0x7F8BDA /end MEASUREMENT
/begin MEASUREMENT CoVeh_pwrAcsLead "Vorhalt Nebenaggregatleistung Auftrag" SWORD Pwr 1 100 -308831.1 308821.7 FORMAT "%8.1" ECU_ADDRESS 0x7F8BDC /end MEASUREMENT
/begin MEASUREMENT CoVeh_pwrAcsTempLim_mp "Power demand for all temporary accessories - limited based on PrpBrk_trqDes" SWORD Pwr 1 100 -308831.1 308821.7 FORMAT "%8.1" ECU_ADDRESS 0x8FE64E /end MEASUREMENT
/begin MEASUREMENT CoVeh_stOrd "Randbedingungen für physikalischen Auftrag" UBYTE OneToOne 1 100 0.00 255.0 FORMAT "%5.1" ECU_ADDRESS 0x7F8839 /end MEASUREMENT
/begin MEASUREMENT CoVeh_trqAcs "Momentenanforderung der Nebenaggregate" SWORD Trq 1 100 -3276.800 3276.700 FORMAT "%8.3" ECU_ADDRESS 0x7F8BDE /end MEASUREMENT
/begin MEASUREMENT CoVeh_trqAcsDes "Momentenanforderung Nebenaggregate Wunschwert" SWORD Trq 1 100 -3276.800 3276.700 FORMAT "%8.3" ECU_ADDRESS 0x7F8BE0 /end MEASUREMENT
/begin MEASUREMENT CoVeh_trqAcsLead "Momentenanforderung Nebenaggregate Vorhaltewert" SWORD Trq 1 100 -3276.800 3276.700 FORMAT "%8.3" ECU_ADDRESS 0x7F8BE2 /end MEASUREMENT
/begin MEASUREMENT CoVeh_trqAcsLimCrSDes_mp "Torque demand" SWORD Trq 1 100 -3276.800 3276.700 FORMAT "%8.3" ECU_ADDRESS 0x8FE650 /end MEASUREMENT
/begin MEASUREMENT CoVeh_trqAcsPerm "Momentenbedarf permanente Nebenaggregate" SWORD Trq 1 100 -3276.800 3276.700 FORMAT "%8.3" ECU_ADDRESS 0x7F8BE4 /end MEASUREMENT
/begin MEASUREMENT CoVeh_trqAcsTemp "Momentenbedarf zuschaltbare Nebenaggregate" SWORD Trq 1 100 -3276.800 3276.700 FORMAT "%8.3" ECU_ADDRESS 0x7F8BE6 /end MEASUREMENT
/begin MEASUREMENT CoVeh_trqPrpDes "Vortriebsmoment Wunschwert" SWORD TrqPrp 1 100 -6553.600 6553.400 FORMAT "%8.3" ECU_ADDRESS 0x7F8BE8 /end MEASUREMENT
/begin MEASUREMENT CoVeh_trqPrpLead "Vortriebsmoment Vorhaltewert" SWORD TrqPrp 1 100 -6553.600 6553.400 FORMAT "%8.3" ECU_ADDRESS 0x7F8BEA /end MEASUREMENT
/begin MEASUREMENT CoVeh_trqPrpLimErr "Begrenzungsmoment für Vortrieb im Falle eines Systemfehlers" SWORD TrqPrp 1 100 -6553.600 6553.400 FORMAT "%8.3" ECU_ADDRESS 0x7F8BEC /end MEASUREMENT
/begin MEASUREMENT CoVM_amAct_mp "Aktueller Integrationswert des  MSR-Momentenüberschußintegrals" SWORD TrqPrpDT 1 100 -163840.0 163835.0 FORMAT "%8.1" ECU_ADDRESS 0x8FE652 /end MEASUREMENT
/begin MEASUREMENT CoVM_stActDem "Status aktiv wirkender Fahrdynamikeingriffe" UBYTE OneToOne 1 100 0.00 255.0 FORMAT "%5.1" ECU_ADDRESS 0x7F8833 /end MEASUREMENT
/begin MEASUREMENT CoVM_stDCSh_mp "unentprellter Status der Plausibilitätsprüfung des erhöhenden Fahrdynamikeingriffs" UBYTE OneToOne 1 100 0.00 255.0 FORMAT "%5.1" ECU_ADDRESS 0x8FE654 /end MEASUREMENT
/begin MEASUREMENT CoVM_stDemCheck "Steuerbits der Abschaltsteuerung der Fahrdynamikeingriffe" UBYTE OneToOne 1 100 0.00 255.0 FORMAT "%5.1" ECU_ADDRESS 0x7F8834 /end MEASUREMENT
/begin MEASUREMENT CoVM_stDemUnplaus_mp "Status der DCS Überwachung" UBYTE OneToOne 1 100 0.00 255.0 FORMAT "%5.1" ECU_ADDRESS 0x8FE655 /end MEASUREMENT
/begin MEASUREMENT CoVM_stOrd "Randbedingungen für physikalischen Auftrag" UBYTE OneToOne 1 100 0.00 255.0 FORMAT "%5.1" ECU_ADDRESS 0x7F8835 /end MEASUREMENT
/begin MEASUREMENT CoVM_stTrqLeadFrz "current status if SW timer running" UBYTE OneToOne 1 100 0.00 255.0 FORMAT "%5.1" ECU_ADDRESS 0x7F8836 /end MEASUREMENT
/begin MEASUREMENT CoVM_swtSlipCtl "Fahrdynamik-Konfiguration (0: ASR aus, MSR aus; 1: ASR an, MSR aus;  2: ASR aus, MSR an;  3: ASR an, MSR an)" UBYTE OneToOne 1 100 0.00 255.0 FORMAT "%5.1" ECU_ADDRESS 0x7F8838 /end MEASUREMENT
/begin MEASUREMENT CoVM_trqDec "Momenteneingriff von ASR" SWORD TrqPrp 1 100 -6553.600 6553.400 FORMAT "%8.3" ECU_ADDRESS 0x7F8BC4 /end MEASUREMENT
/begin MEASUREMENT CoVM_trqDecSetVal_mp "decreasing  torque set value wheel-torque" SWORD TrqPrp 1 100 -6553.600 6553.400 FORMAT "%8.3" ECU_ADDRESS 0x8FE65E /end MEASUREMENT
/begin MEASUREMENT CoVM_trqDesIncMax_mp "Messpunkt des Maximumwertes zwischen PrpBrk_trqDes & CoVM_trqInc" SWORD TrqPrp 1 100 -6553.600 6553.400 FORMAT "%8.3" ECU_ADDRESS 0x8FE658 /end MEASUREMENT
/begin MEASUREMENT CoVM_trqDVCH "Fahrerwunschmoment für DSC, EGS" SWORD Trq 1 100 -3276.800 3276.700 FORMAT "%8.3" ECU_ADDRESS 0x7F8BC2 /end MEASUREMENT
/begin MEASUREMENT CoVM_trqGearbxMax "Momentbegrenzung reduzierender Getriebeeingriff" SWORD Trq 1 100 -3276.800 3276.700 FORMAT "%8.3" ECU_ADDRESS 0x7F8BC6 /end MEASUREMENT
/begin MEASUREMENT CoVM_trqGearbxMin "Momentbegrenzung erhöhender Getriebeeingriff" SWORD Trq 1 100 -3276.800 3276.700 FORMAT "%8.3" ECU_ADDRESS 0x7F8BC8 /end MEASUREMENT
/begin MEASUREMENT CoVM_trqInc "Momenteneingriff von MSR" SWORD TrqPrp 1 100 -6553.600 6553.400 FORMAT "%8.3" ECU_ADDRESS 0x7F8BCA /end MEASUREMENT
/begin MEASUREMENT CoVM_trqIncSetVal_mp "increasing  torque set value  of wheel-torque" SWORD TrqPrp 1 100 -6553.600 6553.400 FORMAT "%8.3" ECU_ADDRESS 0x8FE660 /end MEASUREMENT
/begin MEASUREMENT CoVM_trqInt_mp "Aktuelles  Integrationsmoment des MSR-Momentenüberschußintegrals" SWORD TrqPrp 1 100 -6553.600 6553.400 FORMAT "%8.3" ECU_ADDRESS 0x8FE656 /end MEASUREMENT
/begin MEASUREMENT CoVM_trqLeadIncMax_mp "Messpunkt des Maximumwertes zwischen PrpBrk_trqLead & CoVM_trqInc" SWORD TrqPrp 1 100 -6553.600 6553.400 FORMAT "%8.3" ECU_ADDRESS 0x8FE65C /end MEASUREMENT
/begin MEASUREMENT CoVM_trqPrpDes "Wunsch Vortriebsmoment" SWORD TrqPrp 1 100 -6553.600 6553.400 FORMAT "%8.3" ECU_ADDRESS 0x7F8BCC /end MEASUREMENT
/begin MEASUREMENT CoVM_trqPrpLead "Vorhalt Vortriebsmoment" SWORD TrqPrp 1 100 -6553.600 6553.400 FORMAT "%8.3" ECU_ADDRESS 0x7F8BCE /end MEASUREMENT
/begin MEASUREMENT CpBVlv_qClose_mp "mp für niedrigeren Schwellenwert der Einspriztmenge (Schließung)" SWORD InjMassCyc 1 100 -327.6800 327.6700 FORMAT "%8.4" ECU_ADDRESS 0x8FE662 /end MEASUREMENT
/begin MEASUREMENT CpBVlv_qOpn_mp "mp für höheren Schwellenwert der der Einspriztmenge  (Eröffnung)" SWORD InjMassCyc 1 100 -327.6800 327.6700 FORMAT "%8.4" ECU_ADDRESS 0x8FE664 /end MEASUREMENT
/begin MEASUREMENT CpBVlv_stLogic "Logikstatus fuer Verdichterbypass" UBYTE OneToOne 1 100 0.00 255.0 FORMAT "%5.1" ECU_ADDRESS 0x7F8846 /end MEASUREMENT
/begin MEASUREMENT CpBVlv_stOff_mp "mp für shutoff" UBYTE OneToOne 1 100 0.00 255.0 FORMAT "%5.1" ECU_ADDRESS 0x8FE666 /end MEASUREMENT
/begin MEASUREMENT CpBVlv_stOpn "Zustand Kompressorbypass-Ventil" UBYTE OneToOne 1 100 0.00 255.0 FORMAT "%5.1" ECU_ADDRESS 0x7F8847 /end MEASUREMENT
/begin MEASUREMENT CrCCD_dMFLData_mp "Rohdaten vom MFL" UBYTE OneToOne 1 100 0.00 255.0 FORMAT "%5.1" ECU_ADDRESS 0x8FE667 /end MEASUREMENT
/begin MEASUREMENT CrCCD_stDev "Status FGR-Bedienteil (zusätzliche Abschaltbedingungen)" UBYTE OneToOne 1 100 0.00 255.0 FORMAT "%5.1" ECU_ADDRESS 0x7F8848 /end MEASUREMENT
/begin MEASUREMENT CrCCD_stKey "Rückgabewert ""Taste gedrückt""" UBYTE OneToOne 1 100 0.00 255.0 FORMAT "%5.1" ECU_ADDRESS 0x7F8849 /end MEASUREMENT
/begin MEASUREMENT CrCCD_stKeyOff "tip up und tip down Taste bei deaktivierten CrCtl Hauptschalter" UBYTE OneToOne 1 100 0.00 255.0 FORMAT "%5.1" ECU_ADDRESS 0x7F884A /end MEASUREMENT
/begin MEASUREMENT CrCCD_swtDev "SW-Schalter eingebauter Typ FGR Bedienteil" UBYTE OneToOne 1 100 0.00 255.0 FORMAT "%5.1" ECU_ADDRESS 0x7F884B /end MEASUREMENT
/begin MEASUREMENT CrCCD_swtMSW "Schalterstellung vom MSW (1...MSW ein/0...MSW aus)" UBYTE OneToOne 1 100 0.00 255.0 FORMAT "%5.1" ECU_ADDRESS 0x7F884C /end MEASUREMENT
/begin MEASUREMENT CrCtl_BGSTUTbits2_mp "Instrumente für bgcmsggts_20ms" UWORD OneToOne 1 100 0.00 65535.00 FORMAT "%8.2" ECU_ADDRESS 0x8FE686 /end MEASUREMENT
/begin MEASUREMENT CrCtl_dvAcc_mp "Rampensteigung bei Beschleunigung SET+" SWORD dVel_20ms 1 100 -16384.00 16383.50 FORMAT "%8.2" ECU_ADDRESS 0x8FE66C /end MEASUREMENT
/begin MEASUREMENT CrCtl_dvDecl_mp "Rampensteigung bei Verzögerung SET-" SWORD dVel_20ms 1 100 -16384.00 16383.50 FORMAT "%8.2" ECU_ADDRESS 0x8FE66E /end MEASUREMENT
/begin MEASUREMENT CrCtl_dvResAbv_mp "Rampensteigung bei WA-" SWORD dVel_20ms 1 100 -16384.00 16383.50 FORMAT "%8.2" ECU_ADDRESS 0x8FE670 /end MEASUREMENT
/begin MEASUREMENT CrCtl_dvResBlw_mp "Rampensteigung WA+" SWORD dVel_20ms 1 100 -16384.00 16383.50 FORMAT "%8.2" ECU_ADDRESS 0x8FE672 /end MEASUREMENT
/begin MEASUREMENT CrCtl_facHyp_mp "Wert des hyperbolischen Faktors zur Reduktionsmomenten-Abschwächung im Zustand HOLD." SWORD Fact 1 100 -4.000000 3.999878 FORMAT "%8.6" ECU_ADDRESS 0x8FE674 /end MEASUREMENT
/begin MEASUREMENT CrCtl_mrkeinvp_mp "Instrumente für bgcmsggts_20ms" UBYTE OneToOne 1 100 0.00 255.0 FORMAT "%5.1" ECU_ADDRESS 0x8FE688 /end MEASUREMENT
/begin MEASUREMENT CrCtl_numGear "Gang FGR" SBYTE OneToOne 1 100 -128.0 127.0 FORMAT "%5.1" ECU_ADDRESS 0x7F884D /end MEASUREMENT
/begin MEASUREMENT CrCtl_numVMrk "1 Index für vmrki..." UBYTE OneToOne 1 100 0.00 255.0 FORMAT "%5.1" ECU_ADDRESS 0x7F884E /end MEASUREMENT
/begin MEASUREMENT CrCtl_rVnBeg "Verhältnis Geschwindigkeit zu Drehzahl bei Aktivierung FGR" SWORD VelToN 1 100 0.00 0.3276700 FORMAT "%9.7" ECU_ADDRESS 0x7F8BF0 /end MEASUREMENT
/begin MEASUREMENT CrCtl_st "Status FGR" UBYTE OneToOne 1 100 0.00 255.0 FORMAT "%5.1" ECU_ADDRESS 0x7F884F /end MEASUREMENT
/begin MEASUREMENT CrCtl_stActive "Flag aktiver FGR" UBYTE OneToOne 1 100 0.00 255.0 FORMAT "%5.1" ECU_ADDRESS 0x7F8850 /end MEASUREMENT
/begin MEASUREMENT CrCtl_stBrkBeforeCruise_mp "Meßpunkt für Bremsenanforderung" UBYTE OneToOne 1 100 0.00 255.0 FORMAT "%5.1" ECU_ADDRESS 0x8FE668 /end MEASUREMENT
/begin MEASUREMENT CrCtl_stCAN "Status der CrCtl für CAN" UBYTE OneToOne 1 100 0.00 255.0 FORMAT "%5.1" ECU_ADDRESS 0x7F8851 /end MEASUREMENT
/begin MEASUREMENT CrCtl_stCC "Status FGR" UBYTE OneToOne 1 100 0.00 255.0 FORMAT "%5.1" ECU_ADDRESS 0x7F8852 /end MEASUREMENT
/begin MEASUREMENT CrCtl_stClCtr_mp "Status nach DSC, ASC & MSR Eingriffen" UWORD OneToOne 1 100 0.00 65535.00 FORMAT "%8.2" ECU_ADDRESS 0x8FE66A /end MEASUREMENT
/begin MEASUREMENT CrCtl_stFrzIGovGbx_mp "Integratorzustand (eingefroren oder nicht) infolge eines Getriebeeingriffes im Zustand HOLD." UBYTE OneToOne 1 100 0.00 255.0 FORMAT "%5.1" ECU_ADDRESS 0x8FE676 /end MEASUREMENT
/begin MEASUREMENT CrCtl_stHysTrqDec_mp "Aktueller Zustand der Momentenreduktionskomponente im Zustand HOLD." UBYTE OneToOne 1 100 0.00 255.0 FORMAT "%5.1" ECU_ADDRESS 0x8FE677 /end MEASUREMENT
/begin MEASUREMENT CrCtl_stLampOut "Status der CrCtl-Lampe (wird über CAN versendet)" UBYTE OneToOne 1 100 0.00 255.0 FORMAT "%5.1" ECU_ADDRESS 0x7F8853 /end MEASUREMENT
/begin MEASUREMENT CrCtl_stRecFGR "Status ob FGR im Fahrzeug verbaut ist" UBYTE OneToOne 1 100 0.00 255.0 FORMAT "%5.1" ECU_ADDRESS 0x7F8854 /end MEASUREMENT
/begin MEASUREMENT CrCtl_stShutOffCode "Abschaltgrund FGR" ULONG OneToOne 1 100 0.00 4294967295.00 FORMAT "%13.2" ECU_ADDRESS 0x7F9204 /end MEASUREMENT
/begin MEASUREMENT CrCtl_stShutOffCode1_mp "Low Byte von CrCtl_shutOffCode (Verwendung als Signal)" UWORD OneToOne 1 100 0.00 65535.00 FORMAT "%8.2" ECU_ADDRESS 0x6F8010 /end MEASUREMENT
/begin MEASUREMENT CrCtl_stShutOffCode2_mp "Low Byte von CrCtl_shutOffCode (Verwendung als Signal)" UWORD OneToOne 1 100 0.00 65535.00 FORMAT "%8.2" ECU_ADDRESS 0x6F8012 /end MEASUREMENT
/begin MEASUREMENT CrCtl_stShutOffFrz1_mp "latched shutoff reason" UWORD OneToOne 1 100 0.00 65535.00 FORMAT "%8.2" ECU_ADDRESS 0x6F8014 /end MEASUREMENT
/begin MEASUREMENT CrCtl_stShutOffFrz2_mp "latched shutoff reason" UWORD OneToOne 1 100 0.00 65535.00 FORMAT "%8.2" ECU_ADDRESS 0x6F8016 /end MEASUREMENT
/begin MEASUREMENT CrCtl_stShutOffFrz_mp "eingefrorener Abschaltgrund FGR" ULONG OneToOne 1 100 0.00 4294967295.00 FORMAT "%13.2" ECU_ADDRESS 0x6F8018 /end MEASUREMENT
/begin MEASUREMENT CrCtl_stUpdateVMrk "Trigger zum senden der Botschaft" UBYTE OneToOne 1 100 0.00 255.0 FORMAT "%5.1" ECU_ADDRESS 0x7F8855 /end MEASUREMENT
/begin MEASUREMENT CrCtl_stVCrCtl "Diagnosefreigabestatus für Anzeigegeschwindigkeit" UBYTE OneToOne 1 100 0.00 255.0 FORMAT "%5.1" ECU_ADDRESS 0x7F8856 /end MEASUREMENT
/begin MEASUREMENT CrCtl_stVDisp "Marke aus/ein" UBYTE OneToOne 1 100 0.00 255.0 FORMAT "%5.1" ECU_ADDRESS 0x7F8857 /end MEASUREMENT
/begin MEASUREMENT CrCtl_stVSetNew "neue Sollgeschwindigkeit aus Stufentempomat übernehmen" UBYTE OneToOne 1 100 0.00 255.0 FORMAT "%5.1" ECU_ADDRESS 0x7F8858 /end MEASUREMENT
/begin MEASUREMENT CrCtl_trqDec_mp "Wert des reduzierenden Momentes im Zustand HOLD." SWORD TrqPrp 1 100 -6553.600 6553.400 FORMAT "%8.3" ECU_ADDRESS 0x8FE678 /end MEASUREMENT
/begin MEASUREMENT CrCtl_trqDes "Momentenanforderung FGR" SWORD TrqPrp 1 100 -6553.600 6553.400 FORMAT "%8.3" ECU_ADDRESS 0x7F8BF2 /end MEASUREMENT
/begin MEASUREMENT CrCtl_trqDT1_mp "DT1 Ausgang FGR" SWORD TrqPrp 1 100 -6553.600 6553.400 FORMAT "%8.3" ECU_ADDRESS 0x8FE67A /end MEASUREMENT
/begin MEASUREMENT CrCtl_trqI_mp "I-Anteil FGR" SWORD TrqPrp 1 100 -6553.600 6553.400 FORMAT "%8.3" ECU_ADDRESS 0x8FE67C /end MEASUREMENT
/begin MEASUREMENT CrCtl_trqLead "Vorhaltmoment des FGR" SWORD TrqPrp 1 100 -6553.600 6553.400 FORMAT "%8.3" ECU_ADDRESS 0x7F8BF4 /end MEASUREMENT
/begin MEASUREMENT CrCtl_trqMax_mp "Maximales Moment FGR" SWORD TrqPrp 1 100 -6553.600 6553.400 FORMAT "%8.3" ECU_ADDRESS 0x8FE67E /end MEASUREMENT
/begin MEASUREMENT CrCtl_trqP_mp "P-Anteil der Fahrgeschwindigkeits PI-Regelung" SWORD TrqPrp 1 100 -6553.600 6553.400 FORMAT "%8.3" ECU_ADDRESS 0x8FE680 /end MEASUREMENT
/begin MEASUREMENT CrCtl_vAlwMax "Obere Grenze für FGR-Sollgeschwindigkeit" SWORD Vel 1 100 0.00 300.0000 FORMAT "%8.4" ECU_ADDRESS 0x7F8BF6 /end MEASUREMENT
/begin MEASUREMENT CrCtl_vAlwMin "min. mögliche Setzgeschwindigkeit" SWORD Vel 1 100 0.00 300.0000 FORMAT "%8.4" ECU_ADDRESS 0x7F8BF8 /end MEASUREMENT
/begin MEASUREMENT CrCtl_vBeg "FGR: Fahrgeschwindigkeit am Anfang von EIN+, EIN- und WA" SWORD Vel 1 100 0.00 300.0000 FORMAT "%8.4" ECU_ADDRESS 0x7F8BFA /end MEASUREMENT
/begin MEASUREMENT CrCtl_vCurr "Fahrzeuggeschwindigkeit für FGR" SWORD Vel 1 100 0.00 300.0000 FORMAT "%8.4" ECU_ADDRESS 0x7F8BFC /end MEASUREMENT
/begin MEASUREMENT CrCtl_vDes "Sollgeschwindigkeit FGR" SWORD Vel 1 100 0.00 300.0000 FORMAT "%8.4" ECU_ADDRESS 0x7F8BFE /end MEASUREMENT
/begin MEASUREMENT CrCtl_vDesDisp "aktuelle Zielgeschwindigkeit STUT" SWORD Vel 1 100 0.00 300.0000 FORMAT "%8.4" ECU_ADDRESS 0x7F8C00 /end MEASUREMENT
/begin MEASUREMENT CrCtl_vDiffRed_mp "Geschwindigkeitsdifferenz für Abflachungskennlinie" SWORD Vel 1 100 -327.6800 327.6700 FORMAT "%8.4" ECU_ADDRESS 0x8FE682 /end MEASUREMENT
/begin MEASUREMENT CrCtl_vDiff_mp "FGR: | CrCtl_vDes - CrCtl_vBeg |, Differenz V_SOLL und v bei Anfang EIN+, EIN- und WA" SWORD Vel 1 100 -327.6800 327.6700 FORMAT "%8.4" ECU_ADDRESS 0x8FE684 /end MEASUREMENT
/begin MEASUREMENT CrCtl_vDispOffset "Abweichung Anzeigegeschwindigkeit - gef. Messgeschwindigkeit" SWORD Vel 1 100 0.00 300.0000 FORMAT "%8.4" ECU_ADDRESS 0x7F8C02 /end MEASUREMENT
/begin MEASUREMENT CrCtl_vMrk1 "v-Marke 1 für Botschaft" SWORD Vel 1 100 0.00 300.0000 FORMAT "%8.4" ECU_ADDRESS 0x7F8C04 /end MEASUREMENT
/begin MEASUREMENT CrCtl_vMrk2 "v-Marke für 2 Botschaft" SWORD Vel 1 100 0.00 300.0000 FORMAT "%8.4" ECU_ADDRESS 0x7F8C06 /end MEASUREMENT
/begin MEASUREMENT CrCtl_vMrk3 "v-Marke 3 für Botschaft" SWORD Vel 1 100 0.00 300.0000 FORMAT "%8.4" ECU_ADDRESS 0x7F8C08 /end MEASUREMENT
/begin MEASUREMENT CrCtl_vRmp "Rampenzielgeschwindigkeit FGR" SWORD Vel 1 100 0.00 300.0000 FORMAT "%8.4" ECU_ADDRESS 0x7F8C0A /end MEASUREMENT
/begin MEASUREMENT CrCtl_vSetNew "neue Sollgeschwindigkeit aus Stufentempomat" SWORD Vel 1 100 0.00 300.0000 FORMAT "%8.4" ECU_ADDRESS 0x7F8C0C /end MEASUREMENT
/begin MEASUREMENT CrSCD_dSegMisf "Verschiebung Segmentsystem für Aussetzererkennung" SBYTE OneToOne 1 100 -128.0 127.0 FORMAT "%5.1" ECU_ADDRESS 0x7F8859 /end MEASUREMENT
/begin MEASUREMENT CrSCD_incNextIntDelta_mp "Anzahl der Inkrements bis zum nächsten statischen  Interrupt" SWORD OneToOne 1 100 -32768.00 32767.00 FORMAT "%8.2" ECU_ADDRESS 0x8FE6A0 /end MEASUREMENT
/begin MEASUREMENT CrSCD_incNextInt_mp "Anzahl der Inkrements bis zum nächsten statischen  Interrupt" SBYTE OneToOne 1 100 -128.0 127.0 FORMAT "%5.1" ECU_ADDRESS 0x8FE6A2 /end MEASUREMENT
/begin MEASUREMENT CrSCD_nAvrg "gemittelte Kurbelwellendrehzahl des letzten und vorletzten segmentes" SWORD EngN 1 100 -32768.00 32767.00 FORMAT "%8.2" ECU_ADDRESS 0x7F8C0E /end MEASUREMENT
/begin MEASUREMENT CrSCD_nAvrgHiRes "Gemittelte hochauflösende Drehzahl" SLONG EngN_HiRes 1 100 -268435456.000 268435455.875 FORMAT "%13.3" ECU_ADDRESS 0x7F920C /end MEASUREMENT
/begin MEASUREMENT CrSCD_nCurr "aktuelle Motordrehzahl aus der letzten Segmentperiode" SWORD EngN 1 100 -32768.00 32767.00 FORMAT "%8.2" ECU_ADDRESS 0x7F8C10 /end MEASUREMENT
/begin MEASUREMENT CrSCD_nCurrHiRes "Aktuelle hochauflösende Drehzahl" SLONG EngN_HiRes 1 100 -268435456.000 268435455.875 FORMAT "%13.3" ECU_ADDRESS 0x7F9210 /end MEASUREMENT
/begin MEASUREMENT CrSCD_nDyn "aktuelle Motordrehzahl mit Filter für Segment der Dekompressionsphase" SWORD EngN 1 100 -32768.00 32767.00 FORMAT "%8.2" ECU_ADDRESS 0x7F8C12 /end MEASUREMENT
/begin MEASUREMENT CrSCD_nHold "aktuelle Motordrehzahl des vorletzten Segmentes" SWORD EngN 1 100 -32768.00 32767.00 FORMAT "%8.2" ECU_ADDRESS 0x7F8C14 /end MEASUREMENT
/begin MEASUREMENT CrSCD_nMisf "Drehzahlsignal für ODB-Zündaussetzererkennung" SWORD EngN 1 100 -32768.00 32767.00 FORMAT "%8.2" ECU_ADDRESS 0x7F8C18 /end MEASUREMENT
/begin MEASUREMENT CrSCD_numSeg "aktuelle Segmentnummer  (Segment 0 ist bei OT 1)" UBYTE OneToOne 1 100 0.00 255.0 FORMAT "%5.1" ECU_ADDRESS 0x7F885A /end MEASUREMENT
/begin MEASUREMENT CrSCD_phiCurr_mp "Aktueller Winkel basierent auf dem Inkrementsystem" SWORD AngleCrS 1 100 -768.0000 767.9766 FORMAT "%8.4" ECU_ADDRESS 0x8FE6A4 /end MEASUREMENT
/begin MEASUREMENT CrSCD_phiIncCor "aktuelle Phasenkorrektur des Inkrementsystems der Kurbelwelle" SWORD AngleCrS 1 100 -768.0000 767.9766 FORMAT "%8.4" ECU_ADDRESS 0x7F8C1A /end MEASUREMENT
/begin MEASUREMENT CrSCD_phiIncr "Winkel eines Inkrements in Grad Kurbelwelle" SWORD AngleCrS 1 100 -768.0000 767.9766 FORMAT "%8.4" ECU_ADDRESS 0x7F8C1C /end MEASUREMENT
/begin MEASUREMENT CrSCD_phiSegGrid_mp "Berechnete Drehzahlsegmentlänge" SWORD AngleCrS 1 100 -768.0000 767.9766 FORMAT "%8.4" ECU_ADDRESS 0x8FE6A6 /end MEASUREMENT
/begin MEASUREMENT CrSCD_stIncErr_mp "Fehlerstatus des Inkrementgebersignals (Signalstöhrungen, Frequenzstatus, Inkrementpufferstatus)" UBYTE OneToOne 1 100 0.00 255.0 FORMAT "%5.1" ECU_ADDRESS 0x8FE6A8 /end MEASUREMENT
/begin MEASUREMENT CrSCD_stIncSig_mp "Status des Inkrementgeber Signalauswertung (Plausibilisierung der Zahnflankenzeiten und -anzahl)" UBYTE OneToOne 1 100 0.00 255.0 FORMAT "%5.1" ECU_ADDRESS 0x8FE6A9 /end MEASUREMENT
/begin MEASUREMENT CrSCD_stIncSyncInc_mp "Synchronisationsstatus des Inkrementgebersignals nach Aufruf von CrSCD_UpdPos (Intern, Debugging)" UBYTE OneToOne 1 100 0.00 255.0 FORMAT "%5.1" ECU_ADDRESS 0x8FE6AA /end MEASUREMENT
/begin MEASUREMENT CrSCD_stIncSyncPhase_mp "Synchronisationsstatus des Inkrementgebersignals nach Aufruf von CaSCD_GetPos (Intern, Debugging)" UBYTE OneToOne 1 100 0.00 255.0 FORMAT "%5.1" ECU_ADDRESS 0x8FE6AB /end MEASUREMENT
/begin MEASUREMENT CrSCD_tiSeg "aktuelle Segmentperiode (1 Segment = Winkelbereich der über CrSCD_phiSeg_C appliziert ist, Abtastung = n-sync.)" ULONG Per_Dur 1 100 0.00 4294967295.00 FORMAT "%13.2" ECU_ADDRESS 0x7F9214 /end MEASUREMENT
/begin MEASUREMENT ctblink "Zeitzähler für Blinken der Markenanzeige" UBYTE t20msxs_ub_b5p1 1 100 0.00 5.100 FORMAT "%5.3" ECU_ADDRESS 0x7F89FC /end MEASUREMENT
/begin MEASUREMENT dvmark_w "Mindestabstand von Geschwindigkeitsmarken beim Stufentempomat" UWORD Vel 1 100 0.00 655.3500 FORMAT "%8.4" ECU_ADDRESS 0x7F9188 /end MEASUREMENT
/begin MEASUREMENT dvprg_w "Schrittweite bei Anzeige der Regelgeschwindigkeit im Programmiermodus" UWORD Vel 1 100 0.00 655.3500 FORMAT "%8.4" ECU_ADDRESS 0x7F918A /end MEASUREMENT
/begin MEASUREMENT dvstutom_w "Schrittweite für Verstellung der Zielgeschwindigkeit ohne programmierte Marken" UWORD Vel 1 100 0.00 655.3500 FORMAT "%8.4" ECU_ADDRESS 0x7F918C /end MEASUREMENT
/begin MEASUREMENT indexmrst "Index für vmrki..." UBYTE dez 1 100 0.00 255.0 FORMAT "%5.1" ECU_ADDRESS 0x7F89FD /end MEASUREMENT
/begin MEASUREMENT mmimrk_w "ported from ME9" UWORD Vel 1 100 0.00 655.3500 FORMAT "%8.4" ARRAY_SIZE 15 ECU_ADDRESS 0x7F9472 /end MEASUREMENT
/begin MEASUREMENT mrknrc "Nummer veränderte Geschwindigkeits-Marke für schnelle CAN- Übertragung" UBYTE dez 1 100 0.00 255.0 FORMAT "%5.1" ECU_ADDRESS 0x7F89FE /end MEASUREMENT
/begin MEASUREMENT mrknrcan "Nummer Geschwindigkeits-Marken Stufentempomat f ür CAN- Übertragung" UBYTE dez 1 100 0.00 255.0 FORMAT "%5.1" ARRAY_SIZE 15 ECU_ADDRESS 0x7F9454 /end MEASUREMENT
/begin MEASUREMENT mrknrint "Nummer Geschwindigkeits-Marken Stufentempomat intern" UBYTE dez 1 100 0.00 255.0 FORMAT "%5.1" ARRAY_SIZE 15 ECU_ADDRESS 0x7F9463 /end MEASUREMENT
/begin MEASUREMENT mrkstut_w "Geschwindigkeits-Marken Stufentempomat" UWORD Vel 1 100 0.00 655.3500 FORMAT "%8.4" ARRAY_SIZE 15 ECU_ADDRESS 0x7F9490 /end MEASUREMENT
/begin MEASUREMENT Prp_trqMaxDes_mp "Maximales Wunschmoment über CAN im Fall von Max. Geschwindigkeitsbeschränkung" SWORD TrqPrp 1 100 -6553.600 6553.400 FORMAT "%8.3" ECU_ADDRESS 0x8FE65A /end MEASUREMENT
/begin MEASUREMENT statvza "Status Zielgeschwindigkeit für Kombi-Anzeige Stufentempomat" UBYTE dez 1 100 0.00 255.0 FORMAT "%5.1" ECU_ADDRESS 0x7F8A03 /end MEASUREMENT
/begin MEASUREMENT tnomgs60ms "Zeit in der keine CAN-Botschaft G_T versendet wurde" UBYTE t20msxs_ub_b5p1 1 100 0.00 5.100 FORMAT "%5.3" ECU_ADDRESS 0x7F8A04 /end MEASUREMENT
/begin MEASUREMENT vfgr_w "Fahrzeug-Ist-Geschwindigkeit für FGR" UWORD Vel 1 100 0.00 655.3500 FORMAT "%8.4" ECU_ADDRESS 0x7F9190 /end MEASUREMENT
/begin MEASUREMENT vmrki1_w "v-Marke 1 für Botschaft" UWORD Vel 1 100 0.00 655.3500 FORMAT "%8.4" ECU_ADDRESS 0x7F9192 /end MEASUREMENT
/begin MEASUREMENT vmrki2_w "v-Marke 2 für Botschaft" UWORD Vel 1 100 0.00 655.3500 FORMAT "%8.4" ECU_ADDRESS 0x7F9194 /end MEASUREMENT
/begin MEASUREMENT vmrki3_w "v-Marke 3 für Botschaft" UWORD Vel 1 100 0.00 655.3500 FORMAT "%8.4" ECU_ADDRESS 0x7F9196 /end MEASUREMENT
/begin MEASUREMENT vreglmax_w "Maximal zulässige Sollgeschwindigkeit für FGR" UWORD Vel 1 100 0.00 655.3500 FORMAT "%8.4" ECU_ADDRESS 0x7F9198 /end MEASUREMENT
/begin MEASUREMENT vreglmin_w "minimal zulässige Sollgeschwindigkeit für FGR" UWORD Vel 1 100 0.00 655.3500 FORMAT "%8.4" ECU_ADDRESS 0x7F919A /end MEASUREMENT
/begin MEASUREMENT vzielakvp_w "Variable für Zielgeschwindigkeit im Kombi" UWORD Vel 1 100 0.00 655.3500 FORMAT "%8.4" ECU_ADDRESS 0x7F91A0 /end MEASUREMENT
/begin MEASUREMENT vzielak_w "Zielgeschwindigkeit für Kombi-Anzeige Stufentempomat" UWORD Vel 1 100 0.00 655.3500 FORMAT "%8.4" ECU_ADDRESS 0x7F919E /end MEASUREMENT
/begin MEASUREMENT vziels_w "Berechnete Soll-Zielgeschwindigkeit für FGR" UWORD Vel 1 100 0.00 655.3500 FORMAT "%8.4" ECU_ADDRESS 0x7F91A2 /end MEASUREMENT
/begin MEASUREMENT vziel_w "Zielgeschwindigkeit für FGR" UWORD Vel 1 100 0.00 655.3500 FORMAT "%8.4" ECU_ADDRESS 0x7F919C /end MEASUREMENT
/begin FUNCTION coeng_trqcalc "Motormomentenberechnung"
 /begin DEF_CHARACTERISTIC CoEng_dtrqRmpUp_C CoEng_dtrqRmpDwn_C CoEng_swtSelOvRMonSync_C CoEng_tiRmpStrtDfl_C CoEng_tiRmpStrt_CUR CoEng_tiSwtOffDfl_C CoEng_tiSwtOff_CUR CoEng_trqInrSetLim_CUR CoEng_trqOffs_C CoEng_trqOvrRunThres_C /end DEF_CHARACTERISTIC
 /begin IN_MEASUREMENT CoEng_tiOvRMon_mp DrvTrn_rTransDT /end IN_MEASUREMENT
/end FUNCTION
/begin FUNCTION coeng_trqcalclead "" /end FUNCTION
/begin FUNCTION coeng_trqcalclead_uic ""
 /begin OUT_MEASUREMENT CoEng_trqInrCurrFastBase_mp CoEng_trqInrDesFastBase_mp CoEng_trqInrDesFastUnLim_mp /end OUT_MEASUREMENT
/end FUNCTION
/begin FUNCTION coeng_trqcalc_msg ""
 /begin OUT_MEASUREMENT CoEng_ctUnpla CoEng_stLayer12 CoEng_tiRmpStrt CoEng_tiSwtOff CoEng_trqASDdcInit CoEng_trqASDrfInit CoEng_trqInrLiDesSlw CoEng_trqLimOffs /end OUT_MEASUREMENT
/end FUNCTION
/begin FUNCTION coeng_trqcalc_uic ""
 /begin OUT_MEASUREMENT CoEng_stRmp_mp CoEng_tiOvRMon_mp CoEng_trqBefRmp_mp CoEng_trqInrCurrPre_mp CoEng_trqInrDesSlowBase_mp CoEng_trqInrDesSlowUnLim_mp CoEng_trqInrRawPre_mp CoEng_trqInrSetLim_mp CoEng_trqInrSetUnLtd_mp CoEng_trqLimOffs_mp CoEng_trqRmp_mp CoEng_trqSetASDdc_mp /end OUT_MEASUREMENT
/end FUNCTION
/begin FUNCTION coeng_trqcalc_var "" /end FUNCTION
/begin FUNCTION coeng_trqcalc_var_uic "" /end FUNCTION
/begin FUNCTION coeng_trqlim "Momentenbegrenzung als Motormoment"
 /begin DEF_CHARACTERISTIC CoEng_dnOvrFulMin_C CoEng_dnOvrFulMax_C CoEng_stdnOvrFulLow_C CoEng_stdnOvrFulHigh_C CoEng_dtrqEngPrtRgnMonUp_C CoEng_dtrqEngPrtRgnMonDwn_C CoEng_dtrqLimUp_C CoEng_dtrqLimDwn_C CoEng_dtrqLimUp1_C CoEng_dtrqLimDwn1_C CoEng_dtrqLimUp2_C CoEng_dtrqLimDwn2_C CoEng_dtrqLimUp3_C CoEng_dtrqLimDwn3_C CoEng_dtrqLimUp4_C CoEng_dtrqLimDwn4_C CoEng_dtrqPFltOvldUp_C CoEng_dtrqPFltOvldDwn_C CoEng_tiOvrFulDT1_C CoEng_facOvrFulDKd_C CoEng_facAdjDfl_C CoEng_facAdjMax_C CoEng_facAdjMin_C CoEng_nOvrFulMax_C CoEng_nOvrFulMin_C CoEng_tiPFltdVolPT1_C CoEng_tiPFltResFlowPT1_C CoEng_dtrqOvrFulUp_C CoEng_dtrqOvrFulDown_C CoEng_rOvrFulMin_C CoEng_rOvrFulMax_C CoEng_strOvrFulLow_C CoEng_strOvrFulHigh_C CoEng_stPFltLimMsk_C CoEng_swtPPreCat_C CoEng_tiPFltOvldOk_C CoEng_tiRepOvrFul_C CoEng_tPFltPreLim_C CoEng_trqCorGearbxRgn_CUR CoEng_trqLimErr1_CUR CoEng_trqLimErr2_CUR CoEng_trqLimErr3_CUR CoEng_trqLimErr4_CUR CoEng_trqLimErr_CUR CoEng_trqLimPDiff1_CUR CoEng_trqLimPDiffNOffs_CUR CoEng_trqLimPDiff_MAP CoEng_trqLimPFltOvld_MAP CoEng_trqOvrFulMax_C CoEng_trqOvrFulMin_C CoEng_vOvrFulMin_C CoEng_vOvrFulMax_C CoEng_stvOvrFulLow_C CoEng_stvOvrFulHigh_C /end DEF_CHARACTERISTIC
 /begin IN_MEASUREMENT CoEng_pDiffPFltPrdc2_mp CoEng_tPFltCDMax_mp Eng_nAvrg PFlt_pDiff /end IN_MEASUREMENT
/end FUNCTION
/begin FUNCTION coeng_trqlim_uic ""
 /begin OUT_MEASUREMENT CoEng_dnEngnAvrg_mp CoEng_dVolFlt_mp CoEng_pDiffPFltPrdc2_mp CoEng_pDiffPFltPrdc_mp CoEng_resFlowFlt_mp CoEng_tPFltCDMax_mp CoEng_tPreMax_mp CoEng_trqInrLimLead0_mp CoEng_trqInrLimLead1_mp CoEng_trqInrLimLead2_mp CoEng_trqLimMinEEPVal_mp CoEng_trqLimMin_mp CoEng_trqLimPDiffNOffs_mp CoEng_trqLimPFlt1_mp CoEng_trqLimPFltOvld_mp CoEng_trqLimSwt1_mp CoEng_trqLimSwt2_mp CoEng_trqLimSwt3_mp CoEng_trqLimSwt4_mp /end OUT_MEASUREMENT
/end FUNCTION
/begin FUNCTION coeng_trqslplim "Begrenzungsmoment für Rauchbegrenzung nach Turboschubbegrenzung"
 /begin DEF_CHARACTERISTIC CoEng_nSlpLimMin_C CoEng_dtrqSlpLimUpdef_C CoEng_dtrqSlpLimDwndef_C CoEng_dtrqSlpLimUp1_C CoEng_dtrqSlpLimDwn1_C CoEng_dtrqSlpLimUp2_C CoEng_dtrqSlpLimDwn2_C CoEng_dtrqSlpLimUp3_C CoEng_dtrqSlpLimDwn3_C CoEng_dtrqSlpLimUp4_C CoEng_dtrqSlpLimDwn4_C CoEng_dtrqSlpLimUp5_C CoEng_dtrqSlpLimDwn5_C CoEng_dtrqSlpLimUp6_C CoEng_dtrqSlpLimDwn6_C CoEng_dtrqSlpLimUpREV_C CoEng_dtrqSlpLimDwnREV_C /end DEF_CHARACTERISTIC
/end FUNCTION
/begin FUNCTION coeng_trqslplim_uic "" /begin DEF_CHARACTERISTIC CoEng_trqSlpLim_Vector CoEng_trqSlpLim_Channel /end DEF_CHARACTERISTIC /end FUNCTION
/begin FUNCTION coeng_tstco "Motortestkoordinator" /begin DEF_CHARACTERISTIC CoEng_tiTstMax_C /end DEF_CHARACTERISTIC /end FUNCTION
/begin FUNCTION coeng_tstco_msg "" /begin OUT_MEASUREMENT CoEng_stTst /end OUT_MEASUREMENT /end FUNCTION
/begin FUNCTION coeng_var "" /end FUNCTION
/begin FUNCTION coeng_var_ers "" /end FUNCTION
/begin FUNCTION coeng_var_ers_msg "" /end FUNCTION
/begin FUNCTION coeng_var_ers_uic "" /end FUNCTION
/begin FUNCTION combas_msg "" /begin OUT_MEASUREMENT ComBas_stDiaReq /end OUT_MEASUREMENT /end FUNCTION
/begin FUNCTION conf_proj "" /end FUNCTION
/begin FUNCTION convcd_co "Komponententreiber zur Mapping Funktion auf Struktur"
 /begin DEF_CHARACTERISTIC ConvCD_DebPlaDef_C ConvCD_DebPlaOk_C ConvCD_tiDebPos_C ConvCD_tiDebNeg_C ConvCD_DebSigDef_C ConvCD_DebSigOk_C ConvCD_nNoGearShftDet_C ConvCD_numDioIn_C ConvCD_numStepDef_C ConvCD_numStepOK_C ConvCD_stDflVal_C ConvCD_stGripCtlAST_C ConvCD_swtInv_C ConvCD_swtSigVal_C ConvCD_tiGearShft_C ConvCD_vNoGearShftDet_C /end DEF_CHARACTERISTIC
/end FUNCTION
/begin FUNCTION convcd_co_uic "" /begin OUT_MEASUREMENT ConvCD_ctClutchDfct_mp /end OUT_MEASUREMENT /end FUNCTION
/begin FUNCTION convcd_msg ""
 /begin OUT_MEASUREMENT ConvCD_stClth ConvCD_stClthRaw ConvCD_stClutchRecord ConvCD_stDebVal ConvCD_stIntDebVal ConvCD_stLastDebVal ConvCD_stLastGear ConvCD_stOldGear ConvCD_stRawVal ConvCD_swtSig /end OUT_MEASUREMENT
/end FUNCTION
/begin FUNCTION conv_grip "Function to calculate converter amplification factor" /end FUNCTION
/begin FUNCTION conv_grip_msg "" /begin OUT_MEASUREMENT Conv_rTrans /end OUT_MEASUREMENT /end FUNCTION
/begin FUNCTION coveh_acsmng "Koordination Nebenaggregate" /begin DEF_CHARACTERISTIC CoVeh_dnLI_C /end DEF_CHARACTERISTIC /end FUNCTION
/begin FUNCTION coveh_acsmng_msg ""
 /begin OUT_MEASUREMENT CoVeh_nAcsMax CoVeh_nAcsMin CoVeh_nLimEngSpd CoVeh_pwrAcsDes CoVeh_pwrAcsLead CoVeh_trqAcs CoVeh_trqAcsDes CoVeh_trqAcsLead CoVeh_trqAcsPerm CoVeh_trqAcsTemp /end OUT_MEASUREMENT
/end FUNCTION
/begin FUNCTION coveh_acsmng_uic "" /begin OUT_MEASUREMENT CoVeh_pwrAcsTempLim_mp CoVeh_trqAcsLimCrSDes_mp /end OUT_MEASUREMENT /end FUNCTION
/begin FUNCTION coveh_drvtrnord "Auftrag für Antrieb" /begin DEF_CHARACTERISTIC CoVeh_dtrqLimDwn_C CoVeh_dtrqLimUp_C CoVeh_trqLim_CUR /end DEF_CHARACTERISTIC /begin IN_MEASUREMENT Eng_nAvrg /end IN_MEASUREMENT /end FUNCTION
/begin FUNCTION coveh_drvtrnordlead_uic "" /begin DEF_CHARACTERISTIC CoVeh_trqPrpLead_Vector CoVeh_trqPrpLead_Channel /end DEF_CHARACTERISTIC /end FUNCTION
/begin FUNCTION coveh_drvtrnord_msg ""
 /begin OUT_MEASUREMENT CoVeh_nMax CoVeh_nMin CoVeh_stOrd CoVeh_trqPrpDes CoVeh_trqPrpLead CoVeh_trqPrpLimErr /end OUT_MEASUREMENT
/end FUNCTION
/begin FUNCTION coveh_drvtrnord_uic "" /begin DEF_CHARACTERISTIC CoVeh_trqPrpDes_Vector CoVeh_trqPrpDes_Channel /end DEF_CHARACTERISTIC /end FUNCTION
/begin FUNCTION covm_demcheck "Vortriebsstabilisierungsprüfung"
 /begin DEF_CHARACTERISTIC CoVM_amMAX_C CoVM_swtPlausChkVal_C CoVM_swtPlausChkType_C CoVM_swtSlipCtlVal_C CoVM_swtSlipCtlType_C CoVM_tiDebMaxOk_C CoVM_tiDebMaxDef_C /end DEF_CHARACTERISTIC
/end FUNCTION
/begin FUNCTION covm_demcheck_msg "" /begin OUT_MEASUREMENT CoVM_stDemCheck CoVM_swtSlipCtl /end OUT_MEASUREMENT /end FUNCTION
/begin FUNCTION covm_demcheck_uic ""
 /begin OUT_MEASUREMENT CoVM_amAct_mp CoVM_stDCSh_mp CoVM_stDemUnplaus_mp CoVM_trqInt_mp /end OUT_MEASUREMENT
/end FUNCTION
/begin FUNCTION covm_demcord "Anforderungskoordination"
 /begin DEF_CHARACTERISTIC CoVM_dtrqLeadCorUp_C CoVM_dtrqLeadCorDwn_C CoVM_swtIntvPrio_C CoVM_swtTrqDesSel_C CoVM_swttrqDVCH_C CoVM_tiTrqRedMax_C /end DEF_CHARACTERISTIC
/end FUNCTION
/begin FUNCTION covm_demcordlead_uic "" /begin OUT_MEASUREMENT CoVM_trqLeadIncMax_mp /end OUT_MEASUREMENT /end FUNCTION
/begin FUNCTION covm_demcord_msg ""
 /begin OUT_MEASUREMENT CoVM_stActDem CoVM_stOrd CoVM_stTrqLeadFrz CoVM_trqDVCH CoVM_trqGearbxMax CoVM_trqGearbxMin CoVM_trqPrpDes CoVM_trqPrpLead /end OUT_MEASUREMENT
/end FUNCTION
/begin FUNCTION covm_demcord_uic "" /begin OUT_MEASUREMENT CoVM_trqDesIncMax_mp Prp_trqMaxDes_mp /end OUT_MEASUREMENT /end FUNCTION
/begin FUNCTION covm_stabdem "Vortriebsstabilisierung"
 /begin DEF_CHARACTERISTIC CoVM_trqDecMax_C CoVM_dtrqLimUpDec_C CoVM_dtrqLimDwnDec_C CoVM_trqDSCMax_C CoVM_trqIncMin_C CoVM_dtrqLimUpInc_C CoVM_dtrqLimDwnInc_C /end DEF_CHARACTERISTIC
/end FUNCTION
/begin FUNCTION covm_stabdem_msg "" /begin OUT_MEASUREMENT CoVM_trqDec CoVM_trqInc /end OUT_MEASUREMENT /end FUNCTION
/begin FUNCTION covm_stabdem_uic "" /begin OUT_MEASUREMENT CoVM_trqDecSetVal_mp CoVM_trqIncSetVal_mp /end OUT_MEASUREMENT /end FUNCTION
/begin FUNCTION cpbvlv_logic ""
 /begin DEF_CHARACTERISTIC CpBVlv_numGear_C CpBVlv_qCloseRgn_MAP CpBVlv_qClose_MAP CpBVlv_qOpnRgn_MAP CpBVlv_qOpn_MAP CpBVlv_stClose_C CpBVlv_stOpn_C CpBVlv_stRgnMsk_C CpBVlv_swtErrOff_C CpBVlv_swtQDesVal_C CpBVlv_tiRmpSlp_C /end DEF_CHARACTERISTIC
 /begin IN_MEASUREMENT APSCD_pVal Eng_nAvrg /end IN_MEASUREMENT
/end FUNCTION
/begin FUNCTION cpbvlv_logic_msg "" /begin OUT_MEASUREMENT CpBVlv_stLogic CpBVlv_stOpn /end OUT_MEASUREMENT /end FUNCTION
/begin FUNCTION cpbvlv_logic_uic "" /begin OUT_MEASUREMENT CpBVlv_qClose_mp CpBVlv_qOpn_mp CpBVlv_stOff_mp /end OUT_MEASUREMENT /end FUNCTION
/begin FUNCTION crccd_keydet "Bedienteilerfassung Fahrgeschwindigkeitsregler"
 /begin DEF_CHARACTERISTIC CrCCD_tiDebMaxMFLDef_C CrCCD_tiDebMaxMFLOk_C CrCCD_tiDebMinMFLDef_C CrCCD_tiDebMinMFLOk_C CrCCD_tiDebNplMFLDef_C CrCCD_tiDebNplMFLOk_C CrCCD_tiDebSigMFLDef_C CrCCD_tiDebSigMFLOk_C CrCCD_stMSWModeAdjMax_C CrCCD_stMSWModeAdjMin_C CrCCD_stMSWModeDflt_C CrCCD_swtDevType_C CrCCD_swtDevVal_C CrCCD_swtMSWType_C CrCCD_swtMSWVal_C CrCCD_tiDebSetMn_C CrCCD_tiDebSetPl_C CrCCD_tiToggleMax_C /end DEF_CHARACTERISTIC
/end FUNCTION
/begin FUNCTION crccd_keydet_msg ""
 /begin OUT_MEASUREMENT CrCCD_stDev CrCCD_stKey CrCCD_stKeyOff CrCCD_swtDev CrCCD_swtMSW /end OUT_MEASUREMENT
/end FUNCTION
/begin FUNCTION crccd_keydet_uic "" /begin OUT_MEASUREMENT CrCCD_dMFLData_mp /end OUT_MEASUREMENT /end FUNCTION
/begin FUNCTION crctl_detcrctl "" /end FUNCTION
/begin FUNCTION crctl_detcrctl_msg "" /begin OUT_MEASUREMENT CrCtl_stRecFGR /end OUT_MEASUREMENT /end FUNCTION
/begin FUNCTION crctl_detcrctl_uic "" /end FUNCTION
/begin FUNCTION crctl_msg "" /begin OUT_MEASUREMENT CrCtl_stActive CrCtl_trqDes CrCtl_trqLead /end OUT_MEASUREMENT /end FUNCTION
/begin FUNCTION crctl_sendvmrk "Aufbereitung Stufentempomatinformation für Kombi" /begin DEF_CHARACTERISTIC TMSGSGTMN /end DEF_CHARACTERISTIC /end FUNCTION
/begin FUNCTION crctl_sendvmrk_msg ""
 /begin OUT_MEASUREMENT B_acmsggts B_cmsggts B_ergacgt B_mrkvff indexmrst tnomgs60ms vmrki1_w vmrki2_w vmrki3_w /end OUT_MEASUREMENT
/end FUNCTION
/begin FUNCTION crctl_sendvmrk_uic "" /end FUNCTION
/begin FUNCTION crctl_shutoff "FGR-Abschaltung"
 /begin DEF_CHARACTERISTIC CrCtl_aAccMax_C CrCtl_aDecMax_C CrCtl_nMaxAlw_C CrCtl_nMinAlw_C CrCtl_rVnDvtShutOff_C CrCtl_stShutOffCodeMsk_C CrCtl_stShutOffHDC_C CrCtl_stShutOffInfoLR_C CrCtl_stShutOffLR_C CrCtl_swtSelKombi_C CrCtl_swtShutOffOpt_C CrCtl_tiAcc_C CrCtl_tiAqpl_C CrCtl_tiClCtrDelayABS_C CrCtl_tiClCtrDelayASC_C CrCtl_tiClCtrDelayDSC_C CrCtl_tiClCtrDelayEBV_C CrCtl_tiClCtrDelayHBA_C CrCtl_tiClCtrDelayMSR_C CrCtl_tiDec_C CrCtl_tiGearDeb_C CrCtl_tiNegDvtTi_C CrCtl_vDiffAqpl_C CrCtl_vMaxShutOff_C CrCtl_vMinShutOff_C CrCtl_vNegDvtTi_C CrCtl_vNegDvt_C CrCtl_vPosDvt_C /end DEF_CHARACTERISTIC
/end FUNCTION
/begin FUNCTION crctl_shutoff_msg "" /begin OUT_MEASUREMENT CrCtl_numGear CrCtl_stShutOffCode /end OUT_MEASUREMENT /end FUNCTION
/begin FUNCTION crctl_shutoff_uic ""
 /begin OUT_MEASUREMENT CrCtl_stBrkBeforeCruise_mp CrCtl_stClCtr_mp CrCtl_stShutOffCode1_mp CrCtl_stShutOffCode2_mp CrCtl_stShutOffFrz1_mp CrCtl_stShutOffFrz2_mp CrCtl_stShutOffFrz_mp /end OUT_MEASUREMENT
/end FUNCTION
/begin FUNCTION crctl_updatedem "FGR-Anforderungen Update (Abschalten + Regler)"
 /begin DEF_CHARACTERISTIC CrCtl_aAccLim_C CrCtl_AccGear2PKp_C CrCtl_AccGear2PKpPos_C CrCtl_AccGear2PKpNeg_C CrCtl_vAccGear2PWinPos_C CrCtl_vAccGear2PWinNeg_C CrCtl_AccGear3PKp_C CrCtl_AccGear3PKpPos_C CrCtl_AccGear3PKpNeg_C CrCtl_vAccGear3PWinPos_C CrCtl_vAccGear3PWinNeg_C CrCtl_AccGear4PKp_C CrCtl_AccGear4PKpPos_C CrCtl_AccGear4PKpNeg_C CrCtl_vAccGear4PWinPos_C CrCtl_vAccGear4PWinNeg_C CrCtl_AccGear5PKp_C CrCtl_AccGear5PKpPos_C CrCtl_AccGear5PKpNeg_C CrCtl_vAccGear5PWinPos_C CrCtl_vAccGear5PWinNeg_C CrCtl_AccGear6PKp_C CrCtl_AccGear6PKpPos_C CrCtl_AccGear6PKpNeg_C CrCtl_vAccGear6PWinPos_C CrCtl_vAccGear6PWinNeg_C CrCtl_aDeclLim_C CrCtl_ctMaxTip_C CrCtl_DeclGear2PKp_C CrCtl_DeclGear2PKpPos_C CrCtl_DeclGear2PKpNeg_C CrCtl_vDeclGear2PWinPos_C CrCtl_vDeclGear2PWinNeg_C CrCtl_DeclGear3PKp_C CrCtl_DeclGear3PKpPos_C CrCtl_DeclGear3PKpNeg_C CrCtl_vDeclGear3PWinPos_C CrCtl_vDeclGear3PWinNeg_C CrCtl_DeclGear4PKp_C CrCtl_DeclGear4PKpPos_C CrCtl_DeclGear4PKpNeg_C CrCtl_vDeclGear4PWinPos_C CrCtl_vDeclGear4PWinNeg_C CrCtl_DeclGear5PKp_C CrCtl_DeclGear5PKpPos_C CrCtl_DeclGear5PKpNeg_C CrCtl_vDeclGear5PWinPos_C CrCtl_vDeclGear5PWinNeg_C CrCtl_DeclGear6PKp_C CrCtl_DeclGear6PKpPos_C CrCtl_DeclGear6PKpNeg_C CrCtl_vDeclGear6PWinPos_C CrCtl_vDeclGear6PWinNeg_C CrCtl_tiDT1vCurr_C CrCtl_kdDT1vCurr_C CrCtl_dtrqAccDwn_C CrCtl_dtrqDeclUp_C CrCtl_dtrqOffComf1_C CrCtl_dtrqOffComf2_C CrCtl_dtrqOffFast1_CUR CrCtl_dtrqOffFast2_CUR CrCtl_dtrqOffFast3_CUR CrCtl_dvAccFDCG3_CUR CrCtl_dvAccFDCG4_CUR CrCtl_dvAccFDCG5_CUR CrCtl_dvAccFDCG6_CUR CrCtl_dvAccG3_CUR CrCtl_dvAccG4_CUR CrCtl_dvAccG5_CUR CrCtl_dvAccG6_CUR CrCtl_dvDeclFDCG3_CUR CrCtl_dvDeclFDCG4_CUR CrCtl_dvDeclFDCG5_CUR CrCtl_dvDeclFDCG6_CUR CrCtl_dvDeclG3_CUR CrCtl_dvDeclG4_CUR CrCtl_dvDeclG5_CUR CrCtl_dvDeclG6_CUR CrCtl_dvResAbvFDCG3_CUR CrCtl_dvResAbvFDCG4_CUR CrCtl_dvResAbvFDCG5_CUR CrCtl_dvResAbvFDCG6_CUR CrCtl_dvResAbvG3_MAP CrCtl_dvResAbvG4_MAP CrCtl_dvResAbvG5_MAP CrCtl_dvResAbvG6_MAP CrCtl_dvResBlwFDCG3_CUR CrCtl_dvResBlwFDCG4_CUR CrCtl_dvResBlwFDCG5_CUR CrCtl_dvResBlwFDCG6_CUR CrCtl_dvResBlwG3_MAP CrCtl_dvResBlwG4_MAP CrCtl_dvResBlwG5_MAP CrCtl_dvResBlwG6_MAP CrCtl_facIncSlope_CUR CrCtl_facPropAcc_C CrCtl_facPropDecl_C CrCtl_facRedDecl_C CrCtl_facRedHi_C CrCtl_facRedLo_C CrCtl_facResAbvFDC_CUR CrCtl_facResAbv_CUR CrCtl_facResBlwFDC_CUR CrCtl_facResBlw_CUR CrCtl_facRmpRes_C CrCtl_HoldGear2IKi_C CrCtl_HoldGear2IKiPos_C CrCtl_HoldGear2IKiNeg_C CrCtl_vHoldGear2IWinPos_C CrCtl_vHoldGear2IWinNeg_C CrCtl_HoldGear2PKp_C CrCtl_HoldGear2PKpPos_C CrCtl_HoldGear2PKpNeg_C CrCtl_vHoldGear2PWinPos_C CrCtl_vHoldGear2PWinNeg_C CrCtl_HoldGear3IKi_C CrCtl_HoldGear3IKiPos_C CrCtl_HoldGear3IKiNeg_C CrCtl_vHoldGear3IWinPos_C CrCtl_vHoldGear3IWinNeg_C CrCtl_HoldGear3PKp_C CrCtl_HoldGear3PKpPos_C CrCtl_HoldGear3PKpNeg_C CrCtl_vHoldGear3PWinPos_C CrCtl_vHoldGear3PWinNeg_C CrCtl_HoldGear4IKi_C CrCtl_HoldGear4IKiPos_C CrCtl_HoldGear4IKiNeg_C CrCtl_vHoldGear4IWinPos_C CrCtl_vHoldGear4IWinNeg_C CrCtl_HoldGear4PKp_C CrCtl_HoldGear4PKpPos_C CrCtl_HoldGear4PKpNeg_C CrCtl_vHoldGear4PWinPos_C CrCtl_vHoldGear4PWinNeg_C CrCtl_HoldGear5IKi_C CrCtl_HoldGear5IKiPos_C CrCtl_HoldGear5IKiNeg_C CrCtl_vHoldGear5IWinPos_C CrCtl_vHoldGear5IWinNeg_C CrCtl_HoldGear5PKp_C CrCtl_HoldGear5PKpPos_C CrCtl_HoldGear5PKpNeg_C CrCtl_vHoldGear5PWinPos_C CrCtl_vHoldGear5PWinNeg_C CrCtl_HoldGear6IKi_C CrCtl_HoldGear6IKiPos_C CrCtl_HoldGear6IKiNeg_C CrCtl_vHoldGear6IWinPos_C CrCtl_vHoldGear6IWinNeg_C CrCtl_HoldGear6PKp_C CrCtl_HoldGear6PKpPos_C CrCtl_HoldGear6PKpNeg_C CrCtl_vHoldGear6PWinPos_C CrCtl_vHoldGear6PWinNeg_C CrCtl_tiResAbvGear2DT1_C CrCtl_ResAbvGear2DT1Kd_C CrCtl_tiResAbvGear3DT1_C CrCtl_ResAbvGear3DT1Kd_C CrCtl_tiResAbvGear4DT1_C CrCtl_ResAbvGear4DT1Kd_C CrCtl_tiResAbvGear5DT1_C CrCtl_ResAbvGear5DT1Kd_C CrCtl_tiResAbvGear6DT1_C CrCtl_ResAbvGear6DT1Kd_C CrCtl_ResBlwGear2IKi_C CrCtl_ResBlwGear2IKiPos_C CrCtl_ResBlwGear2IKiNeg_C CrCtl_vResBlwGear2IWinPos_C CrCtl_vResBlwGear2IWinNeg_C CrCtl_ResBlwGear2PKp_C CrCtl_ResBlwGear2PKpPos_C CrCtl_ResBlwGear2PKpNeg_C CrCtl_vResBlwGear2PWinPos_C CrCtl_vResBlwGear2PWinNeg_C CrCtl_ResBlwGear3IKi_C CrCtl_ResBlwGear3IKiPos_C CrCtl_ResBlwGear3IKiNeg_C CrCtl_vResBlwGear3IWinPos_C CrCtl_vResBlwGear3IWinNeg_C CrCtl_ResBlwGear3PKp_C CrCtl_ResBlwGear3PKpPos_C CrCtl_ResBlwGear3PKpNeg_C CrCtl_vResBlwGear3PWinPos_C CrCtl_vResBlwGear3PWinNeg_C CrCtl_ResBlwGear4IKi_C CrCtl_ResBlwGear4IKiPos_C CrCtl_ResBlwGear4IKiNeg_C CrCtl_vResBlwGear4IWinPos_C CrCtl_vResBlwGear4IWinNeg_C CrCtl_ResBlwGear4PKp_C CrCtl_ResBlwGear4PKpPos_C CrCtl_ResBlwGear4PKpNeg_C CrCtl_vResBlwGear4PWinPos_C CrCtl_vResBlwGear4PWinNeg_C CrCtl_ResBlwGear5IKi_C CrCtl_ResBlwGear5IKiPos_C CrCtl_ResBlwGear5IKiNeg_C CrCtl_vResBlwGear5IWinPos_C CrCtl_vResBlwGear5IWinNeg_C CrCtl_ResBlwGear5PKp_C CrCtl_ResBlwGear5PKpPos_C CrCtl_ResBlwGear5PKpNeg_C CrCtl_vResBlwGear5PWinPos_C CrCtl_vResBlwGear5PWinNeg_C CrCtl_ResBlwGear6IKi_C CrCtl_ResBlwGear6IKiPos_C CrCtl_ResBlwGear6IKiNeg_C CrCtl_vResBlwGear6IWinPos_C CrCtl_vResBlwGear6IWinNeg_C CrCtl_ResBlwGear6PKp_C CrCtl_ResBlwGear6PKpPos_C CrCtl_ResBlwGear6PKpNeg_C CrCtl_vResBlwGear6PWinPos_C CrCtl_vResBlwGear6PWinNeg_C CrCtl_ResRmpGear2PKp_C CrCtl_ResRmpGear2PKpPos_C CrCtl_ResRmpGear2PKpNeg_C CrCtl_vResRmpGear2PWinPos_C CrCtl_vResRmpGear2PWinNeg_C CrCtl_ResRmpGear3PKp_C CrCtl_ResRmpGear3PKpPos_C CrCtl_ResRmpGear3PKpNeg_C CrCtl_vResRmpGear3PWinPos_C CrCtl_vResRmpGear3PWinNeg_C CrCtl_ResRmpGear4PKp_C CrCtl_ResRmpGear4PKpPos_C CrCtl_ResRmpGear4PKpNeg_C CrCtl_vResRmpGear4PWinPos_C CrCtl_vResRmpGear4PWinNeg_C CrCtl_ResRmpGear5PKp_C CrCtl_ResRmpGear5PKpPos_C CrCtl_ResRmpGear5PKpNeg_C CrCtl_vResRmpGear5PWinPos_C CrCtl_vResRmpGear5PWinNeg_C CrCtl_ResRmpGear6PKp_C CrCtl_ResRmpGear6PKpPos_C CrCtl_ResRmpGear6PKpNeg_C CrCtl_vResRmpGear6PWinPos_C CrCtl_vResRmpGear6PWinNeg_C CrCtl_swtResOff_C CrCtl_tiOff_C CrCtl_tiTipUpDn_C CrCtl_trqDesThres_C CrCtl_trqMaxOfs_C CrCtl_trqOffComf_C CrCtl_trqOffFast12_C CrCtl_trqOffFast23_C CrCtl_vAccSet_C CrCtl_vAlwDvtThres_C CrCtl_vDeclSet_C CrCtl_vDiffAccMax_C CrCtl_vDiffAcc_C CrCtl_vDiffActvTrqDecHi_C CrCtl_vDiffActvTrqDecLo_C CrCtl_vDiffDeclMax_C CrCtl_vDiffDecl_C CrCtl_vDiffResAbv_C CrCtl_vDiffResBlw_C CrCtl_vDvtNegSwtToResAbv_C CrCtl_vDvtNegTipDwn_C CrCtl_vDvtNegTipUp_C CrCtl_vDvtPosTipDwn_C CrCtl_vHypDenom_C CrCtl_vHypNum_C CrCtl_vOfsDecl_C CrCtl_vOfsResBlw_C CrCtl_vOfsRes_C CrCtl_vRlsOfsI_C CrCtl_vTipStep_C /end DEF_CHARACTERISTIC
 /begin IN_MEASUREMENT CrCtl_vBeg CrCtl_vDiffRed_mp CrCtl_vDiff_mp Gearbx_stGear Rail_tiThresMonEna /end IN_MEASUREMENT
/end FUNCTION
/begin FUNCTION crctl_updatedem_msg ""
 /begin OUT_MEASUREMENT CrCtl_rVnBeg CrCtl_st CrCtl_stCAN CrCtl_stLampOut CrCtl_vBeg CrCtl_vDes CrCtl_vRmp /end OUT_MEASUREMENT
/end FUNCTION
/begin FUNCTION crctl_updatedem_uic ""
 /begin DEF_CHARACTERISTIC CrCtl_trqDes_Vector CrCtl_trqDes_Channel CrCtl_trqLead_Vector CrCtl_trqLead_Channel /end DEF_CHARACTERISTIC
 /begin OUT_MEASUREMENT CrCtl_dvAcc_mp CrCtl_dvDecl_mp CrCtl_dvResAbv_mp CrCtl_dvResBlw_mp CrCtl_facHyp_mp CrCtl_stFrzIGovGbx_mp CrCtl_stHysTrqDec_mp CrCtl_trqDec_mp CrCtl_trqDT1_mp CrCtl_trqI_mp CrCtl_trqMax_mp CrCtl_trqP_mp CrCtl_vDiffRed_mp CrCtl_vDiff_mp /end OUT_MEASUREMENT
/end FUNCTION
/begin FUNCTION crctl_vcrctl "Aktuelle Fahrzeuggeschwindigkeit für GRA"
 /begin DEF_CHARACTERISTIC CrCtl_DebToVCrCtlDef_C CrCtl_DebToVCrCtlOk_C CrCtl_rAccPedVelMin_C CrCtl_swtCrCtlType_C CrCtl_swtOffset_C CrCtl_swtVSSFil_C CrCtl_tiDisableDiagVCrCtl_C CrCtl_tiDispOffFil_C CrCtl_tiVSSFil2_C CrCtl_tiVSSFil_C CrCtl_uBattMin_C CrCtl_vAlwMaxKm_C CrCtl_vAlwMaxMPH_C CrCtl_vAlwMinKm_C CrCtl_vAlwMinMPH_C CrCtl_vOffMax_C /end DEF_CHARACTERISTIC
/end FUNCTION
/begin FUNCTION crctl_vcrctl_msg ""
 /begin OUT_MEASUREMENT CrCtl_stVCrCtl CrCtl_vAlwMax CrCtl_vAlwMin CrCtl_vCurr CrCtl_vDispOffset /end OUT_MEASUREMENT
/end FUNCTION
/begin FUNCTION crctl_vcrctl_uic "" /end FUNCTION
/begin FUNCTION crctl_vsetstep "Stufentempomat"
 /begin DEF_CHARACTERISTIC ANZMRKAUS ANZMRKMX CWBGSTUT DVMARK DVMARKMI DVPRG DVPRGMI DVSTUTOM DVSTUTOMMI TFGRTP TMARK TMRKBLI TSELO TVSTUTK TVSTUTL VFGRPRG VVEMOFS /end DEF_CHARACTERISTIC
/end FUNCTION
/begin FUNCTION crctl_vsetstep_msg ""
 /begin OUT_MEASUREMENT anzmark BGSTUTlokbits0 B_beveh B_bv1 B_bv2 B_envtwa B_fgrepa B_mrkbli B_mrkein B_mrkv B_prgmod B_tmark B_tmrkbli B_vziels canzbl ctblink dvmark_w dvprg_w dvstutom_w mrknrc mrknrcan mrknrint mrkstut_w statvza vzielakvp_w vzielak_w vziels_w /end OUT_MEASUREMENT
/end FUNCTION
/begin FUNCTION crctl_vsetstep_uic "" /begin OUT_MEASUREMENT CrCtl_BGSTUTbits2_mp CrCtl_mrkeinvp_mp /end OUT_MEASUREMENT /end FUNCTION
/begin FUNCTION crctl_vstepadapt "Aufbereitung der Größen für den Stufentempomaten" /end FUNCTION
/begin FUNCTION crctl_vstepadapt_msg ""
 /begin OUT_MEASUREMENT B_acc B_besch B_fgrat B_fgren B_fgresv B_fgrtb2 B_fgrtbe B_fgrtv2 B_fgrtve B_fgrtwa B_fgrvem B_insfgre B_kl15 B_km B_mmiena CrCtl_numVMrk CrCtl_stCC CrCtl_stUpdateVMrk CrCtl_stVDisp CrCtl_stVSetNew CrCtl_vDesDisp CrCtl_vMrk1 CrCtl_vMrk2 CrCtl_vMrk3 CrCtl_vSetNew mmimrk_w vfgr_w vreglmax_w vreglmin_w vziel_w /end OUT_MEASUREMENT
/end FUNCTION
/begin FUNCTION crctl_vstepadapt_uic "" /end FUNCTION
/begin FUNCTION crscd "Komponententreiber Kurbelwelle"
 /begin DEF_CHARACTERISTIC CrSCD_ctTurns_C CrSCD_nFast_C CrSCD_nMax_C CrSCD_nMin_C CrSCD_nSlowHigh_C CrSCD_nSlow_C CrSCD_numShftMisf_C CrSCD_phiIncCor_CUR CrSCD_phiSegLength_C CrSCD_phiSegPhase_C /end DEF_CHARACTERISTIC
 /begin IN_MEASUREMENT CrSCD_nAvrg /end IN_MEASUREMENT
/end FUNCTION
/begin FUNCTION crscd_msg ""
 /begin OUT_MEASUREMENT CrSCD_dSegMisf CrSCD_nAvrg CrSCD_nAvrgHiRes CrSCD_nCurr CrSCD_nCurrHiRes CrSCD_nDyn CrSCD_nHold CrSCD_nMisf CrSCD_numSeg CrSCD_phiIncCor CrSCD_phiIncr CrSCD_tiSeg /end OUT_MEASUREMENT
/end FUNCTION
/begin FUNCTION crscd_thresctl ""
 /begin DEF_CHARACTERISTIC CrSCD_ctThresCtlMin_C CrSCD_nThresCtlHigh_C CrSCD_nThresCtlLow_C /end DEF_CHARACTERISTIC
/end FUNCTION
/begin FUNCTION crscd_uic ""
 /begin OUT_MEASUREMENT CrSCD_incNextIntDelta_mp CrSCD_incNextInt_mp CrSCD_phiCurr_mp CrSCD_phiSegGrid_mp CrSCD_stIncErr_mp CrSCD_stIncSig_mp CrSCD_stIncSyncInc_mp CrSCD_stIncSyncPhase_mp /end OUT_MEASUREMENT
/end FUNCTION
/begin FUNCTION crscd_var ""
 /begin DEF_CHARACTERISTIC CrSCD_ctGapIncs_C CrSCD_ctGaps_C CrSCD_ctIncs_C CrSCD_facGapPlausHigh_CUR CrSCD_facGapPlausLow_CUR CrSCD_facIncPlausHigh_CUR CrSCD_facIncPlausLow_CUR CrSCD_numFBCSeg_C CrSCD_numTDCSeg_C CrSCD_phiGap2Zero_C CrSCD_tiPlausCalcOff_C /end DEF_CHARACTERISTIC
 /begin IN_MEASUREMENT CrSCD_tiIncr /end IN_MEASUREMENT
/end FUNCTION
/begin COMPU_METHOD Acc "Fahrzeugbeschleunigung" RAT_FUNC "%6.5" "m/s^2" COEFFS 0 1000 0 0 0 1 /end COMPU_METHOD
/begin COMPU_METHOD AngleCrS "Winkel Kurbelwelle" RAT_FUNC "%6.4" "deg CrS" COEFFS 0 42.6666666666667 0 0 0 1 /end COMPU_METHOD
/begin COMPU_METHOD B_TRUE "Umrechnung   ----> FALSE;    TRUE = TRUE" TAB_VERB "%6.3" "-" COMPU_TAB_REF B_TRUE /end COMPU_METHOD
/begin COMPU_VTAB B_TRUE "Umrechnung   ----> FALSE;    TRUE = TRUE" TAB_VERB 2 0 "FALSE" 1 "TRUE" /end COMPU_VTAB
/begin COMPU_METHOD CubMtrPerHr "Volumsstrom in m^3/h" RAT_FUNC "%6.3" "m^3/h" COEFFS 0 10 0 0 0 1 /end COMPU_METHOD
/begin COMPU_METHOD dez "K3 Umwandlungen" RAT_FUNC "%6.2" "-" COEFFS 0 1 0 0 0 1 /end COMPU_METHOD
/begin COMPU_METHOD Dia "Durchmesser des Rades" RAT_FUNC "%7.6" "m" COEFFS 0 10000 0 0 0 1 /end COMPU_METHOD
/begin COMPU_METHOD dn_dZ20 "Motorbeschleunigung pro Zeit (dn/dt) (im 20 ms Raster)" RAT_FUNC "%6.1" "rpm/s" COEFFS 0 0.1 0 0 0 1 /end COMPU_METHOD
/begin COMPU_METHOD dTrqPrp_20ms "Anstieg Vortriebsmoment im 20 ms Raster" RAT_FUNC "%6.1" "Nm/s" COEFFS 0 0.1 0 0 0 1 /end COMPU_METHOD
/begin COMPU_METHOD dVel_20ms "Anstieg Fahrgeschwindigkeit im 20 ms Raster" RAT_FUNC "%6.3" "(km/h)/s" COEFFS 0 2 0 0 0 1 /end COMPU_METHOD
/begin COMPU_METHOD EngN "Motordrehzahl" RAT_FUNC "%6.2" "rpm" COEFFS 0 1 0 0 0 1 /end COMPU_METHOD
/begin COMPU_METHOD EngN_HiRes "Motordrehzahl, höhere Auflösung als EngM" RAT_FUNC "%6.3" "rpm" COEFFS 0 8 0 0 0 1 /end COMPU_METHOD
/begin COMPU_METHOD Fact "Faktor mit Auflösung 1 / 8192, hauptsächlich für einen Faktorenbereich 0...1 verwendet" RAT_FUNC "%6.5" "-" COEFFS 0 8192 0 0 0 1 /end COMPU_METHOD
/begin COMPU_METHOD Fact2 "Faktor mit Auflösung 0.001, für einen Faktorenbereich 0...5,46117 verwendet" RAT_FUNC "%7.6" "-" COEFFS 0 16384 0 0 0 1 /end COMPU_METHOD
/begin COMPU_METHOD Fact_Inc "Faktor für Inkrement/Gap Plausibilitäts-Fenster" RAT_FUNC "%6.4" "-" COEFFS 0 256 0 0 0 1 /end COMPU_METHOD
/begin COMPU_METHOD InjMass "Einspritzmenge" RAT_FUNC "%6.4" "mg/hub" COEFFS 0 100 0 0 0 1 /end COMPU_METHOD
/begin COMPU_METHOD InjMassCyc "Einspritzmenge pro Zyklus (mg/Zyklus)" RAT_FUNC "%6.4" "mg/cyc" COEFFS 0 100 0 0 0 1 /end COMPU_METHOD
/begin COMPU_METHOD Kd_rpm2dndt "differential gain(engine speed to rate of change of engine speed)" RAT_FUNC "%8.7" "rmp/sec/rpm" COEFFS 0 131072 0 0 0 1 /end COMPU_METHOD
/begin COMPU_METHOD Kd_Vel2TrqPrp "Differentialverstärkung (Fahrgeschwindigkeit zu Vortriebsmoment)" RAT_FUNC "%6.5" "Nm/(km/h)" COEFFS 0 3276.8 0 0 0 1 /end COMPU_METHOD
/begin COMPU_METHOD Ki_Vel2TrqPrp "Integralverstärkung (Fahrgeschwindigkeit zu Vortriebsmoment)" RAT_FUNC "%6.4" "Nm/(km/h)/s" COEFFS 0 214.7483648 0 0 0 1 /end COMPU_METHOD
/begin COMPU_METHOD Kp_Vel2TrqPrp "Proportionalverstärkung (Fahrgeschwindigkeit zu Vortriebsmoment)" RAT_FUNC "%6.5" "Nm/(km/h)" COEFFS 0 3276.8 0 0 0 1 /end COMPU_METHOD
/begin COMPU_METHOD NumPinDioIn "Verbale Umrechnung für Digitaleingang Signale" TAB_VERB "%6.3" "-" COMPU_TAB_REF NumPinDioIn /end COMPU_METHOD
/begin COMPU_VTAB NumPinDioIn "Verbale Umrechnung für Digitaleingang Signale" TAB_VERB 15 0 "Terminal_15_207" 1 "Main_Brake_Switch_236" 2 "Redundant_Brake_Switch_223" 3 "Clutch_Switch" 4 "Terminal_50_224" 5 "ECU_selection_Switch_251" 6 "FlFlt_Switch_211" 7 "Coolant-heater_212" 8 "Redundant_Terminal_15_209(118)" 9 "AC-compressor_overboost_213" 10 "Additive_tank_level_switch_235" 11 "Terminal_61_113" 12 "Lambda_Regeneration" 13 "Oil_Level_sensor(12hex)_VSA_Diagnose(11hex)_138" 14 "DIO_IN_DUMMY_NOT_USED" /end COMPU_VTAB
/begin COMPU_METHOD OneToOne "eins zu eins (physikalischer Wert ist gleich dem internen Wert)" RAT_FUNC "%6.2" "-" COEFFS 0 1 0 0 0 1 /end COMPU_METHOD
/begin COMPU_METHOD Per_Dur "Periodendauer Segmentzeit" RAT_FUNC "%6.2" "usec" COEFFS 0 1 0 0 0 1 /end COMPU_METHOD
/begin COMPU_METHOD Prc "Prozent, gleiche interne Auflösung wie Fact, aber Darstellung in Prozent (0...100%)" RAT_FUNC "%6.4" "%" COEFFS 0 81.92 0 0 0 1 /end COMPU_METHOD
/begin COMPU_METHOD Prc_1000 "Prozentumrechnung mit größerer Quantisierung, dafür größerer Wertebereich" RAT_FUNC "%6.3" "%" COEFFS 0 8.192 0 0 0 1 /end COMPU_METHOD
/begin COMPU_METHOD Pres_hPa "Druck (angezeigt in [hPa])" RAT_FUNC "%6.2" "hPa" COEFFS 0 1 0 0 0 1 /end COMPU_METHOD
/begin COMPU_METHOD Pwr "Leistung" RAT_FUNC "%6.2" "W" COEFFS 0 0.10610329539459 0 0 0 1 /end COMPU_METHOD
/begin COMPU_METHOD Res_hPaHrPerCM "Strömungswiderstand [hPa h/m3]" RAT_FUNC "%6.5" "hPa/(m^3/h)" COEFFS 0 1000 0 0 0 1 /end COMPU_METHOD
/begin COMPU_METHOD RmpTrq "Rampengradient für Motormoment" RAT_FUNC "%6.4" "Nm/s" COEFFS 0 655.36 0 0 0 1 /end COMPU_METHOD
/begin COMPU_METHOD RmpTrqPrp "Rampenanstieg für Vortriebsmoment [Nm/s]" RAT_FUNC "%6.4" "Nm/s" COEFFS 0 327.68 0 0 0 1 /end COMPU_METHOD
/begin COMPU_METHOD t20msxs_ub_b5p1 "K3 Umwandlungen" RAT_FUNC "%6.4" "s" COEFFS 0 1 0 0 0 0.02 /end COMPU_METHOD
/begin COMPU_METHOD Temp_Cels "Temperatur dargestellt in °C (gleiche interne Darstellung wie Temp_Kelv)" RAT_FUNC "%6.1" "deg C" COEFFS 0 10 2731.4 0 0 1 /end COMPU_METHOD
/begin COMPU_METHOD TimeDeb "Entprellzeit in Millisekunden für Libraryfunktion Debounce" RAT_FUNC "%6.1" "ms" COEFFS 0 0.1 0 0 0 1 /end COMPU_METHOD
/begin COMPU_METHOD TimeDelay_s "Zeitkonstante T1 (in s) für PT1, DT1, etc." RAT_FUNC "%9.3" "s" COEFFS 0 0 1 0 0.00023283064365387 0 /end COMPU_METHOD
/begin COMPU_METHOD TimeDT "Abtastzeit (in us) für Library Regler, Filter, etc." RAT_FUNC "%6.2" "us" COEFFS 0 1 0 0 0 1 /end COMPU_METHOD
/begin COMPU_METHOD TimeEGTRmp "Umrechnung  Zeit in Rampensteigung,  Verwendet in EGT-Bibliothek" RAT_FUNC "%6.3" "s" COEFFS 0 0 1 0 0.0152587890625 0 /end COMPU_METHOD
/begin COMPU_METHOD Time_ms "Zeit in ms für Fehlerentprellung (DSM) und SW-Timer" RAT_FUNC "%6.1" "ms" COEFFS 0 0.1 0 0 0 1 /end COMPU_METHOD
/begin COMPU_METHOD Time_s "Zeit in s für Fehlerentprellung (DSM) und SW-Timer" RAT_FUNC "%6.4" "s" COEFFS 0 100 0 0 0 1 /end COMPU_METHOD
/begin COMPU_METHOD TransR "Übersetzungsverhältnis (Getriebe etc.)" RAT_FUNC "%6.4" "-" COEFFS 0 100 0 0 0 1 /end COMPU_METHOD
/begin COMPU_METHOD Trq "Motormoment" RAT_FUNC "%6.3" "Nm" COEFFS 0 10 0 0 0 1 /end COMPU_METHOD
/begin COMPU_METHOD TrqPrp "Vortriebsmoment" RAT_FUNC "%6.3" "Nm" COEFFS 0 5 0 0 0 1 /end COMPU_METHOD
/begin COMPU_METHOD TrqPrpDT "zeitlich aufintegriertes Vortriebsmoment" RAT_FUNC "%6.2" "Nm*s" COEFFS 0 0.2 0 0 0 1 /end COMPU_METHOD
/begin COMPU_METHOD Vel "Fahrzeuggeschwindigkeit, gleiche interne Auflösung wie Vel_SI" RAT_FUNC "%6.4" "km/h" COEFFS 0 100 0 0 0 1 /end COMPU_METHOD
/begin COMPU_METHOD Vel2TrqPrp "Umwandlung von Fahrgeschwindigkeit zu Vortriebsmoment" RAT_FUNC "%6.4" "Nm/(km/h)" COEFFS 0 409.6 0 0 0 1 /end COMPU_METHOD
/begin COMPU_METHOD VelToN "Verhältnis Fahrzeuggeschwindigkeit zu Motordrehzahl v/n" RAT_FUNC "%8.7" "(km/h)/rpm" COEFFS 0 100000 0 0 0 1 /end COMPU_METHOD
/begin COMPU_METHOD Volt_Batt "Batteriespannung" RAT_FUNC "%6.1" "mV" COEFFS 0 0.05115 0 0 0 1 /end COMPU_METHOD
/begin RECORD_LAYOUT Kf_Xs16_Ys16_Ws16 NO_AXIS_PTS_X 1 SWORD NO_AXIS_PTS_Y 2 SWORD AXIS_PTS_X 3 SWORD INDEX_INCR DIRECT AXIS_PTS_Y 4 SWORD INDEX_INCR DIRECT FNC_VALUES 5 SWORD COLUMN_DIR DIRECT /end RECORD_LAYOUT
/begin RECORD_LAYOUT Kl_Xs16_Ws16 NO_AXIS_PTS_X 1 SWORD AXIS_PTS_X 2 SWORD INDEX_INCR DIRECT FNC_VALUES 3 SWORD COLUMN_DIR DIRECT /end RECORD_LAYOUT
/begin RECORD_LAYOUT KwWU16 FNC_VALUES 1 UWORD COLUMN_DIR DIRECT /end RECORD_LAYOUT
/begin RECORD_LAYOUT KwWU8 FNC_VALUES 1 UBYTE COLUMN_DIR DIRECT /end RECORD_LAYOUT
/begin RECORD_LAYOUT Kw_Ws16 FNC_VALUES 1 SWORD COLUMN_DIR DIRECT /end RECORD_LAYOUT
/begin RECORD_LAYOUT Kw_Ws32 FNC_VALUES 1 SLONG COLUMN_DIR DIRECT /end RECORD_LAYOUT
/begin RECORD_LAYOUT Kw_Ws8 FNC_VALUES 1 SBYTE COLUMN_DIR DIRECT /end RECORD_LAYOUT
/begin RECORD_LAYOUT Kw_Wu16 FNC_VALUES 1 UWORD COLUMN_DIR DIRECT /end RECORD_LAYOUT
/begin RECORD_LAYOUT Kw_Wu32 FNC_VALUES 1 ULONG COLUMN_DIR DIRECT /end RECORD_LAYOUT
/begin RECORD_LAYOUT Kw_Wu8 FNC_VALUES 1 UBYTE COLUMN_DIR DIRECT /end RECORD_LAYOUT
/end MODULE
/end PROJECT
