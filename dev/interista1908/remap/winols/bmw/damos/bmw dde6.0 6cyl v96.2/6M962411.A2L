ASAP2_VERSION 1 3
/begin PROJECT P411 "BMW DDE6.0 6-Zylinder V96.2 14.10.2004"
/begin HEADER "" VERSION "V96.2_6Z" PROJECT_NO P411 /end HEADER
/begin MODULE DIM ""
/begin MOD_COMMON "" BYTE_ORDER MSB_FIRST ALIGNMENT_BYTE 1 ALIGNMENT_WORD 2 ALIGNMENT_LONG 4 ALIGNMENT_FLOAT32_IEEE 4 /end MOD_COMMON
/begin CHARACTERISTIC InjCrv_dtiPiI1RgnRmpUp_C "positive Rampensteigung bei Umschaltung auf Regenerationswert PiI1" VALUE 0xE53E4 Kw_Wu32 65535999.9847 Rmp 0.00 65535999.9847 FORMAT "%13.4" /end CHARACTERISTIC
/begin CHARACTERISTIC InjCrv_dtiPiI1RgnRmpDwn_C "negative Rampensteigung bei Umschaltung auf Regenerationswert PiI1" VALUE 0xE53E8 Kw_Wu32 65535999.9847 Rmp 0.00 65535999.9847 FORMAT "%13.4" /end CHARACTERISTIC
/begin CHARACTERISTIC InjCrv_dtiPiI2RgnRmpUp_C "positive Rampensteigung bei Umschaltung auf Regenerationswert PiI2" VALUE 0xE22D8 Kw_Wu32 65535999.9847 Rmp 0.00 65535999.9847 FORMAT "%13.4" /end CHARACTERISTIC
/begin CHARACTERISTIC InjCrv_dtiPiI2RgnRmpDwn_C "negative Rampensteigung bei Umschaltung auf Regenerationswert PiI2" VALUE 0xE22DC Kw_Wu32 65535999.9847 Rmp 0.00 65535999.9847 FORMAT "%13.4" /end CHARACTERISTIC
/begin CHARACTERISTIC InjCrv_dtiPoI1RgnRmpUp_C "positive Rampensteigung bei Umschaltung auf Regenerationswerte PoI1" VALUE 0xE5F34 Kw_Wu32 65535999.9847 Rmp 0.00 65535999.9847 FORMAT "%13.4" /end CHARACTERISTIC
/begin CHARACTERISTIC InjCrv_dtiPoI1RgnRmpDwn_C "negative Rampensteigung bei Umschaltung auf Regenerationswerte PoI1" VALUE 0xE5F38 Kw_Wu32 65535999.9847 Rmp 0.00 65535999.9847 FORMAT "%13.4" /end CHARACTERISTIC
/begin CHARACTERISTIC InjCrv_dtiPoI1RgnTypeRmpUp_C "positive gradient for activation of regeneration ramp" VALUE 0xE5F3C Kw_Wu32 65535999.9847 Rmp 0.00 65535999.9847 FORMAT "%13.4" /end CHARACTERISTIC
/begin CHARACTERISTIC InjCrv_dtiPoI1RgnTypeRmpDwn_C "negative gradient for activation of regeneration ramp" VALUE 0xE5F40 Kw_Wu32 65535999.9847 Rmp 0.00 65535999.9847 FORMAT "%13.4" /end CHARACTERISTIC
/begin CHARACTERISTIC InjCrv_dtiPoI2RgnEffRmpUp_C "positive gradient of regeneration ramp" VALUE 0xE7AFC Kw_Wu32 65535999.9847 Rmp 0.00 65535999.9847 FORMAT "%13.4" /end CHARACTERISTIC
/begin CHARACTERISTIC InjCrv_dtiPoI2RgnEffRmpDwn_C "negative gradient of regeneration ramp" VALUE 0xE7B00 Kw_Wu32 65535999.9847 Rmp 0.00 65535999.9847 FORMAT "%13.4" /end CHARACTERISTIC
/begin CHARACTERISTIC InjCrv_dtiPoI2RgnRmpUp_C "positive Rampensteigung bei Umschaltung auf Regenerationswerte PoI2" VALUE 0xE7B04 Kw_Wu32 65535999.9847 Rmp 0.00 65535999.9847 FORMAT "%13.4" /end CHARACTERISTIC
/begin CHARACTERISTIC InjCrv_dtiPoI2RgnRmpDwn_C "negative Rampensteigung bei Umschaltung auf Regenerationswerte PoI2" VALUE 0xE7B08 Kw_Wu32 65535999.9847 Rmp 0.00 65535999.9847 FORMAT "%13.4" /end CHARACTERISTIC
/begin CHARACTERISTIC InjCrv_dtiPoI2RgnTypeRmpUp_C "positive gradient of regeneration ramp" VALUE 0xE7B0C Kw_Wu32 65535999.9847 Rmp 0.00 65535999.9847 FORMAT "%13.4" /end CHARACTERISTIC
/begin CHARACTERISTIC InjCrv_dtiPoI2RgnTypeRmpDwn_C "negative gradient of regeneration ramp" VALUE 0xE7B10 Kw_Wu32 65535999.9847 Rmp 0.00 65535999.9847 FORMAT "%13.4" /end CHARACTERISTIC
/begin CHARACTERISTIC InjCrv_facAPPiI1DynCor_CUR "Kennlinie für atmosphärendruckabhängigen Gewichtungsfaktor der Voreinspritzung Pil1" CURVE 0xE292C Kl_Xs16_Ws16 2.000000 Fact 0.00 2.000000 FORMAT "%8.6" EXTENDED_LIMITS -4.000000 3.999878
 /begin AXIS_DESCR STD_AXIS APSCD_pVal Pres_hPa 6 0.00 3500.000 FORMAT "%8.3" EXTENDED_LIMITS -32768.00 32767.00 DEPOSIT ABSOLUTE /end AXIS_DESCR
/end CHARACTERISTIC
/begin CHARACTERISTIC InjCrv_facAPPiI1DynQCor_CUR "atmosphärendruckabhängiger Gewichtungsfaktor" CURVE 0xE2946 Kl_Xs16_Ws16 2.000000 Fact 0.00 2.000000 FORMAT "%8.6" EXTENDED_LIMITS -4.000000 3.999878
 /begin AXIS_DESCR STD_AXIS APSCD_pVal Pres_hPa 6 0.00 3500.000 FORMAT "%8.3" EXTENDED_LIMITS -32768.00 32767.00 DEPOSIT ABSOLUTE /end AXIS_DESCR
/end CHARACTERISTIC
/begin CHARACTERISTIC InjCrv_facDQPiI1DynCor_CUR "Gewichtungskennlinie, abhängig vom Einspritzmengengradianten" CURVE 0xE2400 Kl_Xs16_Ws16 4.000000 Fact -2.000000 2.000000 FORMAT "%8.6" EXTENDED_LIMITS -4.000000 3.999878
 /begin AXIS_DESCR STD_AXIS InjCrv_dqSetUnBalFltLim InjMassPerSec_20ms 6 -16384.00 16383.50 FORMAT "%8.2" DEPOSIT ABSOLUTE /end AXIS_DESCR
/end CHARACTERISTIC
/begin CHARACTERISTIC InjCrv_facDQPiI1DynQCor_CUR "Kennfeld für drehzahlabhängige Mengenkorrektur der Voreinspritzung PiI1" CURVE 0xE241A Kl_Xs16_Ws16 4.000000 Fact -2.000000 2.000000 FORMAT "%8.6" EXTENDED_LIMITS -4.000000 3.999878
 /begin AXIS_DESCR STD_AXIS InjCrv_dqSetUnBalFltLim InjMassPerSec_20ms 6 -16384.00 16383.50 FORMAT "%8.2" DEPOSIT ABSOLUTE /end AXIS_DESCR
/end CHARACTERISTIC
/begin CHARACTERISTIC InjCrv_facETPiI1DynCor_CUR "Kennlinie für motortemperaturabhängigen Gewichtungsfaktor der Voreinspritzung Pil1" CURVE 0xE2960 Kl_Xs16_Ws16 2.000000 Fact 0.00 2.000000 FORMAT "%8.6" EXTENDED_LIMITS -4.000000 3.999878
 /begin AXIS_DESCR STD_AXIS InjCrv_tEng Temp_Cels 6 -50.14000 199.8600 FORMAT "%8.4" EXTENDED_LIMITS -3549.940 3003.560 DEPOSIT ABSOLUTE /end AXIS_DESCR
/end CHARACTERISTIC
/begin CHARACTERISTIC InjCrv_facETPiI1DynQCor_CUR "Kennlinie für motortemperaturabhängigen Gewichtungsfaktor" CURVE 0xE297A Kl_Xs16_Ws16 2.000000 Fact 0.00 2.000000 FORMAT "%8.6" EXTENDED_LIMITS -4.000000 3.999878
 /begin AXIS_DESCR STD_AXIS InjCrv_tEng Temp_Cels 6 -50.14000 199.8600 FORMAT "%8.4" EXTENDED_LIMITS -3549.940 3003.560 DEPOSIT ABSOLUTE /end AXIS_DESCR
/end CHARACTERISTIC
/begin CHARACTERISTIC InjCrv_facIAPiI1DynCor_CUR "Kennlinie für ansauglufttemperaturabhängigen Gewichtungsfaktor der Voreinspritzung PiI1" CURVE 0xE2994 Kl_Xs16_Ws16 2.000000 Fact 0.00 2.000000 FORMAT "%8.6" EXTENDED_LIMITS -4.000000 3.999878
 /begin AXIS_DESCR STD_AXIS IATSCD_tAir Temp_Cels 6 -50.14000 199.8600 FORMAT "%8.4" EXTENDED_LIMITS -3549.940 3003.560 DEPOSIT ABSOLUTE /end AXIS_DESCR
/end CHARACTERISTIC
/begin CHARACTERISTIC InjCrv_facPhPoI2RgnAPCor_CUR "atmosphere pressure part of PoI2 regeneration setpoint correction" CURVE 0xE658E Kl_Xs16_Ws16 2.000000 Fact 0.00 2.000000 FORMAT "%8.6" EXTENDED_LIMITS -4.000000 3.999878
 /begin AXIS_DESCR STD_AXIS APSCD_pLinVal Pres_hPa 1 0.00 3500.000 FORMAT "%8.3" EXTENDED_LIMITS -32768.00 32767.00 DEPOSIT ABSOLUTE /end AXIS_DESCR
/end CHARACTERISTIC
/begin CHARACTERISTIC InjCrv_facPhPoI2RgnETCor_CUR "engine temperature part of PoI2 regeneration setpoint correction" CURVE 0xE6594 Kl_Xs16_Ws16 2.000000 Fact 0.00 2.000000 FORMAT "%8.6" EXTENDED_LIMITS -4.000000 3.999878
 /begin AXIS_DESCR STD_AXIS InjCrv_tEng Temp_Cels 1 -50.14000 199.8600 FORMAT "%8.4" EXTENDED_LIMITS -3549.940 3003.560 DEPOSIT ABSOLUTE /end AXIS_DESCR
/end CHARACTERISTIC
/begin CHARACTERISTIC InjCrv_facPiI1APSQCor2Strt_CUR "weighting factor of atmospheric pressure for quantity correction of PiI1 when PiI2 or PiI3 is active" CURVE 0xE42D8 Kl_Xs16_Ws16 1.000000 Fact 0.00 1.000000 FORMAT "%8.6" EXTENDED_LIMITS -4.000000 3.999878
 /begin AXIS_DESCR STD_AXIS APSCD_pVal Pres_hPa 8 0.00 3500.000 FORMAT "%8.3" EXTENDED_LIMITS -32768.00 32767.00 DEPOSIT ABSOLUTE /end AXIS_DESCR
/end CHARACTERISTIC
/begin CHARACTERISTIC InjCrv_facPiI1APSQCor2_CUR "atmosphärendruckabhängige Mengenkorrekturkennlinie für Voreinspritzung 1 wenn PiI2 oder PiI3 aktiv ist" CURVE 0xE42FA Gkl_Ws16 1.000000 Fact 0.00 1.000000 FORMAT "%8.6" EXTENDED_LIMITS -4.000000 3.999878
 /begin AXIS_DESCR COM_AXIS APSCD_pVal Pres_hPa 10 0.00 3500.000 FORMAT "%8.3" EXTENDED_LIMITS -32768.00 32767.00 AXIS_PTS_REF InjCrv_facPiI1APSQCor_AXIS /end AXIS_DESCR
/end CHARACTERISTIC
/begin CHARACTERISTIC InjCrv_facPiI1APSQCorStrt_CUR "weighting factor of atmospheric pressure for pilot injections quantity correction" CURVE 0xE430E Kl_Xs16_Ws16 1.000000 Fact 0.00 1.000000 FORMAT "%8.6" EXTENDED_LIMITS -4.000000 3.999878
 /begin AXIS_DESCR STD_AXIS APSCD_pVal Pres_hPa 10 0.00 3500.000 FORMAT "%8.3" EXTENDED_LIMITS -32768.00 32767.00 DEPOSIT ABSOLUTE /end AXIS_DESCR
/end CHARACTERISTIC
/begin AXIS_PTS InjCrv_facPiI1APSQCor_AXIS "gemeinsame Stützstellen für atmosphärendruckabhängige Mengenkorrekturkennlinien für PiI1" 0xE4338 APSCD_pVal GSst_Xs16 3500.000 Pres_hPa 10 0.00 3500.000 FORMAT "%8.3" EXTENDED_LIMITS -32768.00 32767.00 DEPOSIT ABSOLUTE /end AXIS_PTS
/begin CHARACTERISTIC InjCrv_facPiI1APSQCor_CUR "atmosphärendruckabhängige Mengenkorrekturkennlinie für Voreinspritzung 1" CURVE 0xE434E Gkl_Ws16 1.000000 Fact 0.00 1.000000 FORMAT "%8.6" EXTENDED_LIMITS -4.000000 3.999878
 /begin AXIS_DESCR COM_AXIS APSCD_pVal Pres_hPa 10 0.00 3500.000 FORMAT "%8.3" EXTENDED_LIMITS -32768.00 32767.00 AXIS_PTS_REF InjCrv_facPiI1APSQCor_AXIS /end AXIS_DESCR
/end CHARACTERISTIC
/begin CHARACTERISTIC InjCrv_facPiI1ATSQCor2Strt_CUR "weighting factor of intake air temperature for quantity correction of PiI1 when PiI2 or PiI3 is active" CURVE 0xE4362 Kl_Xs16_Ws16 1.000000 Fact 0.00 1.000000 FORMAT "%8.6" EXTENDED_LIMITS -4.000000 3.999878
 /begin AXIS_DESCR STD_AXIS IATSCD_tAir Temp_Cels 8 -50.14000 199.8600 FORMAT "%8.4" EXTENDED_LIMITS -3549.940 3003.560 DEPOSIT ABSOLUTE /end AXIS_DESCR
/end CHARACTERISTIC
/begin CHARACTERISTIC InjCrv_facPiI1ATSQCor2_CUR "ansauglufttemperaturabhängige Mengenkorrekturkennlinie für Voreinspritzung 1 wenn PiI2 oder PiI3 aktiv ist" CURVE 0xE4384 Gkl_Ws16 1.000000 Fact 0.00 1.000000 FORMAT "%8.6" EXTENDED_LIMITS -4.000000 3.999878
 /begin AXIS_DESCR COM_AXIS IATSCD_tAir Temp_Cels 10 -50.14000 199.8600 FORMAT "%8.4" EXTENDED_LIMITS -3549.940 3003.560 AXIS_PTS_REF InjCrv_facPiI1ATSQCor_AXIS /end AXIS_DESCR
/end CHARACTERISTIC
/begin CHARACTERISTIC InjCrv_facPiI1ATSQCorStrt_CUR "weighting factor of intake air temperature for pilot injections quantity correction" CURVE 0xE4398 Kl_Xs16_Ws16 1.000000 Fact 0.00 1.000000 FORMAT "%8.6" EXTENDED_LIMITS -4.000000 3.999878
 /begin AXIS_DESCR STD_AXIS IATSCD_tAir Temp_Cels 10 -50.14000 199.8600 FORMAT "%8.4" EXTENDED_LIMITS -3549.940 3003.560 DEPOSIT ABSOLUTE /end AXIS_DESCR
/end CHARACTERISTIC
/begin AXIS_PTS InjCrv_facPiI1ATSQCor_AXIS "gemeinsame Stützstellen für ansauglufttemperaturabhängige Mengenkorrekturkennlinien für PiI1" 0xE43C2 IATSCD_tAir GSst_Xs16 250.0000 Temp_Cels 10 -50.14000 199.8600 FORMAT "%8.4" EXTENDED_LIMITS -3549.940 3003.560 DEPOSIT ABSOLUTE /end AXIS_PTS
/begin CHARACTERISTIC InjCrv_facPiI1ATSQCor_CUR "ansauglufttemperaturabhängige Mengenkorrekturkennlinie für Voreinspritzung 1" CURVE 0xE43D8 Gkl_Ws16 1.000000 Fact 0.00 1.000000 FORMAT "%8.6" EXTENDED_LIMITS -4.000000 3.999878
 /begin AXIS_DESCR COM_AXIS IATSCD_tAir Temp_Cels 10 -50.14000 199.8600 FORMAT "%8.4" EXTENDED_LIMITS -3549.940 3003.560 AXIS_PTS_REF InjCrv_facPiI1ATSQCor_AXIS /end AXIS_DESCR
/end CHARACTERISTIC
/begin CHARACTERISTIC InjCrv_facPiI1ATSSOECor_CUR "kennlinie für ansauglufttemperaturabhängigen Gewichtungsfaktor für PiI1" CURVE 0xE29AE Kl_Xs16_Ws16 1.000000 Fact 0.00 1.000000 FORMAT "%8.6" EXTENDED_LIMITS -4.000000 3.999878
 /begin AXIS_DESCR STD_AXIS IATSCD_tAir Temp_Cels 6 -50.14000 199.8600 FORMAT "%8.4" EXTENDED_LIMITS -3549.940 3003.560 DEPOSIT ABSOLUTE /end AXIS_DESCR
/end CHARACTERISTIC
/begin CHARACTERISTIC InjCrv_facPiI1ChamWllTempCorr_MAP "" MAP 0xE2434 Kf_Xs16_Ys16_Ws16 2.000000 Fact 0.00 2.000000 FORMAT "%8.6" EXTENDED_LIMITS -4.000000 3.999878
 /begin AXIS_DESCR STD_AXIS Eng_tEng Temp_Cels 8 -50.14000 199.8600 FORMAT "%8.4" EXTENDED_LIMITS -3549.940 3003.560 DEPOSIT ABSOLUTE /end AXIS_DESCR
 /begin AXIS_DESCR STD_AXIS Layer_tChamWll Temp_Cels 8 -50.14000 899.8600 FORMAT "%8.4" EXTENDED_LIMITS -3549.940 3003.560 DEPOSIT ABSOLUTE /end AXIS_DESCR
/end CHARACTERISTIC
/begin CHARACTERISTIC InjCrv_facPiI1ETSQCor12_CUR "motortemperaturabhängige Mengenkorrekturkennlinie für Voreinspritzung 1 bei inaktiver Voreinspritzung 2" CURVE 0xE43EC Gkl_Ws16 1.000000 Fact 0.00 1.000000 FORMAT "%8.6" EXTENDED_LIMITS -4.000000 3.999878
 /begin AXIS_DESCR COM_AXIS InjCrv_tEng Temp_Cels 8 -50.14000 199.8600 FORMAT "%8.4" EXTENDED_LIMITS -3549.940 3003.560 AXIS_PTS_REF InjCrv_facPiI1ETSQCor1_AXIS /end AXIS_DESCR
/end CHARACTERISTIC
/begin AXIS_PTS InjCrv_facPiI1ETSQCor1_AXIS "Motortemperatur zur Mengenkorrektur der Voreinspritzung" 0xE43FC InjCrv_tEng GSst_Xs16 250.0000 Temp_Cels 8 -50.14000 199.8600 FORMAT "%8.4" EXTENDED_LIMITS -3549.940 3003.560 DEPOSIT ABSOLUTE /end AXIS_PTS
/begin CHARACTERISTIC InjCrv_facPiI1ETSQCor1_CUR "motortemperaturabhängige Mengenkorrekturkennlinie -1 für Voreinspritzung 1" CURVE 0xE440E Gkl_Ws16 1.000000 Fact 0.00 1.000000 FORMAT "%8.6" EXTENDED_LIMITS -4.000000 3.999878
 /begin AXIS_DESCR COM_AXIS InjCrv_tEng Temp_Cels 8 -50.14000 199.8600 FORMAT "%8.4" EXTENDED_LIMITS -3549.940 3003.560 AXIS_PTS_REF InjCrv_facPiI1ETSQCor1_AXIS /end AXIS_DESCR
/end CHARACTERISTIC
/begin CHARACTERISTIC InjCrv_facPiI1ETSQCor2Strt_CUR "weighting factor of engine temperature for quantity correction of PiI1 when PiI2 or PiI3 is active" CURVE 0xE441E Kl_Xs16_Ws16 1.000000 Fact 0.00 1.000000 FORMAT "%8.6" EXTENDED_LIMITS -4.000000 3.999878
 /begin AXIS_DESCR STD_AXIS InjCrv_tEng Temp_Cels 8 -50.14000 199.8600 FORMAT "%8.4" EXTENDED_LIMITS -3549.940 3003.560 DEPOSIT ABSOLUTE /end AXIS_DESCR
/end CHARACTERISTIC
/begin CHARACTERISTIC InjCrv_facPiI1ETSQCor2_CUR "motortemperaturabhängige Mengenkorrekturkennlinie für Voreinspritzung 1 wenn PiI2 oder PiI3 aktiv ist" CURVE 0xE4440 Gkl_Ws16 1.000000 Fact 0.00 1.000000 FORMAT "%8.6" EXTENDED_LIMITS -4.000000 3.999878
 /begin AXIS_DESCR COM_AXIS InjCrv_tEng Temp_Cels 10 -50.14000 199.8600 FORMAT "%8.4" EXTENDED_LIMITS -3549.940 3003.560 AXIS_PTS_REF InjCrv_facPiI1ETSQCor_AXIS /end AXIS_DESCR
/end CHARACTERISTIC
/begin CHARACTERISTIC InjCrv_facPiI1ETSQCorStrt_CUR "weighting factor of engine temperature for pilot injection quantity correction" CURVE 0xE4454 Kl_Xs16_Ws16 1.000000 Fact 0.00 1.000000 FORMAT "%8.6" EXTENDED_LIMITS -4.000000 3.999878
 /begin AXIS_DESCR STD_AXIS InjCrv_tEng Temp_Cels 10 -50.14000 199.8600 FORMAT "%8.4" EXTENDED_LIMITS -3549.940 3003.560 DEPOSIT ABSOLUTE /end AXIS_DESCR
/end CHARACTERISTIC
/begin AXIS_PTS InjCrv_facPiI1ETSQCor_AXIS "gemeinsame Stützstellen für motortemperaturabhängige Mengenkorrekturkennlinien für PiI1" 0xE447E InjCrv_tEng GSst_Xs16 250.0000 Temp_Cels 10 -50.14000 199.8600 FORMAT "%8.4" EXTENDED_LIMITS -3549.940 3003.560 DEPOSIT ABSOLUTE /end AXIS_PTS
/begin CHARACTERISTIC InjCrv_facPiI1ETSQCor_CUR "motortemperaturabhängige Mengenkorrekturkennlinie für Voreinspritzung 1" CURVE 0xE4494 Gkl_Ws16 1.000000 Fact 0.00 1.000000 FORMAT "%8.6" EXTENDED_LIMITS -4.000000 3.999878
 /begin AXIS_DESCR COM_AXIS InjCrv_tEng Temp_Cels 10 -50.14000 199.8600 FORMAT "%8.4" EXTENDED_LIMITS -3549.940 3003.560 AXIS_PTS_REF InjCrv_facPiI1ETSQCor_AXIS /end AXIS_DESCR
/end CHARACTERISTIC
/begin CHARACTERISTIC InjCrv_facPiI1ETSSOECor12_CUR "motortemperaturabhängige Ansteuerbeginnkorrekturkennlinie für Voreinspritzung 1 bei aktiver Voreinspritzung 2" CURVE 0xE44A8 Gkl_Ws16 1.000000 Fact 0.00 1.000000 FORMAT "%8.6" EXTENDED_LIMITS -4.000000 3.999878
 /begin AXIS_DESCR COM_AXIS InjCrv_tEng Temp_Cels 8 -50.14000 199.8600 FORMAT "%8.4" EXTENDED_LIMITS -3549.940 3003.560 AXIS_PTS_REF InjCrv_facPiI1ETSSOECor1_AXIS /end AXIS_DESCR
/end CHARACTERISTIC
/begin AXIS_PTS InjCrv_facPiI1ETSSOECor1_AXIS "Motortemperatur zur Startmengenkorrektur der Voreinspritzung" 0xE44B8 InjCrv_tEng GSst_Xs16 250.0000 Temp_Cels 8 -50.14000 199.8600 FORMAT "%8.4" EXTENDED_LIMITS -3549.940 3003.560 DEPOSIT ABSOLUTE /end AXIS_PTS
/begin CHARACTERISTIC InjCrv_facPiI1ETSSOECor1_CUR "motortemperaturabhängige Ansteuerbeginnkorrekturkennlinie -1 für Voreinspritzung 1" CURVE 0xE44CA Gkl_Ws16 1.000000 Fact 0.00 1.000000 FORMAT "%8.6" EXTENDED_LIMITS -4.000000 3.999878
 /begin AXIS_DESCR COM_AXIS InjCrv_tEng Temp_Cels 8 -50.14000 199.8600 FORMAT "%8.4" EXTENDED_LIMITS -3549.940 3003.560 AXIS_PTS_REF InjCrv_facPiI1ETSSOECor1_AXIS /end AXIS_DESCR
/end CHARACTERISTIC
/begin CHARACTERISTIC InjCrv_facPiI1ETSSOECor2_CUR "motortemperaturabhängige Ansteuerbeginnkorrekturkennlinie -2 für Voreinspritzung 1" CURVE 0xE44DA Gkl_Ws16 1.000000 Fact 0.00 1.000000 FORMAT "%8.6" EXTENDED_LIMITS -4.000000 3.999878
 /begin AXIS_DESCR COM_AXIS InjCrv_tEng Temp_Cels 10 -50.14000 199.8600 FORMAT "%8.4" EXTENDED_LIMITS -3549.940 3003.560 AXIS_PTS_REF InjCrv_facPiI1ETSSOECor_AXIS /end AXIS_DESCR
/end CHARACTERISTIC
/begin CHARACTERISTIC InjCrv_facPiI1ETSSOECorStrt_CUR "motortemperaturabhängige Ansteuerbeginnkorrekturkennlinie für Voreinspritzung 1 im Startfall" CURVE 0xE44EE Kl_Xs16_Ws16 1.000000 Fact 0.00 1.000000 FORMAT "%8.6" EXTENDED_LIMITS -4.000000 3.999878
 /begin AXIS_DESCR STD_AXIS InjCrv_tEng Temp_Cels 10 -50.14000 199.8600 FORMAT "%8.4" EXTENDED_LIMITS -3549.940 3003.560 DEPOSIT ABSOLUTE /end AXIS_DESCR
/end CHARACTERISTIC
/begin AXIS_PTS InjCrv_facPiI1ETSSOECor_AXIS "gemeinsame Stützstellen für motortemperaturabhängige Ansteuerbeginnkorrekturkennlinien für PiI1" 0xE4518 InjCrv_tEng GSst_Xs16 250.0000 Temp_Cels 10 -50.14000 199.8600 FORMAT "%8.4" EXTENDED_LIMITS -3549.940 3003.560 DEPOSIT ABSOLUTE /end AXIS_PTS
/begin CHARACTERISTIC InjCrv_facPiI1ETSSOECor_CUR "motortemperaturabhängige Ansteuerbeginnkorrekturkennlinie für Voreinspritzung 1" CURVE 0xE452E Gkl_Ws16 1.000000 Fact 0.00 1.000000 FORMAT "%8.6" EXTENDED_LIMITS -4.000000 3.999878
 /begin AXIS_DESCR COM_AXIS InjCrv_tEng Temp_Cels 10 -50.14000 199.8600 FORMAT "%8.4" EXTENDED_LIMITS -3549.940 3003.560 AXIS_PTS_REF InjCrv_facPiI1ETSSOECor_AXIS /end AXIS_DESCR
/end CHARACTERISTIC
/begin CHARACTERISTIC InjCrv_facPoI1APSQCor_CUR "atmospärendruckabhängige Mengenkorrekturkennlinie für PoI1" CURVE 0xE552E Kl_Xs16_Ws16 1.000000 Fact 0.00 1.000000 FORMAT "%8.6" EXTENDED_LIMITS -4.000000 3.999878
 /begin AXIS_DESCR STD_AXIS APSCD_pVal Pres_hPa 6 0.00 3500.000 FORMAT "%8.3" EXTENDED_LIMITS -32768.00 32767.00 DEPOSIT ABSOLUTE /end AXIS_DESCR
/end CHARACTERISTIC
/begin CHARACTERISTIC InjCrv_facPoI1Eff1_MAP "MAP von PoI1 für den Momentenbestimmenden Teil der Einspritzmenge" MAP 0xE555A Kf_Xs16_Ys16_Ws16 1.000000 Fact 0.00 1.000000 FORMAT "%8.6" EXTENDED_LIMITS -4.000000 3.999878
 /begin AXIS_DESCR STD_AXIS Eng_nAvrg EngN 16 0.00 6000.000 FORMAT "%8.3" EXTENDED_LIMITS -32768.00 32767.00 DEPOSIT ABSOLUTE /end AXIS_DESCR
 /begin AXIS_DESCR STD_AXIS InjCtl_qSetUnBal InjMassCyc 16 0.00 327.6700 FORMAT "%8.4" EXTENDED_LIMITS -327.6800 327.6700 DEPOSIT ABSOLUTE /end AXIS_DESCR
/end CHARACTERISTIC
/begin CHARACTERISTIC InjCrv_facPoI1Eff2_MAP "MAP von PoI1 für den Momentenbestimmenden Teil der Einspritzmenge" MAP 0xE579E Kf_Xs16_Ys16_Ws16 1.000000 Fact 0.00 1.000000 FORMAT "%8.6" EXTENDED_LIMITS -4.000000 3.999878
 /begin AXIS_DESCR STD_AXIS Eng_nAvrg EngN 16 0.00 6000.000 FORMAT "%8.3" EXTENDED_LIMITS -32768.00 32767.00 DEPOSIT ABSOLUTE /end AXIS_DESCR
 /begin AXIS_DESCR STD_AXIS InjCtl_qSetUnBal InjMassCyc 16 0.00 327.6700 FORMAT "%8.4" EXTENDED_LIMITS -327.6800 327.6700 DEPOSIT ABSOLUTE /end AXIS_DESCR
/end CHARACTERISTIC
/begin CHARACTERISTIC InjCrv_facPoI1Eff_MAP "MAP von PoI1 für den Momentenbestimmenden Teil der Einspritzmenege" MAP 0xE53F0 Kf_Xs16_Ys16_Ws16 1.000000 Fact 0.00 1.000000 FORMAT "%8.6" EXTENDED_LIMITS -4.000000 3.999878
 /begin AXIS_DESCR STD_AXIS Eng_nAvrg EngN 8 0.00 6000.000 FORMAT "%8.3" EXTENDED_LIMITS -32768.00 32767.00 DEPOSIT ABSOLUTE /end AXIS_DESCR
 /begin AXIS_DESCR STD_AXIS InjCtl_qSetUnBal InjMassCyc 8 0.00 327.6700 FORMAT "%8.4" EXTENDED_LIMITS -327.6800 327.6700 DEPOSIT ABSOLUTE /end AXIS_DESCR
/end CHARACTERISTIC
/begin CHARACTERISTIC InjCrv_facPoI1ETSPhiCor_CUR "motortemperaturabhängige Winkelkorrekturkennlinie für PoI1" CURVE 0xE5548 Kl_Xs16_Ws16 1.000000 Fact 0.00 1.000000 FORMAT "%8.6" EXTENDED_LIMITS -4.000000 3.999878
 /begin AXIS_DESCR STD_AXIS InjCrv_tEng Temp_Cels 1 -50.14000 199.8600 FORMAT "%8.4" EXTENDED_LIMITS -3549.940 3003.560 DEPOSIT ABSOLUTE /end AXIS_DESCR
/end CHARACTERISTIC
/begin CHARACTERISTIC InjCrv_facPoI1ETSQCor_CUR "motortemperaturabhängige Mengenkorrekturkennlinie für PoI1" CURVE 0xE554E Kl_Xs16_Ws16 1.000000 Fact 0.00 1.000000 FORMAT "%8.6" EXTENDED_LIMITS -4.000000 3.999878
 /begin AXIS_DESCR STD_AXIS InjCrv_tEng Temp_Cels 1 -50.14000 199.8600 FORMAT "%8.4" EXTENDED_LIMITS -3549.940 3003.560 DEPOSIT ABSOLUTE /end AXIS_DESCR
/end CHARACTERISTIC
/begin CHARACTERISTIC InjCrv_facPoI2APSQCorStrt_CUR "Atmosphärendruckabhängige Mengenkorrekturkennlinie für Nacheinspritzung 2 im Startzustand." CURVE 0xE6652 Kl_Xs16_Ws16 1.000000 Fact 0.00 1.000000 FORMAT "%8.6" EXTENDED_LIMITS -4.000000 3.999878
 /begin AXIS_DESCR STD_AXIS APSCD_pVal Pres_hPa 10 0.00 3500.000 FORMAT "%8.3" EXTENDED_LIMITS -32768.00 32767.00 DEPOSIT ABSOLUTE /end AXIS_DESCR
/end CHARACTERISTIC
/begin CHARACTERISTIC InjCrv_facPoI2ATSQCorStrt_CUR "Ansauglufttemperaturabhängige Mengenkorrekturkennlinie für Nacheinspritzung 2 im Startzustand." CURVE 0xE667C Kl_Xs16_Ws16 1.000000 Fact 0.00 1.000000 FORMAT "%8.6" EXTENDED_LIMITS -4.000000 3.999878
 /begin AXIS_DESCR STD_AXIS IATSCD_tAir Temp_Cels 10 -50.14000 199.8600 FORMAT "%8.4" EXTENDED_LIMITS -3549.940 3003.560 DEPOSIT ABSOLUTE /end AXIS_DESCR
/end CHARACTERISTIC
/begin CHARACTERISTIC InjCrv_facPoI2ATSQCor_CUR "ansauglufttemperaturabhängige Mengenkorrekturkennlinie für Nacheinspritzung 2" CURVE 0xE66A6 Kl_Xs16_Ws16 1.000000 Fact 0.00 1.000000 FORMAT "%8.6" EXTENDED_LIMITS -4.000000 3.999878
 /begin AXIS_DESCR STD_AXIS IATSCD_tAir Temp_Cels 8 -50.14000 199.8600 FORMAT "%8.4" EXTENDED_LIMITS -3549.940 3003.560 DEPOSIT ABSOLUTE /end AXIS_DESCR
/end CHARACTERISTIC
/begin CHARACTERISTIC InjCrv_facPoI2ATSSOECor_CUR "ansauglufttemperaturabhängige Ansteuerbeginnkorrekturkennlinie für Nacheinspritzung 2" CURVE 0xE66C8 Kl_Xs16_Ws16 1.000000 Fact 0.00 1.000000 FORMAT "%8.6" EXTENDED_LIMITS -4.000000 3.999878
 /begin AXIS_DESCR STD_AXIS IATSCD_tAir Temp_Cels 8 -50.14000 199.8600 FORMAT "%8.4" EXTENDED_LIMITS -3549.940 3003.560 DEPOSIT ABSOLUTE /end AXIS_DESCR
/end CHARACTERISTIC
/begin CHARACTERISTIC InjCrv_facPoI2Eff1_MAP "map of PoI2 for the torque forming part of injection quantity" MAP 0xE6D3C Kf_Xs16_Ys16_Ws16 1.000000 Fact 0.00 1.000000 FORMAT "%8.6" EXTENDED_LIMITS -4.000000 3.999878
 /begin AXIS_DESCR STD_AXIS Eng_nAvrg EngN 16 0.00 6000.000 FORMAT "%8.3" EXTENDED_LIMITS -32768.00 32767.00 DEPOSIT ABSOLUTE /end AXIS_DESCR
 /begin AXIS_DESCR STD_AXIS InjCtl_qSetUnBal InjMassCyc 16 0.00 327.6700 FORMAT "%8.4" EXTENDED_LIMITS -327.6800 327.6700 DEPOSIT ABSOLUTE /end AXIS_DESCR
/end CHARACTERISTIC
/begin CHARACTERISTIC InjCrv_facPoI2Eff2_MAP "map of PoI2 for the torque forming part of injection quantity" MAP 0xE6F80 Kf_Xs16_Ys16_Ws16 1.000000 Fact 0.00 1.000000 FORMAT "%8.6" EXTENDED_LIMITS -4.000000 3.999878
 /begin AXIS_DESCR STD_AXIS Eng_nAvrg EngN 16 0.00 6000.000 FORMAT "%8.3" EXTENDED_LIMITS -32768.00 32767.00 DEPOSIT ABSOLUTE /end AXIS_DESCR
 /begin AXIS_DESCR STD_AXIS InjCtl_qSetUnBal InjMassCyc 16 0.00 327.6700 FORMAT "%8.4" EXTENDED_LIMITS -327.6800 327.6700 DEPOSIT ABSOLUTE /end AXIS_DESCR
/end CHARACTERISTIC
/begin CHARACTERISTIC InjCrv_facPoI2EffRgnAdd_Vector "#SSD Konfigurationslabel für Bypass Freischnitt" VALUE 0xC39B6 Kw_Wu8 255.0 OneToOne 0.00 255.0 FORMAT "%5.1" /end CHARACTERISTIC
/begin CHARACTERISTIC InjCrv_facPoI2EffRgnAdd_Channel "#SSD Konfigurationslabel für Bypass Freischnitt" VALUE 0xC39B7 Kw_Wu8 255.0 OneToOne 0.00 255.0 FORMAT "%5.1" /end CHARACTERISTIC
/begin CHARACTERISTIC InjCrv_facPoI2EffRgn_Vector "#SSD Konfigurationslabel für Bypass Freischnitt" VALUE 0xC39B8 Kw_Wu8 255.0 OneToOne 0.00 255.0 FORMAT "%5.1" /end CHARACTERISTIC
/begin CHARACTERISTIC InjCrv_facPoI2EffRgn_Channel "#SSD Konfigurationslabel für Bypass Freischnitt" VALUE 0xC39B9 Kw_Wu8 255.0 OneToOne 0.00 255.0 FORMAT "%5.1" /end CHARACTERISTIC
/begin CHARACTERISTIC InjCrv_facPoI2Eff_MAP "Faktor für Drehmoment bildenden Anteil der Einspritzmenge PoI2" MAP 0xE6A4C Kf_Xs16_Ys16_Ws16 1.000000 Fact 0.00 1.000000 FORMAT "%8.6" EXTENDED_LIMITS -4.000000 3.999878
 /begin AXIS_DESCR STD_AXIS Eng_nAvrg EngN 8 0.00 6000.000 FORMAT "%8.3" EXTENDED_LIMITS -32768.00 32767.00 DEPOSIT ABSOLUTE /end AXIS_DESCR
 /begin AXIS_DESCR STD_AXIS InjCtl_qSetUnBal InjMassCyc 8 0.00 327.6700 FORMAT "%8.4" EXTENDED_LIMITS -327.6800 327.6700 DEPOSIT ABSOLUTE /end AXIS_DESCR
/end CHARACTERISTIC
/begin CHARACTERISTIC InjCrv_facPoI2ETSQCorStrt_CUR "Motortemperaturabhängige Mengenkorrekturkennlinie für Nacheinspritzung 2 im Startzustand." CURVE 0xE66EA Kl_Xs16_Ws16 1.000000 Fact 0.00 1.000000 FORMAT "%8.6" EXTENDED_LIMITS -4.000000 3.999878
 /begin AXIS_DESCR STD_AXIS InjCrv_tEng Temp_Cels 10 -50.14000 199.8600 FORMAT "%8.4" EXTENDED_LIMITS -3549.940 3003.560 DEPOSIT ABSOLUTE /end AXIS_DESCR
/end CHARACTERISTIC
/begin CHARACTERISTIC InjCrv_facPoI2ETSQCor_CUR "motortemperaturabhängige Mengenkorrekturkennlinie für Nacheinspritzung 2" CURVE 0xE6714 Kl_Xs16_Ws16 1.000000 Fact 0.00 1.000000 FORMAT "%8.6" EXTENDED_LIMITS -4.000000 3.999878
 /begin AXIS_DESCR STD_AXIS InjCrv_tEng Temp_Cels 8 -50.14000 199.8600 FORMAT "%8.4" EXTENDED_LIMITS -3549.940 3003.560 DEPOSIT ABSOLUTE /end AXIS_DESCR
/end CHARACTERISTIC
/begin CHARACTERISTIC InjCrv_facPoI2ETSSOECorStrt_CUR "Motortemperaturabhängige Ansteuerbeginnkorrekturkennlinie für Nacheinspritzung 2 im Startzustand." CURVE 0xE6736 Kl_Xs16_Ws16 1.000000 Fact 0.00 1.000000 FORMAT "%8.6" EXTENDED_LIMITS -4.000000 3.999878
 /begin AXIS_DESCR STD_AXIS InjCrv_tEng Temp_Cels 10 -50.14000 199.8600 FORMAT "%8.4" EXTENDED_LIMITS -3549.940 3003.560 DEPOSIT ABSOLUTE /end AXIS_DESCR
/end CHARACTERISTIC
/begin CHARACTERISTIC InjCrv_facPoI2ETSSOECor_CUR "motortemperaturabhängige Ansteuerbeginnkorrekturkennlinie für PoI2" CURVE 0xE6760 Kl_Xs16_Ws16 1.000000 Fact 0.00 1.000000 FORMAT "%8.6" EXTENDED_LIMITS -4.000000 3.999878
 /begin AXIS_DESCR STD_AXIS InjCrv_tEng Temp_Cels 8 -50.14000 199.8600 FORMAT "%8.4" EXTENDED_LIMITS -3549.940 3003.560 DEPOSIT ABSOLUTE /end AXIS_DESCR
/end CHARACTERISTIC
/begin CHARACTERISTIC InjCrv_facPoI2QntMin_C "Faktor zur applikativen Abschaltung der PoI2 bei Unterschreitung der Mindestmenge" VALUE 0xE6AF0 Kw_Ws16 1.000000 Fact1 0.00 1.000000 FORMAT "%8.6" EXTENDED_LIMITS -256.0000 255.9922 /end CHARACTERISTIC
/begin CHARACTERISTIC InjCrv_facPOpPoI2ETSCorStrt_CUR "Motortemperaturabhängige Freigabekorrekturkennlinie für Nacheinspritzung 2 im Startzustand." CURVE 0xE6782 Kl_Xs16_Ws16 1.000000 Fact 0.00 1.000000 FORMAT "%8.6" EXTENDED_LIMITS -4.000000 3.999878
 /begin AXIS_DESCR STD_AXIS InjCrv_tEng Temp_Cels 10 -50.14000 199.8600 FORMAT "%8.4" EXTENDED_LIMITS -3549.940 3003.560 DEPOSIT ABSOLUTE /end AXIS_DESCR
/end CHARACTERISTIC
/begin CHARACTERISTIC InjCrv_facPOpPoI2ETSCor_CUR "motortemperaturabhängige Freigabekorrekturkennlinie für PoI2" CURVE 0xE67AC Kl_Xs16_Ws16 1.000000 Fact 0.00 1.000000 FORMAT "%8.6" EXTENDED_LIMITS -4.000000 3.999878
 /begin AXIS_DESCR STD_AXIS InjCrv_tEng Temp_Cels 8 -50.14000 199.8600 FORMAT "%8.4" EXTENDED_LIMITS -3549.940 3003.560 DEPOSIT ABSOLUTE /end AXIS_DESCR
/end CHARACTERISTIC
/begin CHARACTERISTIC InjCrv_facqPiI1ChamWllTempCorr_MAP "" MAP 0xE24D8 Kf_Xs16_Ys16_Ws16 2.000000 Fact 0.00 2.000000 FORMAT "%8.6" EXTENDED_LIMITS -4.000000 3.999878
 /begin AXIS_DESCR STD_AXIS Eng_tEng Temp_Cels 8 -50.14000 199.8600 FORMAT "%8.4" EXTENDED_LIMITS -3549.940 3003.560 DEPOSIT ABSOLUTE /end AXIS_DESCR
 /begin AXIS_DESCR STD_AXIS Layer_tChamWll Temp_Cels 8 -50.14000 899.8600 FORMAT "%8.4" EXTENDED_LIMITS -3549.940 3003.560 DEPOSIT ABSOLUTE /end AXIS_DESCR
/end CHARACTERISTIC
/begin CHARACTERISTIC InjCrv_facQPoI2RgnAPCor_CUR "atmosphere pressure part of PoI2 regeneration quantity correction" CURVE 0xE659A Kl_Xs16_Ws16 2.000000 Fact 0.00 2.000000 FORMAT "%8.6" EXTENDED_LIMITS -4.000000 3.999878
 /begin AXIS_DESCR STD_AXIS APSCD_pLinVal Pres_hPa 6 0.00 3500.000 FORMAT "%8.3" EXTENDED_LIMITS -32768.00 32767.00 DEPOSIT ABSOLUTE /end AXIS_DESCR
/end CHARACTERISTIC
/begin CHARACTERISTIC InjCrv_facQPoI2RgnETCor_CUR "engine temperature part of PoI2 regeneration quantity correction" CURVE 0xE65B4 Kl_Xs16_Ws16 2.000000 Fact 0.00 2.000000 FORMAT "%8.6" EXTENDED_LIMITS -4.000000 3.999878
 /begin AXIS_DESCR STD_AXIS InjCrv_tEng Temp_Cels 1 -50.14000 199.8600 FORMAT "%8.4" EXTENDED_LIMITS -3549.940 3003.560 DEPOSIT ABSOLUTE /end AXIS_DESCR
/end CHARACTERISTIC
/begin CHARACTERISTIC InjCrv_facTiPoI2RgnAPCor_CUR " atmosphere pressure part of PoI2 regeneration time correction" CURVE 0xE65BA Kl_Xs16_Ws16 2.000000 Fact 0.00 2.000000 FORMAT "%8.6" EXTENDED_LIMITS -4.000000 3.999878
 /begin AXIS_DESCR STD_AXIS APSCD_pLinVal Pres_hPa 1 0.00 3500.000 FORMAT "%8.3" EXTENDED_LIMITS -32768.00 32767.00 DEPOSIT ABSOLUTE /end AXIS_DESCR
/end CHARACTERISTIC
/begin CHARACTERISTIC InjCrv_facTiPoI2RgnETCor_CUR "engine temperature part of PoI2 regeneration time correction" CURVE 0xE65C0 Kl_Xs16_Ws16 2.000000 Fact 0.00 2.000000 FORMAT "%8.6" EXTENDED_LIMITS -4.000000 3.999878
 /begin AXIS_DESCR STD_AXIS InjCrv_tEng Temp_Cels 1 -50.14000 199.8600 FORMAT "%8.4" EXTENDED_LIMITS -3549.940 3003.560 DEPOSIT ABSOLUTE /end AXIS_DESCR
/end CHARACTERISTIC
/begin CHARACTERISTIC InjCrv_phiDynOfs_CUR "Winkelvorhalt für schnelle dynamische Vorgänge" CURVE 0xE5494 Kl_Xs16_Ws16 767.9766 AngleCrS 0.00 767.9766 FORMAT "%8.4" EXTENDED_LIMITS -768.0000 767.9766
 /begin AXIS_DESCR STD_AXIS Eng_nAvrg EngN 12 0.00 6000.000 FORMAT "%8.3" EXTENDED_LIMITS -32768.00 32767.00 DEPOSIT ABSOLUTE /end AXIS_DESCR
/end CHARACTERISTIC
/begin CHARACTERISTIC InjCrv_phiPiI1DesAdd_Vector "#SSD Bypass-Label für additiven Bypass von InjCrv_phiPiI1Des (Nicht verstellen!)" VALUE 0xC3978 Kw_Wu8 255.0 OneToOne 0.00 255.0 FORMAT "%5.1" /end CHARACTERISTIC
/begin CHARACTERISTIC InjCrv_phiPiI1DesAdd_Channel "#SSD Bypass-Label für additiven Bypass von InjCrv_phiPiI1Des (Nicht verstellen!)" VALUE 0xC3979 Kw_Wu8 255.0 OneToOne 0.00 255.0 FORMAT "%5.1" /end CHARACTERISTIC
/begin CHARACTERISTIC InjCrv_phiPiI1Des_Vector "#SSD Bypass-Label für InjCrv_phiPiI1Des (Nicht verstellen!)" VALUE 0xC397A Kw_Wu8 255.0 OneToOne 0.00 255.0 FORMAT "%5.1" /end CHARACTERISTIC
/begin CHARACTERISTIC InjCrv_phiPiI1Des_Channel "#SSD Bypass-Label für InjCrv_phiPiI1Des (Nicht verstellen!)" VALUE 0xC397B Kw_Wu8 255.0 OneToOne 0.00 255.0 FORMAT "%5.1" /end CHARACTERISTIC
/begin CHARACTERISTIC InjCrv_phiPiI1RgnAdd_Vector "#SSD Bypass-Label für InjCrv_phiPiI1RgnAdd_Vector (Nicht verstellen!)" VALUE 0xC399A Kw_Wu8 255.0 OneToOne 0.00 255.0 FORMAT "%5.1" /end CHARACTERISTIC
/begin CHARACTERISTIC InjCrv_phiPiI1RgnAdd_Channel "#SSD Bypass-Label für InjCrv_phiPiI1RgnAdd_Channel (Nicht verstellen!)" VALUE 0xC399B Kw_Wu8 255.0 OneToOne 0.00 255.0 FORMAT "%5.1" /end CHARACTERISTIC
/begin CHARACTERISTIC InjCrv_phiPiI1Rgn_MAP "Kennfeld für Winkelkomponente Ansteuerbeginn PiI1 im Regenerationsbetrieb" MAP 0xE4F46 Kf_Xs16_Ys16_Ws16 90.00000 AngleCrS 0.00 90.00000 FORMAT "%8.5" EXTENDED_LIMITS -768.0000 767.9766
 /begin AXIS_DESCR STD_AXIS Eng_nAvrg EngN 2 0.00 6000.000 FORMAT "%8.3" EXTENDED_LIMITS -32768.00 32767.00 DEPOSIT ABSOLUTE /end AXIS_DESCR
 /begin AXIS_DESCR STD_AXIS InjCtl_qSetUnBal InjMassCyc 2 0.00 327.6700 FORMAT "%8.4" EXTENDED_LIMITS -327.6800 327.6700 DEPOSIT ABSOLUTE /end AXIS_DESCR
/end CHARACTERISTIC
/begin CHARACTERISTIC InjCrv_phiPiI1Rgn_Vector "#SSD Bypass-Label, nicht editieren !" VALUE 0xC399C Kw_Wu8 255.0 OneToOne 0.00 255.0 FORMAT "%5.1" /end CHARACTERISTIC
/begin CHARACTERISTIC InjCrv_phiPiI1Rgn_Channel "#SSD Bypass-Label, nicht editieren !" VALUE 0xC399D Kw_Wu8 255.0 OneToOne 0.00 255.0 FORMAT "%5.1" /end CHARACTERISTIC
/begin CHARACTERISTIC InjCrv_phiPiI2DesAdd_Vector "#SSD Bypass-Label für additiven Bypass von InjCrv_phiPiI2Des (Nicht verstellen!)" VALUE 0xC397C Kw_Wu8 255.0 OneToOne 0.00 255.0 FORMAT "%5.1" /end CHARACTERISTIC
/begin CHARACTERISTIC InjCrv_phiPiI2DesAdd_Channel "#SSD Bypass-Label für additiven Bypass von InjCrv_phiPiI2Des (Nicht verstellen!)" VALUE 0xC397D Kw_Wu8 255.0 OneToOne 0.00 255.0 FORMAT "%5.1" /end CHARACTERISTIC
/begin CHARACTERISTIC InjCrv_phiPiI2Des_Vector "#SSD Bypass-Label für InjCrv_phiPiI2Des (Nicht verstellen!)" VALUE 0xC397E Kw_Wu8 255.0 OneToOne 0.00 255.0 FORMAT "%5.1" /end CHARACTERISTIC
/begin CHARACTERISTIC InjCrv_phiPiI2Des_Channel "#SSD Bypass-Label für InjCrv_phiPiI2Des (Nicht verstellen!)" VALUE 0xC397F Kw_Wu8 255.0 OneToOne 0.00 255.0 FORMAT "%5.1" /end CHARACTERISTIC
/begin CHARACTERISTIC InjCrv_phiPiI2RgnAdd_Vector "#SSD Konfigurationslabel für Bypass" VALUE 0xC396C Kw_Wu8 255.0 OneToOne 0.00 255.0 FORMAT "%5.1" /end CHARACTERISTIC
/begin CHARACTERISTIC InjCrv_phiPiI2RgnAdd_Channel "#SSD Konfigurationslabel für Bypass" VALUE 0xC396D Kw_Wu8 255.0 OneToOne 0.00 255.0 FORMAT "%5.1" /end CHARACTERISTIC
/begin CHARACTERISTIC InjCrv_phiPiI2Rgn_Vector "#SSD Bypass-Label, nicht editieren !" VALUE 0xC396E Kw_Wu8 255.0 OneToOne 0.00 255.0 FORMAT "%5.1" /end CHARACTERISTIC
/begin CHARACTERISTIC InjCrv_phiPiI2Rgn_Channel "#SSD Bypass-Label, nicht editieren !" VALUE 0xC396F Kw_Wu8 255.0 OneToOne 0.00 255.0 FORMAT "%5.1" /end CHARACTERISTIC
/begin CHARACTERISTIC InjCrv_phiPiI3DesAdd_Vector "#SSD Bypass-Label für additiven Bypass von InjCrv_phiPiI3Des (Nicht verstellen!)" VALUE 0xC3980 Kw_Wu8 255.0 OneToOne 0.00 255.0 FORMAT "%5.1" /end CHARACTERISTIC
/begin CHARACTERISTIC InjCrv_phiPiI3DesAdd_Channel "#SSD Bypass-Label für additiven Bypass von InjCrv_phiPiI3Des (Nicht verstellen!)" VALUE 0xC3981 Kw_Wu8 255.0 OneToOne 0.00 255.0 FORMAT "%5.1" /end CHARACTERISTIC
/begin CHARACTERISTIC InjCrv_phiPiI3Des_Vector "#SSD Bypass-Label für InjCrv_phiPiI3Des (Nicht verstellen!)" VALUE 0xC3982 Kw_Wu8 255.0 OneToOne 0.00 255.0 FORMAT "%5.1" /end CHARACTERISTIC
/begin CHARACTERISTIC InjCrv_phiPiI3Des_Channel "#SSD Bypass-Label für InjCrv_phiPiI3Des (Nicht verstellen!)" VALUE 0xC3983 Kw_Wu8 255.0 OneToOne 0.00 255.0 FORMAT "%5.1" /end CHARACTERISTIC
/begin CHARACTERISTIC InjCrv_phiPoI1Bas_MAP "Grundwert des Ansteuerbeginnwinkels PoI1" MAP 0xE54C6 Kf_Xs16_Ys16_Ws16 60.00000 AngleCrS -100.0078 -40.00781 FORMAT "%8.4" EXTENDED_LIMITS -768.0000 767.9766
 /begin AXIS_DESCR STD_AXIS Eng_nAvrg EngN 2 0.00 6000.000 FORMAT "%8.3" EXTENDED_LIMITS -32768.00 32767.00 DEPOSIT ABSOLUTE /end AXIS_DESCR
 /begin AXIS_DESCR STD_AXIS InjCtl_qSetUnBal InjMassCyc 2 0.00 327.6700 FORMAT "%8.4" EXTENDED_LIMITS -327.6800 327.6700 DEPOSIT ABSOLUTE /end AXIS_DESCR
/end CHARACTERISTIC
/begin CHARACTERISTIC InjCrv_phiPoI1DesAdd_Vector "#SSD Bypass-Label für additiven Bypass von InjCrv_phiPoI1Des (Nicht verstellen!)" VALUE 0xC39A6 Kw_Wu8 255.0 OneToOne 0.00 255.0 FORMAT "%5.1" /end CHARACTERISTIC
/begin CHARACTERISTIC InjCrv_phiPoI1DesAdd_Channel "#SSD Bypass-Label für additiven Bypass von InjCrv_phiPoI1Des (Nicht verstellen!)" VALUE 0xC39A7 Kw_Wu8 255.0 OneToOne 0.00 255.0 FORMAT "%5.1" /end CHARACTERISTIC
/begin CHARACTERISTIC InjCrv_phiPoI1Des_Vector "#SSD Bypass-Label für InjCrv_phiPoI1Des (Nicht verstellen!)" VALUE 0xC39A8 Kw_Wu8 255.0 OneToOne 0.00 255.0 FORMAT "%5.1" /end CHARACTERISTIC
/begin CHARACTERISTIC InjCrv_phiPoI1Des_Channel "#SSD Bypass-Label für InjCrv_phiPoI1Des (Nicht verstellen!)" VALUE 0xC39A9 Kw_Wu8 255.0 OneToOne 0.00 255.0 FORMAT "%5.1" /end CHARACTERISTIC
/begin CHARACTERISTIC InjCrv_phiPoI1ETSCor_MAP "motortemperaturabhängiges Winkelkorrekturkennfeld für PoI1" MAP 0xE54F2 Kf_Xs16_Ys16_Ws16 200.0156 AngleCrS -100.0078 100.0078 FORMAT "%8.4" EXTENDED_LIMITS -768.0000 767.9766
 /begin AXIS_DESCR STD_AXIS Eng_nAvrg EngN 2 0.00 6000.000 FORMAT "%8.3" EXTENDED_LIMITS -32768.00 32767.00 DEPOSIT ABSOLUTE /end AXIS_DESCR
 /begin AXIS_DESCR STD_AXIS InjCtl_qSetUnBal InjMassCyc 2 0.00 327.6700 FORMAT "%8.4" EXTENDED_LIMITS -327.6800 327.6700 DEPOSIT ABSOLUTE /end AXIS_DESCR
/end CHARACTERISTIC
/begin CHARACTERISTIC InjCrv_phiPoI1Max_C "#SSD Maximaler Ansteuerbeginnwinkel PoI1" VALUE 0xE54DA Kw_Ws16 60.00000 AngleCrS -100.0078 -40.00781 FORMAT "%8.4" EXTENDED_LIMITS -768.0000 767.9766 /end CHARACTERISTIC
/begin CHARACTERISTIC InjCrv_phiPoI1Rgn1_MAP "map for value for regeneration of angle comp. SOE PoI1" MAP 0xE59E2 Kf_Xs16_Ys16_Ws16 60.00000 AngleCrS -100.0078 -40.00781 FORMAT "%8.4" EXTENDED_LIMITS -768.0000 767.9766
 /begin AXIS_DESCR STD_AXIS Eng_nAvrg EngN 12 0.00 6000.000 FORMAT "%8.3" EXTENDED_LIMITS -32768.00 32767.00 DEPOSIT ABSOLUTE /end AXIS_DESCR
 /begin AXIS_DESCR STD_AXIS InjCtl_qSetUnBal InjMassCyc 12 0.00 327.6700 FORMAT "%8.4" EXTENDED_LIMITS -327.6800 327.6700 DEPOSIT ABSOLUTE /end AXIS_DESCR
/end CHARACTERISTIC
/begin CHARACTERISTIC InjCrv_phiPoI1Rgn2_MAP "map for value for regeneration of angle comp. SOE PoI1" MAP 0xE5B36 Kf_Xs16_Ys16_Ws16 60.00000 AngleCrS -100.0078 -40.00781 FORMAT "%8.4" EXTENDED_LIMITS -768.0000 767.9766
 /begin AXIS_DESCR STD_AXIS Eng_nAvrg EngN 12 0.00 6000.000 FORMAT "%8.3" EXTENDED_LIMITS -32768.00 32767.00 DEPOSIT ABSOLUTE /end AXIS_DESCR
 /begin AXIS_DESCR STD_AXIS InjCtl_qSetUnBal InjMassCyc 12 0.00 327.6700 FORMAT "%8.4" EXTENDED_LIMITS -327.6800 327.6700 DEPOSIT ABSOLUTE /end AXIS_DESCR
/end CHARACTERISTIC
/begin CHARACTERISTIC InjCrv_phiPoI1RgnAdd_Vector "#SSD Bypass-Label für InjCrv_phiPoI1RgnAdd_Vector (Nicht verstellen!)" VALUE 0xC39AE Kw_Wu8 255.0 OneToOne 0.00 255.0 FORMAT "%5.1" /end CHARACTERISTIC
/begin CHARACTERISTIC InjCrv_phiPoI1RgnAdd_Channel "#SSD Bypass-Label für InjCrv_phiPoI1RgnAdd_Channel (Nicht verstellen!)" VALUE 0xC39AF Kw_Wu8 255.0 OneToOne 0.00 255.0 FORMAT "%5.1" /end CHARACTERISTIC
/begin CHARACTERISTIC InjCrv_phiPoI1Rgn_Vector "#SSD Bypass-Label, nicht editieren !" VALUE 0xC39B0 Kw_Wu8 255.0 OneToOne 0.00 255.0 FORMAT "%5.1" /end CHARACTERISTIC
/begin CHARACTERISTIC InjCrv_phiPoI1Rgn_Channel "#SSD Bypass-Label, nicht editieren !" VALUE 0xC39B1 Kw_Wu8 255.0 OneToOne 0.00 255.0 FORMAT "%5.1" /end CHARACTERISTIC
/begin CHARACTERISTIC InjCrv_phiPoI2Add_Vector "#SSD Bypass-label für additiven Bypass von InjCrv_phiPoI2 ( Nicht verstellen !)" VALUE 0xC39C6 Kw_Wu8 255.0 OneToOne 0.00 255.0 FORMAT "%5.1" /end CHARACTERISTIC
/begin CHARACTERISTIC InjCrv_phiPoI2Add_Channel "#SSD Label für additvien Bypass von InjCrv_phiPoI2 (Nicht verstellen!)" VALUE 0xC39C7 Kw_Wu8 255.0 OneToOne 0.00 255.0 FORMAT "%5.1" /end CHARACTERISTIC
/begin CHARACTERISTIC InjCrv_phiPoI2ATSCor_MAP "kundenspez. ansauglufttemperaturabhängiger Korrekturgrundwert für die Winkelkomponente des Ansteuerbeginns der PoI2" MAP 0xE636E Kf_Xs16_Ys16_Ws16 40.00781 AngleCrS -40.00781 0.00 FORMAT "%8.5" EXTENDED_LIMITS -768.0000 767.9766
 /begin AXIS_DESCR STD_AXIS Eng_nAvrg EngN 16 0.00 6000.000 FORMAT "%8.3" EXTENDED_LIMITS -32768.00 32767.00 DEPOSIT ABSOLUTE /end AXIS_DESCR
 /begin AXIS_DESCR STD_AXIS InjCtl_qSetUnBal InjMassCyc 8 0.00 327.6700 FORMAT "%8.4" EXTENDED_LIMITS -327.6800 327.6700 DEPOSIT ABSOLUTE /end AXIS_DESCR
/end CHARACTERISTIC
/begin CHARACTERISTIC InjCrv_phiPoI2Bas_MAP "Winkelkomponente Ansteuerbeginn Grundwert PoI2" MAP 0xE7CC0 Kf_Xs16_Ys16_Ws16 40.00781 AngleCrS -40.00781 0.00 FORMAT "%8.5" EXTENDED_LIMITS -768.0000 767.9766
 /begin AXIS_DESCR STD_AXIS Eng_nAvrg EngN 2 0.00 6000.000 FORMAT "%8.3" EXTENDED_LIMITS -32768.00 32767.00 DEPOSIT ABSOLUTE /end AXIS_DESCR
 /begin AXIS_DESCR STD_AXIS InjCtl_qSetUnBal InjMassCyc 2 0.00 327.6700 FORMAT "%8.4" EXTENDED_LIMITS -327.6800 327.6700 DEPOSIT ABSOLUTE /end AXIS_DESCR
/end CHARACTERISTIC
/begin CHARACTERISTIC InjCrv_phiPoI2ETSCor_MAP "motortemperaturabhängiger Korrekturgrundwertekennfeld für die Winkelkomponente des Ansteuerbeginns der PoI2" MAP 0xE64A2 Kf_Xs16_Ys16_Ws16 40.00781 AngleCrS -40.00781 0.00 FORMAT "%8.5" EXTENDED_LIMITS -768.0000 767.9766
 /begin AXIS_DESCR STD_AXIS Eng_nAvrg EngN 12 0.00 6000.000 FORMAT "%8.3" EXTENDED_LIMITS -32768.00 32767.00 DEPOSIT ABSOLUTE /end AXIS_DESCR
 /begin AXIS_DESCR STD_AXIS InjCtl_qSetUnBal InjMassCyc 8 0.00 327.6700 FORMAT "%8.4" EXTENDED_LIMITS -327.6800 327.6700 DEPOSIT ABSOLUTE /end AXIS_DESCR
/end CHARACTERISTIC
/begin CHARACTERISTIC InjCrv_phiPoI2Min_C "#SSD minimaler Ansteuerbeginn PoI2 relativ zum oberen Totpunkt" VALUE 0xE7B88 Kw_Ws16 40.00781 AngleCrS -40.00781 0.00 FORMAT "%8.5" EXTENDED_LIMITS -768.0000 767.9766 /end CHARACTERISTIC
/begin CHARACTERISTIC InjCrv_phiPoI2Rgn1_MAP "Kennfeld Regenerationswert 1 Förderbeginn Nacheinspritzung" MAP 0xE71C4 Kf_Xs16_Ys16_Ws16 40.00781 AngleCrS -40.00781 0.00 FORMAT "%8.5" EXTENDED_LIMITS -768.0000 767.9766
 /begin AXIS_DESCR STD_AXIS Eng_nAvrg EngN 2 0.00 6000.000 FORMAT "%8.3" EXTENDED_LIMITS -32768.00 32767.00 DEPOSIT ABSOLUTE /end AXIS_DESCR
 /begin AXIS_DESCR STD_AXIS InjCtl_qSetUnBal InjMassCyc 2 0.00 327.6700 FORMAT "%8.4" EXTENDED_LIMITS -327.6800 327.6700 DEPOSIT ABSOLUTE /end AXIS_DESCR
/end CHARACTERISTIC
/begin CHARACTERISTIC InjCrv_phiPoI2Rgn2_MAP "Kennfeld Regenerationswert 2 Förderbeginn Nacheinspritzung" MAP 0xE71D8 Kf_Xs16_Ys16_Ws16 40.00781 AngleCrS -40.00781 0.00 FORMAT "%8.5" EXTENDED_LIMITS -768.0000 767.9766
 /begin AXIS_DESCR STD_AXIS Eng_nAvrg EngN 2 0.00 6000.000 FORMAT "%8.3" EXTENDED_LIMITS -32768.00 32767.00 DEPOSIT ABSOLUTE /end AXIS_DESCR
 /begin AXIS_DESCR STD_AXIS InjCtl_qSetUnBal InjMassCyc 2 0.00 327.6700 FORMAT "%8.4" EXTENDED_LIMITS -327.6800 327.6700 DEPOSIT ABSOLUTE /end AXIS_DESCR
/end CHARACTERISTIC
/begin CHARACTERISTIC InjCrv_phiPoI2RgnAdd_Vector "#SSD Bypass-Label für InjCrv_phiPoI2RgnAdd_Vector (Nicht verstellen!)" VALUE 0xC39BA Kw_Wu8 255.0 OneToOne 0.00 255.0 FORMAT "%5.1" /end CHARACTERISTIC
/begin CHARACTERISTIC InjCrv_phiPoI2RgnAdd_Channel "#SSD Bypass-Label für InjCrv_phiPoI2RgnAdd_Channel (Nicht verstellen!)" VALUE 0xC39BB Kw_Wu8 255.0 OneToOne 0.00 255.0 FORMAT "%5.1" /end CHARACTERISTIC
/begin CHARACTERISTIC InjCrv_phiPoI2RgnCor_MAP "regeneration map of PoI2 setpoint correction" MAP 0xE65C6 Kf_Xs16_Ys16_Ws16 40.00781 AngleCrS -40.00781 0.00 FORMAT "%8.5" EXTENDED_LIMITS -768.0000 767.9766
 /begin AXIS_DESCR STD_AXIS Eng_nAvrg EngN 2 0.00 6000.000 FORMAT "%8.3" EXTENDED_LIMITS -32768.00 32767.00 DEPOSIT ABSOLUTE /end AXIS_DESCR
 /begin AXIS_DESCR STD_AXIS InjCtl_qSetUnBal InjMassCyc 2 0.00 327.6700 FORMAT "%8.4" EXTENDED_LIMITS -327.6800 327.6700 DEPOSIT ABSOLUTE /end AXIS_DESCR
/end CHARACTERISTIC
/begin CHARACTERISTIC InjCrv_phiPoI2Rgn_Vector "#SSD Bypass-Label, nicht editieren !" VALUE 0xC39BC Kw_Wu8 255.0 OneToOne 0.00 255.0 FORMAT "%5.1" /end CHARACTERISTIC
/begin CHARACTERISTIC InjCrv_phiPoI2Rgn_Channel "#SSD Bypass-Label, nicht editieren !" VALUE 0xC39BD Kw_Wu8 255.0 OneToOne 0.00 255.0 FORMAT "%5.1" /end CHARACTERISTIC
/begin CHARACTERISTIC InjCrv_phiPoI2_Vector "#SSD Bypass-Label, nicht editieren !" VALUE 0xC39C8 Kw_Wu8 255.0 OneToOne 0.00 255.0 FORMAT "%5.1" /end CHARACTERISTIC
/begin CHARACTERISTIC InjCrv_phiPoI2_Channel "#SSD Bypass-Label, nicht editieren !" VALUE 0xC39C9 Kw_Wu8 255.0 OneToOne 0.00 255.0 FORMAT "%5.1" /end CHARACTERISTIC
/begin CHARACTERISTIC InjCrv_POpPoI1Bas_MAP "Grundwert Freigabe PoI1" MAP 0xE5F4C Kf_Xs16_Ys16_Ws16 100.0000 OneToOne 0.00 100.0000 FORMAT "%8.4" EXTENDED_LIMITS -32768.00 32767.00
 /begin AXIS_DESCR STD_AXIS Eng_nAvrg EngN 2 0.00 6000.000 FORMAT "%8.3" EXTENDED_LIMITS -32768.00 32767.00 DEPOSIT ABSOLUTE /end AXIS_DESCR
 /begin AXIS_DESCR STD_AXIS InjCtl_qSetUnBal InjMassCyc 2 0.00 327.6700 FORMAT "%8.4" EXTENDED_LIMITS -327.6800 327.6700 DEPOSIT ABSOLUTE /end AXIS_DESCR
/end CHARACTERISTIC
/begin CHARACTERISTIC InjCrv_POpPoI1ETSCor_CUR "motortemperaturabhängige Freigabekorrekturkennlinie für PoI1" CURVE 0xE5554 Kl_Xs16_Ws16 100.0000 OneToOne 0.00 100.0000 FORMAT "%8.4" EXTENDED_LIMITS -32768.00 32767.00
 /begin AXIS_DESCR STD_AXIS InjCrv_tEng Temp_Cels 1 -50.14000 199.8600 FORMAT "%8.4" EXTENDED_LIMITS -3549.940 3003.560 DEPOSIT ABSOLUTE /end AXIS_DESCR
/end CHARACTERISTIC
/begin CHARACTERISTIC InjCrv_POpPoI1High_C "obere Hystereseschwelle des Grundwertes Freigabe PoI1" VALUE 0xE5F60 Kw_Ws16 100.0000 OneToOne 0.00 100.0000 FORMAT "%8.4" EXTENDED_LIMITS -32768.00 32767.00 /end CHARACTERISTIC
/begin CHARACTERISTIC InjCrv_POpPoI1Low_C "Untere Hystereseschwelle des Grundwertes Freigabe PoI1" VALUE 0xE5F62 Kw_Ws16 100.0000 OneToOne 0.00 100.0000 FORMAT "%8.4" EXTENDED_LIMITS -32768.00 32767.00 /end CHARACTERISTIC
/begin CHARACTERISTIC InjCrv_POpPoI2BasStrt_MAP "Basis MAP für PoI2 Freigabe basierend auf dem Betriebspunkt während des Motorstarts" MAP 0xE7F18 Kf_Xs16_Ys16_Ws16 100.0000 OneToOne 0.00 100.0000 FORMAT "%8.4" EXTENDED_LIMITS -32768.00 32767.00
 /begin AXIS_DESCR STD_AXIS Eng_nAvrg EngN 8 0.00 6000.000 FORMAT "%8.3" EXTENDED_LIMITS -32768.00 32767.00 DEPOSIT ABSOLUTE /end AXIS_DESCR
 /begin AXIS_DESCR STD_AXIS InjCtl_qSetUnBal InjMassCyc 8 0.00 327.6700 FORMAT "%8.4" EXTENDED_LIMITS -327.6800 327.6700 DEPOSIT ABSOLUTE /end AXIS_DESCR
/end CHARACTERISTIC
/begin CHARACTERISTIC InjCrv_POpPoI2Bas_MAP "grundwert Freigabe PoI2" MAP 0xE7B20 Kf_Xs16_Ys16_Ws16 100.0000 OneToOne 0.00 100.0000 FORMAT "%8.4" EXTENDED_LIMITS -32768.00 32767.00
 /begin AXIS_DESCR STD_AXIS Eng_nAvrg EngN 6 0.00 6000.000 FORMAT "%8.3" EXTENDED_LIMITS -32768.00 32767.00 DEPOSIT ABSOLUTE /end AXIS_DESCR
 /begin AXIS_DESCR STD_AXIS InjCtl_qSetUnBal InjMassCyc 6 0.00 327.6700 FORMAT "%8.4" EXTENDED_LIMITS -327.6800 327.6700 DEPOSIT ABSOLUTE /end AXIS_DESCR
/end CHARACTERISTIC
/begin CHARACTERISTIC InjCrv_POpPoI2ETSCorStrt_MAP "Motortemperaturabhängiges Freigabekorrekturkennfeld für PoI2 im Startzustand." MAP 0xE5F64 Kf_Xs16_Ys16_Ws16 100.0000 OneToOne 0.00 100.0000 FORMAT "%8.4" EXTENDED_LIMITS -32768.00 32767.00
 /begin AXIS_DESCR STD_AXIS Eng_nAvrg EngN 8 0.00 6000.000 FORMAT "%8.3" EXTENDED_LIMITS -32768.00 32767.00 DEPOSIT ABSOLUTE /end AXIS_DESCR
 /begin AXIS_DESCR STD_AXIS InjCtl_qSetUnBal InjMassCyc 8 0.00 327.6700 FORMAT "%8.4" EXTENDED_LIMITS -327.6800 327.6700 DEPOSIT ABSOLUTE /end AXIS_DESCR
/end CHARACTERISTIC
/begin CHARACTERISTIC InjCrv_POpPoI2ETSCor_MAP "Motortemperaturabhängiges Freigabekorrekturkennfeld für PoI2" MAP 0xE6008 Kf_Xs16_Ys16_Ws16 100.0000 OneToOne 0.00 100.0000 FORMAT "%8.4" EXTENDED_LIMITS -32768.00 32767.00
 /begin AXIS_DESCR STD_AXIS Eng_nAvrg EngN 8 0.00 6000.000 FORMAT "%8.3" EXTENDED_LIMITS -32768.00 32767.00 DEPOSIT ABSOLUTE /end AXIS_DESCR
 /begin AXIS_DESCR STD_AXIS InjCtl_qSetUnBal InjMassCyc 8 0.00 327.6700 FORMAT "%8.4" EXTENDED_LIMITS -327.6800 327.6700 DEPOSIT ABSOLUTE /end AXIS_DESCR
/end CHARACTERISTIC
/begin CHARACTERISTIC InjCrv_PopPoI2HighStrt_C "Hohe Begrenzung für Hysteresis für Knallberechnung im Anfangszustand." VALUE 0xE7FBC Kw_Ws16 100.0000 OneToOne 0.00 100.0000 FORMAT "%8.4" EXTENDED_LIMITS -32768.00 32767.00 /end CHARACTERISTIC
/begin CHARACTERISTIC InjCrv_POpPoI2High_C "Feigabe PoI2 über Betriebspunkt, obere Hystereseschwelle" VALUE 0xE7B84 Kw_Ws16 100.0000 OneToOne 0.00 100.0000 FORMAT "%8.4" EXTENDED_LIMITS -32768.00 32767.00 /end CHARACTERISTIC
/begin CHARACTERISTIC InjCrv_PopPoI2LowStrt_C "Untere Grenze für Hysteresis für Knallberechnung im Anfangszustand." VALUE 0xE7FBE Kw_Ws16 100.0000 OneToOne 0.00 100.0000 FORMAT "%8.4" EXTENDED_LIMITS -32768.00 32767.00 /end CHARACTERISTIC
/begin CHARACTERISTIC InjCrv_POpPoI2Low_C "Freigabe PoI2 über Betriebspunkt, untere Hystereseschwelle" VALUE 0xE7B86 Kw_Ws16 100.0000 OneToOne 0.00 100.0000 FORMAT "%8.4" EXTENDED_LIMITS -32768.00 32767.00 /end CHARACTERISTIC
/begin CHARACTERISTIC InjCrv_qMin_CUR "Kennlinie für die Berechnung der Minimalmenge einer Einspritzung" CURVE 0xE8118 Kl_Xs16_Ws16 327.6700 InjMassInj 0.00 327.6700 FORMAT "%8.4" EXTENDED_LIMITS -327.6800 327.6700
 /begin AXIS_DESCR STD_AXIS RailCD_pPeak Pres_Rail 16 0.00 2000.000 FORMAT "%5.3" EXTENDED_LIMITS -3276.800 3276.700 DEPOSIT ABSOLUTE /end AXIS_DESCR
/end CHARACTERISTIC
/begin CHARACTERISTIC InjCrv_qPiI1APSCor2_MAP "atmosphärendruckabhängige Einspritzmengenkorrekturkennfeld -2 für PiI1 und PiI2" MAP 0xE2AFC Gkf_Ws16 10.00000 InjMassInj 0.00 10.00000 FORMAT "%8.5" EXTENDED_LIMITS -327.6800 327.6700
 /begin AXIS_DESCR COM_AXIS Eng_nAvrg EngN 16 0.00 6000.000 FORMAT "%8.3" EXTENDED_LIMITS -32768.00 32767.00 AXIS_PTS_REF InjCrv_qPiI1APSCor_X_AXIS /end AXIS_DESCR
 /begin AXIS_DESCR COM_AXIS InjCtl_qSetUnBal InjMassCyc 16 0.00 327.6700 FORMAT "%8.4" EXTENDED_LIMITS -327.6800 327.6700 AXIS_PTS_REF InjCrv_qPiI1APSCor_Y_AXIS /end AXIS_DESCR
/end CHARACTERISTIC
/begin CHARACTERISTIC InjCrv_qPiI1APSCorStrt_MAP "correction value for atmospheric pressure dependent pilot injections quantity correction" MAP 0xE2CFC Kf_Xs16_Ys16_Ws16 10.00000 InjMassInj 0.00 10.00000 FORMAT "%8.5" EXTENDED_LIMITS -327.6800 327.6700
 /begin AXIS_DESCR STD_AXIS Eng_nAvrg EngN 16 0.00 6000.000 FORMAT "%8.3" EXTENDED_LIMITS -32768.00 32767.00 DEPOSIT ABSOLUTE /end AXIS_DESCR
 /begin AXIS_DESCR STD_AXIS InjCtl_qSetUnBal InjMassCyc 16 0.00 327.6700 FORMAT "%8.4" EXTENDED_LIMITS -327.6800 327.6700 DEPOSIT ABSOLUTE /end AXIS_DESCR
/end CHARACTERISTIC
/begin CHARACTERISTIC InjCrv_qPiI1APSCor_MAP "atmosphärendruckabhängiges Mengenkorrekturkennfeld für Voreinspritzung 1" MAP 0xE2F40 Gkf_Ws16 10.00000 InjMassInj 0.00 10.00000 FORMAT "%8.5" EXTENDED_LIMITS -327.6800 327.6700
 /begin AXIS_DESCR COM_AXIS Eng_nAvrg EngN 16 0.00 6000.000 FORMAT "%8.3" EXTENDED_LIMITS -32768.00 32767.00 AXIS_PTS_REF InjCrv_qPiI1APSCor_X_AXIS /end AXIS_DESCR
 /begin AXIS_DESCR COM_AXIS InjCtl_qSetUnBal InjMassCyc 16 0.00 327.6700 FORMAT "%8.4" EXTENDED_LIMITS -327.6800 327.6700 AXIS_PTS_REF InjCrv_qPiI1APSCor_Y_AXIS /end AXIS_DESCR
/end CHARACTERISTIC
/begin AXIS_PTS InjCrv_qPiI1APSCor_X_AXIS "gemeinsame X-Achse für atmosphärendruckabhängige Mengenkorrekturkennfelder für Voreinspritzung 1" 0xE3140 Eng_nAvrg GSst_Xs16 6000.000 EngN 16 0.00 6000.000 FORMAT "%8.3" EXTENDED_LIMITS -32768.00 32767.00 DEPOSIT ABSOLUTE /end AXIS_PTS
/begin AXIS_PTS InjCrv_qPiI1APSCor_Y_AXIS "gemeinsame Y-Achse für atmosphärendruckabhängige Mengenkorrekturkennfelder für Voreinspritzung 1" 0xE3162 InjCtl_qSetUnBal GSst_Xs16 327.6700 InjMassCyc 16 0.00 327.6700 FORMAT "%8.4" EXTENDED_LIMITS -327.6800 327.6700 DEPOSIT ABSOLUTE /end AXIS_PTS
/begin CHARACTERISTIC InjCrv_qPiI1ATSCor2_MAP "ansauglufttemperaturabhängiges Einspritzmengenkorrekturkennfeld -2 für PiI1 und PiI2" MAP 0xE3184 Gkf_Ws16 10.00000 InjMassInj 0.00 10.00000 FORMAT "%8.5" EXTENDED_LIMITS -327.6800 327.6700
 /begin AXIS_DESCR COM_AXIS Eng_nAvrg EngN 16 0.00 6000.000 FORMAT "%8.3" EXTENDED_LIMITS -32768.00 32767.00 AXIS_PTS_REF InjCrv_qPiI1ATSCor_X_AXIS /end AXIS_DESCR
 /begin AXIS_DESCR COM_AXIS InjCtl_qSetUnBal InjMassCyc 16 0.00 327.6700 FORMAT "%8.4" EXTENDED_LIMITS -327.6800 327.6700 AXIS_PTS_REF InjCrv_qPiI1ATSCor_Y_AXIS /end AXIS_DESCR
/end CHARACTERISTIC
/begin CHARACTERISTIC InjCrv_qPiI1ATSCorStrt_MAP "correction value for intake air temperature dependent pilot injections quantity correction" MAP 0xE3384 Kf_Xs16_Ys16_Ws16 10.00000 InjMassInj 0.00 10.00000 FORMAT "%8.5" EXTENDED_LIMITS -327.6800 327.6700
 /begin AXIS_DESCR STD_AXIS Eng_nAvrg EngN 16 0.00 6000.000 FORMAT "%8.3" EXTENDED_LIMITS -32768.00 32767.00 DEPOSIT ABSOLUTE /end AXIS_DESCR
 /begin AXIS_DESCR STD_AXIS InjCtl_qSetUnBal InjMassCyc 16 0.00 327.6700 FORMAT "%8.4" EXTENDED_LIMITS -327.6800 327.6700 DEPOSIT ABSOLUTE /end AXIS_DESCR
/end CHARACTERISTIC
/begin CHARACTERISTIC InjCrv_qPiI1ATSCor_MAP "ansauglufttemperaturabhängiges Mengenkorrekturkennfeld für Voreinspritzung 1" MAP 0xE35C8 Gkf_Ws16 10.00000 InjMassInj 0.00 10.00000 FORMAT "%8.5" EXTENDED_LIMITS -327.6800 327.6700
 /begin AXIS_DESCR COM_AXIS Eng_nAvrg EngN 16 0.00 6000.000 FORMAT "%8.3" EXTENDED_LIMITS -32768.00 32767.00 AXIS_PTS_REF InjCrv_qPiI1ATSCor_X_AXIS /end AXIS_DESCR
 /begin AXIS_DESCR COM_AXIS InjCtl_qSetUnBal InjMassCyc 16 0.00 327.6700 FORMAT "%8.4" EXTENDED_LIMITS -327.6800 327.6700 AXIS_PTS_REF InjCrv_qPiI1ATSCor_Y_AXIS /end AXIS_DESCR
/end CHARACTERISTIC
/begin AXIS_PTS InjCrv_qPiI1ATSCor_X_AXIS "gemeinsame X-Achse für ansauglufttemperaturabhängige Mengenkennfelder für Voreinspritzung 1" 0xE37C8 Eng_nAvrg GSst_Xs16 6000.000 EngN 16 0.00 6000.000 FORMAT "%8.3" EXTENDED_LIMITS -32768.00 32767.00 DEPOSIT ABSOLUTE /end AXIS_PTS
/begin AXIS_PTS InjCrv_qPiI1ATSCor_Y_AXIS "gemeinsame Y-Achse für ansauglufttemperaturabhängige Mengenkennfelder für Voreinspritzung 1" 0xE37EA InjCtl_qSetUnBal GSst_Xs16 327.6700 InjMassCyc 16 0.00 327.6700 FORMAT "%8.4" EXTENDED_LIMITS -327.6800 327.6700 DEPOSIT ABSOLUTE /end AXIS_PTS
/begin CHARACTERISTIC InjCrv_qPiI1ChamWllTempCorr_MAP "Kennfeld zur Ermittlung der Einspritzmenge durch Brennraumwandtemperaturkorrektur" MAP 0xE257C Kf_Xs16_Ys16_Ws16 327.6700 InjMassInj 0.00 327.6700 FORMAT "%8.4" EXTENDED_LIMITS -327.6800 327.6700
 /begin AXIS_DESCR STD_AXIS Eng_nAvrg EngN 8 0.00 6000.000 FORMAT "%8.3" EXTENDED_LIMITS -32768.00 32767.00 DEPOSIT ABSOLUTE /end AXIS_DESCR
 /begin AXIS_DESCR STD_AXIS InjCtl_qSetUnBal InjMassCyc 8 0.00 327.6700 FORMAT "%8.4" EXTENDED_LIMITS -327.6800 327.6700 DEPOSIT ABSOLUTE /end AXIS_DESCR
/end CHARACTERISTIC
/begin CHARACTERISTIC InjCrv_qPiI1DesAdd_Vector "#SSD Bypass-Label für additiven Bypass von InjCrv_qPiI1Des (Nicht verstellen!)" VALUE 0xC3984 Kw_Wu8 255.0 OneToOne 0.00 255.0 FORMAT "%5.1" /end CHARACTERISTIC
/begin CHARACTERISTIC InjCrv_qPiI1DesAdd_Channel "#SSD Bypass-Label für additiven Bypass von InjCrv_qPiI1Des (Nicht verstellen!)" VALUE 0xC3985 Kw_Wu8 255.0 OneToOne 0.00 255.0 FORMAT "%5.1" /end CHARACTERISTIC
/begin CHARACTERISTIC InjCrv_qPiI1Des_Vector "#SSD Bypass-Label für InjCrv_qPiI1Des (Nicht verstellen!)" VALUE 0xC3986 Kw_Wu8 255.0 OneToOne 0.00 255.0 FORMAT "%5.1" /end CHARACTERISTIC
/begin CHARACTERISTIC InjCrv_qPiI1Des_Channel "#SSD Bypass-Label für InjCrv_qPiI1Des (Nicht verstellen!)" VALUE 0xC3987 Kw_Wu8 255.0 OneToOne 0.00 255.0 FORMAT "%5.1" /end CHARACTERISTIC
/begin CHARACTERISTIC InjCrv_qPiI1DynQCor_MAP "Kennfeld für drehzahlabhängige Mengenkorrektur der Voreinspritzung PiI1" MAP 0xE2620 Kf_Xs16_Ys16_Ws16 327.6700 InjMassInj 0.00 327.6700 FORMAT "%8.4" EXTENDED_LIMITS -327.6800 327.6700
 /begin AXIS_DESCR STD_AXIS Eng_nAvrg EngN 16 0.00 6000.000 FORMAT "%8.3" EXTENDED_LIMITS -32768.00 32767.00 DEPOSIT ABSOLUTE /end AXIS_DESCR
 /begin AXIS_DESCR STD_AXIS InjCtl_qSetUnBal InjMassCyc 8 0.00 327.6700 FORMAT "%8.4" EXTENDED_LIMITS -327.6800 327.6700 DEPOSIT ABSOLUTE /end AXIS_DESCR
/end CHARACTERISTIC
/begin CHARACTERISTIC InjCrv_qPiI1ETSCor12_MAP "motortemperaturabhängiges Mengenkorrekturkennfeld für PiI1 bei aktiver PiI2" MAP 0xE380C Gkf_Ws16 10.00000 InjMassInj 0.00 10.00000 FORMAT "%8.5" EXTENDED_LIMITS -327.6800 327.6700
 /begin AXIS_DESCR COM_AXIS Eng_nAvrg EngN 16 0.00 6000.000 FORMAT "%8.3" EXTENDED_LIMITS -32768.00 32767.00 AXIS_PTS_REF InjCrv_qPiI1ETSCor1_X_AXIS /end AXIS_DESCR
 /begin AXIS_DESCR COM_AXIS InjCtl_qSetUnBal InjMassCyc 16 0.00 327.6700 FORMAT "%8.4" EXTENDED_LIMITS -327.6800 327.6700 AXIS_PTS_REF InjCrv_qPiI1ETSCor1_Y_AXIS /end AXIS_DESCR
/end CHARACTERISTIC
/begin CHARACTERISTIC InjCrv_qPiI1ETSCor1_MAP "motortemperaturabhängiges Einspritzmengenkorrekturkennfeld -1 für PiI1 und PiI2" MAP 0xE3A0C Gkf_Ws16 10.00000 InjMassInj 0.00 10.00000 FORMAT "%8.5" EXTENDED_LIMITS -327.6800 327.6700
 /begin AXIS_DESCR COM_AXIS Eng_nAvrg EngN 16 0.00 6000.000 FORMAT "%8.3" EXTENDED_LIMITS -32768.00 32767.00 AXIS_PTS_REF InjCrv_qPiI1ETSCor1_X_AXIS /end AXIS_DESCR
 /begin AXIS_DESCR COM_AXIS InjCtl_qSetUnBal InjMassCyc 16 0.00 327.6700 FORMAT "%8.4" EXTENDED_LIMITS -327.6800 327.6700 AXIS_PTS_REF InjCrv_qPiI1ETSCor1_Y_AXIS /end AXIS_DESCR
/end CHARACTERISTIC
/begin AXIS_PTS InjCrv_qPiI1ETSCor1_X_AXIS "Achsenpunkte der mittleren Drehzahl für die Grundwertkennfelder der Pil1-Einspritzmenge" 0xE3C0C Eng_nAvrg GSst_Xs16 6000.000 EngN 16 0.00 6000.000 FORMAT "%8.3" EXTENDED_LIMITS -32768.00 32767.00 DEPOSIT ABSOLUTE /end AXIS_PTS
/begin AXIS_PTS InjCrv_qPiI1ETSCor1_Y_AXIS "Achsenpunkte der aktuellen Einspritzmenge für die Grundwertkennfelder der Pil1-Einspritzmenge" 0xE3C2E InjCtl_qSetUnBal GSst_Xs16 327.6700 InjMassCyc 16 0.00 327.6700 FORMAT "%8.4" EXTENDED_LIMITS -327.6800 327.6700 DEPOSIT ABSOLUTE /end AXIS_PTS
/begin CHARACTERISTIC InjCrv_qPiI1ETSCor2_MAP "motortemperaturabhängiges Einspritzmengenkorrekturkennfeld -2 für PiI1 und PiI2" MAP 0xE3C50 Gkf_Ws16 10.00000 InjMassInj 0.00 10.00000 FORMAT "%8.5" EXTENDED_LIMITS -327.6800 327.6700
 /begin AXIS_DESCR COM_AXIS Eng_nAvrg EngN 16 0.00 6000.000 FORMAT "%8.3" EXTENDED_LIMITS -32768.00 32767.00 AXIS_PTS_REF InjCrv_qPiI1ETSCor_X_AXIS /end AXIS_DESCR
 /begin AXIS_DESCR COM_AXIS InjCtl_qSetUnBal InjMassCyc 16 0.00 327.6700 FORMAT "%8.4" EXTENDED_LIMITS -327.6800 327.6700 AXIS_PTS_REF InjCrv_qPiI1ETSCor_Y_AXIS /end AXIS_DESCR
/end CHARACTERISTIC
/begin CHARACTERISTIC InjCrv_qPiI1ETSCorStrt_MAP "correction value for engine temperature dependent pilot injections quantity correction" MAP 0xE3E50 Kf_Xs16_Ys16_Ws16 10.00000 InjMassInj 0.00 10.00000 FORMAT "%8.5" EXTENDED_LIMITS -327.6800 327.6700
 /begin AXIS_DESCR STD_AXIS Eng_nAvrg EngN 16 0.00 6000.000 FORMAT "%8.3" EXTENDED_LIMITS -32768.00 32767.00 DEPOSIT ABSOLUTE /end AXIS_DESCR
 /begin AXIS_DESCR STD_AXIS InjCtl_qSetUnBal InjMassCyc 16 0.00 327.6700 FORMAT "%8.4" EXTENDED_LIMITS -327.6800 327.6700 DEPOSIT ABSOLUTE /end AXIS_DESCR
/end CHARACTERISTIC
/begin CHARACTERISTIC InjCrv_qPiI1ETSCor_MAP "motortemperaturabhängiges Mengenkorrekturkennfeld für Voreinspritzung 1" MAP 0xE4094 Gkf_Ws16 10.00000 InjMassInj 0.00 10.00000 FORMAT "%8.5" EXTENDED_LIMITS -327.6800 327.6700
 /begin AXIS_DESCR COM_AXIS Eng_nAvrg EngN 16 0.00 6000.000 FORMAT "%8.3" EXTENDED_LIMITS -32768.00 32767.00 AXIS_PTS_REF InjCrv_qPiI1ETSCor_X_AXIS /end AXIS_DESCR
 /begin AXIS_DESCR COM_AXIS InjCtl_qSetUnBal InjMassCyc 16 0.00 327.6700 FORMAT "%8.4" EXTENDED_LIMITS -327.6800 327.6700 AXIS_PTS_REF InjCrv_qPiI1ETSCor_Y_AXIS /end AXIS_DESCR
/end CHARACTERISTIC
/begin AXIS_PTS InjCrv_qPiI1ETSCor_X_AXIS "gemeinsame X-Achse für motortemperaturabhängige Mengenkorrekturkennfelder für Voreinspritzung 1" 0xE4294 Eng_nAvrg GSst_Xs16 6000.000 EngN 16 0.00 6000.000 FORMAT "%8.3" EXTENDED_LIMITS -32768.00 32767.00 DEPOSIT ABSOLUTE /end AXIS_PTS
/begin AXIS_PTS InjCrv_qPiI1ETSCor_Y_AXIS "gemeinsame Y-Achse für motortemperaturabhängige Mengenkorrekturkennfelder für Voreinspritzung 1" 0xE42B6 InjCtl_qSetUnBal GSst_Xs16 327.6700 InjMassCyc 16 0.00 327.6700 FORMAT "%8.4" EXTENDED_LIMITS -327.6800 327.6700 DEPOSIT ABSOLUTE /end AXIS_PTS
/begin CHARACTERISTIC InjCrv_qPiI1RgnAdd_Vector "#SSD Bypass-Label für InjCrv_qPiI1RgnAdd_Vector (Nicht verstellen!)" VALUE 0xC399E Kw_Wu8 255.0 OneToOne 0.00 255.0 FORMAT "%5.1" /end CHARACTERISTIC
/begin CHARACTERISTIC InjCrv_qPiI1RgnAdd_Channel "#SSD Bypass-Label für InjCrv_qPiI1RgnAdd_Channel (Nicht verstellen!)" VALUE 0xC399F Kw_Wu8 255.0 OneToOne 0.00 255.0 FORMAT "%5.1" /end CHARACTERISTIC
/begin CHARACTERISTIC InjCrv_qPiI1Rgn_MAP "Kennfeld für Einspritzmenge PiI1 im Regenerationsbetrieb" MAP 0xE4F5A Kf_Xs16_Ys16_Ws16 10.00000 InjMassInj 0.00 10.00000 FORMAT "%8.5" EXTENDED_LIMITS -327.6800 327.6700
 /begin AXIS_DESCR STD_AXIS Eng_nAvrg EngN 16 0.00 6000.000 FORMAT "%8.3" EXTENDED_LIMITS -32768.00 32767.00 DEPOSIT ABSOLUTE /end AXIS_DESCR
 /begin AXIS_DESCR STD_AXIS InjCtl_qSetUnBal InjMassCyc 16 0.00 327.6700 FORMAT "%8.4" EXTENDED_LIMITS -327.6800 327.6700 DEPOSIT ABSOLUTE /end AXIS_DESCR
/end CHARACTERISTIC
/begin CHARACTERISTIC InjCrv_qPiI1Rgn_Vector "#SSD Bypass-Label, nicht editieren !" VALUE 0xC39A0 Kw_Wu8 255.0 OneToOne 0.00 255.0 FORMAT "%5.1" /end CHARACTERISTIC
/begin CHARACTERISTIC InjCrv_qPiI1Rgn_Channel "#SSD Bypass-Label, nicht editieren !" VALUE 0xC39A1 Kw_Wu8 255.0 OneToOne 0.00 255.0 FORMAT "%5.1" /end CHARACTERISTIC
/begin CHARACTERISTIC InjCrv_qPiI1SetByp_Vector "#SSD Bypass Label, NICHT AENDERN" VALUE 0xC3988 Kw_Wu8 255.0 OneToOne 0.00 255.0 FORMAT "%5.1" /end CHARACTERISTIC
/begin CHARACTERISTIC InjCrv_qPiI1SetByp_Channel "#SSD Bypass Label, NICHT AENDERN" VALUE 0xC3989 Kw_Wu8 255.0 OneToOne 0.00 255.0 FORMAT "%5.1" /end CHARACTERISTIC
/begin CHARACTERISTIC InjCrv_qPiI2BasStrt_MAP "Einspritzmenge PiI2 Grundwertekennfeld start" MAP 0xE23D8 Kf_Xs16_Ys16_Ws16 10.00000 InjMassInj 0.00 10.00000 FORMAT "%8.5" EXTENDED_LIMITS -327.6800 327.6700
 /begin AXIS_DESCR STD_AXIS Eng_nAvrg EngN 2 0.00 6000.000 FORMAT "%8.3" EXTENDED_LIMITS -32768.00 32767.00 DEPOSIT ABSOLUTE /end AXIS_DESCR
 /begin AXIS_DESCR STD_AXIS InjCtl_qSetUnBal InjMassCyc 2 0.00 327.6700 FORMAT "%8.4" EXTENDED_LIMITS -327.6800 327.6700 DEPOSIT ABSOLUTE /end AXIS_DESCR
/end CHARACTERISTIC
/begin CHARACTERISTIC InjCrv_qPiI2DesAdd_Vector "#SSD Bypass-Label für additiven Bypass von InjCrv_qPiI2Des (Nicht verstellen!)" VALUE 0xC398A Kw_Wu8 255.0 OneToOne 0.00 255.0 FORMAT "%5.1" /end CHARACTERISTIC
/begin CHARACTERISTIC InjCrv_qPiI2DesAdd_Channel "#SSD Bypass-Label für additiven Bypass von InjCrv_qPiI2Des (Nicht verstellen!)" VALUE 0xC398B Kw_Wu8 255.0 OneToOne 0.00 255.0 FORMAT "%5.1" /end CHARACTERISTIC
/begin CHARACTERISTIC InjCrv_qPiI2Des_Vector "#SSD Bypass-Label für InjCrv_qPiI2Des (Nicht verstellen!)" VALUE 0xC398C Kw_Wu8 255.0 OneToOne 0.00 255.0 FORMAT "%5.1" /end CHARACTERISTIC
/begin CHARACTERISTIC InjCrv_qPiI2Des_Channel "#SSD Bypass-Label für InjCrv_qPiI2Des (Nicht verstellen!)" VALUE 0xC398D Kw_Wu8 255.0 OneToOne 0.00 255.0 FORMAT "%5.1" /end CHARACTERISTIC
/begin CHARACTERISTIC InjCrv_qPiI2RgnAdd_Vector "#SSD Konfigurationslabel für Beipass" VALUE 0xC3970 Kw_Wu8 255.0 OneToOne 0.00 255.0 FORMAT "%5.1" /end CHARACTERISTIC
/begin CHARACTERISTIC InjCrv_qPiI2RgnAdd_Channel "#SSD Konfigurationslabel für Beipass" VALUE 0xC3971 Kw_Wu8 255.0 OneToOne 0.00 255.0 FORMAT "%5.1" /end CHARACTERISTIC
/begin CHARACTERISTIC InjCrv_qPiI2Rgn_Vector "#SSD Bypass-Label, nicht editieren !" VALUE 0xC3972 Kw_Wu8 255.0 OneToOne 0.00 255.0 FORMAT "%5.1" /end CHARACTERISTIC
/begin CHARACTERISTIC InjCrv_qPiI2Rgn_Channel "#SSD Bypass-Label, nicht editieren !" VALUE 0xC3973 Kw_Wu8 255.0 OneToOne 0.00 255.0 FORMAT "%5.1" /end CHARACTERISTIC
/begin CHARACTERISTIC InjCrv_qPiI2SetByp_Vector "#SSD Bypass Label, NICHT AENDERN" VALUE 0xC396A Kw_Wu8 255.0 OneToOne 0.00 255.0 FORMAT "%5.1" /end CHARACTERISTIC
/begin CHARACTERISTIC InjCrv_qPiI2SetByp_Channel "#SSD Bypass Label, NICHT AENDERN" VALUE 0xC396B Kw_Wu8 255.0 OneToOne 0.00 255.0 FORMAT "%5.1" /end CHARACTERISTIC
/begin CHARACTERISTIC InjCrv_qPiI3DesAdd_Vector "#SSD Bypass-Label für additiven Bypass von InjCrv_qPiI3Des (Nicht verstellen!)" VALUE 0xC398E Kw_Wu8 255.0 OneToOne 0.00 255.0 FORMAT "%5.1" /end CHARACTERISTIC
/begin CHARACTERISTIC InjCrv_qPiI3DesAdd_Channel "#SSD Bypass-Label für additiven Bypass von InjCrv_qPiI3Des (Nicht verstellen!)" VALUE 0xC398F Kw_Wu8 255.0 OneToOne 0.00 255.0 FORMAT "%5.1" /end CHARACTERISTIC
/begin CHARACTERISTIC InjCrv_qPiI3Des_Vector "#SSD Bypass-Label für InjCrv_qPiI3Des (Nicht verstellen!)" VALUE 0xC3990 Kw_Wu8 255.0 OneToOne 0.00 255.0 FORMAT "%5.1" /end CHARACTERISTIC
/begin CHARACTERISTIC InjCrv_qPiI3Des_Channel "#SSD Bypass-Label für InjCrv_qPiI3Des (Nicht verstellen!)" VALUE 0xC3991 Kw_Wu8 255.0 OneToOne 0.00 255.0 FORMAT "%5.1" /end CHARACTERISTIC
/begin CHARACTERISTIC InjCrv_qPoI1APSCor_MAP "atmospärendruckabhängiges Mengenkorrekturkennfeld für PoI1" MAP 0xE5506 Kf_Xs16_Ys16_Ws16 10.00000 InjMassInj 0.00 10.00000 FORMAT "%8.5" EXTENDED_LIMITS -327.6800 327.6700
 /begin AXIS_DESCR STD_AXIS Eng_nAvrg EngN 2 0.00 6000.000 FORMAT "%8.3" EXTENDED_LIMITS -32768.00 32767.00 DEPOSIT ABSOLUTE /end AXIS_DESCR
 /begin AXIS_DESCR STD_AXIS InjCtl_qSetUnBal InjMassCyc 2 0.00 327.6700 FORMAT "%8.4" EXTENDED_LIMITS -327.6800 327.6700 DEPOSIT ABSOLUTE /end AXIS_DESCR
/end CHARACTERISTIC
/begin CHARACTERISTIC InjCrv_qPoI1Bas_MAP "Grundwert der Einspritzmenge PoI1" MAP 0xE54DC Kf_Xs16_Ys16_Ws16 10.00000 InjMassInj 0.00 10.00000 FORMAT "%8.5" EXTENDED_LIMITS -327.6800 327.6700
 /begin AXIS_DESCR STD_AXIS Eng_nAvrg EngN 2 0.00 6000.000 FORMAT "%8.3" EXTENDED_LIMITS -32768.00 32767.00 DEPOSIT ABSOLUTE /end AXIS_DESCR
 /begin AXIS_DESCR STD_AXIS InjCtl_qSetUnBal InjMassCyc 2 0.00 327.6700 FORMAT "%8.4" EXTENDED_LIMITS -327.6800 327.6700 DEPOSIT ABSOLUTE /end AXIS_DESCR
/end CHARACTERISTIC
/begin CHARACTERISTIC InjCrv_qPoI1DesAdd_Vector "#SSD Bypass-Label für additiven Bypass von InjCrv_qPoI1Des (Nicht verstellen!)" VALUE 0xC39AA Kw_Wu8 255.0 OneToOne 0.00 255.0 FORMAT "%5.1" /end CHARACTERISTIC
/begin CHARACTERISTIC InjCrv_qPoI1DesAdd_Channel "#SSD Bypass-Label für additiven Bypass von InjCrv_qPoI1Des (Nicht verstellen!)" VALUE 0xC39AB Kw_Wu8 255.0 OneToOne 0.00 255.0 FORMAT "%5.1" /end CHARACTERISTIC
/begin CHARACTERISTIC InjCrv_qPoI1Des_Vector "#SSD Bypass-Label für InjCrv_qPoI1Des (Nicht verstellen!)" VALUE 0xC39AC Kw_Wu8 255.0 OneToOne 0.00 255.0 FORMAT "%5.1" /end CHARACTERISTIC
/begin CHARACTERISTIC InjCrv_qPoI1Des_Channel "#SSD Bypass-Label für InjCrv_qPoI1Des (Nicht verstellen!)" VALUE 0xC39AD Kw_Wu8 255.0 OneToOne 0.00 255.0 FORMAT "%5.1" /end CHARACTERISTIC
/begin CHARACTERISTIC InjCrv_qPoI1ETSCor_MAP "motortemperaturabhängiges Mengenkorrekturkennfeld für PoI1" MAP 0xE551A Kf_Xs16_Ys16_Ws16 10.00000 InjMassInj 0.00 10.00000 FORMAT "%8.5" EXTENDED_LIMITS -327.6800 327.6700
 /begin AXIS_DESCR STD_AXIS Eng_nAvrg EngN 2 0.00 6000.000 FORMAT "%8.3" EXTENDED_LIMITS -32768.00 32767.00 DEPOSIT ABSOLUTE /end AXIS_DESCR
 /begin AXIS_DESCR STD_AXIS InjCtl_qSetUnBal InjMassCyc 2 0.00 327.6700 FORMAT "%8.4" EXTENDED_LIMITS -327.6800 327.6700 DEPOSIT ABSOLUTE /end AXIS_DESCR
/end CHARACTERISTIC
/begin CHARACTERISTIC InjCrv_qPoI1Rgn1_MAP "map for value for regeneration of quantity PoI1" MAP 0xE5C8A Kf_Xs16_Ys16_Ws16 10.00000 InjMassInj 0.00 10.00000 FORMAT "%8.5" EXTENDED_LIMITS -327.6800 327.6700
 /begin AXIS_DESCR STD_AXIS Eng_nAvrg EngN 12 0.00 6000.000 FORMAT "%8.3" EXTENDED_LIMITS -32768.00 32767.00 DEPOSIT ABSOLUTE /end AXIS_DESCR
 /begin AXIS_DESCR STD_AXIS InjCtl_qSetUnBal InjMassCyc 12 0.00 327.6700 FORMAT "%8.4" EXTENDED_LIMITS -327.6800 327.6700 DEPOSIT ABSOLUTE /end AXIS_DESCR
/end CHARACTERISTIC
/begin CHARACTERISTIC InjCrv_qPoI1Rgn2_MAP "map for value for regeneration of quantity PoI1" MAP 0xE5DDE Kf_Xs16_Ys16_Ws16 10.00000 InjMassInj 0.00 10.00000 FORMAT "%8.5" EXTENDED_LIMITS -327.6800 327.6700
 /begin AXIS_DESCR STD_AXIS Eng_nAvrg EngN 12 0.00 6000.000 FORMAT "%8.3" EXTENDED_LIMITS -32768.00 32767.00 DEPOSIT ABSOLUTE /end AXIS_DESCR
 /begin AXIS_DESCR STD_AXIS InjCtl_qSetUnBal InjMassCyc 12 0.00 327.6700 FORMAT "%8.4" EXTENDED_LIMITS -327.6800 327.6700 DEPOSIT ABSOLUTE /end AXIS_DESCR
/end CHARACTERISTIC
/begin CHARACTERISTIC InjCrv_qPoI1RgnAdd_Vector "#SSD Konfigurationslabel für Bypass Freischnitt" VALUE 0xC39B2 Kw_Wu8 255.0 OneToOne 0.00 255.0 FORMAT "%5.1" /end CHARACTERISTIC
/begin CHARACTERISTIC InjCrv_qPoI1RgnAdd_Channel "#SSD Konfigurationslabel für Bypass Freischnitt" VALUE 0xC39B3 Kw_Wu8 255.0 OneToOne 0.00 255.0 FORMAT "%5.1" /end CHARACTERISTIC
/begin CHARACTERISTIC InjCrv_qPoI1Rgn_Vector "#SSD Bypass-Label, nicht editieren !" VALUE 0xC39B4 Kw_Wu8 255.0 OneToOne 0.00 255.0 FORMAT "%5.1" /end CHARACTERISTIC
/begin CHARACTERISTIC InjCrv_qPoI1Rgn_Channel "#SSD Bypass-Label, nicht editieren !" VALUE 0xC39B5 Kw_Wu8 255.0 OneToOne 0.00 255.0 FORMAT "%5.1" /end CHARACTERISTIC
/begin CHARACTERISTIC InjCrv_qPoI1SetLim_C "Minimum fuel quantity to enable PoI1" VALUE 0xE54F0 Kw_Ws16 327.6700 InjMassInj 0.00 327.6700 FORMAT "%8.4" EXTENDED_LIMITS -327.6800 327.6700 /end CHARACTERISTIC
/begin CHARACTERISTIC InjCrv_qPoI2APSCorStrt_MAP "Atmosphärendruckabhängiges Mengenkorrekturkennfeld für PoI2 im Startzustand." MAP 0xE60AC Kf_Xs16_Ys16_Ws16 10.00000 InjMassInj 0.00 10.00000 FORMAT "%8.5" EXTENDED_LIMITS -327.6800 327.6700
 /begin AXIS_DESCR STD_AXIS Eng_nAvrg EngN 8 0.00 6000.000 FORMAT "%8.3" EXTENDED_LIMITS -32768.00 32767.00 DEPOSIT ABSOLUTE /end AXIS_DESCR
 /begin AXIS_DESCR STD_AXIS InjCtl_qSetUnBal InjMassCyc 8 0.00 327.6700 FORMAT "%8.4" EXTENDED_LIMITS -327.6800 327.6700 DEPOSIT ABSOLUTE /end AXIS_DESCR
/end CHARACTERISTIC
/begin CHARACTERISTIC InjCrv_qPoI2ATSCorStrt_MAP "Ansauglufttemperaturabhängiges Mengenkorrekturkennfeld für PoI2 im Startzustand." MAP 0xE6150 Kf_Xs16_Ys16_Ws16 10.00000 InjMassInj 0.00 10.00000 FORMAT "%8.5" EXTENDED_LIMITS -327.6800 327.6700
 /begin AXIS_DESCR STD_AXIS Eng_nAvrg EngN 8 0.00 6000.000 FORMAT "%8.3" EXTENDED_LIMITS -32768.00 32767.00 DEPOSIT ABSOLUTE /end AXIS_DESCR
 /begin AXIS_DESCR STD_AXIS InjCtl_qSetUnBal InjMassCyc 8 0.00 327.6700 FORMAT "%8.4" EXTENDED_LIMITS -327.6800 327.6700 DEPOSIT ABSOLUTE /end AXIS_DESCR
/end CHARACTERISTIC
/begin CHARACTERISTIC InjCrv_qPoI2ATSCor_MAP "ansauglufttemperaturabhängiges Mengenkorrekturkennfeld für PoI2" MAP 0xE61F4 Kf_Xs16_Ys16_Ws16 10.00000 InjMassInj 0.00 10.00000 FORMAT "%8.5" EXTENDED_LIMITS -327.6800 327.6700
 /begin AXIS_DESCR STD_AXIS Eng_nAvrg EngN 6 0.00 6000.000 FORMAT "%8.3" EXTENDED_LIMITS -32768.00 32767.00 DEPOSIT ABSOLUTE /end AXIS_DESCR
 /begin AXIS_DESCR STD_AXIS InjCtl_qSetUnBal InjMassCyc 6 0.00 327.6700 FORMAT "%8.4" EXTENDED_LIMITS -327.6800 327.6700 DEPOSIT ABSOLUTE /end AXIS_DESCR
/end CHARACTERISTIC
/begin CHARACTERISTIC InjCrv_qPoI2BasStrt_MAP "Einspritzmenge PoI2 Basis-MAP während Motorstart" MAP 0xE7FC0 Kf_Xs16_Ys16_Ws16 10.00000 InjMassInj 0.00 10.00000 FORMAT "%8.5" EXTENDED_LIMITS -327.6800 327.6700
 /begin AXIS_DESCR STD_AXIS Eng_nAvrg EngN 8 0.00 6000.000 FORMAT "%8.3" EXTENDED_LIMITS -32768.00 32767.00 DEPOSIT ABSOLUTE /end AXIS_DESCR
 /begin AXIS_DESCR STD_AXIS InjCtl_qSetUnBal InjMassCyc 8 0.00 327.6700 FORMAT "%8.4" EXTENDED_LIMITS -327.6800 327.6700 DEPOSIT ABSOLUTE /end AXIS_DESCR
/end CHARACTERISTIC
/begin CHARACTERISTIC InjCrv_qPoI2Bas_MAP "Einspritzmenge PoI2 Grundwert" MAP 0xE6AF2 Kf_Xs16_Ys16_Ws16 10.00000 InjMassInj 0.00 10.00000 FORMAT "%8.5" EXTENDED_LIMITS -327.6800 327.6700
 /begin AXIS_DESCR STD_AXIS Eng_nAvrg EngN 16 0.00 6000.000 FORMAT "%8.3" EXTENDED_LIMITS -32768.00 32767.00 DEPOSIT ABSOLUTE /end AXIS_DESCR
 /begin AXIS_DESCR STD_AXIS InjCtl_qSetUnBal InjMassCyc 16 0.00 327.6700 FORMAT "%8.4" EXTENDED_LIMITS -327.6800 327.6700 DEPOSIT ABSOLUTE /end AXIS_DESCR
/end CHARACTERISTIC
/begin CHARACTERISTIC InjCrv_qPoI2DesAdd_Vector "#SSD Bypass-Label für additiven Bypass von InjCrv_qPoI2Des (Nicht verstellen!)" VALUE 0xC39CA Kw_Wu8 255.0 OneToOne 0.00 255.0 FORMAT "%5.1" /end CHARACTERISTIC
/begin CHARACTERISTIC InjCrv_qPoI2DesAdd_Channel "#SSD Konfigurationslabel für additive Bypass message" VALUE 0xC39CB Kw_Wu8 255.0 OneToOne 0.00 255.0 FORMAT "%5.1" /end CHARACTERISTIC
/begin CHARACTERISTIC InjCrv_qPoI2EffAdd_Vector "#SSD Bypass-label für additiven Bypass InjCrv_qPoI2Eff (nicht verstellen!)" VALUE 0xC39CC Kw_Wu8 255.0 OneToOne 0.00 255.0 FORMAT "%5.1" /end CHARACTERISTIC
/begin CHARACTERISTIC InjCrv_qPoI2EffAdd_Channel "#SSD Bypass-label für additiven Bypass  InjCrv_qPoI2Eff (nicht verstellen!)" VALUE 0xC39CD Kw_Wu8 255.0 OneToOne 0.00 255.0 FORMAT "%5.1" /end CHARACTERISTIC
/begin CHARACTERISTIC InjCrv_qPoI2Eff_Vector "#SSD Bypass-Label, nicht editieren !" VALUE 0xC39CE Kw_Wu8 255.0 OneToOne 0.00 255.0 FORMAT "%5.1" /end CHARACTERISTIC
/begin CHARACTERISTIC InjCrv_qPoI2Eff_Channel "#SSD Bypass-Label, nicht editieren !" VALUE 0xC39CF Kw_Wu8 255.0 OneToOne 0.00 255.0 FORMAT "%5.1" /end CHARACTERISTIC
/begin CHARACTERISTIC InjCrv_qPoI2ETSCorStrt_MAP "Motortemperaturabhängiges Mengenkorrekturkennfeld für PoI2 im Startzustand." MAP 0xE6258 Kf_Xs16_Ys16_Ws16 10.00000 InjMassInj 0.00 10.00000 FORMAT "%8.5" EXTENDED_LIMITS -327.6800 327.6700
 /begin AXIS_DESCR STD_AXIS Eng_nAvrg EngN 8 0.00 6000.000 FORMAT "%8.3" EXTENDED_LIMITS -32768.00 32767.00 DEPOSIT ABSOLUTE /end AXIS_DESCR
 /begin AXIS_DESCR STD_AXIS InjCtl_qSetUnBal InjMassCyc 8 0.00 327.6700 FORMAT "%8.4" EXTENDED_LIMITS -327.6800 327.6700 DEPOSIT ABSOLUTE /end AXIS_DESCR
/end CHARACTERISTIC
/begin CHARACTERISTIC InjCrv_qPoI2ETSCor_MAP "motortemperaturabhängiges Mengenkorrekturkennfeld für PoI2" MAP 0xE62FC Kf_Xs16_Ys16_Ws16 10.00000 InjMassInj 0.00 10.00000 FORMAT "%8.5" EXTENDED_LIMITS -327.6800 327.6700
 /begin AXIS_DESCR STD_AXIS Eng_nAvrg EngN 7 0.00 6000.000 FORMAT "%8.3" EXTENDED_LIMITS -32768.00 32767.00 DEPOSIT ABSOLUTE /end AXIS_DESCR
 /begin AXIS_DESCR STD_AXIS InjCtl_qSetUnBal InjMassCyc 6 0.00 327.6700 FORMAT "%8.4" EXTENDED_LIMITS -327.6800 327.6700 DEPOSIT ABSOLUTE /end AXIS_DESCR
/end CHARACTERISTIC
/begin CHARACTERISTIC InjCrv_qPoI2Rgn1_MAP "regeneration1 map of PoI2 injection quantity" MAP 0xE71EC Kf_Xs16_Ys16_Ws16 10.00000 InjMassInj 0.00 10.00000 FORMAT "%8.5" EXTENDED_LIMITS -327.6800 327.6700
 /begin AXIS_DESCR STD_AXIS Eng_nAvrg EngN 16 0.00 6000.000 FORMAT "%8.3" EXTENDED_LIMITS -32768.00 32767.00 DEPOSIT ABSOLUTE /end AXIS_DESCR
 /begin AXIS_DESCR STD_AXIS InjCtl_qSetUnBal InjMassCyc 16 0.00 327.6700 FORMAT "%8.4" EXTENDED_LIMITS -327.6800 327.6700 DEPOSIT ABSOLUTE /end AXIS_DESCR
/end CHARACTERISTIC
/begin CHARACTERISTIC InjCrv_qPoI2Rgn2_MAP "regeneration2 map of PoI2 injection quantity" MAP 0xE7430 Kf_Xs16_Ys16_Ws16 10.00000 InjMassInj 0.00 10.00000 FORMAT "%8.5" EXTENDED_LIMITS -327.6800 327.6700
 /begin AXIS_DESCR STD_AXIS Eng_nAvrg EngN 16 0.00 6000.000 FORMAT "%8.3" EXTENDED_LIMITS -32768.00 32767.00 DEPOSIT ABSOLUTE /end AXIS_DESCR
 /begin AXIS_DESCR STD_AXIS InjCtl_qSetUnBal InjMassCyc 16 0.00 327.6700 FORMAT "%8.4" EXTENDED_LIMITS -327.6800 327.6700 DEPOSIT ABSOLUTE /end AXIS_DESCR
/end CHARACTERISTIC
/begin CHARACTERISTIC InjCrv_qPoI2RgnAdd_Vector "#SSD Konfigurationslabel für Bypass Freischnitt" VALUE 0xC39BE Kw_Wu8 255.0 OneToOne 0.00 255.0 FORMAT "%5.1" /end CHARACTERISTIC
/begin CHARACTERISTIC InjCrv_qPoI2RgnAdd_Channel "#SSD Konfigurationslabel für Bypass Freischnitt" VALUE 0xC39BF Kw_Wu8 255.0 OneToOne 0.00 255.0 FORMAT "%5.1" /end CHARACTERISTIC
/begin CHARACTERISTIC InjCrv_qPoI2RgnCor_MAP "regeneration map of PoI2 injection quantity correction" MAP 0xE65DA Kf_Xs16_Ys16_Ws16 10.00000 InjMassInj 0.00 10.00000 FORMAT "%8.5" EXTENDED_LIMITS -327.6800 327.6700
 /begin AXIS_DESCR STD_AXIS Eng_nAvrg EngN 6 0.00 6000.000 FORMAT "%8.3" EXTENDED_LIMITS -32768.00 32767.00 DEPOSIT ABSOLUTE /end AXIS_DESCR
 /begin AXIS_DESCR STD_AXIS InjCtl_qSetUnBal InjMassCyc 6 0.00 327.6700 FORMAT "%8.4" EXTENDED_LIMITS -327.6800 327.6700 DEPOSIT ABSOLUTE /end AXIS_DESCR
/end CHARACTERISTIC
/begin CHARACTERISTIC InjCrv_qPoI2Rgn_Vector "#SSD Bypass-Label, nicht editieren !" VALUE 0xC39C0 Kw_Wu8 255.0 OneToOne 0.00 255.0 FORMAT "%5.1" /end CHARACTERISTIC
/begin CHARACTERISTIC InjCrv_qPoI2Rgn_Channel "#SSD Bypass-Label, nicht editieren !" VALUE 0xC39C1 Kw_Wu8 255.0 OneToOne 0.00 255.0 FORMAT "%5.1" /end CHARACTERISTIC
/begin CHARACTERISTIC InjCrv_qPoI2SetLim_C "Threshold injection quantity" VALUE 0xE6D36 Kw_Ws16 327.6700 InjMassInj 0.00 327.6700 FORMAT "%8.4" EXTENDED_LIMITS -327.6800 327.6700 /end CHARACTERISTIC
/begin CHARACTERISTIC InjCrv_qPoI2Des_Vector "#SSD Bypass-Label für InjCrv_qPoI2Des (Nicht verstellen!)" VALUE 0xC39D0 Kw_Wu8 255.0 OneToOne 0.00 255.0 FORMAT "%5.1" /end CHARACTERISTIC
/begin CHARACTERISTIC InjCrv_qPoI2Des_Channel "#SSD Bypass-Label für InjCrv_qPoI2Des (Nicht verstellen!)" VALUE 0xC39D1 Kw_Wu8 255.0 OneToOne 0.00 255.0 FORMAT "%5.1" /end CHARACTERISTIC
/begin CHARACTERISTIC InjCrv_qPoIOvrMax_C "mxaimale Einspritzmenge PoI1,2" VALUE 0xE8108 Kw_Ws32 42949672.9500 InjMassTot -21474836.4800 21474836.4700 FORMAT "%13.4" /end CHARACTERISTIC
/begin CHARACTERISTIC InjCrv_stPiI1RgnMsk_C "Maske zur Aktivierung  der Regeneration über PiI1" VALUE 0xE53EC Kw_Wu32 4294967295.00 OneToOne 0.00 4294967295.00 FORMAT "%13.2" /end CHARACTERISTIC
/begin CHARACTERISTIC InjCrv_stPiI2RgnMsk_C "Maske zur Aktivierung  der Regeneration über PiI2" VALUE 0xE22E0 Kw_Wu32 4294967295.00 OneToOne 0.00 4294967295.00 FORMAT "%13.2" /end CHARACTERISTIC
/begin CHARACTERISTIC InjCrv_stPoI1RgnMsk_C "Bitmaske für Aktivierung  des Regenerationsmodes PoI1" VALUE 0xE5F44 Kw_Wu32 4294967295.00 OneToOne 0.00 4294967295.00 FORMAT "%13.2" /end CHARACTERISTIC
/begin CHARACTERISTIC InjCrv_stPoI1RgnTypeMsk_C "Bitmask to activate switching to regeneration mode" VALUE 0xE5F48 Kw_Wu32 4294967295.00 OneToOne 0.00 4294967295.00 FORMAT "%13.2" /end CHARACTERISTIC
/begin CHARACTERISTIC InjCrv_stPoI2RgnDelMsk_C "Maske für die Deaktivierung der PoI2 Grundwerteberechnung im Regenerationsbetrieb" VALUE 0xE6D38 Kw_Wu32 4294967295.00 OneToOne 0.00 4294967295.00 FORMAT "%13.2" /end CHARACTERISTIC
/begin CHARACTERISTIC InjCrv_stPoI2RgnEffMsk_C "Bitmask for activate PoI2 in regeneration mode" VALUE 0xE7B14 Kw_Wu32 4294967295.00 OneToOne 0.00 4294967295.00 FORMAT "%13.2" /end CHARACTERISTIC
/begin CHARACTERISTIC InjCrv_stPoI2RgnMsk_C "Maske zur Aktivierung der Regeneration über PoI2" VALUE 0xE7B18 Kw_Wu32 4294967295.00 OneToOne 0.00 4294967295.00 FORMAT "%13.2" /end CHARACTERISTIC
/begin CHARACTERISTIC InjCrv_stPoI2RgnTypeMsk_C "Bitmask for activate PoI2 in regeneration mode" VALUE 0xE7B1C Kw_Wu32 4294967295.00 OneToOne 0.00 4294967295.00 FORMAT "%13.2" /end CHARACTERISTIC
/begin CHARACTERISTIC InjCrv_swtPoIOvrQLimActive_C "Schalter für Funktionsaktivierung" VALUE 0xE810C Kw_Wu8 255.0 OneToOne 0.00 255.0 FORMAT "%5.1" /end CHARACTERISTIC
/begin CHARACTERISTIC InjCrv_tiPiI1ATSCor_MAP "Kennfeld für drehzahl- und einrpritzmengenabhängige Zeitkorrektur für die PiI1" MAP 0xE29C8 Kf_Xs16_Ys16_Ws16 26000.00 InjTime_us -13000.00 13000.00 FORMAT "%8.2" EXTENDED_LIMITS -32768.00 32767.00
 /begin AXIS_DESCR STD_AXIS Eng_nAvrg EngN 16 0.00 6000.000 FORMAT "%8.3" EXTENDED_LIMITS -32768.00 32767.00 DEPOSIT ABSOLUTE /end AXIS_DESCR
 /begin AXIS_DESCR STD_AXIS InjCtl_qSetUnBal InjMassCyc 8 0.00 327.6700 FORMAT "%8.4" EXTENDED_LIMITS -327.6800 327.6700 DEPOSIT ABSOLUTE /end AXIS_DESCR
/end CHARACTERISTIC
/begin CHARACTERISTIC InjCrv_tiPiI1ChamWllTempCorr_MAP "Brennraumwandtemperatur Korrektur Kennfeld für die Ermittlung des Einspritzabstandes" MAP 0xE2754 Kf_Xs16_Ys16_Ws16 26000.00 InjTime_us -13000.00 13000.00 FORMAT "%8.2" EXTENDED_LIMITS -32768.00 32767.00
 /begin AXIS_DESCR STD_AXIS Eng_nAvrg EngN 8 0.00 6000.000 FORMAT "%8.3" EXTENDED_LIMITS -32768.00 32767.00 DEPOSIT ABSOLUTE /end AXIS_DESCR
 /begin AXIS_DESCR STD_AXIS InjCtl_qSetUnBal InjMassCyc 8 0.00 327.6700 FORMAT "%8.4" EXTENDED_LIMITS -327.6800 327.6700 DEPOSIT ABSOLUTE /end AXIS_DESCR
/end CHARACTERISTIC
/begin CHARACTERISTIC InjCrv_tiPiI1DesAdd_Vector "#SSD Bypass-Label für additiven Bypass von InjCrv_tiPiI1Des (Nicht verstellen!)" VALUE 0xC3992 Kw_Wu8 255.0 OneToOne 0.00 255.0 FORMAT "%5.1" /end CHARACTERISTIC
/begin CHARACTERISTIC InjCrv_tiPiI1DesAdd_Channel "#SSD Bypass-Label für additiven Bypass von InjCrv_tiPiI1Des (Nicht verstellen!)" VALUE 0xC3993 Kw_Wu8 255.0 OneToOne 0.00 255.0 FORMAT "%5.1" /end CHARACTERISTIC
/begin CHARACTERISTIC InjCrv_tiPiI1Des_Vector "#SSD Bypass-Label für InjCrv_tiPiI1Des (Nicht verstellen!)" VALUE 0xC3994 Kw_Wu8 255.0 OneToOne 0.00 255.0 FORMAT "%5.1" /end CHARACTERISTIC
/begin CHARACTERISTIC InjCrv_tiPiI1Des_Channel "#SSD Bypass-Label für InjCrv_tiPiI1Des (Nicht verstellen!)" VALUE 0xC3995 Kw_Wu8 255.0 OneToOne 0.00 255.0 FORMAT "%5.1" /end CHARACTERISTIC
/begin CHARACTERISTIC InjCrv_tiPiI1DynCor_MAP "base correction map of pilot injection angle correction" MAP 0xE27F8 Kf_Xs16_Ys16_Ws16 26000.00 InjTime_us -13000.00 13000.00 FORMAT "%8.2" EXTENDED_LIMITS -32768.00 32767.00
 /begin AXIS_DESCR STD_AXIS Eng_nAvrg EngN 16 0.00 6000.000 FORMAT "%8.3" EXTENDED_LIMITS -32768.00 32767.00 DEPOSIT ABSOLUTE /end AXIS_DESCR
 /begin AXIS_DESCR STD_AXIS InjCtl_qSetUnBal InjMassCyc 8 0.00 327.6700 FORMAT "%8.4" EXTENDED_LIMITS -327.6800 327.6700 DEPOSIT ABSOLUTE /end AXIS_DESCR
/end CHARACTERISTIC
/begin CHARACTERISTIC InjCrv_tiPiI1ETSCor12_MAP "motortemperaturabhängiges Korrekturgrundwertekennfeld für die Zeitkomponente des Ansteuerbeginns der PiI1bei aktiver PiI2" MAP 0xE4542 Kf_Xs16_Ys16_Ws16 26000.00 InjTime_us -13000.00 13000.00 FORMAT "%8.2" EXTENDED_LIMITS -32768.00 32767.00
 /begin AXIS_DESCR STD_AXIS Eng_nAvrg EngN 10 0.00 6000.000 FORMAT "%8.3" EXTENDED_LIMITS -32768.00 32767.00 DEPOSIT ABSOLUTE /end AXIS_DESCR
 /begin AXIS_DESCR STD_AXIS InjCtl_qSetUnBal InjMassCyc 10 0.00 327.6700 FORMAT "%8.4" EXTENDED_LIMITS -327.6800 327.6700 DEPOSIT ABSOLUTE /end AXIS_DESCR
/end CHARACTERISTIC
/begin CHARACTERISTIC InjCrv_tiPiI1ETSCor1_MAP "motortemperaturabhängiges Korrekturgrundwertekennfeld -1 für die Zeitkomponente Ansteuerbeginn PiI1" MAP 0xE4636 Kf_Xs16_Ys16_Ws16 26000.00 InjTime_us -13000.00 13000.00 FORMAT "%8.2" EXTENDED_LIMITS -32768.00 32767.00
 /begin AXIS_DESCR STD_AXIS Eng_nAvrg EngN 16 0.00 6000.000 FORMAT "%8.3" EXTENDED_LIMITS -32768.00 32767.00 DEPOSIT ABSOLUTE /end AXIS_DESCR
 /begin AXIS_DESCR STD_AXIS InjCtl_qSetUnBal InjMassCyc 16 0.00 327.6700 FORMAT "%8.4" EXTENDED_LIMITS -327.6800 327.6700 DEPOSIT ABSOLUTE /end AXIS_DESCR
/end CHARACTERISTIC
/begin CHARACTERISTIC InjCrv_tiPiI1ETSCor2_MAP "motortemperaturabhängiges Korrekturgrundwertekennfeld -2 für die Zeitkomponente Ansteuerbeginn PiI1" MAP 0xE487A Kf_Xs16_Ys16_Ws16 26000.00 InjTime_us -13000.00 13000.00 FORMAT "%8.2" EXTENDED_LIMITS -32768.00 32767.00
 /begin AXIS_DESCR STD_AXIS Eng_nAvrg EngN 16 0.00 6000.000 FORMAT "%8.3" EXTENDED_LIMITS -32768.00 32767.00 DEPOSIT ABSOLUTE /end AXIS_DESCR
 /begin AXIS_DESCR STD_AXIS InjCtl_qSetUnBal InjMassCyc 16 0.00 327.6700 FORMAT "%8.4" EXTENDED_LIMITS -327.6800 327.6700 DEPOSIT ABSOLUTE /end AXIS_DESCR
/end CHARACTERISTIC
/begin CHARACTERISTIC InjCrv_tiPiI1ETSCorStrt_MAP "base correction map for time-component of SOE of PiI1" MAP 0xE4ABE Kf_Xs16_Ys16_Ws16 26000.00 InjTime_us -13000.00 13000.00 FORMAT "%8.2" EXTENDED_LIMITS -32768.00 32767.00
 /begin AXIS_DESCR STD_AXIS Eng_nAvrg EngN 16 0.00 6000.000 FORMAT "%8.3" EXTENDED_LIMITS -32768.00 32767.00 DEPOSIT ABSOLUTE /end AXIS_DESCR
 /begin AXIS_DESCR STD_AXIS InjCtl_qSetUnBal InjMassCyc 16 0.00 327.6700 FORMAT "%8.4" EXTENDED_LIMITS -327.6800 327.6700 DEPOSIT ABSOLUTE /end AXIS_DESCR
/end CHARACTERISTIC
/begin CHARACTERISTIC InjCrv_tiPiI1ETSCor_MAP "motortemperaturabhängiger Korrekturgrundwertekennfeld für die Zeitkomponente des Ansteuerbeginns der PiI1" MAP 0xE4D02 Kf_Xs16_Ys16_Ws16 26000.00 InjTime_us -13000.00 13000.00 FORMAT "%8.2" EXTENDED_LIMITS -32768.00 32767.00
 /begin AXIS_DESCR STD_AXIS Eng_nAvrg EngN 16 0.00 6000.000 FORMAT "%8.3" EXTENDED_LIMITS -32768.00 32767.00 DEPOSIT ABSOLUTE /end AXIS_DESCR
 /begin AXIS_DESCR STD_AXIS InjCtl_qSetUnBal InjMassCyc 16 0.00 327.6700 FORMAT "%8.4" EXTENDED_LIMITS -327.6800 327.6700 DEPOSIT ABSOLUTE /end AXIS_DESCR
/end CHARACTERISTIC
/begin CHARACTERISTIC InjCrv_tiPiI1RgnAdd_Vector "#SSD Bypass-Label für InjCrv_tiPiI1RgnAdd_Vector (Nicht verstellen!)" VALUE 0xC39A2 Kw_Wu8 255.0 OneToOne 0.00 255.0 FORMAT "%5.1" /end CHARACTERISTIC
/begin CHARACTERISTIC InjCrv_tiPiI1RgnAdd_Channel "#SSD Bypass-Label für InjCrv_tiPiI1RgnAdd_Channel (Nicht verstellen!)" VALUE 0xC39A3 Kw_Wu8 255.0 OneToOne 0.00 255.0 FORMAT "%5.1" /end CHARACTERISTIC
/begin CHARACTERISTIC InjCrv_tiPiI1Rgn_MAP "base map of PiI1 SOE time-component calculation" MAP 0xE519E Kf_Xs16_Ys16_Ws16 13000.00 InjTime_us 0.00 13000.00 FORMAT "%8.2" EXTENDED_LIMITS -32768.00 32767.00
 /begin AXIS_DESCR STD_AXIS Eng_nAvrg EngN 16 0.00 6000.000 FORMAT "%8.3" EXTENDED_LIMITS -32768.00 32767.00 DEPOSIT ABSOLUTE /end AXIS_DESCR
 /begin AXIS_DESCR STD_AXIS InjCtl_qSetUnBal InjMassCyc 16 0.00 327.6700 FORMAT "%8.4" EXTENDED_LIMITS -327.6800 327.6700 DEPOSIT ABSOLUTE /end AXIS_DESCR
/end CHARACTERISTIC
/begin CHARACTERISTIC InjCrv_tiPiI1Rgn_Vector "#SSD Bypass-Label, nicht editieren !" VALUE 0xC39A4 Kw_Wu8 255.0 OneToOne 0.00 255.0 FORMAT "%5.1" /end CHARACTERISTIC
/begin CHARACTERISTIC InjCrv_tiPiI1Rgn_Channel "#SSD Bypass-Label, nicht editieren !" VALUE 0xC39A5 Kw_Wu8 255.0 OneToOne 0.00 255.0 FORMAT "%5.1" /end CHARACTERISTIC
/begin CHARACTERISTIC InjCrv_tiPiI2APSCorStrt_MAP "Korrekturkennfeld für das Timing der 2. Voreinspritzung abhängig vom Luftdruck während des Startvorganges" MAP 0xE1E98 Kf_Xs16_Ys16_Ws16 26000.00 InjTime_us -13000.00 13000.00 FORMAT "%8.2" EXTENDED_LIMITS -32768.00 32767.00
 /begin AXIS_DESCR STD_AXIS Eng_nAvrg EngN 10 0.00 6000.000 FORMAT "%8.3" EXTENDED_LIMITS -32768.00 32767.00 DEPOSIT ABSOLUTE /end AXIS_DESCR
 /begin AXIS_DESCR STD_AXIS InjCtl_qSetUnBal InjMassCyc 10 0.00 327.6700 FORMAT "%8.4" EXTENDED_LIMITS -327.6800 327.6700 DEPOSIT ABSOLUTE /end AXIS_DESCR
/end CHARACTERISTIC
/begin CHARACTERISTIC InjCrv_tiPiI2APSCor_MAP "kundenspez. atmosphärendruckabhängiges Korrekturgrundwertekennfeld für die Zeitkomponente des Ansteuerbeginns der PiI2" MAP 0xE1F8C Kf_Xs16_Ys16_Ws16 26000.00 InjTime_us -13000.00 13000.00 FORMAT "%8.2" EXTENDED_LIMITS -32768.00 32767.00
 /begin AXIS_DESCR STD_AXIS Eng_nAvrg EngN 10 0.00 6000.000 FORMAT "%8.3" EXTENDED_LIMITS -32768.00 32767.00 DEPOSIT ABSOLUTE /end AXIS_DESCR
 /begin AXIS_DESCR STD_AXIS InjCtl_qSetUnBal InjMassCyc 10 0.00 327.6700 FORMAT "%8.4" EXTENDED_LIMITS -327.6800 327.6700 DEPOSIT ABSOLUTE /end AXIS_DESCR
/end CHARACTERISTIC
/begin CHARACTERISTIC InjCrv_tiPiI2BasStrt_MAP "base map of PiI2 SOE time-component calculation" MAP 0xE23EC Kf_Xs16_Ys16_Ws16 13000.00 InjTime_us 0.00 13000.00 FORMAT "%8.2" EXTENDED_LIMITS -32768.00 32767.00
 /begin AXIS_DESCR STD_AXIS Eng_nAvrg EngN 2 0.00 6000.000 FORMAT "%8.3" EXTENDED_LIMITS -32768.00 32767.00 DEPOSIT ABSOLUTE /end AXIS_DESCR
 /begin AXIS_DESCR STD_AXIS InjCtl_qSetUnBal InjMassCyc 2 0.00 327.6700 FORMAT "%8.4" EXTENDED_LIMITS -327.6800 327.6700 DEPOSIT ABSOLUTE /end AXIS_DESCR
/end CHARACTERISTIC
/begin CHARACTERISTIC InjCrv_tiPiI2Bas_MAP "Zeitkomponente Ansteuerbeginn Grundwertekennfeld PiI2" MAP 0xE22E4 Kf_Xs16_Ys16_Ws16 13000.00 InjTime_us 0.00 13000.00 FORMAT "%8.2" EXTENDED_LIMITS -32768.00 32767.00
 /begin AXIS_DESCR STD_AXIS Eng_nAvrg EngN 10 0.00 6000.000 FORMAT "%8.3" EXTENDED_LIMITS -32768.00 32767.00 DEPOSIT ABSOLUTE /end AXIS_DESCR
 /begin AXIS_DESCR STD_AXIS InjCtl_qSetUnBal InjMassCyc 10 0.00 327.6700 FORMAT "%8.4" EXTENDED_LIMITS -327.6800 327.6700 DEPOSIT ABSOLUTE /end AXIS_DESCR
/end CHARACTERISTIC
/begin CHARACTERISTIC InjCrv_tiPiI2DesAdd_Vector "#SSD Bypass-Label für additiven Bypass von InjCrv_tiPiI2Des (Nicht verstellen!)" VALUE 0xC3996 Kw_Wu8 255.0 OneToOne 0.00 255.0 FORMAT "%5.1" /end CHARACTERISTIC
/begin CHARACTERISTIC InjCrv_tiPiI2DesAdd_Channel "#SSD Bypass-Label für additiven Bypass von InjCrv_tiPiI2Des (Nicht verstellen!)" VALUE 0xC3997 Kw_Wu8 255.0 OneToOne 0.00 255.0 FORMAT "%5.1" /end CHARACTERISTIC
/begin CHARACTERISTIC InjCrv_tiPiI2Des_Vector "#SSD Bypass-Label für InjCrv_tiPiI2Des (Nicht verstellen!)" VALUE 0xC3998 Kw_Wu8 255.0 OneToOne 0.00 255.0 FORMAT "%5.1" /end CHARACTERISTIC
/begin CHARACTERISTIC InjCrv_tiPiI2Des_Channel "#SSD Bypass-Label für InjCrv_tiPiI2Des (Nicht verstellen!)" VALUE 0xC3999 Kw_Wu8 255.0 OneToOne 0.00 255.0 FORMAT "%5.1" /end CHARACTERISTIC
/begin CHARACTERISTIC InjCrv_tiPiI2ETSCorStrt_MAP "base correction map for time-component of SOE of PiI2" MAP 0xE2080 Kf_Xs16_Ys16_Ws16 26000.00 InjTime_us -13000.00 13000.00 FORMAT "%8.2" EXTENDED_LIMITS -32768.00 32767.00
 /begin AXIS_DESCR STD_AXIS Eng_nAvrg EngN 2 0.00 6000.000 FORMAT "%8.3" EXTENDED_LIMITS -32768.00 32767.00 DEPOSIT ABSOLUTE /end AXIS_DESCR
 /begin AXIS_DESCR STD_AXIS InjCtl_qSetUnBal InjMassCyc 2 0.00 327.6700 FORMAT "%8.4" EXTENDED_LIMITS -327.6800 327.6700 DEPOSIT ABSOLUTE /end AXIS_DESCR
/end CHARACTERISTIC
/begin CHARACTERISTIC InjCrv_tiPiI2ETSCor_MAP "motortemperaturabhängiger Korrekturgrundwertekennfeld für die Zeitkomponente des Ansteuerbeginns der PiI2" MAP 0xE2094 Kf_Xs16_Ys16_Ws16 26000.00 InjTime_us -13000.00 13000.00 FORMAT "%8.2" EXTENDED_LIMITS -32768.00 32767.00
 /begin AXIS_DESCR STD_AXIS Eng_nAvrg EngN 16 0.00 6000.000 FORMAT "%8.3" EXTENDED_LIMITS -32768.00 32767.00 DEPOSIT ABSOLUTE /end AXIS_DESCR
 /begin AXIS_DESCR STD_AXIS InjCtl_qSetUnBal InjMassCyc 16 0.00 327.6700 FORMAT "%8.4" EXTENDED_LIMITS -327.6800 327.6700 DEPOSIT ABSOLUTE /end AXIS_DESCR
/end CHARACTERISTIC
/begin CHARACTERISTIC InjCrv_tiPiI2RgnAdd_Vector "#SSD Konfigurationslabel für Beipass" VALUE 0xC3974 Kw_Wu8 255.0 OneToOne 0.00 255.0 FORMAT "%5.1" /end CHARACTERISTIC
/begin CHARACTERISTIC InjCrv_tiPiI2RgnAdd_Channel "#SSD Konfigurationslabel für Beipass" VALUE 0xC3975 Kw_Wu8 255.0 OneToOne 0.00 255.0 FORMAT "%5.1" /end CHARACTERISTIC
/begin CHARACTERISTIC InjCrv_tiPiI2Rgn_Vector "#SSD Bypass-Label, nicht editieren !" VALUE 0xC3976 Kw_Wu8 255.0 OneToOne 0.00 255.0 FORMAT "%5.1" /end CHARACTERISTIC
/begin CHARACTERISTIC InjCrv_tiPiI2Rgn_Channel "#SSD Bypass-Label, nicht editieren !" VALUE 0xC3977 Kw_Wu8 255.0 OneToOne 0.00 255.0 FORMAT "%5.1" /end CHARACTERISTIC
/begin CHARACTERISTIC InjCrv_tiPoI2Add_Vector "#SSD Bypass-label für additiven Bypass InjCrv_tiPoI2 (nicht verstellen !)" VALUE 0xC39D2 Kw_Wu8 255.0 OneToOne 0.00 255.0 FORMAT "%5.1" /end CHARACTERISTIC
/begin CHARACTERISTIC InjCrv_tiPoI2Add_Channel "#SSD Bypass-label für additiven Bypass InjCrv_tiPoI2 (nicht verstellen !)" VALUE 0xC39D3 Kw_Wu8 255.0 OneToOne 0.00 255.0 FORMAT "%5.1" /end CHARACTERISTIC
/begin CHARACTERISTIC InjCrv_tiPoI2ATSCor_MAP "kundenspez. ansauglufttemperaturabhängiger Korrekturgrundwert für die Zeitkomponente des Ansteuerbeginns der PoI2" MAP 0xE67CE Kf_Xs16_Ys16_Ws16 26000.00 InjTime_us -13000.00 13000.00 FORMAT "%8.2" EXTENDED_LIMITS -32768.00 32767.00
 /begin AXIS_DESCR STD_AXIS Eng_nAvrg EngN 12 0.00 6000.000 FORMAT "%8.3" EXTENDED_LIMITS -32768.00 32767.00 DEPOSIT ABSOLUTE /end AXIS_DESCR
 /begin AXIS_DESCR STD_AXIS InjCtl_qSetUnBal InjMassCyc 8 0.00 327.6700 FORMAT "%8.4" EXTENDED_LIMITS -327.6800 327.6700 DEPOSIT ABSOLUTE /end AXIS_DESCR
/end CHARACTERISTIC
/begin CHARACTERISTIC InjCrv_tiPoI2BasStrt_MAP "Motortemperaturabhängiger PoI2-Basiswert während Motorstart" MAP 0xE8064 Kf_Xs16_Ys16_Ws16 65535.00 InjTime_us -32768.00 32767.00 FORMAT "%8.2"
 /begin AXIS_DESCR STD_AXIS Eng_nAvrg EngN 8 0.00 6000.000 FORMAT "%8.3" EXTENDED_LIMITS -32768.00 32767.00 DEPOSIT ABSOLUTE /end AXIS_DESCR
 /begin AXIS_DESCR STD_AXIS InjCtl_qSetUnBal InjMassCyc 8 0.00 327.6700 FORMAT "%8.4" EXTENDED_LIMITS -327.6800 327.6700 DEPOSIT ABSOLUTE /end AXIS_DESCR
/end CHARACTERISTIC
/begin CHARACTERISTIC InjCrv_tiPoI2Bas_MAP "Zeitkomponente Ansteuerbeginn Grundwert PoI2" MAP 0xE7CD4 Kf_Xs16_Ys16_Ws16 18000.00 InjTime_us -13000.00 5000.00 FORMAT "%8.2" EXTENDED_LIMITS -32768.00 32767.00
 /begin AXIS_DESCR STD_AXIS Eng_nAvrg EngN 16 0.00 6000.000 FORMAT "%8.3" EXTENDED_LIMITS -32768.00 32767.00 DEPOSIT ABSOLUTE /end AXIS_DESCR
 /begin AXIS_DESCR STD_AXIS InjCtl_qSetUnBal InjMassCyc 16 0.00 327.6700 FORMAT "%8.4" EXTENDED_LIMITS -327.6800 327.6700 DEPOSIT ABSOLUTE /end AXIS_DESCR
/end CHARACTERISTIC
/begin CHARACTERISTIC InjCrv_tiPoI2ETSCorStrt_MAP "Motortemperaturabhängiges Korrekturgrundwertekennfeld für die Zeitkomponente des Ansteuerbeginns der PoI2 im Startzustand." MAP 0xE68BA Kf_Xs16_Ys16_Ws16 26000.00 InjTime_us -13000.00 13000.00 FORMAT "%8.2" EXTENDED_LIMITS -32768.00 32767.00
 /begin AXIS_DESCR STD_AXIS Eng_nAvrg EngN 8 0.00 6000.000 FORMAT "%8.3" EXTENDED_LIMITS -32768.00 32767.00 DEPOSIT ABSOLUTE /end AXIS_DESCR
 /begin AXIS_DESCR STD_AXIS InjCtl_qSetUnBal InjMassCyc 8 0.00 327.6700 FORMAT "%8.4" EXTENDED_LIMITS -327.6800 327.6700 DEPOSIT ABSOLUTE /end AXIS_DESCR
/end CHARACTERISTIC
/begin CHARACTERISTIC InjCrv_tiPoI2ETSCor_MAP "motortemperaturabhängiger Korrekturgrundwertekennfeld für die Zeitkomponente des Ansteuerbeginns der PoI2" MAP 0xE695E Kf_Xs16_Ys16_Ws16 26000.00 InjTime_us -13000.00 13000.00 FORMAT "%8.2" EXTENDED_LIMITS -32768.00 32767.00
 /begin AXIS_DESCR STD_AXIS Eng_nAvrg EngN 12 0.00 6000.000 FORMAT "%8.3" EXTENDED_LIMITS -32768.00 32767.00 DEPOSIT ABSOLUTE /end AXIS_DESCR
 /begin AXIS_DESCR STD_AXIS InjCtl_qSetUnBal InjMassCyc 8 0.00 327.6700 FORMAT "%8.4" EXTENDED_LIMITS -327.6800 327.6700 DEPOSIT ABSOLUTE /end AXIS_DESCR
/end CHARACTERISTIC
/begin CHARACTERISTIC InjCrv_tiPoI2Max_MAP "#SSD maximaler Ansteuerbeginn PoI2 relativ zur Haupteinspritzung" MAP 0xE7B8A Kf_Xs16_Ys16_Ws16 18000.00 InjTime_us -13000.00 5000.00 FORMAT "%8.2" EXTENDED_LIMITS -32768.00 32767.00
 /begin AXIS_DESCR STD_AXIS RailCD_pPeak Pres_Rail 8 0.00 2000.000 FORMAT "%5.3" EXTENDED_LIMITS -3276.800 3276.700 DEPOSIT ABSOLUTE /end AXIS_DESCR
 /begin AXIS_DESCR STD_AXIS InjCrv_qMI1Des InjMassInj 16 0.00 327.6700 FORMAT "%8.4" EXTENDED_LIMITS -327.6800 327.6700 DEPOSIT ABSOLUTE /end AXIS_DESCR
/end CHARACTERISTIC
/begin CHARACTERISTIC InjCrv_tiPoI2Min_C "#SSD physikalisch bedingter minimaler Ansteuerbeginn PoI2" VALUE 0xE7CBE Kw_Ws16 18000.00 InjTime_us -13000.00 5000.00 FORMAT "%8.2" EXTENDED_LIMITS -32768.00 32767.00 /end CHARACTERISTIC
/begin CHARACTERISTIC InjCrv_tiPoI2Rgn1_MAP "regeneration1 map of PoI2 SOE time component" MAP 0xE7674 Kf_Xs16_Ys16_Ws16 18000.00 InjTime_us -13000.00 5000.00 FORMAT "%8.2" EXTENDED_LIMITS -32768.00 32767.00
 /begin AXIS_DESCR STD_AXIS Eng_nAvrg EngN 16 0.00 6000.000 FORMAT "%8.3" EXTENDED_LIMITS -32768.00 32767.00 DEPOSIT ABSOLUTE /end AXIS_DESCR
 /begin AXIS_DESCR STD_AXIS InjCtl_qSetUnBal InjMassCyc 16 0.00 327.6700 FORMAT "%8.4" EXTENDED_LIMITS -327.6800 327.6700 DEPOSIT ABSOLUTE /end AXIS_DESCR
/end CHARACTERISTIC
/begin CHARACTERISTIC InjCrv_tiPoI2Rgn2_MAP "regeneration2 map of PoI2 SOE time component" MAP 0xE78B8 Kf_Xs16_Ys16_Ws16 18000.00 InjTime_us -13000.00 5000.00 FORMAT "%8.2" EXTENDED_LIMITS -32768.00 32767.00
 /begin AXIS_DESCR STD_AXIS Eng_nAvrg EngN 16 0.00 6000.000 FORMAT "%8.3" EXTENDED_LIMITS -32768.00 32767.00 DEPOSIT ABSOLUTE /end AXIS_DESCR
 /begin AXIS_DESCR STD_AXIS InjCtl_qSetUnBal InjMassCyc 16 0.00 327.6700 FORMAT "%8.4" EXTENDED_LIMITS -327.6800 327.6700 DEPOSIT ABSOLUTE /end AXIS_DESCR
/end CHARACTERISTIC
/begin CHARACTERISTIC InjCrv_tiPoI2RgnAdd_Vector "#SSD Bypass-Label für  (Nicht verstellen!)" VALUE 0xC39C2 Kw_Wu8 255.0 OneToOne 0.00 255.0 FORMAT "%5.1" /end CHARACTERISTIC
/begin CHARACTERISTIC InjCrv_tiPoI2RgnAdd_Channel "#SSD Bypass-Label für InjCrv_tiPoI2RgnAdd_Channel (Nicht verstellen!)" VALUE 0xC39C3 Kw_Wu8 255.0 OneToOne 0.00 255.0 FORMAT "%5.1" /end CHARACTERISTIC
/begin CHARACTERISTIC InjCrv_tiPoI2RgnCor_MAP "base map of PoI2 SOE time-component calculation" MAP 0xE663E Kf_Xs16_Ys16_Ws16 13000.00 InjTime_us 0.00 13000.00 FORMAT "%8.2" EXTENDED_LIMITS -32768.00 32767.00
 /begin AXIS_DESCR STD_AXIS Eng_nAvrg EngN 2 0.00 6000.000 FORMAT "%8.3" EXTENDED_LIMITS -32768.00 32767.00 DEPOSIT ABSOLUTE /end AXIS_DESCR
 /begin AXIS_DESCR STD_AXIS InjCtl_qSetUnBal InjMassCyc 2 0.00 327.6700 FORMAT "%8.4" EXTENDED_LIMITS -327.6800 327.6700 DEPOSIT ABSOLUTE /end AXIS_DESCR
/end CHARACTERISTIC
/begin CHARACTERISTIC InjCrv_tiPoI2Rgn_Vector "#SSD Bypass-Label, nicht editieren !" VALUE 0xC39C4 Kw_Wu8 255.0 OneToOne 0.00 255.0 FORMAT "%5.1" /end CHARACTERISTIC
/begin CHARACTERISTIC InjCrv_tiPoI2Rgn_Channel "#SSD Bypass-Label, nicht editieren !" VALUE 0xC39C5 Kw_Wu8 255.0 OneToOne 0.00 255.0 FORMAT "%5.1" /end CHARACTERISTIC
/begin CHARACTERISTIC InjCrv_tiPoI2_Vector "#SSD Bypass-Label, nicht editieren !" VALUE 0xC39D4 Kw_Wu8 255.0 OneToOne 0.00 255.0 FORMAT "%5.1" /end CHARACTERISTIC
/begin CHARACTERISTIC InjCrv_tiPoI2_Channel "#SSD Bypass-Label, nicht editieren !" VALUE 0xC39D5 Kw_Wu8 255.0 OneToOne 0.00 255.0 FORMAT "%5.1" /end CHARACTERISTIC
/begin CHARACTERISTIC InjCrv_tiPoIOvrQLimMax_C "Maximale Abschaltzeit PoI1,2" VALUE 0xE8110 Kw_Wu32 42949672950.0 Time_ms 0.00 42949672950.0 FORMAT "%13.1" /end CHARACTERISTIC
/begin CHARACTERISTIC InjCrv_tOxiPoILimMax_C "Maximaltemperatur PFlt_tOxiPre" VALUE 0xE8114 Kw_Ws16 950.000 Temp_Cels -50.140 899.860 FORMAT "%8.3" EXTENDED_LIMITS -3549.940 3003.560 /end CHARACTERISTIC
/begin CHARACTERISTIC InjCrv_tPrePoILimMax_C "Maximaltemperatur PFlt_tPre" VALUE 0xE8116 Kw_Ws16 950.000 Temp_Cels -50.140 899.860 FORMAT "%8.3" EXTENDED_LIMITS -3549.940 3003.560 /end CHARACTERISTIC
/begin MEASUREMENT InjCrv_facAPPiI1DynCor_mp "atmosphärendruckabhängiger Gewichtungsfaktor" SWORD Fact 1 100 -4.000000 3.999878 FORMAT "%8.6" ECU_ADDRESS 0x8FF64E /end MEASUREMENT
/begin MEASUREMENT InjCrv_facAPPiI1DynQCor_mp "Atmosphärendruckabhängiger Gewichtungsfaktor" SWORD Fact 1 100 -4.000000 3.999878 FORMAT "%8.6" ECU_ADDRESS 0x8FF650 /end MEASUREMENT
/begin MEASUREMENT InjCrv_facDQPiI1DynCor_mp "einspritzmengengradientenabhängiger Gewichtungsfaktor" SWORD Fact 1 100 -4.000000 3.999878 FORMAT "%8.6" ECU_ADDRESS 0x8FF642 /end MEASUREMENT
/begin MEASUREMENT InjCrv_facDQPiI1DynQCor_mp "einspritzmengengradientenabhängiger Gewichtungsfaktor für Voreinspritzmengenkorrektur" SWORD Fact 1 100 -4.000000 3.999878 FORMAT "%8.6" ECU_ADDRESS 0x8FF644 /end MEASUREMENT
/begin MEASUREMENT InjCrv_facETPiI1DynCor_mp "motortemperaturabhängiger Gewichtungsfaktor" SWORD Fact 1 100 -4.000000 3.999878 FORMAT "%8.6" ECU_ADDRESS 0x8FF652 /end MEASUREMENT
/begin MEASUREMENT InjCrv_facETPiI1DynQCor_mp "Motortemperaturabhängiger Gewichtungfaktor" SWORD Fact 1 100 -4.000000 3.999878 FORMAT "%8.6" ECU_ADDRESS 0x8FF654 /end MEASUREMENT
/begin MEASUREMENT InjCrv_facPhPoI2RgnAPCor_mp "atmosphere pressure correction value for PoI2 setpoint" SWORD Fact 1 100 -4.000000 3.999878 FORMAT "%8.6" ECU_ADDRESS 0x8FF6D2 /end MEASUREMENT
/begin MEASUREMENT InjCrv_facPhPoI2RgnETCor_mp "engine temperature correction value for PoI2 setpoint" SWORD Fact 1 100 -4.000000 3.999878 FORMAT "%8.6" ECU_ADDRESS 0x8FF6D4 /end MEASUREMENT
/begin MEASUREMENT InjCrv_facPiI1APSQCor "atmosphärendruckabhängiger Mengenkorrekturfaktor für Voreinspritzung 1" SWORD Fact 1 100 -4.000000 3.999878 FORMAT "%8.6" ECU_ADDRESS 0x7F8E62 /end MEASUREMENT
/begin MEASUREMENT InjCrv_facPiI1APSQCor2 "atmosphärendruckabhängiger Mengenkorrekturfaktor -2 für Voreinspritzung 1" SWORD Fact 1 100 -4.000000 3.999878 FORMAT "%8.6" ECU_ADDRESS 0x7F8E64 /end MEASUREMENT
/begin MEASUREMENT InjCrv_facPiI1APSQCorStrt "atmosphärendruckabhängiger Mengenkorrekturfaktor für Voreinspritzung 1 bei inaktiver Voreinspritzung 2 im Startzustand" SWORD Fact 1 100 -4.000000 3.999878 FORMAT "%8.6" ECU_ADDRESS 0x7F8E66 /end MEASUREMENT
/begin MEASUREMENT InjCrv_facPiI1ATSQCor "ansauglufttemperaturabhängiger Mengenkorrekturfaktor für Voreinspritzung 1" SWORD Fact 1 100 -4.000000 3.999878 FORMAT "%8.6" ECU_ADDRESS 0x7F8E68 /end MEASUREMENT
/begin MEASUREMENT InjCrv_facPiI1ATSQCor2 "ansauglufttemperaturabhängiger Mengenkorrekturfaktor -2 für Voreinspritzung 1" SWORD Fact 1 100 -4.000000 3.999878 FORMAT "%8.6" ECU_ADDRESS 0x7F8E6A /end MEASUREMENT
/begin MEASUREMENT InjCrv_facPiI1ATSQCorStrt "motortemperaturabhängiger Mengenkorrekturfaktor für Voreinspritzung 1 bei inaktiver Voreinspritzung 2 im Startzustand" SWORD Fact 1 100 -4.000000 3.999878 FORMAT "%8.6" ECU_ADDRESS 0x7F8E6C /end MEASUREMENT
/begin MEASUREMENT InjCrv_facPiI1ATSSOECor "kundenspezifischer ansauglufttemperaturabhängiger Gewichtungsfaktor für PiI1" SWORD Fact 1 100 -4.000000 3.999878 FORMAT "%8.6" ECU_ADDRESS 0x7F8E6E /end MEASUREMENT
/begin MEASUREMENT InjCrv_facPiI1DynQCor "dynamischer Mengenkorrekturfaktor für PiI1" SWORD Fact 1 100 -4.000000 3.999878 FORMAT "%8.6" ECU_ADDRESS 0x7F8E70 /end MEASUREMENT
/begin MEASUREMENT InjCrv_facPiI1DynSOECor "motortemperatur- und atmosphärendruckabhängiger Winkelkorrekturfaktor für Pil1" SWORD Fact 1 100 -4.000000 3.999878 FORMAT "%8.6" ECU_ADDRESS 0x7F8E72 /end MEASUREMENT
/begin MEASUREMENT InjCrv_facPiI1ETSQCor "motortemperaturabhängiger Mengenkorrekturfaktor für Voreinspritzung 1" SWORD Fact 1 100 -4.000000 3.999878 FORMAT "%8.6" ECU_ADDRESS 0x7F8E74 /end MEASUREMENT
/begin MEASUREMENT InjCrv_facPiI1ETSQCor1 "motortemperaturabhängiger Mengenkorrekturfaktor -1 für Voreinspritzung 1" SWORD Fact 1 100 -4.000000 3.999878 FORMAT "%8.6" ECU_ADDRESS 0x7F8E76 /end MEASUREMENT
/begin MEASUREMENT InjCrv_facPiI1ETSQCor12 "motortemperaturabhängiger Mengenkorrekturfaktor für Voreinspritzung 1 bei inaktiver Voreinspritzung 2" SWORD Fact 1 100 -4.000000 3.999878 FORMAT "%8.6" ECU_ADDRESS 0x7F8E78 /end MEASUREMENT
/begin MEASUREMENT InjCrv_facPiI1ETSQCor2 "motortemperaturabhängiger Mengenkorrekturfaktor -2 für Voreinspritzung 1" SWORD Fact 1 100 -4.000000 3.999878 FORMAT "%8.6" ECU_ADDRESS 0x7F8E7A /end MEASUREMENT
/begin MEASUREMENT InjCrv_facPiI1ETSQCorStrt "motortemperaturabhängiger Mengenkorrekturfaktor für Voreinspritzung 1 bei inaktiver Voreinspritzung 2 im Startzustand" SWORD Fact 1 100 -4.000000 3.999878 FORMAT "%8.6" ECU_ADDRESS 0x7F8E7C /end MEASUREMENT
/begin MEASUREMENT InjCrv_facPiI1ETSSOECor "motortemperaturabhängiger Ansteuerbeginnkorrekturfaktor für Voreinspritzung 1" SWORD Fact 1 100 -4.000000 3.999878 FORMAT "%8.6" ECU_ADDRESS 0x7F8E7E /end MEASUREMENT
/begin MEASUREMENT InjCrv_facPiI1ETSSOECor1 "motortemperaturabhängiger Ansteuerbeginnkorrekturfaktor -1 für Voreinspritzung 1" SWORD Fact 1 100 -4.000000 3.999878 FORMAT "%8.6" ECU_ADDRESS 0x7F8E80 /end MEASUREMENT
/begin MEASUREMENT InjCrv_facPiI1ETSSOECor12 """motortemperaturabhängiger Ansteuerbeginnkorrekturfaktor für Voreinspritzung 1 bei inaktiver Voreinspritzung 2""" SWORD Fact 1 100 -4.000000 3.999878 FORMAT "%8.6" ECU_ADDRESS 0x7F8E82 /end MEASUREMENT
/begin MEASUREMENT InjCrv_facPiI1ETSSOECor2 "motortemperaturabhängiger Ansteuerbeginnkorrekturfaktor -2 für Voreinspritzung 1" SWORD Fact 1 100 -4.000000 3.999878 FORMAT "%8.6" ECU_ADDRESS 0x7F8E84 /end MEASUREMENT
/begin MEASUREMENT InjCrv_facPiI1ETSSOECorStrt """motortemperaturabhängiger Ansteuerbeginnkorrekturfaktor für Voreinspritzung 1 bei inaktiver Voreinspritzung 2 im Startzustand """ SWORD Fact 1 100 -4.000000 3.999878 FORMAT "%8.6" ECU_ADDRESS 0x7F8E86 /end MEASUREMENT
/begin MEASUREMENT InjCrv_facPiI1QntMin_mp "Wichtungsfaktor zum Abschalten der Berechnung Voreinspritzung 1" SWORD Fact1 1 100 -256.0000 255.9922 FORMAT "%8.4" ECU_ADDRESS 0x8FF600 /end MEASUREMENT
/begin MEASUREMENT InjCrv_facPiI2QntMin_mp "Wichtungsfaktor zum Abschalten der Berechnung Voreinspritzung 2" SWORD Fact1 1 100 -256.0000 255.9922 FORMAT "%8.4" ECU_ADDRESS 0x8FF5B0 /end MEASUREMENT
/begin MEASUREMENT InjCrv_facPoI1APSQCor "atmospärendruckabhängiger Mengenkorrekturfaktor für PoI1" SWORD Fact 1 100 -4.000000 3.999878 FORMAT "%8.6" ECU_ADDRESS 0x7F8E9C /end MEASUREMENT
/begin MEASUREMENT InjCrv_facPoI1EffRgn "" SWORD Fact 1 100 -4.000000 3.999878 FORMAT "%8.6" ECU_ADDRESS 0x7F8EA2 /end MEASUREMENT
/begin MEASUREMENT InjCrv_facPoI1EffRgn1_mp "" SWORD Fact 1 100 -4.000000 3.999878 FORMAT "%8.6" ECU_ADDRESS 0x8FF6B0 /end MEASUREMENT
/begin MEASUREMENT InjCrv_facPoI1EffRgn2_mp "" SWORD Fact 1 100 -4.000000 3.999878 FORMAT "%8.6" ECU_ADDRESS 0x8FF6B2 /end MEASUREMENT
/begin MEASUREMENT InjCrv_facPoI1EffSet_mp "" SWORD Fact 1 100 -4.000000 3.999878 FORMAT "%8.6" ECU_ADDRESS 0x8FF67E /end MEASUREMENT
/begin MEASUREMENT InjCrv_facPoI1Eff_mp "" SWORD Fact 1 100 -4.000000 3.999878 FORMAT "%8.6" ECU_ADDRESS 0x8FF680 /end MEASUREMENT
/begin MEASUREMENT InjCrv_facPoI1ETSPhiCor "motortemperaturabhängiger Winkelkorrekturfaktor für PoI1" SWORD Fact 1 100 -4.000000 3.999878 FORMAT "%8.6" ECU_ADDRESS 0x7F8E9E /end MEASUREMENT
/begin MEASUREMENT InjCrv_facPoI1ETSQCor "motortemperaturabhängiger Mengenkorrekturfaktor für PoI1" SWORD Fact 1 100 -4.000000 3.999878 FORMAT "%8.6" ECU_ADDRESS 0x7F8EA0 /end MEASUREMENT
/begin MEASUREMENT InjCrv_facPoI2APSQCorStrt "Atmosphärendruckabhängiger Mengenkorrekturfaktor für Nacheinspritzung 2 im Startzustand." SWORD Fact 1 100 -4.000000 3.999878 FORMAT "%8.6" ECU_ADDRESS 0x7F8EA4 /end MEASUREMENT
/begin MEASUREMENT InjCrv_facPoI2ATSQCor "ansauglufttemperaturabhängiger Mengenkorrekturfaktor für PoI2" SWORD Fact 1 100 -4.000000 3.999878 FORMAT "%8.6" ECU_ADDRESS 0x7F8EA6 /end MEASUREMENT
/begin MEASUREMENT InjCrv_facPoI2ATSQCorStrt "Ansauglufttemperaturabhängiger Mengenkorrekturfaktor für Nacheinspritzung 2." SWORD Fact 1 100 -4.000000 3.999878 FORMAT "%8.6" ECU_ADDRESS 0x7F8EA8 /end MEASUREMENT
/begin MEASUREMENT InjCrv_facPoI2ATSSOECor "ansauglufttemperaturabhängiger Ansteuerbeginnkorrekturfaktor für PoI2" SWORD Fact 1 100 -4.000000 3.999878 FORMAT "%8.6" ECU_ADDRESS 0x7F8EAA /end MEASUREMENT
/begin MEASUREMENT InjCrv_facPoI2EffRgn "Faktor für den drehmomentbildenden Anteil der Einspritzmenge PoI2 im Regenerationsmodus" SWORD Fact 1 100 -4.000000 3.999878 FORMAT "%8.6" ECU_ADDRESS 0x7F8EB4 /end MEASUREMENT
/begin MEASUREMENT InjCrv_facPoI2EffRgn1_mp "corrected factor component for PoI2" SWORD Fact 1 100 -4.000000 3.999878 FORMAT "%8.6" ECU_ADDRESS 0x8FF704 /end MEASUREMENT
/begin MEASUREMENT InjCrv_facPoI2EffRgn2_mp "corrected factor component for PoI2" SWORD Fact 1 100 -4.000000 3.999878 FORMAT "%8.6" ECU_ADDRESS 0x8FF706 /end MEASUREMENT
/begin MEASUREMENT InjCrv_facPoI2EffRgnByp_mp "Effektivwert Nacheinspritzung Regeneration" SWORD Fact 1 100 -4.000000 3.999878 FORMAT "%8.6" ECU_ADDRESS 0x8FF708 /end MEASUREMENT
/begin MEASUREMENT InjCrv_facPoI2EffSet_mp "Faktor für den drehmomentbildenden Anteil der Einspritzmenge PoI2 (Sollwert)" SWORD Fact 1 100 -4.000000 3.999878 FORMAT "%8.6" ECU_ADDRESS 0x8FF6E4 /end MEASUREMENT
/begin MEASUREMENT InjCrv_facPoI2Eff_mp "Faktor für Drehmoment bildenden Anteil der Einspritzmenge PoI2" SWORD Fact 1 100 -4.000000 3.999878 FORMAT "%8.6" ECU_ADDRESS 0x8FF6E6 /end MEASUREMENT
/begin MEASUREMENT InjCrv_facPoI2ETSQCor "motortemperaturabhängiger Mengenkorrekturfaktor für PoI2" SWORD Fact 1 100 -4.000000 3.999878 FORMAT "%8.6" ECU_ADDRESS 0x7F8EAC /end MEASUREMENT
/begin MEASUREMENT InjCrv_facPoI2ETSQCorStrt "Motortemperaturabhängiger Mengenkorrekturfaktor für Nacheinspritzung 2 im Startzustand." SWORD Fact 1 100 -4.000000 3.999878 FORMAT "%8.6" ECU_ADDRESS 0x7F8EAE /end MEASUREMENT
/begin MEASUREMENT InjCrv_facPoI2ETSSOECor "motortemperaturabhängiger Ansteuerbeginnkorrekturfaktor für PoI2" SWORD Fact 1 100 -4.000000 3.999878 FORMAT "%8.6" ECU_ADDRESS 0x7F8EB0 /end MEASUREMENT
/begin MEASUREMENT InjCrv_facPoI2ETSSOECorStrt "Motortemperaturabhängiger Ansteuerbeginnkorrekturfaktor für Nacheinspritzung 2 im Startzustand." SWORD Fact 1 100 -4.000000 3.999878 FORMAT "%8.6" ECU_ADDRESS 0x7F8EB2 /end MEASUREMENT
/begin MEASUREMENT InjCrv_facPOpPoI2ETSCor "Motortemperaturabhängiger Freigabekorrekturfaktor für  PoI2" SWORD Fact 1 100 -4.000000 3.999878 FORMAT "%8.6" ECU_ADDRESS 0x7F8E5E /end MEASUREMENT
/begin MEASUREMENT InjCrv_facPOpPoI2ETSCorStrt "Motortemperaturabhängiger Freigabekorrekturfaktor für Nacheinspritzung 2 im Startzustand." SWORD Fact 1 100 -4.000000 3.999878 FORMAT "%8.6" ECU_ADDRESS 0x7F8E60 /end MEASUREMENT
/begin MEASUREMENT InjCrv_facQPoI2RgnAPCor_mp "atmosphere pressure correction value for PoI2 quantity" SWORD Fact 1 100 -4.000000 3.999878 FORMAT "%8.6" ECU_ADDRESS 0x8FF6D6 /end MEASUREMENT
/begin MEASUREMENT InjCrv_facQPoI2RgnETCor_mp "engine temperature correction value for PoI2 quantity" SWORD Fact 1 100 -4.000000 3.999878 FORMAT "%8.6" ECU_ADDRESS 0x8FF6D8 /end MEASUREMENT
/begin MEASUREMENT InjCrv_facTiPoI2RgnAPCor_mp "atmosphere pressure correction value for PoI2 time" SWORD Fact 1 100 -4.000000 3.999878 FORMAT "%8.6" ECU_ADDRESS 0x8FF6DA /end MEASUREMENT
/begin MEASUREMENT InjCrv_facTiPoI2RgnETCor_mp "engine temperature correction value for PoI2 time" SWORD Fact 1 100 -4.000000 3.999878 FORMAT "%8.6" ECU_ADDRESS 0x8FF6DC /end MEASUREMENT
/begin MEASUREMENT InjCrv_numInjPoI1Off_mp "Ausgang des Zähler von "" PoI1 nach Überschuß """ SWORD OneToOne 1 100 -32768.00 32767.00 FORMAT "%8.2" ECU_ADDRESS 0x8FF682 /end MEASUREMENT
/begin MEASUREMENT InjCrv_numInjPoI2Off_mp "Ausgang des Zähler von "" PoI2 nach Überschuß """ SWORD OneToOne 1 100 -32768.00 32767.00 FORMAT "%8.2" ECU_ADDRESS 0x8FF6E8 /end MEASUREMENT
/begin MEASUREMENT InjCrv_phiDynOfs_mp "Winkelvorhalt für schnelle dynamische Vorgänge" SWORD AngleCrS 1 100 -768.0000 767.9766 FORMAT "%8.4" ECU_ADDRESS 0x8FF684 /end MEASUREMENT
/begin MEASUREMENT InjCrv_phiNxtCyl_mp "Winkel zwischen aktuellem OT und der frühesten Einspritzung des nächsten Zylinders auf derselben Bank" SWORD AngleCrS 1 100 -768.0000 767.9766 FORMAT "%8.4" ECU_ADDRESS 0x8FF686 /end MEASUREMENT
/begin MEASUREMENT InjCrv_phiNxtTDCoB_mp "Winkel zw. aktuellem OT und OT des nächsten Zylinders auf derselben Bank" SWORD AngleCrS 1 100 -768.0000 767.9766 FORMAT "%8.4" ECU_ADDRESS 0x8FF688 /end MEASUREMENT
/begin MEASUREMENT InjCrv_phiPiI1AbsTot_mp "absoluter Ansteuerbeginn PiI1 aus Winkel- und Zeitkomponente" SWORD AngleCrS 1 100 -768.0000 767.9766 FORMAT "%8.4" ECU_ADDRESS 0x8FF602 /end MEASUREMENT
/begin MEASUREMENT InjCrv_phiPiI1Abs_mp "absolute Winkelkomponente Anteuerbeginn PiI1" SWORD AngleCrS 1 100 -768.0000 767.9766 FORMAT "%8.4" ECU_ADDRESS 0x8FF604 /end MEASUREMENT
/begin MEASUREMENT InjCrv_phiPiI1AddCor "kundenspezifischer Korrekturwinkel für PiI1" SWORD AngleCrS 1 100 -768.0000 767.9766 FORMAT "%8.4" ECU_ADDRESS 0x7F8EC4 /end MEASUREMENT
/begin MEASUREMENT InjCrv_phiPiI1AddCor2 "kundenspezifischer Korrekturwinkel für PiI1 bei aktiver PiI2" SWORD AngleCrS 1 100 -768.0000 767.9766 FORMAT "%8.4" ECU_ADDRESS 0x7F8EC6 /end MEASUREMENT
/begin MEASUREMENT InjCrv_phiPiI1Cor_mp "korrigierter Grundwert Winkelkomponente Ansteuerbeginn PiI1" SWORD AngleCrS 1 100 -768.0000 767.9766 FORMAT "%8.4" ECU_ADDRESS 0x8FF606 /end MEASUREMENT
/begin MEASUREMENT InjCrv_phiPiI1Des "gewünschter Winkelkomponente Ansteuerbeginn PiI1" SWORD AngleCrS 1 100 -768.0000 767.9766 FORMAT "%8.4" ECU_ADDRESS 0x7F8EC8 /end MEASUREMENT
/begin MEASUREMENT InjCrv_phiPiI1DesByp_mp "Bypass-Label, Kopie von InjCrv_phiPiI1Des" SWORD AngleCrS 1 100 -768.0000 767.9766 FORMAT "%8.4" ECU_ADDRESS 0x8FF608 /end MEASUREMENT
/begin MEASUREMENT InjCrv_phiPiI1EnvCor "Korrekturwinkel für Voreinspritzung 1" SWORD AngleCrS 1 100 -768.0000 767.9766 FORMAT "%8.4" ECU_ADDRESS 0x7F8ECA /end MEASUREMENT
/begin MEASUREMENT InjCrv_phiPiI1EnvCor2 "Korrekturwinkel für PiI1 wenn PiI2 aktiv" SWORD AngleCrS 1 100 -768.0000 767.9766 FORMAT "%8.4" ECU_ADDRESS 0x7F8ECC /end MEASUREMENT
/begin MEASUREMENT InjCrv_phiPiI1Rel_mp "Winkelkomponente Ansteuerbeginn PiI1 relaitv zur MI" SWORD AngleCrS 1 100 -768.0000 767.9766 FORMAT "%8.4" ECU_ADDRESS 0x8FF60A /end MEASUREMENT
/begin MEASUREMENT InjCrv_phiPiI1Rgn "Regenerationswert für die  Winkelkomponente des Ansteuerbeginns der PiI1" SWORD AngleCrS 1 100 -768.0000 767.9766 FORMAT "%8.4" ECU_ADDRESS 0x7F8ECE /end MEASUREMENT
/begin MEASUREMENT InjCrv_phiPiI1RgnByp_mp "Messpunkt für Bypass" SWORD AngleCrS 1 100 -768.0000 767.9766 FORMAT "%8.4" ECU_ADDRESS 0x8FF678 /end MEASUREMENT
/begin MEASUREMENT InjCrv_phiPiI2AbsTot_mp "absoluter Ansteuerbeginn PiI2 aus Winkel- und Zeitkomponente" SWORD AngleCrS 1 100 -768.0000 767.9766 FORMAT "%8.4" ECU_ADDRESS 0x8FF5B2 /end MEASUREMENT
/begin MEASUREMENT InjCrv_phiPiI2Abs_mp "absolute Winkelkomponente Ansteuerbeginn PiI2" SWORD AngleCrS 1 100 -768.0000 767.9766 FORMAT "%8.4" ECU_ADDRESS 0x8FF5B4 /end MEASUREMENT
/begin MEASUREMENT InjCrv_phiPiI2Bas_mp "Winkelkomponente Ansteuerbeginn PiI2 Grundwert" SWORD AngleCrS 1 100 -768.0000 767.9766 FORMAT "%8.4" ECU_ADDRESS 0x8FF5F2 /end MEASUREMENT
/begin MEASUREMENT InjCrv_phiPiI2Cor_mp "korrigierter Grundwert Winkelkomponente Ansteuerbeginn PiI2" SWORD AngleCrS 1 100 -768.0000 767.9766 FORMAT "%8.4" ECU_ADDRESS 0x8FF5B6 /end MEASUREMENT
/begin MEASUREMENT InjCrv_phiPiI2Des "gewünschte Winkelkomponente Ansteuerbeginn PiI2" SWORD AngleCrS 1 100 -768.0000 767.9766 FORMAT "%8.4" ECU_ADDRESS 0x7F8ED2 /end MEASUREMENT
/begin MEASUREMENT InjCrv_phiPiI2DesByp_mp "Bypass-Label, Kopie von InjCrv_phiPiI2Des" SWORD AngleCrS 1 100 -768.0000 767.9766 FORMAT "%8.4" ECU_ADDRESS 0x8FF60C /end MEASUREMENT
/begin MEASUREMENT InjCrv_phiPiI2EnvCor "Korrekturwinkel für Voreinspritzung 2" SWORD AngleCrS 1 100 -768.0000 767.9766 FORMAT "%8.4" ECU_ADDRESS 0x7F8ED4 /end MEASUREMENT
/begin MEASUREMENT InjCrv_phiPiI2Rel_mp "Winkelkomponente Ansteuerbeginn PiI2 relativ zur MI" SWORD AngleCrS 1 100 -768.0000 767.9766 FORMAT "%8.4" ECU_ADDRESS 0x8FF5B8 /end MEASUREMENT
/begin MEASUREMENT InjCrv_phiPiI2Rgn "Regenerationswert für die  Winkelkomponente des Ansteuerbeginns der PiI2" SWORD AngleCrS 1 100 -768.0000 767.9766 FORMAT "%8.4" ECU_ADDRESS 0x7F8ED6 /end MEASUREMENT
/begin MEASUREMENT InjCrv_phiPiI2RgnByp_mp "Messpunkt für Bypass" SWORD AngleCrS 1 100 -768.0000 767.9766 FORMAT "%8.4" ECU_ADDRESS 0x8FF5EC /end MEASUREMENT
/begin MEASUREMENT InjCrv_phiPiI3Des "gewünschte Winkelkomponente Ansteuerbeginn PiI3" SWORD AngleCrS 1 100 -768.0000 767.9766 FORMAT "%8.4" ECU_ADDRESS 0x7F8ED8 /end MEASUREMENT
/begin MEASUREMENT InjCrv_phiPiI3DesByp_mp "Bypass-Label, Kopie von InjCrv_phiPiI3Des" SWORD AngleCrS 1 100 -768.0000 767.9766 FORMAT "%8.4" ECU_ADDRESS 0x8FF60E /end MEASUREMENT
/begin MEASUREMENT InjCrv_phiPoI1AddCor "kundenspezifischer Korrekturwinkel für PoI1" SWORD AngleCrS 1 100 -768.0000 767.9766 FORMAT "%8.4" ECU_ADDRESS 0x7F8EDA /end MEASUREMENT
/begin MEASUREMENT InjCrv_phiPoI1Bas_mp "Grundwert des Ansteuerbeginnwinkels PoI1" SWORD AngleCrS 1 100 -768.0000 767.9766 FORMAT "%8.4" ECU_ADDRESS 0x8FF68A /end MEASUREMENT
/begin MEASUREMENT InjCrv_phiPoI1Des "gewünschter Bezugswinkel für Beginn der PoI1" SWORD AngleCrS 1 100 -768.0000 767.9766 FORMAT "%8.4" ECU_ADDRESS 0x7F8EDC /end MEASUREMENT
/begin MEASUREMENT InjCrv_phiPoI1DesByp_mp "Bypass-Label, Kopie von InjCrv_phiPoI1Des" SWORD AngleCrS 1 100 -768.0000 767.9766 FORMAT "%8.4" ECU_ADDRESS 0x8FF68C /end MEASUREMENT
/begin MEASUREMENT InjCrv_phiPoI1Dur_mp "Gesamtzeti PoI1 in Winkelgraden" SWORD AngleCrS 1 100 -768.0000 767.9766 FORMAT "%8.4" ECU_ADDRESS 0x8FF68E /end MEASUREMENT
/begin MEASUREMENT InjCrv_phiPoI1EnvCor "umgebungsbedingungsabhängiger Korrekturwinkel für PoI1" SWORD AngleCrS 1 100 -768.0000 767.9766 FORMAT "%8.4" ECU_ADDRESS 0x7F8EDE /end MEASUREMENT
/begin MEASUREMENT InjCrv_phiPoI1Lim_mp "begrenzeter Ansteuerbeginnwinkel PoI1" SWORD AngleCrS 1 100 -768.0000 767.9766 FORMAT "%8.4" ECU_ADDRESS 0x8FF690 /end MEASUREMENT
/begin MEASUREMENT InjCrv_phiPoI1Min_mp "spätester Ansteuerbeginnwinkel PoI1" SWORD AngleCrS 1 100 -768.0000 767.9766 FORMAT "%8.4" ECU_ADDRESS 0x8FF692 /end MEASUREMENT
/begin MEASUREMENT InjCrv_phiPoI1Rgn "Grundwert der Winkelkomponente Ansteuerbeginn PoI1 im Regenerationsbetrieb" SWORD AngleCrS 1 100 -768.0000 767.9766 FORMAT "%8.4" ECU_ADDRESS 0x7F8EE0 /end MEASUREMENT
/begin MEASUREMENT InjCrv_phiPoI1Rgn1_mp "Regeneration value 1 for the PoI1 start of energising angle component" SWORD AngleCrS 1 100 -768.0000 767.9766 FORMAT "%8.4" ECU_ADDRESS 0x8FF6B4 /end MEASUREMENT
/begin MEASUREMENT InjCrv_phiPoI1Rgn2_mp "Regeneration value 2 for the PoI1 start of energising angle component" SWORD AngleCrS 1 100 -768.0000 767.9766 FORMAT "%8.4" ECU_ADDRESS 0x8FF6B6 /end MEASUREMENT
/begin MEASUREMENT InjCrv_phiPoI1RgnByp_mp "Messpunkt für Bypass" SWORD AngleCrS 1 100 -768.0000 767.9766 FORMAT "%8.4" ECU_ADDRESS 0x8FF6B8 /end MEASUREMENT
/begin MEASUREMENT InjCrv_phiPoI1Set_mp "Sollwert des Ansteuerbeginnwinkels PoI1" SWORD AngleCrS 1 100 -768.0000 767.9766 FORMAT "%8.4" ECU_ADDRESS 0x8FF694 /end MEASUREMENT
/begin MEASUREMENT InjCrv_phiPoI2AbsTot_mp "absoluter Ansteuerbeginn PoI2 aus Winkel- und Zeitkomponente" SWORD AngleCrS 1 100 -768.0000 767.9766 FORMAT "%8.4" ECU_ADDRESS 0x8FF720 /end MEASUREMENT
/begin MEASUREMENT InjCrv_phiPoI2Abs_mp "Sollwert, Winkelkomponente Ansteuerbeginn PoI2 relativ zum oberen Totpunkt" SWORD AngleCrS 1 100 -768.0000 767.9766 FORMAT "%8.4" ECU_ADDRESS 0x8FF722 /end MEASUREMENT
/begin MEASUREMENT InjCrv_phiPoI2AddCor "kundenspezifischer Korrekturwinkel für PoI2" SWORD AngleCrS 1 100 -768.0000 767.9766 FORMAT "%8.4" ECU_ADDRESS 0x7F8EE2 /end MEASUREMENT
/begin MEASUREMENT InjCrv_phiPoI2ATSCor_mp "ansauglufttemperaturabhängiger Korrekturgrundwert für die Winkelkomponente des Ansteuerbeginns der PoI2" SWORD AngleCrS 1 100 -768.0000 767.9766 FORMAT "%8.4" ECU_ADDRESS 0x8FF6CE /end MEASUREMENT
/begin MEASUREMENT InjCrv_phiPoI2Bas_mp "Winkelkomponente Ansteuerbeginn PoI2 Grundwert" SWORD AngleCrS 1 100 -768.0000 767.9766 FORMAT "%8.4" ECU_ADDRESS 0x8FF73A /end MEASUREMENT
/begin MEASUREMENT InjCrv_phiPoI2Byp_mp "Messpunkt für Bypass" SWORD AngleCrS 1 100 -768.0000 767.9766 FORMAT "%8.4" ECU_ADDRESS 0x8FF724 /end MEASUREMENT
/begin MEASUREMENT InjCrv_phiPoI2Cor_mp "korrigierter Grundwert der Winkelkomponente Ansteuerbeginn PoI2" SWORD AngleCrS 1 100 -768.0000 767.9766 FORMAT "%8.4" ECU_ADDRESS 0x8FF726 /end MEASUREMENT
/begin MEASUREMENT InjCrv_phiPoI2Des "gewünschter Bezugswinkel für Beginn der PoI2" SWORD AngleCrS 1 100 -768.0000 767.9766 FORMAT "%8.4" ECU_ADDRESS 0x7F8EE4 /end MEASUREMENT
/begin MEASUREMENT InjCrv_phiPoI2EnvCor "Korrekturwinkel für PoI2" SWORD AngleCrS 1 100 -768.0000 767.9766 FORMAT "%8.4" ECU_ADDRESS 0x7F8EE6 /end MEASUREMENT
/begin MEASUREMENT InjCrv_phiPoI2ETSCor_mp "motortemperaturabhängiger Korrekturgrundwert für die Winkelkomponente des Ansteuerbeginns der PoI2" SWORD AngleCrS 1 100 -768.0000 767.9766 FORMAT "%8.4" ECU_ADDRESS 0x8FF6D0 /end MEASUREMENT
/begin MEASUREMENT InjCrv_phiPoI2Rel_mp "Winkelkomponente Ansteuerbeginn PoI2 relativ zur Haupteinspritzung" SWORD AngleCrS 1 100 -768.0000 767.9766 FORMAT "%8.4" ECU_ADDRESS 0x8FF728 /end MEASUREMENT
/begin MEASUREMENT InjCrv_phiPoI2Rgn "Grundwert der Winkelkomponente Ansteuerbeginn PoI2 im Regenerationsbetrieb" SWORD AngleCrS 1 100 -768.0000 767.9766 FORMAT "%8.4" ECU_ADDRESS 0x7F8EE8 /end MEASUREMENT
/begin MEASUREMENT InjCrv_phiPoI2Rgn1_mp "Regenerationswert 1 für Förderbeginn Nacheinspritzung" SWORD AngleCrS 1 100 -768.0000 767.9766 FORMAT "%8.4" ECU_ADDRESS 0x8FF70A /end MEASUREMENT
/begin MEASUREMENT InjCrv_phiPoI2Rgn2_mp "Regenerationswert 2 für Förderbeginn Nacheinspritzung" SWORD AngleCrS 1 100 -768.0000 767.9766 FORMAT "%8.4" ECU_ADDRESS 0x8FF70C /end MEASUREMENT
/begin MEASUREMENT InjCrv_phiPoI2RgnByp_mp "Messpunkt für Bypass" SWORD AngleCrS 1 100 -768.0000 767.9766 FORMAT "%8.4" ECU_ADDRESS 0x8FF70E /end MEASUREMENT
/begin MEASUREMENT InjCrv_phiPoI2RgnCor "correction value for PoI2 setpoint" SWORD AngleCrS 1 100 -768.0000 767.9766 FORMAT "%8.4" ECU_ADDRESS 0x7F8EEA /end MEASUREMENT
/begin MEASUREMENT InjCrv_PoI1RgnTypeVal "activation value for PoI1 demanded by EGT-System" ULONG EGTSwt 1 100 0.00 262.143999939 FORMAT "%13.9" ECU_ADDRESS 0x7F9288 /end MEASUREMENT
/begin MEASUREMENT InjCrv_PoI1RgnVal "" ULONG EGTSwt 1 100 0.00 262.143999939 FORMAT "%13.9" ECU_ADDRESS 0x7F928C /end MEASUREMENT
/begin MEASUREMENT InjCrv_PoI2EffVal "activation value for PoI2 demanded by EGT-System" ULONG EGTSwt 1 100 0.00 262.143999939 FORMAT "%13.9" ECU_ADDRESS 0x7F9290 /end MEASUREMENT
/begin MEASUREMENT InjCrv_PoI2RgnTypeVal "activation value for PoI2 demanded by EGT-System" ULONG EGTSwt 1 100 0.00 262.143999939 FORMAT "%13.9" ECU_ADDRESS 0x7F9294 /end MEASUREMENT
/begin MEASUREMENT InjCrv_POpPoI1AddCor "kundespezifischer Korrekturwert für Freigabe PoI1" SWORD OneToOne 1 100 -32768.00 32767.00 FORMAT "%8.2" ECU_ADDRESS 0x7F8E32 /end MEASUREMENT
/begin MEASUREMENT InjCrv_POpPoI1Bas_mp "grundwert Freigabe PoI1" SWORD OneToOne 1 100 -32768.00 32767.00 FORMAT "%8.2" ECU_ADDRESS 0x8FF6C0 /end MEASUREMENT
/begin MEASUREMENT InjCrv_POpPoI1EnvCor "Freigabekorrekturwert für PoI1" SWORD OneToOne 1 100 -32768.00 32767.00 FORMAT "%8.2" ECU_ADDRESS 0x7F8E34 /end MEASUREMENT
/begin MEASUREMENT InjCrv_POpPoI1_mp "korrigierter grundwert Freigabe PoI1" SWORD OneToOne 1 100 -32768.00 32767.00 FORMAT "%8.2" ECU_ADDRESS 0x8FF6C2 /end MEASUREMENT
/begin MEASUREMENT InjCrv_POpPoI2AddCor "kundenspezifischer Korrekturwert für Freigabe PoI2" SWORD OneToOne 1 100 -32768.00 32767.00 FORMAT "%8.2" ECU_ADDRESS 0x7F8E36 /end MEASUREMENT
/begin MEASUREMENT InjCrv_POpPoI2BasStrt_mp "" SWORD OneToOne 1 100 -32768.00 32767.00 FORMAT "%8.2" ECU_ADDRESS 0x8FF73E /end MEASUREMENT
/begin MEASUREMENT InjCrv_POpPoI2Bas_mp "grundwert Freigabe PoI2" SWORD OneToOne 1 100 -32768.00 32767.00 FORMAT "%8.2" ECU_ADDRESS 0x8FF71C /end MEASUREMENT
/begin MEASUREMENT InjCrv_POpPoI2EnvCor "Korrekturwert für Freigabe PoI2" SWORD OneToOne 1 100 -32768.00 32767.00 FORMAT "%8.2" ECU_ADDRESS 0x7F8E38 /end MEASUREMENT
/begin MEASUREMENT InjCrv_POpPoI2EnvCorStrt "Korrekturwert für Freigabe PoI2 im Startzustand" SWORD OneToOne 1 100 -32768.00 32767.00 FORMAT "%8.2" ECU_ADDRESS 0x7F8E3A /end MEASUREMENT
/begin MEASUREMENT InjCrv_POpPoI2_mp "reigabe PoI2, korrigierter Grundwert" SWORD OneToOne 1 100 -32768.00 32767.00 FORMAT "%8.2" ECU_ADDRESS 0x8FF71E /end MEASUREMENT
/begin MEASUREMENT InjCrv_qMI1MinPiI1_mp "Minimalmenge der MI1 wenn nur PiI1 abgesetzt wird" SWORD InjMassInj 1 100 -327.6800 327.6700 FORMAT "%8.4" ECU_ADDRESS 0x8FF610 /end MEASUREMENT
/begin MEASUREMENT InjCrv_qMI1MinPiI2_mp "Minimalmenge der MI1 wenn PiI1 und PiI2 abgesetzt werden" SWORD InjMassInj 1 100 -327.6800 327.6700 FORMAT "%8.4" ECU_ADDRESS 0x8FF5BA /end MEASUREMENT
/begin MEASUREMENT InjCrv_qMI1MinPoI2_mp "Minimale Einspritzmenge der MI1 bei der PoI2 Berechnung" SWORD InjMassInj 1 100 -327.6800 327.6700 FORMAT "%8.4" ECU_ADDRESS 0x8FF6EA /end MEASUREMENT
/begin MEASUREMENT InjCrv_qPiI1AddCor "kundenspezifische Korrekturmenge für PiI1" SWORD InjMassInj 1 100 -327.6800 327.6700 FORMAT "%8.4" ECU_ADDRESS 0x7F8EF4 /end MEASUREMENT
/begin MEASUREMENT InjCrv_qPiI1AddCor2 "kundenspezifische Korrekturmenge für PiI1 bei freigegebener PiI2" SWORD InjMassInj 1 100 -327.6800 327.6700 FORMAT "%8.4" ECU_ADDRESS 0x7F8EF6 /end MEASUREMENT
/begin MEASUREMENT InjCrv_qPiI1APSCor2_mp "atmosphärendruckabhängige Korrekturmenge -2 für PiI1 und PiI2" SWORD InjMassInj 1 100 -327.6800 327.6700 FORMAT "%8.4" ECU_ADDRESS 0x8FF658 /end MEASUREMENT
/begin MEASUREMENT InjCrv_qPiI1APSCorStrt_mp "quantity correction value dependent on atmospheric pressure" SWORD InjMassInj 1 100 -327.6800 327.6700 FORMAT "%8.4" ECU_ADDRESS 0x8FF65A /end MEASUREMENT
/begin MEASUREMENT InjCrv_qPiI1APSCor_mp "atmosphärendruckabhängige Korrekturmenge für Voreinspritzung 1" SWORD InjMassInj 1 100 -327.6800 327.6700 FORMAT "%8.4" ECU_ADDRESS 0x8FF65C /end MEASUREMENT
/begin MEASUREMENT InjCrv_qPiI1ATSCor2_mp "ansauglufttemperaturabhängige Korrekturmenge -2 für PiI1 und PiI2" SWORD InjMassInj 1 100 -327.6800 327.6700 FORMAT "%8.4" ECU_ADDRESS 0x8FF65E /end MEASUREMENT
/begin MEASUREMENT InjCrv_qPiI1ATSCorStrt_mp "quantity correction value dependent on intake air temperature" SWORD InjMassInj 1 100 -327.6800 327.6700 FORMAT "%8.4" ECU_ADDRESS 0x8FF660 /end MEASUREMENT
/begin MEASUREMENT InjCrv_qPiI1ATSCor_mp "ansauglufttemperaturabhängige Korrekturmenge für Voreinspritzung 1" SWORD InjMassInj 1 100 -327.6800 327.6700 FORMAT "%8.4" ECU_ADDRESS 0x8FF662 /end MEASUREMENT
/begin MEASUREMENT InjCrv_qPiI1Bas_mp "Einspritzmenge PiI1 Grundwert" SWORD InjMassInj 1 100 -327.6800 327.6700 FORMAT "%8.4" ECU_ADDRESS 0x6F8172 /end MEASUREMENT
/begin MEASUREMENT InjCrv_qPiI1ChamWllTempCorr_mp "messpunkt für die Mengenkorrektur der Brennraumwandtemperaturkorrektur" SWORD InjMassInj 1 100 -327.6800 327.6700 FORMAT "%8.4" ECU_ADDRESS 0x8FF646 /end MEASUREMENT
/begin MEASUREMENT InjCrv_qPiI1Des "gewünschte Einspritzmenge PiI 1" SWORD InjMassInj 1 100 -327.6800 327.6700 FORMAT "%8.4" ECU_ADDRESS 0x7F8EF8 /end MEASUREMENT
/begin MEASUREMENT InjCrv_qPiI1DesByp_mp "Bypass-Label, Kopie von InjCrv_qPiI1Des" SWORD InjMassInj 1 100 -327.6800 327.6700 FORMAT "%8.4" ECU_ADDRESS 0x8FF612 /end MEASUREMENT
/begin MEASUREMENT InjCrv_qPiI1DynCor_mp "Korrekturgrundwert für dynamische Voreinspritzmengenkorrektur" SWORD InjMassInj 1 100 -327.6800 327.6700 FORMAT "%8.4" ECU_ADDRESS 0x8FF648 /end MEASUREMENT
/begin MEASUREMENT InjCrv_qPiI1EnvCor "Korrekturmenge für Voreinspritzung 1" SWORD InjMassInj 1 100 -327.6800 327.6700 FORMAT "%8.4" ECU_ADDRESS 0x7F8EFA /end MEASUREMENT
/begin MEASUREMENT InjCrv_qPiI1EnvCor2 "Korrekturmenge für Voreinspritzung 1 bei freigegebener PiI2" SWORD InjMassInj 1 100 -327.6800 327.6700 FORMAT "%8.4" ECU_ADDRESS 0x7F8EFC /end MEASUREMENT
/begin MEASUREMENT InjCrv_qPiI1EnvCorStrt "Korrekturmenge für Voreinspritzung 1 Start" SWORD InjMassInj 1 100 -327.6800 327.6700 FORMAT "%8.4" ECU_ADDRESS 0x7F8EFE /end MEASUREMENT
/begin MEASUREMENT InjCrv_qPiI1ETSCor12_mp """motortemperaturabhängige Korrekturmenge für PiI1 bei inaktiver PiI2""" SWORD InjMassInj 1 100 -327.6800 327.6700 FORMAT "%8.4" ECU_ADDRESS 0x8FF664 /end MEASUREMENT
/begin MEASUREMENT InjCrv_qPiI1ETSCor1_mp "motortemperaturabhängige Korrekturmenge -1 für PiI1 und PiI2" SWORD InjMassInj 1 100 -327.6800 327.6700 FORMAT "%8.4" ECU_ADDRESS 0x8FF666 /end MEASUREMENT
/begin MEASUREMENT InjCrv_qPiI1ETSCor2_mp "motortemperaturabhängige Korrekturmenge -2 für PiI1 und PiI2" SWORD InjMassInj 1 100 -327.6800 327.6700 FORMAT "%8.4" ECU_ADDRESS 0x8FF668 /end MEASUREMENT
/begin MEASUREMENT InjCrv_qPiI1ETSCorStrt_mp "quantity correction value dependent on engine temperature" SWORD InjMassInj 1 100 -327.6800 327.6700 FORMAT "%8.4" ECU_ADDRESS 0x8FF66A /end MEASUREMENT
/begin MEASUREMENT InjCrv_qPiI1ETSCor_mp "motortemperaturabhängige Korrekturmenge für Voreinspritzung 1" SWORD InjMassInj 1 100 -327.6800 327.6700 FORMAT "%8.4" ECU_ADDRESS 0x8FF66C /end MEASUREMENT
/begin MEASUREMENT InjCrv_qPiI1Max_mp "maximale Einspritzmenge der PiI1" SWORD InjMassInj 1 100 -327.6800 327.6700 FORMAT "%8.4" ECU_ADDRESS 0x8FF614 /end MEASUREMENT
/begin MEASUREMENT InjCrv_qPiI1MinWv_mp "Minimalmenge der PiI1 mit Wellenlorrektur" SWORD InjMassInj 1 100 -327.6800 327.6700 FORMAT "%8.4" ECU_ADDRESS 0x8FF750 /end MEASUREMENT
/begin MEASUREMENT InjCrv_qPiI1Rgn "Regenerationswert für die Einspritmenge der PiI1" SWORD InjMassInj 1 100 -327.6800 327.6700 FORMAT "%8.4" ECU_ADDRESS 0x7F8F00 /end MEASUREMENT
/begin MEASUREMENT InjCrv_qPiI1RgnByp_mp "Messpunkt für Bypass" SWORD InjMassInj 1 100 -327.6800 327.6700 FORMAT "%8.4" ECU_ADDRESS 0x8FF67A /end MEASUREMENT
/begin MEASUREMENT InjCrv_qPiI1SetLimMax_mp "begrenzte maximale Solleinspritzmenge PiI1" SWORD InjMassInj 1 100 -327.6800 327.6700 FORMAT "%8.4" ECU_ADDRESS 0x8FF616 /end MEASUREMENT
/begin MEASUREMENT InjCrv_qPiI1SetLim_mp "begrenzte Solleinspritzmenge PiI1" SWORD InjMassInj 1 100 -327.6800 327.6700 FORMAT "%8.4" ECU_ADDRESS 0x8FF618 /end MEASUREMENT
/begin MEASUREMENT InjCrv_qPiI1SetRaw_mp "Rohwert der Einspritzmenge PiI1" SWORD InjMassInj 1 100 -327.6800 327.6700 FORMAT "%8.4" ECU_ADDRESS 0x8FF61A /end MEASUREMENT
/begin MEASUREMENT InjCrv_qPiI1Set_mp "Sollwert der Einspritzmenge PiI1" SWORD InjMassInj 1 100 -327.6800 327.6700 FORMAT "%8.4" ECU_ADDRESS 0x8FF61C /end MEASUREMENT
/begin MEASUREMENT InjCrv_qPiI2APSCorStrt_mp "PiI2 quantity correction value dependent on atmospheric pressure" SWORD InjMassInj 1 100 -327.6800 327.6700 FORMAT "%8.4" ECU_ADDRESS 0x8FF5D8 /end MEASUREMENT
/begin MEASUREMENT InjCrv_qPiI2APSCor_mp "atmosphärendruckabhängige Korrekturmenge für Voreinspritzung 2" SWORD InjMassInj 1 100 -327.6800 327.6700 FORMAT "%8.4" ECU_ADDRESS 0x8FF5DA /end MEASUREMENT
/begin MEASUREMENT InjCrv_qPiI2ATSCorStrt_mp "PiI2 quantity correction value dependent on intake air temperature" SWORD InjMassInj 1 100 -327.6800 327.6700 FORMAT "%8.4" ECU_ADDRESS 0x8FF5DC /end MEASUREMENT
/begin MEASUREMENT InjCrv_qPiI2ATSCor_mp "ansauglufttemperaturabhängige Korrekturmenge für Voreinspritzung 2" SWORD InjMassInj 1 100 -327.6800 327.6700 FORMAT "%8.4" ECU_ADDRESS 0x8FF5DE /end MEASUREMENT
/begin MEASUREMENT InjCrv_qPiI2BasStrt_mp "Einspritzmenge PiI 2 Grundwert im Startzustand" SWORD InjMassInj 1 100 -327.6800 327.6700 FORMAT "%8.4" ECU_ADDRESS 0x8FF5F6 /end MEASUREMENT
/begin MEASUREMENT InjCrv_qPiI2Bas_mp "Einspritzmenge PiI2 Grundwert" SWORD InjMassInj 1 100 -327.6800 327.6700 FORMAT "%8.4" ECU_ADDRESS 0x6F8170 /end MEASUREMENT
/begin MEASUREMENT InjCrv_qPiI2Des "gewünschte Einspritzmenge PiI 2" SWORD InjMassInj 1 100 -327.6800 327.6700 FORMAT "%8.4" ECU_ADDRESS 0x7F8F04 /end MEASUREMENT
/begin MEASUREMENT InjCrv_qPiI2DesByp_mp "Bypass-Label, Kopie von InjCrv_qPiI2Des" SWORD InjMassInj 1 100 -327.6800 327.6700 FORMAT "%8.4" ECU_ADDRESS 0x8FF61E /end MEASUREMENT
/begin MEASUREMENT InjCrv_qPiI2EnvCor "Korrekturmenge für Voreinspritzung 2" SWORD InjMassInj 1 100 -327.6800 327.6700 FORMAT "%8.4" ECU_ADDRESS 0x7F8F06 /end MEASUREMENT
/begin MEASUREMENT InjCrv_qPiI2EnvCorStrt "Korrekturmenge für Voreinspritzung 2 start" SWORD InjMassInj 1 100 -327.6800 327.6700 FORMAT "%8.4" ECU_ADDRESS 0x7F8F08 /end MEASUREMENT
/begin MEASUREMENT InjCrv_qPiI2ETSCorStrt_mp "PiI2 quantity correction value dependent on engine temperature" SWORD InjMassInj 1 100 -327.6800 327.6700 FORMAT "%8.4" ECU_ADDRESS 0x8FF5E0 /end MEASUREMENT
/begin MEASUREMENT InjCrv_qPiI2ETSCor_mp "motortemperaturabhängige Korrekturmenge für Voreinspritzung 2" SWORD InjMassInj 1 100 -327.6800 327.6700 FORMAT "%8.4" ECU_ADDRESS 0x8FF5E2 /end MEASUREMENT
/begin MEASUREMENT InjCrv_qPiI2Max_mp "maximale Einspritzmenge der PiI2" SWORD InjMassInj 1 100 -327.6800 327.6700 FORMAT "%8.4" ECU_ADDRESS 0x8FF5BC /end MEASUREMENT
/begin MEASUREMENT InjCrv_qPiI2Rgn "Regenerationswert für die Einspritmenge der PiI2" SWORD InjMassInj 1 100 -327.6800 327.6700 FORMAT "%8.4" ECU_ADDRESS 0x7F8F0A /end MEASUREMENT
/begin MEASUREMENT InjCrv_qPiI2RgnByp_mp "Messpunkt für Bypass" SWORD InjMassInj 1 100 -327.6800 327.6700 FORMAT "%8.4" ECU_ADDRESS 0x8FF5EE /end MEASUREMENT
/begin MEASUREMENT InjCrv_qPiI2SetLimMax_mp "begrenzte maximale Solleinspritzmenge PiI2" SWORD InjMassInj 1 100 -327.6800 327.6700 FORMAT "%8.4" ECU_ADDRESS 0x8FF5BE /end MEASUREMENT
/begin MEASUREMENT InjCrv_qPiI2SetLim_mp "begrenzte Solleinspritzmenge PiI2" SWORD InjMassInj 1 100 -327.6800 327.6700 FORMAT "%8.4" ECU_ADDRESS 0x8FF5C0 /end MEASUREMENT
/begin MEASUREMENT InjCrv_qPiI2SetRaw_mp "Rohwert der Einspritzmenge PiI2" SWORD InjMassInj 1 100 -327.6800 327.6700 FORMAT "%8.4" ECU_ADDRESS 0x8FF5C2 /end MEASUREMENT
/begin MEASUREMENT InjCrv_qPiI2Set_mp "Sollwert der Einspritzmenge PiI2" SWORD InjMassInj 1 100 -327.6800 327.6700 FORMAT "%8.4" ECU_ADDRESS 0x8FF5C4 /end MEASUREMENT
/begin MEASUREMENT InjCrv_qPiI3Des "gewünschte Einspritzmenge PiI 3" SWORD InjMassInj 1 100 -327.6800 327.6700 FORMAT "%8.4" ECU_ADDRESS 0x7F8F0C /end MEASUREMENT
/begin MEASUREMENT InjCrv_qPiI3DesByp_mp "Bypass-Label, Kopie von InjCrv_qPiI3Des" SWORD InjMassInj 1 100 -327.6800 327.6700 FORMAT "%8.4" ECU_ADDRESS 0x8FF620 /end MEASUREMENT
/begin MEASUREMENT InjCrv_qPiIMin_mp "minimale Einspritzmenge einer Voreinspritzung, ohne Wellenkorrektur" SWORD InjMassInj 1 100 -327.6800 327.6700 FORMAT "%8.4" ECU_ADDRESS 0x8FF622 /end MEASUREMENT
/begin MEASUREMENT InjCrv_qPoI1AddCor "kundenspezifische Korrekturmenge für PoI1" SWORD InjMassInj 1 100 -327.6800 327.6700 FORMAT "%8.4" ECU_ADDRESS 0x7F8F0E /end MEASUREMENT
/begin MEASUREMENT InjCrv_qPoI1APSCor_mp "atmospärendruckabhängige Korrekturmenge für PoI1" SWORD InjMassInj 1 100 -327.6800 327.6700 FORMAT "%8.4" ECU_ADDRESS 0x8FF6AC /end MEASUREMENT
/begin MEASUREMENT InjCrv_qPoI1Bas_mp "Grundwert der Einspritzmenge PoI1" SWORD InjMassInj 1 100 -327.6800 327.6700 FORMAT "%8.4" ECU_ADDRESS 0x8FF696 /end MEASUREMENT
/begin MEASUREMENT InjCrv_qPoI1Des "gewünschte Einspritzmenge PoI1" SWORD InjMassInj 1 100 -327.6800 327.6700 FORMAT "%8.4" ARRAY_SIZE 6 ECU_ADDRESS 0x7F937C /end MEASUREMENT
/begin MEASUREMENT InjCrv_qPoI1DesByp_mp "Bypass-Label, Kopie von InjCrv_qPoI1Des" SWORD InjMassInj 1 100 -327.6800 327.6700 FORMAT "%8.4" ECU_ADDRESS 0x8FF698 /end MEASUREMENT
/begin MEASUREMENT InjCrv_qPoI1Des_mp "Sollmenge Nacheinspritzung 1" SWORD InjMassInj 1 100 -327.6800 327.6700 FORMAT "%8.4" ECU_ADDRESS 0x8FF69A /end MEASUREMENT
/begin MEASUREMENT InjCrv_qPoI1Eff "Correction in main injection quantity due to regeneration request from particle filter" SWORD InjMassInj 1 100 -327.6800 327.6700 FORMAT "%8.4" ARRAY_SIZE 6 ECU_ADDRESS 0x7F9388 /end MEASUREMENT
/begin MEASUREMENT InjCrv_qPoI1EnvCor "umgebungsbedingungsabhängige Korrekturmenge für PoI1" SWORD InjMassInj 1 100 -327.6800 327.6700 FORMAT "%8.4" ECU_ADDRESS 0x7F8F10 /end MEASUREMENT
/begin MEASUREMENT InjCrv_qPoI1ETSCor_mp "motortemperaturabhängige Korrekturmenge für PoI1" SWORD InjMassInj 1 100 -327.6800 327.6700 FORMAT "%8.4" ECU_ADDRESS 0x8FF6AE /end MEASUREMENT
/begin MEASUREMENT InjCrv_qPoI1Lim_mp "begrenzte Einspritzmenge PoI1" SWORD InjMassInj 1 100 -327.6800 327.6700 FORMAT "%8.4" ECU_ADDRESS 0x8FF69C /end MEASUREMENT
/begin MEASUREMENT InjCrv_qPoI1Max_mp "Maximalwert der Einspritzmenge PoI1" SWORD InjMassInj 1 100 -327.6800 327.6700 FORMAT "%8.4" ECU_ADDRESS 0x8FF69E /end MEASUREMENT
/begin MEASUREMENT InjCrv_qPoI1Min_mp "Minimalwert der Einspritzmenge PoI1" SWORD InjMassInj 1 100 -327.6800 327.6700 FORMAT "%8.4" ECU_ADDRESS 0x8FF6A0 /end MEASUREMENT
/begin MEASUREMENT InjCrv_qPoI1Rgn "Grundwert Einspritzmenge PoI1 im Regenerationsbetrieb" SWORD InjMassInj 1 100 -327.6800 327.6700 FORMAT "%8.4" ECU_ADDRESS 0x7F8F12 /end MEASUREMENT
/begin MEASUREMENT InjCrv_qPoI1Rgn1_mp "Regeneration value 1 for the PoI1 injectin quantity" SWORD InjMassInj 1 100 -327.6800 327.6700 FORMAT "%8.4" ECU_ADDRESS 0x8FF6BA /end MEASUREMENT
/begin MEASUREMENT InjCrv_qPoI1Rgn2_mp "Regeneration value 2 for the PoI1 injectin quantity" SWORD InjMassInj 1 100 -327.6800 327.6700 FORMAT "%8.4" ECU_ADDRESS 0x8FF6BC /end MEASUREMENT
/begin MEASUREMENT InjCrv_qPoI1RgnByp_mp "Messpunkt für Bypass" SWORD InjMassInj 1 100 -327.6800 327.6700 FORMAT "%8.4" ECU_ADDRESS 0x8FF6BE /end MEASUREMENT
/begin MEASUREMENT InjCrv_qPoI1SetLim_mp "PoI1 total quantity before limitations" SWORD InjMassInj 1 100 -327.6800 327.6700 FORMAT "%8.4" ECU_ADDRESS 0x8FF6A2 /end MEASUREMENT
/begin MEASUREMENT InjCrv_qPoI1Set_mp "Sollwert der Einspritzmenge PoI1" SWORD InjMassInj 1 100 -327.6800 327.6700 FORMAT "%8.4" ECU_ADDRESS 0x8FF6A4 /end MEASUREMENT
/begin MEASUREMENT InjCrv_qPoI1_mp "Einspritzmenge für PoI1" SWORD InjMassInj 1 100 -327.6800 327.6700 FORMAT "%8.4" ECU_ADDRESS 0x8FF6A6 /end MEASUREMENT
/begin MEASUREMENT InjCrv_qPoI2AddCor "kundenspezifische Korrekturmenge für PoI2" SWORD InjMassInj 1 100 -327.6800 327.6700 FORMAT "%8.4" ECU_ADDRESS 0x7F8F14 /end MEASUREMENT
/begin MEASUREMENT InjCrv_qPoI2APSCorStrt_mp "Atmosphärendruckabhängiges Mengenkorrektur für PoI2 im Startzustand." SWORD InjMassInj 1 100 -327.6800 327.6700 FORMAT "%8.4" ECU_ADDRESS 0x8FF6C4 /end MEASUREMENT
/begin MEASUREMENT InjCrv_qPoI2ATSCorStrt_mp "Ansauglufttemperaturabhängiges Mengenkorrektur für PoI2 im Startzustand." SWORD InjMassInj 1 100 -327.6800 327.6700 FORMAT "%8.4" ECU_ADDRESS 0x8FF6C6 /end MEASUREMENT
/begin MEASUREMENT InjCrv_qPoI2ATSCor_mp "ansauglufttemperaturabhängige Korrekturmenge für PoI2" SWORD InjMassInj 1 100 -327.6800 327.6700 FORMAT "%8.4" ECU_ADDRESS 0x8FF6C8 /end MEASUREMENT
/begin MEASUREMENT InjCrv_qPoI2BasStrt_mp "" SWORD InjMassInj 1 100 -327.6800 327.6700 FORMAT "%8.4" ECU_ADDRESS 0x8FF740 /end MEASUREMENT
/begin MEASUREMENT InjCrv_qPoI2Bas_mp "Einspritzmenge PoI2 Grundwert" SWORD InjMassInj 1 100 -327.6800 327.6700 FORMAT "%8.4" ECU_ADDRESS 0x8FF6EC /end MEASUREMENT
/begin MEASUREMENT InjCrv_qPoI2Cor_mp "korrigierter Grundwert der Einspritzmenge PoI2" SWORD InjMassInj 1 100 -327.6800 327.6700 FORMAT "%8.4" ECU_ADDRESS 0x8FF6EE /end MEASUREMENT
/begin MEASUREMENT InjCrv_qPoI2Des "Sollmenge Nacheinspritzung 2" SWORD InjMassInj 1 100 -327.6800 327.6700 FORMAT "%8.4" ARRAY_SIZE 6 ECU_ADDRESS 0x7F9394 /end MEASUREMENT
/begin MEASUREMENT InjCrv_qPoI2DesByp_mp "Messpunkt für den Bypass" SWORD InjMassInj 1 100 -327.6800 327.6700 FORMAT "%8.4" ECU_ADDRESS 0x8FF72A /end MEASUREMENT
/begin MEASUREMENT InjCrv_qPoI2Des_mp "Sollmenge Nacheinspritzung 2" SWORD InjMassInj 1 100 -327.6800 327.6700 FORMAT "%8.4" ECU_ADDRESS 0x8FF6F0 /end MEASUREMENT
/begin MEASUREMENT InjCrv_qPoI2Eff "wirksame Einspritzmenge PoI2" SWORD InjMassInj 1 100 -327.6800 327.6700 FORMAT "%8.4" ARRAY_SIZE 6 ECU_ADDRESS 0x7F93A0 /end MEASUREMENT
/begin MEASUREMENT InjCrv_qPoI2EffByp_mp "Messpunkt für den Bypass" SWORD InjMassInj 1 100 -327.6800 327.6700 FORMAT "%8.4" ECU_ADDRESS 0x8FF72C /end MEASUREMENT
/begin MEASUREMENT InjCrv_qPoI2Eff_mp "Wirksame Menge der PoI2" SWORD InjMassInj 1 100 -327.6800 327.6700 FORMAT "%8.4" ECU_ADDRESS 0x8FF6F2 /end MEASUREMENT
/begin MEASUREMENT InjCrv_qPoI2EnvCor "Korrekturmenge für PoI2" SWORD InjMassInj 1 100 -327.6800 327.6700 FORMAT "%8.4" ECU_ADDRESS 0x7F8F16 /end MEASUREMENT
/begin MEASUREMENT InjCrv_qPoI2EnvCorStrt "Korrekturmenge für PoI2 im Startzustand" SWORD InjMassInj 1 100 -327.6800 327.6700 FORMAT "%8.4" ECU_ADDRESS 0x7F8F18 /end MEASUREMENT
/begin MEASUREMENT InjCrv_qPoI2ETSCorStrt_mp "Motortemperaturabhängiges Mengenkorrektur für PoI2 im Startzustand." SWORD InjMassInj 1 100 -327.6800 327.6700 FORMAT "%8.4" ECU_ADDRESS 0x8FF6CA /end MEASUREMENT
/begin MEASUREMENT InjCrv_qPoI2ETSCor_mp "motortemperaturabhängige Korrekturmenge für PoI2" SWORD InjMassInj 1 100 -327.6800 327.6700 FORMAT "%8.4" ECU_ADDRESS 0x8FF6CC /end MEASUREMENT
/begin MEASUREMENT InjCrv_qPoI2Lim_mp "begrenzter Sollwert, Einspritzmenge PoI2" SWORD InjMassInj 1 100 -327.6800 327.6700 FORMAT "%8.4" ECU_ADDRESS 0x8FF6F4 /end MEASUREMENT
/begin MEASUREMENT InjCrv_qPoI2Max_mp "maximale Einspritzmenge PoI2" SWORD InjMassInj 1 100 -327.6800 327.6700 FORMAT "%8.4" ECU_ADDRESS 0x8FF6F6 /end MEASUREMENT
/begin MEASUREMENT InjCrv_qPoI2Min_mp "minimale Einspritzmenge PoI2" SWORD InjMassInj 1 100 -327.6800 327.6700 FORMAT "%8.4" ECU_ADDRESS 0x8FF6F8 /end MEASUREMENT
/begin MEASUREMENT InjCrv_qPoI2Rgn "Grundwert Einspritzmenge PoI2 im Regenerationsbetrieb" SWORD InjMassInj 1 100 -327.6800 327.6700 FORMAT "%8.4" ECU_ADDRESS 0x7F8F1A /end MEASUREMENT
/begin MEASUREMENT InjCrv_qPoI2Rgn1_mp "Grundwert 1 für Regenerationsmenge Nacheinspritzung" SWORD InjMassInj 1 100 -327.6800 327.6700 FORMAT "%8.4" ECU_ADDRESS 0x8FF710 /end MEASUREMENT
/begin MEASUREMENT InjCrv_qPoI2Rgn2_mp "Regenerationswert 2  für Menge Nacheinspritzung" SWORD InjMassInj 1 100 -327.6800 327.6700 FORMAT "%8.4" ECU_ADDRESS 0x8FF712 /end MEASUREMENT
/begin MEASUREMENT InjCrv_qPoI2RgnByp_mp "Messpunkt für Bypass" SWORD InjMassInj 1 100 -327.6800 327.6700 FORMAT "%8.4" ECU_ADDRESS 0x8FF714 /end MEASUREMENT
/begin MEASUREMENT InjCrv_qPoI2RgnCor "correction value for PoI2 quantity" SWORD InjMassInj 1 100 -327.6800 327.6700 FORMAT "%8.4" ECU_ADDRESS 0x7F8F1C /end MEASUREMENT
/begin MEASUREMENT InjCrv_qPoI2Set_mp "Sollwert Einspritzmenge PoI2" SWORD InjMassInj 1 100 -327.6800 327.6700 FORMAT "%8.4" ECU_ADDRESS 0x8FF6FA /end MEASUREMENT
/begin MEASUREMENT InjCrv_qPoI2_mp "" SWORD InjMassInj 1 100 -327.6800 327.6700 FORMAT "%8.4" ECU_ADDRESS 0x8FF6FC /end MEASUREMENT
/begin MEASUREMENT InjCrv_qPoIOvrAct_mp "" SLONG InjMassTot 1 100 -21474836.4800 21474836.4700 FORMAT "%13.4" ECU_ADDRESS 0x8FF744 /end MEASUREMENT
/begin MEASUREMENT InjCrv_qPoIOvrTot_mp "" SLONG InjMassTot 1 100 -21474836.4800 21474836.4700 FORMAT "%13.4" ECU_ADDRESS 0x8FF748 /end MEASUREMENT
/begin MEASUREMENT InjCrv_qPoIRem "" SWORD InjMassInj 1 100 -327.6800 327.6700 FORMAT "%8.4" ARRAY_SIZE 6 ECU_ADDRESS 0x7F93AC /end MEASUREMENT
/begin MEASUREMENT InjCrv_qPoI_mp "" SWORD InjMassInj 1 100 -327.6800 327.6700 FORMAT "%8.4" ECU_ADDRESS 0x8FF74C /end MEASUREMENT
/begin MEASUREMENT InjCrv_stInjPoI1Off_mp "Statusvariable der Funktion ""PoI1 after overrun""" UBYTE OneToOne 1 100 0.00 255.0 FORMAT "%5.1" ECU_ADDRESS 0x8FF6A8 /end MEASUREMENT
/begin MEASUREMENT InjCrv_stInjPoI2Off_mp "Statusvariable der Funktion ""PoI2 after overrun""" UBYTE OneToOne 1 100 0.00 255.0 FORMAT "%5.1" ECU_ADDRESS 0x8FF6FE /end MEASUREMENT
/begin MEASUREMENT InjCrv_stPiI1_mp "Freigabestatus PiI1" UBYTE OneToOne 1 100 0.00 255.0 FORMAT "%5.1" ECU_ADDRESS 0x6F8174 /end MEASUREMENT
/begin MEASUREMENT InjCrv_stPiI2 "Status der Pil2-Aktivierung" UBYTE OneToOne 1 100 0.00 255.0 FORMAT "%5.1" ECU_ADDRESS 0x7F8929 /end MEASUREMENT
/begin MEASUREMENT InjCrv_stPoI1_mp "Freigabestatus PoI1" UBYTE OneToOne 1 100 0.00 255.0 FORMAT "%5.1" ECU_ADDRESS 0x8FF6A9 /end MEASUREMENT
/begin MEASUREMENT InjCrv_stPoI2 "Freigabestatus PoI2" UBYTE OneToOne 1 100 0.00 255.0 FORMAT "%5.1" ECU_ADDRESS 0x7F892A /end MEASUREMENT
/begin MEASUREMENT InjCrv_stPoIOvrQLim "" UBYTE OneToOne 1 100 0.00 255.0 FORMAT "%5.1" ECU_ADDRESS 0x7F892B /end MEASUREMENT
/begin MEASUREMENT InjCrv_stPoIOvrRaw_mp "" UBYTE OneToOne 1 100 0.00 255.0 FORMAT "%5.1" ECU_ADDRESS 0x8FF74E /end MEASUREMENT
/begin MEASUREMENT InjCrv_swtPoI2AgAbsTDC_mp "Status des Betriebsmodus Ansteuerbeginn PoI2 (entweder Winkel absolut zum TDC oder Winkel bzw. Zeit relativ zur MI)" UBYTE OneToOne 1 100 0.00 255.0 FORMAT "%5.1" ECU_ADDRESS 0x8FF72E /end MEASUREMENT
/begin MEASUREMENT InjCrv_tiPiI1AddCor "kundenspezifische Korrekturzeit für PiI1" SWORD InjTime_us 1 100 -32768.00 32767.00 FORMAT "%8.2" ECU_ADDRESS 0x7F8F24 /end MEASUREMENT
/begin MEASUREMENT InjCrv_tiPiI1AddCor2 "zusätzliche Korrekturzeit -2 für PiI1 (n sync)" SWORD InjTime_us 1 100 -32768.00 32767.00 FORMAT "%8.2" ECU_ADDRESS 0x7F8F26 /end MEASUREMENT
/begin MEASUREMENT InjCrv_tiPiI1ATSCor_mp "kundenspezifische Korrekturzeit für PiI1" SWORD InjTime_us 1 100 -32768.00 32767.00 FORMAT "%8.2" ECU_ADDRESS 0x8FF656 /end MEASUREMENT
/begin MEASUREMENT InjCrv_tiPiI1ChamWllTempCorr_mp "Messpunkt für die gesamte Brennraumwandtemperatur Korrektur" SWORD InjTime_us 1 100 -32768.00 32767.00 FORMAT "%8.2" ECU_ADDRESS 0x8FF64A /end MEASUREMENT
/begin MEASUREMENT InjCrv_tiPiI1CorRaw_mp "korrigierter Grundwert Zeitkomponente" SWORD InjTime_us 1 100 -32768.00 32767.00 FORMAT "%8.2" ECU_ADDRESS 0x8FF624 /end MEASUREMENT
/begin MEASUREMENT InjCrv_tiPiI1Cor_mp "korrigierter Grundwert der Zeitkomponente Ansteuerbeginn PiI" SWORD InjTime_us 1 100 -32768.00 32767.00 FORMAT "%8.2" ECU_ADDRESS 0x8FF626 /end MEASUREMENT
/begin MEASUREMENT InjCrv_tiPiI1Des "gewünschte Zeitkomponente Ansteuerbeginn PiI1" SWORD InjTime_us 1 100 -32768.00 32767.00 FORMAT "%8.2" ECU_ADDRESS 0x7F8F28 /end MEASUREMENT
/begin MEASUREMENT InjCrv_tiPiI1DesByp_mp "Bypass-Label, Kopie von InjCrv_tiPiI1Des" SWORD InjTime_us 1 100 -32768.00 32767.00 FORMAT "%8.2" ECU_ADDRESS 0x8FF628 /end MEASUREMENT
/begin MEASUREMENT InjCrv_tiPiI1DynCor_mp "time correction base value for ET, AP and DQ specific correction" SWORD InjTime_us 1 100 -32768.00 32767.00 FORMAT "%8.2" ECU_ADDRESS 0x8FF64C /end MEASUREMENT
/begin MEASUREMENT InjCrv_tiPiI1EnvCor "Korrekturzeit für PiI1" SWORD InjTime_us 1 100 -32768.00 32767.00 FORMAT "%8.2" ECU_ADDRESS 0x7F8F2A /end MEASUREMENT
/begin MEASUREMENT InjCrv_tiPiI1EnvCor2 "umgebungsabhängige Korrekturzeit -2 für PiI1 (n sync)" SWORD InjTime_us 1 100 -32768.00 32767.00 FORMAT "%8.2" ECU_ADDRESS 0x7F8F2C /end MEASUREMENT
/begin MEASUREMENT InjCrv_tiPiI1EnvCorStrt "Korrekturzeit für PiI1für inaktive PiI2" SWORD InjTime_us 1 100 -32768.00 32767.00 FORMAT "%8.2" ECU_ADDRESS 0x7F8F2E /end MEASUREMENT
/begin MEASUREMENT InjCrv_tiPiI1ETNoCor_mp "geschätzte Ansteuerdauer der PiI1 ohne Korrekturen" SWORD InjTime_us 1 100 -32768.00 32767.00 FORMAT "%8.2" ECU_ADDRESS 0x8FF62A /end MEASUREMENT
/begin MEASUREMENT InjCrv_tiPiI1ETSCor12_mp "motortemperaturabhängiger Korrekturgrundwert für die Zeitkomponente des Ansteuerbeginns der PiI1 bei inaktiver PiI2" SWORD InjTime_us 1 100 -32768.00 32767.00 FORMAT "%8.2" ECU_ADDRESS 0x8FF66E /end MEASUREMENT
/begin MEASUREMENT InjCrv_tiPiI1ETSCor1_mp "motortemperaturabhängiger Korrekturgrundwert -1 für die Zeitkomponente Ansteuerbeginn PiI1" SWORD InjTime_us 1 100 -32768.00 32767.00 FORMAT "%8.2" ECU_ADDRESS 0x8FF670 /end MEASUREMENT
/begin MEASUREMENT InjCrv_tiPiI1ETSCor2_mp "motortemperaturabhängiger Korrekturgrundwert -2 für die Zeitkomponente Ansteuerbeginn PiI1" SWORD InjTime_us 1 100 -32768.00 32767.00 FORMAT "%8.2" ECU_ADDRESS 0x8FF672 /end MEASUREMENT
/begin MEASUREMENT InjCrv_tiPiI1ETSCorStrt_mp "motortemperaturabhängiger Korrekturgrundwert für die Zeitkomponente des Ansteuerbeginns der PiI1 bei inaktiver PiI2 im Startzust" SWORD InjTime_us 1 100 -32768.00 32767.00 FORMAT "%8.2" ECU_ADDRESS 0x8FF674 /end MEASUREMENT
/begin MEASUREMENT InjCrv_tiPiI1ETSCor_mp "motortemperaturabhängiger Korrekturgrundwert für die Zeitkomponente des Ansteuerbeginns der PiI1" SWORD InjTime_us 1 100 -32768.00 32767.00 FORMAT "%8.2" ECU_ADDRESS 0x8FF676 /end MEASUREMENT
/begin MEASUREMENT InjCrv_tiPiI1ET_mp "geschätzte Ansteuerdauer der PiI1" SWORD InjTime_us 1 100 -32768.00 32767.00 FORMAT "%8.2" ECU_ADDRESS 0x8FF62C /end MEASUREMENT
/begin MEASUREMENT InjCrv_tiPiI1Hyd_mp "Zeitkomponente Ansteuerbeginn PiI1 für die Berechnung des Ansteuerbeginns der PiI2" SWORD InjTime_us 1 100 -32768.00 32767.00 FORMAT "%8.2" ECU_ADDRESS 0x8FF62E /end MEASUREMENT
/begin MEASUREMENT InjCrv_tiPiI1Min_mp "Minimaler Zeitanteil für PiI1 relativ zur MI" SWORD InjTime_us 1 100 -32768.00 32767.00 FORMAT "%8.2" ECU_ADDRESS 0x8FF630 /end MEASUREMENT
/begin MEASUREMENT InjCrv_tiPiI1RelMI1_mp "Zeitkomponente Ansteuerbeginn PiI1 relativ zur MI1" SWORD InjTime_us 1 100 -32768.00 32767.00 FORMAT "%8.2" ECU_ADDRESS 0x8FF632 /end MEASUREMENT
/begin MEASUREMENT InjCrv_tiPiI1RelTot_mp "Ansteuerbeginnabstand PiI1 aus Winkel- und Zeitkomponente" SWORD InjTime_us 1 100 -32768.00 32767.00 FORMAT "%8.2" ECU_ADDRESS 0x8FF634 /end MEASUREMENT
/begin MEASUREMENT InjCrv_tiPiI1Rel_mp "Zeitkomponente Ansteuerbeginn PiI1 relativ zur MI" SWORD InjTime_us 1 100 -32768.00 32767.00 FORMAT "%8.2" ECU_ADDRESS 0x8FF636 /end MEASUREMENT
/begin MEASUREMENT InjCrv_tiPiI1Rgn "Regenerationswert für die  Zeitkomponente des Ansteuerbeginns der PiI1" SWORD InjTime_us 1 100 -32768.00 32767.00 FORMAT "%8.2" ECU_ADDRESS 0x7F8F30 /end MEASUREMENT
/begin MEASUREMENT InjCrv_tiPiI1RgnByp_mp "Messpunkt für Bypass" SWORD InjTime_us 1 100 -32768.00 32767.00 FORMAT "%8.2" ECU_ADDRESS 0x8FF67C /end MEASUREMENT
/begin MEASUREMENT InjCrv_tiPiI1Tot_mp "gesamte Ansteuerdauer der Pil1" SWORD InjTime_us 1 100 -32768.00 32767.00 FORMAT "%8.2" ECU_ADDRESS 0x8FF638 /end MEASUREMENT
/begin MEASUREMENT InjCrv_tiPiI2APSCorStrt_mp "Messpunkt für die luftdruckabhängige Korrektur des Timings der 2. Voreinspritzung während des Startvorganges" SWORD InjTime_us 1 100 -32768.00 32767.00 FORMAT "%8.2" ECU_ADDRESS 0x8FF5E6 /end MEASUREMENT
/begin MEASUREMENT InjCrv_tiPiI2APSCor_mp "kundenspez. atmosphärendruckabhängiger Korrekturgrundwert für die Zeitkomponente des Ansteuerbeginns der PiI2" SWORD InjTime_us 1 100 -32768.00 32767.00 FORMAT "%8.2" ECU_ADDRESS 0x8FF5E8 /end MEASUREMENT
/begin MEASUREMENT InjCrv_tiPiI2BasStrt_mp "korrigierter Grundwert Zeitkomponente im Startzustand" SWORD InjTime_us 1 100 -32768.00 32767.00 FORMAT "%8.2" ECU_ADDRESS 0x8FF5F8 /end MEASUREMENT
/begin MEASUREMENT InjCrv_tiPiI2Bas_mp "Zeitkomponente Ansteuerbeginn PiI2 Grundwert" SWORD InjTime_us 1 100 -32768.00 32767.00 FORMAT "%8.2" ECU_ADDRESS 0x8FF5F4 /end MEASUREMENT
/begin MEASUREMENT InjCrv_tiPiI2CorRaw_mp "korrigierter Grundwert Zeitkomponente" SWORD InjTime_us 1 100 -32768.00 32767.00 FORMAT "%8.2" ECU_ADDRESS 0x8FF5C6 /end MEASUREMENT
/begin MEASUREMENT InjCrv_tiPiI2Cor_mp "korrigierter Grundwert der  Zeitkomponente Ansteuerbeginn PiI2" SWORD InjTime_us 1 100 -32768.00 32767.00 FORMAT "%8.2" ECU_ADDRESS 0x8FF5C8 /end MEASUREMENT
/begin MEASUREMENT InjCrv_tiPiI2Des "gewünschte Zeitkomponente für Ansteuerbeginn PiI2" SWORD InjTime_us 1 100 -32768.00 32767.00 FORMAT "%8.2" ECU_ADDRESS 0x7F8F34 /end MEASUREMENT
/begin MEASUREMENT InjCrv_tiPiI2DesByp_mp "Bypass-Label, Kopie von InjCrv_tiPiI2Des" SWORD InjTime_us 1 100 -32768.00 32767.00 FORMAT "%8.2" ECU_ADDRESS 0x8FF63A /end MEASUREMENT
/begin MEASUREMENT InjCrv_tiPiI2EnvCor "Korrekturzeit für PiI2" SWORD InjTime_us 1 100 -32768.00 32767.00 FORMAT "%8.2" ECU_ADDRESS 0x7F8F36 /end MEASUREMENT
/begin MEASUREMENT InjCrv_tiPiI2EnvCorStrt "Korrekturwerte der Umgebungszeit für Pil2 während Motorstart" SWORD InjTime_us 1 100 -32768.00 32767.00 FORMAT "%8.2" ECU_ADDRESS 0x7F8F38 /end MEASUREMENT
/begin MEASUREMENT InjCrv_tiPiI2ETSCor_mp "motortemperaturabhängiger Korrekturgrundwert für die Zeitkomponente des Ansteuerbeginns der PiI2" SWORD InjTime_us 1 100 -32768.00 32767.00 FORMAT "%8.2" ECU_ADDRESS 0x8FF5EA /end MEASUREMENT
/begin MEASUREMENT InjCrv_tiPiI2ET_mp "geschätzte Ansteuerdauer PiI2" SWORD InjTime_us 1 100 -32768.00 32767.00 FORMAT "%8.2" ECU_ADDRESS 0x8FF5CA /end MEASUREMENT
/begin MEASUREMENT InjCrv_tiPiI2RelMI_mp "Zeitkomponente Ansteuerbeginn PiI2 relaitv zur MI" SWORD InjTime_us 1 100 -32768.00 32767.00 FORMAT "%8.2" ECU_ADDRESS 0x8FF5CC /end MEASUREMENT
/begin MEASUREMENT InjCrv_tiPiI2RelPiI1_mp "Zeitkomponente Ansteuerbeginn PiI2 relativ zur PiI1" SWORD InjTime_us 1 100 -32768.00 32767.00 FORMAT "%8.2" ECU_ADDRESS 0x8FF5CE /end MEASUREMENT
/begin MEASUREMENT InjCrv_tiPiI2RelTot_mp "Ansteuerbeginnabstand PiI2 aus Winkel- und Zeitkomponente" SWORD InjTime_us 1 100 -32768.00 32767.00 FORMAT "%8.2" ECU_ADDRESS 0x8FF5D0 /end MEASUREMENT
/begin MEASUREMENT InjCrv_tiPiI2Rgn "Regenerationswert für die  Zeitkomponente des Ansteuerbeginns der PiI2" SWORD InjTime_us 1 100 -32768.00 32767.00 FORMAT "%8.2" ECU_ADDRESS 0x7F8F3A /end MEASUREMENT
/begin MEASUREMENT InjCrv_tiPiI2RgnByp_mp "Messpunkt für Bypass" SWORD InjTime_us 1 100 -32768.00 32767.00 FORMAT "%8.2" ECU_ADDRESS 0x8FF5F0 /end MEASUREMENT
/begin MEASUREMENT InjCrv_tiPiI2Tot_mp "gesamte Ansteuerdauer der Pil2" SWORD InjTime_us 1 100 -32768.00 32767.00 FORMAT "%8.2" ECU_ADDRESS 0x8FF5D2 /end MEASUREMENT
/begin MEASUREMENT InjCrv_tiPoI1ET "" SWORD InjTime_us 1 100 -32768.00 32767.00 FORMAT "%8.2" ECU_ADDRESS 0x7F8F3C /end MEASUREMENT
/begin MEASUREMENT InjCrv_tiPoI2AddCor "kundenspezifische Korrekturzeit für PoI2" SWORD InjTime_us 1 100 -32768.00 32767.00 FORMAT "%8.2" ECU_ADDRESS 0x7F8F3E /end MEASUREMENT
/begin MEASUREMENT InjCrv_tiPoI2ATSCor_mp "ansauglufttemperaturabhängiger Korrekturgrundwert für die Zeitkomponente des Ansteuerbeginns der PoI2" SWORD InjTime_us 1 100 -32768.00 32767.00 FORMAT "%8.2" ECU_ADDRESS 0x8FF6DE /end MEASUREMENT
/begin MEASUREMENT InjCrv_tiPoI2BasStrt_mp "" SWORD InjTime_us 1 100 -32768.00 32767.00 FORMAT "%8.2" ECU_ADDRESS 0x8FF742 /end MEASUREMENT
/begin MEASUREMENT InjCrv_tiPoI2Bas_mp "Zeitkomponente Ansteuerbeginn PoI2 Grundwert" SWORD InjTime_us 1 100 -32768.00 32767.00 FORMAT "%8.2" ECU_ADDRESS 0x8FF73C /end MEASUREMENT
/begin MEASUREMENT InjCrv_tiPoI2Byp_mp "Messpunkt für den Bypass" SWORD InjTime_us 1 100 -32768.00 32767.00 FORMAT "%8.2" ECU_ADDRESS 0x8FF730 /end MEASUREMENT
/begin MEASUREMENT InjCrv_tiPoI2Cor_mp "korrigierter Grundwert der Zeitkomponente Ansteuerbeginn PoI2" SWORD InjTime_us 1 100 -32768.00 32767.00 FORMAT "%8.2" ECU_ADDRESS 0x8FF732 /end MEASUREMENT
/begin MEASUREMENT InjCrv_tiPoI2Des "gewünschte Bezugszeitkomponente für Beginn PoI2" SWORD InjTime_us 1 100 -32768.00 32767.00 FORMAT "%8.2" ECU_ADDRESS 0x7F8F40 /end MEASUREMENT
/begin MEASUREMENT InjCrv_tiPoI2EnvCor "Korrekturzeit für PoI2" SWORD InjTime_us 1 100 -32768.00 32767.00 FORMAT "%8.2" ECU_ADDRESS 0x7F8F42 /end MEASUREMENT
/begin MEASUREMENT InjCrv_tiPoI2EnvCorStrt "Korrekturzeit für PoI2 im Startzustand" SWORD InjTime_us 1 100 -32768.00 32767.00 FORMAT "%8.2" ECU_ADDRESS 0x7F8F44 /end MEASUREMENT
/begin MEASUREMENT InjCrv_tiPoI2ETSCorStrt_mp "Motortemperaturabhängiges Korrekturgrundwerte für die Zeitkomponente des Ansteuerbeginns der PoI2 im Startzustand" SWORD InjTime_us 1 100 -32768.00 32767.00 FORMAT "%8.2" ECU_ADDRESS 0x8FF6E0 /end MEASUREMENT
/begin MEASUREMENT InjCrv_tiPoI2ETSCor_mp "motortemperaturabhängiger Korrekturgrundwert für die Zeitkomponente des Ansteuerbeginns der PoI2" SWORD InjTime_us 1 100 -32768.00 32767.00 FORMAT "%8.2" ECU_ADDRESS 0x8FF6E2 /end MEASUREMENT
/begin MEASUREMENT InjCrv_tiPoI2ET_mp "geschätzte Ansteuerdauer PoI2" SWORD InjTime_us 1 100 -32768.00 32767.00 FORMAT "%8.2" ECU_ADDRESS 0x8FF700 /end MEASUREMENT
/begin MEASUREMENT InjCrv_tiPoI2Max_mp "maximaler Ansteuerbeginn PoI2 relativ zur Haupteinspritzung" SWORD InjTime_us 1 100 -32768.00 32767.00 FORMAT "%8.2" ECU_ADDRESS 0x8FF734 /end MEASUREMENT
/begin MEASUREMENT InjCrv_tiPoI2RelTot_mp "Ansteuerbeginnabstand PoI2 aus Winkel- und Zeitkomponente" SWORD InjTime_us 1 100 -32768.00 32767.00 FORMAT "%8.2" ECU_ADDRESS 0x8FF736 /end MEASUREMENT
/begin MEASUREMENT InjCrv_tiPoI2Rel_mp "Zeitkomponente Ansteuerbeginn PoI2 relativ zur Haupteinspritzung" SWORD InjTime_us 1 100 -32768.00 32767.00 FORMAT "%8.2" ECU_ADDRESS 0x8FF738 /end MEASUREMENT
/begin MEASUREMENT InjCrv_tiPoI2Rgn "Grundwert der Zeitkomponente Ansteuerbeginn PoI2 im Regenerationsbetrieb" SWORD InjTime_us 1 100 -32768.00 32767.00 FORMAT "%8.2" ECU_ADDRESS 0x7F8F46 /end MEASUREMENT
/begin MEASUREMENT InjCrv_tiPoI2Rgn1_mp "corrected time component for PoI2 Regeneration 1" SWORD InjTime_us 1 100 -32768.00 32767.00 FORMAT "%8.2" ECU_ADDRESS 0x8FF716 /end MEASUREMENT
/begin MEASUREMENT InjCrv_tiPoI2Rgn2_mp "Corrected time component for PoI2 Regeneration 2" SWORD InjTime_us 1 100 -32768.00 32767.00 FORMAT "%8.2" ECU_ADDRESS 0x8FF718 /end MEASUREMENT
/begin MEASUREMENT InjCrv_tiPoI2RgnByp_mp "Messpunkt für Bypass" SWORD InjTime_us 1 100 -32768.00 32767.00 FORMAT "%8.2" ECU_ADDRESS 0x8FF71A /end MEASUREMENT
/begin MEASUREMENT InjCrv_tiPoI2RgnCor "correction value for PoI2 time" SWORD InjTime_us 1 100 -32768.00 32767.00 FORMAT "%8.2" ECU_ADDRESS 0x7F8F48 /end MEASUREMENT
/begin MEASUREMENT InjCrv_volPiI1Cor_mp "korrigiertes Einspritzvolumen zur Ansteuerdauerabschätzung der PiI1" SWORD InjQntInj 1 100 -327.6800 327.6700 FORMAT "%8.4" ECU_ADDRESS 0x8FF63C /end MEASUREMENT
/begin MEASUREMENT InjCrv_volPiI1NoCor_mp "Einspritzvolumen ohne Korrekturen zur Ansteuerdauerabschätzung der PiI1" SWORD InjQntInj 1 100 -327.6800 327.6700 FORMAT "%8.4" ECU_ADDRESS 0x8FF63E /end MEASUREMENT
/begin MEASUREMENT InjCrv_volPiI1_mp "begrenztes Einspritzvolumen PiI1" SWORD InjQntInj 1 100 -327.6800 327.6700 FORMAT "%8.4" ECU_ADDRESS 0x8FF640 /end MEASUREMENT
/begin MEASUREMENT InjCrv_volPiI2Cor_mp "korrigiertes Einspritzvolumen zur Ansteuerdauerabschätzung der PiI2" SWORD InjQntInj 1 100 -327.6800 327.6700 FORMAT "%8.4" ECU_ADDRESS 0x8FF5D4 /end MEASUREMENT
/begin MEASUREMENT InjCrv_volPiI2_mp "begrenztes Einspritzvolumen PiI2" SWORD InjQntInj 1 100 -327.6800 327.6700 FORMAT "%8.4" ECU_ADDRESS 0x8FF5D6 /end MEASUREMENT
/begin MEASUREMENT InjCrv_volPoI1_mp "begrenztes Einspritzvolumen PoI1" SWORD InjQntInj 1 100 -327.6800 327.6700 FORMAT "%8.4" ECU_ADDRESS 0x8FF6AA /end MEASUREMENT
/begin MEASUREMENT InjCrv_volPoI2_mp "begrenztes Einspritzvolumen PoI2" SWORD InjQntInj 1 100 -327.6800 327.6700 FORMAT "%8.4" ECU_ADDRESS 0x8FF702 /end MEASUREMENT
/begin FUNCTION injcrv_pii2envcorti ""
 /begin DEF_CHARACTERISTIC InjCrv_tiPiI2APSCorStrt_MAP InjCrv_tiPiI2APSCor_MAP InjCrv_tiPiI2ETSCorStrt_MAP InjCrv_tiPiI2ETSCor_MAP /end DEF_CHARACTERISTIC
 /begin IN_MEASUREMENT Eng_nAvrg InjCtl_qSetUnBal /end IN_MEASUREMENT
/end FUNCTION
/begin FUNCTION injcrv_pii2envcorti_uic ""
 /begin OUT_MEASUREMENT InjCrv_tiPiI2APSCorStrt_mp InjCrv_tiPiI2APSCor_mp InjCrv_tiPiI2ETSCor_mp /end OUT_MEASUREMENT
/end FUNCTION
/begin FUNCTION injcrv_pii2envcor_msg ""
 /begin OUT_MEASUREMENT InjCrv_phiPiI2EnvCor InjCrv_qPiI2EnvCor InjCrv_qPiI2EnvCorStrt InjCrv_tiPiI2EnvCor InjCrv_tiPiI2EnvCorStrt /end OUT_MEASUREMENT
/end FUNCTION
/begin FUNCTION injcrv_pii2envcor_uic ""
 /begin OUT_MEASUREMENT InjCrv_qPiI2APSCorStrt_mp InjCrv_qPiI2APSCor_mp InjCrv_qPiI2ATSCorStrt_mp InjCrv_qPiI2ATSCor_mp InjCrv_qPiI2ETSCorStrt_mp InjCrv_qPiI2ETSCor_mp /end OUT_MEASUREMENT
/end FUNCTION
/begin FUNCTION injcrv_pii2rgn "Voreinspritzung 2, Regenerationswertberechnung" /end FUNCTION
/begin FUNCTION injcrv_pii2rgnlib "Funktionsbibliothek für die Regenerationsumschaltung der Voreinspritzung 2"
 /begin DEF_CHARACTERISTIC InjCrv_dtiPiI2RgnRmpUp_C InjCrv_dtiPiI2RgnRmpDwn_C InjCrv_stPiI2RgnMsk_C /end DEF_CHARACTERISTIC
/end FUNCTION
/begin FUNCTION injcrv_pii2rgn_msg "" /begin OUT_MEASUREMENT InjCrv_phiPiI2Rgn InjCrv_qPiI2Rgn InjCrv_tiPiI2Rgn /end OUT_MEASUREMENT /end FUNCTION
/begin FUNCTION injcrv_pii2rgn_uic ""
 /begin DEF_CHARACTERISTIC InjCrv_phiPiI2RgnAdd_Vector InjCrv_phiPiI2RgnAdd_Channel InjCrv_phiPiI2Rgn_Vector InjCrv_phiPiI2Rgn_Channel InjCrv_qPiI2RgnAdd_Vector InjCrv_qPiI2RgnAdd_Channel InjCrv_qPiI2Rgn_Vector InjCrv_qPiI2Rgn_Channel InjCrv_tiPiI2RgnAdd_Vector InjCrv_tiPiI2RgnAdd_Channel InjCrv_tiPiI2Rgn_Vector InjCrv_tiPiI2Rgn_Channel /end DEF_CHARACTERISTIC
 /begin OUT_MEASUREMENT InjCrv_phiPiI2RgnByp_mp InjCrv_qPiI2RgnByp_mp InjCrv_tiPiI2RgnByp_mp /end OUT_MEASUREMENT
/end FUNCTION
/begin FUNCTION injcrv_pii2rmtctl_uic "" /end FUNCTION
/begin FUNCTION injcrv_pii2soephibas "" /end FUNCTION
/begin FUNCTION injcrv_pii2soephibas_uic "" /begin OUT_MEASUREMENT InjCrv_phiPiI2Bas_mp /end OUT_MEASUREMENT /end FUNCTION
/begin FUNCTION injcrv_pii2soetibas "" /begin DEF_CHARACTERISTIC InjCrv_tiPiI2Bas_MAP /end DEF_CHARACTERISTIC /begin IN_MEASUREMENT Eng_nAvrg InjCtl_qSetUnBal /end IN_MEASUREMENT /end FUNCTION
/begin FUNCTION injcrv_pii2soetibas_uic "" /begin OUT_MEASUREMENT InjCrv_tiPiI2Bas_mp /end OUT_MEASUREMENT /end FUNCTION
/begin FUNCTION injcrv_pii2strt "Einspitzverlaufsbestimmung Voreinspritzung 2 während Start" /begin DEF_CHARACTERISTIC InjCrv_qPiI2BasStrt_MAP InjCrv_tiPiI2BasStrt_MAP /end DEF_CHARACTERISTIC /begin IN_MEASUREMENT Eng_nAvrg InjCtl_qSetUnBal /end IN_MEASUREMENT /end FUNCTION
/begin FUNCTION injcrv_pii2strt_uic "" /begin OUT_MEASUREMENT InjCrv_qPiI2BasStrt_mp InjCrv_tiPiI2BasStrt_mp /end OUT_MEASUREMENT /end FUNCTION
/begin FUNCTION injcrv_pii2_msg "" /begin OUT_MEASUREMENT InjCrv_stPiI2 /end OUT_MEASUREMENT /end FUNCTION
/begin FUNCTION injcrv_pii2_uic "" /begin DEF_CHARACTERISTIC InjCrv_qPiI2SetByp_Vector InjCrv_qPiI2SetByp_Channel /end DEF_CHARACTERISTIC
 /begin OUT_MEASUREMENT InjCrv_facPiI2QntMin_mp InjCrv_phiPiI2AbsTot_mp InjCrv_phiPiI2Abs_mp InjCrv_phiPiI2Cor_mp InjCrv_phiPiI2Rel_mp InjCrv_qMI1MinPiI2_mp InjCrv_qPiI2Bas_mp InjCrv_qPiI2Max_mp InjCrv_qPiI2SetLimMax_mp InjCrv_qPiI2SetLim_mp InjCrv_qPiI2SetRaw_mp InjCrv_qPiI2Set_mp InjCrv_tiPiI2CorRaw_mp InjCrv_tiPiI2Cor_mp InjCrv_tiPiI2ET_mp InjCrv_tiPiI2RelMI_mp InjCrv_tiPiI2RelPiI1_mp InjCrv_tiPiI2RelTot_mp InjCrv_tiPiI2Tot_mp InjCrv_volPiI2Cor_mp InjCrv_volPiI2_mp /end OUT_MEASUREMENT
/end FUNCTION
/begin FUNCTION injcrv_pii3 "Berechnung von Menge und Ansteuerbeginn von Voreinspritzung 3" /end FUNCTION
/begin FUNCTION injcrv_pii3addcor "Calculation of customer specific correction values for pilot injection 3." /end FUNCTION
/begin FUNCTION injcrv_pii3addcor_msg "" /end FUNCTION
/begin FUNCTION injcrv_pii3addcor_uic "" /end FUNCTION
/begin FUNCTION injcrv_pii3envcor "Voreinspritzung 3 Korrektur durch Umweltbedingungen" /end FUNCTION
/begin FUNCTION injcrv_pii3envcorslow "" /end FUNCTION
/begin FUNCTION injcrv_pii3envcorslow_msg "" /end FUNCTION
/begin FUNCTION injcrv_pii3envcorslow_uic "" /end FUNCTION
/begin FUNCTION injcrv_pii3envcor_msg "" /end FUNCTION
/begin FUNCTION injcrv_pii3envcor_uic "" /end FUNCTION
/begin FUNCTION injcrv_pii3rgnlib "" /end FUNCTION
/begin FUNCTION injcrv_pii3rgn_msg "" /end FUNCTION
/begin FUNCTION injcrv_pii3rgn_uic "" /end FUNCTION
/begin FUNCTION injcrv_pii3rmtctl_uic "" /end FUNCTION
/begin FUNCTION injcrv_pii3strt "Calculation of start of energizing and injection quantity with engine in startup mode" /end FUNCTION
/begin FUNCTION injcrv_pii3strt_uic "" /end FUNCTION
/begin FUNCTION injcrv_pii3_uic "" /end FUNCTION
/begin FUNCTION injcrv_piiaddcor "Voreinspritzung - projektspezifische Korrektur"
 /begin DEF_CHARACTERISTIC InjCrv_facDQPiI1DynCor_CUR InjCrv_facDQPiI1DynQCor_CUR InjCrv_facPiI1ChamWllTempCorr_MAP InjCrv_facqPiI1ChamWllTempCorr_MAP InjCrv_qPiI1ChamWllTempCorr_MAP InjCrv_qPiI1DynQCor_MAP InjCrv_tiPiI1ChamWllTempCorr_MAP InjCrv_tiPiI1DynCor_MAP /end DEF_CHARACTERISTIC
 /begin IN_MEASUREMENT Eng_nAvrg Eng_tEng InjCrv_dqSetUnBalFltLim InjCtl_qSetUnBal Layer_tChamWll /end IN_MEASUREMENT
/end FUNCTION
/begin FUNCTION injcrv_piiaddcorphi "" /end FUNCTION
/begin FUNCTION injcrv_piiaddcorphi_uic "" /end FUNCTION
/begin FUNCTION injcrv_piiaddcorslow "Gewichtungsfaktor für projektspezifische Korrektur der PiI1"
 /begin DEF_CHARACTERISTIC InjCrv_facAPPiI1DynCor_CUR InjCrv_facAPPiI1DynQCor_CUR InjCrv_facETPiI1DynCor_CUR InjCrv_facETPiI1DynQCor_CUR InjCrv_facIAPiI1DynCor_CUR InjCrv_facPiI1ATSSOECor_CUR /end DEF_CHARACTERISTIC
 /begin IN_MEASUREMENT APSCD_pVal IATSCD_tAir InjCrv_tEng /end IN_MEASUREMENT
/end FUNCTION
/begin FUNCTION injcrv_piiaddcorslow_msg ""
 /begin OUT_MEASUREMENT InjCrv_facPiI1ATSSOECor InjCrv_facPiI1DynQCor InjCrv_facPiI1DynSOECor /end OUT_MEASUREMENT
/end FUNCTION
/begin FUNCTION injcrv_piiaddcorslow_uic ""
 /begin OUT_MEASUREMENT InjCrv_facAPPiI1DynCor_mp InjCrv_facAPPiI1DynQCor_mp InjCrv_facETPiI1DynCor_mp InjCrv_facETPiI1DynQCor_mp /end OUT_MEASUREMENT
/end FUNCTION
/begin FUNCTION injcrv_piiaddcorti "" /begin DEF_CHARACTERISTIC InjCrv_tiPiI1ATSCor_MAP /end DEF_CHARACTERISTIC /begin IN_MEASUREMENT Eng_nAvrg InjCtl_qSetUnBal /end IN_MEASUREMENT /end FUNCTION
/begin FUNCTION injcrv_piiaddcorti_uic "" /begin OUT_MEASUREMENT InjCrv_tiPiI1ATSCor_mp /end OUT_MEASUREMENT /end FUNCTION
/begin FUNCTION injcrv_piiaddcor_msg ""
 /begin OUT_MEASUREMENT InjCrv_phiPiI1AddCor InjCrv_phiPiI1AddCor2 InjCrv_qPiI1AddCor InjCrv_qPiI1AddCor2 InjCrv_tiPiI1AddCor InjCrv_tiPiI1AddCor2 /end OUT_MEASUREMENT
/end FUNCTION
/begin FUNCTION injcrv_piiaddcor_uic ""
 /begin OUT_MEASUREMENT InjCrv_facDQPiI1DynCor_mp InjCrv_facDQPiI1DynQCor_mp InjCrv_qPiI1ChamWllTempCorr_mp InjCrv_qPiI1DynCor_mp InjCrv_tiPiI1ChamWllTempCorr_mp InjCrv_tiPiI1DynCor_mp /end OUT_MEASUREMENT
/end FUNCTION
/begin FUNCTION injcrv_piienvcor "Voreinspritzung - Umwelt -Korrekturen"
 /begin DEF_CHARACTERISTIC InjCrv_qPiI1APSCor2_MAP InjCrv_qPiI1APSCorStrt_MAP InjCrv_qPiI1APSCor_MAP InjCrv_qPiI1APSCor_X_AXIS InjCrv_qPiI1APSCor_Y_AXIS InjCrv_qPiI1ATSCor2_MAP InjCrv_qPiI1ATSCorStrt_MAP InjCrv_qPiI1ATSCor_MAP InjCrv_qPiI1ATSCor_X_AXIS InjCrv_qPiI1ATSCor_Y_AXIS InjCrv_qPiI1ETSCor12_MAP InjCrv_qPiI1ETSCor1_MAP InjCrv_qPiI1ETSCor1_X_AXIS InjCrv_qPiI1ETSCor1_Y_AXIS InjCrv_qPiI1ETSCor2_MAP InjCrv_qPiI1ETSCorStrt_MAP InjCrv_qPiI1ETSCor_MAP InjCrv_qPiI1ETSCor_X_AXIS InjCrv_qPiI1ETSCor_Y_AXIS /end DEF_CHARACTERISTIC
 /begin IN_MEASUREMENT Eng_nAvrg InjCtl_qSetUnBal /end IN_MEASUREMENT
/end FUNCTION
/begin FUNCTION injcrv_piienvcorrgn "Haupteinspritzung - Umwelt - Gewichtungsfaktoren für den Regenerationsbetrieb" /end FUNCTION
/begin FUNCTION injcrv_piienvcorrgn_msg "" /end FUNCTION
/begin FUNCTION injcrv_piienvcorrgn_uic "" /end FUNCTION
/begin FUNCTION injcrv_piienvcorslow "Berechnung der Gewichtungsfunktionen für die Voreinspritzung"
 /begin DEF_CHARACTERISTIC InjCrv_facPiI1APSQCor2Strt_CUR InjCrv_facPiI1APSQCor2_CUR InjCrv_facPiI1APSQCorStrt_CUR InjCrv_facPiI1APSQCor_AXIS InjCrv_facPiI1APSQCor_CUR InjCrv_facPiI1ATSQCor2Strt_CUR InjCrv_facPiI1ATSQCor2_CUR InjCrv_facPiI1ATSQCorStrt_CUR InjCrv_facPiI1ATSQCor_AXIS InjCrv_facPiI1ATSQCor_CUR InjCrv_facPiI1ETSQCor12_CUR InjCrv_facPiI1ETSQCor1_AXIS InjCrv_facPiI1ETSQCor1_CUR InjCrv_facPiI1ETSQCor2Strt_CUR InjCrv_facPiI1ETSQCor2_CUR InjCrv_facPiI1ETSQCorStrt_CUR InjCrv_facPiI1ETSQCor_AXIS InjCrv_facPiI1ETSQCor_CUR InjCrv_facPiI1ETSSOECor12_CUR InjCrv_facPiI1ETSSOECor1_AXIS InjCrv_facPiI1ETSSOECor1_CUR InjCrv_facPiI1ETSSOECor2_CUR InjCrv_facPiI1ETSSOECorStrt_CUR InjCrv_facPiI1ETSSOECor_AXIS InjCrv_facPiI1ETSSOECor_CUR /end DEF_CHARACTERISTIC
 /begin IN_MEASUREMENT APSCD_pVal IATSCD_tAir InjCrv_tEng /end IN_MEASUREMENT
/end FUNCTION
/begin FUNCTION injcrv_piienvcorslowrgn "Voreinspritzung - Umwelt - Gewichtungsfaktoren für den Regenerationsbetrieb" /end FUNCTION
/begin FUNCTION injcrv_piienvcorslowrgn_msg "" /end FUNCTION
/begin FUNCTION injcrv_piienvcorslowrgn_uic "" /end FUNCTION
/begin FUNCTION injcrv_piienvcorslow_msg ""
 /begin OUT_MEASUREMENT InjCrv_facPiI1APSQCor InjCrv_facPiI1APSQCor2 InjCrv_facPiI1APSQCorStrt InjCrv_facPiI1ATSQCor InjCrv_facPiI1ATSQCor2 InjCrv_facPiI1ATSQCorStrt InjCrv_facPiI1ETSQCor InjCrv_facPiI1ETSQCor1 InjCrv_facPiI1ETSQCor12 InjCrv_facPiI1ETSQCor2 InjCrv_facPiI1ETSQCorStrt InjCrv_facPiI1ETSSOECor InjCrv_facPiI1ETSSOECor1 InjCrv_facPiI1ETSSOECor12 InjCrv_facPiI1ETSSOECor2 InjCrv_facPiI1ETSSOECorStrt /end OUT_MEASUREMENT
/end FUNCTION
/begin FUNCTION injcrv_piienvcorslow_uic "" /end FUNCTION
/begin FUNCTION injcrv_piienvcorti ""
 /begin DEF_CHARACTERISTIC InjCrv_tiPiI1ETSCor12_MAP InjCrv_tiPiI1ETSCor1_MAP InjCrv_tiPiI1ETSCor2_MAP InjCrv_tiPiI1ETSCorStrt_MAP InjCrv_tiPiI1ETSCor_MAP /end DEF_CHARACTERISTIC
 /begin IN_MEASUREMENT Eng_nAvrg InjCtl_qSetUnBal /end IN_MEASUREMENT
/end FUNCTION
/begin FUNCTION injcrv_piienvcorti_uic ""
 /begin OUT_MEASUREMENT InjCrv_tiPiI1ETSCor12_mp InjCrv_tiPiI1ETSCor1_mp InjCrv_tiPiI1ETSCor2_mp InjCrv_tiPiI1ETSCorStrt_mp InjCrv_tiPiI1ETSCor_mp /end OUT_MEASUREMENT
/end FUNCTION
/begin FUNCTION injcrv_piienvcor_msg ""
 /begin OUT_MEASUREMENT InjCrv_phiPiI1EnvCor InjCrv_phiPiI1EnvCor2 InjCrv_qPiI1EnvCor InjCrv_qPiI1EnvCor2 InjCrv_qPiI1EnvCorStrt InjCrv_tiPiI1EnvCor InjCrv_tiPiI1EnvCor2 InjCrv_tiPiI1EnvCorStrt /end OUT_MEASUREMENT
/end FUNCTION
/begin FUNCTION injcrv_piienvcor_uic ""
 /begin OUT_MEASUREMENT InjCrv_qPiI1APSCor2_mp InjCrv_qPiI1APSCorStrt_mp InjCrv_qPiI1APSCor_mp InjCrv_qPiI1ATSCor2_mp InjCrv_qPiI1ATSCorStrt_mp InjCrv_qPiI1ATSCor_mp InjCrv_qPiI1ETSCor12_mp InjCrv_qPiI1ETSCor1_mp InjCrv_qPiI1ETSCor2_mp InjCrv_qPiI1ETSCorStrt_mp InjCrv_qPiI1ETSCor_mp /end OUT_MEASUREMENT
/end FUNCTION
/begin FUNCTION injcrv_piirgn "Voreinspritzung 1, Regenerationswertberechnung"
 /begin DEF_CHARACTERISTIC InjCrv_phiPiI1Rgn_MAP InjCrv_qPiI1Rgn_MAP InjCrv_tiPiI1Rgn_MAP /end DEF_CHARACTERISTIC
 /begin IN_MEASUREMENT Eng_nAvrg InjCtl_qSetUnBal /end IN_MEASUREMENT
/end FUNCTION
/begin FUNCTION injcrv_piirgnlib "Funktionsbibliothek für die Regenerationsumschaltung der Voreinspritzung 1"
 /begin DEF_CHARACTERISTIC InjCrv_dtiPiI1RgnRmpUp_C InjCrv_dtiPiI1RgnRmpDwn_C InjCrv_stPiI1RgnMsk_C /end DEF_CHARACTERISTIC
/end FUNCTION
/begin FUNCTION injcrv_piirgn_msg "" /begin OUT_MEASUREMENT InjCrv_phiPiI1Rgn InjCrv_qPiI1Rgn InjCrv_tiPiI1Rgn /end OUT_MEASUREMENT /end FUNCTION
/begin FUNCTION injcrv_piirgn_uic ""
 /begin DEF_CHARACTERISTIC InjCrv_phiPiI1RgnAdd_Vector InjCrv_phiPiI1RgnAdd_Channel InjCrv_phiPiI1Rgn_Vector InjCrv_phiPiI1Rgn_Channel InjCrv_qPiI1RgnAdd_Vector InjCrv_qPiI1RgnAdd_Channel InjCrv_qPiI1Rgn_Vector InjCrv_qPiI1Rgn_Channel InjCrv_tiPiI1RgnAdd_Vector InjCrv_tiPiI1RgnAdd_Channel InjCrv_tiPiI1Rgn_Vector InjCrv_tiPiI1Rgn_Channel /end DEF_CHARACTERISTIC
 /begin OUT_MEASUREMENT InjCrv_phiPiI1RgnByp_mp InjCrv_qPiI1RgnByp_mp InjCrv_tiPiI1RgnByp_mp /end OUT_MEASUREMENT
/end FUNCTION
/begin FUNCTION injcrv_piirmtctl_uic "" /end FUNCTION
/begin FUNCTION injcrv_pii_msg ""
 /begin OUT_MEASUREMENT InjCrv_phiPiI1Des InjCrv_phiPiI2Des InjCrv_phiPiI3Des InjCrv_qPiI1Des InjCrv_qPiI2Des InjCrv_qPiI3Des InjCrv_tiPiI1Des InjCrv_tiPiI2Des /end OUT_MEASUREMENT
/end FUNCTION
/begin FUNCTION injcrv_pii_uic ""
 /begin DEF_CHARACTERISTIC InjCrv_phiPiI1DesAdd_Vector InjCrv_phiPiI1DesAdd_Channel InjCrv_phiPiI1Des_Vector InjCrv_phiPiI1Des_Channel InjCrv_phiPiI2DesAdd_Vector InjCrv_phiPiI2DesAdd_Channel InjCrv_phiPiI2Des_Vector InjCrv_phiPiI2Des_Channel InjCrv_phiPiI3DesAdd_Vector InjCrv_phiPiI3DesAdd_Channel InjCrv_phiPiI3Des_Vector InjCrv_phiPiI3Des_Channel InjCrv_qPiI1DesAdd_Vector InjCrv_qPiI1DesAdd_Channel InjCrv_qPiI1Des_Vector InjCrv_qPiI1Des_Channel InjCrv_qPiI1SetByp_Vector InjCrv_qPiI1SetByp_Channel InjCrv_qPiI2DesAdd_Vector InjCrv_qPiI2DesAdd_Channel InjCrv_qPiI2Des_Vector InjCrv_qPiI2Des_Channel InjCrv_qPiI3DesAdd_Vector InjCrv_qPiI3DesAdd_Channel InjCrv_qPiI3Des_Vector InjCrv_qPiI3Des_Channel InjCrv_tiPiI1DesAdd_Vector InjCrv_tiPiI1DesAdd_Channel InjCrv_tiPiI1Des_Vector InjCrv_tiPiI1Des_Channel InjCrv_tiPiI2DesAdd_Vector InjCrv_tiPiI2DesAdd_Channel InjCrv_tiPiI2Des_Vector InjCrv_tiPiI2Des_Channel /end DEF_CHARACTERISTIC
 /begin OUT_MEASUREMENT InjCrv_facPiI1QntMin_mp InjCrv_phiPiI1AbsTot_mp InjCrv_phiPiI1Abs_mp InjCrv_phiPiI1Cor_mp InjCrv_phiPiI1DesByp_mp InjCrv_phiPiI1Rel_mp InjCrv_phiPiI2DesByp_mp InjCrv_phiPiI3DesByp_mp InjCrv_qMI1MinPiI1_mp InjCrv_qPiI1Bas_mp InjCrv_qPiI1DesByp_mp InjCrv_qPiI1Max_mp InjCrv_qPiI1SetLimMax_mp InjCrv_qPiI1SetLim_mp InjCrv_qPiI1SetRaw_mp InjCrv_qPiI1Set_mp InjCrv_qPiI2DesByp_mp InjCrv_qPiI3DesByp_mp InjCrv_qPiIMin_mp InjCrv_stPiI1_mp InjCrv_tiPiI1CorRaw_mp InjCrv_tiPiI1Cor_mp InjCrv_tiPiI1DesByp_mp InjCrv_tiPiI1ETNoCor_mp InjCrv_tiPiI1ET_mp InjCrv_tiPiI1Hyd_mp InjCrv_tiPiI1Min_mp InjCrv_tiPiI1RelMI1_mp InjCrv_tiPiI1RelTot_mp InjCrv_tiPiI1Rel_mp InjCrv_tiPiI1Tot_mp InjCrv_tiPiI2DesByp_mp InjCrv_volPiI1Cor_mp InjCrv_volPiI1NoCor_mp InjCrv_volPiI1_mp /end OUT_MEASUREMENT
/end FUNCTION
/begin FUNCTION injcrv_poi1 "Einspritzverlauf - Nacheinspritzung 1"
 /begin DEF_CHARACTERISTIC InjCrv_facPoI1Eff_MAP InjCrv_phiDynOfs_CUR InjCrv_phiPoI1Bas_MAP InjCrv_phiPoI1Max_C InjCrv_qPoI1Bas_MAP InjCrv_qPoI1SetLim_C /end DEF_CHARACTERISTIC
 /begin IN_MEASUREMENT Eng_nAvrg InjCtl_qSetUnBal /end IN_MEASUREMENT
/end FUNCTION
/begin FUNCTION injcrv_poi1addcor "Nacheinspritzung 1 - projektspezifische Korrekturen" /end FUNCTION
/begin FUNCTION injcrv_poi1addcor_msg ""
 /begin OUT_MEASUREMENT InjCrv_phiPoI1AddCor InjCrv_POpPoI1AddCor InjCrv_qPoI1AddCor /end OUT_MEASUREMENT
/end FUNCTION
/begin FUNCTION injcrv_poi1addcor_uic "" /end FUNCTION
/begin FUNCTION injcrv_poi1envcor "Nacheinspritzung 1 - Umwelt- Korrekturen (20 ms task)"
 /begin DEF_CHARACTERISTIC InjCrv_phiPoI1ETSCor_MAP InjCrv_qPoI1APSCor_MAP InjCrv_qPoI1ETSCor_MAP /end DEF_CHARACTERISTIC
 /begin IN_MEASUREMENT Eng_nAvrg InjCtl_qSetUnBal /end IN_MEASUREMENT
/end FUNCTION
/begin FUNCTION injcrv_poi1envcorslow "Nacheinspritzung 1 - Umwelt- Korrekturen (100ms task)"
 /begin DEF_CHARACTERISTIC InjCrv_facPoI1APSQCor_CUR InjCrv_facPoI1ETSPhiCor_CUR InjCrv_facPoI1ETSQCor_CUR InjCrv_POpPoI1ETSCor_CUR /end DEF_CHARACTERISTIC
 /begin IN_MEASUREMENT APSCD_pVal InjCrv_tEng /end IN_MEASUREMENT
/end FUNCTION
/begin FUNCTION injcrv_poi1envcorslow_msg ""
 /begin OUT_MEASUREMENT InjCrv_facPoI1APSQCor InjCrv_facPoI1ETSPhiCor InjCrv_facPoI1ETSQCor InjCrv_POpPoI1EnvCor /end OUT_MEASUREMENT
/end FUNCTION
/begin FUNCTION injcrv_poi1envcorslow_uic "" /end FUNCTION
/begin FUNCTION injcrv_poi1envcor_msg "" /begin OUT_MEASUREMENT InjCrv_phiPoI1EnvCor InjCrv_qPoI1EnvCor /end OUT_MEASUREMENT /end FUNCTION
/begin FUNCTION injcrv_poi1envcor_uic "" /begin OUT_MEASUREMENT InjCrv_qPoI1APSCor_mp InjCrv_qPoI1ETSCor_mp /end OUT_MEASUREMENT /end FUNCTION
/begin FUNCTION injcrv_poi1rgn "Regenerationswertberechnung der PoI1"
 /begin DEF_CHARACTERISTIC InjCrv_facPoI1Eff1_MAP InjCrv_facPoI1Eff2_MAP InjCrv_phiPoI1Rgn1_MAP InjCrv_phiPoI1Rgn2_MAP InjCrv_qPoI1Rgn1_MAP InjCrv_qPoI1Rgn2_MAP /end DEF_CHARACTERISTIC
 /begin IN_MEASUREMENT Eng_nAvrg InjCtl_qSetUnBal /end IN_MEASUREMENT
/end FUNCTION
/begin FUNCTION injcrv_poi1rgnlib "Funktionbibliothek der Regenerationswetberechnung für PoI1"
 /begin DEF_CHARACTERISTIC InjCrv_dtiPoI1RgnRmpUp_C InjCrv_dtiPoI1RgnRmpDwn_C InjCrv_dtiPoI1RgnTypeRmpUp_C InjCrv_dtiPoI1RgnTypeRmpDwn_C InjCrv_stPoI1RgnMsk_C InjCrv_stPoI1RgnTypeMsk_C /end DEF_CHARACTERISTIC
/end FUNCTION
/begin FUNCTION injcrv_poi1rgn_msg ""
 /begin OUT_MEASUREMENT InjCrv_facPoI1EffRgn InjCrv_phiPoI1Rgn InjCrv_PoI1RgnTypeVal InjCrv_qPoI1Rgn /end OUT_MEASUREMENT
/end FUNCTION
/begin FUNCTION injcrv_poi1rgn_uic ""
 /begin DEF_CHARACTERISTIC InjCrv_phiPoI1RgnAdd_Vector InjCrv_phiPoI1RgnAdd_Channel InjCrv_phiPoI1Rgn_Vector InjCrv_phiPoI1Rgn_Channel InjCrv_qPoI1RgnAdd_Vector InjCrv_qPoI1RgnAdd_Channel InjCrv_qPoI1Rgn_Vector InjCrv_qPoI1Rgn_Channel /end DEF_CHARACTERISTIC
 /begin OUT_MEASUREMENT InjCrv_facPoI1EffRgn1_mp InjCrv_facPoI1EffRgn2_mp InjCrv_phiPoI1Rgn1_mp InjCrv_phiPoI1Rgn2_mp InjCrv_phiPoI1RgnByp_mp InjCrv_qPoI1Rgn1_mp InjCrv_qPoI1Rgn2_mp InjCrv_qPoI1RgnByp_mp /end OUT_MEASUREMENT
/end FUNCTION
/begin FUNCTION injcrv_poi1rls "Freigabe der PoI1"
 /begin DEF_CHARACTERISTIC InjCrv_POpPoI1Bas_MAP InjCrv_POpPoI1High_C InjCrv_POpPoI1Low_C /end DEF_CHARACTERISTIC
 /begin IN_MEASUREMENT Eng_nAvrg InjCtl_qSetUnBal /end IN_MEASUREMENT
/end FUNCTION
/begin FUNCTION injcrv_poi1rls_uic "" /begin OUT_MEASUREMENT InjCrv_POpPoI1Bas_mp InjCrv_POpPoI1_mp /end OUT_MEASUREMENT /end FUNCTION
/begin FUNCTION injcrv_poi1rmtctl_uic "" /end FUNCTION
/begin FUNCTION injcrv_poi1_msg ""
 /begin OUT_MEASUREMENT InjCrv_phiPoI1Des InjCrv_PoI1RgnVal InjCrv_qPoI1Des InjCrv_qPoI1Eff InjCrv_tiPoI1ET /end OUT_MEASUREMENT
/end FUNCTION
/begin FUNCTION injcrv_poi1_uic ""
 /begin DEF_CHARACTERISTIC InjCrv_phiPoI1DesAdd_Vector InjCrv_phiPoI1DesAdd_Channel InjCrv_phiPoI1Des_Vector InjCrv_phiPoI1Des_Channel InjCrv_qPoI1DesAdd_Vector InjCrv_qPoI1DesAdd_Channel InjCrv_qPoI1Des_Vector InjCrv_qPoI1Des_Channel /end DEF_CHARACTERISTIC
 /begin OUT_MEASUREMENT InjCrv_facPoI1EffSet_mp InjCrv_facPoI1Eff_mp InjCrv_numInjPoI1Off_mp InjCrv_phiDynOfs_mp InjCrv_phiNxtCyl_mp InjCrv_phiNxtTDCoB_mp InjCrv_phiPoI1Bas_mp InjCrv_phiPoI1DesByp_mp InjCrv_phiPoI1Dur_mp InjCrv_phiPoI1Lim_mp InjCrv_phiPoI1Min_mp InjCrv_phiPoI1Set_mp InjCrv_qPoI1Bas_mp InjCrv_qPoI1DesByp_mp InjCrv_qPoI1Des_mp InjCrv_qPoI1Lim_mp InjCrv_qPoI1Max_mp InjCrv_qPoI1Min_mp InjCrv_qPoI1SetLim_mp InjCrv_qPoI1Set_mp InjCrv_qPoI1_mp InjCrv_stInjPoI1Off_mp InjCrv_stPoI1_mp InjCrv_volPoI1_mp /end OUT_MEASUREMENT
/end FUNCTION
/begin FUNCTION injcrv_poi2addcor "Nacheinspritzung 2 - projektspezifische Korrekturen" /end FUNCTION
/begin FUNCTION injcrv_poi2addcor_msg ""
 /begin OUT_MEASUREMENT InjCrv_phiPoI2AddCor InjCrv_POpPoI2AddCor InjCrv_qPoI2AddCor InjCrv_tiPoI2AddCor /end OUT_MEASUREMENT
/end FUNCTION
/begin FUNCTION injcrv_poi2addcor_uic "" /end FUNCTION
/begin FUNCTION injcrv_poi2agabstdc "Umschaltung des Ansteuerbeginns PoI2 in Winkel absolut zum TDC" /end FUNCTION
/begin FUNCTION injcrv_poi2agabstdc_uic "" /end FUNCTION
/begin FUNCTION injcrv_poi2envcor "Nacheinspritzung 2 - Umwelt- Korrekturen"
 /begin DEF_CHARACTERISTIC InjCrv_POpPoI2ETSCorStrt_MAP InjCrv_POpPoI2ETSCor_MAP InjCrv_qPoI2APSCorStrt_MAP InjCrv_qPoI2ATSCorStrt_MAP InjCrv_qPoI2ATSCor_MAP InjCrv_qPoI2ETSCorStrt_MAP InjCrv_qPoI2ETSCor_MAP /end DEF_CHARACTERISTIC
 /begin IN_MEASUREMENT Eng_nAvrg InjCtl_qSetUnBal /end IN_MEASUREMENT
/end FUNCTION
/begin FUNCTION injcrv_poi2envcorphi "" /begin DEF_CHARACTERISTIC InjCrv_phiPoI2ATSCor_MAP InjCrv_phiPoI2ETSCor_MAP /end DEF_CHARACTERISTIC /begin IN_MEASUREMENT Eng_nAvrg InjCtl_qSetUnBal /end IN_MEASUREMENT /end FUNCTION
/begin FUNCTION injcrv_poi2envcorphi_uic "" /begin OUT_MEASUREMENT InjCrv_phiPoI2ATSCor_mp InjCrv_phiPoI2ETSCor_mp /end OUT_MEASUREMENT /end FUNCTION
/begin FUNCTION injcrv_poi2envcorrgn "Injection Curve Post Injection Regeneration Correction"
 /begin DEF_CHARACTERISTIC InjCrv_facPhPoI2RgnAPCor_CUR InjCrv_facPhPoI2RgnETCor_CUR InjCrv_facQPoI2RgnAPCor_CUR InjCrv_facQPoI2RgnETCor_CUR InjCrv_facTiPoI2RgnAPCor_CUR InjCrv_facTiPoI2RgnETCor_CUR InjCrv_phiPoI2RgnCor_MAP InjCrv_qPoI2RgnCor_MAP InjCrv_tiPoI2RgnCor_MAP /end DEF_CHARACTERISTIC
 /begin IN_MEASUREMENT APSCD_pLinVal Eng_nAvrg InjCrv_tEng InjCtl_qSetUnBal /end IN_MEASUREMENT
/end FUNCTION
/begin FUNCTION injcrv_poi2envcorrgn_msg ""
 /begin OUT_MEASUREMENT InjCrv_phiPoI2RgnCor InjCrv_qPoI2RgnCor InjCrv_tiPoI2RgnCor /end OUT_MEASUREMENT
/end FUNCTION
/begin FUNCTION injcrv_poi2envcorrgn_uic ""
 /begin OUT_MEASUREMENT InjCrv_facPhPoI2RgnAPCor_mp InjCrv_facPhPoI2RgnETCor_mp InjCrv_facQPoI2RgnAPCor_mp InjCrv_facQPoI2RgnETCor_mp InjCrv_facTiPoI2RgnAPCor_mp InjCrv_facTiPoI2RgnETCor_mp /end OUT_MEASUREMENT
/end FUNCTION
/begin FUNCTION injcrv_poi2envcorslow ""
 /begin DEF_CHARACTERISTIC InjCrv_facPoI2APSQCorStrt_CUR InjCrv_facPoI2ATSQCorStrt_CUR InjCrv_facPoI2ATSQCor_CUR InjCrv_facPoI2ATSSOECor_CUR InjCrv_facPoI2ETSQCorStrt_CUR InjCrv_facPoI2ETSQCor_CUR InjCrv_facPoI2ETSSOECorStrt_CUR InjCrv_facPoI2ETSSOECor_CUR InjCrv_facPOpPoI2ETSCorStrt_CUR InjCrv_facPOpPoI2ETSCor_CUR /end DEF_CHARACTERISTIC
 /begin IN_MEASUREMENT APSCD_pVal IATSCD_tAir InjCrv_tEng /end IN_MEASUREMENT
/end FUNCTION
/begin FUNCTION injcrv_poi2envcorslowrgn "PoI2 Korrekturwerte für Umweltbedingungen im Regenerationsmodus" /end FUNCTION
/begin FUNCTION injcrv_poi2envcorslowrgn_msg "" /end FUNCTION
/begin FUNCTION injcrv_poi2envcorslowrgn_uic "" /end FUNCTION
/begin FUNCTION injcrv_poi2envcorslow_msg ""
 /begin OUT_MEASUREMENT InjCrv_facPoI2APSQCorStrt InjCrv_facPoI2ATSQCor InjCrv_facPoI2ATSQCorStrt InjCrv_facPoI2ATSSOECor InjCrv_facPoI2ETSQCor InjCrv_facPoI2ETSQCorStrt InjCrv_facPoI2ETSSOECor InjCrv_facPoI2ETSSOECorStrt InjCrv_facPOpPoI2ETSCor InjCrv_facPOpPoI2ETSCorStrt /end OUT_MEASUREMENT
/end FUNCTION
/begin FUNCTION injcrv_poi2envcorslow_uic "" /end FUNCTION
/begin FUNCTION injcrv_poi2envcorti ""
 /begin DEF_CHARACTERISTIC InjCrv_tiPoI2ATSCor_MAP InjCrv_tiPoI2ETSCorStrt_MAP InjCrv_tiPoI2ETSCor_MAP /end DEF_CHARACTERISTIC
 /begin IN_MEASUREMENT Eng_nAvrg InjCtl_qSetUnBal /end IN_MEASUREMENT
/end FUNCTION
/begin FUNCTION injcrv_poi2envcorti_uic ""
 /begin OUT_MEASUREMENT InjCrv_tiPoI2ATSCor_mp InjCrv_tiPoI2ETSCorStrt_mp InjCrv_tiPoI2ETSCor_mp /end OUT_MEASUREMENT
/end FUNCTION
/begin FUNCTION injcrv_poi2envcor_msg ""
 /begin OUT_MEASUREMENT InjCrv_phiPoI2EnvCor InjCrv_POpPoI2EnvCor InjCrv_POpPoI2EnvCorStrt InjCrv_qPoI2EnvCor InjCrv_qPoI2EnvCorStrt InjCrv_tiPoI2EnvCor InjCrv_tiPoI2EnvCorStrt /end OUT_MEASUREMENT
/end FUNCTION
/begin FUNCTION injcrv_poi2envcor_uic ""
 /begin OUT_MEASUREMENT InjCrv_qPoI2APSCorStrt_mp InjCrv_qPoI2ATSCorStrt_mp InjCrv_qPoI2ATSCor_mp InjCrv_qPoI2ETSCorStrt_mp InjCrv_qPoI2ETSCor_mp /end OUT_MEASUREMENT
/end FUNCTION
/begin FUNCTION injcrv_poi2q "Nacheinspritzung 2, Mengenberechnung"
 /begin DEF_CHARACTERISTIC InjCrv_facPoI2Eff_MAP InjCrv_facPoI2QntMin_C InjCrv_qPoI2Bas_MAP InjCrv_qPoI2SetLim_C InjCrv_stPoI2RgnDelMsk_C /end DEF_CHARACTERISTIC
 /begin IN_MEASUREMENT Eng_nAvrg InjCtl_qSetUnBal /end IN_MEASUREMENT
/end FUNCTION
/begin FUNCTION injcrv_poi2qrmtctl_uic "" /end FUNCTION
/begin FUNCTION injcrv_poi2q_msg ""
 /begin OUT_MEASUREMENT InjCrv_PoI2EffVal InjCrv_qPoI2Des InjCrv_qPoI2Eff InjCrv_qPoIRem InjCrv_stPoI2 /end OUT_MEASUREMENT
/end FUNCTION
/begin FUNCTION injcrv_poi2q_uic ""
 /begin OUT_MEASUREMENT InjCrv_facPoI2EffSet_mp InjCrv_facPoI2Eff_mp InjCrv_numInjPoI2Off_mp InjCrv_qMI1MinPoI2_mp InjCrv_qPoI2Bas_mp InjCrv_qPoI2Cor_mp InjCrv_qPoI2Des_mp InjCrv_qPoI2Eff_mp InjCrv_qPoI2Lim_mp InjCrv_qPoI2Max_mp InjCrv_qPoI2Min_mp InjCrv_qPoI2Set_mp InjCrv_qPoI2_mp InjCrv_stInjPoI2Off_mp InjCrv_tiPoI2ET_mp InjCrv_volPoI2_mp /end OUT_MEASUREMENT
/end FUNCTION
/begin FUNCTION injcrv_poi2rgn "Nacheinspritzung 2, Regenerationswertberechnung"
 /begin DEF_CHARACTERISTIC InjCrv_facPoI2Eff1_MAP InjCrv_facPoI2Eff2_MAP InjCrv_phiPoI2Rgn1_MAP InjCrv_phiPoI2Rgn2_MAP InjCrv_qPoI2Rgn1_MAP InjCrv_qPoI2Rgn2_MAP InjCrv_tiPoI2Rgn1_MAP InjCrv_tiPoI2Rgn2_MAP /end DEF_CHARACTERISTIC
 /begin IN_MEASUREMENT Eng_nAvrg InjCtl_qSetUnBal /end IN_MEASUREMENT
/end FUNCTION
/begin FUNCTION injcrv_poi2rgnlib "Library function  of exhaust gas regeneration for Post Injection 2"
 /begin DEF_CHARACTERISTIC InjCrv_dtiPoI2RgnEffRmpUp_C InjCrv_dtiPoI2RgnEffRmpDwn_C InjCrv_dtiPoI2RgnRmpUp_C InjCrv_dtiPoI2RgnRmpDwn_C InjCrv_dtiPoI2RgnTypeRmpUp_C InjCrv_dtiPoI2RgnTypeRmpDwn_C InjCrv_stPoI2RgnEffMsk_C InjCrv_stPoI2RgnMsk_C InjCrv_stPoI2RgnTypeMsk_C /end DEF_CHARACTERISTIC
/end FUNCTION
/begin FUNCTION injcrv_poi2rgn_msg ""
 /begin OUT_MEASUREMENT InjCrv_facPoI2EffRgn InjCrv_phiPoI2Rgn InjCrv_PoI2RgnTypeVal InjCrv_qPoI2Rgn InjCrv_tiPoI2Rgn /end OUT_MEASUREMENT
/end FUNCTION
/begin FUNCTION injcrv_poi2rgn_uic ""
 /begin DEF_CHARACTERISTIC InjCrv_facPoI2EffRgnAdd_Vector InjCrv_facPoI2EffRgnAdd_Channel InjCrv_facPoI2EffRgn_Vector InjCrv_facPoI2EffRgn_Channel InjCrv_phiPoI2RgnAdd_Vector InjCrv_phiPoI2RgnAdd_Channel InjCrv_phiPoI2Rgn_Vector InjCrv_phiPoI2Rgn_Channel InjCrv_qPoI2RgnAdd_Vector InjCrv_qPoI2RgnAdd_Channel InjCrv_qPoI2Rgn_Vector InjCrv_qPoI2Rgn_Channel InjCrv_tiPoI2RgnAdd_Vector InjCrv_tiPoI2RgnAdd_Channel InjCrv_tiPoI2Rgn_Vector InjCrv_tiPoI2Rgn_Channel /end DEF_CHARACTERISTIC
 /begin OUT_MEASUREMENT InjCrv_facPoI2EffRgn1_mp InjCrv_facPoI2EffRgn2_mp InjCrv_facPoI2EffRgnByp_mp InjCrv_phiPoI2Rgn1_mp InjCrv_phiPoI2Rgn2_mp InjCrv_phiPoI2RgnByp_mp InjCrv_qPoI2Rgn1_mp InjCrv_qPoI2Rgn2_mp InjCrv_qPoI2RgnByp_mp InjCrv_tiPoI2Rgn1_mp InjCrv_tiPoI2Rgn2_mp InjCrv_tiPoI2RgnByp_mp /end OUT_MEASUREMENT
/end FUNCTION
/begin FUNCTION injcrv_poi2rls ""
 /begin DEF_CHARACTERISTIC InjCrv_POpPoI2Bas_MAP InjCrv_POpPoI2High_C InjCrv_POpPoI2Low_C /end DEF_CHARACTERISTIC
 /begin IN_MEASUREMENT Eng_nAvrg InjCtl_qSetUnBal /end IN_MEASUREMENT
/end FUNCTION
/begin FUNCTION injcrv_poi2rls_uic "" /begin OUT_MEASUREMENT InjCrv_POpPoI2Bas_mp InjCrv_POpPoI2_mp /end OUT_MEASUREMENT /end FUNCTION
/begin FUNCTION injcrv_poi2soe "Nacheinspritzung 2, Ansteuerdauerberechnung"
 /begin DEF_CHARACTERISTIC InjCrv_phiPoI2Min_C InjCrv_tiPoI2Max_MAP InjCrv_tiPoI2Min_C /end DEF_CHARACTERISTIC
 /begin IN_MEASUREMENT InjCrv_qMI1Des RailCD_pPeak /end IN_MEASUREMENT
/end FUNCTION
/begin FUNCTION injcrv_poi2soephibas "" /begin DEF_CHARACTERISTIC InjCrv_phiPoI2Bas_MAP /end DEF_CHARACTERISTIC /begin IN_MEASUREMENT Eng_nAvrg InjCtl_qSetUnBal /end IN_MEASUREMENT /end FUNCTION
/begin FUNCTION injcrv_poi2soephibas_uic "" /begin OUT_MEASUREMENT InjCrv_phiPoI2Bas_mp /end OUT_MEASUREMENT /end FUNCTION
/begin FUNCTION injcrv_poi2soermtctl_uic "" /end FUNCTION
/begin FUNCTION injcrv_poi2soetibas "" /begin DEF_CHARACTERISTIC InjCrv_tiPoI2Bas_MAP /end DEF_CHARACTERISTIC /begin IN_MEASUREMENT Eng_nAvrg InjCtl_qSetUnBal /end IN_MEASUREMENT /end FUNCTION
/begin FUNCTION injcrv_poi2soetibas_uic "" /begin OUT_MEASUREMENT InjCrv_tiPoI2Bas_mp /end OUT_MEASUREMENT /end FUNCTION
/begin FUNCTION injcrv_poi2soe_msg "" /begin OUT_MEASUREMENT InjCrv_phiPoI2Des InjCrv_tiPoI2Des /end OUT_MEASUREMENT /end FUNCTION
/begin FUNCTION injcrv_poi2soe_uic ""
 /begin DEF_CHARACTERISTIC InjCrv_phiPoI2Add_Vector InjCrv_phiPoI2Add_Channel InjCrv_phiPoI2_Vector InjCrv_phiPoI2_Channel InjCrv_qPoI2DesAdd_Vector InjCrv_qPoI2DesAdd_Channel InjCrv_qPoI2EffAdd_Vector InjCrv_qPoI2EffAdd_Channel InjCrv_qPoI2Eff_Vector InjCrv_qPoI2Eff_Channel InjCrv_qPoI2Des_Vector InjCrv_qPoI2Des_Channel InjCrv_tiPoI2Add_Vector InjCrv_tiPoI2Add_Channel InjCrv_tiPoI2_Vector InjCrv_tiPoI2_Channel /end DEF_CHARACTERISTIC
 /begin OUT_MEASUREMENT InjCrv_phiPoI2AbsTot_mp InjCrv_phiPoI2Abs_mp InjCrv_phiPoI2Byp_mp InjCrv_phiPoI2Cor_mp InjCrv_phiPoI2Rel_mp InjCrv_qPoI2DesByp_mp InjCrv_qPoI2EffByp_mp InjCrv_swtPoI2AgAbsTDC_mp InjCrv_tiPoI2Byp_mp InjCrv_tiPoI2Cor_mp InjCrv_tiPoI2Max_mp InjCrv_tiPoI2RelTot_mp InjCrv_tiPoI2Rel_mp /end OUT_MEASUREMENT
/end FUNCTION
/begin FUNCTION injcrv_poi2strt ""
 /begin DEF_CHARACTERISTIC InjCrv_POpPoI2BasStrt_MAP InjCrv_PopPoI2HighStrt_C InjCrv_PopPoI2LowStrt_C InjCrv_qPoI2BasStrt_MAP InjCrv_tiPoI2BasStrt_MAP /end DEF_CHARACTERISTIC
 /begin IN_MEASUREMENT Eng_nAvrg InjCtl_qSetUnBal /end IN_MEASUREMENT
/end FUNCTION
/begin FUNCTION injcrv_poi2strt_uic ""
 /begin OUT_MEASUREMENT InjCrv_POpPoI2BasStrt_mp InjCrv_qPoI2BasStrt_mp InjCrv_tiPoI2BasStrt_mp /end OUT_MEASUREMENT
/end FUNCTION
/begin FUNCTION injcrv_poiovrqlim ""
 /begin DEF_CHARACTERISTIC InjCrv_qPoIOvrMax_C InjCrv_swtPoIOvrQLimActive_C InjCrv_tiPoIOvrQLimMax_C InjCrv_tOxiPoILimMax_C InjCrv_tPrePoILimMax_C /end DEF_CHARACTERISTIC
/end FUNCTION
/begin FUNCTION injcrv_poiovrqlim_msg "" /begin OUT_MEASUREMENT InjCrv_stPoIOvrQLim /end OUT_MEASUREMENT /end FUNCTION
/begin FUNCTION injcrv_poiovrqlim_uic ""
 /begin OUT_MEASUREMENT InjCrv_qPoIOvrAct_mp InjCrv_qPoIOvrTot_mp InjCrv_qPoI_mp InjCrv_stPoIOvrRaw_mp /end OUT_MEASUREMENT
/end FUNCTION
/begin FUNCTION injcrv_qntminlib "Berechnung minimale Einspritzmenge" /begin DEF_CHARACTERISTIC InjCrv_qMin_CUR /end DEF_CHARACTERISTIC /begin IN_MEASUREMENT RailCD_pPeak /end IN_MEASUREMENT /end FUNCTION
/begin FUNCTION injcrv_qntminlib_uic "" /begin OUT_MEASUREMENT InjCrv_qPiI1MinWv_mp /end OUT_MEASUREMENT /end FUNCTION
/begin FUNCTION injcrv_rmtctl_uic "" /end FUNCTION
/begin COMPU_METHOD AngleCrS "Winkel Kurbelwelle" RAT_FUNC "%6.4" "deg CrS" COEFFS 0 42.6666666666667 0 0 0 1 /end COMPU_METHOD
/begin COMPU_METHOD EGTSwt "Umrechnung für EGT Rampenschalter (1 / 1000*2^14 )" RAT_FUNC "%10.9" "-" COEFFS 0 16384000 0 0 0 1 /end COMPU_METHOD
/begin COMPU_METHOD EngN "Motordrehzahl" RAT_FUNC "%6.2" "rpm" COEFFS 0 1 0 0 0 1 /end COMPU_METHOD
/begin COMPU_METHOD Fact "Faktor mit Auflösung 1 / 8192, hauptsächlich für einen Faktorenbereich 0...1 verwendet" RAT_FUNC "%6.5" "-" COEFFS 0 8192 0 0 0 1 /end COMPU_METHOD
/begin COMPU_METHOD Fact1 "Faktor mit Auflösung 0,01 (100 mal höherer Bereich als Fact)" RAT_FUNC "%6.4" "-" COEFFS 0 128 0 0 0 1 /end COMPU_METHOD
/begin COMPU_METHOD InjMassCyc "Einspritzmenge pro Zyklus (mg/Zyklus)" RAT_FUNC "%6.4" "mg/cyc" COEFFS 0 100 0 0 0 1 /end COMPU_METHOD
/begin COMPU_METHOD InjMassInj "Einspritzmenge pro Einspritzung (mg/Einspritzung)" RAT_FUNC "%6.4" "mg/inj" COEFFS 0 100 0 0 0 1 /end COMPU_METHOD
/begin COMPU_METHOD InjMassPerSec_20ms "Einspritzmengenänderung pro Sekunde für 20ms-Tasks" RAT_FUNC "%6.3" "mg/hub/s" COEFFS 0 2 0 0 0 1 /end COMPU_METHOD
/begin COMPU_METHOD InjMassTot "" RAT_FUNC "%6.4" "mg" COEFFS 0 100 0 0 0 1 /end COMPU_METHOD
/begin COMPU_METHOD InjQntInj "Einspritzmenge der einzelnen Einspritzung" RAT_FUNC "%6.4" "mm^3/inj" COEFFS 0 100 0 0 0 1 /end COMPU_METHOD
/begin COMPU_METHOD InjTime_us "Zeit in Microsekunden für das Einspritztiming" RAT_FUNC "%6.2" "us" COEFFS 0 1 0 0 0 1 /end COMPU_METHOD
/begin COMPU_METHOD Kp_LmbdRec2InjMass_2 "Proportionale Verstärkung Kp (reziprokes Lambda zu Einspritzmenge)" RAT_FUNC "%6.4" "mg/stroke" COEFFS 0 81.92 0 0 0 1 /end COMPU_METHOD
/begin COMPU_METHOD Kp_rpm2Nm_1 "Proportional Verstärkung (Umdrehungen nach Moment), Umrechnung für sint16 Werte" RAT_FUNC "%6.4" "Nm/rpm" COEFFS 0 320 0 0 0 1 /end COMPU_METHOD
/begin COMPU_METHOD OneToOne "eins zu eins (physikalischer Wert ist gleich dem internen Wert)" RAT_FUNC "%6.2" "-" COEFFS 0 1 0 0 0 1 /end COMPU_METHOD
/begin COMPU_METHOD Pres_AC "Druck (Klimatisierung)" RAT_FUNC "%7.2" "hPa" COEFFS 0 0.500000 0 0 0 1 /end COMPU_METHOD
/begin COMPU_METHOD Pres_hPa "Druck (angezeigt in [hPa])" RAT_FUNC "%6.2" "hPa" COEFFS 0 1 0 0 0 1 /end COMPU_METHOD
/begin COMPU_METHOD Pres_Rail "Raildruck in hPa" RAT_FUNC "%4.3" "bar" COEFFS 0 10.000000 0 0 0 1 /end COMPU_METHOD
/begin COMPU_METHOD Rmp "einheitenloser Rampengradient (für Library Ramp, etc.)" RAT_FUNC "%6.4" "1/s" COEFFS 0 65.536 0 0 0 1 /end COMPU_METHOD
/begin COMPU_METHOD Temp_Cels "Temperatur dargestellt in °C (gleiche interne Darstellung wie Temp_Kelv)" RAT_FUNC "%6.1" "deg C" COEFFS 0 10 2731.4 0 0 1 /end COMPU_METHOD
/begin COMPU_METHOD Time_ms "Zeit in ms für Fehlerentprellung (DSM) und SW-Timer" RAT_FUNC "%6.1" "ms" COEFFS 0 0.1 0 0 0 1 /end COMPU_METHOD
/begin RECORD_LAYOUT Gkf_Ws16 FNC_VALUES 1 SWORD COLUMN_DIR DIRECT /end RECORD_LAYOUT
/begin RECORD_LAYOUT Gkl_Ws16 FNC_VALUES 1 SWORD COLUMN_DIR DIRECT /end RECORD_LAYOUT
/begin RECORD_LAYOUT GSst_Xs16 NO_AXIS_PTS_X 1 SWORD AXIS_PTS_X 2 SWORD INDEX_INCR DIRECT /end RECORD_LAYOUT
/begin RECORD_LAYOUT Kf_Xs16_Ys16_Ws16 NO_AXIS_PTS_X 1 SWORD NO_AXIS_PTS_Y 2 SWORD AXIS_PTS_X 3 SWORD INDEX_INCR DIRECT AXIS_PTS_Y 4 SWORD INDEX_INCR DIRECT FNC_VALUES 5 SWORD COLUMN_DIR DIRECT /end RECORD_LAYOUT
/begin RECORD_LAYOUT Kl_Xs16_Ws16 NO_AXIS_PTS_X 1 SWORD AXIS_PTS_X 2 SWORD INDEX_INCR DIRECT FNC_VALUES 3 SWORD COLUMN_DIR DIRECT /end RECORD_LAYOUT
/begin RECORD_LAYOUT Kw_Ws16 FNC_VALUES 1 SWORD COLUMN_DIR DIRECT /end RECORD_LAYOUT
/begin RECORD_LAYOUT Kw_Ws32 FNC_VALUES 1 SLONG COLUMN_DIR DIRECT /end RECORD_LAYOUT
/begin RECORD_LAYOUT Kw_Wu32 FNC_VALUES 1 ULONG COLUMN_DIR DIRECT /end RECORD_LAYOUT
/begin RECORD_LAYOUT Kw_Wu8 FNC_VALUES 1 UBYTE COLUMN_DIR DIRECT /end RECORD_LAYOUT
/end MODULE
/end PROJECT
