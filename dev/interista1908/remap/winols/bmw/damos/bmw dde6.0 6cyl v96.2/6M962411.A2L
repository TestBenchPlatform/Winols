ASAP2_VERSION 1 3
/begin PROJECT P411 "BMW DDE6.0 6-Zylinder V96.2 14.10.2004"
/begin HEADER "" VERSION "V96.2_6Z" PROJECT_NO P411 /end HEADER
/begin MODULE DIM ""
/begin MOD_COMMON "" BYTE_ORDER MSB_FIRST ALIGNMENT_BYTE 1 ALIGNMENT_WORD 2 ALIGNMENT_LONG 4 ALIGNMENT_FLOAT32_IEEE 4 /end MOD_COMMON
/begin CHARACTERISTIC ASDrf_T1CluNeg_C "ARD Führungsformer T1 Kupplung neg. Gradient" VALUE 0xC9108 Kw_Wu32 4294.9673 TimeDelay_s 0.0000010000000 4294.9673 FORMAT "%9.4" /end CHARACTERISTIC
/begin CHARACTERISTIC ASDrf_KdCluNeg_C "ARD Führungsformer Kd=Td/T1 Kupplung neg. Gradient" VALUE 0xC910C Kw_Ws32 32769.0000000 Kd -32768.0000000 1.00000000000 FORMAT "%13.7" EXTENDED_LIMITS -32768.0000000 32767.9999847 /end CHARACTERISTIC
/begin CHARACTERISTIC ASDrf_T1CluPos_C "ARD Führungsformer T1 Kupplung pos. Gradient" VALUE 0xC9110 Kw_Wu32 4294.9673 TimeDelay_s 0.0000010000000 4294.9673 FORMAT "%9.4" /end CHARACTERISTIC
/begin CHARACTERISTIC ASDrf_KdCluPos_C "ARD Führungsformer Kd=Td/T1 Kupplung Ganggruppe pos. Gradient" VALUE 0xC9114 Kw_Ws32 32769.0000000 Kd -32768.0000000 1.00000000000 FORMAT "%13.7" EXTENDED_LIMITS -32768.0000000 32767.9999847 /end CHARACTERISTIC
/begin CHARACTERISTIC ASDrf_CoeffAFDCLossNeg_CUR "Curve for 2nd order parable coeffitient for lad for sport mode" CURVE 0xC91D4 Kl_Xs16_Ws16 319.9951 CoeffA -160.0000 159.9951 FORMAT "%8.4"
 /begin AXIS_DESCR STD_AXIS DrvTrn_rTransDT TransR 8 0.00 100.0000 FORMAT "%8.4" EXTENDED_LIMITS -327.6800 327.6700 DEPOSIT ABSOLUTE /end AXIS_DESCR
/end CHARACTERISTIC
/begin CHARACTERISTIC ASDrf_CoeffAFDCLossPos_CUR "Curve for 2nd order parable coeffitient for lad" CURVE 0xC91F6 Kl_Xs16_Ws16 319.9951 CoeffA -160.0000 159.9951 FORMAT "%8.4"
 /begin AXIS_DESCR STD_AXIS DrvTrn_rTransDT TransR 8 0.00 100.0000 FORMAT "%8.4" EXTENDED_LIMITS -327.6800 327.6700 DEPOSIT ABSOLUTE /end AXIS_DESCR
/end CHARACTERISTIC
/begin CHARACTERISTIC ASDrf_CoeffAGripLossNeg_CUR "Kennlinie für den Koeffitienten zweiter Ordnung der LSD Steigungsbegrenzung." CURVE 0xC9218 Kl_Xs16_Ws16 319.9951 CoeffA -160.0000 159.9951 FORMAT "%8.4"
 /begin AXIS_DESCR STD_AXIS DrvTrn_rTransDT TransR 6 0.00 100.0000 FORMAT "%8.4" EXTENDED_LIMITS -327.6800 327.6700 DEPOSIT ABSOLUTE /end AXIS_DESCR
/end CHARACTERISTIC
/begin CHARACTERISTIC ASDrf_CoeffAGripLossPos_CUR "Kennlinie für den Koeffitienten zweiter Ordnung der LSD Steigungsbegrenzung." CURVE 0xC9232 Kl_Xs16_Ws16 319.9951 CoeffA -160.0000 159.9951 FORMAT "%8.4"
 /begin AXIS_DESCR STD_AXIS DrvTrn_rTransDT TransR 6 0.00 100.0000 FORMAT "%8.4" EXTENDED_LIMITS -327.6800 327.6700 DEPOSIT ABSOLUTE /end AXIS_DESCR
/end CHARACTERISTIC
/begin CHARACTERISTIC ASDrf_CoeffBFDCLossNeg_CUR "Curve for 0th order parable coeffitient for lad" CURVE 0xC924C Kl_Xs16_Ws16 6553.500 dTrq -3276.800 3276.700 FORMAT "%8.3"
 /begin AXIS_DESCR STD_AXIS DrvTrn_rTransDT TransR 8 0.00 100.0000 FORMAT "%8.4" EXTENDED_LIMITS -327.6800 327.6700 DEPOSIT ABSOLUTE /end AXIS_DESCR
/end CHARACTERISTIC
/begin CHARACTERISTIC ASDrf_CoeffBFDCLossPos_CUR "Curve for 0th order parable coeffitient for lad" CURVE 0xC926E Kl_Xs16_Ws16 6553.500 dTrq -3276.800 3276.700 FORMAT "%8.3"
 /begin AXIS_DESCR STD_AXIS DrvTrn_rTransDT TransR 8 0.00 100.0000 FORMAT "%8.4" EXTENDED_LIMITS -327.6800 327.6700 DEPOSIT ABSOLUTE /end AXIS_DESCR
/end CHARACTERISTIC
/begin CHARACTERISTIC ASDrf_CoeffBGripLossNeg_CUR "Kennlinie für den Koeffitienten nullter Ordnung der LSD Steigungsbegrenzung." CURVE 0xC9290 Kl_Xs16_Ws16 6553.500 dTrq -3276.800 3276.700 FORMAT "%8.3"
 /begin AXIS_DESCR STD_AXIS DrvTrn_rTransDT TransR 6 0.00 100.0000 FORMAT "%8.4" EXTENDED_LIMITS -327.6800 327.6700 DEPOSIT ABSOLUTE /end AXIS_DESCR
/end CHARACTERISTIC
/begin CHARACTERISTIC ASDrf_CoeffBGripLossPos_CUR "Kennlinie für den Koeffitienten nullter Ordnung der LSD Steigungsbegrenzung." CURVE 0xC92AA Kl_Xs16_Ws16 6553.500 dTrq -3276.800 3276.700 FORMAT "%8.3"
 /begin AXIS_DESCR STD_AXIS DrvTrn_rTransDT TransR 6 0.00 100.0000 FORMAT "%8.4" EXTENDED_LIMITS -327.6800 327.6700 DEPOSIT ABSOLUTE /end AXIS_DESCR
/end CHARACTERISTIC
/begin CHARACTERISTIC ASDrf_T1ExtInt_C "ARD Führungsformer T1, externer Eingriff" VALUE 0xC9118 Kw_Wu32 4294.9673 TimeDelay_s 0.0000010000000 4294.9673 FORMAT "%9.4" /end CHARACTERISTIC
/begin CHARACTERISTIC ASDrf_KdExtInt_C "ARD Führungsformer Kd=Td/T1, externer Eingriff" VALUE 0xC911C Kw_Ws32 32769.0000000 Kd -32768.0000000 1.00000000000 FORMAT "%13.7" EXTENDED_LIMITS -32768.0000000 32767.9999847 /end CHARACTERISTIC
/begin CHARACTERISTIC ASDrf_KdFDCNeg_CUR "Curve for n dependent gain for PDT1 filtering for negative i/p gradient" CURVE 0xC92C4 Kl_Xs16_Ws16 1.000000 Kd_Lin_16 0.00 1.000000 FORMAT "%8.6" EXTENDED_LIMITS -1.000031 1.000000
 /begin AXIS_DESCR STD_AXIS DrvTrn_rTransDT TransR 8 0.00 100.0000 FORMAT "%8.4" EXTENDED_LIMITS -327.6800 327.6700 DEPOSIT ABSOLUTE /end AXIS_DESCR
/end CHARACTERISTIC
/begin CHARACTERISTIC ASDrf_KdFDCPos_CUR "Curve for n dependent gain for PDT1 filtering for positive i/p gradient" CURVE 0xC92E6 Kl_Xs16_Ws16 1.000000 Kd_Lin_16 0.00 1.000000 FORMAT "%8.6" EXTENDED_LIMITS -1.000031 1.000000
 /begin AXIS_DESCR STD_AXIS DrvTrn_rTransDT TransR 8 0.00 100.0000 FORMAT "%8.4" EXTENDED_LIMITS -327.6800 327.6700 DEPOSIT ABSOLUTE /end AXIS_DESCR
/end CHARACTERISTIC
/begin CHARACTERISTIC ASDrf_KdGripNeg_CUR "Kd bei geschlosenem Antreibsstrang und negativem Gradienten" CURVE 0xC9308 Kl_Xs16_Ws16 1.000000 Kd_Lin_16 0.00 1.000000 FORMAT "%8.6" EXTENDED_LIMITS -1.000031 1.000000
 /begin AXIS_DESCR STD_AXIS DrvTrn_rTransDT TransR 6 0.00 100.0000 FORMAT "%8.4" EXTENDED_LIMITS -327.6800 327.6700 DEPOSIT ABSOLUTE /end AXIS_DESCR
/end CHARACTERISTIC
/begin CHARACTERISTIC ASDrf_KdGripPos_CUR "Kd bei geschlosenem Antreibsstrang und positivem Gradienten" CURVE 0xC9322 Kl_Xs16_Ws16 1.000000 Kd_Lin_16 0.00 1.000000 FORMAT "%8.6" EXTENDED_LIMITS -1.000031 1.000000
 /begin AXIS_DESCR STD_AXIS DrvTrn_rTransDT TransR 6 0.00 100.0000 FORMAT "%8.4" EXTENDED_LIMITS -327.6800 327.6700 DEPOSIT ABSOLUTE /end AXIS_DESCR
/end CHARACTERISTIC
/begin CHARACTERISTIC ASDrf_numDefaultState_C "Vorgabestatus" VALUE 0xC9120 Kw_Wu16 5.00000000000 ASDrf_numDefaultState 0.00 5.00000000000 FORMAT "%13.11" /end CHARACTERISTIC
/begin CHARACTERISTIC ASDrf_numPrio_C "Statuspriorität" VAL_BLK 0xC933C Kwb_Wu8 255.0 OneToOne 0.00 255.0 FORMAT "%5.1" NUMBER 6 /end CHARACTERISTIC
/begin CHARACTERISTIC ASDrf_CoeffACluLossNeg_C "Kennwert für den Koeffitienten zweiter Ordnung der LSD Steigungsbegrenzung." VALUE 0xC9122 Kw_Ws16 159.9951 CoeffA 0.00 159.9951 FORMAT "%8.4" EXTENDED_LIMITS -160.0000 159.9951 /end CHARACTERISTIC
/begin CHARACTERISTIC ASDrf_CoeffBCluLossNeg_C "Kennlinie für den Koeffitienten nullter Ordnung der LSD Steigungsbegrenzung." VALUE 0xC9124 Kw_Ws16 3276.700 dTrq 0.00 3276.700 FORMAT "%8.3" EXTENDED_LIMITS -3276.800 3276.700 /end CHARACTERISTIC
/begin CHARACTERISTIC ASDrf_CoeffACluLossPos_C "Kennwert für den Koeffitienten zweiter Ordnung der LSD Steigungsbegrenzung." VALUE 0xC9126 Kw_Ws16 159.9951 CoeffA 0.00 159.9951 FORMAT "%8.4" EXTENDED_LIMITS -160.0000 159.9951 /end CHARACTERISTIC
/begin CHARACTERISTIC ASDrf_CoeffBCluLossPos_C "Kennwert für den Koeffitienten nullter Ordnung der LSD Steigungsbegrenzung." VALUE 0xC9128 Kw_Ws16 3276.700 dTrq 0.00 3276.700 FORMAT "%8.3" EXTENDED_LIMITS -3276.800 3276.700 /end CHARACTERISTIC
/begin CHARACTERISTIC ASDrf_CoeffAExtIntLoss_C "Kennwert für den Koeffitienten zweiter Ordnung der LSD Steigungsbegrenzung." VALUE 0xC912A Kw_Ws16 159.9951 CoeffA 0.00 159.9951 FORMAT "%8.4" EXTENDED_LIMITS -160.0000 159.9951 /end CHARACTERISTIC
/begin CHARACTERISTIC ASDrf_CoeffBExtIntLoss_C "Kennwert für den Koeffitienten nullter Ordnung der LSD Steigungsbegrenzung." VALUE 0xC912C Kw_Ws16 3276.700 dTrq 0.00 3276.700 FORMAT "%8.3" EXTENDED_LIMITS -3276.800 3276.700 /end CHARACTERISTIC
/begin CHARACTERISTIC ASDrf_CoeffAState3LossNeg_C "Kennwert für den Koeffitienten zweiter Ordnung der LSD Steigungsbegrenzung." VALUE 0xC912E Kw_Ws16 159.9951 CoeffA 0.00 159.9951 FORMAT "%8.4" EXTENDED_LIMITS -160.0000 159.9951 /end CHARACTERISTIC
/begin CHARACTERISTIC ASDrf_CoeffBState3LossNeg_C "Kennwert für den Koeffitienten nullter Ordnung der LSD Steigungsbegrenzung." VALUE 0xC9130 Kw_Ws16 3276.700 dTrq 0.00 3276.700 FORMAT "%8.3" EXTENDED_LIMITS -3276.800 3276.700 /end CHARACTERISTIC
/begin CHARACTERISTIC ASDrf_CoeffAState3LossPos_C "Kennwert für den Koeffitienten zweiter Ordnung der LSD Steigungsbegrenzung." VALUE 0xC9132 Kw_Ws16 159.9951 CoeffA 0.00 159.9951 FORMAT "%8.4" EXTENDED_LIMITS -160.0000 159.9951 /end CHARACTERISTIC
/begin CHARACTERISTIC ASDrf_CoeffBState3LossPos_C "Kennwert für den Koeffitienten nullter Ordnung der LSD Steigungsbegrenzung." VALUE 0xC9134 Kw_Ws16 3276.700 dTrq 0.00 3276.700 FORMAT "%8.3" EXTENDED_LIMITS -3276.800 3276.700 /end CHARACTERISTIC
/begin CHARACTERISTIC ASDrf_CoeffAState4LossNeg_C "Kennwert für den Koeffitienten zweiter Ordnung der LSD Steigungsbegrenzung." VALUE 0xC9136 Kw_Ws16 159.9951 CoeffA 0.00 159.9951 FORMAT "%8.4" EXTENDED_LIMITS -160.0000 159.9951 /end CHARACTERISTIC
/begin CHARACTERISTIC ASDrf_CoeffBState4LossNeg_C "Kennwert für den Koeffitienten nullter Ordnung der LSD Steigungsbegrenzung." VALUE 0xC9138 Kw_Ws16 3276.700 dTrq 0.00 3276.700 FORMAT "%8.3" EXTENDED_LIMITS -3276.800 3276.700 /end CHARACTERISTIC
/begin CHARACTERISTIC ASDrf_CoeffAState4LossPos_C "Kennwert für den Koeffitienten zweiter Ordnung der LSD Steigungsbegrenzung." VALUE 0xC913A Kw_Ws16 159.9951 CoeffA 0.00 159.9951 FORMAT "%8.4" EXTENDED_LIMITS -160.0000 159.9951 /end CHARACTERISTIC
/begin CHARACTERISTIC ASDrf_CoeffBState4LossPos_C "Kennwert für den Koeffitienten nullter Ordnung der LSD Steigungsbegrenzung." VALUE 0xC913C Kw_Ws16 3276.700 dTrq 0.00 3276.700 FORMAT "%8.3" EXTENDED_LIMITS -3276.800 3276.700 /end CHARACTERISTIC
/begin CHARACTERISTIC ASDrf_T1State3Neg_C "ARD Führungsformer T1 frei wählbarer Zustand 3 neg. Gradient" VALUE 0xC9140 Kw_Wu32 4294.9673 TimeDelay_s 0.0000010000000 4294.9673 FORMAT "%9.4" /end CHARACTERISTIC
/begin CHARACTERISTIC ASDrf_KdState3Neg_C "ARD Führungsformer Kd=Td/T1 frei wählbarer Zustand 3 neg. Gradient" VALUE 0xC9144 Kw_Ws32 32769.0000000 Kd -32768.0000000 1.00000000000 FORMAT "%13.7" EXTENDED_LIMITS -32768.0000000 32767.9999847 /end CHARACTERISTIC
/begin CHARACTERISTIC ASDrf_T1State3Pos_C "ARD Führungsformer T1 frei wählbarer Zustand 3 pos. Gradient" VALUE 0xC9148 Kw_Wu32 4294.9673 TimeDelay_s 0.0000010000000 4294.9673 FORMAT "%9.4" /end CHARACTERISTIC
/begin CHARACTERISTIC ASDrf_KdState3Pos_C "ARD Führungsformer Kd=Td/T1 frei wählbarer Zustand 3 pos. Gradient" VALUE 0xC914C Kw_Ws32 32769.0000000 Kd -32768.0000000 1.00000000000 FORMAT "%13.7" EXTENDED_LIMITS -32768.0000000 32767.9999847 /end CHARACTERISTIC
/begin CHARACTERISTIC ASDrf_T1State4Neg_C "ARD Führungsformer T1 frei wählbarer Zustand 4 neg. Gradient" VALUE 0xC9150 Kw_Wu32 4294.9673 TimeDelay_s 0.0000010000000 4294.9673 FORMAT "%9.4" /end CHARACTERISTIC
/begin CHARACTERISTIC ASDrf_KdState4Neg_C "ARD Führungsformer Kd=Td/T1 frei wählbarer Zustand 4 neg. Gradient" VALUE 0xC9154 Kw_Ws32 32769.0000000 Kd -32768.0000000 1.00000000000 FORMAT "%13.7" EXTENDED_LIMITS -32768.0000000 32767.9999847 /end CHARACTERISTIC
/begin CHARACTERISTIC ASDrf_T1State4Pos_C "ARD Führungsformer T1 frei wählbarer Zustand 4 pos. Gradient" VALUE 0xC9158 Kw_Wu32 4294.9673 TimeDelay_s 0.0000010000000 4294.9673 FORMAT "%9.4" /end CHARACTERISTIC
/begin CHARACTERISTIC ASDrf_KdState4Pos_C "ARD Führungsformer Kd=Td/T1 frei wählbarer Zustand 4 pos. Gradient" VALUE 0xC915C Kw_Ws32 32769.0000000 Kd -32768.0000000 1.00000000000 FORMAT "%13.7" EXTENDED_LIMITS -32768.0000000 32767.9999847 /end CHARACTERISTIC
/begin CHARACTERISTIC ASDrf_stConv1_C "Eingangsbedingung ""Wandlerkupplung geschlossen""" VALUE 0xC9160 Kw_Wu8 255.0 OneToOne 0.00 255.0 FORMAT "%5.1" /end CHARACTERISTIC
/begin CHARACTERISTIC ASDrf_stConv2_C "Eingangsbedingung ""Wandlerkupplung geöffnet""" VALUE 0xC9161 Kw_Wu8 255.0 OneToOne 0.00 255.0 FORMAT "%5.1" /end CHARACTERISTIC
/begin CHARACTERISTIC ASDrf_stConv3_C "Eingangsbedingung ""Wandlerkupplung geregelt""" VALUE 0xC9162 Kw_Wu8 255.0 OneToOne 0.00 255.0 FORMAT "%5.1" /end CHARACTERISTIC
/begin CHARACTERISTIC ASDrf_stConvCluEng_C "Bitmuster der Eingangsbedingung für ""geschlossene"" Wandlerkupplung." VALUE 0xC9164 Kw_Wu16 65535.00 OneToOne 0.00 65535.00 FORMAT "%8.2" /end CHARACTERISTIC
/begin CHARACTERISTIC ASDrf_stConvCluOff_C "Bitmuster der Eingangsbedingung für ""geöffnete"" Wandlerkupplung." VALUE 0xC9166 Kw_Wu16 65535.00 OneToOne 0.00 65535.00 FORMAT "%8.2" /end CHARACTERISTIC
/begin CHARACTERISTIC ASDrf_stConvCluSlip_C "Bitmuster der Eingangsbedingung für ""geregelte"" Wandlerkupplung." VALUE 0xC9168 Kw_Wu16 65535.00 OneToOne 0.00 65535.00 FORMAT "%8.2" /end CHARACTERISTIC
/begin CHARACTERISTIC ASDrf_stEntcClu_C "Initialisierungsanforderung beim Eintritt in den Zustand ""offener Antriebsstrang""" VALUE 0xC916A Kw_Wu8 3.000 OneToOne 0.00 3.000 FORMAT "%5.3" EXTENDED_LIMITS 0.00 255.0 /end CHARACTERISTIC
/begin CHARACTERISTIC ASDrf_stEntcExtInt_C "Initialisierungsanforderung beim Eintritt in den Zustand ""externer Momenteneingriff""" VALUE 0xC916B Kw_Wu8 3.000 OneToOne 0.00 3.000 FORMAT "%5.3" EXTENDED_LIMITS 0.00 255.0 /end CHARACTERISTIC
/begin CHARACTERISTIC ASDrf_stEntcFDC_C "status of Vehicle mode" VALUE 0xC916C Kw_Wu8 3.000 OneToOne 0.00 3.000 FORMAT "%5.3" EXTENDED_LIMITS 0.00 255.0 /end CHARACTERISTIC
/begin CHARACTERISTIC ASDrf_stEntcGrip_C "Initialisierungsanforderung beim Eintritt in den Zustand ""Vortrieb""" VALUE 0xC916D Kw_Wu8 3.000 OneToOne 0.00 3.000 FORMAT "%5.3" EXTENDED_LIMITS 0.00 255.0 /end CHARACTERISTIC
/begin CHARACTERISTIC ASDrf_stEntcState3_C "Initialisierungsanforderung beim Eintritt in den Zustand 3" VALUE 0xC916E Kw_Wu8 3.000 OneToOne 0.00 3.000 FORMAT "%5.3" EXTENDED_LIMITS 0.00 255.0 /end CHARACTERISTIC
/begin CHARACTERISTIC ASDrf_stEntcState4_C "Initialisierungsanforderung beim Eintritt in den Zustand 4" VALUE 0xC916F Kw_Wu8 3.000 OneToOne 0.00 3.000 FORMAT "%5.3" EXTENDED_LIMITS 0.00 255.0 /end CHARACTERISTIC
/begin CHARACTERISTIC ASDrf_stExClu_C "Initialisierungsanforderung beim Verlassen des Zustands ""offener Antriebsstrang""" VALUE 0xC9170 Kw_Wu8 3.000 OneToOne 0.00 3.000 FORMAT "%5.3" EXTENDED_LIMITS 0.00 255.0 /end CHARACTERISTIC
/begin CHARACTERISTIC ASDrf_stExExtInt_C "Initialisierungsanforderung beim Verlassen des Zustands ""externer Momenteneingriff""" VALUE 0xC9171 Kw_Wu8 3.000 OneToOne 0.00 3.000 FORMAT "%5.3" EXTENDED_LIMITS 0.00 255.0 /end CHARACTERISTIC
/begin CHARACTERISTIC ASDrf_stExFDC_C "Status des Ausgangs von init-Flag" VALUE 0xC9172 Kw_Wu8 3.000 OneToOne 0.00 3.000 FORMAT "%5.3" EXTENDED_LIMITS 0.00 255.0 /end CHARACTERISTIC
/begin CHARACTERISTIC ASDrf_stExGrip_C "Initialisierungsanforderung beim Verlasssen des Zustands ""Vortrieb""" VALUE 0xC9173 Kw_Wu8 3.000 OneToOne 0.00 3.000 FORMAT "%5.3" EXTENDED_LIMITS 0.00 255.0 /end CHARACTERISTIC
/begin CHARACTERISTIC ASDrf_stExState3_C "Initialisierungsanforderung beim Verlassen des Zustands 3" VALUE 0xC9174 Kw_Wu8 3.000 OneToOne 0.00 3.000 FORMAT "%5.3" EXTENDED_LIMITS 0.00 255.0 /end CHARACTERISTIC
/begin CHARACTERISTIC ASDrf_stExState4_C "Initialisierungsanforderung beim Verlassen des Zustands 4" VALUE 0xC9175 Kw_Wu8 3.000 OneToOne 0.00 3.000 FORMAT "%5.3" EXTENDED_LIMITS 0.00 255.0 /end CHARACTERISTIC
/begin CHARACTERISTIC ASDrf_stExtInt_C "Konfiguration der Eingangsbedingung ""externer Momenteneingriff""" VALUE 0xC9176 Kw_Wu16 65535.00 OneToOne 0.00 65535.00 FORMAT "%8.2" /end CHARACTERISTIC
/begin CHARACTERISTIC ASDrf_stFDC_C "modulation on i/p condition for sport vehicle mode" VALUE 0xC9178 Kw_Wu16 65535.00 OneToOne 0.00 65535.00 FORMAT "%8.2" /end CHARACTERISTIC
/begin CHARACTERISTIC ASDrf_stGrip_C "Konfiguration der Eingangsbedingung ""offener Antriebsstrang""" VALUE 0xC917A Kw_Wu16 65535.00 OneToOne 0.00 65535.00 FORMAT "%8.2" /end CHARACTERISTIC
/begin CHARACTERISTIC ASDrf_stReliablAdpt_C "Flags zur Bestimmung einer vertrauenswürdigen Verlustmomentadaption." VALUE 0xC917C Kw_Wu8 255.0 OneToOne 0.00 255.0 FORMAT "%5.1" /end CHARACTERISTIC
/begin CHARACTERISTIC ASDrf_swtLossClcNoRel_C "Verlustmoment wenn keine Verlustmomentadaption. Applikationsdaten als 0: absolut, 1: offset, 2: offset zum angepassten Moment" VALUE 0xC917D Kw_Wu8 2.000 OneToOne 0.00 2.000 FORMAT "%5.3" EXTENDED_LIMITS 0.00 255.0 /end CHARACTERISTIC
/begin CHARACTERISTIC ASDrf_swtLossClcRel_C " Verlustmoment bei Verlustmomentadaption. Verw. Applikationsdaten als 0: absolut, 1: offset, 2: offset zum angepassten Moment" VALUE 0xC917E Kw_Wu8 2.000 OneToOne 0.00 2.000 FORMAT "%5.3" EXTENDED_LIMITS 0.00 255.0 /end CHARACTERISTIC
/begin CHARACTERISTIC ASDrf_swtOpr_C "Auswahl des Operators für die Primärzustände. (00=OR, 01=AND, 10=NAND, 11=NOR)" VALUE 0xC9180 Kw_Wu16 65535.00 OneToOne 0.00 65535.00 FORMAT "%8.2" /end CHARACTERISTIC
/begin CHARACTERISTIC ASDrf_swtStiffParameter_C "Schalter zur Berücksichtigung der Parameterumschaltung durch DCC" VALUE 0xC9182 Kw_Wu8 1.000 OneToOne 0.00 1.000 FORMAT "%5.3" EXTENDED_LIMITS 0.00 255.0 /end CHARACTERISTIC
/begin CHARACTERISTIC ASDrf_T1FDCNeg_CUR "Curve for n dependent time constant for PDT1 filtering for negative i/p" CURVE 0xC9342 Kl_Xs16_Ws16 1.499985 TimeDelay_s_Lin_16 0.00 1.499985 FORMAT "%8.6" EXTENDED_LIMITS -5.000153 5.000000
 /begin AXIS_DESCR STD_AXIS DrvTrn_rTransDT TransR 8 0.00 100.0000 FORMAT "%8.4" EXTENDED_LIMITS -327.6800 327.6700 DEPOSIT ABSOLUTE /end AXIS_DESCR
/end CHARACTERISTIC
/begin CHARACTERISTIC ASDrf_T1FDCPos_CUR "Curve for n dependent time constant for PDT1 filtering for positive i/p" CURVE 0xC9364 Kl_Xs16_Ws16 1.499985 TimeDelay_s_Lin_16 0.00 1.499985 FORMAT "%8.6" EXTENDED_LIMITS -5.000153 5.000000
 /begin AXIS_DESCR STD_AXIS DrvTrn_rTransDT TransR 8 0.00 100.0000 FORMAT "%8.4" EXTENDED_LIMITS -327.6800 327.6700 DEPOSIT ABSOLUTE /end AXIS_DESCR
/end CHARACTERISTIC
/begin CHARACTERISTIC ASDrf_T1GripNeg_CUR "T1 bei geshchlosenem Antreibsstrang und negativem Gradienten" CURVE 0xC9386 Kl_Xs16_Ws16 1.499985 TimeDelay_s_Lin_16 0.00 1.499985 FORMAT "%8.6" EXTENDED_LIMITS -5.000153 5.000000
 /begin AXIS_DESCR STD_AXIS DrvTrn_rTransDT TransR 6 0.00 100.0000 FORMAT "%8.4" EXTENDED_LIMITS -327.6800 327.6700 DEPOSIT ABSOLUTE /end AXIS_DESCR
/end CHARACTERISTIC
/begin CHARACTERISTIC ASDrf_T1GripPos_CUR "T1 bei geschlosenem Antriebstrang und positivem Gradienten" CURVE 0xC93A0 Kl_Xs16_Ws16 1.499985 TimeDelay_s_Lin_16 0.00 1.499985 FORMAT "%8.6" EXTENDED_LIMITS -5.000153 5.000000
 /begin AXIS_DESCR STD_AXIS DrvTrn_rTransDT TransR 6 0.00 100.0000 FORMAT "%8.4" EXTENDED_LIMITS -327.6800 327.6700 DEPOSIT ABSOLUTE /end AXIS_DESCR
/end CHARACTERISTIC
/begin CHARACTERISTIC ASDrf_trqLossNeg_CUR "Drehzahlabhängige Kennlinie der Verlustmomente für negative Eingangsänderungen." CURVE 0xC9184 Kl_Xs16_Ws16 1500.000 Trq -500.0000 1000.000 FORMAT "%8.3" EXTENDED_LIMITS -3276.800 3276.700
 /begin AXIS_DESCR STD_AXIS Eng_nAvrg EngN 8 0.00 6000.000 FORMAT "%8.3" EXTENDED_LIMITS -32768.00 32767.00 DEPOSIT ABSOLUTE /end AXIS_DESCR
/end CHARACTERISTIC
/begin CHARACTERISTIC ASDrf_trqLossPos_CUR "Drehzahlabhängige Kennlinie der Verlustmomente für positive Eingangsänderungen." CURVE 0xC91A6 Kl_Xs16_Ws16 1500.000 Trq -500.0000 1000.000 FORMAT "%8.3" EXTENDED_LIMITS -3276.800 3276.700
 /begin AXIS_DESCR STD_AXIS Eng_nAvrg EngN 8 0.00 6000.000 FORMAT "%8.3" EXTENDED_LIMITS -32768.00 32767.00 DEPOSIT ABSOLUTE /end AXIS_DESCR
/end CHARACTERISTIC
/begin CHARACTERISTIC ASDrf_trqOfsNegHigh_C "Annäherungsschwelle zum Verlustmoment." VALUE 0xC91C8 Kw_Ws16 1500.000 Trq -500.0000 1000.000 FORMAT "%8.3" EXTENDED_LIMITS -3276.800 3276.700 /end CHARACTERISTIC
/begin CHARACTERISTIC ASDrf_trqOfsNegLow_C "Offset zum Verlustmoment für die Beendigung des Zustands ""Steigungsbegrenzung""." VALUE 0xC91CA Kw_Ws16 1500.000 Trq -500.0000 1000.000 FORMAT "%8.3" EXTENDED_LIMITS -3276.800 3276.700 /end CHARACTERISTIC
/begin CHARACTERISTIC ASDrf_trqOfsNegMid_C "Offset zum Verslustmoment für die Annäherungserkennung und Aktivierung des Zustands ""Steigungsbegrenzung""" VALUE 0xC91CC Kw_Ws16 1500.000 Trq -500.0000 1000.000 FORMAT "%8.3" EXTENDED_LIMITS -3276.800 3276.700 /end CHARACTERISTIC
/begin CHARACTERISTIC ASDrf_trqOfsPosHigh_C "Offset zum Verlustmoment für die Beendigung des Zustands ""Steigungsbegrenzung""." VALUE 0xC91CE Kw_Ws16 1500.000 Trq -500.0000 1000.000 FORMAT "%8.3" EXTENDED_LIMITS -3276.800 3276.700 /end CHARACTERISTIC
/begin CHARACTERISTIC ASDrf_trqOfsPosLow_C "Annäherungsschwelle zum Verlustmoment." VALUE 0xC91D0 Kw_Ws16 1500.000 Trq -500.0000 1000.000 FORMAT "%8.3" EXTENDED_LIMITS -3276.800 3276.700 /end CHARACTERISTIC
/begin CHARACTERISTIC ASDrf_trqOfsPosMid_C "Offset zum Verslustmoment für die Annäherungserkennung und Aktivierung des Zustands ""Steigungsbegrenzung""" VALUE 0xC91D2 Kw_Ws16 1500.000 Trq -500.0000 1000.000 FORMAT "%8.3" EXTENDED_LIMITS -3276.800 3276.700 /end CHARACTERISTIC
/begin CHARACTERISTIC ASMod_dmIndAirRef_MAP "Referenz des Gasmassenstroms als Funktion der Drehzahl und der verbrannten Kraftstoffmasse" MAP 0xC93BA Kf_Xs16_Ys16_Ws16 1400.000 AirMassPerTime 0.00 1400.000 FORMAT "%8.3" EXTENDED_LIMITS -3276.800 3276.700
 /begin AXIS_DESCR STD_AXIS Eng_nAvrg EngN 8 0.00 6000.000 FORMAT "%8.3" EXTENDED_LIMITS -32768.00 32767.00 DEPOSIT ABSOLUTE /end AXIS_DESCR
 /begin AXIS_DESCR STD_AXIS ASMod_qLmbdCtlCorr_mp InjMass 8 0.00 150.0000 FORMAT "%8.4" EXTENDED_LIMITS -327.6800 327.6700 DEPOSIT ABSOLUTE /end AXIS_DESCR
/end CHARACTERISTIC
/begin CHARACTERISTIC ASMod_facDdTm_C "Faktor zur Berechnung der Gaslaufzeit durch den Motor" VALUE 0xC945E Kw_Ws16 7.000000 Fact1 1.000000 8.000000 FORMAT "%8.6" EXTENDED_LIMITS -256.0000 255.9922 /end CHARACTERISTIC
/begin CHARACTERISTIC ASMod_facDMCorTDiff_CUR "Korrekturfaktor der Temperaturerhöhung aufgrund des aktuellen Gasmassenstroms" CURVE 0xC9460 Kl_Xs16_Ws16 2.000000 Fact 0.00 2.000000 FORMAT "%8.6" EXTENDED_LIMITS -4.000000 3.999878
 /begin AXIS_DESCR STD_AXIS ASMod_rDMIndAir_mp RatAirMass 8 -1.000000 1.000000 FORMAT "%8.6" EXTENDED_LIMITS -32.76800 32.76700 DEPOSIT ABSOLUTE /end AXIS_DESCR
/end CHARACTERISTIC
/begin CHARACTERISTIC ASMod_facSOICorTDiff_CUR "Korrekturfaktor der Temperaturerhöhung aufgrund des aktuellen Spritzbeginns" CURVE 0xC9482 Kl_Xs16_Ws16 2.000000 Fact 0.00 2.000000 FORMAT "%8.6" EXTENDED_LIMITS -4.000000 3.999878
 /begin AXIS_DESCR STD_AXIS InjCrv_phiMI1Des AngleCrS 8 -19.99219 19.99219 FORMAT "%8.5" EXTENDED_LIMITS -768.0000 767.9766 DEPOSIT ABSOLUTE /end AXIS_DESCR
/end CHARACTERISTIC
/begin CHARACTERISTIC ASMod_facTCorVolEff_C "Korrekturfaktor zur Kompensation der Abhängigkeit des Luftaufwands von der Gastemperatur vor Einlass" VALUE 0xC9618 Kw_Ws16 2.000000 RatAirMass 0.00 2.000000 FORMAT "%8.6" EXTENDED_LIMITS -32.76800 32.76700 /end CHARACTERISTIC
/begin CHARACTERISTIC ASMod_facVolEff_MAP "Luftaufwand des Motors als Funktion von Drehzahl und aktueller Einspritzmenge" MAP 0xC961A Kf_Xs16_Ys16_Ws16 1.000000 RatAirMass 0.00 1.000000 FORMAT "%8.6" EXTENDED_LIMITS -32.76800 32.76700
 /begin AXIS_DESCR STD_AXIS Eng_nAvrg EngN 10 0.00 6000.000 FORMAT "%8.3" EXTENDED_LIMITS -32768.00 32767.00 DEPOSIT ABSOLUTE /end AXIS_DESCR
 /begin AXIS_DESCR STD_AXIS InjCtl_qCurr InjMassCyc 15 0.00 327.6700 FORMAT "%8.4" EXTENDED_LIMITS -327.6800 327.6700 DEPOSIT ABSOLUTE /end AXIS_DESCR
/end CHARACTERISTIC
/begin CHARACTERISTIC ASMod_facVSACorVolEff_MAP "Korrekturfaktor für Luftaufwand als Funktion von Drehzahl und relativer Drallklappenposition" MAP 0xC977C Kf_Xs16_Ys16_Ws16 2.000000 RatAirMass 0.00 2.000000 FORMAT "%8.6" EXTENDED_LIMITS -32.76800 32.76700
 /begin AXIS_DESCR STD_AXIS Eng_nAvrg EngN 10 0.00 6000.000 FORMAT "%8.3" EXTENDED_LIMITS -32768.00 32767.00 DEPOSIT ABSOLUTE /end AXIS_DESCR
 /begin AXIS_DESCR STD_AXIS ASMod_rRelPosVSA Prc 10 0.00 100.0000 FORMAT "%8.4" EXTENDED_LIMITS -400.0000 399.9878 DEPOSIT ABSOLUTE /end AXIS_DESCR
/end CHARACTERISTIC
/begin CHARACTERISTIC ASMod_phiSOIRef_MAP "Referenz des Spritzbeginns der MI1 als Funktion der Dehzahl und der verbrannten Kraftstoffmenge" MAP 0xC94A4 Kf_Xs16_Ys16_Ws16 60.00000 AngleCrS -19.99219 40.00781 FORMAT "%8.5" EXTENDED_LIMITS -768.0000 767.9766
 /begin AXIS_DESCR STD_AXIS Eng_nAvrg EngN 8 0.00 6000.000 FORMAT "%8.3" EXTENDED_LIMITS -32768.00 32767.00 DEPOSIT ABSOLUTE /end AXIS_DESCR
 /begin AXIS_DESCR STD_AXIS ASMod_qLmbdCtlCorr_mp InjMass 8 0.00 150.0000 FORMAT "%8.4" EXTENDED_LIMITS -327.6800 327.6700 DEPOSIT ABSOLUTE /end AXIS_DESCR
/end CHARACTERISTIC
/begin CHARACTERISTIC ASMod_swtT_C "Schalter für Lufttemperatursenor (0 = Aufnahme der Lufttemperatur vom HFM6 Sensor, 1 = Lufttemperatur nach Kühler)" VALUE 0xC9870 Kw_Wu8 1.000 OneToOne 0.00 1.000 FORMAT "%5.3" EXTENDED_LIMITS 0.00 255.0 /end CHARACTERISTIC
/begin CHARACTERISTIC ASMod_tDiffEng_MAP "Grundkennfeld der Temperaturerhöhung als Funktion der Drehzahl und der verbrannten Kraftstoffmenge" MAP 0xC9548 Kf_Xs16_Ys16_Ws16 1200.000 TempDiff_Cels -600.0000 600.0000 FORMAT "%8.4" EXTENDED_LIMITS -3276.800 3276.700
 /begin AXIS_DESCR STD_AXIS Eng_nAvrg EngN 8 0.00 6000.000 FORMAT "%8.3" EXTENDED_LIMITS -32768.00 32767.00 DEPOSIT ABSOLUTE /end AXIS_DESCR
 /begin AXIS_DESCR STD_AXIS ASMod_qBurned_mp InjMass 8 0.00 150.0000 FORMAT "%8.4" EXTENDED_LIMITS -327.6800 327.6700 DEPOSIT ABSOLUTE /end AXIS_DESCR
/end CHARACTERISTIC
/begin CHARACTERISTIC ASMod_tEngCorTDiff_CUR "Korrektur der Temperaturerhöhung aufgrund der Motortemperatur" CURVE 0xC95EC Kl_Xs16_Ws16 950.0000 Temp_Cels -50.1400 899.8600 FORMAT "%8.4" EXTENDED_LIMITS -3549.8000 3003.7000
 /begin AXIS_DESCR STD_AXIS ASMod_tEngCorTDiff_mp TempDiff_Cels 8 -20.00000 120.0000 FORMAT "%8.4" EXTENDED_LIMITS -3276.800 3276.700 DEPOSIT ABSOLUTE /end AXIS_DESCR
/end CHARACTERISTIC
/begin CHARACTERISTIC ASMod_tEngRef_C "Referenz der Motoretemperatur" VALUE 0xC960E Kw_Ws16 950.0000 Temp_Cels -50.1400 899.8600 FORMAT "%8.4" EXTENDED_LIMITS -3549.940 3003.560 /end CHARACTERISTIC
/begin CHARACTERISTIC ASMod_tiDT1_C "Zeitkonstante des DT1-Glieds in der Funktion Einlaßvolumen (induction volume)" VALUE 0xC9610 Kw_Wu32 4.9499617 TimeDelay_s 0.050000201 4.9999619 FORMAT "%9.7" EXTENDED_LIMITS 0.0000010000000 4294.9673 /end CHARACTERISTIC
/begin CHARACTERISTIC ASMod_tIndAirRef_MAP "Referenz der Gastemperatur vor Einlass als Funktion von Drehzahl und aktueller Einspritzmenge" MAP 0xC9872 Kf_Xs16_Ys16_Ws16 250.0000 Temp_Cels -50.1400 199.8600 FORMAT "%8.4" EXTENDED_LIMITS -3549.940 3003.560
 /begin AXIS_DESCR STD_AXIS Eng_nAvrg EngN 10 0.00 6000.000 FORMAT "%8.3" EXTENDED_LIMITS -32768.00 32767.00 DEPOSIT ABSOLUTE /end AXIS_DESCR
 /begin AXIS_DESCR STD_AXIS InjCtl_qCurr InjMassCyc 10 0.00 327.6700 FORMAT "%8.4" EXTENDED_LIMITS -327.6800 327.6700 DEPOSIT ABSOLUTE /end AXIS_DESCR
/end CHARACTERISTIC
/begin CHARACTERISTIC ASMod_volEng_C "Hubvolumen des Motors" VALUE 0xC9966 Kw_Ws16 20.00000 Vol 0.00 20.00000 FORMAT "%8.5" EXTENDED_LIMITS -327.6800 327.6700 /end CHARACTERISTIC
/begin CHARACTERISTIC ASMod_volIndVol_C "Einlaßvolumen (effektives Volumen zwischen Turbolader und Mischstelle)" VALUE 0xC9614 Kw_Ws16 50.00000 Vol 0.00 50.00000 FORMAT "%8.5" EXTENDED_LIMITS -327.6800 327.6700 /end CHARACTERISTIC
/begin CHARACTERISTIC BattCD_uSRCMin_C "SRC-Min der Batteriespannung" VALUE 0xC996C Kw_Ws16 5200.391 Volt 0.00 5200.391 FORMAT "%8.3" EXTENDED_LIMITS -160156.4 160151.5 /end CHARACTERISTIC
/begin CHARACTERISTIC BattCD_uSRCMax_C "SRC-Max der Batteriespannung" VALUE 0xC996E Kw_Ws16 5200.391 Volt 0.00 5200.391 FORMAT "%8.3" EXTENDED_LIMITS -160156.4 160151.5 /end CHARACTERISTIC
/begin CHARACTERISTIC BattCD_uLin_CUR "Linearisierungskennlinie" CURVE 0xC9970 Kl_Xs16_Ws16 28602.15 Volt_Batt 0.00 28602.15 FORMAT "%8.2" EXTENDED_LIMITS -640625.6 640606.1
 /begin AXIS_DESCR STD_AXIS BattCD_uRaw Volt 25 0.00 5200.391 FORMAT "%8.3" EXTENDED_LIMITS -160156.4 160151.5 DEPOSIT ABSOLUTE /end AXIS_DESCR
/end CHARACTERISTIC
/begin CHARACTERISTIC BattCD_DebSRCHighDef_C "Entprellzeit für Fehlererkennung des SRC-High-Fehlers der Batteriespannung" VALUE 0xC99D6 Kw_Wu16 655350.0 Time_ms 0.00 655350.0 FORMAT "%8.1" /end CHARACTERISTIC
/begin CHARACTERISTIC BattCD_DebSRCHighOk_C "Entprellzeit für Heilung des SRC-High-Fehlers der Batteriespannung" VALUE 0xC99D8 Kw_Wu16 655350.0 Time_ms 0.00 655350.0 FORMAT "%8.1" /end CHARACTERISTIC
/begin CHARACTERISTIC BattCD_DebSRCLowDef_C "Entprellzeit für Fehlererkennung des SRC-Low-Fehlers der Batteriespannung" VALUE 0xC99DA Kw_Wu16 655350.0 Time_ms 0.00 655350.0 FORMAT "%8.1" /end CHARACTERISTIC
/begin CHARACTERISTIC BattCD_DebSRCLowOk_C "Entprellzeit für Heilung des SRC-Low-Fehlers der Batteriespannung" VALUE 0xC99DC Kw_Wu16 655350.0 Time_ms 0.00 655350.0 FORMAT "%8.1" /end CHARACTERISTIC
/begin CHARACTERISTIC BattCD_numAdc_C "#SSD Applikationsparameter" VALUE 0xC99DE Kw_Wu8 26.0000000000 NumPinAdc 0.00 26.0000000000 FORMAT "%13.10" /end CHARACTERISTIC
/begin CHARACTERISTIC BattCD_duRmpSlpUp_C "Rampe Zunahme Batteriespannung negative Steigung" VALUE 0xC99E0 Kw_Wu32 1281250244.02 RmpVoltBatt 977.576769459 1281251221.60 FORMAT "%13.2" EXTENDED_LIMITS 0.00 1281251221.60 /end CHARACTERISTIC
/begin CHARACTERISTIC BattCD_duRmpSlpDwn_C "Rampe Zunahme Batteriespannung positive Steigung" VALUE 0xC99E4 Kw_Wu32 1281250244.02 RmpVoltBatt 977.576769459 1281251221.60 FORMAT "%13.2" EXTENDED_LIMITS 0.00 1281251221.60 /end CHARACTERISTIC
/begin CHARACTERISTIC BattCD_stSensIDWord_C "Kennung Batteriespannungserfassung" VALUE 0xC99E8 Kw_Wu16 65535.00 OneToOne 0.00 65535.00 FORMAT "%8.2" /end CHARACTERISTIC
/begin CHARACTERISTIC BattCD_uDfl_C "Vorgabewert Batteriespannung" VALUE 0xC99EA Kw_Ws16 28602.15 Volt_Batt 0.00 28602.15 FORMAT "%8.2" EXTENDED_LIMITS -640625.6 640606.1 /end CHARACTERISTIC
/begin CHARACTERISTIC Batt_uNrm_C "#SSD Normierte Batteriespannung" VALUE 0xC9968 Kw_Ws16 1281232. Volt_Batt -640625.6 640606.1 FORMAT "%8.1" /end CHARACTERISTIC
/begin CHARACTERISTIC BPACD_ctPwrStgOnMax_C "Maximum der Endstufen aktivierungen im Fahrzyklus bei SCB oder Übertemperatur Fehler" VALUE 0xC99EC Kw_Wu16 65535.00 OneToOne 0.00 65535.00 FORMAT "%8.2" /end CHARACTERISTIC
/begin CHARACTERISTIC BPACD_tiDebBPADia1Def_C "debounce duration for boost pressure actor diagnosis error detection" VALUE 0xC99EE Kw_Wu16 655350.0 Time_ms 0.00 655350.0 FORMAT "%8.1" /end CHARACTERISTIC
/begin CHARACTERISTIC BPACD_tiDebBPADia1Ok_C "debounce duration for boost pressure actor diagnosis error healing" VALUE 0xC99F0 Kw_Wu16 655350.0 Time_ms 0.00 655350.0 FORMAT "%8.1" /end CHARACTERISTIC
/begin CHARACTERISTIC BPACD_tiDebBPADia2Def_C "debounce duration for boost pressure actor diagnosis error detection" VALUE 0xC99F2 Kw_Wu16 655350.0 Time_ms 0.00 655350.0 FORMAT "%8.1" /end CHARACTERISTIC
/begin CHARACTERISTIC BPACD_tiDebBPADia2Ok_C "debounce duration for boost pressure actor diagnosis error healing" VALUE 0xC99F4 Kw_Wu16 655350.0 Time_ms 0.00 655350.0 FORMAT "%8.1" /end CHARACTERISTIC
/begin CHARACTERISTIC BPACD_tiDebBPADia3Def_C "debounce duration for boost pressure actor diagnosis error detection" VALUE 0xC99F6 Kw_Wu16 655350.0 Time_ms 0.00 655350.0 FORMAT "%8.1" /end CHARACTERISTIC
/begin CHARACTERISTIC BPACD_tiDebBPADia3Ok_C "debounce duration for boost pressure actor diagnosis error healing" VALUE 0xC99F8 Kw_Wu16 655350.0 Time_ms 0.00 655350.0 FORMAT "%8.1" /end CHARACTERISTIC
/begin CHARACTERISTIC BPACD_tiDebBPADia4Def_C "Defektentprellzeit für Fensterdiagnose 4" VALUE 0xC99FA Kw_Wu16 655350.0 Time_ms 0.00 655350.0 FORMAT "%8.1" /end CHARACTERISTIC
/begin CHARACTERISTIC BPACD_tiDebBPADia4Ok_C "Heilentprellzeit für Fensterdiagnose 4" VALUE 0xC99FC Kw_Wu16 655350.0 Time_ms 0.00 655350.0 FORMAT "%8.1" /end CHARACTERISTIC
/begin CHARACTERISTIC BPACD_DebExcTempDef_C "#SSD Fehlerentprellzeit für Übertemperatur" VALUE 0xC99FE Kw_Wu16 655350.0 Time_ms 0.00 655350.0 FORMAT "%8.1" /end CHARACTERISTIC
/begin CHARACTERISTIC BPACD_DebExcTempOk_C "Heilungsentprellzeit für Übertemperatur" VALUE 0xC9A00 Kw_Wu16 655350.0 Time_ms 0.00 655350.0 FORMAT "%8.1" /end CHARACTERISTIC
/begin CHARACTERISTIC BPACD_DebExtNplDef_C "Nichtplaus Fehlerentprellzeit für extra BPA Diagnoseeingang Pin" VALUE 0xC9A02 Kw_Wu16 655350.0 Time_ms 0.00 655350.0 FORMAT "%8.1" /end CHARACTERISTIC
/begin CHARACTERISTIC BPACD_DebExtNplOk_C "Nichtplaus Heilentprellzeit für extra BPA Diagnoseeingang-Pin" VALUE 0xC9A04 Kw_Wu16 655350.0 Time_ms 0.00 655350.0 FORMAT "%8.1" /end CHARACTERISTIC
/begin CHARACTERISTIC BPACD_DebExtShortCircBatDef_C "Kurzschluss nach UBat Fehlerentprellzeit für extra BPA Diagnoseeingang-Pin" VALUE 0xC9A06 Kw_Wu16 655350.0 Time_ms 0.00 655350.0 FORMAT "%8.1" /end CHARACTERISTIC
/begin CHARACTERISTIC BPACD_DebExtShortCircBatOk_C "Kurzschluss nach Ubat Heilentprellzeit für extra BPA Diagnoseeingang-Pin" VALUE 0xC9A08 Kw_Wu16 655350.0 Time_ms 0.00 655350.0 FORMAT "%8.1" /end CHARACTERISTIC
/begin CHARACTERISTIC BPACD_DebExtShortCircGndDef_C "Kurzschluss nach Masse Fehlerentprellzeit für extra BPA Diagnoseeingang-Pin" VALUE 0xC9A0A Kw_Wu16 655350.0 Time_ms 0.00 655350.0 FORMAT "%8.1" /end CHARACTERISTIC
/begin CHARACTERISTIC BPACD_DebExtShortCircGndOk_C "Kurzschluss nach Masse Heilentprellzeit für extra BPA Diagnoseeingang-Pin" VALUE 0xC9A0C Kw_Wu16 655350.0 Time_ms 0.00 655350.0 FORMAT "%8.1" /end CHARACTERISTIC
/begin CHARACTERISTIC BPACD_DebNoLoadDef_C "#SSD Fehlerentprellzeit für Lastabfall" VALUE 0xC9A0E Kw_Wu16 655350.0 Time_ms 0.00 655350.0 FORMAT "%8.1" /end CHARACTERISTIC
/begin CHARACTERISTIC BPACD_DebNoLoadOk_C "Heilungsentprellzeit für Lastabfall" VALUE 0xC9A10 Kw_Wu16 655350.0 Time_ms 0.00 655350.0 FORMAT "%8.1" /end CHARACTERISTIC
/begin CHARACTERISTIC BPACD_tiDebPwmInDia1Def_C "Fehlerentprellzeit für Fehler 1 von PWM-Diag-Signal" VALUE 0xC9A12 Kw_Wu16 655350.0 Time_ms 0.00 655350.0 FORMAT "%8.1" /end CHARACTERISTIC
/begin CHARACTERISTIC BPACD_tiDebPwmInDia1Ok_C "Heilentprellzeit für Fehler 1 von PWM-Diag-Signal" VALUE 0xC9A14 Kw_Wu16 655350.0 Time_ms 0.00 655350.0 FORMAT "%8.1" /end CHARACTERISTIC
/begin CHARACTERISTIC BPACD_tiDebPwmInDia2Def_C "Fehlerentprellzeit für Fehler 2 von PWM-Diag-Signal" VALUE 0xC9A16 Kw_Wu16 655350.0 Time_ms 0.00 655350.0 FORMAT "%8.1" /end CHARACTERISTIC
/begin CHARACTERISTIC BPACD_tiDebPwmInDia2Ok_C "Heilentprellzeit für Fehler 2 von PWM-Diag-Signal" VALUE 0xC9A18 Kw_Wu16 655350.0 Time_ms 0.00 655350.0 FORMAT "%8.1" /end CHARACTERISTIC
/begin CHARACTERISTIC BPACD_tiDebPwmInDia3Def_C "Fehlerentprellzeit für Fehler 3 von PWM-Diag-Signal" VALUE 0xC9A1A Kw_Wu16 655350.0 Time_ms 0.00 655350.0 FORMAT "%8.1" /end CHARACTERISTIC
/begin CHARACTERISTIC BPACD_tiDebPwmInDia3Ok_C "Heilentprellzeit für Fehler 3 von PWM-Diag-Signal" VALUE 0xC9A1C Kw_Wu16 655350.0 Time_ms 0.00 655350.0 FORMAT "%8.1" /end CHARACTERISTIC
/begin CHARACTERISTIC BPACD_tiDebPwmInDia4Def_C "Fehlerentprellzeit für Fehler 4 von PWM-Diag-Signal" VALUE 0xC9A1E Kw_Wu16 655350.0 Time_ms 0.00 655350.0 FORMAT "%8.1" /end CHARACTERISTIC
/begin CHARACTERISTIC BPACD_tiDebPwmInDia4Ok_C "Heilentprellzeit für Fehler 4 von PWM-Diag-Signal" VALUE 0xC9A20 Kw_Wu16 655350.0 Time_ms 0.00 655350.0 FORMAT "%8.1" /end CHARACTERISTIC
/begin CHARACTERISTIC BPACD_DebShortCircBatDef_C "#SSD Fehlerentprellzeitzeit für Kurzschluß nach Batteriespannung" VALUE 0xC9A22 Kw_Wu16 655350.0 Time_ms 0.00 655350.0 FORMAT "%8.1" /end CHARACTERISTIC
/begin CHARACTERISTIC BPACD_DebShortCircBatOk_C "Heilungsentprellzeit für Kurzschluß nach Batteriespannung" VALUE 0xC9A24 Kw_Wu16 655350.0 Time_ms 0.00 655350.0 FORMAT "%8.1" /end CHARACTERISTIC
/begin CHARACTERISTIC BPACD_DebShortCircGndDef_C "#SSD Fehlerentprellzeit für Kurzschluß nach Masse" VALUE 0xC9A26 Kw_Wu16 655350.0 Time_ms 0.00 655350.0 FORMAT "%8.1" /end CHARACTERISTIC
/begin CHARACTERISTIC BPACD_DebShortCircGndOk_C "Heilungsentprellzeit für Kurzschluß nach Masse" VALUE 0xC9A28 Kw_Wu16 655350.0 Time_ms 0.00 655350.0 FORMAT "%8.1" /end CHARACTERISTIC
/begin CHARACTERISTIC BPACD_numDia_C "#SSD Applikationsparameter fuer Diagnose Signal :BP-Steller" VALUE 0xC9A2A Kw_Wu8 27.0000000000 NumPinDia 0.00 27.0000000000 FORMAT "%13.10" /end CHARACTERISTIC
/begin CHARACTERISTIC BPACD_numExtPin_C "Pinnummer für extra BPA-Diagnose PWM-Eingang" VALUE 0xC9A2B Kw_Wu8 3.00000000000 NumPinPwmIn 0.00 3.00000000000 FORMAT "%13.11" /end CHARACTERISTIC
/begin CHARACTERISTIC BPACD_numPwmOut_C "#SSD Applikationsparameter fuer Ladedruck-Steller" VALUE 0xC9A2C Kw_Wu8 13.0000000000 NumPinPwmOut 0.00 13.0000000000 FORMAT "%13.10" /end CHARACTERISTIC
/begin CHARACTERISTIC BPACD_stDiaInv_C "Invertierungsschalter für extra BPA-Diagnose PWM-Eingang" VALUE 0xC9A2E Kw_Wu8 1.000 OneToOne 0.00 1.000 FORMAT "%5.3" EXTENDED_LIMITS 0.00 255.0 /end CHARACTERISTIC
/begin CHARACTERISTIC BPACD_tiDiaMin_C "Minimale Periodendauer für extra BPA-Diagnose PWM-Eingang" VALUE 0xC9A30 Kw_Ws16 3276.700 Period 0.00 3276.700 FORMAT "%8.3" EXTENDED_LIMITS -3276.800 3276.700 /end CHARACTERISTIC
/begin CHARACTERISTIC BPACD_tiDiaMax_C "Maximale Periodendauer für extra BPA-Diagnose PWM-Eingang" VALUE 0xC9A32 Kw_Ws16 3276.700 Period 0.00 3276.700 FORMAT "%8.3" EXTENDED_LIMITS -3276.800 3276.700 /end CHARACTERISTIC
/begin CHARACTERISTIC BPACD_rDiaMin_C "Minimales Tastverhältnis für extra BPA-Diagnose PWM-Eingang" VALUE 0xC9A34 Kw_Ws16 100.0000 DtyCyc 0.00 100.0000 FORMAT "%8.4" EXTENDED_LIMITS -327.6800 327.6700 /end CHARACTERISTIC
/begin CHARACTERISTIC BPACD_rDiaMax_C "Maximales Tastverhältnis für extra BPA-Diagnose PWM-Eingang" VALUE 0xC9A36 Kw_Ws16 100.0000 DtyCyc 0.00 100.0000 FORMAT "%8.4" EXTENDED_LIMITS -327.6800 327.6700 /end CHARACTERISTIC
/begin CHARACTERISTIC BPACD_stInvOut_C "Invertierungsparameter für das Signal der Ladedruckstellerendstufe" VALUE 0xC9A38 Kw_Wu8 1.000 OneToOne 0.00 1.000 FORMAT "%5.3" EXTENDED_LIMITS 0.00 255.0 /end CHARACTERISTIC
/begin CHARACTERISTIC BPACD_tiPer_C "Periodendauer Ladedrucksteller." VALUE 0xC9A3A Kw_Ws16 6553.500 Period -3276.800 3276.700 FORMAT "%8.3" /end CHARACTERISTIC
/begin CHARACTERISTIC BPACD_rCnv_CUR "Kennlinie zur konvertierung von Öffnungsgrad in Tastverhältnis" CURVE 0xC9A3C Kl_Xs16_Ws16 100.0000 DtyCyc 0.00 100.0000 FORMAT "%8.4" EXTENDED_LIMITS -327.6800 327.6700
 /begin AXIS_DESCR STD_AXIS BPA_rBPACD Prc 25 -100.0000 200.0000 FORMAT "%8.4" EXTENDED_LIMITS -400.0000 399.9878 DEPOSIT ABSOLUTE /end AXIS_DESCR
/end CHARACTERISTIC
/begin CHARACTERISTIC BPACD_rLin_CUR "Kennlinie von Tastverhältnis des extra BPA-Diagnose PWM-Eingangs zur tatsächlichen BPA-Position" CURVE 0xC9AA2 Kl_Xs16_Ws16 100.0000 Prc 0.00 100.0000 FORMAT "%8.4" EXTENDED_LIMITS -400.0000 399.9878
 /begin AXIS_DESCR STD_AXIS BPACD_rRaw DtyCyc 25 0.00 100.0000 FORMAT "%8.4" EXTENDED_LIMITS -327.6800 327.6700 DEPOSIT ABSOLUTE /end AXIS_DESCR
/end CHARACTERISTIC
/begin CHARACTERISTIC BPACD_rOutMax_C "Maximal auszugebendes Tastverhältnis" VALUE 0xC9B08 Kw_Ws16 655.3500 DtyCyc -327.6800 327.6700 FORMAT "%8.4" /end CHARACTERISTIC
/begin CHARACTERISTIC BPACD_rOutMin_C "Minimal auszugebendes Tastverhältnis" VALUE 0xC9B0A Kw_Ws16 655.3500 DtyCyc -327.6800 327.6700 FORMAT "%8.4" /end CHARACTERISTIC
/begin CHARACTERISTIC BPACD_rTst_C "Tastverhältnis, dass im Fehlerfall zyklisch ausgegeben wird" VALUE 0xC9B0C Kw_Ws16 100.0000 DtyCyc 0.00 100.0000 FORMAT "%8.4" EXTENDED_LIMITS -327.6800 327.6700 /end CHARACTERISTIC
/begin CHARACTERISTIC BPACD_stPwrStgActv_C "Aktivierung der Abschaltbedingungen der Endstufe" VALUE 0xC9B0E Kw_Wu8 255.0 OneToOne 0.00 255.0 FORMAT "%5.1" /end CHARACTERISTIC
/begin CHARACTERISTIC BPACD_stPwrStgDia_C "#SSD Aktivierung der Abschaltbedingungen der Endstufediagnose" VALUE 0xC9B0F Kw_Wu8 255.0 OneToOne 0.00 255.0 FORMAT "%5.1" /end CHARACTERISTIC
/begin CHARACTERISTIC BPACD_stSPICtl_C "Parameter zur Auswahl des Endstufentypes  ( 1 = SPI Endstufe, 0 = Nicht SPI Endstufe )" VALUE 0xC9B10 Kw_Wu8 1.000 OneToOne 0.00 1.000 FORMAT "%5.3" EXTENDED_LIMITS 0.00 255.0 /end CHARACTERISTIC
/begin CHARACTERISTIC BPACD_swtExtPinEna_C "Schalter zur Aktivierung der BPA-Diagnose via extra PWM-Eingang" VALUE 0xC9B11 Kw_Wu8 255.0 OneToOne 0.00 255.0 FORMAT "%5.1" /end CHARACTERISTIC
/begin CHARACTERISTIC BPACD_swt_C "Schalter für Batteriespannungskorrektur (0 = AUS, 1 = EIN)" VALUE 0xC9B12 Kw_Wu8 255.0 OneToOne 0.00 255.0 FORMAT "%5.1" /end CHARACTERISTIC
/begin CHARACTERISTIC BPACD_tiBtwTst_C "#SSD Zeitabstand, in dem im Fehlerfall die Endstufe getestet wird" VALUE 0xC9B14 Kw_Wu16 29980.00 Time_ms 20.00000 30000.00 FORMAT "%8.2" EXTENDED_LIMITS 0.00 655350.0 /end CHARACTERISTIC
/begin CHARACTERISTIC BPACD_tiDiag1Max_C "window 1 max. time" VALUE 0xC9B16 Kw_Wu16 655350.0 Time_ms 0.00 655350.0 FORMAT "%8.1" /end CHARACTERISTIC
/begin CHARACTERISTIC BPACD_tiDiag1Min_C "window 1 min. time" VALUE 0xC9B18 Kw_Wu16 655350.0 Time_ms 0.00 655350.0 FORMAT "%8.1" /end CHARACTERISTIC
/begin CHARACTERISTIC BPACD_tiDiag2Max_C "window 2 max. time" VALUE 0xC9B1A Kw_Wu16 655350.0 Time_ms 0.00 655350.0 FORMAT "%8.1" /end CHARACTERISTIC
/begin CHARACTERISTIC BPACD_tiDiag2Min_C "window 2 min. time" VALUE 0xC9B1C Kw_Wu16 655350.0 Time_ms 0.00 655350.0 FORMAT "%8.1" /end CHARACTERISTIC
/begin CHARACTERISTIC BPACD_tiDiag3Max_C "window 3 max. time" VALUE 0xC9B1E Kw_Wu16 655350.0 Time_ms 0.00 655350.0 FORMAT "%8.1" /end CHARACTERISTIC
/begin CHARACTERISTIC BPACD_tiDiag3Min_C "window 3 min. time" VALUE 0xC9B20 Kw_Wu16 655350.0 Time_ms 0.00 655350.0 FORMAT "%8.1" /end CHARACTERISTIC
/begin CHARACTERISTIC BPACD_tiDiag4Max_C "Maximale Zeit für Fensterdiagnose 4" VALUE 0xC9B22 Kw_Wu16 655350.0 Time_ms 0.00 655350.0 FORMAT "%8.1" /end CHARACTERISTIC
/begin CHARACTERISTIC BPACD_tiDiag4Min_C "Minimale Zeit für Fensterdiagnose 4" VALUE 0xC9B24 Kw_Wu16 655350.0 Time_ms 0.00 655350.0 FORMAT "%8.1" /end CHARACTERISTIC
/begin CHARACTERISTIC BPACD_tiPwrStgOn_C "Zeit für die die Endstufe eingeschalten wird bei nicht SPI Endstufen" VALUE 0xC9B26 Kw_Wu16 655140.0 Time_ms 0.00 655140.0 FORMAT "%8.1" EXTENDED_LIMITS 0.00 655350.0 /end CHARACTERISTIC
/begin CHARACTERISTIC BPA_rBPACD_Vector "#SSD Bypass-Label für BPA_rBPA" VALUE 0xC392C Kw_Wu8 255.0 OneToOne 0.00 255.0 FORMAT "%5.1" /end CHARACTERISTIC
/begin CHARACTERISTIC BPA_rBPACD_Channel "#SSD Bypass-Label für BPA_rBPA" VALUE 0xC392D Kw_Wu8 255.0 OneToOne 0.00 255.0 FORMAT "%5.1" /end CHARACTERISTIC
/begin CHARACTERISTIC BPA_rLPACD_Vector "#SSD Konfigurationslabel für Bypass Freischnitt" VALUE 0xC392E Kw_Wu8 255.0 OneToOne 0.00 255.0 FORMAT "%5.1" /end CHARACTERISTIC
/begin CHARACTERISTIC BPA_rLPACD_Channel "#SSD Konfigurationslabel für Bypass Freischnitt" VALUE 0xC392F Kw_Wu8 255.0 OneToOne 0.00 255.0 FORMAT "%5.1" /end CHARACTERISTIC
/begin CHARACTERISTIC BPSCD_uSRCMin_C "#SSD SRC-Min-Wert für Ladedruck." VALUE 0xC9B28 Kw_Ws16 5200.391 Volt 0.00 5200.391 FORMAT "%8.3" EXTENDED_LIMITS -160156.4 160151.5 /end CHARACTERISTIC
/begin CHARACTERISTIC BPSCD_uSRCMax_C "#SSD SRC-Max-Wert für Ladedruck." VALUE 0xC9B2A Kw_Ws16 5200.391 Volt 0.00 5200.391 FORMAT "%8.3" EXTENDED_LIMITS -160156.4 160151.5 /end CHARACTERISTIC
/begin CHARACTERISTIC BPSCD_pLin_CUR "Linearisierungskennlinie" CURVE 0xC9B2C Kl_Xs16_Ws16 5000.000 Pres_hPa 0.00 5000.000 FORMAT "%8.3" EXTENDED_LIMITS -32768.00 32767.00
 /begin AXIS_DESCR STD_AXIS BPSCD_uRawVal Volt 25 0.00 5000.000 FORMAT "%8.3" EXTENDED_LIMITS -160156.4 160151.5 DEPOSIT ABSOLUTE /end AXIS_DESCR
/end CHARACTERISTIC
/begin CHARACTERISTIC BPSCD_DebNplDef_C "#SSD Fehlerentprellung Plausbilitätsfehler" VALUE 0xC9B92 Kw_Wu16 655350.0 Time_ms 0.00 655350.0 FORMAT "%8.1" /end CHARACTERISTIC
/begin CHARACTERISTIC BPSCD_DebNplOK_C "Heilungsentprellung Plausbilitätsfehler" VALUE 0xC9B94 Kw_Wu16 655350.0 Time_ms 0.00 655350.0 FORMAT "%8.1" /end CHARACTERISTIC
/begin CHARACTERISTIC BPSCD_DebSigDef_C "#SSD Defektentprellzeit fuer CAN Signal defekt" VALUE 0xC9B96 Kw_Wu16 655350.0 Time_ms 0.00 655350.0 FORMAT "%8.1" /end CHARACTERISTIC
/begin CHARACTERISTIC BPSCD_DebSigOK_C "Heilungsentprellzeit fuer CAN Signal defekt" VALUE 0xC9B98 Kw_Wu16 655350.0 Time_ms 0.00 655350.0 FORMAT "%8.1" /end CHARACTERISTIC
/begin CHARACTERISTIC BPSCD_DebSRCHighDef_C "#SSD Fehlerentprellzeit fuer SRC-High Fehler" VALUE 0xC9B9A Kw_Wu16 655350.0 Time_ms 0.00 655350.0 FORMAT "%8.1" /end CHARACTERISTIC
/begin CHARACTERISTIC BPSCD_DebSRCHighOK_C "Heilungsentprellzeit fuer SRC-High Fehler" VALUE 0xC9B9C Kw_Wu16 655350.0 Time_ms 0.00 655350.0 FORMAT "%8.1" /end CHARACTERISTIC
/begin CHARACTERISTIC BPSCD_DebSRCLowDef_C "#SSD Fehlerentprellzeit fuer SRC-Low Fehler" VALUE 0xC9B9E Kw_Wu16 655350.0 Time_ms 0.00 655350.0 FORMAT "%8.1" /end CHARACTERISTIC
/begin CHARACTERISTIC BPSCD_DebSRCLowOK_C "Heilungsentprellzeit fuer SRC-Low Fehler" VALUE 0xC9BA0 Kw_Wu16 655350.0 Time_ms 0.00 655350.0 FORMAT "%8.1" /end CHARACTERISTIC
/begin CHARACTERISTIC BPSCD_tiDT1_C "Reciprocal of time delay" VALUE 0xC9BA4 Kw_Wu32 4294.9663 TimeDelay_s 0.0010000001 4294.9673 FORMAT "%9.4" EXTENDED_LIMITS 0.0000010000000 4294.9673 /end CHARACTERISTIC
/begin CHARACTERISTIC BPSCD_dDT1Kd_C "Reciprocal of time delay" VALUE 0xC9BA8 Kw_Ws32 10.0000000000 Kd 0.00 10.0000000000 FORMAT "%13.10" EXTENDED_LIMITS -32768.0000000 32767.9999847 /end CHARACTERISTIC
/begin CHARACTERISTIC BPSCD_tiLPFiltPT1_C "Zeitkonstante Tiefpass fuer Ladedruck_Fuehler" VALUE 0xC0494 Kw_Wu32 4294.9673 TimeDelay_s 0.0000010000000 4294.9673 FORMAT "%9.4" /end CHARACTERISTIC
/begin CHARACTERISTIC BPSCD_nLim_C "Obere Grenze Motordrehzahl." VALUE 0xC9BAC Kw_Ws16 6000.000 EngN 0.00 6000.000 FORMAT "%8.3" EXTENDED_LIMITS -32768.00 32767.00 /end CHARACTERISTIC
/begin CHARACTERISTIC BPSCD_numAdc_C "#SSD Applikationsparameter fuer Ladedruck-Steller" VALUE 0xC9BAE Kw_Wu8 26.0000000000 NumPinAdc 0.00 26.0000000000 FORMAT "%13.10" /end CHARACTERISTIC
/begin CHARACTERISTIC BPSCD_pDiffLim_C "Grenzwert für absolute Differenz zwischen LD und AD" VALUE 0xC9BB0 Kw_Ws16 3500.000 Pres_hPa 0.00 3500.000 FORMAT "%8.3" EXTENDED_LIMITS -32768.00 32767.00 /end CHARACTERISTIC
/begin CHARACTERISTIC BPSCD_tiOutValDT1_C "Totzeit für  Ladedruck DT1 filter" VALUE 0xC9BB4 Kw_Wu32 4294.9673 TimeDelay_s 0.0000010000000 4294.9673 FORMAT "%9.4" /end CHARACTERISTIC
/begin CHARACTERISTIC BPSCD_dDT1KdOutVal_C "Verstärkungskonstante des DT1 filters für  Ladedrucksignal" VALUE 0xC9BB8 Kw_Ws32 32767.9999847 Kd 0.00 32767.9999847 FORMAT "%13.7" EXTENDED_LIMITS -32768.0000000 32767.9999847 /end CHARACTERISTIC
/begin CHARACTERISTIC BPSCD_tiPT1_C "Verzugszeit. (für PT1 Filter )" VALUE 0xC9BBC Kw_Wu32 4294.9673 TimeDelay_s 0.0000010000000 4294.9673 FORMAT "%9.4" /end CHARACTERISTIC
/begin CHARACTERISTIC BPSCD_dpRmpSlpUp_C "Rampensteigung bei Heilung/Vorgabewert für LDF" VALUE 0xC9BC0 Kw_Wu32 65535899.9786 RmpPres_hPa 100.006103516 65535999.9847 FORMAT "%13.4" EXTENDED_LIMITS 0.00 65535999.9847 /end CHARACTERISTIC
/begin CHARACTERISTIC BPSCD_dpRmpSlpDwn_C "Rampensteigung bei Heilung/Vorgabewert für LDF" VALUE 0xC9BC4 Kw_Wu32 65535899.9786 RmpPres_hPa 100.006103516 65535999.9847 FORMAT "%13.4" EXTENDED_LIMITS 0.00 65535999.9847 /end CHARACTERISTIC
/begin CHARACTERISTIC BPSCD_swtSigVal_C "#SSD Schalter ob Signal ueber CAN/ADC (0 = ADC, 1 = CAN)" VALUE 0xC9BC8 Kw_Wu8 1.000 OneToOne 0.00 1.000 FORMAT "%5.3" EXTENDED_LIMITS 0.00 255.0 /end CHARACTERISTIC
/begin CHARACTERISTIC BPSCD_stSensIDWord_C "Geberkennwort LDF" VALUE 0xC9BCA Kw_Wu16 65535.00 OneToOne 0.00 65535.00 FORMAT "%8.2" /end CHARACTERISTIC
/begin CHARACTERISTIC BPSCD_pDfl_C "Ladedruck Vorgabewert" VALUE 0xC9BCC Kw_Ws16 65535.00 Pres_hPa -32768.00 32767.00 FORMAT "%8.2" /end CHARACTERISTIC
/begin CHARACTERISTIC BrkCD_ctUnPlausDef_C "Defektschwelle dese Unplausibilitätszählers" VALUE 0xC9BD0 Kw_Wu8 255.0 OneToOne 0.00 255.0 FORMAT "%5.1" /end CHARACTERISTIC
/begin CHARACTERISTIC BrkCD_DebSigDef_C "Entprellzeit für CAN-Signal Defekterkennung" VALUE 0xC9BD2 Kw_Wu16 655350.0 Time_ms 0.00 655350.0 FORMAT "%8.1" /end CHARACTERISTIC
/begin CHARACTERISTIC BrkCD_DebSigOk_C "Entprellzeit für Heilung des CAN-Signalfehler" VALUE 0xC9BD4 Kw_Wu16 655350.0 Time_ms 0.00 655350.0 FORMAT "%8.1" /end CHARACTERISTIC
/begin CHARACTERISTIC BrkCD_tiMnSwtDebNeg_C "#SSD Entprellzeit Bremskontakt - abfallende Flanke" VALUE 0xC9BD6 Kw_Wu16 655350.0 TimeDeb 0.00 655350.0 FORMAT "%8.1" /end CHARACTERISTIC
/begin CHARACTERISTIC BrkCD_tiMnSwtDebPos_C "#SSD Entprellzeit Bremskontakt - aufsteigende Flanke" VALUE 0xC9BD8 Kw_Wu16 655350.0 TimeDeb 0.00 655350.0 FORMAT "%8.1" /end CHARACTERISTIC
/begin CHARACTERISTIC BrkCD_numDioInMn_C "#SSD Applikationsparameter fuer Bremspedal" VALUE 0xC9BDA Kw_Wu8 14.0000000000 NumPinDioIn 0.00 14.0000000000 FORMAT "%13.10" /end CHARACTERISTIC
/begin CHARACTERISTIC BrkCD_numDioInRed_C "#SSD Apllikationsparameter fuer redundante Bremssignal" VALUE 0xC9BDB Kw_Wu8 14.0000000000 NumPinDioIn 0.00 14.0000000000 FORMAT "%13.10" /end CHARACTERISTIC
/begin CHARACTERISTIC BrkCD_tiRedSwtDebNeg_C "#SSD Entprellzeit redundanter Bremskontakt - abfallende Flanke" VALUE 0xC9BDC Kw_Wu16 655350.0 TimeDeb 0.00 655350.0 FORMAT "%8.1" /end CHARACTERISTIC
/begin CHARACTERISTIC BrkCD_tiRedSwtDebPos_C "#SSD Entprellzeit redundanter Bremskontakt - aufsteigende Flanke" VALUE 0xC9BDE Kw_Wu16 655350.0 TimeDeb 0.00 655350.0 FORMAT "%8.1" /end CHARACTERISTIC
/begin CHARACTERISTIC BrkCD_stDflVal_C "Redundanter Bremskontakt-Vorgabewert" VALUE 0xC9BE0 Kw_Wu8 3.000 OneToOne 0.00 3.000 FORMAT "%5.3" EXTENDED_LIMITS 0.00 255.0 /end CHARACTERISTIC
/begin CHARACTERISTIC BrkCD_stMnSwtInvIn_C "#SSD Signal Bremskontakt invertiert" VALUE 0xC9BE1 Kw_Wu8 1.000 OneToOne 0.00 1.000 FORMAT "%5.3" EXTENDED_LIMITS 0.00 255.0 /end CHARACTERISTIC
/begin CHARACTERISTIC BrkCD_stRedSwtInvIn_C "#SSD Signal redundanter Bremskontakt invertiert" VALUE 0xC9BE2 Kw_Wu8 1.000 OneToOne 0.00 1.000 FORMAT "%5.3" EXTENDED_LIMITS 0.00 255.0 /end CHARACTERISTIC
/begin CHARACTERISTIC BrkCD_swtRedSwtPresent_C "#SSD Schalter redundanter Bremskontakt vorhanden (1 = vorhanden, 0 = nicht vorhanden)" VALUE 0xC9BE3 Kw_Wu8 1.000 OneToOne 0.00 1.000 FORMAT "%5.3" EXTENDED_LIMITS 0.00 255.0 /end CHARACTERISTIC
/begin CHARACTERISTIC BrkCD_swtSigVal_C "Schalterwert, Signal von HW DIO/CAN (1=CAN, 0=DIO)" VALUE 0xC9BE4 Kw_Wu8 3.000 OneToOne 0.00 3.000 FORMAT "%5.3" EXTENDED_LIMITS 0.00 255.0 /end CHARACTERISTIC
/begin CHARACTERISTIC BrkCD_tiDebResUnPlaus_C "Entprellzeit zur Erkennung auf Plausibilität" VALUE 0xC9BE6 Kw_Wu16 655350.0 Time_ms 0.00 655350.0 FORMAT "%8.1" /end CHARACTERISTIC
/begin CHARACTERISTIC BrkCD_tiDebUnPlausStat_C "Entprellzeit zur Erkennung auf statische Unplausibilität" VALUE 0xC9BE8 Kw_Wu16 655350.0 Time_ms 0.00 655350.0 FORMAT "%8.1" /end CHARACTERISTIC
/begin CHARACTERISTIC BrkCD_tiDebUnPlaus_C "Entprellzeit zur Erkennung auf Unplausibilität" VALUE 0xC9BEA Kw_Wu16 655350.0 Time_ms 0.00 655350.0 FORMAT "%8.1" /end CHARACTERISTIC
/begin CHARACTERISTIC Bss_tiDebDefect_C "Fehlerentprellzeit bei Kommunikationsfehler im BSS Interface" VALUE 0xC9BEC Kw_Wu16 655350.0 Time_ms 0.00 655350.0 FORMAT "%8.1" /end CHARACTERISTIC
/begin CHARACTERISTIC Bss_tiDebOk_C "Heilungsentprellung bei Kommunikationsfehler in BSS Interface" VALUE 0xC9BEE Kw_Wu16 655350.0 Time_ms 0.00 655350.0 FORMAT "%8.1" /end CHARACTERISTIC
/begin CHARACTERISTIC BypEtk_dNsyncStimuli64_C "#SSD Bypass, nicht ändern. Anzahl der winkelsynchron übertragenen Acht-Byte-Größen von ASCET zur ECU." VALUE 0xC9BF0 Kw_Wu8 255.0 OneToOne 0.00 255.0 FORMAT "%5.1" /end CHARACTERISTIC
/begin CHARACTERISTIC BypEtk_dNsyncStimuli32_C "#SSD Bypass, nicht ändern. Anzahl der winkelsynchron übertragenen Vier-Byte-Größen von ASCET zur ECU." VALUE 0xC9BF1 Kw_Wu8 255.0 OneToOne 0.00 255.0 FORMAT "%5.1" /end CHARACTERISTIC
/begin CHARACTERISTIC BypEtk_dNsyncStimuli16_C "#SSD Bypass, nicht ändern. Anzahl der winkelsynchron übertragenen Zwei-Byte-Größen von ASCET zur ECU." VALUE 0xC9BF2 Kw_Wu8 255.0 OneToOne 0.00 255.0 FORMAT "%5.1" /end CHARACTERISTIC
/begin CHARACTERISTIC BypEtk_dNsyncStimuli8_C "#SSD Bypass, nicht ändern. Anzahl der winkelsynchron übertragenen Ein-Byte-Größen von ASCET zur ECU." VALUE 0xC9BF3 Kw_Wu8 255.0 OneToOne 0.00 255.0 FORMAT "%5.1" /end CHARACTERISTIC
/begin CHARACTERISTIC BypEtk_stAscet_C "#SSD Status ASCET ETK Bypass (0: deaktiviert; 1: ETK-Bypass starten, wenn Wert vorher 0; 2: sofort starten)" VALUE 0xC9BF4 Kw_Wu8 2.000 OneToOne 0.00 2.000 FORMAT "%5.3" EXTENDED_LIMITS 0.00 255.0 /end CHARACTERISTIC
/begin CHARACTERISTIC BypEtk_dTsyncStimuli64_C "#SSD Bypass, nicht ändern. Anzahl der zeitsynchron übertragenen Acht-Byte-Größen von ASCET zur ECU." VALUE 0xC9BF5 Kw_Wu8 255.0 OneToOne 0.00 255.0 FORMAT "%5.1" /end CHARACTERISTIC
/begin CHARACTERISTIC BypEtk_dTsyncStimuli32_C "#SSD Bypass, nicht ändern. Anzahl der zeitsynchron übertragenen Vier-Byte-Größen von ASCET zur ECU." VALUE 0xC9BF6 Kw_Wu8 255.0 OneToOne 0.00 255.0 FORMAT "%5.1" /end CHARACTERISTIC
/begin CHARACTERISTIC BypEtk_dTsyncStimuli16_C "#SSD Bypass, nicht ändern. Anzahl der zeitsynchron übertragenen Zwei-Byte-Größen von ASCET zur ECU." VALUE 0xC9BF7 Kw_Wu8 255.0 OneToOne 0.00 255.0 FORMAT "%5.1" /end CHARACTERISTIC
/begin CHARACTERISTIC BypEtk_dTsyncStimuli8_C "#SSD Bypass, nicht ändern. Anzahl der zeitsynchron übertragenen Ein-Byte-Größen von ASCET zur ECU." VALUE 0xC9BF8 Kw_Wu8 255.0 OneToOne 0.00 255.0 FORMAT "%5.1" /end CHARACTERISTIC
/begin CHARACTERISTIC BypInt_adFunc_C "#SSD Feld von Funktionszeigern auf interne Bypass Funktionen" VAL_BLK 0xC9BFC Kwb_Wu32 4294967295.00 OneToOne 0.00 4294967295.00 FORMAT "%13.2" NUMBER 11 /end CHARACTERISTIC
/begin CHARACTERISTIC BypInt_stAscet_C "#SSD Status interner ASCET Bypass (0: deaktiviert; 1: internen Bypass starten, wenn Wert vorher 0; 2: sofort starten)" VALUE 0xC9C28 Kw_Wu8 2.000 OneToOne 0.00 2.000 FORMAT "%5.3" EXTENDED_LIMITS 0.00 255.0 /end CHARACTERISTIC
/begin CHARACTERISTIC Carb_Mode1PID_CA "Feld von unterstützen Carb Mode $1 PID's" VAL_BLK 0xC0498 Kwb_Wu8 254.0 OneToOne 1.000 255.0 FORMAT "%5.1" EXTENDED_LIMITS 0.00 255.0 NUMBER 9 /end CHARACTERISTIC
/begin CHARACTERISTIC Carb_Mode1Signal_CA "Feld der Signale von Carb Mode $1 welche mit den PID's verbunden sind" VAL_BLK 0xC04A2 Kwb_Wu16 255.000000000 SigName 0.00 255.000000000 FORMAT "%13.9" NUMBER 9 /end CHARACTERISTIC
/begin CHARACTERISTIC Carb_Mode2PID_CA "Feld von unterstützen Carb Mode $2 PID's" VAL_BLK 0xC04B4 Kwb_Wu8 254.0 OneToOne 1.000 255.0 FORMAT "%5.1" EXTENDED_LIMITS 0.00 255.0 NUMBER 9 /end CHARACTERISTIC
/begin CHARACTERISTIC Carb_Mode2Signal_CA "Feld der Signale von Carb Mode $2 welche mit den PID's verbunden sind" VAL_BLK 0xC04BE Kwb_Wu16 255.000000000 SigName 0.00 255.000000000 FORMAT "%13.9" NUMBER 9 /end CHARACTERISTIC
/begin CHARACTERISTIC Carb_Mode3SwtDia_C "Anzeigen der Fehler nur für Carb Mode 3(0) oder für Carb Mode 3 und 7 (1)" VALUE 0xC04D0 Kw_Wu8 255.0 OneToOne 0.00 255.0 FORMAT "%5.1" /end CHARACTERISTIC
/begin CHARACTERISTIC Carb_Mode4RefVal_C "Ist Carb_Mode4SigNum_C größer als dieser Referenzwert erfolgt kein Reset" VALUE 0xC04D4 Kw_Ws32 4294967295.00 OneToOne -2147483648.00 2147483647.00 FORMAT "%13.2" /end CHARACTERISTIC
/begin CHARACTERISTIC Carb_Mode4SigNum_C "Vergleiche Carb_Mode4SigNum_C mit dem Referenzwert Carb_Mode4RefVal_C" VALUE 0xC04D8 Kw_Wu16 65535.00 OneToOne 0.00 65535.00 FORMAT "%8.2" /end CHARACTERISTIC
/begin CHARACTERISTIC Carb_Mode6TstComp_CUR "Komponente des Carb Mode 6 Subtests" VAL_BLK 0xC04DA Kwb_Wu8 255.0 OneToOne 0.00 255.0 FORMAT "%5.1" NUMBER 10 /end CHARACTERISTIC
/begin CHARACTERISTIC Carb_Mode6TstNum_CUR "Test Nummer des Carb Mode 6 Subtests" VAL_BLK 0xC04E4 Kwb_Wu8 254.0 OneToOne 1.000 255.0 FORMAT "%5.1" EXTENDED_LIMITS 0.00 255.0 NUMBER 10 /end CHARACTERISTIC
/begin CHARACTERISTIC Carb_Mode6TstRefMax_CUR "Maximaler Referenzwert des Carb Mode 6 Subtest" VAL_BLK 0xC04EE Kwb_Wu16 65534.00 OneToOne 1.000000 65535.00 FORMAT "%8.2" EXTENDED_LIMITS 0.00 65535.00 NUMBER 10 /end CHARACTERISTIC
/begin CHARACTERISTIC Carb_Mode6TstRefMin_CUR "Minimaler Referenzwert des Carb Mode 6 Subtest" VAL_BLK 0xC0502 Kwb_Wu16 65534.00 OneToOne 1.000000 65535.00 FORMAT "%8.2" EXTENDED_LIMITS 0.00 65535.00 NUMBER 10 /end CHARACTERISTIC
/begin CHARACTERISTIC Carb_Mode6TstTestId_CUR "Test Identifier für OBD über CAN" VAL_BLK 0xC0516 Kwb_Wu8 255.0 OneToOne 0.00 255.0 FORMAT "%5.1" NUMBER 10 /end CHARACTERISTIC
/begin CHARACTERISTIC Carb_Mode6TstUnitId_CUR "Einheits und Skalierungs Identifier der Datenbytes" VAL_BLK 0xC0520 Kwb_Wu8 255.0 OneToOne 0.00 255.0 FORMAT "%5.1" NUMBER 10 /end CHARACTERISTIC
/begin CHARACTERISTIC Carb_Mode6TstVal_CUR "Testwert des Carb Mode 6 Subtests" VAL_BLK 0xC052A Kwb_Wu16 65534.00 OneToOne 1.000000 65535.00 FORMAT "%8.2" EXTENDED_LIMITS 0.00 65535.00 NUMBER 10 /end CHARACTERISTIC
/begin CHARACTERISTIC Carb_Mode9PID0_C "Support-Status des Infotype 0x00. Liefert alle ünterstützten Infotypes ( immer 0 für supported)" VALUE 0xC053E Kw_Wu8 255.0 OneToOne 0.00 255.0 FORMAT "%5.1" /end CHARACTERISTIC
/begin CHARACTERISTIC Carb_Mode9PID1_C "Support-Status des Infotype 0x01 (1 für supported, 0 für nicht supported)" VALUE 0xC053F Kw_Wu8 255.0 OneToOne 0.00 255.0 FORMAT "%5.1" /end CHARACTERISTIC
/begin CHARACTERISTIC Carb_Mode9PID2_C "Support-Status des Infotype 0x02 ""Vehicle Identification"" ( 2 für supported, 0 für nicht supported)" VALUE 0xC0540 Kw_Wu8 255.0 OneToOne 0.00 255.0 FORMAT "%5.1" /end CHARACTERISTIC
/begin CHARACTERISTIC Carb_Mode9PID3_C "Support-Status des Infotype 0x03 ( 3 für supported, 0 für nicht supported)" VALUE 0xC0541 Kw_Wu8 255.0 OneToOne 0.00 255.0 FORMAT "%5.1" /end CHARACTERISTIC
/begin CHARACTERISTIC Carb_Mode9PID4_C "Support-Status des Infotype 0x04 ""Calibration Identification"" ( 4 für supported, 0 für nicht supported)" VALUE 0xC0542 Kw_Wu8 255.0 OneToOne 0.00 255.0 FORMAT "%5.1" /end CHARACTERISTIC
/begin CHARACTERISTIC Carb_Mode9PID5_C "Support-Status des Infotype 0x05 ( 5 für supported, 0 für nicht supported)" VALUE 0xC0543 Kw_Wu8 255.0 OneToOne 0.00 255.0 FORMAT "%5.1" /end CHARACTERISTIC
/begin CHARACTERISTIC Carb_Mode9PID6_C "Support-Status des Infotype 0x06 ""Calibration Verification Number"" ( 6 für supported, 0 für nicht supported)" VALUE 0xC0544 Kw_Wu8 6.000 OneToOne 0.00 6.000 FORMAT "%5.3" EXTENDED_LIMITS 0.00 255.0 /end CHARACTERISTIC
/begin CHARACTERISTIC CaSCD_ctAddTooth_C "#SSD Anzahl der tolerierbaren zusätzlichen Zähne im Nockenwellensignal" VALUE 0xC9C2C Kw_Wu8 255.0 OneToOne 0.00 255.0 FORMAT "%5.1" /end CHARACTERISTIC
/begin CHARACTERISTIC CaSCD_ctEdgOfs_C "#SSD Anzahl von Nockenwellenflanken mit erkannter CaS/CrS Verdrehung" VALUE 0xC9C2D Kw_Wu8 255.0 OneToOne 0.00 255.0 FORMAT "%5.1" /end CHARACTERISTIC
/begin CHARACTERISTIC CaSCD_ctErrSegLen2Pos_C "#SSD Anzahl der tolerierbaren Fehler, Segmentlänge paßt nicht zur gefundenen Absolutposition des Nockenwellensignals" VALUE 0xC9C2E Kw_Wu8 255.0 OneToOne 0.00 255.0 FORMAT "%5.1" /end CHARACTERISTIC
/begin CHARACTERISTIC CaSCD_ctErrSync_C "#SSD maximale Anzahl von Störungen auf dem Phasengebersystem während einer Nockenwellenumdrehung" VALUE 0xC9C2F Kw_Wu8 255.0 OneToOne 0.00 255.0 FORMAT "%5.1" /end CHARACTERISTIC
/begin CHARACTERISTIC CaSCD_ctMissTooth_C "#SSD Anzahl der tolerierbaren fehlenden Zähne im Nockenwellensignal" VALUE 0xC9C30 Kw_Wu8 255.0 OneToOne 0.00 255.0 FORMAT "%5.1" /end CHARACTERISTIC
/begin CHARACTERISTIC CaSCD_ctShftSync_C "#SSD Anzahl falscher Nockenwellenflanken bis neue Positionssuche" VALUE 0xC9C31 Kw_Wu8 255.0 OneToOne 0.00 255.0 FORMAT "%5.1" /end CHARACTERISTIC
/begin CHARACTERISTIC CaSCD_dSegSeries_C "#SSD Segmentfolge der Phasengebersegmente" VAL_BLK 0xC0545 Kwb_Wu8 31.00 OneToOne 0.00 31.00 FORMAT "%5.2" EXTENDED_LIMITS 0.00 255.0 NUMBER 16 /end CHARACTERISTIC
/begin CHARACTERISTIC CaSCD_dTrigMsk_C "Triggermaske für vorlaeufige Segmenterkennung" VALUE 0xC0555 Kw_Wu8 255.0 OneToOne 0.00 255.0 FORMAT "%5.1" /end CHARACTERISTIC
/begin CHARACTERISTIC CaSCD_dTrigRslt_C "Triggerergebnis der vorlaeufigen Segmenterkennung" VALUE 0xC0556 Kw_Wu8 255.0 OneToOne 0.00 255.0 FORMAT "%5.1" /end CHARACTERISTIC
/begin CHARACTERISTIC CaSCD_facPlausHigh_CUR "#SSD Obere Grenze der Plausibilitätsprüfung des Phasengebersignals" CURVE 0xC9C32 Kl_Xs16_Ws16 19.00000 Fact1 1.000000 20.00000 FORMAT "%8.5" EXTENDED_LIMITS -256.0000 255.9922
 /begin AXIS_DESCR STD_AXIS CaSCD_tiPeriodRev Period_ms 12 0.00 3276.700 FORMAT "%8.3" EXTENDED_LIMITS -3276.800 3276.700 DEPOSIT ABSOLUTE /end AXIS_DESCR
/end CHARACTERISTIC
/begin CHARACTERISTIC CaSCD_facPlausLow_CUR "#SSD Untere Grenze der Plausibilitätsprüfung des Phasengebersignals" CURVE 0xC9C64 Kl_Xs16_Ws16 1.000000 Fact1 0.00 1.000000 FORMAT "%8.6" EXTENDED_LIMITS -256.0000 255.9922
 /begin AXIS_DESCR STD_AXIS CaSCD_tiPeriodRevHold Period_ms 12 0.00 3276.700 FORMAT "%8.3" EXTENDED_LIMITS -3276.800 3276.700 DEPOSIT ABSOLUTE /end AXIS_DESCR
/end CHARACTERISTIC
/begin CHARACTERISTIC CaSCD_nMinSpeed_C "#SSD Kleinster Wert für Phasengeberraddrehzahl" VALUE 0xC0558 Kw_Ws16 5960.000 EngN 40.00000 6000.000 FORMAT "%8.3" EXTENDED_LIMITS -32768.00 32767.00 /end CHARACTERISTIC
/begin CHARACTERISTIC CaSCD_phiPosTolc_C "#SSD Toleranzen der Absolutpositionen des Nockenwellensignals" VAL_BLK 0xC9C96 Kwb_Ws16 360.0000 AngleCaS 0.00 360.0000 FORMAT "%8.4" EXTENDED_LIMITS -384.0000 383.9883 NUMBER 16 /end CHARACTERISTIC
/begin CHARACTERISTIC CaSCD_phiSegLenTolc_C "#SSD Toleranz für jede Segmentlänge" VAL_BLK 0xC055A Kwb_Ws16 360.0000 AngleCaS 0.00 360.0000 FORMAT "%8.4" EXTENDED_LIMITS -384.0000 383.9883 NUMBER 16 /end CHARACTERISTIC
/begin CHARACTERISTIC CaSCD_phiSegLen_C "#SSD Länge der Phasensegmente" VAL_BLK 0xC057A Kwb_Ws16 360.0000 AngleCaS 0.00 360.0000 FORMAT "%8.4" EXTENDED_LIMITS -384.0000 383.9883 NUMBER 16 /end CHARACTERISTIC
/begin CHARACTERISTIC CaSCD_phiSegOfs_C "#SSD Winkel zwischen physikalischer Nulllage und Beginn Referenztabelle" VALUE 0xC059A Kw_Ws16 360.0000 AngleCaS 0.00 360.0000 FORMAT "%8.4" EXTENDED_LIMITS -384.0000 383.9883 /end CHARACTERISTIC
/begin CHARACTERISTIC CaSCD_phiSpeedCalcTolc_C "#SSD Toleranzwinkel für Segmenterkennung bei der Berechnung der Phasengeberdrehzahl" VALUE 0xC059C Kw_Ws16 360.0000 AngleCaS 0.00 360.0000 FORMAT "%8.4" EXTENDED_LIMITS -384.0000 383.9883 /end CHARACTERISTIC
/begin CHARACTERISTIC CaSCD_phiSpeedSegLen_C "#SSD Winkel einer Segmentlänge zur Berechnung der Phasengeberraddrehzahl" VALUE 0xC059E Kw_Ws16 360.0000 AngleCaS 0.00 360.0000 FORMAT "%8.4" EXTENDED_LIMITS -384.0000 383.9883 /end CHARACTERISTIC
/begin CHARACTERISTIC CaSCD_phiSpeedSegOfs_C "#SSD Winkel zwischen phys. Nullposition und dem Beginn der Segmente zur Phasenraddrehzahlberechnung" VALUE 0xC05A0 Kw_Ws16 360.0000 AngleCaS 0.00 360.0000 FORMAT "%8.4" EXTENDED_LIMITS -384.0000 383.9883 /end CHARACTERISTIC
/begin CHARACTERISTIC CaSCD_phiTrig_C "Triggerwinkel für vorlaeufige Segmenterkennung" VALUE 0xC05A2 Kw_Ws16 360.0000 AngleCaS 0.00 360.0000 FORMAT "%8.4" EXTENDED_LIMITS -384.0000 383.9883 /end CHARACTERISTIC
/begin CHARACTERISTIC CaSCD_stCalc_C "#SSD Abschalten von unterschiedlichen Funktionen des Phasensystems" VALUE 0xC05A4 Kw_Wu8 255.0 OneToOne 0.00 255.0 FORMAT "%5.1" /end CHARACTERISTIC
/begin CHARACTERISTIC CaSCD_stEdgeTrig_C "#SSD Triggerbedingung für die Phasenflankenerfassung" VALUE 0xC05A5 Kw_Wu8 2.000 OneToOne 1.000 3.000 FORMAT "%5.3" EXTENDED_LIMITS 0.00 255.0 /end CHARACTERISTIC
/begin CHARACTERISTIC CaSCD_stPinState_C "#SSD Signalpegel zur Auswertung der Phasensegmente verwenden" VALUE 0xC05A6 Kw_Wu8 1.000 OneToOne 0.00 1.000 FORMAT "%5.3" EXTENDED_LIMITS 0.00 255.0 /end CHARACTERISTIC
/begin CHARACTERISTIC CaSCD_stTPO_C "#SSD True Power On Funktion des Phasengebersensors" VALUE 0xC05A7 Kw_Wu8 1.000 OneToOne 0.00 1.000 FORMAT "%5.3" EXTENDED_LIMITS 0.00 255.0 /end CHARACTERISTIC
/begin CHARACTERISTIC CaSCD_swtSegLenPin2Pos_C "#SSD Variantenschalter zur Überprüfung der Segmentlänge und Pin Status zur Verifikation des Nockenwellensignals" VALUE 0xC9CB6 Kw_Wu8 1.000 OneToOne 0.00 1.000 FORMAT "%5.3" EXTENDED_LIMITS 0.00 255.0 /end CHARACTERISTIC
/begin CHARACTERISTIC CaSCD_tiPeriodRev1Max_C "#SSD Max. Zeit der vorletzten Periode einer Phasengeberradumdrehung" VALUE 0xC05A8 Kw_Ws16 3276.700 Period_ms 0.00 3276.700 FORMAT "%8.3" EXTENDED_LIMITS -3276.800 3276.700 /end CHARACTERISTIC
/begin CHARACTERISTIC CaSCD_tiPeriodRev2Max_C "#SSD Max. Zeit der letzten Periode einer Phasengeberradumdrehung" VALUE 0xC05AA Kw_Ws16 3276.700 Period_ms 0.00 3276.700 FORMAT "%8.3" EXTENDED_LIMITS -3276.800 3276.700 /end CHARACTERISTIC
/begin CHARACTERISTIC CaSCD_tiTimOutOfs_C "#SSD Offset zur Berechnung des Timeout-Wertes der Plausibilitätsprüfung" VALUE 0xC05AC Kw_Ws16 3276.700 Period_ms 0.00 3276.700 FORMAT "%8.3" EXTENDED_LIMITS -3276.800 3276.700 /end CHARACTERISTIC
/begin CHARACTERISTIC CBACD_ctPwrStgOnMax_C "Maximal Einschalt Anzahl der Endstufe bei SCB oder Übertemperaturfehler" VALUE 0xC9CB8 Kw_Wu16 65535.00 OneToOne 0.00 65535.00 FORMAT "%8.2" /end CHARACTERISTIC
/begin CHARACTERISTIC CBACD_numDia_C "Parameter fuer Hardware Diagnose-Pin Auswahl" VALUE 0xC9CBA Kw_Wu8 27.0000000000 NumPinDia 0.00 27.0000000000 FORMAT "%13.10" /end CHARACTERISTIC
/begin CHARACTERISTIC CBACD_numDioOut_C "Parameter fuer Hardware Digitalausgang-Pin Auswahl" VALUE 0xC9CBB Kw_Wu8 11.0000000000 NumPinDioOut 0.00 11.0000000000 FORMAT "%13.10" /end CHARACTERISTIC
/begin CHARACTERISTIC CBACD_stInvOut_C "Invertierung des Digitalausgangs ja/nein" VALUE 0xC9CBC Kw_Wu8 1.000 OneToOne 0.00 1.000 FORMAT "%5.3" EXTENDED_LIMITS 0.00 255.0 /end CHARACTERISTIC
/begin CHARACTERISTIC CBACD_stPwrStgActv_C "Spezifikation des Abschaltverhaltens der Endstufe" VALUE 0xC9CBD Kw_Wu8 255.0 OneToOne 0.00 255.0 FORMAT "%5.1" /end CHARACTERISTIC
/begin CHARACTERISTIC CBACD_stPwrStgDia_C "Spezifikation des Diagnoseverhaltens der Endstufe" VALUE 0xC9CBE Kw_Wu8 255.0 OneToOne 0.00 255.0 FORMAT "%5.1" /end CHARACTERISTIC
/begin CHARACTERISTIC CBACD_stSPICtl_C "Parameter zur Kennzeichnung ob Endstufe SPI oder nicht SPI fähig ( 1 = SPI Endstufe, 0 = Nicht SPI Endstufe )" VALUE 0xC9CBF Kw_Wu8 1.000 OneToOne 0.00 1.000 FORMAT "%5.3" EXTENDED_LIMITS 0.00 255.0 /end CHARACTERISTIC
/begin CHARACTERISTIC CBACD_tiBtwTst_C "Zeit zwischen zwei Test wenn Endstufe defekt" VALUE 0xC9CC0 Kw_Wu16 29980.00 Time_ms 20.00000 30000.00 FORMAT "%8.2" EXTENDED_LIMITS 0.00 655350.0 /end CHARACTERISTIC
/begin CHARACTERISTIC CBACD_tiDebExcTempDef_C "Fehlerentprellzeit Uebertemperatur" VALUE 0xC9CC2 Kw_Wu16 655350.0 Time_ms 0.00 655350.0 FORMAT "%8.1" /end CHARACTERISTIC
/begin CHARACTERISTIC CBACD_tiDebExcTempOk_C "Heilungsentprellzeit Uebertemperatur" VALUE 0xC9CC4 Kw_Wu16 655350.0 Time_ms 0.00 655350.0 FORMAT "%8.1" /end CHARACTERISTIC
/begin CHARACTERISTIC CBACD_tiDebNoLoadDef_C "Fehlerentprellzeit keine Last" VALUE 0xC9CC6 Kw_Wu16 655350.0 Time_ms 0.00 655350.0 FORMAT "%8.1" /end CHARACTERISTIC
/begin CHARACTERISTIC CBACD_tiDebNoLoadOk_C "Heilungsentprellzeit keine Last" VALUE 0xC9CC8 Kw_Wu16 655350.0 Time_ms 0.00 655350.0 FORMAT "%8.1" /end CHARACTERISTIC
/begin CHARACTERISTIC CBACD_tiDebShortCircBatDef_C "Fehlerentprellzzeit Kurzschluss nach UBatt" VALUE 0xC9CCA Kw_Wu16 655350.0 Time_ms 0.00 655350.0 FORMAT "%8.1" /end CHARACTERISTIC
/begin CHARACTERISTIC CBACD_tiDebShortCircBatOk_C "Heilungsentprellzeit Kurzschluss nach UBatt" VALUE 0xC9CCC Kw_Wu16 655350.0 Time_ms 0.00 655350.0 FORMAT "%8.1" /end CHARACTERISTIC
/begin CHARACTERISTIC CBACD_tiDebShortCircGndDef_C "Fehlerentprellzeit Kurzschluss nach Masse" VALUE 0xC9CCE Kw_Wu16 655350.0 Time_ms 0.00 655350.0 FORMAT "%8.1" /end CHARACTERISTIC
/begin CHARACTERISTIC CBACD_tiDebShortCircGndOk_C "Heilungsentprellzeit Kurzschluss nach Masse" VALUE 0xC9CD0 Kw_Wu16 655350.0 Time_ms 0.00 655350.0 FORMAT "%8.1" /end CHARACTERISTIC
/begin CHARACTERISTIC CBACD_tiPwrStgOn_C "Zeit für welche die Endstufe eingeschalten wird bei nicht SPI Endstufen" VALUE 0xC9CD2 Kw_Wu16 655140.0 Time_ms 0.00 655140.0 FORMAT "%8.1" EXTENDED_LIMITS 0.00 655350.0 /end CHARACTERISTIC
/begin CHARACTERISTIC Clg_dtMinDynTst_C "Minimaler Anstieg der Wassertemperatur zur Verifizierung derPlausibilität der Wassertemperatur" VALUE 0xC9CD4 Kw_Ws16 6553.500 TempDiff_Cels -3276.800 3276.700 FORMAT "%8.3" /end CHARACTERISTIC
/begin CHARACTERISTIC Clg_nMinEnaDynTst_C "Minimale Drehzahl zur Aktivierung des dynamischen Plausibilitätstests" VALUE 0xC9CD6 Kw_Ws16 65535.00 EngN -32768.00 32767.00 FORMAT "%8.2" /end CHARACTERISTIC
/begin CHARACTERISTIC Clg_qMinEnaDynTst_C "Minimale Einspritzmenge zur Aktivierung des dynamischen Plausibilitätstests" VALUE 0xC9CD8 Kw_Ws16 655.3500 InjMass -327.6800 327.6700 FORMAT "%8.4" /end CHARACTERISTIC
/begin CHARACTERISTIC Clg_tiInitTmr_C "Zeitspanne nach Motorstatrt bis die Wassertemperatur erfasst wird" VALUE 0xC9CDA Kw_Ws16 655.3500 Time_s -327.6800 327.6700 FORMAT "%8.4" /end CHARACTERISTIC
/begin CHARACTERISTIC Clg_tiMaxDynTst_CUR "Kennlinie der maximal zulässigen Testzeit des dynamischen Plausibilitätstest" CURVE 0xC9CDC Kl_Xs16_Ws16 167769.6 Time_DynTst -83886.08 83883.52 FORMAT "%8.2"
 /begin AXIS_DESCR STD_AXIS Clg_tClntStrtVal_mp Temp_Cels 10 -50.140 899.860 FORMAT "%8.3" EXTENDED_LIMITS -3549.940 3003.560 DEPOSIT ABSOLUTE /end AXIS_DESCR
/end CHARACTERISTIC
/begin CHARACTERISTIC Clg_tMinClntDynTst_C "Minimale Wassertemperatur zur Verifizierung der Plausibilitäts der Wassertemperatur" VALUE 0xC9D06 Kw_Ws16 950.000 Temp_Cels -50.140 899.860 FORMAT "%8.3" EXTENDED_LIMITS -3549.940 3003.560 /end CHARACTERISTIC
/begin CHARACTERISTIC CmbChb_nAvrgThrHi_C "maximale Drehzahl fuer Ueberwachung" VALUE 0xC9D08 Kw_Ws16 6000.000 EngN 0.00 6000.000 FORMAT "%8.3" EXTENDED_LIMITS -32768.00 32767.00 /end CHARACTERISTIC
/begin CHARACTERISTIC CmbChb_nAvrgThrLo_C "minimale Drehzahl fuer Ueberwachung" VALUE 0xC9D0A Kw_Ws16 6000.000 EngN 0.00 6000.000 FORMAT "%8.3" EXTENDED_LIMITS -32768.00 32767.00 /end CHARACTERISTIC
/begin CHARACTERISTIC CmbChb_qRawThrHi_C "maximale Menge fuer Ueberwachung" VALUE 0xC9D0C Kw_Ws16 655.3500 InjMass -327.6800 327.6700 FORMAT "%8.4" /end CHARACTERISTIC
/begin CHARACTERISTIC CmbChb_qRawThrLo_C "minimale Menge fuer Ueberwachung" VALUE 0xC9D0E Kw_Ws16 655.3500 InjMass -327.6800 327.6700 FORMAT "%8.4" /end CHARACTERISTIC
/begin CHARACTERISTIC CmbChb_tClntThrLo_C "minimale Wassertemperatur fuer Ueberwachung" VALUE 0xC9D10 Kw_Ws16 950.000 Temp_Cels -50.140 899.860 FORMAT "%8.3" EXTENDED_LIMITS -3549.940 3003.560 /end CHARACTERISTIC
/begin CHARACTERISTIC CmbChb_vThrHi_C "maximale Geschwindigkeit fuer Ueberwachung" VALUE 0xC9D12 Kw_Ws16 327.6700 Vel 0.00 327.6700 FORMAT "%8.4" EXTENDED_LIMITS -327.6800 327.6700 /end CHARACTERISTIC
/begin CHARACTERISTIC CmbChb_tiDebClutchChng_C "Entprellzeit für die Zustandsänderung des Kupplungssignals" VALUE 0xC9D14 Kw_Wu16 655350.0 Time_ms 0.00 655350.0 FORMAT "%8.1" /end CHARACTERISTIC
/begin CHARACTERISTIC CmbChb_tiDlyStr_C "Startausblendezeit" VALUE 0xC9D16 Kw_Wu16 655350.0 Time_ms 0.00 655350.0 FORMAT "%8.1" /end CHARACTERISTIC
/begin CHARACTERISTIC CmbChb_ctEngRevPerBlk_C "Blockgroesse (UpM) f. Ausbl./Test/Ausw.verz." VALUE 0xC9D18 Kw_Wu16 65535.00 OneToOne 0.00 65535.00 FORMAT "%8.2" /end CHARACTERISTIC
/begin CHARACTERISTIC CmbChb_ctSegTDC1_C "Offset für internen Segmentzähler in Aussetzererkennung" VALUE 0xC9D1A Kw_Wu16 0.00 OneToOne 0.00 0.00 FORMAT "%8.2" EXTENDED_LIMITS 0.00 65535.00 /end CHARACTERISTIC
/begin CHARACTERISTIC CmbChb_numBlk_C "Blockanzahl fuer Test" VALUE 0xC9D1C Kw_Wu16 65535.00 OneToOne 0.00 65535.00 FORMAT "%8.2" /end CHARACTERISTIC
/begin CHARACTERISTIC CmbChb_dnSegMin_C "Prozentuelle Komponente des durchschnittlichen minimalen Drehzahlanstieges" VALUE 0xC9D1E Kw_Ws16 799.9878 Prc -400.0000 399.9878 FORMAT "%8.4" /end CHARACTERISTIC
/begin CHARACTERISTIC CmbChb_ctMisfireMax_C "maximale Anzahl von Aussetzern pro Test" VALUE 0xC9D20 Kw_Wu16 65535.00 OneToOne 0.00 65535.00 FORMAT "%8.2" /end CHARACTERISTIC
/begin CHARACTERISTIC CmbChb_swtMonClutchVal_C "DS-Wert für SW-Schalter CmbChb_swtMonClutch, De/Aktivierung Überwachung Zündaussetzererkennung" VALUE 0xC9D22 Kw_Wu8 3.000 OneToOne 0.00 3.000 FORMAT "%5.3" EXTENDED_LIMITS 0.00 255.0 /end CHARACTERISTIC
/begin CHARACTERISTIC CmbChb_swtMonClutchType_C "Typ SW-Schalter CmbChb_swtMonClutch (1: EEPROM, 2: DS-Wert CrCCD_swtMonClutchVal_C)" VALUE 0xC9D23 Kw_Wu8 1.000 OneToOne 1.000 2.000 FORMAT "%5.3" EXTENDED_LIMITS 0.00 255.0 /end CHARACTERISTIC
/begin CHARACTERISTIC CoDT_tiChkGrpDT1_C "Time delay for DT1 filter" VALUE 0xC9D3C Kw_Wu32 4294.9673 TimeDelay_s 0.0000010000000 4294.9673 FORMAT "%9.4" /end CHARACTERISTIC
/begin CHARACTERISTIC CoDT_dChkGrpDT1Kd_C "Kd value for DT1 fliter" VALUE 0xC9D40 Kw_Ws32 65535.9999847 Kd -32768.0000000 32767.9999847 FORMAT "%13.7" /end CHARACTERISTIC
/begin CHARACTERISTIC CoDT_tiChkGrpPT1_C "Time delay for PT1 filter" VALUE 0xC9D44 Kw_Wu32 4294.9673 TimeDelay_s 0.0000010000000 4294.9673 FORMAT "%9.4" /end CHARACTERISTIC
/begin CHARACTERISTIC CoDT_dOfsGripDet_C "Offset for dn/dt calculation for grip detection" VALUE 0xC9D48 Kw_Ws16 65535.00 dn_dZfine -32768.00 32767.00 FORMAT "%8.2" /end CHARACTERISTIC
/begin CHARACTERISTIC CoDT_dOfsNoGripDet_C "Offset for dn/dt calculation for no grip detection" VALUE 0xC9D4A Kw_Ws16 65535.00 dn_dZfine -32768.00 32767.00 FORMAT "%8.2" /end CHARACTERISTIC
/begin CHARACTERISTIC CoDT_dThetaGripDet_C "Theta for dn/dt calculation for grip detection" VALUE 0xC9D4C Kw_Ws16 655.3500 Moment_Inertia -327.6800 327.6700 FORMAT "%8.4" /end CHARACTERISTIC
/begin CHARACTERISTIC CoDT_dThetaNoGripDet_C "Theta for dn/dt calculation for no grip detection" VALUE 0xC9D4E Kw_Ws16 655.3500 Moment_Inertia -327.6800 327.6700 FORMAT "%8.4" /end CHARACTERISTIC
/begin CHARACTERISTIC CoDT_dtrqLimDwnCurr_C "negative Steigung für einen Rampenschalter im Curr-Pfad" VALUE 0xC9D24 Kw_Wu32 6553599.99847 RmpTrq 0.00 6553599.99847 FORMAT "%13.5" /end CHARACTERISTIC
/begin CHARACTERISTIC CoDT_dtrqLimDwnLead_C "negative Steigung für einen Rampenschalter im Lead-Pfad" VALUE 0xC9D28 Kw_Wu32 6553599.99847 RmpTrq 0.00 6553599.99847 FORMAT "%13.5" /end CHARACTERISTIC
/begin CHARACTERISTIC CoDT_dtrqLimUpCurr_C "positive Steigung für einen Rampenschalter im Curr-Pfad" VALUE 0xC9D2C Kw_Wu32 6553599.99847 RmpTrq 0.00 6553599.99847 FORMAT "%13.5" /end CHARACTERISTIC
/begin CHARACTERISTIC CoDT_dtrqLimUpLead_C "positive Steigung für Rampenschalter im Lead-Pfad" VALUE 0xC9D30 Kw_Wu32 6553599.99847 RmpTrq 0.00 6553599.99847 FORMAT "%13.5" /end CHARACTERISTIC
/begin CHARACTERISTIC CoDT_swtAcsFltEna_C "Schalter um Filterwert zu aktivieren (1 = Filterung, 0 = keine Filterung)" VALUE 0xC9D5C Kw_Wu8 1.000 OneToOne 0.00 1.000 FORMAT "%5.3" EXTENDED_LIMITS 0.00 255.0 /end CHARACTERISTIC
/begin CHARACTERISTIC CoDT_swtCoTypeVal_C "#SSD Sollmoment im Schub über Fahrpedalstellung (0: conventional; 1: mastershift)" VALUE 0xC9D34 Kw_Wu8 1.000 OneToOne 0.00 1.000 FORMAT "%5.3" EXTENDED_LIMITS 0.00 255.0 /end CHARACTERISTIC
/begin CHARACTERISTIC CoDT_swtCoTypeType_C "#SSD CoDT_swtCoType 0: bed. Spez. ; 1: form E2PROM; 2: Applikation" VALUE 0xC9D35 Kw_Wu8 1.000 OneToOne 1.000 2.000 FORMAT "%5.3" EXTENDED_LIMITS 0.00 255.0 /end CHARACTERISTIC
/begin CHARACTERISTIC CoDT_swtNoGripDet_C "Schalter zur deaktivierung der Kraftschlusserkennung mittels Trägheitsmoment (1 = deaktiviert, 0 = aktiviert)" VALUE 0xC9D50 Kw_Wu8 255.0 OneToOne 0.00 255.0 FORMAT "%5.1" /end CHARACTERISTIC
/begin CHARACTERISTIC CoDT_tiDebGearUnVal_C "Delay time for debouncing neutral condition" VALUE 0xC9D52 Kw_Wu16 655350.0 Time_ms 0.00 655350.0 FORMAT "%8.1" /end CHARACTERISTIC
/begin CHARACTERISTIC CoDT_tiDebNoGrip_C "Delay time for debouncing No Grip" VALUE 0xC9D54 Kw_Wu16 655350.0 Time_ms 0.00 655350.0 FORMAT "%8.1" /end CHARACTERISTIC
/begin CHARACTERISTIC CoDT_tiFltPT1_C "Parameter für Filterung des Momentenbands" VALUE 0xC9D60 Kw_Wu32 4294.9673 TimeDelay_s 0.0000010000000 4294.9673 FORMAT "%9.4" /end CHARACTERISTIC
/begin CHARACTERISTIC CoDT_tiGripDeb_C "Entprellzeit für die Kraftschlußerkennung im Triebstrang" VALUE 0xC9D56 Kw_Wu16 655350.0 Time_ms 0.00 655350.0 FORMAT "%8.1" /end CHARACTERISTIC
/begin CHARACTERISTIC CoDT_tiTrqRedMaxCurr_C "Zeitschwelle für ""langen"" Getriebeeingriff im Curr-Pfad" VALUE 0xC9D36 Kw_Wu16 655350.0 Time_ms 0.00 655350.0 FORMAT "%8.1" /end CHARACTERISTIC
/begin CHARACTERISTIC CoDT_tiTrqRedMaxLead_C "Zeitschwell für ""langen"" Getriebeeingriff im Lead-Pfad" VALUE 0xC9D38 Kw_Wu16 655350.0 Time_ms 0.00 655350.0 FORMAT "%8.1" /end CHARACTERISTIC
/begin CHARACTERISTIC CoDT_trqMinInit_C "#SSD Initialwert für minimales Vortriebsmoment" VALUE 0xC9D64 Kw_Ws16 11000.00 TrqPrp -5000.000 6000.000 FORMAT "%8.3" EXTENDED_LIMITS -6553.600 6553.400 /end CHARACTERISTIC
/begin CHARACTERISTIC CoDT_vGrip_C "Geschwindigkeitsschwelle für Kraftschlußerkennung im Triebstrang" VALUE 0xC9D58 Kw_Ws16 400.0000 Vel -100.0000 300.0000 FORMAT "%8.4" EXTENDED_LIMITS -327.6800 327.6700 /end CHARACTERISTIC
/begin CHARACTERISTIC CoEng_dqSubsRgnRmpUp_C "Rampensteigung zur Umschaltung" VALUE 0xC9D84 Kw_Wu32 655359.999847 RmpInjMassCyc 0.00 655359.999847 FORMAT "%13.6" /end CHARACTERISTIC
/begin CHARACTERISTIC CoEng_dqSubsRgnRmpDwn_C "Rampensteigung zur Umschaltung" VALUE 0xC9D88 Kw_Wu32 655359.999847 RmpInjMassCyc 0.00 655359.999847 FORMAT "%13.6" /end CHARACTERISTIC
/begin CHARACTERISTIC CoEng_ExtWaitMsk2_C "#SSD Bitmaske für externe Ereignisse vor Öffnen des Hauptrelais" VALUE 0xC9D74 Kw_Wu8 255.0 OneToOne 0.00 255.0 FORMAT "%5.1" /end CHARACTERISTIC
/begin CHARACTERISTIC CoEng_ExtWaitMsk_C "#SSD Bitmaske für externe Ereignisse for Schreiben des EEPROM" VALUE 0xC9D75 Kw_Wu8 255.0 OneToOne 0.00 255.0 FORMAT "%5.1" /end CHARACTERISTIC
/begin CHARACTERISTIC CoEng_facFlConsumAdjDfl_C "Ersatzwert für den Kraftstoffverbrauchsabgleich" VALUE 0xC9D8C Kw_Ws16 2.000000 Fact 0.00 2.000000 FORMAT "%8.6" EXTENDED_LIMITS -4.000000 3.999878 /end CHARACTERISTIC
/begin CHARACTERISTIC CoEng_facFlConsumAdjMax_C "Maximalwert des Kraftstoffverbrauch-Abgleichwerts" VALUE 0xC9D8E Kw_Ws16 2.000000 Fact 0.00 2.000000 FORMAT "%8.6" EXTENDED_LIMITS -4.000000 3.999878 /end CHARACTERISTIC
/begin CHARACTERISTIC CoEng_facFlConsumAdjMin_C "Minumumwert des Kraftstoffverbrauch-Abgleichwerts" VALUE 0xC9D90 Kw_Ws16 2.000000 Fact 0.00 2.000000 FORMAT "%8.6" EXTENDED_LIMITS -4.000000 3.999878 /end CHARACTERISTIC
/begin CHARACTERISTIC CoEng_lSumFuncPref_C "Schwelle für gefahrene Strecke" VALUE 0xCA040 Kw_Wu32 1000000.00000 Length 0.00 1000000.00000 FORMAT "%13.5" EXTENDED_LIMITS 0.00 4294967295.00 /end CHARACTERISTIC
/begin CHARACTERISTIC CoEng_nActrRelease_C "#SSD Mindestdrehzahl für Stellerfreigabe" VALUE 0xC9D68 Kw_Ws16 32727.00 EngN 40.00000 32767.00 FORMAT "%8.2" EXTENDED_LIMITS -32768.00 32767.00 /end CHARACTERISTIC
/begin CHARACTERISTIC CoEng_nShOffTstMax_C "#SSD maximale Drehzahlschwelle für Abstelltest" VALUE 0xCA0D0 Kw_Ws16 32767.00 EngN 0.00 32767.00 FORMAT "%8.2" EXTENDED_LIMITS -32768.00 32767.00 /end CHARACTERISTIC
/begin CHARACTERISTIC CoEng_nShOffTstMin_C "#SSD minimale Drehzahlschwelle für Abstelltest" VALUE 0xCA0D2 Kw_Ws16 32767.00 EngN 0.00 32767.00 FORMAT "%8.2" EXTENDED_LIMITS -32768.00 32767.00 /end CHARACTERISTIC
/begin CHARACTERISTIC CoEng_nSoftShOffMax_C "engine speed limit for soft shutoff" VALUE 0xCA070 Kw_Ws16 32727.00 EngN 40.00000 32767.00 FORMAT "%8.2" EXTENDED_LIMITS -32768.00 32767.00 /end CHARACTERISTIC
/begin CHARACTERISTIC CoEng_nSoftShOffMin_C "minimale Drehzahlschwelle für Komfortabstellung" VALUE 0xCA072 Kw_Ws16 32727.00 EngN 40.00000 32767.00 FORMAT "%8.2" EXTENDED_LIMITS -32768.00 32767.00 /end CHARACTERISTIC
/begin CHARACTERISTIC CoEng_nThresNrml2Strt_C "Motordrehzahlschwelle für Zustandsübergang von NORMAL nach START" VALUE 0xCA0D8 Kw_Ws16 8000.000 EngN 0.00 8000.000 FORMAT "%8.3" EXTENDED_LIMITS -32768.00 32767.00 /end CHARACTERISTIC
/begin CHARACTERISTIC CoEng_numSelFuncPref_C "Auswahl Funktion mit uneingeschränkter Priorität" VALUE 0xCA044 Kw_Wu8 7.000 OneToOne 0.00 7.000 FORMAT "%5.3" EXTENDED_LIMITS 0.00 255.0 /end CHARACTERISTIC
/begin CHARACTERISTIC CoEng_facActvFunc2_1_C "Gewichtungsfaktor für Schubphasenzähler für Funktion1" VALUE 0xCA045 Kw_Wu8 10.00 OneToOne 0.00 10.00 FORMAT "%5.2" EXTENDED_LIMITS 0.00 255.0 /end CHARACTERISTIC
/begin CHARACTERISTIC CoEng_facActvFunc2_2_C "Gewichtungsfaktor für Schubphasenzähler für Funktion 2" VALUE 0xCA046 Kw_Wu8 10.00 OneToOne 0.00 10.00 FORMAT "%5.2" EXTENDED_LIMITS 0.00 255.0 /end CHARACTERISTIC
/begin CHARACTERISTIC CoEng_facActvFunc2_3_C "Gewichtungsfaktor für Schubphasenzähler für Funktion 3" VALUE 0xCA047 Kw_Wu8 10.00 OneToOne 0.00 10.00 FORMAT "%5.2" EXTENDED_LIMITS 0.00 255.0 /end CHARACTERISTIC
/begin CHARACTERISTIC CoEng_facActvFunc2_4_C "Gewichtungsfaktor für Schubphasenzähler für Funktion 4" VALUE 0xCA048 Kw_Wu8 10.00 OneToOne 0.00 10.00 FORMAT "%5.2" EXTENDED_LIMITS 0.00 255.0 /end CHARACTERISTIC
/begin CHARACTERISTIC CoEng_facActvFunc2_5_C "Gewichtungsfaktor für Schubphasenzähler für Funktion 5" VALUE 0xCA049 Kw_Wu8 10.00 OneToOne 0.00 10.00 FORMAT "%5.2" EXTENDED_LIMITS 0.00 255.0 /end CHARACTERISTIC
/begin CHARACTERISTIC CoEng_facActvFunc2_6_C "Gewichtungsfaktor für Schubphasenzähler für Funktion 6" VALUE 0xCA04A Kw_Wu8 10.00 OneToOne 0.00 10.00 FORMAT "%5.2" EXTENDED_LIMITS 0.00 255.0 /end CHARACTERISTIC
/begin CHARACTERISTIC CoEng_facActvFunc2_7_C "Gewichtungsfaktor für Schubphasenzähler für Funktion 7" VALUE 0xCA04B Kw_Wu8 10.00 OneToOne 0.00 10.00 FORMAT "%5.2" EXTENDED_LIMITS 0.00 255.0 /end CHARACTERISTIC
/begin CHARACTERISTIC CoEng_facActvFunc2_8_C "Gewichtungsfaktor für Schubphasenzähler für reservierte Funktion 8" VALUE 0xCA04C Kw_Wu8 0.00 OneToOne 0.00 0.00 FORMAT "%5.2" EXTENDED_LIMITS 0.00 255.0 /end CHARACTERISTIC
/begin CHARACTERISTIC CoEng_facActvFunc1_C "Gewichtungsfaktor für Schubphasenzähler für Funktion 1" VALUE 0xCA04D Kw_Wu8 10.00 OneToOne 0.00 10.00 FORMAT "%5.2" EXTENDED_LIMITS 0.00 255.0 /end CHARACTERISTIC
/begin CHARACTERISTIC CoEng_facActvFunc2_C "Gewichtungsfaktor für Schubphasenzähler für Funktion 2" VALUE 0xCA04E Kw_Wu8 10.00 OneToOne 0.00 10.00 FORMAT "%5.2" EXTENDED_LIMITS 0.00 255.0 /end CHARACTERISTIC
/begin CHARACTERISTIC CoEng_facActvFunc3_C "Gewichtungsfaktor für Schubphasenzähler für Funktion 3" VALUE 0xCA04F Kw_Wu8 10.00 OneToOne 0.00 10.00 FORMAT "%5.2" EXTENDED_LIMITS 0.00 255.0 /end CHARACTERISTIC
/begin CHARACTERISTIC CoEng_facActvFunc4_C "Gewichtungsfaktor für Schubphasenzähler für Funktion 4" VALUE 0xCA050 Kw_Wu8 10.00 OneToOne 0.00 10.00 FORMAT "%5.2" EXTENDED_LIMITS 0.00 255.0 /end CHARACTERISTIC
/begin CHARACTERISTIC CoEng_facActvFunc5_C "Gewichtungsfaktor für Schubphasenzähler für Funktion 5" VALUE 0xCA051 Kw_Wu8 10.00 OneToOne 0.00 10.00 FORMAT "%5.2" EXTENDED_LIMITS 0.00 255.0 /end CHARACTERISTIC
/begin CHARACTERISTIC CoEng_facActvFunc6_C "Gewichtungsfaktor für Schubphasenzähler für Funktion 6" VALUE 0xCA052 Kw_Wu8 10.00 OneToOne 0.00 10.00 FORMAT "%5.2" EXTENDED_LIMITS 0.00 255.0 /end CHARACTERISTIC
/begin CHARACTERISTIC CoEng_facActvFunc7_C "Gewichtungsfaktor für Schubphasenzähler für Funktion 7" VALUE 0xCA053 Kw_Wu8 10.00 OneToOne 0.00 10.00 FORMAT "%5.2" EXTENDED_LIMITS 0.00 255.0 /end CHARACTERISTIC
/begin CHARACTERISTIC CoEng_facActvFunc8_C "Gewichtungsfaktor für Schubphasenzähler für Funktion 8" VALUE 0xCA054 Kw_Wu8 0.00 OneToOne 0.00 0.00 FORMAT "%5.2" EXTENDED_LIMITS 0.00 255.0 /end CHARACTERISTIC
/begin CHARACTERISTIC CoEng_qSoftShOffMax_C "injection quantity limit for soft shutoff" VALUE 0xCA074 Kw_Ws16 327.6700 InjMassCyc 0.00 327.6700 FORMAT "%8.4" EXTENDED_LIMITS -327.6800 327.6700 /end CHARACTERISTIC
/begin CHARACTERISTIC CoEng_qSubs_MAP "Kennfeld für Ersatzmenge im Regenerationsfall" MAP 0xC9D92 Kf_Xs16_Ys16_Ws16 80.00000 InjMassCyc 0.00 80.00000 FORMAT "%8.5" EXTENDED_LIMITS -327.6800 327.6700
 /begin AXIS_DESCR STD_AXIS Eng_nAvrg EngN 16 0.00 8000.000 FORMAT "%8.3" EXTENDED_LIMITS -32768.00 32767.00 DEPOSIT ABSOLUTE /end AXIS_DESCR
 /begin AXIS_DESCR STD_AXIS CoEng_trq Trq 16 0.00 200.0000 FORMAT "%8.4" EXTENDED_LIMITS -3276.800 3276.700 DEPOSIT ABSOLUTE /end AXIS_DESCR
/end CHARACTERISTIC
/begin CHARACTERISTIC CoEng_rhoFuel_C "#SSD Kraftstoffdichte" VALUE 0xC9FD6 Kw_Ws16 1500.000 RhoFuel 0.00 1500.000 FORMAT "%8.3" EXTENDED_LIMITS -3276.800 3276.700 /end CHARACTERISTIC
/begin CHARACTERISTIC CoEng_stAftRunSel_C "Schalterauswahl für den Nachlauf" VALUE 0xC9D6C Kw_Wu8 255.0 OneToOne 0.00 255.0 FORMAT "%5.1" /end CHARACTERISTIC
/begin CHARACTERISTIC CoEng_stCoopCapbl_C "Kooperationsattribute zu koordinierender Funktionen im Schubkoordinator (bitcodiert)" VALUE 0xCA055 Kw_Wu8 127.0 OneToOne 0.00 127.0 FORMAT "%5.1" EXTENDED_LIMITS 0.00 255.0 /end CHARACTERISTIC
/begin CHARACTERISTIC CoEng_stIRevShutOff_C "#SSD Maske für irreversible Abschaltursachen" VALUE 0xC9FDC Kw_Wu32 4294967295.00 OneToOne 0.00 4294967295.00 FORMAT "%13.2" /end CHARACTERISTIC
/begin CHARACTERISTIC CoEng_stOvrRunRgnMsk_C "Maske zur Erkennung der Regenerationsart" VALUE 0xCA058 Kw_Wu32 4294967295.00 OneToOne 0.00 4294967295.00 FORMAT "%13.2" /end CHARACTERISTIC
/begin CHARACTERISTIC CoEng_stRevShutOff_C "#SSD Maske für reversible Abschaltursachen" VALUE 0xC9FE0 Kw_Wu32 4294967295.00 OneToOne 0.00 4294967295.00 FORMAT "%13.2" /end CHARACTERISTIC
/begin CHARACTERISTIC CoEng_stShOffAddReqIRev_C "#SSD Abstellpfade für kundenspezifische irreversible Abschaltanforderung" VALUE 0xC9FE4 Kw_Wu32 4294967295.00 OneToOne 0.00 4294967295.00 FORMAT "%13.2" /end CHARACTERISTIC
/begin CHARACTERISTIC CoEng_stShOffAddReqRev_C "#SSD Abstellpfade für kundenspezifische reversible Abschaltanforderung" VALUE 0xC9FE8 Kw_Wu32 4294967295.00 OneToOne 0.00 4294967295.00 FORMAT "%13.2" /end CHARACTERISTIC
/begin CHARACTERISTIC CoEng_stShOffAftRun_C "#SSD Abschaltanforderungen im Nachlauf" VALUE 0xCA078 Kw_Wu32 4294967295.00 OneToOne 0.00 4294967295.00 FORMAT "%13.2" /end CHARACTERISTIC
/begin CHARACTERISTIC CoEng_stShOffAirbFrnt_C "#SSD Abstellpfade für Airbag Frontalaufprall aktiv" VALUE 0xC9FEC Kw_Wu32 4294967295.00 OneToOne 0.00 4294967295.00 FORMAT "%13.2" /end CHARACTERISTIC
/begin CHARACTERISTIC CoEng_stShOffAirbRear_C "#SSD Abstellpfade für Airbag Heckaufprall aktiv" VALUE 0xC9FF0 Kw_Wu32 4294967295.00 OneToOne 0.00 4294967295.00 FORMAT "%13.2" /end CHARACTERISTIC
/begin CHARACTERISTIC CoEng_stShOffAirbSide_C "#SSD Abstellpfade für Airbag Seitenaufprall aktiv" VALUE 0xC9FF4 Kw_Wu32 4294967295.00 OneToOne 0.00 4294967295.00 FORMAT "%13.2" /end CHARACTERISTIC
/begin CHARACTERISTIC CoEng_stShOffCycSigChk_C "Abstellpfad für Fehler bei zyklischem Signaturcheck" VALUE 0xC9FF8 Kw_Wu32 4294967295.00 OneToOne 0.00 4294967295.00 FORMAT "%13.2" /end CHARACTERISTIC
/begin CHARACTERISTIC CoEng_stShOffDblCtl_C "#SSD Abstellpfade für unzulässigen Hochdruck-Reglerbetrieb (nur 2-Reglerkonzept)" VALUE 0xC9FFC Kw_Wu32 4294967295.00 OneToOne 0.00 4294967295.00 FORMAT "%13.2" /end CHARACTERISTIC
/begin CHARACTERISTIC CoEng_stShOffDiaReqFI_C "#SSD Abstellantwort von Diagnose-Schnittstelle fuer Kraftstoffzusatz" VALUE 0xCA000 Kw_Wu32 4294967295.00 OneToOne 0.00 4294967295.00 FORMAT "%13.2" /end CHARACTERISTIC
/begin CHARACTERISTIC CoEng_stShOffExtReq_C "#SSD Abstellpfade bei externer Anforderung" VALUE 0xCA07C Kw_Wu32 4294967295.00 OneToOne 0.00 4294967295.00 FORMAT "%13.2" /end CHARACTERISTIC
/begin CHARACTERISTIC CoEng_stShOffFWOscDet_C "#SSD Abschaltpfad für Schwungscheibenschwingung (-Schwungradschwingung)" VALUE 0xCA004 Kw_Wu32 4294967295.00 OneToOne 0.00 4294967295.00 FORMAT "%13.2" /end CHARACTERISTIC
/begin CHARACTERISTIC CoEng_stShOffInit_C "#SSD Abstellpfade, die nach der Initialisierung im Eingriff sind" VALUE 0xCA008 Kw_Wu32 4294967295.00 OneToOne 0.00 4294967295.00 FORMAT "%13.2" /end CHARACTERISTIC
/begin CHARACTERISTIC CoEng_stShOffInjMon_C "#SSD Abstellpfade für mehrfache Injektorlastabfälle" VALUE 0xCA00C Kw_Wu32 4294967295.00 OneToOne 0.00 4294967295.00 FORMAT "%13.2" /end CHARACTERISTIC
/begin CHARACTERISTIC CoEng_stShOffInjShCir_C "#SSD Abstellpfade bei Injektorkurzschluss" VALUE 0xCA010 Kw_Wu32 4294967295.00 OneToOne 0.00 4294967295.00 FORMAT "%13.2" /end CHARACTERISTIC
/begin CHARACTERISTIC CoEng_stShOffIRevSys1_C "#SSD Abstellpfade für irreversible Systemfehler 1" VALUE 0xCA014 Kw_Wu32 4294967295.00 OneToOne 0.00 4294967295.00 FORMAT "%13.2" /end CHARACTERISTIC
/begin CHARACTERISTIC CoEng_stShOffIRevSys2_C "#SSD Abstellpfade für irreversible Systemfehler 2" VALUE 0xCA018 Kw_Wu32 4294967295.00 OneToOne 0.00 4294967295.00 FORMAT "%13.2" /end CHARACTERISTIC
/begin CHARACTERISTIC CoEng_stShOffIRevVeh_C "#SSD Abstellpfade für irreversible Fahrzeugfehler" VALUE 0xCA01C Kw_Wu32 4294967295.00 OneToOne 0.00 4294967295.00 FORMAT "%13.2" /end CHARACTERISTIC
/begin CHARACTERISTIC CoEng_stShOffIrrCmb_C "#SSD Abstellpfade bei irregulärer Verbrennung" VALUE 0xCA020 Kw_Wu32 4294967295.00 OneToOne 0.00 4294967295.00 FORMAT "%13.2" /end CHARACTERISTIC
/begin CHARACTERISTIC CoEng_stShOffOvrSpd_C "#SSD Abstellpfade aufgrund Überdrehzahl" VALUE 0xCA024 Kw_Wu32 4294967295.00 OneToOne 0.00 4294967295.00 FORMAT "%13.2" /end CHARACTERISTIC
/begin CHARACTERISTIC CoEng_stShOffPresMin_C "#SSD Abstellpfade bei Mindestraildruck unteschritten" VALUE 0xCA028 Kw_Wu32 4294967295.00 OneToOne 0.00 4294967295.00 FORMAT "%13.2" /end CHARACTERISTIC
/begin CHARACTERISTIC CoEng_stShOffRevSys1_C "#SSD Abstellpfade für reversible Systemfehler 1" VALUE 0xCA02C Kw_Wu32 4294967295.00 OneToOne 0.00 4294967295.00 FORMAT "%13.2" /end CHARACTERISTIC
/begin CHARACTERISTIC CoEng_stShOffRevSys2_C "#SSD Abstellpfade für reversible Systemfehler 2" VALUE 0xCA030 Kw_Wu32 4294967295.00 OneToOne 0.00 4294967295.00 FORMAT "%13.2" /end CHARACTERISTIC
/begin CHARACTERISTIC CoEng_stShOffRevVeh_C "#SSD Abstellpfade für reversible Fahrzeugfehler" VALUE 0xCA034 Kw_Wu32 4294967295.00 OneToOne 0.00 4294967295.00 FORMAT "%13.2" /end CHARACTERISTIC
/begin CHARACTERISTIC CoEng_stShOffRlOvrBar_C "#SSD Abstellpfade für Überrollbügel aktiv" VALUE 0xCA038 Kw_Wu32 4294967295.00 OneToOne 0.00 4294967295.00 FORMAT "%13.2" /end CHARACTERISTIC
/begin CHARACTERISTIC CoEng_stShOffSV_C "#SSD Abstellpfade aufgrund dauerbestromtem Magnetventil" VALUE 0xCA03C Kw_Wu32 4294967295.00 OneToOne 0.00 4294967295.00 FORMAT "%13.2" /end CHARACTERISTIC
/begin CHARACTERISTIC CoEng_stShOffTstSel_C "#SSD Auswahl der möglichen Abstelltests (Bit 0: ESD/PSP, 1:PCV)" VALUE 0xCA080 Kw_Wu16 65535.00 OneToOne 0.00 65535.00 FORMAT "%8.2" /end CHARACTERISTIC
/begin CHARACTERISTIC CoEng_stSoftShOffAR_C "#SSD Abschaltanforderung im Nachlauf für Komfortabstellung" VALUE 0xCA084 Kw_Wu32 4294967295.00 OneToOne 0.00 4294967295.00 FORMAT "%13.2" /end CHARACTERISTIC
/begin CHARACTERISTIC CoEng_stSubsRgnMsk_C "Maske für Umschaltung auf Ersatzkennfeld" VALUE 0xC9FD8 Kw_Wu32 4294967295.00 OneToOne 0.00 4294967295.00 FORMAT "%13.2" /end CHARACTERISTIC
/begin CHARACTERISTIC CoEng_tiActrPrt_C "#SSD maximale Zeit für Stellerbestromung" VALUE 0xC9D6A Kw_Wu16 655350.0 Time_ms 0.00 655350.0 FORMAT "%8.1" /end CHARACTERISTIC
/begin CHARACTERISTIC CoEng_tiDebnAvrgZero_C "Entprellzeit (fallende Flanke) für die Motordrehzahl" VALUE 0xC9D6E Kw_Wu16 655140.0 Time_ms 0.00 655140.0 FORMAT "%8.1" EXTENDED_LIMITS 0.00 655350.0 /end CHARACTERISTIC
/begin CHARACTERISTIC CoEng_tiDlyT15_C "#SSD Zeit für Fehlerausblendung nach Klemme15 Ein (Abwarten der Init-Zeit anderer Steuergeräte)" VALUE 0xCA064 Kw_Wu16 5000.000 Time_ms 0.00 5000.000 FORMAT "%8.3" EXTENDED_LIMITS 0.00 655350.0 /end CHARACTERISTIC
/begin CHARACTERISTIC CoEng_tiMinAftRun_C "#SSD minimale Nachlaufzeit" VALUE 0xC9D78 Kw_Wu32 42949672950.0 Time_ms 0.00 42949672950.0 FORMAT "%13.1" /end CHARACTERISTIC
/begin CHARACTERISTIC CoEng_tiMRlyShutOffDel_C "delaytime for afterrun" VALUE 0xC9D7C Kw_Wu16 655350.0 Time_ms 0.00 655350.0 FORMAT "%8.1" /end CHARACTERISTIC
/begin CHARACTERISTIC CoEng_tiNrml2Strt_C "Entprellzeit für Zustandsübergang von NORMAL nach START" VALUE 0xCA0DA Kw_Wu16 655350.0 Time_ms 0.00 655350.0 FORMAT "%8.1" /end CHARACTERISTIC
/begin CHARACTERISTIC CoEng_tiOvrRunCoordDebPos_C "#SSD Entprellzeit für den Übergang ""Kein Schub -> Schub"" im Schubkoordinator" VALUE 0xCA05C Kw_Wu16 1000.000 Time_ms 0.00 1000.000 FORMAT "%8.3" EXTENDED_LIMITS 0.00 655350.0 /end CHARACTERISTIC
/begin CHARACTERISTIC CoEng_tiPwrStgDiaRdy_C "#SSD Verzoegerungszeit, um im Nachlauf abgeschaltete Steller zu diagnostizieren" VALUE 0xC9D70 Kw_Wu16 655350.0 Time_ms 0.00 655350.0 FORMAT "%8.1" /end CHARACTERISTIC
/begin CHARACTERISTIC CoEng_tiShOffTstFlSys_C "Zeit bis Ansteuerdauer == 0 beim Test des niederdruckseitigen Abstellpfades" VALUE 0xCA088 Kw_Wu16 655350.0 Time_ms 0.00 655350.0 FORMAT "%8.1" /end CHARACTERISTIC
/begin CHARACTERISTIC CoEng_tiSoftShOff_CUR "#SSD Curve to calculate time delay for soft shutoff" CURVE 0xCA08A Kl_Xs16_Ws16 600.0000 Time_ms 0.00 600.0000 FORMAT "%8.4" EXTENDED_LIMITS -327680.0 327670.0
 /begin AXIS_DESCR STD_AXIS Eng_nAvrg EngN 16 0.00 6000.000 FORMAT "%8.3" EXTENDED_LIMITS -32768.00 32767.00 DEPOSIT ABSOLUTE /end AXIS_DESCR
/end CHARACTERISTIC
/begin CHARACTERISTIC CoEng_tiThresFuncPref_C "Schwelle für Betriebszeit Motor ein" VALUE 0xCA060 Kw_Wu32 100000.000000 TimeEngOn 0.00 100000.000000 FORMAT "%13.6" EXTENDED_LIMITS 0.00 4294967295.00 /end CHARACTERISTIC
/begin CHARACTERISTIC CoEng_tiWakeUp_C "delaytime for afterrun caused hidden pre glow" VALUE 0xC9D80 Kw_Wu32 42949672950.0 Time_ms 0.00 42949672950.0 FORMAT "%13.1" /end CHARACTERISTIC
/begin CHARACTERISTIC CoEng_tShOffTstMin_C "minimale Wassertemperaturschwelle für Abstelltests" VALUE 0xCA0D4 Kw_Ws16 950.000 Temp_Cels -50.140 899.860 FORMAT "%8.3" EXTENDED_LIMITS -3549.940 3003.560 /end CHARACTERISTIC
/begin CHARACTERISTIC CoEng_uHighBattPwrStgHysHi_C "Oberen schwelle der Hysterese für Höhere Grenze der Batteriespannung" VALUE 0xCA066 Kw_Ws16 20000.00 Volt_Batt 0.00 20000.00 FORMAT "%8.2" EXTENDED_LIMITS -640625.6 640606.1 /end CHARACTERISTIC
/begin CHARACTERISTIC CoEng_uHighBattPwrStgHysLo_C "Unteren schwelle der Hysterese für Höhere Grenze der Batteriespannung" VALUE 0xCA068 Kw_Ws16 20000.00 Volt_Batt 0.00 20000.00 FORMAT "%8.2" EXTENDED_LIMITS -640625.6 640606.1 /end CHARACTERISTIC
/begin CHARACTERISTIC CoEng_uLowBattPwrStgHysHi_C "Oberen schwelle der Hysterese für Untere Grenze der Batteriespannung" VALUE 0xCA06A Kw_Ws16 15992.18 Volt_Batt 0.00 15992.18 FORMAT "%8.2" EXTENDED_LIMITS -640625.6 640606.1 /end CHARACTERISTIC
/begin CHARACTERISTIC CoEng_uLowBattPwrStgHysLo_C "Unteren schwelle der Hysterese für Untere Grenze der Batteriespannung" VALUE 0xCA06C Kw_Ws16 15992.18 Volt_Batt 0.00 15992.18 FORMAT "%8.2" EXTENDED_LIMITS -640625.6 640606.1 /end CHARACTERISTIC
/begin CHARACTERISTIC CoEng_vShOffTstMin_C "minimale Fahrgeschwindigkeits-Schwelle für Abstelltests" VALUE 0xCA0D6 Kw_Ws16 327.6700 Vel 0.00 327.6700 FORMAT "%8.4" EXTENDED_LIMITS -327.6800 327.6700 /end CHARACTERISTIC
/begin CHARACTERISTIC CoEng_vSoftShOffMax_C "vehicle speed limit for soft shutoff" VALUE 0xCA0CC Kw_Ws16 327.6700 Vel 0.00 327.6700 FORMAT "%8.4" EXTENDED_LIMITS -327.6800 327.6700 /end CHARACTERISTIC
/begin MEASUREMENT ASDrf_stCond_mp "Status der Eingangsbedingungen" UWORD OneToOne 1 100 0.00 65535.00 FORMAT "%8.2" ECU_ADDRESS 0x8FE522 /end MEASUREMENT
/begin MEASUREMENT ASDrf_stInit "Initialisierungsanforderungen/Quittierungen an PT1, PDT1-Glieder" UBYTE OneToOne 1 100 0.00 255.0 FORMAT "%5.1" ECU_ADDRESS 0x6F8009 /end MEASUREMENT
/begin MEASUREMENT ASDrf_stPrioState_mp "Aktiver Zustand nach der Priorisierung" UWORD OneToOne 1 100 0.00 65535.00 FORMAT "%8.2" ECU_ADDRESS 0x8FE524 /end MEASUREMENT
/begin MEASUREMENT ASDrf_stSelectState_mp "Aktiver Zustand, genau ein Primärzustand ist aktive" UWORD ASDrf_stPrimState 1 100 0.00 32.0000000000 FORMAT "%13.10" ECU_ADDRESS 0x8FE526 /end MEASUREMENT
/begin MEASUREMENT ASDrf_stStates_mp "Auswertung der Primärzustände (konkurrierende Zustände möglich)" UWORD OneToOne 1 100 0.00 65535.00 FORMAT "%8.2" ECU_ADDRESS 0x8FE528 /end MEASUREMENT
/begin MEASUREMENT ASDrf_trqLossNeg "Verlustmoment bei negativem Zustand von ASDrf_stPosNeg." SWORD Trq 1 100 -3276.800 3276.700 FORMAT "%8.3" ECU_ADDRESS 0x7F8A7A /end MEASUREMENT
/begin MEASUREMENT ASDrf_trqLossPos "Verlustmoment bei positivem Zustand von ASDrf_stPosNeg." SWORD Trq 1 100 -3276.800 3276.700 FORMAT "%8.3" ECU_ADDRESS 0x7F8A7C /end MEASUREMENT
/begin MEASUREMENT ASMod_dmAirPerTimeCorr "dynamisch korrigierter Frischluftmassenstrom vor Mischstelle" SWORD AirMassPerTime 1 100 -3276.800 3276.700 FORMAT "%8.3" ECU_ADDRESS 0x7F8A7E /end MEASUREMENT
/begin MEASUREMENT ASMod_dmEGR_mp "rückgeführter Abgasmassenstrom" SWORD AirMassPerTime 1 100 -3276.800 3276.700 FORMAT "%8.3" ECU_ADDRESS 0x8FE52A /end MEASUREMENT
/begin MEASUREMENT ASMod_dmEG_mp "Abgasmassenstrom nach Verbrennung" SWORD AirMassPerTime 1 100 -3276.800 3276.700 FORMAT "%8.3" ECU_ADDRESS 0x8FE534 /end MEASUREMENT
/begin MEASUREMENT ASMod_dmExhMnfPre "Abgasmassenstrom am Eintritt des Abgaskrümmers" SWORD AirMassPerTime 1 100 -3276.800 3276.700 FORMAT "%8.3" ECU_ADDRESS 0x7F8A80 /end MEASUREMENT
/begin MEASUREMENT ASMod_dmExhMnfPst "Abgasmassenstrom am Austritt des Abgaskrümmers" SWORD AirMassPerTime 1 100 -3276.800 3276.700 FORMAT "%8.3" ECU_ADDRESS 0x7F8A82 /end MEASUREMENT
/begin MEASUREMENT ASMod_dmFlBurned_mp "Massenstrom des verbrannten Kraftstoffs" SWORD InjMassPerTime 1 100 -327.6800 327.6700 FORMAT "%8.4" ECU_ADDRESS 0x8FE536 /end MEASUREMENT
/begin MEASUREMENT ASMod_dmFlPerTime_mp "eingespritzter Kraftstoffmassenstrom" SWORD InjMassPerTime 1 100 -327.6800 327.6700 FORMAT "%8.4" ECU_ADDRESS 0x8FE538 /end MEASUREMENT
/begin MEASUREMENT ASMod_dmIndAir "Gasmassenstrom in den Motor" SWORD AirMassPerTime 1 100 -3276.800 3276.700 FORMAT "%8.3" ECU_ADDRESS 0x7F8A84 /end MEASUREMENT
/begin MEASUREMENT ASMod_dmIndAirRef "Referenz des Gasmassenstroms in den Motor während geschlossener Abgasrückführung" SWORD AirMassPerTime 1 100 -3276.800 3276.700 FORMAT "%8.3" ECU_ADDRESS 0x7F8A86 /end MEASUREMENT
/begin MEASUREMENT ASMod_dmIndAirRef_mp "Referenz des Gasmassenstroms in den Motor" SWORD AirMassPerTime 1 100 -3276.800 3276.700 FORMAT "%8.3" ECU_ADDRESS 0x8FE53A /end MEASUREMENT
/begin MEASUREMENT ASMod_dmIndAir_mp "Gasmassenstrom in den Motor" SWORD AirMassPerTime 1 100 -3276.800 3276.700 FORMAT "%8.3" ECU_ADDRESS 0x8FE52C /end MEASUREMENT
/begin MEASUREMENT ASMod_dmIndVol_mp "zeitliche Änderung der Gasmasse im Ansaugvolumen" SWORD AirMassPerTime 1 100 -3276.800 3276.700 FORMAT "%8.3" ECU_ADDRESS 0x8FE558 /end MEASUREMENT
/begin MEASUREMENT ASMod_dmO2EG_mp "Sauerstoffmassenstrom nach Verbrennung" SWORD O2MassPerTime 1 100 -327.6800 327.6700 FORMAT "%8.4" ECU_ADDRESS 0x8FE53C /end MEASUREMENT
/begin MEASUREMENT ASMod_dmO2IndAir "Sauerstoffmassenstrom in den Motor" SWORD O2MassPerTime 1 100 -327.6800 327.6700 FORMAT "%8.4" ECU_ADDRESS 0x7F8A88 /end MEASUREMENT
/begin MEASUREMENT ASMod_dvolIndAirRef "Referenz des Gasvolumenstroms in den Motor" SWORD AirVolPerTime 1 100 -3276.800 3276.700 FORMAT "%8.3" ECU_ADDRESS 0x7F8A8A /end MEASUREMENT
/begin MEASUREMENT ASMod_facAMCor "Korrekturfaktor für Luftmassensignal" SWORD Fact 1 100 -4.000000 3.999878 FORMAT "%8.6" ECU_ADDRESS 0x7F8A8C /end MEASUREMENT
/begin MEASUREMENT ASMod_facDMCorTDiff_mp "Korrekturfaktor der Temperaturerhöhung aufgrund des aktuellen Gasmassenstroms" SWORD Fact 1 100 -4.000000 3.999878 FORMAT "%8.6" ECU_ADDRESS 0x8FE53E /end MEASUREMENT
/begin MEASUREMENT ASMod_facSOICorTDiff_mp "Korrekturfaktor der Temperaturerhöhung aufgrund des aktuellen Spritzbeginns" SWORD Fact 1 100 -4.000000 3.999878 FORMAT "%8.6" ECU_ADDRESS 0x8FE540 /end MEASUREMENT
/begin MEASUREMENT ASMod_facTIndAirCor_mp "Korrekturfaktor für Luftaufwand" SWORD RatAirMass 1 100 -32.76800 32.76700 FORMAT "%8.5" ECU_ADDRESS 0x8FE55C /end MEASUREMENT
/begin MEASUREMENT ASMod_facVolEff_mp "Luftaufwand aus Grundkennfeld" SWORD RatAirMass 1 100 -32.76800 32.76700 FORMAT "%8.5" ECU_ADDRESS 0x8FE55E /end MEASUREMENT
/begin MEASUREMENT ASMod_facVSACorVolEff_mp "Korrekturfaktor für Luftaufwand aufgrund aktueller Drallklappenposition" SWORD RatAirMass 1 100 -32.76800 32.76700 FORMAT "%8.5" ECU_ADDRESS 0x8FE560 /end MEASUREMENT
/begin MEASUREMENT ASMod_mAirPerCylCorr "dynamisch korrigierte Luftmasse pro Zylinder vor Mischstelle" SWORD AirMassPerCyl 1 100 -3276.800 3276.700 FORMAT "%8.3" ECU_ADDRESS 0x7F8A8E /end MEASUREMENT
/begin MEASUREMENT ASMod_mIndVol_mp "Gasmasse im Einlassvolumen" SWORD AirMass 1 100 -327.6800 327.6700 FORMAT "%8.4" ECU_ADDRESS 0x8FE55A /end MEASUREMENT
/begin MEASUREMENT ASMod_phiSOIRef_mp "Referenz des Spritzbeginns der MI1" SWORD AngleCrS 1 100 -768.0000 767.9766 FORMAT "%8.4" ECU_ADDRESS 0x8FE542 /end MEASUREMENT
/begin MEASUREMENT ASMod_qBurned_mp "Menge des verbrannten Kraftstoffes" SWORD InjMass 1 100 -327.6800 327.6700 FORMAT "%8.4" ECU_ADDRESS 0x8FE544 /end MEASUREMENT
/begin MEASUREMENT ASMod_qCor "Korrekturmenge für Mengensignal" SWORD InjMass 1 100 -327.6800 327.6700 FORMAT "%8.4" ECU_ADDRESS 0x7F8A90 /end MEASUREMENT
/begin MEASUREMENT ASMod_qLmbdCtlCorr_mp "korrigierte Lambdakontrollmenge" SWORD InjMass 1 100 -327.6800 327.6700 FORMAT "%8.4" ECU_ADDRESS 0x8FE546 /end MEASUREMENT
/begin MEASUREMENT ASMod_rDMIndAir_mp "relative Abweichung von der Referenz des Gasmassenstroms" SWORD RatAirMass 1 100 -32.76800 32.76700 FORMAT "%8.5" ECU_ADDRESS 0x8FE548 /end MEASUREMENT
/begin MEASUREMENT ASMod_rFlBurned_mp "Verhältnis der verbrannten zur eingespritzten Kraftstoffmasse" SWORD RatFuelMass 1 100 -327.6800 327.6700 FORMAT "%8.4" ECU_ADDRESS 0x8FE54A /end MEASUREMENT
/begin MEASUREMENT ASMod_rLmbdRecEG "schnelles reziprokes Lambda-Signal nach Verbrennung" SWORD lambdaRecVal 1 100 -32.76800 32.76700 FORMAT "%8.5" ECU_ADDRESS 0x7F8A92 /end MEASUREMENT
/begin MEASUREMENT ASMod_rLmbdRecExhMnfPst "reziprokes Lambdasignal am Ausgang des Abgaskrümmers" SWORD lambdaRecVal 1 100 -32.76800 32.76700 FORMAT "%8.5" ECU_ADDRESS 0x7F8A94 /end MEASUREMENT
/begin MEASUREMENT ASMod_rO2EG_mp "Sauerstoffmassenanteil des Abgases nach Verbrennung" SWORD O2 1 100 -0.3276800 0.3276700 FORMAT "%9.7" ECU_ADDRESS 0x8FE54C /end MEASUREMENT
/begin MEASUREMENT ASMod_rO2ExhMnfPre "Sauerstoffmassenanteil des Abgases am Eintritt des Abgaskrümmers" SWORD O2 1 100 -0.3276800 0.3276700 FORMAT "%9.7" ECU_ADDRESS 0x7F8A96 /end MEASUREMENT
/begin MEASUREMENT ASMod_rO2ExhMnfPst_mp "Sauerstoffmassenanteil des Abgases am Austritt des Abgaskrümmers" SWORD O2 1 100 -0.3276800 0.3276700 FORMAT "%9.7" ECU_ADDRESS 0x8FE52E /end MEASUREMENT
/begin MEASUREMENT ASMod_rO2IndAir_mp "Sauerstoffmassenanteil des Massenstroms in den Motor" SWORD O2 1 100 -0.3276800 0.3276700 FORMAT "%9.7" ECU_ADDRESS 0x8FE530 /end MEASUREMENT
/begin MEASUREMENT ASMod_rRelPosVSA "relative Position der Drallklappe" SWORD Prc 1 100 -400.0000 399.9878 FORMAT "%8.4" ECU_ADDRESS 0x7F8A98 /end MEASUREMENT
/begin MEASUREMENT ASMod_tDiffEG_mp "Temperaturerhöhung des Gasmassenstroms durch Verbrennung" SWORD TempDiff_Cels 1 100 -3276.800 3276.700 FORMAT "%8.3" ECU_ADDRESS 0x8FE54E /end MEASUREMENT
/begin MEASUREMENT ASMod_tDiffEng_mp "Temperaturerhöhung des Gasmassenstroms aus dem Grundkennfeld" SWORD TempDiff_Cels 1 100 -3276.800 3276.700 FORMAT "%8.3" ECU_ADDRESS 0x8FE550 /end MEASUREMENT
/begin MEASUREMENT ASMod_tEG_mp "Temperatur des Abgases nach Verbrennung" SWORD Temp_Cels 1 100 -50.140 899.860 FORMAT "%8.3" ECU_ADDRESS 0x8FE552 /end MEASUREMENT
/begin MEASUREMENT ASMod_tEngCorTDiff_mp "Korrektur der Temperaturerhöhung aufgrund der Motortemperatur" SWORD TempDiff_Cels 1 100 -3276.800 3276.700 FORMAT "%8.3" ECU_ADDRESS 0x8FE554 /end MEASUREMENT
/begin MEASUREMENT ASMod_tExhMnfPre "Abgastemperatur am Eintritt des Abgaskrümmers" SWORD Temp_Cels 1 100 -50.140 899.860 FORMAT "%8.3" ECU_ADDRESS 0x7F8A9A /end MEASUREMENT
/begin MEASUREMENT ASMod_tExhMnfPst_mp "Temperatur des Gasmassenstroms am Austritt des Abgaskrümmers" SWORD Temp_Cels 1 100 -50.140 899.860 FORMAT "%8.3" ECU_ADDRESS 0x8FE532 /end MEASUREMENT
/begin MEASUREMENT ASMod_tiDdTm_mp "Gaslaufzeit durch den Motor" SWORD TimeDeb 1 100 -327680.0 327670.0 FORMAT "%8.1" ECU_ADDRESS 0x8FE556 /end MEASUREMENT
/begin MEASUREMENT ASMod_tIndAir "Temperatur des Gasmassenstroms in den Motor" SWORD Temp_Cels 1 100 -50.140 899.860 FORMAT "%8.3" ECU_ADDRESS 0x7F8A9C /end MEASUREMENT
/begin MEASUREMENT ASMod_tIndAirRef "Referenz der Gastemperatur vor Einlass" SWORD Temp_Cels 1 100 -50.140 899.860 FORMAT "%8.3" ECU_ADDRESS 0x7F8A9E /end MEASUREMENT
/begin MEASUREMENT ASMod_tIntakeAir_mp "Ansauglufttemperatur" SWORD Temp_Cels 1 100 -50.140 899.860 FORMAT "%8.3" ECU_ADDRESS 0x8FE562 /end MEASUREMENT
/begin MEASUREMENT BattCD_u "Batteriespannung" SWORD Volt_Batt 1 100 -640625.6 640606.1 FORMAT "%8.1" ECU_ADDRESS 0x7F8B18 /end MEASUREMENT
/begin MEASUREMENT BattCD_uLin "Linearisierter Wert der Batteriespannung" SWORD Volt_Batt 1 100 -640625.6 640606.1 FORMAT "%8.1" ECU_ADDRESS 0x7F8B1A /end MEASUREMENT
/begin MEASUREMENT BattCD_uRaw "Rohwert ADC-Signalspannung für Batteriespannung" SWORD Volt 1 100 -160156.4 160151.5 FORMAT "%8.1" ECU_ADDRESS 0x7F8B1C /end MEASUREMENT
/begin MEASUREMENT Batt_facCor "Faktor für Batteriespannungskorrektur" SWORD Fact 1 100 -4.000000 3.999878 FORMAT "%8.6" ECU_ADDRESS 0x7F8B1E /end MEASUREMENT
/begin MEASUREMENT BdInt_nMax "Schutzdrehzahl für Karosserie und Innenraum" SWORD EngN 1 100 -32768.00 32767.00 FORMAT "%8.2" ECU_ADDRESS 0x7F8B20 /end MEASUREMENT
/begin MEASUREMENT BdInt_nMin "Anforderung Leerlaufdrehzahl durch Karosserie & Innenraum" SWORD EngN 1 100 -32768.00 32767.00 FORMAT "%8.2" ECU_ADDRESS 0x7F8B22 /end MEASUREMENT
/begin MEASUREMENT BdInt_pwrDes "Leistungsanforderung Wunsch Karosserie & Innenraum" SWORD Pwr 1 100 -308831.1 308821.7 FORMAT "%8.1" ECU_ADDRESS 0x7F8B24 /end MEASUREMENT
/begin MEASUREMENT BdInt_pwrLead "Leistungsanforderung Vorhalt Karosserie & Innenraum" SWORD Pwr 1 100 -308831.1 308821.7 FORMAT "%8.1" ECU_ADDRESS 0x7F8B26 /end MEASUREMENT
/begin MEASUREMENT BPACD_rAktPos "durch BPA Diagnose gemeldete Position des BPA" SWORD Prc 1 100 -400.0000 399.9878 FORMAT "%8.4" ECU_ADDRESS 0x7F8AFC /end MEASUREMENT
/begin MEASUREMENT BPACD_rCnv_mp "Tastverhältnis basierend auf dem Ausgang des Ladedrucksreglers" SWORD DtyCyc 1 100 -327.6800 327.6700 FORMAT "%8.4" ECU_ADDRESS 0x8FE568 /end MEASUREMENT
/begin MEASUREMENT BPACD_rOut "Tastverhältnis zür Endstufenansteuerung" SWORD DtyCyc 1 100 -327.6800 327.6700 FORMAT "%8.4" ECU_ADDRESS 0x7F8AFE /end MEASUREMENT
/begin MEASUREMENT BPACD_rRaw "Tastverhältnis des BPA Diagnose Pins" SWORD DtyCyc 1 100 -327.6800 327.6700 FORMAT "%8.4" ECU_ADDRESS 0x7F8B00 /end MEASUREMENT
/begin MEASUREMENT BPACD_stExtErr "Fehlerstatus der/von BPA Diagnose" UBYTE OneToOne 1 100 0.00 255.0 FORMAT "%5.1" ECU_ADDRESS 0x7F87E2 /end MEASUREMENT
/begin MEASUREMENT BPA_rBPAByp_mp "Bypass-Label, Kopie von BPA_rBPA" SWORD Prc 1 100 -400.0000 399.9878 FORMAT "%8.4" ECU_ADDRESS 0x8FE564 /end MEASUREMENT
/begin MEASUREMENT BPA_rBPACD "Stellgröße für Ladedrucksteller (Stellerkoordinatorausgang)" SWORD Prc 1 100 -400.0000 399.9878 FORMAT "%8.4" ECU_ADDRESS 0x7F8B04 /end MEASUREMENT
/begin MEASUREMENT BPA_rLPAByp_mp "LPACD TV rohwert vor ASCET bypass" SWORD Prc 1 100 -400.0000 399.9878 FORMAT "%8.4" ECU_ADDRESS 0x8FE566 /end MEASUREMENT
/begin MEASUREMENT BPA_rLPACD "Sollwert Ladedrucksteller Koordinator Niederdruckstufe" SWORD Prc 1 100 -400.0000 399.9878 FORMAT "%8.4" ECU_ADDRESS 0x7F8B06 /end MEASUREMENT
/begin MEASUREMENT BPSCD_dFltValDT1 "differentiated value of Filtered value of Boost pressure" SWORD dp_dZ10 1 100 -327680.0 327670.0 FORMAT "%8.1" ECU_ADDRESS 0x7F8B08 /end MEASUREMENT
/begin MEASUREMENT BPSCD_dpOutVal "Ladedruckgradient" SWORD dp_dZ10 1 100 -327680.0 327670.0 FORMAT "%8.1" ECU_ADDRESS 0x7F8B0A /end MEASUREMENT
/begin MEASUREMENT BPSCD_pFltVal "gefilterter Wert des Ladedrucks" SWORD Pres_hPa 1 100 -32768.00 32767.00 FORMAT "%8.2" ECU_ADDRESS 0x7F8B0C /end MEASUREMENT
/begin MEASUREMENT BPSCD_pIntVal "aktueller Ladedruck" SWORD Pres_hPa 1 100 -32768.00 32767.00 FORMAT "%8.2" ECU_ADDRESS 0x7F8B0E /end MEASUREMENT
/begin MEASUREMENT BPSCD_pLin "Mittelere Ladedruck-Wert (liniarisiert)" SWORD Pres_hPa 1 100 -32768.00 32767.00 FORMAT "%8.2" ECU_ADDRESS 0x7F8B10 /end MEASUREMENT
/begin MEASUREMENT BPSCD_pOutVal "Ladedruckwert" SWORD Pres_hPa 1 100 -32768.00 32767.00 FORMAT "%8.2" ECU_ADDRESS 0x7F8B12 /end MEASUREMENT
/begin MEASUREMENT BPSCD_pPhyVal "Ladedruck in diesem Zyklus" SWORD Pres_hPa 1 100 -32768.00 32767.00 FORMAT "%8.2" ECU_ADDRESS 0x7F8B14 /end MEASUREMENT
/begin MEASUREMENT BPSCD_stErr "Fehlererkennung (falls einer auftritt) des Ladedrucksensors in einem Zyklus" UBYTE OneToOne 1 100 0.00 255.0 FORMAT "%5.1" ECU_ADDRESS 0x7F87E3 /end MEASUREMENT
/begin MEASUREMENT BPSCD_stPlausErr "Plausibilitaetsfehler Status ( zwischen BPSCD und APSCD )" UBYTE OneToOne 1 100 0.00 255.0 FORMAT "%5.1" ECU_ADDRESS 0x7F87E4 /end MEASUREMENT
/begin MEASUREMENT BPSCD_uRawVal "Spannungsrohwert des Ladedrucksensors" SWORD Volt 1 100 -160156.4 160151.5 FORMAT "%8.1" ECU_ADDRESS 0x7F8B16 /end MEASUREMENT
/begin MEASUREMENT BrkCD_ctUnPlaus_mp "Unplausibilitätszähler" UWORD OneToOne 1 100 0.00 65535.00 FORMAT "%8.2" ECU_ADDRESS 0x6F800A /end MEASUREMENT
/begin MEASUREMENT BrkCD_stDeb_mp "Bremskontaktschalter - Status Fehlerentprellung Plausibilitaetspruefung" UBYTE OneToOne 1 100 0.00 255.0 FORMAT "%5.1" ECU_ADDRESS 0x8FE56A /end MEASUREMENT
/begin MEASUREMENT BrkCD_stMnSwtDebVal "Digitalsignal Bremskontakt entprellt" UBYTE OneToOne 1 100 0.00 255.0 FORMAT "%5.1" ECU_ADDRESS 0x7F8804 /end MEASUREMENT
/begin MEASUREMENT BrkCD_stMnSwtLastDebVal "Letzter logischer Entprellwert vom Bremspedal" UBYTE OneToOne 1 100 0.00 255.0 FORMAT "%5.1" ECU_ADDRESS 0x7F8805 /end MEASUREMENT
/begin MEASUREMENT BrkCD_stMnSwtLogVal_mp "Digitalsignal redundanter Bremskontakt nicht entprellt" UBYTE OneToOne 1 100 0.00 255.0 FORMAT "%5.1" ECU_ADDRESS 0x8FE56B /end MEASUREMENT
/begin MEASUREMENT BrkCD_stMnSwtRawVal "Rohwert Bremskontakt nicht entprellt" UBYTE OneToOne 1 100 0.00 255.0 FORMAT "%5.1" ECU_ADDRESS 0x7F8806 /end MEASUREMENT
/begin MEASUREMENT BrkCD_stPressed "Meldung Bremse betätigt" UBYTE OneToOne 1 100 0.00 255.0 FORMAT "%5.1" ECU_ADDRESS 0x7F8807 /end MEASUREMENT
/begin MEASUREMENT BrkCD_stRedSwtDebVal "Digitalsignal redundanter Bremskontakt entprellt" UBYTE OneToOne 1 100 0.00 255.0 FORMAT "%5.1" ECU_ADDRESS 0x7F8808 /end MEASUREMENT
/begin MEASUREMENT BrkCD_stRedSwtLastDebVal "Letzter logischer Entprellwert vom redundanten Bremspedal" UBYTE OneToOne 1 100 0.00 255.0 FORMAT "%5.1" ECU_ADDRESS 0x7F8809 /end MEASUREMENT
/begin MEASUREMENT BrkCD_stRedSwtLogVal_mp "Digitalsignal redundanter Bremskontakt nicht entprellt" UBYTE OneToOne 1 100 0.00 255.0 FORMAT "%5.1" ECU_ADDRESS 0x8FE56C /end MEASUREMENT
/begin MEASUREMENT BrkCD_stRedSwtPresent "Redundanter Bremskontakt Aktivinformation" UBYTE OneToOne 1 100 0.00 255.0 FORMAT "%5.1" ECU_ADDRESS 0x7F880A /end MEASUREMENT
/begin MEASUREMENT BrkCD_stRedSwtRawVal "Rohwert redundanter Bremskontakt nicht entprellt" UBYTE OneToOne 1 100 0.00 255.0 FORMAT "%5.1" ECU_ADDRESS 0x7F880B /end MEASUREMENT
/begin MEASUREMENT BrkCD_stResUnPlaus_mp "Zustandsbits zum Rücksetzen der Unplausibilität" UBYTE OneToOne 1 100 0.00 255.0 FORMAT "%5.1" ECU_ADDRESS 0x8FE56D /end MEASUREMENT
/begin MEASUREMENT BrkCD_stRun_mp "Laufzeitmesspunkt" UWORD OneToOne 1 100 0.00 65535.00 FORMAT "%8.2" ECU_ADDRESS 0x8FE56E /end MEASUREMENT
/begin MEASUREMENT BrkCD_swtSig "Signalquelle Schalter - DIO/CAN" UBYTE OneToOne 1 100 0.00 255.0 FORMAT "%5.1" ECU_ADDRESS 0x7F880C /end MEASUREMENT
/begin MEASUREMENT BrkCD_tiUnPlausBrkPres_mp "Statische Entprellzeit des Plausibilitäts-Check" UWORD Time_ms 1 100 0.00 655350.0 FORMAT "%8.1" ECU_ADDRESS 0x8FE570 /end MEASUREMENT
/begin MEASUREMENT BypEtk_ctStepDelayNsync_u8 "ETK Bypass Schritt drehzahlsynchron" UBYTE OneToOne 1 100 0.00 255.0 FORMAT "%5.1" ECU_ADDRESS 0x7FDA92 /end MEASUREMENT
/begin MEASUREMENT BypEtk_ctStepDelayTsync_u8 "ETK Bypass Schritt zeitsynchron" UBYTE OneToOne 1 100 0.00 255.0 FORMAT "%5.1" ECU_ADDRESS 0x7FDA93 /end MEASUREMENT
/begin MEASUREMENT BypEtk_stEcu_u8 "Status ETK-Bypass in SG (0: inaktiv im SG; 1: aktiv im SG; 2: wartet auf Kommunikation)" UBYTE OneToOne 1 100 0.00 255.0 FORMAT "%5.1" ECU_ADDRESS 0x7FDA91 /end MEASUREMENT
/begin MEASUREMENT BypInt_stEcu_u8 "Status interner Bypass in SG (0: inaktiv im SG; 1: aktiv im SG; 2: wartet auf Kommunikation)" UBYTE OneToOne 1 100 0.00 255.0 FORMAT "%5.1" ECU_ADDRESS 0x7FDA9D /end MEASUREMENT
/begin MEASUREMENT CaSCD_ctAddTooth_mp "Anzahl der zusätzlichen Zähne im Nockenwellensignal" UBYTE OneToOne 1 100 0.00 255.0 FORMAT "%5.1" ECU_ADDRESS 0x8FE572 /end MEASUREMENT
/begin MEASUREMENT CaSCD_ctEdgCaSRev_mp "Anzahl sämtlicher Phasensignale während einer Nockenwellenumdrehung" UBYTE OneToOne 1 100 0.00 255.0 FORMAT "%5.1" ECU_ADDRESS 0x8FE573 /end MEASUREMENT
/begin MEASUREMENT CaSCD_ctEdgOfs_mp "Zähler erkannter Nockenwellenflanken mit Verdrehung" UBYTE OneToOne 1 100 0.00 255.0 FORMAT "%5.1" ECU_ADDRESS 0x8FE574 /end MEASUREMENT
/begin MEASUREMENT CaSCD_ctEdgOrd_mp "Zähler erkannter Nockenwellenflanken in korrekter Reihenfolge" UBYTE OneToOne 1 100 0.00 255.0 FORMAT "%5.1" ECU_ADDRESS 0x8FE575 /end MEASUREMENT
/begin MEASUREMENT CaSCD_ctErrEdg_mp "Anzahl erkannter Störungen auf einer Nockenwellenumdrehung" UBYTE OneToOne 1 100 0.00 255.0 FORMAT "%5.1" ECU_ADDRESS 0x8FE576 /end MEASUREMENT
/begin MEASUREMENT CaSCD_ctErrSegLen2Pos_mp "Anzahl der Flankenpositionen im Nockenwellensignal mit falscher zugeordneter Segmentlänge" UBYTE OneToOne 1 100 0.00 255.0 FORMAT "%5.1" ECU_ADDRESS 0x8FE577 /end MEASUREMENT
/begin MEASUREMENT CaSCD_ctMissTooth_mp "Anzahl der fehlenden Zähne im Nockenwellensignal" UBYTE OneToOne 1 100 0.00 255.0 FORMAT "%5.1" ECU_ADDRESS 0x8FE578 /end MEASUREMENT
/begin MEASUREMENT CaSCD_ctPhRevEdges_mp "Zähler der Phasengeberflanken über einer Phasengeberradumdrehung" UBYTE OneToOne 1 100 0.00 255.0 FORMAT "%5.1" ECU_ADDRESS 0x8FE579 /end MEASUREMENT
/begin MEASUREMENT CaSCD_ctPhRev_mp "Umdrehungszähler des Phasengeberrades" UBYTE OneToOne 1 100 0.00 255.0 FORMAT "%5.1" ECU_ADDRESS 0x8FE57A /end MEASUREMENT
/begin MEASUREMENT CaSCD_ctSegEdg_mp "Anzahl erkannter SEG Flanken" UBYTE OneToOne 1 100 0.00 255.0 FORMAT "%5.1" ECU_ADDRESS 0x8FE57B /end MEASUREMENT
/begin MEASUREMENT CaSCD_ctSegLenOrd_mp "Anzahl der Segmentlängen, die in Reihenfolge erkannt wurden" UBYTE OneToOne 1 100 0.00 255.0 FORMAT "%5.1" ECU_ADDRESS 0x8FE57C /end MEASUREMENT
/begin MEASUREMENT CaSCD_ctShftPos_mp "Zähler verschobene Nockenwellenflanken" UBYTE OneToOne 1 100 0.00 255.0 FORMAT "%5.1" ECU_ADDRESS 0x8FE57D /end MEASUREMENT
/begin MEASUREMENT CaSCD_ctSyncEdg_mp "Anzahl erkannter SYNC Flanken" UBYTE OneToOne 1 100 0.00 255.0 FORMAT "%5.1" ECU_ADDRESS 0x8FE57E /end MEASUREMENT
/begin MEASUREMENT CaSCD_nPeriod "Phasengeberraddrehzahl basierent auf einer konstanten Phasengebersegmentlänge" SWORD EngN 1 100 -32768.00 32767.00 FORMAT "%8.2" ECU_ADDRESS 0x7F8B32 /end MEASUREMENT
/begin MEASUREMENT CaSCD_nSeg "Die aktuelle Nockenwellensegmentdrehzahl im BackUp-Modus" SWORD EngN 1 100 -32768.00 32767.00 FORMAT "%8.2" ECU_ADDRESS 0x7F8B34 /end MEASUREMENT
/begin MEASUREMENT CaSCD_numFrstInt_mp "Interruptart bei Start der Verifikation CaS/CrS" UBYTE OneToOne 1 100 0.00 255.0 FORMAT "%5.1" ECU_ADDRESS 0x8FE57F /end MEASUREMENT
/begin MEASUREMENT CaSCD_numFrstTDC_mp "Zylinderzählerstand bei Start der Verifikation CaS/CrS" UBYTE OneToOne 1 100 0.00 255.0 FORMAT "%5.1" ECU_ADDRESS 0x8FE580 /end MEASUREMENT
/begin MEASUREMENT CaSCD_phiCurr_mp "Aktuelle Winkelposition des Phasengebers" SWORD AngleCrS 1 100 -768.0000 767.9766 FORMAT "%8.4" ECU_ADDRESS 0x8FE582 /end MEASUREMENT
/begin MEASUREMENT CaSCD_phiLstEdge_mp "Position der letzten Phasengeberflanke" SWORD AngleCrS 1 100 -768.0000 767.9766 FORMAT "%8.4" ECU_ADDRESS 0x8FE584 /end MEASUREMENT
/begin MEASUREMENT CaSCD_stPhaseErr_mp "Fehlerstatus des Phasensystems" UWORD OneToOne 1 100 0.00 65535.00 FORMAT "%8.2" ECU_ADDRESS 0x8FE586 /end MEASUREMENT
/begin MEASUREMENT CaSCD_stPhaseSig_mp "Status des Phasengebersignals (Signalgüte)" UWORD OneToOne 1 100 0.00 65535.00 FORMAT "%8.2" ECU_ADDRESS 0x8FE588 /end MEASUREMENT
/begin MEASUREMENT CaSCD_stPhaseSync_mp "Status der Phasengebersynchronisation (Signalformerkennung)" UWORD OneToOne 1 100 0.00 65535.00 FORMAT "%8.2" ECU_ADDRESS 0x8FE58A /end MEASUREMENT
/begin MEASUREMENT CaSCD_stSegCylEdg_mp "Status erkannter SEG Flanken" UWORD OneToOne 1 100 0.00 65535.00 FORMAT "%8.2" ECU_ADDRESS 0x8FE58C /end MEASUREMENT
/begin MEASUREMENT CaSCD_stSyncCylEdg_mp "Status erkannter SYNC Flanken" UWORD OneToOne 1 100 0.00 65535.00 FORMAT "%8.2" ECU_ADDRESS 0x8FE58E /end MEASUREMENT
/begin MEASUREMENT CaSCD_tiPeriodRev "Periodendauer einer Umdrehung des Phasengeberrades" SWORD Period_ms 1 100 -3276.800 3276.700 FORMAT "%8.3" ECU_ADDRESS 0x7F8B36 /end MEASUREMENT
/begin MEASUREMENT CaSCD_tiPeriodRevHold "Vorletzte Periodendauer einer Umdrehung des Phasengeberrades" SWORD Period_ms 1 100 -3276.800 3276.700 FORMAT "%8.3" ECU_ADDRESS 0x7F8B38 /end MEASUREMENT
/begin MEASUREMENT CaSCD_tiSeg "aktuelle Segmentzeit der Nockenwelle im Backup Mode" ULONG Per_Dur 1 100 0.00 4294967295.00 FORMAT "%13.2" ECU_ADDRESS 0x7F91C4 /end MEASUREMENT
/begin MEASUREMENT CaSCD_tiSigTimOut_mp "Timeoutwert des Phasengebersignals" SWORD Period_ms 1 100 -3276.800 3276.700 FORMAT "%8.3" ECU_ADDRESS 0x8FE590 /end MEASUREMENT
/begin MEASUREMENT CBACD_stLogicOut_mp "duty-cycle given to the actuator" UBYTE OneToOne 1 100 0.00 255.0 FORMAT "%5.1" ECU_ADDRESS 0x6F800C /end MEASUREMENT
/begin MEASUREMENT Clg_dtDynTst "Ansteig der Wassertemperatur seit start" SWORD TempDiff_Cels 1 100 -3276.800 3276.700 FORMAT "%8.3" ECU_ADDRESS 0x7F8B3A /end MEASUREMENT
/begin MEASUREMENT Clg_dtMinDynTst "Kopie von Clg_dtMinDynTst_C fuer Tester" SWORD TempDiff_Cels 1 100 -3276.800 3276.700 FORMAT "%8.3" ECU_ADDRESS 0x7F8B3C /end MEASUREMENT
/begin MEASUREMENT Clg_tClntStrtVal_mp "Wassertemperatur zu Beginn des dynamischen Plausibilitätstests" SWORD Temp_Cels 1 100 -50.140 899.860 FORMAT "%8.3" ECU_ADDRESS 0x8FE592 /end MEASUREMENT
/begin MEASUREMENT Clg_tEndDynTst "CTSCD_tClnt am Ende des Tests" SWORD Temp_Cels 1 100 -50.140 899.860 FORMAT "%8.3" ECU_ADDRESS 0x7F8B3E /end MEASUREMENT
/begin MEASUREMENT Clg_tiDynTst "Abgelaufene Zeit, seit der der dynamische plausibilitätstest aktiv ist" ULONG Time_s 1 100 0.00 42949672.9500 FORMAT "%13.4" ECU_ADDRESS 0x7F91C8 /end MEASUREMENT
/begin MEASUREMENT Clg_tiMaxDynTst "Maximal zulässige Testzeit des dynamischen Plausibilitätstest" ULONG Time_s 1 100 0.00 42949672.9500 FORMAT "%13.4" ECU_ADDRESS 0x7F91CC /end MEASUREMENT
/begin MEASUREMENT Clg_tMinClntDynTst "Kopie von Clg_tMinClntDynTst_C fuer Tester" SWORD Temp_Cels 1 100 -50.140 899.860 FORMAT "%8.3" ECU_ADDRESS 0x7F8B40 /end MEASUREMENT
/begin MEASUREMENT CmbChb_ctEngRevLogBuf1_mp "Meßpunkt für die Anzahl bewerteten Motorumdrehungen der Kurbelwelle des Puffer1" UWORD OneToOne 1 100 0.00 65535.00 FORMAT "%8.2" ECU_ADDRESS 0x8FE5BE /end MEASUREMENT
/begin MEASUREMENT CmbChb_ctEngRevLogBuf2_mp "Meßpunkt für die Anzahl bewerteten Motorumdrehungen der Kurbelwelle des Puffer2" UWORD OneToOne 1 100 0.00 65535.00 FORMAT "%8.2" ECU_ADDRESS 0x8FE5C0 /end MEASUREMENT
/begin MEASUREMENT CmbChb_ctEngRevLogMem_mp "Kurbelwellen-Umdrehungszähler" UWORD OneToOne 1 100 0.00 65535.00 FORMAT "%8.2" ECU_ADDRESS 0x8FE5C2 /end MEASUREMENT
/begin MEASUREMENT CmbChb_ctEngRevPerBlk_mp "Meßpunkt für die Anzahl der Blockgroesse für die bewerteten Motorumdrehungen der Kurbelwelle" UWORD OneToOne 1 100 0.00 65535.00 FORMAT "%8.2" ECU_ADDRESS 0x8FE5C4 /end MEASUREMENT
/begin MEASUREMENT CmbChb_ctMifBuf1_mp "Meßpunkt für die Erkennung der Fehlzündungen der einzelnen Zylinder, Puffer1" UWORD OneToOne 1 100 0.00 65535.00 FORMAT "%8.2" ARRAY_SIZE 7 ECU_ADDRESS 0x8FE594 /end MEASUREMENT
/begin MEASUREMENT CmbChb_ctMifBuf2_mp "Meßpunkt für die Erkennung der Fehlzündungen der einzelnen Zylinder, Puffer2" UWORD OneToOne 1 100 0.00 65535.00 FORMAT "%8.2" ARRAY_SIZE 7 ECU_ADDRESS 0x8FE5A2 /end MEASUREMENT
/begin MEASUREMENT CmbChb_ctMifMem_mp "Meßpunkt für die Erkennung der Fehlzündungen der einzelnen Zylinder, Logging Speicher" UWORD OneToOne 1 100 0.00 65535.00 FORMAT "%8.2" ARRAY_SIZE 7 ECU_ADDRESS 0x8FE5B0 /end MEASUREMENT
/begin MEASUREMENT CmbChb_dnSegMinPerCyl_mp "minimaler Drehzahlanstiege pro Zylinder" SWORD EngN 1 100 -32768.00 32767.00 FORMAT "%8.2" ECU_ADDRESS 0x8FE5C6 /end MEASUREMENT
/begin MEASUREMENT CmbChb_nSegEven_mp "Summe der Drehzahl fuer jede gerade Segmentnummer (von zwei Umdrehungen)" SWORD EngN 1 100 -32768.00 32767.00 FORMAT "%8.2" ECU_ADDRESS 0x8FE5C8 /end MEASUREMENT
/begin MEASUREMENT CmbChb_nSegOdd_mp "Summe der Drehzahl fuer jede ungerade Segmentnummer (von zwei Umdrehungen)" SWORD EngN 1 100 -32768.00 32767.00 FORMAT "%8.2" ECU_ADDRESS 0x8FE5CA /end MEASUREMENT
/begin MEASUREMENT CmbChb_st "Status der Fehlzündungserkennung" UBYTE OneToOne 1 100 0.00 255.0 FORMAT "%5.1" ECU_ADDRESS 0x7F8810 /end MEASUREMENT
/begin MEASUREMENT CmbChb_swtMonClutch "SW-Schalter Aktivierung/Deaktivierung Überwachung Zündaussetzererkennung" UBYTE OneToOne 1 100 0.00 3.000 FORMAT "%5.3" ECU_ADDRESS 0x7F8811 /end MEASUREMENT
/begin MEASUREMENT CoDT_dnAbsEng_mp "Absolute value of DT1 filtered engine speed" SWORD dn_dZfine 1 100 -32768.00 32767.00 FORMAT "%8.2" ECU_ADDRESS 0x8FE5D2 /end MEASUREMENT
/begin MEASUREMENT CoDT_dnEng_mp "DT1 filtered Engine speed" SWORD dn_dZfine 1 100 -32768.00 32767.00 FORMAT "%8.2" ECU_ADDRESS 0x8FE5D4 /end MEASUREMENT
/begin MEASUREMENT CoDT_dnGrip_mp "Expected change in torque" SWORD dn_dZfine 1 100 -32768.00 32767.00 FORMAT "%8.2" ECU_ADDRESS 0x8FE5D6 /end MEASUREMENT
/begin MEASUREMENT CoDT_dnNoGrip_mp "Expected change in engine speed" SWORD dn_dZfine 1 100 -32768.00 32767.00 FORMAT "%8.2" ECU_ADDRESS 0x8FE5D8 /end MEASUREMENT
/begin MEASUREMENT CoDT_Grip "Kraftschluß innerhalb Antrieb" UBYTE OneToOne 1 100 0.00 255.0 FORMAT "%5.1" ECU_ADDRESS 0x7F8812 /end MEASUREMENT
/begin MEASUREMENT CoDT_nMax "Drehzahlforderung Maximalwert Triebstrangkoordinator" SWORD EngN 1 100 -32768.00 32767.00 FORMAT "%8.2" ECU_ADDRESS 0x7F8B44 /end MEASUREMENT
/begin MEASUREMENT CoDT_nMin "Drehzahlforderung Minimalwert Triebstrangkoordinator" SWORD EngN 1 100 -32768.00 32767.00 FORMAT "%8.2" ECU_ADDRESS 0x7F8B46 /end MEASUREMENT
/begin MEASUREMENT CoDT_stGripDeb "Zustand der Kraftschlußentprellung" UBYTE OneToOne 1 100 0.00 255.0 FORMAT "%5.1" ECU_ADDRESS 0x7F8813 /end MEASUREMENT
/begin MEASUREMENT CoDT_stNoGripDet_mp "Bit coded status message" UBYTE OneToOne 1 100 0.00 255.0 FORMAT "%5.1" ECU_ADDRESS 0x8FE5DA /end MEASUREMENT
/begin MEASUREMENT CoDT_stOrd "Randbedingungen für physikalischen Auftrag" UBYTE OneToOne 1 100 0.00 255.0 FORMAT "%5.1" ECU_ADDRESS 0x7F8814 /end MEASUREMENT
/begin MEASUREMENT CoDT_swtCoType "0: conventional; 1: mastershift" UBYTE OneToOne 1 100 0.00 255.0 FORMAT "%5.1" ECU_ADDRESS 0x7F8815 /end MEASUREMENT
/begin MEASUREMENT CoDT_trq "aktuelles Getriebeausgangsmoment" SWORD TrqPrp 1 100 -6553.600 6553.400 FORMAT "%8.3" ECU_ADDRESS 0x7F8B48 /end MEASUREMENT
/begin MEASUREMENT CoDT_trqAbsGbxPT1_mp "Absolute value of delayed gearbox torque input" SWORD Trq 1 100 -3276.800 3276.700 FORMAT "%8.3" ECU_ADDRESS 0x8FE5DC /end MEASUREMENT
/begin MEASUREMENT CoDT_trqAcsDes "torque electrical components" SWORD Trq 1 100 -3276.800 3276.700 FORMAT "%8.3" ECU_ADDRESS 0x7F8B4A /end MEASUREMENT
/begin MEASUREMENT CoDT_trqAcsMax_mp "maximales Nebenaggregatmoment" SWORD Trq 1 100 -3276.800 3276.700 FORMAT "%8.3" ECU_ADDRESS 0x8FE5E2 /end MEASUREMENT
/begin MEASUREMENT CoDT_trqAcsMin "minimaler Momentenbedarf der Nebenaggregate" SWORD Trq 1 100 -3276.800 3276.700 FORMAT "%8.3" ECU_ADDRESS 0x7F8B4C /end MEASUREMENT
/begin MEASUREMENT CoDT_trqAcs_mp "ungefilterter Momentenbedarf der Nebenaggregate" SWORD Trq 1 100 -3276.800 3276.700 FORMAT "%8.3" ECU_ADDRESS 0x8FE5E4 /end MEASUREMENT
/begin MEASUREMENT CoDT_trqActAcs_mp "aktuelle Momentenanforderung der Nebenaggregate" SWORD Trq 1 100 -3276.800 3276.700 FORMAT "%8.3" ECU_ADDRESS 0x8FE5E0 /end MEASUREMENT
/begin MEASUREMENT CoDT_trqCurr "Momentenanforderung Triebstrang Vorhaltewert" SWORD Trq 1 100 -3276.800 3276.700 FORMAT "%8.3" ECU_ADDRESS 0x7F8B4E /end MEASUREMENT
/begin MEASUREMENT CoDT_trqCurrLim "Minimum aller Begrenzungen im Getriebeausgangsmoment" SWORD TrqPrp 1 100 -6553.600 6553.400 FORMAT "%8.3" ECU_ADDRESS 0x7F8B50 /end MEASUREMENT
/begin MEASUREMENT CoDT_trqDes "Momentenanforderung Triebstrangkoordinator Wunschwert" SWORD Trq 1 100 -3276.800 3276.700 FORMAT "%8.3" ECU_ADDRESS 0x7F8B58 /end MEASUREMENT
/begin MEASUREMENT CoDT_trqDTInCurr "Momentenanforderung Vorhalt Triebstrangkoordinator (Kupplungseingang) (curr-Pfad)" SWORD Trq 1 100 -3276.800 3276.700 FORMAT "%8.3" ECU_ADDRESS 0x7F8B52 /end MEASUREMENT
/begin MEASUREMENT CoDT_trqDTInDecLead_mp "Momentenanforderung Triebstrang nach reduzierenden Getriebeeingriffen" SWORD Trq 1 100 -3276.800 3276.700 FORMAT "%8.3" ECU_ADDRESS 0x8FE5CC /end MEASUREMENT
/begin MEASUREMENT CoDT_trqDTInDes "Momentenanforderung Triebstrang (Kupplungseingang) Wunschwert" SWORD Trq 1 100 -3276.800 3276.700 FORMAT "%8.3" ECU_ADDRESS 0x7F8B54 /end MEASUREMENT
/begin MEASUREMENT CoDT_trqDTInIncLead_mp "Momentenanforderung Triebstrang nach erhöhenden Getriebeeingriffen" SWORD Trq 1 100 -3276.800 3276.700 FORMAT "%8.3" ECU_ADDRESS 0x8FE5CE /end MEASUREMENT
/begin MEASUREMENT CoDT_trqDTInLead "Momentenanforderung Triebstrang (Kupplungseingang) Vorhaltewert" SWORD Trq 1 100 -3276.800 3276.700 FORMAT "%8.3" ECU_ADDRESS 0x7F8B56 /end MEASUREMENT
/begin MEASUREMENT CoDT_trqGbx "aktuelles Eingangsmoment Getriebe" SWORD Trq 1 100 -3276.800 3276.700 FORMAT "%8.3" ECU_ADDRESS 0x7F8B5A /end MEASUREMENT
/begin MEASUREMENT CoDT_trqGbxMax "maximales Getriebeeingangsmoment" SWORD Trq 1 100 -3276.800 3276.700 FORMAT "%8.3" ECU_ADDRESS 0x7F8B5C /end MEASUREMENT
/begin MEASUREMENT CoDT_trqGbxMin "minimales Getriebeeingangsmoment" SWORD Trq 1 100 -3276.800 3276.700 FORMAT "%8.3" ECU_ADDRESS 0x7F8B5E /end MEASUREMENT
/begin MEASUREMENT CoDT_trqGbxPT1_mp "Delayed gearbox torque input" SWORD Trq 1 100 -3276.800 3276.700 FORMAT "%8.3" ECU_ADDRESS 0x8FE5DE /end MEASUREMENT
/begin MEASUREMENT CoDT_trqGearbxDes "Getriebeeingangsmoment Fahrerwunsch" SWORD Trq 1 100 -3276.800 3276.700 FORMAT "%8.3" ECU_ADDRESS 0x7F8B60 /end MEASUREMENT
/begin MEASUREMENT CoDT_trqGearbxLead_mp "Getriebeeingangsmoment Vorhaltewert" SWORD Trq 1 100 -3276.800 3276.700 FORMAT "%8.3" ECU_ADDRESS 0x8FE5D0 /end MEASUREMENT
/begin MEASUREMENT CoDT_trqLead "Momentenanforderung Vorhaltewert" SWORD Trq 1 100 -3276.800 3276.700 FORMAT "%8.3" ECU_ADDRESS 0x7F8B62 /end MEASUREMENT
/begin MEASUREMENT CoDT_trqMax "maximal mögliches Antriebsmoment (Getriebeausgang)" SWORD TrqPrp 1 100 -6553.600 6553.400 FORMAT "%8.3" ECU_ADDRESS 0x7F8B64 /end MEASUREMENT
/begin MEASUREMENT CoDT_trqMin "minimal mögliches Antriebsmoment (Getriebeausgang)" SWORD TrqPrp 1 100 -6553.600 6553.400 FORMAT "%8.3" ECU_ADDRESS 0x7F8B66 /end MEASUREMENT
/begin MEASUREMENT CoEng_CoordPrioFld_mp "Messpunktarray zur Darstellung der dynamische Priorität" UWORD OneToOne 1 100 0.00 65535.00 FORMAT "%8.2" ARRAY_SIZE 3 ECU_ADDRESS 0x8FE5F4 /end MEASUREMENT
/begin MEASUREMENT CoEng_dvolFlConsum "Kraftstoffverbrauch" SWORD FlConsum_l_h 1 100 -327.6800 327.6700 FORMAT "%8.4" ECU_ADDRESS 0x7F8B68 /end MEASUREMENT
/begin MEASUREMENT CoEng_dvolPerStroke_mp "Kraftstoffverbrauch" SWORD InjQnt 1 100 -3276.800 3276.700 FORMAT "%8.3" ECU_ADDRESS 0x8FE5E8 /end MEASUREMENT
/begin MEASUREMENT CoEng_facAdj "EEPROM Abgleichwert zur Korrektur des Begrenzungsmomentes" SWORD Fact 1 100 -4.000000 3.999878 FORMAT "%8.6" ECU_ADDRESS 0x7F8B6A /end MEASUREMENT
/begin MEASUREMENT CoEng_facFlConsumAdj_mp "Abgleichwert - Krafstoffverbrauchsabgleich" SWORD Fact 1 100 -4.000000 3.999878 FORMAT "%8.6" ECU_ADDRESS 0x8FE5EA /end MEASUREMENT
/begin MEASUREMENT CoEng_nMax "Drehzahlintervall Maximum" SWORD EngN 1 100 -32768.00 32767.00 FORMAT "%8.2" ECU_ADDRESS 0x7F8B6C /end MEASUREMENT
/begin MEASUREMENT CoEng_nMin "Drehzahlintervall Minimum" SWORD EngN 1 100 -32768.00 32767.00 FORMAT "%8.2" ECU_ADDRESS 0x7F8B6E /end MEASUREMENT
/begin MEASUREMENT CoEng_numShOffTstNewSel "ausgewählter Abstelltest des gegenwaertigen Fahrzyklus" UBYTE OneToOne 1 100 0.00 255.0 FORMAT "%5.1" ECU_ADDRESS 0x7F8817 /end MEASUREMENT
/begin MEASUREMENT CoEng_pRailT15Off "Raildruck bei Klemme 15 aus" SWORD Pres_Rail 1 100 -3276.800 3276.700 FORMAT "%5.3" ECU_ADDRESS 0x7F8B70 /end MEASUREMENT
/begin MEASUREMENT CoEng_qSubs_mp "Ersatzeinspritzmenge für KVA Berechnung" SWORD InjMassCyc 1 100 -327.6800 327.6700 FORMAT "%8.4" ECU_ADDRESS 0x8FE5EC /end MEASUREMENT
/begin MEASUREMENT CoEng_qSum_mp "tatsächlicher Kraftstoffverbrauch" SWORD InjMassCyc 1 100 -327.6800 327.6700 FORMAT "%8.4" ECU_ADDRESS 0x8FE5EE /end MEASUREMENT
/begin MEASUREMENT CoEng_rTrq "Verhältnis aktuelles Moment zu Maximalmoment" SWORD Prc 1 100 -400.0000 399.9878 FORMAT "%8.4" ECU_ADDRESS 0x7F8B72 /end MEASUREMENT
/begin MEASUREMENT CoEng_stAftRun "nachlauf-interner Nachlauf-Zustand" UBYTE OneToOne 1 100 0.00 255.0 FORMAT "%5.1" ECU_ADDRESS 0x7F8818 /end MEASUREMENT
/begin MEASUREMENT CoEng_stAftRunPath "Abschaltpfade aufgrund Motorzustand Nachlauf" ULONG OneToOne 1 100 0.00 4294967295.00 FORMAT "%13.2" ECU_ADDRESS 0x7F91D0 /end MEASUREMENT
/begin MEASUREMENT CoEng_stCoordFuncFld_mp "Messpunktarray zur Statusanzeige Schubkoordinator" UWORD OneToOne 1 100 0.00 65535.00 FORMAT "%8.2" ARRAY_SIZE 3 ECU_ADDRESS 0x8FE5FA /end MEASUREMENT
/begin MEASUREMENT CoEng_stCoordFuncPref_mp "Status Zustand Koordinator" UBYTE OneToOne 1 100 0.00 255.0 FORMAT "%5.1" ECU_ADDRESS 0x8FE600 /end MEASUREMENT
/begin MEASUREMENT CoEng_stCurrLim "Statuswort zur Markierung der niedrigsten Begrenzungsmomente" ULONG OneToOne 1 100 0.00 4294967295.00 FORMAT "%13.2" ECU_ADDRESS 0x7F91D4 /end MEASUREMENT
/begin MEASUREMENT CoEng_stCurrLimActive "Statusword zur Markierung der wirksamen niedrigsten Begrenzungsmomente" ULONG OneToOne 1 100 0.00 4294967295.00 FORMAT "%13.2" ECU_ADDRESS 0x7F91D8 /end MEASUREMENT
/begin MEASUREMENT CoEng_stDisable "Status Schubabschaltung: 1: abgeschalten; 0: nicht abgeschalten" UBYTE OneToOne 1 100 0.00 255.0 FORMAT "%5.1" ECU_ADDRESS 0x7F8819 /end MEASUREMENT
/begin MEASUREMENT CoEng_stDlyT15_mp "Status Variable für Verzögerungszeti nach Klemme 15 ein" UBYTE OneToOne 1 100 0.00 255.0 FORMAT "%5.1" ECU_ADDRESS 0x8FE602 /end MEASUREMENT
/begin MEASUREMENT CoEng_stEEPStore_mp "Speicherstatus für EEPROM während Nachlauf" UBYTE OneToOne 1 100 0.00 255.0 FORMAT "%5.1" ECU_ADDRESS 0x8FE5E6 /end MEASUREMENT
/begin MEASUREMENT CoEng_stEng "aktueller Motorzustand" UBYTE OneToOne 1 100 0.00 255.0 FORMAT "%5.1" ECU_ADDRESS 0x7F881A /end MEASUREMENT
/begin MEASUREMENT CoEng_stEngOld "Motorstatus vor aktuellem Status" UBYTE OneToOne 1 100 0.00 255.0 FORMAT "%5.1" ECU_ADDRESS 0x7F881B /end MEASUREMENT
/begin MEASUREMENT CoEng_stExtWait "Zustand ""warten auf externe Ereignisse vor Schreiben des EEPROM""" UBYTE OneToOne 1 100 0.00 255.0 FORMAT "%5.1" ECU_ADDRESS 0x7F881C /end MEASUREMENT
/begin MEASUREMENT CoEng_stExtWait2 "Zustand ""Warten auf externe Ereignisse vor Öffnen des Hauptrelais""" UBYTE OneToOne 1 100 0.00 255.0 FORMAT "%5.1" ECU_ADDRESS 0x7F881D /end MEASUREMENT
/begin MEASUREMENT CoEng_stIRevShutOff "irreversible Abschaltursachen (nach Maskierung)" ULONG OneToOne 1 100 0.00 4294967295.00 FORMAT "%13.2" ECU_ADDRESS 0x7F91DC /end MEASUREMENT
/begin MEASUREMENT CoEng_stMonActrPrt "Zustand der Steuerung Stellerschutz" UBYTE OneToOne 1 100 0.00 255.0 FORMAT "%5.1" ECU_ADDRESS 0x7F881F /end MEASUREMENT
/begin MEASUREMENT CoEng_stMonShOff "aktueller Zustand der Abstellsteuerung im Nachlauf" UBYTE OneToOne 1 100 0.00 255.0 FORMAT "%5.1" ECU_ADDRESS 0x7F8820 /end MEASUREMENT
/begin MEASUREMENT CoEng_stnAvrgZero_mp "Entprellte Motordrehzahl für den Zustandsübergang im Nachlauf" UBYTE OneToOne 1 100 0.00 255.0 FORMAT "%5.1" ECU_ADDRESS 0x8FE5E7 /end MEASUREMENT
/begin MEASUREMENT CoEng_stOvrFul "" UBYTE OneToOne 1 100 0.00 255.0 FORMAT "%5.1" ECU_ADDRESS 0x7F8821 /end MEASUREMENT
/begin MEASUREMENT CoEng_stOvrRun "Zustand Schuberkennung (0: kein Schub, 1: Schub)" UBYTE OneToOne 1 100 0.00 255.0 FORMAT "%5.1" ECU_ADDRESS 0x7F8822 /end MEASUREMENT
/begin MEASUREMENT CoEng_stOvrRunCoord "Status Schuberkennung des Schubkoordinators (0: kein Schub; 1: Schub)" UBYTE OneToOne 1 100 0.00 255.0 FORMAT "%5.1" ECU_ADDRESS 0x7F8823 /end MEASUREMENT
/begin MEASUREMENT CoEng_stOvrRunEGT_mp "Status Regenerationsanforderung Abgasnachbehandlung im Sinne des Schubkoordinators, 1:keine Freigabe für Funktionen" UBYTE OneToOne 1 100 0.00 255.0 FORMAT "%5.1" ECU_ADDRESS 0x8FE601 /end MEASUREMENT
/begin MEASUREMENT CoEng_stPwrDwn "Status des Diagnose Modus Power-down" UBYTE OneToOne 1 100 0.00 255.0 FORMAT "%5.1" ECU_ADDRESS 0x7F8824 /end MEASUREMENT
/begin MEASUREMENT CoEng_stPwrStgEnaCond "Steuergerätestatus, der für die Abschaltung der Endstufe/Endstufenfehlerdiagnose relevant ist" UBYTE OneToOne 1 100 0.00 255.0 FORMAT "%5.1" ECU_ADDRESS 0x7F8825 /end MEASUREMENT
/begin MEASUREMENT CoEng_stRevShutOff "reversible Abschaltursachen (nach Maskierung)" ULONG OneToOne 1 100 0.00 4294967295.00 FORMAT "%13.2" ECU_ADDRESS 0x7F91E0 /end MEASUREMENT
/begin MEASUREMENT CoEng_stShOffAddReqIRev "Kundenspezifische irreversible Abschaltanforderung" UBYTE OneToOne 1 100 0.00 255.0 FORMAT "%5.1" ECU_ADDRESS 0x7F8826 /end MEASUREMENT
/begin MEASUREMENT CoEng_stShOffAddReqRev "Kundenspezifische reversible Abschaltanforderung" UBYTE OneToOne 1 100 0.00 255.0 FORMAT "%5.1" ECU_ADDRESS 0x7F8827 /end MEASUREMENT
/begin MEASUREMENT CoEng_stShOffTst "Status des Abstelltest" UBYTE OneToOne 1 100 0.00 255.0 FORMAT "%5.1" ECU_ADDRESS 0x7F8828 /end MEASUREMENT
/begin MEASUREMENT CoEng_stShOffTstOldRes_mp "Testergebnis des letzten Fahrzyklus" UBYTE OneToOne 1 100 0.00 255.0 FORMAT "%5.1" ECU_ADDRESS 0x8FE603 /end MEASUREMENT
/begin MEASUREMENT CoEng_stShutOff "Typ der wirksamen Abschaltursache (0: Nachlauf; 1: reversibel; 2: irreversibel)" UBYTE OneToOne 1 100 0.00 255.0 FORMAT "%5.1" ECU_ADDRESS 0x7F8829 /end MEASUREMENT
/begin MEASUREMENT CoEng_stShutOffPath "aktive Abstellpfade resultierend aus aktiven reversiblen, irreversiblen und Nachlauf-Abstellpfaden" ULONG OneToOne 1 100 0.00 4294967295.00 FORMAT "%13.2" ECU_ADDRESS 0x7F91E4 /end MEASUREMENT
/begin MEASUREMENT CoEng_stTrqLimErr "Status Begrenzungsmoment im Systemfehlerfall. Bit0: Begrenzung aktiv; Bit1: Rampe von/zu Begrenzungswert aktiv" UBYTE OneToOne 1 100 0.00 255.0 FORMAT "%5.1" ECU_ADDRESS 0x7F882A /end MEASUREMENT
/begin MEASUREMENT CoEng_stTrqLimErr1 "Begrenzungsmoment im Fehlerfall" UBYTE OneToOne 1 100 0.00 255.0 FORMAT "%5.1" ECU_ADDRESS 0x7F882B /end MEASUREMENT
/begin MEASUREMENT CoEng_stTrqLimErr2 "Begrenzungsmoment im Fehlerfall 2" UBYTE OneToOne 1 100 0.00 255.0 FORMAT "%5.1" ECU_ADDRESS 0x7F882C /end MEASUREMENT
/begin MEASUREMENT CoEng_stTrqLimErr3 "Begrenzungsmoment im Fehlerfall" UBYTE OneToOne 1 100 0.00 255.0 FORMAT "%5.1" ECU_ADDRESS 0x7F882D /end MEASUREMENT
/begin MEASUREMENT CoEng_stTrqLimErr4 "Begrenzungsmoment im Fehlerfall" UBYTE OneToOne 1 100 0.00 255.0 FORMAT "%5.1" ECU_ADDRESS 0x7F882E /end MEASUREMENT
/begin MEASUREMENT CoEng_stTrqLimPFltErr "Status der Momentenbegrenzung bei pflt-Fehlern" UBYTE OneToOne 1 100 0.00 255.0 FORMAT "%5.1" ECU_ADDRESS 0x7F882F /end MEASUREMENT
/begin MEASUREMENT CoEng_stTrqLimPFltOvldErr "Statusmessage f. Ersatzmoment bei Systemfehler_Partikelfilter überladen" UBYTE OneToOne 1 100 0.00 255.0 FORMAT "%5.1" ECU_ADDRESS 0x7F8830 /end MEASUREMENT
/begin MEASUREMENT CoEng_stZFCEmissionRoll "Freigabe Status der ZFC am Rollentester" UBYTE OneToOne 1 100 0.00 255.0 FORMAT "%5.1" ECU_ADDRESS 0x7F8832 /end MEASUREMENT
/begin MEASUREMENT CoEng_tiAfterrun "Zeit seit Erreichen des Motorzustands Nachlauf (COENG_STAFTERRUN)" ULONG Time_ms 1 100 0.00 42949672950.0 FORMAT "%13.1" ECU_ADDRESS 0x7F91E8 /end MEASUREMENT
/begin MEASUREMENT CoEng_tiAfterrunRed "Zeit seit Erreichen des Motorzustands Nachlauf (COENG_STAFTERRUN, 0x30) mit reduzierter Auflösung als KL/KF Eingang" SWORD TimeRed 1 100 -5242.880 5242.720 FORMAT "%8.3" ECU_ADDRESS 0x7F8B74 /end MEASUREMENT
/begin MEASUREMENT CoEng_tiMinAftRun "Minimale Zeitdauer für die Verbindung vom elektronischen Steuergerät zum Hauptrelais" ULONG Time_ms 1 100 0.00 42949672950.0 FORMAT "%13.1" ECU_ADDRESS 0x7F91EC /end MEASUREMENT
/begin MEASUREMENT CoEng_tiNormal "Zeit seit Erreichen des Zustands NORMAL" ULONG Time_ms 1 100 0.00 42949672950.0 FORMAT "%13.1" ECU_ADDRESS 0x7F91F0 /end MEASUREMENT
/begin MEASUREMENT CoEng_tiNormalRed "Zeit seit Erreichen Motorzustand NORMAL (0x04), mit reduzierter Auflösung als KL/KF Eingang" SWORD TimeRed 1 100 -5242.880 5242.720 FORMAT "%8.3" ECU_ADDRESS 0x7F8B76 /end MEASUREMENT
/begin MEASUREMENT CoEng_tiSoftShOff_mp "time delay for soft shutoff" UWORD Time_ms 1 100 0.00 655350.0 FORMAT "%8.1" ECU_ADDRESS 0x8FE604 /end MEASUREMENT
/begin MEASUREMENT CoEng_tiStart "Zeit seit Erreichen Motorzustand START (0x02)" ULONG Time_ms 1 100 0.00 42949672950.0 FORMAT "%13.1" ECU_ADDRESS 0x7F91F4 /end MEASUREMENT
/begin MEASUREMENT CoEng_tiStartRed "Zeit seit Erreichen Motorzustand START (0x02), mit reduzierter Auflösung als KL/KF Eingang" SWORD TimeRed 1 100 -5242.880 5242.720 FORMAT "%8.3" ECU_ADDRESS 0x7F8B7A /end MEASUREMENT
/begin MEASUREMENT CoEng_tiWakeUp "Zeit seit Erreichen Zustand WAKEUP" ULONG Time_ms 1 100 0.00 42949672950.0 FORMAT "%13.1" ECU_ADDRESS 0x7F91F8 /end MEASUREMENT
/begin MEASUREMENT CoEng_trq "aktuelles Motorausgangsmoment" SWORD Trq 1 100 -3276.800 3276.700 FORMAT "%8.3" ECU_ADDRESS 0x7F8B7E /end MEASUREMENT
/begin MEASUREMENT CoEng_trqCorGearbxRgn "Message für die Korrektur der Getriebeschaltschwellen, während der Regeneration steht weniger Moment zur Verfügung" SWORD Trq 1 100 -3276.800 3276.700 FORMAT "%8.3" ECU_ADDRESS 0x7F8B84 /end MEASUREMENT
/begin MEASUREMENT CoEng_trqCurrLim "Minimum aller Begrenzungen als aktuelles Motorausgangsmoment" SWORD Trq 1 100 -3276.800 3276.700 FORMAT "%8.3" ECU_ADDRESS 0x7F8B86 /end MEASUREMENT
/begin MEASUREMENT CoEng_trqInrCurr "inneres Moment aktueller Wert" SWORD Trq 1 100 -3276.800 3276.700 FORMAT "%8.3" ECU_ADDRESS 0x7F8B88 /end MEASUREMENT
/begin MEASUREMENT CoEng_trqInrCurrFast "inneres Wunschmoment (schneller Pfad) erzeugt aus CoDT_trqCurr" SWORD Trq 1 100 -3276.800 3276.700 FORMAT "%8.3" ECU_ADDRESS 0x7F8B8A /end MEASUREMENT
/begin MEASUREMENT CoEng_trqInrCurrLim "aktuell kleinstes Begrenzungsmoment (inneres Motormoment)" SWORD Trq 1 100 -3276.800 3276.700 FORMAT "%8.3" ECU_ADDRESS 0x7F8B8C /end MEASUREMENT
/begin MEASUREMENT CoEng_trqInrDes "Wunschmoment (inneres Motormoment)" SWORD Trq 1 100 -3276.800 3276.700 FORMAT "%8.3" ECU_ADDRESS 0x7F8B8E /end MEASUREMENT
/begin MEASUREMENT CoEng_trqInrDesFast "Wunschmoment (inneres Motormoment) (schneller Pfad) erzeugt aus CoDT_trqLead" SWORD Trq 1 100 -3276.800 3276.700 FORMAT "%8.3" ECU_ADDRESS 0x7F8B90 /end MEASUREMENT
/begin MEASUREMENT CoEng_trqInrDesSlow "inneres Moment Wunschwert (normaler Pfad) erzeugt aus CoDT_trqDes" SWORD Trq 1 100 -3276.800 3276.700 FORMAT "%8.3" ECU_ADDRESS 0x7F8B92 /end MEASUREMENT
/begin MEASUREMENT CoEng_trqInrGearbxInMax_mp "maximales Getriebeeingangsmoment als inneres Motormoment" SWORD Trq 1 100 -3276.800 3276.700 FORMAT "%8.3" ECU_ADDRESS 0x8FE606 /end MEASUREMENT
/begin MEASUREMENT CoEng_trqInrLim "Begrenzungsmoment (inneres Motormoment)" SWORD Trq 1 100 -3276.800 3276.700 FORMAT "%8.3" ECU_ADDRESS 0x7F8B96 /end MEASUREMENT
/begin MEASUREMENT CoEng_trqInrLimDes "Begrenzungsmoment als inneres Motormoment, korrigiert um Leerlaufreglerstellgröße" SWORD Trq 1 100 -3276.800 3276.700 FORMAT "%8.3" ECU_ADDRESS 0x7F8B98 /end MEASUREMENT
/begin MEASUREMENT CoEng_trqInrLimLead "Begrenzungsmoment mit lang anhaltenden Begrenzungen" SWORD Trq 1 100 -3276.800 3276.700 FORMAT "%8.3" ECU_ADDRESS 0x7F8B9A /end MEASUREMENT
/begin MEASUREMENT CoEng_trqInrLtd "inneres Moment Sollwert nach Begrenzung, vor Eingriff ARD-Störungsregler" SWORD Trq 1 100 -3276.800 3276.700 FORMAT "%8.3" ECU_ADDRESS 0x7F8B9C /end MEASUREMENT
/begin MEASUREMENT CoEng_trqInrPrpLimErr_mp "Begrenzungsmoment für Vortrieb im Falle eines Systemfehlers als inneres Motormoment" SWORD Trq 1 100 -3276.800 3276.700 FORMAT "%8.3" ECU_ADDRESS 0x8FE608 /end MEASUREMENT
/begin MEASUREMENT CoEng_trqInrRaw "inneres Moment Rohwert" SWORD Trq 1 100 -3276.800 3276.700 FORMAT "%8.3" ECU_ADDRESS 0x7F8B9E /end MEASUREMENT
/begin MEASUREMENT CoEng_trqInrSet "inneres Moment Sollwert (>Mengenberechnung)" SWORD Trq 1 100 -3276.800 3276.700 FORMAT "%8.3" ECU_ADDRESS 0x7F8BA0 /end MEASUREMENT
/begin MEASUREMENT CoEng_trqLiLtd "begrenztes Leerlaufreglermoment" SWORD Trq 1 100 -3276.800 3276.700 FORMAT "%8.3" ECU_ADDRESS 0x7F8BA2 /end MEASUREMENT
/begin MEASUREMENT CoEng_trqLimErr "Begrenzungsmoment im Falle eines Systemfehlers" SWORD Trq 1 100 -3276.800 3276.700 FORMAT "%8.3" ECU_ADDRESS 0x7F8BA4 /end MEASUREMENT
/begin MEASUREMENT CoEng_trqLimErr1 "Begrenzungsmoment im Falle Systemfehler 1" SWORD Trq 1 100 -3276.800 3276.700 FORMAT "%8.3" ECU_ADDRESS 0x7F8BA6 /end MEASUREMENT
/begin MEASUREMENT CoEng_trqLimErr2 "Begrenzungsmoment im Fall Systemfahler 2" SWORD Trq 1 100 -3276.800 3276.700 FORMAT "%8.3" ECU_ADDRESS 0x7F8BA8 /end MEASUREMENT
/begin MEASUREMENT CoEng_trqLimErr3 "Begrenzungsmoment im Falle Systemfehler3" SWORD Trq 1 100 -3276.800 3276.700 FORMAT "%8.3" ECU_ADDRESS 0x7F8BAA /end MEASUREMENT
/begin MEASUREMENT CoEng_trqLimErr4 "Begrenzungsmoment im Fall Systemfehler 4" SWORD Trq 1 100 -3276.800 3276.700 FORMAT "%8.3" ECU_ADDRESS 0x7F8BAC /end MEASUREMENT
/begin MEASUREMENT CoEng_trqLimPDiff "Momentenbegrenzung aufgrund Druckdifferenz über Partikelfilter" SWORD Trq 1 100 -3276.800 3276.700 FORMAT "%8.3" ECU_ADDRESS 0x7F8BB0 /end MEASUREMENT
/begin MEASUREMENT CoEng_trqLimPFltErr "Ersatzmoment bei Systemfehler_Partikelfilter" SWORD Trq 1 100 -3276.800 3276.700 FORMAT "%8.3" ECU_ADDRESS 0x7F8BB2 /end MEASUREMENT
/begin MEASUREMENT CoEng_trqLimPFltOvldErr "Ersatzmoment bei Systemfehler_Partikelfilter überladen" SWORD Trq 1 100 -3276.800 3276.700 FORMAT "%8.3" ECU_ADDRESS 0x7F8BB4 /end MEASUREMENT
/begin MEASUREMENT CoEng_trqLimSwt "Ausgang des RampSwitch-Block zur Momentbegrenzung im Systemfehlerfall" SWORD Trq 1 100 -3276.800 3276.700 FORMAT "%8.3" ECU_ADDRESS 0x7F8BB6 /end MEASUREMENT
/begin MEASUREMENT CoEng_trqMax "Momentintervall Maximum" SWORD Trq 1 100 -3276.800 3276.700 FORMAT "%8.3" ECU_ADDRESS 0x7F8BB8 /end MEASUREMENT
/begin MEASUREMENT CoEng_trqMin "Schleppmoment" SWORD Trq 1 100 -3276.800 3276.700 FORMAT "%8.3" ECU_ADDRESS 0x7F8BBA /end MEASUREMENT
/begin MEASUREMENT CoEng_trqOvrFul "Overfueling Menge nach Rampe" SWORD Trq 1 100 -3276.800 3276.700 FORMAT "%8.3" ECU_ADDRESS 0x7F8BBC /end MEASUREMENT
/begin MEASUREMENT CoEng_trqSlpLim "Begrenzungsmoment für Rauchbegrenzung nach Turboschubbegrenzung" SWORD Trq 1 100 -3276.800 3276.700 FORMAT "%8.3" ECU_ADDRESS 0x7F8BC0 /end MEASUREMENT
/begin MEASUREMENT CoEng_volFlConsum "absoluter Verbrauch" SLONG FlConsum_ul_20ms 1 100 -2147483648.00 2147483647.00 FORMAT "%13.2" ECU_ADDRESS 0x7F91FC /end MEASUREMENT
/begin MEASUREMENT CoEng_volFlConsumAdj_mp "abgeglicher Kraftstoffverbrauch" SLONG FlConsum_ul_20ms 1 100 -2147483648.00 2147483647.00 FORMAT "%13.2" ECU_ADDRESS 0x8FE5F0 /end MEASUREMENT
/begin MEASUREMENT CoEng_voltotFlConsum "Absoluter Kraftstoffverbrauch" SLONG FlConsum_ul 1 100 -2147483648.00 2147483647.00 FORMAT "%13.2" ECU_ADDRESS 0x7F9200 /end MEASUREMENT
/begin FUNCTION asdrf_selectparameter "Parametersatzauswahl ARD Führungsformer"
 /begin DEF_CHARACTERISTIC ASDrf_T1CluNeg_C ASDrf_KdCluNeg_C ASDrf_T1CluPos_C ASDrf_KdCluPos_C ASDrf_T1ExtInt_C ASDrf_KdExtInt_C ASDrf_numDefaultState_C ASDrf_CoeffACluLossNeg_C ASDrf_CoeffBCluLossNeg_C ASDrf_CoeffACluLossPos_C ASDrf_CoeffBCluLossPos_C ASDrf_CoeffAExtIntLoss_C ASDrf_CoeffBExtIntLoss_C ASDrf_CoeffAState3LossNeg_C ASDrf_CoeffBState3LossNeg_C ASDrf_CoeffAState3LossPos_C ASDrf_CoeffBState3LossPos_C ASDrf_CoeffAState4LossNeg_C ASDrf_CoeffBState4LossNeg_C ASDrf_CoeffAState4LossPos_C ASDrf_CoeffBState4LossPos_C ASDrf_T1State3Neg_C ASDrf_KdState3Neg_C ASDrf_T1State3Pos_C ASDrf_KdState3Pos_C ASDrf_T1State4Neg_C ASDrf_KdState4Neg_C ASDrf_T1State4Pos_C ASDrf_KdState4Pos_C ASDrf_stConv1_C ASDrf_stConv2_C ASDrf_stConv3_C ASDrf_stConvCluEng_C ASDrf_stConvCluOff_C ASDrf_stConvCluSlip_C ASDrf_stEntcClu_C ASDrf_stEntcExtInt_C ASDrf_stEntcFDC_C ASDrf_stEntcGrip_C ASDrf_stEntcState3_C ASDrf_stEntcState4_C ASDrf_stExClu_C ASDrf_stExExtInt_C ASDrf_stExFDC_C ASDrf_stExGrip_C ASDrf_stExState3_C ASDrf_stExState4_C ASDrf_stExtInt_C ASDrf_stFDC_C ASDrf_stGrip_C ASDrf_stReliablAdpt_C ASDrf_swtLossClcNoRel_C ASDrf_swtLossClcRel_C ASDrf_swtOpr_C ASDrf_swtStiffParameter_C ASDrf_trqLossNeg_CUR ASDrf_trqLossPos_CUR ASDrf_trqOfsNegHigh_C ASDrf_trqOfsNegLow_C ASDrf_trqOfsNegMid_C ASDrf_trqOfsPosHigh_C ASDrf_trqOfsPosLow_C ASDrf_trqOfsPosMid_C /end DEF_CHARACTERISTIC
 /begin IN_MEASUREMENT Eng_nAvrg /end IN_MEASUREMENT
 /begin OUT_MEASUREMENT ASDrf_stInit /end OUT_MEASUREMENT
/end FUNCTION
/begin FUNCTION asdrf_selectparameter_msg "" /begin OUT_MEASUREMENT ASDrf_trqLossNeg ASDrf_trqLossPos /end OUT_MEASUREMENT /end FUNCTION
/begin FUNCTION asdrf_selectparameter_uic ""
 /begin OUT_MEASUREMENT ASDrf_stCond_mp ASDrf_stPrioState_mp ASDrf_stSelectState_mp ASDrf_stStates_mp /end OUT_MEASUREMENT
/end FUNCTION
/begin FUNCTION asdrf_selectparameter_var ""
 /begin DEF_CHARACTERISTIC ASDrf_CoeffAFDCLossNeg_CUR ASDrf_CoeffAFDCLossPos_CUR ASDrf_CoeffAGripLossNeg_CUR ASDrf_CoeffAGripLossPos_CUR ASDrf_CoeffBFDCLossNeg_CUR ASDrf_CoeffBFDCLossPos_CUR ASDrf_CoeffBGripLossNeg_CUR ASDrf_CoeffBGripLossPos_CUR ASDrf_KdFDCNeg_CUR ASDrf_KdFDCPos_CUR ASDrf_KdGripNeg_CUR ASDrf_KdGripPos_CUR ASDrf_numPrio_C ASDrf_T1FDCNeg_CUR ASDrf_T1FDCPos_CUR ASDrf_T1GripNeg_CUR ASDrf_T1GripPos_CUR /end DEF_CHARACTERISTIC
 /begin IN_MEASUREMENT DrvTrn_rTransDT /end IN_MEASUREMENT
/end FUNCTION
/begin FUNCTION asmod_co "interface coordinator" /end FUNCTION
/begin FUNCTION asmod_co_msg "" /begin OUT_MEASUREMENT ASMod_facAMCor ASMod_qCor ASMod_rRelPosVSA /end OUT_MEASUREMENT /end FUNCTION
/begin FUNCTION asmod_co_uic "" /end FUNCTION
/begin FUNCTION asmod_detcylch "Füllungserfassung" /end FUNCTION
/begin FUNCTION asmod_detcylch_msg ""
 /begin OUT_MEASUREMENT ASMod_dmExhMnfPst ASMod_dmIndAir ASMod_dmO2IndAir ASMod_rLmbdRecExhMnfPst ASMod_tIndAir /end OUT_MEASUREMENT
/end FUNCTION
/begin FUNCTION asmod_detcylch_uic ""
 /begin OUT_MEASUREMENT ASMod_dmEGR_mp ASMod_dmIndAir_mp ASMod_rO2ExhMnfPst_mp ASMod_rO2IndAir_mp ASMod_tExhMnfPst_mp /end OUT_MEASUREMENT
/end FUNCTION
/begin FUNCTION asmod_eng "Motor"
 /begin DEF_CHARACTERISTIC ASMod_dmIndAirRef_MAP ASMod_facDdTm_C ASMod_facDMCorTDiff_CUR ASMod_facSOICorTDiff_CUR ASMod_phiSOIRef_MAP ASMod_tDiffEng_MAP ASMod_tEngCorTDiff_CUR ASMod_tEngRef_C /end DEF_CHARACTERISTIC
 /begin IN_MEASUREMENT ASMod_qBurned_mp ASMod_qLmbdCtlCorr_mp ASMod_rDMIndAir_mp ASMod_tEngCorTDiff_mp Eng_nAvrg InjCrv_phiMI1Des /end IN_MEASUREMENT
/end FUNCTION
/begin FUNCTION asmod_eng_msg ""
 /begin OUT_MEASUREMENT ASMod_dmExhMnfPre ASMod_rLmbdRecEG ASMod_rO2ExhMnfPre ASMod_tExhMnfPre /end OUT_MEASUREMENT
/end FUNCTION
/begin FUNCTION asmod_eng_uic ""
 /begin OUT_MEASUREMENT ASMod_dmEG_mp ASMod_dmFlBurned_mp ASMod_dmFlPerTime_mp ASMod_dmIndAirRef_mp ASMod_dmO2EG_mp ASMod_facDMCorTDiff_mp ASMod_facSOICorTDiff_mp ASMod_phiSOIRef_mp ASMod_qBurned_mp ASMod_qLmbdCtlCorr_mp ASMod_rDMIndAir_mp ASMod_rFlBurned_mp ASMod_rO2EG_mp ASMod_tDiffEG_mp ASMod_tDiffEng_mp ASMod_tEG_mp ASMod_tEngCorTDiff_mp ASMod_tiDdTm_mp /end OUT_MEASUREMENT
/end FUNCTION
/begin FUNCTION asmod_indvol "Modell des Einlaßvolumens" /begin DEF_CHARACTERISTIC ASMod_tiDT1_C ASMod_volIndVol_C /end DEF_CHARACTERISTIC /end FUNCTION
/begin FUNCTION asmod_indvol_msg "" /begin OUT_MEASUREMENT ASMod_dmAirPerTimeCorr ASMod_mAirPerCylCorr /end OUT_MEASUREMENT /end FUNCTION
/begin FUNCTION asmod_indvol_uic "" /begin OUT_MEASUREMENT ASMod_dmIndVol_mp ASMod_mIndVol_mp /end OUT_MEASUREMENT /end FUNCTION
/begin FUNCTION asmod_voleff "Luftaufwand"
 /begin DEF_CHARACTERISTIC ASMod_facTCorVolEff_C ASMod_facVolEff_MAP ASMod_facVSACorVolEff_MAP ASMod_swtT_C ASMod_tIndAirRef_MAP ASMod_volEng_C /end DEF_CHARACTERISTIC
 /begin IN_MEASUREMENT ASMod_rRelPosVSA Eng_nAvrg InjCtl_qCurr /end IN_MEASUREMENT
/end FUNCTION
/begin FUNCTION asmod_voleff_msg "" /begin OUT_MEASUREMENT ASMod_dmIndAirRef ASMod_dvolIndAirRef ASMod_tIndAirRef /end OUT_MEASUREMENT /end FUNCTION
/begin FUNCTION asmod_voleff_uic ""
 /begin OUT_MEASUREMENT ASMod_facTIndAirCor_mp ASMod_facVolEff_mp ASMod_facVSACorVolEff_mp ASMod_tIntakeAir_mp /end OUT_MEASUREMENT
/end FUNCTION
/begin FUNCTION battcd "Komponententreiber Batteriespannung"
 /begin DEF_CHARACTERISTIC BattCD_uSRCMin_C BattCD_uSRCMax_C BattCD_uLin_CUR BattCD_DebSRCHighDef_C BattCD_DebSRCHighOk_C BattCD_DebSRCLowDef_C BattCD_DebSRCLowOk_C BattCD_numAdc_C BattCD_duRmpSlpUp_C BattCD_duRmpSlpDwn_C BattCD_stSensIDWord_C BattCD_uDfl_C /end DEF_CHARACTERISTIC
 /begin IN_MEASUREMENT BattCD_uRaw /end IN_MEASUREMENT
/end FUNCTION
/begin FUNCTION battcd_msg "" /begin OUT_MEASUREMENT BattCD_u BattCD_uLin BattCD_uRaw /end OUT_MEASUREMENT /end FUNCTION
/begin FUNCTION battcd_uic "" /end FUNCTION
/begin FUNCTION batt_corfac "" /begin DEF_CHARACTERISTIC Batt_uNrm_C /end DEF_CHARACTERISTIC /end FUNCTION
/begin FUNCTION batt_corfac_msg "" /begin OUT_MEASUREMENT Batt_facCor /end OUT_MEASUREMENT /end FUNCTION
/begin FUNCTION bdint "Karosserie und Innenraum" /end FUNCTION
/begin FUNCTION bdint_msg "" /begin OUT_MEASUREMENT BdInt_nMax BdInt_nMin BdInt_pwrDes BdInt_pwrLead /end OUT_MEASUREMENT /end FUNCTION
/begin FUNCTION bpacd "Komponententreiber des Ladedruckstellers"
 /begin DEF_CHARACTERISTIC BPACD_ctPwrStgOnMax_C BPACD_tiDebBPADia1Def_C BPACD_tiDebBPADia1Ok_C BPACD_tiDebBPADia2Def_C BPACD_tiDebBPADia2Ok_C BPACD_tiDebBPADia3Def_C BPACD_tiDebBPADia3Ok_C BPACD_tiDebBPADia4Def_C BPACD_tiDebBPADia4Ok_C BPACD_DebExcTempDef_C BPACD_DebExcTempOk_C BPACD_DebExtNplDef_C BPACD_DebExtNplOk_C BPACD_DebExtShortCircBatDef_C BPACD_DebExtShortCircBatOk_C BPACD_DebExtShortCircGndDef_C BPACD_DebExtShortCircGndOk_C BPACD_DebNoLoadDef_C BPACD_DebNoLoadOk_C BPACD_tiDebPwmInDia1Def_C BPACD_tiDebPwmInDia1Ok_C BPACD_tiDebPwmInDia2Def_C BPACD_tiDebPwmInDia2Ok_C BPACD_tiDebPwmInDia3Def_C BPACD_tiDebPwmInDia3Ok_C BPACD_tiDebPwmInDia4Def_C BPACD_tiDebPwmInDia4Ok_C BPACD_DebShortCircBatDef_C BPACD_DebShortCircBatOk_C BPACD_DebShortCircGndDef_C BPACD_DebShortCircGndOk_C BPACD_numDia_C BPACD_numExtPin_C BPACD_numPwmOut_C BPACD_stDiaInv_C BPACD_tiDiaMin_C BPACD_tiDiaMax_C BPACD_rDiaMin_C BPACD_rDiaMax_C BPACD_stInvOut_C BPACD_tiPer_C BPACD_rCnv_CUR BPACD_rLin_CUR BPACD_rOutMax_C BPACD_rOutMin_C BPACD_rTst_C BPACD_stPwrStgActv_C BPACD_stPwrStgDia_C BPACD_stSPICtl_C BPACD_swtExtPinEna_C BPACD_swt_C BPACD_tiBtwTst_C BPACD_tiDiag1Max_C BPACD_tiDiag1Min_C BPACD_tiDiag2Max_C BPACD_tiDiag2Min_C BPACD_tiDiag3Max_C BPACD_tiDiag3Min_C BPACD_tiDiag4Max_C BPACD_tiDiag4Min_C BPACD_tiPwrStgOn_C /end DEF_CHARACTERISTIC
 /begin IN_MEASUREMENT BPACD_rRaw BPA_rBPACD /end IN_MEASUREMENT
/end FUNCTION
/begin FUNCTION bpacd_msg "" /begin OUT_MEASUREMENT BPACD_rAktPos BPACD_rOut BPACD_rRaw BPACD_stExtErr /end OUT_MEASUREMENT /end FUNCTION
/begin FUNCTION bpacd_uic "" /begin OUT_MEASUREMENT BPACD_rCnv_mp /end OUT_MEASUREMENT /end FUNCTION
/begin FUNCTION bpa_co "Stellerkoordinator für Ladedrucksteller" /end FUNCTION
/begin FUNCTION bpa_co_msg "" /begin OUT_MEASUREMENT BPA_rBPACD /end OUT_MEASUREMENT /end FUNCTION
/begin FUNCTION bpa_co_uic "" /begin DEF_CHARACTERISTIC BPA_rBPACD_Vector BPA_rBPACD_Channel /end DEF_CHARACTERISTIC /begin OUT_MEASUREMENT BPA_rBPAByp_mp /end OUT_MEASUREMENT /end FUNCTION
/begin FUNCTION bpa_lpco "" /end FUNCTION
/begin FUNCTION bpa_lpco_msg "" /begin OUT_MEASUREMENT BPA_rLPACD /end OUT_MEASUREMENT /end FUNCTION
/begin FUNCTION bpa_lpco_uic "" /begin DEF_CHARACTERISTIC BPA_rLPACD_Vector BPA_rLPACD_Channel /end DEF_CHARACTERISTIC /begin OUT_MEASUREMENT BPA_rLPAByp_mp /end OUT_MEASUREMENT /end FUNCTION
/begin FUNCTION bpscd "Komponententreiber des Ladedruckfühlers"
 /begin DEF_CHARACTERISTIC BPSCD_uSRCMin_C BPSCD_uSRCMax_C BPSCD_pLin_CUR BPSCD_DebNplDef_C BPSCD_DebNplOK_C BPSCD_DebSigDef_C BPSCD_DebSigOK_C BPSCD_DebSRCHighDef_C BPSCD_DebSRCHighOK_C BPSCD_DebSRCLowDef_C BPSCD_DebSRCLowOK_C BPSCD_tiDT1_C BPSCD_dDT1Kd_C BPSCD_tiLPFiltPT1_C BPSCD_nLim_C BPSCD_numAdc_C BPSCD_pDiffLim_C BPSCD_tiOutValDT1_C BPSCD_dDT1KdOutVal_C BPSCD_tiPT1_C BPSCD_dpRmpSlpUp_C BPSCD_dpRmpSlpDwn_C BPSCD_swtSigVal_C BPSCD_stSensIDWord_C BPSCD_pDfl_C /end DEF_CHARACTERISTIC
 /begin IN_MEASUREMENT BPSCD_uRawVal /end IN_MEASUREMENT
/end FUNCTION
/begin FUNCTION bpscd_msg ""
 /begin OUT_MEASUREMENT BPSCD_dFltValDT1 BPSCD_dpOutVal BPSCD_pFltVal BPSCD_pIntVal BPSCD_pLin BPSCD_pOutVal BPSCD_pPhyVal BPSCD_stErr BPSCD_stPlausErr BPSCD_uRawVal /end OUT_MEASUREMENT
/end FUNCTION
/begin FUNCTION bpscd_uic "" /end FUNCTION
/begin FUNCTION brkcd "Komponententreiber zur Erfassung aller Bremssignale"
 /begin DEF_CHARACTERISTIC BrkCD_ctUnPlausDef_C BrkCD_DebSigDef_C BrkCD_DebSigOk_C BrkCD_tiMnSwtDebNeg_C BrkCD_tiMnSwtDebPos_C BrkCD_numDioInMn_C BrkCD_numDioInRed_C BrkCD_tiRedSwtDebNeg_C BrkCD_tiRedSwtDebPos_C BrkCD_stDflVal_C BrkCD_stMnSwtInvIn_C BrkCD_stRedSwtInvIn_C BrkCD_swtRedSwtPresent_C BrkCD_swtSigVal_C BrkCD_tiDebResUnPlaus_C BrkCD_tiDebUnPlausStat_C BrkCD_tiDebUnPlaus_C /end DEF_CHARACTERISTIC
/end FUNCTION
/begin FUNCTION brkcd_msg ""
 /begin OUT_MEASUREMENT BrkCD_stMnSwtDebVal BrkCD_stMnSwtLastDebVal BrkCD_stMnSwtRawVal BrkCD_stPressed BrkCD_stRedSwtDebVal BrkCD_stRedSwtLastDebVal BrkCD_stRedSwtPresent BrkCD_stRedSwtRawVal BrkCD_swtSig /end OUT_MEASUREMENT
/end FUNCTION
/begin FUNCTION brkcd_uic ""
 /begin OUT_MEASUREMENT BrkCD_ctUnPlaus_mp BrkCD_stDeb_mp BrkCD_stMnSwtLogVal_mp BrkCD_stRedSwtLogVal_mp BrkCD_stResUnPlaus_mp BrkCD_stRun_mp BrkCD_tiUnPlausBrkPres_mp /end OUT_MEASUREMENT
/end FUNCTION
/begin FUNCTION bss "Servicetask für Bit Serielle Schnittstelle" /begin DEF_CHARACTERISTIC Bss_tiDebDefect_C Bss_tiDebOk_C /end DEF_CHARACTERISTIC /end FUNCTION
/begin FUNCTION bypetk ""
 /begin DEF_CHARACTERISTIC BypEtk_dNsyncStimuli64_C BypEtk_dNsyncStimuli32_C BypEtk_dNsyncStimuli16_C BypEtk_dNsyncStimuli8_C BypEtk_stAscet_C BypEtk_dTsyncStimuli64_C BypEtk_dTsyncStimuli32_C BypEtk_dTsyncStimuli16_C BypEtk_dTsyncStimuli8_C /end DEF_CHARACTERISTIC
/end FUNCTION
/begin FUNCTION bypetk_msg ""
 /begin OUT_MEASUREMENT BypEtk_ctStepDelayNsync_u8 BypEtk_ctStepDelayTsync_u8 BypEtk_stEcu_u8 /end OUT_MEASUREMENT
/end FUNCTION
/begin FUNCTION bypint "" /begin DEF_CHARACTERISTIC BypInt_adFunc_C BypInt_stAscet_C /end DEF_CHARACTERISTIC /end FUNCTION
/begin FUNCTION bypint_msg "" /begin OUT_MEASUREMENT BypInt_stEcu_u8 /end OUT_MEASUREMENT /end FUNCTION
/begin FUNCTION carb "CARB Einstellungen"
 /begin DEF_CHARACTERISTIC Carb_Mode1PID_CA Carb_Mode1Signal_CA Carb_Mode2PID_CA Carb_Mode2Signal_CA Carb_Mode3SwtDia_C Carb_Mode4RefVal_C Carb_Mode4SigNum_C Carb_Mode6TstComp_CUR Carb_Mode6TstNum_CUR Carb_Mode6TstRefMax_CUR Carb_Mode6TstRefMin_CUR Carb_Mode6TstTestId_CUR Carb_Mode6TstUnitId_CUR Carb_Mode6TstVal_CUR Carb_Mode9PID0_C Carb_Mode9PID1_C Carb_Mode9PID2_C Carb_Mode9PID3_C Carb_Mode9PID4_C Carb_Mode9PID5_C Carb_Mode9PID6_C /end DEF_CHARACTERISTIC
/end FUNCTION
/begin FUNCTION cascd "Komponententreiber Nockenwelle"
 /begin DEF_CHARACTERISTIC CaSCD_ctAddTooth_C CaSCD_ctEdgOfs_C CaSCD_ctErrSegLen2Pos_C CaSCD_ctErrSync_C CaSCD_ctMissTooth_C CaSCD_ctShftSync_C CaSCD_dSegSeries_C CaSCD_dTrigMsk_C CaSCD_dTrigRslt_C CaSCD_facPlausHigh_CUR CaSCD_facPlausLow_CUR CaSCD_nMinSpeed_C CaSCD_phiPosTolc_C CaSCD_phiSegLenTolc_C CaSCD_phiSegLen_C CaSCD_phiSegOfs_C CaSCD_phiSpeedCalcTolc_C CaSCD_phiSpeedSegLen_C CaSCD_phiSpeedSegOfs_C CaSCD_phiTrig_C CaSCD_stCalc_C CaSCD_stEdgeTrig_C CaSCD_stPinState_C CaSCD_stTPO_C CaSCD_swtSegLenPin2Pos_C CaSCD_tiPeriodRev1Max_C CaSCD_tiPeriodRev2Max_C CaSCD_tiTimOutOfs_C /end DEF_CHARACTERISTIC
 /begin IN_MEASUREMENT CaSCD_tiPeriodRev CaSCD_tiPeriodRevHold /end IN_MEASUREMENT
/end FUNCTION
/begin FUNCTION cascd_backup "" /end FUNCTION
/begin FUNCTION cascd_msg ""
 /begin OUT_MEASUREMENT CaSCD_nPeriod CaSCD_nSeg CaSCD_tiPeriodRev CaSCD_tiPeriodRevHold CaSCD_tiSeg /end OUT_MEASUREMENT
/end FUNCTION
/begin FUNCTION cascd_uic ""
 /begin OUT_MEASUREMENT CaSCD_ctAddTooth_mp CaSCD_ctEdgCaSRev_mp CaSCD_ctEdgOfs_mp CaSCD_ctEdgOrd_mp CaSCD_ctErrEdg_mp CaSCD_ctErrSegLen2Pos_mp CaSCD_ctMissTooth_mp CaSCD_ctPhRevEdges_mp CaSCD_ctPhRev_mp CaSCD_ctSegEdg_mp CaSCD_ctSegLenOrd_mp CaSCD_ctShftPos_mp CaSCD_ctSyncEdg_mp CaSCD_numFrstInt_mp CaSCD_numFrstTDC_mp CaSCD_phiCurr_mp CaSCD_phiLstEdge_mp CaSCD_stPhaseErr_mp CaSCD_stPhaseSig_mp CaSCD_stPhaseSync_mp CaSCD_stSegCylEdg_mp CaSCD_stSyncCylEdg_mp CaSCD_tiSigTimOut_mp /end OUT_MEASUREMENT
/end FUNCTION
/begin FUNCTION cas_syncnocas "Synchronisation ohne Nockenwellensignal für 3 Zylinder Motoren" /end FUNCTION
/begin FUNCTION cas_syncnocas_msg "" /end FUNCTION
/begin FUNCTION cas_syncnocas_uic "" /end FUNCTION
/begin FUNCTION cbacd ""
 /begin DEF_CHARACTERISTIC CBACD_ctPwrStgOnMax_C CBACD_numDia_C CBACD_numDioOut_C CBACD_stInvOut_C CBACD_stPwrStgActv_C CBACD_stPwrStgDia_C CBACD_stSPICtl_C CBACD_tiBtwTst_C CBACD_tiDebExcTempDef_C CBACD_tiDebExcTempOk_C CBACD_tiDebNoLoadDef_C CBACD_tiDebNoLoadOk_C CBACD_tiDebShortCircBatDef_C CBACD_tiDebShortCircBatOk_C CBACD_tiDebShortCircGndDef_C CBACD_tiDebShortCircGndOk_C CBACD_tiPwrStgOn_C /end DEF_CHARACTERISTIC
/end FUNCTION
/begin FUNCTION cbacd_uic "" /begin OUT_MEASUREMENT CBACD_stLogicOut_mp /end OUT_MEASUREMENT /end FUNCTION
/begin FUNCTION clg "Kühlung"
 /begin DEF_CHARACTERISTIC Clg_dtMinDynTst_C Clg_nMinEnaDynTst_C Clg_qMinEnaDynTst_C Clg_tiInitTmr_C Clg_tiMaxDynTst_CUR Clg_tMinClntDynTst_C /end DEF_CHARACTERISTIC
 /begin IN_MEASUREMENT Clg_tClntStrtVal_mp /end IN_MEASUREMENT
/end FUNCTION
/begin FUNCTION clg_msg ""
 /begin OUT_MEASUREMENT Clg_dtDynTst Clg_dtMinDynTst Clg_tEndDynTst Clg_tiDynTst Clg_tiMaxDynTst Clg_tMinClntDynTst /end OUT_MEASUREMENT
/end FUNCTION
/begin FUNCTION clg_uic "" /begin OUT_MEASUREMENT Clg_tClntStrtVal_mp /end OUT_MEASUREMENT /end FUNCTION
/begin FUNCTION cmbchb_misfire "Brennräume Fehlzündungserkennung"
 /begin DEF_CHARACTERISTIC CmbChb_nAvrgThrHi_C CmbChb_nAvrgThrLo_C CmbChb_qRawThrHi_C CmbChb_qRawThrLo_C CmbChb_tClntThrLo_C CmbChb_vThrHi_C CmbChb_tiDebClutchChng_C CmbChb_tiDlyStr_C CmbChb_ctEngRevPerBlk_C CmbChb_ctSegTDC1_C CmbChb_numBlk_C CmbChb_dnSegMin_C CmbChb_ctMisfireMax_C CmbChb_swtMonClutchVal_C CmbChb_swtMonClutchType_C /end DEF_CHARACTERISTIC
 /begin OUT_MEASUREMENT CmbChb_ctMifBuf1_mp CmbChb_ctMifBuf2_mp CmbChb_ctMifMem_mp /end OUT_MEASUREMENT
/end FUNCTION
/begin FUNCTION cmbchb_misfire_msg "" /begin OUT_MEASUREMENT CmbChb_st CmbChb_swtMonClutch /end OUT_MEASUREMENT /end FUNCTION
/begin FUNCTION cmbchb_misfire_uic ""
 /begin OUT_MEASUREMENT CmbChb_ctEngRevLogBuf1_mp CmbChb_ctEngRevLogBuf2_mp CmbChb_ctEngRevLogMem_mp CmbChb_ctEngRevPerBlk_mp CmbChb_dnSegMinPerCyl_mp CmbChb_nSegEven_mp CmbChb_nSegOdd_mp /end OUT_MEASUREMENT
/end FUNCTION
/begin FUNCTION codt_drvtrncord "Antriebs-Koordination"
 /begin DEF_CHARACTERISTIC CoDT_dtrqLimDwnCurr_C CoDT_dtrqLimDwnLead_C CoDT_dtrqLimUpCurr_C CoDT_dtrqLimUpLead_C CoDT_swtCoTypeVal_C CoDT_swtCoTypeType_C CoDT_tiTrqRedMaxCurr_C CoDT_tiTrqRedMaxLead_C /end DEF_CHARACTERISTIC
/end FUNCTION
/begin FUNCTION codt_drvtrncordlead_uic ""
 /begin OUT_MEASUREMENT CoDT_trqDTInDecLead_mp CoDT_trqDTInIncLead_mp CoDT_trqGearbxLead_mp /end OUT_MEASUREMENT
/end FUNCTION
/begin FUNCTION codt_drvtrncord_msg ""
 /begin OUT_MEASUREMENT CoDT_nMax CoDT_nMin CoDT_stOrd CoDT_swtCoType CoDT_trqAcsDes CoDT_trqCurr CoDT_trqDes CoDT_trqDTInCurr CoDT_trqDTInDes CoDT_trqDTInLead CoDT_trqGearbxDes CoDT_trqLead /end OUT_MEASUREMENT
/end FUNCTION
/begin FUNCTION codt_drvtrncord_uic "" /end FUNCTION
/begin FUNCTION codt_grip "Kraftschluß innerhalb Antrieb"
 /begin DEF_CHARACTERISTIC CoDT_tiChkGrpDT1_C CoDT_dChkGrpDT1Kd_C CoDT_tiChkGrpPT1_C CoDT_dOfsGripDet_C CoDT_dOfsNoGripDet_C CoDT_dThetaGripDet_C CoDT_dThetaNoGripDet_C CoDT_swtNoGripDet_C CoDT_tiDebGearUnVal_C CoDT_tiDebNoGrip_C CoDT_tiGripDeb_C CoDT_vGrip_C /end DEF_CHARACTERISTIC
/end FUNCTION
/begin FUNCTION codt_grip_msg "" /begin OUT_MEASUREMENT CoDT_Grip CoDT_stGripDeb /end OUT_MEASUREMENT /end FUNCTION
/begin FUNCTION codt_grip_uic ""
 /begin OUT_MEASUREMENT CoDT_dnAbsEng_mp CoDT_dnEng_mp CoDT_dnGrip_mp CoDT_dnNoGrip_mp CoDT_stNoGripDet_mp CoDT_trqAbsGbxPT1_mp CoDT_trqGbxPT1_mp /end OUT_MEASUREMENT
/end FUNCTION
/begin FUNCTION codt_prptrqcurrcalc "Antriebsmoment-Berechnung" /end FUNCTION
/begin FUNCTION codt_prptrqcurrcalc_msg "" /begin OUT_MEASUREMENT CoDT_trq CoDT_trqCurrLim CoDT_trqGbx /end OUT_MEASUREMENT /end FUNCTION
/begin FUNCTION codt_prptrqcurrcalc_uic "" /begin OUT_MEASUREMENT CoDT_trqActAcs_mp /end OUT_MEASUREMENT /end FUNCTION
/begin FUNCTION codt_prptrqrngcalc "Bereitstellung Momentenintervall" /begin DEF_CHARACTERISTIC CoDT_swtAcsFltEna_C CoDT_tiFltPT1_C CoDT_trqMinInit_C /end DEF_CHARACTERISTIC /end FUNCTION
/begin FUNCTION codt_prptrqrngcalc_msg ""
 /begin OUT_MEASUREMENT CoDT_trqAcsMin CoDT_trqGbxMax CoDT_trqGbxMin CoDT_trqMax CoDT_trqMin /end OUT_MEASUREMENT
/end FUNCTION
/begin FUNCTION codt_prptrqrngcalc_uic "" /begin OUT_MEASUREMENT CoDT_trqAcsMax_mp CoDT_trqAcs_mp /end OUT_MEASUREMENT /end FUNCTION
/begin FUNCTION coeng_actrprt "Steuerung Stellerschutz" /begin DEF_CHARACTERISTIC CoEng_nActrRelease_C CoEng_tiActrPrt_C /end DEF_CHARACTERISTIC /end FUNCTION
/begin FUNCTION coeng_actrprt_uic "" /end FUNCTION
/begin FUNCTION coeng_aftrun ""
 /begin DEF_CHARACTERISTIC CoEng_stAftRunSel_C CoEng_tiDebnAvrgZero_C CoEng_tiPwrStgDiaRdy_C /end DEF_CHARACTERISTIC
/end FUNCTION
/begin FUNCTION coeng_aftrunextwait "Warten auf externe Ereignisse während Nachlauf"
 /begin DEF_CHARACTERISTIC CoEng_ExtWaitMsk2_C CoEng_ExtWaitMsk_C CoEng_tiMinAftRun_C CoEng_tiMRlyShutOffDel_C CoEng_tiWakeUp_C /end DEF_CHARACTERISTIC
/end FUNCTION
/begin FUNCTION coeng_aftrunextwait_msg "" /begin OUT_MEASUREMENT CoEng_stExtWait CoEng_stExtWait2 CoEng_tiMinAftRun /end OUT_MEASUREMENT /end FUNCTION
/begin FUNCTION coeng_aftrunextwait_uic "" /end FUNCTION
/begin FUNCTION coeng_aftrun_msg "" /begin OUT_MEASUREMENT CoEng_stAftRun CoEng_stAftRunPath /end OUT_MEASUREMENT /end FUNCTION
/begin FUNCTION coeng_aftrun_uic "" /begin OUT_MEASUREMENT CoEng_stEEPStore_mp CoEng_stnAvrgZero_mp /end OUT_MEASUREMENT /end FUNCTION
/begin FUNCTION coeng_flconsum "Verbrauchsberechnung"
 /begin DEF_CHARACTERISTIC CoEng_dqSubsRgnRmpUp_C CoEng_dqSubsRgnRmpDwn_C CoEng_facFlConsumAdjDfl_C CoEng_facFlConsumAdjMax_C CoEng_facFlConsumAdjMin_C CoEng_qSubs_MAP CoEng_rhoFuel_C CoEng_stSubsRgnMsk_C /end DEF_CHARACTERISTIC
 /begin IN_MEASUREMENT CoEng_trq Eng_nAvrg /end IN_MEASUREMENT
/end FUNCTION
/begin FUNCTION coeng_flconsum_uic ""
 /begin OUT_MEASUREMENT CoEng_dvolPerStroke_mp CoEng_facFlConsumAdj_mp CoEng_qSubs_mp CoEng_qSum_mp CoEng_volFlConsumAdj_mp /end OUT_MEASUREMENT
/end FUNCTION
/begin FUNCTION coeng_flconsum_var "" /end FUNCTION
/begin FUNCTION coeng_flconsum_var_msg "" /end FUNCTION
/begin FUNCTION coeng_mon "Abschaltkoordinator"
 /begin DEF_CHARACTERISTIC CoEng_stIRevShutOff_C CoEng_stRevShutOff_C CoEng_stShOffAddReqIRev_C CoEng_stShOffAddReqRev_C CoEng_stShOffAirbFrnt_C CoEng_stShOffAirbRear_C CoEng_stShOffAirbSide_C CoEng_stShOffCycSigChk_C CoEng_stShOffDblCtl_C CoEng_stShOffDiaReqFI_C CoEng_stShOffFWOscDet_C CoEng_stShOffInit_C CoEng_stShOffInjMon_C CoEng_stShOffInjShCir_C CoEng_stShOffIRevSys1_C CoEng_stShOffIRevSys2_C CoEng_stShOffIRevVeh_C CoEng_stShOffIrrCmb_C CoEng_stShOffOvrSpd_C CoEng_stShOffPresMin_C CoEng_stShOffRevSys1_C CoEng_stShOffRevSys2_C CoEng_stShOffRevVeh_C CoEng_stShOffRlOvrBar_C CoEng_stShOffSV_C /end DEF_CHARACTERISTIC
/end FUNCTION
/begin FUNCTION coeng_monaddreq "Kundenspezifische Abschaltanforderungen an Abschaltkoordinator" /end FUNCTION
/begin FUNCTION coeng_monaddreq_msg "" /begin OUT_MEASUREMENT CoEng_stShOffAddReqIRev CoEng_stShOffAddReqRev /end OUT_MEASUREMENT /end FUNCTION
/begin FUNCTION coeng_monaddreq_uic "" /end FUNCTION
/begin FUNCTION coeng_mon_uic "" /end FUNCTION
/begin FUNCTION coeng_msg ""
 /begin OUT_MEASUREMENT CoEng_dvolFlConsum CoEng_facAdj CoEng_nMax CoEng_nMin CoEng_stDisable CoEng_stIRevShutOff CoEng_stMonActrPrt CoEng_stMonShOff CoEng_stOvrFul CoEng_stOvrRun CoEng_stPwrDwn CoEng_stPwrStgEnaCond CoEng_stRevShutOff CoEng_stShutOff CoEng_stShutOffPath CoEng_stTrqLimErr CoEng_stTrqLimErr1 CoEng_stTrqLimErr2 CoEng_stTrqLimErr3 CoEng_stTrqLimErr4 CoEng_stTrqLimPFltErr CoEng_stTrqLimPFltOvldErr CoEng_tiWakeUp CoEng_trq CoEng_trqCorGearbxRgn CoEng_trqCurrLim CoEng_trqInrCurr CoEng_trqInrCurrFast CoEng_trqInrDes CoEng_trqInrDesFast CoEng_trqInrDesSlow CoEng_trqInrLim CoEng_trqInrLimDes CoEng_trqInrLimLead CoEng_trqInrLtd CoEng_trqInrRaw CoEng_trqInrSet CoEng_trqLiLtd CoEng_trqLimErr CoEng_trqLimErr1 CoEng_trqLimErr2 CoEng_trqLimErr3 CoEng_trqLimErr4 CoEng_trqLimPDiff CoEng_trqLimPFltErr CoEng_trqLimPFltOvldErr CoEng_trqLimSwt CoEng_trqMax CoEng_trqMin CoEng_trqOvrFul CoEng_trqSlpLim CoEng_volFlConsum CoEng_voltotFlConsum /end OUT_MEASUREMENT
/end FUNCTION
/begin FUNCTION coeng_ovrruncoord "Schubkoordinator"
 /begin DEF_CHARACTERISTIC CoEng_lSumFuncPref_C CoEng_numSelFuncPref_C CoEng_facActvFunc2_1_C CoEng_facActvFunc2_2_C CoEng_facActvFunc2_3_C CoEng_facActvFunc2_4_C CoEng_facActvFunc2_5_C CoEng_facActvFunc2_6_C CoEng_facActvFunc2_7_C CoEng_facActvFunc2_8_C CoEng_facActvFunc1_C CoEng_facActvFunc2_C CoEng_facActvFunc3_C CoEng_facActvFunc4_C CoEng_facActvFunc5_C CoEng_facActvFunc6_C CoEng_facActvFunc7_C CoEng_facActvFunc8_C CoEng_stCoopCapbl_C CoEng_stOvrRunRgnMsk_C CoEng_tiOvrRunCoordDebPos_C CoEng_tiThresFuncPref_C /end DEF_CHARACTERISTIC
/end FUNCTION
/begin FUNCTION coeng_ovrruncoord_msg "" /begin OUT_MEASUREMENT CoEng_stOvrRunCoord CoEng_stZFCEmissionRoll /end OUT_MEASUREMENT /end FUNCTION
/begin FUNCTION coeng_ovrruncoord_uic ""
 /begin OUT_MEASUREMENT CoEng_CoordPrioFld_mp CoEng_stCoordFuncFld_mp CoEng_stCoordFuncPref_mp CoEng_stOvrRunEGT_mp /end OUT_MEASUREMENT
/end FUNCTION
/begin FUNCTION coeng_pwrstgstatecalc "Endstufenkoordinator"
 /begin DEF_CHARACTERISTIC CoEng_tiDlyT15_C CoEng_uHighBattPwrStgHysHi_C CoEng_uHighBattPwrStgHysLo_C CoEng_uLowBattPwrStgHysHi_C CoEng_uLowBattPwrStgHysLo_C /end DEF_CHARACTERISTIC
/end FUNCTION
/begin FUNCTION coeng_pwrstgstatecalc_uic "" /begin OUT_MEASUREMENT CoEng_stDlyT15_mp /end OUT_MEASUREMENT /end FUNCTION
/begin FUNCTION coeng_shoff "Abstellsteuerung im Nachlauf"
 /begin DEF_CHARACTERISTIC CoEng_nSoftShOffMax_C CoEng_nSoftShOffMin_C CoEng_qSoftShOffMax_C CoEng_stShOffAftRun_C CoEng_stShOffExtReq_C CoEng_stShOffTstSel_C CoEng_stSoftShOffAR_C CoEng_tiShOffTstFlSys_C CoEng_tiSoftShOff_CUR CoEng_vSoftShOffMax_C /end DEF_CHARACTERISTIC
 /begin IN_MEASUREMENT Eng_nAvrg /end IN_MEASUREMENT
/end FUNCTION
/begin FUNCTION coeng_shofflib ""
 /begin DEF_CHARACTERISTIC CoEng_nShOffTstMax_C CoEng_nShOffTstMin_C CoEng_tShOffTstMin_C CoEng_vShOffTstMin_C /end DEF_CHARACTERISTIC
/end FUNCTION
/begin FUNCTION coeng_shofflib_uic "" /end FUNCTION
/begin FUNCTION coeng_shoff_msg "" /begin OUT_MEASUREMENT CoEng_numShOffTstNewSel CoEng_pRailT15Off CoEng_stShOffTst /end OUT_MEASUREMENT /end FUNCTION
/begin FUNCTION coeng_shoff_uic "" /begin OUT_MEASUREMENT CoEng_stShOffTstOldRes_mp CoEng_tiSoftShOff_mp /end OUT_MEASUREMENT /end FUNCTION
/begin FUNCTION coeng_steng "aktueller Motorzustand [-]" /begin DEF_CHARACTERISTIC CoEng_nThresNrml2Strt_C CoEng_tiNrml2Strt_C /end DEF_CHARACTERISTIC /end FUNCTION
/begin FUNCTION coeng_steng_msg ""
 /begin OUT_MEASUREMENT CoEng_stEng CoEng_stEngOld CoEng_tiAfterrun CoEng_tiAfterrunRed CoEng_tiNormal CoEng_tiNormalRed CoEng_tiStart CoEng_tiStartRed /end OUT_MEASUREMENT
/end FUNCTION
/begin FUNCTION coeng_steng_uic "" /end FUNCTION
/begin FUNCTION coeng_sttrqlimcalc "" /end FUNCTION
/begin FUNCTION coeng_sttrqlimcalc_msg ""
 /begin OUT_MEASUREMENT CoEng_rTrq CoEng_stCurrLim CoEng_stCurrLimActive CoEng_trqInrCurrLim /end OUT_MEASUREMENT
/end FUNCTION
/begin FUNCTION coeng_sttrqlimcalc_uic "" /begin OUT_MEASUREMENT CoEng_trqInrGearbxInMax_mp CoEng_trqInrPrpLimErr_mp /end OUT_MEASUREMENT /end FUNCTION
/begin COMPU_METHOD AirMass "Luftmasse" RAT_FUNC "%6.4" "g" COEFFS 0 100 0 0 0 1 /end COMPU_METHOD
/begin COMPU_METHOD AirMassPerCyl "Luftmasse pro Zylinder" RAT_FUNC "%6.3" "mg/Hub" COEFFS 0 10 0 0 0 1 /end COMPU_METHOD
/begin COMPU_METHOD AirMassPerTime "Luftmasse pro Zeit" RAT_FUNC "%6.3" "Kg/h" COEFFS 0 10 0 0 0 1 /end COMPU_METHOD
/begin COMPU_METHOD AirVolPerTime "Umrechnungsformel für Luftvolumenstrom" RAT_FUNC "%6.3" "m^3/h" COEFFS 0 10 0 0 0 1 /end COMPU_METHOD
/begin COMPU_METHOD AngleCaS "Winkel Nockenwelle" RAT_FUNC "%6.4" "deg CaS" COEFFS 0 85.3333333333334 0 0 0 1 /end COMPU_METHOD
/begin COMPU_METHOD AngleCrS "Winkel Kurbelwelle" RAT_FUNC "%6.4" "deg CrS" COEFFS 0 42.6666666666667 0 0 0 1 /end COMPU_METHOD
/begin COMPU_METHOD ASDrf_numDefaultState "Nummer des Default-Primärzustandes" TAB_VERB "%6.3" "-" COMPU_TAB_REF ASDrf_numDefaultState /end COMPU_METHOD
/begin COMPU_VTAB ASDrf_numDefaultState "Nummer des Default-Primärzustandes" TAB_VERB 6 0 "ExtInt" 1 "Clutch" 2 "Grip" 3 "State3" 4 "State4" 5 "Sport mode" /end COMPU_VTAB
/begin COMPU_METHOD ASDrf_stPrimState "Auswahl des Primärstatus in der Statusvariabel sollte übereinstimmedn mit der in der Definition asdrf_selectparemeter.col sein" TAB_VERB "%6.3" "-" COMPU_TAB_REF ASDrf_stPrimState /end COMPU_METHOD
/begin COMPU_VTAB ASDrf_stPrimState "Auswahl des Primärstatus in der Statusvariabel sollte übereinstimmedn mit der in der Definition asdrf_selectparemeter.col sein" TAB_VERB 7 0 "Void" 1 "ExtInt" 2 "Clutch" 4 "Grip" 8 "State3" 16 "State4" 32 "Sport mode" /end COMPU_VTAB
/begin COMPU_METHOD CoeffA "Koeffizient A in der Parabel dTrq = A * Trq^2 + Trq" RAT_FUNC "%6.4" "1/(s*Nm)" COEFFS 0 204.8 0 0 0 1 /end COMPU_METHOD
/begin COMPU_METHOD Curr_10mA "Spannung in mA" RAT_FUNC "%6.1" "mA" COEFFS 0 0.1 0 0 0 1 /end COMPU_METHOD
/begin COMPU_METHOD dFlConsum "Ableitung des Kraftstoffverbrauchs" RAT_FUNC "%6.4" "l/h/s" COEFFS 0 100 0 0 0 1 /end COMPU_METHOD
/begin COMPU_METHOD dn_dZfine "Engine acceleration per time (dn/dt) fine resolution" RAT_FUNC "%6.2" "rpm/s" COEFFS 0 1 0 0 0 1 /end COMPU_METHOD
/begin COMPU_METHOD dp_dZ10 "boost pressure per time (dp/dt) every 10ms" RAT_FUNC "%6.1" "hPa/s" COEFFS 0 0.1 0 0 0 1 /end COMPU_METHOD
/begin COMPU_METHOD dTrq "Umrtechnungsformel dTrq/dTime" RAT_FUNC "%6.3" "Nm/s" COEFFS 0 10 0 0 0 1 /end COMPU_METHOD
/begin COMPU_METHOD DtyCyc "Tastverhaeltnis" RAT_FUNC "%6.4" "%" COEFFS 0 100 0 0 0 1 /end COMPU_METHOD
/begin COMPU_METHOD EngN "Motordrehzahl" RAT_FUNC "%6.2" "rpm" COEFFS 0 1 0 0 0 1 /end COMPU_METHOD
/begin COMPU_METHOD Fact "Faktor mit Auflösung 1 / 8192, hauptsächlich für einen Faktorenbereich 0...1 verwendet" RAT_FUNC "%6.5" "-" COEFFS 0 8192 0 0 0 1 /end COMPU_METHOD
/begin COMPU_METHOD Fact1 "Faktor mit Auflösung 0,01 (100 mal höherer Bereich als Fact)" RAT_FUNC "%6.4" "-" COEFFS 0 128 0 0 0 1 /end COMPU_METHOD
/begin COMPU_METHOD FlConsum_l_h "Kraftstoffverbrauch" RAT_FUNC "%6.4" "l/h" COEFFS 0 100 0 0 0 1 /end COMPU_METHOD
/begin COMPU_METHOD FlConsum_ul "Verbrauchsintegral (in Mikroliter)" RAT_FUNC "%6.2" "ul" COEFFS 0 1 0 0 0 1 /end COMPU_METHOD
/begin COMPU_METHOD FlConsum_ul_20ms "Verbrauchsintegral (in Mikroliter pro 20ms)" RAT_FUNC "%6.2" "ul/20ms" COEFFS 0 1 0 0 0 1 /end COMPU_METHOD
/begin COMPU_METHOD InjMass "Einspritzmenge" RAT_FUNC "%6.4" "mg/hub" COEFFS 0 100 0 0 0 1 /end COMPU_METHOD
/begin COMPU_METHOD InjMassCyc "Einspritzmenge pro Zyklus (mg/Zyklus)" RAT_FUNC "%6.4" "mg/cyc" COEFFS 0 100 0 0 0 1 /end COMPU_METHOD
/begin COMPU_METHOD InjMassPerTime "Kraftstoffmassenstrom" RAT_FUNC "%6.4" "kg/h" COEFFS 0 100 0 0 0 1 /end COMPU_METHOD
/begin COMPU_METHOD InjQnt "Einspritzvolumen/Hub" RAT_FUNC "%6.3" "mm^3/hub" COEFFS 0 10 0 0 0 1 /end COMPU_METHOD
/begin COMPU_METHOD Kd "Differentialverstärkung Kd (gleiche Einheit/Umrechnungsformel an Ein- und Ausgang)" RAT_FUNC "%7.6" "1/1" COEFFS 0 65536 0 0 0 1 /end COMPU_METHOD
/begin COMPU_METHOD Kd_Lin_16 "Kd Verstärkung von linearen Kennlinien/-feldern" RAT_FUNC "%7.6" "1/1" COEFFS 0 32767 0 0 0 1 /end COMPU_METHOD
/begin COMPU_METHOD lambdaRecVal "Reziproker Lambda Wert" RAT_FUNC "%6.5" "-" COEFFS 0 1000 0 0 0 1 /end COMPU_METHOD
/begin COMPU_METHOD Length "Länge in Meter" RAT_FUNC "%6.2" "m" COEFFS 0 1 0 0 0 1 /end COMPU_METHOD
/begin COMPU_METHOD Moment_Inertia "Moment of Inertia" RAT_FUNC "%6.4" "kg * m^2" COEFFS 0 100 0 0 0 1 /end COMPU_METHOD
/begin COMPU_METHOD NumPinAdc "verbale Umrechnung für ADC Signale" TAB_VERB "%6.3" "-" COMPU_TAB_REF NumPinAdc /end COMPU_METHOD
/begin COMPU_VTAB NumPinAdc "verbale Umrechnung für ADC Signale" TAB_VERB 27 0 "Water_Temperature_Sensor_182" 1 "Intake_Air_Temperature_Sensor_157" 2 "Charge_Air_Temperature_Sensor_183" 3 "Exhaust_Temperature_Sensor_2_134" 4 "Exhaust_Temperature_Sensor_1_158" 5 "1st_APP_Sensor_252" 6 "2nd_APP_Sensor_239" 7 "ADC_REF" 8 "Boost_Pressure_Sensor_154" 9 "Atmospheric_Pressure_Sensor" 10 "Battery_Voltage_Sensor" 11 "Rail_Pressure_Sensor_156" 12 "Rail_Pressure_Peak_Value_156" 13 "Booster_Voltage_Sensor" 14 "Current_MeUn_Sensor" 15 "Current_PCV_Sensor" 16 "Voltage_Bank_1" 17 "Voltage_Bank_2" 18 "Pressure_Upstream_Particle_Filter_159" 19 "Engine_Oil_Pressure_110" 20 "Temperature_ECU_PCB" 21 "Voltage_Lambda_Ua" 22 "Voltage_Lambda_Ri" 23 "EMCCD_Current_Governor1_124" 24 "EMCCD_Current_Governor2_121" 25 "ADC_DUMMY_NOT_USED" 26 "ADC_DUMMY_A_NOT_USED" /end COMPU_VTAB
/begin COMPU_METHOD NumPinDia "Verbale Umrechnung für Diagnose Signale" TAB_VERB "%6.3" "-" COMPU_TAB_REF NumPinDia /end COMPU_METHOD
/begin COMPU_VTAB NumPinDia "Verbale Umrechnung für Diagnose Signale" TAB_VERB 28 0 "CJ945_Diagnostic_Signal" 1 "AC_Compressor_DiaSig" 2 "Fuel_Pump_Diagnostic_Signal_232" 3 "Starter_234" 4 "Oil_Pressure_Lamp_Switch_245" 5 "EGRClg_Byp_Diagnostic_Signal_123" 6 "Ebox_Fan_Actuator_Diagnostic_Signal_219" 7 "Shuttr_Actuator_Diagnostic_Signal_231" 8 "Twostage_TurboLoading_SW_DiaSig" 9 "DIO_OUT_DIAGNOSTIC_DUMMY_NOT_USED" 10 "Alternator" 11 "Boost_Pressure_Actuator_Diagnostic_Signal_193" 12 "EGR_Actuator_Diagnostic_Signal_194" 13 "1st_Pressure_Control_Valve_Diagnostic_Signal_172" 14 "2nd_Pressure_Control_Valve_Diagnostic_Signal_172" 15 "1st_Metering_Unit_Diagnostic_Signal_171" 16 "2nd_Metering_Unit_Diagnostic_Signal_171" 17 "Variable_Swirl_Actuator_Diagnostic_Signal_195" 18 "FAN_240" 19 "Add_On_Heater_244" 20 "EngM_Bearing_Actuator_Diagnostic_Signal_124" 21 "EngM_Bearing_Actuator_Diagnostic_Signal_121" 22 "Throttle_Valve_Diagnostic_Signal_196" 23 "Low pressure stage BPA_Diagnostic_Signal_117" 24 "PWM_DIAGNOSTIC_DUMMY_NOT_USED" 25 "1st_Sensor_Supply_Voltage_DiaSig" 26 "2nd_Sensor_Supply_Voltage_DiaSig" 27 "3rd_Sensor_Supply_Voltage_DiaSig" /end COMPU_VTAB
/begin COMPU_METHOD NumPinDioIn "Verbale Umrechnung für Digitaleingang Signale" TAB_VERB "%6.3" "-" COMPU_TAB_REF NumPinDioIn /end COMPU_METHOD
/begin COMPU_VTAB NumPinDioIn "Verbale Umrechnung für Digitaleingang Signale" TAB_VERB 15 0 "Terminal_15_207" 1 "Main_Brake_Switch_236" 2 "Redundant_Brake_Switch_223" 3 "Clutch_Switch" 4 "Terminal_50_224" 5 "ECU_selection_Switch_251" 6 "FlFlt_Switch_211" 7 "Coolant-heater_212" 8 "Redundant_Terminal_15_209(118)" 9 "AC-compressor_overboost_213" 10 "Additive_tank_level_switch_235" 11 "Terminal_61_113" 12 "Lambda_Regeneration" 13 "Oil_Level_sensor(12hex)_VSA_Diagnose(11hex)_138" 14 "DIO_IN_DUMMY_NOT_USED" /end COMPU_VTAB
/begin COMPU_METHOD NumPinDioOut "Verbale Umrechnung für Digitalausgang Signale" TAB_VERB "%6.3" "-" COMPU_TAB_REF NumPinDioOut /end COMPU_METHOD
/begin COMPU_VTAB NumPinDioOut "Verbale Umrechnung für Digitalausgang Signale" TAB_VERB 12 0 "Main_Relay_220(144)" 1 "AC_Compressor" 2 "Fuel_Pump_232" 3 "Starter_234" 4 "OPS_Lamp_245" 5 "EGRClg_Byp_123" 6 "Ebox_Fan_Actuator_219" 7 "Shuttr_Actuator_Digital_231" 8 "STATREG_PSOFF_Bit" 9 "Twostage_TurboLoading_120" 10 "TD_Signal_253" 11 "DIO_OUT_DUMMY_NOT_USED" /end COMPU_VTAB
/begin COMPU_METHOD NumPinPwmIn "Verbale Umrechnung für PWM-Eingang signale" TAB_VERB "%6.3" "-" COMPU_TAB_REF NumPinPwmIn /end COMPU_METHOD
/begin COMPU_VTAB NumPinPwmIn "Verbale Umrechnung für PWM-Eingang signale" TAB_VERB 4 0 "Air_Temperature_sensor_HFM6_146" 1 "Vehicle_Speed_sensor_249" 2 "BPA_Diagnosis(12hex)_or_Alternator(11hex)_137" 3 "PWM_IN_DUMMY_NOT_USED" /end COMPU_VTAB
/begin COMPU_METHOD NumPinPwmOut "Verbale Umrechnung für PWM-Ausgang Signale" TAB_VERB "%6.3" "-" COMPU_TAB_REF NumPinPwmOut /end COMPU_METHOD
/begin COMPU_VTAB NumPinPwmOut "Verbale Umrechnung für PWM-Ausgang Signale" TAB_VERB 14 0 "Boost_Pressure_Actuator_193" 1 "EGR_Actuator_194" 2 "PCV_Actuator_172" 3 "MeUn_Actuator_171" 4 "Variable_Swirl_Actuator_195" 5 "Fan_Actuator_240" 6 "Add_On_Heater_244" 7 "EngM_Bearing_Actuator_124" 8 "EngM_Bearing_Actuator_121" 9 "Throttle_Valve_196" 10 "LSU_Heater_PWMOutput" 11 "Low pressure stage BPA_117" 12 "Shuttr_Actuator_PWM_231" 13 "PWM_DUMMY_NOT_USED" /end COMPU_VTAB
/begin COMPU_METHOD O2 "Sauerstoffkonzentration" RAT_FUNC "%8.7" "-" COEFFS 0 100000 0 0 0 1 /end COMPU_METHOD
/begin COMPU_METHOD O2MassPerTime "Sauerstoffmassenstrom" RAT_FUNC "%6.4" "kg/h" COEFFS 0 100 0 0 0 1 /end COMPU_METHOD
/begin COMPU_METHOD OneToOne "eins zu eins (physikalischer Wert ist gleich dem internen Wert)" RAT_FUNC "%6.2" "-" COEFFS 0 1 0 0 0 1 /end COMPU_METHOD
/begin COMPU_METHOD Period "Periodendauer" RAT_FUNC "%6.3" "ms" COEFFS 0 10 0 0 0 1 /end COMPU_METHOD
/begin COMPU_METHOD Period_ms "Periodendauer in ms" RAT_FUNC "%6.3" "ms" COEFFS 0 10 0 0 0 1 /end COMPU_METHOD
/begin COMPU_METHOD Per_Dur "Periodendauer Segmentzeit" RAT_FUNC "%6.2" "usec" COEFFS 0 1 0 0 0 1 /end COMPU_METHOD
/begin COMPU_METHOD Prc "Prozent, gleiche interne Auflösung wie Fact, aber Darstellung in Prozent (0...100%)" RAT_FUNC "%6.4" "%" COEFFS 0 81.92 0 0 0 1 /end COMPU_METHOD
/begin COMPU_METHOD Pres_hPa "Druck (angezeigt in [hPa])" RAT_FUNC "%6.2" "hPa" COEFFS 0 1 0 0 0 1 /end COMPU_METHOD
/begin COMPU_METHOD Pres_Rail "Raildruck in hPa" RAT_FUNC "%4.3" "bar" COEFFS 0 10.000000 0 0 0 1 /end COMPU_METHOD
/begin COMPU_METHOD Pwr "Leistung" RAT_FUNC "%6.2" "W" COEFFS 0 0.10610329539459 0 0 0 1 /end COMPU_METHOD
/begin COMPU_METHOD RatAirMass "Luftmassenverhältnis" RAT_FUNC "%6.5" "-" COEFFS 0 1000 0 0 0 1 /end COMPU_METHOD
/begin COMPU_METHOD RatFuelMass "Kraftstoffmassenverhältnis" RAT_FUNC "%6.4" "-" COEFFS 0 100 0 0 0 1 /end COMPU_METHOD
/begin COMPU_METHOD RhoFuel "Kraftstoffdichte" RAT_FUNC "%6.3" "kg/m^3" COEFFS 0 10 0 0 0 1 /end COMPU_METHOD
/begin COMPU_METHOD RmpInjMassCyc "DT1 of Injection mass" RAT_FUNC "%6.5" "(mg/cyc)/s" COEFFS 0 6553.6 0 0 0 1 /end COMPU_METHOD
/begin COMPU_METHOD RmpPres_hPa "Rampengradient für Druck angezeigt in [hPa/s]" RAT_FUNC "%6.4" "hPa/s" COEFFS 0 65.536 0 0 0 1 /end COMPU_METHOD
/begin COMPU_METHOD RmpTrq "Rampengradient für Motormoment" RAT_FUNC "%6.4" "Nm/s" COEFFS 0 655.36 0 0 0 1 /end COMPU_METHOD
/begin COMPU_METHOD RmpVoltBatt "Rampengradient für Batteriespannung" RAT_FUNC "%6.3" "mV/s" COEFFS 0 3.3521664 0 0 0 1 /end COMPU_METHOD
/begin COMPU_METHOD SigName "Verbale Umrechnung für Signal Referenz Nummern" TAB_VERB "%6.3" "-" COMPU_TAB_REF SigName /end COMPU_METHOD
/begin COMPU_VTAB SigName "Verbale Umrechnung für Signal Referenz Nummern" TAB_VERB 113 0 "Sig_unused" 4 "CoEng_rTrq__Carb_r_DLen1" 5 "CTSCD_tClntLin__Carb_t_DLen1" 11 "BPSCD_pLin__Carb_p_DLen1" 12 "Eng_nAvrg__Carb_n_DLen2" 13 "VSSCD_vSensVal__Carb_v_DLen1" 15 "AFSCD_tAir_mp__Carb_t_DLen1" 16 "AFSCD_dmAirRawPerTime__Carb_mAirTim_DLen2" 28 "Signals_PID0x1C_C__OneToOne_DLen1" 33 "DSMDur_ctDfctDur1__Carb_l_DLen2" 128 "AFSCD_dmAirPerTime__mAirTim_DLen2" 129 "AFSCD_mAirPerCyl__mAirCyl_DLen2" 131 "AFSCD_rAir__dcyc_DLen2" 133 "AOHtCD_rOut__dcyc_DLen2" 134 "APPCD_rFlt__r_DLen2" 136 "BPACD_rAktPos__r_DLen2" 137 "APPCD_uRawAPP1__u_DLen2" 138 "APPCD_uRawAPP2__u_DLen2" 139 "APSCD_pVal__p_DLen2" 140 "APSCD_uRaw__u_DLen2" 141 "AirCtl_mDesVal__mAirCyl_DLen2" 142 "AltCD_rAltLoad__r_DLen2" 143 "BPACD_rOut__dcyc_DLen2" 145 "BPSCD_pOutVal__p_DLen2" 146 "BPSCD_uRawVal__u_DLen2" 147 "BattCD_u__uBatt_DLen2" 148 "CBACD_stLogicOut_mp__OneToOne_DLen1" 149 "CTSCD_tClnt__t_DLen2" 150 "CTSCD_uRaw__u_DLen2" 151 "CoEng_trq__trq_DLen2" 152 "EBAFCD_stSigOut__OneToOne_DLen1" 153 "EGRCD_rOut__dcyc_DLen2" 155 "EGT_st__ShftRght0Byte_DLen2" 156 "EngM_stOut__OneToOne_DLen1" 157 "EngM_stSync__OneToOne_DLen1" 158 "Eng_nAvrg__n_DLen2" 159 "FMTC_trqInr__trq_DLen2" 160 "FTSCD_tFuel__t_DLen2" 161 "FTSCD_uRaw__u_DLen2" 162 "FanCD_dcycRaw_mp__dcyc_DLen2" 163 "FlFCD_stFlFltRawVal__OneToOne_DLen1" 164 "FrmMng_nPSP__nPSPSpd_DLen2" 165 "FrmMng_rPSPSetPoint__r_DLen2" 166 "GlwCtl_rPwrOut__OneToOne_DLen1" 167 "GlwCtl_stLampOut__OneToOne_DLen1" 168 "HWEMon_numRecovery__ShftRght0Byte_DLen2" 169 "HWEMon_numRecovery__ShftRght1Byte_DLen2" 170 "HWEMon_recLocLow_mp__ShftRght0Byte_DLen2" 171 "HWEMon_recLocLow_mp__ShftRght1Byte_DLen2" 172 "HWEMon_recLocHigh_mp__ShftRght0Byte_DLen2" 173 "IATSCD_tAir__t_DLen2" 174 "IATSCD_tAirCats__t_DLen2" 176 "IATSCD_uRawCats__u_DLen2" 178 "Tn_abstell__DezUwQ1_DLen2" 179 "U_gen__UUwQ0p1_DLen2" 180 "HWEMon_numEEPBlockfailed__OneToOne_DLen1" 181 "InjCtl_qCurr__qInjMassCyc_DLen2" 182 "InjCtl_qSetUnBal__qInjMassCyc_DLen2" 183 "LIGov_nSetpoint__n_DLen2" 184 "LIGov_trq__trq_DLen2" 185 "LPACD_rOut__dcyc_DLen2" 188 "CoEng_stEng__OneToOne_DLen1" 189 "LSU_rO2Adpt[0]__O2_DLen2" 190 "MeUnCD_dcycOut_mp__dcyc_DLen2" 191 "OPSCD_stSigOut__OneToOne_DLen1" 193 "OTSCD_tEngOil__t_DLen2" 194 "OxiCCD_tPre__tExhaustgas_DLen2" 196 "OxiCCD_uRawTempPre__u_DLen2" 198 "PCR_pDesVal__p_DLen2" 199 "PCVCD_dcycOut_mp__dcyc_DLen2" 200 "PFltCD_pPre__p_DLen2" 202 "PFltCD_tPre__tExhaustgas_DLen2" 204 "PFltCD_uRawPresPre_mp__u_DLen2" 206 "PFltCD_uRawTempPre__u_DLen2" 208 "PFlt_dvol__volph_DLen2" 209 "PFlt_lSnceRgnu16_mp__lenrgnu16PFlt_DLen2" 211 "PFlt_mAshOil__mSoot_DLen2" 212 "PFlt_mSot__mSoot_DLen2" 213 "PFlt_mSotSim__mSoot_DLen2" 216 "PFlt_pDiff__p_DLen2" 217 "PFlt_qFl_mp__FlConPFlt_DLen2" 220 "PFlt_stIntr_mp__OneToOne_DLen1" 221 "PFlt_stLck_mp__OneToOne_DLen1" 222 "PSPCD_dvolOut__FlCon_DLen2" 223 "RailCD_pPeak__pRail_DLen2" 224 "RailCD_uPeakRaw__u_DLen2" 225 "Rail_pSetPoint__pRail_DLen2" 226 "TVACD_rOut__dcyc_DLen2" 228 "VSACD_rOut__dcyc_DLen2" 229 "VSSCD_v__v_DLen2" 230 "VehDa_tiEngOn__timEng_DLen2" 231 "PFlt_pPreCorr_mp__p_DLen2" 232 "PFlt_stPresPlaus_mp__OneToOne_DLen1" 234 "EGPpCD_stActrOut__OneToOne_DLen1" 236 "OvRMon_tiTDCAvrg__InjTim_DLen2" 237 "OvRMon_tiOvRMonActive_mp__tims_DLen2" 238 "CoEng_trqInrSet__trq_DLen2" 239 "InjCtl_qSet__qInjMassCyc_DLen2" 240 "Absch_korr__FSwQ0p00153_DLen2" 241 "D_soc__FSwB100_DLen2" 242 "I_batt__IUwQ0p08O200_DLen2" 243 "Oz_oelkm__KmUwQ10_DLen2" 244 "Oz_oelnivkurz__TdUbQ0p5_DLen1" 245 "Oz_oelnivnorm__TdUbQ0p5_DLen1" 246 "Oz_oelnivori__TdUbQ0p5_DLen1" 248 "Stat_sv_reg1__DezUbQ1_DLen1" 249 "Stat_sv_reg2__DezUbQ1_DLen1" 250 "T2histshort__TdUbQ14p9333_DLen1" 251 "T3histshort__TdUbQ14p9333_DLen1" 252 "T4histshort__TdUbQ14p9333_DLen1" 253 "Toel__TSwQ0p1_DLen2" 254 "T_batt__TSwQ0p1_DLen2" 255 "U_batt__UUwQ0p25em3_DLen2" /end COMPU_VTAB
/begin COMPU_METHOD TempDiff_Cels "difference/offset temperature displayed in degree celcius" RAT_FUNC "%6.3" "deg C" COEFFS 0 10 0 0 0 1 /end COMPU_METHOD
/begin COMPU_METHOD Temp_Cels "Temperatur dargestellt in °C (gleiche interne Darstellung wie Temp_Kelv)" RAT_FUNC "%6.1" "deg C" COEFFS 0 10 2731.4 0 0 1 /end COMPU_METHOD
/begin COMPU_METHOD TimeDeb "Entprellzeit in Millisekunden für Libraryfunktion Debounce" RAT_FUNC "%6.1" "ms" COEFFS 0 0.1 0 0 0 1 /end COMPU_METHOD
/begin COMPU_METHOD TimeDelay_s "Zeitkonstante T1 (in s) für PT1, DT1, etc." RAT_FUNC "%9.3" "s" COEFFS 0 0 1 0 0.00023283064365387 0 /end COMPU_METHOD
/begin COMPU_METHOD TimeDelay_s_Lin_16 "Zeitkonstante T1 (in s) für PT1, DT1, etc. für SINT16, kein Kehrwert" RAT_FUNC "%6.5" "s" COEFFS 0 6553.4 0 0 0 1 /end COMPU_METHOD
/begin COMPU_METHOD TimeEngOn "Motorbetriebszeit in Sekunden" RAT_FUNC "%6.2" "s" COEFFS 0 1 0 0 0 1 /end COMPU_METHOD
/begin COMPU_METHOD TimeRed "Zeit in Sekunden mit reduzierter Auflösung für Ein/Ausgänge von KL/KF (sint16)" RAT_FUNC "%6.3" "s" COEFFS 0 6.25 0 0 0 1 /end COMPU_METHOD
/begin COMPU_METHOD Time_DynTst "Zeitumrechung für dynamischen test mit geringerer Auflösung, damit es für KL Ausgang passt" RAT_FUNC "%6.2" "s" COEFFS 0 0.390625 0 0 0 1 /end COMPU_METHOD
/begin COMPU_METHOD Time_ms "Zeit in ms für Fehlerentprellung (DSM) und SW-Timer" RAT_FUNC "%6.1" "ms" COEFFS 0 0.1 0 0 0 1 /end COMPU_METHOD
/begin COMPU_METHOD Time_s "Zeit in s für Fehlerentprellung (DSM) und SW-Timer" RAT_FUNC "%6.4" "s" COEFFS 0 100 0 0 0 1 /end COMPU_METHOD
/begin COMPU_METHOD TransR "Übersetzungsverhältnis (Getriebe etc.)" RAT_FUNC "%6.4" "-" COEFFS 0 100 0 0 0 1 /end COMPU_METHOD
/begin COMPU_METHOD Trq "Motormoment" RAT_FUNC "%6.3" "Nm" COEFFS 0 10 0 0 0 1 /end COMPU_METHOD
/begin COMPU_METHOD TrqPrp "Vortriebsmoment" RAT_FUNC "%6.3" "Nm" COEFFS 0 5 0 0 0 1 /end COMPU_METHOD
/begin COMPU_METHOD Vel "Fahrzeuggeschwindigkeit, gleiche interne Auflösung wie Vel_SI" RAT_FUNC "%6.4" "km/h" COEFFS 0 100 0 0 0 1 /end COMPU_METHOD
/begin COMPU_METHOD Vol "Volumen" RAT_FUNC "%6.4" "l" COEFFS 0 100 0 0 0 1 /end COMPU_METHOD
/begin COMPU_METHOD Volt "Spannung in V (von ADC)" RAT_FUNC "%6.2" "mV" COEFFS 0 0.2046 0 0 0 1 /end COMPU_METHOD
/begin COMPU_METHOD Volt_Batt "Batteriespannung" RAT_FUNC "%6.1" "mV" COEFFS 0 0.05115 0 0 0 1 /end COMPU_METHOD
/begin RECORD_LAYOUT Kf_Xs16_Ys16_Ws16 NO_AXIS_PTS_X 1 SWORD NO_AXIS_PTS_Y 2 SWORD AXIS_PTS_X 3 SWORD INDEX_INCR DIRECT AXIS_PTS_Y 4 SWORD INDEX_INCR DIRECT FNC_VALUES 5 SWORD COLUMN_DIR DIRECT /end RECORD_LAYOUT
/begin RECORD_LAYOUT Kl_Xs16_Ws16 NO_AXIS_PTS_X 1 SWORD AXIS_PTS_X 2 SWORD INDEX_INCR DIRECT FNC_VALUES 3 SWORD COLUMN_DIR DIRECT /end RECORD_LAYOUT
/begin RECORD_LAYOUT Kwb_Ws16 FNC_VALUES 1 SWORD COLUMN_DIR DIRECT /end RECORD_LAYOUT
/begin RECORD_LAYOUT Kwb_Wu16 FNC_VALUES 1 UWORD COLUMN_DIR DIRECT /end RECORD_LAYOUT
/begin RECORD_LAYOUT Kwb_Wu32 FNC_VALUES 1 ULONG COLUMN_DIR DIRECT /end RECORD_LAYOUT
/begin RECORD_LAYOUT Kwb_Wu8 FNC_VALUES 1 UBYTE COLUMN_DIR DIRECT /end RECORD_LAYOUT
/begin RECORD_LAYOUT Kw_Ws16 FNC_VALUES 1 SWORD COLUMN_DIR DIRECT /end RECORD_LAYOUT
/begin RECORD_LAYOUT Kw_Ws32 FNC_VALUES 1 SLONG COLUMN_DIR DIRECT /end RECORD_LAYOUT
/begin RECORD_LAYOUT Kw_Wu16 FNC_VALUES 1 UWORD COLUMN_DIR DIRECT /end RECORD_LAYOUT
/begin RECORD_LAYOUT Kw_Wu32 FNC_VALUES 1 ULONG COLUMN_DIR DIRECT /end RECORD_LAYOUT
/begin RECORD_LAYOUT Kw_Wu8 FNC_VALUES 1 UBYTE COLUMN_DIR DIRECT /end RECORD_LAYOUT
/end MODULE
/end PROJECT
