ASAP2_VERSION 1 3
/begin PROJECT P411 "BMW DDE6.0 6-Zylinder V96.2 14.10.2004"
/begin HEADER "" VERSION "V96.2_6Z" PROJECT_NO P411 /end HEADER
/begin MODULE DIM ""
/begin MOD_COMMON "" BYTE_ORDER MSB_FIRST ALIGNMENT_BYTE 1 ALIGNMENT_WORD 2 ALIGNMENT_LONG 4 ALIGNMENT_FLOAT32_IEEE 4 /end MOD_COMMON
/begin CHARACTERISTIC HPUn_dvolMeUnMax_C "maximales Fördervolumen durch die Zumesseinheit" VALUE 0xD9976 Kw_Ws16 50000.00 Qp_mm3_sec 0.00 50000.00 FORMAT "%8.2" EXTENDED_LIMITS -327680.0 327670.0 /end CHARACTERISTIC
/begin CHARACTERISTIC HPUn_etaPmpFlTemp_CUR "Kraftstofftemperaturabhängiger Wirkungsgrad der Hochdruckpumpe" CURVE 0xD9978 Kl_Xs16_Ws16 0.9921875 Eta 0.007812500 1.000000 FORMAT "%8.6" EXTENDED_LIMITS -256.0000 255.9922
 /begin AXIS_DESCR STD_AXIS FlSys_t Temp_Cels 6 -50.14000 199.8600 FORMAT "%8.4" EXTENDED_LIMITS -3549.940 3003.560 DEPOSIT ABSOLUTE /end AXIS_DESCR
/end CHARACTERISTIC
/begin CHARACTERISTIC HPUn_etaPmpMaxAged_CUR "Maximaler Wirkungsgrad einer gealterten Hochdruckpumpe" CURVE 0xD9992 Kl_Xs16_Ws16 0.9921875 Eta 0.007812500 1.000000 FORMAT "%8.6" EXTENDED_LIMITS -256.0000 255.9922
 /begin AXIS_DESCR STD_AXIS Eng_nAvrg EngN 6 0.00 6000.000 FORMAT "%8.3" EXTENDED_LIMITS -32768.00 32767.00 DEPOSIT ABSOLUTE /end AXIS_DESCR
/end CHARACTERISTIC
/begin CHARACTERISTIC HPUn_etaPmpMech_C "mechanischer Wirkungsgrad der Hochdruckpumpe" VALUE 0xD99AC Kw_Ws16 0.9921875 Eta 0.007812500 1.000000 FORMAT "%8.6" EXTENDED_LIMITS -256.0000 255.9922 /end CHARACTERISTIC
/begin CHARACTERISTIC HPUn_nMin_C "#SSD Drehzahlschwelle zur Abschaltung der Lastmomentberechnung der Hochdruckpumpe" VALUE 0xD99AE Kw_Ws16 6000.000 EngN 0.00 6000.000 FORMAT "%8.3" EXTENDED_LIMITS -32768.00 32767.00 /end CHARACTERISTIC
/begin CHARACTERISTIC HPUn_numInjMin_C "Minimal von der Hochdruckpumpe erlaubte  Anzahl an Einspritzungen" VALUE 0xD9C1C Kw_Wu8 6.000 OneToOne 0.00 6.000 FORMAT "%5.3" EXTENDED_LIMITS 0.00 255.0 /end CHARACTERISTIC
/begin CHARACTERISTIC HPUn_pRailDvtOk_C "#SSD Maximale Raildruck Regelabweichung für die Mengenbilanzprüfung" VALUE 0xD9C1E Kw_Wu16 2000.000 Pres_Rail 0.00 2000.000 FORMAT "%5.3" EXTENDED_LIMITS 0.00 6553.500 /end CHARACTERISTIC
/begin CHARACTERISTIC HPUn_tiPresDvtFlt_C "PT1 Zeitkonstante zur Filterung der Raildruck Regelabweichung" VALUE 0xD9C20 Kw_Wu32 4294.9673 TimeDelay_s 0.0000010000000 4294.9673 FORMAT "%9.4" /end CHARACTERISTIC
/begin CHARACTERISTIC HPUn_qBalLim_CUR "#SSD Begrenzungsmenge auf Grund der Mengenbilanz der Hochdruckpumpe" CURVE 0xD99B0 Kl_Xs16_Ws16 327.6700 InjMassCyc 0.00 327.6700 FORMAT "%8.4" EXTENDED_LIMITS -327.6800 327.6700
 /begin AXIS_DESCR STD_AXIS Eng_nAvrg EngN 8 0.00 6000.000 FORMAT "%8.3" EXTENDED_LIMITS -32768.00 32767.00 DEPOSIT ABSOLUTE /end AXIS_DESCR
/end CHARACTERISTIC
/begin CHARACTERISTIC HPUn_qFlTempLim_MAP "#SSD Kennfeld für Begrenzungsmenge abhängig der Kraftstofftemperatur" MAP 0xD99D2 Kf_Xs16_Ys16_Ws16 327.6700 InjMassCyc 0.00 327.6700 FORMAT "%8.4" EXTENDED_LIMITS -327.6800 327.6700
 /begin AXIS_DESCR STD_AXIS Eng_nAvrg EngN 16 0.00 6000.000 FORMAT "%8.3" EXTENDED_LIMITS -32768.00 32767.00 DEPOSIT ABSOLUTE /end AXIS_DESCR
 /begin AXIS_DESCR STD_AXIS FTSCD_tFuel Temp_Cels 16 -50.14000 199.8600 FORMAT "%8.4" EXTENDED_LIMITS -3549.940 3003.560 DEPOSIT ABSOLUTE /end AXIS_DESCR
/end CHARACTERISTIC
/begin CHARACTERISTIC HPUn_rTransCrS_C "Übersetzung Hochdruckpumpe zu Kurbelwelle" VALUE 0xD9C16 Kw_Ws16 10.00000 TransR 0.00 10.00000 FORMAT "%8.5" EXTENDED_LIMITS -327.6800 327.6700 /end CHARACTERISTIC
/begin CHARACTERISTIC HPUn_tiQntBalDel_C "Verzögerungszeit zur Berechnung der Mengenbilanz der Hochdruckpumpe" VALUE 0xD9C24 Kw_Wu16 655140.0 Time_ms 0.00 655140.0 FORMAT "%8.1" EXTENDED_LIMITS 0.00 655350.0 /end CHARACTERISTIC
/begin CHARACTERISTIC HPUn_volPmp_C "geometrisches Fördervolumen der Hochdruckpumpe pro Pumpenumdrehung" VALUE 0xD9C18 Kw_Ws16 1500.000 PmpQnt 0.00 1500.000 FORMAT "%8.3" EXTENDED_LIMITS -3276.800 3276.700 /end CHARACTERISTIC
/begin CHARACTERISTIC HWEMon_DebComStepDown_C "#SSD Abwärts Schrittweite für Entprellung SPI Kommunikation" VALUE 0xD9C28 Kw_Wu8 3.000 OneToOne 0.00 3.000 FORMAT "%5.3" EXTENDED_LIMITS 0.00 255.0 /end CHARACTERISTIC
/begin CHARACTERISTIC HWEMon_DebComStepUp_C "#SSD Aufwärts Schrittweite für Entprellung SPI Kommunikation" VALUE 0xD9C29 Kw_Wu8 3.000 OneToOne 0.00 3.000 FORMAT "%5.3" EXTENDED_LIMITS 0.00 255.0 /end CHARACTERISTIC
/begin CHARACTERISTIC HWEMon_DebComDef_C "#SSD Entprellung für defekt Erkennung der SPI Kommunikation" VALUE 0xD9C2A Kw_Wu16 65535.00 OneToOne 0.00 65535.00 FORMAT "%8.2" /end CHARACTERISTIC
/begin CHARACTERISTIC HWEMon_DebComOk_C "#SSD Entprellung für intakt Erkennung der SPI Kommunikation" VALUE 0xD9C2C Kw_Wu16 65535.00 OneToOne 0.00 65535.00 FORMAT "%8.2" /end CHARACTERISTIC
/begin CHARACTERISTIC HWEMon_nThres_C "#SSD Drehzahlschwelle für Latchbetrieb der Überspannungsüberwachung (nur für CJ945)" VALUE 0xD9C2E Kw_Ws16 300.0000 EngN 300.0000 600.0000 FORMAT "%8.4" EXTENDED_LIMITS -32768.00 32767.00 /end CHARACTERISTIC
/begin CHARACTERISTIC HWEMon_numTrigRecovery_C "#SSD Nummer der durch Änderung dieses Labels auszulösenden Recovery" VALUE 0xD9C30 Kw_Wu16 65535.00 OneToOne 0.00 65535.00 FORMAT "%8.2" /end CHARACTERISTIC
/begin CHARACTERISTIC IATSCD_uSRCMinCats_C "Minimalwert für SRC Ladelufttemperaturfühler" VALUE 0xD9CE4 Kw_Ws16 5200.391 Volt 0.00 5200.391 FORMAT "%8.3" EXTENDED_LIMITS -160156.4 160151.5 /end CHARACTERISTIC
/begin CHARACTERISTIC IATSCD_uSRCMaxCats_C "Maximalwert für SRC Ladelufttemperaturfühler" VALUE 0xD9CE6 Kw_Ws16 5200.391 Volt 0.00 5200.391 FORMAT "%8.3" EXTENDED_LIMITS -160156.4 160151.5 /end CHARACTERISTIC
/begin CHARACTERISTIC IATSCD_tLinCats_CUR "Linearisierungskennlinie für Ladelufttemperaturfühler" CURVE 0xD9CE8 Kl_Xs16_Ws16 250.0000 Temp_Cels -50.14000 199.8600 FORMAT "%8.4" EXTENDED_LIMITS -3549.940 3003.560
 /begin AXIS_DESCR STD_AXIS IATSCD_uRawCats Volt 16 0.00 5200.391 FORMAT "%8.3" EXTENDED_LIMITS -160156.4 160151.5 DEPOSIT ABSOLUTE /end AXIS_DESCR
/end CHARACTERISTIC
/begin CHARACTERISTIC IATSCD_uSRCMin_C "Minimalwert für SRC LTF-Sensor" VALUE 0xD9C34 Kw_Ws16 5200.391 Volt 0.00 5200.391 FORMAT "%8.3" EXTENDED_LIMITS -160156.4 160151.5 /end CHARACTERISTIC
/begin CHARACTERISTIC IATSCD_uSRCMax_C "Maximalwert für SRC LTF-Sensor" VALUE 0xD9C36 Kw_Ws16 5200.391 Volt 0.00 5200.391 FORMAT "%8.3" EXTENDED_LIMITS -160156.4 160151.5 /end CHARACTERISTIC
/begin CHARACTERISTIC IATSCD_tLin_CUR "Linearisierungskennlinie für LTF-Sensor" CURVE 0xD9C38 Kl_Xs16_Ws16 950.0000 Temp_Cels -50.1400 899.8600 FORMAT "%8.4" EXTENDED_LIMITS -3549.940 3003.560
 /begin AXIS_DESCR STD_AXIS IATSCD_uRaw Volt 25 0.00 5200.391 FORMAT "%8.3" EXTENDED_LIMITS -160156.4 160151.5 DEPOSIT ABSOLUTE /end AXIS_DESCR
/end CHARACTERISTIC
/begin CHARACTERISTIC IATSCD_DebSigDefCats_C "Ladelufttemperatur - Entprellzeit bis Signal defekt" VALUE 0xD9D2A Kw_Wu16 655350.0 Time_ms 0.00 655350.0 FORMAT "%8.1" /end CHARACTERISTIC
/begin CHARACTERISTIC IATSCD_DebSigOkCats_C "Ladelufttemperatur - Entprellzeit bis Signal geheilt" VALUE 0xD9D2C Kw_Wu16 655350.0 Time_ms 0.00 655350.0 FORMAT "%8.1" /end CHARACTERISTIC
/begin CHARACTERISTIC IATSCD_DebSigDef_C "#SSD Ladelufttemperatur - Entprellzeit bis Signal defekt" VALUE 0xD9C9E Kw_Wu16 655350.0 Time_ms 0.00 655350.0 FORMAT "%8.1" /end CHARACTERISTIC
/begin CHARACTERISTIC IATSCD_DebSigOk_C "Ladelufttemperatur - Entprellzeit bis Signal geheilt" VALUE 0xD9CA0 Kw_Wu16 655350.0 Time_ms 0.00 655350.0 FORMAT "%8.1" /end CHARACTERISTIC
/begin CHARACTERISTIC IATSCD_DebSRCHighDefCats_C "Ladelufttemperaturfühler Fehlerentprellzeit fuer SRC-High" VALUE 0xD9D2E Kw_Wu16 655350.0 Time_ms 0.00 655350.0 FORMAT "%8.1" /end CHARACTERISTIC
/begin CHARACTERISTIC IATSCD_DebSRCHighOkCats_C "Ladelufttemperaturfühler Heilungsentprellzeit fuer SRC-High" VALUE 0xD9D30 Kw_Wu16 655350.0 Time_ms 0.00 655350.0 FORMAT "%8.1" /end CHARACTERISTIC
/begin CHARACTERISTIC IATSCD_DebSRCHighDef_C "#SSD LTF Fehlerentprellzeit fuer SRC-High" VALUE 0xD9CA2 Kw_Wu16 655350.0 Time_ms 0.00 655350.0 FORMAT "%8.1" /end CHARACTERISTIC
/begin CHARACTERISTIC IATSCD_DebSRCHighOk_C "LTF Heilungsentprellzeit fuer SRC-High" VALUE 0xD9CA4 Kw_Wu16 655350.0 Time_ms 0.00 655350.0 FORMAT "%8.1" /end CHARACTERISTIC
/begin CHARACTERISTIC IATSCD_DebSRCLowDefCats_C "Ladelufttemperaturfühler Fehlerentprellzeit fuer SRC-Low" VALUE 0xD9D32 Kw_Wu16 655350.0 Time_ms 0.00 655350.0 FORMAT "%8.1" /end CHARACTERISTIC
/begin CHARACTERISTIC IATSCD_DebSRCLowOkCats_C "Ladelufttemperaturfühler Heilungsentprellzeit fuer SRC-Low" VALUE 0xD9D34 Kw_Wu16 655350.0 Time_ms 0.00 655350.0 FORMAT "%8.1" /end CHARACTERISTIC
/begin CHARACTERISTIC IATSCD_DebSRCLowDef_C "#SSD LTF Fehlerentprellzeit fuer SRC-Low" VALUE 0xD9CA6 Kw_Wu16 655350.0 Time_ms 0.00 655350.0 FORMAT "%8.1" /end CHARACTERISTIC
/begin CHARACTERISTIC IATSCD_DebSRCLowOk_C "LTF Heilungsentprellzeit fuer SRC-Low" VALUE 0xD9CA8 Kw_Wu16 655350.0 Time_ms 0.00 655350.0 FORMAT "%8.1" /end CHARACTERISTIC
/begin CHARACTERISTIC IATSCD_facttAir_CUR "Tn_abstell Faktorkennlinie" CURVE 0xD9CAA Kl_Xs16_Ws16 1.000000 Fact 0.00 1.000000 FORMAT "%8.6" EXTENDED_LIMITS -4.000000 3.999878
 /begin AXIS_DESCR STD_AXIS Layer_tiAbstell OneToOne 8 0.00 65535.00 FORMAT "%8.2" DEPOSIT ABSOLUTE /end AXIS_DESCR
/end CHARACTERISTIC
/begin CHARACTERISTIC IATSCD_numAdcCats_C "#SSD Applikationsparameter fuer Ladelufttemperatur-Fuehler" VALUE 0xD9D36 Kw_Wu8 26.0000000000 NumPinAdc 0.00 26.0000000000 FORMAT "%13.10" /end CHARACTERISTIC
/begin CHARACTERISTIC IATSCD_numAdc_C "#SSD Applikationsparameter fuer Ansauglufttemperatur-Fuehler" VALUE 0xD9CCC Kw_Wu8 26.0000000000 NumPinAdc 0.00 26.0000000000 FORMAT "%13.10" /end CHARACTERISTIC
/begin CHARACTERISTIC IATSCD_dtRmpSlpUpCats_C "Rampensteigung bei Heilung/Vorgabewert für Ladelufttemperaturfühler" VALUE 0xD9D38 Kw_Wu32 6553598.99749 RmpTemp 1.00097656250 6553599.99847 FORMAT "%13.5" EXTENDED_LIMITS 0.00 6553599.99847 /end CHARACTERISTIC
/begin CHARACTERISTIC IATSCD_dtRmpSlpDwnCats_C "Rampensteigung bei Heilung/Vorgabewert für Ladelufttemperaturfühler" VALUE 0xD9D3C Kw_Wu32 6553598.99749 RmpTemp 1.00097656250 6553599.99847 FORMAT "%13.5" EXTENDED_LIMITS 0.00 6553599.99847 /end CHARACTERISTIC
/begin CHARACTERISTIC IATSCD_dtRmpSlpUp_C "Rampensteigung bei Heilung/Vorgabewert für LTF" VALUE 0xD9CD0 Kw_Wu32 6553598.99749 RmpTemp 1.00097656250 6553599.99847 FORMAT "%13.5" EXTENDED_LIMITS 0.00 6553599.99847 /end CHARACTERISTIC
/begin CHARACTERISTIC IATSCD_dtRmpSlpDwn_C "Rampensteigung bei Heilung/Vorgabewert für LTF" VALUE 0xD9CD4 Kw_Wu32 6553598.99749 RmpTemp 1.00097656250 6553599.99847 FORMAT "%13.5" EXTENDED_LIMITS 0.00 6553599.99847 /end CHARACTERISTIC
/begin CHARACTERISTIC IATSCD_swtSigValCats_C "Ladelufttemperatur - Funktionsschalter Signalquelle ADC oder CAN (0 = ADC, 1 = CAN)" VALUE 0xD9D40 Kw_Wu8 1.000 OneToOne 0.00 1.000 FORMAT "%5.3" EXTENDED_LIMITS 0.00 255.0 /end CHARACTERISTIC
/begin CHARACTERISTIC IATSCD_swtSigVal_C "Lufttemperatur - Funktionsschalter Signalquelle ADC oder CAN (0=ADC, 1= CAN)" VALUE 0xD9CD8 Kw_Wu8 1.000 OneToOne 0.00 1.000 FORMAT "%5.3" EXTENDED_LIMITS 0.00 255.0 /end CHARACTERISTIC
/begin CHARACTERISTIC IATSCD_swtT10Init_C "Temperatur von ADC/CAN /AFSCD_tAir oder von neuer Initialisierungsfunktionalität  (0...ADC/CAN/AFSCD_tAir , 1... Init-Funktion)" VALUE 0xD9CD9 Kw_Wu8 1.000 OneToOne 0.00 1.000 FORMAT "%5.3" EXTENDED_LIMITS 0.00 255.0 /end CHARACTERISTIC
/begin CHARACTERISTIC IATSCD_swtT10Src_C "Temperatur von ADC/CAN oder von Message AFSCD_tAir (0...ADC, 1...CAN)" VALUE 0xD9CDA Kw_Wu8 1.000 OneToOne 0.00 1.000 FORMAT "%5.3" EXTENDED_LIMITS 0.00 255.0 /end CHARACTERISTIC
/begin CHARACTERISTIC IATSCD_tiAirPT1_C "PT1-filter time constant for intake air temperature" VALUE 0xD9CDC Kw_Wu32 4294.9673 TimeDelay_s 0.0000010000000 4294.9673 FORMAT "%9.4" /end CHARACTERISTIC
/begin CHARACTERISTIC IATSCD_stSensIDWordCats_C "Geberkennwort Ladelufttemperaturfühler" VALUE 0xD9D42 Kw_Wu16 65535.00 OneToOne 0.00 65535.00 FORMAT "%8.2" /end CHARACTERISTIC
/begin CHARACTERISTIC IATSCD_tDflCats_C "Vorgabewert bei defektem Ladelufttemperaturfühler" VALUE 0xD9D44 Kw_Ws16 250.0000 Temp_Cels -50.14000 199.8600 FORMAT "%8.4" EXTENDED_LIMITS -3549.940 3003.560 /end CHARACTERISTIC
/begin CHARACTERISTIC IATSCD_stSensIDWord_C "Geberkennwort LTF-Sensor" VALUE 0xD9CE0 Kw_Wu16 65535.00 OneToOne 0.00 65535.00 FORMAT "%8.2" /end CHARACTERISTIC
/begin CHARACTERISTIC IATSCD_tDfl_C "Vorgabewert bei defektem LTF-Sensor" VALUE 0xD9CE2 Kw_Ws16 950.0000 Temp_Cels -50.1400 899.8600 FORMAT "%8.4" EXTENDED_LIMITS -3549.940 3003.560 /end CHARACTERISTIC
/begin CHARACTERISTIC IBSCD_tiReset_C "Applikationslabel fuer Powermanagement" VALUE 0xD9D4A Kw_Wu16 1980.000 Time_ms 20.00000 2000.000 FORMAT "%8.3" EXTENDED_LIMITS 0.00 655350.0 /end CHARACTERISTIC
/begin CHARACTERISTIC IBSCD_tiWaitDetection_C "Applikationslabel fuer Powermanagement" VALUE 0xD9D48 Kw_Wu16 655350.0 Time_ms 0.00 655350.0 FORMAT "%8.1" /end CHARACTERISTIC
/begin CHARACTERISTIC IndSys_facDiffCorr_CUR "Curve to determine the correction value" CURVE 0xD9D66 Kl_Xs16_Ws16 5.000000 Fact 0.00 5.000000 FORMAT "%8.6" EXTENDED_LIMITS -4.000000 3.999878
 /begin AXIS_DESCR STD_AXIS Eng_tEng Temp_Cels 5 -50.14000 199.8600 FORMAT "%8.4" EXTENDED_LIMITS -3549.940 3003.560 DEPOSIT ABSOLUTE /end AXIS_DESCR
/end CHARACTERISTIC
/begin CHARACTERISTIC IndSys_facVSACTCor_CUR "Korrektur des Drallniveau-Grundwertes  über Wassertemperatur" CURVE 0xD9F24 Kl_Xs16_Ws16 100.0000 Fact 0.00 100.0000 FORMAT "%8.4" EXTENDED_LIMITS -4.000000 3.999878
 /begin AXIS_DESCR STD_AXIS CTSCD_tClnt Temp_Cels 8 -50.1400 899.8600 FORMAT "%8.4" EXTENDED_LIMITS -3549.940 3003.560 DEPOSIT ABSOLUTE /end AXIS_DESCR
/end CHARACTERISTIC
/begin CHARACTERISTIC IndSys_mAirPerCylLim_MAP "map to determine the Airmass value" MAP 0xD9D7C Kf_Xs16_Ys16_Ws16 1500.000 AirMassPerCyl 0.00 1500.000 FORMAT "%8.3" EXTENDED_LIMITS -3276.800 3276.700
 /begin AXIS_DESCR STD_AXIS Eng_nAvrg EngN 4 0.00 6000.000 FORMAT "%8.3" EXTENDED_LIMITS -32768.00 32767.00 DEPOSIT ABSOLUTE /end AXIS_DESCR
 /begin AXIS_DESCR STD_AXIS InjCtl_qSetUnBal InjMassCyc 4 0.00 327.6700 FORMAT "%8.4" EXTENDED_LIMITS -327.6800 327.6700 DEPOSIT ABSOLUTE /end AXIS_DESCR
/end CHARACTERISTIC
/begin CHARACTERISTIC IndSys_nAvrgMax_C "Maximum Engine speed threshold value" VALUE 0xD9DB0 Kw_Ws16 6000.000 EngN 0.00 6000.000 FORMAT "%8.3" EXTENDED_LIMITS -32768.00 32767.00 /end CHARACTERISTIC
/begin CHARACTERISTIC IndSys_nAvrgMin_C "Minimum Engine speed threshold value" VALUE 0xD9DB2 Kw_Ws16 6000.000 EngN 0.00 6000.000 FORMAT "%8.3" EXTENDED_LIMITS -32768.00 32767.00 /end CHARACTERISTIC
/begin CHARACTERISTIC IndSys_pAPDynCorr_CUR "Dynamic air pressure correction" CURVE 0xD9DB4 Kl_Xs16_Ws16 3500.000 Pres_hPa 0.00 3500.000 FORMAT "%8.3" EXTENDED_LIMITS -32768.00 32767.00
 /begin AXIS_DESCR STD_AXIS APSCD_pVal Pres_hPa 5 0.00 4000.000 FORMAT "%8.3" EXTENDED_LIMITS -32768.00 32767.00 DEPOSIT ABSOLUTE /end AXIS_DESCR
/end CHARACTERISTIC
/begin CHARACTERISTIC IndSys_pAPStatCorr_CUR "Static air pressure correction" CURVE 0xD9DCA Kl_Xs16_Ws16 3500.000 Pres_hPa 0.00 3500.000 FORMAT "%8.3" EXTENDED_LIMITS -32768.00 32767.00
 /begin AXIS_DESCR STD_AXIS APSCD_pVal Pres_hPa 5 0.00 4000.000 FORMAT "%8.3" EXTENDED_LIMITS -32768.00 32767.00 DEPOSIT ABSOLUTE /end AXIS_DESCR
/end CHARACTERISTIC
/begin CHARACTERISTIC IndSys_pDiffCorr_MAP "map to determine the correction Pressure value" MAP 0xD9DE0 Kf_Xs16_Ys16_Ws16 3500.000 Pres_hPa 0.00 3500.000 FORMAT "%8.3" EXTENDED_LIMITS -32768.00 32767.00
 /begin AXIS_DESCR STD_AXIS Eng_nAvrg EngN 6 0.00 6000.000 FORMAT "%8.3" EXTENDED_LIMITS -32768.00 32767.00 DEPOSIT ABSOLUTE /end AXIS_DESCR
 /begin AXIS_DESCR STD_AXIS InjCtl_qSetUnBal InjMassCyc 6 0.00 327.6700 FORMAT "%8.4" EXTENDED_LIMITS -327.6800 327.6700 DEPOSIT ABSOLUTE /end AXIS_DESCR
/end CHARACTERISTIC
/begin CHARACTERISTIC IndSys_pDiffStat_MAP "map to determine the Static Pressure value" MAP 0xD9E44 Kf_Xs16_Ys16_Ws16 3500.000 Pres_hPa 0.00 3500.000 FORMAT "%8.3" EXTENDED_LIMITS -32768.00 32767.00
 /begin AXIS_DESCR STD_AXIS Eng_nAvrg EngN 6 0.00 6000.000 FORMAT "%8.3" EXTENDED_LIMITS -32768.00 32767.00 DEPOSIT ABSOLUTE /end AXIS_DESCR
 /begin AXIS_DESCR STD_AXIS InjCtl_qSetUnBal InjMassCyc 6 0.00 327.6700 FORMAT "%8.4" EXTENDED_LIMITS -327.6800 327.6700 DEPOSIT ABSOLUTE /end AXIS_DESCR
/end CHARACTERISTIC
/begin CHARACTERISTIC IndSys_pDynMin_CUR "Curve to determine the Dynamic Pressure value" CURVE 0xD9EA8 Kl_Xs16_Ws16 3500.000 Pres_hPa 0.00 3500.000 FORMAT "%8.3" EXTENDED_LIMITS -32768.00 32767.00
 /begin AXIS_DESCR STD_AXIS Eng_nAvrg EngN 5 0.00 6000.000 FORMAT "%8.3" EXTENDED_LIMITS -32768.00 32767.00 DEPOSIT ABSOLUTE /end AXIS_DESCR
/end CHARACTERISTIC
/begin CHARACTERISTIC IndSys_qDiffStatMax_CUR "Curve to determine the Maximum static diff Quantity value" CURVE 0xD9EBE Kl_Xs16_Ws16 327.6700 InjMassCyc 0.00 327.6700 FORMAT "%8.4" EXTENDED_LIMITS -327.6800 327.6700
 /begin AXIS_DESCR STD_AXIS Eng_nAvrg EngN 5 0.00 6000.000 FORMAT "%8.3" EXTENDED_LIMITS -32768.00 32767.00 DEPOSIT ABSOLUTE /end AXIS_DESCR
/end CHARACTERISTIC
/begin CHARACTERISTIC IndSys_qDiffStatMin_CUR "Curve to determine the Minimum static diff Quantity value" CURVE 0xD9ED4 Kl_Xs16_Ws16 327.6700 InjMassCyc 0.00 327.6700 FORMAT "%8.4" EXTENDED_LIMITS -327.6800 327.6700
 /begin AXIS_DESCR STD_AXIS Eng_nAvrg EngN 5 0.00 6000.000 FORMAT "%8.3" EXTENDED_LIMITS -32768.00 32767.00 DEPOSIT ABSOLUTE /end AXIS_DESCR
/end CHARACTERISTIC
/begin CHARACTERISTIC IndSys_qSetDynMax_CUR "Curve to determine the Maximum Dynamic Quantity value" CURVE 0xD9EEA Kl_Xs16_Ws16 327.6700 InjMassCyc 0.00 327.6700 FORMAT "%8.4" EXTENDED_LIMITS -327.6800 327.6700
 /begin AXIS_DESCR STD_AXIS Eng_nAvrg EngN 5 0.00 6000.000 FORMAT "%8.3" EXTENDED_LIMITS -32768.00 32767.00 DEPOSIT ABSOLUTE /end AXIS_DESCR
/end CHARACTERISTIC
/begin CHARACTERISTIC IndSys_qSetDynMin_CUR "Curve to determine the Minimum Dynamic Quantity value" CURVE 0xD9F00 Kl_Xs16_Ws16 327.6700 InjMassCyc 0.00 327.6700 FORMAT "%8.4" EXTENDED_LIMITS -327.6800 327.6700
 /begin AXIS_DESCR STD_AXIS Eng_nAvrg EngN 5 0.00 6000.000 FORMAT "%8.3" EXTENDED_LIMITS -32768.00 32767.00 DEPOSIT ABSOLUTE /end AXIS_DESCR
/end CHARACTERISTIC
/begin CHARACTERISTIC IndSys_qSetUnBalMax_C "Maximum Quantity  threshold value" VALUE 0xD9F16 Kw_Ws16 327.6700 InjMassCyc 0.00 327.6700 FORMAT "%8.4" EXTENDED_LIMITS -327.6800 327.6700 /end CHARACTERISTIC
/begin CHARACTERISTIC IndSys_qSetUnBalMin_C "Minimum Quantity  threshold value" VALUE 0xD9F18 Kw_Ws16 327.6700 InjMassCyc 0.00 327.6700 FORMAT "%8.4" EXTENDED_LIMITS -327.6800 327.6700 /end CHARACTERISTIC
/begin CHARACTERISTIC IndSys_rClsEGR_C "Ersatzwert für Output von IndSys_rVSARgn_MAP bei geschlossener EGR" VALUE 0xD9F46 Kw_Ws16 327.6700 DtyCyc 0.00 327.6700 FORMAT "%8.4" EXTENDED_LIMITS -327.6800 327.6700 /end CHARACTERISTIC
/begin CHARACTERISTIC IndSys_rVSAAdd_Vector "#SSD Bypass-Label für additiven Bypass von IndSys_rVSA (Nicht verstellen!)" VALUE 0xC3952 Kw_Wu8 255.0 OneToOne 0.00 255.0 FORMAT "%5.1" /end CHARACTERISTIC
/begin CHARACTERISTIC IndSys_rVSAAdd_Channel "#SSD Bypass-Label für additiven Bypass von IndSys_rVSA (Nicht verstellen!)" VALUE 0xC3953 Kw_Wu8 255.0 OneToOne 0.00 255.0 FORMAT "%5.1" /end CHARACTERISTIC
/begin CHARACTERISTIC IndSys_rVSAAPSCorr_CUR "luftdruckabhängige Korrekturkurve für die Drosselklappe" CURVE 0xD9F48 Kl_Xs16_Ws16 100.0000 DtyCyc 0.00 100.0000 FORMAT "%8.4" EXTENDED_LIMITS -327.6800 327.6700
 /begin AXIS_DESCR STD_AXIS APSCD_pVal Pres_hPa 6 0.00 3500.000 FORMAT "%8.3" EXTENDED_LIMITS -32768.00 32767.00 DEPOSIT ABSOLUTE /end AXIS_DESCR
/end CHARACTERISTIC
/begin CHARACTERISTIC IndSys_rVSAATCorr_CUR "Lufttemperatur Korrekturkennlinie" CURVE 0xD9F62 Kl_Xs16_Ws16 100.0000 DtyCyc 0.00 100.0000 FORMAT "%8.4" EXTENDED_LIMITS -327.6800 327.6700
 /begin AXIS_DESCR STD_AXIS IATSCD_tAir Temp_Cels 2 -50.1400 899.8600 FORMAT "%8.4" EXTENDED_LIMITS -3549.940 3003.560 DEPOSIT ABSOLUTE /end AXIS_DESCR
/end CHARACTERISTIC
/begin CHARACTERISTIC IndSys_rVSACTCor_MAP "Korrektur des Drallniveau-Grundwertes über Wassertemperatur" MAP 0xD9F6C Kf_Xs16_Ys16_Ws16 100.0000 DtyCyc 0.00 100.0000 FORMAT "%8.4" EXTENDED_LIMITS -327.6800 327.6700
 /begin AXIS_DESCR STD_AXIS Eng_nAvrg EngN 10 -32768.00 32767.00 FORMAT "%8.2" DEPOSIT ABSOLUTE /end AXIS_DESCR
 /begin AXIS_DESCR STD_AXIS InjCtl_qRaw InjMassCyc 12 -327.6800 327.6700 FORMAT "%8.4" DEPOSIT ABSOLUTE /end AXIS_DESCR
/end CHARACTERISTIC
/begin CHARACTERISTIC IndSys_rVSAMAX_C "maximales Tasterverhältnis für Drallniveausteller (Maximalwertbegrenzung)" VALUE 0xDA08C Kw_Ws16 655.3500 DtyCyc -327.6800 327.6700 FORMAT "%8.4" /end CHARACTERISTIC
/begin CHARACTERISTIC IndSys_rVSARgn_MAP "Drallklappensteuerkennfeld für Regeneration" MAP 0xDA08E Kf_Xs16_Ys16_Ws16 100.0000 DtyCyc 0.00 100.0000 FORMAT "%8.4" EXTENDED_LIMITS -327.6800 327.6700
 /begin AXIS_DESCR STD_AXIS Eng_nAvrg EngN 12 40.00000 6000.000 FORMAT "%8.3" EXTENDED_LIMITS -32768.00 32767.00 DEPOSIT ABSOLUTE /end AXIS_DESCR
 /begin AXIS_DESCR STD_AXIS InjCtl_qCurr InjMassCyc 16 0.00 327.6700 FORMAT "%8.4" EXTENDED_LIMITS -327.6800 327.6700 DEPOSIT ABSOLUTE /end AXIS_DESCR
/end CHARACTERISTIC
/begin CHARACTERISTIC IndSys_rVSA_MAP "Kennfeld für Drallniveausteuerung" MAP 0xDA24A Kf_Xs16_Ys16_Ws16 100.0000 DtyCyc 0.00 100.0000 FORMAT "%8.4" EXTENDED_LIMITS -327.6800 327.6700
 /begin AXIS_DESCR STD_AXIS Eng_nAvrg EngN 12 -32768.00 32767.00 FORMAT "%8.2" DEPOSIT ABSOLUTE /end AXIS_DESCR
 /begin AXIS_DESCR STD_AXIS InjCtl_qCurr InjMassCyc 16 -327.6800 327.6700 FORMAT "%8.4" DEPOSIT ABSOLUTE /end AXIS_DESCR
/end CHARACTERISTIC
/begin CHARACTERISTIC IndSys_rVSA_Vector "#SSD Bypass-Label für IndSys_rVSA (Nicht verstellen!)" VALUE 0xC3954 Kw_Wu8 255.0 OneToOne 0.00 255.0 FORMAT "%5.1" /end CHARACTERISTIC
/begin CHARACTERISTIC IndSys_rVSA_Channel "#SSD Bypass-Label für IndSys_rVSA (Nicht verstellen!)" VALUE 0xC3955 Kw_Wu8 255.0 OneToOne 0.00 255.0 FORMAT "%5.1" /end CHARACTERISTIC
/begin CHARACTERISTIC IndSys_stMskVSARgn_C "Bitmaske für Codierung der Umschaltung bei Regeneration" VALUE 0xDA408 Kw_Wu32 4294967295.00 OneToOne 0.00 4294967295.00 FORMAT "%13.2" /end CHARACTERISTIC
/begin CHARACTERISTIC IndSys_tiDelayDef1_C "Time delay for Defect1" VALUE 0xD9F1A Kw_Wu16 10000.00 Time_ms 0.00 10000.00 FORMAT "%8.2" EXTENDED_LIMITS 0.00 655350.0 /end CHARACTERISTIC
/begin CHARACTERISTIC IndSys_tiDelayDef2_C "Time delay for Defect2" VALUE 0xD9F1C Kw_Wu16 10000.00 Time_ms 0.00 10000.00 FORMAT "%8.2" EXTENDED_LIMITS 0.00 655350.0 /end CHARACTERISTIC
/begin CHARACTERISTIC IndSys_tiDelayDef3_C "IndSys_nAvrgMin_C" VALUE 0xD9F1E Kw_Wu16 10000.00 Time_ms 0.00 10000.00 FORMAT "%8.2" EXTENDED_LIMITS 0.00 655350.0 /end CHARACTERISTIC
/begin CHARACTERISTIC IndSys_tiDelayOK1_C "Time delay for O.K1" VALUE 0xD9F20 Kw_Wu16 10000.00 Time_ms 0.00 10000.00 FORMAT "%8.2" EXTENDED_LIMITS 0.00 655350.0 /end CHARACTERISTIC
/begin CHARACTERISTIC IndSys_tiRmpSlpVSA_C "Rampenlaufzeit für Regenerationsschalter" VALUE 0xDA40C Kw_Wu32 31.775030303030302 TimeEGTRmp 0.99296969696969695 32.768000000000001 FORMAT "%19.16" EXTENDED_LIMITS 0.000000015258789066052715 65.536000000000001 /end CHARACTERISTIC
/begin CHARACTERISTIC IndSys_tiStartDelay_CUR "Startverzögerung zum Umschalten auf einen anderen Vorgabewert, abhängig von Eng_tEng" CURVE 0xDA410 Kl_Xs16_Ws16 500.0000 Time_s 0.00 500.0000 FORMAT "%8.4" EXTENDED_LIMITS -327.6800 327.6700
 /begin AXIS_DESCR STD_AXIS Eng_tEng Temp_Cels 5 -50.14000 199.8600 FORMAT "%8.4" EXTENDED_LIMITS -3549.940 3003.560 DEPOSIT ABSOLUTE /end AXIS_DESCR
/end CHARACTERISTIC
/begin CHARACTERISTIC InjCrv_ctTempSel_C "Auszulesende Motortemperatur aus dem Motortemperaturenfeld" VALUE 0xDA438 Kw_Wu8 2.00000000000 EngTempFldSel 0.00 2.00000000000 FORMAT "%13.11" /end CHARACTERISTIC
/begin CHARACTERISTIC InjCrv_DebLimDef_C "#SSD Fehlerentprellzeit für Begrenzung der Anzahl der Einspritzungen" VALUE 0xDA43A Kw_Wu16 65535.00 OneToOne 0.00 65535.00 FORMAT "%8.2" /end CHARACTERISTIC
/begin CHARACTERISTIC InjCrv_DebLimOk_C "#SSD Heilungsentprellzeit für Begrenzung der Anzahl der Einspritzungen" VALUE 0xDA43C Kw_Wu16 65535.00 OneToOne 0.00 65535.00 FORMAT "%8.2" /end CHARACTERISTIC
/begin CHARACTERISTIC InjCrv_dfacCylOffsUp_C "Rampensteigung für die Rampung des Freigabestatus" VALUE 0xDB6AC Kw_Wu32 1.50000117719 Rmp_Fact 0.499999150634 2.00000032783 FORMAT "%13.11" EXTENDED_LIMITS 0.00 7999.99999814 /end CHARACTERISTIC
/begin CHARACTERISTIC InjCrv_dfacCylOffsDwn_C "Rampensteigung für die Rampung des Freigabestatus" VALUE 0xDB6B0 Kw_Wu32 1.50000117719 Rmp_Fact 0.499999150634 2.00000032783 FORMAT "%13.11" EXTENDED_LIMITS 0.00 7999.99999814 /end CHARACTERISTIC
/begin CHARACTERISTIC InjCrv_dphiMIDynUp_C "Rampensteigung für Korrekturwertsteigung auf 0 Grad KW" VALUE 0xDD56C Kw_Wu32 1535999.99964 RmpCrsAg_InjCrv 0.00 1535999.99964 FORMAT "%13.5" /end CHARACTERISTIC
/begin CHARACTERISTIC InjCrv_dphiMIDynDown_C "Rampensteigung für Korrekturwertabsenkung auf 0 Grad KW" VALUE 0xDD570 Kw_Wu32 1535999.99964 RmpCrsAg_InjCrv 0.00 1535999.99964 FORMAT "%13.5" /end CHARACTERISTIC
/begin CHARACTERISTIC InjCrv_dqFltLowNeg_C "Schwellwert für pos. dq für Filter Parameter Auswahl" VALUE 0xDD574 Kw_Ws16 32767.50 InjMassPerSec_20ms -16384.00 16383.50 FORMAT "%8.2" /end CHARACTERISTIC
/begin CHARACTERISTIC InjCrv_dqFltLowPos_C "pos. dq Schwellwert für Filter Parameter Selektion" VALUE 0xDD576 Kw_Ws16 32767.50 InjMassPerSec_20ms -16384.00 16383.50 FORMAT "%8.2" /end CHARACTERISTIC
/begin CHARACTERISTIC InjCrv_dqFltMidNeg_C "pos dq threshold for PT1 filter parameter selection" VALUE 0xDD578 Kw_Ws16 32767.50 InjMassPerSec_20ms -16384.00 16383.50 FORMAT "%8.2" /end CHARACTERISTIC
/begin CHARACTERISTIC InjCrv_dqFltMidPos_C "pos dq threshold for PT1 filter parameter selection" VALUE 0xDD57A Kw_Ws16 32767.50 InjMassPerSec_20ms -16384.00 16383.50 FORMAT "%8.2" /end CHARACTERISTIC
/begin CHARACTERISTIC InjCrv_dqPoIUp_C "Rampensteigung der Freigabe PoI nach Schub" VALUE 0xDA428 Kw_Wu32 655359.999847 RmpInjMassInj 0.00 655359.999847 FORMAT "%13.6" /end CHARACTERISTIC
/begin CHARACTERISTIC InjCrv_dqPoIDwn_C "Rampensteigung der Freigabe PoI nach Schub" VALUE 0xDA42C Kw_Wu32 655359.999847 RmpInjMassInj 0.00 655359.999847 FORMAT "%13.6" /end CHARACTERISTIC
/begin CHARACTERISTIC InjCrv_dqSetUnBalMax_C "pos dq threshold for PT1 filter parameter selection" VALUE 0xDD57C Kw_Ws16 32767.50 InjMassPerSec_20ms -16384.00 16383.50 FORMAT "%8.2" /end CHARACTERISTIC
/begin CHARACTERISTIC InjCrv_dqSetUnBalMin_C "pos dq threshold for PT1 filter parameter selection" VALUE 0xDD57E Kw_Ws16 32767.50 InjMassPerSec_20ms -16384.00 16383.50 FORMAT "%8.2" /end CHARACTERISTIC
/begin CHARACTERISTIC InjCrv_dtiMI1RgnRmpUp_C "positive Rampensteigung bei Umschaltung auf Regenerationswert MI1" VALUE 0xDFC3C Kw_Wu32 65535999.9847 Rmp 0.00 65535999.9847 FORMAT "%13.4" /end CHARACTERISTIC
/begin CHARACTERISTIC InjCrv_dtiMI1RgnRmpDwn_C "negative Rampensteigung bei Umschaltung auf Regenerationswert MI1" VALUE 0xDFC40 Kw_Wu32 65535999.9847 Rmp 0.00 65535999.9847 FORMAT "%13.4" /end CHARACTERISTIC
/begin CHARACTERISTIC InjCrv_dtiMI1RgnTypeRmpUp_C "Positive Rampensteigung bei Regenerationstyp-Umschaltung von MI1" VALUE 0xDFC44 Kw_Wu32 65535999.9847 Rmp 0.00 65535999.9847 FORMAT "%13.4" /end CHARACTERISTIC
/begin CHARACTERISTIC InjCrv_dtiMI1RgnTypeRmpDwn_C "Negative Rampensteigung bei Regenerationstyp-Umschaltung von MI1" VALUE 0xDFC48 Kw_Wu32 65535999.9847 Rmp 0.00 65535999.9847 FORMAT "%13.4" /end CHARACTERISTIC
/begin CHARACTERISTIC InjCrv_facAPMIDynCor2_CUR "weighting factor by engine temperature for SOE correction" CURVE 0xDD4E0 Kl_Xs16_Ws16 2.000000 Fact 0.00 2.000000 FORMAT "%8.6" EXTENDED_LIMITS -4.000000 3.999878
 /begin AXIS_DESCR STD_AXIS APSCD_pVal Pres_hPa 6 0.00 3500.000 FORMAT "%8.3" EXTENDED_LIMITS -32768.00 32767.00 DEPOSIT ABSOLUTE /end AXIS_DESCR
/end CHARACTERISTIC
/begin CHARACTERISTIC InjCrv_facDQMI1DynCor2_CUR "Gewichtungsfaktor der abgeleiteten Einspritzmenge for S0E Korrektur" CURVE 0xDD580 Kl_Xs16_Ws16 4.000000 Fact -2.000000 2.000000 FORMAT "%8.6" EXTENDED_LIMITS -4.000000 3.999878
 /begin AXIS_DESCR STD_AXIS InjCrv_dqSetUnBalFltLim InjMassPerSec_20ms 6 -16384.00 16383.50 FORMAT "%8.2" DEPOSIT ABSOLUTE /end AXIS_DESCR
/end CHARACTERISTIC
/begin CHARACTERISTIC InjCrv_facETMIDynCor2_CUR "weighting factor by engine temperature for SOE correction" CURVE 0xDD4FA Kl_Xs16_Ws16 2.000000 Fact 0.00 2.000000 FORMAT "%8.6" EXTENDED_LIMITS -4.000000 3.999878
 /begin AXIS_DESCR STD_AXIS InjCrv_tEng Temp_Cels 6 -50.14000 199.8600 FORMAT "%8.4" EXTENDED_LIMITS -3549.940 3003.560 DEPOSIT ABSOLUTE /end AXIS_DESCR
/end CHARACTERISTIC
/begin CHARACTERISTIC InjCrv_facIATMIDynCor2_CUR "Gewichtungsfaktor von der Motortemperatur für die SOE-Korrektur" CURVE 0xDD514 Kl_Xs16_Ws16 2.000000 Fact 0.00 2.000000 FORMAT "%8.6" EXTENDED_LIMITS -4.000000 3.999878
 /begin AXIS_DESCR STD_AXIS IATSCD_tAir Temp_Cels 6 -50.14000 199.8600 FORMAT "%8.4" EXTENDED_LIMITS -3549.940 3003.560 DEPOSIT ABSOLUTE /end AXIS_DESCR
/end CHARACTERISTIC
/begin CHARACTERISTIC InjCrv_facMIAPSPhiCor2_CUR "atmosphärendruckabhängige Korrekturkennlinie -2 für Ansteuerbeginn MI1" CURVE 0xDF384 Gkl_Ws16 1.000000 Fact 0.00 1.000000 FORMAT "%8.6" EXTENDED_LIMITS -4.000000 3.999878
 /begin AXIS_DESCR COM_AXIS APSCD_pVal Pres_hPa 8 0.00 4000.000 FORMAT "%8.3" EXTENDED_LIMITS -32768.00 32767.00 AXIS_PTS_REF InjCrv_facMIAPSPhiCor_AXIS /end AXIS_DESCR
/end CHARACTERISTIC
/begin CHARACTERISTIC InjCrv_facMIAPSPhiCorStrt_CUR "weighting factor by air pressure for SOE correction" CURVE 0xDF394 Kl_Xs16_Ws16 1.000000 Fact 0.00 1.000000 FORMAT "%8.6" EXTENDED_LIMITS -4.000000 3.999878
 /begin AXIS_DESCR STD_AXIS APSCD_pVal Pres_hPa 8 0.00 4000.000 FORMAT "%8.3" EXTENDED_LIMITS -32768.00 32767.00 DEPOSIT ABSOLUTE /end AXIS_DESCR
/end CHARACTERISTIC
/begin AXIS_PTS InjCrv_facMIAPSPhiCor_AXIS "gemeinsame Stützstellen für atmosphärendruckabhängige Ansteuerbeginnkorrekturkennlinien für MI1" 0xDF3B6 APSCD_pVal GSst_Xs16 4000.000 Pres_hPa 8 0.00 4000.000 FORMAT "%8.3" EXTENDED_LIMITS -32768.00 32767.00 DEPOSIT ABSOLUTE /end AXIS_PTS
/begin CHARACTERISTIC InjCrv_facMIAPSPhiCor_CUR "atmosphärendruckabhängige Ansteuerbeginnkorrekturkennlinie für MI1" CURVE 0xDF3C8 Gkl_Ws16 1.000000 Fact 0.00 1.000000 FORMAT "%8.6" EXTENDED_LIMITS -4.000000 3.999878
 /begin AXIS_DESCR COM_AXIS APSCD_pVal Pres_hPa 8 0.00 4000.000 FORMAT "%8.3" EXTENDED_LIMITS -32768.00 32767.00 AXIS_PTS_REF InjCrv_facMIAPSPhiCor_AXIS /end AXIS_DESCR
/end CHARACTERISTIC
/begin CHARACTERISTIC InjCrv_facMIATSDynCor_CUR "Korrekturkennline für Lufttemperaturkorrektur" CURVE 0xDD52E Kl_Xs16_Ws16 2.000000 Fact 0.00 2.000000 FORMAT "%8.6" EXTENDED_LIMITS -4.000000 3.999878
 /begin AXIS_DESCR STD_AXIS IATSCD_tAir Temp_Cels 6 -50.14000 199.8600 FORMAT "%8.4" EXTENDED_LIMITS -3549.940 3003.560 DEPOSIT ABSOLUTE /end AXIS_DESCR
/end CHARACTERISTIC
/begin CHARACTERISTIC InjCrv_facMIATSPhiCor2_CUR "ansauglufttemperaturabhängige Korrekturkennlinie -2 für Ansteuerbeginn MI1" CURVE 0xDF3D8 Gkl_Ws16 1.000000 Fact 0.00 1.000000 FORMAT "%8.6" EXTENDED_LIMITS -4.000000 3.999878
 /begin AXIS_DESCR COM_AXIS IATSCD_tAir Temp_Cels 8 -50.14000 199.8600 FORMAT "%8.4" EXTENDED_LIMITS -3549.940 3003.560 AXIS_PTS_REF InjCrv_facMIATSPhiCor_AXIS /end AXIS_DESCR
/end CHARACTERISTIC
/begin CHARACTERISTIC InjCrv_facMIATSPhiCorStrt_CUR "weighting factor by intake air temperature for SOE correction" CURVE 0xDF3E8 Kl_Xs16_Ws16 1.000000 Fact 0.00 1.000000 FORMAT "%8.6" EXTENDED_LIMITS -4.000000 3.999878
 /begin AXIS_DESCR STD_AXIS IATSCD_tAir Temp_Cels 8 -50.14000 199.8600 FORMAT "%8.4" EXTENDED_LIMITS -3549.940 3003.560 DEPOSIT ABSOLUTE /end AXIS_DESCR
/end CHARACTERISTIC
/begin AXIS_PTS InjCrv_facMIATSPhiCor_AXIS "gemeinsame Stützstellen für ansauglufttemperaturabhängige Ansteuerbeginnkorrekturkennlinien für MI1" 0xDF40A IATSCD_tAir GSst_Xs16 250.0000 Temp_Cels 8 -50.14000 199.8600 FORMAT "%8.4" EXTENDED_LIMITS -3549.940 3003.560 DEPOSIT ABSOLUTE /end AXIS_PTS
/begin CHARACTERISTIC InjCrv_facMIATSPhiCor_CUR "ansauglufttemperaturabhängige Ansteuerbeginnkorrekturkennlinie für MI1" CURVE 0xDF41C Gkl_Ws16 1.000000 Fact 0.00 1.000000 FORMAT "%8.6" EXTENDED_LIMITS -4.000000 3.999878
 /begin AXIS_DESCR COM_AXIS IATSCD_tAir Temp_Cels 8 -50.14000 199.8600 FORMAT "%8.4" EXTENDED_LIMITS -3549.940 3003.560 AXIS_PTS_REF InjCrv_facMIATSPhiCor_AXIS /end AXIS_DESCR
/end CHARACTERISTIC
/begin CHARACTERISTIC InjCrv_facMIChamWllTempCorr_MAP "Brennraumwandtemperatur Korrektur - Kennfeld für die Ermittlung des Korrekturfaktors" MAP 0xDD59A Kf_Xs16_Ys16_Ws16 2.000000 Fact 0.00 2.000000 FORMAT "%8.6" EXTENDED_LIMITS -4.000000 3.999878
 /begin AXIS_DESCR STD_AXIS Eng_tEng Temp_Cels 8 -50.14000 199.8600 FORMAT "%8.4" EXTENDED_LIMITS -3549.940 3003.560 DEPOSIT ABSOLUTE /end AXIS_DESCR
 /begin AXIS_DESCR STD_AXIS Layer_tChamWll Temp_Cels 8 -50.14000 899.8600 FORMAT "%8.4" EXTENDED_LIMITS -3549.940 3003.560 DEPOSIT ABSOLUTE /end AXIS_DESCR
/end CHARACTERISTIC
/begin CHARACTERISTIC InjCrv_facMICTSDynCor_CUR "Korrekturkennlinie für Wassertemperaturkorrektur" CURVE 0xDD548 Kl_Xs16_Ws16 2.000000 Fact 0.00 2.000000 FORMAT "%8.6" EXTENDED_LIMITS -4.000000 3.999878
 /begin AXIS_DESCR STD_AXIS CTSCD_tClnt Temp_Cels 6 -50.14000 199.8600 FORMAT "%8.4" EXTENDED_LIMITS -3549.940 3003.560 DEPOSIT ABSOLUTE /end AXIS_DESCR
/end CHARACTERISTIC
/begin CHARACTERISTIC InjCrv_facMIETSPhiCor12_CUR "motortemperaturabhängige Ansteuerbeginnkorrekturkennlinie" CURVE 0xDF42C Gkl_Ws16 1.000000 Fact 0.00 1.000000 FORMAT "%8.6" EXTENDED_LIMITS -4.000000 3.999878
 /begin AXIS_DESCR COM_AXIS InjCrv_tEng Temp_Cels 8 -50.14000 199.8600 FORMAT "%8.4" EXTENDED_LIMITS -3549.940 3003.560 AXIS_PTS_REF InjCrv_facMIETSPhiCor1_AXIS /end AXIS_DESCR
/end CHARACTERISTIC
/begin AXIS_PTS InjCrv_facMIETSPhiCor1_AXIS "Achsenpunkte der Motortemperatur" 0xDF43C InjCrv_tEng GSst_Xs16 250.0000 Temp_Cels 8 -50.14000 199.8600 FORMAT "%8.4" EXTENDED_LIMITS -3549.940 3003.560 DEPOSIT ABSOLUTE /end AXIS_PTS
/begin CHARACTERISTIC InjCrv_facMIETSPhiCor1_CUR "motortemperaturabhängige Korrekturkennlinie -1 für Ansteuerbeginn MI1" CURVE 0xDF44E Gkl_Ws16 1.000000 Fact 0.00 1.000000 FORMAT "%8.6" EXTENDED_LIMITS -4.000000 3.999878
 /begin AXIS_DESCR COM_AXIS InjCrv_tEng Temp_Cels 8 -50.14000 199.8600 FORMAT "%8.4" EXTENDED_LIMITS -3549.940 3003.560 AXIS_PTS_REF InjCrv_facMIETSPhiCor1_AXIS /end AXIS_DESCR
/end CHARACTERISTIC
/begin CHARACTERISTIC InjCrv_facMIETSPhiCor2_CUR "motortemperaturabhängige Korrekturkennlinie -2 für Ansteuerbeginn MI1" CURVE 0xDF45E Gkl_Ws16 1.000000 Fact 0.00 1.000000 FORMAT "%8.6" EXTENDED_LIMITS -4.000000 3.999878
 /begin AXIS_DESCR COM_AXIS InjCrv_tEng Temp_Cels 8 -50.14000 199.8600 FORMAT "%8.4" EXTENDED_LIMITS -3549.940 3003.560 AXIS_PTS_REF InjCrv_facMIETSPhiCor_AXIS /end AXIS_DESCR
/end CHARACTERISTIC
/begin CHARACTERISTIC InjCrv_facMIETSPhiCorRgn_CUR "motortemperaturabhängige Ansteuerbeginnkorrekturkennlinie für MI1 im Regenerationsbetrieb" CURVE 0xDF4F6 Kl_Xs16_Ws16 1.000000 Fact 0.00 1.000000 FORMAT "%8.6" EXTENDED_LIMITS -4.000000 3.999878
 /begin AXIS_DESCR STD_AXIS CTSCD_tClnt Temp_Cels 8 -50.14000 199.8600 FORMAT "%8.4" EXTENDED_LIMITS -3549.940 3003.560 DEPOSIT ABSOLUTE /end AXIS_DESCR
/end CHARACTERISTIC
/begin CHARACTERISTIC InjCrv_facMIETSPhiCorStrt_CUR "weighting factor by engine temperature for SOE correction" CURVE 0xDF46E Kl_Xs16_Ws16 1.000000 Fact 0.00 1.000000 FORMAT "%8.6" EXTENDED_LIMITS -4.000000 3.999878
 /begin AXIS_DESCR STD_AXIS InjCrv_tEng Temp_Cels 8 -50.14000 199.8600 FORMAT "%8.4" EXTENDED_LIMITS -3549.940 3003.560 DEPOSIT ABSOLUTE /end AXIS_DESCR
/end CHARACTERISTIC
/begin AXIS_PTS InjCrv_facMIETSPhiCor_AXIS "gemeinsame Stützstellen für motortemperaturabhängige Ansteuerbeginnkorrekturkennlinien für MI1" 0xDF490 InjCrv_tEng GSst_Xs16 250.0000 Temp_Cels 8 -50.14000 199.8600 FORMAT "%8.4" EXTENDED_LIMITS -3549.940 3003.560 DEPOSIT ABSOLUTE /end AXIS_PTS
/begin CHARACTERISTIC InjCrv_facMIETSPhiCor_CUR "motortemperaturabhängige Ansteuerbeginnkorrekturkennlinie für MI1" CURVE 0xDF4A2 Gkl_Ws16 1.000000 Fact 0.00 1.000000 FORMAT "%8.6" EXTENDED_LIMITS -4.000000 3.999878
 /begin AXIS_DESCR COM_AXIS InjCrv_tEng Temp_Cels 8 -50.14000 199.8600 FORMAT "%8.4" EXTENDED_LIMITS -3549.940 3003.560 AXIS_PTS_REF InjCrv_facMIETSPhiCor_AXIS /end AXIS_DESCR
/end CHARACTERISTIC
/begin CHARACTERISTIC InjCrv_facMIFTSRailCorStrt_CUR "correction factor curve for the MI1, based on rail pressure" CURVE 0xDF4B2 Kl_Xs16_Ws16 1.000000 Fact 0.00 1.000000 FORMAT "%8.6" EXTENDED_LIMITS -4.000000 3.999878
 /begin AXIS_DESCR STD_AXIS Rail_pSetPointFlTempCor Pres_Rail 8 -1800.000 2000.000 FORMAT "%5.3" EXTENDED_LIMITS -3276.800 3276.700 DEPOSIT ABSOLUTE /end AXIS_DESCR
/end CHARACTERISTIC
/begin CHARACTERISTIC InjCrv_facMIFTSRailCor_CUR "Korrekturfaktorkennlinie für die MI1, abhängig von der kraftstofftemperaturabhängigen Raildruckkorrektur" CURVE 0xDF4D4 Kl_Xs16_Ws16 1.000000 Fact 0.00 1.000000 FORMAT "%8.6" EXTENDED_LIMITS -4.000000 3.999878
 /begin AXIS_DESCR STD_AXIS Rail_pSetPointFlTempCor Pres_Rail 8 -1800.000 2000.000 FORMAT "%5.3" EXTENDED_LIMITS -3276.800 3276.700 DEPOSIT ABSOLUTE /end AXIS_DESCR
/end CHARACTERISTIC
/begin CHARACTERISTIC InjCrv_facMIPDynCor_CUR "Korrekturkennlinie für Faktor abhängig vom Raildruck" CURVE 0xDD63E Kl_Xs16_Ws16 2.000000 Fact 0.00 2.000000 FORMAT "%8.6" EXTENDED_LIMITS -4.000000 3.999878
 /begin AXIS_DESCR STD_AXIS InjCrv_pMIDynCor_mp Pres_Rail 8 -3276.800 3276.700 FORMAT "%5.3" DEPOSIT ABSOLUTE /end AXIS_DESCR
/end CHARACTERISTIC
/begin CHARACTERISTIC InjCrv_facphiMI1CylOffs21_C "Multiplaktiver Faktor auf den Basiswert des Ansteuerbeginns Zyl1 bei aktiver Pii2" VALUE 0xDB6B4 Kw_Ws16 1.000000 Fact1 0.00 1.000000 FORMAT "%8.6" EXTENDED_LIMITS -256.0000 255.9922 /end CHARACTERISTIC
/begin CHARACTERISTIC InjCrv_facphiMI1CylOffs22_C "Multiplaktiver Faktor auf den Basiswert des Ansteuerbeginns Zyl2 bei aktiver Pii2" VALUE 0xDB6B6 Kw_Ws16 1.000000 Fact1 0.00 1.000000 FORMAT "%8.6" EXTENDED_LIMITS -256.0000 255.9922 /end CHARACTERISTIC
/begin CHARACTERISTIC InjCrv_facphiMI1CylOffs23_C "Multiplaktiver Faktor auf den Basiswert des Ansteuerbeginns Zyl3 bei aktiver Pii2" VALUE 0xDB6B8 Kw_Ws16 1.000000 Fact1 0.00 1.000000 FORMAT "%8.6" EXTENDED_LIMITS -256.0000 255.9922 /end CHARACTERISTIC
/begin CHARACTERISTIC InjCrv_facphiMI1CylOffs24_C "Multiplaktiver Faktor auf den Basiswert des Ansteuerbeginns Zyl4 bei aktiver Pii2" VALUE 0xDB6BA Kw_Ws16 1.000000 Fact1 0.00 1.000000 FORMAT "%8.6" EXTENDED_LIMITS -256.0000 255.9922 /end CHARACTERISTIC
/begin CHARACTERISTIC InjCrv_facphiMI1CylOffs25_C "Multiplaktiver Faktor auf den Basiswert des Ansteuerbeginns Zyl5 bei aktiver Pii2" VALUE 0xDB6BC Kw_Ws16 1.000000 Fact1 0.00 1.000000 FORMAT "%8.6" EXTENDED_LIMITS -256.0000 255.9922 /end CHARACTERISTIC
/begin CHARACTERISTIC InjCrv_facphiMI1CylOffs26_C "Multiplaktiver Faktor auf den Basiswert des Ansteuerbeginns Zyl6 bei aktiver Pii2" VALUE 0xDB6BE Kw_Ws16 1.000000 Fact1 0.00 1.000000 FORMAT "%8.6" EXTENDED_LIMITS -256.0000 255.9922 /end CHARACTERISTIC
/begin CHARACTERISTIC InjCrv_facphiMI1CylOffs27_C "Multiplaktiver Faktor auf den Basiswert des Ansteuerbeginns Zyl7 bei aktiver Pii2" VALUE 0xDB6C0 Kw_Ws16 1.000000 Fact1 0.00 1.000000 FORMAT "%8.6" EXTENDED_LIMITS -256.0000 255.9922 /end CHARACTERISTIC
/begin CHARACTERISTIC InjCrv_facphiMI1CylOffs28_C "Multiplaktiver Faktor auf den Basiswert des Ansteuerbeginns Zyl8 bei aktiver Pii2" VALUE 0xDB6C2 Kw_Ws16 1.000000 Fact1 0.00 1.000000 FORMAT "%8.6" EXTENDED_LIMITS -256.0000 255.9922 /end CHARACTERISTIC
/begin CHARACTERISTIC InjCrv_facphiMI1CylOffs1_C "Multiplaktiver Faktor auf den Basiswert des Ansteuerbeginns Zyl1" VALUE 0xDB6C4 Kw_Ws16 1.000000 Fact1 0.00 1.000000 FORMAT "%8.6" EXTENDED_LIMITS -256.0000 255.9922 /end CHARACTERISTIC
/begin CHARACTERISTIC InjCrv_facphiMI1CylOffs2_C "Multiplaktiver Faktor auf den Basiswert des Ansteuerbeginns Zyl2" VALUE 0xDB6C6 Kw_Ws16 1.000000 Fact1 0.00 1.000000 FORMAT "%8.6" EXTENDED_LIMITS -256.0000 255.9922 /end CHARACTERISTIC
/begin CHARACTERISTIC InjCrv_facphiMI1CylOffs3_C "Multiplaktiver Faktor auf den Basiswert des Ansteuerbeginns Zyl3" VALUE 0xDB6C8 Kw_Ws16 1.000000 Fact1 0.00 1.000000 FORMAT "%8.6" EXTENDED_LIMITS -256.0000 255.9922 /end CHARACTERISTIC
/begin CHARACTERISTIC InjCrv_facphiMI1CylOffs4_C "Multiplaktiver Faktor auf den Basiswert des Ansteuerbeginns Zyl4" VALUE 0xDB6CA Kw_Ws16 1.000000 Fact1 0.00 1.000000 FORMAT "%8.6" EXTENDED_LIMITS -256.0000 255.9922 /end CHARACTERISTIC
/begin CHARACTERISTIC InjCrv_facphiMI1CylOffs5_C "Multiplaktiver Faktor auf den Basiswert des Ansteuerbeginns Zyl5" VALUE 0xDB6CC Kw_Ws16 1.000000 Fact1 0.00 1.000000 FORMAT "%8.6" EXTENDED_LIMITS -256.0000 255.9922 /end CHARACTERISTIC
/begin CHARACTERISTIC InjCrv_facphiMI1CylOffs6_C "Multiplaktiver Faktor auf den Basiswert des Ansteuerbeginns Zyl6" VALUE 0xDB6CE Kw_Ws16 1.000000 Fact1 0.00 1.000000 FORMAT "%8.6" EXTENDED_LIMITS -256.0000 255.9922 /end CHARACTERISTIC
/begin CHARACTERISTIC InjCrv_facphiMI1CylOffs7_C "Multiplaktiver Faktor auf den Basiswert des Ansteuerbeginns Zyl7" VALUE 0xDB6D0 Kw_Ws16 1.000000 Fact1 0.00 1.000000 FORMAT "%8.6" EXTENDED_LIMITS -256.0000 255.9922 /end CHARACTERISTIC
/begin CHARACTERISTIC InjCrv_facphiMI1CylOffs8_C "Multiplaktiver Faktor auf den Basiswert des Ansteuerbeginns Zyl8" VALUE 0xDB6D2 Kw_Ws16 1.000000 Fact1 0.00 1.000000 FORMAT "%8.6" EXTENDED_LIMITS -256.0000 255.9922 /end CHARACTERISTIC
/begin CHARACTERISTIC InjCrv_facPiI1QntMax_C "Wichtungsfaktor für die berechnete Sollmenge der Voreinspritzung 1" VALUE 0xE12F0 Kw_Ws16 1.000000 Fact1 0.00 1.000000 FORMAT "%8.6" EXTENDED_LIMITS -256.0000 255.9922 /end CHARACTERISTIC
/begin CHARACTERISTIC InjCrv_facPiI1QntMin_CUR "raildruckabhängige Kennlinie zur Ermittlung des Faktor fuer die Berechnung der Mindestmenge um die PiI1 abzuschalten" CURVE 0xDFE98 Kl_Xs16_Ws16 1.000000 Fact1 0.00 1.000000 FORMAT "%8.6" EXTENDED_LIMITS -256.0000 255.9922
 /begin AXIS_DESCR STD_AXIS RailCD_pPeak Pres_Rail 8 0.00 2000.000 FORMAT "%5.3" EXTENDED_LIMITS -3276.800 3276.700 DEPOSIT ABSOLUTE /end AXIS_DESCR
/end CHARACTERISTIC
/begin CHARACTERISTIC InjCrv_facPiI2APSQCorStrt_CUR "weighting factor of atmospheric pressure for PiI2 quantity correction" CURVE 0xE1D14 Kl_Xs16_Ws16 1.000000 Fact 0.00 1.000000 FORMAT "%8.6" EXTENDED_LIMITS -4.000000 3.999878
 /begin AXIS_DESCR STD_AXIS APSCD_pVal Pres_hPa 10 0.00 3500.000 FORMAT "%8.3" EXTENDED_LIMITS -32768.00 32767.00 DEPOSIT ABSOLUTE /end AXIS_DESCR
/end CHARACTERISTIC
/begin CHARACTERISTIC InjCrv_facPiI2APSQCor_CUR "atmosphärendruckabhängige Mengenkorrekturkennlinie für Voreinspritzung 2" CURVE 0xE1D3E Kl_Xs16_Ws16 1.000000 Fact 0.00 1.000000 FORMAT "%8.6" EXTENDED_LIMITS -4.000000 3.999878
 /begin AXIS_DESCR STD_AXIS APSCD_pVal Pres_hPa 10 0.00 3500.000 FORMAT "%8.3" EXTENDED_LIMITS -32768.00 32767.00 DEPOSIT ABSOLUTE /end AXIS_DESCR
/end CHARACTERISTIC
/begin CHARACTERISTIC InjCrv_facPiI2APSSOECorStrt_CUR "Korrekturkennlinie für das Timing der 2. Voreinspritzung während des Startvorganges" CURVE 0xE1D68 Kl_Xs16_Ws16 1.000000 Fact 0.00 1.000000 FORMAT "%8.6" EXTENDED_LIMITS -4.000000 3.999878
 /begin AXIS_DESCR STD_AXIS APSCD_pVal Pres_hPa 6 0.00 3500.000 FORMAT "%8.3" EXTENDED_LIMITS -32768.00 32767.00 DEPOSIT ABSOLUTE /end AXIS_DESCR
/end CHARACTERISTIC
/begin CHARACTERISTIC InjCrv_facPiI2APSSOECor_CUR "kundenspezifische atmosphärendruckabhängige Gewichtungskennlinie der Spritzbeginnkorrektur der PiI2" CURVE 0xE1D82 Kl_Xs16_Ws16 1.000000 Fact 0.00 1.000000 FORMAT "%8.6" EXTENDED_LIMITS -4.000000 3.999878
 /begin AXIS_DESCR STD_AXIS APSCD_pVal Pres_hPa 6 0.00 3500.000 FORMAT "%8.3" EXTENDED_LIMITS -32768.00 32767.00 DEPOSIT ABSOLUTE /end AXIS_DESCR
/end CHARACTERISTIC
/begin CHARACTERISTIC InjCrv_facPiI2ATSQCorStrt_CUR "weighting factor of intake air temperature for PiI2 quantity correction" CURVE 0xE1D9C Kl_Xs16_Ws16 1.000000 Fact 0.00 1.000000 FORMAT "%8.6" EXTENDED_LIMITS -4.000000 3.999878
 /begin AXIS_DESCR STD_AXIS IATSCD_tAir Temp_Cels 10 -50.14000 199.8600 FORMAT "%8.4" EXTENDED_LIMITS -3549.940 3003.560 DEPOSIT ABSOLUTE /end AXIS_DESCR
/end CHARACTERISTIC
/begin CHARACTERISTIC InjCrv_facPiI2ATSQCor_CUR "ansauglufttemperaturabhängige Mengenkorrekturkennlinie für Voreinspritzung 2" CURVE 0xE1DC6 Kl_Xs16_Ws16 1.000000 Fact 0.00 1.000000 FORMAT "%8.6" EXTENDED_LIMITS -4.000000 3.999878
 /begin AXIS_DESCR STD_AXIS IATSCD_tAir Temp_Cels 10 -50.14000 199.8600 FORMAT "%8.4" EXTENDED_LIMITS -3549.940 3003.560 DEPOSIT ABSOLUTE /end AXIS_DESCR
/end CHARACTERISTIC
/begin CHARACTERISTIC InjCrv_facPiI2ETSQCorStrt_CUR "weighting factor of engine temperature for PiI2 quantity correction" CURVE 0xE1DF0 Kl_Xs16_Ws16 1.000000 Fact 0.00 1.000000 FORMAT "%8.6" EXTENDED_LIMITS -4.000000 3.999878
 /begin AXIS_DESCR STD_AXIS InjCrv_tEng Temp_Cels 10 -50.14000 199.8600 FORMAT "%8.4" EXTENDED_LIMITS -3549.940 3003.560 DEPOSIT ABSOLUTE /end AXIS_DESCR
/end CHARACTERISTIC
/begin CHARACTERISTIC InjCrv_facPiI2ETSQCor_CUR "motortemperaturabhängige Mengenkorrekturkennlinie für Voreinspritzung 2" CURVE 0xE1E1A Kl_Xs16_Ws16 1.000000 Fact 0.00 1.000000 FORMAT "%8.6" EXTENDED_LIMITS -4.000000 3.999878
 /begin AXIS_DESCR STD_AXIS InjCrv_tEng Temp_Cels 10 -50.14000 199.8600 FORMAT "%8.4" EXTENDED_LIMITS -3549.940 3003.560 DEPOSIT ABSOLUTE /end AXIS_DESCR
/end CHARACTERISTIC
/begin CHARACTERISTIC InjCrv_facPiI2ETSSOECorStrt_CUR "motortemperaturabhängige Ansteuerbeginnkorrekturkennlinie für Voreinspritzung 2 im Startfall" CURVE 0xE1E44 Kl_Xs16_Ws16 1.000000 Fact 0.00 1.000000 FORMAT "%8.6" EXTENDED_LIMITS -4.000000 3.999878
 /begin AXIS_DESCR STD_AXIS InjCrv_tEng Temp_Cels 10 -50.14000 199.8600 FORMAT "%8.4" EXTENDED_LIMITS -3549.940 3003.560 DEPOSIT ABSOLUTE /end AXIS_DESCR
/end CHARACTERISTIC
/begin CHARACTERISTIC InjCrv_facPiI2ETSSOECor_CUR "motortemperaturabhängige Ansteuerbeginnkorrekturkennlinie für Voreinspritzung 2" CURVE 0xE1E6E Kl_Xs16_Ws16 1.000000 Fact 0.00 1.000000 FORMAT "%8.6" EXTENDED_LIMITS -4.000000 3.999878
 /begin AXIS_DESCR STD_AXIS InjCrv_tEng Temp_Cels 10 -50.14000 199.8600 FORMAT "%8.4" EXTENDED_LIMITS -3549.940 3003.560 DEPOSIT ABSOLUTE /end AXIS_DESCR
/end CHARACTERISTIC
/begin CHARACTERISTIC InjCrv_facPiI2QntMin_CUR "Faktor zur Berechnung der Mindestmenge fuer die Abschaltung der Voreinspritzung PiI2" CURVE 0xE12F2 Kl_Xs16_Ws16 1.000000 Fact1 0.00 1.000000 FORMAT "%8.6" EXTENDED_LIMITS -256.0000 255.9922
 /begin AXIS_DESCR STD_AXIS RailCD_pPeak Pres_Rail 8 0.00 2000.000 FORMAT "%5.3" EXTENDED_LIMITS -3276.800 3276.700 DEPOSIT ABSOLUTE /end AXIS_DESCR
/end CHARACTERISTIC
/begin CHARACTERISTIC InjCrv_facqPiI1CylOffs21_C "Multiplaktiver Faktor auf den Basiswert der Einspritzmenge Zyl1 bei aktiver Pii2" VALUE 0xDB6D4 Kw_Ws16 1.000000 Fact1 0.00 1.000000 FORMAT "%8.6" EXTENDED_LIMITS -256.0000 255.9922 /end CHARACTERISTIC
/begin CHARACTERISTIC InjCrv_facqPiI1CylOffs22_C "Multiplaktiver Faktor auf den Basiswert der Einspritzmenge Zyl2 bei aktiver Pii2" VALUE 0xDB6D6 Kw_Ws16 1.000000 Fact1 0.00 1.000000 FORMAT "%8.6" EXTENDED_LIMITS -256.0000 255.9922 /end CHARACTERISTIC
/begin CHARACTERISTIC InjCrv_facqPiI1CylOffs23_C "Multiplaktiver Faktor auf den Basiswert der Einspritzmenge Zyl3 bei aktiver Pii2" VALUE 0xDB6D8 Kw_Ws16 1.000000 Fact1 0.00 1.000000 FORMAT "%8.6" EXTENDED_LIMITS -256.0000 255.9922 /end CHARACTERISTIC
/begin CHARACTERISTIC InjCrv_facqPiI1CylOffs24_C "Multiplaktiver Faktor auf den Basiswert der Einspritzmenge Zyl4 bei aktiver Pii2" VALUE 0xDB6DA Kw_Ws16 1.000000 Fact1 0.00 1.000000 FORMAT "%8.6" EXTENDED_LIMITS -256.0000 255.9922 /end CHARACTERISTIC
/begin CHARACTERISTIC InjCrv_facqPiI1CylOffs25_C "Multiplaktiver Faktor auf den Basiswert der Einspritzmenge Zyl5 bei aktiver Pii2" VALUE 0xDB6DC Kw_Ws16 1.000000 Fact1 0.00 1.000000 FORMAT "%8.6" EXTENDED_LIMITS -256.0000 255.9922 /end CHARACTERISTIC
/begin CHARACTERISTIC InjCrv_facqPiI1CylOffs26_C "Multiplaktiver Faktor auf den Basiswert der Einspritzmenge Zyl6 bei aktiver Pii2" VALUE 0xDB6DE Kw_Ws16 1.000000 Fact1 0.00 1.000000 FORMAT "%8.6" EXTENDED_LIMITS -256.0000 255.9922 /end CHARACTERISTIC
/begin CHARACTERISTIC InjCrv_facqPiI1CylOffs27_C "Multiplaktiver Faktor auf den Basiswert der Einspritzmenge Zyl7 bei aktiver Pii2" VALUE 0xDB6E0 Kw_Ws16 1.000000 Fact1 0.00 1.000000 FORMAT "%8.6" EXTENDED_LIMITS -256.0000 255.9922 /end CHARACTERISTIC
/begin CHARACTERISTIC InjCrv_facqPiI1CylOffs28_C "Multiplaktiver Faktor auf den Basiswert der Einspritzmenge Zyl8 bei aktiver Pii2" VALUE 0xDB6E2 Kw_Ws16 1.000000 Fact1 0.00 1.000000 FORMAT "%8.6" EXTENDED_LIMITS -256.0000 255.9922 /end CHARACTERISTIC
/begin CHARACTERISTIC InjCrv_facqPiI1CylOffs1_C "Multiplaktiver Faktor auf den Basiswert der Einspritzmenge für Zyl1" VALUE 0xDB6E4 Kw_Ws16 1.000000 Fact1 0.00 1.000000 FORMAT "%8.6" EXTENDED_LIMITS -256.0000 255.9922 /end CHARACTERISTIC
/begin CHARACTERISTIC InjCrv_facqPiI1CylOffs2_C "Multiplaktiver Faktor auf den Basiswert der Einspritzmenge für Zyl2" VALUE 0xDB6E6 Kw_Ws16 1.000000 Fact1 0.00 1.000000 FORMAT "%8.6" EXTENDED_LIMITS -256.0000 255.9922 /end CHARACTERISTIC
/begin CHARACTERISTIC InjCrv_facqPiI1CylOffs3_C "Multiplaktiver Faktor auf den Basiswert der Einspritzmenge für Zyl3" VALUE 0xDB6E8 Kw_Ws16 1.000000 Fact1 0.00 1.000000 FORMAT "%8.6" EXTENDED_LIMITS -256.0000 255.9922 /end CHARACTERISTIC
/begin CHARACTERISTIC InjCrv_facqPiI1CylOffs4_C "Multiplaktiver Faktor auf den Basiswert der Einspritzmenge für Zyl4" VALUE 0xDB6EA Kw_Ws16 1.000000 Fact1 0.00 1.000000 FORMAT "%8.6" EXTENDED_LIMITS -256.0000 255.9922 /end CHARACTERISTIC
/begin CHARACTERISTIC InjCrv_facqPiI1CylOffs5_C "Multiplaktiver Faktor auf den Basiswert der Einspritzmenge für Zyl5" VALUE 0xDB6EC Kw_Ws16 1.000000 Fact1 0.00 1.000000 FORMAT "%8.6" EXTENDED_LIMITS -256.0000 255.9922 /end CHARACTERISTIC
/begin CHARACTERISTIC InjCrv_facqPiI1CylOffs6_C "Multiplaktiver Faktor auf den Basiswert der Einspritzmenge für Zyl6" VALUE 0xDB6EE Kw_Ws16 1.000000 Fact1 0.00 1.000000 FORMAT "%8.6" EXTENDED_LIMITS -256.0000 255.9922 /end CHARACTERISTIC
/begin CHARACTERISTIC InjCrv_facqPiI1CylOffs7_C "Multiplaktiver Faktor auf den Basiswert der Einspritzmenge für Zyl7" VALUE 0xDB6F0 Kw_Ws16 1.000000 Fact1 0.00 1.000000 FORMAT "%8.6" EXTENDED_LIMITS -256.0000 255.9922 /end CHARACTERISTIC
/begin CHARACTERISTIC InjCrv_facqPiI1CylOffs8_C "Multiplaktiver Faktor auf den Basiswert der Einspritzmenge für Zyl8" VALUE 0xDB6F2 Kw_Ws16 1.000000 Fact1 0.00 1.000000 FORMAT "%8.6" EXTENDED_LIMITS -256.0000 255.9922 /end CHARACTERISTIC
/begin CHARACTERISTIC InjCrv_factiPiI1CylOffs21_C "Multiplaktiver Faktor auf den Basiswert des Ansteuerbeginns Zyl1 bei aktiver Pii2" VALUE 0xDB6F4 Kw_Ws16 1.000000 Fact1 0.00 1.000000 FORMAT "%8.6" EXTENDED_LIMITS -256.0000 255.9922 /end CHARACTERISTIC
/begin CHARACTERISTIC InjCrv_factiPiI1CylOffs22_C "Multiplaktiver Faktor auf den Basiswert des Ansteuerbeginns Zyl2 bei aktiver Pii2" VALUE 0xDB6F6 Kw_Ws16 1.000000 Fact1 0.00 1.000000 FORMAT "%8.6" EXTENDED_LIMITS -256.0000 255.9922 /end CHARACTERISTIC
/begin CHARACTERISTIC InjCrv_factiPiI1CylOffs23_C "Multiplaktiver Faktor auf den Basiswert des Ansteuerbeginns Zyl3 bei aktiver Pii2" VALUE 0xDB6F8 Kw_Ws16 1.000000 Fact1 0.00 1.000000 FORMAT "%8.6" EXTENDED_LIMITS -256.0000 255.9922 /end CHARACTERISTIC
/begin CHARACTERISTIC InjCrv_factiPiI1CylOffs24_C "Multiplaktiver Faktor auf den Basiswert des Ansteuerbeginns Zyl4 bei aktiver Pii2" VALUE 0xDB6FA Kw_Ws16 1.000000 Fact1 0.00 1.000000 FORMAT "%8.6" EXTENDED_LIMITS -256.0000 255.9922 /end CHARACTERISTIC
/begin CHARACTERISTIC InjCrv_factiPiI1CylOffs25_C "Multiplaktiver Faktor auf den Basiswert des Ansteuerbeginns Zyl5 bei aktiver Pii2" VALUE 0xDB6FC Kw_Ws16 1.000000 Fact1 0.00 1.000000 FORMAT "%8.6" EXTENDED_LIMITS -256.0000 255.9922 /end CHARACTERISTIC
/begin CHARACTERISTIC InjCrv_factiPiI1CylOffs26_C "Multiplaktiver Faktor auf den Basiswert des Ansteuerbeginns Zyl6 bei aktiver Pii2" VALUE 0xDB6FE Kw_Ws16 1.000000 Fact1 0.00 1.000000 FORMAT "%8.6" EXTENDED_LIMITS -256.0000 255.9922 /end CHARACTERISTIC
/begin CHARACTERISTIC InjCrv_factiPiI1CylOffs27_C "Multiplaktiver Faktor auf den Basiswert des Ansteuerbeginns Zyl7 bei aktiver Pii2" VALUE 0xDB700 Kw_Ws16 1.000000 Fact1 0.00 1.000000 FORMAT "%8.6" EXTENDED_LIMITS -256.0000 255.9922 /end CHARACTERISTIC
/begin CHARACTERISTIC InjCrv_factiPiI1CylOffs28_C "Multiplaktiver Faktor auf den Basiswert des Ansteuerbeginns Zyl8 bei aktiver Pii2" VALUE 0xDB702 Kw_Ws16 1.000000 Fact1 0.00 1.000000 FORMAT "%8.6" EXTENDED_LIMITS -256.0000 255.9922 /end CHARACTERISTIC
/begin CHARACTERISTIC InjCrv_factiPiI1CylOffs1_C "Multiplaktiver Faktor auf den Basiswert des Ansteuerbeginns PiI1 für Zyl1" VALUE 0xDB704 Kw_Ws16 1.000000 Fact1 0.00 1.000000 FORMAT "%8.6" EXTENDED_LIMITS -256.0000 255.9922 /end CHARACTERISTIC
/begin CHARACTERISTIC InjCrv_factiPiI1CylOffs2_C "Multiplaktiver Faktor auf den Basiswert des Ansteuerbeginns PiI1 für Zyl2" VALUE 0xDB706 Kw_Ws16 1.000000 Fact1 0.00 1.000000 FORMAT "%8.6" EXTENDED_LIMITS -256.0000 255.9922 /end CHARACTERISTIC
/begin CHARACTERISTIC InjCrv_factiPiI1CylOffs3_C "Multiplaktiver Faktor auf den Basiswert des Ansteuerbeginns PiI1 für Zyl3" VALUE 0xDB708 Kw_Ws16 1.000000 Fact1 0.00 1.000000 FORMAT "%8.6" EXTENDED_LIMITS -256.0000 255.9922 /end CHARACTERISTIC
/begin CHARACTERISTIC InjCrv_factiPiI1CylOffs4_C "Multiplaktiver Faktor auf den Basiswert des Ansteuerbeginns PiI1 für Zyl4" VALUE 0xDB70A Kw_Ws16 1.000000 Fact1 0.00 1.000000 FORMAT "%8.6" EXTENDED_LIMITS -256.0000 255.9922 /end CHARACTERISTIC
/begin CHARACTERISTIC InjCrv_factiPiI1CylOffs5_C "Multiplaktiver Faktor auf den Basiswert des Ansteuerbeginns PiI1 für Zyl5" VALUE 0xDB70C Kw_Ws16 1.000000 Fact1 0.00 1.000000 FORMAT "%8.6" EXTENDED_LIMITS -256.0000 255.9922 /end CHARACTERISTIC
/begin CHARACTERISTIC InjCrv_factiPiI1CylOffs6_C "Multiplaktiver Faktor auf den Basiswert des Ansteuerbeginns PiI1 für Zyl6" VALUE 0xDB70E Kw_Ws16 1.000000 Fact1 0.00 1.000000 FORMAT "%8.6" EXTENDED_LIMITS -256.0000 255.9922 /end CHARACTERISTIC
/begin CHARACTERISTIC InjCrv_factiPiI1CylOffs7_C "Multiplaktiver Faktor auf den Basiswert des Ansteuerbeginns PiI1 für Zyl7" VALUE 0xDB710 Kw_Ws16 1.000000 Fact1 0.00 1.000000 FORMAT "%8.6" EXTENDED_LIMITS -256.0000 255.9922 /end CHARACTERISTIC
/begin CHARACTERISTIC InjCrv_factiPiI1CylOffs8_C "Multiplaktiver Faktor auf den Basiswert des Ansteuerbeginns PiI1 für Zyl8" VALUE 0xDB712 Kw_Ws16 1.000000 Fact1 0.00 1.000000 FORMAT "%8.6" EXTENDED_LIMITS -256.0000 255.9922 /end CHARACTERISTIC
/begin CHARACTERISTIC InjCrv_factiPiI2CylOffs21_C "Multiplaktiver Faktor auf den Basiswert des Ansteuerbeginns Zyl1 bei aktiver Pii2" VALUE 0xDB714 Kw_Ws16 1.000000 Fact1 0.00 1.000000 FORMAT "%8.6" EXTENDED_LIMITS -256.0000 255.9922 /end CHARACTERISTIC
/begin CHARACTERISTIC InjCrv_factiPiI2CylOffs22_C "Multiplaktiver Faktor auf den Basiswert des Ansteuerbeginns Zyl2 bei aktiver Pii2" VALUE 0xDB716 Kw_Ws16 1.000000 Fact1 0.00 1.000000 FORMAT "%8.6" EXTENDED_LIMITS -256.0000 255.9922 /end CHARACTERISTIC
/begin CHARACTERISTIC InjCrv_factiPiI2CylOffs23_C "Multiplaktiver Faktor auf den Basiswert des Ansteuerbeginns Zyl3 bei aktiver Pii2" VALUE 0xDB718 Kw_Ws16 1.000000 Fact1 0.00 1.000000 FORMAT "%8.6" EXTENDED_LIMITS -256.0000 255.9922 /end CHARACTERISTIC
/begin CHARACTERISTIC InjCrv_factiPiI2CylOffs24_C "Multiplaktiver Faktor auf den Basiswert des Ansteuerbeginns Zyl4 bei aktiver Pii2" VALUE 0xDB71A Kw_Ws16 1.000000 Fact1 0.00 1.000000 FORMAT "%8.6" EXTENDED_LIMITS -256.0000 255.9922 /end CHARACTERISTIC
/begin CHARACTERISTIC InjCrv_factiPiI2CylOffs25_C "Multiplaktiver Faktor auf den Basiswert des Ansteuerbeginns Zyl5 bei aktiver Pii2" VALUE 0xDB71C Kw_Ws16 1.000000 Fact1 0.00 1.000000 FORMAT "%8.6" EXTENDED_LIMITS -256.0000 255.9922 /end CHARACTERISTIC
/begin CHARACTERISTIC InjCrv_factiPiI2CylOffs26_C "Multiplaktiver Faktor auf den Basiswert des Ansteuerbeginns Zyl6 bei aktiver Pii2" VALUE 0xDB71E Kw_Ws16 1.000000 Fact1 0.00 1.000000 FORMAT "%8.6" EXTENDED_LIMITS -256.0000 255.9922 /end CHARACTERISTIC
/begin CHARACTERISTIC InjCrv_factiPiI2CylOffs27_C "Multiplaktiver Faktor auf den Basiswert des Ansteuerbeginns Zyl7 bei aktiver Pii2" VALUE 0xDB720 Kw_Ws16 1.000000 Fact1 0.00 1.000000 FORMAT "%8.6" EXTENDED_LIMITS -256.0000 255.9922 /end CHARACTERISTIC
/begin CHARACTERISTIC InjCrv_factiPiI2CylOffs28_C "Multiplaktiver Faktor auf den Basiswert des Ansteuerbeginns Zyl8 bei aktiver Pii2" VALUE 0xDB722 Kw_Ws16 1.000000 Fact1 0.00 1.000000 FORMAT "%8.6" EXTENDED_LIMITS -256.0000 255.9922 /end CHARACTERISTIC
/begin CHARACTERISTIC InjCrv_tiLowNegPT1_C "dq filter time constant neg. slope low range" VALUE 0xDD660 Kw_Wu32 4294.9673 TimeDelay_s 0.0000010000000 4294.9673 FORMAT "%9.4" /end CHARACTERISTIC
/begin CHARACTERISTIC InjCrv_tiLowPosPT1_C "dq filter time constant pos. slope low range" VALUE 0xDD664 Kw_Wu32 4294.9673 TimeDelay_s 0.0000010000000 4294.9673 FORMAT "%9.4" /end CHARACTERISTIC
/begin CHARACTERISTIC InjCrv_tiMidNegPT1_C "dq filter time constant neg. slope middle range" VALUE 0xDD668 Kw_Wu32 4294.9673 TimeDelay_s 0.0000010000000 4294.9673 FORMAT "%9.4" /end CHARACTERISTIC
/begin CHARACTERISTIC InjCrv_tiMidPosPT1_C "dq filter time constant pos. slope middle range" VALUE 0xDD66C Kw_Wu32 4294.9673 TimeDelay_s 0.0000010000000 4294.9673 FORMAT "%9.4" /end CHARACTERISTIC
/begin CHARACTERISTIC InjCrv_tiUppNegPT1_C "dq filter time constant neg. slope upper range" VALUE 0xDD670 Kw_Wu32 4294.9673 TimeDelay_s 0.0000010000000 4294.9673 FORMAT "%9.4" /end CHARACTERISTIC
/begin CHARACTERISTIC InjCrv_tiUppPosPT1_C "dq filter time constant pos. slope upper range" VALUE 0xDD674 Kw_Wu32 4294.9673 TimeDelay_s 0.0000010000000 4294.9673 FORMAT "%9.4" /end CHARACTERISTIC
/begin CHARACTERISTIC InjCrv_tiDT1DQMISOECor2_C "reciprocal of time delay DT1" VALUE 0xDD678 Kw_Wu32 4294.9673 TimeDelay_s 0.0000010000000 4294.9673 FORMAT "%9.4" /end CHARACTERISTIC
/begin CHARACTERISTIC InjCrv_KdDT1DQMISOECor2_C "Diffenrential factor Kd q DT1 filter" VALUE 0xDD67C Kw_Ws32 3276799.99924 Kd_PerSec_20ms -1638400.00000 1638399.99924 FORMAT "%13.5" /end CHARACTERISTIC
/begin CHARACTERISTIC InjCrv_tiDpCorrDT1_C "DT1-Paramter für Atmosphärendruckfilterung" VALUE 0xDD564 Kw_Wu32 4294.9673 TimeDelay_s 0.0000010000000 4294.9673 FORMAT "%9.4" /end CHARACTERISTIC
/begin CHARACTERISTIC InjCrv_dpCorrDKd_C "DT1-Paramter Atmosphärendruckfilterung" VALUE 0xDD568 Kw_Ws32 32767.9999924 Kd_Pres2dpdt -16384.0000000 16383.9999924 FORMAT "%13.7" /end CHARACTERISTIC
/begin CHARACTERISTIC InjCrv_nDiffMin_C "Minimaler Drehzahlunterschied für die Freigabe der Voreinspritzung 2" VALUE 0xE1314 Kw_Ws16 6000.000 EngN 0.00 6000.000 FORMAT "%8.3" EXTENDED_LIMITS -32768.00 32767.00 /end CHARACTERISTIC
/begin CHARACTERISTIC InjCrv_nMIDynMax_C "Drehzahlschwelle unter der die Korrektur erfolgt" VALUE 0xDD680 Kw_Ws16 6000.000 EngN 0.00 6000.000 FORMAT "%8.3" EXTENDED_LIMITS -32768.00 32767.00 /end CHARACTERISTIC
/begin CHARACTERISTIC InjCrv_numInjMaxSys_C "#SSD Systembedingte maximal erlaubte Anzahl an Einspritzungen" VALUE 0xDA43E Kw_Wu8 6.000 OneToOne 0.00 6.000 FORMAT "%5.3" EXTENDED_LIMITS 0.00 255.0 /end CHARACTERISTIC
/begin CHARACTERISTIC InjCrv_numInjPoIOff_C "Anzahl Einspritzungen für Sperre der PoI nach Schub" VALUE 0xDA430 Kw_Wu16 65535.00 OneToOne 0.00 65535.00 FORMAT "%8.2" /end CHARACTERISTIC
/begin CHARACTERISTIC InjCrv_pAirCylOffsRlsHigh_C "Oberer Grenzwert Hysterese Luftdruck" VALUE 0xDB724 Kw_Ws16 3500.000 Pres_hPa 0.00 3500.000 FORMAT "%8.3" EXTENDED_LIMITS -32768.00 32767.00 /end CHARACTERISTIC
/begin CHARACTERISTIC InjCrv_pAirCylOffsRlsLow_C "Unterer Grenzwert Hysterese Luftdruck" VALUE 0xDB726 Kw_Ws16 3500.000 Pres_hPa 0.00 3500.000 FORMAT "%8.3" EXTENDED_LIMITS -32768.00 32767.00 /end CHARACTERISTIC
/begin CHARACTERISTIC InjCrv_phiMI1Bas1CBFDC_MAP "1. Grundkennfeld von HE1-SOE für Kompressor-Bypassventil offen, für Sportmodus" MAP 0xDB864 Kf_Xs16_Ys16_Ws16 50.01562 AngleCrS -10.00781 40.00781 FORMAT "%8.5" EXTENDED_LIMITS -768.0000 767.9766
 /begin AXIS_DESCR STD_AXIS Eng_nAvrg EngN 16 0.00 6000.000 FORMAT "%8.3" EXTENDED_LIMITS -32768.00 32767.00 DEPOSIT ABSOLUTE /end AXIS_DESCR
 /begin AXIS_DESCR STD_AXIS InjCtl_qSetUnBal InjMassCyc 16 0.00 327.6700 FORMAT "%8.4" EXTENDED_LIMITS -327.6800 327.6700 DEPOSIT ABSOLUTE /end AXIS_DESCR
/end CHARACTERISTIC
/begin CHARACTERISTIC InjCrv_phiMI1Bas1CB_MAP "Grundwert Ansteuerbeginn, wenn keine PiI aktiv ist bei geoeffnetem Verdichterbypass" MAP 0xDBAA8 Kf_Xs16_Ys16_Ws16 50.01562 AngleCrS -10.00781 40.00781 FORMAT "%8.5" EXTENDED_LIMITS -768.0000 767.9766
 /begin AXIS_DESCR STD_AXIS Eng_nAvrg EngN 16 0.00 6000.000 FORMAT "%8.3" EXTENDED_LIMITS -32768.00 32767.00 DEPOSIT ABSOLUTE /end AXIS_DESCR
 /begin AXIS_DESCR STD_AXIS InjCtl_qSetUnBal InjMassCyc 16 0.00 327.6700 FORMAT "%8.4" EXTENDED_LIMITS -327.6800 327.6700 DEPOSIT ABSOLUTE /end AXIS_DESCR
/end CHARACTERISTIC
/begin CHARACTERISTIC InjCrv_phiMI1Bas1FDC_MAP "1st base map of MI1 SOE for sport mode" MAP 0xDBCEC Kf_Xs16_Ys16_Ws16 50.01562 AngleCrS -10.00781 40.00781 FORMAT "%8.5" EXTENDED_LIMITS -768.0000 767.9766
 /begin AXIS_DESCR STD_AXIS Eng_nAvrg EngN 16 0.00 6000.000 FORMAT "%8.3" EXTENDED_LIMITS -32768.00 32767.00 DEPOSIT ABSOLUTE /end AXIS_DESCR
 /begin AXIS_DESCR STD_AXIS InjCtl_qSetUnBal InjMassCyc 16 0.00 327.6700 FORMAT "%8.4" EXTENDED_LIMITS -327.6800 327.6700 DEPOSIT ABSOLUTE /end AXIS_DESCR
/end CHARACTERISTIC
/begin CHARACTERISTIC InjCrv_phiMI1Bas1_MAP "1. Grundwertekennfeld,  Ansteuerbeginn MI1" MAP 0xDBF30 Kf_Xs16_Ys16_Ws16 1535.977 AngleCrS -768.0000 767.9766 FORMAT "%8.4"
 /begin AXIS_DESCR STD_AXIS Eng_nAvrg EngN 16 0.00 6000.000 FORMAT "%8.3" EXTENDED_LIMITS -32768.00 32767.00 DEPOSIT ABSOLUTE /end AXIS_DESCR
 /begin AXIS_DESCR STD_AXIS InjCtl_qSetUnBal InjMassCyc 16 0.00 327.6700 FORMAT "%8.4" EXTENDED_LIMITS -327.6800 327.6700 DEPOSIT ABSOLUTE /end AXIS_DESCR
/end CHARACTERISTIC
/begin CHARACTERISTIC InjCrv_phiMI1Bas2CBFDC_MAP "2. Grundkennfeld von HE1-SOE für Kompressor-Bypassventil offen, im Sportmodus" MAP 0xDC174 Kf_Xs16_Ys16_Ws16 50.01562 AngleCrS -10.00781 40.00781 FORMAT "%8.5" EXTENDED_LIMITS -768.0000 767.9766
 /begin AXIS_DESCR STD_AXIS Eng_nAvrg EngN 16 0.00 6000.000 FORMAT "%8.3" EXTENDED_LIMITS -32768.00 32767.00 DEPOSIT ABSOLUTE /end AXIS_DESCR
 /begin AXIS_DESCR STD_AXIS InjCtl_qSetUnBal InjMassCyc 16 0.00 327.6700 FORMAT "%8.4" EXTENDED_LIMITS -327.6800 327.6700 DEPOSIT ABSOLUTE /end AXIS_DESCR
/end CHARACTERISTIC
/begin CHARACTERISTIC InjCrv_phiMI1Bas2CB_MAP "Grundwert Ansteuerbeginn, wenn nur PiI1 aktiv ist bei geoeffnetem Verdichterbypass" MAP 0xDC3B8 Kf_Xs16_Ys16_Ws16 50.01562 AngleCrS -10.00781 40.00781 FORMAT "%8.5" EXTENDED_LIMITS -768.0000 767.9766
 /begin AXIS_DESCR STD_AXIS Eng_nAvrg EngN 16 0.00 6000.000 FORMAT "%8.3" EXTENDED_LIMITS -32768.00 32767.00 DEPOSIT ABSOLUTE /end AXIS_DESCR
 /begin AXIS_DESCR STD_AXIS InjCtl_qSetUnBal InjMassCyc 16 0.00 327.6700 FORMAT "%8.4" EXTENDED_LIMITS -327.6800 327.6700 DEPOSIT ABSOLUTE /end AXIS_DESCR
/end CHARACTERISTIC
/begin CHARACTERISTIC InjCrv_phiMI1Bas2FDC_MAP "2nd base map of MI1 SOE for sport mode" MAP 0xDC5FC Kf_Xs16_Ys16_Ws16 50.01562 AngleCrS -10.00781 40.00781 FORMAT "%8.5" EXTENDED_LIMITS -768.0000 767.9766
 /begin AXIS_DESCR STD_AXIS Eng_nAvrg EngN 16 0.00 6000.000 FORMAT "%8.3" EXTENDED_LIMITS -32768.00 32767.00 DEPOSIT ABSOLUTE /end AXIS_DESCR
 /begin AXIS_DESCR STD_AXIS InjCtl_qSetUnBal InjMassCyc 16 0.00 327.6700 FORMAT "%8.4" EXTENDED_LIMITS -327.6800 327.6700 DEPOSIT ABSOLUTE /end AXIS_DESCR
/end CHARACTERISTIC
/begin CHARACTERISTIC InjCrv_phiMI1Bas2_MAP "2. Grundwertekennfeld,  Ansteuerbeginn MI1" MAP 0xDC840 Kf_Xs16_Ys16_Ws16 50.01562 AngleCrS -10.00781 40.00781 FORMAT "%8.5" EXTENDED_LIMITS -768.0000 767.9766
 /begin AXIS_DESCR STD_AXIS Eng_nAvrg EngN 16 0.00 6000.000 FORMAT "%8.3" EXTENDED_LIMITS -32768.00 32767.00 DEPOSIT ABSOLUTE /end AXIS_DESCR
 /begin AXIS_DESCR STD_AXIS InjCtl_qSetUnBal InjMassCyc 16 0.00 327.6700 FORMAT "%8.4" EXTENDED_LIMITS -327.6800 327.6700 DEPOSIT ABSOLUTE /end AXIS_DESCR
/end CHARACTERISTIC
/begin CHARACTERISTIC InjCrv_phiMI1Bas3_MAP "3. Grundwertekennfeld, Ansteuerbeginn MI1" MAP 0xDCA84 Kf_Xs16_Ys16_Ws16 50.01562 AngleCrS -10.00781 40.00781 FORMAT "%8.5" EXTENDED_LIMITS -768.0000 767.9766
 /begin AXIS_DESCR STD_AXIS Eng_nAvrg EngN 16 0.00 6000.000 FORMAT "%8.3" EXTENDED_LIMITS -32768.00 32767.00 DEPOSIT ABSOLUTE /end AXIS_DESCR
 /begin AXIS_DESCR STD_AXIS InjCtl_qSetUnBal InjMassCyc 16 0.00 327.6700 FORMAT "%8.4" EXTENDED_LIMITS -327.6800 327.6700 DEPOSIT ABSOLUTE /end AXIS_DESCR
/end CHARACTERISTIC
/begin CHARACTERISTIC InjCrv_phiMI1Bas4_MAP "4. Grundwertekennfeld, Ansteuerbeginn MI1" MAP 0xDCCC8 Kf_Xs16_Ys16_Ws16 50.01562 AngleCrS -10.00781 40.00781 FORMAT "%8.5" EXTENDED_LIMITS -768.0000 767.9766
 /begin AXIS_DESCR STD_AXIS Eng_nAvrg EngN 16 0.00 6000.000 FORMAT "%8.3" EXTENDED_LIMITS -32768.00 32767.00 DEPOSIT ABSOLUTE /end AXIS_DESCR
 /begin AXIS_DESCR STD_AXIS InjCtl_qSetUnBal InjMassCyc 16 0.00 327.6700 FORMAT "%8.4" EXTENDED_LIMITS -327.6800 327.6700 DEPOSIT ABSOLUTE /end AXIS_DESCR
/end CHARACTERISTIC
/begin CHARACTERISTIC InjCrv_phiMI1Bas5_MAP "5. Grundwertekennfeld, Ansteuerbeginn MI1" MAP 0xDCF0C Kf_Xs16_Ys16_Ws16 50.01562 AngleCrS -10.00781 40.00781 FORMAT "%8.5" EXTENDED_LIMITS -768.0000 767.9766
 /begin AXIS_DESCR STD_AXIS Eng_nAvrg EngN 16 0.00 6000.000 FORMAT "%8.3" EXTENDED_LIMITS -32768.00 32767.00 DEPOSIT ABSOLUTE /end AXIS_DESCR
 /begin AXIS_DESCR STD_AXIS InjCtl_qSetUnBal InjMassCyc 16 0.00 327.6700 FORMAT "%8.4" EXTENDED_LIMITS -327.6800 327.6700 DEPOSIT ABSOLUTE /end AXIS_DESCR
/end CHARACTERISTIC
/begin CHARACTERISTIC InjCrv_phiMI1BasCylOffs_MAP "betriebspunktabhängige Berechnung des Offsets der MI1" MAP 0xDB728 Kf_Xs16_Ys16_Ws16 50.01562 AngleCrS -10.00781 40.00781 FORMAT "%8.5" EXTENDED_LIMITS -768.0000 767.9766
 /begin AXIS_DESCR STD_AXIS Eng_nAvrg EngN 5 0.00 6000.000 FORMAT "%8.3" EXTENDED_LIMITS -32768.00 32767.00 DEPOSIT ABSOLUTE /end AXIS_DESCR
 /begin AXIS_DESCR STD_AXIS InjCtl_qSetUnBal InjMassCyc 5 0.00 327.6700 FORMAT "%8.4" EXTENDED_LIMITS -327.6800 327.6700 DEPOSIT ABSOLUTE /end AXIS_DESCR
/end CHARACTERISTIC
/begin CHARACTERISTIC InjCrv_phiMI1BasStrt_MAP "1st base map of MI1 SOE" MAP 0xDFC54 Kf_Xs16_Ys16_Ws16 50.01562 AngleCrS -10.00781 40.00781 FORMAT "%8.5" EXTENDED_LIMITS -768.0000 767.9766
 /begin AXIS_DESCR STD_AXIS Eng_nAvrg EngN 16 0.00 6000.000 FORMAT "%8.3" EXTENDED_LIMITS -32768.00 32767.00 DEPOSIT ABSOLUTE /end AXIS_DESCR
 /begin AXIS_DESCR STD_AXIS InjCtl_qSetUnBal InjMassCyc 16 0.00 327.6700 FORMAT "%8.4" EXTENDED_LIMITS -327.6800 327.6700 DEPOSIT ABSOLUTE /end AXIS_DESCR
/end CHARACTERISTIC
/begin CHARACTERISTIC InjCrv_phiMI1DesAdd_Vector "#SSD Bypass-Label für additiven Bypass von InjCrv_phiMI1Des (Nicht verstellen!)" VALUE 0xC395A Kw_Wu8 255.0 OneToOne 0.00 255.0 FORMAT "%5.1" /end CHARACTERISTIC
/begin CHARACTERISTIC InjCrv_phiMI1DesAdd_Channel "#SSD Bypass-Label für additiven Bypass von InjCrv_phiMI1Des (Nicht verstellen!)" VALUE 0xC395B Kw_Wu8 255.0 OneToOne 0.00 255.0 FORMAT "%5.1" /end CHARACTERISTIC
/begin CHARACTERISTIC InjCrv_phiMI1Des_Vector "#SSD Bypass-Label für InjCrv_phiMI1Des (Nicht verstellen!)" VALUE 0xC395C Kw_Wu8 255.0 OneToOne 0.00 255.0 FORMAT "%5.1" /end CHARACTERISTIC
/begin CHARACTERISTIC InjCrv_phiMI1Des_Channel "#SSD Bypass-Label für InjCrv_phiMI1Des (Nicht verstellen!)" VALUE 0xC395D Kw_Wu8 255.0 OneToOne 0.00 255.0 FORMAT "%5.1" /end CHARACTERISTIC
/begin CHARACTERISTIC InjCrv_phiMI1DynCor2_MAP "Basiskorrekturkennfeld für MI bei SOE Korrektur 2" MAP 0xDD682 Kf_Xs16_Ys16_Ws16 50.01562 AngleCrS -25.00781 25.00781 FORMAT "%8.5" EXTENDED_LIMITS -768.0000 767.9766
 /begin AXIS_DESCR STD_AXIS Eng_nAvrg EngN 16 0.00 6000.000 FORMAT "%8.3" EXTENDED_LIMITS -32768.00 32767.00 DEPOSIT ABSOLUTE /end AXIS_DESCR
 /begin AXIS_DESCR STD_AXIS InjCtl_qSetUnBal InjMassCyc 8 0.00 327.6700 FORMAT "%8.4" EXTENDED_LIMITS -327.6800 327.6700 DEPOSIT ABSOLUTE /end AXIS_DESCR
/end CHARACTERISTIC
/begin CHARACTERISTIC InjCrv_phiMI1Max2_MAP "#SSD Kennfeld -2 für frühesten Ansteuerbeginn MI1" MAP 0xDD150 Gkf_Ws16 50.01562 AngleCrS -10.00781 40.00781 FORMAT "%8.5" EXTENDED_LIMITS -768.0000 767.9766
 /begin AXIS_DESCR COM_AXIS Eng_nAvrg EngN 8 0.00 6000.000 FORMAT "%8.3" EXTENDED_LIMITS -32768.00 32767.00 AXIS_PTS_REF InjCrv_phiMI1Max_X_AXIS /end AXIS_DESCR
 /begin AXIS_DESCR COM_AXIS InjCtl_qSetUnBal InjMassCyc 8 0.00 327.6700 FORMAT "%8.4" EXTENDED_LIMITS -327.6800 327.6700 AXIS_PTS_REF InjCrv_phiMI1Max_Y_AXIS /end AXIS_DESCR
/end CHARACTERISTIC
/begin CHARACTERISTIC InjCrv_phiMI1Max_MAP "#SSD frühester Ansteuerbeginn der MI1" MAP 0xDD1D0 Gkf_Ws16 50.01562 AngleCrS -10.00781 40.00781 FORMAT "%8.5" EXTENDED_LIMITS -768.0000 767.9766
 /begin AXIS_DESCR COM_AXIS Eng_nAvrg EngN 8 0.00 6000.000 FORMAT "%8.3" EXTENDED_LIMITS -32768.00 32767.00 AXIS_PTS_REF InjCrv_phiMI1Max_X_AXIS /end AXIS_DESCR
 /begin AXIS_DESCR COM_AXIS InjCtl_qSetUnBal InjMassCyc 8 0.00 327.6700 FORMAT "%8.4" EXTENDED_LIMITS -327.6800 327.6700 AXIS_PTS_REF InjCrv_phiMI1Max_Y_AXIS /end AXIS_DESCR
/end CHARACTERISTIC
/begin AXIS_PTS InjCrv_phiMI1Max_X_AXIS "gemeinsame X-Achse der Kennfelder für frühesten Ansteuerbeginn für MI" 0xDD250 Eng_nAvrg GSst_Xs16 6000.000 EngN 8 0.00 6000.000 FORMAT "%8.3" EXTENDED_LIMITS -32768.00 32767.00 DEPOSIT ABSOLUTE /end AXIS_PTS
/begin AXIS_PTS InjCrv_phiMI1Max_Y_AXIS "gemeinsame Y-Achse der Kennfelder für frühesten Ansteuerbeginn für MI" 0xDD262 InjCtl_qSetUnBal GSst_Xs16 327.6700 InjMassCyc 8 0.00 327.6700 FORMAT "%8.4" EXTENDED_LIMITS -327.6800 327.6700 DEPOSIT ABSOLUTE /end AXIS_PTS
/begin CHARACTERISTIC InjCrv_phiMI1Min_CUR "Curve for limiting the latest SOE of MI1" CURVE 0xDD274 Kl_Xs16_Ws16 1535.977 AngleCrS -768.0000 767.9766 FORMAT "%8.4"
 /begin AXIS_DESCR STD_AXIS InjCrv_tEng Temp_Cels 8 -50.14000 199.8600 FORMAT "%8.4" EXTENDED_LIMITS -3549.940 3003.560 DEPOSIT ABSOLUTE /end AXIS_DESCR
/end CHARACTERISTIC
/begin CHARACTERISTIC InjCrv_phiMI1Rgn1_MAP "Grundkennfeld des Haupteinspritzbeginns bei Regeneration 1" MAP 0xDF518 Kf_Xs16_Ys16_Ws16 50.01562 AngleCrS -10.00781 40.00781 FORMAT "%8.5" EXTENDED_LIMITS -768.0000 767.9766
 /begin AXIS_DESCR STD_AXIS Eng_nAvrg EngN 16 0.00 6000.000 FORMAT "%8.3" EXTENDED_LIMITS -32768.00 32767.00 DEPOSIT ABSOLUTE /end AXIS_DESCR
 /begin AXIS_DESCR STD_AXIS InjCtl_qSetUnBal InjMassCyc 16 0.00 327.6700 FORMAT "%8.4" EXTENDED_LIMITS -327.6800 327.6700 DEPOSIT ABSOLUTE /end AXIS_DESCR
/end CHARACTERISTIC
/begin CHARACTERISTIC InjCrv_phiMI1Rgn2_MAP "Grundkennfeld des Haupteinspritzbeginns bei Regeneration 2" MAP 0xDF75C Kf_Xs16_Ys16_Ws16 50.01562 AngleCrS -10.00781 40.00781 FORMAT "%8.5" EXTENDED_LIMITS -768.0000 767.9766
 /begin AXIS_DESCR STD_AXIS Eng_nAvrg EngN 16 0.00 6000.000 FORMAT "%8.3" EXTENDED_LIMITS -32768.00 32767.00 DEPOSIT ABSOLUTE /end AXIS_DESCR
 /begin AXIS_DESCR STD_AXIS InjCtl_qSetUnBal InjMassCyc 16 0.00 327.6700 FORMAT "%8.4" EXTENDED_LIMITS -327.6800 327.6700 DEPOSIT ABSOLUTE /end AXIS_DESCR
/end CHARACTERISTIC
/begin CHARACTERISTIC InjCrv_phiMI1RgnAdd_Vector "#SSD Bypass-Label für InjCrv_phiMI1RgnAdd_Vector (Nicht verstellen!)" VALUE 0xC3962 Kw_Wu8 255.0 OneToOne 0.00 255.0 FORMAT "%5.1" /end CHARACTERISTIC
/begin CHARACTERISTIC InjCrv_phiMI1RgnAdd_Channel "#SSD Bypass-Label für InjCrv_phiMI1RgnAdd_Channel (Nicht verstellen!)" VALUE 0xC3963 Kw_Wu8 255.0 OneToOne 0.00 255.0 FORMAT "%5.1" /end CHARACTERISTIC
/begin CHARACTERISTIC InjCrv_phiMI1Rgn_Vector "#SSD Bypass-Label, nicht editieren !" VALUE 0xC3964 Kw_Wu8 255.0 OneToOne 0.00 255.0 FORMAT "%5.1" /end CHARACTERISTIC
/begin CHARACTERISTIC InjCrv_phiMI1Rgn_Channel "#SSD Bypass-Label, nicht editieren !" VALUE 0xC3965 Kw_Wu8 255.0 OneToOne 0.00 255.0 FORMAT "%5.1" /end CHARACTERISTIC
/begin CHARACTERISTIC InjCrv_phiMIAPSCor2_MAP "atmosphärentemperaturabhängiger Korrekturkennfeld -2 für Ansteuerbeginn MI1" MAP 0xDD9CC Gkf_Ws16 20.01562 AngleCrS -10.00781 10.00781 FORMAT "%8.5" EXTENDED_LIMITS -768.0000 767.9766
 /begin AXIS_DESCR COM_AXIS Eng_nAvrg EngN 16 0.00 6000.000 FORMAT "%8.3" EXTENDED_LIMITS -32768.00 32767.00 AXIS_PTS_REF InjCrv_phiMIAPSCor_X_AXIS /end AXIS_DESCR
 /begin AXIS_DESCR COM_AXIS InjCtl_qSetUnBal InjMassCyc 16 0.00 327.6700 FORMAT "%8.4" EXTENDED_LIMITS -327.6800 327.6700 AXIS_PTS_REF InjCrv_phiMIAPSCor_Y_AXIS /end AXIS_DESCR
/end CHARACTERISTIC
/begin CHARACTERISTIC InjCrv_phiMIAPSCorStrt_MAP "base value for SOE correction to be weighted by air pressure" MAP 0xDDBCC Kf_Xs16_Ys16_Ws16 20.01562 AngleCrS -10.00781 10.00781 FORMAT "%8.5" EXTENDED_LIMITS -768.0000 767.9766
 /begin AXIS_DESCR STD_AXIS Eng_nAvrg EngN 16 0.00 6000.000 FORMAT "%8.3" EXTENDED_LIMITS -32768.00 32767.00 DEPOSIT ABSOLUTE /end AXIS_DESCR
 /begin AXIS_DESCR STD_AXIS InjCtl_qSetUnBal InjMassCyc 16 0.00 327.6700 FORMAT "%8.4" EXTENDED_LIMITS -327.6800 327.6700 DEPOSIT ABSOLUTE /end AXIS_DESCR
/end CHARACTERISTIC
/begin CHARACTERISTIC InjCrv_phiMIAPSCor_MAP "atmosphärendruckabhängiges Ansteuerbeginnkorrekturkennfeld für MI1" MAP 0xDDE10 Gkf_Ws16 20.01562 AngleCrS -10.00781 10.00781 FORMAT "%8.5" EXTENDED_LIMITS -768.0000 767.9766
 /begin AXIS_DESCR COM_AXIS Eng_nAvrg EngN 16 0.00 6000.000 FORMAT "%8.3" EXTENDED_LIMITS -32768.00 32767.00 AXIS_PTS_REF InjCrv_phiMIAPSCor_X_AXIS /end AXIS_DESCR
 /begin AXIS_DESCR COM_AXIS InjCtl_qSetUnBal InjMassCyc 16 0.00 327.6700 FORMAT "%8.4" EXTENDED_LIMITS -327.6800 327.6700 AXIS_PTS_REF InjCrv_phiMIAPSCor_Y_AXIS /end AXIS_DESCR
/end CHARACTERISTIC
/begin AXIS_PTS InjCrv_phiMIAPSCor_X_AXIS "gemeinsame X-Achse für atmosphärendruckabhängige Ansteuerbeginnkorrekturkennfelder für MI" 0xDE010 Eng_nAvrg GSst_Xs16 6000.000 EngN 16 0.00 6000.000 FORMAT "%8.3" EXTENDED_LIMITS -32768.00 32767.00 DEPOSIT ABSOLUTE /end AXIS_PTS
/begin AXIS_PTS InjCrv_phiMIAPSCor_Y_AXIS "gemeinsame Y-Achse für atmosphärendruckabhängige Ansteuerbeginnkorrekturkennfelder für MI" 0xDE032 InjCtl_qSetUnBal GSst_Xs16 327.6700 InjMassCyc 16 0.00 327.6700 FORMAT "%8.4" EXTENDED_LIMITS -327.6800 327.6700 DEPOSIT ABSOLUTE /end AXIS_PTS
/begin CHARACTERISTIC InjCrv_phiMIAPSDynCor_MAP "Korrekturkennfeld für Ansteuerbeginn der Haupteinspritzung" MAP 0xDD7B6 Kf_Xs16_Ys16_Ws16 50.01562 AngleCrS -25.00781 25.00781 FORMAT "%8.5" EXTENDED_LIMITS -768.0000 767.9766
 /begin AXIS_DESCR STD_AXIS Eng_nAvrg EngN 4 0.00 6000.000 FORMAT "%8.3" EXTENDED_LIMITS -32768.00 32767.00 DEPOSIT ABSOLUTE /end AXIS_DESCR
 /begin AXIS_DESCR STD_AXIS InjCrv_dpMIDynCor dp_dZ20 4 -1000.000 1000.000 FORMAT "%8.3" EXTENDED_LIMITS -327680.0 327670.0 DEPOSIT ABSOLUTE /end AXIS_DESCR
/end CHARACTERISTIC
/begin CHARACTERISTIC InjCrv_phiMIATSCor2_MAP "ansauglufttemperaturabhängiger Korrekturkennfeld -2 für Ansteuerbeginn MI1" MAP 0xDE054 Gkf_Ws16 20.01562 AngleCrS -10.00781 10.00781 FORMAT "%8.5" EXTENDED_LIMITS -768.0000 767.9766
 /begin AXIS_DESCR COM_AXIS Eng_nAvrg EngN 16 0.00 6000.000 FORMAT "%8.3" EXTENDED_LIMITS -32768.00 32767.00 AXIS_PTS_REF InjCrv_phiMIATSCor_X_AXIS /end AXIS_DESCR
 /begin AXIS_DESCR COM_AXIS InjCtl_qSetUnBal InjMassCyc 16 0.00 327.6700 FORMAT "%8.4" EXTENDED_LIMITS -327.6800 327.6700 AXIS_PTS_REF InjCrv_phiMIATSCor_Y_AXIS /end AXIS_DESCR
/end CHARACTERISTIC
/begin CHARACTERISTIC InjCrv_phiMIATSCorStrt_MAP "base value for SOE correction to be weighted by intake air temperature" MAP 0xDE254 Kf_Xs16_Ys16_Ws16 20.01562 AngleCrS -10.00781 10.00781 FORMAT "%8.5" EXTENDED_LIMITS -768.0000 767.9766
 /begin AXIS_DESCR STD_AXIS Eng_nAvrg EngN 16 0.00 6000.000 FORMAT "%8.3" EXTENDED_LIMITS -32768.00 32767.00 DEPOSIT ABSOLUTE /end AXIS_DESCR
 /begin AXIS_DESCR STD_AXIS InjCtl_qSetUnBal InjMassCyc 16 0.00 327.6700 FORMAT "%8.4" EXTENDED_LIMITS -327.6800 327.6700 DEPOSIT ABSOLUTE /end AXIS_DESCR
/end CHARACTERISTIC
/begin CHARACTERISTIC InjCrv_phiMIATSCor_MAP "ansauglufttemperaturabhängiges Ansteuerbeginnkorrekturkennfeld für MI1" MAP 0xDE498 Gkf_Ws16 20.01562 AngleCrS -10.00781 10.00781 FORMAT "%8.5" EXTENDED_LIMITS -768.0000 767.9766
 /begin AXIS_DESCR COM_AXIS Eng_nAvrg EngN 16 0.00 6000.000 FORMAT "%8.3" EXTENDED_LIMITS -32768.00 32767.00 AXIS_PTS_REF InjCrv_phiMIATSCor_X_AXIS /end AXIS_DESCR
 /begin AXIS_DESCR COM_AXIS InjCtl_qSetUnBal InjMassCyc 16 0.00 327.6700 FORMAT "%8.4" EXTENDED_LIMITS -327.6800 327.6700 AXIS_PTS_REF InjCrv_phiMIATSCor_Y_AXIS /end AXIS_DESCR
/end CHARACTERISTIC
/begin AXIS_PTS InjCrv_phiMIATSCor_X_AXIS "gemeinsame X-Achse für ansuglufttemperaturabhängige Ansteuerbeginnkorrekturkennfelder für MI" 0xDE698 Eng_nAvrg GSst_Xs16 6000.000 EngN 16 0.00 6000.000 FORMAT "%8.3" EXTENDED_LIMITS -32768.00 32767.00 DEPOSIT ABSOLUTE /end AXIS_PTS
/begin AXIS_PTS InjCrv_phiMIATSCor_Y_AXIS "gemeinsame Y-Achse für ansuglufttemperaturabhängige Ansteuerbeginnkorrekturkennfelder für MI" 0xDE6BA InjCtl_qSetUnBal GSst_Xs16 327.6700 InjMassCyc 16 0.00 327.6700 FORMAT "%8.4" EXTENDED_LIMITS -327.6800 327.6700 DEPOSIT ABSOLUTE /end AXIS_PTS
/begin CHARACTERISTIC InjCrv_phiMIChamWllTempCorr_MAP "Kennfeld zur ermittlung der Winkelkorrektur durch Brennraumwandtemperatur" MAP 0xDD7EA Kf_Xs16_Ys16_Ws16 50.01562 AngleCrS -25.00781 25.00781 FORMAT "%8.5" EXTENDED_LIMITS -768.0000 767.9766
 /begin AXIS_DESCR STD_AXIS Eng_nAvrg EngN 8 0.00 6000.000 FORMAT "%8.3" EXTENDED_LIMITS -32768.00 32767.00 DEPOSIT ABSOLUTE /end AXIS_DESCR
 /begin AXIS_DESCR STD_AXIS InjCtl_qSetUnBal InjMassCyc 8 0.00 327.6700 FORMAT "%8.4" EXTENDED_LIMITS -327.6800 327.6700 DEPOSIT ABSOLUTE /end AXIS_DESCR
/end CHARACTERISTIC
/begin CHARACTERISTIC InjCrv_phiMIDynCor_MAP "Korrekturkennfeld für Ansteuerbeginn Haupteinspritzung" MAP 0xDD88E Kf_Xs16_Ys16_Ws16 50.01562 AngleCrS -25.00781 25.00781 FORMAT "%8.5" EXTENDED_LIMITS -768.0000 767.9766
 /begin AXIS_DESCR STD_AXIS Eng_nAvrg EngN 16 0.00 6000.000 FORMAT "%8.3" EXTENDED_LIMITS -32768.00 32767.00 DEPOSIT ABSOLUTE /end AXIS_DESCR
 /begin AXIS_DESCR STD_AXIS InjCtl_qSetUnBal InjMassCyc 8 0.00 327.6700 FORMAT "%8.4" EXTENDED_LIMITS -327.6800 327.6700 DEPOSIT ABSOLUTE /end AXIS_DESCR
/end CHARACTERISTIC
/begin CHARACTERISTIC InjCrv_phiMIDynMax_C "Max. Grenze für Korrekturwert des Ansteuerbeginns der MI1" VALUE 0xDD9C2 Kw_Ws16 50.01562 AngleCrS -25.00781 25.00781 FORMAT "%8.5" EXTENDED_LIMITS -768.0000 767.9766 /end CHARACTERISTIC
/begin CHARACTERISTIC InjCrv_phiMIDynMin_C "Min. Grenze für Korrekturwert des Ansteuerbeginns der MI1" VALUE 0xDD9C4 Kw_Ws16 50.01562 AngleCrS -25.00781 25.00781 FORMAT "%8.5" EXTENDED_LIMITS -768.0000 767.9766 /end CHARACTERISTIC
/begin CHARACTERISTIC InjCrv_phiMIETSCor12_MAP "kühlmitteltemperaturabhängiges Ansteuerbeginnkorrekturkennfeld für MI1" MAP 0xDE6DC Gkf_Ws16 20.01562 AngleCrS -10.00781 10.00781 FORMAT "%8.5" EXTENDED_LIMITS -768.0000 767.9766
 /begin AXIS_DESCR COM_AXIS Eng_nAvrg EngN 16 0.00 6000.000 FORMAT "%8.3" EXTENDED_LIMITS -32768.00 32767.00 AXIS_PTS_REF InjCrv_phiMIETSCor1_X_AXIS /end AXIS_DESCR
 /begin AXIS_DESCR COM_AXIS InjCtl_qSetUnBal InjMassCyc 16 0.00 327.6700 FORMAT "%8.4" EXTENDED_LIMITS -327.6800 327.6700 AXIS_PTS_REF InjCrv_phiMIETSCor1_Y_AXIS /end AXIS_DESCR
/end CHARACTERISTIC
/begin CHARACTERISTIC InjCrv_phiMIETSCor1_MAP "motortemperaturabhängiger Korrekturkennfeld-1 für Ansteuerbeginn MI1" MAP 0xDE8DC Gkf_Ws16 20.01562 AngleCrS -10.00781 10.00781 FORMAT "%8.5" EXTENDED_LIMITS -768.0000 767.9766
 /begin AXIS_DESCR COM_AXIS Eng_nAvrg EngN 16 0.00 6000.000 FORMAT "%8.3" EXTENDED_LIMITS -32768.00 32767.00 AXIS_PTS_REF InjCrv_phiMIETSCor1_X_AXIS /end AXIS_DESCR
 /begin AXIS_DESCR COM_AXIS InjCtl_qSetUnBal InjMassCyc 16 0.00 327.6700 FORMAT "%8.4" EXTENDED_LIMITS -327.6800 327.6700 AXIS_PTS_REF InjCrv_phiMIETSCor1_Y_AXIS /end AXIS_DESCR
/end CHARACTERISTIC
/begin AXIS_PTS InjCrv_phiMIETSCor1_X_AXIS "Achsenpunkte der mittleren Drehzahl" 0xDEADC Eng_nAvrg GSst_Xs16 6000.000 EngN 16 0.00 6000.000 FORMAT "%8.3" EXTENDED_LIMITS -32768.00 32767.00 DEPOSIT ABSOLUTE /end AXIS_PTS
/begin AXIS_PTS InjCrv_phiMIETSCor1_Y_AXIS "Achsenpunkte der aktuellen Einspritzmenge" 0xDEAFE InjCtl_qSetUnBal GSst_Xs16 327.6700 InjMassCyc 16 0.00 327.6700 FORMAT "%8.4" EXTENDED_LIMITS -327.6800 327.6700 DEPOSIT ABSOLUTE /end AXIS_PTS
/begin CHARACTERISTIC InjCrv_phiMIETSCor2_MAP "motortemperaturabhängiger Korrekturkennfeld-2 für Ansteuerbeginn MI1" MAP 0xDEB20 Gkf_Ws16 20.01562 AngleCrS -10.00781 10.00781 FORMAT "%8.5" EXTENDED_LIMITS -768.0000 767.9766
 /begin AXIS_DESCR COM_AXIS Eng_nAvrg EngN 16 0.00 6000.000 FORMAT "%8.3" EXTENDED_LIMITS -32768.00 32767.00 AXIS_PTS_REF InjCrv_phiMIETSCor_X_AXIS /end AXIS_DESCR
 /begin AXIS_DESCR COM_AXIS InjCtl_qSetUnBal InjMassCyc 16 0.00 327.6700 FORMAT "%8.4" EXTENDED_LIMITS -327.6800 327.6700 AXIS_PTS_REF InjCrv_phiMIETSCor_Y_AXIS /end AXIS_DESCR
/end CHARACTERISTIC
/begin CHARACTERISTIC InjCrv_phiMIETSCorRgn_MAP "motortemperaturabhängiges Ansteuerbeginnkorrekturkennfeld für MI1 im Regenerationsbetrieb" MAP 0xDF9A0 Kf_Xs16_Ys16_Ws16 50.01562 AngleCrS -10.00781 40.00781 FORMAT "%8.5" EXTENDED_LIMITS -768.0000 767.9766
 /begin AXIS_DESCR STD_AXIS Eng_nAvrg EngN 12 0.00 6000.000 FORMAT "%8.3" EXTENDED_LIMITS -32768.00 32767.00 DEPOSIT ABSOLUTE /end AXIS_DESCR
 /begin AXIS_DESCR STD_AXIS InjCtl_qSetUnBal InjMassCyc 12 0.00 327.6700 FORMAT "%8.4" EXTENDED_LIMITS -327.6800 327.6700 DEPOSIT ABSOLUTE /end AXIS_DESCR
/end CHARACTERISTIC
/begin CHARACTERISTIC InjCrv_phiMIETSCorStrt_MAP "base value for SOE correction to be weighted by engine temperature" MAP 0xDED20 Kf_Xs16_Ys16_Ws16 20.01562 AngleCrS -10.00781 10.00781 FORMAT "%8.5" EXTENDED_LIMITS -768.0000 767.9766
 /begin AXIS_DESCR STD_AXIS Eng_nAvrg EngN 16 0.00 6000.000 FORMAT "%8.3" EXTENDED_LIMITS -32768.00 32767.00 DEPOSIT ABSOLUTE /end AXIS_DESCR
 /begin AXIS_DESCR STD_AXIS InjCtl_qSetUnBal InjMassCyc 16 0.00 327.6700 FORMAT "%8.4" EXTENDED_LIMITS -327.6800 327.6700 DEPOSIT ABSOLUTE /end AXIS_DESCR
/end CHARACTERISTIC
/begin CHARACTERISTIC InjCrv_phiMIETSCor_MAP "motortemperaturabhängiges Ansteuerbeginnkorrekturkennfeld für MI1" MAP 0xDEF64 Gkf_Ws16 20.01562 AngleCrS -10.00781 10.00781 FORMAT "%8.5" EXTENDED_LIMITS -768.0000 767.9766
 /begin AXIS_DESCR COM_AXIS Eng_nAvrg EngN 16 0.00 6000.000 FORMAT "%8.3" EXTENDED_LIMITS -32768.00 32767.00 AXIS_PTS_REF InjCrv_phiMIETSCor_X_AXIS /end AXIS_DESCR
 /begin AXIS_DESCR COM_AXIS InjCtl_qSetUnBal InjMassCyc 16 0.00 327.6700 FORMAT "%8.4" EXTENDED_LIMITS -327.6800 327.6700 AXIS_PTS_REF InjCrv_phiMIETSCor_Y_AXIS /end AXIS_DESCR
/end CHARACTERISTIC
/begin AXIS_PTS InjCrv_phiMIETSCor_X_AXIS "gemeinsame X-Achse für motortemperaturabhängige Ansteuerbeginnkorrekturkennfelder für MI" 0xDF164 Eng_nAvrg GSst_Xs16 6000.000 EngN 16 0.00 6000.000 FORMAT "%8.3" EXTENDED_LIMITS -32768.00 32767.00 DEPOSIT ABSOLUTE /end AXIS_PTS
/begin AXIS_PTS InjCrv_phiMIETSCor_Y_AXIS "gemeinsame Y-Achse für motortemperaturabhängige Ansteuerbeginnkorrekturkennfelder für MI" 0xDF186 InjCtl_qSetUnBal GSst_Xs16 327.6700 InjMassCyc 16 0.00 327.6700 FORMAT "%8.4" EXTENDED_LIMITS -327.6800 327.6700 DEPOSIT ABSOLUTE /end AXIS_PTS
/begin CHARACTERISTIC InjCrv_phiMIFTSRailCorMax_C "Maximaler Ansteuerbeginnkorrekturfaktor für MI1, abhängig von der kraftstofftemperaturabhängigen Raildruckkorrektur" VALUE 0xDF1A8 Kw_Ws16 1535.977 AngleCrS -768.0000 767.9766 FORMAT "%8.4" /end CHARACTERISTIC
/begin CHARACTERISTIC InjCrv_phiMIFTSRailCorMin_C "Minimaler Ansteuerbeginnkorrekturfaktor für MI1, abhängig von der kraftstofftemperaturabhängigen Raildruckkorrektur" VALUE 0xDF1AA Kw_Ws16 1535.977 AngleCrS -768.0000 767.9766 FORMAT "%8.4" /end CHARACTERISTIC
/begin CHARACTERISTIC InjCrv_phiMIFTSRailCorStrt_MAP "map for correction factor of SOE for the MI1, based on rail pressure" MAP 0xDF1AC Kf_Xs16_Ys16_Ws16 20.01562 AngleCrS -10.00781 10.00781 FORMAT "%8.5" EXTENDED_LIMITS -768.0000 767.9766
 /begin AXIS_DESCR STD_AXIS Eng_nAvrg EngN 12 0.00 6000.000 FORMAT "%8.3" EXTENDED_LIMITS -32768.00 32767.00 DEPOSIT ABSOLUTE /end AXIS_DESCR
 /begin AXIS_DESCR STD_AXIS InjCtl_qSetUnBal InjMassCyc 8 0.00 327.6700 FORMAT "%8.4" EXTENDED_LIMITS -327.6800 327.6700 DEPOSIT ABSOLUTE /end AXIS_DESCR
/end CHARACTERISTIC
/begin CHARACTERISTIC InjCrv_phiMIFTSRailCor_MAP "Korrekturfaktorkennfeld für die MI1, abhängig von der kraftstofftemperaturabhängigen Raildruckkorrektur" MAP 0xDF298 Kf_Xs16_Ys16_Ws16 20.01562 AngleCrS -10.00781 10.00781 FORMAT "%8.5" EXTENDED_LIMITS -768.0000 767.9766
 /begin AXIS_DESCR STD_AXIS Eng_nAvrg EngN 12 0.00 6000.000 FORMAT "%8.3" EXTENDED_LIMITS -32768.00 32767.00 DEPOSIT ABSOLUTE /end AXIS_DESCR
 /begin AXIS_DESCR STD_AXIS InjCtl_qSetUnBal InjMassCyc 8 0.00 327.6700 FORMAT "%8.4" EXTENDED_LIMITS -327.6800 327.6700 DEPOSIT ABSOLUTE /end AXIS_DESCR
/end CHARACTERISTIC
/begin CHARACTERISTIC InjCrv_phiPiIMax_C "#SSD frühester absoluter Ansteuerbeginn einer PiI" VALUE 0xDFEBA Kw_Ws16 100.0078 AngleCrS 0.00 100.0078 FORMAT "%8.4" EXTENDED_LIMITS -768.0000 767.9766 /end CHARACTERISTIC
/begin CHARACTERISTIC InjCrv_pMIDynMax_C "Max. Grenze Raildruckdifferenz" VALUE 0xDD9C6 Kw_Ws16 2000.000 Pres_Rail 0.00 2000.000 FORMAT "%5.3" EXTENDED_LIMITS -3276.800 3276.700 /end CHARACTERISTIC
/begin CHARACTERISTIC InjCrv_pMIDynMin_C "Min. Grenze Raildruckdifferenz" VALUE 0xDD9C8 Kw_Ws16 2000.000 Pres_Rail 0.00 2000.000 FORMAT "%5.3" EXTENDED_LIMITS -3276.800 3276.700 /end CHARACTERISTIC
/begin CHARACTERISTIC InjCrv_pPiI2RlsAirPXDelta_C "Hysteresis for atmospheric pressure" VALUE 0xDAFAC Kw_Ws16 65535.00 Pres_hPa -32768.00 32767.00 FORMAT "%8.2" /end CHARACTERISTIC
/begin CHARACTERISTIC InjCrv_pPiI2RlsAirXLo_C "Lower threshold for atmospheric pressure" VALUE 0xDAFAE Kw_Ws16 65535.00 Pres_hPa -32768.00 32767.00 FORMAT "%8.2" /end CHARACTERISTIC
/begin CHARACTERISTIC InjCrv_qDiffMin_C "Minimale positive Mengendifferenz für Freigabe Voreinspritzung 2" VALUE 0xE1316 Kw_Ws16 327.6700 InjMassInj 0.00 327.6700 FORMAT "%8.4" EXTENDED_LIMITS -327.6800 327.6700 /end CHARACTERISTIC
/begin CHARACTERISTIC InjCrv_qMI1Cor_MAP "Mengenkorrekturkennfeld der MI1" MAP 0xDD296 Kf_Xs16_Ys16_Ws16 10.00000 InjMassInj 0.00 10.00000 FORMAT "%8.5" EXTENDED_LIMITS -327.6800 327.6700
 /begin AXIS_DESCR STD_AXIS Eng_nAvrg EngN 16 0.00 6000.000 FORMAT "%8.3" EXTENDED_LIMITS -32768.00 32767.00 DEPOSIT ABSOLUTE /end AXIS_DESCR
 /begin AXIS_DESCR STD_AXIS InjCtl_qSetUnBal InjMassCyc 16 0.00 327.6700 FORMAT "%8.4" EXTENDED_LIMITS -327.6800 327.6700 DEPOSIT ABSOLUTE /end AXIS_DESCR
/end CHARACTERISTIC
/begin CHARACTERISTIC InjCrv_qMI1DesAdd_Vector "#SSD Bypass-Label für additiven Bypass von InjCrv_qMI1Des (Nicht verstellen!)" VALUE 0xC395E Kw_Wu8 255.0 OneToOne 0.00 255.0 FORMAT "%5.1" /end CHARACTERISTIC
/begin CHARACTERISTIC InjCrv_qMI1DesAdd_Channel "#SSD Bypass-Label für additiven Bypass von InjCrv_qMI1Des (Nicht verstellen!)" VALUE 0xC395F Kw_Wu8 255.0 OneToOne 0.00 255.0 FORMAT "%5.1" /end CHARACTERISTIC
/begin CHARACTERISTIC InjCrv_qMI1Des_Vector "#SSD Bypass-Label für InjCrv_qMI1Des (Nicht verstellen!)" VALUE 0xC3960 Kw_Wu8 255.0 OneToOne 0.00 255.0 FORMAT "%5.1" /end CHARACTERISTIC
/begin CHARACTERISTIC InjCrv_qMI1Des_Channel "#SSD Bypass-Label für InjCrv_qMI1Des (Nicht verstellen!)" VALUE 0xC3961 Kw_Wu8 255.0 OneToOne 0.00 255.0 FORMAT "%5.1" /end CHARACTERISTIC
/begin CHARACTERISTIC InjCrv_qMI1MinPiI1DiffHys_C "Differenzmenge zwischen unterer und oberer Hystereseschwelle bei PiI1 für Freigabe PiI1 wenn genügend Menge für MI und PiI1" VALUE 0xDFEBC Kw_Ws16 10.00000 InjMassInj 0.00 10.00000 FORMAT "%8.5" EXTENDED_LIMITS -327.6800 327.6700 /end CHARACTERISTIC
/begin CHARACTERISTIC InjCrv_qMI1MinPiI2DiffHys_C "Differenzmenge zwischen unterer und oberer Hystereseschwelle bei PiI2 für Freigabe PiI2 wenn genügend Menge für MI und PiI2" VALUE 0xE1318 Kw_Ws16 10.00000 InjMassInj 0.00 10.00000 FORMAT "%8.5" EXTENDED_LIMITS -327.6800 327.6700 /end CHARACTERISTIC
/begin CHARACTERISTIC InjCrv_qMI1Rgn1_MAP "Grundkennfeld der HE-Menge bei Regeneration 1" MAP 0xDFAF4 Kf_Xs16_Ys16_Ws16 10.00000 InjMassInj 0.00 10.00000 FORMAT "%8.5" EXTENDED_LIMITS -327.6800 327.6700
 /begin AXIS_DESCR STD_AXIS Eng_nAvrg EngN 8 0.00 6000.000 FORMAT "%8.3" EXTENDED_LIMITS -32768.00 32767.00 DEPOSIT ABSOLUTE /end AXIS_DESCR
 /begin AXIS_DESCR STD_AXIS InjCtl_qSetUnBal InjMassCyc 8 0.00 327.6700 FORMAT "%8.4" EXTENDED_LIMITS -327.6800 327.6700 DEPOSIT ABSOLUTE /end AXIS_DESCR
/end CHARACTERISTIC
/begin CHARACTERISTIC InjCrv_qMI1Rgn2_MAP "Basic characteristic map for the MI1 quantity with regeneration 2" MAP 0xDFB98 Kf_Xs16_Ys16_Ws16 10.00000 InjMassInj 0.00 10.00000 FORMAT "%8.5" EXTENDED_LIMITS -327.6800 327.6700
 /begin AXIS_DESCR STD_AXIS Eng_nAvrg EngN 8 0.00 6000.000 FORMAT "%8.3" EXTENDED_LIMITS -32768.00 32767.00 DEPOSIT ABSOLUTE /end AXIS_DESCR
 /begin AXIS_DESCR STD_AXIS InjCtl_qSetUnBal InjMassCyc 8 0.00 327.6700 FORMAT "%8.4" EXTENDED_LIMITS -327.6800 327.6700 DEPOSIT ABSOLUTE /end AXIS_DESCR
/end CHARACTERISTIC
/begin CHARACTERISTIC InjCrv_qMI1RgnAdd_Vector "#SSD Bypass-Label für InjCrv_qMI1RgnAdd_Vector (Nicht verstellen!)" VALUE 0xC3966 Kw_Wu8 255.0 OneToOne 0.00 255.0 FORMAT "%5.1" /end CHARACTERISTIC
/begin CHARACTERISTIC InjCrv_qMI1RgnAdd_Channel "#SSD Bypass-Label für InjCrv_qMI1RgnAdd_Channel (Nicht verstellen!)" VALUE 0xC3967 Kw_Wu8 255.0 OneToOne 0.00 255.0 FORMAT "%5.1" /end CHARACTERISTIC
/begin CHARACTERISTIC InjCrv_qMI1Rgn_Vector "#SSD Bypass-Label für InjCrv_qMI1Rgn (Nicht verstellen!)" VALUE 0xC3968 Kw_Wu8 255.0 OneToOne 0.00 255.0 FORMAT "%5.1" /end CHARACTERISTIC
/begin CHARACTERISTIC InjCrv_qMI1Rgn_Channel "#SSD Konfigurationslabel für Bypass message" VALUE 0xC3969 Kw_Wu8 255.0 OneToOne 0.00 255.0 FORMAT "%5.1" /end CHARACTERISTIC
/begin CHARACTERISTIC InjCrv_qPiI1Bas2_MAP "Einspritzmenge PiI1 Grundwertekennfeld 2" MAP 0xDFEBE Gkf_Ws16 10.00000 InjMassInj 0.00 10.00000 FORMAT "%8.5" EXTENDED_LIMITS -327.6800 327.6700
 /begin AXIS_DESCR COM_AXIS Eng_nAvrg EngN 16 0.00 6000.000 FORMAT "%8.3" EXTENDED_LIMITS -32768.00 32767.00 AXIS_PTS_REF InjCrv_qPiI1Bas_X_AXIS /end AXIS_DESCR
 /begin AXIS_DESCR COM_AXIS InjCtl_qSetUnBal InjMassCyc 16 0.00 327.6700 FORMAT "%8.4" EXTENDED_LIMITS -327.6800 327.6700 AXIS_PTS_REF InjCrv_qPiI1Bas_Y_AXIS /end AXIS_DESCR
/end CHARACTERISTIC
/begin CHARACTERISTIC InjCrv_qPiI1BasCylOffs_MAP "betriebspunktabhängige Berechnung des Offsets der PiI1" MAP 0xDB772 Kf_Xs16_Ys16_Ws16 329.6700 InjMassInj -2.000000 327.6700 FORMAT "%8.4" EXTENDED_LIMITS -327.6800 327.6700
 /begin AXIS_DESCR STD_AXIS Eng_nAvrg EngN 5 0.00 6000.000 FORMAT "%8.3" EXTENDED_LIMITS -32768.00 32767.00 DEPOSIT ABSOLUTE /end AXIS_DESCR
 /begin AXIS_DESCR STD_AXIS InjCtl_qSetUnBal InjMassCyc 5 0.00 327.6700 FORMAT "%8.4" EXTENDED_LIMITS -327.6800 327.6700 DEPOSIT ABSOLUTE /end AXIS_DESCR
/end CHARACTERISTIC
/begin CHARACTERISTIC InjCrv_qPiI1BasFDC_MAP "Grundkennfeld der Pil1-Einspritzmenge für Sportmodus" MAP 0xE00BE Gkf_Ws16 10.00000 InjMassInj 0.00 10.00000 FORMAT "%8.5" EXTENDED_LIMITS -327.6800 327.6700
 /begin AXIS_DESCR COM_AXIS Eng_nAvrg EngN 16 0.00 6000.000 FORMAT "%8.3" EXTENDED_LIMITS -32768.00 32767.00 AXIS_PTS_REF InjCrv_qPiI1Bas_X_AXIS /end AXIS_DESCR
 /begin AXIS_DESCR COM_AXIS InjCtl_qSetUnBal InjMassCyc 16 0.00 327.6700 FORMAT "%8.4" EXTENDED_LIMITS -327.6800 327.6700 AXIS_PTS_REF InjCrv_qPiI1Bas_Y_AXIS /end AXIS_DESCR
/end CHARACTERISTIC
/begin CHARACTERISTIC InjCrv_qPiI1BasStrt_MAP "Grundwertkennlinie start" MAP 0xE1008 Kf_Xs16_Ys16_Ws16 10.00000 InjMassInj 0.00 10.00000 FORMAT "%8.5" EXTENDED_LIMITS -327.6800 327.6700
 /begin AXIS_DESCR STD_AXIS Eng_nAvrg EngN 16 0.00 6000.000 FORMAT "%8.3" EXTENDED_LIMITS -32768.00 32767.00 DEPOSIT ABSOLUTE /end AXIS_DESCR
 /begin AXIS_DESCR STD_AXIS InjCtl_qSetUnBal InjMassCyc 16 0.00 327.6700 FORMAT "%8.4" EXTENDED_LIMITS -327.6800 327.6700 DEPOSIT ABSOLUTE /end AXIS_DESCR
/end CHARACTERISTIC
/begin CHARACTERISTIC InjCrv_qPiI1Bas_MAP "Einspritzmenge PiI1 Grundwertekennfeld" MAP 0xE02BE Gkf_Ws16 10.00000 InjMassInj 0.00 10.00000 FORMAT "%8.5" EXTENDED_LIMITS -327.6800 327.6700
 /begin AXIS_DESCR COM_AXIS Eng_nAvrg EngN 16 0.00 6000.000 FORMAT "%8.3" EXTENDED_LIMITS -32768.00 32767.00 AXIS_PTS_REF InjCrv_qPiI1Bas_X_AXIS /end AXIS_DESCR
 /begin AXIS_DESCR COM_AXIS InjCtl_qSetUnBal InjMassCyc 16 0.00 327.6700 FORMAT "%8.4" EXTENDED_LIMITS -327.6800 327.6700 AXIS_PTS_REF InjCrv_qPiI1Bas_Y_AXIS /end AXIS_DESCR
/end CHARACTERISTIC
/begin AXIS_PTS InjCrv_qPiI1Bas_X_AXIS "gemeinsame X-Achse für Einspritzmengengrundwertkennfelder für Voreinspritzung 1" 0xE04BE Eng_nAvrg GSst_Xs16 6000.000 EngN 16 0.00 6000.000 FORMAT "%8.3" EXTENDED_LIMITS -32768.00 32767.00 DEPOSIT ABSOLUTE /end AXIS_PTS
/begin AXIS_PTS InjCrv_qPiI1Bas_Y_AXIS "gemeinsame Y-Achse für Einspritzmengegrundwertkennfelder für Voreinspritzung 1" 0xE04E0 InjCtl_qSetUnBal GSst_Xs16 327.6700 InjMassCyc 16 0.00 327.6700 FORMAT "%8.4" EXTENDED_LIMITS -327.6800 327.6700 DEPOSIT ABSOLUTE /end AXIS_PTS
/begin CHARACTERISTIC InjCrv_qPiI1Max2_MAP "Einspritzmenge PiI1 Maximalwertekennfeld 2" MAP 0xE0502 Gkf_Ws16 10.00000 InjMassInj 0.00 10.00000 FORMAT "%8.5" EXTENDED_LIMITS -327.6800 327.6700
 /begin AXIS_DESCR COM_AXIS Eng_nAvrg EngN 8 0.00 6000.000 FORMAT "%8.3" EXTENDED_LIMITS -32768.00 32767.00 AXIS_PTS_REF InjCrv_qPiI1Max_X_AXIS /end AXIS_DESCR
 /begin AXIS_DESCR COM_AXIS InjCtl_qSetUnBal InjMassCyc 16 0.00 327.6700 FORMAT "%8.4" EXTENDED_LIMITS -327.6800 327.6700 AXIS_PTS_REF InjCrv_qPiI1Max_Y_AXIS /end AXIS_DESCR
/end CHARACTERISTIC
/begin CHARACTERISTIC InjCrv_qPiI1Max_MAP "Einspritzmenge PiI1 Maximalwertekennfeld" MAP 0xE0602 Gkf_Ws16 10.00000 InjMassInj 0.00 10.00000 FORMAT "%8.5" EXTENDED_LIMITS -327.6800 327.6700
 /begin AXIS_DESCR COM_AXIS Eng_nAvrg EngN 8 0.00 6000.000 FORMAT "%8.3" EXTENDED_LIMITS -32768.00 32767.00 AXIS_PTS_REF InjCrv_qPiI1Max_X_AXIS /end AXIS_DESCR
 /begin AXIS_DESCR COM_AXIS InjCtl_qSetUnBal InjMassCyc 16 0.00 327.6700 FORMAT "%8.4" EXTENDED_LIMITS -327.6800 327.6700 AXIS_PTS_REF InjCrv_qPiI1Max_Y_AXIS /end AXIS_DESCR
/end CHARACTERISTIC
/begin AXIS_PTS InjCrv_qPiI1Max_X_AXIS "gemeinsame X-Achse für Einspritzmengenmaximalwertkennfelder für Voreinspritzung 1" 0xE0702 Eng_nAvrg GSst_Xs16 6000.000 EngN 8 0.00 6000.000 FORMAT "%8.3" EXTENDED_LIMITS -32768.00 32767.00 DEPOSIT ABSOLUTE /end AXIS_PTS
/begin AXIS_PTS InjCrv_qPiI1Max_Y_AXIS "gemeinsame Y-Achse für Einspritzmengenmaximalwertkennfelder für Voreinspritzung 1" 0xE0714 InjCtl_qSetUnBal GSst_Xs16 327.6700 InjMassCyc 16 0.00 327.6700 FORMAT "%8.4" EXTENDED_LIMITS -327.6800 327.6700 DEPOSIT ABSOLUTE /end AXIS_PTS
/begin CHARACTERISTIC InjCrv_qPiI1MinDiff_C "Minimalmenge zwischen unteren und oberen Hystheresenschwelle für Voreinspritzung 1" VALUE 0xE0736 Kw_Ws16 10.00000 InjMassInj 0.00 10.00000 FORMAT "%8.5" EXTENDED_LIMITS -327.6800 327.6700 /end CHARACTERISTIC
/begin CHARACTERISTIC InjCrv_qPiI1WvCorMax_C "Schwelle zur Abschaltung der PiI2 bei Unterschreiten der Mindesteinspritzmenge durch PiI1 bei aktiver Wellenkorrektur" VALUE 0xE131A Kw_Ws16 3.000000 InjMassInj -3.000000 0.00 FORMAT "%8.6" EXTENDED_LIMITS -327.6800 327.6700 /end CHARACTERISTIC
/begin CHARACTERISTIC InjCrv_qPiI2APSCorStrt_MAP "correction value for atmospheric pressure dependent PiI2 quantity correction" MAP 0xE160C Kf_Xs16_Ys16_Ws16 10.00000 InjMassInj 0.00 10.00000 FORMAT "%8.5" EXTENDED_LIMITS -327.6800 327.6700
 /begin AXIS_DESCR STD_AXIS Eng_nAvrg EngN 2 0.00 6000.000 FORMAT "%8.3" EXTENDED_LIMITS -32768.00 32767.00 DEPOSIT ABSOLUTE /end AXIS_DESCR
 /begin AXIS_DESCR STD_AXIS InjCtl_qSetUnBal InjMassCyc 2 0.00 327.6700 FORMAT "%8.4" EXTENDED_LIMITS -327.6800 327.6700 DEPOSIT ABSOLUTE /end AXIS_DESCR
/end CHARACTERISTIC
/begin CHARACTERISTIC InjCrv_qPiI2APSCor_MAP "atmosphärendruckabhängiges Mengenkorrekturkennfeld für Voreinspritzung 2" MAP 0xE1620 Kf_Xs16_Ys16_Ws16 10.00000 InjMassInj 0.00 10.00000 FORMAT "%8.5" EXTENDED_LIMITS -327.6800 327.6700
 /begin AXIS_DESCR STD_AXIS Eng_nAvrg EngN 16 0.00 6000.000 FORMAT "%8.3" EXTENDED_LIMITS -32768.00 32767.00 DEPOSIT ABSOLUTE /end AXIS_DESCR
 /begin AXIS_DESCR STD_AXIS InjCtl_qSetUnBal InjMassCyc 16 0.00 327.6700 FORMAT "%8.4" EXTENDED_LIMITS -327.6800 327.6700 DEPOSIT ABSOLUTE /end AXIS_DESCR
/end CHARACTERISTIC
/begin CHARACTERISTIC InjCrv_qPiI2ATSCorStrt_MAP "correction value for intake air temperature dependent PiI2 quantity correction" MAP 0xE1864 Kf_Xs16_Ys16_Ws16 10.00000 InjMassInj 0.00 10.00000 FORMAT "%8.5" EXTENDED_LIMITS -327.6800 327.6700
 /begin AXIS_DESCR STD_AXIS Eng_nAvrg EngN 2 0.00 6000.000 FORMAT "%8.3" EXTENDED_LIMITS -32768.00 32767.00 DEPOSIT ABSOLUTE /end AXIS_DESCR
 /begin AXIS_DESCR STD_AXIS InjCtl_qSetUnBal InjMassCyc 2 0.00 327.6700 FORMAT "%8.4" EXTENDED_LIMITS -327.6800 327.6700 DEPOSIT ABSOLUTE /end AXIS_DESCR
/end CHARACTERISTIC
/begin CHARACTERISTIC InjCrv_qPiI2ATSCor_MAP "ansauglufttemperaturabhängiges Mengenkorrekturkennfeld für Voreinspritzung 2" MAP 0xE1878 Kf_Xs16_Ys16_Ws16 10.00000 InjMassInj 0.00 10.00000 FORMAT "%8.5" EXTENDED_LIMITS -327.6800 327.6700
 /begin AXIS_DESCR STD_AXIS Eng_nAvrg EngN 16 0.00 6000.000 FORMAT "%8.3" EXTENDED_LIMITS -32768.00 32767.00 DEPOSIT ABSOLUTE /end AXIS_DESCR
 /begin AXIS_DESCR STD_AXIS InjCtl_qSetUnBal InjMassCyc 16 0.00 327.6700 FORMAT "%8.4" EXTENDED_LIMITS -327.6800 327.6700 DEPOSIT ABSOLUTE /end AXIS_DESCR
/end CHARACTERISTIC
/begin CHARACTERISTIC InjCrv_qPiI2Bas_MAP "Einspritzmenge PiI2 Grundwertekennfeld" MAP 0xE131C Kf_Xs16_Ys16_Ws16 10.00000 InjMassInj 0.00 10.00000 FORMAT "%8.5" EXTENDED_LIMITS -327.6800 327.6700
 /begin AXIS_DESCR STD_AXIS Eng_nAvrg EngN 16 0.00 6000.000 FORMAT "%8.3" EXTENDED_LIMITS -32768.00 32767.00 DEPOSIT ABSOLUTE /end AXIS_DESCR
 /begin AXIS_DESCR STD_AXIS InjCtl_qSetUnBal InjMassCyc 16 0.00 327.6700 FORMAT "%8.4" EXTENDED_LIMITS -327.6800 327.6700 DEPOSIT ABSOLUTE /end AXIS_DESCR
/end CHARACTERISTIC
/begin CHARACTERISTIC InjCrv_qPiI2ETSCorStrt_MAP "correction value for engine temperature dependent PiI2 quantity correction" MAP 0xE1ABC Kf_Xs16_Ys16_Ws16 10.00000 InjMassInj 0.00 10.00000 FORMAT "%8.5" EXTENDED_LIMITS -327.6800 327.6700
 /begin AXIS_DESCR STD_AXIS Eng_nAvrg EngN 2 0.00 6000.000 FORMAT "%8.3" EXTENDED_LIMITS -32768.00 32767.00 DEPOSIT ABSOLUTE /end AXIS_DESCR
 /begin AXIS_DESCR STD_AXIS InjCtl_qSetUnBal InjMassCyc 2 0.00 327.6700 FORMAT "%8.4" EXTENDED_LIMITS -327.6800 327.6700 DEPOSIT ABSOLUTE /end AXIS_DESCR
/end CHARACTERISTIC
/begin CHARACTERISTIC InjCrv_qPiI2ETSCor_MAP "motortemperaturabhängiges Mengenkorrekturkennfeld für Voreinspritzung 2" MAP 0xE1AD0 Kf_Xs16_Ys16_Ws16 10.00000 InjMassInj 0.00 10.00000 FORMAT "%8.5" EXTENDED_LIMITS -327.6800 327.6700
 /begin AXIS_DESCR STD_AXIS Eng_nAvrg EngN 16 0.00 6000.000 FORMAT "%8.3" EXTENDED_LIMITS -32768.00 32767.00 DEPOSIT ABSOLUTE /end AXIS_DESCR
 /begin AXIS_DESCR STD_AXIS InjCtl_qSetUnBal InjMassCyc 16 0.00 327.6700 FORMAT "%8.4" EXTENDED_LIMITS -327.6800 327.6700 DEPOSIT ABSOLUTE /end AXIS_DESCR
/end CHARACTERISTIC
/begin CHARACTERISTIC InjCrv_qPiI2Max_MAP "Einspritzmenge PiI2 Maximalwertekennfeld" MAP 0xE1560 Kf_Xs16_Ys16_Ws16 10.00000 InjMassInj 0.00 10.00000 FORMAT "%8.5" EXTENDED_LIMITS -327.6800 327.6700
 /begin AXIS_DESCR STD_AXIS Eng_nAvrg EngN 8 0.00 6000.000 FORMAT "%8.3" EXTENDED_LIMITS -32768.00 32767.00 DEPOSIT ABSOLUTE /end AXIS_DESCR
 /begin AXIS_DESCR STD_AXIS InjCtl_qSetUnBal InjMassCyc 8 0.00 327.6700 FORMAT "%8.4" EXTENDED_LIMITS -327.6800 327.6700 DEPOSIT ABSOLUTE /end AXIS_DESCR
/end CHARACTERISTIC
/begin CHARACTERISTIC InjCrv_qPiI2MinDiff_C "Minimalmenge zwischen unteren und oberen Hystheresenschwelle für Voreinspritzung 2" VALUE 0xE1604 Kw_Ws16 10.00000 InjMassInj 0.00 10.00000 FORMAT "%8.5" EXTENDED_LIMITS -327.6800 327.6700 /end CHARACTERISTIC
/begin CHARACTERISTIC InjCrv_qRawDelta_C "Hystersis for Injection quantity" VALUE 0xDAFB0 Kw_Ws16 327.6700 InjMassCyc 0.00 327.6700 FORMAT "%8.4" EXTENDED_LIMITS -327.6800 327.6700 /end CHARACTERISTIC
/begin CHARACTERISTIC InjCrv_qRawLo_C "Injection Quantity lower threshold value" VALUE 0xDAFB2 Kw_Ws16 327.6700 InjMassCyc 0.00 327.6700 FORMAT "%8.4" EXTENDED_LIMITS -327.6800 327.6700 /end CHARACTERISTIC
/begin CHARACTERISTIC InjCrv_rAPPFullLdDet_C "PWG Schwelle für Funktion ""PoI 1 after overrun""" VALUE 0xDA432 Kw_Ws16 799.9878 Prc -400.0000 399.9878 FORMAT "%8.4" /end CHARACTERISTIC
/begin CHARACTERISTIC InjCrv_rOpRngATSHys_C "Ansauglufttemperatur-Hystereseschwelle zur Bestimmung des Betriebsbereichs" VALUE 0xDB21E Kw_Wu16 100.0000 Prc 0.00 100.0000 FORMAT "%8.4" EXTENDED_LIMITS 0.00 799.9878 /end CHARACTERISTIC
/begin CHARACTERISTIC InjCrv_rOpRngETSHys_C "Motortemperatur-Hystereseschwelle zur Bestimmung des Betriebsbereichs" VALUE 0xDB220 Kw_Wu16 100.0000 Prc 0.00 100.0000 FORMAT "%8.4" EXTENDED_LIMITS 0.00 799.9878 /end CHARACTERISTIC
/begin CHARACTERISTIC InjCrv_rPiIRlsEngSpdHys_C "Drehzahl Hystereseschwelle für die Auswahl der Freigabestruktur der Voreinspritzungen" VALUE 0xDA440 Kw_Wu16 100.0000 Prc 0.00 100.0000 FORMAT "%8.4" EXTENDED_LIMITS 0.00 799.9878 /end CHARACTERISTIC
/begin CHARACTERISTIC InjCrv_rPiIRlsQntHys_C "Mengen-Hystereseschwelle  zur Auswahl der Freigabestruktur der Voreinspritzungen" VALUE 0xDA442 Kw_Wu16 100.0000 Prc 0.00 100.0000 FORMAT "%8.4" EXTENDED_LIMITS 0.00 799.9878 /end CHARACTERISTIC
/begin CHARACTERISTIC InjCrv_stCylOffstAirInv_C "Schalter für Spitze-bit-coded Freigabestatus des Zylinders weg vom" VALUE 0xDB7BC Kw_Wu8 255.0 OneToOne 0.00 255.0 FORMAT "%5.1" /end CHARACTERISTIC
/begin CHARACTERISTIC InjCrv_stCylOffstEngInv_C "Schalter für Spitze-bit-coded Freigabestatus des Zylinders weg vom" VALUE 0xDB7BD Kw_Wu8 255.0 OneToOne 0.00 255.0 FORMAT "%5.1" /end CHARACTERISTIC
/begin CHARACTERISTIC InjCrv_stInjCharPrioRgn_C "Prioritätsstatus für die Abschaltung der Voreinspritzungen im Regenerationsbetrieb" VALUE 0xDA444 Kw_Wu32 4294967295.00 OneToOne 0.00 4294967295.00 FORMAT "%13.2" /end CHARACTERISTIC
/begin CHARACTERISTIC InjCrv_stInjCharPrio_C "Prioritätsstatus für die Abschaltung der Voreinspritzungen" VALUE 0xDA448 Kw_Wu32 4294967295.00 OneToOne 0.00 4294967295.00 FORMAT "%13.2" /end CHARACTERISTIC
/begin CHARACTERISTIC InjCrv_stInjCharSetVal_Vector "#SSD Konfigurationslabel für Bypass" VALUE 0xC3956 Kw_Wu8 255.0 OneToOne 0.00 255.0 FORMAT "%5.1" /end CHARACTERISTIC
/begin CHARACTERISTIC InjCrv_stInjCharSetVal_Channel "#SSD Konfigurationslabels für Bypass" VALUE 0xC3957 Kw_Wu8 255.0 OneToOne 0.00 255.0 FORMAT "%5.1" /end CHARACTERISTIC
/begin CHARACTERISTIC InjCrv_stInjDstSel_C "Status der Darstellung relativer Zeitabstände der Einspritzungen" VALUE 0xDA434 Kw_Wu8 255.0 OneToOne 0.00 255.0 FORMAT "%5.1" /end CHARACTERISTIC
/begin CHARACTERISTIC InjCrv_stMI1RgnDelMsk_C "Maske für die Deaktivierung der MI1 Grundwerteberechnung im Regenerationsbetrieb" VALUE 0xDD4DC Kw_Wu32 4294967295.00 OneToOne 0.00 4294967295.00 FORMAT "%13.2" /end CHARACTERISTIC
/begin CHARACTERISTIC InjCrv_stMI1RgnMsk_C "Maske für Aktivierung  der Regeneration über MI1" VALUE 0xDFC4C Kw_Wu32 4294967295.00 OneToOne 0.00 4294967295.00 FORMAT "%13.2" /end CHARACTERISTIC
/begin CHARACTERISTIC InjCrv_stMI1RgnTypeMsk_C "Maske zur Typauswahl der Regeneration von MI1" VALUE 0xDFC50 Kw_Wu32 4294967295.00 OneToOne 0.00 4294967295.00 FORMAT "%13.2" /end CHARACTERISTIC
/begin CHARACTERISTIC InjCrv_stPiI1RgnDelMsk_C "Maske für die Deaktivierung der PiI1 Grundwerteberechnung im Regenerationsbetrieb" VALUE 0xE0738 Kw_Wu32 4294967295.00 OneToOne 0.00 4294967295.00 FORMAT "%13.2" /end CHARACTERISTIC
/begin CHARACTERISTIC InjCrv_stPiI2RgnDelMsk_C "Maske für die Deaktivierung der PiI2 Grundwerteberechnung im Regenerationsbetrieb" VALUE 0xE1608 Kw_Wu32 4294967295.00 OneToOne 0.00 4294967295.00 FORMAT "%13.2" /end CHARACTERISTIC
/begin CHARACTERISTIC InjCrv_stPiI2RlsGearMax_C "Gear upper threshold" VALUE 0xDAFC2 Kw_Ws8 255.0 OneToOne -128.0 127.0 FORMAT "%5.1" /end CHARACTERISTIC
/begin CHARACTERISTIC InjCrv_stPiI2RlsGearMin_C " Gear lower threshold" VALUE 0xDAFC3 Kw_Ws8 255.0 OneToOne -128.0 127.0 FORMAT "%5.1" /end CHARACTERISTIC
/begin CHARACTERISTIC InjCrv_stPiIRlsBypass_Vector "#SSD Bypass Label, NICHT AENDERN" VALUE 0xC3958 Kw_Wu8 255.0 OneToOne 0.00 255.0 FORMAT "%5.1" /end CHARACTERISTIC
/begin CHARACTERISTIC InjCrv_stPiIRlsBypass_Channel "#SSD Bypass Label, NICHT AENDERN" VALUE 0xC3959 Kw_Wu8 255.0 OneToOne 0.00 255.0 FORMAT "%5.1" /end CHARACTERISTIC
/begin CHARACTERISTIC InjCrv_stPiIRlsOpRng1_MAP "Freigabekennfeld im Betriebsbereich 1" MAP 0xDA44C Kf_Xs16_Ys16_Ws16 4.000000 OneToOne 1.000000 5.000000 FORMAT "%8.6" EXTENDED_LIMITS -32768.00 32767.00
 /begin AXIS_DESCR STD_AXIS Eng_nAvrg EngN 16 0.00 6000.000 FORMAT "%8.3" EXTENDED_LIMITS -32768.00 32767.00 DEPOSIT ABSOLUTE /end AXIS_DESCR
 /begin AXIS_DESCR STD_AXIS InjCtl_qSetUnBal InjMassCyc 16 0.00 327.6700 FORMAT "%8.4" EXTENDED_LIMITS -327.6800 327.6700 DEPOSIT ABSOLUTE /end AXIS_DESCR
/end CHARACTERISTIC
/begin CHARACTERISTIC InjCrv_stPiIRlsOpRng2_MAP "Freigabekennfeld im Betriebsbereich 2" MAP 0xDA690 Kf_Xs16_Ys16_Ws16 4.000000 OneToOne 1.000000 5.000000 FORMAT "%8.6" EXTENDED_LIMITS -32768.00 32767.00
 /begin AXIS_DESCR STD_AXIS Eng_nAvrg EngN 16 0.00 6000.000 FORMAT "%8.3" EXTENDED_LIMITS -32768.00 32767.00 DEPOSIT ABSOLUTE /end AXIS_DESCR
 /begin AXIS_DESCR STD_AXIS InjCtl_qSetUnBal InjMassCyc 16 0.00 327.6700 FORMAT "%8.4" EXTENDED_LIMITS -327.6800 327.6700 DEPOSIT ABSOLUTE /end AXIS_DESCR
/end CHARACTERISTIC
/begin CHARACTERISTIC InjCrv_stPiIRlsOpRng3_MAP "Freigabekennfeld im Betriebsbereich 3" MAP 0xDA8D4 Kf_Xs16_Ys16_Ws16 4.000000 OneToOne 1.000000 5.000000 FORMAT "%8.6" EXTENDED_LIMITS -32768.00 32767.00
 /begin AXIS_DESCR STD_AXIS Eng_nAvrg EngN 16 0.00 6000.000 FORMAT "%8.3" EXTENDED_LIMITS -32768.00 32767.00 DEPOSIT ABSOLUTE /end AXIS_DESCR
 /begin AXIS_DESCR STD_AXIS InjCtl_qSetUnBal InjMassCyc 16 0.00 327.6700 FORMAT "%8.4" EXTENDED_LIMITS -327.6800 327.6700 DEPOSIT ABSOLUTE /end AXIS_DESCR
/end CHARACTERISTIC
/begin CHARACTERISTIC InjCrv_stPiIRlsOpRng4_MAP "Freigabekennfeld im Betriebsbereich 4" MAP 0xDAB18 Kf_Xs16_Ys16_Ws16 4.000000 OneToOne 1.000000 5.000000 FORMAT "%8.6" EXTENDED_LIMITS -32768.00 32767.00
 /begin AXIS_DESCR STD_AXIS Eng_nAvrg EngN 16 0.00 6000.000 FORMAT "%8.3" EXTENDED_LIMITS -32768.00 32767.00 DEPOSIT ABSOLUTE /end AXIS_DESCR
 /begin AXIS_DESCR STD_AXIS InjCtl_qSetUnBal InjMassCyc 16 0.00 327.6700 FORMAT "%8.4" EXTENDED_LIMITS -327.6800 327.6700 DEPOSIT ABSOLUTE /end AXIS_DESCR
/end CHARACTERISTIC
/begin CHARACTERISTIC InjCrv_stPiIRlsOpRng5_MAP "Freigabekennfeld im Betriebsbereich 5" MAP 0xDAD5C Kf_Xs16_Ys16_Ws16 4.000000 OneToOne 1.000000 5.000000 FORMAT "%8.6" EXTENDED_LIMITS -32768.00 32767.00
 /begin AXIS_DESCR STD_AXIS Eng_nAvrg EngN 16 0.00 6000.000 FORMAT "%8.3" EXTENDED_LIMITS -32768.00 32767.00 DEPOSIT ABSOLUTE /end AXIS_DESCR
 /begin AXIS_DESCR STD_AXIS InjCtl_qSetUnBal InjMassCyc 16 0.00 327.6700 FORMAT "%8.4" EXTENDED_LIMITS -327.6800 327.6700 DEPOSIT ABSOLUTE /end AXIS_DESCR
/end CHARACTERISTIC
/begin CHARACTERISTIC InjCrv_stPiIRlsOpRng6_MAP "PiI release map for operation range 6" MAP 0xDAFC4 Kf_Xs16_Ys16_Ws16 4.000000 OneToOne 1.000000 5.000000 FORMAT "%8.6" EXTENDED_LIMITS -32768.00 32767.00
 /begin AXIS_DESCR STD_AXIS Eng_nAvrg EngN 16 0.00 6000.000 FORMAT "%8.3" EXTENDED_LIMITS -32768.00 32767.00 DEPOSIT ABSOLUTE /end AXIS_DESCR
 /begin AXIS_DESCR STD_AXIS InjCtl_qSetUnBal InjMassCyc 16 0.00 327.6700 FORMAT "%8.4" EXTENDED_LIMITS -327.6800 327.6700 DEPOSIT ABSOLUTE /end AXIS_DESCR
/end CHARACTERISTIC
/begin CHARACTERISTIC InjCrv_stPrioRgnMsk_C "Bitmaske für Aktivierung  des Prioritätsstaus im Regenerationsbetrieb" VALUE 0xDAFA0 Kw_Wu32 4294967295.00 OneToOne 0.00 4294967295.00 FORMAT "%13.2" /end CHARACTERISTIC
/begin CHARACTERISTIC InjCrv_stRlsOpRngThresRgn_MAP "Betriebsbereichsschwellen für die Freigabe der Voreinspritzungen im Regenerationsbetrieb" MAP 0xDB222 Kf_Xs16_Ys16_Ws16 4.000000 OneToOne 1.000000 5.000000 FORMAT "%8.6" EXTENDED_LIMITS -32768.00 32767.00
 /begin AXIS_DESCR STD_AXIS InjCrv_tEng Temp_Cels 16 -50.14000 199.8600 FORMAT "%8.4" EXTENDED_LIMITS -3549.940 3003.560 DEPOSIT ABSOLUTE /end AXIS_DESCR
 /begin AXIS_DESCR STD_AXIS IATSCD_tAir Temp_Cels 16 -50.14000 199.8600 FORMAT "%8.4" EXTENDED_LIMITS -3549.940 3003.560 DEPOSIT ABSOLUTE /end AXIS_DESCR
/end CHARACTERISTIC
/begin CHARACTERISTIC InjCrv_stRlsOpRngThres_MAP "Betriebsbereichsschwellen für die Freigabe der Voreinspritzungen" MAP 0xDB466 Kf_Xs16_Ys16_Ws16 4.000000 OneToOne 1.000000 5.000000 FORMAT "%8.6" EXTENDED_LIMITS -32768.00 32767.00
 /begin AXIS_DESCR STD_AXIS InjCrv_tEng Temp_Cels 16 -50.14000 199.8600 FORMAT "%8.4" EXTENDED_LIMITS -3549.940 3003.560 DEPOSIT ABSOLUTE /end AXIS_DESCR
 /begin AXIS_DESCR STD_AXIS IATSCD_tAir Temp_Cels 16 -50.14000 199.8600 FORMAT "%8.4" EXTENDED_LIMITS -3549.940 3003.560 DEPOSIT ABSOLUTE /end AXIS_DESCR
/end CHARACTERISTIC
/begin CHARACTERISTIC InjCrv_stRlsRgnMsk_C "Bitmaske für Aktivierung des Freigabekennfelds im Regenerationsbetrieb" VALUE 0xDAFA4 Kw_Wu32 4294967295.00 OneToOne 0.00 4294967295.00 FORMAT "%13.2" /end CHARACTERISTIC
/begin CHARACTERISTIC InjCrv_swtPiIDblCorMapVal_C "Schalter für die PiI1- und MI- Korrekturwertberechnung mit verdoppeltem Kennfeldsatz (1: doppeltes, 0: einfaches Kennfeld)" VALUE 0xDAFA8 Kw_Wu8 1.000 OneToOne 0.00 1.000 FORMAT "%5.3" EXTENDED_LIMITS 0.00 255.0 /end CHARACTERISTIC
/begin CHARACTERISTIC InjCrv_swtPiIDblCorMapType_C "Schaltertyp für die PiI1- und MI- Korrekturwertberechnung mit verdoppeltem Kennfeldsatz" VALUE 0xDAFA9 Kw_Wu8 0.00 OneToOne 2.000 2.000 FORMAT "%5.3" EXTENDED_LIMITS 0.00 255.0 /end CHARACTERISTIC
/begin CHARACTERISTIC InjCrv_tAirCylOffsRlsMaxHigh_C "Obere Grenze der Hystrerese tAir max" VALUE 0xDB7BE Kw_Ws16 950.0000 Temp_Cels -50.1400 899.8600 FORMAT "%8.4" EXTENDED_LIMITS -3549.940 3003.560 /end CHARACTERISTIC
/begin CHARACTERISTIC InjCrv_tAirCylOffsRlsMaxLow_C "Obere Grenze der Hystrerese tAir min" VALUE 0xDB7C0 Kw_Ws16 950.0000 Temp_Cels -50.1400 899.8600 FORMAT "%8.4" EXTENDED_LIMITS -3549.940 3003.560 /end CHARACTERISTIC
/begin CHARACTERISTIC InjCrv_tAirCylOffsRlsMinHigh_C "Obere Grenze der Hystrerese tAir min" VALUE 0xDB7C2 Kw_Ws16 950.0000 Temp_Cels -50.1400 899.8600 FORMAT "%8.4" EXTENDED_LIMITS -3549.940 3003.560 /end CHARACTERISTIC
/begin CHARACTERISTIC InjCrv_tAirCylOffsRlsMinLow_C "Untere Grenze der Hystrerese tAir min" VALUE 0xDB7C4 Kw_Ws16 950.0000 Temp_Cels -50.1400 899.8600 FORMAT "%8.4" EXTENDED_LIMITS -3549.940 3003.560 /end CHARACTERISTIC
/begin CHARACTERISTIC InjCrv_tEngCylOffsRlsMaxHigh_C "Obere Grenze der Hystrerese tEng max" VALUE 0xDB7C6 Kw_Ws16 950.0000 Temp_Cels -50.1400 899.8600 FORMAT "%8.4" EXTENDED_LIMITS -3549.940 3003.560 /end CHARACTERISTIC
/begin CHARACTERISTIC InjCrv_tEngCylOffsRlsMaxLow_C "Untere Grenze der Hystrerese tEng max" VALUE 0xDB7C8 Kw_Ws16 950.0000 Temp_Cels -50.1400 899.8600 FORMAT "%8.4" EXTENDED_LIMITS -3549.940 3003.560 /end CHARACTERISTIC
/begin CHARACTERISTIC InjCrv_tEngCylOffsRlsMinHigh_C "Obere Grenze der Hystrerese tEng min" VALUE 0xDB7CA Kw_Ws16 950.0000 Temp_Cels -50.1400 899.8600 FORMAT "%8.4" EXTENDED_LIMITS -3549.940 3003.560 /end CHARACTERISTIC
/begin CHARACTERISTIC InjCrv_tEngCylOffsRlsMinLow_C "Untere Grenze der Hystrerese tEng min" VALUE 0xDB7CC Kw_Ws16 950.0000 Temp_Cels -50.1400 899.8600 FORMAT "%8.4" EXTENDED_LIMITS -3549.940 3003.560 /end CHARACTERISTIC
/begin CHARACTERISTIC InjCrv_tiFullLdDet_C "Zeitfenster für Erkennung einer ""starken Beschleunigung"" nach Schub" VALUE 0xDA436 Kw_Wu16 655350.0 Time_ms 0.00 655350.0 FORMAT "%8.1" /end CHARACTERISTIC
/begin CHARACTERISTIC InjCrv_tiPause_C "#SSD physikalische bedingte Mindestzeit zwischen 2 Einspritzungen" VALUE 0xC061A Kw_Ws16 65535.00 InjTime_us -32768.00 32767.00 FORMAT "%8.2" /end CHARACTERISTIC
/begin CHARACTERISTIC InjCrv_tiPiI1Bas1FDC_MAP " base map of PiI1 SOE time calculation, if PiI2 is inactive for sport mode" MAP 0xE0928 Kf_Xs16_Ys16_Ws16 13000.00 InjTime_us 0.00 13000.00 FORMAT "%8.2" EXTENDED_LIMITS -32768.00 32767.00
 /begin AXIS_DESCR STD_AXIS Eng_nAvrg EngN 16 0.00 6000.000 FORMAT "%8.3" EXTENDED_LIMITS -32768.00 32767.00 DEPOSIT ABSOLUTE /end AXIS_DESCR
 /begin AXIS_DESCR STD_AXIS InjCtl_qSetUnBal InjMassCyc 16 0.00 327.6700 FORMAT "%8.4" EXTENDED_LIMITS -327.6800 327.6700 DEPOSIT ABSOLUTE /end AXIS_DESCR
/end CHARACTERISTIC
/begin CHARACTERISTIC InjCrv_tiPiI1Bas1_MAP "Zeitkomponente Ansteuerbeginn Grundwertekennfeld PiI1 ohne Freigabe PiI2" MAP 0xE0B6C Kf_Xs16_Ys16_Ws16 13000.00 InjTime_us 0.00 13000.00 FORMAT "%8.2" EXTENDED_LIMITS -32768.00 32767.00
 /begin AXIS_DESCR STD_AXIS Eng_nAvrg EngN 16 0.00 6000.000 FORMAT "%8.3" EXTENDED_LIMITS -32768.00 32767.00 DEPOSIT ABSOLUTE /end AXIS_DESCR
 /begin AXIS_DESCR STD_AXIS InjCtl_qSetUnBal InjMassCyc 16 0.00 327.6700 FORMAT "%8.4" EXTENDED_LIMITS -327.6800 327.6700 DEPOSIT ABSOLUTE /end AXIS_DESCR
/end CHARACTERISTIC
/begin CHARACTERISTIC InjCrv_tiPiI1Bas2_MAP "Zeitkomponente Ansteuerbeginn Grundwertekennfeld PiI1 mit freigabe PiI2" MAP 0xE0DB0 Kf_Xs16_Ys16_Ws16 13000.00 InjTime_us 0.00 13000.00 FORMAT "%8.2" EXTENDED_LIMITS -32768.00 32767.00
 /begin AXIS_DESCR STD_AXIS Eng_nAvrg EngN 16 0.00 6000.000 FORMAT "%8.3" EXTENDED_LIMITS -32768.00 32767.00 DEPOSIT ABSOLUTE /end AXIS_DESCR
 /begin AXIS_DESCR STD_AXIS InjCtl_qSetUnBal InjMassCyc 16 0.00 327.6700 FORMAT "%8.4" EXTENDED_LIMITS -327.6800 327.6700 DEPOSIT ABSOLUTE /end AXIS_DESCR
/end CHARACTERISTIC
/begin CHARACTERISTIC InjCrv_tiPiI1Bas3_MAP "Zeitkomponente Ansteuerbeginn Grundwertekennfeld PiI1 mit Freigabe PiI3" MAP 0xE0FF4 Kf_Xs16_Ys16_Ws16 13000.00 InjTime_us 0.00 13000.00 FORMAT "%8.2" EXTENDED_LIMITS -32768.00 32767.00
 /begin AXIS_DESCR STD_AXIS Eng_nAvrg EngN 2 0.00 6000.000 FORMAT "%8.3" EXTENDED_LIMITS -32768.00 32767.00 DEPOSIT ABSOLUTE /end AXIS_DESCR
 /begin AXIS_DESCR STD_AXIS InjCtl_qSetUnBal InjMassCyc 2 0.00 327.6700 FORMAT "%8.4" EXTENDED_LIMITS -327.6800 327.6700 DEPOSIT ABSOLUTE /end AXIS_DESCR
/end CHARACTERISTIC
/begin CHARACTERISTIC InjCrv_tiPiI1BasCylOffs_MAP "Basiskennfeld des Offsets des Ansteueerbeginns der VE1" MAP 0xDB7CE Kf_Xs16_Ys16_Ws16 8000.000 InjTime_us -3000.000 5000.000 FORMAT "%8.3" EXTENDED_LIMITS -32768.00 32767.00
 /begin AXIS_DESCR STD_AXIS Eng_nAvrg EngN 5 0.00 6000.000 FORMAT "%8.3" EXTENDED_LIMITS -32768.00 32767.00 DEPOSIT ABSOLUTE /end AXIS_DESCR
 /begin AXIS_DESCR STD_AXIS InjCtl_qSetUnBal InjMassCyc 5 0.00 327.6700 FORMAT "%8.4" EXTENDED_LIMITS -327.6800 327.6700 DEPOSIT ABSOLUTE /end AXIS_DESCR
/end CHARACTERISTIC
/begin CHARACTERISTIC InjCrv_tiPiI1BasStrt_MAP "base map of PiI1 SOE time calculation, if PiI3 is active" MAP 0xE124C Kf_Xs16_Ys16_Ws16 13000.00 InjTime_us 0.00 13000.00 FORMAT "%8.2" EXTENDED_LIMITS -32768.00 32767.00
 /begin AXIS_DESCR STD_AXIS Eng_nAvrg EngN 8 0.00 6000.000 FORMAT "%8.3" EXTENDED_LIMITS -32768.00 32767.00 DEPOSIT ABSOLUTE /end AXIS_DESCR
 /begin AXIS_DESCR STD_AXIS InjCtl_qSetUnBal InjMassCyc 8 0.00 327.6700 FORMAT "%8.4" EXTENDED_LIMITS -327.6800 327.6700 DEPOSIT ABSOLUTE /end AXIS_DESCR
/end CHARACTERISTIC
/begin CHARACTERISTIC InjCrv_tiPiI1MinRgn_MAP "Mappe des Pil1-Abstands im Fall der Regeneration" MAP 0xE073C Kf_Xs16_Ys16_Ws16 13000.00 InjTime_us 0.00 13000.00 FORMAT "%8.2" EXTENDED_LIMITS -32768.00 32767.00
 /begin AXIS_DESCR STD_AXIS Eng_nAvrg EngN 10 0.00 6000.000 FORMAT "%8.3" EXTENDED_LIMITS -32768.00 32767.00 DEPOSIT ABSOLUTE /end AXIS_DESCR
 /begin AXIS_DESCR STD_AXIS InjCtl_qSetUnBal InjMassCyc 10 0.00 327.6700 FORMAT "%8.4" EXTENDED_LIMITS -327.6800 327.6700 DEPOSIT ABSOLUTE /end AXIS_DESCR
/end CHARACTERISTIC
/begin CHARACTERISTIC InjCrv_tiPiI1Min_MAP "Kennfeld zur Ermittlung der minimalen Zeit der PiI1 relativ zur MI" MAP 0xE0830 Kf_Xs16_Ys16_Ws16 13000.00 InjTime_us 0.00 13000.00 FORMAT "%8.2" EXTENDED_LIMITS -32768.00 32767.00
 /begin AXIS_DESCR STD_AXIS Eng_nAvrg EngN 10 0.00 6000.000 FORMAT "%8.3" EXTENDED_LIMITS -32768.00 32767.00 DEPOSIT ABSOLUTE /end AXIS_DESCR
 /begin AXIS_DESCR STD_AXIS InjCtl_qSetUnBal InjMassCyc 10 0.00 327.6700 FORMAT "%8.4" EXTENDED_LIMITS -327.6800 327.6700 DEPOSIT ABSOLUTE /end AXIS_DESCR
/end CHARACTERISTIC
/begin CHARACTERISTIC InjCrv_tiPiI2BasCylOffs_MAP "betriebspunktabhängige Berechnung des Offsets der PiI2" MAP 0xDB818 Kf_Xs16_Ys16_Ws16 8000.000 InjTime_us -3000.000 5000.000 FORMAT "%8.3" EXTENDED_LIMITS -32768.00 32767.00
 /begin AXIS_DESCR STD_AXIS Eng_nAvrg EngN 5 0.00 6000.000 FORMAT "%8.3" EXTENDED_LIMITS -32768.00 32767.00 DEPOSIT ABSOLUTE /end AXIS_DESCR
 /begin AXIS_DESCR STD_AXIS InjCtl_qSetUnBal InjMassCyc 5 0.00 327.6700 FORMAT "%8.4" EXTENDED_LIMITS -327.6800 327.6700 DEPOSIT ABSOLUTE /end AXIS_DESCR
/end CHARACTERISTIC
/begin CHARACTERISTIC InjCrv_tiPiIMax_C "#SSD maximale Zeitkomponente PiI, bedingt durch Hardware" VALUE 0xE0924 Kw_Ws16 13000.00 InjTime_us 0.00 13000.00 FORMAT "%8.2" EXTENDED_LIMITS -32768.00 32767.00 /end CHARACTERISTIC
/begin CHARACTERISTIC InjCrv_tPiI2RlsAirTXDelta_C "Hysteresis for intake air temperature" VALUE 0xDAFB4 Kw_Ws16 6553.500 TempDiff_Cels -3276.800 3276.700 FORMAT "%8.3" /end CHARACTERISTIC
/begin CHARACTERISTIC InjCrv_tPiI2RlsAirTXLo1_C "Threshold 1 for intake air temperature" VALUE 0xDAFB6 Kw_Ws16 950.000 Temp_Cels -50.140 899.860 FORMAT "%8.3" EXTENDED_LIMITS -3549.940 3003.560 /end CHARACTERISTIC
/begin CHARACTERISTIC InjCrv_tPiI2RlsAirTXLo2_C "Threshold 2 for intake air temperature" VALUE 0xDAFB8 Kw_Ws16 950.000 Temp_Cels -50.140 899.860 FORMAT "%8.3" EXTENDED_LIMITS -3549.940 3003.560 /end CHARACTERISTIC
/begin CHARACTERISTIC InjCrv_tPiI2RlsAirTXLo3_C "Threshold 3 for intake air temperature" VALUE 0xDAFBA Kw_Ws16 950.000 Temp_Cels -50.140 899.860 FORMAT "%8.3" EXTENDED_LIMITS -3549.940 3003.560 /end CHARACTERISTIC
/begin CHARACTERISTIC InjCrv_tPiI2RlsAirTXLo4_C "Threshold 4 for intake air temperature" VALUE 0xDAFBC Kw_Ws16 950.000 Temp_Cels -50.140 899.860 FORMAT "%8.3" EXTENDED_LIMITS -3549.940 3003.560 /end CHARACTERISTIC
/begin CHARACTERISTIC InjCrv_tPiI2RlsAirTXLo5_C "Threshold 5 for intake air temperature" VALUE 0xDAFBE Kw_Ws16 950.000 Temp_Cels -50.140 899.860 FORMAT "%8.3" EXTENDED_LIMITS -3549.940 3003.560 /end CHARACTERISTIC
/begin CHARACTERISTIC InjCrv_tPiI2RlsAirTXLo6_C "Threshold 6 for intake air temperature" VALUE 0xDAFC0 Kw_Ws16 950.000 Temp_Cels -50.140 899.860 FORMAT "%8.3" EXTENDED_LIMITS -3549.940 3003.560 /end CHARACTERISTIC
/begin CHARACTERISTIC InjCrv_tPiI2RlsTAirXDelta_C " Hysteresis for Air temperature" VALUE 0xDB208 Kw_Ws16 6553.500 TempDiff_Cels -3276.800 3276.700 FORMAT "%8.3" /end CHARACTERISTIC
/begin CHARACTERISTIC InjCrv_tPiI2RlsTAirXLo1_C "Air temperature lower threshold" VALUE 0xDB20A Kw_Ws16 950.000 Temp_Cels -50.140 899.860 FORMAT "%8.3" EXTENDED_LIMITS -3549.940 3003.560 /end CHARACTERISTIC
/begin CHARACTERISTIC InjCrv_tPiI2RlsTAirXLo2_C "Air temperature upper threshold" VALUE 0xDB20C Kw_Ws16 950.000 Temp_Cels -50.140 899.860 FORMAT "%8.3" EXTENDED_LIMITS -3549.940 3003.560 /end CHARACTERISTIC
/begin CHARACTERISTIC InjCrv_tPiI2RlsTEngXDelta_C "Hysteresis for engine temperature" VALUE 0xDB20E Kw_Ws16 6553.500 TempDiff_Cels -3276.800 3276.700 FORMAT "%8.3" /end CHARACTERISTIC
/begin CHARACTERISTIC InjCrv_tPiI2RlsTEngXLo1_C "Lower threshold for engine temperature" VALUE 0xDB210 Kw_Ws16 950.000 Temp_Cels -50.140 899.860 FORMAT "%8.3" EXTENDED_LIMITS -3549.940 3003.560 /end CHARACTERISTIC
/begin CHARACTERISTIC InjCrv_tPiI2RlsTEngXLo2_C " Upper threshold for engine temperature" VALUE 0xDB212 Kw_Ws16 950.000 Temp_Cels -50.140 899.860 FORMAT "%8.3" EXTENDED_LIMITS -3549.940 3003.560 /end CHARACTERISTIC
/begin CHARACTERISTIC InjCrv_vPiI2RlsXDelta_C "Hysteresis for vehicle speed" VALUE 0xDB214 Kw_Ws16 655.3500 Vel -327.6800 327.6700 FORMAT "%8.4" /end CHARACTERISTIC
/begin CHARACTERISTIC InjCrv_vPiI2RlsXLo123_C "Threshold for vehicle speed in 1,2 or 3rd gear" VALUE 0xDB216 Kw_Ws16 655.3500 Vel -327.6800 327.6700 FORMAT "%8.4" /end CHARACTERISTIC
/begin CHARACTERISTIC InjCrv_vPiI2RlsXLo4_C "Threshold for vehicle speed in 4th gear" VALUE 0xDB218 Kw_Ws16 655.3500 Vel -327.6800 327.6700 FORMAT "%8.4" /end CHARACTERISTIC
/begin CHARACTERISTIC InjCrv_vPiI2RlsXLo5_C "Threshold for vehicle speed in 5th gear" VALUE 0xDB21A Kw_Ws16 655.3500 Vel -327.6800 327.6700 FORMAT "%8.4" /end CHARACTERISTIC
/begin CHARACTERISTIC InjCrv_vPiI2RlsXLo6_C "Threshold for vehicle speed in 6th gear" VALUE 0xDB21C Kw_Ws16 655.3500 Vel -327.6800 327.6700 FORMAT "%8.4" /end CHARACTERISTIC
/begin MEASUREMENT HPUn_dvolPmpMaxCor_mp "Wirkungsgrad korrigiertes physikalisches Maximum des Volumenstroms einer Hochdruckpumpe" SWORD Qp_mm3_sec 1 100 -327680.0 327670.0 FORMAT "%8.1" ECU_ADDRESS 0x8FF4C4 /end MEASUREMENT
/begin MEASUREMENT HPUn_dvolPmpMax_mp "Physikalisches Maximum des Volumenstroms einer Hochdruckpumpe" SWORD Qp_mm3_sec 1 100 -327680.0 327670.0 FORMAT "%8.1" ECU_ADDRESS 0x8FF4C6 /end MEASUREMENT
/begin MEASUREMENT HPUn_etaPmpFlTemp_mp "Kraftstofftemperaturabhängiger Wirkungsgrad der Hochdruckpumpe" SWORD Eta 1 100 -256.0000 255.9922 FORMAT "%8.4" ECU_ADDRESS 0x8FF4C8 /end MEASUREMENT
/begin MEASUREMENT HPUn_etaPmpMaxAged_mp "maximaler Wirkungsgrad einer gealterten Hochdruckpumpe" SWORD Eta 1 100 -256.0000 255.9922 FORMAT "%8.4" ECU_ADDRESS 0x8FF4CA /end MEASUREMENT
/begin MEASUREMENT HPUn_numInjQntBal "Maximale Anzahl an Einspritzungen aufgrund der Mengenbilanz der Hochdruckpumpe" UBYTE OneToOne 1 100 0.00 255.0 FORMAT "%5.1" ECU_ADDRESS 0x7F8912 /end MEASUREMENT
/begin MEASUREMENT HPUn_pRailDvtFlt_mp "Gefilterte Raildruck Regelabweichung" SWORD Pres_Rail 1 100 -3276.800 3276.700 FORMAT "%5.3" ECU_ADDRESS 0x8FF4D2 /end MEASUREMENT
/begin MEASUREMENT HPUn_qBalLim_mp "Begrenzungsmenge auf Grund der Mengenbilanz der Hochdruckpumpe" SWORD InjMassCyc 1 100 -327.6800 327.6700 FORMAT "%8.4" ECU_ADDRESS 0x8FF4CC /end MEASUREMENT
/begin MEASUREMENT HPUn_qFlTempLim_mp "Begrenzungsmenge abhängig der Kraftstofftemperatur" SWORD InjMassCyc 1 100 -327.6800 327.6700 FORMAT "%8.4" ECU_ADDRESS 0x8FF4CE /end MEASUREMENT
/begin MEASUREMENT HPUn_qLim "Begrenzungsmenge der Hochdruckpumpe" SWORD InjMassCyc 1 100 -327.6800 327.6700 FORMAT "%8.4" ECU_ADDRESS 0x7F8E12 /end MEASUREMENT
/begin MEASUREMENT HPUn_rTransCrS "Übersetzung Hochdruckpumpe zu Kurbelwelle" SWORD TransR 1 100 -327.6800 327.6700 FORMAT "%8.4" ECU_ADDRESS 0x7F8E14 /end MEASUREMENT
/begin MEASUREMENT HPUn_stNumInjMax_mp "Statusvariable, Mengebilanz der Hochruckpumpe" UBYTE OneToOne 1 100 0.00 255.0 FORMAT "%5.1" ECU_ADDRESS 0x8FF4D4 /end MEASUREMENT
/begin MEASUREMENT HPUn_stQntBal_mp "Status der Mengenbilanz der Hochdruckpumpe" UBYTE OneToOne 1 100 0.00 255.0 FORMAT "%5.1" ECU_ADDRESS 0x8FF4D0 /end MEASUREMENT
/begin MEASUREMENT HPUn_trqDes "Momentenanforderung der Hochdruckpumpe" SWORD Trq 1 100 -3276.800 3276.700 FORMAT "%8.3" ECU_ADDRESS 0x7F8E16 /end MEASUREMENT
/begin MEASUREMENT HWEMon_ctRecovery "Anzahl der während 2 Sekunden aufgetretenen Recoverys" UBYTE OneToOne 1 100 0.00 255.0 FORMAT "%5.1" ECU_ADDRESS 0x7F8913 /end MEASUREMENT
/begin MEASUREMENT HWEMon_numEEPBlockfailed "Nummer des ersten EEPROM Blockes der als defekt erkannt wurde" UBYTE OneToOne 1 100 0.00 255.0 FORMAT "%5.1" ECU_ADDRESS 0x7F8914 /end MEASUREMENT
/begin MEASUREMENT HWEMon_numRecovery "Herkunft des letzten Reset ( >0 = Recovery )" UWORD OneToOne 1 100 0.00 65535.00 FORMAT "%8.2" ECU_ADDRESS 0x7F8E18 /end MEASUREMENT
/begin MEASUREMENT HWEMon_recLocHigh_mp "HighAdresse recovery location" UWORD OneToOne 1 100 0.00 65535.00 FORMAT "%8.2" ECU_ADDRESS 0x6F816A /end MEASUREMENT
/begin MEASUREMENT HWEMon_recLocLow_mp "LowAdresse recovery location" UWORD OneToOne 1 100 0.00 65535.00 FORMAT "%8.2" ECU_ADDRESS 0x6F816C /end MEASUREMENT
/begin MEASUREMENT HWEMon_stVoltMon_mp "Latchbetrieb der Überspannungsüberwachung (1 = Latch aktiv)" UBYTE OneToOne 1 100 0.00 255.0 FORMAT "%5.1" ECU_ADDRESS 0x8FF4D5 /end MEASUREMENT
/begin MEASUREMENT IATSCD_dtAir "Änderungsrate der angesaugten Lufttemperatur" SWORD TempCels_100ms 1 100 -32768.00 32767.00 FORMAT "%8.2" ECU_ADDRESS 0x7F8E1A /end MEASUREMENT
/begin MEASUREMENT IATSCD_dtAirCats "Anderung von IATSCD_tAirCats zwischen den Abtastschritten n und n-1" SWORD TempCels_100ms 1 100 -32768.00 32767.00 FORMAT "%8.2" ECU_ADDRESS 0x7F8E1C /end MEASUREMENT
/begin MEASUREMENT IATSCD_factHFM_mp "Faktor Ansauglufttemperatur" SWORD Fact 1 100 -4.000000 3.999878 FORMAT "%8.6" ECU_ADDRESS 0x8FF4D6 /end MEASUREMENT
/begin MEASUREMENT IATSCD_facttAir_mp "Lufttemperaturfaktor" SWORD Fact 1 100 -4.000000 3.999878 FORMAT "%8.6" ECU_ADDRESS 0x8FF4D8 /end MEASUREMENT
/begin MEASUREMENT IATSCD_swtSig "Signalquelle Schalter ADC/CAN" UBYTE OneToOne 1 100 0.00 255.0 FORMAT "%5.1" ECU_ADDRESS 0x7F8915 /end MEASUREMENT
/begin MEASUREMENT IATSCD_swtSigCats "Signalquelle Schalter Ladelufttemperatur über ADC oder CAN" UBYTE OneToOne 1 100 0.00 255.0 FORMAT "%5.1" ECU_ADDRESS 0x7F8916 /end MEASUREMENT
/begin MEASUREMENT IATSCD_tAir "Ansauglufttemperatur" SWORD Temp_Cels 1 100 -50.140 899.860 FORMAT "%8.3" ECU_ADDRESS 0x7F8E1E /end MEASUREMENT
/begin MEASUREMENT IATSCD_tAirCats "Ladelufttemperatur nach Ladeluftkühler" SWORD Temp_Cels 1 100 -50.140 899.860 FORMAT "%8.3" ECU_ADDRESS 0x7F8E20 /end MEASUREMENT
/begin MEASUREMENT IATSCD_tAirHFM_mp "Lufttemperatur von HFM" SWORD Temp_Cels 1 100 -50.140 899.860 FORMAT "%8.3" ECU_ADDRESS 0x8FF4DA /end MEASUREMENT
/begin MEASUREMENT IATSCD_tAirLin "linearisierter Wert aus HWK vorm Aufruf der Übergangsfunktion" SWORD Temp_Cels 1 100 -50.140 899.860 FORMAT "%8.3" ECU_ADDRESS 0x7F8E22 /end MEASUREMENT
/begin MEASUREMENT IATSCD_tAirLinCats "Ladelufttemperatur - Linearisierter Wert aus HWK vor Aufruf der Übergangsfunktion" SWORD Temp_Cels 1 100 -50.140 899.860 FORMAT "%8.3" ECU_ADDRESS 0x7F8E24 /end MEASUREMENT
/begin MEASUREMENT IATSCD_tInit_mp "Initial Lufttemperaturwert" SWORD TempDiff_Cels 1 100 -3276.800 3276.700 FORMAT "%8.3" ECU_ADDRESS 0x8FF4DC /end MEASUREMENT
/begin MEASUREMENT IATSCD_tStrtFlt_mp "Start Lufttemperaturwert" SWORD Temp_Cels 1 100 -50.140 899.860 FORMAT "%8.3" ECU_ADDRESS 0x8FF4DE /end MEASUREMENT
/begin MEASUREMENT IATSCD_tStrtFreeze_mp "Startlufttemperatur (gefroren)" SWORD Temp_Cels 1 100 -50.140 899.860 FORMAT "%8.3" ECU_ADDRESS 0x8FF4E0 /end MEASUREMENT
/begin MEASUREMENT IATSCD_uRaw "Lufttemperatur Spannungsrohwert" SWORD Volt 1 100 -160156.4 160151.5 FORMAT "%8.1" ECU_ADDRESS 0x7F8E26 /end MEASUREMENT
/begin MEASUREMENT IATSCD_uRawCats "Ladelufttemperatur Spannungsrohwert" SWORD Volt 1 100 -160156.4 160151.5 FORMAT "%8.1" ECU_ADDRESS 0x7F8E28 /end MEASUREMENT
/begin MEASUREMENT IBSCD_BsdControl_mp "flags to koordinate communication between HT and KT" UBYTE OneToOne 1 100 0.00 255.0 FORMAT "%5.1" ECU_ADDRESS 0x8FF4E2 /end MEASUREMENT
/begin MEASUREMENT IBSCD_BsdData_mp "data from IBS and to IBS" UBYTE OneToOne 1 100 0.00 255.0 FORMAT "%5.1" ECU_ADDRESS 0x8FF4E4 /end MEASUREMENT
/begin MEASUREMENT IBSCD_BsdRegAdr_mp "adress of BSD register in IBS" UBYTE OneToOne 1 100 0.00 255.0 FORMAT "%5.1" ECU_ADDRESS 0x8FF4E5 /end MEASUREMENT
/begin MEASUREMENT IBSCD_stB_ibsactiv_mp "status IBS" UBYTE B_TRUE 1 100 0.00 1.00000000000 FORMAT "%13.11" ECU_ADDRESS 0x8FF4E3 /end MEASUREMENT
/begin MEASUREMENT IBSCD_stB_ibsdetec_mp "IBS detection status" UBYTE B_TRUE 1 100 0.00 1.00000000000 FORMAT "%13.11" ECU_ADDRESS 0x8FF4E6 /end MEASUREMENT
/begin MEASUREMENT IgnLck_st "Abschaltanforderungen für Immobilizer/Wegfahrsperre" UBYTE OneToOne 1 100 0.00 255.0 FORMAT "%5.1" ECU_ADDRESS 0x7F8917 /end MEASUREMENT
/begin MEASUREMENT ImmCtl_stIniSeq "status initialisation" UBYTE OneToOne 1 100 0.00 255.0 FORMAT "%5.1" ECU_ADDRESS 0x7F891A /end MEASUREMENT
/begin MEASUREMENT IndSys_mAirPerCylLim_mp "Air mass Per Cylinder value" SWORD AirMassPerCyl 1 100 -3276.800 3276.700 FORMAT "%8.3" ECU_ADDRESS 0x8FF512 /end MEASUREMENT
/begin MEASUREMENT IndSys_rVSA "Sollposition für Einlaßkanalabschaltung" SWORD DtyCyc 1 100 -327.6800 327.6700 FORMAT "%8.4" ECU_ADDRESS 0x7F8E30 /end MEASUREMENT
/begin MEASUREMENT IndSys_rVSAAPSCorr_mp "Messpunkt für die luftdruckabhängige Korrektur der Drosselklappensteuerung" SWORD DtyCyc 1 100 -327.6800 327.6700 FORMAT "%8.4" ECU_ADDRESS 0x8FF516 /end MEASUREMENT
/begin MEASUREMENT IndSys_rVSAATCorr_mp "Lufttemperatur Korrekturwert" SWORD DtyCyc 1 100 -327.6800 327.6700 FORMAT "%8.4" ECU_ADDRESS 0x8FF518 /end MEASUREMENT
/begin MEASUREMENT IndSys_rVSABase_mp "Drallniveausteuerung - Grundwert" SWORD DtyCyc 1 100 -327.6800 327.6700 FORMAT "%8.4" ECU_ADDRESS 0x8FF51A /end MEASUREMENT
/begin MEASUREMENT IndSys_rVSAByp_mp "Bypass-Label, Kopie von IndSys_rVSA" SWORD DtyCyc 1 100 -327.6800 327.6700 FORMAT "%8.4" ECU_ADDRESS 0x8FF51C /end MEASUREMENT
/begin MEASUREMENT IndSys_rVSACorr_mp "korrigierter Wert (vor der Maximalwert-Begrenzung)" SWORD DtyCyc 1 100 -327.6800 327.6700 FORMAT "%8.4" ECU_ADDRESS 0x8FF51E /end MEASUREMENT
/begin MEASUREMENT IndSys_rVSACTCorr_mp "Külmitteltemperatur Korrekturwert" SWORD DtyCyc 1 100 -327.6800 327.6700 FORMAT "%8.4" ECU_ADDRESS 0x8FF520 /end MEASUREMENT
/begin MEASUREMENT IndSys_stPart1_mp "Status Induction system" UBYTE OneToOne 1 100 0.00 255.0 FORMAT "%5.1" ECU_ADDRESS 0x8FF514 /end MEASUREMENT
/begin MEASUREMENT IndSys_stPart2_mp "Status Induction system" UBYTE OneToOne 1 100 0.00 255.0 FORMAT "%5.1" ECU_ADDRESS 0x8FF515 /end MEASUREMENT
/begin MEASUREMENT IndSys_tFld "Temperaturfeld Ansaugtrakt" SWORD Temp_Cels 1 100 -50.140 899.860 FORMAT "%8.3" ARRAY_SIZE 3 ECU_ADDRESS 0x7F9334 /end MEASUREMENT
/begin MEASUREMENT IndSys_tiStartDelay_mp "Motortemperaturabhänige Startverzögerung" SWORD Time_s 1 100 -327.6800 327.6700 FORMAT "%8.4" ECU_ADDRESS 0x8FF522 /end MEASUREMENT
/begin MEASUREMENT InjCrv_dpMIDynCor "DT1 gefilterter Atmosphärendruck" SWORD dp_dZ20 1 100 -327680.0 327670.0 FORMAT "%8.1" ECU_ADDRESS 0x7F8E3C /end MEASUREMENT
/begin MEASUREMENT InjCrv_dqSetUnBalFltLim "gefilterter, limitierter Einspritzmengengradient" SWORD InjMassPerSec_20ms 1 100 -16384.00 16383.50 FORMAT "%8.2" ECU_ADDRESS 0x7F8E3E /end MEASUREMENT
/begin MEASUREMENT InjCrv_dqSetUnBal_mp "InjCrv_qSetUnBal DT1 filtered" SWORD InjMassPerSec_20ms 1 100 -16384.00 16383.50 FORMAT "%8.2" ECU_ADDRESS 0x8FF55C /end MEASUREMENT
/begin MEASUREMENT InjCrv_facMI1DynCor2_mp "dq correction factor MI SOE customer correction II" SWORD Fact 1 100 -4.000000 3.999878 FORMAT "%8.6" ECU_ADDRESS 0x8FF55E /end MEASUREMENT
/begin MEASUREMENT InjCrv_facMI1DynCorSlow2 "factor depending on atmospheric pressure" SWORD Fact 1 100 -4.000000 3.999878 FORMAT "%8.6" ECU_ADDRESS 0x7F8E40 /end MEASUREMENT
/begin MEASUREMENT InjCrv_facMIAPSPhiCor "atmosphärendruckabhängiger Korrekturfaktor für die MI1" SWORD Fact 1 100 -4.000000 3.999878 FORMAT "%8.6" ECU_ADDRESS 0x7F8E42 /end MEASUREMENT
/begin MEASUREMENT InjCrv_facMIAPSPhiCor2 "atmosphärendruckabhängiger Korrekturfaktor -2 für MI1" SWORD Fact 1 100 -4.000000 3.999878 FORMAT "%8.6" ECU_ADDRESS 0x7F8E44 /end MEASUREMENT
/begin MEASUREMENT InjCrv_facMIAPSPhiCorStrt "Korrekturfaktur für Atmosphärendruck im Start" SWORD Fact 1 100 -4.000000 3.999878 FORMAT "%8.6" ECU_ADDRESS 0x7F8E46 /end MEASUREMENT
/begin MEASUREMENT InjCrv_facMIATSPhiCor "ansauglufttemperaturabhängiger Korrekturfaktor für die MI1" SWORD Fact 1 100 -4.000000 3.999878 FORMAT "%8.6" ECU_ADDRESS 0x7F8E48 /end MEASUREMENT
/begin MEASUREMENT InjCrv_facMIATSPhiCor2 "ansauglufttemperaturabhängiger Korrekturfaktor -2 für MI1" SWORD Fact 1 100 -4.000000 3.999878 FORMAT "%8.6" ECU_ADDRESS 0x7F8E4A /end MEASUREMENT
/begin MEASUREMENT InjCrv_facMIATSPhiCorStrt "Korrekturfaktur für Umgebungstemperatur im Start" SWORD Fact 1 100 -4.000000 3.999878 FORMAT "%8.6" ECU_ADDRESS 0x7F8E4C /end MEASUREMENT
/begin MEASUREMENT InjCrv_facMIDynCor "resultierneder Faktor abhängig von Lufttemperatur und Wassertemperatur" SWORD Fact 1 100 -4.000000 3.999878 FORMAT "%8.6" ECU_ADDRESS 0x7F8E4E /end MEASUREMENT
/begin MEASUREMENT InjCrv_facMIETSPhiCor "Gewichtsfaktor für Ansteuerbeginnkorrektur Haupteinspritzung in Abhängigkeit der Motortemperatur" SWORD Fact 1 100 -4.000000 3.999878 FORMAT "%8.6" ECU_ADDRESS 0x7F8E50 /end MEASUREMENT
/begin MEASUREMENT InjCrv_facMIETSPhiCor1 "motortemperaturabhängiger Korrekturfaktor -1 für MI1" SWORD Fact 1 100 -4.000000 3.999878 FORMAT "%8.6" ECU_ADDRESS 0x7F8E52 /end MEASUREMENT
/begin MEASUREMENT InjCrv_facMIETSPhiCor12 """motortemperaturabhängiger Korrekturfaktor für MI1 bei inaktiver PiI2""" SWORD Fact 1 100 -4.000000 3.999878 FORMAT "%8.6" ECU_ADDRESS 0x7F8E54 /end MEASUREMENT
/begin MEASUREMENT InjCrv_facMIETSPhiCor2 "motortemperaturabhängiger Korrekturfaktor -2 für MI1" SWORD Fact 1 100 -4.000000 3.999878 FORMAT "%8.6" ECU_ADDRESS 0x7F8E56 /end MEASUREMENT
/begin MEASUREMENT InjCrv_facMIETSPhiCorStrt "Korrekturfaktur für Motortemperatur im Start" SWORD Fact 1 100 -4.000000 3.999878 FORMAT "%8.6" ECU_ADDRESS 0x7F8E58 /end MEASUREMENT
/begin MEASUREMENT InjCrv_facMIFTSRailCor "Korrekturfaktor für die MI1, abhängig von der kraftstofftemperaturabhängigen Raildruckkorrektur" SWORD Fact 1 100 -4.000000 3.999878 FORMAT "%8.6" ECU_ADDRESS 0x7F8E5A /end MEASUREMENT
/begin MEASUREMENT InjCrv_facMIFTSRailCorStrt "Korrekturfaktor für Kraftstofftemperatur im Start" SWORD Fact 1 100 -4.000000 3.999878 FORMAT "%8.6" ECU_ADDRESS 0x7F8E5C /end MEASUREMENT
/begin MEASUREMENT InjCrv_facMIPDynCor_mp "Korrekturfaktor abhängig vom Raildruck" SWORD Fact 1 100 -4.000000 3.999878 FORMAT "%8.6" ECU_ADDRESS 0x8FF560 /end MEASUREMENT
/begin MEASUREMENT InjCrv_facPiI2APSQCor "atmosphärendruckabhängiger Mengenkorrekturfaktor für Voreinspritzung 2" SWORD Fact 1 100 -4.000000 3.999878 FORMAT "%8.6" ECU_ADDRESS 0x7F8E88 /end MEASUREMENT
/begin MEASUREMENT InjCrv_facPiI2APSQCorStrt "atmospheric pressure dependent correction factor for quantity PiI2" SWORD Fact 1 100 -4.000000 3.999878 FORMAT "%8.6" ECU_ADDRESS 0x7F8E8A /end MEASUREMENT
/begin MEASUREMENT InjCrv_facPiI2APSSOECor "Korrekturfaktor für Voreinspritzung 2 durch den Luftdruck" SWORD Fact 1 100 -4.000000 3.999878 FORMAT "%8.6" ECU_ADDRESS 0x7F8E8C /end MEASUREMENT
/begin MEASUREMENT InjCrv_facPiI2APSSOECorStrt "Korrekturfaktor für die 2. Voreinspirtzung abhängig vom Luftdruck während des Startvorgangs" SWORD Fact 1 100 -4.000000 3.999878 FORMAT "%8.6" ECU_ADDRESS 0x7F8E8E /end MEASUREMENT
/begin MEASUREMENT InjCrv_facPiI2ATSQCor "ansauglufttemperaturabhängiger Mengenkorrekturfaktor für Voreinspritzung 2" SWORD Fact 1 100 -4.000000 3.999878 FORMAT "%8.6" ECU_ADDRESS 0x7F8E90 /end MEASUREMENT
/begin MEASUREMENT InjCrv_facPiI2ATSQCorStrt "intake air temperature dependent correction factor for quantity PiI2" SWORD Fact 1 100 -4.000000 3.999878 FORMAT "%8.6" ECU_ADDRESS 0x7F8E92 /end MEASUREMENT
/begin MEASUREMENT InjCrv_facPiI2ETSQCor "motortemperaturabhängiger Mengenkorrekturfaktor für Voreinspritzung 2" SWORD Fact 1 100 -4.000000 3.999878 FORMAT "%8.6" ECU_ADDRESS 0x7F8E94 /end MEASUREMENT
/begin MEASUREMENT InjCrv_facPiI2ETSQCorStrt "atmospheric pressure dependent correction factor for quantity PiI2" SWORD Fact 1 100 -4.000000 3.999878 FORMAT "%8.6" ECU_ADDRESS 0x7F8E96 /end MEASUREMENT
/begin MEASUREMENT InjCrv_facPiI2ETSSOECor "motortemperaturabhängiger Ansteuerbeginnkorrekturfaktor für Voreinspritzung 2" SWORD Fact 1 100 -4.000000 3.999878 FORMAT "%8.6" ECU_ADDRESS 0x7F8E98 /end MEASUREMENT
/begin MEASUREMENT InjCrv_facPiI2ETSSOECorStrt "engine temperature dependent correction factor for PiI2-SOE" SWORD Fact 1 100 -4.000000 3.999878 FORMAT "%8.6" ECU_ADDRESS 0x7F8E9A /end MEASUREMENT
/begin MEASUREMENT InjCrv_facRmpCylOffs_mp "Messpunkt gerampter Freigabestatus der Funktion cyloffs" SWORD Fact 1 100 -4.000000 3.999878 FORMAT "%8.6" ECU_ADDRESS 0x8FF538 /end MEASUREMENT
/begin MEASUREMENT InjCrv_MI1RgnTypeVal "Aktivierungswert für die Freigabe MI1 über das Abgasnachbehandlungssystem" ULONG EGTSwt 1 100 0.00 262.143999939 FORMAT "%13.9" ECU_ADDRESS 0x7F9280 /end MEASUREMENT
/begin MEASUREMENT InjCrv_MI1RgnVal "Wert für Regenerationsstatus MI1" ULONG EGTSwt 1 100 0.00 262.143999939 FORMAT "%13.9" ECU_ADDRESS 0x7F9284 /end MEASUREMENT
/begin MEASUREMENT InjCrv_numInjDes_mp "gewünschte Anzahl an Einspritzungen pro Arbeitsspiel" UBYTE OneToOne 1 100 0.00 255.0 FORMAT "%5.1" ECU_ADDRESS 0x8FF524 /end MEASUREMENT
/begin MEASUREMENT InjCrv_numInjLim_mp "Erlaubte Anzahl an Einspritzungen" UBYTE OneToOne 1 100 0.00 255.0 FORMAT "%5.1" ECU_ADDRESS 0x8FF525 /end MEASUREMENT
/begin MEASUREMENT InjCrv_numInjMaxSys "Systembedingte maximal erlaubte Anzahl an Einspritzungen" UBYTE OneToOne 1 100 0.00 255.0 FORMAT "%5.1" ECU_ADDRESS 0x7F8924 /end MEASUREMENT
/begin MEASUREMENT InjCrv_phiMI1AddCor "Korrekturwinkel für Ansteuerbeginn MI1 in Abhängigkeit kundenspezifischer Funktionen" SWORD AngleCrS 1 100 -768.0000 767.9766 FORMAT "%8.4" ECU_ADDRESS 0x7F8EB6 /end MEASUREMENT
/begin MEASUREMENT InjCrv_phiMI1AddCor2 "kundenspezifischer Korrekturwinkel für die MI bei aktiver PiI2" SWORD AngleCrS 1 100 -768.0000 767.9766 FORMAT "%8.4" ECU_ADDRESS 0x7F8EB8 /end MEASUREMENT
/begin MEASUREMENT InjCrv_phiMI1BasCylOffs_mp "Messpunkt Basiswert des Offsets des Ansteuerbeginns der MI1" SWORD AngleCrS 1 100 -768.0000 767.9766 FORMAT "%8.4" ECU_ADDRESS 0x8FF53A /end MEASUREMENT
/begin MEASUREMENT InjCrv_phiMI1Bas_mp "Grundwert Ansteuerbeginn MI1" SWORD AngleCrS 1 100 -768.0000 767.9766 FORMAT "%8.4" ECU_ADDRESS 0x8FF544 /end MEASUREMENT
/begin MEASUREMENT InjCrv_phiMI1Cor_mp "korrigierter Grundwert Ansteuerbeginn MI1" SWORD AngleCrS 1 100 -768.0000 767.9766 FORMAT "%8.4" ECU_ADDRESS 0x8FF546 /end MEASUREMENT
/begin MEASUREMENT InjCrv_phiMI1CylOffs "Messpunkt Array Zyl[1-8] Offset Einspritzwinkel der MI1" SWORD AngleCrS 1 100 -768.0000 767.9766 FORMAT "%8.4" ARRAY_SIZE 7 ECU_ADDRESS 0x7F940E /end MEASUREMENT
/begin MEASUREMENT InjCrv_phiMI1Des "gewünschter Bezugswinkel für Beginn der MI1" SWORD AngleCrS 1 100 -768.0000 767.9766 FORMAT "%8.4" ECU_ADDRESS 0x7F8EBA /end MEASUREMENT
/begin MEASUREMENT InjCrv_phiMI1DesByp_mp "Bypass-Label, Kopie von InjCrv_phiMI1Des" SWORD AngleCrS 1 100 -768.0000 767.9766 FORMAT "%8.4" ECU_ADDRESS 0x8FF548 /end MEASUREMENT
/begin MEASUREMENT InjCrv_phiMI1DynCor1_mp "MI SOE customer correction 1" SWORD AngleCrS 1 100 -768.0000 767.9766 FORMAT "%8.4" ECU_ADDRESS 0x8FF562 /end MEASUREMENT
/begin MEASUREMENT InjCrv_phiMI1DynCor2Bas_mp "MI SOE customer correction II, base value" SWORD AngleCrS 1 100 -768.0000 767.9766 FORMAT "%8.4" ECU_ADDRESS 0x8FF564 /end MEASUREMENT
/begin MEASUREMENT InjCrv_phiMI1DynCor2_mp "MI SOE customer correction II" SWORD AngleCrS 1 100 -768.0000 767.9766 FORMAT "%8.4" ECU_ADDRESS 0x8FF566 /end MEASUREMENT
/begin MEASUREMENT InjCrv_phiMI1EnvCor "Ansteuerbeginn Korrekturwinkel für MI1" SWORD AngleCrS 1 100 -768.0000 767.9766 FORMAT "%8.4" ECU_ADDRESS 0x7F8EBC /end MEASUREMENT
/begin MEASUREMENT InjCrv_phiMI1EnvCor2 "Ansteuerbeginnkorrekturwert -2 für MI1 (n sync)" SWORD AngleCrS 1 100 -768.0000 767.9766 FORMAT "%8.4" ECU_ADDRESS 0x7F8EBE /end MEASUREMENT
/begin MEASUREMENT InjCrv_phiMI1EnvCorStrt "Winkelkorektur für Haupteinspritzung bei Start" SWORD AngleCrS 1 100 -768.0000 767.9766 FORMAT "%8.4" ECU_ADDRESS 0x7F8EC0 /end MEASUREMENT
/begin MEASUREMENT InjCrv_phiMI1Lim_mp "begrenzter Sollwert Ansteuerbeginn MI1" SWORD AngleCrS 1 100 -768.0000 767.9766 FORMAT "%8.4" ECU_ADDRESS 0x8FF54A /end MEASUREMENT
/begin MEASUREMENT InjCrv_phiMI1Max_mp "frühester Ansteuerbeginn der MI1" SWORD AngleCrS 1 100 -768.0000 767.9766 FORMAT "%8.4" ECU_ADDRESS 0x8FF54C /end MEASUREMENT
/begin MEASUREMENT InjCrv_phiMI1Min_mp "Latest SOE of MI1" SWORD AngleCrS 1 100 -768.0000 767.9766 FORMAT "%8.4" ECU_ADDRESS 0x8FF54E /end MEASUREMENT
/begin MEASUREMENT InjCrv_phiMI1Rgn "Regenerationswert für den Ansteuerbeginn der MI1" SWORD AngleCrS 1 100 -768.0000 767.9766 FORMAT "%8.4" ECU_ADDRESS 0x7F8EC2 /end MEASUREMENT
/begin MEASUREMENT InjCrv_phiMI1Rgn1_mp "Haupteinspritzbeginns bei Regeneration 1" SWORD AngleCrS 1 100 -768.0000 767.9766 FORMAT "%8.4" ECU_ADDRESS 0x8FF592 /end MEASUREMENT
/begin MEASUREMENT InjCrv_phiMI1Rgn2_mp "Haupteinspritzbeginns bei Regeneration 2" SWORD AngleCrS 1 100 -768.0000 767.9766 FORMAT "%8.4" ECU_ADDRESS 0x8FF594 /end MEASUREMENT
/begin MEASUREMENT InjCrv_phiMI1RgnByp_mp "Messpunkt für Bypass" SWORD AngleCrS 1 100 -768.0000 767.9766 FORMAT "%8.4" ECU_ADDRESS 0x8FF596 /end MEASUREMENT
/begin MEASUREMENT InjCrv_phiMI1Rgn_mp "Ansteuerbeginn der MI1 im Regenerationsbetrieb" SWORD AngleCrS 1 100 -768.0000 767.9766 FORMAT "%8.4" ECU_ADDRESS 0x8FF598 /end MEASUREMENT
/begin MEASUREMENT InjCrv_phiMI1StrtCor_mp "Korrekturwinkel der HE während des Starts" SWORD AngleCrS 1 100 -768.0000 767.9766 FORMAT "%8.4" ECU_ADDRESS 0x8FF5A2 /end MEASUREMENT
/begin MEASUREMENT InjCrv_phiMIAPSCor2_mp "atmosphärendruckabhängiger Korrekturwinkel für den Ansteuerbeginn der MI1 bei aktiver PiI2" SWORD AngleCrS 1 100 -768.0000 767.9766 FORMAT "%8.4" ECU_ADDRESS 0x8FF578 /end MEASUREMENT
/begin MEASUREMENT InjCrv_phiMIAPSCorStrt_mp "Korrekturwert des Phasewinkels für Haupteinspritzung beim Motorstart" SWORD AngleCrS 1 100 -768.0000 767.9766 FORMAT "%8.4" ECU_ADDRESS 0x8FF57A /end MEASUREMENT
/begin MEASUREMENT InjCrv_phiMIAPSCor_mp "atmosphärendruckabhängiger Korrekturwert für den Ansteuerbeginn der MI1" SWORD AngleCrS 1 100 -768.0000 767.9766 FORMAT "%8.4" ECU_ADDRESS 0x8FF57C /end MEASUREMENT
/begin MEASUREMENT InjCrv_phiMIAPSDynCor_mp "Korrekturwert für Ansteuerbeginn der Haupteinspritzung" SWORD AngleCrS 1 100 -768.0000 767.9766 FORMAT "%8.4" ECU_ADDRESS 0x8FF568 /end MEASUREMENT
/begin MEASUREMENT InjCrv_phiMIATSCor2_mp "ansauglufttemperaturabhängiger Korrekturwinkel für den Ansteuerbeginn der MI1 bei aktiver PiI2" SWORD AngleCrS 1 100 -768.0000 767.9766 FORMAT "%8.4" ECU_ADDRESS 0x8FF57E /end MEASUREMENT
/begin MEASUREMENT InjCrv_phiMIATSCorStrt_mp "ansauglufttemperaturabhängiger Korrekturwert für den Ansteuerbeginn der MI1 im Startzustand" SWORD AngleCrS 1 100 -768.0000 767.9766 FORMAT "%8.4" ECU_ADDRESS 0x8FF580 /end MEASUREMENT
/begin MEASUREMENT InjCrv_phiMIATSCor_mp "ansauglufttemperaturabhängiger Korrekturwert für den Ansteuerbeginn der MI1" SWORD AngleCrS 1 100 -768.0000 767.9766 FORMAT "%8.4" ECU_ADDRESS 0x8FF582 /end MEASUREMENT
/begin MEASUREMENT InjCrv_phiMIChamWllTempCorr_mp "Messpunkt für die Winkelkorrektur durch Brennraumwandtemperatur" SWORD AngleCrS 1 100 -768.0000 767.9766 FORMAT "%8.4" ECU_ADDRESS 0x8FF56A /end MEASUREMENT
/begin MEASUREMENT InjCrv_phiMIDynCor_mp "Korrekturwert für Ansteuerbeginn der Haupteinspritzung" SWORD AngleCrS 1 100 -768.0000 767.9766 FORMAT "%8.4" ECU_ADDRESS 0x8FF56C /end MEASUREMENT
/begin MEASUREMENT InjCrv_phiMIETSCor12_mp "kühlmitteltemperaturabhängiger Korrekturwert für den Ansteuerbeginn der MI1" SWORD AngleCrS 1 100 -768.0000 767.9766 FORMAT "%8.4" ECU_ADDRESS 0x8FF584 /end MEASUREMENT
/begin MEASUREMENT InjCrv_phiMIETSCor1_mp "motortemperaturabhängiger Korrekturwert -1 für Ansteuerbeginn MI1" SWORD AngleCrS 1 100 -768.0000 767.9766 FORMAT "%8.4" ECU_ADDRESS 0x8FF586 /end MEASUREMENT
/begin MEASUREMENT InjCrv_phiMIETSCor2_mp "motortemperaturabhängiger Korrekturwert -2 für Ansteuerbeginn MI1" SWORD AngleCrS 1 100 -768.0000 767.9766 FORMAT "%8.4" ECU_ADDRESS 0x8FF588 /end MEASUREMENT
/begin MEASUREMENT InjCrv_phiMIETSCorRgn_mp "Korrekturwinkel für Ansteuerbeginn Haupteinspritzung in Abhängigkeit der Motortemperatur im Regenerationsbetrieb" SWORD AngleCrS 1 100 -768.0000 767.9766 FORMAT "%8.4" ECU_ADDRESS 0x8FF59A /end MEASUREMENT
/begin MEASUREMENT InjCrv_phiMIETSCorStrt_mp "correction angle value = f(n, qSetUnBal, ETS)" SWORD AngleCrS 1 100 -768.0000 767.9766 FORMAT "%8.4" ECU_ADDRESS 0x8FF58A /end MEASUREMENT
/begin MEASUREMENT InjCrv_phiMIETSCor_mp "Korrekturwinkel für Ansteuerbeginn Haupteinspritzung in Abhängigkeit der Motortemperatur" SWORD AngleCrS 1 100 -768.0000 767.9766 FORMAT "%8.4" ECU_ADDRESS 0x8FF58C /end MEASUREMENT
/begin MEASUREMENT InjCrv_phiMIFTSRailCorStrt_mp "correction angle value = f(n, qSetUnBal, FTS,InjCrv_phiMIFTSRailCor_Max, InjCrv_phiMIFTSRailCor_Min)" SWORD AngleCrS 1 100 -768.0000 767.9766 FORMAT "%8.4" ECU_ADDRESS 0x8FF58E /end MEASUREMENT
/begin MEASUREMENT InjCrv_phiMIFTSRailCor_mp "Ansteuerbeginnkorrekturfaktor für MI1, abhängig von der kraftstofftemperaturabhängigen Raildruckkorrektur" SWORD AngleCrS 1 100 -768.0000 767.9766 FORMAT "%8.4" ECU_ADDRESS 0x8FF590 /end MEASUREMENT
/begin MEASUREMENT InjCrv_phiMIPDynCor_mp "Korrekturwert für Ansteuerbeginn der Haupteinspritzung" SWORD AngleCrS 1 100 -768.0000 767.9766 FORMAT "%8.4" ECU_ADDRESS 0x8FF56E /end MEASUREMENT
/begin MEASUREMENT InjCrv_phiPiI1Bas_mp "Winkelkomponente Ansteuerbeginn PiI1Grundwert" SWORD AngleCrS 1 100 -768.0000 767.9766 FORMAT "%8.4" ECU_ADDRESS 0x8FF5A4 /end MEASUREMENT
/begin MEASUREMENT InjCrv_phiPiI2AddCor "kundenspezifischer Korrekturwinkel für PiI2" SWORD AngleCrS 1 100 -768.0000 767.9766 FORMAT "%8.4" ECU_ADDRESS 0x7F8ED0 /end MEASUREMENT
/begin MEASUREMENT InjCrv_phiPiI2ETSCor_mp "motortemperaturabhängiger Korrekturgrundwert für die Winkelkomponente des Ansteuerbeginns der PiI2" SWORD AngleCrS 1 100 -768.0000 767.9766 FORMAT "%8.4" ECU_ADDRESS 0x8FF5E4 /end MEASUREMENT
/begin MEASUREMENT InjCrv_phiStrtInjSetPoint "Spritzbeginn-Sollwinkel" SWORD AngleCrS 1 100 -768.0000 767.9766 FORMAT "%8.4" ECU_ADDRESS 0x7F8EEC /end MEASUREMENT
/begin MEASUREMENT InjCrv_PiI1RgnVal_mp "Aktivierungswert für die Freigabe PiI1 über das Abgasnachbehandlungssystem" ULONG EGTSwt 1 100 0.00 262.143999939 FORMAT "%13.9" ECU_ADDRESS 0x8FF5FC /end MEASUREMENT
/begin MEASUREMENT InjCrv_PiI2RgnVal_mp "Aktivierungswert für die Freigabe PiI2 über das Abgasnachbehandlungssystem" ULONG EGTSwt 1 100 0.00 262.143999939 FORMAT "%13.9" ECU_ADDRESS 0x8FF5AC /end MEASUREMENT
/begin MEASUREMENT InjCrv_pMIDynCor_mp "begrenzte Raildruckdifferenz" SWORD Pres_Rail 1 100 -3276.800 3276.700 FORMAT "%5.3" ECU_ADDRESS 0x8FF570 /end MEASUREMENT
/begin MEASUREMENT InjCrv_PoI2RgnVal "Aktivierungswert für die Freigabe der PoI2 über das Abgasnachbehandlungssystem" ULONG EGTSwt 1 100 0.00 262.143999939 FORMAT "%13.9" ECU_ADDRESS 0x7F9298 /end MEASUREMENT
/begin MEASUREMENT InjCrv_PoI2RgnValTSync "Aktivierungswert für die Freigabe der PoI2 über das Abgasnachbehandlungssystem (t sync)" ULONG EGTSwt 1 100 0.00 262.143999939 FORMAT "%13.9" ECU_ADDRESS 0x7F929C /end MEASUREMENT
/begin MEASUREMENT InjCrv_qLmbdCtl "Lambdakontrollmenge" SWORD InjMassCyc 1 100 -327.6800 327.6700 FORMAT "%8.4" ECU_ADDRESS 0x7F8EEE /end MEASUREMENT
/begin MEASUREMENT InjCrv_qMI1Des "Sollmenge Haupteinspritzung" SWORD InjMassInj 1 100 -327.6800 327.6700 FORMAT "%8.4" ECU_ADDRESS 0x7F8EF0 /end MEASUREMENT
/begin MEASUREMENT InjCrv_qMI1DesByp_mp "Bypass-Label, Kopie von InjCrv_qMI1Des" SWORD InjMassInj 1 100 -327.6800 327.6700 FORMAT "%8.4" ECU_ADDRESS 0x8FF550 /end MEASUREMENT
/begin MEASUREMENT InjCrv_qMI1Min_mp "Minimale Einspritzmenge der Haupteinspritzung 1" SWORD InjMassInj 1 100 -327.6800 327.6700 FORMAT "%8.4" ECU_ADDRESS 0x8FF552 /end MEASUREMENT
/begin MEASUREMENT InjCrv_qMI1Nrm_mp "Normalmenge der Einspritzung MI1" SWORD InjMassInj 1 100 -327.6800 327.6700 FORMAT "%8.4" ECU_ADDRESS 0x8FF554 /end MEASUREMENT
/begin MEASUREMENT InjCrv_qMI1Rgn "Regenerationswert für die Menge der MI1" SWORD InjMassInj 1 100 -327.6800 327.6700 FORMAT "%8.4" ECU_ADDRESS 0x7F8EF2 /end MEASUREMENT
/begin MEASUREMENT InjCrv_qMI1Rgn1_mp "HE-Menge bei Regeneration 1" SWORD InjMassInj 1 100 -327.6800 327.6700 FORMAT "%8.4" ECU_ADDRESS 0x8FF59C /end MEASUREMENT
/begin MEASUREMENT InjCrv_qMI1Rgn2_mp "HE-Menge bei Regeneration 2" SWORD InjMassInj 1 100 -327.6800 327.6700 FORMAT "%8.4" ECU_ADDRESS 0x8FF59E /end MEASUREMENT
/begin MEASUREMENT InjCrv_qMI1RgnByp_mp "Messpunkt für Bypass" SWORD InjMassInj 1 100 -327.6800 327.6700 FORMAT "%8.4" ECU_ADDRESS 0x8FF5A0 /end MEASUREMENT
/begin MEASUREMENT InjCrv_qMI1Set_mp "Sollmenge der Einspritzung MI1" SWORD InjMassInj 1 100 -327.6800 327.6700 FORMAT "%8.4" ECU_ADDRESS 0x8FF556 /end MEASUREMENT
/begin MEASUREMENT InjCrv_qPiI1BasCylOffs_mp "Messpunkt Basiswert des Offsets der Menge PiI1" SWORD InjMassInj 1 100 -327.6800 327.6700 FORMAT "%8.4" ECU_ADDRESS 0x8FF53C /end MEASUREMENT
/begin MEASUREMENT InjCrv_qPiI1BasStrt_mp "Einspritzmenge PiI 1 Grundwert im Startzustand" SWORD InjMassInj 1 100 -327.6800 327.6700 FORMAT "%8.4" ECU_ADDRESS 0x8FF5A6 /end MEASUREMENT
/begin MEASUREMENT InjCrv_qPiI1CylOffs "Messpunkt Array Zyl[1-8] Offset Einspritzmenge der PiI1" SWORD InjMassInj 1 100 -327.6800 327.6700 FORMAT "%8.4" ARRAY_SIZE 7 ECU_ADDRESS 0x7F941C /end MEASUREMENT
/begin MEASUREMENT InjCrv_qPiI2AddCor "kundenspezifische Korrekturmenge für PiI2" SWORD InjMassInj 1 100 -327.6800 327.6700 FORMAT "%8.4" ECU_ADDRESS 0x7F8F02 /end MEASUREMENT
/begin MEASUREMENT InjCrv_qTot "Gesamteinspritzmenge" SWORD InjMassCyc 1 100 -327.6800 327.6700 FORMAT "%8.4" ECU_ADDRESS 0x7F8F1E /end MEASUREMENT
/begin MEASUREMENT InjCrv_stCylOffsRls_mp "Messpunkt Freigabestatus der Funktion Cyloffs" UBYTE OneToOne 1 100 0.00 255.0 FORMAT "%5.1" ECU_ADDRESS 0x8FF53E /end MEASUREMENT
/begin MEASUREMENT InjCrv_stInjCharActVal "Einspritzverlauf aktueller Wert" UBYTE OneToOne 1 100 0.00 255.0 FORMAT "%5.1" ECU_ADDRESS 0x7F8925 /end MEASUREMENT
/begin MEASUREMENT InjCrv_stInjCharDes_mp "Wunscheinspritzverlauf" UBYTE OneToOne 1 100 0.00 255.0 FORMAT "%5.1" ECU_ADDRESS 0x8FF526 /end MEASUREMENT
/begin MEASUREMENT InjCrv_stInjCharPrio "Prioritätenstatus zur Abschaltung der Einspritzung" ULONG OneToOne 1 100 0.00 4294967295.00 FORMAT "%13.2" ECU_ADDRESS 0x7F92A0 /end MEASUREMENT
/begin MEASUREMENT InjCrv_stInjCharPrioTSync "Prioritätenstatus zur Abschaltung von Einspritzungen (t sync)" ULONG OneToOne 1 100 0.00 4294967295.00 FORMAT "%13.2" ECU_ADDRESS 0x7F92A4 /end MEASUREMENT
/begin MEASUREMENT InjCrv_stInjCharSetVal "Einspritzverlauf Sollwert (drehzahlsynchron)" UBYTE OneToOne 1 100 0.00 255.0 FORMAT "%5.1" ECU_ADDRESS 0x7F8926 /end MEASUREMENT
/begin MEASUREMENT InjCrv_stInjCharSetValTSync "Einspritzverlauf Sollwert (zeitsynchron)" UBYTE OneToOne 1 100 0.00 255.0 FORMAT "%5.1" ECU_ADDRESS 0x7F8927 /end MEASUREMENT
/begin MEASUREMENT InjCrv_stInjCharSetVal_mp "Messpunkt vor dem Ascet Freischnitt" UBYTE OneToOne 1 100 0.00 255.0 FORMAT "%5.1" ECU_ADDRESS 0x8FF527 /end MEASUREMENT
/begin MEASUREMENT InjCrv_stLmbdCtl "Freigabestatus Lambdakontrollmenge" UBYTE OneToOne 1 100 0.00 255.0 FORMAT "%5.1" ECU_ADDRESS 0x7F8928 /end MEASUREMENT
/begin MEASUREMENT InjCrv_stPiI2RlsAirP_mp "Freigabezustand der ansaugluftdruckabhängigen Voreinspritzung 2" UBYTE OneToOne 1 100 0.00 255.0 FORMAT "%5.1" ECU_ADDRESS 0x8FF52B /end MEASUREMENT
/begin MEASUREMENT InjCrv_stPiI2RlsAirTBit_mp "Freigabezustand der ansauglufttemperaturabhängigen Voreinspritzung 2" UBYTE OneToOne 1 100 0.00 255.0 FORMAT "%5.1" ECU_ADDRESS 0x8FF52C /end MEASUREMENT
/begin MEASUREMENT InjCrv_stPiI2RlsAirT_mp "status of Piot injection 2 release based on Intake air temperature" UBYTE OneToOne 1 100 0.00 255.0 FORMAT "%5.1" ECU_ADDRESS 0x8FF52D /end MEASUREMENT
/begin MEASUREMENT InjCrv_stPiI2RlsOpRng6Bit_mp "aktueller Betriebspunkt zur Freigabe von Voreinspritzungszuständen" UBYTE OneToOne 1 100 0.00 255.0 FORMAT "%5.1" ECU_ADDRESS 0x8FF532 /end MEASUREMENT
/begin MEASUREMENT InjCrv_stPiI2RlsQRaw_mp "Freigabezustand der rohmengenabhängigen Voreinspritzung 2" UBYTE OneToOne 1 100 0.00 255.0 FORMAT "%5.1" ECU_ADDRESS 0x8FF52E /end MEASUREMENT
/begin MEASUREMENT InjCrv_stPiIRlsCor_mp "Freigabestruktur der Voreinspritzung nach Korrekturen" SWORD OneToOne 1 100 -32768.00 32767.00 FORMAT "%8.2" ECU_ADDRESS 0x8FF534 /end MEASUREMENT
/begin MEASUREMENT InjCrv_stPiIRlsOpRng6_mp "Current operation point for release of pilot injections" UBYTE OneToOne 1 100 0.00 255.0 FORMAT "%5.1" ECU_ADDRESS 0x8FF536 /end MEASUREMENT
/begin MEASUREMENT InjCrv_stPiIRlsOpRng_mp "aktueller Betriebsbereich für die Freigabe der Voreinspritzungen" UBYTE OneToOne 1 100 0.00 255.0 FORMAT "%5.1" ECU_ADDRESS 0x8FF537 /end MEASUREMENT
/begin MEASUREMENT InjCrv_stPiIRlsRaw_mp "Freigabestruktur der Voreinspritzung vor zusätzlichen Korrekturen" SWORD OneToOne 1 100 -32768.00 32767.00 FORMAT "%8.2" ECU_ADDRESS 0x8FF528 /end MEASUREMENT
/begin MEASUREMENT InjCrv_stPiIRlsStructRaw_mp "gewünschte Freigabekombination der Voreinspritzungen" SWORD OneToOne 1 100 -32768.00 32767.00 FORMAT "%8.2" ECU_ADDRESS 0x8FF530 /end MEASUREMENT
/begin MEASUREMENT InjCrv_stPiIRlsStruct_mp "Freigabestruktur der Voreinspritzungen" UBYTE OneToOne 1 100 0.00 255.0 FORMAT "%5.1" ECU_ADDRESS 0x8FF52A /end MEASUREMENT
/begin MEASUREMENT InjCrv_swtPiIDblCorMap "Berechnung der kundenspezifischen und der Umgebungskorrekturen für PiI und MI auf der Basis eines doppelten Kennfeldsatzes" UBYTE OneToOne 1 100 0.00 255.0 FORMAT "%5.1" ECU_ADDRESS 0x7F892C /end MEASUREMENT
/begin MEASUREMENT InjCrv_tEng "selektierte Motortemperatur für das Einspritzsystem" SWORD Temp_Cels 1 100 -50.140 899.860 FORMAT "%8.3" ECU_ADDRESS 0x7F8F20 /end MEASUREMENT
/begin MEASUREMENT InjCrv_tiDQPT1AddCor2_mp "dq PT1 filter const. in MI SOE correction II" ULONG TimeDelay_s 1 100 0.0000010000000 4294.9673 FORMAT "%9.4" ECU_ADDRESS 0x8FF574 /end MEASUREMENT
/begin MEASUREMENT InjCrv_tiMI1ET "geschätzte Ansteuerdauer MI1" SWORD InjTime_us 1 100 -32768.00 32767.00 FORMAT "%8.2" ECU_ADDRESS 0x7F8F22 /end MEASUREMENT
/begin MEASUREMENT InjCrv_tiPiI1BasCylOffs_mp "Messpunkt betriebspunktabhängige Berechnung des Offsets der PiI1" SWORD InjTime_us 1 100 -32768.00 32767.00 FORMAT "%8.2" ECU_ADDRESS 0x8FF540 /end MEASUREMENT
/begin MEASUREMENT InjCrv_tiPiI1BasStrt_mp "korrigierter Grundwert Zeitkomponente im Startzustand" SWORD InjTime_us 1 100 -32768.00 32767.00 FORMAT "%8.2" ECU_ADDRESS 0x8FF5A8 /end MEASUREMENT
/begin MEASUREMENT InjCrv_tiPiI1Bas_mp "Zeitkomponente Ansteuerbeginn PiI1Grundwert" SWORD InjTime_us 1 100 -32768.00 32767.00 FORMAT "%8.2" ECU_ADDRESS 0x6F816E /end MEASUREMENT
/begin MEASUREMENT InjCrv_tiPiI1CylOffs "Messpunkt Array Zyl[1-8] Offset Einspritzzeitpunkt der PiI1" SWORD InjTime_us 1 100 -32768.00 32767.00 FORMAT "%8.2" ARRAY_SIZE 7 ECU_ADDRESS 0x7F942A /end MEASUREMENT
/begin MEASUREMENT InjCrv_tiPiI2AddCor "kundenspezifische Korrekturzeit für PiI2" SWORD InjTime_us 1 100 -32768.00 32767.00 FORMAT "%8.2" ECU_ADDRESS 0x7F8F32 /end MEASUREMENT
/begin MEASUREMENT InjCrv_tiPiI2BasCylOffs_mp "Messpunkt Basiswert des Offsets der Menge PiI2" SWORD InjTime_us 1 100 -32768.00 32767.00 FORMAT "%8.2" ECU_ADDRESS 0x8FF542 /end MEASUREMENT
/begin MEASUREMENT InjCrv_tiPiI2CylOffs "Messpunkt Array Zyl[1-8] Offset Ansteuerbeginns der PiI2" SWORD InjTime_us 1 100 -32768.00 32767.00 FORMAT "%8.2" ARRAY_SIZE 7 ECU_ADDRESS 0x7F9438 /end MEASUREMENT
/begin MEASUREMENT InjCrv_volMI1Cor_mp "Einspritzvolumen MI1 mit Korrekturwerten" SWORD InjQntInj 1 100 -327.6800 327.6700 FORMAT "%8.4" ECU_ADDRESS 0x8FF558 /end MEASUREMENT
/begin MEASUREMENT InjCrv_volMI1_mp "Einspritzvolumen MI1" SWORD InjQntInj 1 100 -327.6800 327.6700 FORMAT "%8.4" ECU_ADDRESS 0x8FF55A /end MEASUREMENT
/begin FUNCTION hpun_co "Hochdruckpumpe"
 /begin DEF_CHARACTERISTIC HPUn_dvolMeUnMax_C HPUn_etaPmpFlTemp_CUR HPUn_etaPmpMaxAged_CUR HPUn_etaPmpMech_C HPUn_nMin_C HPUn_qBalLim_CUR HPUn_qFlTempLim_MAP HPUn_rTransCrS_C HPUn_volPmp_C /end DEF_CHARACTERISTIC
 /begin IN_MEASUREMENT Eng_nAvrg FlSys_t FTSCD_tFuel /end IN_MEASUREMENT
/end FUNCTION
/begin FUNCTION hpun_co_msg "" /begin OUT_MEASUREMENT HPUn_numInjQntBal HPUn_qLim HPUn_rTransCrS HPUn_trqDes /end OUT_MEASUREMENT /end FUNCTION
/begin FUNCTION hpun_co_uic ""
 /begin OUT_MEASUREMENT HPUn_dvolPmpMaxCor_mp HPUn_dvolPmpMax_mp HPUn_etaPmpFlTemp_mp HPUn_etaPmpMaxAged_mp HPUn_qBalLim_mp HPUn_qFlTempLim_mp HPUn_stQntBal_mp /end OUT_MEASUREMENT
/end FUNCTION
/begin FUNCTION hpun_qntbalinjlim "maximale Anzahl an Einspritzungen aufgrund der Mengenbilanz der Hochdruckpumpe"
 /begin DEF_CHARACTERISTIC HPUn_numInjMin_C HPUn_pRailDvtOk_C HPUn_tiPresDvtFlt_C HPUn_tiQntBalDel_C /end DEF_CHARACTERISTIC
/end FUNCTION
/begin FUNCTION hpun_qntbalinjlim_uic "" /begin OUT_MEASUREMENT HPUn_pRailDvtFlt_mp HPUn_stNumInjMax_mp /end OUT_MEASUREMENT /end FUNCTION
/begin FUNCTION hwemon "Monitoring of Hardware Encapsulation Functions"
 /begin DEF_CHARACTERISTIC HWEMon_DebComStepDown_C HWEMon_DebComStepUp_C HWEMon_DebComDef_C HWEMon_DebComOk_C HWEMon_nThres_C HWEMon_numTrigRecovery_C /end DEF_CHARACTERISTIC
/end FUNCTION
/begin FUNCTION hwemon_msg ""
 /begin OUT_MEASUREMENT HWEMon_ctRecovery HWEMon_numEEPBlockfailed HWEMon_numRecovery /end OUT_MEASUREMENT
/end FUNCTION
/begin FUNCTION hwemon_uic ""
 /begin OUT_MEASUREMENT HWEMon_recLocHigh_mp HWEMon_recLocLow_mp HWEMon_stVoltMon_mp /end OUT_MEASUREMENT
/end FUNCTION
/begin FUNCTION iatscd "Lufttemperaturfühler Komponententreiber"
 /begin DEF_CHARACTERISTIC IATSCD_uSRCMin_C IATSCD_uSRCMax_C IATSCD_tLin_CUR IATSCD_DebSigDef_C IATSCD_DebSigOk_C IATSCD_DebSRCHighDef_C IATSCD_DebSRCHighOk_C IATSCD_DebSRCLowDef_C IATSCD_DebSRCLowOk_C IATSCD_facttAir_CUR IATSCD_numAdc_C IATSCD_dtRmpSlpUp_C IATSCD_dtRmpSlpDwn_C IATSCD_swtSigVal_C IATSCD_swtT10Init_C IATSCD_swtT10Src_C IATSCD_tiAirPT1_C IATSCD_stSensIDWord_C IATSCD_tDfl_C /end DEF_CHARACTERISTIC
 /begin IN_MEASUREMENT IATSCD_uRaw Layer_tiAbstell /end IN_MEASUREMENT
/end FUNCTION
/begin FUNCTION iatscd_cats ""
 /begin DEF_CHARACTERISTIC IATSCD_uSRCMinCats_C IATSCD_uSRCMaxCats_C IATSCD_tLinCats_CUR IATSCD_DebSigDefCats_C IATSCD_DebSigOkCats_C IATSCD_DebSRCHighDefCats_C IATSCD_DebSRCHighOkCats_C IATSCD_DebSRCLowDefCats_C IATSCD_DebSRCLowOkCats_C IATSCD_numAdcCats_C IATSCD_dtRmpSlpUpCats_C IATSCD_dtRmpSlpDwnCats_C IATSCD_swtSigValCats_C IATSCD_stSensIDWordCats_C IATSCD_tDflCats_C /end DEF_CHARACTERISTIC
 /begin IN_MEASUREMENT IATSCD_uRawCats /end IN_MEASUREMENT
/end FUNCTION
/begin FUNCTION iatscd_cats_msg ""
 /begin OUT_MEASUREMENT IATSCD_dtAirCats IATSCD_swtSigCats IATSCD_tAirCats IATSCD_tAirLinCats IATSCD_uRawCats /end OUT_MEASUREMENT
/end FUNCTION
/begin FUNCTION iatscd_cats_uic "" /end FUNCTION
/begin FUNCTION iatscd_cats_var_msg "" /end FUNCTION
/begin FUNCTION iatscd_msg ""
 /begin OUT_MEASUREMENT IATSCD_dtAir IATSCD_swtSig IATSCD_tAir IATSCD_tAirLin IATSCD_uRaw /end OUT_MEASUREMENT
/end FUNCTION
/begin FUNCTION iatscd_uic ""
 /begin OUT_MEASUREMENT IATSCD_factHFM_mp IATSCD_facttAir_mp IATSCD_tAirHFM_mp IATSCD_tInit_mp IATSCD_tStrtFlt_mp IATSCD_tStrtFreeze_mp /end OUT_MEASUREMENT
/end FUNCTION
/begin FUNCTION iatscd_var_msg "" /end FUNCTION
/begin FUNCTION ibscd "" /begin DEF_CHARACTERISTIC IBSCD_tiWaitDetection_C /end DEF_CHARACTERISTIC /end FUNCTION
/begin FUNCTION ibscd_ht "" /begin DEF_CHARACTERISTIC IBSCD_tiReset_C /end DEF_CHARACTERISTIC /end FUNCTION
/begin FUNCTION ibscd_ht_uic "" /begin OUT_MEASUREMENT IBSCD_BsdControl_mp IBSCD_stB_ibsactiv_mp /end OUT_MEASUREMENT /end FUNCTION
/begin FUNCTION ibscd_msg "" /end FUNCTION
/begin FUNCTION ibscd_uic "" /begin OUT_MEASUREMENT IBSCD_BsdData_mp IBSCD_BsdRegAdr_mp IBSCD_stB_ibsdetec_mp /end OUT_MEASUREMENT /end FUNCTION
/begin FUNCTION ignlck "Zündschloss" /end FUNCTION
/begin FUNCTION ignlck_msg "" /begin OUT_MEASUREMENT IgnLck_st /end OUT_MEASUREMENT /end FUNCTION
/begin FUNCTION ignlck_uic "" /end FUNCTION
/begin FUNCTION immcd "Immobilizer component driver" /begin DEF_CHARACTERISTIC /end DEF_CHARACTERISTIC /end FUNCTION
/begin FUNCTION immcd_msg "" /begin OUT_MEASUREMENT /end OUT_MEASUREMENT /end FUNCTION
/begin FUNCTION immcd_uic "" /end FUNCTION
/begin FUNCTION immctl "Steuerung Wegfahrsperre" /begin DEF_CHARACTERISTIC /end DEF_CHARACTERISTIC /end FUNCTION
/begin FUNCTION immctl_msg "" /begin OUT_MEASUREMENT ImmCtl_stIniSeq /end OUT_MEASUREMENT /end FUNCTION
/begin FUNCTION immctl_uic "" /end FUNCTION
/begin FUNCTION immeep_eval "" /end FUNCTION
/begin FUNCTION immeep_eval_msg "" /begin OUT_MEASUREMENT /end OUT_MEASUREMENT /end FUNCTION
/begin FUNCTION immeep_eval_uic "" /begin OUT_MEASUREMENT /end OUT_MEASUREMENT /end FUNCTION
/begin FUNCTION indsys_bpatdefdet ""
 /begin DEF_CHARACTERISTIC IndSys_facDiffCorr_CUR IndSys_mAirPerCylLim_MAP IndSys_nAvrgMax_C IndSys_nAvrgMin_C IndSys_pAPDynCorr_CUR IndSys_pAPStatCorr_CUR IndSys_pDiffCorr_MAP IndSys_pDiffStat_MAP IndSys_pDynMin_CUR IndSys_qDiffStatMax_CUR IndSys_qDiffStatMin_CUR IndSys_qSetDynMax_CUR IndSys_qSetDynMin_CUR IndSys_qSetUnBalMax_C IndSys_qSetUnBalMin_C IndSys_tiDelayDef1_C IndSys_tiDelayDef2_C IndSys_tiDelayDef3_C IndSys_tiDelayOK1_C /end DEF_CHARACTERISTIC
 /begin IN_MEASUREMENT APSCD_pVal Eng_nAvrg Eng_tEng InjCtl_qSetUnBal /end IN_MEASUREMENT
/end FUNCTION
/begin FUNCTION indsys_bpatdefdet_uic ""
 /begin OUT_MEASUREMENT IndSys_mAirPerCylLim_mp IndSys_stPart1_mp IndSys_stPart2_mp /end OUT_MEASUREMENT
/end FUNCTION
/begin FUNCTION indsys_calcswirl "Drallniveausteuerung"
 /begin DEF_CHARACTERISTIC IndSys_facVSACTCor_CUR IndSys_rClsEGR_C IndSys_rVSAAPSCorr_CUR IndSys_rVSAATCorr_CUR IndSys_rVSACTCor_MAP IndSys_rVSAMAX_C IndSys_rVSARgn_MAP IndSys_rVSA_MAP IndSys_stMskVSARgn_C IndSys_tiRmpSlpVSA_C IndSys_tiStartDelay_CUR /end DEF_CHARACTERISTIC
 /begin IN_MEASUREMENT APSCD_pVal CTSCD_tClnt Eng_nAvrg Eng_tEng IATSCD_tAir InjCtl_qCurr InjCtl_qRaw /end IN_MEASUREMENT
/end FUNCTION
/begin FUNCTION indsys_calcswirl_uic ""
 /begin DEF_CHARACTERISTIC IndSys_rVSAAdd_Vector IndSys_rVSAAdd_Channel IndSys_rVSA_Vector IndSys_rVSA_Channel /end DEF_CHARACTERISTIC
 /begin OUT_MEASUREMENT IndSys_rVSAAPSCorr_mp IndSys_rVSAATCorr_mp IndSys_rVSABase_mp IndSys_rVSAByp_mp IndSys_rVSACorr_mp IndSys_rVSACTCorr_mp IndSys_tiStartDelay_mp /end OUT_MEASUREMENT
/end FUNCTION
/begin FUNCTION indsys_msg "" /begin OUT_MEASUREMENT IndSys_rVSA /end OUT_MEASUREMENT /end FUNCTION
/begin FUNCTION indsys_tair_msg "" /begin OUT_MEASUREMENT IndSys_tFld /end OUT_MEASUREMENT /end FUNCTION
/begin FUNCTION indsys_tair_uic "" /end FUNCTION
/begin FUNCTION indsys_uic "" /end FUNCTION
/begin FUNCTION injcrv "Einspritzverlauf"
 /begin DEF_CHARACTERISTIC InjCrv_dqPoIUp_C InjCrv_dqPoIDwn_C InjCrv_numInjPoIOff_C InjCrv_rAPPFullLdDet_C InjCrv_stInjDstSel_C InjCrv_tiFullLdDet_C InjCrv_tiPause_C /end DEF_CHARACTERISTIC
/end FUNCTION
/begin FUNCTION injcrv_co "Spritzbeginn Sollwertbildung"
 /begin DEF_CHARACTERISTIC InjCrv_ctTempSel_C InjCrv_DebLimDef_C InjCrv_DebLimOk_C InjCrv_numInjMaxSys_C InjCrv_rPiIRlsEngSpdHys_C InjCrv_rPiIRlsQntHys_C InjCrv_stInjCharPrioRgn_C InjCrv_stInjCharPrio_C InjCrv_stPiIRlsOpRng1_MAP InjCrv_stPiIRlsOpRng2_MAP InjCrv_stPiIRlsOpRng3_MAP InjCrv_stPiIRlsOpRng4_MAP InjCrv_stPiIRlsOpRng5_MAP InjCrv_stPrioRgnMsk_C InjCrv_stRlsRgnMsk_C InjCrv_swtPiIDblCorMapVal_C InjCrv_swtPiIDblCorMapType_C /end DEF_CHARACTERISTIC
 /begin IN_MEASUREMENT Eng_nAvrg InjCtl_qSetUnBal /end IN_MEASUREMENT
/end FUNCTION
/begin FUNCTION injcrv_copiirlsaddcor ""
 /begin DEF_CHARACTERISTIC InjCrv_pPiI2RlsAirPXDelta_C InjCrv_pPiI2RlsAirXLo_C InjCrv_qRawDelta_C InjCrv_qRawLo_C InjCrv_tPiI2RlsAirTXDelta_C InjCrv_tPiI2RlsAirTXLo1_C InjCrv_tPiI2RlsAirTXLo2_C InjCrv_tPiI2RlsAirTXLo3_C InjCrv_tPiI2RlsAirTXLo4_C InjCrv_tPiI2RlsAirTXLo5_C InjCrv_tPiI2RlsAirTXLo6_C /end DEF_CHARACTERISTIC
/end FUNCTION
/begin FUNCTION injcrv_copiirlsaddcor_uic ""
 /begin OUT_MEASUREMENT InjCrv_stPiI2RlsAirP_mp InjCrv_stPiI2RlsAirTBit_mp InjCrv_stPiI2RlsAirT_mp InjCrv_stPiI2RlsQRaw_mp InjCrv_stPiIRlsStructRaw_mp /end OUT_MEASUREMENT
/end FUNCTION
/begin FUNCTION injcrv_copiirlscor ""
 /begin DEF_CHARACTERISTIC InjCrv_stPiI2RlsGearMax_C InjCrv_stPiI2RlsGearMin_C InjCrv_stPiIRlsOpRng6_MAP InjCrv_tPiI2RlsTAirXDelta_C InjCrv_tPiI2RlsTAirXLo1_C InjCrv_tPiI2RlsTAirXLo2_C InjCrv_tPiI2RlsTEngXDelta_C InjCrv_tPiI2RlsTEngXLo1_C InjCrv_tPiI2RlsTEngXLo2_C InjCrv_vPiI2RlsXDelta_C InjCrv_vPiI2RlsXLo123_C InjCrv_vPiI2RlsXLo4_C InjCrv_vPiI2RlsXLo5_C InjCrv_vPiI2RlsXLo6_C /end DEF_CHARACTERISTIC
 /begin IN_MEASUREMENT Eng_nAvrg InjCtl_qSetUnBal /end IN_MEASUREMENT
/end FUNCTION
/begin FUNCTION injcrv_copiirlscor_uic ""
 /begin OUT_MEASUREMENT InjCrv_stPiI2RlsOpRng6Bit_mp InjCrv_stPiIRlsCor_mp InjCrv_stPiIRlsOpRng6_mp /end OUT_MEASUREMENT
/end FUNCTION
/begin FUNCTION injcrv_copiirlsoprng ""
 /begin DEF_CHARACTERISTIC InjCrv_rOpRngATSHys_C InjCrv_rOpRngETSHys_C InjCrv_stRlsOpRngThresRgn_MAP InjCrv_stRlsOpRngThres_MAP /end DEF_CHARACTERISTIC
 /begin IN_MEASUREMENT IATSCD_tAir InjCrv_tEng /end IN_MEASUREMENT
/end FUNCTION
/begin FUNCTION injcrv_copiirlsoprng_uic "" /begin OUT_MEASUREMENT InjCrv_stPiIRlsOpRng_mp /end OUT_MEASUREMENT /end FUNCTION
/begin FUNCTION injcrv_co_msg ""
 /begin OUT_MEASUREMENT InjCrv_numInjMaxSys InjCrv_PoI2RgnVal InjCrv_PoI2RgnValTSync InjCrv_stInjCharActVal InjCrv_stInjCharPrio InjCrv_stInjCharPrioTSync InjCrv_stInjCharSetVal InjCrv_stInjCharSetValTSync InjCrv_swtPiIDblCorMap InjCrv_tEng /end OUT_MEASUREMENT
/end FUNCTION
/begin FUNCTION injcrv_co_uic ""
 /begin DEF_CHARACTERISTIC InjCrv_stInjCharSetVal_Vector InjCrv_stInjCharSetVal_Channel InjCrv_stPiIRlsBypass_Vector InjCrv_stPiIRlsBypass_Channel /end DEF_CHARACTERISTIC
 /begin OUT_MEASUREMENT InjCrv_numInjDes_mp InjCrv_numInjLim_mp InjCrv_stInjCharDes_mp InjCrv_stInjCharSetVal_mp InjCrv_stPiIRlsRaw_mp InjCrv_stPiIRlsStruct_mp /end OUT_MEASUREMENT
/end FUNCTION
/begin FUNCTION injcrv_ctlqnt "" /end FUNCTION
/begin FUNCTION injcrv_ctlqnt_msg "" /begin OUT_MEASUREMENT InjCrv_qLmbdCtl InjCrv_qTot InjCrv_stLmbdCtl /end OUT_MEASUREMENT /end FUNCTION
/begin FUNCTION injcrv_ctlqnt_uic "" /end FUNCTION
/begin FUNCTION injcrv_cyloffs ""
 /begin DEF_CHARACTERISTIC InjCrv_dfacCylOffsUp_C InjCrv_dfacCylOffsDwn_C InjCrv_facphiMI1CylOffs21_C InjCrv_facphiMI1CylOffs22_C InjCrv_facphiMI1CylOffs23_C InjCrv_facphiMI1CylOffs24_C InjCrv_facphiMI1CylOffs25_C InjCrv_facphiMI1CylOffs26_C InjCrv_facphiMI1CylOffs27_C InjCrv_facphiMI1CylOffs28_C InjCrv_facphiMI1CylOffs1_C InjCrv_facphiMI1CylOffs2_C InjCrv_facphiMI1CylOffs3_C InjCrv_facphiMI1CylOffs4_C InjCrv_facphiMI1CylOffs5_C InjCrv_facphiMI1CylOffs6_C InjCrv_facphiMI1CylOffs7_C InjCrv_facphiMI1CylOffs8_C InjCrv_facqPiI1CylOffs21_C InjCrv_facqPiI1CylOffs22_C InjCrv_facqPiI1CylOffs23_C InjCrv_facqPiI1CylOffs24_C InjCrv_facqPiI1CylOffs25_C InjCrv_facqPiI1CylOffs26_C InjCrv_facqPiI1CylOffs27_C InjCrv_facqPiI1CylOffs28_C InjCrv_facqPiI1CylOffs1_C InjCrv_facqPiI1CylOffs2_C InjCrv_facqPiI1CylOffs3_C InjCrv_facqPiI1CylOffs4_C InjCrv_facqPiI1CylOffs5_C InjCrv_facqPiI1CylOffs6_C InjCrv_facqPiI1CylOffs7_C InjCrv_facqPiI1CylOffs8_C InjCrv_factiPiI1CylOffs21_C InjCrv_factiPiI1CylOffs22_C InjCrv_factiPiI1CylOffs23_C InjCrv_factiPiI1CylOffs24_C InjCrv_factiPiI1CylOffs25_C InjCrv_factiPiI1CylOffs26_C InjCrv_factiPiI1CylOffs27_C InjCrv_factiPiI1CylOffs28_C InjCrv_factiPiI1CylOffs1_C InjCrv_factiPiI1CylOffs2_C InjCrv_factiPiI1CylOffs3_C InjCrv_factiPiI1CylOffs4_C InjCrv_factiPiI1CylOffs5_C InjCrv_factiPiI1CylOffs6_C InjCrv_factiPiI1CylOffs7_C InjCrv_factiPiI1CylOffs8_C InjCrv_factiPiI2CylOffs21_C InjCrv_factiPiI2CylOffs22_C InjCrv_factiPiI2CylOffs23_C InjCrv_factiPiI2CylOffs24_C InjCrv_factiPiI2CylOffs25_C InjCrv_factiPiI2CylOffs26_C InjCrv_factiPiI2CylOffs27_C InjCrv_factiPiI2CylOffs28_C InjCrv_pAirCylOffsRlsHigh_C InjCrv_pAirCylOffsRlsLow_C InjCrv_phiMI1BasCylOffs_MAP InjCrv_qPiI1BasCylOffs_MAP InjCrv_stCylOffstAirInv_C InjCrv_stCylOffstEngInv_C InjCrv_tAirCylOffsRlsMaxHigh_C InjCrv_tAirCylOffsRlsMaxLow_C InjCrv_tAirCylOffsRlsMinHigh_C InjCrv_tAirCylOffsRlsMinLow_C InjCrv_tEngCylOffsRlsMaxHigh_C InjCrv_tEngCylOffsRlsMaxLow_C InjCrv_tEngCylOffsRlsMinHigh_C InjCrv_tEngCylOffsRlsMinLow_C InjCrv_tiPiI1BasCylOffs_MAP InjCrv_tiPiI2BasCylOffs_MAP /end DEF_CHARACTERISTIC
 /begin IN_MEASUREMENT Eng_nAvrg InjCtl_qSetUnBal /end IN_MEASUREMENT
/end FUNCTION
/begin FUNCTION injcrv_cyloffs_msg ""
 /begin OUT_MEASUREMENT InjCrv_phiMI1CylOffs InjCrv_qPiI1CylOffs InjCrv_tiPiI1CylOffs InjCrv_tiPiI2CylOffs /end OUT_MEASUREMENT
/end FUNCTION
/begin FUNCTION injcrv_cyloffs_uic ""
 /begin OUT_MEASUREMENT InjCrv_facRmpCylOffs_mp InjCrv_phiMI1BasCylOffs_mp InjCrv_qPiI1BasCylOffs_mp InjCrv_stCylOffsRls_mp InjCrv_tiPiI1BasCylOffs_mp InjCrv_tiPiI2BasCylOffs_mp /end OUT_MEASUREMENT
/end FUNCTION
/begin FUNCTION injcrv_mi "Einspritzverlauf - Haupteinspritzung"
 /begin DEF_CHARACTERISTIC InjCrv_phiMI1Bas1CBFDC_MAP InjCrv_phiMI1Bas1CB_MAP InjCrv_phiMI1Bas1FDC_MAP InjCrv_phiMI1Bas1_MAP InjCrv_phiMI1Bas2CBFDC_MAP InjCrv_phiMI1Bas2CB_MAP InjCrv_phiMI1Bas2FDC_MAP InjCrv_phiMI1Bas2_MAP InjCrv_phiMI1Bas3_MAP InjCrv_phiMI1Bas4_MAP InjCrv_phiMI1Bas5_MAP InjCrv_phiMI1Max2_MAP InjCrv_phiMI1Max_MAP InjCrv_phiMI1Max_X_AXIS InjCrv_phiMI1Max_Y_AXIS InjCrv_phiMI1Min_CUR InjCrv_qMI1Cor_MAP InjCrv_stMI1RgnDelMsk_C /end DEF_CHARACTERISTIC
 /begin IN_MEASUREMENT Eng_nAvrg InjCrv_tEng InjCtl_qSetUnBal /end IN_MEASUREMENT
/end FUNCTION
/begin FUNCTION injcrv_mi1phiaddcorslow "Haupteinspritzung - projektspezifische Korrekturen zeitsynchron"
 /begin DEF_CHARACTERISTIC InjCrv_facAPMIDynCor2_CUR InjCrv_facETMIDynCor2_CUR InjCrv_facIATMIDynCor2_CUR InjCrv_facMIATSDynCor_CUR InjCrv_facMICTSDynCor_CUR InjCrv_tiDpCorrDT1_C InjCrv_dpCorrDKd_C /end DEF_CHARACTERISTIC
 /begin IN_MEASUREMENT APSCD_pVal CTSCD_tClnt IATSCD_tAir InjCrv_tEng /end IN_MEASUREMENT
/end FUNCTION
/begin FUNCTION injcrv_mi1phiaddcorslow_uic "" /end FUNCTION
/begin FUNCTION injcrv_miaddcor "Haupteinspritzung - projektspezifische Korrekturen"
 /begin DEF_CHARACTERISTIC InjCrv_dphiMIDynUp_C InjCrv_dphiMIDynDown_C InjCrv_dqFltLowNeg_C InjCrv_dqFltLowPos_C InjCrv_dqFltMidNeg_C InjCrv_dqFltMidPos_C InjCrv_dqSetUnBalMax_C InjCrv_dqSetUnBalMin_C InjCrv_facDQMI1DynCor2_CUR InjCrv_facMIChamWllTempCorr_MAP InjCrv_facMIPDynCor_CUR InjCrv_tiLowNegPT1_C InjCrv_tiLowPosPT1_C InjCrv_tiMidNegPT1_C InjCrv_tiMidPosPT1_C InjCrv_tiUppNegPT1_C InjCrv_tiUppPosPT1_C InjCrv_tiDT1DQMISOECor2_C InjCrv_KdDT1DQMISOECor2_C InjCrv_nMIDynMax_C InjCrv_phiMI1DynCor2_MAP InjCrv_phiMIAPSDynCor_MAP InjCrv_phiMIChamWllTempCorr_MAP InjCrv_phiMIDynCor_MAP InjCrv_phiMIDynMax_C InjCrv_phiMIDynMin_C InjCrv_pMIDynMax_C InjCrv_pMIDynMin_C /end DEF_CHARACTERISTIC
 /begin IN_MEASUREMENT Eng_nAvrg Eng_tEng InjCrv_dpMIDynCor InjCrv_dqSetUnBalFltLim InjCrv_pMIDynCor_mp InjCtl_qSetUnBal Layer_tChamWll /end IN_MEASUREMENT
/end FUNCTION
/begin FUNCTION injcrv_miaddcor_msg ""
 /begin OUT_MEASUREMENT InjCrv_dpMIDynCor InjCrv_dqSetUnBalFltLim InjCrv_facMI1DynCorSlow2 InjCrv_facMIDynCor InjCrv_phiMI1AddCor InjCrv_phiMI1AddCor2 /end OUT_MEASUREMENT
/end FUNCTION
/begin FUNCTION injcrv_miaddcor_uic ""
 /begin OUT_MEASUREMENT InjCrv_dqSetUnBal_mp InjCrv_facMI1DynCor2_mp InjCrv_facMIPDynCor_mp InjCrv_phiMI1DynCor1_mp InjCrv_phiMI1DynCor2Bas_mp InjCrv_phiMI1DynCor2_mp InjCrv_phiMIAPSDynCor_mp InjCrv_phiMIChamWllTempCorr_mp InjCrv_phiMIDynCor_mp InjCrv_phiMIPDynCor_mp InjCrv_pMIDynCor_mp InjCrv_tiDQPT1AddCor2_mp /end OUT_MEASUREMENT
/end FUNCTION
/begin FUNCTION injcrv_mienvcor "Haupteinspritzung - Umwelt - Korrekturen"
 /begin DEF_CHARACTERISTIC InjCrv_phiMIAPSCor2_MAP InjCrv_phiMIAPSCorStrt_MAP InjCrv_phiMIAPSCor_MAP InjCrv_phiMIAPSCor_X_AXIS InjCrv_phiMIAPSCor_Y_AXIS InjCrv_phiMIATSCor2_MAP InjCrv_phiMIATSCorStrt_MAP InjCrv_phiMIATSCor_MAP InjCrv_phiMIATSCor_X_AXIS InjCrv_phiMIATSCor_Y_AXIS InjCrv_phiMIETSCor12_MAP InjCrv_phiMIETSCor1_MAP InjCrv_phiMIETSCor1_X_AXIS InjCrv_phiMIETSCor1_Y_AXIS InjCrv_phiMIETSCor2_MAP InjCrv_phiMIETSCorStrt_MAP InjCrv_phiMIETSCor_MAP InjCrv_phiMIETSCor_X_AXIS InjCrv_phiMIETSCor_Y_AXIS InjCrv_phiMIFTSRailCorMax_C InjCrv_phiMIFTSRailCorMin_C InjCrv_phiMIFTSRailCorStrt_MAP InjCrv_phiMIFTSRailCor_MAP /end DEF_CHARACTERISTIC
 /begin IN_MEASUREMENT Eng_nAvrg InjCtl_qSetUnBal /end IN_MEASUREMENT
/end FUNCTION
/begin FUNCTION injcrv_mienvcorrgn "Haupteinspritzung - Umwelt - Korrekturen für den Regenerationsbetrieb" /end FUNCTION
/begin FUNCTION injcrv_mienvcorrgn_msg "" /end FUNCTION
/begin FUNCTION injcrv_mienvcorrgn_uic "" /end FUNCTION
/begin FUNCTION injcrv_mienvcorslow "Korrekturen für die Haupteinspritzung (langsamer Prozess)"
 /begin DEF_CHARACTERISTIC InjCrv_facMIAPSPhiCor2_CUR InjCrv_facMIAPSPhiCorStrt_CUR InjCrv_facMIAPSPhiCor_AXIS InjCrv_facMIAPSPhiCor_CUR InjCrv_facMIATSPhiCor2_CUR InjCrv_facMIATSPhiCorStrt_CUR InjCrv_facMIATSPhiCor_AXIS InjCrv_facMIATSPhiCor_CUR InjCrv_facMIETSPhiCor12_CUR InjCrv_facMIETSPhiCor1_AXIS InjCrv_facMIETSPhiCor1_CUR InjCrv_facMIETSPhiCor2_CUR InjCrv_facMIETSPhiCorStrt_CUR InjCrv_facMIETSPhiCor_AXIS InjCrv_facMIETSPhiCor_CUR InjCrv_facMIFTSRailCorStrt_CUR InjCrv_facMIFTSRailCor_CUR /end DEF_CHARACTERISTIC
 /begin IN_MEASUREMENT APSCD_pVal IATSCD_tAir InjCrv_tEng Rail_pSetPointFlTempCor /end IN_MEASUREMENT
/end FUNCTION
/begin FUNCTION injcrv_mienvcorslowrgn "Haupteinspritzung - Umwelt - Gewichtungsfaktoren für den Regenerationsbetrieb" /end FUNCTION
/begin FUNCTION injcrv_mienvcorslowrgn_msg "" /end FUNCTION
/begin FUNCTION injcrv_mienvcorslowrgn_uic "" /end FUNCTION
/begin FUNCTION injcrv_mienvcorslow_msg ""
 /begin OUT_MEASUREMENT InjCrv_facMIAPSPhiCor InjCrv_facMIAPSPhiCor2 InjCrv_facMIAPSPhiCorStrt InjCrv_facMIATSPhiCor InjCrv_facMIATSPhiCor2 InjCrv_facMIATSPhiCorStrt InjCrv_facMIETSPhiCor InjCrv_facMIETSPhiCor1 InjCrv_facMIETSPhiCor12 InjCrv_facMIETSPhiCor2 InjCrv_facMIETSPhiCorStrt InjCrv_facMIFTSRailCor InjCrv_facMIFTSRailCorStrt /end OUT_MEASUREMENT
/end FUNCTION
/begin FUNCTION injcrv_mienvcorslow_uic "" /end FUNCTION
/begin FUNCTION injcrv_mienvcor_msg ""
 /begin OUT_MEASUREMENT InjCrv_phiMI1EnvCor InjCrv_phiMI1EnvCor2 InjCrv_phiMI1EnvCorStrt /end OUT_MEASUREMENT
/end FUNCTION
/begin FUNCTION injcrv_mienvcor_uic ""
 /begin OUT_MEASUREMENT InjCrv_phiMIAPSCor2_mp InjCrv_phiMIAPSCorStrt_mp InjCrv_phiMIAPSCor_mp InjCrv_phiMIATSCor2_mp InjCrv_phiMIATSCorStrt_mp InjCrv_phiMIATSCor_mp InjCrv_phiMIETSCor12_mp InjCrv_phiMIETSCor1_mp InjCrv_phiMIETSCor2_mp InjCrv_phiMIETSCorStrt_mp InjCrv_phiMIETSCor_mp InjCrv_phiMIFTSRailCorStrt_mp InjCrv_phiMIFTSRailCor_mp /end OUT_MEASUREMENT
/end FUNCTION
/begin FUNCTION injcrv_mirgn "Haupteinspritzung Regenerationswertberechnung"
 /begin DEF_CHARACTERISTIC InjCrv_facMIETSPhiCorRgn_CUR InjCrv_phiMI1Rgn1_MAP InjCrv_phiMI1Rgn2_MAP InjCrv_phiMIETSCorRgn_MAP InjCrv_qMI1Rgn1_MAP InjCrv_qMI1Rgn2_MAP /end DEF_CHARACTERISTIC
 /begin IN_MEASUREMENT CTSCD_tClnt Eng_nAvrg InjCtl_qSetUnBal /end IN_MEASUREMENT
/end FUNCTION
/begin FUNCTION injcrv_mirgnlib "Regeneration function library for MI"
 /begin DEF_CHARACTERISTIC InjCrv_dtiMI1RgnRmpUp_C InjCrv_dtiMI1RgnRmpDwn_C InjCrv_dtiMI1RgnTypeRmpUp_C InjCrv_dtiMI1RgnTypeRmpDwn_C InjCrv_stMI1RgnMsk_C InjCrv_stMI1RgnTypeMsk_C /end DEF_CHARACTERISTIC
/end FUNCTION
/begin FUNCTION injcrv_mirgn_msg "" /begin OUT_MEASUREMENT InjCrv_MI1RgnTypeVal InjCrv_phiMI1Rgn InjCrv_qMI1Rgn /end OUT_MEASUREMENT /end FUNCTION
/begin FUNCTION injcrv_mirgn_uic ""
 /begin DEF_CHARACTERISTIC InjCrv_phiMI1RgnAdd_Vector InjCrv_phiMI1RgnAdd_Channel InjCrv_phiMI1Rgn_Vector InjCrv_phiMI1Rgn_Channel InjCrv_qMI1RgnAdd_Vector InjCrv_qMI1RgnAdd_Channel InjCrv_qMI1Rgn_Vector InjCrv_qMI1Rgn_Channel /end DEF_CHARACTERISTIC
 /begin OUT_MEASUREMENT InjCrv_phiMI1Rgn1_mp InjCrv_phiMI1Rgn2_mp InjCrv_phiMI1RgnByp_mp InjCrv_phiMI1Rgn_mp InjCrv_phiMIETSCorRgn_mp InjCrv_qMI1Rgn1_mp InjCrv_qMI1Rgn2_mp InjCrv_qMI1RgnByp_mp /end OUT_MEASUREMENT
/end FUNCTION
/begin FUNCTION injcrv_mirmtctl_uic "" /end FUNCTION
/begin FUNCTION injcrv_misoergn_msg "" /begin OUT_MEASUREMENT InjCrv_MI1RgnVal InjCrv_phiStrtInjSetPoint /end OUT_MEASUREMENT /end FUNCTION
/begin FUNCTION injcrv_misoergn_uic "" /end FUNCTION
/begin FUNCTION injcrv_mistrt "Berechnung Start der Einspritzung während Start" /begin DEF_CHARACTERISTIC InjCrv_phiMI1BasStrt_MAP /end DEF_CHARACTERISTIC /begin IN_MEASUREMENT Eng_nAvrg InjCtl_qSetUnBal /end IN_MEASUREMENT /end FUNCTION
/begin FUNCTION injcrv_mistrt_uic "" /begin OUT_MEASUREMENT InjCrv_phiMI1StrtCor_mp /end OUT_MEASUREMENT /end FUNCTION
/begin FUNCTION injcrv_mi_msg "" /begin OUT_MEASUREMENT InjCrv_phiMI1Des InjCrv_qMI1Des InjCrv_tiMI1ET /end OUT_MEASUREMENT /end FUNCTION
/begin FUNCTION injcrv_mi_uic ""
 /begin DEF_CHARACTERISTIC InjCrv_phiMI1DesAdd_Vector InjCrv_phiMI1DesAdd_Channel InjCrv_phiMI1Des_Vector InjCrv_phiMI1Des_Channel InjCrv_qMI1DesAdd_Vector InjCrv_qMI1DesAdd_Channel InjCrv_qMI1Des_Vector InjCrv_qMI1Des_Channel /end DEF_CHARACTERISTIC
 /begin OUT_MEASUREMENT InjCrv_phiMI1Bas_mp InjCrv_phiMI1Cor_mp InjCrv_phiMI1DesByp_mp InjCrv_phiMI1Lim_mp InjCrv_phiMI1Max_mp InjCrv_phiMI1Min_mp InjCrv_qMI1DesByp_mp InjCrv_qMI1Min_mp InjCrv_qMI1Nrm_mp InjCrv_qMI1Set_mp InjCrv_volMI1Cor_mp InjCrv_volMI1_mp /end OUT_MEASUREMENT
/end FUNCTION
/begin FUNCTION injcrv_pii "Einspritzverlauf - Voreinspritzung"
 /begin DEF_CHARACTERISTIC InjCrv_facPiI1QntMin_CUR InjCrv_phiPiIMax_C InjCrv_qMI1MinPiI1DiffHys_C InjCrv_qPiI1Bas2_MAP InjCrv_qPiI1BasFDC_MAP InjCrv_qPiI1Bas_MAP InjCrv_qPiI1Bas_X_AXIS InjCrv_qPiI1Bas_Y_AXIS InjCrv_qPiI1Max2_MAP InjCrv_qPiI1Max_MAP InjCrv_qPiI1Max_X_AXIS InjCrv_qPiI1Max_Y_AXIS InjCrv_qPiI1MinDiff_C InjCrv_stPiI1RgnDelMsk_C InjCrv_tiPiI1MinRgn_MAP InjCrv_tiPiI1Min_MAP InjCrv_tiPiIMax_C /end DEF_CHARACTERISTIC
 /begin IN_MEASUREMENT Eng_nAvrg InjCtl_qSetUnBal RailCD_pPeak /end IN_MEASUREMENT
 /begin OUT_MEASUREMENT InjCrv_PiI1RgnVal_mp /end OUT_MEASUREMENT
/end FUNCTION
/begin FUNCTION injcrv_pii1soephibas "" /end FUNCTION
/begin FUNCTION injcrv_pii1soephibas_uic "" /begin OUT_MEASUREMENT InjCrv_phiPiI1Bas_mp /end OUT_MEASUREMENT /end FUNCTION
/begin FUNCTION injcrv_pii1soetibas ""
 /begin DEF_CHARACTERISTIC InjCrv_tiPiI1Bas1FDC_MAP InjCrv_tiPiI1Bas1_MAP InjCrv_tiPiI1Bas2_MAP InjCrv_tiPiI1Bas3_MAP /end DEF_CHARACTERISTIC
 /begin IN_MEASUREMENT Eng_nAvrg InjCtl_qSetUnBal /end IN_MEASUREMENT
/end FUNCTION
/begin FUNCTION injcrv_pii1soetibas_uic "" /begin OUT_MEASUREMENT InjCrv_tiPiI1Bas_mp /end OUT_MEASUREMENT /end FUNCTION
/begin FUNCTION injcrv_pii1strt "" /begin DEF_CHARACTERISTIC InjCrv_qPiI1BasStrt_MAP InjCrv_tiPiI1BasStrt_MAP /end DEF_CHARACTERISTIC /begin IN_MEASUREMENT Eng_nAvrg InjCtl_qSetUnBal /end IN_MEASUREMENT /end FUNCTION
/begin FUNCTION injcrv_pii1strt_uic "" /begin OUT_MEASUREMENT InjCrv_qPiI1BasStrt_mp InjCrv_tiPiI1BasStrt_mp /end OUT_MEASUREMENT /end FUNCTION
/begin FUNCTION injcrv_pii2 "Einspritzverlauf - Voreinspritzung 2"
 /begin DEF_CHARACTERISTIC InjCrv_facPiI1QntMax_C InjCrv_facPiI2QntMin_CUR InjCrv_nDiffMin_C InjCrv_qDiffMin_C InjCrv_qMI1MinPiI2DiffHys_C InjCrv_qPiI1WvCorMax_C InjCrv_qPiI2Bas_MAP InjCrv_qPiI2Max_MAP InjCrv_qPiI2MinDiff_C InjCrv_stPiI2RgnDelMsk_C /end DEF_CHARACTERISTIC
 /begin IN_MEASUREMENT Eng_nAvrg InjCtl_qSetUnBal RailCD_pPeak /end IN_MEASUREMENT
 /begin OUT_MEASUREMENT InjCrv_PiI2RgnVal_mp /end OUT_MEASUREMENT
/end FUNCTION
/begin FUNCTION injcrv_pii2addcor "PiI2 - projektspezifische Korrektur" /end FUNCTION
/begin FUNCTION injcrv_pii2addcorphi "" /end FUNCTION
/begin FUNCTION injcrv_pii2addcorphi_uic "" /end FUNCTION
/begin FUNCTION injcrv_pii2addcorslow "Gewichtungsfaktor für projektspezifische Korrektur der PiI2" /end FUNCTION
/begin FUNCTION injcrv_pii2addcorslow_msg "" /end FUNCTION
/begin FUNCTION injcrv_pii2addcorslow_uic "" /end FUNCTION
/begin FUNCTION injcrv_pii2addcorti_uic "" /end FUNCTION
/begin FUNCTION injcrv_pii2addcor_msg ""
 /begin OUT_MEASUREMENT InjCrv_phiPiI2AddCor InjCrv_qPiI2AddCor InjCrv_tiPiI2AddCor /end OUT_MEASUREMENT
/end FUNCTION
/begin FUNCTION injcrv_pii2addcor_uic "" /end FUNCTION
/begin FUNCTION injcrv_pii2envcor "Voreinspritzung 2 - Umwelt -Korrekturen"
 /begin DEF_CHARACTERISTIC InjCrv_qPiI2APSCorStrt_MAP InjCrv_qPiI2APSCor_MAP InjCrv_qPiI2ATSCorStrt_MAP InjCrv_qPiI2ATSCor_MAP InjCrv_qPiI2ETSCorStrt_MAP InjCrv_qPiI2ETSCor_MAP /end DEF_CHARACTERISTIC
 /begin IN_MEASUREMENT Eng_nAvrg InjCtl_qSetUnBal /end IN_MEASUREMENT
/end FUNCTION
/begin FUNCTION injcrv_pii2envcorphi "" /end FUNCTION
/begin FUNCTION injcrv_pii2envcorphi_uic "" /begin OUT_MEASUREMENT InjCrv_phiPiI2ETSCor_mp /end OUT_MEASUREMENT /end FUNCTION
/begin FUNCTION injcrv_pii2envcorslow ""
 /begin DEF_CHARACTERISTIC InjCrv_facPiI2APSQCorStrt_CUR InjCrv_facPiI2APSQCor_CUR InjCrv_facPiI2APSSOECorStrt_CUR InjCrv_facPiI2APSSOECor_CUR InjCrv_facPiI2ATSQCorStrt_CUR InjCrv_facPiI2ATSQCor_CUR InjCrv_facPiI2ETSQCorStrt_CUR InjCrv_facPiI2ETSQCor_CUR InjCrv_facPiI2ETSSOECorStrt_CUR InjCrv_facPiI2ETSSOECor_CUR /end DEF_CHARACTERISTIC
 /begin IN_MEASUREMENT APSCD_pVal IATSCD_tAir InjCrv_tEng /end IN_MEASUREMENT
/end FUNCTION
/begin FUNCTION injcrv_pii2envcorslow_msg ""
 /begin OUT_MEASUREMENT InjCrv_facPiI2APSQCor InjCrv_facPiI2APSQCorStrt InjCrv_facPiI2APSSOECor InjCrv_facPiI2APSSOECorStrt InjCrv_facPiI2ATSQCor InjCrv_facPiI2ATSQCorStrt InjCrv_facPiI2ETSQCor InjCrv_facPiI2ETSQCorStrt InjCrv_facPiI2ETSSOECor InjCrv_facPiI2ETSSOECorStrt /end OUT_MEASUREMENT
/end FUNCTION
/begin FUNCTION injcrv_pii2envcorslow_uic "" /end FUNCTION
/begin COMPU_METHOD AirMassPerCyl "Luftmasse pro Zylinder" RAT_FUNC "%6.3" "mg/Hub" COEFFS 0 10 0 0 0 1 /end COMPU_METHOD
/begin COMPU_METHOD AngleCrS "Winkel Kurbelwelle" RAT_FUNC "%6.4" "deg CrS" COEFFS 0 42.6666666666667 0 0 0 1 /end COMPU_METHOD
/begin COMPU_METHOD B_TRUE "Umrechnung   ----> FALSE;    TRUE = TRUE" TAB_VERB "%6.3" "-" COMPU_TAB_REF B_TRUE /end COMPU_METHOD
/begin COMPU_VTAB B_TRUE "Umrechnung   ----> FALSE;    TRUE = TRUE" TAB_VERB 2 0 "FALSE" 1 "TRUE" /end COMPU_VTAB
/begin COMPU_METHOD dp_dZ20 " boost pressure per time (dp/dt) every 20ms" RAT_FUNC "%6.1" "hPa/s" COEFFS 0 0.1 0 0 0 1 /end COMPU_METHOD
/begin COMPU_METHOD DtyCyc "Tastverhaeltnis" RAT_FUNC "%6.4" "%" COEFFS 0 100 0 0 0 1 /end COMPU_METHOD
/begin COMPU_METHOD EGTSwt "Umrechnung für EGT Rampenschalter (1 / 1000*2^14 )" RAT_FUNC "%10.9" "-" COEFFS 0 16384000 0 0 0 1 /end COMPU_METHOD
/begin COMPU_METHOD EngN "Motordrehzahl" RAT_FUNC "%6.2" "rpm" COEFFS 0 1 0 0 0 1 /end COMPU_METHOD
/begin COMPU_METHOD EngTempFldSel "Verbale Umrechnung für Auswahl aus dem Motortemperatur-Feld Eng_tFld" TAB_VERB "%6.3" "-" COMPU_TAB_REF EngTempFldSel /end COMPU_METHOD
/begin COMPU_VTAB EngTempFldSel "Verbale Umrechnung für Auswahl aus dem Motortemperatur-Feld Eng_tFld" TAB_VERB 3 0 "Coolant_Temperature" 1 "Oil_Temperature" 2 "Eng_tEng" /end COMPU_VTAB
/begin COMPU_METHOD Eta "Umrechnugsformel für Wirkungsgradfaktor eta" RAT_FUNC "%6.4" "Nm/(mg/cyc)" COEFFS 0 128 0 0 0 1 /end COMPU_METHOD
/begin COMPU_METHOD Fact "Faktor mit Auflösung 1 / 8192, hauptsächlich für einen Faktorenbereich 0...1 verwendet" RAT_FUNC "%6.5" "-" COEFFS 0 8192 0 0 0 1 /end COMPU_METHOD
/begin COMPU_METHOD Fact1 "Faktor mit Auflösung 0,01 (100 mal höherer Bereich als Fact)" RAT_FUNC "%6.4" "-" COEFFS 0 128 0 0 0 1 /end COMPU_METHOD
/begin COMPU_METHOD InjMassCyc "Einspritzmenge pro Zyklus (mg/Zyklus)" RAT_FUNC "%6.4" "mg/cyc" COEFFS 0 100 0 0 0 1 /end COMPU_METHOD
/begin COMPU_METHOD InjMassInj "Einspritzmenge pro Einspritzung (mg/Einspritzung)" RAT_FUNC "%6.4" "mg/inj" COEFFS 0 100 0 0 0 1 /end COMPU_METHOD
/begin COMPU_METHOD InjMassPerSec_20ms "Einspritzmengenänderung pro Sekunde für 20ms-Tasks" RAT_FUNC "%6.3" "mg/hub/s" COEFFS 0 2 0 0 0 1 /end COMPU_METHOD
/begin COMPU_METHOD InjQntInj "Einspritzmenge der einzelnen Einspritzung" RAT_FUNC "%6.4" "mm^3/inj" COEFFS 0 100 0 0 0 1 /end COMPU_METHOD
/begin COMPU_METHOD InjTime_us "Zeit in Microsekunden für das Einspritztiming" RAT_FUNC "%6.2" "us" COEFFS 0 1 0 0 0 1 /end COMPU_METHOD
/begin COMPU_METHOD Kd_PerSec_20ms "differential gain (same unit as input and output) per time" RAT_FUNC "%6.5" "1/s" COEFFS 0 1310.72 0 0 0 1 /end COMPU_METHOD
/begin COMPU_METHOD Kd_Pres2dpdt "differential gain(boost pressure to rate of change of boost pressure)" RAT_FUNC "%8.7" "hPa/sec/hPa" COEFFS 0 131072 0 0 0 1 /end COMPU_METHOD
/begin COMPU_METHOD Ki_Trq2TrqT "Integrale Verstärkung Ki (Getriebeausgangsmoment über die Zeit aufintegriert)" RAT_FUNC "%6.4" "Nms" COEFFS 0 171.79869184 0 0 0 1 /end COMPU_METHOD
/begin COMPU_METHOD Ki_Trq2TrqT2 "Integrale Verstärkung Ki (Kupplungsmoment über die Zeit aufintegriert)" RAT_FUNC "%6.4" "Nms" COEFFS 0 429.4967296 0 0 0 1 /end COMPU_METHOD
/begin COMPU_METHOD NumPinAdc "verbale Umrechnung für ADC Signale" TAB_VERB "%6.3" "-" COMPU_TAB_REF NumPinAdc /end COMPU_METHOD
/begin COMPU_VTAB NumPinAdc "verbale Umrechnung für ADC Signale" TAB_VERB 27 0 "Water_Temperature_Sensor_182" 1 "Intake_Air_Temperature_Sensor_157" 2 "Charge_Air_Temperature_Sensor_183" 3 "Exhaust_Temperature_Sensor_2_134" 4 "Exhaust_Temperature_Sensor_1_158" 5 "1st_APP_Sensor_252" 6 "2nd_APP_Sensor_239" 7 "ADC_REF" 8 "Boost_Pressure_Sensor_154" 9 "Atmospheric_Pressure_Sensor" 10 "Battery_Voltage_Sensor" 11 "Rail_Pressure_Sensor_156" 12 "Rail_Pressure_Peak_Value_156" 13 "Booster_Voltage_Sensor" 14 "Current_MeUn_Sensor" 15 "Current_PCV_Sensor" 16 "Voltage_Bank_1" 17 "Voltage_Bank_2" 18 "Pressure_Upstream_Particle_Filter_159" 19 "Engine_Oil_Pressure_110" 20 "Temperature_ECU_PCB" 21 "Voltage_Lambda_Ua" 22 "Voltage_Lambda_Ri" 23 "EMCCD_Current_Governor1_124" 24 "EMCCD_Current_Governor2_121" 25 "ADC_DUMMY_NOT_USED" 26 "ADC_DUMMY_A_NOT_USED" /end COMPU_VTAB
/begin COMPU_METHOD OneToOne "eins zu eins (physikalischer Wert ist gleich dem internen Wert)" RAT_FUNC "%6.2" "-" COEFFS 0 1 0 0 0 1 /end COMPU_METHOD
/begin COMPU_METHOD PmpQnt "Fördermenge der Pumpe / Umdrehung" RAT_FUNC "%6.3" "mm^3/rev" COEFFS 0 10 0 0 0 1 /end COMPU_METHOD
/begin COMPU_METHOD Prc "Prozent, gleiche interne Auflösung wie Fact, aber Darstellung in Prozent (0...100%)" RAT_FUNC "%6.4" "%" COEFFS 0 81.92 0 0 0 1 /end COMPU_METHOD
/begin COMPU_METHOD Pres_hPa "Druck (angezeigt in [hPa])" RAT_FUNC "%6.2" "hPa" COEFFS 0 1 0 0 0 1 /end COMPU_METHOD
/begin COMPU_METHOD Pres_Rail "Raildruck in hPa" RAT_FUNC "%4.3" "bar" COEFFS 0 10.000000 0 0 0 1 /end COMPU_METHOD
/begin COMPU_METHOD Qp_mm3_sec "Umrechnung für Volumenstrom" RAT_FUNC "%6.1" "mm3/s" COEFFS 0 0.1 0 0 0 1 /end COMPU_METHOD
/begin COMPU_METHOD Rmp "einheitenloser Rampengradient (für Library Ramp, etc.)" RAT_FUNC "%6.4" "1/s" COEFFS 0 65.536 0 0 0 1 /end COMPU_METHOD
/begin COMPU_METHOD RmpCrsAg_InjCrv "Kurbelwellenwinkel Rampengradient" RAT_FUNC "%6.5" "deg Crs/s" COEFFS 0 2796.20266666667 0 0 0 1 /end COMPU_METHOD
/begin COMPU_METHOD RmpInjMassInj "injection mass per injection ramp gradient" RAT_FUNC "%6.5" "mg/inj/s" COEFFS 0 6553.6 0 0 0 1 /end COMPU_METHOD
/begin COMPU_METHOD RmpTemp "Rampengradient für Temperatur" RAT_FUNC "%6.4" "deg C/s" COEFFS 0 655.36 0 0 0 1 /end COMPU_METHOD
/begin COMPU_METHOD Rmp_Fact "Rampenfaktorgradient" RAT_FUNC "%8.7" "1/s" COEFFS 0 536870.912 0 0 0 1 /end COMPU_METHOD
/begin COMPU_METHOD TempCels_100ms "Temperatur Differenz in Grad C/sec (bezgl. 100ms task)" RAT_FUNC "%6.2" "deg C/s" COEFFS 0 1 0 0 0 1 /end COMPU_METHOD
/begin COMPU_METHOD TempDiff_Cels "difference/offset temperature displayed in degree celcius" RAT_FUNC "%6.3" "deg C" COEFFS 0 10 0 0 0 1 /end COMPU_METHOD
/begin COMPU_METHOD Temp_Cels "Temperatur dargestellt in °C (gleiche interne Darstellung wie Temp_Kelv)" RAT_FUNC "%6.1" "deg C" COEFFS 0 10 2731.4 0 0 1 /end COMPU_METHOD
/begin COMPU_METHOD TimeDelay_s "Zeitkonstante T1 (in s) für PT1, DT1, etc." RAT_FUNC "%9.3" "s" COEFFS 0 0 1 0 0.00023283064365387 0 /end COMPU_METHOD
/begin COMPU_METHOD TimeEGTRmp "Umrechnung  Zeit in Rampensteigung,  Verwendet in EGT-Bibliothek" RAT_FUNC "%6.3" "s" COEFFS 0 0 1 0 0.0152587890625 0 /end COMPU_METHOD
/begin COMPU_METHOD Time_ms "Zeit in ms für Fehlerentprellung (DSM) und SW-Timer" RAT_FUNC "%6.1" "ms" COEFFS 0 0.1 0 0 0 1 /end COMPU_METHOD
/begin COMPU_METHOD Time_s "Zeit in s für Fehlerentprellung (DSM) und SW-Timer" RAT_FUNC "%6.4" "s" COEFFS 0 100 0 0 0 1 /end COMPU_METHOD
/begin COMPU_METHOD TransR "Übersetzungsverhältnis (Getriebe etc.)" RAT_FUNC "%6.4" "-" COEFFS 0 100 0 0 0 1 /end COMPU_METHOD
/begin COMPU_METHOD Trq "Motormoment" RAT_FUNC "%6.3" "Nm" COEFFS 0 10 0 0 0 1 /end COMPU_METHOD
/begin COMPU_METHOD Vel "Fahrzeuggeschwindigkeit, gleiche interne Auflösung wie Vel_SI" RAT_FUNC "%6.4" "km/h" COEFFS 0 100 0 0 0 1 /end COMPU_METHOD
/begin COMPU_METHOD Volt "Spannung in V (von ADC)" RAT_FUNC "%6.2" "mV" COEFFS 0 0.2046 0 0 0 1 /end COMPU_METHOD
/begin RECORD_LAYOUT Gkf_Ws16 FNC_VALUES 1 SWORD COLUMN_DIR DIRECT /end RECORD_LAYOUT
/begin RECORD_LAYOUT Gkl_Ws16 FNC_VALUES 1 SWORD COLUMN_DIR DIRECT /end RECORD_LAYOUT
/begin RECORD_LAYOUT GSst_Xs16 NO_AXIS_PTS_X 1 SWORD AXIS_PTS_X 2 SWORD INDEX_INCR DIRECT /end RECORD_LAYOUT
/begin RECORD_LAYOUT Kf_Xs16_Ys16_Ws16 NO_AXIS_PTS_X 1 SWORD NO_AXIS_PTS_Y 2 SWORD AXIS_PTS_X 3 SWORD INDEX_INCR DIRECT AXIS_PTS_Y 4 SWORD INDEX_INCR DIRECT FNC_VALUES 5 SWORD COLUMN_DIR DIRECT /end RECORD_LAYOUT
/begin RECORD_LAYOUT Kl_Xs16_Ws16 NO_AXIS_PTS_X 1 SWORD AXIS_PTS_X 2 SWORD INDEX_INCR DIRECT FNC_VALUES 3 SWORD COLUMN_DIR DIRECT /end RECORD_LAYOUT
/begin RECORD_LAYOUT Kw_Ws16 FNC_VALUES 1 SWORD COLUMN_DIR DIRECT /end RECORD_LAYOUT
/begin RECORD_LAYOUT Kw_Ws32 FNC_VALUES 1 SLONG COLUMN_DIR DIRECT /end RECORD_LAYOUT
/begin RECORD_LAYOUT Kw_Ws8 FNC_VALUES 1 SBYTE COLUMN_DIR DIRECT /end RECORD_LAYOUT
/begin RECORD_LAYOUT Kw_Wu16 FNC_VALUES 1 UWORD COLUMN_DIR DIRECT /end RECORD_LAYOUT
/begin RECORD_LAYOUT Kw_Wu32 FNC_VALUES 1 ULONG COLUMN_DIR DIRECT /end RECORD_LAYOUT
/begin RECORD_LAYOUT Kw_Wu8 FNC_VALUES 1 UBYTE COLUMN_DIR DIRECT /end RECORD_LAYOUT
/end MODULE
/end PROJECT
