ASAP2_VERSION 1 3
/begin PROJECT P411 "BMW DDE6.0 6-Zylinder V96.2 14.10.2004"
/begin HEADER "" VERSION "V96.2_6Z" PROJECT_NO P411 /end HEADER
/begin MODULE DIM ""
/begin MOD_COMMON "" BYTE_ORDER MSB_FIRST ALIGNMENT_BYTE 1 ALIGNMENT_WORD 2 ALIGNMENT_LONG 4 ALIGNMENT_FLOAT32_IEEE 4 /end MOD_COMMON
/begin CHARACTERISTIC EGSys_AlpFreeCnvtTube_C "Wärmeübertragungskoeffizient am Abgasrohr aufgrund freier Konvektion" VAL_BLK 0xD0628 Kwb_Ws16 999.9000 ThermalCoEff 0.1000000 1000.000 FORMAT "%8.3" EXTENDED_LIMITS -3276.800 3276.700 NUMBER 2 /end CHARACTERISTIC
/begin CHARACTERISTIC EGSys_cpChrg_C "Wärmekapazität Turbolader" VALUE 0xD0554 Kw_Ws16 3000.000 HeatCapacity 0.00 3000.000 FORMAT "%8.3" EXTENDED_LIMITS -3276.800 3276.700 /end CHARACTERISTIC
/begin CHARACTERISTIC EGSys_cpTube_C "Wärmekapazität Abgasrohr" VAL_BLK 0xD062C Kwb_Ws16 2999.900 HeatCapacity 0.1000000 3000.000 FORMAT "%8.3" EXTENDED_LIMITS -3276.800 3276.700 NUMBER 2 /end CHARACTERISTIC
/begin CHARACTERISTIC EGSys_etaChrg_MAP "Kennfeld Gesamtwirkungsgrad Turbolader" MAP 0xD0556 Kf_Xs16_Ys16_Ws16 0.9998779 Fact 0.0001220703 1.000000 FORMAT "%8.6" EXTENDED_LIMITS -4.000000 3.999878
 /begin AXIS_DESCR STD_AXIS AFSCD_dmAirPerTime AirMassPerTime 8 0.00 1000.000 FORMAT "%8.3" EXTENDED_LIMITS -3276.800 3276.700 DEPOSIT ABSOLUTE /end AXIS_DESCR
 /begin AXIS_DESCR STD_AXIS EGSys_rPresCmpr_mp Fact 8 0.00 8.000000 FORMAT "%8.6" EXTENDED_LIMITS -4.000000 3.999878 DEPOSIT ABSOLUTE /end AXIS_DESCR
/end CHARACTERISTIC
/begin CHARACTERISTIC EGSys_facTempClg_CUR "Abkühlkennlinie abgasführende Bauteile" CURVE 0xD04EC Kl_Xs16_Ws16 2.000000 Fact 0.00 2.000000 FORMAT "%8.6" EXTENDED_LIMITS -4.000000 3.999878
 /begin AXIS_DESCR STD_AXIS EGSys_rTimeTrb_mp Fact1 8 0.00 8.000000 FORMAT "%8.6" EXTENDED_LIMITS -256.0000 255.9922 DEPOSIT ABSOLUTE /end AXIS_DESCR
/end CHARACTERISTIC
/begin CHARACTERISTIC EGSys_facTimeClg_CUR "inverse Abkühlkennlinie Motor" CURVE 0xD050E Kl_Xs16_Ws16 255.0000 Fact1 0.00 255.0000 FORMAT "%8.4" EXTENDED_LIMITS -256.0000 255.9922
 /begin AXIS_DESCR STD_AXIS EGSys_rTempClnt_mp Fact 8 0.00 3.900024 FORMAT "%8.6" EXTENDED_LIMITS -4.000000 3.999878 DEPOSIT ABSOLUTE /end AXIS_DESCR
/end CHARACTERISTIC
/begin CHARACTERISTIC EGSys_lDiamTube_C "Durchmesser Abgasrohr" VAL_BLK 0xD0630 Kwb_Ws16 99.99219 Length1 0.007812500 100.0000 FORMAT "%8.4" EXTENDED_LIMITS -256.0000 255.9922 NUMBER 2 /end CHARACTERISTIC
/begin CHARACTERISTIC EGSys_lLngthTube_C "Länge Abgasrohr" VAL_BLK 0xD0634 Kwb_Ws16 99.99219 Length1 0.007812500 100.0000 FORMAT "%8.4" EXTENDED_LIMITS -256.0000 255.9922 NUMBER 2 /end CHARACTERISTIC
/begin CHARACTERISTIC EGSys_NuTubeEnv_CUR "Nusselt-Zahl Abgasrohr-Aussenumströmung (nicht applizierbar)" CURVE 0xD0638 Kl_Xs16_Ws16 5309.000 OneToOne 0.00 5309.000 FORMAT "%8.3" EXTENDED_LIMITS -32768.00 32767.00 READ_ONLY
 /begin AXIS_DESCR STD_AXIS EGSys_ReTubeEnvInpCrv_mp OneToOne 8 0.00 3750.000 FORMAT "%8.3" EXTENDED_LIMITS -32768.00 32767.00 DEPOSIT ABSOLUTE /end AXIS_DESCR
/end CHARACTERISTIC
/begin CHARACTERISTIC EGSys_NuTube_CUR "Nusselt-Zahl für Abgasrohrdurchströmung (nicht applizierbar)" CURVE 0xD065A Kl_Xs16_Ws16 1130.000 OneToOne 0.00 1130.000 FORMAT "%8.3" EXTENDED_LIMITS -32768.00 32767.00 READ_ONLY
 /begin AXIS_DESCR STD_AXIS EGSys_ReTubeInpCrv_mp ReynoldsNum 8 0.00 800000.0 FORMAT "%8.1" EXTENDED_LIMITS -3276800. 3276700. DEPOSIT ABSOLUTE /end AXIS_DESCR
/end CHARACTERISTIC
/begin CHARACTERISTIC EGSys_tiChrgPT1_C "Feste thermische Zeitkonstante Turbolader" VALUE 0xD05FC Kw_Wu32 4294.9663 TimeDelay_s 0.0010000001 4294.9673 FORMAT "%9.4" EXTENDED_LIMITS 0.0000010000000 4294.9673 /end CHARACTERISTIC
/begin CHARACTERISTIC EGSys_pValDfl_C "Vorgabewert Umgebungsdruck für Turboladermodell" VALUE 0xD0600 Kw_Ws16 3000.000 Pres_hPa 500.0000 3500.000 FORMAT "%8.3" EXTENDED_LIMITS -32768.00 32767.00 /end CHARACTERISTIC
/begin CHARACTERISTIC EGSys_rSqTube_C "Anteil der vom Fahrtwind beaufschlagten Oberfläche Abgasrohr" VAL_BLK 0xD067C Kwb_Ws16 3.800049 Fact 0.09997559 3.900024 FORMAT "%8.6" EXTENDED_LIMITS -4.000000 3.999878 NUMBER 2 /end CHARACTERISTIC
/begin CHARACTERISTIC EGSys_rTempAdbt_CUR "Kennlinie für die adiabatische Zustandänderung der Temperatur (nicht applizierbar)" CURVE 0xD0602 Kl_Xs16_Ws16 0.4000244 Fact 1.000000 1.400024 FORMAT "%8.6" EXTENDED_LIMITS -4.000000 3.999878 READ_ONLY
 /begin AXIS_DESCR STD_AXIS EGSys_rPresCmpr_mp Fact 8 1.000000 8.000000 FORMAT "%8.6" EXTENDED_LIMITS -4.000000 3.999878 DEPOSIT ABSOLUTE /end AXIS_DESCR
/end CHARACTERISTIC
/begin CHARACTERISTIC EGSys_swtTAirSens_C "Umschalter für Umgebungstemperatursensor (1: Ladelufttemperatursensor, 0: Umgebungslufttemperatursensor)" VALUE 0xD0530 Kw_Wu8 1.000 OneToOne 0.00 1.000 FORMAT "%5.3" EXTENDED_LIMITS 0.00 255.0 /end CHARACTERISTIC
/begin CHARACTERISTIC EGSys_swtTimeChrg_C "Schalter zur Verwendung fester oder variabler thermischer Zeitkonstante für Turbolader (1 = fest, 0 = variabel)" VALUE 0xD0624 Kw_Wu8 1.000 OneToOne 0.00 1.000 FORMAT "%5.3" EXTENDED_LIMITS 0.00 255.0 /end CHARACTERISTIC
/begin CHARACTERISTIC EGSys_tEGPstTrbnDfl_C "Ersatzwert Turbinentemperatur im Fehlerfall" VALUE 0xD0626 Kw_Ws16 950.000 Temp_Cels -50.140 899.860 FORMAT "%8.3" EXTENDED_LIMITS -3549.940 3003.560 /end CHARACTERISTIC
/begin CHARACTERISTIC EGSys_tEGTubeDfl_C "Ersatzwert Abgastemperatur im Abgasrohr" VAL_BLK 0xD0680 Kwb_Ws16 950.000 Temp_Cels -50.140 899.860 FORMAT "%8.3" EXTENDED_LIMITS -3549.940 3003.560 NUMBER 2 /end CHARACTERISTIC
/begin CHARACTERISTIC EGSys_tiHaValClnt_C "Abkühl-Halbwertszeit Motor" VALUE 0xD0534 Kw_Wu32 42949672.9500 Time_s 0.00 42949672.9500 FORMAT "%13.4" /end CHARACTERISTIC
/begin CHARACTERISTIC EGSys_tiHaValNSC_C "Abkühl-Halbwertszeit NSC" VALUE 0xD0538 Kw_Wu32 42949672.9500 Time_s 0.00 42949672.9500 FORMAT "%13.4" /end CHARACTERISTIC
/begin CHARACTERISTIC EGSys_tiHaValOxiCat_C "Abkühl-Halbwertszeit Oxidationskatalysator" VALUE 0xD053C Kw_Wu32 42949672.9500 Time_s 0.00 42949672.9500 FORMAT "%13.4" /end CHARACTERISTIC
/begin CHARACTERISTIC EGSys_tiHaValTrb_C "Abkühlen der Halbzeit-Periode turbocharge" VALUE 0xD0540 Kw_Wu32 42949672.9500 Time_s 0.00 42949672.9500 FORMAT "%13.4" /end CHARACTERISTIC
/begin CHARACTERISTIC EGSys_tiHaValTube_C "Abkühl-Halbwertszeit Abgasrohr" VAL_BLK 0xD0544 Kwb_Wu32 42949672.9500 Time_s 0.00 42949672.9500 FORMAT "%13.4" NUMBER 2 /end CHARACTERISTIC
/begin CHARACTERISTIC EGSys_tiOfsClg_C "Abkühlzeitkorrektur Motor wg. Stauwärmeeffekten" VALUE 0xD054C Kw_Wu32 42949672.9500 Time_s 0.00 42949672.9500 FORMAT "%13.4" /end CHARACTERISTIC
/begin CHARACTERISTIC EGSys_tStrtCsRepl_C "Ersatzwert für Initialisierungstemperaturen der abgasführen den Bauteile im Fehlerfall" VALUE 0xD0550 Kw_Ws16 950.000 Temp_Cels -50.140 899.860 FORMAT "%8.3" EXTENDED_LIMITS -3549.940 3003.560 /end CHARACTERISTIC
/begin CHARACTERISTIC EGSys_tTubeDfl_C "Ersatzwert Abgasrohr-Temperatur" VAL_BLK 0xD0684 Kwb_Ws16 950.000 Temp_Cels -50.140 899.860 FORMAT "%8.3" EXTENDED_LIMITS -3549.940 3003.560 NUMBER 2 /end CHARACTERISTIC
/begin CHARACTERISTIC EGSys_tTubeIKi_C "I-Verstärkung Integrator zur Abgasrohr-Temperaturmodellierung" VALUE 0xD0688 Kw_Wu32 4.00003045797 Ki_Kelv_Sec 0.00 4.00003045797 FORMAT "%13.11" EXTENDED_LIMITS 0.00 9999999.99767 /end CHARACTERISTIC
/begin CHARACTERISTIC EGSys_tTubeIKiPos_C "I-Verstärkung Integrator Abgasrohr-Temperaturmodellierung für pos. Großsignalbereich" VALUE 0xD068C Kw_Wu32 4.00003045797 Ki_Kelv_Sec 0.00 4.00003045797 FORMAT "%13.11" EXTENDED_LIMITS 0.00 9999999.99767 /end CHARACTERISTIC
/begin CHARACTERISTIC EGSys_tTubeIKiNeg_C "I-Verstärkung Integrator Abgasrohr-Temperaturmodellierung für neg. Großsignalbereich" VALUE 0xD0690 Kw_Wu32 4.00003045797 Ki_Kelv_Sec 0.00 4.00003045797 FORMAT "%13.11" EXTENDED_LIMITS 0.00 9999999.99767 /end CHARACTERISTIC
/begin CHARACTERISTIC EGSys_tTubeIWinPos_C "Obere Kleinstwertgrenze Integrator zur Abgasrohr-Temperaturmodellierung" VALUE 0xD0694 Kw_Ws16 65535.00 OneToOne -32768.00 32767.00 FORMAT "%8.2" READ_ONLY /end CHARACTERISTIC
/begin CHARACTERISTIC EGSys_tTubeIWinNeg_C "Untere Kleinstwertgrenze Integrator zur Abgasrohr-Temperaturmodellierung" VALUE 0xD0696 Kw_Ws16 65535.00 OneToOne -32768.00 32767.00 FORMAT "%8.2" READ_ONLY /end CHARACTERISTIC
/begin CHARACTERISTIC EGT_CritMsOilKi_C "Steigung des Ölverdünnungsintegrators" VALUE 0xD06B0 Kw_Wu16 100.0000 Ki_mOil 0.00 100.0000 FORMAT "%8.4" EXTENDED_LIMITS 0.00 63.99902 /end CHARACTERISTIC
/begin CHARACTERISTIC EGT_DebMsOilSensVld_C "Entprellzeiten für die Validierung des TÖNS Signals für die Gesamtölmasse" VALUE 0xD06B2 Kw_Wu16 1000.000 Time_ms 0.00 1000.000 FORMAT "%8.3" EXTENDED_LIMITS 0.00 655350.0 /end CHARACTERISTIC
/begin CHARACTERISTIC EGT_dmOilDilPoIBas_MAP "Betriebspunktabhängiges Basiskennfeld zur Ermittlung des Kraftstoffeintrags ins Motoröl während einer Nacheinspritzung" MAP 0xD06B4 Kf_Xs16_Ys16_Ws16 655.3400 OilMassPerTime -327.6700 327.6700 FORMAT "%8.4" EXTENDED_LIMITS -327.6800 327.6700
 /begin AXIS_DESCR STD_AXIS Eng_nAvrg EngN 16 0.00 6000.000 FORMAT "%8.3" EXTENDED_LIMITS -32768.00 32767.00 DEPOSIT ABSOLUTE /end AXIS_DESCR
 /begin AXIS_DESCR STD_AXIS InjCtl_qSetUnBal InjMassCyc 16 0.00 327.6700 FORMAT "%8.4" EXTENDED_LIMITS -327.6800 327.6700 DEPOSIT ABSOLUTE /end AXIS_DESCR
/end CHARACTERISTIC
/begin CHARACTERISTIC EGT_dmOilRmvBas_MAP "Betriebspunktabhängiges Basiskennfeld für die Verringerung der Ölmasse" MAP 0xD08F8 Kf_Xs16_Ys16_Ws16 655.3400 OilMassPerTime -327.6700 327.6700 FORMAT "%8.4" EXTENDED_LIMITS -327.6800 327.6700
 /begin AXIS_DESCR STD_AXIS Eng_nAvrg EngN 16 0.00 6000.000 FORMAT "%8.3" EXTENDED_LIMITS -32768.00 32767.00 DEPOSIT ABSOLUTE /end AXIS_DESCR
 /begin AXIS_DESCR STD_AXIS InjCtl_qSetUnBal InjMassCyc 16 0.00 327.6700 FORMAT "%8.4" EXTENDED_LIMITS -327.6800 327.6700 DEPOSIT ABSOLUTE /end AXIS_DESCR
/end CHARACTERISTIC
/begin CHARACTERISTIC EGT_facKiAMPT_CUR "Grundwert I-Anteil des Reglereingriffs über Luftmasse" CURVE 0xD0BE8 Kl_Xs16_Ws16 0.06000046 Ki_Temp2EGTFact 0.00 0.06000046 FORMAT "%10.8" EXTENDED_LIMITS -0.03814697 0.03814581
 /begin AXIS_DESCR STD_AXIS Eng_nAvrg EngN 8 0.00 6000.000 FORMAT "%8.3" EXTENDED_LIMITS -32768.00 32767.00 DEPOSIT ABSOLUTE /end AXIS_DESCR
/end CHARACTERISTIC
/begin CHARACTERISTIC EGT_facKiInrNegTempGvnr_C "Korrekturfaktor I-Anteil bei negativer Großsignalverstärkung innerer Regler" VALUE 0xD0C0C Kw_Wu32 100.000000000 Fact1 0.00 100.000000000 FORMAT "%13.9" EXTENDED_LIMITS 0.00 33554431.9922 /end CHARACTERISTIC
/begin CHARACTERISTIC EGT_facKiInrPosTempGvnr_C "Korrekturfaktor I-Anteil bei positiver Großsignalverstärkung innerer Regler" VALUE 0xD0C10 Kw_Wu32 100.000000000 Fact1 0.00 100.000000000 FORMAT "%13.9" EXTENDED_LIMITS 0.00 33554431.9922 /end CHARACTERISTIC
/begin CHARACTERISTIC EGT_facKiOutrNegTempGvnr_C "Korrekturfaktor I-Anteil bei negativer Großsignalverstärkung äußerer Regler" VALUE 0xD0C14 Kw_Wu32 100.000000000 Fact1 0.00 100.000000000 FORMAT "%13.9" EXTENDED_LIMITS 0.00 33554431.9922 /end CHARACTERISTIC
/begin CHARACTERISTIC EGT_facKiOutrPosTempGvnr_C "Korrekturfaktor I-Anteil bei positiver Großsignalverstärkung äußerer Regler" VALUE 0xD0C18 Kw_Wu32 100.000000000 Fact1 0.00 100.000000000 FORMAT "%13.9" EXTENDED_LIMITS 0.00 33554431.9922 /end CHARACTERISTIC
/begin CHARACTERISTIC EGT_facKiQntPoI1_MAP "Grundwert I-Anteil des äußeren Reglers bei Eingriff über Einspritzung" MAP 0xD0C1C Kf_Xs16_Ys16_Ws16 0.06000046 Ki_Temp2EGTFact 0.00 0.06000046 FORMAT "%10.8" EXTENDED_LIMITS -0.03814697 0.03814581
 /begin AXIS_DESCR STD_AXIS Eng_nAvrg EngN 8 0.00 6000.000 FORMAT "%8.3" EXTENDED_LIMITS -32768.00 32767.00 DEPOSIT ABSOLUTE /end AXIS_DESCR
 /begin AXIS_DESCR STD_AXIS InjCtl_qSetUnBal InjMassCyc 8 0.00 327.6700 FORMAT "%8.4" EXTENDED_LIMITS -327.6800 327.6700 DEPOSIT ABSOLUTE /end AXIS_DESCR
/end CHARACTERISTIC
/begin CHARACTERISTIC EGT_facKiQntPoI2_MAP "Grundwert I-Anteil des inneren Reglers bei Eingriff über Einspritzung" MAP 0xD0CC0 Kf_Xs16_Ys16_Ws16 0.06000046 Ki_Temp2EGTFact 0.00 0.06000046 FORMAT "%10.8" EXTENDED_LIMITS -0.03814697 0.03814581
 /begin AXIS_DESCR STD_AXIS Eng_nAvrg EngN 8 0.00 6000.000 FORMAT "%8.3" EXTENDED_LIMITS -32768.00 32767.00 DEPOSIT ABSOLUTE /end AXIS_DESCR
 /begin AXIS_DESCR STD_AXIS InjCtl_qSetUnBal InjMassCyc 8 0.00 327.6700 FORMAT "%8.4" EXTENDED_LIMITS -327.6800 327.6700 DEPOSIT ABSOLUTE /end AXIS_DESCR
/end CHARACTERISTIC
/begin CHARACTERISTIC EGT_facKiTempInrCor_MAP "Grundwert I-Anteil des inneren Reglers bei Eingriff über Temperatursollwert" MAP 0xD0D64 Kf_Xs16_Ys16_Ws16 0.06000046 Ki_Temp2EGTFact 0.00 0.06000046 FORMAT "%10.8" EXTENDED_LIMITS -0.03814697 0.03814581
 /begin AXIS_DESCR STD_AXIS Eng_nAvrg EngN 8 0.00 6000.000 FORMAT "%8.3" EXTENDED_LIMITS -32768.00 32767.00 DEPOSIT ABSOLUTE /end AXIS_DESCR
 /begin AXIS_DESCR STD_AXIS InjCtl_qSetUnBal InjMassCyc 8 0.00 327.6700 FORMAT "%8.4" EXTENDED_LIMITS -327.6800 327.6700 DEPOSIT ABSOLUTE /end AXIS_DESCR
/end CHARACTERISTIC
/begin CHARACTERISTIC EGT_facKpAMPT_CUR "Grundwert P-Anteil des inneren Reglers bei Eingriff über Luftmasse" CURVE 0xD0E08 Kl_Xs16_Ws16 0.06000000 Kp_Temp2EGTFact 0.00 0.06000000 FORMAT "%10.8" EXTENDED_LIMITS -0.6400000 0.6399805
 /begin AXIS_DESCR STD_AXIS Eng_nAvrg EngN 8 0.00 6000.000 FORMAT "%8.3" EXTENDED_LIMITS -32768.00 32767.00 DEPOSIT ABSOLUTE /end AXIS_DESCR
/end CHARACTERISTIC
/begin CHARACTERISTIC EGT_facKpInrNegTempGvnr_C "Korrekturfaktor P-Anteil bei negativer Großsignalverstärkung innerer Regler" VALUE 0xD0E2C Kw_Ws32 4.00000000000 Fact1 0.00 4.00000000000 FORMAT "%13.11" EXTENDED_LIMITS -16777216.0000 16777215.9922 /end CHARACTERISTIC
/begin CHARACTERISTIC EGT_facKpInrPosTempGvnr_C "Korrekturfaktor P-Anteil bei positiver Großsignalverstärkung innerer Regler" VALUE 0xD0E30 Kw_Ws32 4.00000000000 Fact1 0.00 4.00000000000 FORMAT "%13.11" EXTENDED_LIMITS -16777216.0000 16777215.9922 /end CHARACTERISTIC
/begin CHARACTERISTIC EGT_facKpOutrNegTempGvnr_C "Korrekturfaktor P-Anteil bei negativer Großsignalverstärkung äußerer Regler" VALUE 0xD0E34 Kw_Ws32 4.00000000000 Fact1 0.00 4.00000000000 FORMAT "%13.11" EXTENDED_LIMITS -16777216.0000 16777215.9922 /end CHARACTERISTIC
/begin CHARACTERISTIC EGT_facKpOutrPosTempGvnr_C "Korrekturfaktor P-Anteil bei positiver Großsignalverstärkung äußerer Regler" VALUE 0xD0E38 Kw_Ws32 4.00000000000 Fact1 0.00 4.00000000000 FORMAT "%13.11" EXTENDED_LIMITS -16777216.0000 16777215.9922 /end CHARACTERISTIC
/begin CHARACTERISTIC EGT_facKpQntPoI1_MAP "Grundwert P-Anteil des äußeren Reglers bei Eingriff über Einspritzung" MAP 0xD0E3C Kf_Xs16_Ys16_Ws16 0.06000000 Kp_Temp2EGTFact 0.00 0.06000000 FORMAT "%10.8" EXTENDED_LIMITS -0.6400000 0.6399805
 /begin AXIS_DESCR STD_AXIS Eng_nAvrg EngN 8 0.00 6000.000 FORMAT "%8.3" EXTENDED_LIMITS -32768.00 32767.00 DEPOSIT ABSOLUTE /end AXIS_DESCR
 /begin AXIS_DESCR STD_AXIS InjCtl_qSetUnBal InjMassCyc 8 0.00 327.6700 FORMAT "%8.4" EXTENDED_LIMITS -327.6800 327.6700 DEPOSIT ABSOLUTE /end AXIS_DESCR
/end CHARACTERISTIC
/begin CHARACTERISTIC EGT_facKpQntPoI2_MAP "Grundwert P-Anteil des inneren Reglers bei Eingriff über Einspritzung" MAP 0xD0EE0 Kf_Xs16_Ys16_Ws16 0.06000000 Kp_Temp2EGTFact 0.00 0.06000000 FORMAT "%10.8" EXTENDED_LIMITS -0.6400000 0.6399805
 /begin AXIS_DESCR STD_AXIS Eng_nAvrg EngN 8 0.00 6000.000 FORMAT "%8.3" EXTENDED_LIMITS -32768.00 32767.00 DEPOSIT ABSOLUTE /end AXIS_DESCR
 /begin AXIS_DESCR STD_AXIS InjCtl_qSetUnBal InjMassCyc 8 0.00 327.6700 FORMAT "%8.4" EXTENDED_LIMITS -327.6800 327.6700 DEPOSIT ABSOLUTE /end AXIS_DESCR
/end CHARACTERISTIC
/begin CHARACTERISTIC EGT_facKpTempInrCor_MAP "Grundwert P-Anteil des inneren Reglers bei Eingriff über Temperatursollwert" MAP 0xD0F84 Kf_Xs16_Ys16_Ws16 0.06000000 Kp_Temp2EGTFact 0.00 0.06000000 FORMAT "%10.8" EXTENDED_LIMITS -0.6400000 0.6399805
 /begin AXIS_DESCR STD_AXIS Eng_nAvrg EngN 8 0.00 6000.000 FORMAT "%8.3" EXTENDED_LIMITS -32768.00 32767.00 DEPOSIT ABSOLUTE /end AXIS_DESCR
 /begin AXIS_DESCR STD_AXIS InjCtl_qSetUnBal InjMassCyc 8 0.00 327.6700 FORMAT "%8.4" EXTENDED_LIMITS -327.6800 327.6700 DEPOSIT ABSOLUTE /end AXIS_DESCR
/end CHARACTERISTIC
/begin CHARACTERISTIC EGT_facOilDilTempEng_CUR "Motortemperaturabhängige Kennlinie für den Kraftstoffeintrag ins Motoröl während der Nacheinspritzung" CURVE 0xD0B3C Kl_Xs16_Ws16 1.000000 Fact 0.00 1.000000 FORMAT "%8.6" EXTENDED_LIMITS -4.000000 3.999878
 /begin AXIS_DESCR STD_AXIS EGT_tEng_mp Temp_Cels 8 -50.140 899.860 FORMAT "%8.3" EXTENDED_LIMITS -3549.940 3003.560 DEPOSIT ABSOLUTE /end AXIS_DESCR
/end CHARACTERISTIC
/begin CHARACTERISTIC EGT_facOilRmvMsOil_CUR "Ölmassenabhängiges Korrekturkennfeld für die Verringerung der Ölmasse" CURVE 0xD0B5E Kl_Xs16_Ws16 1.000000 Fact 0.00 1.000000 FORMAT "%8.6" EXTENDED_LIMITS -4.000000 3.999878
 /begin AXIS_DESCR STD_AXIS EGT_mOilEngCrvIn_mp OilMassRed 8 0.00 134213.6 FORMAT "%8.1" EXTENDED_LIMITS -134217.7 134213.6 DEPOSIT ABSOLUTE /end AXIS_DESCR
/end CHARACTERISTIC
/begin CHARACTERISTIC EGT_facOilRmvTempOil_CUR "Öltemperaturabhängige Kennlnie für die Verringerung der Ölmasse" CURVE 0xD0B80 Kl_Xs16_Ws16 1.000000 Fact 0.00 1.000000 FORMAT "%8.6" EXTENDED_LIMITS -4.000000 3.999878
 /begin AXIS_DESCR STD_AXIS EGT_tOil_mp Temp_Cels 8 -50.140 899.860 FORMAT "%8.3" EXTENDED_LIMITS -3549.940 3003.560 DEPOSIT ABSOLUTE /end AXIS_DESCR
/end CHARACTERISTIC
/begin CHARACTERISTIC EGT_facPoI2Dist_C "Anteil der vom inneren Regelkreis geforderten Menge, die auf die PoI2 entfällt" VALUE 0xD27B0 Kw_Wu16 1.000000 Fact_EGT 0.00 1.000000 FORMAT "%8.6" EXTENDED_LIMITS 0.00 65.53500 /end CHARACTERISTIC
/begin CHARACTERISTIC EGT_facQntPoI2Rmp_CUR "Anpassung Rampenwert an PoI2" CURVE 0xD27B2 Kl_Xs16_Ws16 1.000000 EGTSwt_S16 0.00 1.000000 FORMAT "%8.6" EXTENDED_LIMITS -2.000000 1.999939
 /begin AXIS_DESCR STD_AXIS EGT_facQntPoI2RmpCur_mp EGTSwt_S16 3 0.00 1.000000 FORMAT "%8.6" EXTENDED_LIMITS -2.000000 1.999939 DEPOSIT ABSOLUTE /end AXIS_DESCR
/end CHARACTERISTIC
/begin CHARACTERISTIC EGT_mAirDesTempGvnrMnl_C "Manueller Defaultwert für Luftmassensollwertkorektur" VALUE 0xD27C0 Kw_Ws16 10000.00 AirMassPerCyl -5000.000 5000.000 FORMAT "%8.3" EXTENDED_LIMITS -3276.800 3276.700 /end CHARACTERISTIC
/begin CHARACTERISTIC EGT_mAirLmbd_CUR "Luftmassenkorrektur über Lambdawert" CURVE 0xD27C2 Kl_Xs16_Ws16 10000.00 AirMassPerCyl -5000.000 5000.000 FORMAT "%8.3" EXTENDED_LIMITS -3276.800 3276.700
 /begin AXIS_DESCR STD_AXIS EGT_rLmbd_mp lambda 8 0.00 7.000000 FORMAT "%8.6" EXTENDED_LIMITS -32.76800 32.76700 DEPOSIT ABSOLUTE /end AXIS_DESCR
/end CHARACTERISTIC
/begin CHARACTERISTIC EGT_mAirTempGvnrMax_MAP "Maximal mögliche Luftmassensollwertkorrektur" MAP 0xD1028 Kf_Xs16_Ys16_Ws16 5000.000 AirMassPerCyl 0.00 5000.000 FORMAT "%8.3" EXTENDED_LIMITS -3276.800 3276.700
 /begin AXIS_DESCR STD_AXIS Eng_nAvrg EngN 16 0.00 6000.000 FORMAT "%8.3" EXTENDED_LIMITS -32768.00 32767.00 DEPOSIT ABSOLUTE /end AXIS_DESCR
 /begin AXIS_DESCR STD_AXIS InjCtl_qSetUnBal InjMassCyc 16 0.00 327.6700 FORMAT "%8.4" EXTENDED_LIMITS -327.6800 327.6700 DEPOSIT ABSOLUTE /end AXIS_DESCR
/end CHARACTERISTIC
/begin CHARACTERISTIC EGT_mAirTempGvnrMin_MAP "Minimal mögliche Luftmassensollwertkorrektur" MAP 0xD126C Kf_Xs16_Ys16_Ws16 5000.000 AirMassPerCyl -5000.000 0.00 FORMAT "%8.3" EXTENDED_LIMITS -3276.800 3276.700
 /begin AXIS_DESCR STD_AXIS Eng_nAvrg EngN 16 0.00 6000.000 FORMAT "%8.3" EXTENDED_LIMITS -32768.00 32767.00 DEPOSIT ABSOLUTE /end AXIS_DESCR
 /begin AXIS_DESCR STD_AXIS InjCtl_qSetUnBal InjMassCyc 16 0.00 327.6700 FORMAT "%8.4" EXTENDED_LIMITS -327.6800 327.6700 DEPOSIT ABSOLUTE /end AXIS_DESCR
/end CHARACTERISTIC
/begin CHARACTERISTIC EGT_mAirThresOff_C "Abschaltschwelle für Luftmassen-Eingriff" VALUE 0xD14B0 Kw_Ws16 5000.000 AirMassPerCyl 0.00 5000.000 FORMAT "%8.3" EXTENDED_LIMITS -3276.800 3276.700 /end CHARACTERISTIC
/begin CHARACTERISTIC EGT_mOilDilEngDflMax_C "Maximale Verdünnte Ölmasse (Defaultwert)" VALUE 0xD0BA4 Kw_Ws32 2147483.64700 OilMass 0.00 2147483.64700 FORMAT "%13.5" EXTENDED_LIMITS -2147483.64800 2147483.64700 /end CHARACTERISTIC
/begin CHARACTERISTIC EGT_mOilDilEngDflMin_C "Festwert für Minimum - Default Verdünnte Ölmasse" VALUE 0xD0BA8 Kw_Ws32 2147483.64700 OilMass 0.00 2147483.64700 FORMAT "%13.5" EXTENDED_LIMITS -2147483.64800 2147483.64700 /end CHARACTERISTIC
/begin CHARACTERISTIC EGT_mOilDilEngSubs_C "EEPROM - Ersatzwert für Ölverdünnungsmasse" VALUE 0xD0BAC Kw_Ws32 2147483.64700 OilMass 0.00 2147483.64700 FORMAT "%13.5" EXTENDED_LIMITS -2147483.64800 2147483.64700 /end CHARACTERISTIC
/begin CHARACTERISTIC EGT_mOilEngCritMax_C "Maximaler Schwellwert für Kritische Ölmasse" VALUE 0xD0BB0 Kw_Ws32 2147483.64700 OilMass 0.00 2147483.64700 FORMAT "%13.5" EXTENDED_LIMITS -2147483.64800 2147483.64700 /end CHARACTERISTIC
/begin CHARACTERISTIC EGT_mOilEngCritMin_C "Minimaler Schwellwert für Kritische Ölmasse" VALUE 0xD0BB4 Kw_Ws32 2147483.64700 OilMass 0.00 2147483.64700 FORMAT "%13.5" EXTENDED_LIMITS -2147483.64800 2147483.64700 /end CHARACTERISTIC
/begin CHARACTERISTIC EGT_mOilEngDflMax_C "Festwert für Maximale Defaultölmasse" VALUE 0xD0BB8 Kw_Ws32 2147483.64700 OilMass 0.00 2147483.64700 FORMAT "%13.5" EXTENDED_LIMITS -2147483.64800 2147483.64700 /end CHARACTERISTIC
/begin CHARACTERISTIC EGT_mOilEngDflMin_C "Fixwert für die Minimale Standardgesamtölmasse" VALUE 0xD0BBC Kw_Ws32 2147483.64700 OilMass 0.00 2147483.64700 FORMAT "%13.5" EXTENDED_LIMITS -2147483.64800 2147483.64700 /end CHARACTERISTIC
/begin CHARACTERISTIC EGT_mOilEngSensVldMax_C "Maximaler Ölmassenschwellwert für die Gültigkeit des Ölsensorsignals" VALUE 0xD0BC0 Kw_Ws32 2147483.64700 OilMass 0.00 2147483.64700 FORMAT "%13.5" EXTENDED_LIMITS -2147483.64800 2147483.64700 /end CHARACTERISTIC
/begin CHARACTERISTIC EGT_mOilEngSensVldMin_C "Minimaler Ölmassenschwellwert für die Gültigkeit des Sensorsignals" VALUE 0xD0BC4 Kw_Ws32 2147483.64700 OilMass 0.00 2147483.64700 FORMAT "%13.5" EXTENDED_LIMITS -2147483.64800 2147483.64700 /end CHARACTERISTIC
/begin CHARACTERISTIC EGT_numTempEng_C "Auswahlschalter für Motortemperatur aus Motortemperaturarray" VALUE 0xD0BC8 Kw_Wu8 2.00000000000 EngTempFldSel 0.00 2.00000000000 FORMAT "%13.11" /end CHARACTERISTIC
/begin CHARACTERISTIC EGT_numTempOil_C "Auswahlschalter für Öltemperatur aus Öltemperaturarray" VALUE 0xD0BC9 Kw_Wu8 2.00000000000 EngTempFldSel 0.00 2.00000000000 FORMAT "%13.11" /end CHARACTERISTIC
/begin CHARACTERISTIC EGT_phiPoI1TempGvnr_MAP "Additive Winkelkorrektur der verzögerten Nacheinspritzung" MAP 0xD27E4 Kf_Xs16_Ys16_Ws16 399.9844 AngleCrS -199.9922 199.9922 FORMAT "%8.4" EXTENDED_LIMITS -768.0000 767.9766
 /begin AXIS_DESCR STD_AXIS Eng_nAvrg EngN 8 0.00 6000.000 FORMAT "%8.3" EXTENDED_LIMITS -32768.00 32767.00 DEPOSIT ABSOLUTE /end AXIS_DESCR
 /begin AXIS_DESCR STD_AXIS InjCtl_qSetUnBal InjMassCyc 8 0.00 327.6700 FORMAT "%8.4" EXTENDED_LIMITS -327.6800 327.6700 DEPOSIT ABSOLUTE /end AXIS_DESCR
/end CHARACTERISTIC
/begin CHARACTERISTIC EGT_qHCQntPoI1_CUR "Einspritzmengenkorrektur für HC-Dosierventil" CURVE 0xD2888 Kl_Xs16_Ws16 400.0000 InjMassInj -200.0000 200.0000 FORMAT "%8.4" EXTENDED_LIMITS -327.6800 327.6700
 /begin AXIS_DESCR STD_AXIS EGT_qPoI1Outr_mp InjMassInj 1 -200.0000 200.0000 FORMAT "%8.4" EXTENDED_LIMITS -327.6800 327.6700 DEPOSIT ABSOLUTE /end AXIS_DESCR
/end CHARACTERISTIC
/begin CHARACTERISTIC EGT_qPoI1Min_C "Minimalwert der angelagerten Nacheinspritzung" VALUE 0xD14B2 Kw_Ws16 327.6700 InjMassInj 0.00 327.6700 FORMAT "%8.4" EXTENDED_LIMITS -327.6800 327.6700 /end CHARACTERISTIC
/begin CHARACTERISTIC EGT_qPoI1TempGvnrMax_MAP "Maximal mögliche Korrektur der angelagerten Nacheinspritzung" MAP 0xD14B4 Kf_Xs16_Ys16_Ws16 200.0000 InjMassInj 0.00 200.0000 FORMAT "%8.4" EXTENDED_LIMITS -327.6800 327.6700
 /begin AXIS_DESCR STD_AXIS Eng_nAvrg EngN 16 0.00 6000.000 FORMAT "%8.3" EXTENDED_LIMITS -32768.00 32767.00 DEPOSIT ABSOLUTE /end AXIS_DESCR
 /begin AXIS_DESCR STD_AXIS InjCtl_qSetUnBal InjMassCyc 16 0.00 327.6700 FORMAT "%8.4" EXTENDED_LIMITS -327.6800 327.6700 DEPOSIT ABSOLUTE /end AXIS_DESCR
/end CHARACTERISTIC
/begin CHARACTERISTIC EGT_qPoI1TempGvnrMin_MAP "Minimal mögliche Korrektur der angelagerten Nacheinspritzung" MAP 0xD16F8 Kf_Xs16_Ys16_Ws16 200.0000 InjMassInj -200.0000 0.00 FORMAT "%8.4" EXTENDED_LIMITS -327.6800 327.6700
 /begin AXIS_DESCR STD_AXIS Eng_nAvrg EngN 16 0.00 6000.000 FORMAT "%8.3" EXTENDED_LIMITS -32768.00 32767.00 DEPOSIT ABSOLUTE /end AXIS_DESCR
 /begin AXIS_DESCR STD_AXIS InjCtl_qSetUnBal InjMassCyc 16 0.00 327.6700 FORMAT "%8.4" EXTENDED_LIMITS -327.6800 327.6700 DEPOSIT ABSOLUTE /end AXIS_DESCR
/end CHARACTERISTIC
/begin CHARACTERISTIC EGT_qPoI1TempGvnrMnl_C "Manueller Defaultwert der angelagerten Nacheinspritzung" VALUE 0xD288E Kw_Ws16 400.0000 InjMassInj -200.0000 200.0000 FORMAT "%8.4" EXTENDED_LIMITS -327.6800 327.6700 /end CHARACTERISTIC
/begin CHARACTERISTIC EGT_qPoI1ThresOff_C "Abschaltschwelle für PoI1-Eingriff" VALUE 0xD193C Kw_Ws16 327.6700 InjMassInj 0.00 327.6700 FORMAT "%8.4" EXTENDED_LIMITS -327.6800 327.6700 /end CHARACTERISTIC
/begin CHARACTERISTIC EGT_qPoI2Min_C "Minimalwert der angelagerten Nacheinspritzung" VALUE 0xD193E Kw_Ws16 327.6700 InjMassInj 0.00 327.6700 FORMAT "%8.4" EXTENDED_LIMITS -327.6800 327.6700 /end CHARACTERISTIC
/begin CHARACTERISTIC EGT_qPoI2TempGvnrMax_MAP "Maximal mögliche Korrekturmenge der angelagerten Nacheinspritzung" MAP 0xD1940 Kf_Xs16_Ys16_Ws16 200.0000 InjMassInj 0.00 200.0000 FORMAT "%8.4" EXTENDED_LIMITS -327.6800 327.6700
 /begin AXIS_DESCR STD_AXIS Eng_nAvrg EngN 16 0.00 6000.000 FORMAT "%8.3" EXTENDED_LIMITS -32768.00 32767.00 DEPOSIT ABSOLUTE /end AXIS_DESCR
 /begin AXIS_DESCR STD_AXIS InjCtl_qSetUnBal InjMassCyc 16 0.00 327.6700 FORMAT "%8.4" EXTENDED_LIMITS -327.6800 327.6700 DEPOSIT ABSOLUTE /end AXIS_DESCR
/end CHARACTERISTIC
/begin CHARACTERISTIC EGT_qPoI2TempGvnrMin_MAP "Minimal mögliche Korrekturmenge der angelagerten Nacheinspritzung" MAP 0xD1B84 Kf_Xs16_Ys16_Ws16 200.0000 InjMassInj -200.0000 0.00 FORMAT "%8.4" EXTENDED_LIMITS -327.6800 327.6700
 /begin AXIS_DESCR STD_AXIS Eng_nAvrg EngN 16 0.00 6000.000 FORMAT "%8.3" EXTENDED_LIMITS -32768.00 32767.00 DEPOSIT ABSOLUTE /end AXIS_DESCR
 /begin AXIS_DESCR STD_AXIS InjCtl_qSetUnBal InjMassCyc 16 0.00 327.6700 FORMAT "%8.4" EXTENDED_LIMITS -327.6800 327.6700 DEPOSIT ABSOLUTE /end AXIS_DESCR
/end CHARACTERISTIC
/begin CHARACTERISTIC EGT_qPoI2TempGvnrMnl_C "Manueller Defaultwert der angelagerten Nacheinspritzung" VALUE 0xD2890 Kw_Ws16 400.0000 InjMassInj -200.0000 200.0000 FORMAT "%8.4" EXTENDED_LIMITS -327.6800 327.6700 /end CHARACTERISTIC
/begin CHARACTERISTIC EGT_qPoI2ThresOff_C "Abschaltschwelle für PoI2-Eingriff" VALUE 0xD1DC8 Kw_Ws16 327.6700 InjMassInj 0.00 327.6700 FORMAT "%8.4" EXTENDED_LIMITS -327.6800 327.6700 /end CHARACTERISTIC
/begin CHARACTERISTIC EGT_rhoFuel_C "Öldichte in kg/m³" VALUE 0xD0BCC Kw_Ws32 429496729.500 RhoFuel -214748364.800 214748364.700 FORMAT "%13.3" /end CHARACTERISTIC
/begin CHARACTERISTIC EGT_rOilDilEngCritMax_C "Maximale Schwelle für Kritischen Anteil an Ölverdünnung" VALUE 0xD0BD0 Kw_Ws16 100.0000 OilMassPrc 0.00 100.0000 FORMAT "%8.4" EXTENDED_LIMITS -32.76800 32.76700 /end CHARACTERISTIC
/begin CHARACTERISTIC EGT_rOilEngCritMaxVsc_C "Maximale Schwelle für kritischen Anteil an Ölverdünnung bei minimaler Default - Gesamtölmasse im Motor" VALUE 0xD0BD2 Kw_Ws16 100.0000 OilMassPrc 0.00 100.0000 FORMAT "%8.4" EXTENDED_LIMITS -32.76800 32.76700 /end CHARACTERISTIC
/begin CHARACTERISTIC EGT_stMskClsThrVlv_C "Bitmaske Anforderung maximale Androsselung" VALUE 0xD1DCC Kw_Wu32 2147483647.00 OneToOne 0.00 2147483647.00 FORMAT "%13.2" EXTENDED_LIMITS 0.00 4294967295.00 /end CHARACTERISTIC
/begin CHARACTERISTIC EGT_stMskInrTempGvnr_C "Maske Aktivierung innerer Regelkreis" VALUE 0xD277C Kw_Wu32 2147483647.00 OneToOne 0.00 2147483647.00 FORMAT "%13.2" EXTENDED_LIMITS 0.00 4294967295.00 /end CHARACTERISTIC
/begin CHARACTERISTIC EGT_stMskInrTempGvrService_C "Bitmaske für EGT_st um auf den  kundenspezifischen Temperaturregler umzuschalten" VALUE 0xD293C Kw_Wu32 4294967295.00 OneToOne 0.00 4294967295.00 FORMAT "%13.2" /end CHARACTERISTIC
/begin CHARACTERISTIC EGT_stMskOutrTempGvnr_C "Maske Aktivierung äußerer Regelkreis" VALUE 0xD2780 Kw_Wu32 2147483647.00 OneToOne 0.00 2147483647.00 FORMAT "%13.2" EXTENDED_LIMITS 0.00 4294967295.00 /end CHARACTERISTIC
/begin CHARACTERISTIC EGT_stOilDilMsk_C "Maske für die Festlegung von Ölverdünnungsbedingungen" VALUE 0xD0BD4 Kw_Wu32 4294967295.00 OneToOne 0.00 4294967295.00 FORMAT "%13.2" /end CHARACTERISTIC
/begin CHARACTERISTIC EGT_stRgnLckMsk_C "Maske zur Blockierung und Aktivierung der Regenerationsmaßnahmen" VALUE 0xD069C Kw_Wu32 2147483647.00 OneToOne 0.00 2147483647.00 FORMAT "%13.2" EXTENDED_LIMITS 0.00 4294967295.00 /end CHARACTERISTIC
/begin CHARACTERISTIC EGT_stTSync_Vector "#SSD Konfigurationslabel für Bypass" VALUE 0xC393E Kw_Wu8 255.0 OneToOne 0.00 255.0 FORMAT "%5.1" /end CHARACTERISTIC
/begin CHARACTERISTIC EGT_stTSync_Channel "#SSD Konfigurationslabels für Bypass" VALUE 0xC393F Kw_Wu8 255.0 OneToOne 0.00 255.0 FORMAT "%5.1" /end CHARACTERISTIC
/begin CHARACTERISTIC EGT_swtEGTActv_C "Schalter- Wert, um die EGT- Funktionen ein- oder auszuschalten" VALUE 0xD0698 Kw_Wu8 1.000 OneToOne 0.00 1.000 FORMAT "%5.3" EXTENDED_LIMITS 0.00 255.0 /end CHARACTERISTIC
/begin CHARACTERISTIC EGT_swtInrTempOutr_C "Innerer Regelkreis im stand-alone aktiv (=1), Regler in Kaskade (=0)" VALUE 0xD1DD0 Kw_Wu8 1.000 OneToOne 0.00 1.000 FORMAT "%5.3" EXTENDED_LIMITS 0.00 255.0 /end CHARACTERISTIC
/begin CHARACTERISTIC EGT_swtOilSensVldMaxMnl_C "Manuelle Bedingung für Übernahme des Ölsensorwertes für maximale Gesamtölmasse" VALUE 0xD0BD8 Kw_Wu8 1.000 OneToOne 0.00 1.000 FORMAT "%5.3" EXTENDED_LIMITS 0.00 255.0 /end CHARACTERISTIC
/begin CHARACTERISTIC EGT_swtOilSensVldMinMnl_C "Manuelle Bedingung für die Übernahme des Ölsensorsignals für die Minimale Gesamtölmasse" VALUE 0xD0BD9 Kw_Wu8 1.000 OneToOne 0.00 1.000 FORMAT "%5.3" EXTENDED_LIMITS 0.00 255.0 /end CHARACTERISTIC
/begin CHARACTERISTIC EGT_swtPoI1PoI2Dist_C "Aktivierung Durchgriff des inneren Regelkreises auf PoI1" VALUE 0xD2892 Kw_Wu8 1.000 OneToOne 0.00 1.000 FORMAT "%5.3" EXTENDED_LIMITS 0.00 255.0 /end CHARACTERISTIC
/begin CHARACTERISTIC EGT_swtQntPoI1HC_C "Umschaltung: 1= angelagerte Nacheinspritzung, 0 = HC Dosierventil" VALUE 0xD2893 Kw_Wu8 1.000 OneToOne 0.00 1.000 FORMAT "%5.3" EXTENDED_LIMITS 0.00 255.0 /end CHARACTERISTIC
/begin CHARACTERISTIC EGT_swtRgnLckRst_C "Schalter zum Rücksetzen der Verriegelung der Regenerationsmaßnahmen bei kritischer Ölverdünnungszeit (1: reset, 0: no reset)" VALUE 0xD06A0 Kw_Wu8 1.000 OneToOne 0.00 1.000 FORMAT "%5.3" EXTENDED_LIMITS 0.00 255.0 /end CHARACTERISTIC
/begin CHARACTERISTIC EGT_swtServiceVal_C "Serviceschalter zur Rücksetzung nach Ölwechsel (1: Reset, 0: kein Reset)" VALUE 0xD06A1 Kw_Wu8 1.000 OneToOne 0.00 1.000 FORMAT "%5.3" EXTENDED_LIMITS 0.00 255.0 /end CHARACTERISTIC
/begin CHARACTERISTIC EGT_swtTempOutrDes_C "Schaltet zwischen kundenspezifischem Sollwert (=1) und äußerem Regelkreis (=0)" VALUE 0xD2268 Kw_Wu8 1.000 OneToOne 0.00 1.000 FORMAT "%5.3" EXTENDED_LIMITS 0.00 255.0 /end CHARACTERISTIC
/begin CHARACTERISTIC EGT_swtTempTurbPre_C "Schalter für Umschaltung Temperatur vor Turbine (1: innererRegelkreis, 0: Temperatur vor Oxikat)" VALUE 0xD2269 Kw_Wu8 1.000 OneToOne 0.00 1.000 FORMAT "%5.3" EXTENDED_LIMITS 0.00 255.0 /end CHARACTERISTIC
/begin CHARACTERISTIC EGT_DebOilLvlCritMaxDef_C "Enprellzeit für die Defekt - Erkennung bei kritischer Ölmasse" VALUE 0xD0BDA Kw_Wu16 1000.000 Time_ms 0.00 1000.000 FORMAT "%8.3" EXTENDED_LIMITS 0.00 655350.0 /end CHARACTERISTIC
/begin CHARACTERISTIC EGT_DebOilLvlCritMaxOk_C "Entprellzeit für Heilung eines Kritische - Ölmasse - Fehlers" VALUE 0xD0BDC Kw_Wu16 1000.000 Time_ms 0.00 1000.000 FORMAT "%8.3" EXTENDED_LIMITS 0.00 655350.0 /end CHARACTERISTIC
/begin CHARACTERISTIC EGT_DebOilLvlCritMinDef_C "Entprellzeit für die Defekterkennung eines kritischen Ölstandsminimumsfehlers" VALUE 0xD0BDE Kw_Wu16 1000.000 Time_ms 0.00 1000.000 FORMAT "%8.3" EXTENDED_LIMITS 0.00 655350.0 /end CHARACTERISTIC
/begin CHARACTERISTIC EGT_DebOilLvlCritMinOk_C "Entprellzeit für die Heilung eines Kritischen Ölstandsminimumfehlers" VALUE 0xD0BE0 Kw_Wu16 1000.000 Time_ms 0.00 1000.000 FORMAT "%8.3" EXTENDED_LIMITS 0.00 655350.0 /end CHARACTERISTIC
/begin CHARACTERISTIC EGT_DebOilVscCritMinDef_C "Entprellzeit für die Defekterkennung kritischer Ölviskosität" VALUE 0xD0BE2 Kw_Wu16 1000.000 Time_ms 0.00 1000.000 FORMAT "%8.3" EXTENDED_LIMITS 0.00 655350.0 /end CHARACTERISTIC
/begin CHARACTERISTIC EGT_DebOilVscCritMinOk_C "Entprellzeit für die Heilung eines Kritischen Ölviskositätsfehlers" VALUE 0xD0BE4 Kw_Wu16 1000.000 Time_ms 0.00 1000.000 FORMAT "%8.3" EXTENDED_LIMITS 0.00 655350.0 /end CHARACTERISTIC
/begin CHARACTERISTIC EGT_DebTempGvnrInrMaxDef_C " Entprellzeit setzen Maximumfehler innerer Regelkreis" VALUE 0xD2784 Kw_Wu16 10000.00 Time_ms 0.00 10000.00 FORMAT "%8.2" EXTENDED_LIMITS 0.00 655350.0 /end CHARACTERISTIC
/begin CHARACTERISTIC EGT_DebTempGvnrInrMaxOK_C " Entprellzeit heilen Fehler innerer Regelkreis" VALUE 0xD2786 Kw_Wu16 10000.00 Time_ms 0.00 10000.00 FORMAT "%8.2" EXTENDED_LIMITS 0.00 655350.0 /end CHARACTERISTIC
/begin CHARACTERISTIC EGT_DebTempGvnrInrMinDef_C " Entprellzeit setzen Minimumfehler innerer Regelkreis" VALUE 0xD2788 Kw_Wu16 10000.00 Time_ms 0.00 10000.00 FORMAT "%8.2" EXTENDED_LIMITS 0.00 655350.0 /end CHARACTERISTIC
/begin CHARACTERISTIC EGT_DebTempGvnrInrMinOK_C " Entprellzeit heilen Fehler innerer Regelkreis" VALUE 0xD278A Kw_Wu16 10000.00 Time_ms 0.00 10000.00 FORMAT "%8.2" EXTENDED_LIMITS 0.00 655350.0 /end CHARACTERISTIC
/begin CHARACTERISTIC EGT_DebTempGvnrOutrMaxDef_C "Entprellzeit setzen Maximumfehler äußerer Regelkreis" VALUE 0xD278C Kw_Wu16 10000.00 Time_ms 0.00 10000.00 FORMAT "%8.2" EXTENDED_LIMITS 0.00 655350.0 /end CHARACTERISTIC
/begin CHARACTERISTIC EGT_DebTempGvnrOutrMaxOK_C "Entprellzeit heilen Fehler äußerer Regelkreis" VALUE 0xD278E Kw_Wu16 10000.00 Time_ms 0.00 10000.00 FORMAT "%8.2" EXTENDED_LIMITS 0.00 655350.0 /end CHARACTERISTIC
/begin CHARACTERISTIC EGT_DebTempGvnrOutrMinDef_C "Entprellzeit setzen Minimumfehler äußererer Regelkreis" VALUE 0xD2790 Kw_Wu16 10000.00 Time_ms 0.00 10000.00 FORMAT "%8.2" EXTENDED_LIMITS 0.00 655350.0 /end CHARACTERISTIC
/begin CHARACTERISTIC EGT_DebTempGvnrOutrMinOK_C "Entprellzeit heilen Fehler äußerer Regelkreis" VALUE 0xD2792 Kw_Wu16 10000.00 Time_ms 0.00 10000.00 FORMAT "%8.2" EXTENDED_LIMITS 0.00 655350.0 /end CHARACTERISTIC
/begin CHARACTERISTIC EGT_tiHiLoTempGvnr_C "Entprellzeit der Aktivierungsschwellen (high -> low) der Reglerkreise" VALUE 0xD2794 Kw_Wu16 655140.0 Time_s 0.00 655140.0 FORMAT "%8.1" EXTENDED_LIMITS 0.00 655.3500 /end CHARACTERISTIC
/begin CHARACTERISTIC EGT_tiLoHiTempGvnr_C "Entprellzeit für Aktivierungsschwellen (low -> high) der Reglerkreise" VALUE 0xD2796 Kw_Wu16 655140.0 Time_s 0.00 655140.0 FORMAT "%8.1" EXTENDED_LIMITS 0.00 655.3500 /end CHARACTERISTIC
/begin CHARACTERISTIC EGT_tInrCorTempGvnrMax_MAP "Maximal erlaubte Sollwertkorrektur des inneren Regelkreises" MAP 0xD1DD2 Kf_Xs16_Ys16_Ws16 1600.000 TempDiff_Cels -100.0000 1500.000 FORMAT "%8.3" EXTENDED_LIMITS -3276.800 3276.700
 /begin AXIS_DESCR STD_AXIS Eng_nAvrg EngN 16 0.00 6000.000 FORMAT "%8.3" EXTENDED_LIMITS -32768.00 32767.00 DEPOSIT ABSOLUTE /end AXIS_DESCR
 /begin AXIS_DESCR STD_AXIS InjCtl_qSetUnBal InjMassCyc 16 0.00 327.6700 FORMAT "%8.4" EXTENDED_LIMITS -327.6800 327.6700 DEPOSIT ABSOLUTE /end AXIS_DESCR
/end CHARACTERISTIC
/begin CHARACTERISTIC EGT_tInrCorTempGvnrMin_MAP "Minimal erlaubte Sollwertkorrektur des inneren Regelkreises" MAP 0xD2016 Kf_Xs16_Ys16_Ws16 1500.000 TempDiff_Cels -1500.000 0.00 FORMAT "%8.3" EXTENDED_LIMITS -3276.800 3276.700
 /begin AXIS_DESCR STD_AXIS Eng_nAvrg EngN 16 0.00 6000.000 FORMAT "%8.3" EXTENDED_LIMITS -32768.00 32767.00 DEPOSIT ABSOLUTE /end AXIS_DESCR
 /begin AXIS_DESCR STD_AXIS InjCtl_qSetUnBal InjMassCyc 16 0.00 327.6700 FORMAT "%8.4" EXTENDED_LIMITS -327.6800 327.6700 DEPOSIT ABSOLUTE /end AXIS_DESCR
/end CHARACTERISTIC
/begin CHARACTERISTIC EGT_tInrCorThresOff_C "Applikationsparameter der Temperaturgrenzwerten für die innere Regelkreis" VALUE 0xD225A Kw_Ws16 2000.000 TempDiff_Cels -1000.000 1000.000 FORMAT "%8.3" EXTENDED_LIMITS -3276.800 3276.700 /end CHARACTERISTIC
/begin CHARACTERISTIC EGT_tInrDesInTempGvnr_Vector "Externer Bypass hook für Temperatursetpointwert des Kunden spezifisch von innerer Regelkreis" VALUE 0xC3940 Kw_Wu8 255.0 OneToOne 0.00 255.0 FORMAT "%5.1" /end CHARACTERISTIC
/begin CHARACTERISTIC EGT_tInrDesInTempGvnr_Channel "Externer Bypass hook für Temperatursetpointwert des Kunden spezifisch von innerer Regelkreis" VALUE 0xC3941 Kw_Wu8 255.0 OneToOne 0.00 255.0 FORMAT "%5.1" /end CHARACTERISTIC
/begin CHARACTERISTIC EGT_tInrDesTempTurb_CUR "Sollwertkorrektur des inneren Regelkreises in Abhängigkeit der Temperatur vor Turbolader" CURVE 0xD226A Kl_Xs16_Ws16 1600.000 TempDiff_Cels -100.0000 1500.000 FORMAT "%8.3" EXTENDED_LIMITS -3276.800 3276.700
 /begin AXIS_DESCR STD_AXIS EGT_tTurbPre_mp Temp_Cels 8 -50.140 899.860 FORMAT "%8.3" EXTENDED_LIMITS -3549.940 3003.560 DEPOSIT ABSOLUTE /end AXIS_DESCR
/end CHARACTERISTIC
/begin CHARACTERISTIC EGT_tInrDes_MAP "Grundwert der Solltemperatur des inneren Regelkreises" MAP 0xD228C Kf_Xs16_Ys16_Ws16 950.000 Temp_Cels -50.140 899.860 FORMAT "%8.3" EXTENDED_LIMITS -3549.940 3003.560
 /begin AXIS_DESCR STD_AXIS Eng_nAvrg EngN 16 0.00 6000.000 FORMAT "%8.3" EXTENDED_LIMITS -32768.00 32767.00 DEPOSIT ABSOLUTE /end AXIS_DESCR
 /begin AXIS_DESCR STD_AXIS InjCtl_qSetUnBal InjMassCyc 16 0.00 327.6700 FORMAT "%8.4" EXTENDED_LIMITS -327.6800 327.6700 DEPOSIT ABSOLUTE /end AXIS_DESCR
/end CHARACTERISTIC
/begin CHARACTERISTIC EGT_tInrDvtMax_C "Maximale Regelabweichung innerer Regelkreis" VALUE 0xD2798 Kw_Ws16 1000.000 TempDiff_Cels -500.0000 500.0000 FORMAT "%8.4" EXTENDED_LIMITS -3276.800 3276.700 /end CHARACTERISTIC
/begin CHARACTERISTIC EGT_tInrDvtMin_C "Minimale Regelabweichung innerer Regelkreis" VALUE 0xD279A Kw_Ws16 1000.000 TempDiff_Cels -500.0000 500.0000 FORMAT "%8.4" EXTENDED_LIMITS -3276.800 3276.700 /end CHARACTERISTIC
/begin CHARACTERISTIC EGT_tInrThresDwn_C "Untere Temperaturschwelle des inneren Regelkreises" VALUE 0xD279C Kw_Ws16 950.000 Temp_Cels -50.140 899.860 FORMAT "%8.3" EXTENDED_LIMITS -3549.940 3003.560 /end CHARACTERISTIC
/begin CHARACTERISTIC EGT_tInrThresUp_C "Obere Temperaturschwelle des inneren Regelkreises" VALUE 0xD279E Kw_Ws16 950.000 Temp_Cels -50.140 899.860 FORMAT "%8.3" EXTENDED_LIMITS -3549.940 3003.560 /end CHARACTERISTIC
/begin CHARACTERISTIC EGT_tInrWinNeg_C "Negativer Fensterwert des inneren Regelkreises" VALUE 0xD225C Kw_Ws16 2000.000 TempDiff_Cels -1000.000 1000.000 FORMAT "%8.3" EXTENDED_LIMITS -3276.800 3276.700 /end CHARACTERISTIC
/begin CHARACTERISTIC EGT_tInrWinPos_C "Positiver Fensterwert des inneren Regelkreises" VALUE 0xD225E Kw_Ws16 2000.000 TempDiff_Cels -1000.000 1000.000 FORMAT "%8.3" EXTENDED_LIMITS -3276.800 3276.700 /end CHARACTERISTIC
/begin CHARACTERISTIC EGT_tiPoI1TThres_C "Wartezeit für Freigabe PoI1" VALUE 0xD2260 Kw_Wu32 100.000000000 Time_s 0.00 100.000000000 FORMAT "%13.9" EXTENDED_LIMITS 0.00 42949672.9500 /end CHARACTERISTIC
/begin CHARACTERISTIC EGT_tiPoI2TempGvnr_MAP "Additive Winkelkorrektur der Nacheinspritzung" MAP 0xD2894 Kf_Xs16_Ys16_Ws16 18000.00 InjTime_us -13000.00 5000.00 FORMAT "%8.2" EXTENDED_LIMITS -32768.00 32767.00
 /begin AXIS_DESCR STD_AXIS Eng_nAvrg EngN 8 0.00 6000.000 FORMAT "%8.3" EXTENDED_LIMITS -32768.00 32767.00 DEPOSIT ABSOLUTE /end AXIS_DESCR
 /begin AXIS_DESCR STD_AXIS InjCtl_qSetUnBal InjMassCyc 8 0.00 327.6700 FORMAT "%8.4" EXTENDED_LIMITS -327.6800 327.6700 DEPOSIT ABSOLUTE /end AXIS_DESCR
/end CHARACTERISTIC
/begin CHARACTERISTIC EGT_tiPoIHiLoTempGvnr_C "Entprellzeit für Nacheinspritzung (high -> low)" VALUE 0xD27A0 Kw_Wu16 655140.0 Time_s 0.00 655140.0 FORMAT "%8.1" EXTENDED_LIMITS 0.00 655.3500 /end CHARACTERISTIC
/begin CHARACTERISTIC EGT_tiPoILoHiTempGvnr_C "Entprellzeit für Nacheinspritzung (low -> high)" VALUE 0xD27A2 Kw_Wu16 655140.0 Time_s 0.00 655140.0 FORMAT "%8.1" EXTENDED_LIMITS 0.00 655.3500 /end CHARACTERISTIC
/begin CHARACTERISTIC EGT_tiRgnOilDilMax_C "Maximalschwelle für kritische Ölverdünnungszeit" VALUE 0xD06A4 Kw_Wu32 500.000000000 Time_s 0.00 500.000000000 FORMAT "%13.9" EXTENDED_LIMITS 0.00 42949672.9500 /end CHARACTERISTIC
/begin CHARACTERISTIC EGT_tiRgnOilDilSubs_C "EEPROM Ersatzwert für kritische Ölverdünnungszeit" VALUE 0xD06A8 Kw_Wu32 500.000000000 Time_s 0.00 500.000000000 FORMAT "%13.9" EXTENDED_LIMITS 0.00 42949672.9500 /end CHARACTERISTIC
/begin CHARACTERISTIC EGT_tiRmpSlpMax_C "Maximale Rampenlaufzeit für EGT-Mehrfachschalter" VALUE 0xD06AC Kw_Wu32 15.391030303030304 TimeEGTRmp 0.99296969696969695 16.384000000000000 FORMAT "%19.16" EXTENDED_LIMITS 0.000000015258789066052715 65.536000000000001 /end CHARACTERISTIC
/begin CHARACTERISTIC EGT_tiRmpSlpTempGvnr_C "Rampenzeit für Temperaturregler" VALUE 0xD2938 Kw_Wu32 31.775030303030302 TimeEGTRmp 0.99296969696969695 32.768000000000001 FORMAT "%19.16" EXTENDED_LIMITS 0.000000015258789066052715 65.536000000000001 /end CHARACTERISTIC
/begin CHARACTERISTIC EGT_tOutrDesInTempGvnr_Vector "Externer Bypass hook für Temperatursetpointwert des Kunden spezifisch von äußerer Regelkreis" VALUE 0xC3942 Kw_Wu8 255.0 OneToOne 0.00 255.0 FORMAT "%5.1" /end CHARACTERISTIC
/begin CHARACTERISTIC EGT_tOutrDesInTempGvnr_Channel "Externer Bypass hook für Temperatursetpointwert des Kunden spezifisch von äußerer Regelkreis" VALUE 0xC3943 Kw_Wu8 255.0 OneToOne 0.00 255.0 FORMAT "%5.1" /end CHARACTERISTIC
/begin CHARACTERISTIC EGT_tOutrDesMflO2_CUR "Sollwertkorrektur des äußeren Regelkreises in Abhängigkeit des Sauerstoffmasssenstromes" CURVE 0xD24D0 Kl_Xs16_Ws16 1600.000 TempDiff_Cels -100.0000 1500.000 FORMAT "%8.3" EXTENDED_LIMITS -3276.800 3276.700
 /begin AXIS_DESCR STD_AXIS EGT_dmO2Aprx_mp AirMassPerTime 8 0.00 50.00000 FORMAT "%8.5" EXTENDED_LIMITS -3276.800 3276.700 DEPOSIT ABSOLUTE /end AXIS_DESCR
/end CHARACTERISTIC
/begin CHARACTERISTIC EGT_tOutrDesMsSot_CUR "Sollwertkorrektur des äußeren Regelkreises in Abhängigkeit der Rußmassenbeladung des Partikelfilters" CURVE 0xD24F2 Kl_Xs16_Ws16 1600.000 TempDiff_Cels -100.0000 1500.000 FORMAT "%8.3" EXTENDED_LIMITS -3276.800 3276.700
 /begin AXIS_DESCR STD_AXIS EGT_mSot_mp mSoot_g 8 0.00 300.0000 FORMAT "%8.4" EXTENDED_LIMITS -327.6800 327.6700 DEPOSIT ABSOLUTE /end AXIS_DESCR
/end CHARACTERISTIC
/begin CHARACTERISTIC EGT_tOutrDesTempPst_CUR "Sollwertkorrektur in Abhängigkeit der Temperatur unterhalb Oxidationskatalysator" CURVE 0xD2514 Kl_Xs16_Ws16 1600.000 TempDiff_Cels -100.0000 1500.000 FORMAT "%8.3" EXTENDED_LIMITS -3276.800 3276.700
 /begin AXIS_DESCR STD_AXIS EGT_tOxiPst_mp Temp_Cels 8 -50.140 899.860 FORMAT "%8.3" EXTENDED_LIMITS -3549.940 3003.560 DEPOSIT ABSOLUTE /end AXIS_DESCR
/end CHARACTERISTIC
/begin CHARACTERISTIC EGT_tOutrDes_MAP "Grundsollwert des äußeren Regelkreises" MAP 0xD2536 Kf_Xs16_Ys16_Ws16 950.000 Temp_Cels -50.140 899.860 FORMAT "%8.3" EXTENDED_LIMITS -3549.940 3003.560
 /begin AXIS_DESCR STD_AXIS Eng_nAvrg EngN 16 0.00 6000.000 FORMAT "%8.3" EXTENDED_LIMITS -32768.00 32767.00 DEPOSIT ABSOLUTE /end AXIS_DESCR
 /begin AXIS_DESCR STD_AXIS InjCtl_qSetUnBal InjMassCyc 16 0.00 327.6700 FORMAT "%8.4" EXTENDED_LIMITS -327.6800 327.6700 DEPOSIT ABSOLUTE /end AXIS_DESCR
/end CHARACTERISTIC
/begin CHARACTERISTIC EGT_tOutrDvtMax_C "Maximale Regelabweichung äußerer Regelkreis" VALUE 0xD27A4 Kw_Ws16 1000.000 TempDiff_Cels -500.0000 500.0000 FORMAT "%8.4" EXTENDED_LIMITS -3276.800 3276.700 /end CHARACTERISTIC
/begin CHARACTERISTIC EGT_tOutrDvtMin_C "Minimale Regelabweichung äußerer Regelkreis" VALUE 0xD27A6 Kw_Ws16 1000.000 TempDiff_Cels -500.0000 500.0000 FORMAT "%8.4" EXTENDED_LIMITS -3276.800 3276.700 /end CHARACTERISTIC
/begin CHARACTERISTIC EGT_tOutrThresDwn_C "Untere Temperaturschwelle des äußeren Regelkreises" VALUE 0xD27A8 Kw_Ws16 950.000 Temp_Cels -50.140 899.860 FORMAT "%8.3" EXTENDED_LIMITS -3549.940 3003.560 /end CHARACTERISTIC
/begin CHARACTERISTIC EGT_tOutrThresUp_C "Obere Temperaturschwelle des äußeren Regelkreises" VALUE 0xD27AA Kw_Ws16 950.000 Temp_Cels -50.140 899.860 FORMAT "%8.3" EXTENDED_LIMITS -3549.940 3003.560 /end CHARACTERISTIC
/begin CHARACTERISTIC EGT_tOutrWinNeg_C "Negativer Fensterwert des äßeren Regelkreises" VALUE 0xD2264 Kw_Ws16 2000.000 TempDiff_Cels -1000.000 1000.000 FORMAT "%8.3" EXTENDED_LIMITS -3276.800 3276.700 /end CHARACTERISTIC
/begin CHARACTERISTIC EGT_tOutrWinPos_C "Positiver Fensterwert des äßeren Regelkreises" VALUE 0xD2266 Kw_Ws16 2000.000 TempDiff_Cels -1000.000 1000.000 FORMAT "%8.3" EXTENDED_LIMITS -3276.800 3276.700 /end CHARACTERISTIC
/begin CHARACTERISTIC EGT_tOxiPreThresBrn_C "Untere Schwelle Temperatur vor Oxidationskatalysator des äußeren Regelkreises" VALUE 0xD27AC Kw_Ws16 950.000 Temp_Cels -50.140 899.860 FORMAT "%8.3" EXTENDED_LIMITS -3549.940 3003.560 /end CHARACTERISTIC
/begin CHARACTERISTIC EGT_tSrvRgn_CUR "Anpassung des Temperaturreglers" CURVE 0xD2940 Kl_Xs16_Ws16 950.000 Temp_Cels -50.140 899.860 FORMAT "%8.3" EXTENDED_LIMITS -3549.940 3003.560
 /begin AXIS_DESCR STD_AXIS EGT_tiSrvRgnIn_mp TimeOneToOne 100 0.00 32767.00 FORMAT "%8.2" EXTENDED_LIMITS -32768.00 32767.00 DEPOSIT ABSOLUTE /end AXIS_DESCR
/end CHARACTERISTIC
/begin CHARACTERISTIC EMCCD_uSRCMinActVal1_C "SRC-Min-Wert für EMCCD-1 analogue eingang" VALUE 0xD2AD4 Kw_Ws16 5200.391 Volt 0.00 5200.391 FORMAT "%8.3" EXTENDED_LIMITS -160156.4 160151.5 /end CHARACTERISTIC
/begin CHARACTERISTIC EMCCD_uSRCMaxActVal1_C "SRC-Max-Wert für EMCCD-1 analogue eingang" VALUE 0xD2AD6 Kw_Ws16 5200.391 Volt 0.00 5200.391 FORMAT "%8.3" EXTENDED_LIMITS -160156.4 160151.5 /end CHARACTERISTIC
/begin CHARACTERISTIC EMCCD_iLinActVal1_CUR "Analogeingang" CURVE 0xD2AD8 Kl_Xs16_Ws16 5000.000 Curr 0.00 5000.000 FORMAT "%8.3" EXTENDED_LIMITS -32768.00 32767.00
 /begin AXIS_DESCR STD_AXIS EMCCD_uRawActVal1_mp Volt 2 0.00 5200.391 FORMAT "%8.3" EXTENDED_LIMITS -160156.4 160151.5 DEPOSIT ABSOLUTE /end AXIS_DESCR
/end CHARACTERISTIC
/begin CHARACTERISTIC EMCCD_uSRCMinActVal2_C "SRC-Min-Wert für EMCCD-2 analogue eingang" VALUE 0xD2AE2 Kw_Ws16 5200.391 Volt 0.00 5200.391 FORMAT "%8.3" EXTENDED_LIMITS -160156.4 160151.5 /end CHARACTERISTIC
/begin CHARACTERISTIC EMCCD_uSRCMaxActVal2_C "SRC-Max-Wert für EMCCD-2 analogue eingang" VALUE 0xD2AE4 Kw_Ws16 5200.391 Volt 0.00 5200.391 FORMAT "%8.3" EXTENDED_LIMITS -160156.4 160151.5 /end CHARACTERISTIC
/begin CHARACTERISTIC EMCCD_iLinActVal2_CUR "Analogeingang" CURVE 0xD2AE6 Kl_Xs16_Ws16 5000.000 Curr 0.00 5000.000 FORMAT "%8.3" EXTENDED_LIMITS -32768.00 32767.00
 /begin AXIS_DESCR STD_AXIS EMCCD_uRawActVal2_mp Volt 2 0.00 5200.391 FORMAT "%8.3" EXTENDED_LIMITS -160156.4 160151.5 DEPOSIT ABSOLUTE /end AXIS_DESCR
/end CHARACTERISTIC
/begin CHARACTERISTIC EMCCD_ctPwrStgOnMax1_C "Maximaler Zähler für Powerstage On im Fehlerfall" VALUE 0xD2AF0 Kw_Wu16 65535.00 OneToOne 0.00 65535.00 FORMAT "%8.2" /end CHARACTERISTIC
/begin CHARACTERISTIC EMCCD_ctPwrStgOnMax2_C "Maximaler Zähler für Powerstage On im Fehlerfall" VALUE 0xD2AF2 Kw_Wu16 65535.00 OneToOne 0.00 65535.00 FORMAT "%8.2" /end CHARACTERISTIC
/begin CHARACTERISTIC EMCCD_dcycCurrLowTemp_MAP "Arbeitszyklus für niedrige Temperatur" MAP 0xD2AF4 Kf_Xs16_Ys16_Ws16 655.3500 DtyCyc -327.6800 327.6700 FORMAT "%8.4"
 /begin AXIS_DESCR STD_AXIS BattCD_u Volt_Batt 3 0.00 28602.15 FORMAT "%8.2" EXTENDED_LIMITS -640625.6 640606.1 DEPOSIT ABSOLUTE /end AXIS_DESCR
 /begin AXIS_DESCR STD_AXIS EMCCD_resAct1 Resist 3 0.00 5000.000 FORMAT "%8.3" EXTENDED_LIMITS -3276.800 3276.700 DEPOSIT ABSOLUTE /end AXIS_DESCR
/end CHARACTERISTIC
/begin CHARACTERISTIC EMCCD_dcycCurrOff_MAP "Berechnung des Strom AUS-Tastverhältnisses bei Strom-Regellogik" MAP 0xD2B16 Kf_Xs16_Ys16_Ws16 655.3500 DtyCyc -327.6800 327.6700 FORMAT "%8.4"
 /begin AXIS_DESCR STD_AXIS BattCD_u Volt_Batt 7 0.00 28602.15 FORMAT "%8.2" EXTENDED_LIMITS -640625.6 640606.1 DEPOSIT ABSOLUTE /end AXIS_DESCR
 /begin AXIS_DESCR STD_AXIS EMCCD_resAct1 Resist 16 0.00 5000.000 FORMAT "%8.3" EXTENDED_LIMITS -3276.800 3276.700 DEPOSIT ABSOLUTE /end AXIS_DESCR
/end CHARACTERISTIC
/begin CHARACTERISTIC EMCCD_dcycCurrOnHi_MAP "Berechnung des Haltestrom-Tastverhältnisses bei Strom-Regellogik" MAP 0xD2C28 Kf_Xs16_Ys16_Ws16 655.3500 DtyCyc -327.6800 327.6700 FORMAT "%8.4"
 /begin AXIS_DESCR STD_AXIS BattCD_u Volt_Batt 7 0.00 28602.15 FORMAT "%8.2" EXTENDED_LIMITS -640625.6 640606.1 DEPOSIT ABSOLUTE /end AXIS_DESCR
 /begin AXIS_DESCR STD_AXIS EMCCD_resAct1 Resist 16 0.00 5000.000 FORMAT "%8.3" EXTENDED_LIMITS -3276.800 3276.700 DEPOSIT ABSOLUTE /end AXIS_DESCR
/end CHARACTERISTIC
/begin CHARACTERISTIC EMCCD_dcycCurrOnLow_MAP "Berechnung des Startstrom-Tastverhältnisses bei Strom-Regellogik" MAP 0xD2D3A Kf_Xs16_Ys16_Ws16 655.3500 DtyCyc -327.6800 327.6700 FORMAT "%8.4"
 /begin AXIS_DESCR STD_AXIS BattCD_u Volt_Batt 7 0.00 28602.15 FORMAT "%8.2" EXTENDED_LIMITS -640625.6 640606.1 DEPOSIT ABSOLUTE /end AXIS_DESCR
 /begin AXIS_DESCR STD_AXIS EMCCD_resAct1 Resist 16 0.00 5000.000 FORMAT "%8.3" EXTENDED_LIMITS -3276.800 3276.700 DEPOSIT ABSOLUTE /end AXIS_DESCR
/end CHARACTERISTIC
/begin CHARACTERISTIC EMCCD_dcycMax_C "Max-Wert" VALUE 0xD2E4C Kw_Ws16 655.3500 DtyCyc -327.6800 327.6700 FORMAT "%8.4" /end CHARACTERISTIC
/begin CHARACTERISTIC EMCCD_dcycMin_C "Min-Wert" VALUE 0xD2E4E Kw_Ws16 655.3500 DtyCyc -327.6800 327.6700 FORMAT "%8.4" /end CHARACTERISTIC
/begin CHARACTERISTIC EMCCD_dcycWarmUp_MAP "Berechnung des Aufwärmungsstrom-Tastverhältnisses bei Strom-Regellogik" MAP 0xD2E50 Kf_Xs16_Ys16_Ws16 655.3500 DtyCyc -327.6800 327.6700 FORMAT "%8.4"
 /begin AXIS_DESCR STD_AXIS Eng_tEng Temp_Cels 15 -50.14000 199.8600 FORMAT "%8.4" EXTENDED_LIMITS -3549.940 3003.560 DEPOSIT ABSOLUTE /end AXIS_DESCR
 /begin AXIS_DESCR STD_AXIS EATSCD_tAir Temp_Cels 15 -50.14000 199.8600 FORMAT "%8.4" EXTENDED_LIMITS -3549.940 3003.560 DEPOSIT ABSOLUTE /end AXIS_DESCR
/end CHARACTERISTIC
/begin CHARACTERISTIC EMCCD_DebExcTempDef1_C "Zeit bis defekt für EXC_TEMP Fehler" VALUE 0xD3052 Kw_Wu16 655350.0 Time_ms 0.00 655350.0 FORMAT "%8.1" /end CHARACTERISTIC
/begin CHARACTERISTIC EMCCD_DebExcTempOk1_C "Heilungszeit für EXC_TEMP Fehler" VALUE 0xD3054 Kw_Wu16 655350.0 Time_ms 0.00 655350.0 FORMAT "%8.1" /end CHARACTERISTIC
/begin CHARACTERISTIC EMCCD_DebExcTempDef2_C "Zeit bis defekt für EXC_TEMP Fehler" VALUE 0xD3056 Kw_Wu16 655350.0 Time_ms 0.00 655350.0 FORMAT "%8.1" /end CHARACTERISTIC
/begin CHARACTERISTIC EMCCD_DebExcTempOk2_C "Heilungszeit für EXC_TEMP Fehler" VALUE 0xD3058 Kw_Wu16 655350.0 Time_ms 0.00 655350.0 FORMAT "%8.1" /end CHARACTERISTIC
/begin CHARACTERISTIC EMCCD_DebNoLoadDef1_C "Zeit bis defekt für NO_LOAD Fehler" VALUE 0xD305A Kw_Wu16 655350.0 Time_ms 0.00 655350.0 FORMAT "%8.1" /end CHARACTERISTIC
/begin CHARACTERISTIC EMCCD_DebNoLoadOk1_C "Heilungszeit für NO_LOAD Fehler" VALUE 0xD305C Kw_Wu16 655350.0 Time_ms 0.00 655350.0 FORMAT "%8.1" /end CHARACTERISTIC
/begin CHARACTERISTIC EMCCD_DebNoLoadDef2_C "Zeit bis defekt für NO_LOAD Fehler" VALUE 0xD305E Kw_Wu16 655350.0 Time_ms 0.00 655350.0 FORMAT "%8.1" /end CHARACTERISTIC
/begin CHARACTERISTIC EMCCD_DebNoLoadOk2_C "Heilungszeit für NO_LOAD Fehler" VALUE 0xD3060 Kw_Wu16 655350.0 Time_ms 0.00 655350.0 FORMAT "%8.1" /end CHARACTERISTIC
/begin CHARACTERISTIC EMCCD_DebShortCircBatDef1_C "Zeit bis defekt für SC_BAT Fehler" VALUE 0xD3062 Kw_Wu16 655350.0 Time_ms 0.00 655350.0 FORMAT "%8.1" /end CHARACTERISTIC
/begin CHARACTERISTIC EMCCD_DebShortCircBatOk1_C "Heilungszeit für SC_BAT Fehler" VALUE 0xD3064 Kw_Wu16 655350.0 Time_ms 0.00 655350.0 FORMAT "%8.1" /end CHARACTERISTIC
/begin CHARACTERISTIC EMCCD_DebShortCircBatDef2_C "Zeit bis defekt für SC_BAT Fehler" VALUE 0xD3066 Kw_Wu16 655350.0 Time_ms 0.00 655350.0 FORMAT "%8.1" /end CHARACTERISTIC
/begin CHARACTERISTIC EMCCD_DebShortCircBatOk2_C "Heilungszeit für SC_BAT Fehler" VALUE 0xD3068 Kw_Wu16 655350.0 Time_ms 0.00 655350.0 FORMAT "%8.1" /end CHARACTERISTIC
/begin CHARACTERISTIC EMCCD_DebShortCircGndDef1_C "Zeit bis defekt für SC_GND Fehler" VALUE 0xD306A Kw_Wu16 655350.0 Time_ms 0.00 655350.0 FORMAT "%8.1" /end CHARACTERISTIC
/begin CHARACTERISTIC EMCCD_DebShortCircGndOk1_C "Heilungszeit für SC_GND Fehler" VALUE 0xD306C Kw_Wu16 655350.0 Time_ms 0.00 655350.0 FORMAT "%8.1" /end CHARACTERISTIC
/begin CHARACTERISTIC EMCCD_DebShortCircGndDef2_C "Zeit bis defekt für SC_GND Fehler" VALUE 0xD306E Kw_Wu16 655350.0 Time_ms 0.00 655350.0 FORMAT "%8.1" /end CHARACTERISTIC
/begin CHARACTERISTIC EMCCD_DebShortCircGndOk2_C "Heilungszeit für SC_GND Fehler" VALUE 0xD3070 Kw_Wu16 655350.0 Time_ms 0.00 655350.0 FORMAT "%8.1" /end CHARACTERISTIC
/begin CHARACTERISTIC EMCCD_DebSRCHighDef1_C "Zeit bis defekt für SRC_HIGH Fehler" VALUE 0xD3072 Kw_Wu16 655350.0 Time_ms 0.00 655350.0 FORMAT "%8.1" /end CHARACTERISTIC
/begin CHARACTERISTIC EMCCD_DebSRCHighOk1_C "Heilungszeit für SRC_HIGH Fehler" VALUE 0xD3074 Kw_Wu16 655350.0 Time_ms 0.00 655350.0 FORMAT "%8.1" /end CHARACTERISTIC
/begin CHARACTERISTIC EMCCD_DebSRCHighDef2_C "Zeit bis defekt für SRC_HIGH Fehler" VALUE 0xD3076 Kw_Wu16 655350.0 Time_ms 0.00 655350.0 FORMAT "%8.1" /end CHARACTERISTIC
/begin CHARACTERISTIC EMCCD_DebSRCHighOk2_C "Heilungszeit für SRC_HIGH Fehler" VALUE 0xD3078 Kw_Wu16 655350.0 Time_ms 0.00 655350.0 FORMAT "%8.1" /end CHARACTERISTIC
/begin CHARACTERISTIC EMCCD_DebSRCLowDef1_C "Zeit bis defekt für SRC_LOW Fehler" VALUE 0xD307A Kw_Wu16 655350.0 Time_ms 0.00 655350.0 FORMAT "%8.1" /end CHARACTERISTIC
/begin CHARACTERISTIC EMCCD_DebSRCLowOk1_C "Heilungszeit für SRC_LOW Fehler" VALUE 0xD307C Kw_Wu16 655350.0 Time_ms 0.00 655350.0 FORMAT "%8.1" /end CHARACTERISTIC
/begin CHARACTERISTIC EMCCD_DebSRCLowDef2_C "Zeit bis defekt für SRC_LOW Fehler" VALUE 0xD307E Kw_Wu16 655350.0 Time_ms 0.00 655350.0 FORMAT "%8.1" /end CHARACTERISTIC
/begin CHARACTERISTIC EMCCD_DebSRCLowOk2_C "Heilungszeit für SRC_LOW Fehler" VALUE 0xD3080 Kw_Wu16 655350.0 Time_ms 0.00 655350.0 FORMAT "%8.1" /end CHARACTERISTIC
/begin CHARACTERISTIC EMCCD_dtRmpSlpUpActVal1_C "Aufwärts-Schritt für Rampe" VALUE 0xD3084 Kw_Wu32 65535999.9847 RmpCurr 0.00 65535999.9847 FORMAT "%13.4" /end CHARACTERISTIC
/begin CHARACTERISTIC EMCCD_dtRmpSlpDwnActVal1_C "Abw.-Schritt fuer Rampe" VALUE 0xD3088 Kw_Wu32 65535999.9847 RmpCurr 0.00 65535999.9847 FORMAT "%13.4" /end CHARACTERISTIC
/begin CHARACTERISTIC EMCCD_dtRmpSlpUpActVal2_C "Aufwärts-Schritt für Rampe" VALUE 0xD308C Kw_Wu32 65535999.9847 RmpCurr 0.00 65535999.9847 FORMAT "%13.4" /end CHARACTERISTIC
/begin CHARACTERISTIC EMCCD_dtRmpSlpDwnActVal2_C "Abw.-Schritt fuer Rampe" VALUE 0xD3090 Kw_Wu32 65535999.9847 RmpCurr 0.00 65535999.9847 FORMAT "%13.4" /end CHARACTERISTIC
/begin CHARACTERISTIC EMCCD_numAdc1_C "Applikationsparameter zur Auswahl des analogen Eingangssignals für EMCCD-1" VALUE 0xD3094 Kw_Wu8 26.0000000000 NumPinAdc 0.00 26.0000000000 FORMAT "%13.10" /end CHARACTERISTIC
/begin CHARACTERISTIC EMCCD_numAdc2_C "Applikationsparameter zur Auswahl des analogen Eingangssignals für EMCCD-2" VALUE 0xD3095 Kw_Wu8 26.0000000000 NumPinAdc 0.00 26.0000000000 FORMAT "%13.10" /end CHARACTERISTIC
/begin CHARACTERISTIC EMCCD_numDiaOut1_C "Parameter zur Pin-Auswahl der Hardware-Diagnose" VALUE 0xD3096 Kw_Wu8 27.0000000000 NumPinDia 0.00 27.0000000000 FORMAT "%13.10" /end CHARACTERISTIC
/begin CHARACTERISTIC EMCCD_numDiaOut2_C "Parameter zur Pin-Auswahl der Hardware-Diagnose" VALUE 0xD3097 Kw_Wu8 27.0000000000 NumPinDia 0.00 27.0000000000 FORMAT "%13.10" /end CHARACTERISTIC
/begin CHARACTERISTIC EMCCD_numPwmOut1_C "Parameter für Auswahl Hardware Endstufen-Pin des PWM-Signals EMCCD-1" VALUE 0xD3098 Kw_Wu8 13.0000000000 NumPinPwmOut 0.00 13.0000000000 FORMAT "%13.10" /end CHARACTERISTIC
/begin CHARACTERISTIC EMCCD_numPwmOut2_C "Parameter für Auswahl Hardware Endstufen-Pin des PWM-Signals EMCCD-2" VALUE 0xD3099 Kw_Wu8 13.0000000000 NumPinPwmOut 0.00 13.0000000000 FORMAT "%13.10" /end CHARACTERISTIC
/begin CHARACTERISTIC EMCCD_tiActValPT1_1_C "Zeitkonstante für  PT1-Filter  für EMCCD-1 analogue eingang" VALUE 0xD309C Kw_Wu32 4294.9663 TimeDelay_s 0.0010000001 4294.9673 FORMAT "%9.4" EXTENDED_LIMITS 0.0000010000000 4294.9673 /end CHARACTERISTIC
/begin CHARACTERISTIC EMCCD_tiActValPT1_2_C "Zeitkonstante für  PT1-Filter  für EMCCD-2 analogue eingang" VALUE 0xD30A0 Kw_Wu32 4294.9663 TimeDelay_s 0.0010000001 4294.9673 FORMAT "%9.4" EXTENDED_LIMITS 0.0000010000000 4294.9673 /end CHARACTERISTIC
/begin CHARACTERISTIC EMCCD_stInvOut1_C "Label zur Invertierung der Endstufe" VALUE 0xD30A4 Kw_Wu8 1.000 OneToOne 0.00 1.000 FORMAT "%5.3" EXTENDED_LIMITS 0.00 255.0 /end CHARACTERISTIC
/begin CHARACTERISTIC EMCCD_tiPer1_C "Aggregatelagersteuerung Endstufenausgangs Periode" VALUE 0xD30A6 Kw_Ws16 6553.500 Period -3276.800 3276.700 FORMAT "%8.3" /end CHARACTERISTIC
/begin CHARACTERISTIC EMCCD_stInvOut2_C "Label zur Invertierung der Endstufe" VALUE 0xD30A8 Kw_Wu8 1.000 OneToOne 0.00 1.000 FORMAT "%5.3" EXTENDED_LIMITS 0.00 255.0 /end CHARACTERISTIC
/begin CHARACTERISTIC EMCCD_tiPer2_C "Aggregatelagersteuerung Endstufenausgangs Periode" VALUE 0xD30AA Kw_Ws16 6553.500 Period -3276.800 3276.700 FORMAT "%8.3" /end CHARACTERISTIC
/begin CHARACTERISTIC EMCCD_resHysLow_C "Senken Sie Widerstand Begrenzung für die Kaltstartkorrektur des Motorlagers" VALUE 0xD30AC Kw_Ws16 6553.500 Resist -3276.800 3276.700 FORMAT "%8.3" /end CHARACTERISTIC
/begin CHARACTERISTIC EMCCD_resHysUp_C "Obere Widerstand Begrenzung für die Kaltstartkorrektur des Motorlagers" VALUE 0xD30AE Kw_Ws16 6553.500 Resist -3276.800 3276.700 FORMAT "%8.3" /end CHARACTERISTIC
/begin CHARACTERISTIC EMCCD_stSPICtl1_C "Schalter ob Endstufe SPI kontrollierbar = 1 oder nicht SPI kontrollierbar = 0" VALUE 0xD30B0 Kw_Wu8 1.000 OneToOne 0.00 1.000 FORMAT "%5.3" EXTENDED_LIMITS 0.00 255.0 /end CHARACTERISTIC
/begin CHARACTERISTIC EMCCD_stSPICtl2_C "Schalter ob Endstufe SPI kontrollierbar = 1 oder nicht SPI kontrollierbar = 0" VALUE 0xD30B1 Kw_Wu8 1.000 OneToOne 0.00 1.000 FORMAT "%5.3" EXTENDED_LIMITS 0.00 255.0 /end CHARACTERISTIC
/begin CHARACTERISTIC EMCCD_swtRegOn_C "Auswahl der Strom-Regellogik zur Berechnung des Ausgangs-Tastverhältnisses (0: standard Logik, 1: derzeitiger Governor)" VALUE 0xD30B2 Kw_Wu8 255.0 OneToOne 0.00 255.0 FORMAT "%5.1" /end CHARACTERISTIC
/begin CHARACTERISTIC EMCCD_tiBtwTst1_C "Zeitabstand, in dem die Endstufe im Fehlerfall getestet wird" VALUE 0xD30B4 Kw_Wu16 29980.00 Time_ms 20.00000 30000.00 FORMAT "%8.2" EXTENDED_LIMITS 0.00 655350.0 /end CHARACTERISTIC
/begin CHARACTERISTIC EMCCD_tiBtwTst2_C "Zeitabstand, in dem die Endstufe im Fehlerfall getestet wird" VALUE 0xD30B6 Kw_Wu16 29980.00 Time_ms 20.00000 30000.00 FORMAT "%8.2" EXTENDED_LIMITS 0.00 655350.0 /end CHARACTERISTIC
/begin CHARACTERISTIC EMCCD_tiCurrOnHi_C "Zeit, für die der Startsstrom bei Strom-Regellogik betätigt werden soll" VALUE 0xD30B8 Kw_Wu16 655.3500 Time_s 0.00 655.3500 FORMAT "%8.4" /end CHARACTERISTIC
/begin CHARACTERISTIC EMCCD_tiPwrStgOn1_C "Zeit für welche die Endstufe im Fehlerfall eingeschalten wird (nur nicht SPI kontrolliert)" VALUE 0xD30BA Kw_Wu16 655140.0 Time_ms 0.00 655140.0 FORMAT "%8.1" EXTENDED_LIMITS 0.00 655350.0 /end CHARACTERISTIC
/begin CHARACTERISTIC EMCCD_tiPwrStgOn2_C "Zeit für welche die Endstufe im Fehlerfall eingeschalten wird (nur nicht SPI kontrolliert)" VALUE 0xD30BC Kw_Wu16 655140.0 Time_ms 0.00 655140.0 FORMAT "%8.1" EXTENDED_LIMITS 0.00 655350.0 /end CHARACTERISTIC
/begin CHARACTERISTIC EMCCD_tiWarmUp_C "Zeit, für die der Strom, der durch Aufwärmungskennfeld berechnet wird, betätigt werden soll" VALUE 0xD30BE Kw_Wu16 655.3500 Time_s 0.00 655.3500 FORMAT "%8.4" /end CHARACTERISTIC
/begin CHARACTERISTIC EMCCD_stSensIDWordActVal1_C "Statuswort für zustandsübergreifende Antwort der EMCCD-1 analogue eingang im Fehlerfall" VALUE 0xD30C0 Kw_Wu16 65535.00 OneToOne 0.00 65535.00 FORMAT "%8.2" /end CHARACTERISTIC
/begin CHARACTERISTIC EMCCD_iDflActVal1_C "Vorgabewert für EMCCD-1 analogue eingang" VALUE 0xD30C2 Kw_Ws16 5000.000 Curr 0.00 5000.000 FORMAT "%8.3" EXTENDED_LIMITS -32768.00 32767.00 /end CHARACTERISTIC
/begin CHARACTERISTIC EMCCD_stSensIDWordActVal2_C "Statuswort für zustandsübergreifende Antwort der EMCCD-2 analogue eingang im Fehlerfall" VALUE 0xD30C4 Kw_Wu16 65535.00 OneToOne 0.00 65535.00 FORMAT "%8.2" /end CHARACTERISTIC
/begin CHARACTERISTIC EMCCD_iDflActVal2_C "Vorgabewert für EMCCD-2 analogue eingang" VALUE 0xD30C6 Kw_Ws16 5000.000 Curr 0.00 5000.000 FORMAT "%8.3" EXTENDED_LIMITS -32768.00 32767.00 /end CHARACTERISTIC
/begin CHARACTERISTIC EngM_ctOfsCaSCrS_C "#SSD Anzahl von Interrupts mit CaS/CrS Verdrehung (> EngM_phiDelta_C) im WAIT_PHASE State bis Verdreherkennung" VALUE 0xD3338 Kw_Wu8 255.0 OneToOne 0.00 255.0 FORMAT "%5.1" /end CHARACTERISTIC
/begin CHARACTERISTIC EngM_ctPhWhlRev_C "#SSD Anzahl von Phasenradumdrehungen bis zum Abbruch der Plausibilitätsprüfung" VALUE 0xD3339 Kw_Wu8 255.0 OneToOne 0.00 255.0 FORMAT "%5.1" /end CHARACTERISTIC
/begin CHARACTERISTIC EngM_ctPostSync_C "#SSD Anzahl statischer Interrupts bis zum Verlassen des Zustands POST" VALUE 0xD333A Kw_Wu8 255.0 OneToOne 0.00 255.0 FORMAT "%5.1" /end CHARACTERISTIC
/begin CHARACTERISTIC EngM_ctPwrStgOnMax1_C "Maximaler Zähler für Powerstage On im Fehlerfall" VALUE 0xD30C8 Kw_Wu16 65535.00 OneToOne 0.00 65535.00 FORMAT "%8.2" /end CHARACTERISTIC
/begin CHARACTERISTIC EngM_ctPwrStgOnMax2_C "Maximaler Zähler für Powerstage On im Fehlerfall" VALUE 0xD30CA Kw_Wu16 65535.00 OneToOne 0.00 65535.00 FORMAT "%8.2" /end CHARACTERISTIC
/begin CHARACTERISTIC EngM_ctReSync_C "#SSD Max. Anzahl von Versuchen das System umzusynchronisieren" VALUE 0xD333B Kw_Wu8 255.0 OneToOne 0.00 255.0 FORMAT "%5.1" /end CHARACTERISTIC
/begin CHARACTERISTIC EngM_ctSpdtoZero_C "#SSD Anzahl Timeoutinterrupts bis Motordrehzahl  = Null" VALUE 0xD3370 Kw_Wu16 65535.00 OneToOne 0.00 65535.00 FORMAT "%8.2" /end CHARACTERISTIC
/begin CHARACTERISTIC EngM_ctVerSync_C "#SSD Anzahl der MAIN, PILOT, UPDATE, SEGMENT  Interrupts zur Plausibilisierung der Nockenwelle mit der Kurbelwelle" VALUE 0xD333C Kw_Wu8 255.0 OneToOne 0.00 255.0 FORMAT "%5.1" /end CHARACTERISTIC
/begin CHARACTERISTIC EngM_DebIncCaSErrSigDef_C "#SSD Inkrementdefektentprellung  für Nockenwellen-Signalstörung" VALUE 0xD3372 Kw_Wu16 65535.00 OneToOne 0.00 65535.00 FORMAT "%8.2" /end CHARACTERISTIC
/begin CHARACTERISTIC EngM_DebIncCaSErrSigOK_C "#SSD Inkrementheilungsentprellung bis NW-Position gueltig" VALUE 0xD3374 Kw_Wu16 65535.00 OneToOne 0.00 65535.00 FORMAT "%8.2" /end CHARACTERISTIC
/begin CHARACTERISTIC EngM_DebIncCaSNoSigDef_C "#SSD Inkrementdefektentprellung für Nockenwellen-Signalausfall" VALUE 0xD3376 Kw_Wu16 65535.00 OneToOne 0.00 65535.00 FORMAT "%8.2" /end CHARACTERISTIC
/begin CHARACTERISTIC EngM_DebIncCrSErrSigDef_C "#SSD Inkrementdefektentprellung für gestörtes Kurbelwellen-Signal" VALUE 0xD3378 Kw_Wu16 65535.00 OneToOne 0.00 65535.00 FORMAT "%8.2" /end CHARACTERISTIC
/begin CHARACTERISTIC EngM_DebIncCrSErrSigOK_C "#SSD Inkrementheilungsprellung für gestörtes Kurbelwellen-Signal" VALUE 0xD337A Kw_Wu16 65535.00 OneToOne 0.00 65535.00 FORMAT "%8.2" /end CHARACTERISTIC
/begin CHARACTERISTIC EngM_DebIncOfsSigCaSCrSDef_C "#SSD Inkremententprellung zur Unterdrückung doppelter Fehlereinträge von Signal Störung / Verdrehung" VALUE 0xD337C Kw_Wu16 65535.00 OneToOne 0.00 65535.00 FORMAT "%8.2" /end CHARACTERISTIC
/begin CHARACTERISTIC EngM_DebPhCrSErrSigDef_C "#SSD Entprellung des Kurbelwellensignalausfalls über die Anzahl von Nockenwellenzaehnen" VALUE 0xD337E Kw_Wu16 65535.00 OneToOne 0.00 65535.00 FORMAT "%8.2" /end CHARACTERISTIC
/begin CHARACTERISTIC EngM_dLimitCond_ASD_CA "#SSD Abschrankbedingung fuer die ASD-Task" VAL_BLK 0xD3304 Kwb_Wu8 255.0 OneToOne 0.00 255.0 FORMAT "%5.1" NUMBER 3 /end CHARACTERISTIC
/begin CHARACTERISTIC EngM_dLimitCond_Common_CA "#SSD Abschrankbedingung fuer die Common-Task" VAL_BLK 0xD3307 Kwb_Wu8 255.0 OneToOne 0.00 255.0 FORMAT "%5.1" NUMBER 3 /end CHARACTERISTIC
/begin CHARACTERISTIC EngM_dLimitCond_FBC_CA "#SSD Abschrankbedingung fuer die FBC-Task" VAL_BLK 0xD330A Kwb_Wu8 255.0 OneToOne 0.00 255.0 FORMAT "%5.1" NUMBER 3 /end CHARACTERISTIC
/begin CHARACTERISTIC EngM_dLimitCond_Joint_CA "#SSD Abschrankbedingung fuer die Joint-Task" VAL_BLK 0xD330D Kwb_Wu8 255.0 OneToOne 0.00 255.0 FORMAT "%5.1" NUMBER 3 /end CHARACTERISTIC
/begin CHARACTERISTIC EngM_dLimitCond_LiGov_CA "#SSD Abschrankbedingung fuer die LiGov-Task" VAL_BLK 0xD3310 Kwb_Wu8 255.0 OneToOne 0.00 255.0 FORMAT "%5.1" NUMBER 3 /end CHARACTERISTIC
/begin CHARACTERISTIC EngM_dLimitCond_Pilot_CA "#SSD Abschrankbedingung fuer die Pilot-Task" VAL_BLK 0xD3313 Kwb_Wu8 255.0 OneToOne 0.00 255.0 FORMAT "%5.1" NUMBER 3 /end CHARACTERISTIC
/begin CHARACTERISTIC EngM_dtrqFrcPDiffUp_C "Negative Rampensteigung für Umschaltung auf Drehmomentverlust bei erkanntem Systemfehler" VALUE 0xD3400 Kw_Wu32 6553649.99847 RmpTrq -50.0000000000 6553599.99847 FORMAT "%13.5" EXTENDED_LIMITS 0.00 6553599.99847 /end CHARACTERISTIC
/begin CHARACTERISTIC EngM_dtrqFrcPDiffDwn_C "Negative Rampensteigung für Umschaltung auf Drehmomentverlust bei geheiltem Systemfehler" VALUE 0xD3404 Kw_Wu32 6553649.99847 RmpTrq -50.0000000000 6553599.99847 FORMAT "%13.5" EXTENDED_LIMITS 0.00 6553599.99847 /end CHARACTERISTIC
/begin CHARACTERISTIC EngM_facT1Reliabl_C "Multiplikationsfaktor für Zuverlässigkeitsbestimmung der Reibmomentenadaption" VALUE 0xD3674 Kw_Wu8 255.0 OneToOne 0.00 255.0 FORMAT "%5.1" /end CHARACTERISTIC
/begin CHARACTERISTIC EngM_facTrqFrcPDiff_CUR "Faktor zur Korrektur Momentenverlust aufgrund Differenzdruck über Partikelfilter nach Einbau eines Partikelfilters" CURVE 0xD3408 Kl_Xs16_Ws16 512.0000 Fact1 -256.0000 256.0000 FORMAT "%8.4" EXTENDED_LIMITS -256.0000 255.9922
 /begin AXIS_DESCR STD_AXIS Eng_nAvrg EngN 8 0.00 5000.000 FORMAT "%8.3" EXTENDED_LIMITS -32768.00 32767.00 DEPOSIT ABSOLUTE /end AXIS_DESCR
/end CHARACTERISTIC
/begin CHARACTERISTIC EngM_tiFltACoff_C "Adaptionsfilterzeitkonstante für Zustand ""Klima aus"" der Reibmomentenadaption" VALUE 0xD3678 Kw_Wu32 4294.9673 TimeDelay_s 0.0000010000000 4294.9673 FORMAT "%9.4" /end CHARACTERISTIC
/begin CHARACTERISTIC EngM_tiFltACon_C "Adaptionsfilterzeitkonstante für Zustand ""Klima an"" der Reibmomentenadaption" VALUE 0xD367C Kw_Wu32 4294.9673 TimeDelay_s 0.0000010000000 4294.9673 FORMAT "%9.4" /end CHARACTERISTIC
/begin CHARACTERISTIC EngM_HldCurr_MAP "Kennfeld um das Tastverhältnis der Haltephase für die Motorlagersteuerung zu bestimmen - abhängig von Eng_tEng und BattCD_u" MAP 0xD30CC Kf_Xs16_Ys16_Ws16 655.3500 DtyCyc -327.6800 327.6700 FORMAT "%8.4"
 /begin AXIS_DESCR STD_AXIS BattCD_u Volt_Batt 6 0.00 28602.15 FORMAT "%8.2" EXTENDED_LIMITS -640625.6 640606.1 DEPOSIT ABSOLUTE /end AXIS_DESCR
 /begin AXIS_DESCR STD_AXIS Eng_tEng Temp_Cels 15 -50.14000 199.8600 FORMAT "%8.4" EXTENDED_LIMITS -3549.940 3003.560 DEPOSIT ABSOLUTE /end AXIS_DESCR
/end CHARACTERISTIC
/begin CHARACTERISTIC EngM_nAvrgHysDelta_C "speed threshold for calculating Hysterisis lower limit" VALUE 0xD338A Kw_Ws16 6000.000 EngN 0.00 6000.000 FORMAT "%8.3" EXTENDED_LIMITS -32768.00 32767.00 /end CHARACTERISTIC
/begin CHARACTERISTIC EngM_nAvrgHysHigh_CUR "curve for max. cutout speed = f ( engine-temp. )" CURVE 0xD338C Kl_Xs16_Ws16 6000.000 EngN 0.00 6000.000 FORMAT "%8.3" EXTENDED_LIMITS -32768.00 32767.00
 /begin AXIS_DESCR STD_AXIS Eng_tEng Temp_Cels 25 -50.14000 199.8600 FORMAT "%8.4" EXTENDED_LIMITS -3549.940 3003.560 DEPOSIT ABSOLUTE /end AXIS_DESCR
/end CHARACTERISTIC
/begin CHARACTERISTIC EngM_nAvrgLim_C "Engine speed limiting  value" VALUE 0xD33F2 Kw_Ws16 6000.000 EngN 0.00 6000.000 FORMAT "%8.3" EXTENDED_LIMITS -32768.00 32767.00 /end CHARACTERISTIC
/begin CHARACTERISTIC EngM_nLimitInj_C "#SSD Drehzahlschwelle zur Abschrankung der Mengen- und Ansteuerbeginnberechnung" VALUE 0xD3316 Kw_Wu16 6000.000 EngN 0.00 6000.000 FORMAT "%8.3" EXTENDED_LIMITS 0.00 65535.00 /end CHARACTERISTIC
/begin CHARACTERISTIC EngM_nLimitThreshHyst_CA "#SSD Hysteresebreite der Abschrankdrehzahl" VAL_BLK 0xD3318 Kwb_Wu16 600.0000 EngN 0.00 600.0000 FORMAT "%8.4" EXTENDED_LIMITS 0.00 65535.00 NUMBER 3 /end CHARACTERISTIC
/begin CHARACTERISTIC EngM_nLimitThresh_CA "#SSD Drehzahlschwellen zur Taskabschrankung" VAL_BLK 0xD331E Kwb_Wu16 6000.000 EngN 0.00 6000.000 FORMAT "%8.3" EXTENDED_LIMITS 0.00 65535.00 NUMBER 3 /end CHARACTERISTIC
/begin CHARACTERISTIC EngM_nLimitTimeout_C "#SSD Drehzahlschwelle für die Änderung des Schedulings der drehzahlsynchronen Interrupts" VAL_BLK 0xD3324 Kwb_Ws16 4000.000 EngN 2000.000 6000.000 FORMAT "%8.3" EXTENDED_LIMITS -32768.00 32767.00 NUMBER 3 /end CHARACTERISTIC
/begin CHARACTERISTIC EngM_nLISetDiffOffs_C "Maximale zulässige Leerlaufreglerabweichung für Reibmomentenadaption" VALUE 0xD3680 Kw_Wu16 50.00000 EngN 0.00 50.00000 FORMAT "%8.5" EXTENDED_LIMITS 0.00 65535.00 /end CHARACTERISTIC
/begin CHARACTERISTIC EngM_nMaxFrstInj_C "#SSD Maximale Drehzahlschwelle zur nachträglichen Berechnung der ersten Einspritzung im Start" VALUE 0xD333E Kw_Ws16 6000.000 EngN 0.00 6000.000 FORMAT "%8.3" EXTENDED_LIMITS -32768.00 32767.00 /end CHARACTERISTIC
/begin CHARACTERISTIC EngM_nMaxStrtBackUp_C "#SSD Max. Drehzahl für Start nur mit Nockenwellensignal" VALUE 0xD3386 Kw_Ws16 300.0000 EngN 900.0000 1200.000 FORMAT "%8.3" EXTENDED_LIMITS -32768.00 32767.00 /end CHARACTERISTIC
/begin CHARACTERISTIC EngM_nMaxStrt_C "#SSD Motordrehzahl unterhalb dieser Schwelle; Einspritzung für redundanten Start mit Kurbelwelle ist erlaubt" VALUE 0xD3340 Kw_Ws16 65535.00 EngN -32768.00 32767.00 FORMAT "%8.2" /end CHARACTERISTIC
/begin CHARACTERISTIC EngM_nMinDiag_C "#SSD Nockenwellendiagnose ab minimale Motordrehzahl" VALUE 0xC0618 Kw_Ws16 480.0000 EngN 20.00000 500.0000 FORMAT "%8.4" EXTENDED_LIMITS -32768.00 32767.00 /end CHARACTERISTIC
/begin CHARACTERISTIC EngM_nPolling_C "#SSD Drehzahlschwelle für die Änderung des Abtastwinkels von 60 auf 90 ° Kurbelwelle" VALUE 0xD332A Kw_Ws16 6000.000 EngN 0.00 6000.000 FORMAT "%8.3" EXTENDED_LIMITS -32768.00 32767.00 /end CHARACTERISTIC
/begin CHARACTERISTIC EngM_nSwtCoMa_C "#SSD Schwellendrehzahl für die Umschaltung der Aufrufreihenfolge von Common- und MainInj-Task" VALUE 0xD332C Kw_Wu16 6000.000 EngN 0.00 6000.000 FORMAT "%8.3" EXTENDED_LIMITS 0.00 65535.00 /end CHARACTERISTIC
/begin CHARACTERISTIC EngM_nSwtErrSigDiagCrSOff_C "Drehzahlschwelle zum Abschalten der CrS Störerkennung" VALUE 0xD3380 Kw_Ws16 2000.000 EngN 0.00 2000.000 FORMAT "%8.3" EXTENDED_LIMITS -32768.00 32767.00 /end CHARACTERISTIC
/begin CHARACTERISTIC EngM_nSwtErrSigDiagCrSOn_C "Drehzahlschwelle zum Einschalten der CrS Störerkennung" VALUE 0xD3382 Kw_Ws16 2000.000 EngN 0.00 2000.000 FORMAT "%8.3" EXTENDED_LIMITS -32768.00 32767.00 /end CHARACTERISTIC
/begin CHARACTERISTIC EngM_nSyncNoInjRls_C "Drehzahlschwelle über der die Einspritzung unterdrückt wird für die Verifiaktionsphase" VALUE 0xD3342 Kw_Ws16 6000.000 EngN 0.00 6000.000 FORMAT "%8.3" EXTENDED_LIMITS -32768.00 32767.00 /end CHARACTERISTIC
/begin CHARACTERISTIC EngM_numLimitInj_C "#SSD Berechnungshäufigkeit bei aktiver Abschrankung der Mengen- und Ansteuerbeginnberechnung" VALUE 0xD332E Kw_Wu8 9.000 OneToOne 1.000 10.00 FORMAT "%5.2" EXTENDED_LIMITS 0.00 255.0 /end CHARACTERISTIC
/begin CHARACTERISTIC EngM_numLimitTimeout_C "#SSD Begrenzungsfaktoren für die Änderung der Aktivierreihenfolge der drehzahlsynchronen Interrupts" VAL_BLK 0xD332F Kwb_Wu8 255.0 OneToOne 0.00 255.0 FORMAT "%5.1" NUMBER 3 /end CHARACTERISTIC
/begin CHARACTERISTIC EngM_numPin_C "#SSD Zuordnungstabelle phyikalischer Zylinder zu SG-Endstufe (SG-Pin)" VAL_BLK 0xC05FC Kwb_Wu8 255.0 OneToOne 0.00 255.0 FORMAT "%5.1" NUMBER 6 /end CHARACTERISTIC
/begin CHARACTERISTIC EngM_numTDSig_C "Ausgangspin für TD-Signal über DIO" VALUE 0xD33FE Kw_Wu8 11.0000000000 NumPinDioOut 0.00 11.0000000000 FORMAT "%13.10" /end CHARACTERISTIC
/begin CHARACTERISTIC EngM_numTrqFrc_C "Parameter für die Auswahl einer Motortemperatur aus dem Temperaturfeld Eng_tFld für die Reibmomentenberechnung" VALUE 0xD342A Kw_Wu8 2.00000000000 EngTempFldSel 0.00 2.00000000000 FORMAT "%13.11" /end CHARACTERISTIC
/begin CHARACTERISTIC EngM_nWaitIncSig_C "#SSD Inkrementdrehzahl ab der das Signal im Start ausgeblendet wird" VALUE 0xD3344 Kw_Ws16 6000.000 EngN 0.00 6000.000 FORMAT "%8.3" EXTENDED_LIMITS -32768.00 32767.00 /end CHARACTERISTIC
/begin CHARACTERISTIC EngM_phiDelayPhNoSig_C "#SSD Winkelverzoegerung für die Erkennung kein Nockenwellensignal" VALUE 0xD3346 Kw_Ws16 720.0000 AngleCrS 0.00 720.0000 FORMAT "%8.4" EXTENDED_LIMITS -768.0000 767.9766 /end CHARACTERISTIC
/begin CHARACTERISTIC EngM_phiDeltaExtSync_C "#SSD Toleranz zwischen Kurbelwelle und Nockenwelle bei freigeschalteten CAN-Synchronisation" VALUE 0xD3348 Kw_Ws16 720.0000 AngleCrS 0.00 720.0000 FORMAT "%8.4" EXTENDED_LIMITS -768.0000 767.9766 /end CHARACTERISTIC
/begin CHARACTERISTIC EngM_phiDelta_C "#SSD Toleranz zwischen Kurbelwelle und Nockenwelle" VALUE 0xD334A Kw_Ws16 720.0000 AngleCrS 0.00 720.0000 FORMAT "%8.4" EXTENDED_LIMITS -768.0000 767.9766 /end CHARACTERISTIC
/begin CHARACTERISTIC EngM_phiFrstInjInt_C "#SSD Position des ersten Interrupts vor OT zur Berechnung der ersten Einspritzung" VALUE 0xD334C Kw_Ws16 0.00 AngleCrS 739.9922 739.9922 FORMAT "%8.4" EXTENDED_LIMITS -768.0000 767.9766 /end CHARACTERISTIC
/begin CHARACTERISTIC EngM_phiIntMin_C "#SSD Minimale Interruptpositionen bezüglich OT für die erste Einspritzung." VAL_BLK 0xD334E Kwb_Ws16 720.0000 AngleCrS 0.00 720.0000 FORMAT "%8.4" EXTENDED_LIMITS -768.0000 767.9766 NUMBER 5 /end CHARACTERISTIC
/begin CHARACTERISTIC EngM_phiInt_C "#SSD Positionen der stat. Interrupts vor jedem OT" VAL_BLK 0xD3358 Kwb_Ws16 720.0000 AngleCrS 0.00 720.0000 FORMAT "%8.4" EXTENDED_LIMITS -768.0000 767.9766 NUMBER 5 /end CHARACTERISTIC
/begin CHARACTERISTIC EngM_phiMax_C "#SSD Max. physikalischer Winkel im System" VALUE 0xC0604 Kw_Ws32 360.000000000 AngleCrS 360.000000000 720.000000000 FORMAT "%13.9" EXTENDED_LIMITS -50331648.0000 50331647.9766 /end CHARACTERISTIC
/begin CHARACTERISTIC EngM_phiTDC_C "#SSD Vektor der OT-Winkel aller Zylinder" VAL_BLK 0xC0608 Kwb_Ws16 720.0000 AngleCrS 0.00 720.0000 FORMAT "%8.4" EXTENDED_LIMITS -768.0000 767.9766 NUMBER 6 /end CHARACTERISTIC
/begin CHARACTERISTIC EngM_RetCurr_MAP "Kennfeld um das Tastverhältnis der Fangphase der Motorlagersteuerung zu bestimmen - abhängig von Eng_tEng und BattCD_u" MAP 0xD31AE Kf_Xs16_Ys16_Ws16 655.3500 DtyCyc -327.6800 327.6700 FORMAT "%8.4"
 /begin AXIS_DESCR STD_AXIS BattCD_u Volt_Batt 6 0.00 28602.15 FORMAT "%8.2" EXTENDED_LIMITS -640625.6 640606.1 DEPOSIT ABSOLUTE /end AXIS_DESCR
 /begin AXIS_DESCR STD_AXIS Eng_tEng Temp_Cels 15 -50.14000 199.8600 FORMAT "%8.4" EXTENDED_LIMITS -3549.940 3003.560 DEPOSIT ABSOLUTE /end AXIS_DESCR
/end CHARACTERISTIC
/begin CHARACTERISTIC EngM_stBackUpVar_C "#SSD Variante: 0->Wechsel in BU-mode erfolgt bei einen Timeout von CrSCD  1->Wechsel erfolgt sobald Fehlerpf. CrS1 gesetzt ist" VALUE 0xD3388 Kw_Wu8 1.000 OneToOne 0.00 1.000 FORMAT "%5.3" EXTENDED_LIMITS 0.00 255.0 /end CHARACTERISTIC
/begin CHARACTERISTIC EngM_stChkPN_C "Auswahlschalter:  Abfrage P/N-Status für Adaptionsfreigabe" VALUE 0xD3682 Kw_Wu8 1.000 OneToOne 0.00 1.000 FORMAT "%5.3" EXTENDED_LIMITS 0.00 255.0 /end CHARACTERISTIC
/begin CHARACTERISTIC EngM_stEnaBackUp_C "#SSD Schalter zur Aktivierung des Betriebsmodus nur mit Nockenwellensignal" VALUE 0xD3389 Kw_Wu8 1.000 OneToOne 0.00 1.000 FORMAT "%5.3" EXTENDED_LIMITS 0.00 255.0 /end CHARACTERISTIC
/begin CHARACTERISTIC EngM_stOutHard_C "Hard control Bearing" VALUE 0xD33F4 Kw_Wu8 1.000 OneToOne 0.00 1.000 FORMAT "%5.3" EXTENDED_LIMITS 0.00 255.0 /end CHARACTERISTIC
/begin CHARACTERISTIC EngM_stOutSoft_C "soft control Bearing" VALUE 0xD33F5 Kw_Wu8 1.000 OneToOne 0.00 1.000 FORMAT "%5.3" EXTENDED_LIMITS 0.00 255.0 /end CHARACTERISTIC
/begin CHARACTERISTIC EngM_stSyncBefGap_C "#SSD Synchronisation ohne  Luecke" VALUE 0xD3362 Kw_Wu8 1.000 OneToOne 0.00 1.000 FORMAT "%5.3" EXTENDED_LIMITS 0.00 255.0 /end CHARACTERISTIC
/begin CHARACTERISTIC EngM_swtExitOfs_C "#SSD Aussprungbedingung aus dem SYNC_OFFSET State (0x00: Keyless Go, 0x01: Kl. 15 AUS/EIN, 0x10: SYNC_VERIFY_INC)" VALUE 0xD3363 Kw_Wu8 255.0 OneToOne 0.00 255.0 FORMAT "%5.1" /end CHARACTERISTIC
/begin CHARACTERISTIC EngM_swtNumCylVal_C "#SSD Zylinderanzahl, bei Applikation nicht verändern" VALUE 0xD3332 Kw_Wu8 9.000 OneToOne 3.000 12.00 FORMAT "%5.2" EXTENDED_LIMITS 0.00 255.0 /end CHARACTERISTIC
/begin CHARACTERISTIC EngM_swtSyncViaCAN_C "#SSD Ein-, Ausschalten 1/0 der Master-Slave Synchronisation via CAN" VALUE 0xD3364 Kw_Wu8 1.000 OneToOne 0.00 1.000 FORMAT "%5.3" EXTENDED_LIMITS 0.00 255.0 /end CHARACTERISTIC
/begin CHARACTERISTIC EngM_swtT50CDDiag_C "#SSD 0 = Diagnosezähler werden mit T50CD_stDebVal nicht geresetet  1= Diagnosezähler werden mit T50CD_stDebVal geresetet" VALUE 0xD3384 Kw_Wu8 1.000 OneToOne 0.00 1.000 FORMAT "%5.3" EXTENDED_LIMITS 0.00 255.0 /end CHARACTERISTIC
/begin CHARACTERISTIC EngM_swtUpdTDC_C "#SSD Schalter für TDC Umschaltung / Standard: False     nur 8-Zyl. Single ECU = TRUE" VALUE 0xD3365 Kw_Wu8 1.000 OneToOne 0.00 1.000 FORMAT "%5.3" EXTENDED_LIMITS 0.00 255.0 /end CHARACTERISTIC
/begin CHARACTERISTIC EngM_tAdptMin_C "Minimalmotortemperatur für Reibmomentenadaption" VALUE 0xD3684 Kw_Wu16 950.000 Temp_Cels -50.140 899.860 FORMAT "%8.3" EXTENDED_LIMITS -273.1400 6280.360 /end CHARACTERISTIC
/begin CHARACTERISTIC EngM_tEngMax_C "Obere Motortemperaturgrenze für die Motorlagersteuerungsansteuerung" VALUE 0xD3290 Kw_Ws16 250.0000 Temp_Cels -50.1400 199.8600 FORMAT "%8.4" EXTENDED_LIMITS -3549.940 3003.560 /end CHARACTERISTIC
/begin CHARACTERISTIC EngM_tEngMin_C "Untere Temperaturschwelle für die Motorlagersteuerungsansteuerung" VALUE 0xD3292 Kw_Ws16 250.0000 Temp_Cels -50.1400 199.8600 FORMAT "%8.4" EXTENDED_LIMITS -3549.940 3003.560 /end CHARACTERISTIC
/begin CHARACTERISTIC EngM_tiCpuTimeOut_C "#SSD CPU timeout Periode" VALUE 0xC0614 Kw_Wu32 100000.000000 TimeDT 0.00 100000.000000 FORMAT "%13.6" EXTENDED_LIMITS 0.00 4294967295.00 /end CHARACTERISTIC
/begin CHARACTERISTIC EngM_tiDiffInt_C "#SSD Minimaler Abstand swischen zwei stat. Interrupts" VALUE 0xD3368 Kw_Wu32 1228361874.73 TimeSys_us 0.00 1228361874.73 FORMAT "%13.2" /end CHARACTERISTIC
/begin CHARACTERISTIC EngM_tiEngMntCtl_C "Zeitintervall zum Umschalten zwischen den Tastverhältnissen der Halte und der Fangphase" VALUE 0xD3294 Kw_Wu16 655.3500 Time_s 0.00 655.3500 FORMAT "%8.4" /end CHARACTERISTIC
/begin CHARACTERISTIC EngM_tiHardAftrGear_C "time after which the ramp is activated for gear state" VALUE 0xD33F6 Kw_Wu16 655.3500 Time_s 0.00 655.3500 FORMAT "%8.4" /end CHARACTERISTIC
/begin CHARACTERISTIC EngM_tiRelAdpt_C "Entprellzeit für Übergang NO_ADAPT --> ADAPT der Reibmomentenadaption" VALUE 0xD3686 Kw_Wu16 655350.0 TimeDeb 0.00 655350.0 FORMAT "%8.1" /end CHARACTERISTIC
/begin CHARACTERISTIC EngM_tiSegMin_C "Minimale Segmentzeit zur Berechnung der Motorbeschleunigung" VALUE 0xD3334 Kw_Wu16 65535.00 TimeDT 0.00 65535.00 FORMAT "%8.2" /end CHARACTERISTIC
/begin CHARACTERISTIC EngM_tiSoftAftrStrt_C "time after which the ramp is activated for engine state" VALUE 0xD33F8 Kw_Wu16 655.3500 Time_s 0.00 655.3500 FORMAT "%8.4" /end CHARACTERISTIC
/begin CHARACTERISTIC EngM_tiWaitIncSig_C "#SSD Zeit zum Ausblenden des Inkrementsignals im Start" VALUE 0xD336C Kw_Wu16 20000.00 Time_ms 0.00 20000.00 FORMAT "%8.2" EXTENDED_LIMITS 0.00 655350.0 /end CHARACTERISTIC
/begin CHARACTERISTIC EngM_trqFrcPDiffMax_C "Obere Begrenzung des Drehmomentenverlustes durch Abgasgegendruck aufgrund eingebautem Partikelfilter" VALUE 0xD342C Kw_Ws16 6000.000 Trq -3000.000 3000.000 FORMAT "%8.3" EXTENDED_LIMITS -3276.800 3276.700 /end CHARACTERISTIC
/begin CHARACTERISTIC EngM_trqFrcPDiffMin_C "Untere Begrenzung des Drehmomentenverlustes durch Abgasgegendruck aufgrund eingebautem Partikelfilter" VALUE 0xD342E Kw_Ws16 6000.000 Trq -3000.000 3000.000 FORMAT "%8.3" EXTENDED_LIMITS -3276.800 3276.700 /end CHARACTERISTIC
/begin CHARACTERISTIC EngM_trqFrc_Vector "#SSD Bypass Label für EngM_trqFrc (nicht verändern !)" VALUE 0xC3944 Kw_Wu8 255.0 OneToOne 0.00 255.0 FORMAT "%5.1" /end CHARACTERISTIC
/begin CHARACTERISTIC EngM_trqFrc_Channel "#SSD Bypass Label for EngM_trqFrc (nicht verändern !)" VALUE 0xC3945 Kw_Wu8 255.0 OneToOne 0.00 255.0 FORMAT "%5.1" /end CHARACTERISTIC
/begin CHARACTERISTIC EngM_trqFrc_MAP "Schleppkennfeld, Reibkennfeld" MAP 0xD3430 Kf_Xs16_Ys16_Ws16 6553.500 Trq -3276.800 3276.700 FORMAT "%8.3"
 /begin AXIS_DESCR STD_AXIS Eng_nAvrg EngN 16 0.00 32767.00 FORMAT "%8.2" EXTENDED_LIMITS -32768.00 32767.00 DEPOSIT ABSOLUTE /end AXIS_DESCR
 /begin AXIS_DESCR STD_AXIS EngM_tTrqFrc_mp Temp_Cels 16 -50.140 899.860 FORMAT "%8.3" EXTENDED_LIMITS -3549.940 3003.560 DEPOSIT ABSOLUTE /end AXIS_DESCR
/end CHARACTERISTIC
/begin CHARACTERISTIC EngM_uBattMax_C "Obere Batteriespannungsgrenze für die Motorlageransteuerung" VALUE 0xD3296 Kw_Ws16 17008.80 Volt_Batt 0.00 17008.80 FORMAT "%8.2" EXTENDED_LIMITS -640625.6 640606.1 /end CHARACTERISTIC
/begin CHARACTERISTIC EngM_uBattMin_C "Untere Batteriespannungsgrenze für die Motorlageransteuerung" VALUE 0xD3298 Kw_Ws16 2991.202 Volt_Batt 0.00 2991.202 FORMAT "%8.3" EXTENDED_LIMITS -640625.6 640606.1 /end CHARACTERISTIC
/begin CHARACTERISTIC EngM_vLimRefuse_C "Schwellgeschwindigkeit für Zustandsübergang REFUSE_ADAPT --> NO_ADAPT der Reibmomentenadaption" VALUE 0xD3688 Kw_Wu16 655.3500 Vel 0.00 655.3500 FORMAT "%8.4" /end CHARACTERISTIC
/begin CHARACTERISTIC EngM_vThresAdpt_C "vehicle speed threshold for release of adaption" VALUE 0xD368A Kw_Wu16 655.3500 Vel 0.00 655.3500 FORMAT "%8.4" /end CHARACTERISTIC
/begin CHARACTERISTIC EngM_vVSSCDHysHigh_C "high threshold for vechile speed hysteresis" VALUE 0xD33FA Kw_Ws16 300.0000 Vel 0.00 300.0000 FORMAT "%8.4" EXTENDED_LIMITS -327.6800 327.6700 /end CHARACTERISTIC
/begin CHARACTERISTIC EngM_vVSSCDHysLow_C "low threshold for vechile speed hysteresis" VALUE 0xD33FC Kw_Ws16 300.0000 Vel 0.00 300.0000 FORMAT "%8.4" EXTENDED_LIMITS -327.6800 327.6700 /end CHARACTERISTIC
/begin CHARACTERISTIC EngPrt_dTrqLimUp_C "ramp slope up" VALUE 0xD368C Kw_Wu32 6553594.99817 RmpTrq 5.00030517578 6553599.99847 FORMAT "%13.5" EXTENDED_LIMITS 0.00 6553599.99847 /end CHARACTERISTIC
/begin CHARACTERISTIC EngPrt_dTrqLimDown_C "ramp slope down" VALUE 0xD3690 Kw_Wu32 6553594.99817 RmpTrq 5.00030517578 6553599.99847 FORMAT "%13.5" EXTENDED_LIMITS 0.00 6553599.99847 /end CHARACTERISTIC
/begin CHARACTERISTIC EngPrt_facAPSPrv_MAP "Kennfeld für Überhitzungsschutz in Abhängigkeit des Atmosphärendrucks" MAP 0xD3694 Kf_Xs16_Ys16_Ws16 3.999878 Fact 0.00 3.999878 FORMAT "%8.6" EXTENDED_LIMITS -4.000000 3.999878
 /begin AXIS_DESCR STD_AXIS APSCD_pVal Pres_hPa 9 -32768.00 32767.00 FORMAT "%8.2" DEPOSIT ABSOLUTE /end AXIS_DESCR
 /begin AXIS_DESCR STD_AXIS Eng_nAvrg EngN 9 0.00 32767.00 FORMAT "%8.2" EXTENDED_LIMITS -32768.00 32767.00 DEPOSIT ABSOLUTE /end AXIS_DESCR
/end CHARACTERISTIC
/begin CHARACTERISTIC EngPrt_facOvhtPrvCT_CUR "Überhitzungsschutz-Kennlinie Kühlwassertemperatur in Faktor" CURVE 0xD3A4A Kl_Xs16_Ws16 1.000000 Fact 0.00 1.000000 FORMAT "%8.6" EXTENDED_LIMITS -4.000000 3.999878
 /begin AXIS_DESCR STD_AXIS CTSCD_tClnt Temp_Cels 25 -50.14000 199.8600 FORMAT "%8.4" EXTENDED_LIMITS -3549.940 3003.560 DEPOSIT ABSOLUTE /end AXIS_DESCR
/end CHARACTERISTIC
/begin CHARACTERISTIC EngPrt_facOvhtPrvFT_CUR "Überhitzungsschutz-Kennlinie Kraftstofftemperatur in Faktor" CURVE 0xD3AB0 Kl_Xs16_Ws16 1.000000 Fact 0.00 1.000000 FORMAT "%8.6" EXTENDED_LIMITS -4.000000 3.999878
 /begin AXIS_DESCR STD_AXIS FTSCD_tFuel Temp_Cels 25 -50.14000 199.8600 FORMAT "%8.4" EXTENDED_LIMITS -3549.940 3003.560 DEPOSIT ABSOLUTE /end AXIS_DESCR
/end CHARACTERISTIC
/begin CHARACTERISTIC EngPrt_facOvhtPrvOT_CUR "Überhitzungsschutz-Kennlinie Motoröltemperatur in Faktor" CURVE 0xD3B16 Kl_Xs16_Ws16 1.000000 Fact 0.00 1.000000 FORMAT "%8.6" EXTENDED_LIMITS -4.000000 3.999878
 /begin AXIS_DESCR STD_AXIS Gearbx_tOil Temp_Cels 25 -50.14000 199.8600 FORMAT "%8.4" EXTENDED_LIMITS -3549.940 3003.560 DEPOSIT ABSOLUTE /end AXIS_DESCR
/end CHARACTERISTIC
/begin CHARACTERISTIC EngPrt_facOvhtPrv_MAP "Map for overheating prevention factor of engine" MAP 0xD375E Kf_Xs16_Ys16_Ws16 3.999878 Fact 0.00 3.999878 FORMAT "%8.6" EXTENDED_LIMITS -4.000000 3.999878
 /begin AXIS_DESCR STD_AXIS Eng_tEng Temp_Cels 7 -50.140 899.860 FORMAT "%8.3" EXTENDED_LIMITS -3549.940 3003.560 DEPOSIT ABSOLUTE /end AXIS_DESCR
 /begin AXIS_DESCR STD_AXIS VSSCD_v Vel 7 0.00 327.6700 FORMAT "%8.4" EXTENDED_LIMITS -327.6800 327.6700 DEPOSIT ABSOLUTE /end AXIS_DESCR
/end CHARACTERISTIC
/begin CHARACTERISTIC EngPrt_nOvrSpd_C "#SSD Schwelle für Überdrehzahlerkennung" VALUE 0xD37E0 Kw_Ws16 6000.000 EngN 0.00 6000.000 FORMAT "%8.3" EXTENDED_LIMITS -32768.00 32767.00 /end CHARACTERISTIC
/begin CHARACTERISTIC EngPrt_nTrqShutOff_C "threshold value of engine speed for fly wheel oscillation detection" VALUE 0xD3A44 Kw_Ws16 6000.000 EngN 0.00 6000.000 FORMAT "%8.3" EXTENDED_LIMITS -32768.00 32767.00 /end CHARACTERISTIC
/begin CHARACTERISTIC EngPrt_pAPSPrvDfl_C "Default-Wert bei Ausfall des Atmosphärendrucksensors" VALUE 0xD37E2 Kw_Ws16 3500.000 Pres_hPa 0.00 3500.000 FORMAT "%8.3" EXTENDED_LIMITS -32768.00 32767.00 /end CHARACTERISTIC
/begin CHARACTERISTIC EngPrt_qOvhtPrvNRng_MAP "Überhitzungsschutz-Kennfeld für Drehzahl" MAP 0xD3B7C Kf_Xs16_Ys16_Ws16 327.6700 InjMass 0.00 327.6700 FORMAT "%8.4" EXTENDED_LIMITS -327.6800 327.6700
 /begin AXIS_DESCR STD_AXIS Eng_nAvrg EngN 16 40.00000 6000.000 FORMAT "%8.3" EXTENDED_LIMITS -32768.00 32767.00 DEPOSIT ABSOLUTE /end AXIS_DESCR
 /begin AXIS_DESCR STD_AXIS EngPrt_facOvhtPrv_mp Fact 16 0.00 1.000000 FORMAT "%8.6" EXTENDED_LIMITS -4.000000 3.999878 DEPOSIT ABSOLUTE /end AXIS_DESCR
/end CHARACTERISTIC
/begin CHARACTERISTIC EngPrt_qOvhtPrvVRng_MAP "Überhitzungsschutz-Kennfeld für Fahrzeuggeschwindigkeit" MAP 0xD3DC0 Kf_Xs16_Ys16_Ws16 327.6700 InjMass 0.00 327.6700 FORMAT "%8.4" EXTENDED_LIMITS -327.6800 327.6700
 /begin AXIS_DESCR STD_AXIS EngPrt_facOvhtPrv_mp Fact 16 0.00 1.000000 FORMAT "%8.6" EXTENDED_LIMITS -4.000000 3.999878 DEPOSIT ABSOLUTE /end AXIS_DESCR
 /begin AXIS_DESCR STD_AXIS VSSCD_v Vel 16 0.00 300.0000 FORMAT "%8.4" EXTENDED_LIMITS -327.6800 327.6700 DEPOSIT ABSOLUTE /end AXIS_DESCR
/end CHARACTERISTIC
/begin CHARACTERISTIC EngPrt_qPrtLim_Vector "#SSD Bypass Label, nicht ändern!" VALUE 0xC3946 Kw_Wu8 255.0 OneToOne 0.00 255.0 FORMAT "%5.1" /end CHARACTERISTIC
/begin CHARACTERISTIC EngPrt_qPrtLim_Channel "#SSD Bypass Label, nicht ändern!" VALUE 0xC3947 Kw_Wu8 255.0 OneToOne 0.00 255.0 FORMAT "%5.1" /end CHARACTERISTIC
/begin CHARACTERISTIC EngPrt_dtrqUpCBLim_C "Positiv rampensteigung fuer Drehmomentbegrenzung bei Verdichterbypass oeffnen" VALUE 0xD37E4 Kw_Wu32 6553594.99817 RmpTrq 5.00030517578 6553599.99847 FORMAT "%13.5" EXTENDED_LIMITS 0.00 6553599.99847 /end CHARACTERISTIC
/begin CHARACTERISTIC EngPrt_dtrqDwnCBLim_C "Negativ rampensteigung fuer Drehmomentbegrenzung bei Verdichterbypass oeffnen" VALUE 0xD37E8 Kw_Wu32 6553594.99817 RmpTrq 5.00030517578 6553599.99847 FORMAT "%13.5" EXTENDED_LIMITS 0.00 6553599.99847 /end CHARACTERISTIC
/begin CHARACTERISTIC EngPrt_dtrqUpNLim_C "Rampenanstieg von Ersatzkennlinie auf Normalkennlinie der Motordrehzahlbegrenzung" VALUE 0xD37EC Kw_Wu32 6553594.99817 RmpTrq 5.00030517578 6553599.99847 FORMAT "%13.5" EXTENDED_LIMITS 0.00 6553599.99847 /end CHARACTERISTIC
/begin CHARACTERISTIC EngPrt_dtrqDwnNLim_C "Rampenanstieg von Normalkennlinie zur Ersatzkennlinie der Motordrehzahlbegrenzung" VALUE 0xD37F0 Kw_Wu32 6553594.99817 RmpTrq 5.00030517578 6553599.99847 FORMAT "%13.5" EXTENDED_LIMITS 0.00 6553599.99847 /end CHARACTERISTIC
/begin CHARACTERISTIC EngPrt_rVnDAMax_C "Maximum v/n Verhältnis" VALUE 0xD37F4 Kw_Ws16 0.3276700 VelToN 0.00 0.3276700 FORMAT "%9.7" EXTENDED_LIMITS -0.3276800 0.3276700 /end CHARACTERISTIC
/begin CHARACTERISTIC EngPrt_rVnDAMin_C "Minimum v/n Verhältnis" VALUE 0xD37F6 Kw_Ws16 0.3276700 VelToN 0.00 0.3276700 FORMAT "%9.7" EXTENDED_LIMITS -0.3276800 0.3276700 /end CHARACTERISTIC
/begin CHARACTERISTIC EngPrt_rVnTrqMax_C "Maximum v/n Verhältnis" VALUE 0xD37F8 Kw_Ws16 0.3276700 VelToN 0.00 0.3276700 FORMAT "%9.7" EXTENDED_LIMITS -0.3276800 0.3276700 /end CHARACTERISTIC
/begin CHARACTERISTIC EngPrt_rVnTrqMin_C "Minimum v/n Verhältnis" VALUE 0xD37FA Kw_Ws16 0.3276700 VelToN 0.00 0.3276700 FORMAT "%9.7" EXTENDED_LIMITS -0.3276800 0.3276700 /end CHARACTERISTIC
/begin CHARACTERISTIC EngPrt_swtTrqGear_CUR "applizierbare Gänge: Wert = 0 nicht aktiv; Wert = 1 aktiv" CURVE 0xD37FC Kl_Xs16_Ws16 32767.00 OneToOne 0.00 32767.00 FORMAT "%8.2" EXTENDED_LIMITS -32768.00 32767.00
 /begin AXIS_DESCR STD_AXIS Gearbx_stGear OneToOne 8 -1.000 127.0 FORMAT "%5.1" EXTENDED_LIMITS -128.0 127.0 DEPOSIT ABSOLUTE /end AXIS_DESCR
/end CHARACTERISTIC
/begin CHARACTERISTIC EngPrt_trqCBLim1_CUR "Drehmomentbegrenzung bei geoeffnetem Verdichterbypass" CURVE 0xD381E Kl_Xs16_Ws16 3276.700 Trq 0.00 3276.700 FORMAT "%8.3" EXTENDED_LIMITS -3276.800 3276.700
 /begin AXIS_DESCR STD_AXIS Eng_nAvrg EngN 20 0.00 32767.00 FORMAT "%8.2" EXTENDED_LIMITS -32768.00 32767.00 DEPOSIT ABSOLUTE /end AXIS_DESCR
/end CHARACTERISTIC
/begin CHARACTERISTIC EngPrt_trqCBLim_CUR "Drehmomentbegrenzung bei geoeffnetem Verdichterbypass" CURVE 0xD3870 Kl_Xs16_Ws16 3276.700 Trq 0.00 3276.700 FORMAT "%8.3" EXTENDED_LIMITS -3276.800 3276.700
 /begin AXIS_DESCR STD_AXIS Eng_nAvrg EngN 20 0.00 32767.00 FORMAT "%8.2" EXTENDED_LIMITS -32768.00 32767.00 DEPOSIT ABSOLUTE /end AXIS_DESCR
/end CHARACTERISTIC
/begin CHARACTERISTIC EngPrt_trqLim1_CUR "Momentenbegrenzungskurve für AT mit geschlossener Wandlerkupplung und aktueller Gang muß in EngPrt_swtTrqGear_CUR 1 sein." CURVE 0xD38C2 Kl_Xs16_Ws16 3276.700 Trq 0.00 3276.700 FORMAT "%8.3" EXTENDED_LIMITS -3276.800 3276.700
 /begin AXIS_DESCR STD_AXIS Eng_nAvrg EngN 21 0.00 32767.00 FORMAT "%8.2" EXTENDED_LIMITS -32768.00 32767.00 DEPOSIT ABSOLUTE /end AXIS_DESCR
/end CHARACTERISTIC
/begin CHARACTERISTIC EngPrt_trqLimDA_CUR "Anfahrdrehmomentenbegrenzungskennlinie" CURVE 0xD3918 Kl_Xs16_Ws16 3276.700 Trq 0.00 3276.700 FORMAT "%8.3" EXTENDED_LIMITS -3276.800 3276.700
 /begin AXIS_DESCR STD_AXIS Eng_nAvrg EngN 21 0.00 32767.00 FORMAT "%8.2" EXTENDED_LIMITS -32768.00 32767.00 DEPOSIT ABSOLUTE /end AXIS_DESCR
/end CHARACTERISTIC
/begin CHARACTERISTIC EngPrt_trqLim_CUR "Kennlinie die Drehmomentbegrenzung (je nach Application inneres oder äußeres Motormoment)" CURVE 0xD396E Kl_Xs16_Ws16 3276.700 Trq 0.00 3276.700 FORMAT "%8.3" EXTENDED_LIMITS -3276.800 3276.700
 /begin AXIS_DESCR STD_AXIS Eng_nAvrg EngN 21 0.00 32767.00 FORMAT "%8.2" EXTENDED_LIMITS -32768.00 32767.00 DEPOSIT ABSOLUTE /end AXIS_DESCR
/end CHARACTERISTIC
/begin CHARACTERISTIC EngPrt_trqNLimSpr_CUR "Kennlinie für Motordrehzahlbegrenzung bei Systemfehler (als Begrenzungsmoment)" CURVE 0xD39C4 Kl_Xs16_Ws16 3276.700 Trq 0.00 3276.700 FORMAT "%8.3" EXTENDED_LIMITS -3276.800 3276.700
 /begin AXIS_DESCR STD_AXIS Eng_nAvrg EngN 10 0.00 32767.00 FORMAT "%8.2" EXTENDED_LIMITS -32768.00 32767.00 DEPOSIT ABSOLUTE /end AXIS_DESCR
/end CHARACTERISTIC
/begin CHARACTERISTIC EngPrt_trqNLim_CUR "Kennlinie für Drehzahlbegrenzung im Normalbetrieb (inneres Motormoment)" CURVE 0xD39EE Kl_Xs16_Ws16 3276.700 Trq 0.00 3276.700 FORMAT "%8.3" EXTENDED_LIMITS -3276.800 3276.700
 /begin AXIS_DESCR STD_AXIS Eng_nAvrg EngN 21 0.00 32767.00 FORMAT "%8.2" EXTENDED_LIMITS -32768.00 32767.00 DEPOSIT ABSOLUTE /end AXIS_DESCR
/end CHARACTERISTIC
/begin CHARACTERISTIC EngPrt_trqNLim_Vector "#SSD Bypass Label, nicht ändern!" VALUE 0xC3948 Kw_Wu8 255.0 OneToOne 0.00 255.0 FORMAT "%5.1" /end CHARACTERISTIC
/begin CHARACTERISTIC EngPrt_trqNLim_Channel "#SSD Bypass Label, nicht ändern!" VALUE 0xC3949 Kw_Wu8 255.0 OneToOne 0.00 255.0 FORMAT "%5.1" /end CHARACTERISTIC
/begin CHARACTERISTIC EngPrt_trqPrtLim_Vector "#SSD Bypass Label, nicht ändern!" VALUE 0xC394A Kw_Wu8 255.0 OneToOne 0.00 255.0 FORMAT "%5.1" /end CHARACTERISTIC
/begin CHARACTERISTIC EngPrt_trqPrtLim_Channel "#SSD Bypass Label, nicht ändern!" VALUE 0xC394B Kw_Wu8 255.0 OneToOne 0.00 255.0 FORMAT "%5.1" /end CHARACTERISTIC
/begin CHARACTERISTIC Eng_ctEngSpdDiffCalc_C "Anzahl der Drehzahlwerte zur Mittelung" VALUE 0xD329C Kw_Wu8 4.000 OneToOne 1.000 5.000 FORMAT "%5.3" EXTENDED_LIMITS 0.00 255.0 /end CHARACTERISTIC
/begin CHARACTERISTIC Eng_tiOvrTemp2_C "Zeitverzögerung Übertemperatur 2" VALUE 0xD32FC Kw_Ws16 655.3500 Time_s -327.6800 327.6700 FORMAT "%8.4" /end CHARACTERISTIC
/begin CHARACTERISTIC Eng_tiOvrTempOn2_C "" VALUE 0xD32FE Kw_Ws16 655.3500 Time_s -327.6800 327.6700 FORMAT "%8.4" /end CHARACTERISTIC
/begin CHARACTERISTIC Eng_tiOvrTempOn_C "" VALUE 0xD3300 Kw_Ws16 655.3500 Time_s -327.6800 327.6700 FORMAT "%8.4" /end CHARACTERISTIC
/begin CHARACTERISTIC Eng_tiOvrTemp_C "Zeitverzögerung Übertemperatur 1" VALUE 0xD3302 Kw_Ws16 655.3500 Time_s -327.6800 327.6700 FORMAT "%8.4" /end CHARACTERISTIC
/begin CHARACTERISTIC Eng_tOvrHi2_C "high hysteresis limit for setting of overheat status" VALUE 0xD329E Kw_Ws16 250.0000 Temp_Cels -50.14000 199.8600 FORMAT "%8.4" EXTENDED_LIMITS -3549.940 3003.560 /end CHARACTERISTIC
/begin CHARACTERISTIC Eng_tOvrHi_C "Obere Hystereseschwelle für Erkennung Übertemperatur" VALUE 0xD32A0 Kw_Ws16 250.0000 Temp_Cels -50.14000 199.8600 FORMAT "%8.4" EXTENDED_LIMITS -3549.940 3003.560 /end CHARACTERISTIC
/begin CHARACTERISTIC Eng_tOvrLo2_C "low hysteresis limit for setting of overheat status" VALUE 0xD32A2 Kw_Ws16 250.0000 Temp_Cels -50.14000 199.8600 FORMAT "%8.4" EXTENDED_LIMITS -3549.940 3003.560 /end CHARACTERISTIC
/begin CHARACTERISTIC Eng_tOvrLo_C "Untere Hystereseschwelle für Erkennung Übertemperatur" VALUE 0xD32A4 Kw_Ws16 250.0000 Temp_Cels -50.14000 199.8600 FORMAT "%8.4" EXTENDED_LIMITS -3549.940 3003.560 /end CHARACTERISTIC
/begin CHARACTERISTIC Eng_trqSpd_CUR "Drehmomentkennlinie" CURVE 0xD32A6 Kl_Xs16_Ws16 3276.700 Trq 0.00 3276.700 FORMAT "%8.3" EXTENDED_LIMITS -3276.800 3276.700
 /begin AXIS_DESCR STD_AXIS Eng_nAvrg EngN 21 0.00 6000.000 FORMAT "%8.3" EXTENDED_LIMITS -32768.00 32767.00 DEPOSIT ABSOLUTE /end AXIS_DESCR
/end CHARACTERISTIC
/begin CHARACTERISTIC ErLpCD_ctMilPwrStgOnMax_C "Maximaler Zähler für Powerstage On im Fehlerfall" VALUE 0xD4004 Kw_Wu16 65535.00 OneToOne 0.00 65535.00 FORMAT "%8.2" /end CHARACTERISTIC
/begin CHARACTERISTIC ErLpCD_ctSysLmpPwrStgOnMax_C "Maximaler Zähler für Powerstage On im Fehlerfall" VALUE 0xD4006 Kw_Wu16 65535.00 OneToOne 0.00 65535.00 FORMAT "%8.2" /end CHARACTERISTIC
/begin CHARACTERISTIC ErLpCD_tiDefMil_C "Zeit für MIL Defekterkennung (Endstufenüberwachung)" VALUE 0xD4008 Kw_Wu16 655350.0 Time_ms 0.00 655350.0 FORMAT "%8.1" /end CHARACTERISTIC
/begin CHARACTERISTIC ErLpCD_tiOkMil_C "Zeit für MIL in Ordnung Erkennung (Endstufenüberwachung)" VALUE 0xD400A Kw_Wu16 655350.0 Time_ms 0.00 655350.0 FORMAT "%8.1" /end CHARACTERISTIC
/begin CHARACTERISTIC ErLpCD_nThresMil_C "Drehzahlgrenze für MIL-Test" VALUE 0xD400C Kw_Ws16 65535.00 EngN -32768.00 32767.00 FORMAT "%8.2" /end CHARACTERISTIC
/begin CHARACTERISTIC ErLpCD_tiMaxMil_C "Zeitgrenze für MIL-Test" VALUE 0xD400E Kw_Wu16 655350.0 Time_ms 0.00 655350.0 FORMAT "%8.1" /end CHARACTERISTIC
/begin CHARACTERISTIC ErLpCD_tiMilTst_C "zusätzliche MIL Test Zeit nach Überschreiten Drehzahlschwelle" VALUE 0xD4010 Kw_Wu16 655350.0 Time_ms 0.00 655350.0 FORMAT "%8.1" /end CHARACTERISTIC
/begin CHARACTERISTIC ErLpCD_tiDelMil_C "Verzögerung der MIL Anzeige nach Lampentest" VALUE 0xD4012 Kw_Wu16 655350.0 Time_ms 0.00 655350.0 FORMAT "%8.1" /end CHARACTERISTIC
/begin CHARACTERISTIC ErLpCD_tiBlkMil_C "halbe Zeit der MIL Blink Periodedauer" VALUE 0xD4014 Kw_Wu16 655350.0 Time_ms 0.00 655350.0 FORMAT "%8.1" /end CHARACTERISTIC
/begin CHARACTERISTIC ErLpCD_swtMilEna_C "MIL Freigabe Schalter (0 = abgeschaltet; 1 = eingeschaltet)" VALUE 0xD4016 Kw_Wu8 1.000 OneToOne 0.00 1.000 FORMAT "%5.3" EXTENDED_LIMITS 0.00 255.0 /end CHARACTERISTIC
/begin CHARACTERISTIC ErLpCD_numDiaErrLmp_C "#SSD application parameter for error lamp diagnostic signal" VALUE 0xD4018 Kw_Wu8 27.0000000000 NumPinDia 0.00 27.0000000000 FORMAT "%13.10" /end CHARACTERISTIC
/begin CHARACTERISTIC ErLpCD_numDiaSysLmp_C "#SSD application parameter for system lamp diagnostic signal" VALUE 0xD4019 Kw_Wu8 27.0000000000 NumPinDia 0.00 27.0000000000 FORMAT "%13.10" /end CHARACTERISTIC
/begin CHARACTERISTIC ErLpCD_numDioOutErrLmp_C "#SSD application parameter for error lamp" VALUE 0xD401A Kw_Wu8 11.0000000000 NumPinDioOut 0.00 11.0000000000 FORMAT "%13.10" /end CHARACTERISTIC
/begin CHARACTERISTIC ErLpCD_numDioOutSysLmp_C "#SSD application parameter for system lamp" VALUE 0xD401B Kw_Wu8 11.0000000000 NumPinDioOut 0.00 11.0000000000 FORMAT "%13.10" /end CHARACTERISTIC
/begin CHARACTERISTIC ErLpCD_stRdy_C "Status der readyness function" VALUE 0xD401C Kw_Wu8 1.000 OneToOne 0.00 1.000 FORMAT "%5.3" EXTENDED_LIMITS 0.00 255.0 /end CHARACTERISTIC
/begin CHARACTERISTIC ErLpCD_tiRdy_C "Maximale Zeit für das Prüfen der readiness via MIL" VALUE 0xD401E Kw_Wu16 655350.0 Time_ms 0.00 655350.0 FORMAT "%8.1" /end CHARACTERISTIC
/begin CHARACTERISTIC ErLpCD_tiBlkOn_C "Dauer Lampe ein während der Blinkphase" VALUE 0xD4020 Kw_Wu16 655350.0 Time_ms 0.00 655350.0 FORMAT "%8.1" /end CHARACTERISTIC
/begin CHARACTERISTIC ErLpCD_tiBlkOff_C "Dauer Lampe aus während der Blinkphase" VALUE 0xD4022 Kw_Wu16 655350.0 Time_ms 0.00 655350.0 FORMAT "%8.1" /end CHARACTERISTIC
/begin CHARACTERISTIC ErLpCD_stMilSPICtl_C "Parameter zur Anzeige der verwendeten Endstufenart (1 = SPI kontrolliert, 0 = nicht SPI kontrolliert)" VALUE 0xD4024 Kw_Wu8 1.000 OneToOne 0.00 1.000 FORMAT "%5.3" EXTENDED_LIMITS 0.00 255.0 /end CHARACTERISTIC
/begin CHARACTERISTIC ErLpCD_stPwrStgActvLmp_C "Spezifikation des Abschaltverhaltens der Lamp-Endstufe" VALUE 0xD4025 Kw_Wu8 255.0 OneToOne 0.00 255.0 FORMAT "%5.1" /end CHARACTERISTIC
/begin CHARACTERISTIC ErLpCD_stPwrStgActvMil_C "Spezifikation des Abschaltverhaltens der MIL-Endstufe" VALUE 0xD4026 Kw_Wu8 255.0 OneToOne 0.00 255.0 FORMAT "%5.1" /end CHARACTERISTIC
/begin CHARACTERISTIC ErLpCD_stPwrStgDiaLmp_C "Spezifikation des Diagnoseabschaltverhaltens der Lamp-Endstufe" VALUE 0xD4027 Kw_Wu8 255.0 OneToOne 0.00 255.0 FORMAT "%5.1" /end CHARACTERISTIC
/begin CHARACTERISTIC ErLpCD_stPwrStgDiaMil_C "Spezifikation des Diagnoseabschaltverhaltens der MIL-Endstufe" VALUE 0xD4028 Kw_Wu8 255.0 OneToOne 0.00 255.0 FORMAT "%5.1" /end CHARACTERISTIC
/begin CHARACTERISTIC ErLpCD_stSysLmpSPICtl_C "Parameter zur Anzeige der verwendeten Endstufenart (1 = SPI kontrolliert, 0 = nicht SPI kontrolliert)" VALUE 0xD4029 Kw_Wu8 1.000 OneToOne 0.00 1.000 FORMAT "%5.3" EXTENDED_LIMITS 0.00 255.0 /end CHARACTERISTIC
/begin CHARACTERISTIC ErLpCD_swtSysEqGlwLmp_C "SysLamp entspricht Glühlampe (Signalumleitung) (0 = abgeschaltet; 1 = eingeschaltet)" VALUE 0xD402A Kw_Wu8 1.000 OneToOne 0.00 1.000 FORMAT "%5.3" EXTENDED_LIMITS 0.00 255.0 /end CHARACTERISTIC
/begin CHARACTERISTIC ErLpCD_tiDefSysLmp_C "Zeit für SysLamp Defekterkennung (Endstufenüberwachung)" VALUE 0xD402C Kw_Wu16 655350.0 Time_ms 0.00 655350.0 FORMAT "%8.1" /end CHARACTERISTIC
/begin CHARACTERISTIC ErLpCD_tiOkSysLmp_C "Zeit für SysLamp in Ordnung Erkennung (Endstufenüberwachung)" VALUE 0xD402E Kw_Wu16 655350.0 Time_ms 0.00 655350.0 FORMAT "%8.1" /end CHARACTERISTIC
/begin CHARACTERISTIC ErLpCD_nThresSysLmp_C "Drehzahlgrenze für SysLamp-Test" VALUE 0xD4030 Kw_Ws16 65535.00 EngN -32768.00 32767.00 FORMAT "%8.2" /end CHARACTERISTIC
/begin CHARACTERISTIC ErLpCD_tiMaxSysLmp_C "Zeitgrenze für SysLamp-Test" VALUE 0xD4032 Kw_Wu16 655350.0 Time_ms 0.00 655350.0 FORMAT "%8.1" /end CHARACTERISTIC
/begin CHARACTERISTIC ErLpCD_tiTstSysLmp_C "zusätzliche SysLamp Test Zeit nach Überschreiten Drehzahlschwelle" VALUE 0xD4034 Kw_Wu16 655350.0 Time_ms 0.00 655350.0 FORMAT "%8.1" /end CHARACTERISTIC
/begin CHARACTERISTIC ErLpCD_tiDelSysLmp_C "Verzögerung der SysLamp Anzeige nach Lampentest" VALUE 0xD4036 Kw_Wu16 655350.0 Time_ms 0.00 655350.0 FORMAT "%8.1" /end CHARACTERISTIC
/begin CHARACTERISTIC ErLpCD_tiBlkSysLmp_C "halbe Zeit der SysLamp Blink Periodedauer" VALUE 0xD4038 Kw_Wu16 655350.0 Time_ms 0.00 655350.0 FORMAT "%8.1" /end CHARACTERISTIC
/begin CHARACTERISTIC ErLpCD_swtSysLmpEna_C "SysLamp Freigabe Schalter (0 = abgeschaltet; 1 = eingeschaltet)" VALUE 0xD403A Kw_Wu8 1.000 OneToOne 0.00 1.000 FORMAT "%5.3" EXTENDED_LIMITS 0.00 255.0 /end CHARACTERISTIC
/begin CHARACTERISTIC ErLpCD_tiBtwTstMil_C "Zeitabstand, in dem die Endstufe im Fehlerfall getestet wird" VALUE 0xD403C Kw_Wu16 655140.0 Time_ms 0.00 655140.0 FORMAT "%8.1" EXTENDED_LIMITS 0.00 655350.0 /end CHARACTERISTIC
/begin CHARACTERISTIC ErLpCD_tiBtwTstSysLmp_C "Zeitabstand, in dem die Endstufe im Fehlerfall getestet wird" VALUE 0xD403E Kw_Wu16 655140.0 Time_ms 0.00 655140.0 FORMAT "%8.1" EXTENDED_LIMITS 0.00 655350.0 /end CHARACTERISTIC
/begin CHARACTERISTIC ErLpCD_tiMilPwrStgOn_C "Zeit für welche die Endstufe im Fehlerfall eingeschalten wird (nur nicht SPI kontrolliert)" VALUE 0xD4040 Kw_Wu16 655140.0 Time_ms 0.00 655140.0 FORMAT "%8.1" EXTENDED_LIMITS 0.00 655350.0 /end CHARACTERISTIC
/begin CHARACTERISTIC ErLpCD_tiSysLmpPwrStgOn_C "Zeit für welche die Endstufe im Fehlerfall eingeschalten wird (nur nicht SPI kontrolliert)" VALUE 0xD4042 Kw_Wu16 655140.0 Time_ms 0.00 655140.0 FORMAT "%8.1" EXTENDED_LIMITS 0.00 655350.0 /end CHARACTERISTIC
/begin CHARACTERISTIC EngPrt_tiFWOscDetDebDef_C "Debounce time for fly wheel oscillation defect detection" VALUE 0xD3A46 Kw_Wu16 2000.000 TimeDeb 0.00 2000.000 FORMAT "%8.3" EXTENDED_LIMITS 0.00 655350.0 /end CHARACTERISTIC
/begin CHARACTERISTIC EngPrt_tiFWOscDetDebOk_C "Debounce time for fly wheel oscillation defect healing" VALUE 0xD3A48 Kw_Wu16 2000.000 TimeDeb 0.00 2000.000 FORMAT "%8.3" EXTENDED_LIMITS 0.00 655350.0 /end CHARACTERISTIC
/begin MEASUREMENT EGSys_AlpEGTube_mp "Wärmeübertragungskoeffizient zwischen Abgas und Abgasrohr" SWORD ThermalCoEff 1 100 -3276.800 3276.700 FORMAT "%8.3" ARRAY_SIZE 2 ECU_ADDRESS 0x8FEE90 /end MEASUREMENT
/begin MEASUREMENT EGSys_AlpTubeEnv_mp "Wärmeübertragungskoeffizient zwischen Abgasrohr und Umgebung" SWORD ThermalCoEff 1 100 -3276.800 3276.700 FORMAT "%8.3" ARRAY_SIZE 2 ECU_ADDRESS 0x8FEE94 /end MEASUREMENT
/begin MEASUREMENT EGSys_cndHtEGi_mp "Wärmeleitfähigkeit Abgas im Rohr" SWORD Fact 1 100 -4.000000 3.999878 FORMAT "%8.6" ARRAY_SIZE 2 ECU_ADDRESS 0x8FEE98 /end MEASUREMENT
/begin MEASUREMENT EGSys_cndHtEGo_mp "Wärmeleitfähigkeit Luft ausserhalb des Rohres" SWORD Fact 1 100 -4.000000 3.999878 FORMAT "%8.6" ARRAY_SIZE 2 ECU_ADDRESS 0x8FEE9C /end MEASUREMENT
/begin MEASUREMENT EGSys_cpEGOxiCat_mp "Spezifische Wärmekapazität Abgas im Oxidationskatalysator" SWORD SpecificHeat 1 100 -3.276800 3.276700 FORMAT "%8.6" ECU_ADDRESS 0x8FEE5C /end MEASUREMENT
/begin MEASUREMENT EGSys_cpEGTrbn_mp "Spezifische Wärmekapazität Abgas in Turbine" SWORD SpecificHeat 1 100 -3.276800 3.276700 FORMAT "%8.6" ECU_ADDRESS 0x8FEE84 /end MEASUREMENT
/begin MEASUREMENT EGSys_cpEGTube_mp "Spezifsche Wärmekapazität Abgas im Abgasrohr" SWORD SpecificHeat 1 100 -3.276800 3.276700 FORMAT "%8.6" ARRAY_SIZE 2 ECU_ADDRESS 0x8FEEA0 /end MEASUREMENT
/begin MEASUREMENT EGSys_dtTube_mp "Temperaturänderung Abgasrohr" SWORD Temp_Kelv_Sec 1 100 -327.6800 327.6700 FORMAT "%8.4" ARRAY_SIZE 2 ECU_ADDRESS 0x8FEEA4 /end MEASUREMENT
/begin MEASUREMENT EGSys_dwFlCmb_mp "Wärmestrom durch spät nacheingespritzte Kraftstoffmenge" SLONG Pwr1 1 100 -214748364.800 214748364.700 FORMAT "%13.3" ECU_ADDRESS 0x8FEE60 /end MEASUREMENT
/begin MEASUREMENT EGSys_dwTubeIn_mp "Eintretender Wärmestrom Abgasrohr" SLONG Pwr1 1 100 -214748364.800 214748364.700 FORMAT "%13.3" ARRAY_SIZE 2 ECU_ADDRESS 0x8FEEA8 /end MEASUREMENT
/begin MEASUREMENT EGSys_dwTubeOut_mp "Austretender Wärmestrom Abgasrohr" SLONG Pwr1 1 100 -214748364.800 214748364.700 FORMAT "%13.3" ARRAY_SIZE 2 ECU_ADDRESS 0x8FEEB0 /end MEASUREMENT
/begin MEASUREMENT EGSys_dwTube_mp "Wärmeänderung Abgasrohr" SLONG Pwr1 1 100 -214748364.800 214748364.700 FORMAT "%13.3" ARRAY_SIZE 2 ECU_ADDRESS 0x8FEEB8 /end MEASUREMENT
/begin MEASUREMENT EGSys_etaChrg_mp "Gesamtwirkungsgrad Turbolader" SWORD Fact 1 100 -4.000000 3.999878 FORMAT "%8.6" ECU_ADDRESS 0x8FEE86 /end MEASUREMENT
/begin MEASUREMENT EGSys_facPT1Chrg_mp "Variabler Faktor für thermische Zeitkonstante Lader" SWORD Fact_PT1 1 100 -256.0000 255.9922 FORMAT "%8.4" ECU_ADDRESS 0x8FEE88 /end MEASUREMENT
/begin MEASUREMENT EGSys_NuTubeEnv_mp "Nusselt-Zahl Aussenumströmung Abgasrohr" SWORD OneToOne 1 100 -32768.00 32767.00 FORMAT "%8.2" ARRAY_SIZE 2 ECU_ADDRESS 0x8FEEC0 /end MEASUREMENT
/begin MEASUREMENT EGSys_NuTube_mp "Nusselt-Zahl im Abgasrohr" SWORD OneToOne 1 100 -32768.00 32767.00 FORMAT "%8.2" ARRAY_SIZE 2 ECU_ADDRESS 0x8FEEC4 /end MEASUREMENT
/begin MEASUREMENT EGSys_pwrCmpr_mp "Verdichterleistung" SWORD Pwr 1 100 -308831.1 308821.7 FORMAT "%8.1" ECU_ADDRESS 0x8FEE8A /end MEASUREMENT
/begin MEASUREMENT EGSys_ReTubeEnvInpCrv_mp "Messpunkt Eingangswert Kurve EGSys_NuTubeEnv_CUR" SWORD OneToOne 1 100 -32768.00 32767.00 FORMAT "%8.2" ECU_ADDRESS 0x8FEEC8 /end MEASUREMENT
/begin MEASUREMENT EGSys_ReTubeEnv_mp "Reynolds-Zahl Aussenumströmung Abgasrohr" SWORD OneToOne 1 100 -32768.00 32767.00 FORMAT "%8.2" ARRAY_SIZE 2 ECU_ADDRESS 0x8FEECA /end MEASUREMENT
/begin MEASUREMENT EGSys_ReTubeInpCrv_mp "Messpunkt Eingang Kurve EGSys_NuTube_CUR" SWORD ReynoldsNum 1 100 -3276800. 3276700. FORMAT "%8.0" ECU_ADDRESS 0x8FEECE /end MEASUREMENT
/begin MEASUREMENT EGSys_ReTube_mp "Reynolds-Zahl im Abgasrohr" SWORD ReynoldsNum 1 100 -3276800. 3276700. FORMAT "%8.0" ARRAY_SIZE 2 ECU_ADDRESS 0x8FEED0 /end MEASUREMENT
/begin MEASUREMENT EGSys_rPresCmpr_mp "Verdichterdruckverhältnis" SWORD Fact 1 100 -4.000000 3.999878 FORMAT "%8.6" ECU_ADDRESS 0x8FEE8C /end MEASUREMENT
/begin MEASUREMENT EGSys_rTempClnt_mp "Verhältnis Motorübertemperatur Motorstart / -stop" SWORD Fact 1 100 -4.000000 3.999878 FORMAT "%8.6" ECU_ADDRESS 0x8FEE70 /end MEASUREMENT
/begin MEASUREMENT EGSys_rTimeNSC_mp "Verhältnis Standzeit zu Halbwertszeit NSC" SWORD Fact1 1 100 -256.0000 255.9922 FORMAT "%8.4" ECU_ADDRESS 0x8FEE72 /end MEASUREMENT
/begin MEASUREMENT EGSys_rTimeOxiCat_mp "Verhältnis Standzeit zu Halbwertszeit Oxidationskatalysator" SWORD Fact1 1 100 -256.0000 255.9922 FORMAT "%8.4" ECU_ADDRESS 0x8FEE74 /end MEASUREMENT
/begin MEASUREMENT EGSys_rTimeTrb_mp "Verhältnis-Stillstand-Zeit / Halbzeit-Periode turbocharger" SWORD Fact1 1 100 -256.0000 255.9922 FORMAT "%8.4" ECU_ADDRESS 0x8FEE76 /end MEASUREMENT
/begin MEASUREMENT EGSys_rTimeTube_mp "Verhältnis Standzeit zu Halbwertszeit Abgasrohr" SWORD Fact1 1 100 -256.0000 255.9922 FORMAT "%8.4" ARRAY_SIZE 2 ECU_ADDRESS 0x8FEE6C /end MEASUREMENT
/begin MEASUREMENT EGSys_sqTube_mp "Oberfläche Abgasrohr" SWORD Area 1 100 -4.000000 3.999878 FORMAT "%8.6" ARRAY_SIZE 2 ECU_ADDRESS 0x8FEED4 /end MEASUREMENT
/begin MEASUREMENT EGSys_tAvrgEGTrbn_mp "Mittlere Abgastemperatur in Turbine" SWORD Temp_Cels 1 100 -50.140 899.860 FORMAT "%8.3" ECU_ADDRESS 0x8FEE8E /end MEASUREMENT
/begin MEASUREMENT EGSys_tAvrgEGTube_mp "Mittlere Abgastemperatur im Abgasrohr" SWORD Temp_Cels 1 100 -50.140 899.860 FORMAT "%8.3" ARRAY_SIZE 2 ECU_ADDRESS 0x8FEED8 /end MEASUREMENT
/begin MEASUREMENT EGSys_tAvrgOxiCat_mp "Mittlere Temperatur Oxidationskatalysator" SWORD Temp_Cels 1 100 -50.140 899.860 FORMAT "%8.3" ECU_ADDRESS 0x8FEE64 /end MEASUREMENT
/begin MEASUREMENT EGSys_tDiffEGTube_mp "Temperaturdifferenz Abgas / Abgasrohr" SWORD TempDiff_Cels 1 100 -3276.800 3276.700 FORMAT "%8.3" ARRAY_SIZE 2 ECU_ADDRESS 0x8FEEDC /end MEASUREMENT
/begin MEASUREMENT EGSys_tDiffTubeEnv_mp "Temperaturdifferenz Abgasrohr / Umgebung" SWORD TempDiff_Cels 1 100 -3276.800 3276.700 FORMAT "%8.3" ARRAY_SIZE 2 ECU_ADDRESS 0x8FEEE0 /end MEASUREMENT
/begin MEASUREMENT EGSys_tEGPstTrbn "Abgas-Temperatur nach Turbolader" SWORD Temp_Cels 1 100 -50.140 899.860 FORMAT "%8.3" ECU_ADDRESS 0x7F8C5E /end MEASUREMENT
/begin MEASUREMENT EGSys_tEGPstTube "Abgastemperatur am Abgasrohr-Auslass" SWORD Temp_Cels 1 100 -50.140 899.860 FORMAT "%8.3" ARRAY_SIZE 2 ECU_ADDRESS 0x7F9220 /end MEASUREMENT
/begin MEASUREMENT EGSys_tExcClntStrtCs_mp "Motorübertemperatur bei Motorstart" SWORD TempDiff_Cels 1 100 -3276.800 3276.700 FORMAT "%8.3" ECU_ADDRESS 0x8FEE78 /end MEASUREMENT
/begin MEASUREMENT EGSys_tiClg_mp "Abkühlzeit" ULONG Time_s 1 100 0.00 42949672.9500 FORMAT "%13.4" ECU_ADDRESS 0x8FEE7C /end MEASUREMENT
/begin MEASUREMENT EGSys_tIncrPoI_mp "Temperaturerhöhung im Oxidationskatalysator aufgrund später Nacheinspritzung" SWORD TempDiff_Cels 1 100 -3276.800 3276.700 FORMAT "%8.3" ECU_ADDRESS 0x8FEE66 /end MEASUREMENT
/begin MEASUREMENT EGSys_tiRefClg_mp "Referenz-Abkühlzeit aus Motor-Abkühlung" ULONG Time_s 1 100 0.00 42949672.9500 FORMAT "%13.4" ECU_ADDRESS 0x8FEE80 /end MEASUREMENT
/begin MEASUREMENT EGSys_tMidEGTube_mp "Mittlere Temperatur zwischen Abgas und Abgasrohrwand" SWORD Temp_Cels 1 100 -50.140 899.860 FORMAT "%8.3" ARRAY_SIZE 2 ECU_ADDRESS 0x8FEEE4 /end MEASUREMENT
/begin MEASUREMENT EGSys_tMidTubeEnv_mp "Mittlere Temperatur zwischen Abgasrohr und Umgebung" SWORD Temp_Cels 1 100 -50.140 899.860 FORMAT "%8.3" ARRAY_SIZE 2 ECU_ADDRESS 0x8FEEE8 /end MEASUREMENT
/begin MEASUREMENT EGSys_tNSCStrtCs "Temperatur NSC bei Motorstart" SWORD Temp_Cels 1 100 -50.140 899.860 FORMAT "%8.3" ECU_ADDRESS 0x7F8C64 /end MEASUREMENT
/begin MEASUREMENT EGSys_tOxiCatExoIncr_mp "Temperaturerhöhung im Oxidationskatalysator durch chemische Reaktionen" SWORD TempDiff_Cels 1 100 -3276.800 3276.700 FORMAT "%8.3" ECU_ADDRESS 0x8FEE68 /end MEASUREMENT
/begin MEASUREMENT EGSys_tOxiCatStat_mp "Stationäre Temperatur Oxidationskatalysator" SWORD Temp_Cels 1 100 -50.140 899.860 FORMAT "%8.3" ECU_ADDRESS 0x8FEE6A /end MEASUREMENT
/begin MEASUREMENT EGSys_tOxiCatStrtCs "Temperatur Oxidationskatalysator bei Motorstart" SWORD Temp_Cels 1 100 -50.140 899.860 FORMAT "%8.3" ECU_ADDRESS 0x7F8C68 /end MEASUREMENT
/begin MEASUREMENT EGSys_tTrbStrtCs "Turbocharger Temperatur an Maschinenanfang" SWORD Temp_Cels 1 100 -50.140 899.860 FORMAT "%8.3" ECU_ADDRESS 0x7F8C6A /end MEASUREMENT
/begin MEASUREMENT EGSys_tTube "Wandtemperatur Abgasrohr" SWORD Temp_Cels 1 100 -50.140 899.860 FORMAT "%8.3" ARRAY_SIZE 2 ECU_ADDRESS 0x7F9224 /end MEASUREMENT
/begin MEASUREMENT EGSys_tTubeStrtCs "Temperatur Abgasrohr bei Motorstart" SWORD Temp_Cels 1 100 -50.140 899.860 FORMAT "%8.3" ARRAY_SIZE 2 ECU_ADDRESS 0x7F9228 /end MEASUREMENT
/begin MEASUREMENT EGT_dmO2Aprx_mp "Messpunkt für Kurveneingang" SWORD AirMassPerTime 1 100 -3276.800 3276.700 FORMAT "%8.3" ECU_ADDRESS 0x8FEF50 /end MEASUREMENT
/begin MEASUREMENT EGT_dmOilDilAct_mp "Volumenstrom der aktuellen Ölverdünnung" SWORD OilMassPerTime 1 100 -327.6800 327.6700 FORMAT "%8.4" ECU_ADDRESS 0x8FEEFC /end MEASUREMENT
/begin MEASUREMENT EGT_dmOilDilPoIBas_mp "Basis Volumenstrom für die Ölverdünnung durch Nacheinspritzung" SWORD OilMassPerTime 1 100 -327.6800 327.6700 FORMAT "%8.4" ECU_ADDRESS 0x8FEEFE /end MEASUREMENT
/begin MEASUREMENT EGT_dmOilDilPoICorr_mp "Korrigierter Volumenstrom für die Ölverdünnung durch Nacheinspritzung" SWORD OilMassPerTime 1 100 -327.6800 327.6700 FORMAT "%8.4" ECU_ADDRESS 0x8FEF00 /end MEASUREMENT
/begin MEASUREMENT EGT_dmOilRmvBas_mp "Basisvolumenstrom für die Ölmassenverringerung" SWORD OilMassPerTime 1 100 -327.6800 327.6700 FORMAT "%8.4" ECU_ADDRESS 0x8FEF02 /end MEASUREMENT
/begin MEASUREMENT EGT_dmOilRmvCorr_mp "Korrigierter Volumenstrom für die Ölmassenverringerung" SWORD OilMassPerTime 1 100 -327.6800 327.6700 FORMAT "%8.4" ECU_ADDRESS 0x8FEF04 /end MEASUREMENT
/begin MEASUREMENT EGT_dmOilRmvTempCorr_mp "Durch Öltemperatur korrigierter Volumenstrom zur Verringerung des Ölniveaus" SWORD OilMassPerTime 1 100 -327.6800 327.6700 FORMAT "%8.4" ECU_ADDRESS 0x8FEF06 /end MEASUREMENT
/begin MEASUREMENT EGT_facQntPoI2RmpCur_mp "Messpunkt für Kurveneingang" SWORD EGTSwt_S16 1 100 -2.000000 1.999939 FORMAT "%8.6" ECU_ADDRESS 0x8FEF58 /end MEASUREMENT
/begin MEASUREMENT EGT_facRmpVal "Zentraler Rampenwert (drehzahlsynchron)" SWORD EGTSwt_S16 1 100 -2.000000 1.999939 FORMAT "%8.6" ECU_ADDRESS 0x7F8C6E /end MEASUREMENT
/begin MEASUREMENT EGT_facRmpValTempGvnr_mp "aktueller Rampenwert des EGT Temperaturreglers" ULONG EGTSwt 1 100 0.00 262.143999939 FORMAT "%13.9" ECU_ADDRESS 0x8FEF5C /end MEASUREMENT
/begin MEASUREMENT EGT_facRmp_mp "Rampenwert für Umwandlung 32bit -> 16bit" SWORD EGTSwt_S16 1 100 -2.000000 1.999939 FORMAT "%8.6" ECU_ADDRESS 0x8FEF60 /end MEASUREMENT
/begin MEASUREMENT EGT_mAirDesInrTempGvnr "Additive Luftmassensollwertkorrektur" SWORD AirMassPerCyl 1 100 -3276.800 3276.700 FORMAT "%8.3" ECU_ADDRESS 0x7F8C70 /end MEASUREMENT
/begin MEASUREMENT EGT_mAirDesTempGvnr "Temperaturreglerkorrektur für den Luftmassensollwert" SWORD AirMassPerCyl 1 100 -3276.800 3276.700 FORMAT "%8.3" ECU_ADDRESS 0x7F8C72 /end MEASUREMENT
/begin MEASUREMENT EGT_mAirLmbdTempGvnr_mp "Luftmassenkorrektur durch Lambda" SWORD AirMassPerCyl 1 100 -3276.800 3276.700 FORMAT "%8.3" ECU_ADDRESS 0x8FEF62 /end MEASUREMENT
/begin MEASUREMENT EGT_mAirTempGvnrMin_mp "Minimal mögliche Luftmassensollwertkorrektur" SWORD AirMassPerCyl 1 100 -3276.800 3276.700 FORMAT "%8.3" ECU_ADDRESS 0x8FEF22 /end MEASUREMENT
/begin MEASUREMENT EGT_mAirTempGvnrRng_mp "Korrekturbereich der Luftmassensollwertkorrektur" SWORD AirMassPerCyl 1 100 -3276.800 3276.700 FORMAT "%8.3" ECU_ADDRESS 0x8FEF24 /end MEASUREMENT
/begin MEASUREMENT EGT_mOilDilEng "Verdünnte Ölmasse" SLONG OilMass 1 100 -2147483.64800 2147483.64700 FORMAT "%13.5" ECU_ADDRESS 0x7F922C /end MEASUREMENT
/begin MEASUREMENT EGT_mOilEng "Ölmasse im Motor" SLONG OilMass 1 100 -2147483.64800 2147483.64700 FORMAT "%13.5" ECU_ADDRESS 0x7F9230 /end MEASUREMENT
/begin MEASUREMENT EGT_mOilEngCrvIn_mp "Ölmasse im Motor (verringerte Auflösung)" SWORD OilMassRed 1 100 -134217.7 134213.6 FORMAT "%8.1" ECU_ADDRESS 0x8FEF08 /end MEASUREMENT
/begin MEASUREMENT EGT_mOilEngMax_mp "Maximale Gesamtölmasse im Motor mit Ölverdünnung" SLONG OilMass 1 100 -2147483.64800 2147483.64700 FORMAT "%13.5" ECU_ADDRESS 0x8FEF0C /end MEASUREMENT
/begin MEASUREMENT EGT_mOilEngMin_mp "Minimale Gesamtölmasse im Motor mit Ölverdünnung" SLONG OilMass 1 100 -2147483.64800 2147483.64700 FORMAT "%13.5" ECU_ADDRESS 0x8FEF10 /end MEASUREMENT
/begin MEASUREMENT EGT_mOilEngSens_mp "Ölniveau Sensor Signal" SLONG OilMass 1 100 -2147483.64800 2147483.64700 FORMAT "%13.5" ECU_ADDRESS 0x8FEF14 /end MEASUREMENT
/begin MEASUREMENT EGT_mSot_mp "Messpunkt für Kurveneingang" SWORD mSoot_g 1 100 -327.6800 327.6700 FORMAT "%8.4" ECU_ADDRESS 0x8FEF52 /end MEASUREMENT
/begin MEASUREMENT EGT_phiPoI1TempGvnr "Additive Winkelkorrektur der verzögerten Nacheinspritzung" SWORD AngleCrS 1 100 -768.0000 767.9766 FORMAT "%8.4" ECU_ADDRESS 0x7F8C74 /end MEASUREMENT
/begin MEASUREMENT EGT_qHCTempGvnr "Additive Einpritzmengenkorrektur des HC-Dosierventils" SWORD InjMassInj 1 100 -327.6800 327.6700 FORMAT "%8.4" ECU_ADDRESS 0x7F8C76 /end MEASUREMENT
/begin MEASUREMENT EGT_qPoI1Min_mp "Minimal erlaubte Korrektur der angelagerten Nacheinspritzung" SWORD InjMassInj 1 100 -327.6800 327.6700 FORMAT "%8.4" ECU_ADDRESS 0x8FEF26 /end MEASUREMENT
/begin MEASUREMENT EGT_qPoI1OutrTempGvnr "Additive Korrektur der angelagerten Nacheinspritzung" SWORD InjMassInj 1 100 -327.6800 327.6700 FORMAT "%8.4" ECU_ADDRESS 0x7F8C78 /end MEASUREMENT
/begin MEASUREMENT EGT_qPoI1Outr_mp "Messpunkt für Kurveneingang" SWORD InjMassInj 1 100 -327.6800 327.6700 FORMAT "%8.4" ECU_ADDRESS 0x8FEF64 /end MEASUREMENT
/begin MEASUREMENT EGT_qPoI1Rng_mp "Korrekturbereich der angelagerten Nacheinspritzung" SWORD InjMassInj 1 100 -327.6800 327.6700 FORMAT "%8.4" ECU_ADDRESS 0x8FEF28 /end MEASUREMENT
/begin MEASUREMENT EGT_qPoI1TempGvnr "EGT Temperaturregler PoI1 Menge während einer Regeneration" SWORD InjMassInj 1 100 -327.6800 327.6700 FORMAT "%8.4" ECU_ADDRESS 0x7F8C7A /end MEASUREMENT
/begin MEASUREMENT EGT_qPoI2InrTempGvnr "Additive fortgeschrittene Nacheinspritzmengenkorrektur" SWORD InjMassInj 1 100 -327.6800 327.6700 FORMAT "%8.4" ECU_ADDRESS 0x7F8C7C /end MEASUREMENT
/begin MEASUREMENT EGT_qPoI2Min_mp "Minimal erlaubte Korrekturmenge der angelagerten Nacheinspritzung" SWORD InjMassInj 1 100 -327.6800 327.6700 FORMAT "%8.4" ECU_ADDRESS 0x8FEF2A /end MEASUREMENT
/begin MEASUREMENT EGT_qPoI2Rng_mp "Korrekturbereich der Einpritzmengenkorrektur" SWORD InjMassInj 1 100 -327.6800 327.6700 FORMAT "%8.4" ECU_ADDRESS 0x8FEF2C /end MEASUREMENT
/begin MEASUREMENT EGT_qPoI2TempGvnr "EGT Temperaturreglerkorrektur der angelagerten Nacheinspritzung 2 während einer Partikelfilterregeneration" SWORD InjMassInj 1 100 -327.6800 327.6700 FORMAT "%8.4" ECU_ADDRESS 0x7F8C7E /end MEASUREMENT
/begin MEASUREMENT EGT_rIInrTempGvnr_mp "Reglerausgang des inneren Regelkreises: I-Anteil" SWORD EGTFact 1 100 -32.76800 32.76700 FORMAT "%8.5" ECU_ADDRESS 0x8FEF2E /end MEASUREMENT
/begin MEASUREMENT EGT_rInrTempGvnr_mp "Reglerausgang des inneren Regelkreises" SWORD EGTFact 1 100 -32.76800 32.76700 FORMAT "%8.5" ECU_ADDRESS 0x8FEF30 /end MEASUREMENT
/begin MEASUREMENT EGT_rIOutrTempGvnr_mp "Reglerausgang der äußeren Regelkreises: I-Anteil" SWORD EGTFact 1 100 -32.76800 32.76700 FORMAT "%8.5" ECU_ADDRESS 0x8FEF32 /end MEASUREMENT
/begin MEASUREMENT EGT_rLmbd_mp "Messpunkt für Kurveneingang" SWORD lambda 1 100 -32.76800 32.76700 FORMAT "%8.5" ECU_ADDRESS 0x8FEF66 /end MEASUREMENT
/begin MEASUREMENT EGT_rMaxInrTempGvnr_mp "Maximaler Reglerausgang innerer Regelkreis" SWORD EGTFact 1 100 -32.76800 32.76700 FORMAT "%8.5" ECU_ADDRESS 0x8FEF34 /end MEASUREMENT
/begin MEASUREMENT EGT_rMaxOutrTempGvnr_mp "Maximaler Reglerausgang äußerer Regelkreis" SWORD EGTFact 1 100 -32.76800 32.76700 FORMAT "%8.5" ECU_ADDRESS 0x8FEF36 /end MEASUREMENT
/begin MEASUREMENT EGT_rMinInrTempGvnr_mp "Minimaler Reglerausgang innerer Regelkreis" SWORD EGTFact 1 100 -32.76800 32.76700 FORMAT "%8.5" ECU_ADDRESS 0x8FEF38 /end MEASUREMENT
/begin MEASUREMENT EGT_rMinOutrTempGvnr_mp "Minimaler Reglerausgang äußerer Regelkreis" SWORD EGTFact 1 100 -32.76800 32.76700 FORMAT "%8.5" ECU_ADDRESS 0x8FEF3A /end MEASUREMENT
/begin MEASUREMENT EGT_rOilDilEng "Anteil der Ölmasse durch Ölverdünnung" SWORD OilMassPrc 1 100 -32.76800 32.76700 FORMAT "%8.5" ECU_ADDRESS 0x7F8C80 /end MEASUREMENT
/begin MEASUREMENT EGT_rOilDilEngMsOilMax_mp "Anteil der Ölverdünnung bei maximaler Gesamtölmasse im Motor" SWORD OilMassPrc 1 100 -32.76800 32.76700 FORMAT "%8.5" ECU_ADDRESS 0x8FEF18 /end MEASUREMENT
/begin MEASUREMENT EGT_rOilDilEngMsOilMin_mp "Anteil der Ölverdünnung bei minimaler Gesamtölmasse im Motor" SWORD OilMassPrc 1 100 -32.76800 32.76700 FORMAT "%8.5" ECU_ADDRESS 0x8FEF1A /end MEASUREMENT
/begin MEASUREMENT EGT_rOutrTempGvnr_mp "Regelerausgang des äußeren Regelkreises" SWORD EGTFact 1 100 -32.76800 32.76700 FORMAT "%8.5" ECU_ADDRESS 0x8FEF3C /end MEASUREMENT
/begin MEASUREMENT EGT_rPInrTempGvnr_mp "Regelerausgnag des inneren Regelkreises: P-Anteil" SWORD EGTFact 1 100 -32.76800 32.76700 FORMAT "%8.5" ECU_ADDRESS 0x8FEF3E /end MEASUREMENT
/begin MEASUREMENT EGT_rPOutrTempGvnr_mp "Reglerausgang des äußeren Regelkreises: P-Anteil" SWORD EGTFact 1 100 -32.76800 32.76700 FORMAT "%8.5" ECU_ADDRESS 0x8FEF40 /end MEASUREMENT
/begin MEASUREMENT EGT_rStyInrTempGvnr_mp "Modellierten stationärer Reglerausgang des inneren Regelkreises" SWORD EGTFact 1 100 -32.76800 32.76700 FORMAT "%8.5" ECU_ADDRESS 0x8FEF42 /end MEASUREMENT
/begin MEASUREMENT EGT_rStyOutrTempGvnr_mp "Modellierter stationärer Reglerausgang des äußeren Regelkreises" SWORD EGTFact 1 100 -32.76800 32.76700 FORMAT "%8.5" ECU_ADDRESS 0x8FEF44 /end MEASUREMENT
/begin MEASUREMENT EGT_st "Regenerationsanforderung für Abgasnachbehandlung (drehzahlsynchron)" ULONG OneToOne 1 100 0.00 4294967295.00 FORMAT "%13.2" ECU_ADDRESS 0x7F9234 /end MEASUREMENT
/begin MEASUREMENT EGT_stClsThrVlv_mp "Maximale Androsselung aktiv" UBYTE OneToOne 1 100 0.00 255.0 FORMAT "%5.1" ECU_ADDRESS 0x8FEF46 /end MEASUREMENT
/begin MEASUREMENT EGT_stCoRgn "Innerer Zustand des Regenerationskoordinator (drehzahlsynchron)" UBYTE OneToOne 1 100 0.00 255.0 FORMAT "%5.1" ECU_ADDRESS 0x7F8878 /end MEASUREMENT
/begin MEASUREMENT EGT_stCoRgnOld_mp "Alter Wert für den inneren Zustand des Regenerationkoordinators" UBYTE OneToOne 1 100 0.00 255.0 FORMAT "%5.1" ECU_ADDRESS 0x8FEEEC /end MEASUREMENT
/begin MEASUREMENT EGT_stCoRgnTSync "Innerer Zustand des Regenerationskoordinator (zeitsynchron)" UBYTE OneToOne 1 100 0.00 255.0 FORMAT "%5.1" ECU_ADDRESS 0x7F8879 /end MEASUREMENT
/begin MEASUREMENT EGT_stDel "Verzögerte Regenerationsanforderung für Abgasnachbehandlung (drehzahl synchron)" UBYTE OneToOne 1 100 0.00 255.0 FORMAT "%5.1" ECU_ADDRESS 0x7F9238 /end MEASUREMENT
/begin MEASUREMENT EGT_stLck "Status EGT_stTSync-Kopiervorgang (drehzahlsynchron)" UBYTE OneToOne 1 100 0.00 255.0 FORMAT "%5.1" ECU_ADDRESS 0x7F887A /end MEASUREMENT
/begin MEASUREMENT EGT_stMsOilSensVld_mp "Status der Gültigkeitsbedingung für die Übernahme der Gesamtölmasse im Motor vom Ölstandssensor" UBYTE OneToOne 1 100 0.00 255.0 FORMAT "%5.1" ECU_ADDRESS 0x8FEF1C /end MEASUREMENT
/begin MEASUREMENT EGT_stOilEng "Status des Motorenöls" ULONG OneToOne 1 100 0.00 4294967295.00 FORMAT "%13.2" ECU_ADDRESS 0x7F923C /end MEASUREMENT
/begin MEASUREMENT EGT_stOilLayer "Status des Ölvolumens welches an den Layer gesendet wird" ULONG OneToOne 1 100 0.00 4294967295.00 FORMAT "%13.2" ECU_ADDRESS 0x7F9240 /end MEASUREMENT
/begin MEASUREMENT EGT_stRgnOilDilAct_mp "Status für Regenerationsmassnahmen mit Ölverdünnung" UBYTE OneToOne 1 100 0.00 255.0 FORMAT "%5.1" ECU_ADDRESS 0x8FEF1D /end MEASUREMENT
/begin MEASUREMENT EGT_stRgnOilDil_mp "Status Bit Bedingungen erfüllt für Ölverdünnung" UBYTE OneToOne 1 100 0.00 255.0 FORMAT "%5.1" ECU_ADDRESS 0x8FEEED /end MEASUREMENT
/begin MEASUREMENT EGT_stTempGvnr "Status des Abgastemperaturreglers" UWORD OneToOne 1 100 0.00 65535.00 FORMAT "%8.2" ECU_ADDRESS 0x7F8C82 /end MEASUREMENT
/begin MEASUREMENT EGT_stTSync "Regenerationsanforderung für Abgasnachbehandlung (zeitsynchron)" ULONG OneToOne 1 100 0.00 4294967295.00 FORMAT "%13.2" ECU_ADDRESS 0x7F9244 /end MEASUREMENT
/begin MEASUREMENT EGT_stTSyncDes_mp "Regeneration demand for exhaust gas treatment for state machine" ULONG OneToOne 1 100 0.00 4294967295.00 FORMAT "%13.2" ECU_ADDRESS 0x8FEEF0 /end MEASUREMENT
/begin MEASUREMENT EGT_stTSyncLck "Status Kopieren der Regenerationsanforderung (zeit-synchron)" UBYTE OneToOne 1 100 0.00 255.0 FORMAT "%5.1" ECU_ADDRESS 0x7F887B /end MEASUREMENT
/begin MEASUREMENT EGT_swtEGTActv "Message zur Deaktivierung der gesamten Funktionalität der Abgasnachbehandlung" UBYTE OneToOne 1 100 0.00 255.0 FORMAT "%5.1" ECU_ADDRESS 0x7F887C /end MEASUREMENT
/begin MEASUREMENT EGT_swtRgnLck_mp "Schalter zur Unterdrückung der Regenerationsmaßnahmen" UBYTE OneToOne 1 100 0.00 255.0 FORMAT "%5.1" ECU_ADDRESS 0x8FEEF4 /end MEASUREMENT
/begin MEASUREMENT EGT_tEng_mp "Motortemperatur aus Motortemperaturarray" SWORD Temp_Cels 1 100 -50.140 899.860 FORMAT "%8.3" ECU_ADDRESS 0x8FEF1E /end MEASUREMENT
/begin MEASUREMENT EGT_tInrCorMax_mp "Maximal erlaubte Korrektur des inneren Regelkreises" SWORD TempDiff_Cels 1 100 -3276.800 3276.700 FORMAT "%8.3" ECU_ADDRESS 0x8FEF48 /end MEASUREMENT
/begin MEASUREMENT EGT_tInrCorRng_mp "Korrekturbereich der Sollwertkorrektur des inneren Regelkreises" SWORD TempDiff_Cels 1 100 -3276.800 3276.700 FORMAT "%8.3" ECU_ADDRESS 0x8FEF4A /end MEASUREMENT
/begin MEASUREMENT EGT_tInrDesCorTempGvnr "Solllwertkorrektur der inneren Kaskade" SWORD TempDiff_Cels 1 100 -3276.800 3276.700 FORMAT "%8.3" ECU_ADDRESS 0x7F8C84 /end MEASUREMENT
/begin MEASUREMENT EGT_tInrDesTempGvnr "Sollwert für den inneren Abgastemperaturregelkreis" SWORD Temp_Cels 1 100 -50.140 899.860 FORMAT "%8.3" ECU_ADDRESS 0x7F8C88 /end MEASUREMENT
/begin MEASUREMENT EGT_tInrDvtTempGvnr "Regelabweichung innerer Regelkreis" SWORD TempDiff_Cels 1 100 -3276.800 3276.700 FORMAT "%8.3" ECU_ADDRESS 0x7F8C8A /end MEASUREMENT
/begin MEASUREMENT EGT_tInrTempGvnr "Aktueller Wert des inneren Abgastemperaturreglers" SWORD Temp_Cels 1 100 -50.140 899.860 FORMAT "%8.3" ECU_ADDRESS 0x7F8C8C /end MEASUREMENT
/begin MEASUREMENT EGT_tiPoI1ActvCnt_mp "Wartezeit aktive PoI1" ULONG Time_s 1 100 0.00 42949672.9500 FORMAT "%13.4" ECU_ADDRESS 0x8FEF4C /end MEASUREMENT
/begin MEASUREMENT EGT_tiPoI2TempGvnr "Additive Einspritzzeitkorrektur" SWORD InjTime_us 1 100 -32768.00 32767.00 FORMAT "%8.2" ECU_ADDRESS 0x7F8C96 /end MEASUREMENT
/begin MEASUREMENT EGT_tiRgn "Zeit seit letzter Änderung von EGT_st (drehzahlsynchron)" ULONG Time_s 1 100 0.00 42949672.9500 FORMAT "%13.4" ECU_ADDRESS 0x7F9248 /end MEASUREMENT
/begin MEASUREMENT EGT_tiRgnOilDil "Kritische Zeit für Ölverdünnung" ULONG Time_s 1 100 0.00 42949672.9500 FORMAT "%13.4" ECU_ADDRESS 0x7F924C /end MEASUREMENT
/begin MEASUREMENT EGT_tiRgnTSync "Zeit seit letzter Änderung von EGT_st (zeitsynchron)" ULONG Time_s 1 100 0.00 42949672.9500 FORMAT "%13.4" ECU_ADDRESS 0x7F9250 /end MEASUREMENT
/begin MEASUREMENT EGT_tiRgnTSyncPre_mp "Gesamtzeit seit letzter EGT-Statusänderung" ULONG Time_s 1 100 0.00 42949672.9500 FORMAT "%13.4" ECU_ADDRESS 0x8FEEF8 /end MEASUREMENT
/begin MEASUREMENT EGT_tiRmpSlpMax "Maximale Rampenlaufzeit für EGT-Mehrfachschalter" ULONG TimeEGTRmp 1 100 0.000000015258789066052715 65.536000000000001 FORMAT "%19.16" ECU_ADDRESS 0x7F9254 /end MEASUREMENT
/begin MEASUREMENT EGT_tiSrvRgnIn_mp "Timer - Wert für das Kennfeld EGT_tSrvRgn_CUR mit verringerter Auflösung (1 Sekunde)" SWORD TimeOneToOne 1 100 -32768.00 32767.00 FORMAT "%8.2" ECU_ADDRESS 0x8FEF68 /end MEASUREMENT
/begin MEASUREMENT EGT_tOil_mp "Öltemperatur aus dem Öltemperaturarray" SWORD Temp_Cels 1 100 -50.140 899.860 FORMAT "%8.3" ECU_ADDRESS 0x8FEF20 /end MEASUREMENT
/begin MEASUREMENT EGT_tOutrDesTempGvnr "Sollwert des äußeren Abgastemperaturregelkreises" SWORD Temp_Cels 1 100 -50.140 899.860 FORMAT "%8.3" ECU_ADDRESS 0x7F8C90 /end MEASUREMENT
/begin MEASUREMENT EGT_tOutrDvtTempGvnr "Regelabweichung äußerer Regelkreis" SWORD TempDiff_Cels 1 100 -3276.800 3276.700 FORMAT "%8.3" ECU_ADDRESS 0x7F8C92 /end MEASUREMENT
/begin MEASUREMENT EGT_tOutrTempGvnr "Aktueller Wert des äußeren Abgastemperaturregelkreises" SWORD Temp_Cels 1 100 -50.140 899.860 FORMAT "%8.3" ECU_ADDRESS 0x7F8C94 /end MEASUREMENT
/begin MEASUREMENT EGT_tOxiPst_mp "Messpunkt für Kurveneingang" SWORD Temp_Cels 1 100 -50.140 899.860 FORMAT "%8.3" ECU_ADDRESS 0x8FEF54 /end MEASUREMENT
/begin MEASUREMENT EGT_tTurbPre_mp "Messpunkt für Kurveneingang" SWORD Temp_Cels 1 100 -50.140 899.860 FORMAT "%8.3" ECU_ADDRESS 0x8FEF56 /end MEASUREMENT
/begin MEASUREMENT EGT_volOilDilEng "Volumen der Verdünnten Ölmasse" UWORD Vol_Oil 1 100 0.00 655.3500 FORMAT "%8.4" ECU_ADDRESS 0x7F8C98 /end MEASUREMENT
/begin MEASUREMENT EMCCD_dcycCurrOff1_mp "Ausgang des Tastverhältnisses bei Strom AUS der EMCCD1-PWM-Endstufe bei der Strom-Regellogik" SWORD DtyCyc 1 100 -327.6800 327.6700 FORMAT "%8.4" ECU_ADDRESS 0x8FEF6A /end MEASUREMENT
/begin MEASUREMENT EMCCD_dcycCurrOff2_mp "Ausgang des Tastverhältnisses bei Strom AUS der EMCCD2-PWM-Endstufe bei der Strom-Regellogik" SWORD DtyCyc 1 100 -327.6800 327.6700 FORMAT "%8.4" ECU_ADDRESS 0x8FEF6C /end MEASUREMENT
/begin MEASUREMENT EMCCD_dcycCurrOn1_mp "Ausgang des Tastverhältnisses bei Strom EIN der EMCCD1-PWM-Endstufe bei der Strom-Regellogik" SWORD DtyCyc 1 100 -327.6800 327.6700 FORMAT "%8.4" ECU_ADDRESS 0x8FEF6E /end MEASUREMENT
/begin MEASUREMENT EMCCD_dcycCurrOn2_mp "Ausgang des Tastverhältnisses bei Strom EIN der EMCCD2-PWM-Endstufe bei der Strom-Regellogik" SWORD DtyCyc 1 100 -327.6800 327.6700 FORMAT "%8.4" ECU_ADDRESS 0x8FEF70 /end MEASUREMENT
/begin MEASUREMENT EMCCD_dcycMntCtlOut1_mp "Ausgang des Tastverhältnisses nach Begrenzung der EMCCD1-PWM-Endstufe bei der Strom-Regellogik" SWORD DtyCyc 1 100 -327.6800 327.6700 FORMAT "%8.4" ECU_ADDRESS 0x8FEF72 /end MEASUREMENT
/begin MEASUREMENT EMCCD_dcycMntCtlOut2_mp "Ausgang des Tastverhältnisses nach Begrenzung der EMCCD2-PWM-Endstufe bei der Strom-Regellogik" SWORD DtyCyc 1 100 -327.6800 327.6700 FORMAT "%8.4" ECU_ADDRESS 0x8FEF74 /end MEASUREMENT
/begin MEASUREMENT EMCCD_dcycMntCtlOutOld1_mp "" SWORD DtyCyc 1 100 -327.6800 327.6700 FORMAT "%8.4" ECU_ADDRESS 0x8FEF76 /end MEASUREMENT
/begin MEASUREMENT EMCCD_dcycMntCtlOutOld2_mp "" SWORD DtyCyc 1 100 -327.6800 327.6700 FORMAT "%8.4" ECU_ADDRESS 0x8FEF78 /end MEASUREMENT
/begin MEASUREMENT EMCCD_dcycOut1_mp "Ausgang des Tastverhältnisses ohne Begrenzung der EMCCD1-PWM-Endstufe bei der Strom-Regellogik" SWORD DtyCyc 1 100 -327.6800 327.6700 FORMAT "%8.4" ECU_ADDRESS 0x8FEF7A /end MEASUREMENT
/begin MEASUREMENT EMCCD_dcycOut2_mp "Ausgang des Tastverhältnisses ohne Begrenzung der EMCCD2-PWM-Endstufe bei der Strom-Regellogik" SWORD DtyCyc 1 100 -327.6800 327.6700 FORMAT "%8.4" ECU_ADDRESS 0x8FEF7C /end MEASUREMENT
/begin MEASUREMENT EMCCD_iActVal1 "An EMCCD1-PWM-Endstufe gemessener Strom bei der Strom-Regellogik" SWORD Curr 1 100 -32768.00 32767.00 FORMAT "%8.2" ECU_ADDRESS 0x7F8C9A /end MEASUREMENT
/begin MEASUREMENT EMCCD_iActVal2 "An EMCCD2-PWM-Endstufe gemessener Strom bei der Strom-Regellogik" SWORD Curr 1 100 -32768.00 32767.00 FORMAT "%8.2" ECU_ADDRESS 0x7F8C9C /end MEASUREMENT
/begin MEASUREMENT EMCCD_iActValFlt1_mp "An EMCCD1-PWM-Endstufe gemessener gefilterter Strom bei der Strom-Regellogik" SWORD Curr 1 100 -32768.00 32767.00 FORMAT "%8.2" ECU_ADDRESS 0x8FEF7E /end MEASUREMENT
/begin MEASUREMENT EMCCD_iActValFlt2_mp "An EMCCD2-PWM-Endstufe gemessener gefilterter Strom bei der Strom-Regellogik" SWORD Curr 1 100 -32768.00 32767.00 FORMAT "%8.2" ECU_ADDRESS 0x8FEF80 /end MEASUREMENT
/begin MEASUREMENT EMCCD_resAct1 "Widerstand bei der EMCCD1-PWM-Endstufe bei der Strom-Regellogik" SWORD Resist 1 100 -3276.800 3276.700 FORMAT "%8.3" ECU_ADDRESS 0x7F8C9E /end MEASUREMENT
/begin MEASUREMENT EMCCD_resAct2 "An EMCCD2-PWM-Endstufe gemessener Strom bei der Strom-Regellogik" SWORD Resist 1 100 -3276.800 3276.700 FORMAT "%8.3" ECU_ADDRESS 0x7F8CA0 /end MEASUREMENT
/begin MEASUREMENT EMCCD_rHWE1_mp "Ausgang des Tastverhälnisses der EMCCD1-PWD-Endstufe" SWORD DtyCyc 1 100 -327.6800 327.6700 FORMAT "%8.4" ECU_ADDRESS 0x8FEF82 /end MEASUREMENT
/begin MEASUREMENT EMCCD_rHWE2_mp "Ausgang des Tastverhälnisses der EMCCD2-PWD-Endstufe" SWORD DtyCyc 1 100 -327.6800 327.6700 FORMAT "%8.4" ECU_ADDRESS 0x8FEF84 /end MEASUREMENT
/begin MEASUREMENT EMCCD_stOut_mp "Feststellung, ob im Start- oder Haltestromzustand" UBYTE OneToOne 1 100 0.00 255.0 FORMAT "%5.1" ECU_ADDRESS 0x8FEF86 /end MEASUREMENT
/begin MEASUREMENT EMCCD_uDtyCyc1_mp "" SWORD Volt_Batt 1 100 -640625.6 640606.1 FORMAT "%8.1" ECU_ADDRESS 0x8FEF88 /end MEASUREMENT
/begin MEASUREMENT EMCCD_uDtyCyc2_mp "" SWORD Volt_Batt 1 100 -640625.6 640606.1 FORMAT "%8.1" ECU_ADDRESS 0x8FEF8A /end MEASUREMENT
/begin MEASUREMENT EMCCD_uRawActVal1_mp "Bei der EMCCD1-PWM-Endstufe gemessener Spannungsrohwert bei Strom-Regellogik" SWORD Volt 1 100 -160156.4 160151.5 FORMAT "%8.1" ECU_ADDRESS 0x8FEF8C /end MEASUREMENT
/begin MEASUREMENT EMCCD_uRawActVal2_mp "Bei der EMCCD2-PWM-Endstufe gemessener Spannungsrohwert bei Strom-Regellogik" SWORD Volt 1 100 -160156.4 160151.5 FORMAT "%8.1" ECU_ADDRESS 0x8FEF8E /end MEASUREMENT
/begin MEASUREMENT EngMon_stShOffIrrCmb "Abschaltbotschaft an Abschaltkoordinator auf Grund irregulärer Verbrennung" UBYTE OneToOne 1 100 0.00 255.0 FORMAT "%5.1" ECU_ADDRESS 0x7F8895 /end MEASUREMENT
/begin MEASUREMENT EngM_ctFrstInj_mp "Anzahl der nachgeholten Interruptions MAIN / PILOT für Startsfunktion." UBYTE OneToOne 1 100 0.00 255.0 FORMAT "%5.1" ECU_ADDRESS 0x8FEF92 /end MEASUREMENT
/begin MEASUREMENT EngM_ctIncErrSigDiagCaSDef_mp "Inkrementezaehlerstand zur Erkennung gestörtes Nockenwellensignal" UWORD OneToOne 1 100 0.00 65535.00 FORMAT "%8.2" ECU_ADDRESS 0x8FEFAE /end MEASUREMENT
/begin MEASUREMENT EngM_ctIncErrSigDiagCaSOk_mp "Inkrementezaehlerstand zur Erkennung gestörtes Nockenwellensignal geheilt" UWORD OneToOne 1 100 0.00 65535.00 FORMAT "%8.2" ECU_ADDRESS 0x8FEFB0 /end MEASUREMENT
/begin MEASUREMENT EngM_ctIncErrSigDiagCrSDef_mp "Inkrementezaehlerstand zur Erkennung eines gestörten Kurbelwellensignal" UWORD OneToOne 1 100 0.00 65535.00 FORMAT "%8.2" ECU_ADDRESS 0x8FEFB2 /end MEASUREMENT
/begin MEASUREMENT EngM_ctIncErrSigDiagCrSOK_mp "Inkrementezaehlerstand zur Erkennung Kurbelwellensignal ohne Störungen" UWORD OneToOne 1 100 0.00 65535.00 FORMAT "%8.2" ECU_ADDRESS 0x8FEFB4 /end MEASUREMENT
/begin MEASUREMENT EngM_ctIncErrSigDiagmaxCaSDef_mp "maximaler Inkrementezaehlerstand bei Erkennung gestörtes Nockenwellensignal" UWORD OneToOne 1 100 0.00 65535.00 FORMAT "%8.2" ECU_ADDRESS 0x8FEFB6 /end MEASUREMENT
/begin MEASUREMENT EngM_ctIncErrSigDiagmaxCaSOk_mp "maximaler Inkrementezaehlerstand bei Erkennung gestörtes Nockenwellensignal geheilt" UWORD OneToOne 1 100 0.00 65535.00 FORMAT "%8.2" ECU_ADDRESS 0x8FEFB8 /end MEASUREMENT
/begin MEASUREMENT EngM_ctIncErrSigDiagmaxCrSDef_mp "maximeler Inkrementezaehlerstand bei Erkennung gestörtes Kurbelwellensignal" UWORD OneToOne 1 100 0.00 65535.00 FORMAT "%8.2" ECU_ADDRESS 0x8FEFBA /end MEASUREMENT
/begin MEASUREMENT EngM_ctIncNoSigDiagCaS_mp "Inkrementezaehlerstand zur Erkennung ausgefallenes Nockenwellensignal" UWORD OneToOne 1 100 0.00 65535.00 FORMAT "%8.2" ECU_ADDRESS 0x8FEFBC /end MEASUREMENT
/begin MEASUREMENT EngM_ctIncNoSigDiagmaxCaS_mp "maximaler Inkrementezaehlerstand bei Erkennung ausgefallenes Nockenwellensignal" UWORD OneToOne 1 100 0.00 65535.00 FORMAT "%8.2" ECU_ADDRESS 0x8FEFBE /end MEASUREMENT
/begin MEASUREMENT EngM_ctIntOvrLoad_mp "Anzahl der statischen Interrupts, bei denen der zeitliche Abstand zu kurz ist" UBYTE OneToOne 1 100 0.00 255.0 FORMAT "%5.1" ECU_ADDRESS 0x8FEF93 /end MEASUREMENT
/begin MEASUREMENT EngM_ctPhErrSigDiagCrSDef_mp "Anzahl Nockenwellenzaehne zur Erkennung eines gestörten Kurbelwellensignal" UWORD OneToOne 1 100 0.00 65535.00 FORMAT "%8.2" ECU_ADDRESS 0x8FEFC0 /end MEASUREMENT
/begin MEASUREMENT EngM_ctPhErrSigDiagmaxCrSDef_mp "maximale Anzahl Nockenwellenzaehne bei Erkennung ausgefallenes Kurbelwellensignal" UWORD OneToOne 1 100 0.00 65535.00 FORMAT "%8.2" ECU_ADDRESS 0x8FEFC2 /end MEASUREMENT
/begin MEASUREMENT EngM_ctPostSync_mp "Interruptzähler im State EngM_stSync = 64 (Post-Synchron)" UBYTE OneToOne 1 100 0.00 255.0 FORMAT "%5.1" ECU_ADDRESS 0x8FEF94 /end MEASUREMENT
/begin MEASUREMENT EngM_ctReSync "Resynchronisationszähler, wird bei jeder Resynchronisation inkrementiert" UBYTE OneToOne 1 100 0.00 255.0 FORMAT "%5.1" ECU_ADDRESS 0x7F8880 /end MEASUREMENT
/begin MEASUREMENT EngM_ctRevIni "Umdrehzungszaehler seit Initialisierung" SWORD OneToOne 1 100 -32768.00 32767.00 FORMAT "%8.2" ECU_ADDRESS 0x7F8CAC /end MEASUREMENT
/begin MEASUREMENT EngM_ctRevSta "Umdrehungszaehler seit Startabwurf" SWORD OneToOne 1 100 -32768.00 32767.00 FORMAT "%8.2" ECU_ADDRESS 0x7F8CAE /end MEASUREMENT
/begin MEASUREMENT EngM_ctSpdtoZero_mp "Zähler Timeoutinterrupts bis Motordrehzahl  = Null" ULONG OneToOne 1 100 0.00 4294967295.00 FORMAT "%13.2" ECU_ADDRESS 0x8FEFC4 /end MEASUREMENT
/begin MEASUREMENT EngM_ctVerSync_mp "Verif.zähler der Sync; Anzahl der MAIN, PILOT, UPDATE, SEGMENT Interrupts zur Plaus. der NW mit der KW" UBYTE OneToOne 1 100 0.00 255.0 FORMAT "%5.1" ECU_ADDRESS 0x8FEF95 /end MEASUREMENT
/begin MEASUREMENT EngM_nAvrg "Mittlere Motordrehzahl." SWORD EngN 1 100 -32768.00 32767.00 FORMAT "%8.2" ECU_ADDRESS 0x7F8CB0 /end MEASUREMENT
/begin MEASUREMENT EngM_nAvrgHysHigh_mp "engine speed hysteresis higher limit" SWORD EngN 1 100 -32768.00 32767.00 FORMAT "%8.2" ECU_ADDRESS 0x8FEFCA /end MEASUREMENT
/begin MEASUREMENT EngM_nAvrgHysLow_mp "engine speed hysteresis lower limit" SWORD EngN 1 100 -32768.00 32767.00 FORMAT "%8.2" ECU_ADDRESS 0x8FEFCC /end MEASUREMENT
/begin MEASUREMENT EngM_nCurr "Aktuelle Motordrehzahl" SWORD EngN 1 100 -32768.00 32767.00 FORMAT "%8.2" ECU_ADDRESS 0x7F8CB2 /end MEASUREMENT
/begin MEASUREMENT EngM_nDyn "dynamische Drehzahl" SWORD EngN 1 100 -32768.00 32767.00 FORMAT "%8.2" ECU_ADDRESS 0x7F8CB4 /end MEASUREMENT
/begin MEASUREMENT EngM_nLISetDiff_mp "Betrag Leerlaufreglerabweichung" SWORD EngN 1 100 -32768.00 32767.00 FORMAT "%8.2" ECU_ADDRESS 0x8FEFDC /end MEASUREMENT
/begin MEASUREMENT EngM_numCyl "Zylinderanzahl" UBYTE OneToOne 1 100 0.00 255.0 FORMAT "%5.1" ECU_ADDRESS 0x7F8881 /end MEASUREMENT
/begin MEASUREMENT EngM_numInt "Interreupt-Klasse" UBYTE OneToOne 1 100 0.00 255.0 FORMAT "%5.1" ECU_ADDRESS 0x7F8883 /end MEASUREMENT
/begin MEASUREMENT EngM_numLastTDC "Vorhergehender Zünd-OT" UBYTE OneToOne 1 100 0.00 255.0 FORMAT "%5.1" ECU_ADDRESS 0x7F8884 /end MEASUREMENT
/begin MEASUREMENT EngM_numRevCnt "Zähler der Kurbelwellenumdrehungen" UWORD OneToOne 1 100 0.00 65535.00 FORMAT "%8.2" ECU_ADDRESS 0x7F8CB6 /end MEASUREMENT
/begin MEASUREMENT EngM_numSyncTDC "Zylindernummer an dem die Synchronisation erkannt wurde" UBYTE OneToOne 1 100 0.00 255.0 FORMAT "%5.1" ECU_ADDRESS 0x7F8885 /end MEASUREMENT
/begin MEASUREMENT EngM_numTDC "Aktueller Zünd-OT" UBYTE OneToOne 1 100 0.00 255.0 FORMAT "%5.1" ECU_ADDRESS 0x7F8886 /end MEASUREMENT
/begin MEASUREMENT EngM_numTimeout_mp "Beschränkungszähler für TimeOut Interrupt" SBYTE OneToOne 1 100 -128.0 127.0 FORMAT "%5.1" ECU_ADDRESS 0x8FEF96 /end MEASUREMENT
/begin MEASUREMENT EngM_phiDiffTDC "Winkel zwischen TDC1 und dem in der Zündreihenfolge nächsten TDC auf diesem Steuergerät" SWORD AngleCrS 1 100 -768.0000 767.9766 FORMAT "%8.4" ECU_ADDRESS 0x7F8CB8 /end MEASUREMENT
/begin MEASUREMENT EngM_phiInt "aktuelle Interrupt-Position" SWORD AngleCrS 1 100 -768.0000 767.9766 FORMAT "%8.4" ECU_ADDRESS 0x7F8CBA /end MEASUREMENT
/begin MEASUREMENT EngM_phiIntExt "aktuelle Interrupt-Position, extern vom Master zum Slave über CAN" SWORD AngleCrS 1 100 -768.0000 767.9766 FORMAT "%8.4" ECU_ADDRESS 0x7F8CBC /end MEASUREMENT
/begin MEASUREMENT EngM_phiIntExtCorr_mp "aktuelle Winkelposition an der Masterseite nach der Korrektur im Slave-Steuergerät" SWORD AngleCrS 1 100 -768.0000 767.9766 FORMAT "%8.4" ECU_ADDRESS 0x8FEF98 /end MEASUREMENT
/begin MEASUREMENT EngM_phiTDC "OT-Position der aktuellen Zumessung" SWORD AngleCrS 1 100 -768.0000 767.9766 FORMAT "%8.4" ECU_ADDRESS 0x7F8CC0 /end MEASUREMENT
/begin MEASUREMENT EngM_rCurrProf_mp "Prozess EngM_EngMntCtl" SWORD DtyCyc 1 100 -327.6800 327.6700 FORMAT "%8.4" ECU_ADDRESS 0x8FEFCE /end MEASUREMENT
/begin MEASUREMENT EngM_SchedDelta_mp "Sprungweite in der Schedule-Tabelle" UBYTE OneToOne 1 100 0.00 255.0 FORMAT "%5.1" ECU_ADDRESS 0x8FEF9A /end MEASUREMENT
/begin MEASUREMENT EngM_SchedIndex_mp "Anzahl der abgearbeiteten Anweisungen der Schedule-Sequenz" UBYTE OneToOne 1 100 0.00 255.0 FORMAT "%5.1" ECU_ADDRESS 0x8FEF9B /end MEASUREMENT
/begin MEASUREMENT EngM_SchedLimitInt_mp "Nummer des Abschrankintervalls" UBYTE OneToOne 1 100 0.00 255.0 FORMAT "%5.1" ECU_ADDRESS 0x8FEF9C /end MEASUREMENT
/begin MEASUREMENT EngM_SchedSegID_mp "Nummer des Segments vor dem Interrupt" UBYTE OneToOne 1 100 0.00 255.0 FORMAT "%5.1" ECU_ADDRESS 0x8FEF9D /end MEASUREMENT
/begin MEASUREMENT EngM_stAdpt "Zustand Reibmomentenadaption" UBYTE OneToOne 1 100 0.00 255.0 FORMAT "%5.1" ECU_ADDRESS 0x7F8887 /end MEASUREMENT
/begin MEASUREMENT EngM_stCaSDrvOk "NW-Signalqualität der letzten NW- Umdrehung" UBYTE OneToOne 1 100 0.00 255.0 FORMAT "%5.1" ECU_ADDRESS 0x7F8888 /end MEASUREMENT
/begin MEASUREMENT EngM_stCaSExt "Statusinformation CaSCD_stPhaseSig_mp vom Mastersteuergeraet über CAN" UWORD OneToOne 1 100 0.00 65535.00 FORMAT "%8.2" ECU_ADDRESS 0x7F8CC2 /end MEASUREMENT
/begin MEASUREMENT EngM_stCaSVerifyDiag "Statusinformation der Diagnose aus den VERIFY Zustand" UBYTE OneToOne 1 100 0.00 255.0 FORMAT "%5.1" ECU_ADDRESS 0x7F8889 /end MEASUREMENT
/begin MEASUREMENT EngM_stEngMntCtl_mp "status of error bit values" UBYTE OneToOne 1 100 0.00 255.0 FORMAT "%5.1" ECU_ADDRESS 0x8FEFD0 /end MEASUREMENT
/begin MEASUREMENT EngM_stErrCanExt "CAN-Errorstatus der Botschaft MS_PHI_SNYC extern vom Master mit: EngM_phiIntExt, EngM_stNextExt" UBYTE OneToOne 1 100 0.00 255.0 FORMAT "%5.1" ECU_ADDRESS 0x7F888A /end MEASUREMENT
/begin MEASUREMENT EngM_stEvent "Interruptereignis" UBYTE OneToOne 1 100 0.00 255.0 FORMAT "%5.1" ECU_ADDRESS 0x7F888B /end MEASUREMENT
/begin MEASUREMENT EngM_stEventEnable_mp "n-synchrone Interrupts freigegeben" UWORD OneToOne 1 100 0.00 65535.00 FORMAT "%8.2" ECU_ADDRESS 0x8FEF9E /end MEASUREMENT
/begin MEASUREMENT EngM_stEventServed_mp "Aktuell bediente Interrupts" UWORD OneToOne 1 100 0.00 65535.00 FORMAT "%8.2" ECU_ADDRESS 0x8FEFA0 /end MEASUREMENT
/begin MEASUREMENT EngM_stFrstInj_mp "Status der ersten Einspritzung" UBYTE OneToOne 1 100 0.00 255.0 FORMAT "%5.1" ECU_ADDRESS 0x8FEFA2 /end MEASUREMENT
/begin MEASUREMENT EngM_stGbxRel_mp "Status Freigabebedingung: Antriebsstrang offen" UBYTE OneToOne 1 100 0.00 255.0 FORMAT "%5.1" ECU_ADDRESS 0x8FEFDE /end MEASUREMENT
/begin MEASUREMENT EngM_stGenRel_mp "Status generelle Freigabebedingungen für Reibmomentenadaption" UBYTE OneToOne 1 100 0.00 255.0 FORMAT "%5.1" ECU_ADDRESS 0x8FEFDF /end MEASUREMENT
/begin MEASUREMENT EngM_stInjCharSetVal "Zeigt den Zustand der erlaubten Einspritzungen" UBYTE OneToOne 1 100 0.00 255.0 FORMAT "%5.1" ECU_ADDRESS 0x7F888C /end MEASUREMENT
/begin MEASUREMENT EngM_stInjRls "Freigabe der Einspritzung vom Modul EngM" UBYTE OneToOne 1 100 0.00 255.0 FORMAT "%5.1" ECU_ADDRESS 0x7F888D /end MEASUREMENT
/begin MEASUREMENT EngM_stNDiffRng_mp "Status Leerlaufreglerabweichung innerhalb zulässiger Schwellwerte" UBYTE OneToOne 1 100 0.00 255.0 FORMAT "%5.1" ECU_ADDRESS 0x8FEFE0 /end MEASUREMENT
/begin MEASUREMENT EngM_stNext "Meta-Status der KW- und NW-Ereignisverwaltung (Motorpositions-Management), ohne Interim-Zustände" UBYTE OneToOne 1 100 0.00 255.0 FORMAT "%5.1" ECU_ADDRESS 0x7F888E /end MEASUREMENT
/begin MEASUREMENT EngM_stNextExt "Meta-Status der KW- und NW-Ereignisverwaltung, ohne Interim-Zustände, extern vom Master zum Slave über CAN" UBYTE OneToOne 1 100 0.00 255.0 FORMAT "%5.1" ECU_ADDRESS 0x7F888F /end MEASUREMENT
/begin MEASUREMENT EngM_stOut "state of engine bearing depending on engine speed, engine temperature and gear state" UBYTE OneToOne 1 100 0.00 255.0 FORMAT "%5.1" ECU_ADDRESS 0x7F8890 /end MEASUREMENT
/begin MEASUREMENT EngM_stReliablAdpt "Zuverlässigkeitsstatus des adaptierten Verlustmoments" UBYTE OneToOne 1 100 0.00 255.0 FORMAT "%5.1" ECU_ADDRESS 0x7F8891 /end MEASUREMENT
/begin MEASUREMENT EngM_stSpd "Status der Motordrehzahl" UBYTE OneToOne 1 100 0.00 255.0 FORMAT "%5.1" ECU_ADDRESS 0x7F8892 /end MEASUREMENT
/begin MEASUREMENT EngM_stStrtRevRls "Status Drehzahl gleich 0 in der Motormechanikdiagnose der Winkelsysteme" UBYTE OneToOne 1 100 0.00 255.0 FORMAT "%5.1" ECU_ADDRESS 0x7F8893 /end MEASUREMENT
/begin MEASUREMENT EngM_stSync "Meta-Status der KW- und NW-Ereignisverwaltung (Motorpositions-Management)" UBYTE OneToOne 1 100 0.00 255.0 FORMAT "%5.1" ECU_ADDRESS 0x7F8894 /end MEASUREMENT
/begin MEASUREMENT EngM_stT50CDResetDiag_mp "Reset der Diagnosezähler mit T50CD_stDebVal (Klemme 50)" UBYTE OneToOne 1 100 0.00 255.0 FORMAT "%5.1" ECU_ADDRESS 0x8FEFC8 /end MEASUREMENT
/begin MEASUREMENT EngM_stTrqFrcPDiffErr_mp "Statusmesspunkt für Ersatzdrehmomentverlust im Systemfehlerefall" UBYTE OneToOne 1 100 0.00 255.0 FORMAT "%5.1" ECU_ADDRESS 0x8FEFD1 /end MEASUREMENT
/begin MEASUREMENT EngM_stTstDem_mp "Status Testereingriff für Eng_nAvrg" UBYTE OneToOne 1 100 0.00 255.0 FORMAT "%5.1" ECU_ADDRESS 0x8FEFA3 /end MEASUREMENT
/begin MEASUREMENT EngM_tiASD_nTask_mp "Segmentzeit für die aktuelle ASD_nTask" UWORD TimeDT 1 100 0.00 65535.00 FORMAT "%8.2" ECU_ADDRESS 0x8FEFA4 /end MEASUREMENT
/begin MEASUREMENT EngM_tiDiffInt_mp "Differenz zwischen zwei statische interrupts" ULONG TimeSys_us 1 100 0.00 1228361874.73 FORMAT "%13.2" ECU_ADDRESS 0x8FEFA8 /end MEASUREMENT
/begin MEASUREMENT EngM_tiSeg "Segmentzeit" UWORD TimeDT 1 100 0.00 65535.00 FORMAT "%8.2" ECU_ADDRESS 0x7F8CC4 /end MEASUREMENT
/begin MEASUREMENT EngM_tiSegLimAvrg "gemittelte beschränkte Segmentzeit" UWORD TimeDT 1 100 0.00 65535.00 FORMAT "%8.2" ECU_ADDRESS 0x7F8CC6 /end MEASUREMENT
/begin MEASUREMENT EngM_tiSegTimeoutCurr_mp "Zeit seit dem letzten TimeOut - Interrupt" UWORD TimeDT 1 100 0.00 65535.00 FORMAT "%8.2" ECU_ADDRESS 0x8FEFAC /end MEASUREMENT
/begin MEASUREMENT EngM_tiSegTwo "Dauer der vergangenen beiden Segmente" UWORD TimeDT 1 100 0.00 65535.00 FORMAT "%8.2" ECU_ADDRESS 0x7F8CC8 /end MEASUREMENT
/begin MEASUREMENT EngM_trqDiffAdpt "Adaptiertes Differenzmoment" SWORD Trq 1 100 -3276.800 3276.700 FORMAT "%8.3" ECU_ADDRESS 0x7F8CCA /end MEASUREMENT
/begin MEASUREMENT EngM_trqFltACoff_mp "Adaptionsfilter-Ausgang für Zustand ""Klima Kompressor aus""" SWORD Trq 1 100 -3276.800 3276.700 FORMAT "%8.3" ECU_ADDRESS 0x8FEFE2 /end MEASUREMENT
/begin MEASUREMENT EngM_trqFltACon_mp "Adaptionsfilter-Ausgang für Zustand ""Klimakompressor an""" SWORD Trq 1 100 -3276.800 3276.700 FORMAT "%8.3" ECU_ADDRESS 0x8FEFE4 /end MEASUREMENT
/begin MEASUREMENT EngM_trqFrc "aktuelles Reibmoment" SWORD Trq 1 100 -3276.800 3276.700 FORMAT "%8.3" ECU_ADDRESS 0x7F8CCC /end MEASUREMENT
/begin MEASUREMENT EngM_trqFrcPDiffLim_mp "limitierter Momentenverlust aufgrund Differenzdruck über Partikelfilter" SWORD Trq 1 100 -3276.800 3276.700 FORMAT "%8.3" ECU_ADDRESS 0x8FEFD2 /end MEASUREMENT
/begin MEASUREMENT EngM_trqFrcPDiffRaw_mp "Rohwert des Momentenverlustes aufgrund Differenzdruck über Partikelfilter" SWORD Trq 1 100 -3276.800 3276.700 FORMAT "%8.3" ECU_ADDRESS 0x8FEFD4 /end MEASUREMENT
/begin MEASUREMENT EngM_trqFrcPDiff_mp "Momentenverlust aufgrund Differenzdruck über Partikelfilter" SWORD Trq 1 100 -3276.800 3276.700 FORMAT "%8.3" ECU_ADDRESS 0x8FEFD6 /end MEASUREMENT
/begin MEASUREMENT EngM_trqFrcT_mp "ausgewählte Temperature zur Berechnung Reibmoment" SWORD Trq 1 100 -3276.800 3276.700 FORMAT "%8.3" ECU_ADDRESS 0x8FEFD8 /end MEASUREMENT
/begin MEASUREMENT EngM_trqLossAdpt "Adaptiertes Gesamtverlustmoment des Motors" SWORD Trq 1 100 -3276.800 3276.700 FORMAT "%8.3" ECU_ADDRESS 0x7F8CCE /end MEASUREMENT
/begin MEASUREMENT EngM_trqLossCompl_mp "komplettes Motor-Verlustmoment" SWORD Trq 1 100 -3276.800 3276.700 FORMAT "%8.3" ECU_ADDRESS 0x8FEFE6 /end MEASUREMENT
/begin MEASUREMENT EngM_trqLossDiff_mp "Differenzverlustmoment der Reibmomenten-Adaption" SWORD Trq 1 100 -3276.800 3276.700 FORMAT "%8.3" ECU_ADDRESS 0x8FEFE8 /end MEASUREMENT
/begin MEASUREMENT EngM_tTrqFrc_mp "Ausgewählte Temperatur für die Reibmomentenberechnung" SWORD Temp_Cels 1 100 -50.140 899.860 FORMAT "%8.3" ECU_ADDRESS 0x8FEFDA /end MEASUREMENT
/begin MEASUREMENT EngPrt_facOvhtPrvCT_mp "Faktor aus Kühlmitteltemperatur" SWORD Fact 1 100 -4.000000 3.999878 FORMAT "%8.6" ECU_ADDRESS 0x8FEFEA /end MEASUREMENT
/begin MEASUREMENT EngPrt_facOvhtPrvFT_mp "Faktor aus Kraftstofftemperatur" SWORD Fact 1 100 -4.000000 3.999878 FORMAT "%8.6" ECU_ADDRESS 0x8FEFEC /end MEASUREMENT
/begin MEASUREMENT EngPrt_facOvhtPrvOT_mp "Faktor aus Motoröltemperatur" SWORD Fact 1 100 -4.000000 3.999878 FORMAT "%8.6" ECU_ADDRESS 0x8FEFEE /end MEASUREMENT
/begin MEASUREMENT EngPrt_facOvhtPrv_mp "Minimum der Temperaturfaktoren" SWORD Fact 1 100 -4.000000 3.999878 FORMAT "%8.6" ECU_ADDRESS 0x8FEFF0 /end MEASUREMENT
/begin MEASUREMENT EngPrt_facPrtLim "Motorschutzbegrenzungsfaktor" SWORD Fact 1 100 -4.000000 3.999878 FORMAT "%8.6" ECU_ADDRESS 0x7F8CD0 /end MEASUREMENT
/begin MEASUREMENT EngPrt_qOvhtPrvNRng_mp "Begrenzungsmenge auf Grund der mittleren Drehzahl" SWORD InjMass 1 100 -327.6800 327.6700 FORMAT "%8.4" ECU_ADDRESS 0x8FEFF2 /end MEASUREMENT
/begin MEASUREMENT EngPrt_qOvhtPrvVRng_mp "Begrenzungsmenge auf Grund der Fahrzeuggeschwindigkeit" SWORD InjMass 1 100 -327.6800 327.6700 FORMAT "%8.4" ECU_ADDRESS 0x8FEFF4 /end MEASUREMENT
/begin MEASUREMENT EngPrt_qPrtLim "Begrenzungmenge zum thermischen Motorschutz" SWORD InjMass 1 100 -327.6800 327.6700 FORMAT "%8.4" ECU_ADDRESS 0x7F8CD2 /end MEASUREMENT
/begin MEASUREMENT EngPrt_stFWOscDet "Status of fly wheel oscillation detection" UBYTE OneToOne 1 100 0.00 255.0 FORMAT "%5.1" ECU_ADDRESS 0x7F8896 /end MEASUREMENT
/begin MEASUREMENT EngPrt_stOvrSpd "Überdrehzahl-Status" UBYTE OneToOne 1 100 0.00 255.0 FORMAT "%5.1" ECU_ADDRESS 0x7F8897 /end MEASUREMENT
/begin MEASUREMENT EngPrt_stTrqRampSwitch_mp "status of rampswitch" UWORD OneToOne 1 100 0.00 65535.00 FORMAT "%8.2" ECU_ADDRESS 0x8FEFF6 /end MEASUREMENT
/begin MEASUREMENT EngPrt_trqLim "Begrenzungsmoment zum Schutz vor zu hohem Drehmoment (als inneres Motormoment)" SWORD Trq 1 100 -3276.800 3276.700 FORMAT "%8.3" ECU_ADDRESS 0x7F8CD4 /end MEASUREMENT
/begin MEASUREMENT EngPrt_trqLimPrvLim_mp "uic-Datei für Motormechanikschutz" SWORD Trq 1 100 -3276.800 3276.700 FORMAT "%8.3" ECU_ADDRESS 0x8FEFF8 /end MEASUREMENT
/begin MEASUREMENT EngPrt_trqNLim "Begrenzungsmoment zum Schutz vor zu hoher Drehzahl (als inneres Motormoment)" SWORD Trq 1 100 -3276.800 3276.700 FORMAT "%8.3" ECU_ADDRESS 0x7F8CD6 /end MEASUREMENT
/begin MEASUREMENT EngPrt_trqOvhtPrv "Begrenzungsmoment für Überhitzungsschutz" SWORD Trq 1 100 -3276.800 3276.700 FORMAT "%8.3" ECU_ADDRESS 0x7F8CD8 /end MEASUREMENT
/begin MEASUREMENT EngPrt_trqPrtLim "resultierendes Begrenzungsmoment für Motormechanikschutz (inneres Motormoment)" SWORD Trq 1 100 -3276.800 3276.700 FORMAT "%8.3" ECU_ADDRESS 0x7F8CDA /end MEASUREMENT
/begin MEASUREMENT EngPrt_trqRamLim1_mp "Ausgang der Sekunde rampswitch" SWORD Trq 1 100 -3276.800 3276.700 FORMAT "%8.3" ECU_ADDRESS 0x8FEFFA /end MEASUREMENT
/begin MEASUREMENT EngPrt_trqRamLim_mp "Ausgang von erstem rampswitch" SWORD Trq 1 100 -3276.800 3276.700 FORMAT "%8.3" ECU_ADDRESS 0x8FEFFC /end MEASUREMENT
/begin MEASUREMENT Eng_dnAvrg "gemittelte Drehzahländerung pro Sekunde" SWORD Eng_dN 1 100 -32768.00 32767.00 FORMAT "%8.2" ECU_ADDRESS 0x7F8CDC /end MEASUREMENT
/begin MEASUREMENT Eng_nAvrg "mittlere Motordrehzahl" SWORD EngN 1 100 -32768.00 32767.00 FORMAT "%8.2" ECU_ADDRESS 0x7F8CDE /end MEASUREMENT
/begin MEASUREMENT Eng_nCurr "aktuelle Motordrehzahl" SWORD EngN 1 100 -32768.00 32767.00 FORMAT "%8.2" ECU_ADDRESS 0x7F8CE0 /end MEASUREMENT
/begin MEASUREMENT Eng_stEngRun_mp "" UBYTE OneToOne 1 100 0.00 255.0 FORMAT "%5.1" ECU_ADDRESS 0x8FEF90 /end MEASUREMENT
/begin MEASUREMENT Eng_stOvrTemp "Status Übertemperatur" UBYTE OneToOne 1 100 0.00 255.0 FORMAT "%5.1" ECU_ADDRESS 0x7F8898 /end MEASUREMENT
/begin MEASUREMENT Eng_stOvrTemp2 "Status Übertemperatur 2" UBYTE OneToOne 1 100 0.00 255.0 FORMAT "%5.1" ECU_ADDRESS 0x7F8899 /end MEASUREMENT
/begin MEASUREMENT Eng_stOvrTemp_mp "Status Übertemperatur" UBYTE OneToOne 1 100 0.00 255.0 FORMAT "%5.1" ECU_ADDRESS 0x8FEF91 /end MEASUREMENT
/begin MEASUREMENT Eng_tEng "Motortemperatur" SWORD Temp_Cels 1 100 -50.140 899.860 FORMAT "%8.3" ECU_ADDRESS 0x7F8CE2 /end MEASUREMENT
/begin MEASUREMENT Eng_tFld "Motortemperatur-Feld" SWORD Temp_Cels 1 100 -50.140 899.860 FORMAT "%8.3" ARRAY_SIZE 3 ECU_ADDRESS 0x7F9328 /end MEASUREMENT
/begin MEASUREMENT Eng_trqCrvMax "maximales Moment des Momentenintervalls (über Drehzahl)" SWORD Trq 1 100 -3276.800 3276.700 FORMAT "%8.3" ECU_ADDRESS 0x7F8CE8 /end MEASUREMENT
/begin MEASUREMENT Eng_tStrt "Motortemperatur beim Start" SWORD Temp_Cels 1 100 -50.140 899.860 FORMAT "%8.3" ECU_ADDRESS 0x7F8CE4 /end MEASUREMENT
/begin MEASUREMENT ErLpCD_OrdGlwLmp "Message vom Fehlerlampen Handler and Glühzeitsteuerung, steuert die Glühlampe bei Systemlampenfehlern an." UBYTE OneToOne 1 100 0.00 255.0 FORMAT "%5.1" ECU_ADDRESS 0x7F889A /end MEASUREMENT
/begin MEASUREMENT ErLpCD_stMil "Gesamtatus der MIL und Status der Aktivierungsquellen" UBYTE OneToOne 1 100 0.00 255.0 FORMAT "%5.1" ECU_ADDRESS 0x7F889B /end MEASUREMENT
/begin MEASUREMENT ErLpCD_stMilLmpTst "Status der MIL während Lampentest" UBYTE OneToOne 1 100 0.00 255.0 FORMAT "%5.1" ECU_ADDRESS 0x7F889C /end MEASUREMENT
/begin MEASUREMENT ErLpCD_stMilReq "Status der externen MIL Ansteuerungs Anforderung (Achtung: wechselt während der Ansteuerung dauernd den Zustand)" UBYTE OneToOne 1 100 0.00 255.0 FORMAT "%5.1" ECU_ADDRESS 0x7F889D /end MEASUREMENT
/begin MEASUREMENT ErLpCD_stSysLmp "Gesamtatus der System Lampe und Status der Aktivierungsquellen" UBYTE OneToOne 1 100 0.00 255.0 FORMAT "%5.1" ECU_ADDRESS 0x7F889E /end MEASUREMENT
/begin MEASUREMENT ErLpCD_stSysLmpReq "Status der externen Systemlampen  Ansteuerungs Anforderung (Achtung: wechselt während der Ansteuerung dauernd den Zustand)" UBYTE OneToOne 1 100 0.00 255.0 FORMAT "%5.1" ECU_ADDRESS 0x7F889F /end MEASUREMENT
/begin MEASUREMENT ErLpCD_stTstMIL_mp "Testzustand und Fehlerspeicheranforderung der MIL" UBYTE OneToOne 1 100 0.00 255.0 FORMAT "%5.1" ECU_ADDRESS 0x8FEFFE /end MEASUREMENT
/begin MEASUREMENT ErLpCD_stTstSysLmp_mp "Testzustand und Anforderung durch Fehlerspeicher für Systemlampe" UBYTE OneToOne 1 100 0.00 255.0 FORMAT "%5.1" ECU_ADDRESS 0x8FEFFF /end MEASUREMENT
/begin FUNCTION egsys_toxicatmod_uic ""
 /begin OUT_MEASUREMENT EGSys_cpEGOxiCat_mp EGSys_dwFlCmb_mp EGSys_tAvrgOxiCat_mp EGSys_tIncrPoI_mp EGSys_tOxiCatExoIncr_mp EGSys_tOxiCatStat_mp /end OUT_MEASUREMENT
/end FUNCTION
/begin FUNCTION egsys_tstrtcalc "Temperaturmodell für Fahrzeugstillstand"
 /begin DEF_CHARACTERISTIC EGSys_facTempClg_CUR EGSys_facTimeClg_CUR EGSys_swtTAirSens_C EGSys_tiHaValClnt_C EGSys_tiHaValNSC_C EGSys_tiHaValOxiCat_C EGSys_tiHaValTrb_C EGSys_tiHaValTube_C EGSys_tiOfsClg_C EGSys_tStrtCsRepl_C /end DEF_CHARACTERISTIC
 /begin IN_MEASUREMENT EGSys_rTempClnt_mp EGSys_rTimeTrb_mp /end IN_MEASUREMENT
 /begin OUT_MEASUREMENT EGSys_rTimeTube_mp /end OUT_MEASUREMENT
/end FUNCTION
/begin FUNCTION egsys_tstrtcalc_msg ""
 /begin OUT_MEASUREMENT EGSys_tNSCStrtCs EGSys_tOxiCatStrtCs EGSys_tTrbStrtCs EGSys_tTubeStrtCs /end OUT_MEASUREMENT
/end FUNCTION
/begin FUNCTION egsys_tstrtcalc_uic ""
 /begin OUT_MEASUREMENT EGSys_rTempClnt_mp EGSys_rTimeNSC_mp EGSys_rTimeOxiCat_mp EGSys_rTimeTrb_mp EGSys_tExcClntStrtCs_mp EGSys_tiClg_mp EGSys_tiRefClg_mp /end OUT_MEASUREMENT
/end FUNCTION
/begin FUNCTION egsys_ttrbmod "Turboladerabgastemperaturmodell"
 /begin DEF_CHARACTERISTIC EGSys_cpChrg_C EGSys_etaChrg_MAP EGSys_tiChrgPT1_C EGSys_pValDfl_C EGSys_rTempAdbt_CUR EGSys_swtTimeChrg_C EGSys_tEGPstTrbnDfl_C /end DEF_CHARACTERISTIC
 /begin IN_MEASUREMENT AFSCD_dmAirPerTime EGSys_rPresCmpr_mp /end IN_MEASUREMENT
/end FUNCTION
/begin FUNCTION egsys_ttrbmod_msg "" /begin OUT_MEASUREMENT EGSys_tEGPstTrbn /end OUT_MEASUREMENT /end FUNCTION
/begin FUNCTION egsys_ttrbmod_uic ""
 /begin OUT_MEASUREMENT EGSys_cpEGTrbn_mp EGSys_etaChrg_mp EGSys_facPT1Chrg_mp EGSys_pwrCmpr_mp EGSys_rPresCmpr_mp EGSys_tAvrgEGTrbn_mp /end OUT_MEASUREMENT
/end FUNCTION
/begin FUNCTION egsys_ttubemod "Temperaturmodell für Abgasrohr"
 /begin DEF_CHARACTERISTIC EGSys_AlpFreeCnvtTube_C EGSys_cpTube_C EGSys_lDiamTube_C EGSys_lLngthTube_C EGSys_NuTubeEnv_CUR EGSys_NuTube_CUR EGSys_rSqTube_C EGSys_tEGTubeDfl_C EGSys_tTubeDfl_C EGSys_tTubeIKi_C EGSys_tTubeIKiPos_C EGSys_tTubeIKiNeg_C EGSys_tTubeIWinPos_C EGSys_tTubeIWinNeg_C /end DEF_CHARACTERISTIC
 /begin OUT_MEASUREMENT EGSys_AlpEGTube_mp EGSys_AlpTubeEnv_mp EGSys_cndHtEGi_mp EGSys_cndHtEGo_mp EGSys_cpEGTube_mp EGSys_dtTube_mp EGSys_dwTubeIn_mp EGSys_dwTubeOut_mp EGSys_dwTube_mp EGSys_NuTubeEnv_mp EGSys_NuTube_mp EGSys_ReTubeEnvInpCrv_mp EGSys_ReTubeEnv_mp EGSys_ReTubeInpCrv_mp EGSys_ReTube_mp EGSys_sqTube_mp EGSys_tAvrgEGTube_mp EGSys_tDiffEGTube_mp EGSys_tDiffTubeEnv_mp EGSys_tMidEGTube_mp EGSys_tMidTubeEnv_mp /end OUT_MEASUREMENT
/end FUNCTION
/begin FUNCTION egsys_ttubemod_msg "" /begin OUT_MEASUREMENT EGSys_tEGPstTube EGSys_tTube /end OUT_MEASUREMENT /end FUNCTION
/begin FUNCTION egsys_ttubemod_uic "" /end FUNCTION
/begin FUNCTION egt_corgn "Regenerationskoordinator Abgasnachbehandlung" /begin DEF_CHARACTERISTIC EGT_swtEGTActv_C /end DEF_CHARACTERISTIC /end FUNCTION
/begin FUNCTION egt_corgntsync "Regenerationskoordinator Abgasnachbehandlung (zeitsynchron)"
 /begin DEF_CHARACTERISTIC EGT_stRgnLckMsk_C EGT_swtRgnLckRst_C EGT_swtServiceVal_C EGT_tiRgnOilDilMax_C EGT_tiRgnOilDilSubs_C EGT_tiRmpSlpMax_C /end DEF_CHARACTERISTIC
/end FUNCTION
/begin FUNCTION egt_corgntsync_msg ""
 /begin OUT_MEASUREMENT EGT_stCoRgnTSync EGT_stDel EGT_stTSync EGT_stTSyncLck EGT_tiRgnOilDil EGT_tiRgnTSync EGT_tiRmpSlpMax /end OUT_MEASUREMENT
/end FUNCTION
/begin FUNCTION egt_corgntsync_uic "" /begin DEF_CHARACTERISTIC EGT_stTSync_Vector EGT_stTSync_Channel /end DEF_CHARACTERISTIC
 /begin OUT_MEASUREMENT EGT_stCoRgnOld_mp EGT_stRgnOilDil_mp EGT_stTSyncDes_mp EGT_swtRgnLck_mp EGT_tiRgnTSyncPre_mp /end OUT_MEASUREMENT
/end FUNCTION
/begin FUNCTION egt_corgn_msg ""
 /begin OUT_MEASUREMENT EGT_facRmpVal EGT_st EGT_stCoRgn EGT_stLck EGT_swtEGTActv EGT_tiRgn /end OUT_MEASUREMENT
/end FUNCTION
/begin FUNCTION egt_corgn_uic "" /end FUNCTION
/begin FUNCTION egt_critoilmsdet "Berechnung Oilverdünnung"
 /begin DEF_CHARACTERISTIC EGT_CritMsOilKi_C EGT_DebMsOilSensVld_C EGT_dmOilDilPoIBas_MAP EGT_dmOilRmvBas_MAP EGT_facOilDilTempEng_CUR EGT_facOilRmvMsOil_CUR EGT_facOilRmvTempOil_CUR EGT_mOilDilEngDflMax_C EGT_mOilDilEngDflMin_C EGT_mOilDilEngSubs_C EGT_mOilEngCritMax_C EGT_mOilEngCritMin_C EGT_mOilEngDflMax_C EGT_mOilEngDflMin_C EGT_mOilEngSensVldMax_C EGT_mOilEngSensVldMin_C EGT_numTempEng_C EGT_numTempOil_C EGT_rhoFuel_C EGT_rOilDilEngCritMax_C EGT_rOilEngCritMaxVsc_C EGT_stOilDilMsk_C EGT_swtOilSensVldMaxMnl_C EGT_swtOilSensVldMinMnl_C EGT_DebOilLvlCritMaxDef_C EGT_DebOilLvlCritMaxOk_C EGT_DebOilLvlCritMinDef_C EGT_DebOilLvlCritMinOk_C EGT_DebOilVscCritMinDef_C EGT_DebOilVscCritMinOk_C /end DEF_CHARACTERISTIC
 /begin IN_MEASUREMENT EGT_mOilEngCrvIn_mp EGT_tEng_mp EGT_tOil_mp Eng_nAvrg InjCtl_qSetUnBal /end IN_MEASUREMENT
/end FUNCTION
/begin FUNCTION egt_critoilmsdet_msg ""
 /begin OUT_MEASUREMENT EGT_mOilDilEng EGT_mOilEng EGT_rOilDilEng EGT_stOilEng EGT_stOilLayer EGT_volOilDilEng /end OUT_MEASUREMENT
/end FUNCTION
/begin FUNCTION egt_critoilmsdet_uic ""
 /begin OUT_MEASUREMENT EGT_dmOilDilAct_mp EGT_dmOilDilPoIBas_mp EGT_dmOilDilPoICorr_mp EGT_dmOilRmvBas_mp EGT_dmOilRmvCorr_mp EGT_dmOilRmvTempCorr_mp EGT_mOilEngCrvIn_mp EGT_mOilEngMax_mp EGT_mOilEngMin_mp EGT_mOilEngSens_mp EGT_rOilDilEngMsOilMax_mp EGT_rOilDilEngMsOilMin_mp EGT_stMsOilSensVld_mp EGT_stRgnOilDilAct_mp EGT_tEng_mp EGT_tOil_mp /end OUT_MEASUREMENT
/end FUNCTION
/begin FUNCTION egt_tempgvnr "EGT temperature governor"
 /begin DEF_CHARACTERISTIC EGT_facKiAMPT_CUR EGT_facKiInrNegTempGvnr_C EGT_facKiInrPosTempGvnr_C EGT_facKiOutrNegTempGvnr_C EGT_facKiOutrPosTempGvnr_C EGT_facKiQntPoI1_MAP EGT_facKiQntPoI2_MAP EGT_facKiTempInrCor_MAP EGT_facKpAMPT_CUR EGT_facKpInrNegTempGvnr_C EGT_facKpInrPosTempGvnr_C EGT_facKpOutrNegTempGvnr_C EGT_facKpOutrPosTempGvnr_C EGT_facKpQntPoI1_MAP EGT_facKpQntPoI2_MAP EGT_facKpTempInrCor_MAP EGT_mAirTempGvnrMax_MAP EGT_mAirTempGvnrMin_MAP EGT_mAirThresOff_C EGT_qPoI1Min_C EGT_qPoI1TempGvnrMax_MAP EGT_qPoI1TempGvnrMin_MAP EGT_qPoI1ThresOff_C EGT_qPoI2Min_C EGT_qPoI2TempGvnrMax_MAP EGT_qPoI2TempGvnrMin_MAP EGT_qPoI2ThresOff_C EGT_stMskClsThrVlv_C EGT_swtInrTempOutr_C EGT_tInrCorTempGvnrMax_MAP EGT_tInrCorTempGvnrMin_MAP EGT_tInrCorThresOff_C EGT_tInrWinNeg_C EGT_tInrWinPos_C EGT_tiPoI1TThres_C EGT_tOutrWinNeg_C EGT_tOutrWinPos_C /end DEF_CHARACTERISTIC
 /begin IN_MEASUREMENT Eng_nAvrg InjCtl_qSetUnBal /end IN_MEASUREMENT
/end FUNCTION
/begin FUNCTION egt_tempgvnrdesval "Sollwertbildung des Abgastemperaturreglers"
 /begin DEF_CHARACTERISTIC EGT_swtTempOutrDes_C EGT_swtTempTurbPre_C EGT_tInrDesTempTurb_CUR EGT_tInrDes_MAP EGT_tOutrDesMflO2_CUR EGT_tOutrDesMsSot_CUR EGT_tOutrDesTempPst_CUR EGT_tOutrDes_MAP /end DEF_CHARACTERISTIC
 /begin IN_MEASUREMENT EGT_dmO2Aprx_mp EGT_mSot_mp EGT_tOxiPst_mp EGT_tTurbPre_mp Eng_nAvrg InjCtl_qSetUnBal /end IN_MEASUREMENT
/end FUNCTION
/begin FUNCTION egt_tempgvnrdesval_msg ""
 /begin OUT_MEASUREMENT EGT_tInrDesTempGvnr EGT_tInrTempGvnr EGT_tOutrDesTempGvnr EGT_tOutrTempGvnr /end OUT_MEASUREMENT
/end FUNCTION
/begin FUNCTION egt_tempgvnrdesval_uic ""
 /begin DEF_CHARACTERISTIC EGT_tInrDesInTempGvnr_Vector EGT_tInrDesInTempGvnr_Channel EGT_tOutrDesInTempGvnr_Vector EGT_tOutrDesInTempGvnr_Channel /end DEF_CHARACTERISTIC
 /begin OUT_MEASUREMENT EGT_dmO2Aprx_mp EGT_mSot_mp EGT_tOxiPst_mp EGT_tTurbPre_mp /end OUT_MEASUREMENT
/end FUNCTION
/begin FUNCTION egt_tempgvnrmonitor "Überwachung des Abgastemperaturreglers"
 /begin DEF_CHARACTERISTIC EGT_stMskInrTempGvnr_C EGT_stMskOutrTempGvnr_C EGT_DebTempGvnrInrMaxDef_C EGT_DebTempGvnrInrMaxOK_C EGT_DebTempGvnrInrMinDef_C EGT_DebTempGvnrInrMinOK_C EGT_DebTempGvnrOutrMaxDef_C EGT_DebTempGvnrOutrMaxOK_C EGT_DebTempGvnrOutrMinDef_C EGT_DebTempGvnrOutrMinOK_C EGT_tiHiLoTempGvnr_C EGT_tiLoHiTempGvnr_C EGT_tInrDvtMax_C EGT_tInrDvtMin_C EGT_tInrThresDwn_C EGT_tInrThresUp_C EGT_tiPoIHiLoTempGvnr_C EGT_tiPoILoHiTempGvnr_C EGT_tOutrDvtMax_C EGT_tOutrDvtMin_C EGT_tOutrThresDwn_C EGT_tOutrThresUp_C EGT_tOxiPreThresBrn_C /end DEF_CHARACTERISTIC
/end FUNCTION
/begin FUNCTION egt_tempgvnrmonitor_msg "" /begin OUT_MEASUREMENT EGT_stTempGvnr /end OUT_MEASUREMENT /end FUNCTION
/begin FUNCTION egt_tempgvnrmonitor_uic "" /end FUNCTION
/begin FUNCTION egt_tempgvnroutval "Ausgabeschnittstelle der Abgastemperaturregelung"
 /begin DEF_CHARACTERISTIC EGT_facPoI2Dist_C EGT_facQntPoI2Rmp_CUR EGT_mAirDesTempGvnrMnl_C EGT_mAirLmbd_CUR EGT_phiPoI1TempGvnr_MAP EGT_qHCQntPoI1_CUR EGT_qPoI1TempGvnrMnl_C EGT_qPoI2TempGvnrMnl_C EGT_swtPoI1PoI2Dist_C EGT_swtQntPoI1HC_C EGT_tiPoI2TempGvnr_MAP EGT_tiRmpSlpTempGvnr_C /end DEF_CHARACTERISTIC
 /begin IN_MEASUREMENT EGT_facQntPoI2RmpCur_mp EGT_qPoI1Outr_mp EGT_rLmbd_mp Eng_nAvrg InjCtl_qSetUnBal /end IN_MEASUREMENT
/end FUNCTION
/begin FUNCTION egt_tempgvnroutval_msg ""
 /begin OUT_MEASUREMENT EGT_mAirDesTempGvnr EGT_phiPoI1TempGvnr EGT_qHCTempGvnr EGT_qPoI1TempGvnr EGT_qPoI2TempGvnr EGT_tiPoI2TempGvnr /end OUT_MEASUREMENT
/end FUNCTION
/begin FUNCTION egt_tempgvnroutval_uic ""
 /begin OUT_MEASUREMENT EGT_facQntPoI2RmpCur_mp EGT_facRmpValTempGvnr_mp EGT_facRmp_mp EGT_mAirLmbdTempGvnr_mp EGT_qPoI1Outr_mp EGT_rLmbd_mp /end OUT_MEASUREMENT
/end FUNCTION
/begin FUNCTION egt_tempgvnrprj "" /begin DEF_CHARACTERISTIC EGT_stMskInrTempGvrService_C EGT_tSrvRgn_CUR /end DEF_CHARACTERISTIC /begin IN_MEASUREMENT EGT_tiSrvRgnIn_mp /end IN_MEASUREMENT /end FUNCTION
/begin FUNCTION egt_tempgvnrprj_uic "" /begin OUT_MEASUREMENT EGT_tiSrvRgnIn_mp /end OUT_MEASUREMENT /end FUNCTION
/begin FUNCTION egt_tempgvnr_msg ""
 /begin OUT_MEASUREMENT EGT_mAirDesInrTempGvnr EGT_qPoI1OutrTempGvnr EGT_qPoI2InrTempGvnr EGT_tInrDesCorTempGvnr EGT_tInrDvtTempGvnr EGT_tOutrDvtTempGvnr /end OUT_MEASUREMENT
/end FUNCTION
/begin FUNCTION egt_tempgvnr_uic ""
 /begin OUT_MEASUREMENT EGT_mAirTempGvnrMin_mp EGT_mAirTempGvnrRng_mp EGT_qPoI1Min_mp EGT_qPoI1Rng_mp EGT_qPoI2Min_mp EGT_qPoI2Rng_mp EGT_rIInrTempGvnr_mp EGT_rInrTempGvnr_mp EGT_rIOutrTempGvnr_mp EGT_rMaxInrTempGvnr_mp EGT_rMaxOutrTempGvnr_mp EGT_rMinInrTempGvnr_mp EGT_rMinOutrTempGvnr_mp EGT_rOutrTempGvnr_mp EGT_rPInrTempGvnr_mp EGT_rPOutrTempGvnr_mp EGT_rStyInrTempGvnr_mp EGT_rStyOutrTempGvnr_mp EGT_stClsThrVlv_mp EGT_tInrCorMax_mp EGT_tInrCorRng_mp EGT_tiPoI1ActvCnt_mp /end OUT_MEASUREMENT
/end FUNCTION
/begin FUNCTION emccd "Komponententreiber der Motorlagersteuerung"
 /begin DEF_CHARACTERISTIC EMCCD_uSRCMinActVal1_C EMCCD_uSRCMaxActVal1_C EMCCD_iLinActVal1_CUR EMCCD_uSRCMinActVal2_C EMCCD_uSRCMaxActVal2_C EMCCD_iLinActVal2_CUR EMCCD_ctPwrStgOnMax1_C EMCCD_ctPwrStgOnMax2_C EMCCD_dcycCurrLowTemp_MAP EMCCD_dcycCurrOff_MAP EMCCD_dcycCurrOnHi_MAP EMCCD_dcycCurrOnLow_MAP EMCCD_dcycMax_C EMCCD_dcycMin_C EMCCD_dcycWarmUp_MAP EMCCD_DebExcTempDef1_C EMCCD_DebExcTempOk1_C EMCCD_DebExcTempDef2_C EMCCD_DebExcTempOk2_C EMCCD_DebNoLoadDef1_C EMCCD_DebNoLoadOk1_C EMCCD_DebNoLoadDef2_C EMCCD_DebNoLoadOk2_C EMCCD_DebShortCircBatDef1_C EMCCD_DebShortCircBatOk1_C EMCCD_DebShortCircBatDef2_C EMCCD_DebShortCircBatOk2_C EMCCD_DebShortCircGndDef1_C EMCCD_DebShortCircGndOk1_C EMCCD_DebShortCircGndDef2_C EMCCD_DebShortCircGndOk2_C EMCCD_DebSRCHighDef1_C EMCCD_DebSRCHighOk1_C EMCCD_DebSRCHighDef2_C EMCCD_DebSRCHighOk2_C EMCCD_DebSRCLowDef1_C EMCCD_DebSRCLowOk1_C EMCCD_DebSRCLowDef2_C EMCCD_DebSRCLowOk2_C EMCCD_dtRmpSlpUpActVal1_C EMCCD_dtRmpSlpDwnActVal1_C EMCCD_dtRmpSlpUpActVal2_C EMCCD_dtRmpSlpDwnActVal2_C EMCCD_numAdc1_C EMCCD_numAdc2_C EMCCD_numDiaOut1_C EMCCD_numDiaOut2_C EMCCD_numPwmOut1_C EMCCD_numPwmOut2_C EMCCD_tiActValPT1_1_C EMCCD_tiActValPT1_2_C EMCCD_stInvOut1_C EMCCD_tiPer1_C EMCCD_stInvOut2_C EMCCD_tiPer2_C EMCCD_resHysLow_C EMCCD_resHysUp_C EMCCD_stSPICtl1_C EMCCD_stSPICtl2_C EMCCD_swtRegOn_C EMCCD_tiBtwTst1_C EMCCD_tiBtwTst2_C EMCCD_tiCurrOnHi_C EMCCD_tiPwrStgOn1_C EMCCD_tiPwrStgOn2_C EMCCD_tiWarmUp_C EMCCD_stSensIDWordActVal1_C EMCCD_iDflActVal1_C EMCCD_stSensIDWordActVal2_C EMCCD_iDflActVal2_C EngM_ctPwrStgOnMax1_C EngM_ctPwrStgOnMax2_C EngM_HldCurr_MAP EngM_RetCurr_MAP EngM_tEngMax_C EngM_tEngMin_C EngM_tiEngMntCtl_C EngM_uBattMax_C EngM_uBattMin_C /end DEF_CHARACTERISTIC
 /begin IN_MEASUREMENT BattCD_u EATSCD_tAir EMCCD_resAct1 EMCCD_uRawActVal1_mp EMCCD_uRawActVal2_mp Eng_tEng /end IN_MEASUREMENT
/end FUNCTION
/begin FUNCTION emccd_msg "" /begin OUT_MEASUREMENT EMCCD_iActVal1 EMCCD_iActVal2 EMCCD_resAct1 EMCCD_resAct2 /end OUT_MEASUREMENT /end FUNCTION
/begin FUNCTION emccd_uic ""
 /begin OUT_MEASUREMENT EMCCD_dcycCurrOff1_mp EMCCD_dcycCurrOff2_mp EMCCD_dcycCurrOn1_mp EMCCD_dcycCurrOn2_mp EMCCD_dcycMntCtlOut1_mp EMCCD_dcycMntCtlOut2_mp EMCCD_dcycMntCtlOutOld1_mp EMCCD_dcycMntCtlOutOld2_mp EMCCD_dcycOut1_mp EMCCD_dcycOut2_mp EMCCD_iActValFlt1_mp EMCCD_iActValFlt2_mp EMCCD_rHWE1_mp EMCCD_rHWE2_mp EMCCD_stOut_mp EMCCD_uDtyCyc1_mp EMCCD_uDtyCyc2_mp EMCCD_uRawActVal1_mp EMCCD_uRawActVal2_mp /end OUT_MEASUREMENT
/end FUNCTION
/begin FUNCTION eng "Motor"
 /begin DEF_CHARACTERISTIC Eng_ctEngSpdDiffCalc_C Eng_tOvrHi2_C Eng_tOvrHi_C Eng_tOvrLo2_C Eng_tOvrLo_C Eng_trqSpd_CUR /end DEF_CHARACTERISTIC
 /begin IN_MEASUREMENT Eng_nAvrg /end IN_MEASUREMENT
/end FUNCTION
/begin FUNCTION engm "Motormechanik"
 /begin DEF_CHARACTERISTIC EngM_dLimitCond_ASD_CA EngM_dLimitCond_Common_CA EngM_dLimitCond_FBC_CA EngM_dLimitCond_Joint_CA EngM_dLimitCond_LiGov_CA EngM_dLimitCond_Pilot_CA EngM_nLimitInj_C EngM_nLimitThreshHyst_CA EngM_nLimitThresh_CA EngM_nLimitTimeout_C EngM_nPolling_C EngM_nSwtCoMa_C EngM_numLimitInj_C EngM_numLimitTimeout_C EngM_swtNumCylVal_C EngM_tiSegMin_C /end DEF_CHARACTERISTIC
/end FUNCTION
/begin FUNCTION engmon_irrcmb "Verbrennungserkennung mit Lambdasonde" /end FUNCTION
/begin FUNCTION engmon_irrcmb_msg "" /begin OUT_MEASUREMENT EngMon_stShOffIrrCmb /end OUT_MEASUREMENT /end FUNCTION
/begin FUNCTION engmon_irrcmb_uic "" /end FUNCTION
/begin FUNCTION engm_ang ""
 /begin DEF_CHARACTERISTIC EngM_ctOfsCaSCrS_C EngM_ctPhWhlRev_C EngM_ctPostSync_C EngM_ctReSync_C EngM_ctVerSync_C EngM_nMaxFrstInj_C EngM_nMaxStrt_C EngM_nSyncNoInjRls_C EngM_numPin_C EngM_nWaitIncSig_C EngM_phiDelayPhNoSig_C EngM_phiDeltaExtSync_C EngM_phiDelta_C EngM_phiFrstInjInt_C EngM_phiIntMin_C EngM_phiInt_C EngM_phiMax_C EngM_phiTDC_C EngM_stSyncBefGap_C EngM_swtExitOfs_C EngM_swtSyncViaCAN_C EngM_swtUpdTDC_C EngM_tiCpuTimeOut_C EngM_tiDiffInt_C EngM_tiWaitIncSig_C /end DEF_CHARACTERISTIC
/end FUNCTION
/begin FUNCTION engm_angdiag "Diagnose des Kurbelwellen- und Nockenwellensignals"
 /begin DEF_CHARACTERISTIC EngM_ctSpdtoZero_C EngM_DebIncCaSErrSigDef_C EngM_DebIncCaSErrSigOK_C EngM_DebIncCaSNoSigDef_C EngM_DebIncCrSErrSigDef_C EngM_DebIncCrSErrSigOK_C EngM_DebIncOfsSigCaSCrSDef_C EngM_DebPhCrSErrSigDef_C EngM_nMinDiag_C EngM_nSwtErrSigDiagCrSOff_C EngM_nSwtErrSigDiagCrSOn_C EngM_swtT50CDDiag_C /end DEF_CHARACTERISTIC
/end FUNCTION
/begin FUNCTION engm_angdiagnocas "" /end FUNCTION
/begin FUNCTION engm_angdiag_uic ""
 /begin OUT_MEASUREMENT EngM_ctIncErrSigDiagCaSDef_mp EngM_ctIncErrSigDiagCaSOk_mp EngM_ctIncErrSigDiagCrSDef_mp EngM_ctIncErrSigDiagCrSOK_mp EngM_ctIncErrSigDiagmaxCaSDef_mp EngM_ctIncErrSigDiagmaxCaSOk_mp EngM_ctIncErrSigDiagmaxCrSDef_mp EngM_ctIncNoSigDiagCaS_mp EngM_ctIncNoSigDiagmaxCaS_mp EngM_ctPhErrSigDiagCrSDef_mp EngM_ctPhErrSigDiagmaxCrSDef_mp EngM_ctSpdtoZero_mp EngM_stT50CDResetDiag_mp /end OUT_MEASUREMENT
/end FUNCTION
/begin FUNCTION engm_angdiag_var "" /end FUNCTION
/begin FUNCTION engm_angdiag_var_uic "" /end FUNCTION
/begin FUNCTION engm_ang_msg ""
 /begin OUT_MEASUREMENT EngM_ctReSync EngM_nDyn EngM_numInt EngM_numLastTDC EngM_numRevCnt EngM_numSyncTDC EngM_numTDC EngM_phiDiffTDC EngM_phiInt EngM_phiIntExt EngM_phiTDC EngM_stCaSExt EngM_stCaSVerifyDiag EngM_stErrCanExt EngM_stEvent EngM_stInjCharSetVal EngM_stInjRls EngM_stNext EngM_stNextExt EngM_stSync EngM_tiSeg EngM_tiSegLimAvrg EngM_tiSegTwo /end OUT_MEASUREMENT
/end FUNCTION
/begin FUNCTION engm_ang_uic ""
 /begin OUT_MEASUREMENT EngM_ctFrstInj_mp EngM_ctIntOvrLoad_mp EngM_ctPostSync_mp EngM_ctVerSync_mp EngM_numTimeout_mp EngM_phiIntExtCorr_mp EngM_SchedDelta_mp EngM_SchedIndex_mp EngM_SchedLimitInt_mp EngM_SchedSegID_mp EngM_stEventEnable_mp EngM_stEventServed_mp EngM_stFrstInj_mp EngM_stTstDem_mp EngM_tiASD_nTask_mp EngM_tiDiffInt_mp EngM_tiSegTimeoutCurr_mp /end OUT_MEASUREMENT
/end FUNCTION
/begin FUNCTION engm_backup "Start und Betrieb des Motors nur mit Nockenwellensignal"
 /begin DEF_CHARACTERISTIC EngM_nMaxStrtBackUp_C EngM_stBackUpVar_C EngM_stEnaBackUp_C /end DEF_CHARACTERISTIC
/end FUNCTION
/begin FUNCTION engm_backup_uic "" /end FUNCTION
/begin FUNCTION engm_engmntctl "Motorlagersteuerung"
 /begin DEF_CHARACTERISTIC EngM_nAvrgHysDelta_C EngM_nAvrgHysHigh_CUR EngM_nAvrgLim_C EngM_stOutHard_C EngM_stOutSoft_C EngM_tiHardAftrGear_C EngM_tiSoftAftrStrt_C EngM_vVSSCDHysHigh_C EngM_vVSSCDHysLow_C /end DEF_CHARACTERISTIC
 /begin IN_MEASUREMENT Eng_tEng /end IN_MEASUREMENT
/end FUNCTION
/begin FUNCTION engm_engmntctl_msg "" /begin OUT_MEASUREMENT EngM_stOut /end OUT_MEASUREMENT /end FUNCTION
/begin FUNCTION engm_engmntctl_uic ""
 /begin OUT_MEASUREMENT EngM_nAvrgHysHigh_mp EngM_nAvrgHysLow_mp EngM_rCurrProf_mp EngM_stEngMntCtl_mp /end OUT_MEASUREMENT
/end FUNCTION
/begin FUNCTION engm_msg ""
 /begin OUT_MEASUREMENT EngM_ctRevIni EngM_ctRevSta EngM_nAvrg EngM_nCurr EngM_numCyl EngM_stCaSDrvOk EngM_stSpd EngM_stStrtRevRls Eng_dnAvrg Eng_nAvrg Eng_nCurr /end OUT_MEASUREMENT
/end FUNCTION
/begin FUNCTION engm_soptst "" /end FUNCTION
/begin FUNCTION engm_syncnocas "" /end FUNCTION
/begin FUNCTION engm_syncnocas_uic "" /end FUNCTION
/begin FUNCTION engm_tdsig "" /begin DEF_CHARACTERISTIC EngM_numTDSig_C /end DEF_CHARACTERISTIC /end FUNCTION
/begin FUNCTION engm_trqfrc "aktuelles Reibmoment"
 /begin DEF_CHARACTERISTIC EngM_dtrqFrcPDiffUp_C EngM_dtrqFrcPDiffDwn_C EngM_facTrqFrcPDiff_CUR EngM_numTrqFrc_C EngM_trqFrcPDiffMax_C EngM_trqFrcPDiffMin_C EngM_trqFrc_MAP /end DEF_CHARACTERISTIC
 /begin IN_MEASUREMENT EngM_tTrqFrc_mp Eng_nAvrg /end IN_MEASUREMENT
/end FUNCTION
/begin FUNCTION engm_trqfrcadpt "Reibmomentenadaption"
 /begin DEF_CHARACTERISTIC EngM_facT1Reliabl_C EngM_tiFltACoff_C EngM_tiFltACon_C EngM_nLISetDiffOffs_C EngM_stChkPN_C EngM_tAdptMin_C EngM_tiRelAdpt_C EngM_vLimRefuse_C EngM_vThresAdpt_C /end DEF_CHARACTERISTIC
/end FUNCTION
/begin FUNCTION engm_trqfrcadpt_msg ""
 /begin OUT_MEASUREMENT EngM_stAdpt EngM_stReliablAdpt EngM_trqDiffAdpt EngM_trqLossAdpt /end OUT_MEASUREMENT
/end FUNCTION
/begin FUNCTION engm_trqfrcadpt_uic ""
 /begin OUT_MEASUREMENT EngM_nLISetDiff_mp EngM_stGbxRel_mp EngM_stGenRel_mp EngM_stNDiffRng_mp EngM_trqFltACoff_mp EngM_trqFltACon_mp EngM_trqLossCompl_mp EngM_trqLossDiff_mp /end OUT_MEASUREMENT
/end FUNCTION
/begin FUNCTION engm_trqfrc_msg "" /begin OUT_MEASUREMENT EngM_trqFrc /end OUT_MEASUREMENT /end FUNCTION
/begin FUNCTION engm_trqfrc_uic "" /begin DEF_CHARACTERISTIC EngM_trqFrc_Vector EngM_trqFrc_Channel /end DEF_CHARACTERISTIC
 /begin OUT_MEASUREMENT EngM_stTrqFrcPDiffErr_mp EngM_trqFrcPDiffLim_mp EngM_trqFrcPDiffRaw_mp EngM_trqFrcPDiff_mp EngM_trqFrcT_mp EngM_tTrqFrc_mp /end OUT_MEASUREMENT
/end FUNCTION
/begin FUNCTION engm_uic "" /end FUNCTION
/begin FUNCTION engprt "Motormechanikschutz"
 /begin DEF_CHARACTERISTIC EngPrt_dTrqLimUp_C EngPrt_dTrqLimDown_C EngPrt_facAPSPrv_MAP EngPrt_facOvhtPrv_MAP EngPrt_nOvrSpd_C EngPrt_pAPSPrvDfl_C EngPrt_dtrqUpCBLim_C EngPrt_dtrqDwnCBLim_C EngPrt_dtrqUpNLim_C EngPrt_dtrqDwnNLim_C EngPrt_rVnDAMax_C EngPrt_rVnDAMin_C EngPrt_rVnTrqMax_C EngPrt_rVnTrqMin_C EngPrt_swtTrqGear_CUR EngPrt_trqCBLim1_CUR EngPrt_trqCBLim_CUR EngPrt_trqLim1_CUR EngPrt_trqLimDA_CUR EngPrt_trqLim_CUR EngPrt_trqNLimSpr_CUR EngPrt_trqNLim_CUR /end DEF_CHARACTERISTIC
 /begin IN_MEASUREMENT APSCD_pVal Eng_nAvrg Eng_tEng Gearbx_stGear VSSCD_v /end IN_MEASUREMENT
/end FUNCTION
/begin FUNCTION engprt_fwoscdet ""
 /begin DEF_CHARACTERISTIC EngPrt_nTrqShutOff_C EngPrt_tiFWOscDetDebDef_C EngPrt_tiFWOscDetDebOk_C /end DEF_CHARACTERISTIC
/end FUNCTION
/begin FUNCTION engprt_fwoscdet_msg "" /begin OUT_MEASUREMENT EngPrt_stFWOscDet /end OUT_MEASUREMENT /end FUNCTION
/begin FUNCTION engprt_fwoscdet_uic "" /end FUNCTION
/begin FUNCTION engprt_msg ""
 /begin OUT_MEASUREMENT EngPrt_facPrtLim EngPrt_stOvrSpd EngPrt_trqLim EngPrt_trqNLim EngPrt_trqOvhtPrv EngPrt_trqPrtLim /end OUT_MEASUREMENT
/end FUNCTION
/begin FUNCTION engprt_prtlim_var_uic "" /end FUNCTION
/begin FUNCTION engprt_qprtlim "Begrenzungmenge zum thermischen Motorschutz"
 /begin DEF_CHARACTERISTIC EngPrt_facOvhtPrvCT_CUR EngPrt_facOvhtPrvFT_CUR EngPrt_facOvhtPrvOT_CUR EngPrt_qOvhtPrvNRng_MAP EngPrt_qOvhtPrvVRng_MAP /end DEF_CHARACTERISTIC
 /begin IN_MEASUREMENT CTSCD_tClnt EngPrt_facOvhtPrv_mp Eng_nAvrg FTSCD_tFuel Gearbx_tOil VSSCD_v /end IN_MEASUREMENT
/end FUNCTION
/begin FUNCTION engprt_qprtlim_msg "" /begin OUT_MEASUREMENT EngPrt_qPrtLim /end OUT_MEASUREMENT /end FUNCTION
/begin FUNCTION engprt_qprtlim_uic "" /begin DEF_CHARACTERISTIC EngPrt_qPrtLim_Vector EngPrt_qPrtLim_Channel /end DEF_CHARACTERISTIC
 /begin OUT_MEASUREMENT EngPrt_facOvhtPrvCT_mp EngPrt_facOvhtPrvFT_mp EngPrt_facOvhtPrvOT_mp EngPrt_facOvhtPrv_mp EngPrt_qOvhtPrvNRng_mp EngPrt_qOvhtPrvVRng_mp /end OUT_MEASUREMENT
/end FUNCTION
/begin FUNCTION engprt_uic ""
 /begin DEF_CHARACTERISTIC EngPrt_trqNLim_Vector EngPrt_trqNLim_Channel EngPrt_trqPrtLim_Vector EngPrt_trqPrtLim_Channel /end DEF_CHARACTERISTIC
 /begin OUT_MEASUREMENT EngPrt_stTrqRampSwitch_mp EngPrt_trqLimPrvLim_mp EngPrt_trqRamLim1_mp EngPrt_trqRamLim_mp /end OUT_MEASUREMENT
/end FUNCTION
/begin FUNCTION engprt_var_msg "" /end FUNCTION
/begin FUNCTION eng_msg "" /begin OUT_MEASUREMENT Eng_stOvrTemp Eng_stOvrTemp2 Eng_trqCrvMax /end OUT_MEASUREMENT /end FUNCTION
/begin FUNCTION eng_teng "Motortemperatur"
 /begin DEF_CHARACTERISTIC Eng_tiOvrTemp2_C Eng_tiOvrTempOn2_C Eng_tiOvrTempOn_C Eng_tiOvrTemp_C /end DEF_CHARACTERISTIC
/end FUNCTION
/begin FUNCTION eng_teng_msg "" /begin OUT_MEASUREMENT Eng_tEng Eng_tFld Eng_tStrt /end OUT_MEASUREMENT /end FUNCTION
/begin FUNCTION eng_teng_uic "" /begin OUT_MEASUREMENT Eng_stEngRun_mp Eng_stOvrTemp_mp /end OUT_MEASUREMENT /end FUNCTION
/begin FUNCTION erlpcd "Fehlerlampe Komponententreiber"
 /begin DEF_CHARACTERISTIC ErLpCD_ctMilPwrStgOnMax_C ErLpCD_ctSysLmpPwrStgOnMax_C ErLpCD_tiDefMil_C ErLpCD_tiOkMil_C ErLpCD_nThresMil_C ErLpCD_tiMaxMil_C ErLpCD_tiMilTst_C ErLpCD_tiDelMil_C ErLpCD_tiBlkMil_C ErLpCD_swtMilEna_C ErLpCD_numDiaErrLmp_C ErLpCD_numDiaSysLmp_C ErLpCD_numDioOutErrLmp_C ErLpCD_numDioOutSysLmp_C ErLpCD_stRdy_C ErLpCD_tiRdy_C ErLpCD_tiBlkOn_C ErLpCD_tiBlkOff_C ErLpCD_stMilSPICtl_C ErLpCD_stPwrStgActvLmp_C ErLpCD_stPwrStgActvMil_C ErLpCD_stPwrStgDiaLmp_C ErLpCD_stPwrStgDiaMil_C ErLpCD_stSysLmpSPICtl_C ErLpCD_swtSysEqGlwLmp_C ErLpCD_tiDefSysLmp_C ErLpCD_tiOkSysLmp_C ErLpCD_nThresSysLmp_C ErLpCD_tiMaxSysLmp_C ErLpCD_tiTstSysLmp_C ErLpCD_tiDelSysLmp_C ErLpCD_tiBlkSysLmp_C ErLpCD_swtSysLmpEna_C ErLpCD_tiBtwTstMil_C ErLpCD_tiBtwTstSysLmp_C ErLpCD_tiMilPwrStgOn_C ErLpCD_tiSysLmpPwrStgOn_C /end DEF_CHARACTERISTIC
/end FUNCTION
/begin FUNCTION erlpcd_msg ""
 /begin OUT_MEASUREMENT ErLpCD_OrdGlwLmp ErLpCD_stMil ErLpCD_stMilLmpTst ErLpCD_stMilReq ErLpCD_stSysLmp ErLpCD_stSysLmpReq /end OUT_MEASUREMENT
/end FUNCTION
/begin FUNCTION erlpcd_uic "" /begin OUT_MEASUREMENT ErLpCD_stTstMIL_mp ErLpCD_stTstSysLmp_mp /end OUT_MEASUREMENT /end FUNCTION
/begin COMPU_METHOD AirMassPerCyl "Luftmasse pro Zylinder" RAT_FUNC "%6.3" "mg/Hub" COEFFS 0 10 0 0 0 1 /end COMPU_METHOD
/begin COMPU_METHOD AirMassPerTime "Luftmasse pro Zeit" RAT_FUNC "%6.3" "Kg/h" COEFFS 0 10 0 0 0 1 /end COMPU_METHOD
/begin COMPU_METHOD AngleCrS "Winkel Kurbelwelle" RAT_FUNC "%6.4" "deg CrS" COEFFS 0 42.6666666666667 0 0 0 1 /end COMPU_METHOD
/begin COMPU_METHOD Area "Flaeche mit hoher Aufloesung" RAT_FUNC "%6.5" "m*m" COEFFS 0 8192 0 0 0 1 /end COMPU_METHOD
/begin COMPU_METHOD Curr "Strom" RAT_FUNC "%6.2" "mA" COEFFS 0 1 0 0 0 1 /end COMPU_METHOD
/begin COMPU_METHOD DtyCyc "Tastverhaeltnis" RAT_FUNC "%6.4" "%" COEFFS 0 100 0 0 0 1 /end COMPU_METHOD
/begin COMPU_METHOD EGTFact "Umrechnung für EGT_TempGvnr Ausgabeschnittstellen und Messpunkte" RAT_FUNC "%6.5" "-" COEFFS 0 1000 0 0 0 1 /end COMPU_METHOD
/begin COMPU_METHOD EGTSwt "Umrechnung für EGT Rampenschalter (1 / 1000*2^14 )" RAT_FUNC "%10.9" "-" COEFFS 0 16384000 0 0 0 1 /end COMPU_METHOD
/begin COMPU_METHOD EGTSwt_S16 "Faktor (0...1) für sint16 Type mit 0.000061 Auflösung" RAT_FUNC "%7.6" "-" COEFFS 0 16384 0 0 0 1 /end COMPU_METHOD
/begin COMPU_METHOD EngN "Motordrehzahl" RAT_FUNC "%6.2" "rpm" COEFFS 0 1 0 0 0 1 /end COMPU_METHOD
/begin COMPU_METHOD EngTempFldSel "Verbale Umrechnung für Auswahl aus dem Motortemperatur-Feld Eng_tFld" TAB_VERB "%6.3" "-" COMPU_TAB_REF EngTempFldSel /end COMPU_METHOD
/begin COMPU_VTAB EngTempFldSel "Verbale Umrechnung für Auswahl aus dem Motortemperatur-Feld Eng_tFld" TAB_VERB 3 0 "Coolant_Temperature" 1 "Oil_Temperature" 2 "Eng_tEng" /end COMPU_VTAB
/begin COMPU_METHOD Eng_dN "Motorbeschleunigung" RAT_FUNC "%6.2" "rpm/s" COEFFS 0 1 0 0 0 1 /end COMPU_METHOD
/begin COMPU_METHOD Fact "Faktor mit Auflösung 1 / 8192, hauptsächlich für einen Faktorenbereich 0...1 verwendet" RAT_FUNC "%6.5" "-" COEFFS 0 8192 0 0 0 1 /end COMPU_METHOD
/begin COMPU_METHOD Fact1 "Faktor mit Auflösung 0,01 (100 mal höherer Bereich als Fact)" RAT_FUNC "%6.4" "-" COEFFS 0 128 0 0 0 1 /end COMPU_METHOD
/begin COMPU_METHOD Fact_EGT "Umrechnungsfaktor mit Aufloesung 0.001" RAT_FUNC "%6.5" "-" COEFFS 0 1000 0 0 0 1 /end COMPU_METHOD
/begin COMPU_METHOD Fact_PT1 "Faktor um die Zeitkonstante eines PT1 filters festzulegen (Taupunktermittlung)" RAT_FUNC "%6.4" "W/K" COEFFS 0 128 0 0 0 1 /end COMPU_METHOD
/begin COMPU_METHOD HeatCapacity "Waermekapazitaet einer Substanz" RAT_FUNC "%6.3" "J/K" COEFFS 0 10 0 0 0 1 /end COMPU_METHOD
/begin COMPU_METHOD InjMass "Einspritzmenge" RAT_FUNC "%6.4" "mg/hub" COEFFS 0 100 0 0 0 1 /end COMPU_METHOD
/begin COMPU_METHOD InjMassCyc "Einspritzmenge pro Zyklus (mg/Zyklus)" RAT_FUNC "%6.4" "mg/cyc" COEFFS 0 100 0 0 0 1 /end COMPU_METHOD
/begin COMPU_METHOD InjMassInj "Einspritzmenge pro Einspritzung (mg/Einspritzung)" RAT_FUNC "%6.4" "mg/inj" COEFFS 0 100 0 0 0 1 /end COMPU_METHOD
/begin COMPU_METHOD InjMassNSlp "Steigung der Korrektureinspritzmenge aufgrund der Drehzahlrichtung" RAT_FUNC "%7.6" "(mg/hub)/rpm" COEFFS 0 10000 0 0 0 1 /end COMPU_METHOD
/begin COMPU_METHOD InjMassQSlp "Steigung der Korrektureinspritzmenge aufgrund der Mengenrichtung" RAT_FUNC "%6.4" "-" COEFFS 0 100 0 0 0 1 /end COMPU_METHOD
/begin COMPU_METHOD InjTime_us "Zeit in Microsekunden für das Einspritztiming" RAT_FUNC "%6.2" "us" COEFFS 0 1 0 0 0 1 /end COMPU_METHOD
/begin COMPU_METHOD Ki_Kelv_Sec "Verstärkungskonstante für Integrator für zeitliche Ableitung der Temperatur" RAT_FUNC "%6.4" "1/s" COEFFS 0 429.4967296 0 0 0 1 /end COMPU_METHOD
/begin COMPU_METHOD Ki_mOil "" RAT_FUNC "%6.5" "s" COEFFS 0 1024 0 0 0 1 /end COMPU_METHOD
/begin COMPU_METHOD Ki_Temp2EGTFact "Umrechnung für die Integrator Verstärkung des PI Reglers im EGT_TempGvnr [1/K]" RAT_FUNC "%8.7" "1/(K*s)" COEFFS 0 858993.4592 0 0 0 1 /end COMPU_METHOD
/begin COMPU_METHOD Kp_Temp2EGTFact "Umrechnung für die Proportional Verstärkung des PI Reglers im EGT_TempGvnr [1/K]" RAT_FUNC "%7.6" "1/K" COEFFS 0 51200 0 0 0 1 /end COMPU_METHOD
/begin COMPU_METHOD lambda "Lambda" RAT_FUNC "%6.5" "-" COEFFS 0 1000 0 0 0 1 /end COMPU_METHOD
/begin COMPU_METHOD Length1 "Abstand in Meter" RAT_FUNC "%6.4" "m" COEFFS 0 128 0 0 0 1 /end COMPU_METHOD
/begin COMPU_METHOD mSoot_g "Rußmasse [g]" RAT_FUNC "%6.4" "g" COEFFS 0 100 0 0 0 1 /end COMPU_METHOD
/begin COMPU_METHOD NumPinAdc "verbale Umrechnung für ADC Signale" TAB_VERB "%6.3" "-" COMPU_TAB_REF NumPinAdc /end COMPU_METHOD
/begin COMPU_VTAB NumPinAdc "verbale Umrechnung für ADC Signale" TAB_VERB 27 0 "Water_Temperature_Sensor_182" 1 "Intake_Air_Temperature_Sensor_157" 2 "Charge_Air_Temperature_Sensor_183" 3 "Exhaust_Temperature_Sensor_2_134" 4 "Exhaust_Temperature_Sensor_1_158" 5 "1st_APP_Sensor_252" 6 "2nd_APP_Sensor_239" 7 "ADC_REF" 8 "Boost_Pressure_Sensor_154" 9 "Atmospheric_Pressure_Sensor" 10 "Battery_Voltage_Sensor" 11 "Rail_Pressure_Sensor_156" 12 "Rail_Pressure_Peak_Value_156" 13 "Booster_Voltage_Sensor" 14 "Current_MeUn_Sensor" 15 "Current_PCV_Sensor" 16 "Voltage_Bank_1" 17 "Voltage_Bank_2" 18 "Pressure_Upstream_Particle_Filter_159" 19 "Engine_Oil_Pressure_110" 20 "Temperature_ECU_PCB" 21 "Voltage_Lambda_Ua" 22 "Voltage_Lambda_Ri" 23 "EMCCD_Current_Governor1_124" 24 "EMCCD_Current_Governor2_121" 25 "ADC_DUMMY_NOT_USED" 26 "ADC_DUMMY_A_NOT_USED" /end COMPU_VTAB
/begin COMPU_METHOD NumPinDia "Verbale Umrechnung für Diagnose Signale" TAB_VERB "%6.3" "-" COMPU_TAB_REF NumPinDia /end COMPU_METHOD
/begin COMPU_VTAB NumPinDia "Verbale Umrechnung für Diagnose Signale" TAB_VERB 28 0 "CJ945_Diagnostic_Signal" 1 "AC_Compressor_DiaSig" 2 "Fuel_Pump_Diagnostic_Signal_232" 3 "Starter_234" 4 "Oil_Pressure_Lamp_Switch_245" 5 "EGRClg_Byp_Diagnostic_Signal_123" 6 "Ebox_Fan_Actuator_Diagnostic_Signal_219" 7 "Shuttr_Actuator_Diagnostic_Signal_231" 8 "Twostage_TurboLoading_SW_DiaSig" 9 "DIO_OUT_DIAGNOSTIC_DUMMY_NOT_USED" 10 "Alternator" 11 "Boost_Pressure_Actuator_Diagnostic_Signal_193" 12 "EGR_Actuator_Diagnostic_Signal_194" 13 "1st_Pressure_Control_Valve_Diagnostic_Signal_172" 14 "2nd_Pressure_Control_Valve_Diagnostic_Signal_172" 15 "1st_Metering_Unit_Diagnostic_Signal_171" 16 "2nd_Metering_Unit_Diagnostic_Signal_171" 17 "Variable_Swirl_Actuator_Diagnostic_Signal_195" 18 "FAN_240" 19 "Add_On_Heater_244" 20 "EngM_Bearing_Actuator_Diagnostic_Signal_124" 21 "EngM_Bearing_Actuator_Diagnostic_Signal_121" 22 "Throttle_Valve_Diagnostic_Signal_196" 23 "Low pressure stage BPA_Diagnostic_Signal_117" 24 "PWM_DIAGNOSTIC_DUMMY_NOT_USED" 25 "1st_Sensor_Supply_Voltage_DiaSig" 26 "2nd_Sensor_Supply_Voltage_DiaSig" 27 "3rd_Sensor_Supply_Voltage_DiaSig" /end COMPU_VTAB
/begin COMPU_METHOD NumPinDioOut "Verbale Umrechnung für Digitalausgang Signale" TAB_VERB "%6.3" "-" COMPU_TAB_REF NumPinDioOut /end COMPU_METHOD
/begin COMPU_VTAB NumPinDioOut "Verbale Umrechnung für Digitalausgang Signale" TAB_VERB 12 0 "Main_Relay_220(144)" 1 "AC_Compressor" 2 "Fuel_Pump_232" 3 "Starter_234" 4 "OPS_Lamp_245" 5 "EGRClg_Byp_123" 6 "Ebox_Fan_Actuator_219" 7 "Shuttr_Actuator_Digital_231" 8 "STATREG_PSOFF_Bit" 9 "Twostage_TurboLoading_120" 10 "TD_Signal_253" 11 "DIO_OUT_DUMMY_NOT_USED" /end COMPU_VTAB
/begin COMPU_METHOD NumPinPwmOut "Verbale Umrechnung für PWM-Ausgang Signale" TAB_VERB "%6.3" "-" COMPU_TAB_REF NumPinPwmOut /end COMPU_METHOD
/begin COMPU_VTAB NumPinPwmOut "Verbale Umrechnung für PWM-Ausgang Signale" TAB_VERB 14 0 "Boost_Pressure_Actuator_193" 1 "EGR_Actuator_194" 2 "PCV_Actuator_172" 3 "MeUn_Actuator_171" 4 "Variable_Swirl_Actuator_195" 5 "Fan_Actuator_240" 6 "Add_On_Heater_244" 7 "EngM_Bearing_Actuator_124" 8 "EngM_Bearing_Actuator_121" 9 "Throttle_Valve_196" 10 "LSU_Heater_PWMOutput" 11 "Low pressure stage BPA_117" 12 "Shuttr_Actuator_PWM_231" 13 "PWM_DUMMY_NOT_USED" /end COMPU_VTAB
/begin COMPU_METHOD OilMass "Oil mass in Kg" RAT_FUNC "%6.5" "g" COEFFS 0 1000 0 0 0 1 /end COMPU_METHOD
/begin COMPU_METHOD OilMassPerTime "" RAT_FUNC "%6.4" "mg/s" COEFFS 0 100 0 0 0 1 /end COMPU_METHOD
/begin COMPU_METHOD OilMassPrc "" RAT_FUNC "%6.5" "g" COEFFS 0 1000 0 0 0 1 /end COMPU_METHOD
/begin COMPU_METHOD OilMassRed "" RAT_FUNC "%6.2" "g" COEFFS 0 0.244140625 0 0 0 1 /end COMPU_METHOD
/begin COMPU_METHOD OneToOne "eins zu eins (physikalischer Wert ist gleich dem internen Wert)" RAT_FUNC "%6.2" "-" COEFFS 0 1 0 0 0 1 /end COMPU_METHOD
/begin COMPU_METHOD Period "Periodendauer" RAT_FUNC "%6.3" "ms" COEFFS 0 10 0 0 0 1 /end COMPU_METHOD
/begin COMPU_METHOD Pres_hPa "Druck (angezeigt in [hPa])" RAT_FUNC "%6.2" "hPa" COEFFS 0 1 0 0 0 1 /end COMPU_METHOD
/begin COMPU_METHOD Pwr "Leistung" RAT_FUNC "%6.2" "W" COEFFS 0 0.10610329539459 0 0 0 1 /end COMPU_METHOD
/begin COMPU_METHOD Pwr1 "Leistung mit Hoher Aufloesung" RAT_FUNC "%6.3" "W" COEFFS 0 10 0 0 0 1 /end COMPU_METHOD
/begin COMPU_METHOD Resist "Widerstand" RAT_FUNC "%6.3" "Ohm" COEFFS 0 10 0 0 0 1 /end COMPU_METHOD
/begin COMPU_METHOD ReynoldsNum "Reynolds Nummer um den thermischen Koeffizienten zu bestimmen" RAT_FUNC "%6.0" "-" COEFFS 0 0.01 0 0 0 1 /end COMPU_METHOD
/begin COMPU_METHOD RhoFuel "Kraftstoffdichte" RAT_FUNC "%6.3" "kg/m^3" COEFFS 0 10 0 0 0 1 /end COMPU_METHOD
/begin COMPU_METHOD RmpCurr "Einheit für Rampe des Stroms mA/sec" RAT_FUNC "%6.4" "mA/s" COEFFS 0 65.536 0 0 0 1 /end COMPU_METHOD
/begin COMPU_METHOD RmpTrq "Rampengradient für Motormoment" RAT_FUNC "%6.4" "Nm/s" COEFFS 0 655.36 0 0 0 1 /end COMPU_METHOD
/begin COMPU_METHOD SpecificHeat "spezifische Waermekapazitaet einer Substanz" RAT_FUNC "%7.6" "J/g/K" COEFFS 0 10000 0 0 0 1 /end COMPU_METHOD
/begin COMPU_METHOD TempDiff_Cels "difference/offset temperature displayed in degree celcius" RAT_FUNC "%6.3" "deg C" COEFFS 0 10 0 0 0 1 /end COMPU_METHOD
/begin COMPU_METHOD Temp_Cels "Temperatur dargestellt in °C (gleiche interne Darstellung wie Temp_Kelv)" RAT_FUNC "%6.1" "deg C" COEFFS 0 10 2731.4 0 0 1 /end COMPU_METHOD
/begin COMPU_METHOD Temp_Kelv_Sec "Temperaturaenderungsrate" RAT_FUNC "%6.4" "K/s" COEFFS 0 100 0 0 0 1 /end COMPU_METHOD
/begin COMPU_METHOD ThermalCoEff "Waermekoeffiziens einer Substanz" RAT_FUNC "%6.3" "W/m/m/K" COEFFS 0 10 0 0 0 1 /end COMPU_METHOD
/begin COMPU_METHOD TimeDeb "Entprellzeit in Millisekunden für Libraryfunktion Debounce" RAT_FUNC "%6.1" "ms" COEFFS 0 0.1 0 0 0 1 /end COMPU_METHOD
/begin COMPU_METHOD TimeDelay_s "Zeitkonstante T1 (in s) für PT1, DT1, etc." RAT_FUNC "%9.3" "s" COEFFS 0 0 1 0 0.00023283064365387 0 /end COMPU_METHOD
/begin COMPU_METHOD TimeDT "Abtastzeit (in us) für Library Regler, Filter, etc." RAT_FUNC "%6.2" "us" COEFFS 0 1 0 0 0 1 /end COMPU_METHOD
/begin COMPU_METHOD TimeEGTRmp "Umrechnung  Zeit in Rampensteigung,  Verwendet in EGT-Bibliothek" RAT_FUNC "%6.3" "s" COEFFS 0 0 1 0 0.0152587890625 0 /end COMPU_METHOD
/begin COMPU_METHOD TimeOneToOne "" RAT_FUNC "%6.2" "s" COEFFS 0 1 0 0 0 1 /end COMPU_METHOD
/begin COMPU_METHOD TimeSys_us "Zeit in [us] mit Systemzeit-Auflösung" RAT_FUNC "%6.3" "us" COEFFS 0 3.4965 0 0 0 1 /end COMPU_METHOD
/begin COMPU_METHOD Time_ms "Zeit in ms für Fehlerentprellung (DSM) und SW-Timer" RAT_FUNC "%6.1" "ms" COEFFS 0 0.1 0 0 0 1 /end COMPU_METHOD
/begin COMPU_METHOD Time_s "Zeit in s für Fehlerentprellung (DSM) und SW-Timer" RAT_FUNC "%6.4" "s" COEFFS 0 100 0 0 0 1 /end COMPU_METHOD
/begin COMPU_METHOD Trq "Motormoment" RAT_FUNC "%6.3" "Nm" COEFFS 0 10 0 0 0 1 /end COMPU_METHOD
/begin COMPU_METHOD Vel "Fahrzeuggeschwindigkeit, gleiche interne Auflösung wie Vel_SI" RAT_FUNC "%6.4" "km/h" COEFFS 0 100 0 0 0 1 /end COMPU_METHOD
/begin COMPU_METHOD VelToN "Verhältnis Fahrzeuggeschwindigkeit zu Motordrehzahl v/n" RAT_FUNC "%8.7" "(km/h)/rpm" COEFFS 0 100000 0 0 0 1 /end COMPU_METHOD
/begin COMPU_METHOD Volt "Spannung in V (von ADC)" RAT_FUNC "%6.2" "mV" COEFFS 0 0.2046 0 0 0 1 /end COMPU_METHOD
/begin COMPU_METHOD Volt_Batt "Batteriespannung" RAT_FUNC "%6.1" "mV" COEFFS 0 0.05115 0 0 0 1 /end COMPU_METHOD
/begin COMPU_METHOD Vol_Oil "" RAT_FUNC "%6.4" "l" COEFFS 0 100 0 0 0 1 /end COMPU_METHOD
/begin RECORD_LAYOUT Kf_Xs16_Ys16_Ws16 NO_AXIS_PTS_X 1 SWORD NO_AXIS_PTS_Y 2 SWORD AXIS_PTS_X 3 SWORD INDEX_INCR DIRECT AXIS_PTS_Y 4 SWORD INDEX_INCR DIRECT FNC_VALUES 5 SWORD COLUMN_DIR DIRECT /end RECORD_LAYOUT
/begin RECORD_LAYOUT Kl_Xs16_Ws16 NO_AXIS_PTS_X 1 SWORD AXIS_PTS_X 2 SWORD INDEX_INCR DIRECT FNC_VALUES 3 SWORD COLUMN_DIR DIRECT /end RECORD_LAYOUT
/begin RECORD_LAYOUT Kwb_Ws16 FNC_VALUES 1 SWORD COLUMN_DIR DIRECT /end RECORD_LAYOUT
/begin RECORD_LAYOUT Kwb_Wu16 FNC_VALUES 1 UWORD COLUMN_DIR DIRECT /end RECORD_LAYOUT
/begin RECORD_LAYOUT Kwb_Wu32 FNC_VALUES 1 ULONG COLUMN_DIR DIRECT /end RECORD_LAYOUT
/begin RECORD_LAYOUT Kwb_Wu8 FNC_VALUES 1 UBYTE COLUMN_DIR DIRECT /end RECORD_LAYOUT
/begin RECORD_LAYOUT Kw_Ws16 FNC_VALUES 1 SWORD COLUMN_DIR DIRECT /end RECORD_LAYOUT
/begin RECORD_LAYOUT Kw_Ws32 FNC_VALUES 1 SLONG COLUMN_DIR DIRECT /end RECORD_LAYOUT
/begin RECORD_LAYOUT Kw_Wu16 FNC_VALUES 1 UWORD COLUMN_DIR DIRECT /end RECORD_LAYOUT
/begin RECORD_LAYOUT Kw_Wu32 FNC_VALUES 1 ULONG COLUMN_DIR DIRECT /end RECORD_LAYOUT
/begin RECORD_LAYOUT Kw_Wu8 FNC_VALUES 1 UBYTE COLUMN_DIR DIRECT /end RECORD_LAYOUT
/end MODULE
/end PROJECT
