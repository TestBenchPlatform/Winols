/* MODASAP: (V10.0.1 - 11.02.2004) Datei /vobs/edc/bin/edc16_13.a2l bearbeitet: 13.10.2004 17:40:09 by system solaris*/
/* Erstellt von DAMOS++ V1.20-1 SunOS */
ASAP2_VERSION 1 3
/begin PROJECT P411 "BMW DDE6.0 6-Zylinder V96.2 14.10.2004"
/begin HEADER "" VERSION "V96.2_6Z" PROJECT_NO P411 /end HEADER
/begin MODULE DIM ""
/begin MOD_PAR "B_EDC16" VERSION "XXX" CUSTOMER_NO "999" USER "X" PHONE_NO "X" CPU_TYPE "GreenOak" ECU "GrO3"
 /begin MEMORY_SEGMENT Pst8000 "" CODE FLASH INTERN 0x8000 0xB8000 -1 -1 -1 -1 -1 /begin IF_DATA ETK ADDRESS_MAPPING 0x8000 0x8000 0xB8000 /end IF_DATA /end MEMORY_SEGMENT
 /begin MEMORY_SEGMENT Pst400000 "" CODE FLASH INTERN 0x400000 0x080000 -1 -1 -1 -1 -1 /begin IF_DATA ETK ADDRESS_MAPPING 0x400000 0x400000 0x080000 /end IF_DATA /end MEMORY_SEGMENT
 /begin MEMORY_SEGMENT DstC0000 "" DATA FLASH INTERN 0xC0000 0x3DF78 -1 -1 -1 -1 -1 /begin IF_DATA ETK ADDRESS_MAPPING 0xC0000 0x8C0000 0x3DF78 /end IF_DATA /end MEMORY_SEGMENT
 /begin MEMORY_SEGMENT DstFDF78 "" RESERVED FLASH INTERN 0xFDF78 0x88 -1 -1 -1 -1 -1 /begin IF_DATA ETK ADDRESS_MAPPING 0xFDF78 0x8FDF78 0x88 /end IF_DATA /end MEMORY_SEGMENT
 /begin MEMORY_SEGMENT ExtRam8FE000 "" VARIABLES RAM EXTERN 0x8FE000 0x2000 -1 -1 -1 -1 -1 /* AsapMLXFm - CCP_V2_3 */ /begin IF_DATA ETK ADDRESS_MAPPING 0x8FE000 0x8FE000 0x2000 /end IF_DATA /* AsapMLXFm - KWP2000 */ /* AsapMLXFm - McMess */ /end MEMORY_SEGMENT
 /begin MEMORY_SEGMENT Ram7F8000 "" VARIABLES RAM INTERN 0x7F8000 0x8000 -1 -1 -1 -1 -1 /end MEMORY_SEGMENT
 /begin MEMORY_SEGMENT Ram6F8000 "" VARIABLES RAM INTERN 0x6F8000 0x800 -1 -1 -1 -1 -1 /end MEMORY_SEGMENT
 /begin MEMORY_SEGMENT Ram800000 "" VARIABLES RAM INTERN 0x800000 0x8000 -1 -1 -1 -1 -1 /end MEMORY_SEGMENT
 SYSTEM_CONSTANT "ACCD_PANALIN_CUR_X" "2"
 SYSTEM_CONSTANT "ACCD_PPRESLIN_CUR_X" "2"
 SYSTEM_CONSTANT "ACCD_PRESSEL_ANALOG" "1"
 SYSTEM_CONSTANT "ACCD_PRESSEL_PWM" "2"
 SYSTEM_CONSTANT "ACCD_SWTPRESSEL_TYPE" "2"
 SYSTEM_CONSTANT "ACCD_SWTPRESSEL_VAL" "2"
 SYSTEM_CONSTANT "ACCD_SWTSIG_TYPE" "2"
 SYSTEM_CONSTANT "ACCD_SWTSIG_VAL" "0"
 SYSTEM_CONSTANT "ACCPED_NERR_CUR_X" "2"
 SYSTEM_CONSTANT "ACCPED_RFDC_CUR_X" "16"
 SYSTEM_CONSTANT "ACCPED_RPLAMAXVAL_CUR_X" "6"
 SYSTEM_CONSTANT "ACCPED_TRQENG_MAP_X" "16"
 SYSTEM_CONSTANT "ACCPED_TRQENG_MAP_Y" "10"
 SYSTEM_CONSTANT "ACCPED_TRQPRP_MAP_X" "2"
 SYSTEM_CONSTANT "ACCPED_TRQPRP_MAP_Y" "2"
 SYSTEM_CONSTANT "ACC_MAX" "10"
 SYSTEM_CONSTANT "ACC_NORM_FAC" "2777777.77777778"
 SYSTEM_CONSTANT "ACC_RES" "0.001"
 SYSTEM_CONSTANT "ACC_TRQREDSHFT_CUR_X" "7"
 SYSTEM_CONSTANT "ACC_ZERO" "0"
 SYSTEM_CONSTANT "ACTRQC_TRQAC_CUR_X" "16"
 SYSTEM_CONSTANT "ADC_RES" "1023"
 SYSTEM_CONSTANT "ADDPMP_SWTSERVICE_TYPE" "2"
 SYSTEM_CONSTANT "ADDPMP_SWTSERVICE_VAL" "0"
 SYSTEM_CONSTANT "ADDPMP_VOLADDDEM_CUR_X" "2"
 SYSTEM_CONSTANT "AFSCD_DMAIRSUBSVAL_MAP_X" "16"
 SYSTEM_CONSTANT "AFSCD_DMAIRSUBSVAL_MAP_Y" "16"
 SYSTEM_CONSTANT "AFSCD_DMLINHFM6_CUR_X" "57"
 SYSTEM_CONSTANT "AFSCD_DOUBLE" "2"
 SYSTEM_CONSTANT "AFSCD_FACCOREXT_CUR_X" "3"
 SYSTEM_CONSTANT "AFSCD_MAIRCONV" "33333"
 SYSTEM_CONSTANT "AFSCD_PLSCOR_MAP_X" "2"
 SYSTEM_CONSTANT "AFSCD_PLSCOR_MAP_Y" "2"
 SYSTEM_CONSTANT "AFSCD_QAIRMTHRSRCHIACTV_CUR_X" "14"
 SYSTEM_CONSTANT "AFSCD_QWINLDADJHI_CUR_X" "4"
 SYSTEM_CONSTANT "AFSCD_QWINLDADJLO_CUR_X" "5"
 SYSTEM_CONSTANT "AFSCD_SENSSEL_SWT" "1"
 SYSTEM_CONSTANT "AFSCD_SINGLE" "1"
 SYSTEM_CONSTANT "AFSCD_SWTAIRSYS_TYPE" "0"
 SYSTEM_CONSTANT "AFSCD_SWTAIRSYS_VAL" "1"
 SYSTEM_CONSTANT "AFSCD_SWTHFM5" "0"
 SYSTEM_CONSTANT "AFSCD_SWTHFM6" "1"
 SYSTEM_CONSTANT "AFSCD_SWTSENSINST_TYPE" "2"
 SYSTEM_CONSTANT "AFSCD_SWTSENSINST_VAL" "1"
 SYSTEM_CONSTANT "AFSCD_SWTSENSSEL_TYPE" "0"
 SYSTEM_CONSTANT "AFSCD_SWTSENSSEL_VAL" "1"
 SYSTEM_CONSTANT "AFSCD_SWTSENS_INST" "1"
 SYSTEM_CONSTANT "AFSCD_SWTSENS_NOTINST" "0"
 SYSTEM_CONSTANT "AFSCD_SWT_HFM5" "0"
 SYSTEM_CONSTANT "AFSCD_SWT_HFM6" "1"
 SYSTEM_CONSTANT "AFSCD_TLIN_CUR_X" "11"
 SYSTEM_CONSTANT "AFS_FACDYNCORR1_CUR_X" "7"
 SYSTEM_CONSTANT "AFS_FACNENGDYN_MAP_X" "7"
 SYSTEM_CONSTANT "AFS_FACNENGDYN_MAP_Y" "7"
 SYSTEM_CONSTANT "AFS_FACVEHSPD_MAP_X" "3"
 SYSTEM_CONSTANT "AFS_FACVEHSPD_MAP_Y" "3"
 SYSTEM_CONSTANT "AFS_TRQBASEDYN_MAP_X" "7"
 SYSTEM_CONSTANT "AFS_TRQBASEDYN_MAP_Y" "7"
 SYSTEM_CONSTANT "AFS_TRQBASESTATE_MAP_X" "9"
 SYSTEM_CONSTANT "AFS_TRQBASESTATE_MAP_Y" "7"
 SYSTEM_CONSTANT "AFS_TRQDISABLE_MAP_X" "2"
 SYSTEM_CONSTANT "AFS_TRQDISABLE_MAP_Y" "2"
 SYSTEM_CONSTANT "AFS_TRQDYNCORR1_MAP_X" "7"
 SYSTEM_CONSTANT "AFS_TRQDYNCORR1_MAP_Y" "7"
 SYSTEM_CONSTANT "AIRCTL_ADD" "0"
 SYSTEM_CONSTANT "AIRCTL_APCORRGN_CUR_X" "8"
 SYSTEM_CONSTANT "AIRCTL_APSCORRGN_CUR_X" "25"
 SYSTEM_CONSTANT "AIRCTL_APSCOR_CUR_X" "8"
 SYSTEM_CONSTANT "AIRCTL_ATCORRGN_CUR_X" "6"
 SYSTEM_CONSTANT "AIRCTL_DKDNEGAGR_CUR_X" "8"
 SYSTEM_CONSTANT "AIRCTL_DKDNEGAGR_MAP_X" "8"
 SYSTEM_CONSTANT "AIRCTL_DKDNEGAGR_MAP_Y" "8"
 SYSTEM_CONSTANT "AIRCTL_DKDNEGQDES_CUR_X" "8"
 SYSTEM_CONSTANT "AIRCTL_DKDNEGQDES_MAP_X" "8"
 SYSTEM_CONSTANT "AIRCTL_DKDNEGQDES_MAP_Y" "8"
 SYSTEM_CONSTANT "AIRCTL_DKDNEGRGN_MAP_X" "8"
 SYSTEM_CONSTANT "AIRCTL_DKDNEGRGN_MAP_Y" "8"
 SYSTEM_CONSTANT "AIRCTL_DKDPOSAGR_CUR_X" "8"
 SYSTEM_CONSTANT "AIRCTL_DKDPOSAGR_MAP_X" "8"
 SYSTEM_CONSTANT "AIRCTL_DKDPOSAGR_MAP_Y" "8"
 SYSTEM_CONSTANT "AIRCTL_DKDPOSQDES_CUR_X" "8"
 SYSTEM_CONSTANT "AIRCTL_DKDPOSQDES_MAP_X" "8"
 SYSTEM_CONSTANT "AIRCTL_DKDPOSQDES_MAP_Y" "8"
 SYSTEM_CONSTANT "AIRCTL_DKDPOSRGN_MAP_X" "8"
 SYSTEM_CONSTANT "AIRCTL_DKDPOSRGN_MAP_Y" "8"
 SYSTEM_CONSTANT "AIRCTL_DNSURGEHIGH_CUR_X" "5"
 SYSTEM_CONSTANT "AIRCTL_DNSURGELOW_CUR_X" "5"
 SYSTEM_CONSTANT "AIRCTL_FACAPSMAIRDYNCOR1_CUR_X" "6"
 SYSTEM_CONSTANT "AIRCTL_FACATPARADPKD_CUR_X" "8"
 SYSTEM_CONSTANT "AIRCTL_FACATPARADPKI_CUR_X" "8"
 SYSTEM_CONSTANT "AIRCTL_FACATPARADPKP_CUR_X" "8"
 SYSTEM_CONSTANT "AIRCTL_FACCTSCOR1_CUR_X" "10"
 SYSTEM_CONSTANT "AIRCTL_FACCTSCOR2_CUR_X" "8"
 SYSTEM_CONSTANT "AIRCTL_FACCTSCORRGN_CUR_X" "10"
 SYSTEM_CONSTANT "AIRCTL_FACDQMAIRDYNCOR1_CUR_X" "6"
 SYSTEM_CONSTANT "AIRCTL_FACEGRCTLATCOR_CUR_X" "6"
 SYSTEM_CONSTANT "AIRCTL_FACEGRCTLCTCOR_CUR_X" "6"
 SYSTEM_CONSTANT "AIRCTL_FACEGRRGNCORR_CUR_X" "8"
 SYSTEM_CONSTANT "AIRCTL_FACETMAIRDYNCOR1_CUR_X" "6"
 SYSTEM_CONSTANT "AIRCTL_FACIATSCORRGN_CUR_X" "10"
 SYSTEM_CONSTANT "AIRCTL_FACIATSCOR_CUR_X" "10"
 SYSTEM_CONSTANT "AIRCTL_FACIATSMAIRDYNCOR1_CUR_X" "6"
 SYSTEM_CONSTANT "AIRCTL_FACIATSPAR_CUR_X" "25"
 SYSTEM_CONSTANT "AIRCTL_FACNQPARADPKD_MAP_X" "8"
 SYSTEM_CONSTANT "AIRCTL_FACNQPARADPKD_MAP_Y" "8"
 SYSTEM_CONSTANT "AIRCTL_FACNQPARADPKI_MAP_X" "8"
 SYSTEM_CONSTANT "AIRCTL_FACNQPARADPKI_MAP_Y" "8"
 SYSTEM_CONSTANT "AIRCTL_FACNQPARADPKP_MAP_X" "8"
 SYSTEM_CONSTANT "AIRCTL_FACNQPARADPKP_MAP_Y" "8"
 SYSTEM_CONSTANT "AIRCTL_FACNQPAR_MAP_X" "16"
 SYSTEM_CONSTANT "AIRCTL_FACNQPAR_MAP_Y" "16"
 SYSTEM_CONSTANT "AIRCTL_FACPRESDIFFCOR_CUR_X" "8"
 SYSTEM_CONSTANT "AIRCTL_FACTVACTLATCOR_CUR_X" "6"
 SYSTEM_CONSTANT "AIRCTL_FACTVACTLCTCOR_CUR_X" "6"
 SYSTEM_CONSTANT "AIRCTL_MAIRDYNCOR1_MAP_X" "12"
 SYSTEM_CONSTANT "AIRCTL_MAIRDYNCOR1_MAP_Y" "8"
 SYSTEM_CONSTANT "AIRCTL_MDESBASDEF_MAP_X" "16"
 SYSTEM_CONSTANT "AIRCTL_MDESBASDEF_MAP_Y" "16"
 SYSTEM_CONSTANT "AIRCTL_MDESBASFDC_MAP_X" "16"
 SYSTEM_CONSTANT "AIRCTL_MDESBASFDC_MAP_Y" "16"
 SYSTEM_CONSTANT "AIRCTL_MDESBASRGN1_MAP_X" "16"
 SYSTEM_CONSTANT "AIRCTL_MDESBASRGN1_MAP_Y" "16"
 SYSTEM_CONSTANT "AIRCTL_MDESBASRGN2_MAP_X" "16"
 SYSTEM_CONSTANT "AIRCTL_MDESBASRGN2_MAP_Y" "16"
 SYSTEM_CONSTANT "AIRCTL_MDESBAS_MAP_X" "16"
 SYSTEM_CONSTANT "AIRCTL_MDESBAS_MAP_Y" "16"
 SYSTEM_CONSTANT "AIRCTL_MDESGEARCORR_MAP_X" "4"
 SYSTEM_CONSTANT "AIRCTL_MDESGEARCORR_MAP_Y" "4"
 SYSTEM_CONSTANT "AIRCTL_MDESGEAR_MAP_X" "4"
 SYSTEM_CONSTANT "AIRCTL_MDESGEAR_MAP_Y" "4"
 SYSTEM_CONSTANT "AIRCTL_MDESLIM_MAP_X" "16"
 SYSTEM_CONSTANT "AIRCTL_MDESLIM_MAP_Y" "16"
 SYSTEM_CONSTANT "AIRCTL_MDESRGN1_MAP_X" "16"
 SYSTEM_CONSTANT "AIRCTL_MDESRGN1_MAP_Y" "16"
 SYSTEM_CONSTANT "AIRCTL_MDESRGN2_MAP_X" "16"
 SYSTEM_CONSTANT "AIRCTL_MDESRGN2_MAP_Y" "16"
 SYSTEM_CONSTANT "AIRCTL_MDESRGN3_MAP_X" "16"
 SYSTEM_CONSTANT "AIRCTL_MDESRGN3_MAP_Y" "16"
 SYSTEM_CONSTANT "AIRCTL_MDESRMP_CUR_X" "8"
 SYSTEM_CONSTANT "AIRCTL_MMAXDVTRGN_MAP_X" "8"
 SYSTEM_CONSTANT "AIRCTL_MMAXDVTRGN_MAP_Y" "4"
 SYSTEM_CONSTANT "AIRCTL_MMAXDVT_MAP_X" "16"
 SYSTEM_CONSTANT "AIRCTL_MMAXDVT_MAP_Y" "16"
 SYSTEM_CONSTANT "AIRCTL_MNQCTSCOR1_MAP_X" "16"
 SYSTEM_CONSTANT "AIRCTL_MNQCTSCOR1_MAP_Y" "16"
 SYSTEM_CONSTANT "AIRCTL_MNQCTSCOR2_MAP_X" "12"
 SYSTEM_CONSTANT "AIRCTL_MNQCTSCOR2_MAP_Y" "16"
 SYSTEM_CONSTANT "AIRCTL_MNQCTSCORRGN_MAP_X" "16"
 SYSTEM_CONSTANT "AIRCTL_MNQCTSCORRGN_MAP_Y" "16"
 SYSTEM_CONSTANT "AIRCTL_MUL" "1"
 SYSTEM_CONSTANT "AIRCTL_NQAPCORRGN_MAP_X" "16"
 SYSTEM_CONSTANT "AIRCTL_NQAPCORRGN_MAP_Y" "16"
 SYSTEM_CONSTANT "AIRCTL_NQATCORRGN_MAP_X" "8"
 SYSTEM_CONSTANT "AIRCTL_NQATCORRGN_MAP_Y" "8"
 SYSTEM_CONSTANT "AIRCTL_NQIATSCORRGN_MAP_X" "16"
 SYSTEM_CONSTANT "AIRCTL_NQIATSCORRGN_MAP_Y" "16"
 SYSTEM_CONSTANT "AIRCTL_NQIATSCOR_MAP_X" "16"
 SYSTEM_CONSTANT "AIRCTL_NQIATSCOR_MAP_Y" "16"
 SYSTEM_CONSTANT "AIRCTL_QHIRGN_CUR_X" "6"
 SYSTEM_CONSTANT "AIRCTL_QHI_CUR_X" "25"
 SYSTEM_CONSTANT "AIRCTL_QLORGN_CUR_X" "6"
 SYSTEM_CONSTANT "AIRCTL_QLO_CUR_X" "25"
 SYSTEM_CONSTANT "AIRCTL_QSURGEHIGH_CUR_X" "5"
 SYSTEM_CONSTANT "AIRCTL_QSURGELOW_CUR_X" "5"
 SYSTEM_CONSTANT "AIRCTL_RDIFFDYNMIN_CUR_X" "6"
 SYSTEM_CONSTANT "AIRCTL_RDYNMINRGN_MAP_X" "8"
 SYSTEM_CONSTANT "AIRCTL_RDYNMINRGN_MAP_Y" "6"
 SYSTEM_CONSTANT "AIRCTL_RDYNMIN_MAP_X" "8"
 SYSTEM_CONSTANT "AIRCTL_RDYNMIN_MAP_Y" "6"
 SYSTEM_CONSTANT "AIRCTL_REGRBAS_MAP_X" "8"
 SYSTEM_CONSTANT "AIRCTL_REGRBAS_MAP_Y" "8"
 SYSTEM_CONSTANT "AIRCTL_REGRCTLAPSCOR_CUR_X" "6"
 SYSTEM_CONSTANT "AIRCTL_REGRCTLATCOR_MAP_X" "8"
 SYSTEM_CONSTANT "AIRCTL_REGRCTLATCOR_MAP_Y" "8"
 SYSTEM_CONSTANT "AIRCTL_REGRCTLBAS_MAP_X" "10"
 SYSTEM_CONSTANT "AIRCTL_REGRCTLBAS_MAP_Y" "10"
 SYSTEM_CONSTANT "AIRCTL_REGRCTLCTCOR_MAP_X" "8"
 SYSTEM_CONSTANT "AIRCTL_REGRCTLCTCOR_MAP_Y" "8"
 SYSTEM_CONSTANT "AIRCTL_REGRINV_MAP_X" "8"
 SYSTEM_CONSTANT "AIRCTL_REGRINV_MAP_Y" "4"
 SYSTEM_CONSTANT "AIRCTL_REGRRGNCORR_MAP_X" "16"
 SYSTEM_CONSTANT "AIRCTL_REGRRGNCORR_MAP_Y" "16"
 SYSTEM_CONSTANT "AIRCTL_REGRRGN_MAP_X" "8"
 SYSTEM_CONSTANT "AIRCTL_REGRRGN_MAP_Y" "8"
 SYSTEM_CONSTANT "AIRCTL_REGR_MAP_X" "8"
 SYSTEM_CONSTANT "AIRCTL_REGR_MAP_Y" "16"
 SYSTEM_CONSTANT "AIRCTL_RGVNRDVTCONV" "-8192"
 SYSTEM_CONSTANT "AIRCTL_RGVNRDYNMINRGN_CUR_X" "6"
 SYSTEM_CONSTANT "AIRCTL_RGVNRDYNMIN_CUR_X" "6"
 SYSTEM_CONSTANT "AIRCTL_RTVABAS_MAP_X" "8"
 SYSTEM_CONSTANT "AIRCTL_RTVABAS_MAP_Y" "8"
 SYSTEM_CONSTANT "AIRCTL_RTVACTLAPSCOR_CUR_X" "6"
 SYSTEM_CONSTANT "AIRCTL_RTVACTLATCOR_MAP_X" "8"
 SYSTEM_CONSTANT "AIRCTL_RTVACTLATCOR_MAP_Y" "8"
 SYSTEM_CONSTANT "AIRCTL_RTVACTLBAS_MAP_X" "10"
 SYSTEM_CONSTANT "AIRCTL_RTVACTLBAS_MAP_Y" "10"
 SYSTEM_CONSTANT "AIRCTL_RTVACTLCTCOR_MAP_X" "8"
 SYSTEM_CONSTANT "AIRCTL_RTVACTLCTCOR_MAP_Y" "8"
 SYSTEM_CONSTANT "AIRCTL_RTVARGN_MAP_X" "4"
 SYSTEM_CONSTANT "AIRCTL_RTVARGN_MAP_Y" "8"
 SYSTEM_CONSTANT "AIRCTL_RTVA_MAP_X" "8"
 SYSTEM_CONSTANT "AIRCTL_RTVA_MAP_Y" "16"
 SYSTEM_CONSTANT "AIRCTL_SWTAPSCOR_TYPE" "0"
 SYSTEM_CONSTANT "AIRCTL_SWTAPSCOR_VAL" "0"
 SYSTEM_CONSTANT "AIRCTL_SWTGVNR_TYPE" "2"
 SYSTEM_CONSTANT "AIRCTL_SWTGVNR_VAL" "1"
 SYSTEM_CONSTANT "AIRCTL_SWTIATSCOR_TYPE" "0"
 SYSTEM_CONSTANT "AIRCTL_SWTIATSCOR_VAL" "0"
 SYSTEM_CONSTANT "AIRCTL_SWTTRM_TYPE" "0"
 SYSTEM_CONSTANT "AIRCTL_SWTTRM_VAL" "0"
 SYSTEM_CONSTANT "AIRCTL_TICLDSTRT_CUR_X" "8"
 SYSTEM_CONSTANT "AIRCTL_TRMRGN_MAP_X" "8"
 SYSTEM_CONSTANT "AIRCTL_TRMRGN_MAP_Y" "8"
 SYSTEM_CONSTANT "AIRMASS_MAX" "5000"
 SYSTEM_CONSTANT "AIRMASS_MIN" "-5000"
 SYSTEM_CONSTANT "AIRMASS_ONE" "1"
 SYSTEM_CONSTANT "AIRMASS_ZERO" "0"
 SYSTEM_CONSTANT "AIRSYS_BANKSEL_SWT" "0"
 SYSTEM_CONSTANT "AIRSYS_SWT_DOUBLE" "1"
 SYSTEM_CONSTANT "AIRSYS_SWT_SINGLE" "0"
 SYSTEM_CONSTANT "AIR_KG_GM" "10"
 SYSTEM_CONSTANT "AIR_MASS_NORM" "33333"
 SYSTEM_CONSTANT "ALTCD_RLOADLIN_CUR_X" "25"
 SYSTEM_CONSTANT "ALT_PWRBAS_CUR_X" "2"
 SYSTEM_CONSTANT "AMPC_RES" "0.1"
 SYSTEM_CONSTANT "AMPC_RES_REV" "10"
 SYSTEM_CONSTANT "AMPC_ZERO" "0"
 SYSTEM_CONSTANT "AMPT_RES" "0.1"
 SYSTEM_CONSTANT "AMPT_RES_INV" "10"
 SYSTEM_CONSTANT "AMPT_RES_REV" "10"
 SYSTEM_CONSTANT "AMPT_ZERO" "0"
 SYSTEM_CONSTANT "AM_RES" "0.01"
 SYSTEM_CONSTANT "AM_RES_2" "0.1"
 SYSTEM_CONSTANT "ANGLEGRADPERSEC_RES" "0.04395"
 SYSTEM_CONSTANT "ANGLEGRAD_RES" "0.04395"
 SYSTEM_CONSTANT "ANGLE_RES" "42.6666666666667"
 SYSTEM_CONSTANT "ANGLE_RES_INC" "256"
 SYSTEM_CONSTANT "AOHT_TAIRUPLI_CUR_X" "25"
 SYSTEM_CONSTANT "APPCD_DUSYNC_CUR_X" "2"
 SYSTEM_CONSTANT "APPCD_RLINAPP1_CUR_X" "2"
 SYSTEM_CONSTANT "APPCD_RLINAPP2_CUR_X" "2"
 SYSTEM_CONSTANT "APPCD_RLINAPP_CUR_X" "2"
 SYSTEM_CONSTANT "APSCD_PCOR_MAP_X" "1"
 SYSTEM_CONSTANT "APSCD_PCOR_MAP_Y" "1"
 SYSTEM_CONSTANT "APSCD_PLIN_CUR_X" "2"
 SYSTEM_CONSTANT "APSCD_SWTSIG_TYPE" "2"
 SYSTEM_CONSTANT "APSCD_SWTSIG_VAL" "0"
 SYSTEM_CONSTANT "ARS_TRQCURMAX_MAP_X" "7"
 SYSTEM_CONSTANT "ARS_TRQCURMAX_MAP_Y" "7"
 SYSTEM_CONSTANT "ARS_TRQDESMAX_MAP_X" "7"
 SYSTEM_CONSTANT "ARS_TRQDESMAX_MAP_Y" "7"
 SYSTEM_CONSTANT "ASDDC_FDC_MAP_X" "6"
 SYSTEM_CONSTANT "ASDDC_FDC_MAP_Y" "5"
 SYSTEM_CONSTANT "ASDDC_GRIP_MAP_X" "6"
 SYSTEM_CONSTANT "ASDDC_GRIP_MAP_Y" "5"
 SYSTEM_CONSTANT "ASDdc_NUMBEROFSTATES" "7"
 SYSTEM_CONSTANT "ASDRF_COEFFA_FDCNEG_CUR_X" "8"
 SYSTEM_CONSTANT "ASDRF_COEFFA_FDCPOS_CUR_X" "8"
 SYSTEM_CONSTANT "ASDRF_COEFFA_GRIPNEG_CUR_X" "6"
 SYSTEM_CONSTANT "ASDRF_COEFFA_GRIPPOS_CUR_X" "6"
 SYSTEM_CONSTANT "ASDRF_COEFFB_FDCNEG_CUR_X" "8"
 SYSTEM_CONSTANT "ASDRF_COEFFB_FDCPOS_CUR_X" "8"
 SYSTEM_CONSTANT "ASDRF_COEFFB_GRIPNEG_CUR_X" "6"
 SYSTEM_CONSTANT "ASDRF_COEFFB_GRIPPOS_CUR_X" "6"
 SYSTEM_CONSTANT "ASDRF_KDGRIPNEG_CUR_X" "7"
 SYSTEM_CONSTANT "ASDRF_KDGRIPPOS_CUR_X" "7"
 SYSTEM_CONSTANT "ASDRF_KD_FDCNEG_CUR_X" "8"
 SYSTEM_CONSTANT "ASDRF_KD_FDCPOS_CUR_X" "8"
 SYSTEM_CONSTANT "ASDRF_KD_GRIPNEG_CUR_X" "6"
 SYSTEM_CONSTANT "ASDRF_KD_GRIPPOS_CUR_X" "6"
 SYSTEM_CONSTANT "ASDrf_NUMBEROFSTATES" "6"
 SYSTEM_CONSTANT "ASDRF_T1GRIPNEG_CUR_X" "7"
 SYSTEM_CONSTANT "ASDRF_T1GRIPPOS_CUR_X" "7"
 SYSTEM_CONSTANT "ASDRF_T1_FDCNEG_CUR_X" "8"
 SYSTEM_CONSTANT "ASDRF_T1_FDCPOS_CUR_X" "8"
 SYSTEM_CONSTANT "ASDRF_T1_GRIPNEG_CUR_X" "6"
 SYSTEM_CONSTANT "ASDRF_T1_GRIPPOS_CUR_X" "6"
 SYSTEM_CONSTANT "ASDRF_TMFWROACT" "4"
 SYSTEM_CONSTANT "ASD_TIME_DT_RES_FL" "1e-06"
 SYSTEM_CONSTANT "ASMOD_CALCBACKUP" "14500"
 SYSTEM_CONSTANT "ASMOD_DMAIRCONV" "2949.12"
 SYSTEM_CONSTANT "ASMOD_DMFUELBURNED_RES" "6896.55172413793"
 SYSTEM_CONSTANT "ASMOD_DMFUEL_RES" "33333.3333333333"
 SYSTEM_CONSTANT "ASMOD_DMINDAIRREF_MAP_X" "8"
 SYSTEM_CONSTANT "ASMOD_DMINDAIRREF_MAP_Y" "8"
 SYSTEM_CONSTANT "ASMOD_DMO2_RES" "10000"
 SYSTEM_CONSTANT "ASMOD_EXHMASS_MNF" "10"
 SYSTEM_CONSTANT "ASMOD_FACAMCOR_RES" "122.0703125"
 SYSTEM_CONSTANT "ASMOD_FACDMCORTDIFF_CUR_X" "8"
 SYSTEM_CONSTANT "ASMOD_FACSOICORTDIFF_CUR_X" "8"
 SYSTEM_CONSTANT "ASMOD_FACVOLEFF_MAP_X" "10"
 SYSTEM_CONSTANT "ASMOD_FACVOLEFF_MAP_Y" "15"
 SYSTEM_CONSTANT "ASMOD_FACVSACORVOLEFF_MAP_X" "10"
 SYSTEM_CONSTANT "ASMOD_FACVSACORVOLEFF_MAP_Y" "10"
 SYSTEM_CONSTANT "ASMOD_HENG_RES" "348"
 SYSTEM_CONSTANT "ASMOD_HMOT_RES" "95238.0952380953"
 SYSTEM_CONSTANT "ASMOD_IMPT2AMPT" "10"
 SYSTEM_CONSTANT "ASMOD_INDVOL_MAX" "50"
 SYSTEM_CONSTANT "ASMOD_INDVOL_MIN" "0"
 SYSTEM_CONSTANT "ASMOD_LAMBDAREC1" "335671.375"
 SYSTEM_CONSTANT "ASMOD_LMBDSENSDDTM_CUR_X" "8"
 SYSTEM_CONSTANT "ASMOD_LMBDSENSPT1_CUR_X" "8"
 SYSTEM_CONSTANT "ASMOD_MAIRCONV" "33333"
 SYSTEM_CONSTANT "ASMOD_MASS_NORM" "2873.56321839081"
 SYSTEM_CONSTANT "ASMOD_MINDAIR" "445.44"
 SYSTEM_CONSTANT "ASMOD_NDELAY_RES" "937500"
 SYSTEM_CONSTANT "ASMOD_PHISOIREF_MAP_X" "8"
 SYSTEM_CONSTANT "ASMOD_PHISOIREF_MAP_Y" "8"
 SYSTEM_CONSTANT "ASMOD_QLMBD" "100"
 SYSTEM_CONSTANT "ASMOD_QSWTOUTOBSVRMAX_CUR" "8"
 SYSTEM_CONSTANT "ASMOD_QSWTOUTOBSVRMIN_CUR" "8"
 SYSTEM_CONSTANT "ASMOD_RFUELBURNED_RES" "100"
 SYSTEM_CONSTANT "ASMOD_RLMBDREC" "1450"
 SYSTEM_CONSTANT "ASMOD_RO2EXHGS_RES" "10000"
 SYSTEM_CONSTANT "ASMOD_R_STOICH" "1450"
 SYSTEM_CONSTANT "ASMOD_TDIFFENG_MAP_X" "8"
 SYSTEM_CONSTANT "ASMOD_TDIFFENG_MAP_Y" "8"
 SYSTEM_CONSTANT "ASMOD_TDIFFLIN_RES" "1280"
 SYSTEM_CONSTANT "ASMOD_TDIFFSQ_RES" "1000"
 SYSTEM_CONSTANT "ASMOD_TENGCORTDIFF_CUR_X" "8"
 SYSTEM_CONSTANT "ASMOD_TIDT1_MAX" "5"
 SYSTEM_CONSTANT "ASMOD_TIDT1_MIN" "0.05"
 SYSTEM_CONSTANT "ASMOD_TINDAIRREF_MAP_X" "10"
 SYSTEM_CONSTANT "ASMOD_TINDAIRREF_MAP_Y" "10"
 SYSTEM_CONSTANT "ASMOD_VOL_NORM" "333333.333333333"
 SYSTEM_CONSTANT "AVPT_RES" "0.1"
 SYSTEM_CONSTANT "BATTCD_ULIN_CUR_X" "25"
 SYSTEM_CONSTANT "BOS_MSG_SUPPORT_OUT" "1"
 SYSTEM_CONSTANT "BOS_NOTSUPPORTED" "0"
 SYSTEM_CONSTANT "BOS_SUPPORT" "1"
 SYSTEM_CONSTANT "BOS_SUPPORTED" "1"
 SYSTEM_CONSTANT "BOS_SUPPORT_VAL" "1"
 SYSTEM_CONSTANT "BPACD_DCYCCONV_CUR_X" "25"
 SYSTEM_CONSTANT "BPSCD_PLIN_CUR_X" "25"
 SYSTEM_CONSTANT "BPSCD_SWTSIG_TYPE" "2"
 SYSTEM_CONSTANT "BPSCD_SWTSIG_VAL" "0"
 SYSTEM_CONSTANT "BRKCD_SWTSIG_TYPE" "2"
 SYSTEM_CONSTANT "BRKCD_SWTSIG_VAL" "0"
 SYSTEM_CONSTANT "BRKCD_TYPE_CAN_BRK" "1"
 SYSTEM_CONSTANT "BRKCD_TYPE_CAN_RED" "2"
 SYSTEM_CONSTANT "BRKCD_TYPE_CAN_REDBRK" "3"
 SYSTEM_CONSTANT "BRKCD_TYPE_HW" "0"
 SYSTEM_CONSTANT "CALORY1_RES" "1"
 SYSTEM_CONSTANT "CALORY_RES" "100"
 SYSTEM_CONSTANT "CAN1_RES" "0.0001"
 SYSTEM_CONSTANT "CAN1_RES_REV" "10000"
 SYSTEM_CONSTANT "CAN_BAUDRATE" "500"
 SYSTEM_CONSTANT "CAN_COM_11H" "1"
 SYSTEM_CONSTANT "CAN_COM_12H" "2"
 SYSTEM_CONSTANT "CAN_COM_TYPE" "2"
 SYSTEM_CONSTANT "CAN_RES" "0.001"
 SYSTEM_CONSTANT "CAN_RES_REV" "1000"
 SYSTEM_CONSTANT "CASCD_FACPLAUSHIGH_CUR_X" "12"
 SYSTEM_CONSTANT "CASCD_FACPLAUSLOW_CUR_X" "12"
 SYSTEM_CONSTANT "CAS_MAX" "3"
 SYSTEM_CONSTANT "CLG_TIMAXDYNTST_CUR_X" "10"
 SYSTEM_CONSTANT "CMBCHB_CONST" "1000"
 SYSTEM_CONSTANT "CMBCHB_DISABLED" "0"
 SYSTEM_CONSTANT "CMBCHB_ENABLED" "3"
 SYSTEM_CONSTANT "CMBCHB_NOT_PRESSED" "2"
 SYSTEM_CONSTANT "CMBCHB_PRESSED" "1"
 SYSTEM_CONSTANT "CMBCHB_SWTMONCLUTCH_TYPE" "2"
 SYSTEM_CONSTANT "CMBCHB_SWTMONCLUTCH_VAL" "3"
 SYSTEM_CONSTANT "CODT_SWTCOTYPE_CNV" "0"
 SYSTEM_CONSTANT "CODT_SWTCOTYPE_MSFT" "1"
 SYSTEM_CONSTANT "CODT_SWTCOTYPE_TYPE" "2"
 SYSTEM_CONSTANT "CODT_SWTCOTYPE_VAL" "1"
 SYSTEM_CONSTANT "COEFFA_MAX" "159.9951171875"
 SYSTEM_CONSTANT "COEFFA_MIN" "0"
 SYSTEM_CONSTANT "COEFFA_RES" "0.0048828125"
 SYSTEM_CONSTANT "COENG_QSUBS_MAP_X" "16"
 SYSTEM_CONSTANT "COENG_QSUBS_MAP_Y" "16"
 SYSTEM_CONSTANT "COENG_RES_INV" "10000"
 SYSTEM_CONSTANT "COENG_SHOFFECUSel" "6"
 SYSTEM_CONSTANT "COENG_STSHOFFIMMO" "7"
 SYSTEM_CONSTANT "COENG_TIRMPSTRT_CUR_X" "7"
 SYSTEM_CONSTANT "COENG_TISOFTSHOFF_CUR_X" "16"
 SYSTEM_CONSTANT "COENG_TISWTOFF_CUR_X" "7"
 SYSTEM_CONSTANT "COENG_TRQCORGEARBXRGN_CUR_X" "16"
 SYSTEM_CONSTANT "COENG_TRQINRSETLIM_CUR_X" "3"
 SYSTEM_CONSTANT "COENG_TRQLIMERR_CUR1_X" "10"
 SYSTEM_CONSTANT "COENG_TRQLIMERR_CUR_X" "10"
 SYSTEM_CONSTANT "COENG_TRQLIMPDIFF1_CUR_X" "8"
 SYSTEM_CONSTANT "COENG_TRQLIMPDIFFNOFFS_CUR_X" "16"
 SYSTEM_CONSTANT "COENG_TRQLIMPDIFF_CUR_X" "21"
 SYSTEM_CONSTANT "COENG_TRQLIMPDIFF_MAP_X" "16"
 SYSTEM_CONSTANT "COENG_TRQLIMPDIFF_MAP_Y" "8"
 SYSTEM_CONSTANT "COENG_TRQLIMPFLTOVLD_MAP_X" "10"
 SYSTEM_CONSTANT "COENG_TRQLIMPFLTOVLD_MAP_Y" "10"
 SYSTEM_CONSTANT "CONVCD_SWTSIG_TYPE" "2"
 SYSTEM_CONSTANT "CONVCD_SWTSIG_VAL" "0"
 SYSTEM_CONSTANT "CONVCD_SWT_PN" "2"
 SYSTEM_CONSTANT "CONV_HR2SEC" "36"
 SYSTEM_CONSTANT "CONV_KD_16_TO_KD_32" "2.00006103701895"
 SYSTEM_CONSTANT "CONV_T1_16_2_TO_1_T1_32" "70366.596694016"
 SYSTEM_CONSTANT "CONV_T1_16_TO_1_T1_32" "28146638.6776064"
 SYSTEM_CONSTANT "COORD_FUNC_ARRAY_MP" "3"
 SYSTEM_CONSTANT "COVEH_TRQLIM_CUR_X" "10"
 SYSTEM_CONSTANT "COVM_PLAUSCHK_TYPE" "2"
 SYSTEM_CONSTANT "COVM_PLAUSCHK_VAL" "0"
 SYSTEM_CONSTANT "COVM_SWTSLIPCTL_TYPE" "2"
 SYSTEM_CONSTANT "COVM_SWTSLIPCTL_VAL" "0"
 SYSTEM_CONSTANT "COVM_TCS_OFF_DCS_OFF" "0"
 SYSTEM_CONSTANT "COVM_TCS_OFF_DCS_ON" "2"
 SYSTEM_CONSTANT "COVM_TCS_ON_DCS_OFF" "1"
 SYSTEM_CONSTANT "COVM_TCS_ON_DCS_ON" "3"
 SYSTEM_CONSTANT "CPBVLV_QCLOSERGN_MAP_X" "12"
 SYSTEM_CONSTANT "CPBVLV_QCLOSERGN_MAP_Y" "6"
 SYSTEM_CONSTANT "CPBVLV_QCLOSE_MAP_X" "12"
 SYSTEM_CONSTANT "CPBVLV_QCLOSE_MAP_Y" "6"
 SYSTEM_CONSTANT "CPBVLV_QOPNRGN_MAP_X" "12"
 SYSTEM_CONSTANT "CPBVLV_QOPNRGN_MAP_Y" "6"
 SYSTEM_CONSTANT "CPBVLV_QOPN_MAP_X" "12"
 SYSTEM_CONSTANT "CPBVLV_QOPN_MAP_Y" "6"
 SYSTEM_CONSTANT "CRCTL_DTRQOFFFAST_CUR_X" "8"
 SYSTEM_CONSTANT "CRCTL_DVACCFDCG3_CUR_X" "3"
 SYSTEM_CONSTANT "CRCTL_DVACCFDCG4_CUR_X" "3"
 SYSTEM_CONSTANT "CRCTL_DVACCFDCG5_CUR_X" "3"
 SYSTEM_CONSTANT "CRCTL_DVACCFDCG6_CUR_X" "3"
 SYSTEM_CONSTANT "CRCTL_DVACCG3_CUR_X" "3"
 SYSTEM_CONSTANT "CRCTL_DVACCG4_CUR_X" "3"
 SYSTEM_CONSTANT "CRCTL_DVACCG5_CUR_X" "3"
 SYSTEM_CONSTANT "CRCTL_DVACCG6_CUR_X" "3"
 SYSTEM_CONSTANT "CRCTL_DVDECLFDCG3_CUR_X" "3"
 SYSTEM_CONSTANT "CRCTL_DVDECLFDCG4_CUR_X" "3"
 SYSTEM_CONSTANT "CRCTL_DVDECLFDCG5_CUR_X" "3"
 SYSTEM_CONSTANT "CRCTL_DVDECLFDCG6_CUR_X" "3"
 SYSTEM_CONSTANT "CRCTL_DVDECLG3_CUR_X" "3"
 SYSTEM_CONSTANT "CRCTL_DVDECLG4_CUR_X" "3"
 SYSTEM_CONSTANT "CRCTL_DVDECLG5_CUR_X" "3"
 SYSTEM_CONSTANT "CRCTL_DVDECLG6_CUR_X" "3"
 SYSTEM_CONSTANT "CRCTL_DVRESABVFDCG3_CUR_X" "3"
 SYSTEM_CONSTANT "CRCTL_DVRESABVFDCG4_CUR_X" "3"
 SYSTEM_CONSTANT "CRCTL_DVRESABVFDCG5_CUR_X" "3"
 SYSTEM_CONSTANT "CRCTL_DVRESABVFDCG6_CUR_X" "3"
 SYSTEM_CONSTANT "CRCTL_DVRESABVG3_MAP_X" "3"
 SYSTEM_CONSTANT "CRCTL_DVRESABVG3_MAP_Y" "1"
 SYSTEM_CONSTANT "CRCTL_DVRESABVG4_MAP_X" "3"
 SYSTEM_CONSTANT "CRCTL_DVRESABVG4_MAP_Y" "1"
 SYSTEM_CONSTANT "CRCTL_DVRESABVG5_MAP_X" "3"
 SYSTEM_CONSTANT "CRCTL_DVRESABVG5_MAP_Y" "1"
 SYSTEM_CONSTANT "CRCTL_DVRESABVG6_MAP_X" "3"
 SYSTEM_CONSTANT "CRCTL_DVRESABVG6_MAP_Y" "1"
 SYSTEM_CONSTANT "CRCTL_DVRESBLWFDCG3_CUR_X" "3"
 SYSTEM_CONSTANT "CRCTL_DVRESBLWFDCG4_CUR_X" "3"
 SYSTEM_CONSTANT "CRCTL_DVRESBLWFDCG5_CUR_X" "3"
 SYSTEM_CONSTANT "CRCTL_DVRESBLWFDCG6_CUR_X" "3"
 SYSTEM_CONSTANT "CRCTL_DVRESBLWG3_MAP_X" "3"
 SYSTEM_CONSTANT "CRCTL_DVRESBLWG3_MAP_Y" "1"
 SYSTEM_CONSTANT "CRCTL_DVRESBLWG4_MAP_X" "3"
 SYSTEM_CONSTANT "CRCTL_DVRESBLWG4_MAP_Y" "1"
 SYSTEM_CONSTANT "CRCTL_DVRESBLWG5_MAP_X" "3"
 SYSTEM_CONSTANT "CRCTL_DVRESBLWG5_MAP_Y" "1"
 SYSTEM_CONSTANT "CRCTL_DVRESBLWG6_MAP_X" "3"
 SYSTEM_CONSTANT "CRCTL_DVRESBLWG6_MAP_Y" "1"
 SYSTEM_CONSTANT "CRCTL_FACINCSLOPE_CUR_X" "6"
 SYSTEM_CONSTANT "CRCTL_FACRESABVFDC_CUR_X" "6"
 SYSTEM_CONSTANT "CRCTL_FACRESABV_CUR_X" "3"
 SYSTEM_CONSTANT "CRCTL_FACRESBLWFDC_CUR_X" "6"
 SYSTEM_CONSTANT "CRCTL_FACRESBLW_CUR_X" "3"
 SYSTEM_CONSTANT "CRSCD_DYNPL_HEALSEC" "1"
 SYSTEM_CONSTANT "CRSCD_FACGAPPLAUSHIGH_CUR_X" "10"
 SYSTEM_CONSTANT "CRSCD_FACGAPPLAUSLOW_CUR_X" "10"
 SYSTEM_CONSTANT "CRSCD_FACINCPLAUSHIGH_CUR_X" "10"
 SYSTEM_CONSTANT "CRSCD_FACINCPLAUSLOW_CUR_X" "10"
 SYSTEM_CONSTANT "CRSCD_PHIINCCOR_CUR_X" "12"
 SYSTEM_CONSTANT "CRSCD_STATPL_SEC" "1"
 SYSTEM_CONSTANT "CRSCD_SWTDYNPL_TYPE" "2"
 SYSTEM_CONSTANT "CRSCD_SWTDYNPL_VAL" "1"
 SYSTEM_CONSTANT "CRSCD_SWTSTATPL_TYPE" "2"
 SYSTEM_CONSTANT "CRSCD_SWTSTATPL_VAL" "1"
 SYSTEM_CONSTANT "CRS_FACSEGTIME_CUR_X" "3"
 SYSTEM_CONSTANT "CRS_RES" "42.6666666666667"
 SYSTEM_CONSTANT "CRS_RES_REV" "0.0234375"
 SYSTEM_CONSTANT "CRS_TO_CAS" "2"
 SYSTEM_CONSTANT "CTSCD_SWTSIG_TYPE" "2"
 SYSTEM_CONSTANT "CTSCD_SWTSIG_VAL" "0"
 SYSTEM_CONSTANT "CTSCD_TLIN_CUR_X" "20"
 SYSTEM_CONSTANT "CURR_10MA_RES" "10"
 SYSTEM_CONSTANT "CURR_RES" "1"
 SYSTEM_CONSTANT "CYL_8SYS" "8"
 SYSTEM_CONSTANT "CYL_FAC_NORM" "33333"
 SYSTEM_CONSTANT "CYL_MAX" "6"
 SYSTEM_CONSTANT "CYL_NUM" "6"
 SYSTEM_CONSTANT "CYL_VOL" "800"
 SYSTEM_CONSTANT "DCC_NSETPOINT_CUR_X" "6"
 SYSTEM_CONSTANT "DCC_TRQSHFT_CUR_X" "7"
 SYSTEM_CONSTANT "DDVOL_RES" "10"
 SYSTEM_CONSTANT "DELTA_M_PER_TIME_NBR" "5"
 SYSTEM_CONSTANT "DELTA_N_PER_TIME_NBR" "5"
 SYSTEM_CONSTANT "DELTA_PRES_FAC" "250000"
 SYSTEM_CONSTANT "DELTA_P_PER_TIME_NBR" "5"
 SYSTEM_CONSTANT "DIA_RES" "0.0001"
 SYSTEM_CONSTANT "DIA_RES_REV" "10000"
 SYSTEM_CONSTANT "DISTM_FAC" "6366.19772367539"
 SYSTEM_CONSTANT "DISTM_FAC1" "407436654.315225"
 SYSTEM_CONSTANT "DIST_20MS_RES" "5.55555555555556e-05"
 SYSTEM_CONSTANT "DM_SOOT_MAX" "100"
 SYSTEM_CONSTANT "DM_SOOT_MIN" "0"
 SYSTEM_CONSTANT "DM_SOOT_RES" "0.01"
 SYSTEM_CONSTANT "DN_DZFINE_RES" "1"
 SYSTEM_CONSTANT "DPDIFFTMP_RES" "100"
 SYSTEM_CONSTANT "DPDIFF_RES" "0.1"
 SYSTEM_CONSTANT "DPHI_STRG_MAX" "1439.95"
 SYSTEM_CONSTANT "DPHI_STRG_MIN" "-1439.95"
 SYSTEM_CONSTANT "DTRQPRP_20MS_RES" "10"
 SYSTEM_CONSTANT "DTRQ_MAX" "2000"
 SYSTEM_CONSTANT "DTRQ_MIN" "-2000"
 SYSTEM_CONSTANT "DTRQ_ONE" "1"
 SYSTEM_CONSTANT "DTRQ_RES" "0.1"
 SYSTEM_CONSTANT "DTRQ_ZERO" "0"
 SYSTEM_CONSTANT "DTY_CYC_10" "10"
 SYSTEM_CONSTANT "DTY_CYC_100" "100"
 SYSTEM_CONSTANT "DTY_CYC_25" "25"
 SYSTEM_CONSTANT "DTY_CYC_33" "33.33"
 SYSTEM_CONSTANT "DTY_CYC_5" "5"
 SYSTEM_CONSTANT "DTY_CYC_FAC" "1400"
 SYSTEM_CONSTANT "DTY_CYC_MAX" "100"
 SYSTEM_CONSTANT "DTY_CYC_MIN" "0"
 SYSTEM_CONSTANT "DTY_CYC_RES" "0.01"
 SYSTEM_CONSTANT "DTY_CYC_RES_REV" "100"
 SYSTEM_CONSTANT "DT_DEN" "500"
 SYSTEM_CONSTANT "DT_NUM" "143.000143000143"
 SYSTEM_CONSTANT "DT_SCAL" "2"
 SYSTEM_CONSTANT "DU_VBATFAC" "100"
 SYSTEM_CONSTANT "DVEL_20MS_RES" "0.5"
 SYSTEM_CONSTANT "DVOL_MAX" "3000"
 SYSTEM_CONSTANT "DVOL_MIN" "0"
 SYSTEM_CONSTANT "DVOL_RES" "0.1"
 SYSTEM_CONSTANT "DVOL_RES_INV" "10"
 SYSTEM_CONSTANT "DXS_FL" "4000000"
 SYSTEM_CONSTANT "DYN_TST_TIME_FACT" "655.36"
 SYSTEM_CONSTANT "D_FLCONS_RES" "0.01"
 SYSTEM_CONSTANT "EATSCD_SWTSIG_TYPE" "2"
 SYSTEM_CONSTANT "EATSCD_SWTSIG_VAL" "0"
 SYSTEM_CONSTANT "EATSCD_TLIN_CUR_X" "25"
 SYSTEM_CONSTANT "EBTSCD_TLIN_CUR_X" "5"
 SYSTEM_CONSTANT "EGPP_FACPOW_CUR_X" "11"
 SYSTEM_CONSTANT "EGPP_FACRHOETA_CUR_X" "9"
 SYSTEM_CONSTANT "EGPP_PPRESCALC_MAP_X" "8"
 SYSTEM_CONSTANT "EGPP_PPRESCALC_MAP_Y" "8"
 SYSTEM_CONSTANT "EGPP_STFLAPRGN_MAP_X" "8"
 SYSTEM_CONSTANT "EGPP_STFLAPRGN_MAP_Y" "8"
 SYSTEM_CONSTANT "EGPP_STFLAP_MAP_X" "8"
 SYSTEM_CONSTANT "EGPP_STFLAP_MAP_Y" "8"
 SYSTEM_CONSTANT "EGRCD_DCYCEGR_MAP_X" "8"
 SYSTEM_CONSTANT "EGRCD_DCYCEGR_MAP_Y" "8"
 SYSTEM_CONSTANT "EGRCLG_QBYPOFF_CUR_X" "8"
 SYSTEM_CONSTANT "EGRCLG_QBYPON_CUR_X" "8"
 SYSTEM_CONSTANT "EGSYS_CNDHTEG_CUR_X" "8"
 SYSTEM_CONSTANT "EGSYS_CPEG_MAP_X" "6"
 SYSTEM_CONSTANT "EGSYS_CPEG_MAP_Y" "6"
 SYSTEM_CONSTANT "EGSYS_CT_TUBES" "2"
 SYSTEM_CONSTANT "EGSYS_DMAIR_MAP_X" "8"
 SYSTEM_CONSTANT "EGSYS_DMAIR_MAP_Y" "8"
 SYSTEM_CONSTANT "EGSYS_DPEXHGAS_MAP_X" "10"
 SYSTEM_CONSTANT "EGSYS_DPEXHGAS_MAP_Y" "10"
 SYSTEM_CONSTANT "EGSYS_ETACHRG_MAP_X" "8"
 SYSTEM_CONSTANT "EGSYS_ETACHRG_MAP_Y" "8"
 SYSTEM_CONSTANT "EGSYS_FACAIRMASS_CUR_X" "8"
 SYSTEM_CONSTANT "EGSYS_FACCMPRINTK_CUR_X" "8"
 SYSTEM_CONSTANT "EGSYS_FACCORRCLDENG_CUR_X" "8"
 SYSTEM_CONSTANT "EGSYS_FACSTRTDLV_CUR_X" "8"
 SYSTEM_CONSTANT "EGSYS_FACTEMPCLG_CUR_X" "8"
 SYSTEM_CONSTANT "EGSYS_FACTEMPCMB_CUR_X" "8"
 SYSTEM_CONSTANT "EGSYS_FACTIMECLG_CUR_X" "8"
 SYSTEM_CONSTANT "EGSYS_NUPIPEENV_CUR_X" "8"
 SYSTEM_CONSTANT "EGSYS_NUPIPE_CUR_X" "8"
 SYSTEM_CONSTANT "EGSYS_NUTUBEENV_CUR_X" "8"
 SYSTEM_CONSTANT "EGSYS_NUTUBE_CUR_X" "8"
 SYSTEM_CONSTANT "EGSYS_PHISTRTDLV_MAP_X" "8"
 SYSTEM_CONSTANT "EGSYS_PHISTRTDLV_MAP_Y" "8"
 SYSTEM_CONSTANT "EGSYS_RTEMPADBT_CUR_X" "8"
 SYSTEM_CONSTANT "EGSYS_TEMP1" "1000"
 SYSTEM_CONSTANT "EGSYS_TIAT_MAP_X" "8"
 SYSTEM_CONSTANT "EGSYS_TIAT_MAP_Y" "8"
 SYSTEM_CONSTANT "EGSYS_TMANFSTAT_MAP_X" "10"
 SYSTEM_CONSTANT "EGSYS_TMANFSTAT_MAP_Y" "8"
 SYSTEM_CONSTANT "EGSYS_TNSCEXOINCR_MAP_X" "8"
 SYSTEM_CONSTANT "EGSYS_TNSCEXOINCR_MAP_Y" "8"
 SYSTEM_CONSTANT "EGSYS_TOXICATEXOINCR_MAP_X" "8"
 SYSTEM_CONSTANT "EGSYS_TOXICATEXOINCR_MAP_Y" "8"
 SYSTEM_CONSTANT "EGSYS_VSCDYNEG_CUR_X" "8"
 SYSTEM_CONSTANT "EGSYS_VSCKINEG_CUR_X" "8"
 SYSTEM_CONSTANT "EGSYS_WTHRESLSU0_MAP_X" "10"
 SYSTEM_CONSTANT "EGSYS_WTHRESLSU0_MAP_Y" "10"
 SYSTEM_CONSTANT "EGTFACT_MAX" "3"
 SYSTEM_CONSTANT "EGTFACT_MIN" "-3"
 SYSTEM_CONSTANT "EGTFACT_RES" "0.001"
 SYSTEM_CONSTANT "EGTFACT_RES_INV" "1000"
 SYSTEM_CONSTANT "EGTSWT_FACT" "16384000"
 SYSTEM_CONSTANT "EGTSWT_FACT_S16" "16384"
 SYSTEM_CONSTANT "EGTSWT_NRM_EXP" "14"
 SYSTEM_CONSTANT "EGTSWT_RES" "6.103515625e-08"
 SYSTEM_CONSTANT "EGTSWT_RES_S16" "6.103515625e-05"
 SYSTEM_CONSTANT "EGTSWT_ZERO" "0"
 SYSTEM_CONSTANT "EGT_DMOILDILPOIBAS_MAP_X" "16"
 SYSTEM_CONSTANT "EGT_DMOILDILPOIBAS_MAP_Y" "16"
 SYSTEM_CONSTANT "EGT_DMOILRMVBAS_MAP_X" "16"
 SYSTEM_CONSTANT "EGT_DMOILRMVBAS_MAP_Y" "16"
 SYSTEM_CONSTANT "EGT_FACKIAMPT_CUR_X" "8"
 SYSTEM_CONSTANT "EGT_FACKIQNTPOI1_MAP_X" "8"
 SYSTEM_CONSTANT "EGT_FACKIQNTPOI1_MAP_Y" "8"
 SYSTEM_CONSTANT "EGT_FACKIQNTPOI2_MAP_X" "8"
 SYSTEM_CONSTANT "EGT_FACKIQNTPOI2_MAP_Y" "8"
 SYSTEM_CONSTANT "EGT_FACKITEMPINRCOR_MAP_X" "8"
 SYSTEM_CONSTANT "EGT_FACKITEMPINRCOR_MAP_Y" "8"
 SYSTEM_CONSTANT "EGT_FACKPAMPT_CUR_X" "8"
 SYSTEM_CONSTANT "EGT_FACKPQNTPOI1_MAP_X" "8"
 SYSTEM_CONSTANT "EGT_FACKPQNTPOI1_MAP_Y" "8"
 SYSTEM_CONSTANT "EGT_FACKPQNTPOI2_MAP_X" "8"
 SYSTEM_CONSTANT "EGT_FACKPQNTPOI2_MAP_Y" "8"
 SYSTEM_CONSTANT "EGT_FACKPTEMPINRCOR_MAP_X" "8"
 SYSTEM_CONSTANT "EGT_FACKPTEMPINRCOR_MAP_Y" "8"
 SYSTEM_CONSTANT "EGT_FACOILDILTEMPENG_CUR_X" "8"
 SYSTEM_CONSTANT "EGT_FACOILRMVMSOIL_CUR_X" "8"
 SYSTEM_CONSTANT "EGT_FACOILRMVTEMPOIL_CUR_X" "8"
 SYSTEM_CONSTANT "EGT_FACQNTPOI2RMP_CUR_X" "3"
 SYSTEM_CONSTANT "EGT_FACT" "0"
 SYSTEM_CONSTANT "EGT_FACTMAX" "1"
 SYSTEM_CONSTANT "EGT_LIMMAX" "1"
 SYSTEM_CONSTANT "EGT_LIMMIN" "-1"
 SYSTEM_CONSTANT "EGT_MAIRLMBD_CUR_X" "8"
 SYSTEM_CONSTANT "EGT_MAIRTEMPGVNRMAX_MAP_X" "16"
 SYSTEM_CONSTANT "EGT_MAIRTEMPGVNRMAX_MAP_Y" "16"
 SYSTEM_CONSTANT "EGT_MAIRTEMPGVNRMIN_MAP_X" "16"
 SYSTEM_CONSTANT "EGT_MAIRTEMPGVNRMIN_MAP_Y" "16"
 SYSTEM_CONSTANT "EGT_PHIPOI1TEMPGVNR_MAP_X" "8"
 SYSTEM_CONSTANT "EGT_PHIPOI1TEMPGVNR_MAP_Y" "8"
 SYSTEM_CONSTANT "EGT_PHIPOI2TEMPGVNR_MAP_X" "8"
 SYSTEM_CONSTANT "EGT_PHIPOI2TEMPGVNR_MAP_Y" "8"
 SYSTEM_CONSTANT "EGT_QHCQNTPOI1_CUR_X" "1"
 SYSTEM_CONSTANT "EGT_QPOI1TEMPGVNRMAX_MAP_X" "16"
 SYSTEM_CONSTANT "EGT_QPOI1TEMPGVNRMAX_MAP_Y" "16"
 SYSTEM_CONSTANT "EGT_QPOI1TEMPGVNRMIN_MAP_X" "16"
 SYSTEM_CONSTANT "EGT_QPOI1TEMPGVNRMIN_MAP_Y" "16"
 SYSTEM_CONSTANT "EGT_QPOI2TEMPGVNRMAX_MAP_X" "16"
 SYSTEM_CONSTANT "EGT_QPOI2TEMPGVNRMAX_MAP_Y" "16"
 SYSTEM_CONSTANT "EGT_QPOI2TEMPGVNRMIN_MAP_X" "16"
 SYSTEM_CONSTANT "EGT_QPOI2TEMPGVNRMIN_MAP_Y" "16"
 SYSTEM_CONSTANT "EGT_STATE" "1"
 SYSTEM_CONSTANT "EGT_SWTRGN_VAL" "0"
 SYSTEM_CONSTANT "EGT_SWT_DISABLED" "0"
 SYSTEM_CONSTANT "EGT_SWT_ENABLED" "1"
 SYSTEM_CONSTANT "EGT_TINRCORTEMPGVNRMAX_MAP_X" "16"
 SYSTEM_CONSTANT "EGT_TINRCORTEMPGVNRMAX_MAP_Y" "16"
 SYSTEM_CONSTANT "EGT_TINRCORTEMPGVNRMIN_MAP_X" "16"
 SYSTEM_CONSTANT "EGT_TINRCORTEMPGVNRMIN_MAP_Y" "16"
 SYSTEM_CONSTANT "EGT_TINRDESTEMPTURB_CUR_X" "8"
 SYSTEM_CONSTANT "EGT_TINRDES_MAP_X" "16"
 SYSTEM_CONSTANT "EGT_TINRDES_MAP_Y" "16"
 SYSTEM_CONSTANT "EGT_TIPOI2TEMPGVNR_MAP_X" "8"
 SYSTEM_CONSTANT "EGT_TIPOI2TEMPGVNR_MAP_Y" "8"
 SYSTEM_CONSTANT "EGT_TOUTRDESMFLO2_CUR_X" "8"
 SYSTEM_CONSTANT "EGT_TOUTRDESMSSOT_CUR_X" "8"
 SYSTEM_CONSTANT "EGT_TOUTRDESTEMPPST_CUR_X" "8"
 SYSTEM_CONSTANT "EGT_TOUTRDES_MAP_X" "16"
 SYSTEM_CONSTANT "EGT_TOUTRDES_MAP_Y" "16"
 SYSTEM_CONSTANT "EGT_ZERO" "0"
 SYSTEM_CONSTANT "EMCCD_DCYCCURRLOWTEMP_MAP_X" "3"
 SYSTEM_CONSTANT "EMCCD_DCYCCURRLOWTEMP_MAP_Y" "3"
 SYSTEM_CONSTANT "EMCCD_DCYCCURROFF_MAP_X" "7"
 SYSTEM_CONSTANT "EMCCD_DCYCCURROFF_MAP_Y" "16"
 SYSTEM_CONSTANT "EMCCD_DCYCCURRONHI_MAP_X" "7"
 SYSTEM_CONSTANT "EMCCD_DCYCCURRONHI_MAP_Y" "16"
 SYSTEM_CONSTANT "EMCCD_DCYCCURRONLOW_MAP_X" "7"
 SYSTEM_CONSTANT "EMCCD_DCYCCURRONLOW_MAP_Y" "16"
 SYSTEM_CONSTANT "EMCCD_DCYCWARMUP_MAP_X" "15"
 SYSTEM_CONSTANT "EMCCD_DCYCWARMUP_MAP_Y" "15"
 SYSTEM_CONSTANT "EMCCD_ILINACTVAL1_CUR_X" "2"
 SYSTEM_CONSTANT "EMCCD_ILINACTVAL2_CUR_X" "2"
 SYSTEM_CONSTANT "EMCCD_RESIST_NORM" "195.503421309873"
 SYSTEM_CONSTANT "ENERGY_RES" "1"
 SYSTEM_CONSTANT "ENGDN_RES" "1"
 SYSTEM_CONSTANT "ENGM_DN_NORM" "125000"
 SYSTEM_CONSTANT "ENGM_DN_NORM_RED" "31250"
 SYSTEM_CONSTANT "ENGM_FACTRQ_FRC" "8"
 SYSTEM_CONSTANT "ENGM_MNTCTLPWMSIG_MAP_X" "6"
 SYSTEM_CONSTANT "ENGM_MNTCTLPWMSIG_MAP_Y" "15"
 SYSTEM_CONSTANT "ENGM_NAVRGHYSHIGH_CUR_X" "25"
 SYSTEM_CONSTANT "ENGM_NDIFF_MAX" "17179.869176"
 SYSTEM_CONSTANT "ENGM_NDIFF_MIN" "-17179.869184"
 SYSTEM_CONSTANT "ENGM_NUMCYL_10" "10"
 SYSTEM_CONSTANT "ENGM_NUMCYL_3" "3"
 SYSTEM_CONSTANT "ENGM_NUMCYL_4" "4"
 SYSTEM_CONSTANT "ENGM_NUMCYL_5" "5"
 SYSTEM_CONSTANT "ENGM_NUMCYL_6" "6"
 SYSTEM_CONSTANT "ENGM_NUMCYL_8" "8"
 SYSTEM_CONSTANT "ENGM_NUMTHRESH" "3"
 SYSTEM_CONSTANT "ENGM_N_SWT_RES" "400"
 SYSTEM_CONSTANT "ENGM_RED_FAC" "4"
 SYSTEM_CONSTANT "ENGM_SWTNUMCYL_TYPE" "0"
 SYSTEM_CONSTANT "ENGM_SWTNUMCYL_VAL" "6"
 SYSTEM_CONSTANT "ENGM_SWTNUMCYL_VAL_OUT" "6"
 SYSTEM_CONSTANT "ENGM_SWTTTRQFRC_TYPE" "0"
 SYSTEM_CONSTANT "ENGM_SWTTTRQFRC_VAL" "1"
 SYSTEM_CONSTANT "ENGM_TRQFRC_MAP_X" "16"
 SYSTEM_CONSTANT "ENGM_TRQFRC_MAP_Y" "16"
 SYSTEM_CONSTANT "ENGM_TTRQFRC_OIL" "0"
 SYSTEM_CONSTANT "ENGM_TTRQFRC_WATER" "1"
 SYSTEM_CONSTANT "ENGPRT_FACAPSPRV_MAP_X" "9"
 SYSTEM_CONSTANT "ENGPRT_FACAPSPRV_MAP_Y" "9"
 SYSTEM_CONSTANT "ENGPRT_FACOVHTPRVCT_CUR_X" "25"
 SYSTEM_CONSTANT "ENGPRT_FACOVHTPRVFT_CUR_X" "25"
 SYSTEM_CONSTANT "ENGPRT_FACOVHTPRVOT_CUR_X" "25"
 SYSTEM_CONSTANT "ENGPRT_FACOVHTPRV_MAP_X" "7"
 SYSTEM_CONSTANT "ENGPRT_FACOVHTPRV_MAP_Y" "7"
 SYSTEM_CONSTANT "ENGPRT_QLIM_CUR_X" "25"
 SYSTEM_CONSTANT "ENGPRT_QOVHTPRVNRNG_MAP_X" "16"
 SYSTEM_CONSTANT "ENGPRT_QOVHTPRVNRNG_MAP_Y" "16"
 SYSTEM_CONSTANT "ENGPRT_QOVHTPRVVRNG_MAP_X" "16"
 SYSTEM_CONSTANT "ENGPRT_QOVHTPRVVRNG_MAP_Y" "16"
 SYSTEM_CONSTANT "ENGPRT_QOVHTPRV_MAP_X" "2"
 SYSTEM_CONSTANT "ENGPRT_QOVHTPRV_MAP_Y" "3"
 SYSTEM_CONSTANT "ENGPRT_SWTTRQGEAR_CUR_X" "8"
 SYSTEM_CONSTANT "ENGPRT_TRQCBLIM1_CUR_X" "20"
 SYSTEM_CONSTANT "ENGPRT_TRQCBLIM_CUR_X" "20"
 SYSTEM_CONSTANT "ENGPRT_TRQLIM1_CUR_X" "21"
 SYSTEM_CONSTANT "ENGPRT_TRQLIMDA_CUR_X" "21"
 SYSTEM_CONSTANT "ENGPRT_TRQLIM_CUR_X" "21"
 SYSTEM_CONSTANT "ENGPRT_TRQNLIMSPR_CUR_X" "10"
 SYSTEM_CONSTANT "ENGPRT_TRQNLIM_CUR_X" "21"
 SYSTEM_CONSTANT "ENG_CTFLD_NUM" "3"
 SYSTEM_CONSTANT "ENG_DN_DT_RES" "0.5"
 SYSTEM_CONSTANT "ENG_DP_DT_RES" "0.5"
 SYSTEM_CONSTANT "ENG_GEN_MAX" "32767"
 SYSTEM_CONSTANT "ENG_GEN_MIN" "0"
 SYSTEM_CONSTANT "ENG_N_HIRES" "0.125"
 SYSTEM_CONSTANT "ENG_N_HIRES_EXP" "3"
 SYSTEM_CONSTANT "ENG_N_MAX" "6000"
 SYSTEM_CONSTANT "ENG_N_MIN" "40"
 SYSTEM_CONSTANT "ENG_N_RES" "1"
 SYSTEM_CONSTANT "ENG_N_RES_FL" "1"
 SYSTEM_CONSTANT "ENG_N_RES_INV" "1"
 SYSTEM_CONSTANT "ENG_N_TEST" "8000"
 SYSTEM_CONSTANT "ENG_N_ZERO" "0"
 SYSTEM_CONSTANT "ENG_TRQSPD_CUR_X" "21"
 SYSTEM_CONSTANT "ESCU_DES_ZERO" "0"
 SYSTEM_CONSTANT "ETA_CORR_FACT_ONE" "1"
 SYSTEM_CONSTANT "ETA_EXP" "7"
 SYSTEM_CONSTANT "ETA_RES" "0.0078125"
 SYSTEM_CONSTANT "ETA_RES_REV" "128"
 SYSTEM_CONSTANT "ETCLB_NUM_RAILP_CLB_PNT" "3"
 SYSTEM_CONSTANT "ETCLB_SWTCORACTV_TYPE" "2"
 SYSTEM_CONSTANT "ETCLB_SWTCORACTV_VAL" "0"
 SYSTEM_CONSTANT "EXHAUST_P_MAX" "5000"
 SYSTEM_CONSTANT "EXHAUST_P_MIN" "0"
 SYSTEM_CONSTANT "FACHALFPI" "1.570796326795"
 SYSTEM_CONSTANT "FACPI" "3.14159265359"
 SYSTEM_CONSTANT "FACT1_EXP" "7"
 SYSTEM_CONSTANT "FACT1_FACT1_RES" "16384"
 SYSTEM_CONSTANT "FACT1_MAX" "10"
 SYSTEM_CONSTANT "FACT1_ONE" "1"
 SYSTEM_CONSTANT "FACT1_RES" "0.0078125"
 SYSTEM_CONSTANT "FACT1_RES_REV" "128"
 SYSTEM_CONSTANT "FACT1_ZERO" "0"
 SYSTEM_CONSTANT "FACT2_RES" "6.103515625e-05"
 SYSTEM_CONSTANT "FACT2_RES_REV" "16384"
 SYSTEM_CONSTANT "FACTHREEHALFPI" "4.712388980385"
 SYSTEM_CONSTANT "FACTM_EXP" "4"
 SYSTEM_CONSTANT "FACTM_ONE" "1"
 SYSTEM_CONSTANT "FACTM_RES" "0.0625"
 SYSTEM_CONSTANT "FACTM_RES_REV" "16"
 SYSTEM_CONSTANT "FACTM_ZERO" "0"
 SYSTEM_CONSTANT "FACTOR_10" "10"
 SYSTEM_CONSTANT "FACTOR_100" "100"
 SYSTEM_CONSTANT "FACTOR_1000" "1000"
 SYSTEM_CONSTANT "FACTOR_10000" "10000"
 SYSTEM_CONSTANT "FACTOR_60" "60"
 SYSTEM_CONSTANT "FACTWOPI" "6.28318530718"
 SYSTEM_CONSTANT "FACT_EGT_ONE" "1"
 SYSTEM_CONSTANT "FACT_EGT_RES" "0.001"
 SYSTEM_CONSTANT "FACT_EGT_RES_REV" "1000"
 SYSTEM_CONSTANT "FACT_GEN_MAX" "5.46116666666667"
 SYSTEM_CONSTANT "FACT_GEN_MIN" "0"
 SYSTEM_CONSTANT "FACT_HFM6_RES" "6.103515625e-05"
 SYSTEM_CONSTANT "FACT_HFM6_RES_REV" "16384"
 SYSTEM_CONSTANT "FACT_LAMBDAREC1" "100"
 SYSTEM_CONSTANT "FACT_LAMBDAREC2" "1000000"
 SYSTEM_CONSTANT "FACT_LAMBDAREC3" "2"
 SYSTEM_CONSTANT "FACT_MAX" "1.2"
 SYSTEM_CONSTANT "FACT_MIN" "0.8333"
 SYSTEM_CONSTANT "FACT_NRM_EXP" "13"
 SYSTEM_CONSTANT "FACT_NRM_EXP_HIGH" "12"
 SYSTEM_CONSTANT "FACT_NRM_EXP_LOW" "10"
 SYSTEM_CONSTANT "FACT_ONE" "1"
 SYSTEM_CONSTANT "FACT_RES" "0.0001220703125"
 SYSTEM_CONSTANT "FACT_RES_HIGH" "0.0001220703125"
 SYSTEM_CONSTANT "FACT_RES_LOW" "0.0009765625"
 SYSTEM_CONSTANT "FACT_RES_REV" "8192"
 SYSTEM_CONSTANT "FACT_RES_REV_1_KD_RPM2NM_1_NRM" "4"
 SYSTEM_CONSTANT "FACT_RES_REV_1_KI_RPM2NM_1_NRM" "32"
 SYSTEM_CONSTANT "FACT_RES_REV_1_KP_RPM2NM_1_NRM" "4"
 SYSTEM_CONSTANT "FACT_RES_REV_HIGH" "4096"
 SYSTEM_CONSTANT "FACT_RES_REV_LOW" "1024"
 SYSTEM_CONSTANT "FACT_TEMP" "-2731.4"
 SYSTEM_CONSTANT "FACT_TEN" "10"
 SYSTEM_CONSTANT "FACT_ZERO" "0"
 SYSTEM_CONSTANT "FAC_MASSINJ_TO_QNTINJ" "10000"
 SYSTEM_CONSTANT "FAC_PERDUR_TO_RPM" "60000000"
 SYSTEM_CONSTANT "FAC_PRECTL_CTLINJ" "120000"
 SYSTEM_CONSTANT "FAC_PRES2TRQ_REV" "1000"
 SYSTEM_CONSTANT "FAC_QNTADJ_TO_QNTINJ_0" "10"
 SYSTEM_CONSTANT "FAC_QNTADJ_TO_QNTINJ_1" "15"
 SYSTEM_CONSTANT "FAC_QNTADJ_TO_QNTINJ_2" "25"
 SYSTEM_CONSTANT "FAC_QNTADJ_TO_QNTINJ_3" "50"
 SYSTEM_CONSTANT "FAC_RPM_TO_SWTIME" "6000"
 SYSTEM_CONSTANT "FAC_USEC_TO_RPM" "60000000"
 SYSTEM_CONSTANT "FAK_Q0P5_RES" "0.5"
 SYSTEM_CONSTANT "FAK_Q0P5_RES_REV" "2"
 SYSTEM_CONSTANT "FANCTL_DCYCCALC_CUR_X" "25"
 SYSTEM_CONSTANT "FANCTL_DCYC_CUR_X" "4"
 SYSTEM_CONSTANT "FANCTL_FACWGHFCTR_CUR_X" "4"
 SYSTEM_CONSTANT "FANCTL_NSETGBXOIL_MAP_X" "8"
 SYSTEM_CONSTANT "FANCTL_NSETGBXOIL_MAP_Y" "10"
 SYSTEM_CONSTANT "FANCTL_NSETPNT_CUR_X" "2"
 SYSTEM_CONSTANT "FANCTL_NSETPNT_MAP_X" "8"
 SYSTEM_CONSTANT "FANCTL_NSETPNT_MAP_Y" "10"
 SYSTEM_CONSTANT "FANSPD_MAX" "3000"
 SYSTEM_CONSTANT "FANSPD_MIN" "0"
 SYSTEM_CONSTANT "FBC_AAL0" "0.0744924388"
 SYSTEM_CONSTANT "FBC_AAL1" "0.249256558"
 SYSTEM_CONSTANT "FBC_AAL2" "0.352502005"
 SYSTEM_CONSTANT "FBC_AAL3" "0.249256558"
 SYSTEM_CONSTANT "FBC_AAL4" "0.0744924388"
 SYSTEM_CONSTANT "FBC_AAL5" "0"
 SYSTEM_CONSTANT "FBC_AAL6" "0"
 SYSTEM_CONSTANT "FBC_AAL7" "0"
 SYSTEM_CONSTANT "FBC_AAL8" "0"
 SYSTEM_CONSTANT "FBC_AALORD" "4"
 SYSTEM_CONSTANT "FBC_BPfacINV_RES" "546.116666666667"
 SYSTEM_CONSTANT "FBC_BPfacINV_RES_FL" "546.116666666667"
 SYSTEM_CONSTANT "FBC_BPfac_MAX" "0.0549333170567949"
 SYSTEM_CONSTANT "FBC_BPfac_MIN" "-0.0549333170567949"
 SYSTEM_CONSTANT "FBC_BPfac_RES" "0.00183111056855983"
 SYSTEM_CONSTANT "FBC_BPfac_RES_FL" "0.00183111056855983"
 SYSTEM_CONSTANT "FBC_CTSEGOFFSET" "3"
 SYSTEM_CONSTANT "FBC_CTTDCOFFSET" "1"
 SYSTEM_CONSTANT "FBC_DBPFAC1DEN1" "1.6879"
 SYSTEM_CONSTANT "FBC_DBPFAC1DEN2" "0.949"
 SYSTEM_CONSTANT "FBC_DBPFAC2DEN1" "0.9747"
 SYSTEM_CONSTANT "FBC_DBPFAC2DEN2" "0.949"
 SYSTEM_CONSTANT "FBC_DBPFAC3DEN1" "0.000425"
 SYSTEM_CONSTANT "FBC_DBPFAC3DEN2" "0.949"
 SYSTEM_CONSTANT "FBC_DBPFAC4DEN1" "0"
 SYSTEM_CONSTANT "FBC_DBPFAC4DEN2" "0"
 SYSTEM_CONSTANT "FBC_DBPFAC5DEN1" "0"
 SYSTEM_CONSTANT "FBC_DBPFAC5DEN2" "0"
 SYSTEM_CONSTANT "FBC_DSYN" "1"
 SYSTEM_CONSTANT "FBC_NUMSEG" "2"
 SYSTEM_CONSTANT "FBC_QDVTMAX_CUR_X" "2"
 SYSTEM_CONSTANT "FBC_QDVTMIN_CUR_X" "2"
 SYSTEM_CONSTANT "FBC_QLIM_CUR_X" "4"
 SYSTEM_CONSTANT "FIOMAX" "8"
 SYSTEM_CONSTANT "FIR_SEQ_GEO" "1"
 SYSTEM_CONSTANT "FIR_SEQ_NUM" "0"
 SYSTEM_CONSTANT "FLCONS1_RES" "0.01"
 SYSTEM_CONSTANT "FLCONS1_RES_INV" "100"
 SYSTEM_CONSTANT "FLCONS2_RES" "1"
 SYSTEM_CONSTANT "FLMNG_APCOR_CUR_X" "8"
 SYSTEM_CONSTANT "FLMNG_APCOR_MAP_X" "16"
 SYSTEM_CONSTANT "FLMNG_APCOR_MAP_Y" "16"
 SYSTEM_CONSTANT "FLMNG_ATSCOR_CUR_X" "8"
 SYSTEM_CONSTANT "FLMNG_ETSCOR_CUR_X" "8"
 SYSTEM_CONSTANT "FLMNG_FACLMBDAPSCORRGN1_CUR_X" "8"
 SYSTEM_CONSTANT "FLMNG_FACLMBDAPSCORRGN2_CUR_X" "8"
 SYSTEM_CONSTANT "FLMNG_FULLLDRGLIKI_CUR_X" "7"
 SYSTEM_CONSTANT "FLMNG_FULLLDRGLPKP_CUR_X" "7"
 SYSTEM_CONSTANT "FLMNG_QDEFECTMIN_MAP_X" "16"
 SYSTEM_CONSTANT "FLMNG_QDEFECTMIN_MAP_Y" "16"
 SYSTEM_CONSTANT "FLMNG_QENGTEMP_CUR_X" "5"
 SYSTEM_CONSTANT "FLMNG_RLMBDAPSCORRGN1_MAP_X" "16"
 SYSTEM_CONSTANT "FLMNG_RLMBDAPSCORRGN1_MAP_Y" "16"
 SYSTEM_CONSTANT "FLMNG_RLMBDAPSCORRGN2_MAP_X" "16"
 SYSTEM_CONSTANT "FLMNG_RLMBDAPSCORRGN2_MAP_Y" "16"
 SYSTEM_CONSTANT "FLMNG_RLMBDATSCOR_MAP_X" "16"
 SYSTEM_CONSTANT "FLMNG_RLMBDATSCOR_MAP_Y" "16"
 SYSTEM_CONSTANT "FLMNG_RLMBDETSCOR_MAP_X" "16"
 SYSTEM_CONSTANT "FLMNG_RLMBDETSCOR_MAP_Y" "16"
 SYSTEM_CONSTANT "FLMNG_RLMBDFULLLD_MAP_X" "16"
 SYSTEM_CONSTANT "FLMNG_RLMBDFULLLD_MAP_Y" "16"
 SYSTEM_CONSTANT "FLMNG_RLMBDSMK2FDC_MAP_X" "16"
 SYSTEM_CONSTANT "FLMNG_RLMBDSMK2FDC_MAP_Y" "16"
 SYSTEM_CONSTANT "FLMNG_RLMBDSMK2RGN1_MAP_X" "16"
 SYSTEM_CONSTANT "FLMNG_RLMBDSMK2RGN1_MAP_Y" "16"
 SYSTEM_CONSTANT "FLMNG_RLMBDSMK2RGN2_MAP_X" "16"
 SYSTEM_CONSTANT "FLMNG_RLMBDSMK2RGN2_MAP_Y" "16"
 SYSTEM_CONSTANT "FLMNG_RLMBDSMKDEF_MAP_X" "16"
 SYSTEM_CONSTANT "FLMNG_RLMBDSMKDEF_MAP_Y" "16"
 SYSTEM_CONSTANT "FLMNG_RLMBDSMKFDC_MAP_X" "16"
 SYSTEM_CONSTANT "FLMNG_RLMBDSMKFDC_MAP_Y" "16"
 SYSTEM_CONSTANT "FLMNG_RLMBDSMKRGN1_MAP_X" "16"
 SYSTEM_CONSTANT "FLMNG_RLMBDSMKRGN1_MAP_Y" "16"
 SYSTEM_CONSTANT "FLMNG_RLMBDSMKRGN2_MAP_X" "16"
 SYSTEM_CONSTANT "FLMNG_RLMBDSMKRGN2_MAP_Y" "16"
 SYSTEM_CONSTANT "FLMNG_RLMBDSMKUGBX_MAP_X" "16"
 SYSTEM_CONSTANT "FLMNG_RLMBDSMKUGBX_MAP_Y" "16"
 SYSTEM_CONSTANT "FLMNG_RLMBDSMK_MAP_X" "16"
 SYSTEM_CONSTANT "FLMNG_RLMBDSMK_MAP_Y" "16"
 SYSTEM_CONSTANT "FLMNG_R_STOICH" "14.5"
 SYSTEM_CONSTANT "FLMNG_R_STOICH_INT" "145"
 SYSTEM_CONSTANT "FLMNG_SMK_NORM" "689.655172413793"
 SYSTEM_CONSTANT "FLMNG_SWTFULLLDRGL_TYPE" "2"
 SYSTEM_CONSTANT "FLMNG_SWTFULLLDRGL_VAL" "0"
 SYSTEM_CONSTANT "FLMNG_TIAIRPERCYLPT1_MAP_X" "8"
 SYSTEM_CONSTANT "FLMNG_TIAIRPERCYLPT1_MAP_Y" "8"
 SYSTEM_CONSTANT "FLMNG_TIFULLLDRGLDEL_CUR_X" "10"
 SYSTEM_CONSTANT "FlSCD_SWTSIG_ADC" "0"
 SYSTEM_CONSTANT "FlSCD_SWTSIG_CAN" "1"
 SYSTEM_CONSTANT "FlSCD_SWTSIG_TYPE" "2"
 SYSTEM_CONSTANT "FlSCD_SWTSIG_VAL" "1"
 SYSTEM_CONSTANT "FLSCD_VOLTOTALLIN_CUR_X" "2"
 SYSTEM_CONSTANT "FLSYS_FTS_EXISTS" "1"
 SYSTEM_CONSTANT "FLSYS_FTS_NONE" "0"
 SYSTEM_CONSTANT "FLSYS_RHOFL_CUR_X" "2"
 SYSTEM_CONSTANT "FLSYS_SWTTEMPSENSCFG_TYPE" "2"
 SYSTEM_CONSTANT "FLSYS_SWTTEMPSENSCFG_VAL" "0"
 SYSTEM_CONSTANT "FLSYS_TEMP_CTS" "1"
 SYSTEM_CONSTANT "FLSYS_TEMP_DFL" "2"
 SYSTEM_CONSTANT "FLSYS_TEMP_FTS" "0"
 SYSTEM_CONSTANT "FL_2_RES" "1"
 SYSTEM_CONSTANT "FL_Half_L_MAX" "300"
 SYSTEM_CONSTANT "FL_Half_L_MIN" "0"
 SYSTEM_CONSTANT "FL_L_MAX" "320"
 SYSTEM_CONSTANT "FL_L_MIN" "0"
 SYSTEM_CONSTANT "FL_L_RES" "0.01"
 SYSTEM_CONSTANT "FL_L_RES_INV" "100"
 SYSTEM_CONSTANT "FL_RES" "0.05"
 SYSTEM_CONSTANT "FL_RES_INV" "20"
 SYSTEM_CONSTANT "FL_VOL_RES" "0.001"
 SYSTEM_CONSTANT "FL_VOL_RES_INV" "1000"
 SYSTEM_CONSTANT "FMA_DT1_RES" "4294.967296"
 SYSTEM_CONSTANT "FMA_FACAIRSWTOFF_CUR_X" "8"
 SYSTEM_CONSTANT "FMA_FACENGSWTOFF_CUR_X" "8"
 SYSTEM_CONSTANT "FMA_FACFLSWTOFF_CUR_X" "8"
 SYSTEM_CONSTANT "FMA_FACNQSWTOFF_MAP_X" "8"
 SYSTEM_CONSTANT "FMA_FACNQSWTOFF_MAP_Y" "8"
 SYSTEM_CONSTANT "FMA_INJMASS_RES" "10"
 SYSTEM_CONSTANT "FMTC_FACAIRCORR_CUR_X" "8"
 SYSTEM_CONSTANT "FMTC_FACAIRCORR_MAP_X" "8"
 SYSTEM_CONSTANT "FMTC_FACAIRCORR_MAP_Y" "8"
 SYSTEM_CONSTANT "FMTC_FACETACORLIM_MAP_X" "10"
 SYSTEM_CONSTANT "FMTC_FACETACORLIM_MAP_Y" "10"
 SYSTEM_CONSTANT "FMTC_FACPCRCORR_CUR_X" "8"
 SYSTEM_CONSTANT "FMTC_FACPCRCORR_MAP_X" "8"
 SYSTEM_CONSTANT "FMTC_FACPCRCORR_MAP_Y" "8"
 SYSTEM_CONSTANT "FMTC_FACSTRTINJCORR_CUR_X" "8"
 SYSTEM_CONSTANT "FMTC_FACSTRTINJCORR_MAP_X" "8"
 SYSTEM_CONSTANT "FMTC_FACSTRTINJCORR_MAP_Y" "8"
 SYSTEM_CONSTANT "FMTC_MAIROPT_MAP_X" "16"
 SYSTEM_CONSTANT "FMTC_MAIROPT_MAP_Y" "16"
 SYSTEM_CONSTANT "FMTC_PHISTRTINJOPT_MAP_X" "16"
 SYSTEM_CONSTANT "FMTC_PHISTRTINJOPT_MAP_Y" "16"
 SYSTEM_CONSTANT "FMTC_PPCROPT_MAP_X" "16"
 SYSTEM_CONSTANT "FMTC_PPCROPT_MAP_Y" "16"
 SYSTEM_CONSTANT "FMTC_QBASCBOPN_MAP_X" "16"
 SYSTEM_CONSTANT "FMTC_QBASCBOPN_MAP_Y" "16"
 SYSTEM_CONSTANT "FMTC_QBASPII2_MAP_X" "10"
 SYSTEM_CONSTANT "FMTC_QBASPII2_MAP_Y" "16"
 SYSTEM_CONSTANT "FMTC_QBAS_MAP_X" "16"
 SYSTEM_CONSTANT "FMTC_QBAS_MAP_Y" "16"
 SYSTEM_CONSTANT "FMTC_TQBAS_MAP_X" "24"
 SYSTEM_CONSTANT "FMTC_TQBAS_MAP_Y" "24"
 SYSTEM_CONSTANT "FOSC" "20"
 SYSTEM_CONSTANT "FRMMNG_DCYCFAN_MAX" "100"
 SYSTEM_CONSTANT "FRMMNG_ENGINERPM_CUR_X" "6"
 SYSTEM_CONSTANT "FSYS" "56"
 SYSTEM_CONSTANT "FTSCD_TLIN_CUR_X" "20"
 SYSTEM_CONSTANT "GAS_CONST" "0.2875"
 SYSTEM_CONSTANT "GEARBX_DTRQLIMUP_CUR_X" "8"
 SYSTEM_CONSTANT "GEARBX_NMINFDC_MAP_X" "4"
 SYSTEM_CONSTANT "GEARBX_NMINFDC_MAP_Y" "8"
 SYSTEM_CONSTANT "GEARBX_NMIN_MAP_X" "4"
 SYSTEM_CONSTANT "GEARBX_NMIN_MAP_Y" "8"
 SYSTEM_CONSTANT "GEARBX_NUMGEAR_MAX" "6"
 SYSTEM_CONSTANT "GEARBX_NUMGEAR_MIN" "-1"
 SYSTEM_CONSTANT "GEARBX_SWTTYPE_TYPE" "2"
 SYSTEM_CONSTANT "GEARBX_SWTTYPE_VAL" "0"
 SYSTEM_CONSTANT "GEARBX_TRQDECMAX_CUR_X" "16"
 SYSTEM_CONSTANT "GEARBX_TRQINMAX_CUR_X" "10"
 SYSTEM_CONSTANT "GEARBX_TRQMAXERR2_CUR_X" "25"
 SYSTEM_CONSTANT "GEARBX_TRQMAXERR_CUR_X" "10"
 SYSTEM_CONSTANT "GEARBX_TRQMAXGEAR1_CUR_X" "10"
 SYSTEM_CONSTANT "GEARBX_TRQMAXGEAR2_CUR_X" "10"
 SYSTEM_CONSTANT "GEARBX_TRQMAXGEAR3_CUR_X" "10"
 SYSTEM_CONSTANT "GEARBX_TRQMAXGEAR4_CUR_X" "10"
 SYSTEM_CONSTANT "GEARBX_TRQMAXGEAR5_CUR_X" "10"
 SYSTEM_CONSTANT "GEARBX_TRQMAXGEAR6_CUR_X" "10"
 SYSTEM_CONSTANT "GEARBX_TRQMAXGEARR_CUR_X" "10"
 SYSTEM_CONSTANT "GEARBX_TRQNLIMSSG_MAP_X" "8"
 SYSTEM_CONSTANT "GEARBX_TRQNLIMSSG_MAP_Y" "8"
 SYSTEM_CONSTANT "GEARBX_TYPE_AST" "2"
 SYSTEM_CONSTANT "GEARBX_TYPE_AT" "1"
 SYSTEM_CONSTANT "GEARBX_TYPE_CVT" "3"
 SYSTEM_CONSTANT "GEARBX_TYPE_MT" "0"
 SYSTEM_CONSTANT "GLWCD_FACQNT" "10"
 SYSTEM_CONSTANT "GLWCD_PWRPERLSB" "12.8"
 SYSTEM_CONSTANT "GLWCD_PWRQNT" "128"
 SYSTEM_CONSTANT "GLWCD_PWRZERO" "0"
 SYSTEM_CONSTANT "GlwCD_tiNewState_C" "200"
 SYSTEM_CONSTANT "GlwCD_tiOutput_C" "400"
 SYSTEM_CONSTANT "GLWCTL_PREGLWDURCALC_AIRPRESS" "1"
 SYSTEM_CONSTANT "GLWCTL_PREGLWDURCALC_UBATT" "0"
 SYSTEM_CONSTANT "GLWCTL_RLIMITCLNT_CUR_X" "8"
 SYSTEM_CONSTANT "GLWCTL_RLIMITENTLAST_CUR_X" "8"
 SYSTEM_CONSTANT "GLWCTL_RLIMITENTLAST_MAP_X" "6"
 SYSTEM_CONSTANT "GLWCTL_RLIMITENTLAST_MAP_Y" "6"
 SYSTEM_CONSTANT "GLWCTL_RLIMITNM_MAP_X" "6"
 SYSTEM_CONSTANT "GLWCTL_RLIMITNM_MAP_Y" "6"
 SYSTEM_CONSTANT "GLWCTL_RPWRCLNT_CUR_X" "8"
 SYSTEM_CONSTANT "GLWCTL_RPWRNM_MAP_X" "6"
 SYSTEM_CONSTANT "GLWCTL_RPWRNM_MAP_Y" "6"
 SYSTEM_CONSTANT "GLWCTL_RPWRPAIR_CUR_X" "8"
 SYSTEM_CONSTANT "GLWCTL_RPWRRGN_MAP_X" "6"
 SYSTEM_CONSTANT "GLWCTL_RPWRRGN_MAP_Y" "6"
 SYSTEM_CONSTANT "GLWCTL_RPWRTAIR_CUR_X" "8"
 SYSTEM_CONSTANT "GLWCTL_RSTART_CUR_X" "2"
 SYSTEM_CONSTANT "GLWCTL_SWTPREGLWDURCALC_TYPE" "2"
 SYSTEM_CONSTANT "GLWCTL_SWTPREGLWDURCALC_VAL" "0"
 SYSTEM_CONSTANT "GLWCTL_TILAMPBASE_CUR_X" "6"
 SYSTEM_CONSTANT "GLWCTL_TILAMPPAIR_CUR_X" "2"
 SYSTEM_CONSTANT "GLWCTL_TILAMPUBATT_CUR_X" "2"
 SYSTEM_CONSTANT "GLWCTL_TIPOST_CUR_X" "6"
 SYSTEM_CONSTANT "GLWCTL_TIPRE_CUR_X" "6"
 SYSTEM_CONSTANT "GRADTRQ_RES" "1"
 SYSTEM_CONSTANT "HEAT_CAPACITY_RES" "0.1"
 SYSTEM_CONSTANT "HFM_ADJVAL_CORR" "333.333333333333"
 SYSTEM_CONSTANT "HFM_ADJVAL_CORR_FAC" "100"
 SYSTEM_CONSTANT "HPUN_2PI_REV" "9.54929658551309"
 SYSTEM_CONSTANT "HPUN_DVOLPMPAGED_CUR_X" "12"
 SYSTEM_CONSTANT "HPUN_ETAPMPFLTEMP_CUR_X" "6"
 SYSTEM_CONSTANT "HPUN_ETAPMPMAXAGED_CUR_X" "6"
 SYSTEM_CONSTANT "HPUN_QBALLIM_CUR_X" "8"
 SYSTEM_CONSTANT "HPUN_QFLTEMPLIM_MAP_X" "16"
 SYSTEM_CONSTANT "HPUN_QFLTEMPLIM_MAP_Y" "16"
 SYSTEM_CONSTANT "HPUN_VOL2DVOL_RES" "6000"
 SYSTEM_CONSTANT "IATSCD_FACTTAIR_CUR_X" "8"
 SYSTEM_CONSTANT "IATSCD_SWTSIGCATS_TYPE" "2"
 SYSTEM_CONSTANT "IATSCD_SWTSIGCATS_VAL" "0"
 SYSTEM_CONSTANT "IATSCD_SWTSIG_TYPE" "2"
 SYSTEM_CONSTANT "IATSCD_SWTSIG_VAL" "0"
 SYSTEM_CONSTANT "IATSCD_TLIN_CATS_CUR_X" "16"
 SYSTEM_CONSTANT "IATSCD_TLIN_CUR_X" "25"
 SYSTEM_CONSTANT "IDEAL_GAS_CONSTANT" "287.5"
 SYSTEM_CONSTANT "IDEAL_GAS_CONSTANT_INT" "2875"
 SYSTEM_CONSTANT "IDEAL_GAS_INT" "2875"
 SYSTEM_CONSTANT "IMMCTL_APPLOFF" "0"
 SYSTEM_CONSTANT "IMMCTL_APPLON" "1"
 SYSTEM_CONSTANT "IMMCTL_APPL_OFF" "0"
 SYSTEM_CONSTANT "IMMCTL_APPL_ON" "1"
 SYSTEM_CONSTANT "IMMCTL_APPL_SWT" "0"
 SYSTEM_CONSTANT "IMMCTL_APPL_VAL" "0"
 SYSTEM_CONSTANT "IMPT_RES" "0.01"
 SYSTEM_CONSTANT "INDSYS_CTFLD_NUM" "3"
 SYSTEM_CONSTANT "INDSYS_FACDIFFCORR_CUR_X" "5"
 SYSTEM_CONSTANT "INDSYS_FACVSACTCOR_CUR_X" "8"
 SYSTEM_CONSTANT "INDSYS_MAIRPERCYLLIM_MAP_X" "4"
 SYSTEM_CONSTANT "INDSYS_MAIRPERCYLLIM_MAP_Y" "4"
 SYSTEM_CONSTANT "INDSYS_PAPDYNCORR_CUR_X" "5"
 SYSTEM_CONSTANT "INDSYS_PAPSTATCORR_CUR_X" "5"
 SYSTEM_CONSTANT "INDSYS_PDIFFCORR_MAP_X" "6"
 SYSTEM_CONSTANT "INDSYS_PDIFFCORR_MAP_Y" "6"
 SYSTEM_CONSTANT "INDSYS_PDIFFSTAT_MAP_X" "6"
 SYSTEM_CONSTANT "INDSYS_PDIFFSTAT_MAP_Y" "6"
 SYSTEM_CONSTANT "INDSYS_PDYNMIN_CUR_X" "5"
 SYSTEM_CONSTANT "INDSYS_QDIFFSTATMAX_CUR_X" "5"
 SYSTEM_CONSTANT "INDSYS_QDIFFSTATMIN_CUR_X" "5"
 SYSTEM_CONSTANT "INDSYS_QSETDYNMAX_CUR_X" "5"
 SYSTEM_CONSTANT "INDSYS_QSETDYNMIN_CUR_X" "5"
 SYSTEM_CONSTANT "INDSYS_RVSAAPSCORR_CUR_X" "6"
 SYSTEM_CONSTANT "INDSYS_RVSAATCORR_CUR_X" "2"
 SYSTEM_CONSTANT "INDSYS_RVSACTCOR_MAP_X" "10"
 SYSTEM_CONSTANT "INDSYS_RVSACTCOR_MAP_Y" "12"
 SYSTEM_CONSTANT "INDSYS_RVSARGN_MAP_X" "12"
 SYSTEM_CONSTANT "INDSYS_RVSARGN_MAP_Y" "16"
 SYSTEM_CONSTANT "INDSYS_RVSA_MAP_X" "12"
 SYSTEM_CONSTANT "INDSYS_RVSA_MAP_Y" "16"
 SYSTEM_CONSTANT "INDSYS_TISTARTDELAY_CUR_X" "5"
 SYSTEM_CONSTANT "INJCRV_FACAPMIDYNCOR2_CUR_X" "6"
 SYSTEM_CONSTANT "INJCRV_FACAPPII1DYNCOR_CUR_X" "6"
 SYSTEM_CONSTANT "INJCRV_FACAPPII1DYNQCOR_CUR_X" "6"
 SYSTEM_CONSTANT "INJCRV_FACDQMIDYNCOR2_CUR_X" "6"
 SYSTEM_CONSTANT "INJCRV_FACDQPII1DYNCOR_CUR_X" "6"
 SYSTEM_CONSTANT "INJCRV_FACDQPII1DYNQCOR_CUR_X" "6"
 SYSTEM_CONSTANT "INJCRV_FACETMIDYNCOR2_CUR_X" "6"
 SYSTEM_CONSTANT "INJCRV_FACETPII1DYNCOR_CUR_X" "6"
 SYSTEM_CONSTANT "INJCRV_FACETPII1DYNQCOR_CUR_X" "6"
 SYSTEM_CONSTANT "INJCRV_FACIAMIDYNCOR2_CUR_X" "6"
 SYSTEM_CONSTANT "INJCRV_FACIAPII1DYNCOR_CUR_X" "6"
 SYSTEM_CONSTANT "INJCRV_FACMI1POICORR_MAP_X" "32"
 SYSTEM_CONSTANT "INJCRV_FACMI1POICORR_MAP_Y" "16"
 SYSTEM_CONSTANT "INJCRV_FACMIAPSPHICOR_CUR_X" "8"
 SYSTEM_CONSTANT "INJCRV_FACMIATSDYN_CUR_X" "6"
 SYSTEM_CONSTANT "INJCRV_FACMIATSPHICOR_CUR_X" "8"
 SYSTEM_CONSTANT "INJCRV_FACMICHAMWLLTEMPCORR_MAP_X" "8"
 SYSTEM_CONSTANT "INJCRV_FACMICHAMWLLTEMPCORR_MAP_Y" "8"
 SYSTEM_CONSTANT "INJCRV_FACMICTSDYN_CUR_X" "6"
 SYSTEM_CONSTANT "INJCRV_FACMIETSPHICOR1_CUR_X" "8"
 SYSTEM_CONSTANT "INJCRV_FACMIETSPHICORRGN_CUR_X" "8"
 SYSTEM_CONSTANT "INJCRV_FACMIETSPHICOR_CUR_X" "8"
 SYSTEM_CONSTANT "INJCRV_FACMIFTSRAILCOR_CUR_X" "8"
 SYSTEM_CONSTANT "INJCRV_FACMIPDYN_CUR_X" "8"
 SYSTEM_CONSTANT "INJCRV_FACPII1ATSSOECOR_CUR_X" "6"
 SYSTEM_CONSTANT "INJCRV_FACPII1CHAMWLLTEMPCORR_MAP_X" "8"
 SYSTEM_CONSTANT "INJCRV_FACPII1CHAMWLLTEMPCORR_MAP_Y" "8"
 SYSTEM_CONSTANT "INJCRV_FACPII1QNTMIN_CUR_X" "8"
 SYSTEM_CONSTANT "INJCRV_FACPII2QNTMIN_CUR_X" "8"
 SYSTEM_CONSTANT "INJCRV_FACPII3APSQCOR_CUR_X" "6"
 SYSTEM_CONSTANT "INJCRV_FACPII3ATSQCOR_CUR_X" "6"
 SYSTEM_CONSTANT "INJCRV_FACPII3ETSQCOR_CUR_X" "6"
 SYSTEM_CONSTANT "INJCRV_FACPII3ETSSOECOR_CUR_X" "6"
 SYSTEM_CONSTANT "INJCRV_FACPIIAPSQCOR2_CUR_X" "8"
 SYSTEM_CONSTANT "INJCRV_FACPIIAPSQCOR_CUR_X" "10"
 SYSTEM_CONSTANT "INJCRV_FACPIIAPSSOECORSTRT_CUR_X" "6"
 SYSTEM_CONSTANT "INJCRV_FACPIIAPSSOECOR_CUR_X" "6"
 SYSTEM_CONSTANT "INJCRV_FACPIIATSQCOR2_CUR_X" "8"
 SYSTEM_CONSTANT "INJCRV_FACPIIATSQCOR_CUR_X" "10"
 SYSTEM_CONSTANT "INJCRV_FACPIIETSQCOR1_CUR_X" "8"
 SYSTEM_CONSTANT "INJCRV_FACPIIETSQCOR2_CUR_X" "8"
 SYSTEM_CONSTANT "INJCRV_FACPIIETSQCOR_CUR_X" "10"
 SYSTEM_CONSTANT "INJCRV_FACPIIETSSOECOR1_CUR_X" "8"
 SYSTEM_CONSTANT "INJCRV_FACPIIETSSOECORSTRT_CUR_X" "10"
 SYSTEM_CONSTANT "INJCRV_FACPIIETSSOECOR_CUR_X" "10"
 SYSTEM_CONSTANT "INJCRV_FACPOI1APSQCOR_CUR_X" "6"
 SYSTEM_CONSTANT "INJCRV_FACPOI1CATPHICOR_CUR_X" "2"
 SYSTEM_CONSTANT "INJCRV_FACPOI1CATQCOR_CUR_X" "2"
 SYSTEM_CONSTANT "INJCRV_FACPOI1EFF1_MAP_X" "16"
 SYSTEM_CONSTANT "INJCRV_FACPOI1EFF1_MAP_Y" "16"
 SYSTEM_CONSTANT "INJCRV_FACPOI1EFF2_MAP_X" "16"
 SYSTEM_CONSTANT "INJCRV_FACPOI1EFF2_MAP_Y" "16"
 SYSTEM_CONSTANT "INJCRV_FACPOI1EFF_MAP_X" "8"
 SYSTEM_CONSTANT "INJCRV_FACPOI1EFF_MAP_Y" "8"
 SYSTEM_CONSTANT "INJCRV_FACPOI1ETSPHICOR_CUR_X" "1"
 SYSTEM_CONSTANT "INJCRV_FACPOI1ETSQCOR_CUR_X" "1"
 SYSTEM_CONSTANT "INJCRV_FACPOI2APSQCORSTRT_CUR_X" "10"
 SYSTEM_CONSTANT "INJCRV_FACPOI2ATSQCORSTRT_CUR_X" "10"
 SYSTEM_CONSTANT "INJCRV_FACPOI2ATSQCOR_CUR_X" "8"
 SYSTEM_CONSTANT "INJCRV_FACPOI2ATSSOECOR_CUR_X" "8"
 SYSTEM_CONSTANT "INJCRV_FACPOI2EFF1_MAP_X" "16"
 SYSTEM_CONSTANT "INJCRV_FACPOI2EFF1_MAP_Y" "16"
 SYSTEM_CONSTANT "INJCRV_FACPOI2EFF2_MAP_X" "16"
 SYSTEM_CONSTANT "INJCRV_FACPOI2EFF2_MAP_Y" "16"
 SYSTEM_CONSTANT "INJCRV_FACPOI2EFF_MAP_X" "8"
 SYSTEM_CONSTANT "INJCRV_FACPOI2EFF_MAP_Y" "8"
 SYSTEM_CONSTANT "INJCRV_FACPOI2ETSQCORSTRT_CUR_X" "10"
 SYSTEM_CONSTANT "INJCRV_FACPOI2ETSQCOR_CUR_X" "8"
 SYSTEM_CONSTANT "INJCRV_FACPOI2ETSSOECORSTRT_CUR_X" "10"
 SYSTEM_CONSTANT "INJCRV_FACPOI2ETSSOECOR_CUR_X" "8"
 SYSTEM_CONSTANT "INJCRV_FACPOPPOI2ETSCORSTRT_CUR_X" "10"
 SYSTEM_CONSTANT "INJCRV_FACPOPPOI2ETSCOR_CUR_X" "8"
 SYSTEM_CONSTANT "INJCRV_FACQPII1CHAMWLLTEMPCORR_MAP_X" "8"
 SYSTEM_CONSTANT "INJCRV_FACQPII1CHAMWLLTEMPCORR_MAP_Y" "8"
 SYSTEM_CONSTANT "INJCRV_PHIDYNOFS_CUR_X" "12"
 SYSTEM_CONSTANT "INJCRV_PHIMI1BAS1CBFDC_MAP_X" "16"
 SYSTEM_CONSTANT "INJCRV_PHIMI1BAS1CBFDC_MAP_Y" "16"
 SYSTEM_CONSTANT "INJCRV_PHIMI1BAS1CB_MAP_X" "16"
 SYSTEM_CONSTANT "INJCRV_PHIMI1BAS1CB_MAP_Y" "16"
 SYSTEM_CONSTANT "INJCRV_PHIMI1BAS1FDC_MAP_X" "16"
 SYSTEM_CONSTANT "INJCRV_PHIMI1BAS1FDC_MAP_Y" "16"
 SYSTEM_CONSTANT "INJCRV_PHIMI1BAS1_MAP_X" "16"
 SYSTEM_CONSTANT "INJCRV_PHIMI1BAS1_MAP_Y" "16"
 SYSTEM_CONSTANT "INJCRV_PHIMI1BAS2CBFDC_MAP_X" "16"
 SYSTEM_CONSTANT "INJCRV_PHIMI1BAS2CBFDC_MAP_Y" "16"
 SYSTEM_CONSTANT "INJCRV_PHIMI1BAS2CB_MAP_X" "16"
 SYSTEM_CONSTANT "INJCRV_PHIMI1BAS2CB_MAP_Y" "16"
 SYSTEM_CONSTANT "INJCRV_PHIMI1BAS2FDC_MAP_X" "16"
 SYSTEM_CONSTANT "INJCRV_PHIMI1BAS2FDC_MAP_Y" "16"
 SYSTEM_CONSTANT "INJCRV_PHIMI1BAS2_MAP_X" "16"
 SYSTEM_CONSTANT "INJCRV_PHIMI1BAS2_MAP_Y" "16"
 SYSTEM_CONSTANT "INJCRV_PHIMI1BAS3_MAP_X" "16"
 SYSTEM_CONSTANT "INJCRV_PHIMI1BAS3_MAP_Y" "16"
 SYSTEM_CONSTANT "INJCRV_PHIMI1BAS4_MAP_X" "16"
 SYSTEM_CONSTANT "INJCRV_PHIMI1BAS4_MAP_Y" "16"
 SYSTEM_CONSTANT "INJCRV_PHIMI1BAS5_MAP_X" "16"
 SYSTEM_CONSTANT "INJCRV_PHIMI1BAS5_MAP_Y" "16"
 SYSTEM_CONSTANT "INJCRV_PHIMI1MAX_MAP_X" "8"
 SYSTEM_CONSTANT "INJCRV_PHIMI1MAX_MAP_Y" "8"
 SYSTEM_CONSTANT "INJCRV_PHIMI1MIN_CUR_X" "8"
 SYSTEM_CONSTANT "INJCRV_PHIMI1RGN1_MAP_X" "16"
 SYSTEM_CONSTANT "INJCRV_PHIMI1RGN1_MAP_Y" "16"
 SYSTEM_CONSTANT "INJCRV_PHIMI1RGN2_MAP_X" "16"
 SYSTEM_CONSTANT "INJCRV_PHIMI1RGN2_MAP_Y" "16"
 SYSTEM_CONSTANT "INJCRV_PHIMI1STINJ_MAP_X" "16"
 SYSTEM_CONSTANT "INJCRV_PHIMI1STINJ_MAP_Y" "16"
 SYSTEM_CONSTANT "INJCRV_PHIMIAPSCORSTRT_MAP_X" "16"
 SYSTEM_CONSTANT "INJCRV_PHIMIAPSCORSTRT_MAP_Y" "16"
 SYSTEM_CONSTANT "INJCRV_PHIMIAPSCOR_MAP_X" "16"
 SYSTEM_CONSTANT "INJCRV_PHIMIAPSCOR_MAP_Y" "16"
 SYSTEM_CONSTANT "INJCRV_PHIMIAPSDYNCOR_MAP_X" "4"
 SYSTEM_CONSTANT "INJCRV_PHIMIAPSDYNCOR_MAP_Y" "4"
 SYSTEM_CONSTANT "INJCRV_PHIMIATSCORSTRT_MAP_X" "16"
 SYSTEM_CONSTANT "INJCRV_PHIMIATSCORSTRT_MAP_Y" "16"
 SYSTEM_CONSTANT "INJCRV_PHIMIATSCOR_MAP_X" "16"
 SYSTEM_CONSTANT "INJCRV_PHIMIATSCOR_MAP_Y" "16"
 SYSTEM_CONSTANT "INJCRV_PHIMICHAMWLLTEMPCORR_MAP_X" "8"
 SYSTEM_CONSTANT "INJCRV_PHIMICHAMWLLTEMPCORR_MAP_Y" "8"
 SYSTEM_CONSTANT "INJCRV_PHIMIDYNCOR2_MAP_X" "16"
 SYSTEM_CONSTANT "INJCRV_PHIMIDYNCOR2_MAP_Y" "8"
 SYSTEM_CONSTANT "INJCRV_PHIMIDYNCOR_MAP_X" "16"
 SYSTEM_CONSTANT "INJCRV_PHIMIDYNCOR_MAP_Y" "8"
 SYSTEM_CONSTANT "INJCRV_PHIMIETSCOR1_MAP_X" "16"
 SYSTEM_CONSTANT "INJCRV_PHIMIETSCOR1_MAP_Y" "16"
 SYSTEM_CONSTANT "INJCRV_PHIMIETSCORGN_MAP_X" "12"
 SYSTEM_CONSTANT "INJCRV_PHIMIETSCORGN_MAP_Y" "12"
 SYSTEM_CONSTANT "INJCRV_PHIMIETSCORSTRT_MAP_X" "16"
 SYSTEM_CONSTANT "INJCRV_PHIMIETSCORSTRT_MAP_Y" "16"
 SYSTEM_CONSTANT "INJCRV_PHIMIETSCOR_MAP_X" "16"
 SYSTEM_CONSTANT "INJCRV_PHIMIETSCOR_MAP_Y" "16"
 SYSTEM_CONSTANT "INJCRV_PHIMIFTSRAILCORSTRT_MAP_X" "12"
 SYSTEM_CONSTANT "INJCRV_PHIMIFTSRAILCORSTRT_MAP_Y" "8"
 SYSTEM_CONSTANT "INJCRV_PHIMIFTSRAILCOR_MAP_X" "12"
 SYSTEM_CONSTANT "INJCRV_PHIMIFTSRAILCOR_MAP_Y" "8"
 SYSTEM_CONSTANT "INJCRV_PHIPII1ATSCOR_MAP_X" "12"
 SYSTEM_CONSTANT "INJCRV_PHIPII1ATSCOR_MAP_Y" "8"
 SYSTEM_CONSTANT "INJCRV_PHIPII1BASSTRT_MAP_X" "2"
 SYSTEM_CONSTANT "INJCRV_PHIPII1BASSTRT_MAP_Y" "2"
 SYSTEM_CONSTANT "INJCRV_PHIPII1ETSCOR_MAP_X" "2"
 SYSTEM_CONSTANT "INJCRV_PHIPII1ETSCOR_MAP_Y" "2"
 SYSTEM_CONSTANT "INJCRV_PHIPII1RGN_MAP_X" "2"
 SYSTEM_CONSTANT "INJCRV_PHIPII1RGN_MAP_Y" "2"
 SYSTEM_CONSTANT "INJCRV_PHIPII2BAS_MAP_X" "2"
 SYSTEM_CONSTANT "INJCRV_PHIPII2BAS_MAP_Y" "2"
 SYSTEM_CONSTANT "INJCRV_PHIPII2ETSCOR_MAP_X" "2"
 SYSTEM_CONSTANT "INJCRV_PHIPII2ETSCOR_MAP_Y" "2"
 SYSTEM_CONSTANT "INJCRV_PHIPII3BAS1_MAP_X" "8"
 SYSTEM_CONSTANT "INJCRV_PHIPII3BAS1_MAP_Y" "8"
 SYSTEM_CONSTANT "INJCRV_PHIPII3BAS2_MAP_X" "8"
 SYSTEM_CONSTANT "INJCRV_PHIPII3BAS2_MAP_Y" "8"
 SYSTEM_CONSTANT "INJCRV_PHIPII3ETSCOR_MAP_X" "8"
 SYSTEM_CONSTANT "INJCRV_PHIPII3ETSCOR_MAP_Y" "8"
 SYSTEM_CONSTANT "INJCRV_PHIPII3ETS_MAP_X" "8"
 SYSTEM_CONSTANT "INJCRV_PHIPII3ETS_MAP_Y" "8"
 SYSTEM_CONSTANT "INJCRV_PHIPOI1CATCOR_MAP_X" "2"
 SYSTEM_CONSTANT "INJCRV_PHIPOI1CATCOR_MAP_Y" "2"
 SYSTEM_CONSTANT "INJCRV_PHIPOI1ETSCOR_MAP_X" "2"
 SYSTEM_CONSTANT "INJCRV_PHIPOI1ETSCOR_MAP_Y" "2"
 SYSTEM_CONSTANT "INJCRV_PHIPOI1MAX_MAP_X" "2"
 SYSTEM_CONSTANT "INJCRV_PHIPOI1MAX_MAP_Y" "2"
 SYSTEM_CONSTANT "INJCRV_PHIPOI1RGN1_MAP_X" "12"
 SYSTEM_CONSTANT "INJCRV_PHIPOI1RGN1_MAP_Y" "12"
 SYSTEM_CONSTANT "INJCRV_PHIPOI1RGN2_MAP_X" "12"
 SYSTEM_CONSTANT "INJCRV_PHIPOI1RGN2_MAP_Y" "12"
 SYSTEM_CONSTANT "INJCRV_PHIPOI2ATSCOR_MAP_X" "16"
 SYSTEM_CONSTANT "INJCRV_PHIPOI2ATSCOR_MAP_Y" "8"
 SYSTEM_CONSTANT "INJCRV_PHIPOI2BAS_MAP_X" "2"
 SYSTEM_CONSTANT "INJCRV_PHIPOI2BAS_MAP_Y" "2"
 SYSTEM_CONSTANT "INJCRV_PHIPOI2ETSCOR_MAP_X" "12"
 SYSTEM_CONSTANT "INJCRV_PHIPOI2ETSCOR_MAP_Y" "8"
 SYSTEM_CONSTANT "INJCRV_PHIPOI2RGN1_MAP_X" "2"
 SYSTEM_CONSTANT "INJCRV_PHIPOI2RGN1_MAP_Y" "2"
 SYSTEM_CONSTANT "INJCRV_PHIPOI2RGN2_MAP_X" "2"
 SYSTEM_CONSTANT "INJCRV_PHIPOI2RGN2_MAP_Y" "2"
 SYSTEM_CONSTANT "INJCRV_PHIPOI2RGNAPCOR_CUR_X" "1"
 SYSTEM_CONSTANT "INJCRV_PHIPOI2RGNCOR_MAP_X" "2"
 SYSTEM_CONSTANT "INJCRV_PHIPOI2RGNCOR_MAP_Y" "2"
 SYSTEM_CONSTANT "INJCRV_PHIPOI2RGNETCOR_CUR_X" "1"
 SYSTEM_CONSTANT "INJCRV_PIIDBLCORMAP_OFF" "0"
 SYSTEM_CONSTANT "INJCRV_PIIDBLCORMAP_ON" "1"
 SYSTEM_CONSTANT "INJCRV_PIONOFF_OFF" "255"
 SYSTEM_CONSTANT "INJCRV_PIONOFF_ON" "0"
 SYSTEM_CONSTANT "INJCRV_POPPII1BAS_MAP_X" "12"
 SYSTEM_CONSTANT "INJCRV_POPPII1BAS_MAP_Y" "12"
 SYSTEM_CONSTANT "INJCRV_POPPII2BAS_MAP_X" "12"
 SYSTEM_CONSTANT "INJCRV_POPPII2BAS_MAP_Y" "12"
 SYSTEM_CONSTANT "INJCRV_POPPIIAIRCOR_CUR_X" "8"
 SYSTEM_CONSTANT "INJCRV_POPPIIETSCOR_CUR_X" "8"
 SYSTEM_CONSTANT "INJCRV_POPPOI1BAS_MAP_X" "2"
 SYSTEM_CONSTANT "INJCRV_POPPOI1BAS_MAP_Y" "2"
 SYSTEM_CONSTANT "INJCRV_POPPOI1ETSCOR_CUR_X" "1"
 SYSTEM_CONSTANT "INJCRV_POPPOI2BASSTRT_MAP_X" "8"
 SYSTEM_CONSTANT "INJCRV_POPPOI2BASSTRT_MAP_Y" "8"
 SYSTEM_CONSTANT "INJCRV_POPPOI2BAS_MAP_X" "6"
 SYSTEM_CONSTANT "INJCRV_POPPOI2BAS_MAP_Y" "6"
 SYSTEM_CONSTANT "INJCRV_POPPOI2ETSCORSTRT_MAP_X" "8"
 SYSTEM_CONSTANT "INJCRV_POPPOI2ETSCORSTRT_MAP_Y" "8"
 SYSTEM_CONSTANT "INJCRV_POPPOI2ETSCOR_MAP_X" "8"
 SYSTEM_CONSTANT "INJCRV_POPPOI2ETSCOR_MAP_Y" "8"
 SYSTEM_CONSTANT "INJCRV_QMI1COR_MAP_X" "16"
 SYSTEM_CONSTANT "INJCRV_QMI1COR_MAP_Y" "16"
 SYSTEM_CONSTANT "INJCRV_QMI1RGN1_MAP_X" "8"
 SYSTEM_CONSTANT "INJCRV_QMI1RGN1_MAP_Y" "8"
 SYSTEM_CONSTANT "INJCRV_QMI1RGN2_MAP_X" "8"
 SYSTEM_CONSTANT "INJCRV_QMI1RGN2_MAP_Y" "8"
 SYSTEM_CONSTANT "INJCRV_QMIN1_CUR_X" "16"
 SYSTEM_CONSTANT "INJCRV_QMIN2_CUR_X" "16"
 SYSTEM_CONSTANT "INJCRV_QMIN3_CUR_X" "16"
 SYSTEM_CONSTANT "INJCRV_QMIN4_CUR_X" "16"
 SYSTEM_CONSTANT "INJCRV_QMIN5_CUR_X" "16"
 SYSTEM_CONSTANT "INJCRV_QMIN_MAP_X" "16"
 SYSTEM_CONSTANT "INJCRV_QMIN_MAP_Y" "16"
 SYSTEM_CONSTANT "INJCRV_QPII1APSCORSTRT_MAP_X" "16"
 SYSTEM_CONSTANT "INJCRV_QPII1APSCORSTRT_MAP_Y" "16"
 SYSTEM_CONSTANT "INJCRV_QPII1APSCOR_MAP_X" "16"
 SYSTEM_CONSTANT "INJCRV_QPII1APSCOR_MAP_Y" "16"
 SYSTEM_CONSTANT "INJCRV_QPII1ATSCORSTRT_MAP_X" "16"
 SYSTEM_CONSTANT "INJCRV_QPII1ATSCORSTRT_MAP_Y" "16"
 SYSTEM_CONSTANT "INJCRV_QPII1ATSCOR_MAP_X" "16"
 SYSTEM_CONSTANT "INJCRV_QPII1ATSCOR_MAP_Y" "16"
 SYSTEM_CONSTANT "INJCRV_QPII1BAS2_MAP_X" "16"
 SYSTEM_CONSTANT "INJCRV_QPII1BAS2_MAP_Y" "16"
 SYSTEM_CONSTANT "INJCRV_QPII1BAS_MAP_X" "16"
 SYSTEM_CONSTANT "INJCRV_QPII1BAS_MAP_Y" "16"
 SYSTEM_CONSTANT "INJCRV_QPII1CHAMWLLTEMPCORR_MAP_X" "8"
 SYSTEM_CONSTANT "INJCRV_QPII1CHAMWLLTEMPCORR_MAP_Y" "8"
 SYSTEM_CONSTANT "INJCRV_QPII1DYNQCOR_MAP_X" "16"
 SYSTEM_CONSTANT "INJCRV_QPII1DYNQCOR_MAP_Y" "8"
 SYSTEM_CONSTANT "INJCRV_QPII1ETSCOR1_MAP_X" "16"
 SYSTEM_CONSTANT "INJCRV_QPII1ETSCOR1_MAP_Y" "16"
 SYSTEM_CONSTANT "INJCRV_QPII1ETSCORSTRT_MAP_X" "16"
 SYSTEM_CONSTANT "INJCRV_QPII1ETSCORSTRT_MAP_Y" "16"
 SYSTEM_CONSTANT "INJCRV_QPII1ETSCOR_MAP_X" "16"
 SYSTEM_CONSTANT "INJCRV_QPII1ETSCOR_MAP_Y" "16"
 SYSTEM_CONSTANT "INJCRV_QPII1MAX2_MAP_X" "8"
 SYSTEM_CONSTANT "INJCRV_QPII1MAX2_MAP_Y" "16"
 SYSTEM_CONSTANT "INJCRV_QPII1MAX_MAP_X" "8"
 SYSTEM_CONSTANT "INJCRV_QPII1MAX_MAP_Y" "16"
 SYSTEM_CONSTANT "INJCRV_QPII1RGN_MAP_X" "16"
 SYSTEM_CONSTANT "INJCRV_QPII1RGN_MAP_Y" "16"
 SYSTEM_CONSTANT "INJCRV_QPII2APSCORSTRT_MAP_X" "2"
 SYSTEM_CONSTANT "INJCRV_QPII2APSCORSTRT_MAP_Y" "2"
 SYSTEM_CONSTANT "INJCRV_QPII2APSCOR_MAP_X" "16"
 SYSTEM_CONSTANT "INJCRV_QPII2APSCOR_MAP_Y" "16"
 SYSTEM_CONSTANT "INJCRV_QPII2ATSCORSTRT_MAP_X" "2"
 SYSTEM_CONSTANT "INJCRV_QPII2ATSCORSTRT_MAP_Y" "2"
 SYSTEM_CONSTANT "INJCRV_QPII2ATSCOR_MAP_X" "16"
 SYSTEM_CONSTANT "INJCRV_QPII2ATSCOR_MAP_Y" "16"
 SYSTEM_CONSTANT "INJCRV_QPII2BASSTRT_MAP_X" "2"
 SYSTEM_CONSTANT "INJCRV_QPII2BASSTRT_MAP_Y" "2"
 SYSTEM_CONSTANT "INJCRV_QPII2BAS_MAP_X" "16"
 SYSTEM_CONSTANT "INJCRV_QPII2BAS_MAP_Y" "16"
 SYSTEM_CONSTANT "INJCRV_QPII2ETSCORSTRT_MAP_X" "2"
 SYSTEM_CONSTANT "INJCRV_QPII2ETSCORSTRT_MAP_Y" "2"
 SYSTEM_CONSTANT "INJCRV_QPII2ETSCOR_MAP_X" "16"
 SYSTEM_CONSTANT "INJCRV_QPII2ETSCOR_MAP_Y" "16"
 SYSTEM_CONSTANT "INJCRV_QPII2MAX_MAP_X" "8"
 SYSTEM_CONSTANT "INJCRV_QPII2MAX_MAP_Y" "8"
 SYSTEM_CONSTANT "INJCRV_QPII3APSCOR_MAP_X" "8"
 SYSTEM_CONSTANT "INJCRV_QPII3APSCOR_MAP_Y" "8"
 SYSTEM_CONSTANT "INJCRV_QPII3ATSCOR_MAP_X" "8"
 SYSTEM_CONSTANT "INJCRV_QPII3ATSCOR_MAP_Y" "8"
 SYSTEM_CONSTANT "INJCRV_QPII3BAS_MAP_X" "16"
 SYSTEM_CONSTANT "INJCRV_QPII3BAS_MAP_Y" "8"
 SYSTEM_CONSTANT "INJCRV_QPII3ETSCOR_MAP_X" "8"
 SYSTEM_CONSTANT "INJCRV_QPII3ETSCOR_MAP_Y" "8"
 SYSTEM_CONSTANT "INJCRV_QPII3MAX_MAP_X" "8"
 SYSTEM_CONSTANT "INJCRV_QPII3MAX_MAP_Y" "8"
 SYSTEM_CONSTANT "INJCRV_QPIIETSCOR1_MAP_X" "16"
 SYSTEM_CONSTANT "INJCRV_QPIIETSCOR1_MAP_Y" "16"
 SYSTEM_CONSTANT "INJCRV_QPOI1APSCOR_MAP_X" "2"
 SYSTEM_CONSTANT "INJCRV_QPOI1APSCOR_MAP_Y" "2"
 SYSTEM_CONSTANT "INJCRV_QPOI1BAS_MAP_X" "2"
 SYSTEM_CONSTANT "INJCRV_QPOI1BAS_MAP_Y" "2"
 SYSTEM_CONSTANT "INJCRV_QPOI1CATCOR_MAP_X" "2"
 SYSTEM_CONSTANT "INJCRV_QPOI1CATCOR_MAP_Y" "2"
 SYSTEM_CONSTANT "INJCRV_QPOI1ETSCOR_MAP_X" "2"
 SYSTEM_CONSTANT "INJCRV_QPOI1ETSCOR_MAP_Y" "2"
 SYSTEM_CONSTANT "INJCRV_QPOI1MAX_MAP_X" "6"
 SYSTEM_CONSTANT "INJCRV_QPOI1MAX_MAP_Y" "6"
 SYSTEM_CONSTANT "INJCRV_QPOI1RGN1_MAP_X" "12"
 SYSTEM_CONSTANT "INJCRV_QPOI1RGN1_MAP_Y" "12"
 SYSTEM_CONSTANT "INJCRV_QPOI1RGN2_MAP_X" "12"
 SYSTEM_CONSTANT "INJCRV_QPOI1RGN2_MAP_Y" "12"
 SYSTEM_CONSTANT "INJCRV_QPOI2APSCORSTRT_MAP_X" "8"
 SYSTEM_CONSTANT "INJCRV_QPOI2APSCORSTRT_MAP_Y" "8"
 SYSTEM_CONSTANT "INJCRV_QPOI2ATSCORSTRT_MAP_X" "8"
 SYSTEM_CONSTANT "INJCRV_QPOI2ATSCORSTRT_MAP_Y" "8"
 SYSTEM_CONSTANT "INJCRV_QPOI2ATSCOR_MAP_X" "6"
 SYSTEM_CONSTANT "INJCRV_QPOI2ATSCOR_MAP_Y" "6"
 SYSTEM_CONSTANT "INJCRV_QPOI2BASSTRT_MAP_X" "8"
 SYSTEM_CONSTANT "INJCRV_QPOI2BASSTRT_MAP_Y" "8"
 SYSTEM_CONSTANT "INJCRV_QPOI2BAS_MAP_X" "16"
 SYSTEM_CONSTANT "INJCRV_QPOI2BAS_MAP_Y" "16"
 SYSTEM_CONSTANT "INJCRV_QPOI2ETSCORSTRT_MAP_X" "8"
 SYSTEM_CONSTANT "INJCRV_QPOI2ETSCORSTRT_MAP_Y" "8"
 SYSTEM_CONSTANT "INJCRV_QPOI2ETSCOR_MAP_X" "7"
 SYSTEM_CONSTANT "INJCRV_QPOI2ETSCOR_MAP_Y" "6"
 SYSTEM_CONSTANT "INJCRV_QPOI2MIN_CUR_X" "1"
 SYSTEM_CONSTANT "INJCRV_QPOI2RGN1_MAP_X" "16"
 SYSTEM_CONSTANT "INJCRV_QPOI2RGN1_MAP_Y" "16"
 SYSTEM_CONSTANT "INJCRV_QPOI2RGN2_MAP_X" "16"
 SYSTEM_CONSTANT "INJCRV_QPOI2RGN2_MAP_Y" "16"
 SYSTEM_CONSTANT "INJCRV_QPOI2RGNAPCOR_CUR_X" "6"
 SYSTEM_CONSTANT "INJCRV_QPOI2RGNCOR_MAP_X" "6"
 SYSTEM_CONSTANT "INJCRV_QPOI2RGNCOR_MAP_Y" "6"
 SYSTEM_CONSTANT "INJCRV_QPOI2RGNETCOR_CUR_X" "1"
 SYSTEM_CONSTANT "INJCRV_STPIIRLSOPRNG1_MAP_X" "16"
 SYSTEM_CONSTANT "INJCRV_STPIIRLSOPRNG1_MAP_Y" "16"
 SYSTEM_CONSTANT "INJCRV_STPIIRLSOPRNG2_MAP_X" "16"
 SYSTEM_CONSTANT "INJCRV_STPIIRLSOPRNG2_MAP_Y" "16"
 SYSTEM_CONSTANT "INJCRV_STPIIRLSOPRNG3_MAP_X" "16"
 SYSTEM_CONSTANT "INJCRV_STPIIRLSOPRNG3_MAP_Y" "16"
 SYSTEM_CONSTANT "INJCRV_STPIIRLSOPRNG4_MAP_X" "16"
 SYSTEM_CONSTANT "INJCRV_STPIIRLSOPRNG4_MAP_Y" "16"
 SYSTEM_CONSTANT "INJCRV_STPIIRLSOPRNG5_MAP_X" "16"
 SYSTEM_CONSTANT "INJCRV_STPIIRLSOPRNG5_MAP_Y" "16"
 SYSTEM_CONSTANT "INJCRV_STPIIRLSOPRNG6_MAP_X" "16"
 SYSTEM_CONSTANT "INJCRV_STPIIRLSOPRNG6_MAP_Y" "16"
 SYSTEM_CONSTANT "INJCRV_STRLSOPRNGTHRESRGN_MAP_X" "16"
 SYSTEM_CONSTANT "INJCRV_STRLSOPRNGTHRESRGN_MAP_Y" "16"
 SYSTEM_CONSTANT "INJCRV_STRLSOPRNGTHRES_MAP_X" "16"
 SYSTEM_CONSTANT "INJCRV_STRLSOPRNGTHRES_MAP_Y" "16"
 SYSTEM_CONSTANT "INJCRV_SWTPIIDBLCORMAP_TYPE" "2"
 SYSTEM_CONSTANT "INJCRV_SWTPIIDBLCORMAP_VAL" "0"
 SYSTEM_CONSTANT "INJCRV_SWTPIONOFF_TYPE" "0"
 SYSTEM_CONSTANT "INJCRV_SWTPIONOFF_VAL" "0"
 SYSTEM_CONSTANT "INJCRV_SWTTIPSE_TYPE" "2"
 SYSTEM_CONSTANT "INJCRV_SWTTIPSE_VAL" "0"
 SYSTEM_CONSTANT "INJCRV_TIPII1ATSCOR_MAP_X" "16"
 SYSTEM_CONSTANT "INJCRV_TIPII1ATSCOR_MAP_Y" "8"
 SYSTEM_CONSTANT "INJCRV_TIPII1BAS1FDC_MAP_X" "16"
 SYSTEM_CONSTANT "INJCRV_TIPII1BAS1FDC_MAP_Y" "16"
 SYSTEM_CONSTANT "INJCRV_TIPII1BAS1_MAP_X" "16"
 SYSTEM_CONSTANT "INJCRV_TIPII1BAS1_MAP_Y" "16"
 SYSTEM_CONSTANT "INJCRV_TIPII1BAS2_MAP_X" "16"
 SYSTEM_CONSTANT "INJCRV_TIPII1BAS2_MAP_Y" "16"
 SYSTEM_CONSTANT "INJCRV_TIPII1BAS3_MAP_X" "2"
 SYSTEM_CONSTANT "INJCRV_TIPII1BAS3_MAP_Y" "2"
 SYSTEM_CONSTANT "INJCRV_TIPII1BASSTRT_MAP_X" "8"
 SYSTEM_CONSTANT "INJCRV_TIPII1BASSTRT_MAP_Y" "8"
 SYSTEM_CONSTANT "INJCRV_TIPII1CHAMWLLTEMPCORR_MAP_X" "8"
 SYSTEM_CONSTANT "INJCRV_TIPII1CHAMWLLTEMPCORR_MAP_Y" "8"
 SYSTEM_CONSTANT "INJCRV_TIPII1CYLOFFS_MAP_X" "5"
 SYSTEM_CONSTANT "INJCRV_TIPII1CYLOFFS_MAP_Y" "5"
 SYSTEM_CONSTANT "INJCRV_TIPII1DYNCOR_MAP_X" "16"
 SYSTEM_CONSTANT "INJCRV_TIPII1DYNCOR_MAP_Y" "8"
 SYSTEM_CONSTANT "INJCRV_TIPII1ETSCOR12_MAP_X" "10"
 SYSTEM_CONSTANT "INJCRV_TIPII1ETSCOR12_MAP_Y" "10"
 SYSTEM_CONSTANT "INJCRV_TIPII1ETSCOR1_MAP_X" "16"
 SYSTEM_CONSTANT "INJCRV_TIPII1ETSCOR1_MAP_Y" "16"
 SYSTEM_CONSTANT "INJCRV_TIPII1ETSCOR2_MAP_X" "16"
 SYSTEM_CONSTANT "INJCRV_TIPII1ETSCOR2_MAP_Y" "16"
 SYSTEM_CONSTANT "INJCRV_TIPII1ETSCORSTRT_MAP_X" "16"
 SYSTEM_CONSTANT "INJCRV_TIPII1ETSCORSTRT_MAP_Y" "16"
 SYSTEM_CONSTANT "INJCRV_TIPII1ETSCOR_MAP_X" "16"
 SYSTEM_CONSTANT "INJCRV_TIPII1ETSCOR_MAP_Y" "16"
 SYSTEM_CONSTANT "INJCRV_TIPII1MINRNG_MAP_X" "10"
 SYSTEM_CONSTANT "INJCRV_TIPII1MINRNG_MAP_Y" "10"
 SYSTEM_CONSTANT "INJCRV_TIPII1MIN_MAP_X" "10"
 SYSTEM_CONSTANT "INJCRV_TIPII1MIN_MAP_Y" "10"
 SYSTEM_CONSTANT "INJCRV_TIPII1RGN_MAP_X" "16"
 SYSTEM_CONSTANT "INJCRV_TIPII1RGN_MAP_Y" "16"
 SYSTEM_CONSTANT "INJCRV_TIPII2APSCORSTRT_MAP_X" "10"
 SYSTEM_CONSTANT "INJCRV_TIPII2APSCORSTRT_MAP_Y" "10"
 SYSTEM_CONSTANT "INJCRV_TIPII2APSCOR_MAP_X" "10"
 SYSTEM_CONSTANT "INJCRV_TIPII2APSCOR_MAP_Y" "10"
 SYSTEM_CONSTANT "INJCRV_TIPII2BASSTRT_MAP_X" "2"
 SYSTEM_CONSTANT "INJCRV_TIPII2BASSTRT_MAP_Y" "2"
 SYSTEM_CONSTANT "INJCRV_TIPII2BAS_MAP_X" "10"
 SYSTEM_CONSTANT "INJCRV_TIPII2BAS_MAP_Y" "10"
 SYSTEM_CONSTANT "INJCRV_TIPII2ETSCORSTRT_MAP_X" "2"
 SYSTEM_CONSTANT "INJCRV_TIPII2ETSCORSTRT_MAP_Y" "2"
 SYSTEM_CONSTANT "INJCRV_TIPII2ETSCOR_MAP_X" "16"
 SYSTEM_CONSTANT "INJCRV_TIPII2ETSCOR_MAP_Y" "16"
 SYSTEM_CONSTANT "INJCRV_TIPOI2ATSCOR_MAP_X" "12"
 SYSTEM_CONSTANT "INJCRV_TIPOI2ATSCOR_MAP_Y" "8"
 SYSTEM_CONSTANT "INJCRV_TIPOI2BASSTRT_MAP_X" "8"
 SYSTEM_CONSTANT "INJCRV_TIPOI2BASSTRT_MAP_Y" "8"
 SYSTEM_CONSTANT "INJCRV_TIPOI2BAS_MAP_X" "16"
 SYSTEM_CONSTANT "INJCRV_TIPOI2BAS_MAP_Y" "16"
 SYSTEM_CONSTANT "INJCRV_TIPOI2ETSCORSTRT_MAP_X" "8"
 SYSTEM_CONSTANT "INJCRV_TIPOI2ETSCORSTRT_MAP_Y" "8"
 SYSTEM_CONSTANT "INJCRV_TIPOI2ETSCOR_MAP_X" "12"
 SYSTEM_CONSTANT "INJCRV_TIPOI2ETSCOR_MAP_Y" "8"
 SYSTEM_CONSTANT "INJCRV_TIPOI2MAX_MAP_X" "8"
 SYSTEM_CONSTANT "INJCRV_TIPOI2MAX_MAP_Y" "16"
 SYSTEM_CONSTANT "INJCRV_TIPOI2RGN1_MAP_X" "16"
 SYSTEM_CONSTANT "INJCRV_TIPOI2RGN1_MAP_Y" "16"
 SYSTEM_CONSTANT "INJCRV_TIPOI2RGN2_MAP_X" "16"
 SYSTEM_CONSTANT "INJCRV_TIPOI2RGN2_MAP_Y" "16"
 SYSTEM_CONSTANT "INJCRV_TIPOI2RGNAPCOR_CUR_X" "1"
 SYSTEM_CONSTANT "INJCRV_TIPOI2RGNCOR_MAP_X" "2"
 SYSTEM_CONSTANT "INJCRV_TIPOI2RGNCOR_MAP_Y" "2"
 SYSTEM_CONSTANT "INJCRV_TIPOI2RGNETCOR_CUR_X" "1"
 SYSTEM_CONSTANT "INJCRV_TIPSE_CONST" "0"
 SYSTEM_CONSTANT "INJCRV_TIPSE_UPD" "1"
 SYSTEM_CONSTANT "INJCTL_QADJQNT_MAP_X" "8"
 SYSTEM_CONSTANT "INJCTL_QADJQNT_MAP_Y" "6"
 SYSTEM_CONSTANT "INJCTL_QDRIFTCOMP_MAP_X" "8"
 SYSTEM_CONSTANT "INJCTL_QDRIFTCOMP_MAP_Y" "4"
 SYSTEM_CONSTANT "INJCTL_QLIMERR_CUR_X" "21"
 SYSTEM_CONSTANT "INJCTL_QLIMERR_MAP_X" "12"
 SYSTEM_CONSTANT "INJCTL_QLIMERR_MAP_Y" "5"
 SYSTEM_CONSTANT "INJCTL_QLIMSOFTSHOFF_CUR_X" "16"
 SYSTEM_CONSTANT "INJTIME_US_ZERO" "0"
 SYSTEM_CONSTANT "INJUN_FACFLMASSCNV_MAP_X" "2"
 SYSTEM_CONSTANT "INJUN_FACFLMASSCNV_MAP_Y" "2"
 SYSTEM_CONSTANT "INJUN_FLQNTADJ_ARRAYSIZE" "9"
 SYSTEM_CONSTANT "INJUN_MI1" "2"
 SYSTEM_CONSTANT "INJUN_MI2" "3"
 SYSTEM_CONSTANT "INJUN_PII1" "4"
 SYSTEM_CONSTANT "INJUN_PII2" "5"
 SYSTEM_CONSTANT "INJUN_PII3" "6"
 SYSTEM_CONSTANT "INJUN_POI1" "0"
 SYSTEM_CONSTANT "INJUN_POI2" "1"
 SYSTEM_CONSTANT "INJUN_POI2EFF" "8"
 SYSTEM_CONSTANT "INJUN_QFULLLDQNTADJ1_MAP_X" "5"
 SYSTEM_CONSTANT "INJUN_QFULLLDQNTADJ1_MAP_Y" "3"
 SYSTEM_CONSTANT "INJUN_QFULLLDQNTADJ2_MAP_X" "5"
 SYSTEM_CONSTANT "INJUN_QFULLLDQNTADJ2_MAP_Y" "3"
 SYSTEM_CONSTANT "INJUN_QFULLLDQNTADJ3_MAP_X" "5"
 SYSTEM_CONSTANT "INJUN_QFULLLDQNTADJ3_MAP_Y" "3"
 SYSTEM_CONSTANT "INJUN_QFULLLDQNTADJ4_MAP_X" "5"
 SYSTEM_CONSTANT "INJUN_QFULLLDQNTADJ4_MAP_Y" "3"
 SYSTEM_CONSTANT "INJUN_QFULLLDQNTADJ5_MAP_X" "5"
 SYSTEM_CONSTANT "INJUN_QFULLLDQNTADJ5_MAP_Y" "3"
 SYSTEM_CONSTANT "INJUN_QFULLLDQNTADJ6_MAP_X" "5"
 SYSTEM_CONSTANT "INJUN_QFULLLDQNTADJ6_MAP_Y" "3"
 SYSTEM_CONSTANT "INJUN_QFULLLDQNTADJ7_MAP_X" "5"
 SYSTEM_CONSTANT "INJUN_QFULLLDQNTADJ7_MAP_Y" "3"
 SYSTEM_CONSTANT "INJUN_QFULLLDQNTADJ8_MAP_X" "5"
 SYSTEM_CONSTANT "INJUN_QFULLLDQNTADJ8_MAP_Y" "3"
 SYSTEM_CONSTANT "INJUN_ZFC" "9"
 SYSTEM_CONSTANT "INJVCD_MI1" "6"
 SYSTEM_CONSTANT "INJVCD_MI1PII1" "7"
 SYSTEM_CONSTANT "INJVCD_MI1PII1PII2" "8"
 SYSTEM_CONSTANT "INJVCD_MI1PII1PII3" "9"
 SYSTEM_CONSTANT "INJVCD_MI1_ESTET" "3"
 SYSTEM_CONSTANT "INJVCD_PII1" "10"
 SYSTEM_CONSTANT "INJVCD_PII1PII2" "11"
 SYSTEM_CONSTANT "INJVCD_PII1_ESTET" "0"
 SYSTEM_CONSTANT "INJVCD_PII2" "12"
 SYSTEM_CONSTANT "INJVCD_PII2_ESTET" "1"
 SYSTEM_CONSTANT "INJVCD_PII3" "13"
 SYSTEM_CONSTANT "INJVCD_PII3_ESTET" "2"
 SYSTEM_CONSTANT "INJVCD_POI1" "14"
 SYSTEM_CONSTANT "INJVCD_POI1_ESTET" "4"
 SYSTEM_CONSTANT "INJVCD_POI2" "15"
 SYSTEM_CONSTANT "INJVCD_POI2_ESTET" "5"
 SYSTEM_CONSTANT "INJVCD_TIET1_MAP_X" "16"
 SYSTEM_CONSTANT "INJVCD_TIET1_MAP_Y" "32"
 SYSTEM_CONSTANT "INJVCD_TIET2_MAP_X" "16"
 SYSTEM_CONSTANT "INJVCD_TIET2_MAP_Y" "32"
 SYSTEM_CONSTANT "INJVCD_TIET3_MAP_X" "16"
 SYSTEM_CONSTANT "INJVCD_TIET3_MAP_Y" "32"
 SYSTEM_CONSTANT "INJVCD_TIET4_MAP_X" "16"
 SYSTEM_CONSTANT "INJVCD_TIET4_MAP_Y" "32"
 SYSTEM_CONSTANT "INJVCD_TIET5_MAP_X" "16"
 SYSTEM_CONSTANT "INJVCD_TIET5_MAP_Y" "32"
 SYSTEM_CONSTANT "INJVCD_TIET6_MAP_X" "16"
 SYSTEM_CONSTANT "INJVCD_TIET6_MAP_Y" "32"
 SYSTEM_CONSTANT "INJVCD_TIET_MAP_X" "16"
 SYSTEM_CONSTANT "INJVCD_TIET_MAP_Y" "40"
 SYSTEM_CONSTANT "INJVCD_TIPICKUPCURR_CUR_X" "2"
 SYSTEM_CONSTANT "InjVlv_1BANK_U8" "0"
 SYSTEM_CONSTANT "InjVlv_2BANK_U8" "2"
 SYSTEM_CONSTANT "InjVlv_ACTIVE_U8" "0"
 SYSTEM_CONSTANT "InjVlv_BOR_ERR_DISABLE_U8" "0"
 SYSTEM_CONSTANT "InjVlv_BOR_ERR_ENABLE_U8" "64"
 SYSTEM_CONSTANT "InjVlv_COM_MAIN_CONT_U8" "192"
 SYSTEM_CONSTANT "InjVlv_COM_MAIN_IR1_U8" "144"
 SYSTEM_CONSTANT "InjVlv_COM_MAIN_IR2_U8" "160"
 SYSTEM_CONSTANT "InjVlv_COM_MAIN_IR3_U8" "48"
 SYSTEM_CONSTANT "InjVlv_COM_MAIN_NOP_U8" "96"
 SYSTEM_CONSTANT "InjVlv_COM_MAIN_OFF_U8" "240"
 SYSTEM_CONSTANT "InjVlv_COM_MAIN_UB_U8" "96"
 SYSTEM_CONSTANT "InjVlv_COM_MAIN_URT_U8" "80"
 SYSTEM_CONSTANT "InjVlv_COM_PARITY_U8" "128"
 SYSTEM_CONSTANT "InjVlv_COM_PRE_B1H_U8" "5"
 SYSTEM_CONSTANT "InjVlv_COM_PRE_B1L_U8" "132"
 SYSTEM_CONSTANT "InjVlv_COM_PRE_B2H_U8" "135"
 SYSTEM_CONSTANT "InjVlv_COM_PRE_B2L_U8" "6"
 SYSTEM_CONSTANT "InjVlv_COM_PRE_OFF_U8" "0"
 SYSTEM_CONSTANT "InjVlv_COM_PRE_SKIP_U8" "129"
 SYSTEM_CONSTANT "InjVlv_COM_PRE_SL0_U8" "12"
 SYSTEM_CONSTANT "InjVlv_COM_PRE_SL2H_U8" "9"
 SYSTEM_CONSTANT "InjVlv_COM_PRE_SL2L_U8" "136"
 SYSTEM_CONSTANT "InjVlv_COM_PRE_SL3H_U8" "139"
 SYSTEM_CONSTANT "InjVlv_COM_PRE_SL3L_U8" "10"
 SYSTEM_CONSTANT "InjVlv_COM_PRE_SLPR_U8" "130"
 SYSTEM_CONSTANT "InjVlv_COM_PRE_SLZ_U8" "141"
 SYSTEM_CONSTANT "InjVlv_CP1_DISABLE_U8" "8"
 SYSTEM_CONSTANT "InjVlv_CP1_ENABLE_U8" "0"
 SYSTEM_CONSTANT "InjVlv_CP2_DISABLE_U8" "16"
 SYSTEM_CONSTANT "InjVlv_CP2_ENABLE_U8" "0"
 SYSTEM_CONSTANT "InjVlv_DCDC_DISABLE_U8" "128"
 SYSTEM_CONSTANT "InjVlv_DCDC_ENABLE_U8" "0"
 SYSTEM_CONSTANT "InjVlv_DIFF_I1_ERR_DISABLE_U8" "0"
 SYSTEM_CONSTANT "InjVlv_DIFF_I1_ERR_ENABLE_U8" "8"
 SYSTEM_CONSTANT "InjVlv_DIFF_I2_ERR_DISABLE_U8" "0"
 SYSTEM_CONSTANT "InjVlv_DIFF_I2_ERR_ENABLE_U8" "16"
 SYSTEM_CONSTANT "InjVlv_DIFF_I3_ERR_DISABLE_U8" "0"
 SYSTEM_CONSTANT "InjVlv_DIFF_I3_ERR_ENABLE_U8" "32"
 SYSTEM_CONSTANT "InjVlv_DIFF_RCHG_ERR_DISABLE_U8" "0"
 SYSTEM_CONSTANT "InjVlv_DIFF_RCHG_ERR_ENABLE_U8" "128"
 SYSTEM_CONSTANT "INJVLV_ERR_MAX" "32"
 SYSTEM_CONSTANT "INJVLV_FACADDBALRLS_MAP_X" "3"
 SYSTEM_CONSTANT "INJVLV_FACADDBALRLS_MAP_Y" "2"
 SYSTEM_CONSTANT "INJVLV_FACFTSWVCOR_MAP_X" "16"
 SYSTEM_CONSTANT "INJVLV_FACFTSWVCOR_MAP_Y" "8"
 SYSTEM_CONSTANT "INJVLV_FACPII1QNTCOR_CUR_X" "10"
 SYSTEM_CONSTANT "INJVLV_FACWVCOR1_MAP_X" "8"
 SYSTEM_CONSTANT "INJVLV_FACWVCOR1_MAP_Y" "16"
 SYSTEM_CONSTANT "INJVLV_FACWVCOR2_MAP_X" "8"
 SYSTEM_CONSTANT "INJVLV_FACWVCOR2_MAP_Y" "16"
 SYSTEM_CONSTANT "InjVlv_HS_MODE_DISABLE_U8" "0"
 SYSTEM_CONSTANT "InjVlv_HS_MODE_ENABLE_U8" "32"
 SYSTEM_CONSTANT "InjVlv_I1_ERR_DISABLE_U8" "0"
 SYSTEM_CONSTANT "InjVlv_I1_ERR_ENABLE_U8" "1"
 SYSTEM_CONSTANT "InjVlv_I2_ERR_DISABLE_U8" "0"
 SYSTEM_CONSTANT "InjVlv_I2_ERR_ENABLE_U8" "2"
 SYSTEM_CONSTANT "InjVlv_I3_ERR_DISABLE_U8" "0"
 SYSTEM_CONSTANT "InjVlv_I3_ERR_ENABLE_U8" "4"
 SYSTEM_CONSTANT "InjVlv_I_BOR_19A_U8" "0"
 SYSTEM_CONSTANT "InjVlv_I_BOR_25A_U8" "16"
 SYSTEM_CONSTANT "InjVlv_I_BOR_32A_U8" "32"
 SYSTEM_CONSTANT "InjVlv_I_BOR_38A_U8" "48"
 SYSTEM_CONSTANT "InjVlv_I_DCDC_MAX_1A5_U8" "0"
 SYSTEM_CONSTANT "InjVlv_I_DCDC_MAX_2A5_U8" "4"
 SYSTEM_CONSTANT "InjVlv_I_DCDC_MAX_2A_U8" "2"
 SYSTEM_CONSTANT "InjVlv_I_DCDC_MAX_3A5_U8" "8"
 SYSTEM_CONSTANT "InjVlv_I_DCDC_MAX_3A_U8" "6"
 SYSTEM_CONSTANT "InjVlv_I_DCDC_MAX_4A5_U8" "12"
 SYSTEM_CONSTANT "InjVlv_I_DCDC_MAX_4A_U8" "10"
 SYSTEM_CONSTANT "InjVlv_I_DCDC_MAX_5A_U8" "14"
 SYSTEM_CONSTANT "InjVlv_I_DCDC_MIN_0A5_U8" "0"
 SYSTEM_CONSTANT "InjVlv_I_DCDC_MIN_1A_U8" "1"
 SYSTEM_CONSTANT "InjVlv_KEY_U8" "51"
 SYSTEM_CONSTANT "InjVlv_LS_MODE_DISABLE_U8" "0"
 SYSTEM_CONSTANT "InjVlv_LS_MODE_ENABLE_U8" "4"
 SYSTEM_CONSTANT "InjVlv_NORMAL_U8" "0"
 SYSTEM_CONSTANT "INJVLV_NUMCHKPNT" "5"
 SYSTEM_CONSTANT "INJVLV_NUMINJCHRGBAL_MAP_X" "15"
 SYSTEM_CONSTANT "INJVLV_NUMINJCHRGBAL_MAP_Y" "6"
 SYSTEM_CONSTANT "INJVLV_PMIN_CUR_X" "8"
 SYSTEM_CONSTANT "InjVlv_PROGRAMMING_U8" "1"
 SYSTEM_CONSTANT "InjVlv_PWM_HIGH_0MS5_U8" "0"
 SYSTEM_CONSTANT "InjVlv_PWM_HIGH_10MS5_U8" "160"
 SYSTEM_CONSTANT "InjVlv_PWM_HIGH_11MS5_U8" "176"
 SYSTEM_CONSTANT "InjVlv_PWM_HIGH_12MS5_U8" "192"
 SYSTEM_CONSTANT "InjVlv_PWM_HIGH_13MS5_U8" "208"
 SYSTEM_CONSTANT "InjVlv_PWM_HIGH_14MS5_U8" "224"
 SYSTEM_CONSTANT "InjVlv_PWM_HIGH_15MS5_U8" "240"
 SYSTEM_CONSTANT "InjVlv_PWM_HIGH_1MS5_U8" "16"
 SYSTEM_CONSTANT "InjVlv_PWM_HIGH_2MS5_U8" "32"
 SYSTEM_CONSTANT "InjVlv_PWM_HIGH_3MS5_U8" "48"
 SYSTEM_CONSTANT "InjVlv_PWM_HIGH_4MS5_U8" "64"
 SYSTEM_CONSTANT "InjVlv_PWM_HIGH_5MS5_U8" "80"
 SYSTEM_CONSTANT "InjVlv_PWM_HIGH_6MS5_U8" "96"
 SYSTEM_CONSTANT "InjVlv_PWM_HIGH_7MS5_U8" "112"
 SYSTEM_CONSTANT "InjVlv_PWM_HIGH_8MS5_U8" "128"
 SYSTEM_CONSTANT "InjVlv_PWM_HIGH_9MS5_U8" "144"
 SYSTEM_CONSTANT "InjVlv_PWM_LOW_0MS25_U8" "0"
 SYSTEM_CONSTANT "InjVlv_PWM_LOW_0MS75_U8" "1"
 SYSTEM_CONSTANT "InjVlv_PWM_LOW_1MS25_U8" "2"
 SYSTEM_CONSTANT "InjVlv_PWM_LOW_1MS75_U8" "3"
 SYSTEM_CONSTANT "InjVlv_PWM_LOW_2MS25_U8" "4"
 SYSTEM_CONSTANT "InjVlv_PWM_LOW_2MS75_U8" "5"
 SYSTEM_CONSTANT "InjVlv_PWM_LOW_3MS25_U8" "6"
 SYSTEM_CONSTANT "InjVlv_PWM_LOW_3MS75_U8" "7"
 SYSTEM_CONSTANT "InjVlv_PWM_LOW_4MS25_U8" "8"
 SYSTEM_CONSTANT "InjVlv_PWM_LOW_4MS75_U8" "9"
 SYSTEM_CONSTANT "InjVlv_PWM_LOW_5MS25_U8" "10"
 SYSTEM_CONSTANT "InjVlv_PWM_LOW_5MS75_U8" "11"
 SYSTEM_CONSTANT "InjVlv_PWM_LOW_6MS25_U8" "12"
 SYSTEM_CONSTANT "InjVlv_PWM_LOW_6MS75_U8" "13"
 SYSTEM_CONSTANT "InjVlv_PWM_LOW_7MS25_U8" "14"
 SYSTEM_CONSTANT "InjVlv_PWM_LOW_7MS75_U8" "15"
 SYSTEM_CONSTANT "InjVlv_PWM_LOW_DUMMY_U8" "15"
 SYSTEM_CONSTANT "INJVLV_QWVCOR1_MAP_X" "32"
 SYSTEM_CONSTANT "INJVLV_QWVCOR1_MAP_Y" "16"
 SYSTEM_CONSTANT "INJVLV_QWVCOR2_MAP_X" "32"
 SYSTEM_CONSTANT "INJVLV_QWVCOR2_MAP_Y" "16"
 SYSTEM_CONSTANT "INJVLV_QWVCOR3_MAP_X" "16"
 SYSTEM_CONSTANT "INJVLV_QWVCOR3_MAP_Y" "16"
 SYSTEM_CONSTANT "INJVLV_QWVCORNORM_CUR_X" "20"
 SYSTEM_CONSTANT "InjVlv_RB_SPI_SEL_U8" "1"
 SYSTEM_CONSTANT "InjVlv_RB_TPU_SEL_U8" "0"
 SYSTEM_CONSTANT "InjVlv_RCHG_MULTI_U8" "1"
 SYSTEM_CONSTANT "InjVlv_RCHG_RS_BLOCK1" "0"
 SYSTEM_CONSTANT "InjVlv_RCHG_RS_BLOCK2" "8"
 SYSTEM_CONSTANT "InjVlv_RCHG_RS_BLOCK3" "16"
 SYSTEM_CONSTANT "InjVlv_RCHG_SINGLE_U8" "0"
 SYSTEM_CONSTANT "InjVlv_rIDivMax_SC" "4640"
 SYSTEM_CONSTANT "InjVlv_rIDivMin_SC" "562"
 SYSTEM_CONSTANT "InjVlv_rIMeas_SC" "10"
 SYSTEM_CONSTANT "InjVlv_rUDivMax_SC" "21500"
 SYSTEM_CONSTANT "InjVlv_rUDivMin_SC" "825"
 SYSTEM_CONSTANT "InjVlv_SMR_DISABLE_U8" "0"
 SYSTEM_CONSTANT "InjVlv_SMR_ENABLE_U8" "2"
 SYSTEM_CONSTANT "InjVlv_SPI_FULL_POWER_U8" "0"
 SYSTEM_CONSTANT "InjVlv_SPI_RB1" "0"
 SYSTEM_CONSTANT "InjVlv_SPI_RB2" "8"
 SYSTEM_CONSTANT "InjVlv_SPI_RB3" "16"
 SYSTEM_CONSTANT "InjVlv_SPI_RED_POWER_U8" "2"
 SYSTEM_CONSTANT "INJVLV_STQNTADJ_MAP_X" "10"
 SYSTEM_CONSTANT "INJVLV_STQNTADJ_MAP_Y" "10"
 SYSTEM_CONSTANT "INJVLV_STWVCORDISBL" "0"
 SYSTEM_CONSTANT "INJVLV_STWVCORENA" "1"
 SYSTEM_CONSTANT "InjVlv_TESTMODE_U8" "4"
 SYSTEM_CONSTANT "INJVLV_TIDIFFHYD_MAP_X" "16"
 SYSTEM_CONSTANT "INJVLV_TIDIFFHYD_MAP_Y" "16"
 SYSTEM_CONSTANT "InjVlv_TIM_BAS_2US_U8" "0"
 SYSTEM_CONSTANT "InjVlv_TIM_BAS_32US_U8" "48"
 SYSTEM_CONSTANT "InjVlv_TIM_BAS_4US_U8" "16"
 SYSTEM_CONSTANT "InjVlv_TIM_BAS_8US_U8" "32"
 SYSTEM_CONSTANT "InjVlv_TIM_FAC_10_U8" "9"
 SYSTEM_CONSTANT "InjVlv_TIM_FAC_11_U8" "10"
 SYSTEM_CONSTANT "InjVlv_TIM_FAC_12_U8" "11"
 SYSTEM_CONSTANT "InjVlv_TIM_FAC_13_U8" "12"
 SYSTEM_CONSTANT "InjVlv_TIM_FAC_14_U8" "13"
 SYSTEM_CONSTANT "InjVlv_TIM_FAC_15_U8" "14"
 SYSTEM_CONSTANT "InjVlv_TIM_FAC_16_U8" "15"
 SYSTEM_CONSTANT "InjVlv_TIM_FAC_1_U8" "0"
 SYSTEM_CONSTANT "InjVlv_TIM_FAC_2_U8" "1"
 SYSTEM_CONSTANT "InjVlv_TIM_FAC_3_U8" "2"
 SYSTEM_CONSTANT "InjVlv_TIM_FAC_4_U8" "3"
 SYSTEM_CONSTANT "InjVlv_TIM_FAC_5_U8" "4"
 SYSTEM_CONSTANT "InjVlv_TIM_FAC_6_U8" "5"
 SYSTEM_CONSTANT "InjVlv_TIM_FAC_7_U8" "6"
 SYSTEM_CONSTANT "InjVlv_TIM_FAC_8_U8" "7"
 SYSTEM_CONSTANT "InjVlv_TIM_FAC_9_U8" "8"
 SYSTEM_CONSTANT "INJVLV_TWVCOR_MAP_X" "16"
 SYSTEM_CONSTANT "INJVLV_TWVCOR_MAP_Y" "16"
 SYSTEM_CONSTANT "InjVlv_uBandgap_SC" "123"
 SYSTEM_CONSTANT "InjVlv_UB_ERR_DISABLE_U8" "0"
 SYSTEM_CONSTANT "InjVlv_UB_ERR_ENABLE_U8" "64"
 SYSTEM_CONSTANT "INJ_MASSCORR_RES" "0.001"
 SYSTEM_CONSTANT "INJ_MASSCYC_MAX" "327.67"
 SYSTEM_CONSTANT "INJ_MASSCYC_MIN" "0"
 SYSTEM_CONSTANT "INJ_MASSCYC_RES" "0.01"
 SYSTEM_CONSTANT "INJ_MASSCYC_RES_INV" "100"
 SYSTEM_CONSTANT "INJ_MASSCYC_ZERO" "0"
 SYSTEM_CONSTANT "INJ_MASSINJ_MAX" "327.67"
 SYSTEM_CONSTANT "INJ_MASSINJ_MIN" "0"
 SYSTEM_CONSTANT "INJ_MASSINJ_ONE" "1"
 SYSTEM_CONSTANT "INJ_MASSINJ_RES" "0.01"
 SYSTEM_CONSTANT "INJ_MASSINJ_RES_INV" "100"
 SYSTEM_CONSTANT "INJ_MASSINJ_ZERO" "0"
 SYSTEM_CONSTANT "INJ_MASSMICOR1_MAX" "10"
 SYSTEM_CONSTANT "INJ_MASSMIN_MAX" "10"
 SYSTEM_CONSTANT "INJ_MASSNSLP_RES" "0.0001"
 SYSTEM_CONSTANT "INJ_MASSPII1_MAX" "10"
 SYSTEM_CONSTANT "INJ_MASSPII2_MAX" "10"
 SYSTEM_CONSTANT "INJ_MASSPII3_MAX" "10"
 SYSTEM_CONSTANT "INJ_MASSPOI1_MAX" "10"
 SYSTEM_CONSTANT "INJ_MASSPOI1_MIN" "0"
 SYSTEM_CONSTANT "INJ_MASSPOI2_MAX" "10"
 SYSTEM_CONSTANT "INJ_MASSQSLP_RES" "0.01"
 SYSTEM_CONSTANT "INJ_MASSTEMPGVNR_MAX" "200"
 SYSTEM_CONSTANT "INJ_MASSTEMPGVNR_MIN" "-200"
 SYSTEM_CONSTANT "INJ_MASS_MAX" "327.67"
 SYSTEM_CONSTANT "INJ_MASS_MIN" "0"
 SYSTEM_CONSTANT "INJ_MASS_MIN_LMBD" "0.1"
 SYSTEM_CONSTANT "INJ_MASS_RES" "0.01"
 SYSTEM_CONSTANT "INJ_MASS_RES_FL" "0.01"
 SYSTEM_CONSTANT "INJ_MASS_RES_INV" "100"
 SYSTEM_CONSTANT "INJ_MASS_TEMPGVNR" "0.1"
 SYSTEM_CONSTANT "INJ_MASS_ZERO" "0"
 SYSTEM_CONSTANT "INJ_QNTINJ_MAX" "100"
 SYSTEM_CONSTANT "INJ_QNTINJ_MIN" "0"
 SYSTEM_CONSTANT "INJ_QNTINJ_RES" "0.01"
 SYSTEM_CONSTANT "INJ_QNTINJ_ZERO" "0"
 SYSTEM_CONSTANT "INJ_QNT_RES" "0.1"
 SYSTEM_CONSTANT "INPUT_FREQ" "55944"
 SYSTEM_CONSTANT "INT_MAX" "5"
 SYSTEM_CONSTANT "I_COIL_MAX" "5000"
 SYSTEM_CONSTANT "I_COIL_MIN" "0"
 SYSTEM_CONSTANT "JUL_RES" "0.1"
 SYSTEM_CONSTANT "KD_1_MAX" "50"
 SYSTEM_CONSTANT "KD_1_NRM" "7"
 SYSTEM_CONSTANT "KD_LIN_16_RES" "32767"
 SYSTEM_CONSTANT "KD_PRAIL2Q_1_MAX" "0.5"
 SYSTEM_CONSTANT "KD_PRAIL2Q_1_NRM" "4"
 SYSTEM_CONSTANT "KD_RED_RES" "512"
 SYSTEM_CONSTANT "KD_RED_RES_2" "64"
 SYSTEM_CONSTANT "KD_RES16_REV" "1024"
 SYSTEM_CONSTANT "KD_RES16_REV_FL" "1024"
 SYSTEM_CONSTANT "KD_RES_REV" "65536"
 SYSTEM_CONSTANT "KD_RES_S16_REV" "8192"
 SYSTEM_CONSTANT "KD_RPM2NM_1_MAX" "100"
 SYSTEM_CONSTANT "KD_RPM2NM_1_NRM" "11"
 SYSTEM_CONSTANT "KD_SHIFT" "128"
 SYSTEM_CONSTANT "KD_SHIFT_2" "1024"
 SYSTEM_CONSTANT "KFACT_MAX" "1"
 SYSTEM_CONSTANT "KFACT_MIN" "0"
 SYSTEM_CONSTANT "KGH_TO_KGS" "3600"
 SYSTEM_CONSTANT "KG_PER_H_TO_G_PER_M" "33333"
 SYSTEM_CONSTANT "KITEMPGOV_MAX" "100"
 SYSTEM_CONSTANT "KITEMPGOV_MIN" "0"
 SYSTEM_CONSTANT "KI_1_MAX" "250"
 SYSTEM_CONSTANT "KI_1_NRM" "6"
 SYSTEM_CONSTANT "KI_EGTFACT_EXP" "1"
 SYSTEM_CONSTANT "KI_EGTFACT_NRM" "2"
 SYSTEM_CONSTANT "KI_FACTEGT_MAX" "0.06"
 SYSTEM_CONSTANT "KI_FACTEGT_MIN" "0"
 SYSTEM_CONSTANT "KI_MOIL_RES_REV" "1024"
 SYSTEM_CONSTANT "KI_PRAIL2Q_1_MAX" "2"
 SYSTEM_CONSTANT "KI_PRAIL2Q_1_NRM" "2"
 SYSTEM_CONSTANT "KI_PRCEGRRMP2PRC_ONE" "1"
 SYSTEM_CONSTANT "KI_RES_REV" "4294.967296"
 SYSTEM_CONSTANT "KI_RPM2NM_1_MAX" "100"
 SYSTEM_CONSTANT "KI_RPM2NM_1_NRM" "8"
 SYSTEM_CONSTANT "Ki_TRQ" "1"
 SYSTEM_CONSTANT "Ki_TRQ2" "1"
 SYSTEM_CONSTANT "KPTEMPGOV_MAX" "4"
 SYSTEM_CONSTANT "KPTEMPGOV_MIN" "0"
 SYSTEM_CONSTANT "KP_1_MAX" "300"
 SYSTEM_CONSTANT "KP_1_NRM" "10"
 SYSTEM_CONSTANT "KP_EGTFACT_EXP" "7"
 SYSTEM_CONSTANT "KP_EGTFACT_RES_REV" "128"
 SYSTEM_CONSTANT "KP_FACTEGT_MAX" "0.06"
 SYSTEM_CONSTANT "KP_FACTEGT_MIN" "0"
 SYSTEM_CONSTANT "KP_LMBDREC2INJMASS_1_MAX" "250"
 SYSTEM_CONSTANT "KP_LMBDREC2INJMASS_1_NRM" "3"
 SYSTEM_CONSTANT "KP_LMBDREC2INJMASS_2_MAX" "250"
 SYSTEM_CONSTANT "KP_LMBDREC2INJMASS_2_NRM" "3"
 SYSTEM_CONSTANT "KP_PRAIL2Q_1_MAX" "0.2"
 SYSTEM_CONSTANT "KP_PRAIL2Q_1_NRM" "3"
 SYSTEM_CONSTANT "KP_RES_REV" "65536"
 SYSTEM_CONSTANT "KP_RPM2NM_1_MAX" "100"
 SYSTEM_CONSTANT "KP_RPM2NM_1_NRM" "11"
 SYSTEM_CONSTANT "LAMBDA" "10"
 SYSTEM_CONSTANT "LAMBDAREC_RES" "0.0001"
 SYSTEM_CONSTANT "LAMBDAREC_RESVAL" "0.001"
 SYSTEM_CONSTANT "LAMBDAREC_RESVAL_REV" "1000"
 SYSTEM_CONSTANT "LAMBDAREC_RES_REV" "10000"
 SYSTEM_CONSTANT "LAMBDAREC_ZERO" "0"
 SYSTEM_CONSTANT "LAMBDA_INJMASS_RES" "1450"
 SYSTEM_CONSTANT "LAMBDA_MAX" "30"
 SYSTEM_CONSTANT "LAMBDA_RES" "0.001"
 SYSTEM_CONSTANT "LAMBDA_RES2LAMBDAREC_RES" "10"
 SYSTEM_CONSTANT "LAMBDA_RES_INV" "1000"
 SYSTEM_CONSTANT "LAMBDA_RES_REV" "1000"
 SYSTEM_CONSTANT "LAYER_FUEL_L_RES" "0.01"
 SYSTEM_CONSTANT "LAYER_M2VOL_RES" "16"
 SYSTEM_CONSTANT "LAYER_M2VOL_RES_EXP" "4"
 SYSTEM_CONSTANT "LENGTH_KM_RES" "1"
 SYSTEM_CONSTANT "LENGTH_RES" "1"
 SYSTEM_CONSTANT "LENGTH_RES_INV" "1"
 SYSTEM_CONSTANT "LIGOV_NSETPOINTINIT_CUR_X" "25"
 SYSTEM_CONSTANT "LIGOV_NSETPOINTINIT_MAP_X" "8"
 SYSTEM_CONSTANT "LIGOV_NSETPOINTINIT_MAP_Y" "8"
 SYSTEM_CONSTANT "LIGOV_PARDRIVEOFF_NOTUSED" "0"
 SYSTEM_CONSTANT "LIGOV_PARDRIVEOFF_USED" "1"
 SYSTEM_CONSTANT "LIGOV_SWTPARDRIVEOFF_TYPE" "0"
 SYSTEM_CONSTANT "LIGOV_SWTPARDRIVEOFF_VAL" "1"
 SYSTEM_CONSTANT "LIGOV_TIPT1_CUR_X" "10"
 SYSTEM_CONSTANT "LIGOV_TRQINITI_CUR_X" "8"
 SYSTEM_CONSTANT "LIGOV_TRQINITI_MAP_X" "8"
 SYSTEM_CONSTANT "LIGOV_TRQINITI_MAP_Y" "8"
 SYSTEM_CONSTANT "LIGOV_TRQMAX_CUR_X" "8"
 SYSTEM_CONSTANT "LMBD_SENS_AFT_TRBN" "0"
 SYSTEM_CONSTANT "LPACD_DCYCCONV_CUR_X" "25"
 SYSTEM_CONSTANT "LSNCERGN_U16_EXP" "7"
 SYSTEM_CONSTANT "LSNCERGN_U16_RES" "128"
 SYSTEM_CONSTANT "LSUCD_CT_SENSORS" "1"
 SYSTEM_CONSTANT "LSUCD_FCTRPCOMP_CUR_X" "10"
 SYSTEM_CONSTANT "LSUCD_RLMBDREC_CUR_X" "12"
 SYSTEM_CONSTANT "LSUCD_RO2_CUR_X" "15"
 SYSTEM_CONSTANT "LSUCD_SWTADPT_DISABLED" "0"
 SYSTEM_CONSTANT "LSUCD_SWTADPT_ENABLED" "1"
 SYSTEM_CONSTANT "LSUCD_SWTADPT_TYPE" "2"
 SYSTEM_CONSTANT "LSUCD_SWTADPT_VAL" "0"
 SYSTEM_CONSTANT "LSUCD_TEMPRI_CUR_X" "16"
 SYSTEM_CONSTANT "LSUCTL_DCYCSTRT_CUR_X" "5"
 SYSTEM_CONSTANT "LSUM_U16_EXP" "14"
 SYSTEM_CONSTANT "LSUM_U16_RES" "16384"
 SYSTEM_CONSTANT "LSU_NUM_SENSCMPCHKS" "0"
 SYSTEM_CONSTANT "LSU_SWT_DISABLED" "0"
 SYSTEM_CONSTANT "LSU_SWT_ENABLED" "1"
 SYSTEM_CONSTANT "LSU_SWT_TYPE" "2"
 SYSTEM_CONSTANT "LSU_SWT_VAL" "0"
 SYSTEM_CONSTANT "MAXSINT16" "32767"
 SYSTEM_CONSTANT "MAXSINT32" "2147483647"
 SYSTEM_CONSTANT "MAXUINT16" "65535"
 SYSTEM_CONSTANT "MAXUINT32" "1"
 SYSTEM_CONSTANT "MAXUINT8" "255"
 SYSTEM_CONSTANT "MEUNCD_DCYCSETVALLIN_CUR_X" "4"
 SYSTEM_CONSTANT "MEUNCD_FACIGOVINIT_CUR_X" "3"
 SYSTEM_CONSTANT "MEUNCD_ILIN_CUR_X" "2"
 SYSTEM_CONSTANT "MEUNCD_TIPER_CUR_X" "30"
 SYSTEM_CONSTANT "MEUN_ICNVFLOWRATE_CUR_X" "10"
 SYSTEM_CONSTANT "MINSINT16" "-32768"
 SYSTEM_CONSTANT "MINSINT32" "-2147483648"
 SYSTEM_CONSTANT "MNELEM_VBATAVRG" "1"
 SYSTEM_CONSTANT "MODE1_SIGNALS_NUM" "9"
 SYSTEM_CONSTANT "MODE2_SIGNALS_NUM" "9"
 SYSTEM_CONSTANT "MODE6_SUBTST_NUM" "10"
 SYSTEM_CONSTANT "MOMENT_INERTIA_RES" "100"
 SYSTEM_CONSTANT "MSidCD_ECULearn_TYPE" "1"
 SYSTEM_CONSTANT "MSidCD_ECULearn_VAL" "0"
 SYSTEM_CONSTANT "MSidCD_ECUSelect_TYPE" "1"
 SYSTEM_CONSTANT "MSidCD_ECUSelect_VAL" "8"
 SYSTEM_CONSTANT "MSIDCD_SEL_SWT" "0"
 SYSTEM_CONSTANT "MSIDCD_SEL_VAL" "0"
 SYSTEM_CONSTANT "MSIDCD_SWTMSOFF" "0"
 SYSTEM_CONSTANT "MSIDCD_SWTMSON" "1"
 SYSTEM_CONSTANT "MSIDCD_SWT_MS_OFF" "0"
 SYSTEM_CONSTANT "MSIDCD_SWT_MS_ON" "1"
 SYSTEM_CONSTANT "MSid_EcuSelect_Learned" "1"
 SYSTEM_CONSTANT "MSid_EcuSelect_NotLearned" "0"
 SYSTEM_CONSTANT "MSid_NotPlaus" "8"
 SYSTEM_CONSTANT "MS_MASTER" "0"
 SYSTEM_CONSTANT "MS_SINGLE" "-1"
 SYSTEM_CONSTANT "MS_SLAVE1" "1"
 SYSTEM_CONSTANT "MS_SLAVE2" "2"
 SYSTEM_CONSTANT "MS_SLAVE3" "3"
 SYSTEM_CONSTANT "MXELEM_VBATAVRG" "10"
 SYSTEM_CONSTANT "M_SOOT_MAX" "300"
 SYSTEM_CONSTANT "M_SOOT_MIN" "0"
 SYSTEM_CONSTANT "M_SOOT_RES" "0.01"
 SYSTEM_CONSTANT "NORM_DVOLPERSTRK_X_N" "3333.33333333333"
 SYSTEM_CONSTANT "NORM_DVOL_X_DT" "360000"
 SYSTEM_CONSTANT "NORM_ETA_X_ETA" "128"
 SYSTEM_CONSTANT "NORM_FACT1" "3333.3"
 SYSTEM_CONSTANT "NORM_FLCONS1" "4611.11111111111"
 SYSTEM_CONSTANT "NORM_FLCONS2" "360000"
 SYSTEM_CONSTANT "NORM_L2UL" "1000000"
 SYSTEM_CONSTANT "NORM_LMBD_RES" "1450"
 SYSTEM_CONSTANT "NORM_MINUTE_MICROSEC" "60000000"
 SYSTEM_CONSTANT "NORM_MS2US" "1000"
 SYSTEM_CONSTANT "NORM_NANOSEC_MICROSEC" "1000"
 SYSTEM_CONSTANT "NORM_N_X_R" "100"
 SYSTEM_CONSTANT "NORM_PWRACS" "900"
 SYSTEM_CONSTANT "NORM_PWRENG" "900"
 SYSTEM_CONSTANT "NORM_PWRPRP" "450"
 SYSTEM_CONSTANT "NORM_PWR_BY_ETA" "128"
 SYSTEM_CONSTANT "NORM_Q_BY_FAC" "8192"
 SYSTEM_CONSTANT "NORM_Q_BY_RHO" "1000"
 SYSTEM_CONSTANT "NORM_Q_X_ETA" "1280"
 SYSTEM_CONSTANT "NORM_R_X_R" "100"
 SYSTEM_CONSTANT "NORM_R_X_TRQ" "100"
 SYSTEM_CONSTANT "NORM_TRQ2TRQPRP" "200"
 SYSTEM_CONSTANT "NORM_TRQACS" "900"
 SYSTEM_CONSTANT "NORM_TRQPRP" "450"
 SYSTEM_CONSTANT "NORM_TRQPRP2TRQ" "2"
 SYSTEM_CONSTANT "NORM_TRQ_BY_ETA" "1280"
 SYSTEM_CONSTANT "NORM_TRQ_BY_Q" "1280"
 SYSTEM_CONSTANT "NORM_TRQ_BY_R" "100"
 SYSTEM_CONSTANT "NORM_TRQ_X_FAC" "8192"
 SYSTEM_CONSTANT "NSCCD_TLINPRE_CUR_X" "25"
 SYSTEM_CONSTANT "NSCCD_TLINPST_CUR_X" "25"
 SYSTEM_CONSTANT "NUM_ECU1" "1"
 SYSTEM_CONSTANT "NUM_INJ_MAX" "6"
 SYSTEM_CONSTANT "NUM_MAX_FBC_SEG" "8"
 SYSTEM_CONSTANT "O2MASS_MAX" "50"
 SYSTEM_CONSTANT "O2MASS_MIN" "0"
 SYSTEM_CONSTANT "O2MPT_RES" "0.01"
 SYSTEM_CONSTANT "O2_NORM" "0.21"
 SYSTEM_CONSTANT "O2_NORM_INV" "4.773"
 SYSTEM_CONSTANT "O2_RES" "1e-05"
 SYSTEM_CONSTANT "O2_RES_REV" "100000"
 SYSTEM_CONSTANT "O2_RMASS_AIR" "0.2314975"
 SYSTEM_CONSTANT "O2_RVOL_AIR" "0.2095"
 SYSTEM_CONSTANT "O2_THRES1_ADD" "0.063"
 SYSTEM_CONSTANT "O2_THRES1_FAC" "0.7"
 SYSTEM_CONSTANT "O2_THRES2_ADD" "0.126"
 SYSTEM_CONSTANT "O2_THRES2_FAC" "0.4"
 SYSTEM_CONSTANT "O2_ZERO" "0"
 SYSTEM_CONSTANT "OILMASSPRC_100" "100"
 SYSTEM_CONSTANT "OILMASSPRC_RES" "0.001"
 SYSTEM_CONSTANT "OILMASSPRC_RES_REV" "1000"
 SYSTEM_CONSTANT "OILMASSPRC_ZERO" "0"
 SYSTEM_CONSTANT "OILMASSRED_RES" "4.096"
 SYSTEM_CONSTANT "OILMASS_100" "100"
 SYSTEM_CONSTANT "OILMASS_RES" "0.001"
 SYSTEM_CONSTANT "OILMASS_ZERO" "0"
 SYSTEM_CONSTANT "OMPT_RES" "0.01"
 SYSTEM_CONSTANT "OPSCD_PLINPRE_CUR_X" "25"
 SYSTEM_CONSTANT "OTSCD_SWTSIG_TYPE" "2"
 SYSTEM_CONSTANT "OTSCD_SWTSIG_VAL" "0"
 SYSTEM_CONSTANT "OTSCD_TLIN_CUR_X" "2"
 SYSTEM_CONSTANT "OVRMON_BRK_SWTSIG_TYPE" "2"
 SYSTEM_CONSTANT "OVRMON_BRK_SWTSIG_VAL" "0"
 SYSTEM_CONSTANT "OVRMON_BRK_TYPE_CAN_BRK" "1"
 SYSTEM_CONSTANT "OVRMON_BRK_TYPE_CAN_RED" "2"
 SYSTEM_CONSTANT "OVRMON_BRK_TYPE_CAN_REDBRK" "3"
 SYSTEM_CONSTANT "OVRMON_BRK_TYPE_HW" "0"
 SYSTEM_CONSTANT "OVRMON_FACINJEFF_CUR_X" "16"
 SYSTEM_CONSTANT "OVRMON_FACINJEFF_CUR_Y" "12"
 SYSTEM_CONSTANT "OVRMON_TILIMET_MAP_X" "6"
 SYSTEM_CONSTANT "OVRMON_TILIMET_MAP_Y" "6"
 SYSTEM_CONSTANT "OXICAT_PPRECATCOR_CUR_X" "8"
 SYSTEM_CONSTANT "OXICCD_SWTSIGTPRE_TYPE" "2"
 SYSTEM_CONSTANT "OXICCD_SWTSIGTPRE_VAL" "0"
 SYSTEM_CONSTANT "OXICCD_TLINPRE_CUR_X" "16"
 SYSTEM_CONSTANT "P2U_NORM" "2557.5"
 SYSTEM_CONSTANT "PCR_BALGVNR_CTL_OFF" "0"
 SYSTEM_CONSTANT "PCR_BALGVNR_CTL_ON" "1"
 SYSTEM_CONSTANT "PCR_CURLIM" "0"
 SYSTEM_CONSTANT "PCR_DNSURGEHIGH_CUR_X" "5"
 SYSTEM_CONSTANT "PCR_DNSURGELOW_CUR_X" "5"
 SYSTEM_CONSTANT "PCR_FACAIRFLOW1CORR_CUR_X" "12"
 SYSTEM_CONSTANT "PCR_FACATRGN_CUR_X" "6"
 SYSTEM_CONSTANT "PCR_FACBALGVNRI_MAP_X" "10"
 SYSTEM_CONSTANT "PCR_FACBALGVNRI_MAP_Y" "10"
 SYSTEM_CONSTANT "PCR_FACBALGVNRP_MAP_X" "10"
 SYSTEM_CONSTANT "PCR_FACBALGVNRP_MAP_Y" "10"
 SYSTEM_CONSTANT "PCR_FACBPCTLBASCORR_CUR_X" "8"
 SYSTEM_CONSTANT "PCR_FACBPCTLBASRGN1CORR_CUR_X" "8"
 SYSTEM_CONSTANT "PCR_FACBPGOVMAXCORR_CUR_X" "8"
 SYSTEM_CONSTANT "PCR_FACCNV_CUR_X" "10"
 SYSTEM_CONSTANT "PCR_FACCTLAPRGN_CUR_X" "6"
 SYSTEM_CONSTANT "PCR_FACCTLAPRGN_MAP_X" "10"
 SYSTEM_CONSTANT "PCR_FACCTLAPRGN_MAP_Y" "12"
 SYSTEM_CONSTANT "PCR_FACCTLAP_MAP_X" "10"
 SYSTEM_CONSTANT "PCR_FACCTLAP_MAP_Y" "12"
 SYSTEM_CONSTANT "PCR_FACCTLATRGN_CUR_X" "6"
 SYSTEM_CONSTANT "PCR_FACCTLIAT_CUR_X" "6"
 SYSTEM_CONSTANT "PCR_FACCTQNT_MAP_X" "2"
 SYSTEM_CONSTANT "PCR_FACCTQNT_MAP_Y" "2"
 SYSTEM_CONSTANT "PCR_FACDNCORR_CUR_X" "6"
 SYSTEM_CONSTANT "PCR_FACDPCORR_CUR_X" "10"
 SYSTEM_CONSTANT "PCR_FACD_MAP_X" "10"
 SYSTEM_CONSTANT "PCR_FACD_MAP_Y" "4"
 SYSTEM_CONSTANT "PCR_FACIAT_CUR_X" "6"
 SYSTEM_CONSTANT "PCR_FACI_MAP_X" "10"
 SYSTEM_CONSTANT "PCR_FACI_MAP_Y" "4"
 SYSTEM_CONSTANT "PCR_FACMAIR1_MAP_X" "6"
 SYSTEM_CONSTANT "PCR_FACMAIR1_MAP_Y" "12"
 SYSTEM_CONSTANT "PCR_FACMAIR2_MAP_X" "6"
 SYSTEM_CONSTANT "PCR_FACMAIR2_MAP_Y" "10"
 SYSTEM_CONSTANT "PCR_FACMAIRFLOW1CORR_MAP_X" "8"
 SYSTEM_CONSTANT "PCR_FACMAIRFLOW1CORR_MAP_Y" "8"
 SYSTEM_CONSTANT "PCR_FACN_CUR_X" "6"
 SYSTEM_CONSTANT "PCR_FACPCRDNAVRG" "10"
 SYSTEM_CONSTANT "PCR_FACP_MAP_X" "10"
 SYSTEM_CONSTANT "PCR_FACP_MAP_Y" "4"
 SYSTEM_CONSTANT "PCR_FACRESFLOWRAWCORR_MAP_X" "10"
 SYSTEM_CONSTANT "PCR_FACRESFLOWRAWCORR_MAP_Y" "8"
 SYSTEM_CONSTANT "PCR_FACSIN_CUR_X" "11"
 SYSTEM_CONSTANT "PCR_FACSQR_CUR_X" "19"
 SYSTEM_CONSTANT "PCR_FACSURGEDES_MAP_X" "6"
 SYSTEM_CONSTANT "PCR_FACSURGEDES_MAP_Y" "4"
 SYSTEM_CONSTANT "PCR_FACSURGEI_MAP_X" "6"
 SYSTEM_CONSTANT "PCR_FACSURGEI_MAP_Y" "4"
 SYSTEM_CONSTANT "PCR_FACSURGEP_MAP_X" "6"
 SYSTEM_CONSTANT "PCR_FACSURGEP_MAP_Y" "4"
 SYSTEM_CONSTANT "PCR_LPGOVRMPSLP_MAX" "3"
 SYSTEM_CONSTANT "PCR_MAIRDIFFDEF_MAP_X" "8"
 SYSTEM_CONSTANT "PCR_MAIRDIFFDEF_MAP_Y" "8"
 SYSTEM_CONSTANT "PCR_MAIRDIFFHYST_CUR_X" "8"
 SYSTEM_CONSTANT "PCR_MAPLIM" "1"
 SYSTEM_CONSTANT "PCR_MSURGEAMPLDES_CUR_X" "6"
 SYSTEM_CONSTANT "PCR_NUMSENSVALMAX" "10"
 SYSTEM_CONSTANT "PCR_NUMSENSVALMIN" "1"
 SYSTEM_CONSTANT "PCR_PAPQCMPNRGN_MAP_X" "6"
 SYSTEM_CONSTANT "PCR_PAPQCMPNRGN_MAP_Y" "6"
 SYSTEM_CONSTANT "PCR_PAPQCMPN_MAP_X" "6"
 SYSTEM_CONSTANT "PCR_PAPQCMPN_MAP_Y" "6"
 SYSTEM_CONSTANT "PCR_PAPQCOMPRGN_MAP_X" "8"
 SYSTEM_CONSTANT "PCR_PAPQCOMPRGN_MAP_Y" "8"
 SYSTEM_CONSTANT "PCR_PAPQNTCOR_MAP_X" "2"
 SYSTEM_CONSTANT "PCR_PAPQNTCOR_MAP_Y" "2"
 SYSTEM_CONSTANT "PCR_PBDESBASRGN1_MAP_X" "16"
 SYSTEM_CONSTANT "PCR_PBDESBASRGN1_MAP_Y" "16"
 SYSTEM_CONSTANT "PCR_PBDESBASRGN2_MAP_X" "16"
 SYSTEM_CONSTANT "PCR_PBDESBASRGN2_MAP_Y" "16"
 SYSTEM_CONSTANT "PCR_PBDESLPRGN1_MAP_X" "16"
 SYSTEM_CONSTANT "PCR_PBDESLPRGN1_MAP_Y" "16"
 SYSTEM_CONSTANT "PCR_PBDESLPRGN2_MAP_X" "16"
 SYSTEM_CONSTANT "PCR_PBDESLPRGN2_MAP_Y" "16"
 SYSTEM_CONSTANT "PCR_PBDESLP_MAP_X" "16"
 SYSTEM_CONSTANT "PCR_PBDESLP_MAP_Y" "16"
 SYSTEM_CONSTANT "PCR_PBDESMAXAPLP_MAP_X" "10"
 SYSTEM_CONSTANT "PCR_PBDESMAXAPLP_MAP_Y" "10"
 SYSTEM_CONSTANT "PCR_PBGDEVMAX_MAP_X" "4"
 SYSTEM_CONSTANT "PCR_PBGDEVMAX_MAP_Y" "4"
 SYSTEM_CONSTANT "PCR_PBGDEVMIN_MAP_X" "4"
 SYSTEM_CONSTANT "PCR_PBGDEVMIN_MAP_Y" "4"
 SYSTEM_CONSTANT "PCR_PBSURGECTLVAL_MAP_X" "6"
 SYSTEM_CONSTANT "PCR_PBSURGECTLVAL_MAP_Y" "6"
 SYSTEM_CONSTANT "PCR_PBSURGEDESMAX_MAP_X" "5"
 SYSTEM_CONSTANT "PCR_PBSURGEDESMAX_MAP_Y" "5"
 SYSTEM_CONSTANT "PCR_PBSURGEDESMIN_MAP_X" "5"
 SYSTEM_CONSTANT "PCR_PBSURGEDESMIN_MAP_Y" "5"
 SYSTEM_CONSTANT "PCR_PDESBASFDC_MAP_X" "16"
 SYSTEM_CONSTANT "PCR_PDESBASFDC_MAP_Y" "16"
 SYSTEM_CONSTANT "PCR_PDESBAS_MAP_X" "16"
 SYSTEM_CONSTANT "PCR_PDESBAS_MAP_Y" "16"
 SYSTEM_CONSTANT "PCR_PDESMAXAP_MAP_X" "16"
 SYSTEM_CONSTANT "PCR_PDESMAXAP_MAP_Y" "16"
 SYSTEM_CONSTANT "PCR_PDVTMAX_MAP_X" "12"
 SYSTEM_CONSTANT "PCR_PDVTMAX_MAP_Y" "12"
 SYSTEM_CONSTANT "PCR_PDVTMIN_MAP_X" "12"
 SYSTEM_CONSTANT "PCR_PDVTMIN_MAP_Y" "12"
 SYSTEM_CONSTANT "PCR_PLPDVTMAX_MAP_X" "4"
 SYSTEM_CONSTANT "PCR_PLPDVTMAX_MAP_Y" "4"
 SYSTEM_CONSTANT "PCR_PLPDVTMIN_MAP_X" "4"
 SYSTEM_CONSTANT "PCR_PLPDVTMIN_MAP_Y" "4"
 SYSTEM_CONSTANT "PCR_PNQCTCMPN_MAP_X" "2"
 SYSTEM_CONSTANT "PCR_PNQCTCMPN_MAP_Y" "2"
 SYSTEM_CONSTANT "PCR_PNQNTCTCOR_MAP_X" "2"
 SYSTEM_CONSTANT "PCR_PNQNTCTCOR_MAP_Y" "2"
 SYSTEM_CONSTANT "PCR_PSURGEDES_CUR_X" "2"
 SYSTEM_CONSTANT "PCR_QBALGVNR_QCURR" "0"
 SYSTEM_CONSTANT "PCR_QBALGVNR_QRAW" "1"
 SYSTEM_CONSTANT "PCR_QCLUTCHTHRES_CUR_X" "4"
 SYSTEM_CONSTANT "PCR_QGVNROFF_CUR_X" "25"
 SYSTEM_CONSTANT "PCR_QGVNRON_CUR_X" "25"
 SYSTEM_CONSTANT "PCR_QLPCLUTCHTHRES_CUR_X" "4"
 SYSTEM_CONSTANT "PCR_QLPGVNROFFRGN_CUR_X" "8"
 SYSTEM_CONSTANT "PCR_QLPGVNROFF_CUR_X" "8"
 SYSTEM_CONSTANT "PCR_QLPGVNRONRGN_CUR_X" "8"
 SYSTEM_CONSTANT "PCR_QLPGVNRON_CUR_X" "8"
 SYSTEM_CONSTANT "PCR_QNTCTL_QCURR" "1"
 SYSTEM_CONSTANT "PCR_QNTCTL_QCURRCOR" "4"
 SYSTEM_CONSTANT "PCR_QNTCTL_QINR" "3"
 SYSTEM_CONSTANT "PCR_QNTCTL_QRAW" "2"
 SYSTEM_CONSTANT "PCR_QNTCTL_QRAWCOR" "5"
 SYSTEM_CONSTANT "PCR_QRGTOFFAIRMASSTST_CUR_X" "9"
 SYSTEM_CONSTANT "PCR_QRGTOFFRGN_CUR_X" "8"
 SYSTEM_CONSTANT "PCR_QRGTOFF_CUR_X" "9"
 SYSTEM_CONSTANT "PCR_QRGTONAIRMASSTST_CUR_X" "9"
 SYSTEM_CONSTANT "PCR_QRGTONRGN_CUR_X" "8"
 SYSTEM_CONSTANT "PCR_QRGTON_CUR_X" "9"
 SYSTEM_CONSTANT "PCR_QSURGEHIGH_CUR_X" "5"
 SYSTEM_CONSTANT "PCR_QSURGELOW_CUR_X" "5"
 SYSTEM_CONSTANT "PCR_Q_QCURR" "1"
 SYSTEM_CONSTANT "PCR_Q_QCURRCOR" "4"
 SYSTEM_CONSTANT "PCR_Q_QINR" "3"
 SYSTEM_CONSTANT "PCR_Q_QRAW" "2"
 SYSTEM_CONSTANT "PCR_Q_QRAWCOR" "5"
 SYSTEM_CONSTANT "PCR_RBALGVNRMAX_MAP_X" "10"
 SYSTEM_CONSTANT "PCR_RBALGVNRMAX_MAP_Y" "10"
 SYSTEM_CONSTANT "PCR_RBALGVNRMIN_MAP_X" "10"
 SYSTEM_CONSTANT "PCR_RBALGVNRMIN_MAP_Y" "10"
 SYSTEM_CONSTANT "PCR_RBPBASLPRGN1_MAP_X" "16"
 SYSTEM_CONSTANT "PCR_RBPBASLPRGN1_MAP_Y" "16"
 SYSTEM_CONSTANT "PCR_RBPBASLPRGN2_MAP_X" "16"
 SYSTEM_CONSTANT "PCR_RBPBASLPRGN2_MAP_Y" "16"
 SYSTEM_CONSTANT "PCR_RBPBASLP_MAP_X" "16"
 SYSTEM_CONSTANT "PCR_RBPBASLP_MAP_Y" "16"
 SYSTEM_CONSTANT "PCR_RBPCTLBASAIRCTLOFF_MAP_X" "16"
 SYSTEM_CONSTANT "PCR_RBPCTLBASAIRCTLOFF_MAP_Y" "16"
 SYSTEM_CONSTANT "PCR_RBPCTLBASCORR_MAP_X" "16"
 SYSTEM_CONSTANT "PCR_RBPCTLBASCORR_MAP_Y" "10"
 SYSTEM_CONSTANT "PCR_RBPCTLBASFDC_MAP_X" "16"
 SYSTEM_CONSTANT "PCR_RBPCTLBASFDC_MAP_Y" "16"
 SYSTEM_CONSTANT "PCR_RBPCTLBASRGN1CORR_MAP_X" "16"
 SYSTEM_CONSTANT "PCR_RBPCTLBASRGN1CORR_MAP_Y" "10"
 SYSTEM_CONSTANT "PCR_RBPCTLBASRGN_MAP_X" "16"
 SYSTEM_CONSTANT "PCR_RBPCTLBASRGN_MAP_Y" "16"
 SYSTEM_CONSTANT "PCR_RBPGOVMAXCORR_MAP_X" "16"
 SYSTEM_CONSTANT "PCR_RBPGOVMAXCORR_MAP_Y" "10"
 SYSTEM_CONSTANT "PCR_RBPRGLBASLPRGN1_MAP_X" "16"
 SYSTEM_CONSTANT "PCR_RBPRGLBASLPRGN1_MAP_Y" "16"
 SYSTEM_CONSTANT "PCR_RBPRGLBASLPRGN2_MAP_X" "16"
 SYSTEM_CONSTANT "PCR_RBPRGLBASLPRGN2_MAP_Y" "16"
 SYSTEM_CONSTANT "PCR_RBPRGLBASLP_MAP_X" "16"
 SYSTEM_CONSTANT "PCR_RBPRGLBASLP_MAP_Y" "16"
 SYSTEM_CONSTANT "PCR_RCTLAPCMPNRGN_MAP_X" "12"
 SYSTEM_CONSTANT "PCR_RCTLAPCMPNRGN_MAP_Y" "16"
 SYSTEM_CONSTANT "PCR_RCTLAPCOR_MAP_X" "10"
 SYSTEM_CONSTANT "PCR_RCTLAPCOR_MAP_Y" "8"
 SYSTEM_CONSTANT "PCR_RCTLATCMPNRGN_MAP_X" "8"
 SYSTEM_CONSTANT "PCR_RCTLATCMPNRGN_MAP_Y" "8"
 SYSTEM_CONSTANT "PCR_RCTLATCMPN_MAP_X" "10"
 SYSTEM_CONSTANT "PCR_RCTLATCMPN_MAP_Y" "8"
 SYSTEM_CONSTANT "PCR_RCTLBAS_MAP_X" "16"
 SYSTEM_CONSTANT "PCR_RCTLBAS_MAP_Y" "16"
 SYSTEM_CONSTANT "PCR_RELABS_ABS" "0"
 SYSTEM_CONSTANT "PCR_RELABS_REL" "1"
 SYSTEM_CONSTANT "PCR_RGVNRMAX15_MAP_X" "8"
 SYSTEM_CONSTANT "PCR_RGVNRMAX15_MAP_Y" "8"
 SYSTEM_CONSTANT "PCR_RGVNRMAXDYNCORR_MAP_X" "8"
 SYSTEM_CONSTANT "PCR_RGVNRMAXDYNCORR_MAP_Y" "8"
 SYSTEM_CONSTANT "PCR_RGVNRMAXDYN_MAP_X" "8"
 SYSTEM_CONSTANT "PCR_RGVNRMAXDYN_MAP_Y" "8"
 SYSTEM_CONSTANT "PCR_RGVNRMAX_CUR_X" "16"
 SYSTEM_CONSTANT "PCR_RGVNRMAX_MAP_X" "16"
 SYSTEM_CONSTANT "PCR_RGVNRMAX_MAP_Y" "16"
 SYSTEM_CONSTANT "PCR_RGVNRMIN_CUR_X" "2"
 SYSTEM_CONSTANT "PCR_RGVNRMIN_MAP_X" "4"
 SYSTEM_CONSTANT "PCR_RGVNRMIN_MAP_Y" "4"
 SYSTEM_CONSTANT "PCR_RGVNRRGN18_MAP_X" "8"
 SYSTEM_CONSTANT "PCR_RGVNRRGN18_MAP_Y" "8"
 SYSTEM_CONSTANT "PCR_RMPSLP_MAX" "3"
 SYSTEM_CONSTANT "PCR_ROUTIMAXLP_MAP_X" "4"
 SYSTEM_CONSTANT "PCR_ROUTIMAXLP_MAP_Y" "2"
 SYSTEM_CONSTANT "PCR_ROUTIMAX_MAP_X" "8"
 SYSTEM_CONSTANT "PCR_ROUTIMAX_MAP_Y" "8"
 SYSTEM_CONSTANT "PCR_ROUTIMIN_MAP_X" "8"
 SYSTEM_CONSTANT "PCR_ROUTIMIN_MAP_Y" "8"
 SYSTEM_CONSTANT "PCR_RSURGECTLVAL_MAP_X" "16"
 SYSTEM_CONSTANT "PCR_RSURGECTLVAL_MAP_Y" "16"
 SYSTEM_CONSTANT "PCR_RSURGEGVNROFF_CUR_X" "5"
 SYSTEM_CONSTANT "PCR_RSURGEGVNRON_MAP_X" "6"
 SYSTEM_CONSTANT "PCR_RSURGEGVNRON_MAP_Y" "4"
 SYSTEM_CONSTANT "PCR_RSURGEGVNR_MAP_X" "5"
 SYSTEM_CONSTANT "PCR_RSURGEGVNR_MAP_Y" "5"
 SYSTEM_CONSTANT "PCR_RSURGEHIGH_MAP_X" "8"
 SYSTEM_CONSTANT "PCR_RSURGELOW_MAP_Y" "3"
 SYSTEM_CONSTANT "PCR_RSURGEOFS_CUR_X" "5"
 SYSTEM_CONSTANT "PCR_SWTLIMSEL_TYPE" "0"
 SYSTEM_CONSTANT "PCR_SWTLIMSEL_VAL" "1"
 SYSTEM_CONSTANT "PCR_SWTQBAL_TYPE" "2"
 SYSTEM_CONSTANT "PCR_SWTQBAL_VAL" "1"
 SYSTEM_CONSTANT "PCR_SWTQNTCTL_TYPE" "2"
 SYSTEM_CONSTANT "PCR_SWTQNTCTL_VAL" "1"
 SYSTEM_CONSTANT "PCR_SWTQNTDES_TYPE" "2"
 SYSTEM_CONSTANT "PCR_SWTQNTDES_VAL" "1"
 SYSTEM_CONSTANT "PCR_SWTRELABS_TYPE" "2"
 SYSTEM_CONSTANT "PCR_SWTRELABS_VAL" "0"
 SYSTEM_CONSTANT "PCR_SWTST_TYPE" "2"
 SYSTEM_CONSTANT "PCR_SWTST_VAL" "1"
 SYSTEM_CONSTANT "PCR_TICLDSTRT_CUR_X" "6"
 SYSTEM_CONSTANT "PCR_TIGVNROFFDEL_CUR_X" "6"
 SYSTEM_CONSTANT "PCVCD_CTLSTATE_CONST" "0"
 SYSTEM_CONSTANT "PCVCD_CTLSTATE_DEP" "1"
 SYSTEM_CONSTANT "PCVCD_FACIGOVINIT_CUR_X" "4"
 SYSTEM_CONSTANT "PCVCD_ILIN_CUR_X" "2"
 SYSTEM_CONSTANT "PCVCD_SWTCTLSTATE_TYPE" "2"
 SYSTEM_CONSTANT "PCVCD_SWTCTLSTATE_VAL" "0"
 SYSTEM_CONSTANT "PCV_DVOLLEAK_CUR_X" "6"
 SYSTEM_CONSTANT "PCV_ICNVPRESS_CUR_X" "10"
 SYSTEM_CONSTANT "PERIOD_DASM_MAX" "22.2"
 SYSTEM_CONSTANT "PERIOD_DASM_MIN" "1.1"
 SYSTEM_CONSTANT "PERIOD_MAX" "100"
 SYSTEM_CONSTANT "PERIOD_MIN" "10"
 SYSTEM_CONSTANT "PERIOD_PWM_MAX" "11.7"
 SYSTEM_CONSTANT "PERIOD_PWM_MIN" "1.1"
 SYSTEM_CONSTANT "PERIOD_RES" "100"
 SYSTEM_CONSTANT "PERIOD_TPU_MAX" "15.3"
 SYSTEM_CONSTANT "PERIOD_TPU_MIN" "1.1"
 SYSTEM_CONSTANT "PER_CNT_MAX" "1000000"
 SYSTEM_CONSTANT "PER_DUR_ONE" "256"
 SYSTEM_CONSTANT "PER_DUR_RES" "1"
 SYSTEM_CONSTANT "PER_DUR_SHIFT" "256"
 SYSTEM_CONSTANT "PER_DUR_SHIFT_FL" "256"
 SYSTEM_CONSTANT "PFLTCD_PLINDIFF_CUR_X" "25"
 SYSTEM_CONSTANT "PFLTCD_PLINPRE_CUR_X" "8"
 SYSTEM_CONSTANT "PFLTCD_PPRECOR_CUR_X" "16"
 SYSTEM_CONSTANT "PFLTCD_TLINPRE_CUR_X" "16"
 SYSTEM_CONSTANT "PFLTCD_TPRECOR_CUR_X" "16"
 SYSTEM_CONSTANT "PFLT_ASHCORACT_X" "8"
 SYSTEM_CONSTANT "PFLT_ASHCORACT_Y" "8"
 SYSTEM_CONSTANT "PFLT_DMNOXENGBAS_MAP_X" "8"
 SYSTEM_CONSTANT "PFLT_DMNOXENGBAS_MAP_Y" "8"
 SYSTEM_CONSTANT "PFLT_DMSOTSIMBAS_MAP_X" "9"
 SYSTEM_CONSTANT "PFLT_DMSOTSIMBAS_MAP_Y" "8"
 SYSTEM_CONSTANT "PFLT_DMSOTSIMDYN_CUR_X" "8"
 SYSTEM_CONSTANT "PFLT_DMSOTSIMEGROFF_MAP_X" "8"
 SYSTEM_CONSTANT "PFLT_DMSOTSIMEGROFF_MAP_Y" "8"
 SYSTEM_CONSTANT "PFLT_DMSOTSIMRGNBAS_CUR_X" "8"
 SYSTEM_CONSTANT "PFLT_FACCNVCAT_CUR_X" "8"
 SYSTEM_CONSTANT "PFLT_FACDPN_MAP_X" "8"
 SYSTEM_CONSTANT "PFLT_FACDPN_MAP_Y" "8"
 SYSTEM_CONSTANT "PFLT_FACDYNVISC_CUR_X" "8"
 SYSTEM_CONSTANT "PFLT_FACHTTRANSNOLIN_CUR_X" "8"
 SYSTEM_CONSTANT "PFLT_FACMFLO2SIMRGN_CUR_X" "8"
 SYSTEM_CONSTANT "PFLT_FACMLTCOR_CUR_X" "8"
 SYSTEM_CONSTANT "PFLT_FACNO2RGNINHRGN_CUR_X" "10"
 SYSTEM_CONSTANT "PFLT_FACNO2RGNPRTMAX_CUR_X" "10"
 SYSTEM_CONSTANT "PFLT_FACNO2RGNTRQLIM_CUR_X" "10"
 SYSTEM_CONSTANT "PFLT_FACSOTSIMRGNCRT_CUR_X" "8"
 SYSTEM_CONSTANT "PFLT_FACTEMPCRT_CUR_X" "8"
 SYSTEM_CONSTANT "PFLT_FACTEMPSIMRGN_CUR_X" "8"
 SYSTEM_CONSTANT "PFLT_LSNCERGNINTR_CA_X" "10"
 SYSTEM_CONSTANT "PFLT_LSUMMAXHCCOND_MAP_X" "10"
 SYSTEM_CONSTANT "PFLT_LSUMMAXHCCOND_MAP_Y" "10"
 SYSTEM_CONSTANT "PFLT_MASHADI_CUR_X" "6"
 SYSTEM_CONSTANT "PFLT_MASHOIL_CUR_X" "6"
 SYSTEM_CONSTANT "PFLT_MSOTMEAS_CUR_X" "8"
 SYSTEM_CONSTANT "PFLT_MSOTMEAS_MAP_X" "16"
 SYSTEM_CONSTANT "PFLT_MSOTMEAS_MAP_Y" "16"
 SYSTEM_CONSTANT "PFLT_NUMENGPOPDEL_CA_X" "12"
 SYSTEM_CONSTANT "PFLT_NUMENGPOPDEL_CA_Y" "10"
 SYSTEM_CONSTANT "PFLT_NUMENGPOP_CA_X" "12"
 SYSTEM_CONSTANT "PFLT_NUMENGPOP_CA_Y" "10"
 SYSTEM_CONSTANT "PFLT_NUMTHRESH_X" "11"
 SYSTEM_CONSTANT "PFLT_NUMTHRESH_Y" "2"
 SYSTEM_CONSTANT "PFLT_PENGPRTMAX_MAP_X" "8"
 SYSTEM_CONSTANT "PFLT_PENGPRTMAX_MAP_Y" "8"
 SYSTEM_CONSTANT "PFLT_PENGPRTMIN_MAP_X" "8"
 SYSTEM_CONSTANT "PFLT_PENGPRTMIN_MAP_Y" "8"
 SYSTEM_CONSTANT "PFLT_PPFLTOVLDINHRGN_MAP_X" "8"
 SYSTEM_CONSTANT "PFLT_PPFLTOVLDINHRGN_MAP_Y" "8"
 SYSTEM_CONSTANT "PFLT_PPFLTOVLDTRQLIM_MAP_X" "8"
 SYSTEM_CONSTANT "PFLT_PPFLTOVLDTRQLIM_MAP_Y" "8"
 SYSTEM_CONSTANT "PFLT_PPREASHOILCORR_MAP_X" "5"
 SYSTEM_CONSTANT "PFLT_PPREASHOILCORR_MAP_Y" "5"
 SYSTEM_CONSTANT "PFLT_PPRESOTSIMCORR_MAP_X" "5"
 SYSTEM_CONSTANT "PFLT_PPRESOTSIMCORR_MAP_Y" "5"
 SYSTEM_CONSTANT "PFLT_PPREVOLCORR_CUR_X" "5"
 SYSTEM_CONSTANT "PFLT_QDIAGMAX_CUR_X" "8"
 SYSTEM_CONSTANT "PFLT_QDIAGMIN_CUR_X" "8"
 SYSTEM_CONSTANT "PFLT_QFLMAX_CUR_X" "8"
 SYSTEM_CONSTANT "PFLT_QSETUNBAL_CUR_X" "8"
 SYSTEM_CONSTANT "PFLT_RESFLOWADIOFS_MAP_X" "8"
 SYSTEM_CONSTANT "PFLT_RESFLOWADIOFS_MAP_Y" "8"
 SYSTEM_CONSTANT "PFLT_RESFLOWENGPRTCOR_MAP_X" "8"
 SYSTEM_CONSTANT "PFLT_RESFLOWENGPRTCOR_MAP_Y" "8"
 SYSTEM_CONSTANT "PFLT_RESFLOWENGPRTMAX_MAP_X" "8"
 SYSTEM_CONSTANT "PFLT_RESFLOWENGPRTMAX_MAP_Y" "8"
 SYSTEM_CONSTANT "PFLT_RESFLOWENGPRTMIN_MAP_X" "8"
 SYSTEM_CONSTANT "PFLT_RESFLOWENGPRTMIN_MAP_Y" "8"
 SYSTEM_CONSTANT "PFLT_RESFLOWMEASINV_MAP_X" "16"
 SYSTEM_CONSTANT "PFLT_RESFLOWMEASINV_MAP_Y" "16"
 SYSTEM_CONSTANT "PFLT_RESFLOWOILOFS_MAP_X" "8"
 SYSTEM_CONSTANT "PFLT_RESFLOWOILOFS_MAP_Y" "8"
 SYSTEM_CONSTANT "PFLT_RESFLOWOVLDINHRGN_MAP_X" "8"
 SYSTEM_CONSTANT "PFLT_RESFLOWOVLDINHRGN_MAP_Y" "8"
 SYSTEM_CONSTANT "PFLT_RESFLOWOVLDTRQLIM_MAP_X" "8"
 SYSTEM_CONSTANT "PFLT_RESFLOWOVLDTRQLIM_MAP_Y" "8"
 SYSTEM_CONSTANT "PFLT_RESFLOW_MAP_X" "8"
 SYSTEM_CONSTANT "PFLT_RESFLOW_MAP_Y" "8"
 SYSTEM_CONSTANT "PFLT_R_MO2AIR" "233"
 SYSTEM_CONSTANT "PFLT_TADDPOI1_MAP_X" "8"
 SYSTEM_CONSTANT "PFLT_TADDPOI1_MAP_Y" "8"
 SYSTEM_CONSTANT "PFLT_TADDPOI2_MAP_X" "8"
 SYSTEM_CONSTANT "PFLT_TADDPOI2_MAP_Y" "8"
 SYSTEM_CONSTANT "PFLT_TEXHGSSTY_MAP_X" "12"
 SYSTEM_CONSTANT "PFLT_TEXHGSSTY_MAP_Y" "12"
 SYSTEM_CONSTANT "PFLT_TICHKTEMPPLAUSMAX_CUR_X" "8"
 SYSTEM_CONSTANT "PFLT_TIEXHGSDEL_CUR_X" "8"
 SYSTEM_CONSTANT "PFLT_TIHTTRANSDT1_CUR_X" "8"
 SYSTEM_CONSTANT "PFLT_TILCKRGNERR_CA_X" "10"
 SYSTEM_CONSTANT "PFLT_TILCKRGN_CA_X" "10"
 SYSTEM_CONSTANT "PFLT_TIRGNMAX_CA_X" "7"
 SYSTEM_CONSTANT "PFLT_TIRGNMAX_X" "6"
 SYSTEM_CONSTANT "PFLT_TOXIPREDIFFMAX_MAP_X" "12"
 SYSTEM_CONSTANT "PFLT_TOXIPREDIFFMAX_MAP_Y" "12"
 SYSTEM_CONSTANT "PFLT_TPREDIFFMAX_MAP_X" "12"
 SYSTEM_CONSTANT "PFLT_TPREDIFFMAX_MAP_Y" "12"
 SYSTEM_CONSTANT "PHASE_PERIOD_RES" "10"
 SYSTEM_CONSTANT "PHI_COR_MAX" "10"
 SYSTEM_CONSTANT "PHI_INT_MAIN" "54"
 SYSTEM_CONSTANT "PHI_INT_PILOT" "120"
 SYSTEM_CONSTANT "PHI_INT_SEGMENT" "144"
 SYSTEM_CONSTANT "PHI_INT_UPDATE_A" "180"
 SYSTEM_CONSTANT "PHI_INT_UPDATE_B" "180"
 SYSTEM_CONSTANT "PHI_INT_UPDATE_C" "180"
 SYSTEM_CONSTANT "PHI_INT_UPDATE_D" "180"
 SYSTEM_CONSTANT "PHI_INT_UPDATE_E" "180"
 SYSTEM_CONSTANT "PHI_INT_UPDATE_F" "180"
 SYSTEM_CONSTANT "PHI_INT_UPDATE_G" "180"
 SYSTEM_CONSTANT "PHI_MI_CORMAX" "25"
 SYSTEM_CONSTANT "PHI_MI_CORMIN" "-25"
 SYSTEM_CONSTANT "PHI_MI_EARL" "40"
 SYSTEM_CONSTANT "PHI_MI_LATE" "-10"
 SYSTEM_CONSTANT "PHI_PII_EARL_ABS" "100"
 SYSTEM_CONSTANT "PHI_PII_EARL_REL" "90"
 SYSTEM_CONSTANT "PHI_PII_LATE_REL" "5"
 SYSTEM_CONSTANT "PHI_POI1_EARL" "-40"
 SYSTEM_CONSTANT "PHI_POI1_LATE" "-100"
 SYSTEM_CONSTANT "PHI_POI1_ZERO" "0"
 SYSTEM_CONSTANT "PHI_POI2_LATE" "-40"
 SYSTEM_CONSTANT "PHI_POLLING" "60"
 SYSTEM_CONSTANT "PHI_POLLING_LONG" "90"
 SYSTEM_CONSTANT "PHI_STRG_LEFT" "-180"
 SYSTEM_CONSTANT "PHI_STRG_RIGHT" "180"
 SYSTEM_CONSTANT "PHI_STRG_ZERO" "0"
 SYSTEM_CONSTANT "PHI_TEMPGVNR_MAX" "200"
 SYSTEM_CONSTANT "PHI_TEMPGVNR_MIN" "-200"
 SYSTEM_CONSTANT "PHI_TIME_BY_N" "3906.25"
 SYSTEM_CONSTANT "PHI_ZERO" "0"
 SYSTEM_CONSTANT "PI" "3.14159265359"
 SYSTEM_CONSTANT "PMP_QNT_MAX" "1500"
 SYSTEM_CONSTANT "PMP_QNT_RES" "0.1"
 SYSTEM_CONSTANT "PMP_QNT_ZERO" "0"
 SYSTEM_CONSTANT "PRC_100" "100"
 SYSTEM_CONSTANT "PRC_1000" "100"
 SYSTEM_CONSTANT "PRC_50" "50"
 SYSTEM_CONSTANT "PRC_EGRRMP_RES" "0.152587890625"
 SYSTEM_CONSTANT "PRC_RES" "0.01220703125"
 SYSTEM_CONSTANT "PRC_RES_REV" "81"
 SYSTEM_CONSTANT "PRC_SCAL_FAC" "8192"
 SYSTEM_CONSTANT "PRC_SCAL_NRM_EXP" "13"
 SYSTEM_CONSTANT "PRC_ZERO" "0"
 SYSTEM_CONSTANT "PRESCALER" "16"
 SYSTEM_CONSTANT "PRESCALER_TPWM" "4"
 SYSTEM_CONSTANT "PRES_AC_HPA_RES" "2"
 SYSTEM_CONSTANT "PRES_AC_RES" "0.2"
 SYSTEM_CONSTANT "PRES_AIR_MAX" "3500"
 SYSTEM_CONSTANT "PRES_AIR_MIN" "0"
 SYSTEM_CONSTANT "PRES_BAR_RES" "1"
 SYSTEM_CONSTANT "PRES_ENG_NORM" "10"
 SYSTEM_CONSTANT "PRES_HPA_RES" "1"
 SYSTEM_CONSTANT "PRES_HPA_RES_INV" "1"
 SYSTEM_CONSTANT "PRES_RAIL_GRAD_TO_VAL" "4"
 SYSTEM_CONSTANT "PRES_RAIL_RES" "100"
 SYSTEM_CONSTANT "PRES_RES" "0.1"
 SYSTEM_CONSTANT "PRES_SI_RES" "100"
 SYSTEM_CONSTANT "PRES_TIME_RES" "400"
 SYSTEM_CONSTANT "PRE_SCALER_ENGPRTRGNMON" "1000000"
 SYSTEM_CONSTANT "PRE_SCALER_LIMPHOME" "10000000"
 SYSTEM_CONSTANT "PRPCTL_SWTSPDLIM_TYPE" "2"
 SYSTEM_CONSTANT "PRPCTL_SWTSPDLIM_VAL" "1"
 SYSTEM_CONSTANT "PRP_CCON_OFF" "0"
 SYSTEM_CONSTANT "PRP_CCON_ON" "1"
 SYSTEM_CONSTANT "PRP_CCSEL_ACC" "1"
 SYSTEM_CONSTANT "PRP_CCSEL_CRCTL" "0"
 SYSTEM_CONSTANT "PRP_RENG_MAP_X" "16"
 SYSTEM_CONSTANT "PRP_RENG_MAP_Y" "16"
 SYSTEM_CONSTANT "PRP_RPRP_MAP_X" "1"
 SYSTEM_CONSTANT "PRP_RPRP_MAP_Y" "1"
 SYSTEM_CONSTANT "PRP_SWTCCON_TYPE" "1"
 SYSTEM_CONSTANT "PRP_SWTCCON_VAL" "0"
 SYSTEM_CONSTANT "PRP_SWTCCSEL_TYPE" "1"
 SYSTEM_CONSTANT "PRP_SWTCCSEL_VAL" "0"
 SYSTEM_CONSTANT "PRP_TRQTHRESENG_CUR_X" "16"
 SYSTEM_CONSTANT "PRP_TRQTHRESPRP_CUR_X" "1"
 SYSTEM_CONSTANT "PSPCD_DVOLBASE_CUR_X" "16"
 SYSTEM_CONSTANT "PSPCD_DVOLTEMPLIM_MAP_X" "6"
 SYSTEM_CONSTANT "PSPCD_DVOLTEMPLIM_MAP_Y" "6"
 SYSTEM_CONSTANT "PSPCD_FACFTSCOR_CUR_X" "8"
 SYSTEM_CONSTANT "PSPCD_TIT15DELAY_CUR_X" "16"
 SYSTEM_CONSTANT "PSP_N_RES" "1"
 SYSTEM_CONSTANT "PSP_TICLNT_CUR_X" "12"
 SYSTEM_CONSTANT "PWRMNG_FACELTEMP_CUR_X" "6"
 SYSTEM_CONSTANT "PWRMNG_FACELUB_CUR_X" "5"
 SYSTEM_CONSTANT "PWRMNG_FACUBATT1_CUR_X" "4"
 SYSTEM_CONSTANT "PWRMNG_FACUBATT2_CUR_X" "4"
 SYSTEM_CONSTANT "PWRMNG_FACUBATT3_CUR_X" "4"
 SYSTEM_CONSTANT "PWRMNG_IELUPWM_MAP_X" "7"
 SYSTEM_CONSTANT "PWRMNG_IELUPWM_MAP_Y" "7"
 SYSTEM_CONSTANT "PWR_HIGH_RES" "0.1"
 SYSTEM_CONSTANT "PWR_HIRES" "0.5"
 SYSTEM_CONSTANT "PWR_KW_RES" "0.01"
 SYSTEM_CONSTANT "PWR_MAX" "300000"
 SYSTEM_CONSTANT "PWR_RES" "9.42477796077"
 SYSTEM_CONSTANT "PWR_ZERO" "0"
 SYSTEM_CONSTANT "QNTR_EXP" "10"
 SYSTEM_CONSTANT "QNTR_MAX" "24"
 SYSTEM_CONSTANT "QNTR_MIN" "0.0009765625"
 SYSTEM_CONSTANT "QNTR_RES" "0.0009765625"
 SYSTEM_CONSTANT "QNTR_RES_REV" "1024"
 SYSTEM_CONSTANT "Qp_RES" "10"
 SYSTEM_CONSTANT "RAILCD_PFLTWINNEG_CUR_X" "10"
 SYSTEM_CONSTANT "RAILCD_PLIN_CUR_X" "4"
 SYSTEM_CONSTANT "RAILCD_SSPMON" "2"
 SYSTEM_CONSTANT "RAILCD_TIOFSTSTDEL_CUR_X" "2"
 SYSTEM_CONSTANT "RAIL_CALCBACK_I" "1"
 SYSTEM_CONSTANT "RAIL_DPDECMONMAX_CUR_X" "5"
 SYSTEM_CONSTANT "RAIL_DPSETPOINTINCFDC_MAP_X" "12"
 SYSTEM_CONSTANT "RAIL_DPSETPOINTINCFDC_MAP_Y" "8"
 SYSTEM_CONSTANT "RAIL_DPSETPOINTINC_MAP_X" "12"
 SYSTEM_CONSTANT "RAIL_DPSETPOINTINC_MAP_Y" "8"
 SYSTEM_CONSTANT "RAIL_DP_MAX" "13000000"
 SYSTEM_CONSTANT "RAIL_DP_ZERO" "0"
 SYSTEM_CONSTANT "RAIL_DVOLLEAKAGED_MAP_X" "10"
 SYSTEM_CONSTANT "RAIL_DVOLLEAKAGED_MAP_Y" "10"
 SYSTEM_CONSTANT "RAIL_DVOLLEAK_MAP_X" "10"
 SYSTEM_CONSTANT "RAIL_DVOLLEAK_MAP_Y" "10"
 SYSTEM_CONSTANT "RAIL_DVOLMEUNCTLINITI_CUR_X" "3"
 SYSTEM_CONSTANT "RAIL_DVOLMEUNCTLUPLIM_CUR_X" "11"
 SYSTEM_CONSTANT "RAIL_DVOLMEUNOVRRUN_CUR_X" "2"
 SYSTEM_CONSTANT "RAIL_DVOLPRECTLBAS_MAP_X" "16"
 SYSTEM_CONSTANT "RAIL_DVOLPRECTLBAS_MAP_Y" "16"
 SYSTEM_CONSTANT "RAIL_DVOLPRECTLOFS_MAP_X" "8"
 SYSTEM_CONSTANT "RAIL_DVOLPRECTLOFS_MAP_Y" "8"
 SYSTEM_CONSTANT "RAIL_DVOLPRECTLPOI1_MAP_X" "2"
 SYSTEM_CONSTANT "RAIL_DVOLPRECTLPOI1_MAP_Y" "4"
 SYSTEM_CONSTANT "RAIL_DVOLPRECTLPOI2_MAP_X" "2"
 SYSTEM_CONSTANT "RAIL_DVOLPRECTLPOI2_MAP_Y" "4"
 SYSTEM_CONSTANT "RAIL_DVOLSTRT_MAP_X" "8"
 SYSTEM_CONSTANT "RAIL_DVOLSTRT_MAP_Y" "8"
 SYSTEM_CONSTANT "RAIL_FACAPSETPDYNCOR_CUR_X" "6"
 SYSTEM_CONSTANT "RAIL_FACCHAMWLLTEMPCORR_MAP_X" "8"
 SYSTEM_CONSTANT "RAIL_FACCHAMWLLTEMPCORR_MAP_Y" "8"
 SYSTEM_CONSTANT "RAIL_FACDQSETPDYNCOR_CUR_X" "6"
 SYSTEM_CONSTANT "RAIL_FACETSETPDYNCOR_CUR_X" "6"
 SYSTEM_CONSTANT "RAIL_FACIASETPDYNCOR_CUR_X" "6"
 SYSTEM_CONSTANT "RAIL_FACMEUNCTLDCOR_CUR_X" "8"
 SYSTEM_CONSTANT "RAIL_FACMEUNCTLICOR_CUR_X" "8"
 SYSTEM_CONSTANT "RAIL_FACMEUNCTLPCOR_CUR_X" "8"
 SYSTEM_CONSTANT "RAIL_FACSETPOINTAPSCOR_CUR_X" "8"
 SYSTEM_CONSTANT "RAIL_FACSETPOINTATSCOR_CUR_X" "8"
 SYSTEM_CONSTANT "RAIL_FACSETPOINTETSCOR1_CUR_X" "8"
 SYSTEM_CONSTANT "RAIL_FACSETPOINTETSCOR_CUR_X" "8"
 SYSTEM_CONSTANT "RAIL_FACSETPOINTFTSCOR_CUR_X" "6"
 SYSTEM_CONSTANT "RAIL_FREEZE_I" "0"
 SYSTEM_CONSTANT "RAIL_MEUNCTLDKD_CUR_X" "3"
 SYSTEM_CONSTANT "RAIL_MEUNCTLIKINEG_CUR_X" "13"
 SYSTEM_CONSTANT "RAIL_MEUNCTLIKIPOS_CUR_X" "13"
 SYSTEM_CONSTANT "RAIL_MEUNCTLIKI_CUR_X" "13"
 SYSTEM_CONSTANT "RAIL_MEUNCTLPKPNEG_CUR_X" "13"
 SYSTEM_CONSTANT "RAIL_MEUNCTLPKPPOS_CUR_X" "13"
 SYSTEM_CONSTANT "RAIL_MEUNCTLPKP_CUR_X" "13"
 SYSTEM_CONSTANT "RAIL_PCHAMWLLTEMPCORR_MAP_X" "8"
 SYSTEM_CONSTANT "RAIL_PCHAMWLLTEMPCORR_MAP_Y" "8"
 SYSTEM_CONSTANT "RAIL_PCVCTLDKD_CUR_X" "3"
 SYSTEM_CONSTANT "RAIL_PCVCTLIKINEG_CUR_X" "13"
 SYSTEM_CONSTANT "RAIL_PCVCTLIKIPOS_CUR_X" "13"
 SYSTEM_CONSTANT "RAIL_PCVCTLIKI_CUR_X" "13"
 SYSTEM_CONSTANT "RAIL_PCVCTLPKPNEG_CUR_X" "13"
 SYSTEM_CONSTANT "RAIL_PCVCTLPKPPOS_CUR_X" "13"
 SYSTEM_CONSTANT "RAIL_PCVCTLPKP_CUR_X" "13"
 SYSTEM_CONSTANT "RAIL_PMEUNDVTMAX_CUR_X" "4"
 SYSTEM_CONSTANT "RAIL_PMEUNDVTMIN_CUR_X" "4"
 SYSTEM_CONSTANT "RAIL_PMEUNPEAKMIN_CUR_X" "5"
 SYSTEM_CONSTANT "RAIL_PNIPCVMAX_MAP_X" "6"
 SYSTEM_CONSTANT "RAIL_PNIPCVMAX_MAP_Y" "8"
 SYSTEM_CONSTANT "RAIL_PNIPCVMIN_MAP_X" "6"
 SYSTEM_CONSTANT "RAIL_PNIPCVMIN_MAP_Y" "8"
 SYSTEM_CONSTANT "RAIL_PPCVCLOSEOFFS_CUR_X" "4"
 SYSTEM_CONSTANT "RAIL_PPCVCLOSEOFS_CUR_X" "4"
 SYSTEM_CONSTANT "RAIL_PPCVDVTMAX_CUR_X" "4"
 SYSTEM_CONSTANT "RAIL_PPCVINITI_MAP_X" "8"
 SYSTEM_CONSTANT "RAIL_PPCVINITI_MAP_Y" "12"
 SYSTEM_CONSTANT "RAIL_PPCVPEAKMIN_CUR_X" "4"
 SYSTEM_CONSTANT "RAIL_PPCVREDOFS_CUR_X" "4"
 SYSTEM_CONSTANT "RAIL_PPCVSETMAX_CUR_X" "4"
 SYSTEM_CONSTANT "RAIL_PPRECTL_MAP_X" "8"
 SYSTEM_CONSTANT "RAIL_PPRECTL_MAP_Y" "12"
 SYSTEM_CONSTANT "RAIL_PRESS_ABS" "0"
 SYSTEM_CONSTANT "RAIL_PRESS_DIF" "1"
 SYSTEM_CONSTANT "RAIL_PSETPDYNCOR_MAP_X" "16"
 SYSTEM_CONSTANT "RAIL_PSETPDYNCOR_MAP_Y" "8"
 SYSTEM_CONSTANT "RAIL_PSETPOINTAPSCOR_MAP_X" "12"
 SYSTEM_CONSTANT "RAIL_PSETPOINTAPSCOR_MAP_Y" "8"
 SYSTEM_CONSTANT "RAIL_PSETPOINTATSCOR_MAP_X" "12"
 SYSTEM_CONSTANT "RAIL_PSETPOINTATSCOR_MAP_Y" "8"
 SYSTEM_CONSTANT "RAIL_PSETPOINTBASEFDC_MAP_X" "16"
 SYSTEM_CONSTANT "RAIL_PSETPOINTBASEFDC_MAP_Y" "16"
 SYSTEM_CONSTANT "RAIL_PSETPOINTBASE_MAP_X" "16"
 SYSTEM_CONSTANT "RAIL_PSETPOINTBASE_MAP_Y" "16"
 SYSTEM_CONSTANT "RAIL_PSETPOINTBATTMIN_CUR_X" "4"
 SYSTEM_CONSTANT "RAIL_PSETPOINTETSCOR1_MAP_X" "12"
 SYSTEM_CONSTANT "RAIL_PSETPOINTETSCOR1_MAP_Y" "8"
 SYSTEM_CONSTANT "RAIL_PSETPOINTETSCOR_MAP_X" "12"
 SYSTEM_CONSTANT "RAIL_PSETPOINTETSCOR_MAP_Y" "8"
 SYSTEM_CONSTANT "RAIL_PSETPOINTFTSCOR_MAP_X" "8"
 SYSTEM_CONSTANT "RAIL_PSETPOINTFTSCOR_MAP_Y" "8"
 SYSTEM_CONSTANT "RAIL_PSETPOINTLIMNFlTEMP_MAP_X" "8"
 SYSTEM_CONSTANT "RAIL_PSETPOINTLIMNFlTEMP_MAP_Y" "8"
 SYSTEM_CONSTANT "RAIL_PSETPOINTMAXDEF_CUR_X" "6"
 SYSTEM_CONSTANT "RAIL_PSETPOINTMAXDEF_MAP_X" "6"
 SYSTEM_CONSTANT "RAIL_PSETPOINTMAXDEF_MAP_Y" "5"
 SYSTEM_CONSTANT "RAIL_PSETPOINTMAX_MAP_X" "5"
 SYSTEM_CONSTANT "RAIL_PSETPOINTMAX_MAP_Y" "6"
 SYSTEM_CONSTANT "RAIL_PSETPOINTMIN_MAP_X" "5"
 SYSTEM_CONSTANT "RAIL_PSETPOINTMIN_MAP_Y" "6"
 SYSTEM_CONSTANT "RAIL_PSETPOINTRGN_MAP_X" "16"
 SYSTEM_CONSTANT "RAIL_PSETPOINTRGN_MAP_Y" "16"
 SYSTEM_CONSTANT "RAIL_P_MAX" "1800000"
 SYSTEM_CONSTANT "RAIL_P_ZERO" "0"
 SYSTEM_CONSTANT "RAIL_QMEUNCTLTYPE_CUR_X" "8"
 SYSTEM_CONSTANT "RAIL_QPCVCTLTYPE_CUR_X" "8"
 SYSTEM_CONSTANT "RAIL_SWTPRECTL_TYPE" "2"
 SYSTEM_CONSTANT "RAIL_SWTPRECTL_VAL" "0"
 SYSTEM_CONSTANT "RAIL_SWTPRESS_TYPE" "2"
 SYSTEM_CONSTANT "RAIL_SWTPRESS_VAL" "0"
 SYSTEM_CONSTANT "RAIL_SWTWINDUP_TYPE" "2"
 SYSTEM_CONSTANT "RAIL_SWTWINDUP_VAL" "1"
 SYSTEM_CONSTANT "RAIL_TIMEUNCTLDT1_CUR_X" "5"
 SYSTEM_CONSTANT "RAIL_TIMEUNCTLPT1_CUR_X" "8"
 SYSTEM_CONSTANT "RAIL_TIMEUNRMPDUR_CUR_X" "8"
 SYSTEM_CONSTANT "RAIL_TIPCVCTLDT1_CUR_X" "5"
 SYSTEM_CONSTANT "RAIL_TIPCVRMPDUR_CUR_X" "8"
 SYSTEM_CONSTANT "RAIL_TMEUNCTLTYPE_CUR_X" "3"
 SYSTEM_CONSTANT "RAIL_TPCVCTLTYPE_CUR_X" "3"
 SYSTEM_CONSTANT "RAIL_WITHOUT_PRECTL" "0"
 SYSTEM_CONSTANT "RAIL_WITH_PRECTL" "1"
 SYSTEM_CONSTANT "RATAM_RES" "0.001"
 SYSTEM_CONSTANT "RATAM_RES_REV" "1000"
 SYSTEM_CONSTANT "RATFM_ONE" "1"
 SYSTEM_CONSTANT "RATFM_RES" "0.01"
 SYSTEM_CONSTANT "RATFM_ZERO" "0"
 SYSTEM_CONSTANT "RESIST_RES" "0.1"
 SYSTEM_CONSTANT "RESIST_ZERO" "0"
 SYSTEM_CONSTANT "RES_T_P_DV" "10000"
 SYSTEM_CONSTANT "REYNOLDS_NUM_RES" "10000"
 SYSTEM_CONSTANT "RHO_FUEL" "830"
 SYSTEM_CONSTANT "RHO_FUEL_RES" "0.1"
 SYSTEM_CONSTANT "Rk_RES" "0.001"
 SYSTEM_CONSTANT "RMP_FANCTL_NRM" "65536"
 SYSTEM_CONSTANT "RMP_INTMIN_DT10" "6554"
 SYSTEM_CONSTANT "RMP_INTMIN_DT100" "656"
 SYSTEM_CONSTANT "RMP_INTMIN_DT20" "3277"
 SYSTEM_CONSTANT "RMP_NRM_EXP" "16"
 SYSTEM_CONSTANT "RMP_RES" "0.0152587890625"
 SYSTEM_CONSTANT "RMP_RES_1" "0.001"
 SYSTEM_CONSTANT "RMP_RES_1_REV" "1000"
 SYSTEM_CONSTANT "RMP_RES_INV" "65.536"
 SYSTEM_CONSTANT "ROOM_RES" "256"
 SYSTEM_CONSTANT "RPM2SEGTIME" "5000000"
 SYSTEM_CONSTANT "RTMO_ZERO" "0"
 SYSTEM_CONSTANT "R_COIL_MAX" "5000"
 SYSTEM_CONSTANT "R_COIL_MIN" "0"
 SYSTEM_CONSTANT "R_RES" "1"
 SYSTEM_CONSTANT "SCAL_16TO32_EXP" "4"
 SYSTEM_CONSTANT "SCAL_16TO32_FAC" "16"
 SYSTEM_CONSTANT "SEC_RES" "1"
 SYSTEM_CONSTANT "SHUTCD_PWM0" "0"
 SYSTEM_CONSTANT "SIXTY" "60000"
 SYSTEM_CONSTANT "SOOT_GPERLTR_RES" "0.01"
 SYSTEM_CONSTANT "SOOT_GPERLTR_RES_REV" "100"
 SYSTEM_CONSTANT "SPECIFICHEAT_RES" "0.0001"
 SYSTEM_CONSTANT "SRVPMP_FACSTWAV_CUR_X" "7"
 SYSTEM_CONSTANT "SRVPMP_FACVS_CUR_X" "7"
 SYSTEM_CONSTANT "SRVPMP_TRQSTWABASE_CUR_X" "7"
 SYSTEM_CONSTANT "STPII2INIT" "6"
 SYSTEM_CONSTANT "STSYS_FACAPSCOR_CUR_X" "8"
 SYSTEM_CONSTANT "STSYS_NSTRTCUTOUT_MAP_X" "8"
 SYSTEM_CONSTANT "STSYS_NSTRTCUTOUT_MAP_Y" "8"
 SYSTEM_CONSTANT "STSYS_STRTTIP_ACTV" "1"
 SYSTEM_CONSTANT "STSYS_STRTTIP_NACTV" "0"
 SYSTEM_CONSTANT "STSYS_TRQSTRTAPSCOR_MAP_X" "8"
 SYSTEM_CONSTANT "STSYS_TRQSTRTAPSCOR_MAP_Y" "8"
 SYSTEM_CONSTANT "STSYS_TRQSTRTBAS_MAP_X" "8"
 SYSTEM_CONSTANT "STSYS_TRQSTRTBAS_MAP_Y" "10"
 SYSTEM_CONSTANT "ST_RES_MAX" "25"
 SYSTEM_CONSTANT "ST_RES_MIN" "0"
 SYSTEM_CONSTANT "ST_RES_RES" "0.001"
 SYSTEM_CONSTANT "ST_RES_RES_INV" "1000"
 SYSTEM_CONSTANT "SWT_DISABLED" "0"
 SYSTEM_CONSTANT "SWT_ENABLED" "1"
 SYSTEM_CONSTANT "SWT_SIG_CAN" "1"
 SYSTEM_CONSTANT "SWT_SIG_HW" "0"
 SYSTEM_CONSTANT "SWT_SSPMON1" "1"
 SYSTEM_CONSTANT "SWT_SSPMON2" "2"
 SYSTEM_CONSTANT "SWT_SSPMON3" "3"
 SYSTEM_CONSTANT "SWT_TYPE_APPL" "2"
 SYSTEM_CONSTANT "SWT_TYPE_DATASET" "0"
 SYSTEM_CONSTANT "SWT_TYPE_EEP" "1"
 SYSTEM_CONSTANT "SYS_TICK_DURATION" "286.000286000286"
 SYSTEM_CONSTANT "SY_CLASS_TAB_SIZE" "20"
 SYSTEM_CONSTANT "SY_D2CNT_SIZE" "0"
 SYSTEM_CONSTANT "SY_DFPMENV" "10"
 SYSTEM_CONSTANT "SY_DFPMFFS" "11"
 SYSTEM_CONSTANT "SY_DFPMTIM" "2"
 SYSTEM_CONSTANT "SY_DFPM_HLC_BEHAVIOUR" "0"
 SYSTEM_CONSTANT "SY_DFP_FCM_BEHAVIOUR" "1"
 SYSTEM_CONSTANT "SY_DFP_FILLFRZ_IN_FCM_BEHAVIOUR" "1"
 SYSTEM_CONSTANT "SY_DSCHED_DFP_DEF_TAB_SIZE" "10"
 SYSTEM_CONSTANT "SY_DSCHED_DFP_OK_TAB_SIZE" "20"
 SYSTEM_CONSTANT "SY_DSCHED_ENABLE" "0"
 SYSTEM_CONSTANT "SY_DSMEX" "12"
 SYSTEM_CONSTANT "SY_DSMFA" "8"
 SYSTEM_CONSTANT "SY_DSMMAST" "16"
 SYSTEM_CONSTANT "SY_DSMSLP" "8"
 SYSTEM_CONSTANT "SY_DSM_BE_LOCK_ERROR" "0"
 SYSTEM_CONSTANT "SY_DSM_BLK_CODE_ENABLE" "0"
 SYSTEM_CONSTANT "SY_DSM_CHECKSUM_ACT" "0"
 SYSTEM_CONSTANT "SY_DSM_DC_BEHAVIOUR" "0"
 SYSTEM_CONSTANT "SY_DSM_DIS_AT_EOLTESTER" "0"
 SYSTEM_CONSTANT "SY_DSM_DUR_FCM_ENABLE" "0"
 SYSTEM_CONSTANT "SY_DSM_DUR_GLOBAL_ENABLE" "1"
 SYSTEM_CONSTANT "SY_DSM_FA_FADEMSK_ENABLE" "1"
 SYSTEM_CONSTANT "SY_DSM_HISTORYSIZE" "14"
 SYSTEM_CONSTANT "SY_DSM_INHIBIT_DELAY" "1"
 SYSTEM_CONSTANT "SY_DSM_INHIBIT_DELAY_LAMP_ENABLE" "0"
 SYSTEM_CONSTANT "SY_DSM_MASTER_SLAVE_ENABLE" "0"
 SYSTEM_CONSTANT "SY_DSM_MAST_SLA_COMP" "0"
 SYSTEM_CONSTANT "SY_DSM_NUM_COLL_MP" "23"
 SYSTEM_CONSTANT "SY_DSM_NUM_FID_COLL_MP" "20"
 SYSTEM_CONSTANT "SY_DSM_PROTECT_FCM" "1"
 SYSTEM_CONSTANT "SY_DSM_RDY_ACC" "0"
 SYSTEM_CONSTANT "SY_DSM_SHADOW_CLEAR" "0"
 SYSTEM_CONSTANT "SY_DSM_SHADOW_ENABLE" "1"
 SYSTEM_CONSTANT "SY_DSM_SHADOW_INH_BEHAVIOUR" "1"
 SYSTEM_CONSTANT "SY_DSM_SHADOW_TIMAX" "0"
 SYSTEM_CONSTANT "SY_DSM_SIZE_FCM_ENTRY" "46"
 SYSTEM_CONSTANT "SY_DSM_SUPP_16BIT_DFP" "1"
 SYSTEM_CONSTANT "SY_DSM_SYSLMP_BLK" "0"
 SYSTEM_CONSTANT "SY_DSM_VALID_PRESENT" "0"
 SYSTEM_CONSTANT "SY_DSM_VISIBILITY_SUPPORT" "0"
 SYSTEM_CONSTANT "SY_ENABLE_D2CNT" "0"
 SYSTEM_CONSTANT "SY_ENABLE_ENG_RUN_HOUR_CNT" "0"
 SYSTEM_CONSTANT "SY_ENVBLOK" "2"
 SYSTEM_CONSTANT "SY_ENV_BYTE" "1"
 SYSTEM_CONSTANT "SY_ENV_WORD" "0"
 SYSTEM_CONSTANT "SY_FAULT_TYPE_CONV" "1"
 SYSTEM_CONSTANT "SY_FCMSIZE" "14"
 SYSTEM_CONSTANT "SY_FFESIZE" "0"
 SYSTEM_CONSTANT "SY_INH_POINT_APPLIC" "0"
 SYSTEM_CONSTANT "SY_SUPPORT_TRIGGER_ACTION" "0"
 SYSTEM_CONSTANT "SY_WTTLEN" "20"
 SYSTEM_CONSTANT "T50CD_SWTSIG_VAL" "0"
 SYSTEM_CONSTANT "TEGCO_Q_CNV" "128"
 SYSTEM_CONSTANT "TEGMOD_ALPHAEGPIPE_RES" "1280"
 SYSTEM_CONSTANT "TEGMOD_ALPHAPIPEENV_RES" "52428.8"
 SYSTEM_CONSTANT "TEGMOD_AREAPIPE_RES" "201.06192982976"
 SYSTEM_CONSTANT "TEGMOD_CMPRPWR_RES" "76747.2972710018"
 SYSTEM_CONSTANT "TEGMOD_DELTATEMP_RES" "100"
 SYSTEM_CONSTANT "TEGMOD_FACPT1_RES" "2812.5"
 SYSTEM_CONSTANT "TEGMOD_HEATFLOWKW_RES" "100000"
 SYSTEM_CONSTANT "TEGMOD_HEATFLOW_INTER_RES" "360"
 SYSTEM_CONSTANT "TEGMOD_HEATFLOW_RES" "1000"
 SYSTEM_CONSTANT "TEGMOD_HEATKJ_RES" "100"
 SYSTEM_CONSTANT "TEGMOD_HEATRANS_INTER_RES" "819.2"
 SYSTEM_CONSTANT "TEGMOD_HEATRANS_RES" "100"
 SYSTEM_CONSTANT "TEGMOD_HUBPERSEC_RES" "120"
 SYSTEM_CONSTANT "TEGMOD_INJMASSKGH_OXI_RES" "294.912"
 SYSTEM_CONSTANT "TEGMOD_INJMASSKGH_RES" "377.48736"
 SYSTEM_CONSTANT "TEGMOD_INTER1_RES" "0.01"
 SYSTEM_CONSTANT "TEGMOD_INTER_RES" "1"
 SYSTEM_CONSTANT "TEGMOD_LAMBDA_RES" "8827.58620689655"
 SYSTEM_CONSTANT "TEGMOD_PT1TIMECONST_RES" "335.54432"
 SYSTEM_CONSTANT "TEGMOD_REPIPEENV_RES" "1456.35555555556"
 SYSTEM_CONSTANT "TEGMOD_REPIPE_RES" "370.857896905592"
 SYSTEM_CONSTANT "TEGMOD_TEMPEG_INTER_RES" "3600"
 SYSTEM_CONSTANT "TEGMOD_TEMPEG_RES" "100"
 SYSTEM_CONSTANT "TEGMOD_TEMPTRBN_INTER_RES" "10485.76"
 SYSTEM_CONSTANT "TEGMOD_TEMPTRBN_RES" "9424.77796077"
 SYSTEM_CONSTANT "TEGMOD_TEMP_RES" "819.2"
 SYSTEM_CONSTANT "TEMP_CELS_OFFSET" "0"
 SYSTEM_CONSTANT "TEMP_CELS_RES" "0.1"
 SYSTEM_CONSTANT "TEMP_HIGH_RES" "0.01"
 SYSTEM_CONSTANT "TEMP_NULL_C" "-273.14"
 SYSTEM_CONSTANT "TEMP_NULL_F" "-459.652"
 SYSTEM_CONSTANT "TEMP_NULL_K" "273.14"
 SYSTEM_CONSTANT "TEMP_RES" "0.1"
 SYSTEM_CONSTANT "TEMP_RES_INV" "10"
 SYSTEM_CONSTANT "TEMP_RES_REV" "10"
 SYSTEM_CONSTANT "TEMP_WVCOR_MAX" "140"
 SYSTEM_CONSTANT "TEMP_WVCOR_MIN" "-40"
 SYSTEM_CONSTANT "THERMAL_COEFF_RES" "0.1"
 SYSTEM_CONSTANT "TIMEDELAY_ADC_FILTER" "2684.35456"
 SYSTEM_CONSTANT "TIMEDELAY_S_1_MIN" "4e-05"
 SYSTEM_CONSTANT "TIMEDELAY_S_1_NRM" "12"
 SYSTEM_CONSTANT "TIMEDELAY_S_2_MIN" "0.001"
 SYSTEM_CONSTANT "TIMEDELAY_S_2_NRM" "8"
 SYSTEM_CONSTANT "TIMEDELAY_S_LIN_16_2_MAX" "2000"
 SYSTEM_CONSTANT "TIMEDELAY_S_LIN_16_2_RES" "0.0610370189519944"
 SYSTEM_CONSTANT "TIMEDELAY_S_LIN_16_MAX" "5"
 SYSTEM_CONSTANT "TIMEDELAY_S_LIN_16_MAX_ASDDC" "1.5"
 SYSTEM_CONSTANT "TIMEDELAY_S_LIN_16_MAX_ASDRF" "1.5"
 SYSTEM_CONSTANT "TIMEDELAY_S_LIN_16_REC_RES" "4294.967296"
 SYSTEM_CONSTANT "TIMEDELAY_S_LIN_16_RES" "0.000152592547379986"
 SYSTEM_CONSTANT "TIMEDELAY_S_LIN_16_RES_FL" "0.000152592547379986"
 SYSTEM_CONSTANT "TIMERMPINV_RES" "1.52587890625e-05"
 SYSTEM_CONSTANT "TIME_100ms_CYCLE" "100000"
 SYSTEM_CONSTANT "TIME_10ms_CYCLE" "10000"
 SYSTEM_CONSTANT "TIME_200ms_CYCLE" "200"
 SYSTEM_CONSTANT "TIME_20ms_CYCLE" "20000"
 SYSTEM_CONSTANT "TIME_2MS_CYCLE" "2000"
 SYSTEM_CONSTANT "TIME_32BTIMER" "100"
 SYSTEM_CONSTANT "TIME_40ms_CYCLE" "40000"
 SYSTEM_CONSTANT "TIME_4US_RES" "4"
 SYSTEM_CONSTANT "TIME_ADCFILT_RES" "0.003906"
 SYSTEM_CONSTANT "TIME_CONV_TICK" "8192"
 SYSTEM_CONSTANT "TIME_DEB_MAX" "655140"
 SYSTEM_CONSTANT "TIME_DEB_MIN" "0"
 SYSTEM_CONSTANT "TIME_DEB_RES" "10"
 SYSTEM_CONSTANT "TIME_DT_10MS" "10000"
 SYSTEM_CONSTANT "TIME_DT_MS_RES" "0.001"
 SYSTEM_CONSTANT "TIME_DT_RES" "1"
 SYSTEM_CONSTANT "TIME_DT_RES_FL" "1"
 SYSTEM_CONSTANT "TIME_ENG_ON_RES" "1"
 SYSTEM_CONSTANT "TIME_MS_10MS" "10"
 SYSTEM_CONSTANT "TIME_MS_10MS_RES" "10"
 SYSTEM_CONSTANT "TIME_MS_20MS_RES" "20"
 SYSTEM_CONSTANT "TIME_MS_40MS_RES" "40"
 SYSTEM_CONSTANT "TIME_MS_MAX" "655140"
 SYSTEM_CONSTANT "TIME_MS_ZERO" "0"
 SYSTEM_CONSTANT "TIME_PFLTLIMPHOME_RES" "10"
 SYSTEM_CONSTANT "TIME_PWM_HIGH_RES" "1e-07"
 SYSTEM_CONSTANT "TIME_RECOVERBUSOFF_MIN" "150"
 SYSTEM_CONSTANT "TIME_RED_MAX" "3600"
 SYSTEM_CONSTANT "TIME_RED_NRM" "4"
 SYSTEM_CONSTANT "TIME_RED_RES" "0.16"
 SYSTEM_CONSTANT "TIME_RED_ZERO" "0"
 SYSTEM_CONSTANT "TIME_RMP1_RES" "100000"
 SYSTEM_CONSTANT "TIME_RMPFMA_RES" "53687091.2"
 SYSTEM_CONSTANT "TIME_RMP_RES" "6553.6"
 SYSTEM_CONSTANT "TIME_SECOND" "1"
 SYSTEM_CONSTANT "TIME_S_MAX" "655.14"
 SYSTEM_CONSTANT "TIME_S_ZERO" "0"
 SYSTEM_CONSTANT "TIME_TICK" "10"
 SYSTEM_CONSTANT "TIME_TICK_RES" "10"
 SYSTEM_CONSTANT "TIME_TICK_S" "0.01"
 SYSTEM_CONSTANT "TIME_TICK_SEC_INV" "100"
 SYSTEM_CONSTANT "TIME_US_RES" "1"
 SYSTEM_CONSTANT "TIME_US_ZERO" "0"
 SYSTEM_CONSTANT "TIOP_U16_EXP" "6"
 SYSTEM_CONSTANT "TIOP_U16_RES" "64"
 SYSTEM_CONSTANT "TIPICKUPCURRMAX" "1600"
 SYSTEM_CONSTANT "TIPICKUPCURRMIN" "60"
 SYSTEM_CONSTANT "TIPICKUPCURRZERO" "0"
 SYSTEM_CONSTANT "TISNCERGN_U16_EXP" "8"
 SYSTEM_CONSTANT "TISNCERGN_U16_RES" "256"
 SYSTEM_CONSTANT "TI_DIFF_HYD_MAX" "5000"
 SYSTEM_CONSTANT "TI_DIFF_HYD_MIN" "-5000"
 SYSTEM_CONSTANT "TI_PII_EARL_REL" "13000"
 SYSTEM_CONSTANT "TI_POI2_LATE_REL" "-13000"
 SYSTEM_CONSTANT "TI_PT1_MAX" "4000"
 SYSTEM_CONSTANT "TI_PT1_MIN" "0.14"
 SYSTEM_CONSTANT "TMR_SHIFT_EXP" "13"
 SYSTEM_CONSTANT "TOXICATMOD_HEATFLOW_RES" "0.277777777777778"
 SYSTEM_CONSTANT "TOXICATMOD_INTER1_RES" "29"
 SYSTEM_CONSTANT "TOXICATMOD_INTER2_RES" "10"
 SYSTEM_CONSTANT "TOXICATMOD_INTER3_RES" "36"
 SYSTEM_CONSTANT "TOXICATMOD_INTER_RES" "200"
 SYSTEM_CONSTANT "TRANS_R_MAX" "32767"
 SYSTEM_CONSTANT "TRANS_R_ONE" "1"
 SYSTEM_CONSTANT "TRANS_R_RES" "0.01"
 SYSTEM_CONSTANT "TRANS_R_RES_REV" "100"
 SYSTEM_CONSTANT "TRANS_R_RES_REZ" "100"
 SYSTEM_CONSTANT "TRQPRP_HIGH_RES" "1"
 SYSTEM_CONSTANT "TRQPRP_MAX" "6000"
 SYSTEM_CONSTANT "TRQPRP_MIN" "-5000"
 SYSTEM_CONSTANT "TRQPRP_RES" "0.2"
 SYSTEM_CONSTANT "TRQPRP_RES_REV" "5"
 SYSTEM_CONSTANT "TRQPRP_RES_REZ" "5"
 SYSTEM_CONSTANT "TRQPRP_ZERO" "0"
 SYSTEM_CONSTANT "TRQ_400" "400"
 SYSTEM_CONSTANT "TRQ_FRC_INI" "-50"
 SYSTEM_CONSTANT "TRQ_INT_RES" "5"
 SYSTEM_CONSTANT "TRQ_INT_RES2" "1"
 SYSTEM_CONSTANT "TRQ_MAX" "1000"
 SYSTEM_CONSTANT "TRQ_MIN" "-500"
 SYSTEM_CONSTANT "TRQ_ONE" "1"
 SYSTEM_CONSTANT "TRQ_RES" "0.1"
 SYSTEM_CONSTANT "TRQ_RES_FL" "0.1"
 SYSTEM_CONSTANT "TRQ_RES_REV" "10"
 SYSTEM_CONSTANT "TRQ_RES_REZ" "10"
 SYSTEM_CONSTANT "TRQ_ZERO" "0"
 SYSTEM_CONSTANT "TVACD_DCYCCONV_CUR_X" "25"
 SYSTEM_CONSTANT "TWO_PI" "628.318530718"
 SYSTEM_CONSTANT "T_AIR_MAX" "199.86"
 SYSTEM_CONSTANT "T_AIR_MIN" "-50.14"
 SYSTEM_CONSTANT "T_CAT_MAX" "800"
 SYSTEM_CONSTANT "T_CAT_MIN" "-50"
 SYSTEM_CONSTANT "T_CHAMWLL_MAX" "326"
 SYSTEM_CONSTANT "T_CLNT_DIFF_MAX" "200"
 SYSTEM_CONSTANT "T_CLNT_DIFF_MIN" "0"
 SYSTEM_CONSTANT "T_CLNT_MAX" "149.86"
 SYSTEM_CONSTANT "T_CLNT_MIN" "-50.14"
 SYSTEM_CONSTANT "T_COREGTGVNR_MAX" "0"
 SYSTEM_CONSTANT "T_COREGTGVNR_MIN" "-1500"
 SYSTEM_CONSTANT "T_COREXHGS_MIN" "0"
 SYSTEM_CONSTANT "T_DVT_MAX" "500"
 SYSTEM_CONSTANT "T_DVT_MIN" "-500"
 SYSTEM_CONSTANT "T_EGAS_MAX" "1273"
 SYSTEM_CONSTANT "T_EGAS_MIN" "223"
 SYSTEM_CONSTANT "T_EGTGVNR" "25"
 SYSTEM_CONSTANT "T_EGTGVNR_MIN" "0"
 SYSTEM_CONSTANT "T_EGT_CORMAX_C" "0.5"
 SYSTEM_CONSTANT "T_EGT_CORMIN_C" "0"
 SYSTEM_CONSTANT "T_EGT_WINNEG" "-1000"
 SYSTEM_CONSTANT "T_EGT_WINPOS" "1000"
 SYSTEM_CONSTANT "T_ENGRPM_DFL" "-50.04"
 SYSTEM_CONSTANT "T_ENG_MAX" "199.86"
 SYSTEM_CONSTANT "T_ENG_MIN" "-50.14"
 SYSTEM_CONSTANT "T_EXHGS_MAX" "1050"
 SYSTEM_CONSTANT "T_EXHGS_MIN" "-45"
 SYSTEM_CONSTANT "T_FUEL_MAX" "149.86"
 SYSTEM_CONSTANT "T_FUEL_MIN" "-50.14"
 SYSTEM_CONSTANT "T_GVNRIO_MAX" "1500"
 SYSTEM_CONSTANT "T_GVNRIO_MIN" "-100"
 SYSTEM_CONSTANT "T_GVNR_MAX" "1500"
 SYSTEM_CONSTANT "T_GVNR_MIN" "-100"
 SYSTEM_CONSTANT "T_LAMBDA_MAX" "-143.14"
 SYSTEM_CONSTANT "T_LAMBDA_MIN" "-263.14"
 SYSTEM_CONSTANT "UBATT_ADC_REF" "20000"
 SYSTEM_CONSTANT "U_ADC_MAX" "5200"
 SYSTEM_CONSTANT "U_ADC_MIN" "0"
 SYSTEM_CONSTANT "U_ADC_REF_SYS" "5000"
 SYSTEM_CONSTANT "U_BATT_MAX" "28600"
 SYSTEM_CONSTANT "U_BATT_MIN" "0"
 SYSTEM_CONSTANT "U_RATED" "14000"
 SYSTEM_CONSTANT "U_RATED_PASS" "14000"
 SYSTEM_CONSTANT "U_RATED_TRUCK" "28000"
 SYSTEM_CONSTANT "U_RES" "5.0830889540567"
 SYSTEM_CONSTANT "U_TO_RESIST_RES" "0.001"
 SYSTEM_CONSTANT "U_TO_RESIST_REV_RES" "1000"
 SYSTEM_CONSTANT "V2N_NORM" "1000"
 SYSTEM_CONSTANT "V2N_RES" "1e-05"
 SYSTEM_CONSTANT "V2N_ZERO" "0"
 SYSTEM_CONSTANT "VEHDA_LOAD_SEC_X" "6"
 SYSTEM_CONSTANT "VEHDA_LOAD_SEC_Y" "8"
 SYSTEM_CONSTANT "VEL1_RES" "0.1"
 SYSTEM_CONSTANT "VEL1_RES_REV" "10"
 SYSTEM_CONSTANT "VEL2TRQPRP_CONV" "8192"
 SYSTEM_CONSTANT "VEL2TRQPRP_EXT" "8192"
 SYSTEM_CONSTANT "VEL2TRQPRP_RES" "0.00244140625"
 SYSTEM_CONSTANT "VELKMPH_FAC" "88.4194128288249"
 SYSTEM_CONSTANT "VEL_KMH_RES" "0.036"
 SYSTEM_CONSTANT "VEL_MAX" "300"
 SYSTEM_CONSTANT "VEL_MIN" "0"
 SYSTEM_CONSTANT "VEL_MPS_RES" "100"
 SYSTEM_CONSTANT "VEL_RES" "0.01"
 SYSTEM_CONSTANT "VEL_RES_SI" "0.00277777777777778"
 SYSTEM_CONSTANT "VEL_THRES" "360000000"
 SYSTEM_CONSTANT "VEL_ZERO" "0"
 SYSTEM_CONSTANT "VOLCYL_RES" "1"
 SYSTEM_CONSTANT "VOLT_ZERO" "0"
 SYSTEM_CONSTANT "VOL_ADD_MAX" "3276.7"
 SYSTEM_CONSTANT "VOL_ADD_MAX_FINE" "32.767"
 SYSTEM_CONSTANT "VOL_ADD_MAX_UL" "2000000"
 SYSTEM_CONSTANT "VOL_ADD_MIN" "0"
 SYSTEM_CONSTANT "VOL_ADD_MIN_FINE" "0"
 SYSTEM_CONSTANT "VOL_ADD_MIN_UL" "0"
 SYSTEM_CONSTANT "VOL_ADD_RES" "0.1"
 SYSTEM_CONSTANT "VOL_ADD_RES1" "0"
 SYSTEM_CONSTANT "VOL_ADD_RES1_REV" "65536"
 SYSTEM_CONSTANT "VOL_ADD_RES_1ML" "1"
 SYSTEM_CONSTANT "VOL_ADD_RES_1ML_REV" "1"
 SYSTEM_CONSTANT "VOL_ADD_RES_FINE" "0.001"
 SYSTEM_CONSTANT "VOL_ADD_RES_FINE_REV" "1000"
 SYSTEM_CONSTANT "VOL_ADD_RES_FINE_REZ" "1000"
 SYSTEM_CONSTANT "VOL_ADD_RES_REV" "10"
 SYSTEM_CONSTANT "VOL_ADD_RES_REZ" "10"
 SYSTEM_CONSTANT "VOL_CONST" "-2652.58238486475"
 SYSTEM_CONSTANT "VOL_FL_L_TO_FL_2" "100"
 SYSTEM_CONSTANT "VOL_PFLT_MAX" "100"
 SYSTEM_CONSTANT "VOL_PFLT_MIN" "0.01"
 SYSTEM_CONSTANT "VOL_RES" "0.01"
 SYSTEM_CONSTANT "VSACD_DCYCCONV_CUR_X" "8"
 SYSTEM_CONSTANT "VSSCD_SIG_CAN" "1"
 SYSTEM_CONSTANT "VSSCD_SIG_HW" "0"
 SYSTEM_CONSTANT "VSSCD_SIG_KIENZLE" "2"
 SYSTEM_CONSTANT "VSSCD_SWTSIG_TYPE" "2"
 SYSTEM_CONSTANT "VSSCD_SWTSIG_VAL" "0"
 SYSTEM_CONSTANT "VSSCD_SWTSIG_VAL_MAX" "1"
 SYSTEM_CONSTANT "VSSCD_TIPER_MAX" "13421772.8"
 SYSTEM_CONSTANT "WHEEL_N_RES" "1"
 SYSTEM_CONSTANT "ZFC_NUM_RAILP_CLB_PNT" "2"
 SYSTEM_CONSTANT "ZFC_PHISET_CUR_X" "16"
 SYSTEM_CONSTANT "ZFC_SWTCLBACTV_TYPE" "2"
 SYSTEM_CONSTANT "ZFC_SWTCLBACTV_VAL" "0"
 SYSTEM_CONSTANT "ZFC_TICLDCHAM_CUR_X" "12"
 SYSTEM_CONSTANT "_EpromID" "99"
 SYSTEM_CONSTANT "_PA_BRANCHTAB" "65792" /end MOD_PAR
/begin MOD_COMMON "" BYTE_ORDER MSB_FIRST ALIGNMENT_BYTE 1 ALIGNMENT_WORD 2 ALIGNMENT_LONG 4 ALIGNMENT_FLOAT32_IEEE 4 /end MOD_COMMON
/begin IF_DATA ASAP1B_Bypass
 /begin TP_BLOB 0x100 /* Bypass version */ 0x100 /end TP_BLOB
/end IF_DATA
/begin IF_DATA ASAP1B_CCP
 /begin SOURCE "segment synchronous event channel" 103 1 /begin QP_BLOB 0 LENGTH 8 CAN_ID_FIXED 0x330 FIRST_PID 0 RASTER 0 /end QP_BLOB /end SOURCE
 /begin SOURCE "10ms time synchronous event channel" 4 1 /begin QP_BLOB 1 LENGTH 12 CAN_ID_FIXED 0x340 FIRST_PID 8 RASTER 1 /end QP_BLOB /end SOURCE
 /begin SOURCE "100ms time synchronous event channel" 4 10 /begin QP_BLOB 2 LENGTH 8 CAN_ID_FIXED 0x350 FIRST_PID 20 RASTER 2 /end QP_BLOB /end SOURCE
 /begin RASTER "segment synchronous event channel" "seg_sync" 0 103 1 /end RASTER
 /begin RASTER "10ms time synchronous event channel" "10_ms" 1 4 1 /end RASTER
 /begin RASTER "100ms time synchronous event channel" "100_ms" 2 4 10 /end RASTER
 /begin SEED_KEY /* seed&key dll for CAL privilege */ "" /* seed&key dll for DAQ privilege */ "" /* seed&key dll for PGM privilege */ "" /end SEED_KEY
 /begin TP_BLOB /* CCP version */ 0x200 0x202 /* CAN msg ID - send */ 0x200 /* CAN msg ID - recv */ 0x210 /* station address */ 0x1234 /* byte order */ 1
  /begin CAN_PARAM /* crystal frequency */ 0x3E8 /* timing register 0 */ 0x40 /* timing register 1 */ 0x16 /end CAN_PARAM
  DAQ_MODE BURST CONSISTENCY DAQ
  /begin CHECKSUM_PARAM /* algorithm */ 0xC001 /* limit */ 0xFFFFFFFF CHECKSUM_CALCULATION ACTIVE_PAGE /end CHECKSUM_PARAM
  /begin DEFINED_PAGES 1 "reference page" /* address ext. */ 0x00 /* base address */ 0xC3A10 /* page length */ 0x31B74 ROM /end DEFINED_PAGES
  /begin DEFINED_PAGES 2 "working page" /* address ext. */ 0x00 /* base address */ 0x800C3A10 /* page length */ 0x31B74 RAM RAM_INIT_BY_ECU /end DEFINED_PAGES
  OPTIONAL_CMD 0x11 /* SELECT_CAL_PAGE */ OPTIONAL_CMD 0xE /* BUILD_CHKSUM */ OPTIONAL_CMD 0x19 /* MOVE */ OPTIONAL_CMD 0x9 /* GET_ACTIVE_CAL_PAGE */ OPTIONAL_CMD 0xC /* SET_S_STATUS */ OPTIONAL_CMD 0xD /* GET_S_STATUS */ OPTIONAL_CMD 0x12 /* GET_SEED */ OPTIONAL_CMD 0x13 /* UNLOCK */ /end TP_BLOB
/end IF_DATA
/begin IF_DATA ETK
 /begin SOURCE "segment synchronous raster" 103 1 QP_BLOB 1 /* MAXNUM_A */ 100 /* DISTAB_A */ 0x8C33A4 /* CHNL_A */ 0x8FE0DC /* TRG_ID_A */ 0x8FE088 /* TrgRate */ 0 0 0x0 /end SOURCE
 /begin SOURCE "10ms time synchronous raster" 4 1 QP_BLOB 2 /* MAXNUM_B */ 100 /* DISTAB_B */ 0x8C353C /* CHNL_B */ 0x8FE140 /* TRG_ID_B */ 0x8FE08C /* TrgRate */ 20 0 0x0 /end SOURCE
 /begin SOURCE "100ms time synchronous raster" 5 1 QP_BLOB 3 /* MAXNUM_C */ 100 /* DISTAB_C */ 0x8C36D4 /* CHNL_C */ 0x8FE1A4 /* TRG_ID_C */ 0x8FE090 100 0 0x0 /end SOURCE
 /begin SOURCE "bypass segment sync. raster" 103 1 QP_BLOB 4 /* BPMAX_S */ 28 /* BYPASS_S */ 0x8C3274 /* CHNL_S */ 0x8FE094 /* TRGID_S */ 0x8FE080 0 /* BPMAX_T */ 28 /* CHNL_T */ 0x8C386C /end SOURCE
 /begin SOURCE "bypass 10ms time sync. raster" 4 1 QP_BLOB 5 /* BPMAX_X */ 44 /* BYPASS_X */ 0x8C32EC /* CHNL_X */ 0x8FE0B0 /* TRGID_X */ 0x8FE084 20 /* BPMAX_Y */ 44 /* CHNL_Y */ 0x8C38AC /end SOURCE
 /begin TP_BLOB 0x1000001 /* PBA */ 0x0 /* RESET_CFG */ 0x800
  /begin DISTAB_CFG /* DSPTAB */ 13 /* DAT_MOD */ 1 /* RFG */ 1 /* TRGSEGAD */ 0x8FE000 /* TRG_CFG */ 0x1020100 TRG_MOD 0 255 /end DISTAB_CFG
  CODE_CHK /* ChkSumData */ 0x8FDF70 /* PrgDataLen */ 0x4 /* ChkSumExtRam */ 0x8FFFF8 /* PrgExtRamLen */ 0x4 ETK_CFG 0x03 0xD2 0x4D 0xFF 0xEF 0x4E 0xDF 0xEF 0x4E 0xFF 0xFB 0xFE 0xFF 0xFF 0xFE 0xFF 0xFF 0xF0 0x0F 0xFF 0x03 0xCD 0xFF 0xFF RESERVED 0x8C3271 0x79F EXTERN -1 -1 -1 -1 -1 /end TP_BLOB
/end IF_DATA
/begin IF_DATA ASAP1B_KWP2000
 /begin SOURCE "timeslot" 4 1 QP_BLOB 0 BLOCKMODE 0xF0 0 20 /end SOURCE
 /begin TP_BLOB 0x101 /* ECU address on k line */ 0x12 /* requ. tester address */ 0xF1 /* ECU stimulation mode */ WuP /* byte order */ MSB_FIRST 1 DATA_ACCESS /* Flash address */ 0x000000 /* RAM address */ 0x000000 /* Data Read */ 1 /* Code Verify */ 0 /* Code Read */ 0 /* Load mode */ 1 /begin CHECKSUM 0x010201 1 1 RequestRoutineResults RNC_RESULT 0x23 /end CHECKSUM
  /begin FLASH_COPY NOFLASHBACK 3 RequestRoutineResults RAM_InitByECU 0x86 COPY_FRAME 1 RNC_RESULT 0x23 0xFB 0xFC /end FLASH_COPY
  /begin DIAG_BAUD 38400 0x86 BD_PARA 0x50 /end DIAG_BAUD
  /begin DIAG_BAUD 10400 0x86 BD_PARA 0x14 /end DIAG_BAUD
  /begin DIAG_BAUD 57600 0x86 BD_PARA 0x64 /end DIAG_BAUD
  /begin DIAG_BAUD 125000 0x86 BD_PARA 0x87 /end DIAG_BAUD
  /* Timing Parameter: p1Max p2Min p2Max p3Min p3Max p4Min */ TIME_DEF 0x0014 0x0000 0x0032 0x0003 0x0200 0x0000 TIME_DEF 0x0014 0x0000 0x0032 0x0003 0x0200 0x0001 TIME_DEF 20 0 2000 0 5000 65440 /* Seed&Key Parameter: AccMode CalcMethod Delay */ /* SECURITY_ACCESS 9 1 0 */ /begin PAGE_SWITCH ESCAPE_CODE ESCAPE_CODE_PARA 0x90 PAGE_CODE 0x00 0x01 /end PAGE_SWITCH /end TP_BLOB
/end IF_DATA
/begin IF_DATA ASAP1B_MCMESS
 /begin SOURCE "segment synchronous raster" 103 1 QP_BLOB ANGLE 20 /* max. number of bytes (BLKZ_W) */ /end SOURCE
 /begin SOURCE "10ms time synchronous raster" 103 1 QP_BLOB TIME 20 /* max. number of bytes (BLKZ_Z) */ /end SOURCE
 /begin SOURCE "handshake" 103 1 QP_BLOB HANDSHAKE 0 /* max. number of bytes: 0 */ /end SOURCE
 /begin TP_BLOB 0x101 KOMKEN 11 /* communication identifier */ MCTGT 0x11 /* target address */ MCINI KW2000 /* wake up method */
  /begin CHECKSUM_PARAM /* type qualifier */ 0x8001 CHECKSUM_CALCULATION ACTIVE_PAGE /end CHECKSUM_PARAM
  /begin DEFINED_PAGES 1 "reference page" FLASH NO_FLASH_BACK DEFAULT /end DEFINED_PAGES
  BYTE_ORDER MSB_FIRST THREE_BYTE_ADDRESSES /end TP_BLOB
/end IF_DATA
/begin CHARACTERISTIC ACCD_uSRCMin_C "SRC-MIN-Wert für Spannung A/C Kühlmitteldruck" VALUE 0xC3D30 Kw_Ws16 5200.391 Volt 0.00 5200.391 FORMAT "%8.3" EXTENDED_LIMITS -160156.4 160151.5 /end CHARACTERISTIC
/begin CHARACTERISTIC ACCD_uSRCMax_C "SRC-MAX-Wert fü Spannung A/C Kühlmitteldruck" VALUE 0xC3D32 Kw_Ws16 5200.391 Volt 0.00 5200.391 FORMAT "%8.3" EXTENDED_LIMITS -160156.4 160151.5 /end CHARACTERISTIC
/begin CHARACTERISTIC ACCD_pAnaLin_CUR "Linearisierungskennlinie des analogen Klimakompressordrucks" CURVE 0xC3D34 Kl_Xs16_Ws16 35000.00 PresAC_hPa 0.00 35000.00 FORMAT "%8.2" EXTENDED_LIMITS -65536.00 65534.00
 /begin AXIS_DESCR STD_AXIS ACCD_uRaw Volt 2 0.00 5200.391 FORMAT "%8.3" EXTENDED_LIMITS -160156.4 160151.5 DEPOSIT ABSOLUTE /end AXIS_DESCR
/end CHARACTERISTIC
/begin CHARACTERISTIC ACCD_ctPwrStgOnMax_C "maximale Anzahl von Endstufen-Einschaltungen pro Fahrzyklus bei SCB oder Übertemperatur" VALUE 0xC3D12 Kw_Wu16 65535.00 OneToOne 0.00 65535.00 FORMAT "%8.2" /end CHARACTERISTIC
/begin CHARACTERISTIC ACCD_dcycPresSensorThres_C "Tastverhältnis mit Sensorfehler" VALUE 0xC3D3E Kw_Ws16 100.0000 Prc 0.00 100.0000 FORMAT "%8.4" EXTENDED_LIMITS -400.0000 399.9878 /end CHARACTERISTIC
/begin CHARACTERISTIC ACCD_dcycPWMThres_C "Schwellwert Tastverhältnis für Sensorfehler PWM Eingang Klimakompressordruck" VALUE 0xC3D40 Kw_Ws16 100.0000 Prc 0.00 100.0000 FORMAT "%8.4" EXTENDED_LIMITS -400.0000 399.9878 /end CHARACTERISTIC
/begin CHARACTERISTIC ACCD_DebExcTempDef_C "Fehlerentprellzeit, Übertemperaturfehler" VALUE 0xC3D14 Kw_Wu16 655350.0 Time_ms 0.00 655350.0 FORMAT "%8.1" /end CHARACTERISTIC
/begin CHARACTERISTIC ACCD_DebExcTempOk_C "Heilungsentprellzeit, Übertemperaturfehler" VALUE 0xC3D16 Kw_Wu16 655350.0 Time_ms 0.00 655350.0 FORMAT "%8.1" /end CHARACTERISTIC
/begin CHARACTERISTIC ACCD_DebNoLoadDef_C "Defektzeit für Fehler ""Endstufe im Leerlauf""" VALUE 0xC3D18 Kw_Wu16 655350.0 Time_ms 0.00 655350.0 FORMAT "%8.1" /end CHARACTERISTIC
/begin CHARACTERISTIC ACCD_DebNoLoadOk_C "Heilungszeit für Fehler ""Endstufe im Leerlauf""" VALUE 0xC3D1A Kw_Wu16 655350.0 Time_ms 0.00 655350.0 FORMAT "%8.1" /end CHARACTERISTIC
/begin CHARACTERISTIC ACCD_DebNplDef_C "Defect debounce time for Non-Plausible CAN Msg. error." VALUE 0xC3D78 Kw_Wu16 655350.0 Time_ms 0.00 655350.0 FORMAT "%8.1" /end CHARACTERISTIC
/begin CHARACTERISTIC ACCD_DebNplOK_C "Intact  debounce time for CAN Msg. Non-Plausible error." VALUE 0xC3D7A Kw_Wu16 655350.0 Time_ms 0.00 655350.0 FORMAT "%8.1" /end CHARACTERISTIC
/begin CHARACTERISTIC ACCD_DebShortCircBatDef_C "Defektzeit für Fehler ""Kurzschluß nach BATT""" VALUE 0xC3D1C Kw_Wu16 655350.0 Time_ms 0.00 655350.0 FORMAT "%8.1" /end CHARACTERISTIC
/begin CHARACTERISTIC ACCD_DebShortCircBatOk_C "Heilungszeit für Fehler ""Kurzschluß nach BATT""" VALUE 0xC3D1E Kw_Wu16 655350.0 Time_ms 0.00 655350.0 FORMAT "%8.1" /end CHARACTERISTIC
/begin CHARACTERISTIC ACCD_DebShortCircGndDef_C "Defektzeit für Fehler ""Kurzschluß nach Masse""" VALUE 0xC3D20 Kw_Wu16 655350.0 Time_ms 0.00 655350.0 FORMAT "%8.1" /end CHARACTERISTIC
/begin CHARACTERISTIC ACCD_DebShortCircGndOk_C "Heilungszeit für Fehler ""Kurzschluß nach Masse""" VALUE 0xC3D22 Kw_Wu16 655350.0 Time_ms 0.00 655350.0 FORMAT "%8.1" /end CHARACTERISTIC
/begin CHARACTERISTIC ACCD_DebSigDef_C "Defektentprellzeit für Timeout der CAN Botschaft" VALUE 0xC3D7C Kw_Wu16 655350.0 Time_ms 0.00 655350.0 FORMAT "%8.1" /end CHARACTERISTIC
/begin CHARACTERISTIC ACCD_DebSigOk_C "Heilentprellzeit für CAN Botschaft Timeout" VALUE 0xC3D7E Kw_Wu16 655350.0 Time_ms 0.00 655350.0 FORMAT "%8.1" /end CHARACTERISTIC
/begin CHARACTERISTIC ACCD_DebSRCHighDef_C "Fehlerentprellung SRC-High-Fehler" VALUE 0xC3D42 Kw_Wu16 655350.0 Time_ms 0.00 655350.0 FORMAT "%8.1" /end CHARACTERISTIC
/begin CHARACTERISTIC ACCD_DebSRCHighOk_C "Heilungsentprellung SRC-High-Fehler" VALUE 0xC3D44 Kw_Wu16 655350.0 Time_ms 0.00 655350.0 FORMAT "%8.1" /end CHARACTERISTIC
/begin CHARACTERISTIC ACCD_DebSRCLowDef_C "Fehlerentprellung SRC-Low-Fehler" VALUE 0xC3D46 Kw_Wu16 655350.0 Time_ms 0.00 655350.0 FORMAT "%8.1" /end CHARACTERISTIC
/begin CHARACTERISTIC ACCD_DebSRCLowOk_C "Heilungsentprellung SRC-Low-Fehler" VALUE 0xC3D48 Kw_Wu16 655350.0 Time_ms 0.00 655350.0 FORMAT "%8.1" /end CHARACTERISTIC
/begin CHARACTERISTIC ACCD_nEngLowLim_C "Motor-Drehzahlschwelle zur Abschaltung der analogen Klimadruck-Plausibilitäsprüfung" VALUE 0xC3D4A Kw_Ws16 1000.000 EngN 0.00 1000.000 FORMAT "%8.3" EXTENDED_LIMITS -32768.00 32767.00 /end CHARACTERISTIC
/begin CHARACTERISTIC ACCD_numAdc_C "#SSD Auswahl ADC-Eingang für Klimaanlage Flüssigkeitsdruck" VALUE 0xC3D4C Kw_Wu8 26.0000000000 NumPinAdc 0.00 26.0000000000 FORMAT "%13.10" /end CHARACTERISTIC
/begin CHARACTERISTIC ACCD_numDia_C "#SSD Parameter für Hardware Diagnose Pin Auswahl" VALUE 0xC3D24 Kw_Wu8 27.0000000000 NumPinDia 0.00 27.0000000000 FORMAT "%13.10" /end CHARACTERISTIC
/begin CHARACTERISTIC ACCD_numDioOut_C "#SSD Auswahl Digitalausgang für Klimakompressor" VALUE 0xC3D25 Kw_Wu8 11.0000000000 NumPinDioOut 0.00 11.0000000000 FORMAT "%13.10" /end CHARACTERISTIC
/begin CHARACTERISTIC ACCD_pPresLin_CUR "Linearisierungskurve Klimaanlagendruck über PWM Eingang" CURVE 0xC3D4E Kl_Xs16_Ws16 35000.00 PresAC_hPa 0.00 35000.00 FORMAT "%8.2" EXTENDED_LIMITS -65536.00 65534.00
 /begin AXIS_DESCR STD_AXIS ACCD_dcycPres Prc 2 0.00 100.0000 FORMAT "%8.4" EXTENDED_LIMITS -400.0000 399.9878 DEPOSIT ABSOLUTE /end AXIS_DESCR
/end CHARACTERISTIC
/begin CHARACTERISTIC ACCD_debPresDef_C "Fehlerentprellung für PM/Sensor" VALUE 0xC3D58 Kw_Wu16 655350.0 Time_ms 0.00 655350.0 FORMAT "%8.1" /end CHARACTERISTIC
/begin CHARACTERISTIC ACCD_debPresOk_C "Heilungsentprellung für PM/Sensor" VALUE 0xC3D5A Kw_Wu16 655350.0 Time_ms 0.00 655350.0 FORMAT "%8.1" /end CHARACTERISTIC
/begin CHARACTERISTIC ACCD_PresPwmInInv_C "Invertierung des PWM-Eingangs für den Klimakompressordruck" VALUE 0xC3D5C Kw_Wu8 1.000 OneToOne 0.00 1.000 FORMAT "%5.3" EXTENDED_LIMITS 0.00 255.0 /end CHARACTERISTIC
/begin CHARACTERISTIC ACCD_PresPwmInMinPer_C "Minimale Periodendauer des PWM-Eingangs Klimakompressordruck" VALUE 0xC3D5E Kw_Ws16 3276.700 Period 0.00 3276.700 FORMAT "%8.3" EXTENDED_LIMITS -3276.800 3276.700 /end CHARACTERISTIC
/begin CHARACTERISTIC ACCD_PresPwmInMaxPer_C "Maximale Periodendauer des PWM-Eingangs Klimakompressordruck" VALUE 0xC3D60 Kw_Ws16 3276.700 Period 0.00 3276.700 FORMAT "%8.3" EXTENDED_LIMITS -3276.800 3276.700 /end CHARACTERISTIC
/begin CHARACTERISTIC ACCD_dcycPresPwmInMin_C "Minimales Tastverhältnis für PWM-Eingang" VALUE 0xC3D62 Kw_Ws16 100.0000 Prc 0.00 100.0000 FORMAT "%8.4" EXTENDED_LIMITS -400.0000 399.9878 /end CHARACTERISTIC
/begin CHARACTERISTIC ACCD_dcycPresPwmInMax_C "Maximales Tastverhältnis für PWM Eingang" VALUE 0xC3D64 Kw_Ws16 100.0000 Prc 0.00 100.0000 FORMAT "%8.4" EXTENDED_LIMITS -400.0000 399.9878 /end CHARACTERISTIC
/begin CHARACTERISTIC ACCD_dtRmpSlpUp_C "Aufwärts-Schrittweite für Klimadruck" VALUE 0xC3D68 Kw_Wu32 131071879.974 RmpPresAC_hPa 119.995117188 131071999.969 FORMAT "%13.3" EXTENDED_LIMITS 0.00 131071999.969 /end CHARACTERISTIC
/begin CHARACTERISTIC ACCD_dtRmpSlpDwn_C "Abwärts-Schrittweite für AC Kühlmitteldruck" VALUE 0xC3D6C Kw_Wu32 131071879.974 RmpPresAC_hPa 119.995117188 131071999.969 FORMAT "%13.3" EXTENDED_LIMITS 0.00 131071999.969 /end CHARACTERISTIC
/begin CHARACTERISTIC ACCD_stDigInvOut_C "Invertierung des Digitalausgangs für Klimakompressor" VALUE 0xC3D26 Kw_Wu8 1.000 OneToOne 0.00 1.000 FORMAT "%5.3" EXTENDED_LIMITS 0.00 255.0 /end CHARACTERISTIC
/begin CHARACTERISTIC ACCD_stPwrStgActv_C "Spezifikation des Abschaltverhaltens der Endstufe" VALUE 0xC3D27 Kw_Wu8 255.0 OneToOne 0.00 255.0 FORMAT "%5.1" /end CHARACTERISTIC
/begin CHARACTERISTIC ACCD_stPwrStgDia_C "Spezifikation des Diagnoseabschaltverhaltens der Endstufe" VALUE 0xC3D28 Kw_Wu8 255.0 OneToOne 0.00 255.0 FORMAT "%5.1" /end CHARACTERISTIC
/begin CHARACTERISTIC ACCD_stSPICtl_C "Parameter zur Anzeige der verwendeten Endstufenart ( 1 = SPI kontrollierbare Endstufe, 0 = nicht SPI-Endstufe )" VALUE 0xC3D29 Kw_Wu8 1.000 OneToOne 0.00 1.000 FORMAT "%5.3" EXTENDED_LIMITS 0.00 255.0 /end CHARACTERISTIC
/begin CHARACTERISTIC ACCD_swtPresSelVal_C "Auswahl Klimadruck-Eingangssignal, 1=Analog-Eingang, 2=PWM Eingang" VALUE 0xC3D70 Kw_Wu8 1.000 OneToOne 1.000 2.000 FORMAT "%5.3" EXTENDED_LIMITS 0.00 255.0 /end CHARACTERISTIC
/begin CHARACTERISTIC ACCD_swtPresSelType_C "SW-Schaltertyp für Klimadruck Eingangsauswahl (0=Datensatzwert, nicht applizierbar/1=EEPROM-Wert/2=Datensatzwert)" VALUE 0xC3D71 Kw_Wu8 1.000 OneToOne 1.000 2.000 FORMAT "%5.3" EXTENDED_LIMITS 0.00 255.0 /end CHARACTERISTIC
/begin CHARACTERISTIC ACCD_tAirLowLim_C "Umgebungstemperaturschwelle zur Abschaltung der analogen Klimadruck-Plausibilitäsprüfung" VALUE 0xC3D72 Kw_Ws16 250.00000 Temp_Cels -50.14000 199.86000 FORMAT "%8.5" EXTENDED_LIMITS -3549.940 3003.560 /end CHARACTERISTIC
/begin CHARACTERISTIC ACCD_tiBtwTst_C "Zeitabstand, in dem die Endstufe im Fehlerfall getestet wird" VALUE 0xC3D2A Kw_Wu16 655140.0 Time_ms 0.00 655140.0 FORMAT "%8.1" EXTENDED_LIMITS 0.00 655350.0 /end CHARACTERISTIC
/begin CHARACTERISTIC ACCD_tiKLIDeb_C "Entprellzeit für automatische Klimanlagenerkennung" VALUE 0xC3D80 Kw_Wu16 655350.0 TimeDeb 0.00 655350.0 FORMAT "%8.1" /end CHARACTERISTIC
/begin CHARACTERISTIC ACCD_tiPwrStgOn_C "Zeit, für welche die Endstufe beim Fall der nicht-SPI-Endstufe eingeschaltet wird." VALUE 0xC3D2C Kw_Wu16 655140.0 Time_ms 0.00 655140.0 FORMAT "%8.1" EXTENDED_LIMITS 0.00 655350.0 /end CHARACTERISTIC
/begin CHARACTERISTIC ACCD_stSensIDWord_C "Kennzahl zur Festlegung des Fehlerverhaltens des Klimadrucks" VALUE 0xC3D74 Kw_Wu16 65535.00 OneToOne 0.00 65535.00 FORMAT "%8.2" /end CHARACTERISTIC
/begin CHARACTERISTIC ACCD_pDfl_C "Klimadruck-Vorgabewert" VALUE 0xC3D76 Kw_Ws16 35000.00 PresAC_hPa 0.00 35000.00 FORMAT "%8.2" EXTENDED_LIMITS -65536.00 65534.00 /end CHARACTERISTIC
/begin CHARACTERISTIC ACCD_trqLim_C "torque limitation threshold value" VALUE 0xC3D10 Kw_Ws16 1500.000 Trq -500.0000 1000.000 FORMAT "%8.3" EXTENDED_LIMITS -3276.800 3276.700 /end CHARACTERISTIC
/begin CHARACTERISTIC AccPed_tiDebAliveDef_C "#SSD Entprellzeit für Lebenderrkennung APP" VALUE 0xC3D84 Kw_Wu16 655350.0 Time_ms 0.00 655350.0 FORMAT "%8.1" /end CHARACTERISTIC
/begin CHARACTERISTIC AccPed_tiDebAliveOk_C "#SSD Entprellzeit für Lebenderrkennung APP" VALUE 0xC3D86 Kw_Wu16 655350.0 Time_ms 0.00 655350.0 FORMAT "%8.1" /end CHARACTERISTIC
/begin CHARACTERISTIC AccPed_tiDebPladrLckDef_C "Entprellzeit für Erkennung APP-Gradient" VALUE 0xC3D88 Kw_Wu16 655350.0 Time_ms 0.00 655350.0 FORMAT "%8.1" /end CHARACTERISTIC
/begin CHARACTERISTIC AccPed_tiDebPladrLckOk_C "#SSD Entprellzeit für Erkennung APP-Gradient" VALUE 0xC3D8A Kw_Wu16 655350.0 Time_ms 0.00 655350.0 FORMAT "%8.1" /end CHARACTERISTIC
/begin CHARACTERISTIC AccPed_drAPPUnFltLim_C "#SSD Schwelle Fahrpedalgradient für Aufhebung der Plausibilitätsprüfung Fahrpedal/Bremse" VALUE 0xC3D8C Kw_Ws16 5000.000 PrcPerSec 0.00 5000.000 FORMAT "%8.3" EXTENDED_LIMITS -20000.00 19999.39 /end CHARACTERISTIC
/begin CHARACTERISTIC AccPed_drLimpMax_C "#SSD Maximaler APP-Gradient im Notfahrbetrieb" VALUE 0xC3D8E Kw_Ws16 5000.000 PrcPerSec 0.00 5000.000 FORMAT "%8.3" EXTENDED_LIMITS -20000.00 19999.39 /end CHARACTERISTIC
/begin CHARACTERISTIC AccPed_facAcsWghMax_C "#SSD High limit value for LIGov specific overrun behavior weighting factor" VALUE 0xC3D90 Kw_Ws16 1.000000 Fact 0.00 1.000000 FORMAT "%8.6" EXTENDED_LIMITS -4.000000 3.999878 /end CHARACTERISTIC
/begin CHARACTERISTIC AccPed_facAcsWghMin_C "#SSD Low limit value for LIGov specific overrun behavior weighting factor" VALUE 0xC3D92 Kw_Ws16 1.000000 Fact 0.00 1.000000 FORMAT "%8.6" EXTENDED_LIMITS -4.000000 3.999878 /end CHARACTERISTIC
/begin CHARACTERISTIC AccPed_facLIOvrBehWgh_C "#SSD Weighting factor for Low Idle overrun behavior" VALUE 0xC3D94 Kw_Ws16 1.000000 Fact 0.00 1.000000 FORMAT "%8.6" EXTENDED_LIMITS -4.000000 3.999878 /end CHARACTERISTIC
/begin CHARACTERISTIC AccPed_drLimUp_C "#SSD positive Rampensteigung bei Erkennung oder Heilung Unplausibilität  PWG-Bremse" VALUE 0xC3D98 Kw_Wu32 799999.999814 RmpPrc 0.00 799999.999814 FORMAT "%13.6" /end CHARACTERISTIC
/begin CHARACTERISTIC AccPed_drLimDwn_C "#SSD negative Rampensteigung bei Unplausibilität PWG-Bremse" VALUE 0xC3D9C Kw_Wu32 799999.999814 RmpPrc 0.00 799999.999814 FORMAT "%13.6" /end CHARACTERISTIC
/begin CHARACTERISTIC AccPed_nErrBrk_C "#SSD erhöhte Leerlaufdrehzahl bei Plausibilitätsfehler" VALUE 0xC3DA0 Kw_Ws16 6000.000 EngN 0.00 6000.000 FORMAT "%8.3" EXTENDED_LIMITS -32768.00 32767.00 /end CHARACTERISTIC
/begin CHARACTERISTIC AccPed_nErr_CUR "#SSD Kennlinie zur Veränderung der Leerlaufdrehzahl in Abhängigkeit des Getriebezustandes bei Plausibilitätsfehler" CURVE 0xC3DA2 Kl_Xs16_Ws16 6000.000 EngN 0.00 6000.000 FORMAT "%8.3" EXTENDED_LIMITS -32768.00 32767.00
 /begin AXIS_DESCR STD_AXIS Gearbx_stGear OneToOne 2 -1.000 6.000 FORMAT "%5.3" EXTENDED_LIMITS -128.0 127.0 DEPOSIT ABSOLUTE /end AXIS_DESCR
/end CHARACTERISTIC
/begin CHARACTERISTIC AccPed_nLimNMR_C "#SSD Drehzahlschwelle für nicht überwachten Betriebsbereich" VALUE 0xC3DAC Kw_Ws16 6000.000 EngN 0.00 6000.000 FORMAT "%8.3" EXTENDED_LIMITS -32768.00 32767.00 /end CHARACTERISTIC
/begin CHARACTERISTIC AccPed_nLim_C "#SSD Drehzahlschwelle für Freigabe Fahrpedalprüfung" VALUE 0xC3DAE Kw_Ws16 6000.000 EngN 0.00 6000.000 FORMAT "%8.3" EXTENDED_LIMITS -32768.00 32767.00 /end CHARACTERISTIC
/begin CHARACTERISTIC AccPed_nPlaAPPBrk_C "#SSD Leerlaufdrehzahl im Falle einer Unplausibilität PWG/Bremse" VALUE 0xC3DB0 Kw_Ws16 6000.000 EngN 0.00 6000.000 FORMAT "%8.3" EXTENDED_LIMITS -32768.00 32767.00 /end CHARACTERISTIC
/begin CHARACTERISTIC AccPed_pBrkHigh_C "#SSD obere Bremsdruckschwelle" VALUE 0xC3DB2 Kw_Wu16 100.0000 Pres_bar 0.00 100.0000 FORMAT "%8.4" EXTENDED_LIMITS 0.00 65535.00 /end CHARACTERISTIC
/begin CHARACTERISTIC AccPed_pBrkLow_C "#SSD untere Bremsdruckschwelle" VALUE 0xC3DB4 Kw_Wu16 100.0000 Pres_bar 0.00 100.0000 FORMAT "%8.4" EXTENDED_LIMITS 0.00 65535.00 /end CHARACTERISTIC
/begin CHARACTERISTIC AccPed_tiPlausBrkDebPos_C "#SSD Entrpellzeit für Fehler bei Unplausibilität AccPed-Bremse" VALUE 0xC3DB6 Kw_Wu16 655350.0 Time_ms 0.00 655350.0 FORMAT "%8.1" /end CHARACTERISTIC
/begin CHARACTERISTIC AccPed_tiPlausBrkDebNeg_C "Entprellzeit Fehlerheilung bei Unplausibilität AccPed-Bremse" VALUE 0xC3DB8 Kw_Wu16 655350.0 Time_ms 0.00 655350.0 FORMAT "%8.1" /end CHARACTERISTIC
/begin CHARACTERISTIC AccPed_rFDC_CUR "curve for sport mode in drive dynamism control" CURVE 0xC3DBA Kl_Xs16_Ws16 100.0000 Prc 0.00 100.0000 FORMAT "%8.4" EXTENDED_LIMITS -400.0000 399.9878
 /begin AXIS_DESCR STD_AXIS AccPed_rChkdVal Prc 16 0.00 100.0000 FORMAT "%8.4" EXTENDED_LIMITS -400.0000 399.9878 DEPOSIT ABSOLUTE /end AXIS_DESCR
/end CHARACTERISTIC
/begin CHARACTERISTIC AccPed_rLimpMax_C "#SSD Maximaler APP-Wert im Notfahrbetrieb" VALUE 0xC3DFC Kw_Ws16 100.0000 Prc 0.00 100.0000 FORMAT "%8.4" EXTENDED_LIMITS -400.0000 399.9878 /end CHARACTERISTIC
/begin CHARACTERISTIC AccPed_drRmpUp_C "Parameter für die Rampenfunktion (Aufwärtsrampe)" VALUE 0xC3E00 Kw_Wu32 799999.999814 RmpPrc 0.00 799999.999814 FORMAT "%13.6" /end CHARACTERISTIC
/begin CHARACTERISTIC AccPed_drRmpDwn_C "Parameter für die Rampenfunktion (Abärtsrampe)" VALUE 0xC3E04 Kw_Wu32 799999.999814 RmpPrc 0.00 799999.999814 FORMAT "%13.6" /end CHARACTERISTIC
/begin CHARACTERISTIC AccPed_rPlaMaxVal_C "#SSD Maximaler APP-Wert bei Plausibilitaetsverletzung" VALUE 0xC3E08 Kw_Ws16 100.0000 Prc 0.00 100.0000 FORMAT "%8.4" EXTENDED_LIMITS -400.0000 399.9878 /end CHARACTERISTIC
/begin CHARACTERISTIC AccPed_rPlaMaxVal_CUR "#SSD bremsdruckabhängiger APP- Ersatzwert bei Plausibilitätsverletzung" CURVE 0xC3E0A Kl_Xs16_Ws16 100.0000 Prc 0.00 100.0000 FORMAT "%8.4" EXTENDED_LIMITS -400.0000 399.9878
 /begin AXIS_DESCR STD_AXIS FrmMng_pBrkSys Pres_bar 6 0.00 100.0000 FORMAT "%8.4" EXTENDED_LIMITS 0.00 65535.00 DEPOSIT ABSOLUTE /end AXIS_DESCR
/end CHARACTERISTIC
/begin CHARACTERISTIC AccPed_rPlaRls_C "APP- Schwelle zur Freigabe der Plausibilitätsprüfung" VALUE 0xC3E24 Kw_Ws16 100.0000 Prc 0.00 100.0000 FORMAT "%8.4" EXTENDED_LIMITS -400.0000 399.9878 /end CHARACTERISTIC
/begin CHARACTERISTIC AccPed_rThPlaus_C "#SSD Schwelle für Erkennung: PWG betätigt" VALUE 0xC3E26 Kw_Ws16 100.0000 Prc 0.00 100.0000 FORMAT "%8.4" EXTENDED_LIMITS -400.0000 399.9878 /end CHARACTERISTIC
/begin CHARACTERISTIC AccPed_rThresPrp_C "#SSD Schwelle zwischen Schub- und Zugbetrieb" VALUE 0xC3E28 Kw_Ws16 100.0000 Prc 0.00 100.0000 FORMAT "%8.4" EXTENDED_LIMITS -400.0000 399.9878 /end CHARACTERISTIC
/begin CHARACTERISTIC AccPed_rZero_C "#SSD PWG-Stellung, unterhalb der Schubbetrieb gelten soll" VALUE 0xC3E2A Kw_Ws16 399.9878 Prc 0.00 399.9878 FORMAT "%8.4" EXTENDED_LIMITS -400.0000 399.9878 /end CHARACTERISTIC
/begin CHARACTERISTIC AccPed_swtAliveDetEna_C "#SSD Schalter um Lebenderkennung zu aktivieren (1: Lebenderkennung aktiv, 0: inaktiev)" VALUE 0xC3E2C Kw_Wu8 1.000 OneToOne 0.00 1.000 FORMAT "%5.3" EXTENDED_LIMITS 0.00 255.0 /end CHARACTERISTIC
/begin CHARACTERISTIC AccPed_swtAppGradEna_C "Schalter zur Aktivierung der Rücksetzbedingung der APP/Bremse-Plausibilisierung durch APP-Aenderung" VALUE 0xC3E2D Kw_Wu8 1.000 OneToOne 0.00 1.000 FORMAT "%5.3" EXTENDED_LIMITS 0.00 255.0 /end CHARACTERISTIC
/begin CHARACTERISTIC AccPed_swtBrkDet_C "Schalter zur Auswahl der Bremssignalerkennung (1: Erkennung durch Ändern des Hauptschalters, 0: durch Wert von BrkCD_stPressed)" VALUE 0xC3E2E Kw_Wu8 1.000 OneToOne 0.00 1.000 FORMAT "%5.3" EXTENDED_LIMITS 0.00 255.0 /end CHARACTERISTIC
/begin CHARACTERISTIC AccPed_swtBrkPres_C "Schalter zur Berücksichtigung des Bremsdrucks (1: Bremsdruck berücksichtigt, 0: Bremsdruck nicht berücksichtigt)" VALUE 0xC3E2F Kw_Wu8 1.000 OneToOne 0.00 1.000 FORMAT "%5.3" EXTENDED_LIMITS 0.00 255.0 /end CHARACTERISTIC
/begin CHARACTERISTIC AccPed_swtDrvBehav_C "Wert = 1 : Der Fahrerwunsch wird nur über ein Fahrverhaltenkennfeld (AccPed_trqEngLow_MAP) ermittelt." VALUE 0xC3E30 Kw_Wu8 1.000 OneToOne 0.00 1.000 FORMAT "%5.3" EXTENDED_LIMITS 0.00 255.0 /end CHARACTERISTIC
/begin CHARACTERISTIC AccPed_swtPlausCheckReqd_C "#SSD Freigabe der Überprüfung auf Unplausibilität (1:Freigabe, 0: keine Freigabe)" VALUE 0xC3E31 Kw_Wu8 1.000 OneToOne 0.00 1.000 FORMAT "%5.3" EXTENDED_LIMITS 0.00 255.0 /end CHARACTERISTIC
/begin CHARACTERISTIC AccPed_swtRstCon_C "#SSD 1: Rücksetzen Unplausibilität auf AccPed ODER Bremse 0:  Rücksetzen Unplausibilität nur auf AccPed" VALUE 0xC3E32 Kw_Wu8 1.000 OneToOne 0.00 1.000 FORMAT "%5.3" EXTENDED_LIMITS 0.00 255.0 /end CHARACTERISTIC
/begin CHARACTERISTIC AccPed_swtVehDynReqd_C "#SSD 1: Berücksichtigung Fahrdynamikeingriffe aktiv, 0: Berücksichtigung Fahrdynamikeingriffe inaktiv" VALUE 0xC3E33 Kw_Wu8 1.000 OneToOne 0.00 1.000 FORMAT "%5.3" EXTENDED_LIMITS 0.00 255.0 /end CHARACTERISTIC
/begin CHARACTERISTIC AccPed_tiDebPlaDet_C "#SSD Entprellzeit für APP/Bremse Plausibilitaetserkennung" VALUE 0xC3E34 Kw_Wu16 655350.0 TimeDeb 0.00 655350.0 FORMAT "%8.1" /end CHARACTERISTIC
/begin CHARACTERISTIC AccPed_tiDebPlaRst_C "#SSD Entprellzeit für APP/Bremse Plausibilisierung ruecksetzen" VALUE 0xC3E36 Kw_Wu16 655350.0 TimeDeb 0.00 655350.0 FORMAT "%8.1" /end CHARACTERISTIC
/begin CHARACTERISTIC AccPed_trqDes_Vector "#SSD Bypass Label, nicht ändern!" VALUE 0xC390C Kw_Wu8 255.0 OneToOne 0.00 255.0 FORMAT "%5.1" /end CHARACTERISTIC
/begin CHARACTERISTIC AccPed_trqDes_Channel "#SSD Bypass Label, nicht ändern!" VALUE 0xC390D Kw_Wu8 255.0 OneToOne 0.00 255.0 FORMAT "%5.1" /end CHARACTERISTIC
/begin CHARACTERISTIC AccPed_trqEngHigh_MAP "Fahrverhaltenkennfeld für Maximalwert des Fahrerwunsches." MAP 0xC3E38 Kf_Xs16_Ys16_Ws16 6553.500 Trq -3276.800 3276.700 FORMAT "%8.3"
 /begin AXIS_DESCR STD_AXIS Eng_nAvrg EngN 16 -32768.00 32767.00 FORMAT "%8.2" DEPOSIT ABSOLUTE /end AXIS_DESCR
 /begin AXIS_DESCR STD_AXIS AccPed_rChkdVal Prc 10 -400.0000 399.9878 FORMAT "%8.4" DEPOSIT ABSOLUTE /end AXIS_DESCR
/end CHARACTERISTIC
/begin CHARACTERISTIC AccPed_trqEngLow_MAP "Fahrverhaltenkennfeld für Minimalwert des Fahrerwunsches." MAP 0xC3FB0 Kf_Xs16_Ys16_Ws16 6553.500 Trq -3276.800 3276.700 FORMAT "%8.3"
 /begin AXIS_DESCR STD_AXIS Eng_nAvrg EngN 16 -32768.00 32767.00 FORMAT "%8.2" DEPOSIT ABSOLUTE /end AXIS_DESCR
 /begin AXIS_DESCR STD_AXIS AccPed_rChkdVal Prc 10 -400.0000 399.9878 FORMAT "%8.4" DEPOSIT ABSOLUTE /end AXIS_DESCR
/end CHARACTERISTIC
/begin CHARACTERISTIC AccPed_trqLIOvrBehOfsH_C "High Offset value for LIGov depended overrun behavior" VALUE 0xC4128 Kw_Ws16 1500.000 Trq -500.0000 1000.000 FORMAT "%8.3" EXTENDED_LIMITS -3276.800 3276.700 /end CHARACTERISTIC
/begin CHARACTERISTIC AccPed_trqLIOvrBehOfsL_C "#SSD Low Offset value for LIGov depended overrun behavior" VALUE 0xC412A Kw_Ws16 1000.000 Trq 0.00 1000.000 FORMAT "%8.3" EXTENDED_LIMITS -3276.800 3276.700 /end CHARACTERISTIC
/begin CHARACTERISTIC AccPed_trqNMRMax_C "#SSD maximale erlaubte Momentenforderung im nicht überwachbaren Bereich des PWG" VALUE 0xC412C Kw_Ws16 13107.00 TrqPrp -6553.600 6553.400 FORMAT "%8.3" /end CHARACTERISTIC
/begin CHARACTERISTIC AccPed_trqPrp_MAP "#SSD Fahrverhaltenkennfeld als Getriebeausgangsmoment für Mastershift Antriebsstrangmanagement" MAP 0xC412E Kf_Xs16_Ys16_Ws16 13107.00 TrqPrp -6553.600 6553.400 FORMAT "%8.3"
 /begin AXIS_DESCR STD_AXIS VSSCD_v Vel 2 -327.6800 327.6700 FORMAT "%8.4" DEPOSIT ABSOLUTE /end AXIS_DESCR
 /begin AXIS_DESCR STD_AXIS AccPed_rChkdVal Prc 2 -400.0000 399.9878 FORMAT "%8.4" DEPOSIT ABSOLUTE /end AXIS_DESCR
/end CHARACTERISTIC
/begin CHARACTERISTIC AccPed_vLim_C "#SSD Geschwindigkeitsschwelle für Freigabe Fahrpedalprüfung" VALUE 0xC4142 Kw_Ws16 300.0000 Vel 0.00 300.0000 FORMAT "%8.4" EXTENDED_LIMITS -327.6800 327.6700 /end CHARACTERISTIC
/begin CHARACTERISTIC AccPed_vVSSmax_C "Maximalwert der Fahrzeuggeschwindigkeit für lineare Interpolation des Fahrerwunschmomentes." VALUE 0xC4144 Kw_Ws16 300.0000 Vel 0.00 300.0000 FORMAT "%8.4" EXTENDED_LIMITS -327.6800 327.6700 /end CHARACTERISTIC
/begin CHARACTERISTIC AccPed_vVSSmin_C "Minimalwert der Fahrzeuggeschwindigkeit für lineare Interpolation des Fahrerwunschmomentes." VALUE 0xC4146 Kw_Ws16 300.0000 Vel 0.00 300.0000 FORMAT "%8.4" EXTENDED_LIMITS -327.6800 327.6700 /end CHARACTERISTIC
/begin CHARACTERISTIC ACCtl_drACAccPedXLow_C "Untere Grenze der Fahrpedaländerung zum Testen der Beschleunigungsbedingung" VALUE 0xC4148 Kw_Ws16 19999.39 PrcPerSec 0.00 19999.39 FORMAT "%8.2" EXTENDED_LIMITS -20000.00 19999.39 /end CHARACTERISTIC
/begin CHARACTERISTIC ACCtl_drACAccPedXHigh_C "Obere Grenze der Fahrpedaländerung zum Testen der Beschleunigungsbedingung" VALUE 0xC414A Kw_Ws16 19999.39 PrcPerSec 0.00 19999.39 FORMAT "%8.2" EXTENDED_LIMITS -20000.00 19999.39 /end CHARACTERISTIC
/begin CHARACTERISTIC ACCtl_ACAccPedYLow_C "Low output of hysteresis for ""Change in Accelerator"". Normally should be 0." VALUE 0xC414C Kw_Ws16 1.000000 OneToOne 0.00 1.000000 FORMAT "%8.6" EXTENDED_LIMITS -32768.00 32767.00 /end CHARACTERISTIC
/begin CHARACTERISTIC ACCtl_ACAccPedYHigh_C "High output of hysteresis for ""Change in Accelerator"". Normally should be 1." VALUE 0xC414E Kw_Ws16 1.000000 OneToOne 0.00 1.000000 FORMAT "%8.6" EXTENDED_LIMITS -32768.00 32767.00 /end CHARACTERISTIC
/begin CHARACTERISTIC ACCtl_nACEngXLow_C "Untere Grenze für ""Motordrehzahl"" für Beschleunigungs-Zustand" VALUE 0xC4150 Kw_Ws16 6000.000 EngN 0.00 6000.000 FORMAT "%8.3" EXTENDED_LIMITS -32768.00 32767.00 /end CHARACTERISTIC
/begin CHARACTERISTIC ACCtl_nACEngXHigh_C "Obere Grenze für ""Motordrehzahl"" für Beschleunigungs-Zustand" VALUE 0xC4152 Kw_Ws16 6000.000 EngN 0.00 6000.000 FORMAT "%8.3" EXTENDED_LIMITS -32768.00 32767.00 /end CHARACTERISTIC
/begin CHARACTERISTIC ACCtl_ACEngYLow_C "Low output for hystersis ""engine speed "" , ( normally should be 0)" VALUE 0xC4154 Kw_Ws16 1.000000 OneToOne 0.00 1.000000 FORMAT "%8.6" EXTENDED_LIMITS -32768.00 32767.00 /end CHARACTERISTIC
/begin CHARACTERISTIC ACCtl_ACEngYHigh_C "High output for Hysteresis for  ""Engine Speed"". Normally should be 1." VALUE 0xC4156 Kw_Ws16 1.000000 OneToOne 0.00 1.000000 FORMAT "%8.6" EXTENDED_LIMITS -32768.00 32767.00 /end CHARACTERISTIC
/begin CHARACTERISTIC ACCtl_nDAEngXLow_C "Untere Grenze für ""Motordrehzahl"" für Anfahr-Zustand" VALUE 0xC4158 Kw_Ws16 6000.000 EngN 0.00 6000.000 FORMAT "%8.3" EXTENDED_LIMITS -32768.00 32767.00 /end CHARACTERISTIC
/begin CHARACTERISTIC ACCtl_nDAEngXHigh_C "Obere Grenze für ""Motordrehzahl"" für Anfahr-Zustand" VALUE 0xC415A Kw_Ws16 6000.000 EngN 0.00 6000.000 FORMAT "%8.3" EXTENDED_LIMITS -32768.00 32767.00 /end CHARACTERISTIC
/begin CHARACTERISTIC ACCtl_DAEngYLow_C "Low output for hystersis ""engine speed"" for drive away condition , ( normally should be 0)" VALUE 0xC415C Kw_Ws16 1.000000 OneToOne 0.00 1.000000 FORMAT "%8.6" EXTENDED_LIMITS -32768.00 32767.00 /end CHARACTERISTIC
/begin CHARACTERISTIC ACCtl_DAEngYHigh_C "High output for hystersis ""engine speed"" for drive away condition, ( normally should be 1)" VALUE 0xC415E Kw_Ws16 1.000000 OneToOne 0.00 1.000000 FORMAT "%8.6" EXTENDED_LIMITS -32768.00 32767.00 /end CHARACTERISTIC
/begin CHARACTERISTIC ACCtl_nQuickPedXLow_C "untere Drehzahlgrenze Sturzgas" VALUE 0xC4160 Kw_Ws16 6000.000 EngN 0.00 6000.000 FORMAT "%8.3" EXTENDED_LIMITS -32768.00 32767.00 /end CHARACTERISTIC
/begin CHARACTERISTIC ACCtl_nQuickPedXHigh_C "obere Drehzahlgrenze Sturzgas" VALUE 0xC4162 Kw_Ws16 6000.000 EngN 0.00 6000.000 FORMAT "%8.3" EXTENDED_LIMITS -32768.00 32767.00 /end CHARACTERISTIC
/begin CHARACTERISTIC ACCtl_QuickPedYLow_C "Low output for hystersis ""quick press accelerator pedal "" , ( normally should be 0)" VALUE 0xC4164 Kw_Ws16 1.000000 OneToOne 0.00 1.000000 FORMAT "%8.6" EXTENDED_LIMITS -32768.00 32767.00 /end CHARACTERISTIC
/begin CHARACTERISTIC ACCtl_QuickPedYHigh_C "High output for hystersis ""quick press accelerator pedal "" , ( normally should be 1)" VALUE 0xC4166 Kw_Ws16 1.000000 OneToOne 0.00 1.000000 FORMAT "%8.6" EXTENDED_LIMITS -32768.00 32767.00 /end CHARACTERISTIC
/begin CHARACTERISTIC ACCtl_rDAAccPedXLow_C "untere Fahrpedalposition für Anfahrzustand" VALUE 0xC4168 Kw_Ws16 100.0000 Prc 0.00 100.0000 FORMAT "%8.4" EXTENDED_LIMITS -400.0000 399.9878 /end CHARACTERISTIC
/begin CHARACTERISTIC ACCtl_rDAAccPedXHigh_C "obere Fahrpedalposition für Anfahrzustand" VALUE 0xC416A Kw_Ws16 100.0000 Prc 0.00 100.0000 FORMAT "%8.4" EXTENDED_LIMITS -400.0000 399.9878 /end CHARACTERISTIC
/begin CHARACTERISTIC ACCtl_DAAccPedYLow_C "Low output for hystersis ""accelerator pedal "" for drive away condition , ( normally should be 0)" VALUE 0xC416C Kw_Ws16 1.000000 OneToOne 0.00 1.000000 FORMAT "%8.6" EXTENDED_LIMITS -32768.00 32767.00 /end CHARACTERISTIC
/begin CHARACTERISTIC ACCtl_DAAccPedYHigh_C "High output for hystersis ""accelerator pedal"" for drive away condition, ( normally should be 1)" VALUE 0xC416E Kw_Ws16 1.000000 OneToOne 0.00 1.000000 FORMAT "%8.6" EXTENDED_LIMITS -32768.00 32767.00 /end CHARACTERISTIC
/begin CHARACTERISTIC ACCtl_stDAGearXLow_C "unterster Gang für Anfahrzustand" VALUE 0xC4170 Kw_Ws16 5.000000 OneToOne 1.000000 6.000000 FORMAT "%8.6" EXTENDED_LIMITS -32768.00 32767.00 /end CHARACTERISTIC
/begin CHARACTERISTIC ACCtl_stDAGearXHigh_C "oberster Gang für Anfahrzustand" VALUE 0xC4172 Kw_Ws16 5.000000 OneToOne 1.000000 6.000000 FORMAT "%8.6" EXTENDED_LIMITS -32768.00 32767.00 /end CHARACTERISTIC
/begin CHARACTERISTIC ACCtl_DAGearYLow_C "Low output for hystersis ""gear information"" for drive away condition , ( normally should be 0)" VALUE 0xC4174 Kw_Ws16 1.000000 OneToOne 0.00 1.000000 FORMAT "%8.6" EXTENDED_LIMITS -32768.00 32767.00 /end CHARACTERISTIC
/begin CHARACTERISTIC ACCtl_DAGearYHigh_C "High output for hystersis ""gear information"" for drive away condition, ( normally should be 1)" VALUE 0xC4176 Kw_Ws16 1.000000 OneToOne 0.00 1.000000 FORMAT "%8.6" EXTENDED_LIMITS -32768.00 32767.00 /end CHARACTERISTIC
/begin CHARACTERISTIC ACCtl_tClntXLow_C "Untere Kühlwassertemperatur für Kühlmitteltemperaturbereich-Bedingung" VALUE 0xC4178 Kw_Ws16 250.0000 Temp_Cels -50.1400 199.8600 FORMAT "%8.4" EXTENDED_LIMITS -3549.940 3003.560 /end CHARACTERISTIC
/begin CHARACTERISTIC ACCtl_tClntXHigh_C "Obere Kühlwassertemperatur für Kühlmitteltemperaturbereich-Bedingung" VALUE 0xC417A Kw_Ws16 250.0000 Temp_Cels -50.1400 199.8600 FORMAT "%8.4" EXTENDED_LIMITS -3549.940 3003.560 /end CHARACTERISTIC
/begin CHARACTERISTIC ACCtl_ClntYLow_C "Low output for hystersis ""coolant temperature "" , ( normally should be 0)" VALUE 0xC417C Kw_Ws16 1.000000 OneToOne 0.00 1.000000 FORMAT "%8.6" EXTENDED_LIMITS -32768.00 32767.00 /end CHARACTERISTIC
/begin CHARACTERISTIC ACCtl_ClntYHigh_C "High output for hystersis ""coolant temperature"", ( normally should be 1)" VALUE 0xC417E Kw_Ws16 1.000000 OneToOne 0.00 1.000000 FORMAT "%8.6" EXTENDED_LIMITS -32768.00 32767.00 /end CHARACTERISTIC
/begin CHARACTERISTIC ACCtl_tiAccMin_C "Mindestabschaltdauer durch Abschaltbedingung Beschleunigung" VALUE 0xC4180 Kw_Wu16 655350.0 Time_ms 0.00 655350.0 FORMAT "%8.1" /end CHARACTERISTIC
/begin CHARACTERISTIC ACCtl_tOilXHigh_C "High hysteresis limit for setting of Gearbox high temperature status" VALUE 0xC4182 Kw_Ws16 250.0000 Temp_Cels -50.14000 199.8600 FORMAT "%8.4" EXTENDED_LIMITS -3549.940 3003.560 /end CHARACTERISTIC
/begin CHARACTERISTIC ACCtl_tOilXLow_C "Low hysteresis limit for setting of Gearbox high temperature status" VALUE 0xC4184 Kw_Ws16 250.0000 Temp_Cels -50.14000 199.8600 FORMAT "%8.4" EXTENDED_LIMITS -3549.940 3003.560 /end CHARACTERISTIC
/begin CHARACTERISTIC ACCtl_vACVehXLow_C "Untere Hysteresegrenze für Fahrzeuggeschwindigkeit bei Beschleunigung" VALUE 0xC4186 Kw_Ws16 300.0000 Vel 0.00 300.0000 FORMAT "%8.4" EXTENDED_LIMITS -327.6800 327.6700 /end CHARACTERISTIC
/begin CHARACTERISTIC ACCtl_vACVehXHigh_C "Obere Hysteresegrenze für Fahrzeuggeschwindigkeit bei Beschleunigung" VALUE 0xC4188 Kw_Ws16 300.0000 Vel 0.00 300.0000 FORMAT "%8.4" EXTENDED_LIMITS -327.6800 327.6700 /end CHARACTERISTIC
/begin CHARACTERISTIC ACCtl_ACVehYLow_C "Low output for hystersis ""vehicle speed "" , ( normally should be 0)" VALUE 0xC418A Kw_Ws16 1.000000 OneToOne 0.00 1.000000 FORMAT "%8.6" EXTENDED_LIMITS -32768.00 32767.00 /end CHARACTERISTIC
/begin CHARACTERISTIC ACCtl_ACVehYHigh_C "High output for hystersis ""vehicle acceleration"", ( normally should be 1)" VALUE 0xC418C Kw_Ws16 1.000000 OneToOne 0.00 1.000000 FORMAT "%8.6" EXTENDED_LIMITS -32768.00 32767.00 /end CHARACTERISTIC
/begin CHARACTERISTIC ACCtl_vDAVehXLow_C "untere Fahrgeschwindigkeit für Anfahrzustand" VALUE 0xC418E Kw_Ws16 299.0000 Vel 1.000000 300.0000 FORMAT "%8.4" EXTENDED_LIMITS -327.6800 327.6700 /end CHARACTERISTIC
/begin CHARACTERISTIC ACCtl_vDAVehXHigh_C "obere Fahrgeschwindigkeit für Anfahrzustand" VALUE 0xC4190 Kw_Ws16 299.0000 Vel 1.000000 300.0000 FORMAT "%8.4" EXTENDED_LIMITS -327.6800 327.6700 /end CHARACTERISTIC
/begin CHARACTERISTIC ACCtl_DAVehYLow_C "Low output for hystersis ""vehicle speed"" for drive away condition , ( normally should be 0)" VALUE 0xC4192 Kw_Ws16 1.000000 OneToOne 0.00 1.000000 FORMAT "%8.6" EXTENDED_LIMITS -32768.00 32767.00 /end CHARACTERISTIC
/begin CHARACTERISTIC ACCtl_DAVehYHigh_C "High output for hystersis ""vehicle speed"" for drive away condition, ( normally should be 1)" VALUE 0xC4194 Kw_Ws16 1.000000 OneToOne 0.00 1.000000 FORMAT "%8.6" EXTENDED_LIMITS -32768.00 32767.00 /end CHARACTERISTIC
/begin CHARACTERISTIC AC_rAdjValDef_C "Standardwert für Abgleich Leistungsanforderung Klimakompressor" VALUE 0xC3CA4 Kw_Ws16 0.00 Fact 1.000000 1.000000 FORMAT "%8.6" EXTENDED_LIMITS -4.000000 3.999878 /end CHARACTERISTIC
/begin CHARACTERISTIC AC_rAdjValMax_C "Maximalwert für Abgleich Leistungsanforderung Klimakompressor" VALUE 0xC3CA6 Kw_Ws16 3.199951 Fact 0.00 3.199951 FORMAT "%8.6" EXTENDED_LIMITS -4.000000 3.999878 /end CHARACTERISTIC
/begin CHARACTERISTIC AC_rAdjValMin_C "Minimalwert für Abgleich Leistungsanforderung Klimakompressor" VALUE 0xC3CA8 Kw_Ws16 3.199951 Fact 0.00 3.199951 FORMAT "%8.6" EXTENDED_LIMITS -4.000000 3.999878 /end CHARACTERISTIC
/begin CHARACTERISTIC AC_rTrans_C "Übersetzung des Klimakompressorantriebs" VALUE 0xC3CAA Kw_Ws16 337.6800 TransR -327.6800 10.00000 FORMAT "%8.4" EXTENDED_LIMITS -327.6800 327.6700 /end CHARACTERISTIC
/begin CHARACTERISTIC AC_tiPT1_C "time to filter" VALUE 0xC3CAC Kw_Wu32 4294.9673 TimeDelay_s 0.0000010000000 4294.9673 FORMAT "%9.4" /end CHARACTERISTIC
/begin MEASUREMENT ACCD_dcycPres "AC Druck für PWM Eingang" SWORD Prc 1 100 -400.0000 399.9878 FORMAT "%8.4" ECU_ADDRESS 0x7F8A06 /end MEASUREMENT
/begin MEASUREMENT ACCD_p "entprellter Klimakompressordruck" SWORD PresAC_hPa 1 100 -65536.00 65534.00 FORMAT "%8.2" ECU_ADDRESS 0x7F8A08 /end MEASUREMENT
/begin MEASUREMENT ACCD_pAna "analoger Klimadruck-Wert" SWORD PresAC_hPa 1 100 -65536.00 65534.00 FORMAT "%8.2" ECU_ADDRESS 0x7F8A0A /end MEASUREMENT
/begin MEASUREMENT ACCD_pAnaLin "linearisierter analog Klimadruck-Wert aus HWK vor Aufruf der Übergangsfunktion" SWORD PresAC_hPa 1 100 -65536.00 65534.00 FORMAT "%8.2" ECU_ADDRESS 0x7F8A0C /end MEASUREMENT
/begin MEASUREMENT ACCD_pPWM "PWM Klimadruckwert" SWORD PresAC_hPa 1 100 -65536.00 65534.00 FORMAT "%8.2" ECU_ADDRESS 0x7F8A0E /end MEASUREMENT
/begin MEASUREMENT ACCD_PresHiThres_mp "Obere Grenze des normalen Sektors AC Druck (über PWM)" SWORD Prc 1 100 -400.0000 399.9878 FORMAT "%8.4" ECU_ADDRESS 0x8FE228 /end MEASUREMENT
/begin MEASUREMENT ACCD_PresLoThres_mp "untere Grenze normaler Sektor AC-Druck (über PWM)" SWORD Prc 1 100 -400.0000 399.9878 FORMAT "%8.4" ECU_ADDRESS 0x8FE22A /end MEASUREMENT
/begin MEASUREMENT ACCD_rDigOut_mp "Digitalausgang Ansteuerung Klimakompressor" SWORD OneToOne 1 100 -32768.00 32767.00 FORMAT "%8.2" ECU_ADDRESS 0x8FE226 /end MEASUREMENT
/begin MEASUREMENT ACCD_stACPresent "Klimaanlage im Auto vorhanden" UBYTE OneToOne 1 100 0.00 255.0 FORMAT "%5.1" ECU_ADDRESS 0x7F87AC /end MEASUREMENT
/begin MEASUREMENT ACCD_stMnSwtDebVal "entprellter Klimaanlagen-Hauptschalter" UBYTE OneToOne 1 100 0.00 255.0 FORMAT "%5.1" ECU_ADDRESS 0x7F87AD /end MEASUREMENT
/begin MEASUREMENT ACCD_swtPresSel "Signalquelle AC Druck (PWM oder ADC)" UBYTE OneToOne 1 100 0.00 255.0 FORMAT "%5.1" ECU_ADDRESS 0x7F87AF /end MEASUREMENT
/begin MEASUREMENT ACCD_trqLim "Externally controlled regulator for AC compressor" SWORD Trq 1 100 -3276.800 3276.700 FORMAT "%8.3" ECU_ADDRESS 0x7F8A10 /end MEASUREMENT
/begin MEASUREMENT ACCD_uRaw "Klimadruck Spannungsrohwert der Analogwerterfassung" SWORD Volt 1 100 -160156.4 160151.5 FORMAT "%8.1" ECU_ADDRESS 0x7F8A12 /end MEASUREMENT
/begin MEASUREMENT AccPed_facAcsWgh_mp "weighting factor for accessories overrun torque" SWORD Fact 1 100 -4.000000 3.999878 FORMAT "%8.6" ECU_ADDRESS 0x8FE234 /end MEASUREMENT
/begin MEASUREMENT AccPed_nErr_mp "Leerlaufsolldrehzahl bei Plausibilitätsfehler" SWORD EngN 1 100 -32768.00 32767.00 FORMAT "%8.2" ECU_ADDRESS 0x8FE236 /end MEASUREMENT
/begin MEASUREMENT AccPed_nMin "Leerlaufsolldrehzahl PWG" SWORD EngN 1 100 -32768.00 32767.00 FORMAT "%8.2" ECU_ADDRESS 0x7F8AA0 /end MEASUREMENT
/begin MEASUREMENT AccPed_rAPPunLim_mp "APP-Wert ohne Begrenzung durch APP-Lebenderkennung" SWORD Prc 1 100 -400.0000 399.9878 FORMAT "%8.4" ECU_ADDRESS 0x8FE252 /end MEASUREMENT
/begin MEASUREMENT AccPed_rChkdVal "PWG-Stellung nach Überwachung" SWORD Prc 1 100 -400.0000 399.9878 FORMAT "%8.4" ECU_ADDRESS 0x7F8AA2 /end MEASUREMENT
/begin MEASUREMENT AccPed_rDes_mp "PWG Position" SWORD Prc 1 100 -400.0000 399.9878 FORMAT "%8.4" ECU_ADDRESS 0x8FE22C /end MEASUREMENT
/begin MEASUREMENT AccPed_rLead_mp "PWG1 ungefilterter Positionswert abhängig ob Sport mode aktiv oder nicht" SWORD Prc 1 100 -400.0000 399.9878 FORMAT "%8.4" ECU_ADDRESS 0x8FE238 /end MEASUREMENT
/begin MEASUREMENT AccPed_rPlaMaxVal_mp "bremsdruckabhängiger APP Ersatzwert" SWORD Prc 1 100 -400.0000 399.9878 FORMAT "%8.4" ECU_ADDRESS 0x8FE254 /end MEASUREMENT
/begin MEASUREMENT AccPed_rPla_mp "Begrenzter APP-Wert nach Plausibilitätsprüfung APP/Bremse" SWORD Prc 1 100 -400.0000 399.9878 FORMAT "%8.4" ECU_ADDRESS 0x8FE256 /end MEASUREMENT
/begin MEASUREMENT AccPed_rThresPrp "Schwelle zwischen Schub- und Zugbetrieb" SWORD Prc 1 100 -400.0000 399.9878 FORMAT "%8.4" ECU_ADDRESS 0x7F8AA4 /end MEASUREMENT
/begin MEASUREMENT AccPed_rZero "PWG-Stellung, unterhalb der Schubbetrieb gelten soll" SWORD Prc 1 100 -400.0000 399.9878 FORMAT "%8.4" ECU_ADDRESS 0x7F8AA6 /end MEASUREMENT
/begin MEASUREMENT AccPed_stAPPalive "Status der APP-Lebenderkennung" UBYTE OneToOne 1 100 0.00 255.0 FORMAT "%5.1" ECU_ADDRESS 0x7F87CD /end MEASUREMENT
/begin MEASUREMENT AccPed_stError "Fehlerzustand in AccPed" UBYTE OneToOne 1 100 0.00 255.0 FORMAT "%5.1" ECU_ADDRESS 0x7F87CE /end MEASUREMENT
/begin MEASUREMENT AccPed_stPlaAPPBrk "Status der Plausibilitätsprüfung APP/Bremse" UBYTE OneToOne 1 100 0.00 255.0 FORMAT "%5.1" ECU_ADDRESS 0x7F87CF /end MEASUREMENT
/begin MEASUREMENT AccPed_stPlaAPPBrkDet_mp "Status der Erkennung auf Plausibilitätsverletzung APP/Bremse" UBYTE OneToOne 1 100 0.00 255.0 FORMAT "%5.1" ECU_ADDRESS 0x8FE258 /end MEASUREMENT
/begin MEASUREMENT AccPed_stPlaAPPBrkRst_mp "Status Rücksetzen einer Plausibilitätsverletzung APP/Bremse" UBYTE OneToOne 1 100 0.00 255.0 FORMAT "%5.1" ECU_ADDRESS 0x8FE259 /end MEASUREMENT
/begin MEASUREMENT AccPed_trqDes "Fahrerwunsch Rohwert" SWORD TrqPrp 1 100 -6553.600 6553.400 FORMAT "%8.3" ECU_ADDRESS 0x7F8AA8 /end MEASUREMENT
/begin MEASUREMENT AccPed_trqDesDrvDem_mp "Rohwert Fahrerwunsch nach Überlagerung von Zug- und Schubbeitrag" SWORD TrqPrp 1 100 -6553.600 6553.400 FORMAT "%8.3" ECU_ADDRESS 0x8FE22E /end MEASUREMENT
/begin MEASUREMENT AccPed_trqDesOvrRun "Fahrerwunsch Schubbetrieb für Sollwert" SWORD TrqPrp 1 100 -6553.600 6553.400 FORMAT "%8.3" ECU_ADDRESS 0x7F8AAA /end MEASUREMENT
/begin MEASUREMENT AccPed_trqDesOvrRunAPP_mp "APP - specific desired overrun torque" SWORD TrqPrp 1 100 -6553.600 6553.400 FORMAT "%8.3" ECU_ADDRESS 0x8FE230 /end MEASUREMENT
/begin MEASUREMENT AccPed_trqDesPull "Fahrerwunsch Zugbetrieb für Sollwert" SWORD TrqPrp 1 100 -6553.600 6553.400 FORMAT "%8.3" ECU_ADDRESS 0x7F8AAC /end MEASUREMENT
/begin MEASUREMENT AccPed_trqDesUnLim_mp "Fahrerwunsch Sollwert vor Begrenzung" SWORD TrqPrp 1 100 -6553.600 6553.400 FORMAT "%8.3" ECU_ADDRESS 0x8FE232 /end MEASUREMENT
/begin MEASUREMENT AccPed_trqEngDes_mp "Fahrermomentenwunsch nach linearer Interpolation und Beschränkung." SWORD TrqPrp 1 100 -6553.600 6553.400 FORMAT "%8.3" ECU_ADDRESS 0x8FE23A /end MEASUREMENT
/begin MEASUREMENT AccPed_trqEngHighDes_mp "Maximalwert des Fahrerwunsches" SWORD Trq 1 100 -3276.800 3276.700 FORMAT "%8.3" ECU_ADDRESS 0x8FE23C /end MEASUREMENT
/begin MEASUREMENT AccPed_trqEngHighLead_mp "Maximalwert des Fahrerwunsches (Lead-Pfad)" SWORD Trq 1 100 -3276.800 3276.700 FORMAT "%8.3" ECU_ADDRESS 0x8FE23E /end MEASUREMENT
/begin MEASUREMENT AccPed_trqEngLead_mp "Fahrermomentenwunsch nach linearer Interpolation und Beschränkung (Lead-Pfad)" SWORD TrqPrp 1 100 -6553.600 6553.400 FORMAT "%8.3" ECU_ADDRESS 0x8FE240 /end MEASUREMENT
/begin MEASUREMENT AccPed_trqEngLinIntDes_Ipoed_mp "In Abhängigkeit der Fahrzeuggeschwindigkeit Interpolierter Wert des Fahrerwunsches." SWORD Trq 1 100 -3276.800 3276.700 FORMAT "%8.3" ECU_ADDRESS 0x8FE242 /end MEASUREMENT
/begin MEASUREMENT AccPed_trqEngLinIntLead_Ipoed_mp "In Abhängigkeit der Fahrzeuggeschwindigkeit Interpolierter Wert des Fahrerwunsches (Lead-Pfad)." SWORD Trq 1 100 -3276.800 3276.700 FORMAT "%8.3" ECU_ADDRESS 0x8FE244 /end MEASUREMENT
/begin MEASUREMENT AccPed_trqEngLowDes_mp "Minalwert des Fahrerwunsches" SWORD Trq 1 100 -3276.800 3276.700 FORMAT "%8.3" ECU_ADDRESS 0x8FE246 /end MEASUREMENT
/begin MEASUREMENT AccPed_trqEngLowLead_mp "Minimalwert des Fahrerwunsches (Lead-Pfad)" SWORD Trq 1 100 -3276.800 3276.700 FORMAT "%8.3" ECU_ADDRESS 0x8FE248 /end MEASUREMENT
/begin MEASUREMENT AccPed_trqLead "Vorhaltmoment des Fahrpedals (schneller Fahrerwunsch)" SWORD TrqPrp 1 100 -6553.600 6553.400 FORMAT "%8.3" ECU_ADDRESS 0x7F8AB0 /end MEASUREMENT
/begin MEASUREMENT AccPed_trqLeadDrvDem_mp "Rohwert Fahrerwunschvorhalt nach Überlagerung von Zug- und Schubbeitrag" SWORD TrqPrp 1 100 -6553.600 6553.400 FORMAT "%8.3" ECU_ADDRESS 0x8FE24A /end MEASUREMENT
/begin MEASUREMENT AccPed_trqLeadOvrRun "Fahrerwunsch Schubbetrieb für Vorhaltewert" SWORD TrqPrp 1 100 -6553.600 6553.400 FORMAT "%8.3" ECU_ADDRESS 0x7F8AB2 /end MEASUREMENT
/begin MEASUREMENT AccPed_trqLeadOvrRunAPP_mp "lead overrun torque" SWORD TrqPrp 1 100 -6553.600 6553.400 FORMAT "%8.3" ECU_ADDRESS 0x8FE24C /end MEASUREMENT
/begin MEASUREMENT AccPed_trqLeadPull_mp "Fahrerwunsch Zugbetrieb für Vorhaltewert" SWORD TrqPrp 1 100 -6553.600 6553.400 FORMAT "%8.3" ECU_ADDRESS 0x8FE24E /end MEASUREMENT
/begin MEASUREMENT AccPed_trqLeadUnLim_mp "Fahrerwunsch Vorhalt vor Begrenzung" SWORD TrqPrp 1 100 -6553.600 6553.400 FORMAT "%8.3" ECU_ADDRESS 0x8FE250 /end MEASUREMENT
/begin MEASUREMENT AccPed_trqLILtd "begrenztes LIGov Moment von AccPed" SWORD TrqPrp 1 100 -6553.600 6553.400 FORMAT "%8.3" ECU_ADDRESS 0x7F8AAE /end MEASUREMENT
/begin MEASUREMENT AccPed_trqOvrRunLIGov "LIGov specific overrun torque" SWORD TrqPrp 1 100 -6553.600 6553.400 FORMAT "%8.3" ECU_ADDRESS 0x7F8AB4 /end MEASUREMENT
/begin FUNCTION ac ""
 /begin DEF_CHARACTERISTIC AC_rAdjValDef_C AC_rAdjValMax_C AC_rAdjValMin_C AC_rTrans_C AC_tiPT1_C /end DEF_CHARACTERISTIC
/end FUNCTION
/begin FUNCTION accd "" /end FUNCTION
/begin FUNCTION accd_actrout "" /begin DEF_CHARACTERISTIC ACCD_trqLim_C /end DEF_CHARACTERISTIC /end FUNCTION
/begin FUNCTION accd_actrout_msg "" /begin OUT_MEASUREMENT ACCD_trqLim /end OUT_MEASUREMENT /end FUNCTION
/begin FUNCTION accd_actrout_uic "" /end FUNCTION
/begin FUNCTION accd_cmpr ""
 /begin DEF_CHARACTERISTIC ACCD_ctPwrStgOnMax_C ACCD_DebExcTempDef_C ACCD_DebExcTempOk_C ACCD_DebNoLoadDef_C ACCD_DebNoLoadOk_C ACCD_DebShortCircBatDef_C ACCD_DebShortCircBatOk_C ACCD_DebShortCircGndDef_C ACCD_DebShortCircGndOk_C ACCD_numDia_C ACCD_numDioOut_C ACCD_stDigInvOut_C ACCD_stPwrStgActv_C ACCD_stPwrStgDia_C ACCD_stSPICtl_C ACCD_tiBtwTst_C ACCD_tiPwrStgOn_C /end DEF_CHARACTERISTIC
/end FUNCTION
/begin FUNCTION accd_cmpr_uic "" /begin OUT_MEASUREMENT ACCD_rDigOut_mp /end OUT_MEASUREMENT /end FUNCTION
/begin FUNCTION accd_press ""
 /begin DEF_CHARACTERISTIC ACCD_uSRCMin_C ACCD_uSRCMax_C ACCD_pAnaLin_CUR ACCD_dcycPresSensorThres_C ACCD_dcycPWMThres_C ACCD_DebSRCHighDef_C ACCD_DebSRCHighOk_C ACCD_DebSRCLowDef_C ACCD_DebSRCLowOk_C ACCD_nEngLowLim_C ACCD_numAdc_C ACCD_pPresLin_CUR ACCD_debPresDef_C ACCD_debPresOk_C ACCD_PresPwmInInv_C ACCD_PresPwmInMinPer_C ACCD_PresPwmInMaxPer_C ACCD_dcycPresPwmInMin_C ACCD_dcycPresPwmInMax_C ACCD_dtRmpSlpUp_C ACCD_dtRmpSlpDwn_C ACCD_swtPresSelVal_C ACCD_swtPresSelType_C ACCD_tAirLowLim_C ACCD_stSensIDWord_C ACCD_pDfl_C /end DEF_CHARACTERISTIC
 /begin IN_MEASUREMENT ACCD_dcycPres ACCD_uRaw /end IN_MEASUREMENT
/end FUNCTION
/begin FUNCTION accd_press_msg ""
 /begin OUT_MEASUREMENT ACCD_dcycPres ACCD_p ACCD_pAna ACCD_pAnaLin ACCD_pPWM ACCD_swtPresSel ACCD_uRaw /end OUT_MEASUREMENT
/end FUNCTION
/begin FUNCTION accd_press_uic "" /begin OUT_MEASUREMENT ACCD_PresHiThres_mp ACCD_PresLoThres_mp /end OUT_MEASUREMENT /end FUNCTION
/begin FUNCTION accd_swtin ""
 /begin DEF_CHARACTERISTIC ACCD_DebNplDef_C ACCD_DebNplOK_C ACCD_DebSigDef_C ACCD_DebSigOk_C ACCD_tiKLIDeb_C /end DEF_CHARACTERISTIC
/end FUNCTION
/begin FUNCTION accd_swtin_msg "" /begin OUT_MEASUREMENT ACCD_stACPresent ACCD_stMnSwtDebVal /end OUT_MEASUREMENT /end FUNCTION
/begin FUNCTION accd_uic "" /end FUNCTION
/begin FUNCTION accd_var "" /end FUNCTION
/begin FUNCTION accd_var_msg "" /end FUNCTION
/begin FUNCTION accped "Fahrpedal"
 /begin DEF_CHARACTERISTIC AccPed_tiDebAliveDef_C AccPed_tiDebAliveOk_C AccPed_tiDebPladrLckDef_C AccPed_tiDebPladrLckOk_C AccPed_drAPPUnFltLim_C AccPed_drLimpMax_C AccPed_facAcsWghMax_C AccPed_facAcsWghMin_C AccPed_facLIOvrBehWgh_C AccPed_drLimUp_C AccPed_drLimDwn_C AccPed_nErrBrk_C AccPed_nErr_CUR AccPed_nLimNMR_C AccPed_nLim_C AccPed_nPlaAPPBrk_C AccPed_pBrkHigh_C AccPed_pBrkLow_C AccPed_tiPlausBrkDebPos_C AccPed_tiPlausBrkDebNeg_C AccPed_rFDC_CUR AccPed_rLimpMax_C AccPed_drRmpUp_C AccPed_drRmpDwn_C AccPed_rPlaMaxVal_C AccPed_rPlaMaxVal_CUR AccPed_rPlaRls_C AccPed_rThPlaus_C AccPed_rThresPrp_C AccPed_rZero_C AccPed_swtAliveDetEna_C AccPed_swtAppGradEna_C AccPed_swtBrkDet_C AccPed_swtBrkPres_C AccPed_swtDrvBehav_C AccPed_swtPlausCheckReqd_C AccPed_swtRstCon_C AccPed_swtVehDynReqd_C AccPed_tiDebPlaDet_C AccPed_tiDebPlaRst_C AccPed_trqEngHigh_MAP AccPed_trqEngLow_MAP AccPed_trqLIOvrBehOfsH_C AccPed_trqLIOvrBehOfsL_C AccPed_trqNMRMax_C AccPed_trqPrp_MAP AccPed_vLim_C AccPed_vVSSmax_C AccPed_vVSSmin_C /end DEF_CHARACTERISTIC
 /begin IN_MEASUREMENT AccPed_rChkdVal Eng_nAvrg FrmMng_pBrkSys Gearbx_stGear VSSCD_v /end IN_MEASUREMENT
/end FUNCTION
/begin FUNCTION accped_drvdemlead_uic ""
 /begin OUT_MEASUREMENT AccPed_facAcsWgh_mp AccPed_nErr_mp AccPed_rLead_mp AccPed_trqEngDes_mp AccPed_trqEngHighDes_mp AccPed_trqEngHighLead_mp AccPed_trqEngLead_mp AccPed_trqEngLinIntDes_Ipoed_mp AccPed_trqEngLinIntLead_Ipoed_mp AccPed_trqEngLowDes_mp AccPed_trqEngLowLead_mp AccPed_trqLeadDrvDem_mp AccPed_trqLeadOvrRunAPP_mp AccPed_trqLeadPull_mp AccPed_trqLeadUnLim_mp /end OUT_MEASUREMENT
/end FUNCTION
/begin FUNCTION accped_drvdem_uic "" /begin DEF_CHARACTERISTIC AccPed_trqDes_Vector AccPed_trqDes_Channel /end DEF_CHARACTERISTIC
 /begin OUT_MEASUREMENT AccPed_rDes_mp AccPed_trqDesDrvDem_mp AccPed_trqDesOvrRunAPP_mp AccPed_trqDesUnLim_mp /end OUT_MEASUREMENT
/end FUNCTION
/begin FUNCTION accped_msg ""
 /begin OUT_MEASUREMENT AccPed_nMin AccPed_rChkdVal AccPed_rThresPrp AccPed_rZero AccPed_stAPPalive AccPed_stError AccPed_stPlaAPPBrk AccPed_trqDes AccPed_trqDesOvrRun AccPed_trqDesPull AccPed_trqLead AccPed_trqLeadOvrRun AccPed_trqLILtd AccPed_trqOvrRunLIGov /end OUT_MEASUREMENT
/end FUNCTION
/begin FUNCTION accped_uic ""
 /begin OUT_MEASUREMENT AccPed_rAPPunLim_mp AccPed_rPlaMaxVal_mp AccPed_rPla_mp AccPed_stPlaAPPBrkDet_mp AccPed_stPlaAPPBrkRst_mp /end OUT_MEASUREMENT
/end FUNCTION
/begin FUNCTION acctl_hys "Abschaltbedingungen des Klimakompressors"
 /begin DEF_CHARACTERISTIC ACCtl_drACAccPedXLow_C ACCtl_drACAccPedXHigh_C ACCtl_ACAccPedYLow_C ACCtl_ACAccPedYHigh_C ACCtl_nACEngXLow_C ACCtl_nACEngXHigh_C ACCtl_ACEngYLow_C ACCtl_ACEngYHigh_C ACCtl_nDAEngXLow_C ACCtl_nDAEngXHigh_C ACCtl_DAEngYLow_C ACCtl_DAEngYHigh_C ACCtl_nQuickPedXLow_C ACCtl_nQuickPedXHigh_C ACCtl_QuickPedYLow_C ACCtl_QuickPedYHigh_C ACCtl_rDAAccPedXLow_C ACCtl_rDAAccPedXHigh_C ACCtl_DAAccPedYLow_C ACCtl_DAAccPedYHigh_C ACCtl_stDAGearXLow_C ACCtl_stDAGearXHigh_C ACCtl_DAGearYLow_C ACCtl_DAGearYHigh_C ACCtl_tClntXLow_C ACCtl_tClntXHigh_C ACCtl_ClntYLow_C ACCtl_ClntYHigh_C ACCtl_tiAccMin_C ACCtl_tOilXHigh_C ACCtl_tOilXLow_C ACCtl_vACVehXLow_C ACCtl_vACVehXHigh_C ACCtl_ACVehYLow_C ACCtl_ACVehYHigh_C ACCtl_vDAVehXLow_C ACCtl_vDAVehXHigh_C ACCtl_DAVehYLow_C ACCtl_DAVehYHigh_C /end DEF_CHARACTERISTIC
/end FUNCTION
/begin FUNCTION acctl_hys_msg "" /end FUNCTION
/begin COMPU_METHOD EngN "Motordrehzahl" RAT_FUNC "%6.2" "rpm" COEFFS 0 1 0 0 0 1 /end COMPU_METHOD
/begin COMPU_METHOD Fact "Faktor mit Auflösung 1 / 8192, hauptsächlich für einen Faktorenbereich 0...1 verwendet" RAT_FUNC "%6.5" "-" COEFFS 0 8192 0 0 0 1 /end COMPU_METHOD
/begin COMPU_METHOD NumPinAdc "verbale Umrechnung für ADC Signale" TAB_VERB "%6.3" "-" COMPU_TAB_REF NumPinAdc /end COMPU_METHOD
/begin COMPU_VTAB NumPinAdc "verbale Umrechnung für ADC Signale" TAB_VERB 27 0 "Water_Temperature_Sensor_182" 1 "Intake_Air_Temperature_Sensor_157" 2 "Charge_Air_Temperature_Sensor_183" 3 "Exhaust_Temperature_Sensor_2_134" 4 "Exhaust_Temperature_Sensor_1_158" 5 "1st_APP_Sensor_252" 6 "2nd_APP_Sensor_239" 7 "ADC_REF" 8 "Boost_Pressure_Sensor_154" 9 "Atmospheric_Pressure_Sensor" 10 "Battery_Voltage_Sensor" 11 "Rail_Pressure_Sensor_156" 12 "Rail_Pressure_Peak_Value_156" 13 "Booster_Voltage_Sensor" 14 "Current_MeUn_Sensor" 15 "Current_PCV_Sensor" 16 "Voltage_Bank_1" 17 "Voltage_Bank_2" 18 "Pressure_Upstream_Particle_Filter_159" 19 "Engine_Oil_Pressure_110" 20 "Temperature_ECU_PCB" 21 "Voltage_Lambda_Ua" 22 "Voltage_Lambda_Ri" 23 "EMCCD_Current_Governor1_124" 24 "EMCCD_Current_Governor2_121" 25 "ADC_DUMMY_NOT_USED" 26 "ADC_DUMMY_A_NOT_USED" /end COMPU_VTAB
/begin COMPU_METHOD NumPinDia "Verbale Umrechnung für Diagnose Signale" TAB_VERB "%6.3" "-" COMPU_TAB_REF NumPinDia /end COMPU_METHOD
/begin COMPU_VTAB NumPinDia "Verbale Umrechnung für Diagnose Signale" TAB_VERB 28 0 "CJ945_Diagnostic_Signal" 1 "AC_Compressor_DiaSig" 2 "Fuel_Pump_Diagnostic_Signal_232" 3 "Starter_234" 4 "Oil_Pressure_Lamp_Switch_245" 5 "EGRClg_Byp_Diagnostic_Signal_123" 6 "Ebox_Fan_Actuator_Diagnostic_Signal_219" 7 "Shuttr_Actuator_Diagnostic_Signal_231" 8 "Twostage_TurboLoading_SW_DiaSig" 9 "DIO_OUT_DIAGNOSTIC_DUMMY_NOT_USED" 10 "Alternator" 11 "Boost_Pressure_Actuator_Diagnostic_Signal_193" 12 "EGR_Actuator_Diagnostic_Signal_194" 13 "1st_Pressure_Control_Valve_Diagnostic_Signal_172" 14 "2nd_Pressure_Control_Valve_Diagnostic_Signal_172" 15 "1st_Metering_Unit_Diagnostic_Signal_171" 16 "2nd_Metering_Unit_Diagnostic_Signal_171" 17 "Variable_Swirl_Actuator_Diagnostic_Signal_195" 18 "FAN_240" 19 "Add_On_Heater_244" 20 "EngM_Bearing_Actuator_Diagnostic_Signal_124" 21 "EngM_Bearing_Actuator_Diagnostic_Signal_121" 22 "Throttle_Valve_Diagnostic_Signal_196" 23 "Low pressure stage BPA_Diagnostic_Signal_117" 24 "PWM_DIAGNOSTIC_DUMMY_NOT_USED" 25 "1st_Sensor_Supply_Voltage_DiaSig" 26 "2nd_Sensor_Supply_Voltage_DiaSig" 27 "3rd_Sensor_Supply_Voltage_DiaSig" /end COMPU_VTAB
/begin COMPU_METHOD NumPinDioOut "Verbale Umrechnung für Digitalausgang Signale" TAB_VERB "%6.3" "-" COMPU_TAB_REF NumPinDioOut /end COMPU_METHOD
/begin COMPU_VTAB NumPinDioOut "Verbale Umrechnung für Digitalausgang Signale" TAB_VERB 12 0 "Main_Relay_220(144)" 1 "AC_Compressor" 2 "Fuel_Pump_232" 3 "Starter_234" 4 "OPS_Lamp_245" 5 "EGRClg_Byp_123" 6 "Ebox_Fan_Actuator_219" 7 "Shuttr_Actuator_Digital_231" 8 "STATREG_PSOFF_Bit" 9 "Twostage_TurboLoading_120" 10 "TD_Signal_253" 11 "DIO_OUT_DUMMY_NOT_USED" /end COMPU_VTAB
/begin COMPU_METHOD OneToOne "eins zu eins (physikalischer Wert ist gleich dem internen Wert)" RAT_FUNC "%6.2" "-" COEFFS 0 1 0 0 0 1 /end COMPU_METHOD
/begin COMPU_METHOD Period "Periodendauer" RAT_FUNC "%6.3" "ms" COEFFS 0 10 0 0 0 1 /end COMPU_METHOD
/begin COMPU_METHOD Prc "Prozent, gleiche interne Auflösung wie Fact, aber Darstellung in Prozent (0...100%)" RAT_FUNC "%6.4" "%" COEFFS 0 81.92 0 0 0 1 /end COMPU_METHOD
/begin COMPU_METHOD PrcPerSec "Prozentänderung pro Sekunde für 20ms-Tasks" RAT_FUNC "%6.3" "%/s" COEFFS 0 1.6384 0 0 0 1 /end COMPU_METHOD
/begin COMPU_METHOD PresAC_hPa "Druck (Klimatisierung) angezeigt in [hPa]" RAT_FUNC "%6.2" "hPa" COEFFS 0 0.5 0 0 0 1 /end COMPU_METHOD
/begin COMPU_METHOD Pres_bar "Druck (angezeigt in bar)" RAT_FUNC "%6.2" "bar" COEFFS 0 1 0 0 0 1 /end COMPU_METHOD
/begin COMPU_METHOD RmpPrc "Prozent Rampengradient" RAT_FUNC "%6.5" "%/s" COEFFS 0 5368.70912 0 0 0 1 /end COMPU_METHOD
/begin COMPU_METHOD RmpPresAC_hPa "Rampenanstieg für Klimaanlagendruck angezeigt in [hPa/s]" RAT_FUNC "%6.4" "hPa/s" COEFFS 0 32.768 0 0 0 1 /end COMPU_METHOD
/begin COMPU_METHOD Temp_Cels "Temperatur dargestellt in °C (gleiche interne Darstellung wie Temp_Kelv)" RAT_FUNC "%6.1" "deg C" COEFFS 0 10 2731.4 0 0 1 /end COMPU_METHOD
/begin COMPU_METHOD TimeDeb "Entprellzeit in Millisekunden für Libraryfunktion Debounce" RAT_FUNC "%6.1" "ms" COEFFS 0 0.1 0 0 0 1 /end COMPU_METHOD
/begin COMPU_METHOD TimeDelay_s "Zeitkonstante T1 (in s) für PT1, DT1, etc." RAT_FUNC "%9.3" "s" COEFFS 0 0 1 0 0.00023283064365387 0 /end COMPU_METHOD
/begin COMPU_METHOD Time_ms "Zeit in ms für Fehlerentprellung (DSM) und SW-Timer" RAT_FUNC "%6.1" "ms" COEFFS 0 0.1 0 0 0 1 /end COMPU_METHOD
/begin COMPU_METHOD TransR "Übersetzungsverhältnis (Getriebe etc.)" RAT_FUNC "%6.4" "-" COEFFS 0 100 0 0 0 1 /end COMPU_METHOD
/begin COMPU_METHOD Trq "Motormoment" RAT_FUNC "%6.3" "Nm" COEFFS 0 10 0 0 0 1 /end COMPU_METHOD
/begin COMPU_METHOD TrqPrp "Vortriebsmoment" RAT_FUNC "%6.3" "Nm" COEFFS 0 5 0 0 0 1 /end COMPU_METHOD
/begin COMPU_METHOD Vel "Fahrzeuggeschwindigkeit, gleiche interne Auflösung wie Vel_SI" RAT_FUNC "%6.4" "km/h" COEFFS 0 100 0 0 0 1 /end COMPU_METHOD
/begin COMPU_METHOD Volt "Spannung in V (von ADC)" RAT_FUNC "%6.2" "mV" COEFFS 0 0.2046 0 0 0 1 /end COMPU_METHOD
/begin RECORD_LAYOUT Kf_Xs16_Ys16_Ws16 NO_AXIS_PTS_X 1 SWORD NO_AXIS_PTS_Y 2 SWORD AXIS_PTS_X 3 SWORD INDEX_INCR DIRECT AXIS_PTS_Y 4 SWORD INDEX_INCR DIRECT FNC_VALUES 5 SWORD COLUMN_DIR DIRECT /end RECORD_LAYOUT
/begin RECORD_LAYOUT Kl_Xs16_Ws16 NO_AXIS_PTS_X 1 SWORD AXIS_PTS_X 2 SWORD INDEX_INCR DIRECT FNC_VALUES 3 SWORD COLUMN_DIR DIRECT /end RECORD_LAYOUT
/begin RECORD_LAYOUT Kw_Ws16 FNC_VALUES 1 SWORD COLUMN_DIR DIRECT /end RECORD_LAYOUT
/begin RECORD_LAYOUT Kw_Wu16 FNC_VALUES 1 UWORD COLUMN_DIR DIRECT /end RECORD_LAYOUT
/begin RECORD_LAYOUT Kw_Wu32 FNC_VALUES 1 ULONG COLUMN_DIR DIRECT /end RECORD_LAYOUT
/begin RECORD_LAYOUT Kw_Wu8 FNC_VALUES 1 UBYTE COLUMN_DIR DIRECT /end RECORD_LAYOUT
/end MODULE
/end PROJECT
