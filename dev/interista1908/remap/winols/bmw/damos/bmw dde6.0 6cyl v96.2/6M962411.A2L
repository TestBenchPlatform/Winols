ASAP2_VERSION 1 3
/begin PROJECT P411 "BMW DDE6.0 6-Zylinder V96.2 14.10.2004"
/begin HEADER "" VERSION "V96.2_6Z" PROJECT_NO P411 /end HEADER
/begin MODULE DIM ""
/begin MOD_COMMON "" BYTE_ORDER MSB_FIRST ALIGNMENT_BYTE 1 ALIGNMENT_WORD 2 ALIGNMENT_LONG 4 ALIGNMENT_FLOAT32_IEEE 4 /end MOD_COMMON
/begin CHARACTERISTIC FrmMng_ACCSelfRec_C "Switch to disable/enable ACC self recognition" VALUE 0xD8D80 Kw_Wu8 1.000 OneToOne 0.00 1.000 FORMAT "%5.3" EXTENDED_LIMITS 0.00 255.0 /end CHARACTERISTIC
/begin CHARACTERISTIC FrmMng_ACSelfRec_C "Selbsterkennungsschalter für Klimaanlage" VALUE 0xD8D81 Kw_Wu8 1.000 OneToOne 0.00 1.000 FORMAT "%5.3" EXTENDED_LIMITS 0.00 255.0 /end CHARACTERISTIC
/begin CHARACTERISTIC FrmMng_aDirectDef_C "Defektwert für FrmMng_aDirectDef_C" VALUE 0xD8D82 Kw_Ws16 65.53500 Acc -32.76800 32.76700 FORMAT "%8.5" /end CHARACTERISTIC
/begin CHARACTERISTIC FrmMng_AFSSelfRec_C "Switch for enabling self recognition of AFS" VALUE 0xD8D84 Kw_Wu8 1.000 OneToOne 0.00 1.000 FORMAT "%5.3" EXTENDED_LIMITS 0.00 255.0 /end CHARACTERISTIC
/begin CHARACTERISTIC FrmMng_ARSSelfRec_C "Switch to disable ARS recognition" VALUE 0xD8D85 Kw_Wu8 1.000 OneToOne 0.00 1.000 FORMAT "%5.3" EXTENDED_LIMITS 0.00 255.0 /end CHARACTERISTIC
/begin CHARACTERISTIC FrmMng_aSideDef_C "#SSD Defektwert für FrmMng_aSideDef_C Botschaft" VALUE 0xD8D86 Kw_Ws16 65.53500 Acc -32.76800 32.76700 FORMAT "%8.5" /end CHARACTERISTIC
/begin CHARACTERISTIC FrmMng_cnvAccmLimTrq_Offset_C "#SSD HEATING_CURRENT" VALUE 0xD8D88 Kw_Ws16 6553.500 Trq -3276.800 3276.700 FORMAT "%8.3" /end CHARACTERISTIC
/begin CHARACTERISTIC FrmMng_cnvAccmLimTrq_Slope_C "#SSD HEATING_CURRENT" VALUE 0xD8D8A Kw_Ws16 65.53500 SlopeRes1000 -32.76800 32.76700 FORMAT "%8.5" /end CHARACTERISTIC
/begin CHARACTERISTIC FrmMng_cnvACCtrq_Offset_C "#SSD DREHMOMENT_ANF_ACC   Signal: TORQ_TAR_ACC" VALUE 0xD8D8C Kw_Ws16 6553.500 Trq -3276.800 3276.700 FORMAT "%8.3" /end CHARACTERISTIC
/begin CHARACTERISTIC FrmMng_cnvACCtrq_Slope_C "#SSD DREHMOMENT_ANF_ACC   Signal: TORQ_TAR_ACC" VALUE 0xD8D8E Kw_Ws16 65.53500 SlopeRes1000 -32.76800 32.76700 FORMAT "%8.5" /end CHARACTERISTIC
/begin CHARACTERISTIC FrmMng_cnvAVA_DSC_Offset_C "#SSD Offset for conversion of ACLN_VEH_ACRO_DSC" VALUE 0xD8D90 Kw_Ws16 65.53500 Acc -32.76800 32.76700 FORMAT "%8.5" /end CHARACTERISTIC
/begin CHARACTERISTIC FrmMng_cnvAVA_DSC_Slope_C "#SSD slope for conversion of ACLN_VEH_ACRO_DSC" VALUE 0xD8D92 Kw_Ws16 65.53500 SlopeRes1000 -32.76800 32.76700 FORMAT "%8.5" /end CHARACTERISTIC
/begin CHARACTERISTIC FrmMng_cnvLN_DSC_Offset_C "#SSD Offset zur Umrechnung ACLN_VEH_ACRO_DSC -> FrmMng_aDirect" VALUE 0xD8D94 Kw_Ws16 65.53500 Acc -32.76800 32.76700 FORMAT "%8.5" /end CHARACTERISTIC
/begin CHARACTERISTIC FrmMng_cnvLN_DSC_Slope_C "#SSD Steigung zur Umrechnung ACLN_VEH_ACRO_DSC -> FrmMng_aDirect" VALUE 0xD8D96 Kw_Ws16 65.53500 SlopeRes1000 -32.76800 32.76700 FORMAT "%8.5" /end CHARACTERISTIC
/begin CHARACTERISTIC FrmMng_cnvAFStrq_Offset_C "#SSD Offset for calculation of ST_TORQ_AVL & TORQ_TAR_AFS" VALUE 0xD8D98 Kw_Ws16 6553.500 Trq -3276.800 3276.700 FORMAT "%8.3" /end CHARACTERISTIC
/begin CHARACTERISTIC FrmMng_cnvAFStrq_Slope_C "#SSD Slope for calculation of ST_TORQ_AVL & TORQ_TAR_AFS" VALUE 0xD8D9A Kw_Ws16 65.53500 SlopeRes1000 -32.76800 32.76700 FORMAT "%8.5" /end CHARACTERISTIC
/begin CHARACTERISTIC FrmMng_cnvAipEng_Offset_C "#SSD Offset fuer Umwandlung von AIP_ENG" VALUE 0xD8D9C Kw_Ws16 65535.00 Pres_hPa -32768.00 32767.00 FORMAT "%8.2" /end CHARACTERISTIC
/begin CHARACTERISTIC FrmMng_cnvAipEng_Slope_C "#SSD Steigung fuer Umwandlung von AIP_ENG" VALUE 0xD8D9E Kw_Ws16 65.53500 SlopeRes1000 -32.76800 32.76700 FORMAT "%8.5" /end CHARACTERISTIC
/begin CHARACTERISTIC FrmMng_cnvAngAcpd_Offset_C "#SSD Offset fuer Umwandlung von ANG_ACPD" VALUE 0xD8DA0 Kw_Ws16 799.9878 Prc -400.0000 399.9878 FORMAT "%8.4" /end CHARACTERISTIC
/begin CHARACTERISTIC FrmMng_cnvAngAcpd_Slope_C "#SSD Steigung fuer Umwandlung von ANG_ACPD" VALUE 0xD8DA2 Kw_Ws16 65.53500 SlopeRes1000 -32.76800 32.76700 FORMAT "%8.5" /end CHARACTERISTIC
/begin CHARACTERISTIC FrmMng_cnvAPP_Offset_C "#SSD Offset fuer ANG_ACPD_REAL und ANG_ACPD_TAR signale" VALUE 0xD8DA4 Kw_Ws16 799.9878 Prc -400.0000 399.9878 FORMAT "%8.4" /end CHARACTERISTIC
/begin CHARACTERISTIC FrmMng_cnvAPP_Slope_C "#SSD Slope fuer ANG_ACPD_REAL und ANG_ACPD_TAR signale" VALUE 0xD8DA6 Kw_Ws16 65.53500 SlopeRes1000 -32.76800 32.76700 FORMAT "%8.5" /end CHARACTERISTIC
/begin CHARACTERISTIC FrmMng_cnvARStrq_Offset_C "#SSD offset for conversion of ARS-torque" VALUE 0xD8DA8 Kw_Ws16 13107.00 TrqPrp -6553.600 6553.400 FORMAT "%8.3" /end CHARACTERISTIC
/begin CHARACTERISTIC FrmMng_cnvARStrq_Slope_C "#SSD slope for conversion of ARS-torque" VALUE 0xD8DAA Kw_Ws16 65.53500 SlopeRes1000 -32.76800 32.76700 FORMAT "%8.5" /end CHARACTERISTIC
/begin CHARACTERISTIC FrmMng_cnvDCCtrq_Offset_C "#SSD Offset für Umrechnung von WMOM_PT_TAR in FrmMng_trqDCC_TrqDes" VALUE 0xD8DAC Kw_Ws16 65535.00 TrqPrpHigh -32768.00 32767.00 FORMAT "%8.2" /end CHARACTERISTIC
/begin CHARACTERISTIC FrmMng_cnvDCCtrq_Slope_C "#SSD Stiegung für Umrechnung von WMOM_PT_TAR in FrmMng_trqDCC_TrqDes" VALUE 0xD8DAE Kw_Ws16 65.53500 SlopeRes1000 -32.76800 32.76700 FORMAT "%8.5" /end CHARACTERISTIC
/begin CHARACTERISTIC FrmMng_cnvdLRADWINKStrg_Offset_C "#SSD Offset for calculation dphiStrg from CAN" VALUE 0xD8DB0 Kw_Ws16 2880.263 AngleGradPerSec -1440.154 1440.110 FORMAT "%8.3" /end CHARACTERISTIC
/begin CHARACTERISTIC FrmMng_cnvdLRADWINKStrg_Slope_C "#SSD Slope for calculation  dphiStrg from CAN" VALUE 0xD8DB2 Kw_Ws16 65.53500 SlopeRes1000 -32.76800 32.76700 FORMAT "%8.5" /end CHARACTERISTIC
/begin CHARACTERISTIC FrmMng_cnvDSCtrq_Offset_C "#SSD offset for conversion of DSC-torque" VALUE 0xD8DB4 Kw_Ws16 6553.500 Trq -3276.800 3276.700 FORMAT "%8.3" /end CHARACTERISTIC
/begin CHARACTERISTIC FrmMng_cnvDSCtrq_Slope_C "#SSD slope for conversion of DSC-torque" VALUE 0xD8DB6 Kw_Ws16 65.53500 SlopeRes1000 -32.76800 32.76700 FORMAT "%8.5" /end CHARACTERISTIC
/begin CHARACTERISTIC FrmMng_cnvIjvFu_Offset_C "#SSD Offset fuer Umwandlung von IJV_FU" VALUE 0xD8DB8 Kw_Ws16 65535.00 FlConsum_ul -32768.00 32767.00 FORMAT "%8.2" /end CHARACTERISTIC
/begin CHARACTERISTIC FrmMng_cnvIjvFu_Slope_C "#SSD Steigung fuer Umwandlung von IJV_FU" VALUE 0xD8DBA Kw_Ws16 65.53500 SlopeRes1000 -32.76800 32.76700 FORMAT "%8.5" /end CHARACTERISTIC
/begin CHARACTERISTIC FrmMng_cnvKOMBIv_Offset_C "#SSD Conversion V_VEH_SPDM -> FrmMng_vDisp" VALUE 0xD8DBC Kw_Ws16 655.3500 Vel -327.6800 327.6700 FORMAT "%8.4" /end CHARACTERISTIC
/begin CHARACTERISTIC FrmMng_cnvKOMBIv_Slope_C "#SSD Conversion V_VEH_SPDM -> FrmMng_vDisp" VALUE 0xD8DBE Kw_Ws16 65.53500 SlopeRes1000 -32.76800 32.76700 FORMAT "%8.5" /end CHARACTERISTIC
/begin CHARACTERISTIC FrmMng_cnvLimRpmEng_Offset_C "#SSD Offset for conversion of LIM_RPM_ENG" VALUE 0xD8DC0 Kw_Ws16 65535.00 EngN -32768.00 32767.00 FORMAT "%8.2" /end CHARACTERISTIC
/begin CHARACTERISTIC FrmMng_cnvLimRpmEng_Slope_C "#SSD Slope for the conversion of LIM_RPM_ENG" VALUE 0xD8DC2 Kw_Ws16 65.53500 SlopeRes1000 -32.76800 32.76700 FORMAT "%8.5" /end CHARACTERISTIC
/begin CHARACTERISTIC FrmMng_cnvLRADWINKStrg_Offset_C "#SSD Offset for calculation of LRADWINK signal" VALUE 0xD8DC4 Kw_Ws16 2880.263 AngleGrad -1440.154 1440.110 FORMAT "%8.3" /end CHARACTERISTIC
/begin CHARACTERISTIC FrmMng_cnvLRADWINKStrg_Slope_C "#SSD Slope for calculation of LRADWINK signal" VALUE 0xD8DC6 Kw_Ws16 65.53500 SlopeRes1000 -32.76800 32.76700 FORMAT "%8.5" /end CHARACTERISTIC
/begin CHARACTERISTIC FrmMng_cnvnEngRpm_Offset_C "#SSD Offset for the calculation of RPM_TEMP_DOM_1 and RPM_TEMP_DOM_2" VALUE 0xD8DC8 Kw_Ws16 65535.00 EngN -32768.00 32767.00 FORMAT "%8.2" /end CHARACTERISTIC
/begin CHARACTERISTIC FrmMng_cnvnEngRpm_Slope_C "#SSD Slope for the calculation of RPM_TEMP_DOM_1 &  RPM_TEMP_DOM_2 signals" VALUE 0xD8DCA Kw_Ws16 655.3500 SlopeRes100 -327.6800 327.6700 FORMAT "%8.4" /end CHARACTERISTIC
/begin CHARACTERISTIC FrmMng_cnvnSetpoint_Offset_C "Offset Wert für Byte 7 der ENGINE1 CAN Botschaft" VALUE 0xD8DCC Kw_Ws16 65535.00 EngN -32768.00 32767.00 FORMAT "%8.2" /end CHARACTERISTIC
/begin CHARACTERISTIC FrmMng_cnvnSetpoint_Slope_C "Steigungs Wert für Byte 7 der ENGINE1 CAN Botschaft" VALUE 0xD8DCE Kw_Ws16 65.53500 SlopeRes1000 -32.76800 32.76700 FORMAT "%8.5" /end CHARACTERISTIC
/begin CHARACTERISTIC FrmMng_cnvpBrkSys_Offset_C "#SSD Offset für Umrechnung von BRP in FrmMng_pBrkSys" VALUE 0xD8DD0 Kw_Ws16 65535.00 Pres_bar -32768.00 32767.00 FORMAT "%8.2" /end CHARACTERISTIC
/begin CHARACTERISTIC FrmMng_cnvpBrkSys_Slope_C "#SSD Steigung für Umrechnung von BRP in FrmMng_pBrkSys" VALUE 0xD8DD2 Kw_Ws16 65.53500 SlopeRes1000 -32.76800 32.76700 FORMAT "%8.5" /end CHARACTERISTIC
/begin CHARACTERISTIC FrmMng_cnvrHtFlow_Offset_C "#SSD Conversion HTFL_RQ_AIC -> FrmMng_rHtFlowReq" VALUE 0xD8DD4 Kw_Ws16 799.9878 Prc -400.0000 399.9878 FORMAT "%8.4" /end CHARACTERISTIC
/begin CHARACTERISTIC FrmMng_cnvrHtFlow_Slope_C "#SSD Conversion HTFL_RQ_AIC -> FrmMng_rHtFlowReq" VALUE 0xD8DD6 Kw_Ws16 655.3500 SlopeRes100 -327.6800 327.6700 FORMAT "%8.4" /end CHARACTERISTIC
/begin CHARACTERISTIC FrmMng_cnvRpmEng_Offset_C "#SSD Offset fuer Umwandlung von RPM_ENG" VALUE 0xD8DD8 Kw_Ws16 65535.00 EngN -32768.00 32767.00 FORMAT "%8.2" /end CHARACTERISTIC
/begin CHARACTERISTIC FrmMng_cnvRpmEng_Slope_C "#SSD Steigung fuer Umwandlung von RPM_ENG" VALUE 0xD8DDA Kw_Ws16 65.53500 SlopeRes1000 -32.76800 32.76700 FORMAT "%8.5" /end CHARACTERISTIC
/begin CHARACTERISTIC FrmMng_cnvRPM_GRB_TURB_Offset_C "#SSD Offset zur Umrechnung RPM_GRB_TURB -> FrmMng_nTSC" VALUE 0xD8DDC Kw_Ws16 65535.00 EngN -32768.00 32767.00 FORMAT "%8.2" /end CHARACTERISTIC
/begin CHARACTERISTIC FrmMng_cnvRPM_GRB_TURB_Slope_C "#SSD Steigung zur Umrechnung RPM_GRB_TURB -> FrmMng_nTSC" VALUE 0xD8DDE Kw_Ws16 65.53500 SlopeRes1000 -32.76800 32.76700 FORMAT "%8.5" /end CHARACTERISTIC
/begin CHARACTERISTIC FrmMng_cnvRqamFu_Offset_C "#SSD required-amount fuel Offset" VALUE 0xD8DE0 Kw_Ws16 655.3500 FlConsum_l_h -327.6800 327.6700 FORMAT "%8.4" /end CHARACTERISTIC
/begin CHARACTERISTIC FrmMng_cnvRqamFu_Slope_C "#SSD required-amount fuel Slope" VALUE 0xD8DE2 Kw_Ws16 655.3500 SlopeRes100 -327.6800 327.6700 FORMAT "%8.4" /end CHARACTERISTIC
/begin CHARACTERISTIC FrmMng_cnvrTransDT_Offset_C "#SSD Offset für Umrechnung von Getriebsstrang Verstärkung (GRDT_REIN) in FrmMng_rTransDT" VALUE 0xD8DE4 Kw_Ws16 655.3500 TransR -327.6800 327.6700 FORMAT "%8.4" /end CHARACTERISTIC
/begin CHARACTERISTIC FrmMng_cnvrTransDT_Slope_C "#SSD Stiegung für Umrechnung von Getriebsstrang Verstärkung (GRDT_REIN) in FrmMng_rTransDT" VALUE 0xD8DE6 Kw_Ws16 65.53500 SlopeRes1000 -32.76800 32.76700 FORMAT "%8.5" /end CHARACTERISTIC
/begin CHARACTERISTIC FrmMng_cnvrWaterVlv_Offset_C "#SSD Offset value for CTR_APE_WV" VALUE 0xD8DE8 Kw_Ws16 799.9878 Prc -400.0000 399.9878 FORMAT "%8.4" /end CHARACTERISTIC
/begin CHARACTERISTIC FrmMng_cnvrWaterVlv_Slope_C "#SSD Slope value for CTR_APE_WV" VALUE 0xD8DEA Kw_Ws16 6553.500 SlopeRes10 -3276.800 3276.700 FORMAT "%8.3" /end CHARACTERISTIC
/begin CHARACTERISTIC FrmMng_cnvTempEng_Offset_C "#SSD Offset fuer Umwandlung von TEMP_ENG" VALUE 0xD8DEC Kw_Ws16 950.000 Temp_Cels -50.140 899.860 FORMAT "%8.3" EXTENDED_LIMITS -3549.940 3003.560 /end CHARACTERISTIC
/begin CHARACTERISTIC FrmMng_cnvTempEng_Slope_C "#SSD Steigung fuer Umwandlung von TEMP_ENG" VALUE 0xD8DEE Kw_Ws16 65.53500 SlopeRes1000 -32.76800 32.76700 FORMAT "%8.5" /end CHARACTERISTIC
/begin CHARACTERISTIC FrmMng_cnvtOil_Offset_C "#SSD Conversion TEMP_GRB -> FrmMng_tOil" VALUE 0xD8DF0 Kw_Ws16 950.000 Temp_Cels -50.140 899.860 FORMAT "%8.3" EXTENDED_LIMITS -3549.940 3003.560 /end CHARACTERISTIC
/begin CHARACTERISTIC FrmMng_cnvtOil_Slope_C "#SSD Conversion TEMP_GRB -> FrmMng_tOil" VALUE 0xD8DF2 Kw_Ws16 65.53500 SlopeRes1000 -32.76800 32.76700 FORMAT "%8.5" /end CHARACTERISTIC
/begin CHARACTERISTIC FrmMng_cnvTrqAvl_Offset_C "#SSD Offset fuer Umwandlung von TORQ_AVL" VALUE 0xD8DF4 Kw_Ws16 6553.500 Trq -3276.800 3276.700 FORMAT "%8.3" /end CHARACTERISTIC
/begin CHARACTERISTIC FrmMng_cnvTrqAvl_Slope_C "#SSD Steigung fuer Umwandlung von TORQ_AVL" VALUE 0xD8DF6 Kw_Ws16 65.53500 SlopeRes1000 -32.76800 32.76700 FORMAT "%8.5" /end CHARACTERISTIC
/begin CHARACTERISTIC FrmMng_cnvTrqDvch_Offset_C "#SSD Offset fuer Umwandlung von TORQ_DVCH" VALUE 0xD8DF8 Kw_Ws16 6553.500 Trq -3276.800 3276.700 FORMAT "%8.3" /end CHARACTERISTIC
/begin CHARACTERISTIC FrmMng_cnvTrqDvch_Slope_C "#SSD Steigung fuer Umwandlung von TORQ_DVCH" VALUE 0xD8DFA Kw_Ws16 65.53500 SlopeRes1000 -32.76800 32.76700 FORMAT "%8.5" /end CHARACTERISTIC
/begin CHARACTERISTIC FrmMng_cnvtrqWheel_Offset_C "#SSD Offset Umrechnung TORQ_AVL" VALUE 0xD8DFC Kw_Ws16 65535.00 TrqPrpHigh -32768.00 32767.00 FORMAT "%8.2" /end CHARACTERISTIC
/begin CHARACTERISTIC FrmMng_cnvtrqWheel_Slope_C "#SSD Slope fuer WMOM_PT_AVL ,WMOM_PT_MIN_LOW und WMOM_PT_MAX signale" VALUE 0xD8DFE Kw_Ws16 65.53500 SlopeRes1000 -32.76800 32.76700 FORMAT "%8.5" /end CHARACTERISTIC
/begin CHARACTERISTIC FrmMng_cnvtrq_Offset_C "#SSD offset for message FrmMng_trqGearbxFrc" VALUE 0xD8E00 Kw_Ws16 6553.500 Trq -3276.800 3276.700 FORMAT "%8.3" /end CHARACTERISTIC
/begin CHARACTERISTIC FrmMng_cnvtrq_Slope_C "#SSD Slope for the message FrmMng_trqGearbxFrc" VALUE 0xD8E02 Kw_Ws16 65.53500 SlopeRes1000 -32.76800 32.76700 FORMAT "%8.5" /end CHARACTERISTIC
/begin CHARACTERISTIC FrmMng_cnvvMrk_Offset_C "#SSD SPEED_CLCTR" VALUE 0xD8E04 Kw_Ws16 655.3500 Vel -327.6800 327.6700 FORMAT "%8.4" /end CHARACTERISTIC
/begin CHARACTERISTIC FrmMng_cnvvMrk_Slope_C "#SSD SPEED_CLCTR" VALUE 0xD8E06 Kw_Ws16 65.53500 SlopeRes1000 -32.76800 32.76700 FORMAT "%8.5" /end CHARACTERISTIC
/begin CHARACTERISTIC FrmMng_cnvV_VEH_Offset_C "#SSD Offset für Fahrgeschwindigkeitsumrechnung" VALUE 0xD8E08 Kw_Ws16 655.3500 Vel -327.6800 327.6700 FORMAT "%8.4" /end CHARACTERISTIC
/begin CHARACTERISTIC FrmMng_cnvV_VEH_Slope_C "#SSD Steigung für Geschwindigkeitsumrechnung" VALUE 0xD8E0A Kw_Ws16 65.53500 SlopeRes1000 -32.76800 32.76700 FORMAT "%8.5" /end CHARACTERISTIC
/begin CHARACTERISTIC FrmMng_cnv_BattCls_Offset_C "#SSD Offsetwert für FrmMng_nBattCls" VALUE 0xD8E0C Kw_Ws16 65535.00 DEZ -32768.00 32767.00 FORMAT "%8.2" /end CHARACTERISTIC
/begin CHARACTERISTIC FrmMng_cnv_BattCls_Slope_C "#SSD Steigungswert für FrmMng_nBattCls" VALUE 0xD8E0E Kw_Ws16 65.53500 SlopeRes1000 -32.76800 32.76700 FORMAT "%8.5" /end CHARACTERISTIC
/begin CHARACTERISTIC FrmMng_cnv_HiLimCurr_Offset_C "#SSD Offsetwert für FrmMng_iHiLimCurr" VALUE 0xD8E10 Kw_Ws16 655350. i_ub_q10p0 -327680. 327670. FORMAT "%5.0" /end CHARACTERISTIC
/begin CHARACTERISTIC FrmMng_cnv_HiLimCurr_Slope_C "#SSD Steigungswert für FrmMng_iHiLimCurr" VALUE 0xD8E12 Kw_Ws16 65.53500 SlopeRes1000 -32.76800 32.76700 FORMAT "%8.5" /end CHARACTERISTIC
/begin CHARACTERISTIC FrmMng_cnv_LoLimCurr_Offset_C "#SSD Offsetwert für FrmMng_iLoLimCurr" VALUE 0xD8E14 Kw_Ws16 655350. i_ub_q10p0 -327680. 327670. FORMAT "%5.0" /end CHARACTERISTIC
/begin CHARACTERISTIC FrmMng_cnv_LoLimCurr_Slope_C "#SSD Steigungswert für FrmMng_iLoLimCurr" VALUE 0xD8E16 Kw_Ws16 65.53500 SlopeRes1000 -32.76800 32.76700 FORMAT "%8.5" /end CHARACTERISTIC
/begin CHARACTERISTIC FrmMng_cnv_ZrCurrLim_Offset_C "#SSD Offsetwert für FrmMng_iZrCurrLim" VALUE 0xD8E18 Kw_Ws16 65.53 i_ub_q0p001 -32.77 32.77 FORMAT "%5.2" /end CHARACTERISTIC
/begin CHARACTERISTIC FrmMng_cnv_ZrCurrLim_Slope_C "#SSD Steigungswert für FrmMng_iZrCurrLim" VALUE 0xD8E1A Kw_Ws16 65.53500 SlopeRes1000 -32.76800 32.76700 FORMAT "%8.5" /end CHARACTERISTIC
/begin CHARACTERISTIC FrmMng_ctASCDef_C "Defektentprellzähler, ASC-Plausibilisierung" VALUE 0xD918C Kw_Wu8 255.0 OneToOne 0.00 255.0 FORMAT "%5.1" /end CHARACTERISTIC
/begin CHARACTERISTIC FrmMng_ctDebAlvDMANFAFSDef_C "#SSD Defect time for DREHMOMENT_ANF_AFS  message alive counter error" VALUE 0xD8E1C Kw_Wu16 65535.00 OneToOne 0.00 65535.00 FORMAT "%8.2" /end CHARACTERISTIC
/begin CHARACTERISTIC FrmMng_ctDebAlvDMANFAFSOk_C "Healing time for DREHMOMENT_ANF_AFS  message alive counter error" VALUE 0xD8E1E Kw_Wu16 65535.00 OneToOne 0.00 65535.00 FORMAT "%8.2" /end CHARACTERISTIC
/begin CHARACTERISTIC FrmMng_ctDebAlvDRMANFSSGDef_C "measuring point for evluating ST_SW_WAUP signal" VALUE 0xD8E20 Kw_Wu16 65535.00 OneToOne 0.00 65535.00 FORMAT "%8.2" /end CHARACTERISTIC
/begin CHARACTERISTIC FrmMng_ctDebAlvDRMANFSSGOk_C "Healing time" VALUE 0xD8E22 Kw_Wu16 65535.00 OneToOne 0.00 65535.00 FORMAT "%8.2" /end CHARACTERISTIC
/begin CHARACTERISTIC FrmMng_ctDebCsDMANFAFSDef_C "#SSD Defect time for DREHMOMENT_ANF_AFS message check sum error" VALUE 0xD8E24 Kw_Wu16 65535.00 OneToOne 0.00 65535.00 FORMAT "%8.2" /end CHARACTERISTIC
/begin CHARACTERISTIC FrmMng_ctDebCsDMANFAFSOk_C "Healing time for DREHMOMENT_ANF_AFS message check sum error" VALUE 0xD8E26 Kw_Wu16 65535.00 OneToOne 0.00 65535.00 FORMAT "%8.2" /end CHARACTERISTIC
/begin CHARACTERISTIC FrmMng_ctDebCsDRMANFSSGDef_C " Defect time" VALUE 0xD8E28 Kw_Wu16 65535.00 OneToOne 0.00 65535.00 FORMAT "%8.2" /end CHARACTERISTIC
/begin CHARACTERISTIC FrmMng_ctDebCsDRMANFSSGOk_C "Healing time" VALUE 0xD8E2A Kw_Wu16 65535.00 OneToOne 0.00 65535.00 FORMAT "%8.2" /end CHARACTERISTIC
/begin CHARACTERISTIC FrmMng_ctDebSigDMANFAFSDef_C "#SSD Defect time for DREHMOMENT_ANF_AFS message signal error" VALUE 0xD8E2C Kw_Wu16 65535.00 OneToOne 0.00 65535.00 FORMAT "%8.2" /end CHARACTERISTIC
/begin CHARACTERISTIC FrmMng_ctDebSigDMANFAFSOk_C "Healing time for DREHMOMENT_ANF_AFS message signal error" VALUE 0xD8E2E Kw_Wu16 65535.00 OneToOne 0.00 65535.00 FORMAT "%8.2" /end CHARACTERISTIC
/begin CHARACTERISTIC FrmMng_ctDebSigDRMANFSSGDef_C "Defect time for DREHMOMENT_ANF_SSG message signal error" VALUE 0xD8E30 Kw_Wu16 65535.00 OneToOne 0.00 65535.00 FORMAT "%8.2" /end CHARACTERISTIC
/begin CHARACTERISTIC FrmMng_ctDebSigDRMANFSSGOk_C "Healing time for DREHMOMENT_ANF_SSG messages signal error" VALUE 0xD8E32 Kw_Wu16 65535.00 OneToOne 0.00 65535.00 FORMAT "%8.2" /end CHARACTERISTIC
/begin CHARACTERISTIC FrmMng_ctDebSigLRADWINKDef_C "Defect time for LENKRADWINKEL messages signal error" VALUE 0xD8E34 Kw_Wu16 65535.00 OneToOne 0.00 65535.00 FORMAT "%8.2" /end CHARACTERISTIC
/begin CHARACTERISTIC FrmMng_ctDebSigLRADWINKOk_C "Healing time for LENKRADWINKEL messages signal error" VALUE 0xD8E36 Kw_Wu16 65535.00 OneToOne 0.00 65535.00 FORMAT "%8.2" /end CHARACTERISTIC
/begin CHARACTERISTIC FrmMng_ctDebSigstCurrDef_C "Defektentprellung für Signal Fehler von CODIERUNG_PM Botschaft" VALUE 0xD8E38 Kw_Wu16 65535.00 OneToOne 0.00 65535.00 FORMAT "%8.2" /end CHARACTERISTIC
/begin CHARACTERISTIC FrmMng_ctDebSigstCurrOk_C "Heilentprellung für Signal Fehler von CODIERUNG_PM Botschaft" VALUE 0xD8E3A Kw_Wu16 65535.00 OneToOne 0.00 65535.00 FORMAT "%8.2" /end CHARACTERISTIC
/begin CHARACTERISTIC FrmMng_ctDebSigswtPSPOffDef_C "Defektentprellung für Signal Fehler von  CTR_CRASH_SWO_EKP Botschaft" VALUE 0xD8E3C Kw_Wu16 65535.00 OneToOne 0.00 65535.00 FORMAT "%8.2" /end CHARACTERISTIC
/begin CHARACTERISTIC FrmMng_ctDebSigswtPSPOffOk_C "Heilentprellung für Signal Fehler von  CTR_CRASH_SWO_EKP Botschaft" VALUE 0xD8E3E Kw_Wu16 65535.00 OneToOne 0.00 65535.00 FORMAT "%8.2" /end CHARACTERISTIC
/begin CHARACTERISTIC FrmMng_ctDebToDMANFAFSDef_C "#SSD Defect time for DREHMOMENT_ANF_AFS messages Timeout" VALUE 0xD8E40 Kw_Wu16 65535.00 OneToOne 0.00 65535.00 FORMAT "%8.2" /end CHARACTERISTIC
/begin CHARACTERISTIC FrmMng_ctDebToDMANFAFSOk_C "Healing time for DREHMOMENT_ANF_AFS messages Timeout" VALUE 0xD8E42 Kw_Wu16 65535.00 OneToOne 0.00 65535.00 FORMAT "%8.2" /end CHARACTERISTIC
/begin CHARACTERISTIC FrmMng_ctDebToDRMANFSSGDef_C "Defect time for DREHMOMENT_ANF_SSG messages Timeout" VALUE 0xD8E44 Kw_Wu16 65535.00 OneToOne 0.00 65535.00 FORMAT "%8.2" /end CHARACTERISTIC
/begin CHARACTERISTIC FrmMng_ctDebToDRMANFSSGOk_C "Healing time for DREHMOMENT_ANF_SSG messages Timeout" VALUE 0xD8E46 Kw_Wu16 65535.00 OneToOne 0.00 65535.00 FORMAT "%8.2" /end CHARACTERISTIC
/begin CHARACTERISTIC FrmMng_ctDebToLRADWINKDef_C "Defect time for LENKRADWINKEL messages time out error" VALUE 0xD8E48 Kw_Wu16 65535.00 OneToOne 0.00 65535.00 FORMAT "%8.2" /end CHARACTERISTIC
/begin CHARACTERISTIC FrmMng_ctDebToLRADWINKOk_C "Healing  time for LENKRADWINKEL messages time out error" VALUE 0xD8E4A Kw_Wu16 65535.00 OneToOne 0.00 65535.00 FORMAT "%8.2" /end CHARACTERISTIC
/begin CHARACTERISTIC FrmMng_ctDebTostCurrDef_C "Defektentprellung für Timeout-Fehler von  CODIERUNG_PM Botschaft" VALUE 0xD8E4C Kw_Wu16 65535.00 OneToOne 0.00 65535.00 FORMAT "%8.2" /end CHARACTERISTIC
/begin CHARACTERISTIC FrmMng_ctDebTostCurrOk_C "Heilentprellung für Timeout-Fehler von  CODIERUNG_PM Botschaft" VALUE 0xD8E4E Kw_Wu16 65535.00 OneToOne 0.00 65535.00 FORMAT "%8.2" /end CHARACTERISTIC
/begin CHARACTERISTIC FrmMng_ctDebToswtPSPOffDef_C "Defect time for ASC2-messages Timeout" VALUE 0xD8E50 Kw_Wu16 65535.00 OneToOne 0.00 65535.00 FORMAT "%8.2" /end CHARACTERISTIC
/begin CHARACTERISTIC FrmMng_ctDebToswtPSPOffOk_C "Heilentprellung für Timeout-Fehler von  CTR_CRASH_SWO_EKP Botschaft" VALUE 0xD8E52 Kw_Wu16 65535.00 OneToOne 0.00 65535.00 FORMAT "%8.2" /end CHARACTERISTIC
/begin CHARACTERISTIC FrmMng_ctMulDDE2_C "#SSD Anzahl  der zu multiplexenden  - DDE2 Messages" VALUE 0xD918E Kw_Wu16 4.000000 OneToOne 0.00 4.000000 FORMAT "%8.6" EXTENDED_LIMITS 0.00 65535.00 /end CHARACTERISTIC
/begin CHARACTERISTIC FrmMng_ctrRelDef_C "Defektwert für FrmMng_tRelDef_C Botschaft" VALUE 0xD8E54 Kw_Wu32 4294967295.00 OneToOne 0.00 4294967295.00 FORMAT "%13.2" /end CHARACTERISTIC
/begin CHARACTERISTIC FrmMng_cnvCTR_GEN_U_TAR_Offset_C "Offset zur Berechnung CTR_GEN_U_TAR aus CAN" VALUE 0xD8E58 Kw_Ws16 65535.00 OneToOne -32768.00 32767.00 FORMAT "%8.2" /end CHARACTERISTIC
/begin CHARACTERISTIC FrmMng_cnvCTR_GEN_U_TAR_Slope_C "Steigung zur Berechnung CTR_GEN_U_TAR aus CAN" VALUE 0xD8E5A Kw_Ws16 65.53500 SlopeRes1000 -32.76800 32.76700 FORMAT "%8.5" /end CHARACTERISTIC
/begin CHARACTERISTIC FrmMng_dCanState_C "#SSD Multiplexinfo für MUL_COD = 0" VALUE 0xD9190 Kw_Wu8 63.00 OneToOne 0.00 63.00 FORMAT "%5.2" EXTENDED_LIMITS 0.00 255.0 /end CHARACTERISTIC
/begin CHARACTERISTIC FrmMng_DebACTrqDef_C "#SSD debouncing of ACTrq for defect detection" VALUE 0xD8E5C Kw_Wu16 65535.00 OneToOne 0.00 65535.00 FORMAT "%8.2" /end CHARACTERISTIC
/begin CHARACTERISTIC FrmMng_DebACTrqOk_C "debouncing of ACTrq for healing" VALUE 0xD8E5E Kw_Wu16 65535.00 OneToOne 0.00 65535.00 FORMAT "%8.2" /end CHARACTERISTIC
/begin CHARACTERISTIC FrmMng_DebAlvANFRADMOMPTDef_C "Defektentprellung für RADMOM_PT_1-messages Alive-Zähler" VALUE 0xD8E60 Kw_Wu16 65535.00 OneToOne 0.00 65535.00 FORMAT "%8.2" /end CHARACTERISTIC
/begin CHARACTERISTIC FrmMng_DebAlvANFRADMOMPTOk_C "Heilentprellung für RADMOM_PT_1-messages Alive-Zähler" VALUE 0xD8E62 Kw_Wu16 65535.00 OneToOne 0.00 65535.00 FORMAT "%8.2" /end CHARACTERISTIC
/begin CHARACTERISTIC FrmMng_DebAlvDMOMENT_ACCDef_C "#SSD Defect time of DMOMENT_ACC aliv" VALUE 0xD8E64 Kw_Wu16 65535.00 OneToOne 0.00 65535.00 FORMAT "%8.2" /end CHARACTERISTIC
/begin CHARACTERISTIC FrmMng_DebAlvDMOMENT_ACCOk_C "Healing time  of  DMOMENT_ACC aliv" VALUE 0xD8E66 Kw_Wu16 65535.00 OneToOne 0.00 65535.00 FORMAT "%8.2" /end CHARACTERISTIC
/begin CHARACTERISTIC FrmMng_DebAlvOPCRCTLACCDef_C "#SSD debouncing of alive-ctr.-error OPCRCTLACC (no.of events)" VALUE 0xD8E68 Kw_Wu16 65535.00 OneToOne 0.00 65535.00 FORMAT "%8.2" /end CHARACTERISTIC
/begin CHARACTERISTIC FrmMng_DebAlvOPCRCTLACCOk_C "debouncing of alive-ctr.-error OPCRCTLACC (no.of events)" VALUE 0xD8E6A Kw_Wu16 65535.00 OneToOne 0.00 65535.00 FORMAT "%8.2" /end CHARACTERISTIC
/begin CHARACTERISTIC FrmMng_DebAlvSTAT_ARSDef_C "#SSD debouncing of alive-ctr.-error STAT_ARS (no.of events)" VALUE 0xD8E6C Kw_Wu16 65535.00 OneToOne 0.00 65535.00 FORMAT "%8.2" /end CHARACTERISTIC
/begin CHARACTERISTIC FrmMng_DebAlvSTAT_ARSOk_C "debouncing of alive-ctr.-error STAT_ARS (no.of events)" VALUE 0xD8E6E Kw_Wu16 65535.00 OneToOne 0.00 65535.00 FORMAT "%8.2" /end CHARACTERISTIC
/begin CHARACTERISTIC FrmMng_DebAlvSTAT_KOMBIDef_C "#SSD debouncing of alive-ctr.-error STAT_KOMBI (no.of events)" VALUE 0xD8E70 Kw_Wu16 65535.00 OneToOne 0.00 65535.00 FORMAT "%8.2" /end CHARACTERISTIC
/begin CHARACTERISTIC FrmMng_DebAlvSTAT_KOMBIOk_C "debouncing of alive-ctr.-error STAT_KOMBI (no.of events)" VALUE 0xD8E72 Kw_Wu16 65535.00 OneToOne 0.00 65535.00 FORMAT "%8.2" /end CHARACTERISTIC
/begin CHARACTERISTIC FrmMng_DebAlvTERMINALDef_C "debouncing of alive-ctr.-error TERMINAL (no.of events)" VALUE 0xD8E74 Kw_Wu16 65535.00 OneToOne 0.00 65535.00 FORMAT "%8.2" /end CHARACTERISTIC
/begin CHARACTERISTIC FrmMng_DebAlvTERMINALOk_C "debouncing of alive-ctr.-error TERMINAL (no.of events)" VALUE 0xD8E76 Kw_Wu16 65535.00 OneToOne 0.00 65535.00 FORMAT "%8.2" /end CHARACTERISTIC
/begin CHARACTERISTIC FrmMng_DebAlvTORQUE_DSCDef_C "#SSD debouncing of alive-ctr.-error TORQUE_DSC (no.of events)" VALUE 0xD8E78 Kw_Wu16 65535.00 OneToOne 0.00 65535.00 FORMAT "%8.2" /end CHARACTERISTIC
/begin CHARACTERISTIC FrmMng_DebAlvTORQUE_DSCOk_C "debouncing of alive-ctr.-error TORQUE_DSC (no.of events)" VALUE 0xD8E7A Kw_Wu16 65535.00 OneToOne 0.00 65535.00 FORMAT "%8.2" /end CHARACTERISTIC
/begin CHARACTERISTIC FrmMng_DebAlvTORQUE_GEARBXDef_C "#SSD debouncing of alive-ctr.-error TORQUE_GEARBX (no.of events)" VALUE 0xD8E7C Kw_Wu16 65535.00 OneToOne 0.00 65535.00 FORMAT "%8.2" /end CHARACTERISTIC
/begin CHARACTERISTIC FrmMng_DebAlvTORQUE_GEARBXOk_C "debouncing of alive-ctr.-error TORQUE_GEARBX (no.of events)" VALUE 0xD8E7E Kw_Wu16 65535.00 OneToOne 0.00 65535.00 FORMAT "%8.2" /end CHARACTERISTIC
/begin CHARACTERISTIC FrmMng_DebAlvVEH_MODDef_C "Defect time for VEH_MOD signal" VALUE 0xD8E80 Kw_Wu16 65535.00 OneToOne 0.00 65535.00 FORMAT "%8.2" /end CHARACTERISTIC
/begin CHARACTERISTIC FrmMng_DebAlvVEH_MODOk_C "debounce OK time for alive counter for VEH_MOD signal" VALUE 0xD8E82 Kw_Wu16 65535.00 OneToOne 0.00 65535.00 FORMAT "%8.2" /end CHARACTERISTIC
/begin CHARACTERISTIC FrmMng_DebCsANFRADMOMPTDef_C "Defektentprellung für RADMOM_PT_1-messages Checksum" VALUE 0xD8E84 Kw_Wu16 65535.00 OneToOne 0.00 65535.00 FORMAT "%8.2" /end CHARACTERISTIC
/begin CHARACTERISTIC FrmMng_DebCsANFRADMOMPTOk_C "Heilentprellung für RADMOM_PT_1-messages Checksum" VALUE 0xD8E86 Kw_Wu16 65535.00 OneToOne 0.00 65535.00 FORMAT "%8.2" /end CHARACTERISTIC
/begin CHARACTERISTIC FrmMng_DebCsDMOMENT_ACCDef_C "#SSD Defect time of DMOMENT_ACC   check sum" VALUE 0xD8E88 Kw_Wu16 65535.00 OneToOne 0.00 65535.00 FORMAT "%8.2" /end CHARACTERISTIC
/begin CHARACTERISTIC FrmMng_DebCsDMOMENT_ACCOk_C "Healing time  of  DMOMENT_ACC check sum" VALUE 0xD8E8A Kw_Wu16 65535.00 OneToOne 0.00 65535.00 FORMAT "%8.2" /end CHARACTERISTIC
/begin CHARACTERISTIC FrmMng_DebCsOPCRCTLACCDef_C "#SSD debouncing of checksum-error OPCRCTLACC (no.of events)" VALUE 0xD8E8C Kw_Wu16 65535.00 OneToOne 0.00 65535.00 FORMAT "%8.2" /end CHARACTERISTIC
/begin CHARACTERISTIC FrmMng_DebCsOPCRCTLACCOk_C "debouncing of checksum-error OPCRCTLACC (no.of events)" VALUE 0xD8E8E Kw_Wu16 65535.00 OneToOne 0.00 65535.00 FORMAT "%8.2" /end CHARACTERISTIC
/begin CHARACTERISTIC FrmMng_DebCsTERMINALDef_C "debouncing of checksum-error TERMINAL (no.of events)" VALUE 0xD8E90 Kw_Wu16 65535.00 OneToOne 0.00 65535.00 FORMAT "%8.2" /end CHARACTERISTIC
/begin CHARACTERISTIC FrmMng_DebCsTERMINALOk_C "debouncing of checksum-error TERMINAL (no.of events)" VALUE 0xD8E92 Kw_Wu16 65535.00 OneToOne 0.00 65535.00 FORMAT "%8.2" /end CHARACTERISTIC
/begin CHARACTERISTIC FrmMng_DebCsTORQUE_DSCDef_C "#SSD debouncing of checksum-error TORQUE_DSC (no.of events)" VALUE 0xD8E94 Kw_Wu16 65535.00 OneToOne 0.00 65535.00 FORMAT "%8.2" /end CHARACTERISTIC
/begin CHARACTERISTIC FrmMng_DebCsTORQUE_DSCOk_C "debouncing of checksum-error TORQUE_DSC (no.of events)" VALUE 0xD8E96 Kw_Wu16 65535.00 OneToOne 0.00 65535.00 FORMAT "%8.2" /end CHARACTERISTIC
/begin CHARACTERISTIC FrmMng_DebCsTORQUE_GEARBXDef_C "#SSD debouncing of checksum-error TORQUE_GEARBX (no.of events)" VALUE 0xD8E98 Kw_Wu16 65535.00 OneToOne 0.00 65535.00 FORMAT "%8.2" /end CHARACTERISTIC
/begin CHARACTERISTIC FrmMng_DebCsTORQUE_GEARBXOk_C "debouncing of checksum-error TORQUE_GEARBX (no.of events)" VALUE 0xD8E9A Kw_Wu16 65535.00 OneToOne 0.00 65535.00 FORMAT "%8.2" /end CHARACTERISTIC
/begin CHARACTERISTIC FrmMng_DebCsVEH_MODDef_C "defect time for VEH_MOD" VALUE 0xD8E9C Kw_Wu16 65535.00 OneToOne 0.00 65535.00 FORMAT "%8.2" /end CHARACTERISTIC
/begin CHARACTERISTIC FrmMng_DebCsVEH_MODOk_C "Defect debouncing for check sum for VEH_MOD signal" VALUE 0xD8E9E Kw_Wu16 65535.00 OneToOne 0.00 65535.00 FORMAT "%8.2" /end CHARACTERISTIC
/begin CHARACTERISTIC FrmMng_DebGearbxRpmOk_C "Entprellzeit bevor die Anforderung der Getriebedrehzahlschwellensenkung zurück genommen wird" VALUE 0xD8EA0 Kw_Wu16 65540.00 Time_ms 0.00 65540.00 FORMAT "%8.2" EXTENDED_LIMITS 0.00 655350.0 /end CHARACTERISTIC
/begin CHARACTERISTIC FrmMng_DebGearbxRpmRduc_C "Entprellzeit bevor die Anforderung der Getriebedrehzahlschwellensenkung gesendet wird" VALUE 0xD8EA2 Kw_Wu16 65540.00 Time_ms 0.00 65540.00 FORMAT "%8.2" EXTENDED_LIMITS 0.00 655350.0 /end CHARACTERISTIC
/begin CHARACTERISTIC FrmMng_DebSigANFRADMOMPTDef_C "Defektentprellung für RADMOM_PT_1-messages Signalfehler" VALUE 0xD8EA4 Kw_Wu16 65535.00 OneToOne 0.00 65535.00 FORMAT "%8.2" /end CHARACTERISTIC
/begin CHARACTERISTIC FrmMng_DebSigANFRADMOMPTOk_C "Heilentprellung für RADMOM_PT_1-messages Signalfehler" VALUE 0xD8EA6 Kw_Wu16 65535.00 OneToOne 0.00 65535.00 FORMAT "%8.2" /end CHARACTERISTIC
/begin CHARACTERISTIC FrmMng_ctDebSigASC1Def_C "Entprellung von Signalfehler bei ASC1" VALUE 0xD9192 Kw_Wu16 65535.00 OneToOne 0.00 65535.00 FORMAT "%8.2" /end CHARACTERISTIC
/begin CHARACTERISTIC FrmMng_ctDebSigASC1Ok_C "Entprellung von Signalfehler bei ASC1" VALUE 0xD9194 Kw_Wu16 65535.00 OneToOne 0.00 65535.00 FORMAT "%8.2" /end CHARACTERISTIC
/begin CHARACTERISTIC FrmMng_ctDebSigASC2Def_C "Entprellung von Signalfehler bei ASC2" VALUE 0xD9196 Kw_Wu16 65535.00 OneToOne 0.00 65535.00 FORMAT "%8.2" /end CHARACTERISTIC
/begin CHARACTERISTIC FrmMng_ctDebSigASC2Ok_C "Entprellung von Signalfehler bei ASC2" VALUE 0xD9198 Kw_Wu16 65535.00 OneToOne 0.00 65535.00 FORMAT "%8.2" /end CHARACTERISTIC
/begin CHARACTERISTIC FrmMng_ctDebSigASC3Def_C "Entprellung von Signalfehler bei ASC3" VALUE 0xD919A Kw_Wu16 65535.00 OneToOne 0.00 65535.00 FORMAT "%8.2" /end CHARACTERISTIC
/begin CHARACTERISTIC FrmMng_ctDebSigASC3Ok_C "Entprellung von Signalfehler bei ASC3" VALUE 0xD919C Kw_Wu16 65535.00 OneToOne 0.00 65535.00 FORMAT "%8.2" /end CHARACTERISTIC
/begin CHARACTERISTIC FrmMng_ctDebSigASC4Def_C "Debounce für signal Fehler defekt im Botschaft ASC4" VALUE 0xD919E Kw_Wu16 65535.00 OneToOne 0.00 65535.00 FORMAT "%8.2" /end CHARACTERISTIC
/begin CHARACTERISTIC FrmMng_ctDebSigASC4Ok_C "Entprellung von Signalfehler bei ASC4" VALUE 0xD91A0 Kw_Wu16 65535.00 OneToOne 0.00 65535.00 FORMAT "%8.2" /end CHARACTERISTIC
/begin CHARACTERISTIC FrmMng_DebSigBOS_RESET_2Def_C "Defektzeit des PRGG_CCTR-Signalfehlers" VALUE 0xD8EA8 Kw_Wu16 65535.00 OneToOne 0.00 65535.00 FORMAT "%8.2" /end CHARACTERISTIC
/begin CHARACTERISTIC FrmMng_DebSigBOS_RESET_2Ok_C "Heilungszeit des PRGG_CCTR-Signalfehlers" VALUE 0xD8EAA Kw_Wu16 65535.00 OneToOne 0.00 65535.00 FORMAT "%8.2" /end CHARACTERISTIC
/begin CHARACTERISTIC FrmMng_DebSigBOS_RESETDef_C "debouncing of signal-error BOS_RESET (no.of events)" VALUE 0xD8EAC Kw_Wu16 65535.00 OneToOne 0.00 65535.00 FORMAT "%8.2" /end CHARACTERISTIC
/begin CHARACTERISTIC FrmMng_DebSigBOS_RESETOk_C "debouncing of signal-error BOS_RESET (no.of events)" VALUE 0xD8EAE Kw_Wu16 65535.00 OneToOne 0.00 65535.00 FORMAT "%8.2" /end CHARACTERISTIC
/begin CHARACTERISTIC FrmMng_DebSigDMOMENT_ACCDef_C "#SSD Defect time of DMOMENT_ACC sig" VALUE 0xD8EB0 Kw_Wu16 65535.00 OneToOne 0.00 65535.00 FORMAT "%8.2" /end CHARACTERISTIC
/begin CHARACTERISTIC FrmMng_DebSigDMOMENT_ACCOk_C "Healing time of  DMOMENT_ACC sig" VALUE 0xD8EB2 Kw_Wu16 65535.00 OneToOne 0.00 65535.00 FORMAT "%8.2" /end CHARACTERISTIC
/begin CHARACTERISTIC FrmMng_ctDebSigEGS1Def_C "Entprellung von Signalfehler bei EGS1" VALUE 0xD91A2 Kw_Wu16 65535.00 OneToOne 0.00 65535.00 FORMAT "%8.2" /end CHARACTERISTIC
/begin CHARACTERISTIC FrmMng_ctDebSigEGS1Ok_C "Entprellung von Signalfehler bei EGS1" VALUE 0xD91A4 Kw_Wu16 65535.00 OneToOne 0.00 65535.00 FORMAT "%8.2" /end CHARACTERISTIC
/begin CHARACTERISTIC FrmMng_ctDebSigEGS2Def_C "Entprellung von Signalfehler bei EGS2" VALUE 0xD91A6 Kw_Wu16 65535.00 OneToOne 0.00 65535.00 FORMAT "%8.2" /end CHARACTERISTIC
/begin CHARACTERISTIC FrmMng_ctDebSigEGS2Ok_C "Entprellung von Signalfehler bei EGS2" VALUE 0xD91A8 Kw_Wu16 65535.00 OneToOne 0.00 65535.00 FORMAT "%8.2" /end CHARACTERISTIC
/begin CHARACTERISTIC FrmMng_DebSigGEARBX_DATA2Def_C "debouncing of signal-error GEARBX_DATA2 (no.of events)" VALUE 0xD8EB4 Kw_Wu16 65535.00 OneToOne 0.00 65535.00 FORMAT "%8.2" /end CHARACTERISTIC
/begin CHARACTERISTIC FrmMng_DebSigGEARBX_DATA2Ok_C "debouncing of signal-error GEARBX_DATA (no.of events)" VALUE 0xD8EB6 Kw_Wu16 65535.00 OneToOne 0.00 65535.00 FORMAT "%8.2" /end CHARACTERISTIC
/begin CHARACTERISTIC FrmMng_DebSigGEARBX_DATADef_C "debouncing of signal-error GEARBX_DATA (no.of events)" VALUE 0xD8EB8 Kw_Wu16 65535.00 OneToOne 0.00 65535.00 FORMAT "%8.2" /end CHARACTERISTIC
/begin CHARACTERISTIC FrmMng_DebSigGEARBX_DATAOk_C "debouncing of signal-error GEARBX_DATA (no.of events)" VALUE 0xD8EBA Kw_Wu16 65535.00 OneToOne 0.00 65535.00 FORMAT "%8.2" /end CHARACTERISTIC
/begin CHARACTERISTIC FrmMng_DebSigHEAT_ACDef_C "debouncing of signal-error HEAT_AC (no.of events)" VALUE 0xD8EBC Kw_Wu16 65535.00 OneToOne 0.00 65535.00 FORMAT "%8.2" /end CHARACTERISTIC
/begin CHARACTERISTIC FrmMng_DebSigHEAT_ACOk_C "debouncing of signal-error HEAT_AC (no.of events)" VALUE 0xD8EBE Kw_Wu16 65535.00 OneToOne 0.00 65535.00 FORMAT "%8.2" /end CHARACTERISTIC
/begin CHARACTERISTIC FrmMng_ctDebSigINSTR2Def_C "Defekterkennung von Signalfehlern der INSTR2-Botschaft" VALUE 0xD91AA Kw_Wu16 65535.00 OneToOne 0.00 65535.00 FORMAT "%8.2" /end CHARACTERISTIC
/begin CHARACTERISTIC FrmMng_ctDebSigINSTR2Ok_C "Heilerkennung von Signalfehlern der INSTR2-Botschaft" VALUE 0xD91AC Kw_Wu16 65535.00 OneToOne 0.00 65535.00 FORMAT "%8.2" /end CHARACTERISTIC
/begin CHARACTERISTIC FrmMng_ctDebSigINSTR3Def_C "Defekterkennung Signalfehler der INSTR3-Botschaft" VALUE 0xD91AE Kw_Wu16 65535.00 OneToOne 0.00 65535.00 FORMAT "%8.2" /end CHARACTERISTIC
/begin CHARACTERISTIC FrmMng_ctDebSigINSTR3Ok_C "Heilerkennung Signalfehler der INSTR3-Botschaft" VALUE 0xD91B0 Kw_Wu16 65535.00 OneToOne 0.00 65535.00 FORMAT "%8.2" /end CHARACTERISTIC
/begin CHARACTERISTIC FrmMng_DebSigMILEAGE_RANGEDef_C "#SSD debouncing of signal-error MILEAGE_RANGE ( no of events )" VALUE 0xD8EC0 Kw_Wu16 65535.00 OneToOne 0.00 65535.00 FORMAT "%8.2" /end CHARACTERISTIC
/begin CHARACTERISTIC FrmMng_DebSigMILEAGE_RANGEOk_C "debounce of signal - error MILEAGE_RANGE( no of events)" VALUE 0xD8EC2 Kw_Wu16 65535.00 OneToOne 0.00 65535.00 FORMAT "%8.2" /end CHARACTERISTIC
/begin CHARACTERISTIC FrmMng_DebSigOPCRCTLACCDef_C "#SSD debouncing of signal OPCRCTLACC (no.of events)" VALUE 0xD8EC4 Kw_Wu16 65535.00 OneToOne 0.00 65535.00 FORMAT "%8.2" /end CHARACTERISTIC
/begin CHARACTERISTIC FrmMng_DebSigOPCRCTLACCOk_C "debouncing of signal OPCRCTLACC (no.of events)" VALUE 0xD8EC6 Kw_Wu16 65535.00 OneToOne 0.00 65535.00 FORMAT "%8.2" /end CHARACTERISTIC
/begin CHARACTERISTIC FrmMng_DebSigParkConsumerDef_C "Defektentprellzeit des Signalfehlers der CAN-Botschaft PWMG_STANDVERBR" VALUE 0xD8EC8 Kw_Wu16 65535.00 OneToOne 0.00 65535.00 FORMAT "%8.2" /end CHARACTERISTIC
/begin CHARACTERISTIC FrmMng_DebSigParkConsumerOk_C "Heilungsentprellzeit des Signalfehlers der CAN-Botschaft PWMG_STANDVERBR" VALUE 0xD8ECA Kw_Wu16 65535.00 OneToOne 0.00 65535.00 FORMAT "%8.2" /end CHARACTERISTIC
/begin CHARACTERISTIC FrmMng_DebSigPRGG_CCTRDef_C "Defect time for PRGG_CCTR-signalerror" VALUE 0xD8ECC Kw_Wu16 65535.00 OneToOne 0.00 65535.00 FORMAT "%8.2" /end CHARACTERISTIC
/begin CHARACTERISTIC FrmMng_DebSigPRGG_CCTROk_C "Healing time for PRGG_CCTR-signalerror" VALUE 0xD8ECE Kw_Wu16 65535.00 OneToOne 0.00 65535.00 FORMAT "%8.2" /end CHARACTERISTIC
/begin CHARACTERISTIC FrmMng_DebSigPWRMNG_LOADVDef_C "Defektzeit des PWRMNG_LOADV-Signalfehlers" VALUE 0xD8ED0 Kw_Wu16 65535.00 OneToOne 0.00 65535.00 FORMAT "%8.2" /end CHARACTERISTIC
/begin CHARACTERISTIC FrmMng_DebSigPWRMNG_LOADVOk_C "Heilungszeit des PWRMNG_LOADV-Signalfehlers" VALUE 0xD8ED2 Kw_Wu16 65535.00 OneToOne 0.00 65535.00 FORMAT "%8.2" /end CHARACTERISTIC
/begin CHARACTERISTIC FrmMng_DebSigRQ_STG_EFANDef_C "Defektentprellung für RQ_STG_EFAN-messages Signalfehler" VALUE 0xD8ED4 Kw_Wu16 65535.00 OneToOne 0.00 65535.00 FORMAT "%8.2" /end CHARACTERISTIC
/begin CHARACTERISTIC FrmMng_DebSigRQ_STG_EFANOk_C "Heilentprellung für RQ_STG_EFAN messages Signalfehler" VALUE 0xD8ED6 Kw_Wu16 65535.00 OneToOne 0.00 65535.00 FORMAT "%8.2" /end CHARACTERISTIC
/begin CHARACTERISTIC FrmMng_ctDebSigSITZGURTDef_C "STAT_SITZBELEGUNG_GURT rohes messagebyte 0" VALUE 0xD8ED8 Kw_Wu16 65535.00 OneToOne 0.00 65535.00 FORMAT "%8.2" /end CHARACTERISTIC
/begin CHARACTERISTIC FrmMng_ctDebSigSITZGURTOk_C "Heilentprellung für STAT_SITZBELEGUNG_GURT-messages Signalfehler" VALUE 0xD8EDA Kw_Wu16 65535.00 OneToOne 0.00 65535.00 FORMAT "%8.2" /end CHARACTERISTIC
/begin CHARACTERISTIC FrmMng_DebSigSTAT_ANHDef_C "Defektzeit des PRGG_CCTR-Signalfehlers" VALUE 0xD8EDC Kw_Wu16 65535.00 OneToOne 0.00 65535.00 FORMAT "%8.2" /end CHARACTERISTIC
/begin CHARACTERISTIC FrmMng_DebSigSTAT_ANHOk_C "Heilungszeit des PRGG_CCTR-Signalfehlers" VALUE 0xD8EDE Kw_Wu16 65535.00 OneToOne 0.00 65535.00 FORMAT "%8.2" /end CHARACTERISTIC
/begin CHARACTERISTIC FrmMng_DebSigSTAT_ARSDef_C "#SSD debouncing of signal-error STAT_ARS (no.of events)" VALUE 0xD8EE0 Kw_Wu16 65535.00 OneToOne 0.00 65535.00 FORMAT "%8.2" /end CHARACTERISTIC
/begin CHARACTERISTIC FrmMng_DebSigSTAT_ARSOk_C "debouncing of signal-error STAT_ARS (no.of events)" VALUE 0xD8EE2 Kw_Wu16 65535.00 OneToOne 0.00 65535.00 FORMAT "%8.2" /end CHARACTERISTIC
/begin CHARACTERISTIC FrmMng_DebSigSTAT_DSCDef_C "#SSD debouncing of signal-error STAT_DSC (no.of events)" VALUE 0xD8EE4 Kw_Wu16 65535.00 OneToOne 0.00 65535.00 FORMAT "%8.2" /end CHARACTERISTIC
/begin CHARACTERISTIC FrmMng_DebSigSTAT_DSCOk_C "debouncing of signal-error STAT_DSC (no.of events)" VALUE 0xD8EE6 Kw_Wu16 65535.00 OneToOne 0.00 65535.00 FORMAT "%8.2" /end CHARACTERISTIC
/begin CHARACTERISTIC FrmMng_DebSigSTAT_EKPDef_C "Defektentprellung für STAT_EKP-messages Signalfehler" VALUE 0xD8EE8 Kw_Wu16 65535.00 OneToOne 0.00 65535.00 FORMAT "%8.2" /end CHARACTERISTIC
/begin CHARACTERISTIC FrmMng_DebSigSTAT_EKPOk_C "Heilentprellung für STAT_EKP messages Signalfehler" VALUE 0xD8EEA Kw_Wu16 65535.00 OneToOne 0.00 65535.00 FORMAT "%8.2" /end CHARACTERISTIC
/begin CHARACTERISTIC FrmMng_DebSigSTAT_KOMBIDef_C "#SSD debouncing of signal-error STAT_KOMBI (no.of events)" VALUE 0xD8EEC Kw_Wu16 65535.00 OneToOne 0.00 65535.00 FORMAT "%8.2" /end CHARACTERISTIC
/begin CHARACTERISTIC FrmMng_DebSigSTAT_KOMBIOk_C "debouncing of signal-error STAT_KOMBI (no.of events)" VALUE 0xD8EEE Kw_Wu16 65535.00 OneToOne 0.00 65535.00 FORMAT "%8.2" /end CHARACTERISTIC
/begin CHARACTERISTIC FrmMng_ctDebOBDGbxMilOfDef_C "Defektl-Entprellzähler für MilOf" VALUE 0xD8EF0 Kw_Wu16 655350.0 Time_ms 0.00 655350.0 FORMAT "%8.1" /end CHARACTERISTIC
/begin CHARACTERISTIC FrmMng_ctDebSigStOBDGbxMilOfOk_C "Healing time for MIL off" VALUE 0xD8EF2 Kw_Wu16 655350.0 Time_ms 0.00 655350.0 FORMAT "%8.1" /end CHARACTERISTIC
/begin CHARACTERISTIC FrmMng_ctDebOBDGbxMilOnDef_C "Defekt-Entprellzähler für MilOn" VALUE 0xD8EF4 Kw_Wu16 655350.0 Time_ms 0.00 655350.0 FORMAT "%8.1" /end CHARACTERISTIC
/begin CHARACTERISTIC FrmMng_ctDebSigStOBDGbxMilOnOk_C "Healing time for MIL on" VALUE 0xD8EF6 Kw_Wu16 655350.0 Time_ms 0.00 655350.0 FORMAT "%8.1" /end CHARACTERISTIC
/begin CHARACTERISTIC FrmMng_DebSigTEMPRELTIMEDef_C "debouncing of signal-error PWRMNGLOADV (no.of events)" VALUE 0xD8EF8 Kw_Wu16 65535.00 OneToOne 0.00 65535.00 FORMAT "%8.2" /end CHARACTERISTIC
/begin CHARACTERISTIC FrmMng_DebSigTEMPRELTIMEOk_C "debouncing of signal-error PWRMNGLOADV (no.of events)" VALUE 0xD8EFA Kw_Wu16 65535.00 OneToOne 0.00 65535.00 FORMAT "%8.2" /end CHARACTERISTIC
/begin CHARACTERISTIC FrmMng_DebSigTERMINALDef_C "debouncing of signal-error TERMINAL(no.of events)" VALUE 0xD8EFC Kw_Wu16 65535.00 OneToOne 0.00 65535.00 FORMAT "%8.2" /end CHARACTERISTIC
/begin CHARACTERISTIC FrmMng_DebSigTERMINALOk_C "debouncing of signal-error TERMINAL(no.of events)" VALUE 0xD8EFE Kw_Wu16 65535.00 OneToOne 0.00 65535.00 FORMAT "%8.2" /end CHARACTERISTIC
/begin CHARACTERISTIC FrmMng_DebSigTIME_DATEDef_C "Defektzeit des PRGG_CCTR-Signalfehlers" VALUE 0xD8F00 Kw_Wu16 65535.00 OneToOne 0.00 65535.00 FORMAT "%8.2" /end CHARACTERISTIC
/begin CHARACTERISTIC FrmMng_DebSigTIME_DATEOk_C "Heilungszeit des PRGG_CCTR-Signalfehlers" VALUE 0xD8F02 Kw_Wu16 65535.00 OneToOne 0.00 65535.00 FORMAT "%8.2" /end CHARACTERISTIC
/begin CHARACTERISTIC FrmMng_DebSigTORQUE_DSCDef_C "#SSD debouncing of signal-error TORQUE_DSC (no.of events)" VALUE 0xD8F04 Kw_Wu16 65535.00 OneToOne 0.00 65535.00 FORMAT "%8.2" /end CHARACTERISTIC
/begin CHARACTERISTIC FrmMng_DebSigTORQUE_DSCOk_C "debouncing of signal-error TORQUE_DSC (no.of events)" VALUE 0xD8F06 Kw_Wu16 65535.00 OneToOne 0.00 65535.00 FORMAT "%8.2" /end CHARACTERISTIC
/begin CHARACTERISTIC FrmMng_DebSigTORQUE_GEARBXDef_C "#SSD debouncing of signal-error TORQUE_GEARBX (no.of events)" VALUE 0xD8F08 Kw_Wu16 65535.00 OneToOne 0.00 65535.00 FORMAT "%8.2" /end CHARACTERISTIC
/begin CHARACTERISTIC FrmMng_DebSigTORQUE_GEARBXOk_C "debouncing of signal-error TORQUE_GEARBX (no.of events)" VALUE 0xD8F0A Kw_Wu16 65535.00 OneToOne 0.00 65535.00 FORMAT "%8.2" /end CHARACTERISTIC
/begin CHARACTERISTIC FrmMng_DebSigVEH_MODDef_C "defect debouncing time for signal error for VEH_MOD signal" VALUE 0xD8F0C Kw_Wu16 65535.00 OneToOne 0.00 65535.00 FORMAT "%8.2" /end CHARACTERISTIC
/begin CHARACTERISTIC FrmMng_DebSigVEH_MODOk_C "Debouncing time for sig error for VEH_MOD signal" VALUE 0xD8F0E Kw_Wu16 65535.00 OneToOne 0.00 65535.00 FORMAT "%8.2" /end CHARACTERISTIC
/begin CHARACTERISTIC FrmMng_DebSigVELOCITYDef_C "debouncing of signal-error VELOCITY (no.of events)" VALUE 0xD8F10 Kw_Wu16 65535.00 OneToOne 0.00 65535.00 FORMAT "%8.2" /end CHARACTERISTIC
/begin CHARACTERISTIC FrmMng_DebSigVELOCITYOk_C "debouncing of signal-error VELOCITY (no.of events)" VALUE 0xD8F12 Kw_Wu16 65535.00 OneToOne 0.00 65535.00 FORMAT "%8.2" /end CHARACTERISTIC
/begin CHARACTERISTIC FrmMng_ctDebSigWHEEL_SPEEDDef_C "Fehlerentprellzeit für CAN message Wheel Speed (Signalfehler)" VALUE 0xD8F14 Kw_Wu16 65535.00 OneToOne 0.00 65535.00 FORMAT "%8.2" /end CHARACTERISTIC
/begin CHARACTERISTIC FrmMng_ctDebSigWHEEL_SPEEDOk_C "Heilungsentprellzeit für CAN message Wheel Speed (Signalfehler)" VALUE 0xD8F16 Kw_Wu16 65535.00 OneToOne 0.00 65535.00 FORMAT "%8.2" /end CHARACTERISTIC
/begin CHARACTERISTIC FrmMng_DebTGearbxDef_C "debouncing of TGearbx for defect detection" VALUE 0xD8F18 Kw_Wu16 65535.00 OneToOne 0.00 65535.00 FORMAT "%8.2" /end CHARACTERISTIC
/begin CHARACTERISTIC FrmMng_DebTGearbxOk_C "debouncing of TGearbx for healing" VALUE 0xD8F1A Kw_Wu16 65535.00 OneToOne 0.00 65535.00 FORMAT "%8.2" /end CHARACTERISTIC
/begin CHARACTERISTIC FrmMng_DebToANFRADMOMPTDef_C "Defektentprellung für RADMOM_PT_1-messages Timeout" VALUE 0xD8F1C Kw_Wu16 65535.00 OneToOne 0.00 65535.00 FORMAT "%8.2" /end CHARACTERISTIC
/begin CHARACTERISTIC FrmMng_DebToANFRADMOMPTOk_C "Heilentprellung für RADMOM_PT_1-messages Timeout" VALUE 0xD8F1E Kw_Wu16 65535.00 OneToOne 0.00 65535.00 FORMAT "%8.2" /end CHARACTERISTIC
/begin CHARACTERISTIC FrmMng_ctDebToASC1Def_C "#SSD Entprellung von Signal-Timeout bei ASC1" VALUE 0xD91B2 Kw_Wu16 65535.00 OneToOne 0.00 65535.00 FORMAT "%8.2" /end CHARACTERISTIC
/begin CHARACTERISTIC FrmMng_ctDebToASC1Ok_C "Entprellzähler, Heilung ASC1 Signal-Timeout" VALUE 0xD91B4 Kw_Wu16 65535.00 OneToOne 0.00 65535.00 FORMAT "%8.2" /end CHARACTERISTIC
/begin CHARACTERISTIC FrmMng_ctDebToASC2Def_C "Entprellung des timeout - Error ASC2" VALUE 0xD91B6 Kw_Wu16 65535.00 OneToOne 0.00 65535.00 FORMAT "%8.2" /end CHARACTERISTIC
/begin CHARACTERISTIC FrmMng_ctDebToASC2Ok_C "Entprellung des timeout - Error ASC2" VALUE 0xD91B8 Kw_Wu16 65535.00 OneToOne 0.00 65535.00 FORMAT "%8.2" /end CHARACTERISTIC
/begin CHARACTERISTIC FrmMng_ctDebToASC3Def_C "Entprellung des timeout - Error ASC3" VALUE 0xD91BA Kw_Wu16 65535.00 OneToOne 0.00 65535.00 FORMAT "%8.2" /end CHARACTERISTIC
/begin CHARACTERISTIC FrmMng_ctDebToASC3Ok_C "Entprellung des timeout - Error ACS3" VALUE 0xD91BC Kw_Wu16 65535.00 OneToOne 0.00 65535.00 FORMAT "%8.2" /end CHARACTERISTIC
/begin CHARACTERISTIC FrmMng_ctDebToASC4Def_C "Debounce für Timeout Fehler von Botschaft ASC4" VALUE 0xD91BE Kw_Wu16 65535.00 OneToOne 0.00 65535.00 FORMAT "%8.2" /end CHARACTERISTIC
/begin CHARACTERISTIC FrmMng_ctDebToASC4Ok_C "Heilentprellung für ASC4-Botschaft Timeout" VALUE 0xD91C0 Kw_Wu16 65535.00 OneToOne 0.00 65535.00 FORMAT "%8.2" /end CHARACTERISTIC
/begin CHARACTERISTIC FrmMng_DebToBOS_RESET_2Def_C "Defektzeit der PRGG_CCTR-Botschaften Timeout" VALUE 0xD8F20 Kw_Wu16 65535.00 OneToOne 0.00 65535.00 FORMAT "%8.2" /end CHARACTERISTIC
/begin CHARACTERISTIC FrmMng_DebToBOS_RESET_2Ok_C "Heilungszeit der PRGG_CCTR-Botschaften Timeout" VALUE 0xD8F22 Kw_Wu16 65535.00 OneToOne 0.00 65535.00 FORMAT "%8.2" /end CHARACTERISTIC
/begin CHARACTERISTIC FrmMng_DebToBOS_RESETDef_C "debouncing of timeout-error BOS_RESET (no.of events)" VALUE 0xD8F24 Kw_Wu16 65535.00 OneToOne 0.00 65535.00 FORMAT "%8.2" /end CHARACTERISTIC
/begin CHARACTERISTIC FrmMng_DebToBOS_RESETOk_C "debouncing of timeout-error BOS_RESET (no.of events)" VALUE 0xD8F26 Kw_Wu16 65535.00 OneToOne 0.00 65535.00 FORMAT "%8.2" /end CHARACTERISTIC
/begin CHARACTERISTIC FrmMng_DebToDMOMENT_ACCDef_C "#SSD Defect time of DMOMENT_ACC time out" VALUE 0xD8F28 Kw_Wu16 65535.00 OneToOne 0.00 65535.00 FORMAT "%8.2" /end CHARACTERISTIC
/begin CHARACTERISTIC FrmMng_DebToDMOMENT_ACCOk_C "Healing time  of  DMOMENT_ACC  time out" VALUE 0xD8F2A Kw_Wu16 65535.00 OneToOne 0.00 65535.00 FORMAT "%8.2" /end CHARACTERISTIC
/begin CHARACTERISTIC FrmMng_ctDebToEGS1Def_C "Entprellung des timeout - Error EGS1" VALUE 0xD91C2 Kw_Wu16 65535.00 OneToOne 0.00 65535.00 FORMAT "%8.2" /end CHARACTERISTIC
/begin CHARACTERISTIC FrmMng_ctDebToEGS1Ok_C "Entprellung des Timeout - Error" VALUE 0xD91C4 Kw_Wu16 65535.00 OneToOne 0.00 65535.00 FORMAT "%8.2" /end CHARACTERISTIC
/begin CHARACTERISTIC FrmMng_ctDebToEGS2Def_C "Entprellung des timeout - Error EGS2" VALUE 0xD91C6 Kw_Wu16 65535.00 OneToOne 0.00 65535.00 FORMAT "%8.2" /end CHARACTERISTIC
/begin CHARACTERISTIC FrmMng_ctDebToEGS2Ok_C "Entprellung des timeout - Error EGS2" VALUE 0xD91C8 Kw_Wu16 65535.00 OneToOne 0.00 65535.00 FORMAT "%8.2" /end CHARACTERISTIC
/begin CHARACTERISTIC FrmMng_DebToGEARBX_DATA2Def_C "debouncing of timeout-error GEARBX_DATA2 (no.of events)" VALUE 0xD8F2C Kw_Wu16 65535.00 OneToOne 0.00 65535.00 FORMAT "%8.2" /end CHARACTERISTIC
/begin CHARACTERISTIC FrmMng_DebToGEARBX_DATA2Ok_C "Healing time for GEARBX_DATA2-messages Timeout" VALUE 0xD8F2E Kw_Wu16 65535.00 OneToOne 0.00 65535.00 FORMAT "%8.2" /end CHARACTERISTIC
/begin CHARACTERISTIC FrmMng_DebToGEARBX_DATADef_C "debouncing of timeout-error GEARBX_DATA (no.of events)" VALUE 0xD8F30 Kw_Wu16 65535.00 OneToOne 0.00 65535.00 FORMAT "%8.2" /end CHARACTERISTIC
/begin CHARACTERISTIC FrmMng_DebToGEARBX_DATAOk_C "debouncing of timeout-error GEARBX_DATA (no.of events)" VALUE 0xD8F32 Kw_Wu16 65535.00 OneToOne 0.00 65535.00 FORMAT "%8.2" /end CHARACTERISTIC
/begin CHARACTERISTIC FrmMng_DebToHEAT_ACDef_C "debouncing of timeout-error HEAT_AC (no.of events)" VALUE 0xD8F34 Kw_Wu16 65535.00 OneToOne 0.00 65535.00 FORMAT "%8.2" /end CHARACTERISTIC
/begin CHARACTERISTIC FrmMng_DebToHEAT_ACOk_C "debouncing of timeout-error HEAT_AC (no.of events)" VALUE 0xD8F36 Kw_Wu16 65535.00 OneToOne 0.00 65535.00 FORMAT "%8.2" /end CHARACTERISTIC
/begin CHARACTERISTIC FrmMng_ctDebToINSTR2Def_C "Defekterkennung Timeout INSTR2-Botschaft" VALUE 0xD91CA Kw_Wu16 65535.00 OneToOne 0.00 65535.00 FORMAT "%8.2" /end CHARACTERISTIC
/begin CHARACTERISTIC FrmMng_ctDebToINSTR2Ok_C "Heilerkennung Timeout INSTR2-Botschaft" VALUE 0xD91CC Kw_Wu16 65535.00 OneToOne 0.00 65535.00 FORMAT "%8.2" /end CHARACTERISTIC
/begin CHARACTERISTIC FrmMng_ctDebToINSTR3Def_C "Defekterkennung Timeout INSTR3-Botschaft" VALUE 0xD91CE Kw_Wu16 65535.00 OneToOne 0.00 65535.00 FORMAT "%8.2" /end CHARACTERISTIC
/begin CHARACTERISTIC FrmMng_ctDebToINSTR3Ok_C "Heilerkennung Timeout INSTR3-Botschaft" VALUE 0xD91D0 Kw_Wu16 65535.00 OneToOne 0.00 65535.00 FORMAT "%8.2" /end CHARACTERISTIC
/begin CHARACTERISTIC FrmMng_DebToMILEAGE_RANGEDef_C "#SSD debouncing of timeout - error MILEAGE_RANGE(no of events)" VALUE 0xD8F38 Kw_Wu16 65535.00 OneToOne 0.00 65535.00 FORMAT "%8.2" /end CHARACTERISTIC
/begin CHARACTERISTIC FrmMng_DebToMILEAGE_RANGEOk_C "debouncing of timeout - error MILEAGE_RANGE (no of events)" VALUE 0xD8F3A Kw_Wu16 65535.00 OneToOne 0.00 65535.00 FORMAT "%8.2" /end CHARACTERISTIC
/begin CHARACTERISTIC FrmMng_DebToOPCRCTLACCDef_C "#SSD debouncing of timeout-error OPCRCTLACC (no.of events)" VALUE 0xD8F3C Kw_Wu16 65535.00 OneToOne 0.00 65535.00 FORMAT "%8.2" /end CHARACTERISTIC
/begin CHARACTERISTIC FrmMng_DebToOPCRCTLACCOk_C "debouncing of timeout-error OPCRCTLACC (no.of events)" VALUE 0xD8F3E Kw_Wu16 65535.00 OneToOne 0.00 65535.00 FORMAT "%8.2" /end CHARACTERISTIC
/begin CHARACTERISTIC FrmMng_DebToParkConsumerDef_C "Defektentprellzeit Botschaftsausfall PWMG_STANDVERBR" VALUE 0xD8F40 Kw_Wu16 65535.00 OneToOne 0.00 65535.00 FORMAT "%8.2" /end CHARACTERISTIC
/begin CHARACTERISTIC FrmMng_DebToParkConsumerOk_C "Heilentprellzeit Botschaftsausfall PWMG_STANDVERBR" VALUE 0xD8F42 Kw_Wu16 65535.00 OneToOne 0.00 65535.00 FORMAT "%8.2" /end CHARACTERISTIC
/begin CHARACTERISTIC FrmMng_DebToPRGG_CCTRDef_C "Defect time for PRGG_CCTR-messages Timeout" VALUE 0xD8F44 Kw_Wu16 65535.00 OneToOne 0.00 65535.00 FORMAT "%8.2" /end CHARACTERISTIC
/begin CHARACTERISTIC FrmMng_DebToPRGG_CCTROk_C "Healing time for PRGG_CCTR-messages Timeout" VALUE 0xD8F46 Kw_Wu16 65535.00 OneToOne 0.00 65535.00 FORMAT "%8.2" /end CHARACTERISTIC
/begin CHARACTERISTIC FrmMng_DebToPWRMNG_LOADVDef_C "Defektzeit der PWRMNG_LOADV-Botschaften Timeout" VALUE 0xD8F48 Kw_Wu16 65535.00 OneToOne 0.00 65535.00 FORMAT "%8.2" /end CHARACTERISTIC
/begin CHARACTERISTIC FrmMng_DebToPWRMNG_LOADVOk_C "Heilungszeit der PWRMNG_LOADV-Botschaften Timeout" VALUE 0xD8F4A Kw_Wu16 65535.00 OneToOne 0.00 65535.00 FORMAT "%8.2" /end CHARACTERISTIC
/begin CHARACTERISTIC FrmMng_DebToRQ_STG_EFANDef_C "Defektentprellung für RQ_STG_EFAN - messages timeout" VALUE 0xD8F4C Kw_Wu16 65535.00 OneToOne 0.00 65535.00 FORMAT "%8.2" /end CHARACTERISTIC
/begin CHARACTERISTIC FrmMng_DebToRQ_STG_EFANOk_C "Heilentprellung für RQ_STG_EFAN - messages timeout" VALUE 0xD8F4E Kw_Wu16 65535.00 OneToOne 0.00 65535.00 FORMAT "%8.2" /end CHARACTERISTIC
/begin CHARACTERISTIC FrmMng_ctDebToSITZGURTDef_C "Defektentprellung für STAT_SITZBELEGUNG_GURT-messages Timeout" VALUE 0xD8F50 Kw_Wu16 65535.00 OneToOne 0.00 65535.00 FORMAT "%8.2" /end CHARACTERISTIC
/begin CHARACTERISTIC FrmMng_ctDebToSITZGURTOk_C "Heilentprellung für STAT_SITZBELEGUNG_GURT-messages Timeout" VALUE 0xD8F52 Kw_Wu16 65535.00 OneToOne 0.00 65535.00 FORMAT "%8.2" /end CHARACTERISTIC
/begin CHARACTERISTIC FrmMng_DebToSTAT_ANHDef_C "Defektzeit der PRGG_CCTR-Botschaften Timeout" VALUE 0xD8F54 Kw_Wu16 65535.00 OneToOne 0.00 65535.00 FORMAT "%8.2" /end CHARACTERISTIC
/begin CHARACTERISTIC FrmMng_DebToSTAT_ANHOk_C "Heilungszeit der PRGG_CCTR-Botschaften Timeout" VALUE 0xD8F56 Kw_Wu16 65535.00 OneToOne 0.00 65535.00 FORMAT "%8.2" /end CHARACTERISTIC
/begin CHARACTERISTIC FrmMng_DebToSTAT_ARSDef_C "#SSD debouncing of timeout-error STAT_ARS (no.of events)" VALUE 0xD8F58 Kw_Wu16 65535.00 OneToOne 0.00 65535.00 FORMAT "%8.2" /end CHARACTERISTIC
/begin CHARACTERISTIC FrmMng_DebToSTAT_ARSOk_C "debouncing of timeout-error STAT_ARS (no.of events)" VALUE 0xD8F5A Kw_Wu16 65535.00 OneToOne 0.00 65535.00 FORMAT "%8.2" /end CHARACTERISTIC
/begin CHARACTERISTIC FrmMng_DebToSTAT_DSCDef_C "#SSD debouncing of timeout-error STAT_DSC (no.of events)" VALUE 0xD8F5C Kw_Wu16 65535.00 OneToOne 0.00 65535.00 FORMAT "%8.2" /end CHARACTERISTIC
/begin CHARACTERISTIC FrmMng_DebToSTAT_DSCOk_C "debouncing of timeout-error STAT_DSC (no.of events)" VALUE 0xD8F5E Kw_Wu16 65535.00 OneToOne 0.00 65535.00 FORMAT "%8.2" /end CHARACTERISTIC
/begin CHARACTERISTIC FrmMng_DebToSTAT_EKPDef_C "Defektentprellung für STAT_EKPmessages  Timeout fehler" VALUE 0xD8F60 Kw_Wu16 65535.00 OneToOne 0.00 65535.00 FORMAT "%8.2" /end CHARACTERISTIC
/begin CHARACTERISTIC FrmMng_DebToSTAT_EKPOk_C "Heilentprellung  für STAT_EKP-messages Timeout lfehler" VALUE 0xD8F62 Kw_Wu16 65535.00 OneToOne 0.00 65535.00 FORMAT "%8.2" /end CHARACTERISTIC
/begin CHARACTERISTIC FrmMng_DebToSTAT_KOMBIDef_C "#SSD debouncing of timeout - error STAT_KOMBI (no of events)" VALUE 0xD8F64 Kw_Wu16 65535.00 OneToOne 0.00 65535.00 FORMAT "%8.2" /end CHARACTERISTIC
/begin CHARACTERISTIC FrmMng_DebToSTAT_KOMBIOk_C "debouncing of timeout - error STAT_KOMBI (no of events)" VALUE 0xD8F66 Kw_Wu16 65535.00 OneToOne 0.00 65535.00 FORMAT "%8.2" /end CHARACTERISTIC
/begin CHARACTERISTIC FrmMng_DebToTEMPRELTIMEDef_C "debouncing of timeout-error TEMPRELTIME (no.of events)" VALUE 0xD8F68 Kw_Wu16 65535.00 OneToOne 0.00 65535.00 FORMAT "%8.2" /end CHARACTERISTIC
/begin CHARACTERISTIC FrmMng_DebToTEMPRELTIMEOk_C "debouncing of timeout-error TEMPRELTIME (no.of events)" VALUE 0xD8F6A Kw_Wu16 65535.00 OneToOne 0.00 65535.00 FORMAT "%8.2" /end CHARACTERISTIC
/begin CHARACTERISTIC FrmMng_DebToTERMINALDef_C "debouncing of timeout-error TERMINAL (no.of events)" VALUE 0xD8F6C Kw_Wu16 65535.00 OneToOne 0.00 65535.00 FORMAT "%8.2" /end CHARACTERISTIC
/begin CHARACTERISTIC FrmMng_DebToTERMINALOk_C "debouncing of timeout-error TERMINAL (no.of events)" VALUE 0xD8F6E Kw_Wu16 65535.00 OneToOne 0.00 65535.00 FORMAT "%8.2" /end CHARACTERISTIC
/begin CHARACTERISTIC FrmMng_DebToTIME_DATEDef_C "Defektzeit der PRGG_CCTR-Botschaften Timeout" VALUE 0xD8F70 Kw_Wu16 65535.00 OneToOne 0.00 65535.00 FORMAT "%8.2" /end CHARACTERISTIC
/begin CHARACTERISTIC FrmMng_DebToTIME_DATEOk_C "Heilungszeit der PRGG_CCTR-Botschaften Timeout" VALUE 0xD8F72 Kw_Wu16 65535.00 OneToOne 0.00 65535.00 FORMAT "%8.2" /end CHARACTERISTIC
/begin CHARACTERISTIC FrmMng_DebToTORQUE_DSCDef_C "#SSD debouncing of timeout-error TORQUE_DSC (no.of events)" VALUE 0xD8F74 Kw_Wu16 65535.00 OneToOne 0.00 65535.00 FORMAT "%8.2" /end CHARACTERISTIC
/begin CHARACTERISTIC FrmMng_DebToTORQUE_DSCOk_C "debouncing of timeout-error TORQUE_DSC (no.of events)" VALUE 0xD8F76 Kw_Wu16 65535.00 OneToOne 0.00 65535.00 FORMAT "%8.2" /end CHARACTERISTIC
/begin CHARACTERISTIC FrmMng_DebToTORQUE_GEARBXDef_C "#SSD debouncing of timeout-error TORQUE_GEARBX (no.of events)" VALUE 0xD8F78 Kw_Wu16 65535.00 OneToOne 0.00 65535.00 FORMAT "%8.2" /end CHARACTERISTIC
/begin CHARACTERISTIC FrmMng_DebToTORQUE_GEARBXOk_C "debouncing of timeout-error TORQUE_GEARBX (no.of events)" VALUE 0xD8F7A Kw_Wu16 65535.00 OneToOne 0.00 65535.00 FORMAT "%8.2" /end CHARACTERISTIC
/begin CHARACTERISTIC FrmMng_DebToVEH_MODDef_C "Defect debouncing time VEH_MOD" VALUE 0xD8F7C Kw_Wu16 65535.00 OneToOne 0.00 65535.00 FORMAT "%8.2" /end CHARACTERISTIC
/begin CHARACTERISTIC FrmMng_DebToVEH_MODOk_C "Debouncing OK time for VEH_MOD signal" VALUE 0xD8F7E Kw_Wu16 65535.00 OneToOne 0.00 65535.00 FORMAT "%8.2" /end CHARACTERISTIC
/begin CHARACTERISTIC FrmMng_DebToVELOCITYDef_C "debouncing of timeout-error VELOCITY (no.of events)" VALUE 0xD8F80 Kw_Wu16 65535.00 OneToOne 0.00 65535.00 FORMAT "%8.2" /end CHARACTERISTIC
/begin CHARACTERISTIC FrmMng_DebToVELOCITYOk_C "debouncing of timeout-error VELOCITY (no.of events)" VALUE 0xD8F82 Kw_Wu16 65535.00 OneToOne 0.00 65535.00 FORMAT "%8.2" /end CHARACTERISTIC
/begin CHARACTERISTIC FrmMng_ctDebToWHEEL_SPEEDDef_C "#SSD Fehlerentprellzeit für CAN message Wheel Speed (timeout)" VALUE 0xD8F84 Kw_Wu16 65535.00 OneToOne 0.00 65535.00 FORMAT "%8.2" /end CHARACTERISTIC
/begin CHARACTERISTIC FrmMng_ctDebToWHEEL_SPEEDOk_C "Fehlerheilungszeit für CAN message Wheel Speed (timeout)" VALUE 0xD8F86 Kw_Wu16 65535.00 OneToOne 0.00 65535.00 FORMAT "%8.2" /end CHARACTERISTIC
/begin CHARACTERISTIC FrmMng_dEngGearbox_C "gearboxcode for multiplexinfo[1]" VALUE 0xD91D2 Kw_Wu8 63.00 OneToOne 0.00 63.00 FORMAT "%5.2" EXTENDED_LIMITS 0.00 255.0 /end CHARACTERISTIC
/begin CHARACTERISTIC FrmMng_dOBDCtrl_C "mulinfo[3] of DDE2" VALUE 0xD91D3 Kw_Wu8 63.00 OneToOne 0.00 63.00 FORMAT "%5.2" EXTENDED_LIMITS 0.00 255.0 /end CHARACTERISTIC
/begin CHARACTERISTIC FrmMng_drAPP1Min_C "threshold for accelerator padel 1 value" VALUE 0xD8F88 Kw_Ws16 5000.000 PrcPerSec 0.00 5000.000 FORMAT "%8.3" EXTENDED_LIMITS -20000.00 19999.39 /end CHARACTERISTIC
/begin CHARACTERISTIC FrmMng_dstGearbx_C "Umrechnung fuer GANG_INF" VAL_BLK 0xD91D4 Kwb_Wu8 16.00 OneToOne 0.00 16.00 FORMAT "%5.2" EXTENDED_LIMITS 0.00 255.0 NUMBER 8 /end CHARACTERISTIC
/begin CHARACTERISTIC FrmMng_dstGear_C "#SSD translationtable ST_GR_GRB to FrmMng_stGear" VAL_BLK 0xD8F8A Kwb_Wu8 14.00 OneToOne 0.00 14.00 FORMAT "%5.2" EXTENDED_LIMITS 0.00 255.0 NUMBER 15 /end CHARACTERISTIC
/begin CHARACTERISTIC FrmMng_dTrqWheelRmpUp_C "Negative Radmoment Rampensteigung" VALUE 0xD8F9C Kw_Wu32 13107199.9969 RmpTrqPrp 0.00 13107199.9969 FORMAT "%13.4" /end CHARACTERISTIC
/begin CHARACTERISTIC FrmMng_dTrqWheelRmpDwn_C "Positive Radmoment Rampensteigung" VALUE 0xD8FA0 Kw_Wu32 13107199.9969 RmpTrqPrp 0.00 13107199.9969 FORMAT "%13.4" /end CHARACTERISTIC
/begin CHARACTERISTIC FrmMng_facTrqAC_MAP "Korrekturfaktor für Drehmomentanforderung Klimaanlage" MAP 0xD8FA4 Kf_Xs16_Ys16_Ws16 6000.000 Fact 0.00 6000.000 FORMAT "%8.3" EXTENDED_LIMITS -4.000000 3.999878
 /begin AXIS_DESCR STD_AXIS FrmMng_trqAC_mp Trq 4 0.00 30.00000 FORMAT "%8.5" EXTENDED_LIMITS -3276.800 3276.700 DEPOSIT ABSOLUTE /end AXIS_DESCR
 /begin AXIS_DESCR STD_AXIS Eng_nAvrg EngN 4 0.00 6000.000 FORMAT "%8.3" EXTENDED_LIMITS -32768.00 32767.00 DEPOSIT ABSOLUTE /end AXIS_DESCR
/end CHARACTERISTIC
/begin CHARACTERISTIC FrmMng_factrqInrStrt_C "Faktor zur Minimierung des inneren Moments im Startfall" VALUE 0xD8FD8 Kw_Wu16 7.999878 Fact 0.00 7.999878 FORMAT "%8.6" /end CHARACTERISTIC
/begin CHARACTERISTIC FrmMng_FDCSelfRec_C "Schalter zur Auswahl des FDC Selbstanerkennung" VALUE 0xD8FDA Kw_Wu8 1.000 OneToOne 0.00 1.000 FORMAT "%5.3" EXTENDED_LIMITS 0.00 255.0 /end CHARACTERISTIC
/begin CHARACTERISTIC FrmMng_FGRSelfRec_C "Switch to disable/enable FGR self recognition" VALUE 0xD8FDB Kw_Wu8 1.000 OneToOne 0.00 1.000 FORMAT "%5.3" EXTENDED_LIMITS 0.00 255.0 /end CHARACTERISTIC
/begin CHARACTERISTIC FrmMng_cnvFLLV_FUTA_Offset_C "#SSD Offset to calculate FST from CAN" VALUE 0xD8FDC Kw_Ws16 65535.00 OneToOne -32768.00 32767.00 FORMAT "%8.2" /end CHARACTERISTIC
/begin CHARACTERISTIC FrmMng_cnvFLLV_FUTA_Slope_C "#SSD Slope to calculate FST from CAN" VALUE 0xD8FDE Kw_Ws16 65.53500 SlopeRes1000 -32.76800 32.76700 FORMAT "%8.5" /end CHARACTERISTIC
/begin CHARACTERISTIC FrmMng_fst_Offset_C "#SSD Umrechnung Füllstand CAN-->intern Offset" VALUE 0xD91DC Kw_Ws16 65535.00 OneToOne -32768.00 32767.00 FORMAT "%8.2" /end CHARACTERISTIC
/begin CHARACTERISTIC FrmMng_fst_Slope_C "#SSD Umrechnung Füllstand CAN-->intern Steigung" VALUE 0xD91DE Kw_Ws16 65.53500 SlopeRes1000 -32.76800 32.76700 FORMAT "%8.5" /end CHARACTERISTIC
/begin CHARACTERISTIC FrmMng_kmst_Offset_C "#SSD Offset für Kilometerstandsumrechnung" VALUE 0xD91E0 Kw_Ws16 65535.00 OneToOne -32768.00 32767.00 FORMAT "%8.2" /end CHARACTERISTIC
/begin CHARACTERISTIC FrmMng_kmst_Slope_C "#SSD Slope für Kilometerstandsumrechnung" VALUE 0xD91E2 Kw_Ws16 65.53500 SlopeRes1000 -32.76800 32.76700 FORMAT "%8.5" /end CHARACTERISTIC
/begin CHARACTERISTIC FrmMng_mskDM_ANF_ACC_C "Maskierung des Signalfehlers von einzelnen Signalen der Botschaft" VALUE 0xD8FE0 Kw_Wu16 65535.00 OneToOne 0.00 65535.00 FORMAT "%8.2" /end CHARACTERISTIC
/begin CHARACTERISTIC FrmMng_mskDM_ANF_AFS_C "mask for the status bits to supress unwanted errors" VALUE 0xD8FE2 Kw_Wu8 255.0 OneToOne 0.00 255.0 FORMAT "%5.1" /end CHARACTERISTIC
/begin CHARACTERISTIC FrmMng_mskDM_ANF_SSG_C "Maske um mittels Status Bits div. Fehler auszublenden" VALUE 0xD8FE4 Kw_Wu16 65535.00 OneToOne 0.00 65535.00 FORMAT "%8.2" /end CHARACTERISTIC
/begin CHARACTERISTIC FrmMng_mskGEARBX_DATA_C "Maske um mittels Status Bits div. Fehler auszublenden" VALUE 0xD8FE6 Kw_Wu16 65535.00 OneToOne 0.00 65535.00 FORMAT "%8.2" /end CHARACTERISTIC
/begin CHARACTERISTIC FrmMng_mskHEAT_AC_C "label to mask signal error of message HEAT_AC" VALUE 0xD8FE8 Kw_Wu16 65535.00 OneToOne 0.00 65535.00 FORMAT "%8.2" /end CHARACTERISTIC
/begin CHARACTERISTIC FrmMng_mskSTAT_ARS_C "mask signalerrors" VALUE 0xD8FEA Kw_Wu16 65535.00 OneToOne 0.00 65535.00 FORMAT "%8.2" /end CHARACTERISTIC
/begin CHARACTERISTIC FrmMng_mskTORQUE_DSC_C "mask signal errors" VALUE 0xD8FEC Kw_Wu16 65535.00 OneToOne 0.00 65535.00 FORMAT "%8.2" /end CHARACTERISTIC
/begin CHARACTERISTIC FrmMng_mskTORQUE_GEARBX_C " mask signalerrors" VALUE 0xD8FEE Kw_Wu16 65535.00 OneToOne 0.00 65535.00 FORMAT "%8.2" /end CHARACTERISTIC
/begin CHARACTERISTIC FrmMng_nAvrg_Def_C "#SSD Fehlerwert für nAvrg" VALUE 0xD91E4 Kw_Wu16 10240.00 EngN 0.00 10240.00 FORMAT "%8.2" EXTENDED_LIMITS 0.00 65535.00 /end CHARACTERISTIC
/begin CHARACTERISTIC FrmMng_nAvrg_Slope_C "#SSD Slope für nAvrg" VALUE 0xD91E6 Kw_Wu16 32767.00 OneToOne 0.00 32767.00 FORMAT "%8.2" EXTENDED_LIMITS 0.00 65535.00 /end CHARACTERISTIC
/begin CHARACTERISTIC FrmMng_nDiv_Fac_C "#SSD Divisionsfaktor für nAvrg Slope" VALUE 0xD91E8 Kw_Wu16 32767.00 OneToOne 0.00 32767.00 FORMAT "%8.2" EXTENDED_LIMITS 0.00 65535.00 /end CHARACTERISTIC
/begin CHARACTERISTIC FrmMng_nEngOFF_C "Engine speed threshold for engine state" VALUE 0xD8FF0 Kw_Ws16 8000.000 EngN 0.00 8000.000 FORMAT "%8.3" EXTENDED_LIMITS -32768.00 32767.00 /end CHARACTERISTIC
/begin CHARACTERISTIC FrmMng_nEngON_C "Drehzahlschwelle für Motorzustand Start" VALUE 0xD8FF2 Kw_Ws16 8000.000 EngN 0.00 8000.000 FORMAT "%8.3" EXTENDED_LIMITS -32768.00 32767.00 /end CHARACTERISTIC
/begin CHARACTERISTIC FrmMng_nEngRpm1_CUR "Curve for calculating the engine speed threshold 1" CURVE 0xD8FF4 Kl_Xs16_Ws16 5960.000 EngN 40.00000 6000.000 FORMAT "%8.3" EXTENDED_LIMITS -32768.00 32767.00
 /begin AXIS_DESCR STD_AXIS FrmMng_tEngRpm_mp Temp_Cels 6 -50.14000 199.8600 FORMAT "%8.4" EXTENDED_LIMITS -3549.940 3003.560 DEPOSIT ABSOLUTE /end AXIS_DESCR
/end CHARACTERISTIC
/begin CHARACTERISTIC FrmMng_nEngRpm2_CUR "Curve for calculating the engine speed threshold 2" CURVE 0xD900E Kl_Xs16_Ws16 5960.000 EngN 40.00000 6000.000 FORMAT "%8.3" EXTENDED_LIMITS -32768.00 32767.00
 /begin AXIS_DESCR STD_AXIS FrmMng_tEngRpm_mp Temp_Cels 6 -50.14000 199.8600 FORMAT "%8.4" EXTENDED_LIMITS -3549.940 3003.560 DEPOSIT ABSOLUTE /end AXIS_DESCR
/end CHARACTERISTIC
/begin CHARACTERISTIC FrmMng_nFanDflt_C "Unterlassungs-Fan eilt" VALUE 0xD9028 Kw_Wu16 3000.000 FanSpd 0.00 3000.000 FORMAT "%8.3" EXTENDED_LIMITS 0.00 6000.092 /end CHARACTERISTIC
/begin CHARACTERISTIC FrmMng_nFanErr_C "Fehlerwert für Lüfterdrehzahl" VALUE 0xD91EA Kw_Ws16 6000.092 FanSpd -3000.092 3000.000 FORMAT "%8.3" /end CHARACTERISTIC
/begin CHARACTERISTIC FrmMng_nFan_C "Umsetzungstabelle Lüfterstufe --> Lüfterdrehzahl" VAL_BLK 0xD91EC Kwb_Ws16 3000.000 FanSpd 0.00 3000.000 FORMAT "%8.3" EXTENDED_LIMITS -3000.092 3000.000 NUMBER 16 /end CHARACTERISTIC
/begin CHARACTERISTIC FrmMng_nFan_CUR "Umsetzungstabelle Lüfterstufe --> Lüfterdrehzahl" CURVE 0xD902A Kl_Xs16_Ws16 3000.000 FanSpd 0.00 3000.000 FORMAT "%8.3" EXTENDED_LIMITS -3000.092 3000.000
 /begin AXIS_DESCR STD_AXIS FrmMng_numACFanDes OneToOne 4 0.00 15.00 FORMAT "%5.2" EXTENDED_LIMITS 0.00 255.0 DEPOSIT ABSOLUTE /end AXIS_DESCR
/end CHARACTERISTIC
/begin CHARACTERISTIC FrmMng_nHtgUpActMax_C "speed threshold for evaluating ST_SW_WAUP signal" VALUE 0xD903C Kw_Ws16 5960.000 EngN 40.00000 6000.000 FORMAT "%8.3" EXTENDED_LIMITS -32768.00 32767.00 /end CHARACTERISTIC
/begin CHARACTERISTIC FrmMng_nHtgUpCrCtlMax_C "max cruise control speed switch" VALUE 0xD903E Kw_Ws16 5960.000 EngN 40.00000 6000.000 FORMAT "%8.3" EXTENDED_LIMITS -32768.00 32767.00 /end CHARACTERISTIC
/begin CHARACTERISTIC FrmMng_nLIGovOffs_C "ST_SW_LEV_RPM - status switch level RPM" VALUE 0xD9040 Kw_Ws16 5960.000 EngN 40.00000 6000.000 FORMAT "%8.3" EXTENDED_LIMITS -32768.00 32767.00 /end CHARACTERISTIC
/begin CHARACTERISTIC FrmMng_nLimSSGErr_C "Error value for Maximum engine speed in phase 2 of the switching process" VALUE 0xD9042 Kw_Ws16 5960.000 EngN 40.00000 6000.000 FORMAT "%8.3" EXTENDED_LIMITS -32768.00 32767.00 /end CHARACTERISTIC
/begin CHARACTERISTIC FrmMng_nLISetPoint_Offset_C "#SSD Low idle speed offset value for normalisation" VALUE 0xD920C Kw_Ws16 65535.00 EngN -32768.00 32767.00 FORMAT "%8.2" /end CHARACTERISTIC
/begin CHARACTERISTIC FrmMng_nLISetPoint_Slope_C "#SSD Low idle speed slope value for normalisation" VALUE 0xD920E Kw_Ws16 65.53500 SlopeRes1000 -32.76800 32.76700 FORMAT "%8.5" /end CHARACTERISTIC
/begin CHARACTERISTIC FrmMng_nLLOfsNeg_C "Leerlauf-Drehzahlintervall Minimum" VALUE 0xD9044 Kw_Ws16 6000.000 EngN 0.00 6000.000 FORMAT "%8.3" EXTENDED_LIMITS -32768.00 32767.00 /end CHARACTERISTIC
/begin CHARACTERISTIC FrmMng_nLLOfsPos_C "Leerlauf-Drehzahlintervall Maximum" VALUE 0xD9046 Kw_Ws16 6000.000 EngN 0.00 6000.000 FORMAT "%8.3" EXTENDED_LIMITS -32768.00 32767.00 /end CHARACTERISTIC
/begin CHARACTERISTIC FrmMng_nML_C "Applikationswert zur Begrezung der Motorlaufzustand über CAN" VALUE 0xD9210 Kw_Ws16 5960.000 EngN 40.00000 6000.000 FORMAT "%8.3" EXTENDED_LIMITS -32768.00 32767.00 /end CHARACTERISTIC
/begin CHARACTERISTIC FrmMng_cnvnPSPSpd_Offset_C "#SSD Offset for the calculation of RPM_FU_PP_EL signal" VALUE 0xD9048 Kw_Ws16 65535.00 PSP_Spd -32768.00 32767.00 FORMAT "%8.2" /end CHARACTERISTIC
/begin CHARACTERISTIC FrmMng_cnvnPSPSpd_Slope_C "#SSD Slope for the calculation of RPM_FU_PP_EL signal" VALUE 0xD904A Kw_Ws16 655.3500 SlopeRes100 -327.6800 327.6700 FORMAT "%8.4" /end CHARACTERISTIC
/begin CHARACTERISTIC FrmMng_nRqStgEFan_CUR "Kennlinie zur Berechnung der Lüfterdrehzal aus der Lüfterstufe" CURVE 0xD904C Kl_Xs16_Ws16 3000.000 FanSpd 0.00 3000.000 FORMAT "%8.3" EXTENDED_LIMITS -3000.092 3000.000
 /begin AXIS_DESCR STD_AXIS FrmMng_numRqStgEFan OneToOne 4 0.00 15.00 FORMAT "%5.2" EXTENDED_LIMITS 0.00 255.0 DEPOSIT ABSOLUTE /end AXIS_DESCR
/end CHARACTERISTIC
/begin CHARACTERISTIC FrmMng_nTSCErr_C "Fehlerwert für Eingangsturbinendrehzahl" VALUE 0xD9212 Kw_Wu16 65535.00 EngN 0.00 65535.00 FORMAT "%8.2" /end CHARACTERISTIC
/begin CHARACTERISTIC FrmMng_nTSC_Offset_C "#SSD Offset für Eingangsturbinendrehzahl" VALUE 0xD9214 Kw_Ws16 65535.00 EngN -32768.00 32767.00 FORMAT "%8.2" /end CHARACTERISTIC
/begin CHARACTERISTIC FrmMng_nTSC_Slope_C "#SSD Steigung für Eingangsturbinendrehzahl" VALUE 0xD9216 Kw_Ws16 65.53500 SlopeRes1000 -32.76800 32.76700 FORMAT "%8.5" /end CHARACTERISTIC
/begin CHARACTERISTIC FrmMng_numACFanDesDef_C "Defektwert für FrmMng_numACFanDesDef_C Botschaft" VALUE 0xD905E Kw_Wu8 255.0 OneToOne 0.00 255.0 FORMAT "%5.1" /end CHARACTERISTIC
/begin CHARACTERISTIC FrmMng_numCCAddLevlFlsh_C "State flash cycle for Checkcontroll message 11" VALUE 0xD905F Kw_Wu8 3.000 OneToOne 0.00 3.000 FORMAT "%5.3" EXTENDED_LIMITS 0.00 255.0 /end CHARACTERISTIC
/begin CHARACTERISTIC FrmMng_numCCAddLevlNum_C "#SSD Number Checkcontroll message 11" VALUE 0xD9060 Kw_Wu16 65535.00 OneToOne 0.00 65535.00 FORMAT "%8.2" /end CHARACTERISTIC
/begin CHARACTERISTIC FrmMng_numCCBrkDefFlsh_C "Status Blinken Takt CC-Meldung Bremslichtschalter defekt" VALUE 0xD9062 Kw_Wu8 3.000 OneToOne 0.00 3.000 FORMAT "%5.3" EXTENDED_LIMITS 0.00 255.0 /end CHARACTERISTIC
/begin CHARACTERISTIC FrmMng_numCCBrkDefNum_C "Nummer CC-Meldung Bremslichtschalter defekt" VALUE 0xD9064 Kw_Wu16 65535.00 OneToOne 0.00 65535.00 FORMAT "%8.2" /end CHARACTERISTIC
/begin CHARACTERISTIC FrmMng_numCCbtnachFlsh_C "State flash cycle for Checkcontroll message 17" VALUE 0xD9066 Kw_Wu8 3.000 OneToOne 0.00 3.000 FORMAT "%5.3" EXTENDED_LIMITS 0.00 255.0 /end CHARACTERISTIC
/begin CHARACTERISTIC FrmMng_numCCbtnachNum_C "#SSD Number Checkcontroll message 17" VALUE 0xD9068 Kw_Wu16 65535.00 OneToOne 0.00 65535.00 FORMAT "%8.2" /end CHARACTERISTIC
/begin CHARACTERISTIC FrmMng_numCCbttdfkFlsh_C "State flash cycle for Checkcontroll message 19" VALUE 0xD906A Kw_Wu8 3.000 OneToOne 0.00 3.000 FORMAT "%5.3" EXTENDED_LIMITS 0.00 255.0 /end CHARACTERISTIC
/begin CHARACTERISTIC FrmMng_numCCbttdfkNum_C "Number Checkcontroll message 19" VALUE 0xD906C Kw_Wu16 65535.00 OneToOne 0.00 65535.00 FORMAT "%8.2" /end CHARACTERISTIC
/begin CHARACTERISTIC FrmMng_numCCbttkntFlsh_C "State flash cycle for Checkcontroll message 20" VALUE 0xD906E Kw_Wu8 3.000 OneToOne 0.00 3.000 FORMAT "%5.3" EXTENDED_LIMITS 0.00 255.0 /end CHARACTERISTIC
/begin CHARACTERISTIC FrmMng_numCCbttkntNum_C "Number Checkcontroll message 20" VALUE 0xD9070 Kw_Wu16 65535.00 OneToOne 0.00 65535.00 FORMAT "%8.2" /end CHARACTERISTIC
/begin CHARACTERISTIC FrmMng_numCCGenDef2Flsh_C "State flash cycle for Checkcontroll message 14" VALUE 0xD9072 Kw_Wu8 3.000 OneToOne 0.00 3.000 FORMAT "%5.3" EXTENDED_LIMITS 0.00 255.0 /end CHARACTERISTIC
/begin CHARACTERISTIC FrmMng_numCCGenDef2Num_C "#SSD Number Checkcontroll message 14" VALUE 0xD9074 Kw_Wu16 65535.00 OneToOne 0.00 65535.00 FORMAT "%8.2" /end CHARACTERISTIC
/begin CHARACTERISTIC FrmMng_numCCNoCrCtlFlsh_C "Status Blinken Takt der Checkcontrol Meldung Geschwindigkeitsregelung ohne Funktion" VALUE 0xD9076 Kw_Wu8 3.000 OneToOne 0.00 3.000 FORMAT "%5.3" EXTENDED_LIMITS 0.00 255.0 /end CHARACTERISTIC
/begin CHARACTERISTIC FrmMng_numCCNoCrCtlNum_C "#SSD Nummer der Checkcontrol Meldung Geschwindigkeitsregelung ohne Funktion" VALUE 0xD9078 Kw_Wu16 65535.00 OneToOne 0.00 65535.00 FORMAT "%8.2" /end CHARACTERISTIC
/begin CHARACTERISTIC FrmMng_numCCOelLevlFlsh_C "State flash cycle for Checkcontroll message 10" VALUE 0xD907A Kw_Wu8 3.000 OneToOne 0.00 3.000 FORMAT "%5.3" EXTENDED_LIMITS 0.00 255.0 /end CHARACTERISTIC
/begin CHARACTERISTIC FrmMng_numCCOelLevlNum_C "#SSD Number Checkcontroll message 10" VALUE 0xD907C Kw_Wu16 65535.00 OneToOne 0.00 65535.00 FORMAT "%8.2" /end CHARACTERISTIC
/begin CHARACTERISTIC FrmMng_numCCOelVerbFlsh_C "State flash cycle for Checkcontroll message 8" VALUE 0xD907E Kw_Wu8 3.000 OneToOne 0.00 3.000 FORMAT "%5.3" EXTENDED_LIMITS 0.00 255.0 /end CHARACTERISTIC
/begin CHARACTERISTIC FrmMng_numCCOelVerbNum_C "#SSD Number Checkcontroll message 8" VALUE 0xD9080 Kw_Wu16 65535.00 OneToOne 0.00 65535.00 FORMAT "%8.2" /end CHARACTERISTIC
/begin CHARACTERISTIC FrmMng_numCCOelVerlFlsh_C "State flash cycle for Checkcontroll message 9" VALUE 0xD9082 Kw_Wu8 3.000 OneToOne 0.00 3.000 FORMAT "%5.3" EXTENDED_LIMITS 0.00 255.0 /end CHARACTERISTIC
/begin CHARACTERISTIC FrmMng_numCCOelVerlNum_C "#SSD Number Checkcontroll message 9" VALUE 0xD9084 Kw_Wu16 65535.00 OneToOne 0.00 65535.00 FORMAT "%8.2" /end CHARACTERISTIC
/begin CHARACTERISTIC FrmMng_numCCOilPresFlsh_C "State flash cycle for Checkcontroll message 4" VALUE 0xD9086 Kw_Wu8 3.000 OneToOne 0.00 3.000 FORMAT "%5.3" EXTENDED_LIMITS 0.00 255.0 /end CHARACTERISTIC
/begin CHARACTERISTIC FrmMng_numCCOilPresNum_C "#SSD Number Checkcontroll message 4" VALUE 0xD9088 Kw_Wu16 65535.00 OneToOne 0.00 65535.00 FORMAT "%8.2" /end CHARACTERISTIC
/begin CHARACTERISTIC FrmMng_numCCOvrTem2Flsh_C "State flash cycle for Checkcontroll message 6" VALUE 0xD908A Kw_Wu8 3.000 OneToOne 0.00 3.000 FORMAT "%5.3" EXTENDED_LIMITS 0.00 255.0 /end CHARACTERISTIC
/begin CHARACTERISTIC FrmMng_numCCOvrTem2Num_C "#SSD Number Checkcontroll message 6" VALUE 0xD908C Kw_Wu16 65535.00 OneToOne 0.00 65535.00 FORMAT "%8.2" /end CHARACTERISTIC
/begin CHARACTERISTIC FrmMng_numCCOvrTempFlsh_C "State flash cycle for Checkcontroll message 5" VALUE 0xD908E Kw_Wu8 3.000 OneToOne 0.00 3.000 FORMAT "%5.3" EXTENDED_LIMITS 0.00 255.0 /end CHARACTERISTIC
/begin CHARACTERISTIC FrmMng_numCCOvrTempNum_C "#SSD Number Checkcontroll message 5" VALUE 0xD9090 Kw_Wu16 65535.00 OneToOne 0.00 65535.00 FORMAT "%8.2" /end CHARACTERISTIC
/begin CHARACTERISTIC FrmMng_numCCPFltDefFlsh_C "State flash cycle for Checkcontroll message 12" VALUE 0xD9092 Kw_Wu8 3.000 OneToOne 0.00 3.000 FORMAT "%5.3" EXTENDED_LIMITS 0.00 255.0 /end CHARACTERISTIC
/begin CHARACTERISTIC FrmMng_numCCPFltDefNum_C "#SSD Number Checkcontroll message 12" VALUE 0xD9094 Kw_Wu16 65535.00 OneToOne 0.00 65535.00 FORMAT "%8.2" /end CHARACTERISTIC
/begin CHARACTERISTIC FrmMng_numCCpmerrFlsh_C "State flash cycle for Checkcontroll message 18" VALUE 0xD9096 Kw_Wu8 3.000 OneToOne 0.00 3.000 FORMAT "%5.3" EXTENDED_LIMITS 0.00 255.0 /end CHARACTERISTIC
/begin CHARACTERISTIC FrmMng_numCCpmerrNum_C "#SSD Number Checkcontroll message 18" VALUE 0xD9098 Kw_Wu16 65535.00 OneToOne 0.00 65535.00 FORMAT "%8.2" /end CHARACTERISTIC
/begin CHARACTERISTIC FrmMng_numCCPreGlowFlsh_C "Status Blinken Takt der Checkcontrol Meldung Vorglühen" VALUE 0xD909A Kw_Wu8 3.000 OneToOne 0.00 3.000 FORMAT "%5.3" EXTENDED_LIMITS 0.00 255.0 /end CHARACTERISTIC
/begin CHARACTERISTIC FrmMng_numCCPreGlowNum_C "#SSD Nummer der Checkcontrol Meldung Vorglühen" VALUE 0xD909C Kw_Wu16 65535.00 OneToOne 0.00 65535.00 FORMAT "%8.2" /end CHARACTERISTIC
/begin CHARACTERISTIC FrmMng_numCCprioFlsh_C "State flash cycle for Checkcontroll message 21" VALUE 0xD909E Kw_Wu8 3.000 OneToOne 0.00 3.000 FORMAT "%5.3" EXTENDED_LIMITS 0.00 255.0 /end CHARACTERISTIC
/begin CHARACTERISTIC FrmMng_numCCprioNum_C "#SSD Number Checkcontroll message 21" VALUE 0xD90A0 Kw_Wu16 65535.00 OneToOne 0.00 65535.00 FORMAT "%8.2" /end CHARACTERISTIC
/begin CHARACTERISTIC FrmMng_numCCruhverFlsh_C "State flash cycle for Checkcontroll message 16" VALUE 0xD90A2 Kw_Wu8 3.000 OneToOne 0.00 3.000 FORMAT "%5.3" EXTENDED_LIMITS 0.00 255.0 /end CHARACTERISTIC
/begin CHARACTERISTIC FrmMng_numCCruhverNum_C "#SSD Number Checkcontroll message 16" VALUE 0xD90A4 Kw_Wu16 65535.00 OneToOne 0.00 65535.00 FORMAT "%8.2" /end CHARACTERISTIC
/begin CHARACTERISTIC FrmMng_numCCStatMilFlsh_C "State flash cycle for Checkcontroll message 7" VALUE 0xD90A6 Kw_Wu8 3.000 OneToOne 0.00 3.000 FORMAT "%5.3" EXTENDED_LIMITS 0.00 255.0 /end CHARACTERISTIC
/begin CHARACTERISTIC FrmMng_numCCStatMilLmpTstFlsh_C "State flash cycle for Checkcontroll message 34" VALUE 0xD90A7 Kw_Wu8 3.000 OneToOne 0.00 3.000 FORMAT "%5.3" EXTENDED_LIMITS 0.00 255.0 /end CHARACTERISTIC
/begin CHARACTERISTIC FrmMng_numCCStatMilLmpTstNum_C "#SSD Number Checkcontroll message 34" VALUE 0xD90A8 Kw_Wu16 65535.00 OneToOne 0.00 65535.00 FORMAT "%8.2" /end CHARACTERISTIC
/begin CHARACTERISTIC FrmMng_numCCStatMilNum_C "#SSD Number Checkcontroll message 7" VALUE 0xD90AA Kw_Wu16 65535.00 OneToOne 0.00 65535.00 FORMAT "%8.2" /end CHARACTERISTIC
/begin CHARACTERISTIC FrmMng_numCCSysLampFlsh_C "Status Blinken Takt der Checkcontrol Meldung Motornotprogramm" VALUE 0xD90AC Kw_Wu8 3.000 OneToOne 0.00 3.000 FORMAT "%5.3" EXTENDED_LIMITS 0.00 255.0 /end CHARACTERISTIC
/begin CHARACTERISTIC FrmMng_numCCSysLampNum_C "#SSD Nummer der Checkcontrolmessage Motornotprogramm" VALUE 0xD90AE Kw_Wu16 65535.00 OneToOne 0.00 65535.00 FORMAT "%8.2" /end CHARACTERISTIC
/begin CHARACTERISTIC FrmMng_numInqyID_C "Number Inquiry message 1" VALUE 0xD90B0 Kw_Wu16 65535.00 OneToOne 0.00 65535.00 FORMAT "%8.2" /end CHARACTERISTIC
/begin CHARACTERISTIC FrmMng_numRecACCMax_C "Number of allowed errors for ACC recognition" VALUE 0xD90B2 Kw_Wu8 119.0 OneToOne 1.000 120.0 FORMAT "%5.1" EXTENDED_LIMITS 0.00 255.0 /end CHARACTERISTIC
/begin CHARACTERISTIC FrmMng_numRecACMax_C "maximaler Wert des Erkennungsschalters für Klimaanlage" VALUE 0xD90B3 Kw_Wu8 119.0 OneToOne 1.000 120.0 FORMAT "%5.1" EXTENDED_LIMITS 0.00 255.0 /end CHARACTERISTIC
/begin CHARACTERISTIC FrmMng_numRecAFSMax_C "Maximum number of messages received" VALUE 0xD90B4 Kw_Wu8 119.0 OneToOne 1.000 120.0 FORMAT "%5.1" EXTENDED_LIMITS 0.00 255.0 /end CHARACTERISTIC
/begin CHARACTERISTIC FrmMng_numRecARSMax_C "No of errors for ARS detection" VALUE 0xD90B5 Kw_Wu8 119.0 OneToOne 1.000 120.0 FORMAT "%5.1" EXTENDED_LIMITS 0.00 255.0 /end CHARACTERISTIC
/begin CHARACTERISTIC FrmMng_numRecDCCMax_C "Anzahl Botschaften für Erkennung Empfang Radmomentanforderung-Botschaft" VALUE 0xD90B6 Kw_Wu8 119.0 OneToOne 1.000 120.0 FORMAT "%5.1" EXTENDED_LIMITS 0.00 255.0 /end CHARACTERISTIC
/begin CHARACTERISTIC FrmMng_numRecFDCMax_C "Z" VALUE 0xD90B7 Kw_Wu8 119.0 OneToOne 1.000 120.0 FORMAT "%5.1" EXTENDED_LIMITS 0.00 255.0 /end CHARACTERISTIC
/begin CHARACTERISTIC FrmMng_numRecFGRMax_C "Number of allowed errors for FGR recognition" VALUE 0xD90B8 Kw_Wu8 119.0 OneToOne 1.000 120.0 FORMAT "%5.1" EXTENDED_LIMITS 0.00 255.0 /end CHARACTERISTIC
/begin CHARACTERISTIC FrmMng_dtrqOvrRunRmpUp_C "parameter for overrun shut off ramp up  slope" VALUE 0xD90BC Kw_Wu32 6553584.99908 RmpTrq 14.9993896484 6553599.99847 FORMAT "%13.5" EXTENDED_LIMITS 0.00 6553599.99847 READ_ONLY /end CHARACTERISTIC
/begin CHARACTERISTIC FrmMng_dtrqOvrRunRmpDwn_C "#SSD parameter for overrun shut off ramp down  slope" VALUE 0xD90C0 Kw_Wu32 6553584.99908 RmpTrq 14.9993896484 6553599.99847 FORMAT "%13.5" EXTENDED_LIMITS 0.00 6553599.99847 /end CHARACTERISTIC
/begin CHARACTERISTIC FrmMng_pVal_Offset_C "#SSD Offset für pVal" VALUE 0xD9218 Kw_Ws16 65535.00 OneToOne -32768.00 32767.00 FORMAT "%8.2" /end CHARACTERISTIC
/begin CHARACTERISTIC FrmMng_pVal_Slope_C "#SSD Offset für pVal" VALUE 0xD921A Kw_Ws16 65.53500 SlopeRes1000 -32.76800 32.76700 FORMAT "%8.5" /end CHARACTERISTIC
/begin CHARACTERISTIC FrmMng_qOvrRun_C "ST_INFS - status over-run-fuel-shutoff" VALUE 0xD90C4 Kw_Ws16 327.6700 InjMass 0.00 327.6700 FORMAT "%8.4" EXTENDED_LIMITS -327.6800 327.6700 /end CHARACTERISTIC
/begin CHARACTERISTIC FrmMng_rAppMax_C "Maximum APP Percentage to be sent on CAN" VALUE 0xD90C6 Kw_Ws16 100.0000 Prc 0.00 100.0000 FORMAT "%8.4" EXTENDED_LIMITS -400.0000 399.9878 /end CHARACTERISTIC
/begin CHARACTERISTIC FrmMng_rFlt_Offset_C "#SSD Offset für rFlt" VALUE 0xD921C Kw_Ws16 65535.00 OneToOne -32768.00 32767.00 FORMAT "%8.2" /end CHARACTERISTIC
/begin CHARACTERISTIC FrmMng_rFlt_Slope_C "#SSD Steigung für rFlt" VALUE 0xD921E Kw_Ws16 65.53500 SlopeRes1000 -32.76800 32.76700 FORMAT "%8.5" /end CHARACTERISTIC
/begin CHARACTERISTIC FrmMng_cnvrPSPSetPoint_Offset_C "#SSD Offset Wert für die SETQ_FU_PP_EL signale" VALUE 0xD90C8 Kw_Ws16 799.9878 Prc -400.0000 399.9878 FORMAT "%8.4" /end CHARACTERISTIC
/begin CHARACTERISTIC FrmMng_cnvrPSPSetPoint_Slope_C "#SSD Steigungs Wert für SETQ_FU_PP_EL der STAT_EKP  CAN Botschaft" VALUE 0xD90CA Kw_Ws16 655.3500 SlopeRes100 -327.6800 327.6700 FORMAT "%8.4" /end CHARACTERISTIC
/begin CHARACTERISTIC FrmMng_rWaterVlvClose_C "value for water valve fully closed" VALUE 0xD90CC Kw_Wu16 100.0000 Prc 0.00 100.0000 FORMAT "%8.4" EXTENDED_LIMITS 0.00 799.9878 /end CHARACTERISTIC
/begin CHARACTERISTIC FrmMng_rWaterVlvCtl_C "Control value for water valve" VALUE 0xD90CE Kw_Wu16 100.0000 Prc 0.00 100.0000 FORMAT "%8.4" EXTENDED_LIMITS 0.00 799.9878 /end CHARACTERISTIC
/begin CHARACTERISTIC FrmMng_rWaterVlvOpen_C "value for water valve fully open" VALUE 0xD90D0 Kw_Wu16 100.0000 Prc 0.00 100.0000 FORMAT "%8.4" EXTENDED_LIMITS 0.00 799.9878 /end CHARACTERISTIC
/begin CHARACTERISTIC FrmMng_stBltbDrDef_C "Ersatzwert" VALUE 0xD90D2 Kw_Wu8 255.0 OneToOne 0.00 255.0 FORMAT "%5.1" /end CHARACTERISTIC
/begin CHARACTERISTIC FrmMng_stClCtrDEF_C "#SSD defekt value for FrmMng_stClCtr (CAN message ST_CLCTR)" VALUE 0xD90D3 Kw_Wu8 255.0 OneToOne 0.00 255.0 FORMAT "%5.1" /end CHARACTERISTIC
/begin CHARACTERISTIC FrmMng_stConvErr_C "#SSD Status der Wandlerkupplung, Wert im Fehlerfall" VALUE 0xD90D4 Kw_Wu8 15.00 OneToOne 0.00 15.00 FORMAT "%5.2" EXTENDED_LIMITS 0.00 255.0 /end CHARACTERISTIC
/begin CHARACTERISTIC FrmMng_stFDC_C "application parameter for FrmMng_stFDC value" VALUE 0xD90D5 Kw_Wu8 2.000 OneToOne 0.00 2.000 FORMAT "%5.3" EXTENDED_LIMITS 0.00 255.0 /end CHARACTERISTIC
/begin CHARACTERISTIC FrmMng_stGbxErr_C "Schaltung aktiv, Vorgabewert im Fehlerfall" VALUE 0xD90D6 Kw_Wu8 15.00 OneToOne 0.00 15.00 FORMAT "%5.2" EXTENDED_LIMITS 0.00 255.0 /end CHARACTERISTIC
/begin CHARACTERISTIC Frmmng_stGearbxHtgUpActMsk_C "Masking value for measuring point  Frmmng_stGearbxHtgUpAct_mp" VALUE 0xD90D7 Kw_Wu8 255.0 OneToOne 0.00 255.0 FORMAT "%5.1" /end CHARACTERISTIC
/begin CHARACTERISTIC FrmMng_stGearErr_C "#SSD Vorgabewert bei EGS1 Botschaftsausfall" VALUE 0xD9220 Kw_Wu8 255.0 OneToOne 0.00 255.0 FORMAT "%5.1" /end CHARACTERISTIC
/begin CHARACTERISTIC Frmmng_stGearHtgUpAct_C "velocity threshold for evaluating ST_SW_WAUP signal" VALUE 0xD90D8 Kw_Wu8 6.000 OneToOne 0.00 6.000 FORMAT "%5.3" EXTENDED_LIMITS 0.00 255.0 /end CHARACTERISTIC
/begin CHARACTERISTIC FrmMng_stKeyVldDef_C "Ersatzwert" VALUE 0xD90D9 Kw_Wu8 255.0 OneToOne 0.00 255.0 FORMAT "%5.1" /end CHARACTERISTIC
/begin CHARACTERISTIC FrmMng_stRgnHtgUp_C "Masking for EGT_CmpSt function" VALUE 0xD90DC Kw_Wu32 2147483647.00 OneToOne 0.00 2147483647.00 FORMAT "%13.2" EXTENDED_LIMITS 0.00 4294967295.00 /end CHARACTERISTIC
/begin CHARACTERISTIC FrmMng_stT15Def_C "Intern Fehlerwert für T15" VALUE 0xD90E0 Kw_Wu8 255.0 OneToOne 0.00 255.0 FORMAT "%5.1" /end CHARACTERISTIC
/begin CHARACTERISTIC FrmMng_stT50Def_C "Defektwert für FrmMng_numACFanDesDef_C Botschaft" VALUE 0xD90E1 Kw_Wu8 255.0 OneToOne 0.00 255.0 FORMAT "%5.1" /end CHARACTERISTIC
/begin CHARACTERISTIC FrmMng_Sttorqavl_Errval_C "Error value for status torque actual-value" VALUE 0xD90E2 Kw_Wu8 10.00 OneToOne 0.00 10.00 FORMAT "%5.2" EXTENDED_LIMITS 0.00 255.0 /end CHARACTERISTIC
/begin CHARACTERISTIC FrmMng_stTRadioDef_C "defekt value for FrmMng_stTRadio" VALUE 0xD90E3 Kw_Wu8 255.0 OneToOne 0.00 255.0 FORMAT "%5.1" /end CHARACTERISTIC
/begin CHARACTERISTIC FrmMng_stWghSeatDrDef_C "Ersatzwert" VALUE 0xD90E4 Kw_Wu8 255.0 OneToOne 0.00 255.0 FORMAT "%5.1" /end CHARACTERISTIC
/begin CHARACTERISTIC FrmMng_swtANFRADMOMPT_C "Aktivierung der Botschaft ANF_RADMOM_PT" VALUE 0xD90E5 Kw_Wu8 1.000 OneToOne 0.00 1.000 FORMAT "%5.3" EXTENDED_LIMITS 0.00 255.0 /end CHARACTERISTIC
/begin CHARACTERISTIC FrmMng_swtANFRAGE_C "Schalter, um die Verarbeitung der Message zu deaktivieren (1: aktiviert, 0: deaktiviert)" VALUE 0xD90E6 Kw_Wu8 1.000 OneToOne 0.00 1.000 FORMAT "%5.3" EXTENDED_LIMITS 0.00 255.0 /end CHARACTERISTIC
/begin CHARACTERISTIC FrmMng_swtASC1_C "ASC1 Botschaft aktivieren bzw. deaktivieren (1: aktiviert, 0: deaktiviert)" VALUE 0xD9221 Kw_Wu8 1.000 OneToOne 0.00 1.000 FORMAT "%5.3" EXTENDED_LIMITS 0.00 255.0 /end CHARACTERISTIC
/begin CHARACTERISTIC FrmMng_swtASC2_C "ASC2 Botschaft aktivieren bzw.  deaktivieren (1: aktiviert, 0: deaktiviert)" VALUE 0xD9222 Kw_Wu8 1.000 OneToOne 0.00 1.000 FORMAT "%5.3" EXTENDED_LIMITS 0.00 255.0 /end CHARACTERISTIC
/begin CHARACTERISTIC FrmMng_swtASC3_C "ASC3 Botschaft aktivieren bzw. deaktivieren (1: aktiviert, 0: deaktiviert)" VALUE 0xD9223 Kw_Wu8 1.000 OneToOne 0.00 1.000 FORMAT "%5.3" EXTENDED_LIMITS 0.00 255.0 /end CHARACTERISTIC
/begin CHARACTERISTIC FrmMng_swtASC4_C "ASC4 Botschaft aktivieren bzw. deaktivieren (1: aktiviert, 0: deaktiviert)" VALUE 0xD9224 Kw_Wu8 1.000 OneToOne 0.00 1.000 FORMAT "%5.3" EXTENDED_LIMITS 0.00 255.0 /end CHARACTERISTIC
/begin CHARACTERISTIC FrmMng_swtASDdc_C "Schalter um die ASDdc message zu deaktivieren (1...enabled, 0...disabled)" VALUE 0xD90E7 Kw_Wu8 1.000 OneToOne 0.00 1.000 FORMAT "%5.3" EXTENDED_LIMITS 0.00 255.0 /end CHARACTERISTIC
/begin CHARACTERISTIC FrmMng_swtBOS_Oil_2_C "Aktivieren der CAN-Botschaft BOS Meldung Oil 2 (1...aktiev, 0...inaktiev)" VALUE 0xD90E8 Kw_Wu8 1.000 OneToOne 0.00 1.000 FORMAT "%5.3" EXTENDED_LIMITS 0.00 255.0 /end CHARACTERISTIC
/begin CHARACTERISTIC FrmMng_swtBOS_Oil_C "Schalter zum deaktivieren der Message (0: aktiev, 1: inaktiev)" VALUE 0xD90E9 Kw_Wu8 1.000 OneToOne 0.00 1.000 FORMAT "%5.3" EXTENDED_LIMITS 0.00 255.0 /end CHARACTERISTIC
/begin CHARACTERISTIC FrmMng_swtBOS_PFlt_2_C "Schalter, um die Message BOS_MELDUNG_PFLT_2 zu aktivieren (1...enabled,. 0...disabled)" VALUE 0xD90EA Kw_Wu8 1.000 OneToOne 0.00 1.000 FORMAT "%5.3" EXTENDED_LIMITS 0.00 255.0 /end CHARACTERISTIC
/begin CHARACTERISTIC FrmMng_swtBOS_PFlt_C "Schalter, um die Message BOS_MELDUNG_PFLT zu aktivieren (1...enabled,. 0...disabled)" VALUE 0xD90EB Kw_Wu8 1.000 OneToOne 0.00 1.000 FORMAT "%5.3" EXTENDED_LIMITS 0.00 255.0 /end CHARACTERISTIC
/begin CHARACTERISTIC FrmMng_swtBOS_RESET_2_C "Schalter zum deaktivieren der Auswertung der Message (1: aktiev, 0: inaktiev)" VALUE 0xD90EC Kw_Wu8 1.000 OneToOne 0.00 1.000 FORMAT "%5.3" EXTENDED_LIMITS 0.00 255.0 /end CHARACTERISTIC
/begin CHARACTERISTIC FrmMng_swtBOS_RESET_C "Schalter zum deaktivieren der auswertung von BOS_RESET (1: aktiev, 0: deaktiev)" VALUE 0xD90ED Kw_Wu8 1.000 OneToOne 0.00 1.000 FORMAT "%5.3" EXTENDED_LIMITS 0.00 255.0 /end CHARACTERISTIC
/begin CHARACTERISTIC FrmMng_swtCalcV_C "Radgeschwindigkeiten zur Mitelwertsbildung herangezogen (0...nicht, 1...herangezogen)  Bit0: LV, Bit1: RV, Bit2: LH, Bit3: RH" VALUE 0xD90EE Kw_Wu8 15.00 OneToOne 0.00 15.00 FORMAT "%5.2" EXTENDED_LIMITS 0.00 255.0 /end CHARACTERISTIC
/begin CHARACTERISTIC FrmMng_swtCANA_C "Schalter zum Deaktivieren der Kommunikation des CAN A, 1=AUS" VALUE 0xD9225 Kw_Wu8 1.000 OneToOne 0.00 1.000 FORMAT "%5.3" EXTENDED_LIMITS 0.00 255.0 /end CHARACTERISTIC
/begin CHARACTERISTIC FrmMng_swtCarType_C "Schaltet CAN zwischen 0: E60, 1: E65 und 2: E90" VALUE 0xC3C9C Kw_Wu8 5.00000000000 CarType 0.00 5.00000000000 FORMAT "%13.11" /end CHARACTERISTIC
/begin CHARACTERISTIC FrmMng_swtCCMsg_C "Unterdrücken aller Checkcontrol Meldungen (0=AUS, 1...EIN)" VALUE 0xD90EF Kw_Wu8 1.000 OneToOne 0.00 1.000 FORMAT "%5.3" EXTENDED_LIMITS 0.00 255.0 /end CHARACTERISTIC
/begin CHARACTERISTIC FrmMng_swtCCNoCrCtl_C "Setzten/Löschen der Checkcontrol Meldung Geschwindigkeitsregelung ohne Funktion (1...setzen,. 0...löschen)" VALUE 0xD90F0 Kw_Wu8 1.000 OneToOne 0.00 1.000 FORMAT "%5.3" EXTENDED_LIMITS 0.00 255.0 /end CHARACTERISTIC
/begin CHARACTERISTIC FrmMng_swtCorTrqACC_C "Schalter zur Korrektur von FrmMng_trqACC_TrqDes mit Gearbx_trqFrc (1...Korrektur, 0...keine Korrektur)" VALUE 0xD90F1 Kw_Wu8 1.000 OneToOne 0.00 1.000 FORMAT "%5.3" EXTENDED_LIMITS 0.00 255.0 /end CHARACTERISTIC
/begin CHARACTERISTIC FrmMng_swtCorTrqDSC_C "Schalter zur Korrektur des DSC-Moment durch Gearbx_trqFrc (1...Korrektur, 0...keine Korrektur)" VALUE 0xD90F2 Kw_Wu8 1.000 OneToOne 0.00 1.000 FORMAT "%5.3" EXTENDED_LIMITS 0.00 255.0 /end CHARACTERISTIC
/begin CHARACTERISTIC FrmMng_swtDCCSelfRec_C "Status Aktivierung Erkennung Empfang Radmomentanforderung Botschaft" VALUE 0xD90F3 Kw_Wu8 1.000 OneToOne 0.00 1.000 FORMAT "%5.3" EXTENDED_LIMITS 0.00 255.0 /end CHARACTERISTIC
/begin CHARACTERISTIC FrmMng_swtDDE1_C "DDE1 Botschaft aktivieren/deaktivieren (1...enabled, 0...disabled)" VALUE 0xD9226 Kw_Wu8 1.000 OneToOne 0.00 1.000 FORMAT "%5.3" EXTENDED_LIMITS 0.00 255.0 /end CHARACTERISTIC
/begin CHARACTERISTIC FrmMng_swtDDE2_C "DDE2 Botschaft aktivieren / deaktivieren (1...enabled, 0...disabled)" VALUE 0xD9227 Kw_Wu8 1.000 OneToOne 0.00 1.000 FORMAT "%5.3" EXTENDED_LIMITS 0.00 255.0 /end CHARACTERISTIC
/begin CHARACTERISTIC FrmMng_swtDDE4_C "DDE4 Botschaft aktivieren / deaktivieren (1...enabled, 0...disabled)" VALUE 0xD9228 Kw_Wu8 1.000 OneToOne 0.00 1.000 FORMAT "%5.3" EXTENDED_LIMITS 0.00 255.0 /end CHARACTERISTIC
/begin CHARACTERISTIC FrmMng_swtDMOMENT_ACC_C "#SSD Schalter zum deaktivieren der Message DREHMOMENT_ANF_ACC (1...enabled, 0...disabled)" VALUE 0xD90F4 Kw_Wu8 1.000 OneToOne 0.00 1.000 FORMAT "%5.3" EXTENDED_LIMITS 0.00 255.0 /end CHARACTERISTIC
/begin CHARACTERISTIC FrmMng_swtDM_ANF_AFS_C "Schalter zum aktivieren der Message DREHMOMENT_ANF_AFS (1...enabled, 0...disabled)" VALUE 0xD90F5 Kw_Wu8 1.000 OneToOne 0.00 1.000 FORMAT "%5.3" EXTENDED_LIMITS 0.00 255.0 /end CHARACTERISTIC
/begin CHARACTERISTIC FrmMng_swtDRMANFSSG_C "#SSD SChalter zum aktivieren der Message DREHMOMENT_ANF_SSG  (1...enabled, 0...disabled)" VALUE 0xD90F6 Kw_Wu8 1.000 OneToOne 0.00 1.000 FORMAT "%5.3" EXTENDED_LIMITS 0.00 255.0 /end CHARACTERISTIC
/begin CHARACTERISTIC FrmMng_swtDSCBrkAct_C "Auswahl zwischen 0: DSC-brake intervention, 1: DSC control and 2: ASC control" VALUE 0xD9229 Kw_Wu8 7.000 OneToOne 0.00 7.000 FORMAT "%5.3" EXTENDED_LIMITS 0.00 255.0 /end CHARACTERISTIC
/begin CHARACTERISTIC FrmMng_swtEGS1_C "EGS1 Botschaft aktivieren oder deaktivieren (1...enabled, 0...disabled)" VALUE 0xD922A Kw_Wu8 1.000 OneToOne 0.00 1.000 FORMAT "%5.3" EXTENDED_LIMITS 0.00 255.0 /end CHARACTERISTIC
/begin CHARACTERISTIC FrmMng_swtEGS2_C "EGS2 Botschaft aktivieren bzw. deaktivieren (1...enabled, 0...disabled)" VALUE 0xD922B Kw_Wu8 1.000 OneToOne 0.00 1.000 FORMAT "%5.3" EXTENDED_LIMITS 0.00 255.0 /end CHARACTERISTIC
/begin CHARACTERISTIC FrmMng_swtEKP_C "Schalter für EKP-Botschaft (1...on, 0...off)" VALUE 0xD922C Kw_Wu8 1.000 OneToOne 0.00 1.000 FORMAT "%5.3" EXTENDED_LIMITS 0.00 255.0 /end CHARACTERISTIC
/begin CHARACTERISTIC FrmMng_swtENGINE1_C "Schalter zur Abschaltung der Berechnung von ENGINE1 (1...enabled, 0...disabled)" VALUE 0xD90F7 Kw_Wu8 1.000 OneToOne 0.00 1.000 FORMAT "%5.3" EXTENDED_LIMITS 0.00 255.0 /end CHARACTERISTIC
/begin CHARACTERISTIC FrmMng_swtENGINE_RPM_C "Aktivierung Botschaft ENGINE_RPM (1...enabled, 0...disableb)" VALUE 0xD90F8 Kw_Wu8 1.000 OneToOne 0.00 1.000 FORMAT "%5.3" EXTENDED_LIMITS 0.00 255.0 /end CHARACTERISTIC
/begin CHARACTERISTIC FrmMng_swtEngRpmTempSel_C "Schalter, um die Kuehler- oder die Motor Oel Temperatur auszuwaehlen (1...oel, 0...Kuehler)" VALUE 0xD90F9 Kw_Wu8 1.000 OneToOne 0.00 1.000 FORMAT "%5.3" EXTENDED_LIMITS 0.00 255.0 /end CHARACTERISTIC
/begin CHARACTERISTIC FrmMng_swtFDC_C "Schalter, um den FrmMng_stFDC- Wert auszuwählen (1...Applikationswert, 0...lokaler Wert)" VALUE 0xD90FA Kw_Wu8 1.000 OneToOne 0.00 1.000 FORMAT "%5.3" EXTENDED_LIMITS 0.00 255.0 /end CHARACTERISTIC
/begin CHARACTERISTIC FrmMng_swtGbxRepWTrqIntv_C "abschalten des erhöhenden Getriebemomenten Eingriffes für Signal TORQ_AVL_DMEE" VALUE 0xD90FB Kw_Wu8 1.000 OneToOne 0.00 1.000 FORMAT "%5.3" EXTENDED_LIMITS 0.00 255.0 /end CHARACTERISTIC
/begin CHARACTERISTIC FrmMng_swtGEARBX_DATA2_C "Schalter, um die Message GEARBX_DATA2 zu aktivieren (1...enabled,. 0...disabled)" VALUE 0xD90FC Kw_Wu8 1.000 OneToOne 0.00 1.000 FORMAT "%5.3" EXTENDED_LIMITS 0.00 255.0 /end CHARACTERISTIC
/begin CHARACTERISTIC FrmMng_swtGEARBX_DATA_C "Schalter um die Message  GEARBX_DATA zu aktivieren (1...enabled,. 0...disabled)" VALUE 0xD90FD Kw_Wu8 1.000 OneToOne 0.00 1.000 FORMAT "%5.3" EXTENDED_LIMITS 0.00 255.0 /end CHARACTERISTIC
/begin CHARACTERISTIC FrmMng_swtHEATINGCURRENT_C "Aktivierung und deaktivierung der Message HEATING_CURRENT (1...enabled,. 0...disabled)" VALUE 0xD90FE Kw_Wu8 1.000 OneToOne 0.00 1.000 FORMAT "%5.3" EXTENDED_LIMITS 0.00 255.0 /end CHARACTERISTIC
/begin CHARACTERISTIC FrmMng_swtHEAT_AC_C "Schalter, um die Message HEAT_AC zu aktivieren (1...enabled,. 0...disabled)" VALUE 0xD90FF Kw_Wu8 1.000 OneToOne 0.00 1.000 FORMAT "%5.3" EXTENDED_LIMITS 0.00 255.0 /end CHARACTERISTIC
/begin CHARACTERISTIC FrmMng_swtINSTR2_C "Schalter, um die Message INSTR2 zu aktivieren (1...enabled,. 0...disabled)" VALUE 0xD922D Kw_Wu8 1.000 OneToOne 0.00 1.000 FORMAT "%5.3" EXTENDED_LIMITS 0.00 255.0 /end CHARACTERISTIC
/begin CHARACTERISTIC FrmMng_swtINSTR3_C "Schalter, um die Message INSTR3 zu aktivieren (1...enabled,. 0...disabled)" VALUE 0xD922E Kw_Wu8 1.000 OneToOne 0.00 1.000 FORMAT "%5.3" EXTENDED_LIMITS 0.00 255.0 /end CHARACTERISTIC
/begin CHARACTERISTIC FrmMng_swtLENKRADWINKEL_C "Schalter, um die Message LENKRADWINKEL zu aktivieren (1...enabled,. 0...disabled)" VALUE 0xD9100 Kw_Wu8 1.000 OneToOne 0.00 1.000 FORMAT "%5.3" EXTENDED_LIMITS 0.00 255.0 /end CHARACTERISTIC
/begin CHARACTERISTIC FrmMng_swtMILEAGE_RANGE_C "Schalter, um die Message MILEAGE_RANGE zu aktivieren (1...enabled,. 0...disabled)" VALUE 0xD9101 Kw_Wu8 1.000 OneToOne 0.00 1.000 FORMAT "%5.3" EXTENDED_LIMITS 0.00 255.0 /end CHARACTERISTIC
/begin CHARACTERISTIC FrmMng_swtOEL_MESS_C "Schalter zur Sperrung der Botschaftsbehandlung" VALUE 0xD9102 Kw_Wu8 1.000 OneToOne 0.00 1.000 FORMAT "%5.3" EXTENDED_LIMITS 0.00 255.0 /end CHARACTERISTIC
/begin CHARACTERISTIC FrmMng_swtOPCRCTLACC_C "Schalter, um die Message OP_CRCTLACC zu aktivieren (1...enabled,. 0...disabled)" VALUE 0xD9103 Kw_Wu8 1.000 OneToOne 0.00 1.000 FORMAT "%5.3" EXTENDED_LIMITS 0.00 255.0 /end CHARACTERISTIC
/begin CHARACTERISTIC FrmMng_swtParkConsumer_C "Schalter, um die Message PWRMNG_STANDVBR zu aktivieren (1...enabled,. 0...disabled)" VALUE 0xD9104 Kw_Wu8 1.000 OneToOne 0.00 1.000 FORMAT "%5.3" EXTENDED_LIMITS 0.00 255.0 /end CHARACTERISTIC
/begin CHARACTERISTIC FrmMng_swtPlausOn_C "Schalter, um die Momenteneingriffsmessage zu aktivieren (1...enabled,. 0...disabled)" VALUE 0xD9105 Kw_Wu8 1.000 OneToOne 0.00 1.000 FORMAT "%5.3" EXTENDED_LIMITS 0.00 255.0 /end CHARACTERISTIC
/begin CHARACTERISTIC FrmMng_swtPOWERMGMTBATTSP_C "Schalter, um die Message POWERMGMT_BATTERIESPANNUNG zu aktivieren (1...enabled,. 0...disabled)" VALUE 0xD9106 Kw_Wu8 1.000 OneToOne 0.00 1.000 FORMAT "%5.3" EXTENDED_LIMITS 0.00 255.0 /end CHARACTERISTIC
/begin CHARACTERISTIC FrmMng_swtPRGG_CCTR_C "Schalter, um die Message PRGG_CCTR zu aktivieren (1...enabled,. 0...disabled)" VALUE 0xD9107 Kw_Wu8 1.000 OneToOne 0.00 1.000 FORMAT "%5.3" EXTENDED_LIMITS 0.00 255.0 /end CHARACTERISTIC
/begin CHARACTERISTIC FrmMng_swtPSPOffErr_C "Schalter, um die Message CTR_CR_SWO_EKP zu aktivieren (1...enabled,. 0...disabled)" VALUE 0xD9108 Kw_Wu8 1.000 OneToOne 0.00 1.000 FORMAT "%5.3" EXTENDED_LIMITS 0.00 255.0 /end CHARACTERISTIC
/begin CHARACTERISTIC FrmMng_swtPSPOff_C "Schalter, um die Message CTR_CRASH_SWO_EKP zu aktivieren (1...enabled,. 0...disabled)" VALUE 0xD9109 Kw_Wu8 1.000 OneToOne 0.00 1.000 FORMAT "%5.3" EXTENDED_LIMITS 0.00 255.0 /end CHARACTERISTIC
/begin CHARACTERISTIC FrmMng_swtPWRMNG_CTR_COS_C "Schalter, um die Message PWRMNG_CTR_COS zu aktivieren (1...enabled,. 0...disabled)" VALUE 0xD910A Kw_Wu8 1.000 OneToOne 0.00 1.000 FORMAT "%5.3" EXTENDED_LIMITS 0.00 255.0 /end CHARACTERISTIC
/begin CHARACTERISTIC FrmMng_swtPWRMNG_LOADV_C "Schalter, um die Message PWRMNG_LOADV zu aktivieren (1...enabled,. 0...disabled)" VALUE 0xD910B Kw_Wu8 1.000 OneToOne 0.00 1.000 FORMAT "%5.3" EXTENDED_LIMITS 0.00 255.0 /end CHARACTERISTIC
/begin CHARACTERISTIC FrmMng_swtRADMOM_PT1_C "Aktivierung der Botschaft RADMOM_PT_1" VALUE 0xD910C Kw_Wu8 1.000 OneToOne 0.00 1.000 FORMAT "%5.3" EXTENDED_LIMITS 0.00 255.0 /end CHARACTERISTIC
/begin CHARACTERISTIC FrmMng_swtRADMOM_PT2_C "Aktivierung der Botschaft RADMOM_PT_2" VALUE 0xD910D Kw_Wu8 1.000 OneToOne 0.00 1.000 FORMAT "%5.3" EXTENDED_LIMITS 0.00 255.0 /end CHARACTERISTIC
/begin CHARACTERISTIC FrmMng_swtRPM_STA_C "Schalter, um die Message RPM_STA zu aktivieren (1...enabled,. 0...disabled)" VALUE 0xD910E Kw_Wu8 1.000 OneToOne 0.00 1.000 FORMAT "%5.3" EXTENDED_LIMITS 0.00 255.0 /end CHARACTERISTIC
/begin CHARACTERISTIC FrmMng_swtRQ_STG_EFAN_C "Schalter, um die Message PRQ_STG_EFAN zu aktivieren (1...enabled,. 0...disabled)" VALUE 0xD910F Kw_Wu8 1.000 OneToOne 0.00 1.000 FORMAT "%5.3" EXTENDED_LIMITS 0.00 255.0 /end CHARACTERISTIC
/begin CHARACTERISTIC FrmMng_swtSITZGURT_C "Schalter, um die Message STAT_SITZBELEGUNG_GURT zu aktivieren (1...enabled,. 0...disabled)" VALUE 0xD9110 Kw_Wu8 1.000 OneToOne 0.00 1.000 FORMAT "%5.3" EXTENDED_LIMITS 0.00 255.0 /end CHARACTERISTIC
/begin CHARACTERISTIC FrmMng_swtSPEED_CLCTR_C "Schalter, um die cruise control Message zu aktivieren (1...enabled,. 0...disabled)" VALUE 0xD9111 Kw_Wu8 1.000 OneToOne 0.00 1.000 FORMAT "%5.3" EXTENDED_LIMITS 0.00 255.0 /end CHARACTERISTIC
/begin CHARACTERISTIC FrmMng_swtSTAT_ANH_C "Schalter, um die Message STAT_ANH zu aktivieren (1...enabled,. 0...disabled)" VALUE 0xD9112 Kw_Wu8 1.000 OneToOne 0.00 1.000 FORMAT "%5.3" EXTENDED_LIMITS 0.00 255.0 /end CHARACTERISTIC
/begin CHARACTERISTIC FrmMng_swtSTAT_ARS_C "Schalter, um die Message STAT_ARS zu aktivieren (1...enabled,. 0...disabled)" VALUE 0xD9113 Kw_Wu8 1.000 OneToOne 0.00 1.000 FORMAT "%5.3" EXTENDED_LIMITS 0.00 255.0 /end CHARACTERISTIC
/begin CHARACTERISTIC FrmMng_swtSTAT_DSC_C "Schalter, um die Message STAT_DSC zu aktivieren (1...enabled,. 0...disabled)" VALUE 0xD9114 Kw_Wu8 1.000 OneToOne 0.00 1.000 FORMAT "%5.3" EXTENDED_LIMITS 0.00 255.0 /end CHARACTERISTIC
/begin CHARACTERISTIC FrmMng_swtSTAT_EKP_C "Schalter, um die Message STAT_EKP zu aktivieren (1...enabled,. 0...disabled)" VALUE 0xD9115 Kw_Wu8 1.000 OneToOne 0.00 1.000 FORMAT "%5.3" EXTENDED_LIMITS 0.00 255.0 /end CHARACTERISTIC
/begin CHARACTERISTIC FrmMng_swtSTAT_KOMBI_C "Schalter, um die Message STAT_KOMBI zu aktivieren (1...enabled,. 0...disabled)" VALUE 0xD9116 Kw_Wu8 1.000 OneToOne 0.00 1.000 FORMAT "%5.3" EXTENDED_LIMITS 0.00 255.0 /end CHARACTERISTIC
/begin CHARACTERISTIC FrmMng_swtstCurr_C "Schalter, um die Message CODIERUNG_PM zu aktivieren (1...enabled,. 0...disabled)" VALUE 0xD9117 Kw_Wu8 1.000 OneToOne 0.00 1.000 FORMAT "%5.3" EXTENDED_LIMITS 0.00 255.0 /end CHARACTERISTIC
/begin CHARACTERISTIC FrmMng_swtTEMPRELTIME_C "Schalter, um die Message A_TEMP_RELATIVZEIT zu aktivieren (1...enabled,. 0...disabled)" VALUE 0xD9118 Kw_Wu8 1.000 OneToOne 0.00 1.000 FORMAT "%5.3" EXTENDED_LIMITS 0.00 255.0 /end CHARACTERISTIC
/begin CHARACTERISTIC FrmMng_swtTERMINAL_C "Schalter, um die Message TERMINAL zu aktivieren (1...enabled,. 0...disabled)" VALUE 0xD9119 Kw_Wu8 1.000 OneToOne 0.00 1.000 FORMAT "%5.3" EXTENDED_LIMITS 0.00 255.0 /end CHARACTERISTIC
/begin CHARACTERISTIC FrmMng_swtTIME_DATE_C "Schalter, um die Message TIME_DATE zu aktivieren (1...enabled,. 0...disabled)" VALUE 0xD911A Kw_Wu8 1.000 OneToOne 0.00 1.000 FORMAT "%5.3" EXTENDED_LIMITS 0.00 255.0 /end CHARACTERISTIC
/begin CHARACTERISTIC FrmMng_swtTORQUE1_C "Schalter, um die Message TORQUE1 zu aktivieren (1...enabled,. 0...disabled)" VALUE 0xD911B Kw_Wu8 1.000 OneToOne 0.00 1.000 FORMAT "%5.3" EXTENDED_LIMITS 0.00 255.0 /end CHARACTERISTIC
/begin CHARACTERISTIC FrmMng_swtTORQUE2_C "Schalter, um die Message TORQUE2 zu aktivieren (1...enabled,. 0...disabled)" VALUE 0xD911C Kw_Wu8 2.000 OneToOne 0.00 2.000 FORMAT "%5.3" EXTENDED_LIMITS 0.00 255.0 /end CHARACTERISTIC
/begin CHARACTERISTIC FrmMng_swtTORQUE3_C "Schalter, um die Message TORQUE3 zu aktivieren (1...enabled,. 0...disabled)" VALUE 0xD911D Kw_Wu8 1.000 OneToOne 0.00 1.000 FORMAT "%5.3" EXTENDED_LIMITS 0.00 255.0 /end CHARACTERISTIC
/begin CHARACTERISTIC FrmMng_swtTORQUE_DSC_C "Schalter, um die Message TORQUE_DSC zu aktivieren (1...enabled,. 0...disabled)" VALUE 0xD911E Kw_Wu8 1.000 OneToOne 0.00 1.000 FORMAT "%5.3" EXTENDED_LIMITS 0.00 255.0 /end CHARACTERISTIC
/begin CHARACTERISTIC FrmMng_swtTORQUE_GEARBX_C "Schalter, um die Message TORQUE_GEARBX zu aktivieren (1...enabled,. 0...disabled)" VALUE 0xD911F Kw_Wu8 1.000 OneToOne 0.00 1.000 FORMAT "%5.3" EXTENDED_LIMITS 0.00 255.0 /end CHARACTERISTIC
/begin CHARACTERISTIC FrmMng_swtVEH_MOD_C "Schalter, um die Message VEH_MOD zu aktivieren (1...enabled,. 0...disabled)" VALUE 0xD9120 Kw_Wu8 1.000 OneToOne 0.00 1.000 FORMAT "%5.3" EXTENDED_LIMITS 0.00 255.0 /end CHARACTERISTIC
/begin CHARACTERISTIC FrmMng_swtVELOCITY_C "Schalter, um die Message VELOCITY zu aktivieren (1...enabled,. 0...disabled)" VALUE 0xD9121 Kw_Wu8 1.000 OneToOne 0.00 1.000 FORMAT "%5.3" EXTENDED_LIMITS 0.00 255.0 /end CHARACTERISTIC
/begin CHARACTERISTIC FrmMng_swtWHEEL_SPEED_C "Schalter, um die Wheel Speed Message zu aktivieren (1...enabled,. 0...disabled)" VALUE 0xD9122 Kw_Wu8 1.000 OneToOne 0.00 1.000 FORMAT "%5.3" EXTENDED_LIMITS 0.00 255.0 /end CHARACTERISTIC
/begin CHARACTERISTIC FrmMng_cnvTEMP_EX_Offset_C "#SSD Offset to calculate TEMP_EX from CAN" VALUE 0xD9124 Kw_Ws16 65535.00 OneToOne -32768.00 32767.00 FORMAT "%8.2" /end CHARACTERISTIC
/begin CHARACTERISTIC FrmMng_cnvTEMP_EX_Slope_C "#SSD Slope to calculate TEMP_EX from CAN" VALUE 0xD9126 Kw_Ws16 655.3500 SlopeRes100 -327.6800 327.6700 FORMAT "%8.4" /end CHARACTERISTIC
/begin CHARACTERISTIC FrmMng_tEngLimHi_C "obere Temperaturschwelle für Motortemperatur" VALUE 0xD9128 Kw_Ws16 250.0000 Temp_Cels -50.14000 199.8600 FORMAT "%8.4" EXTENDED_LIMITS -3549.940 3003.560 /end CHARACTERISTIC
/begin CHARACTERISTIC FrmMng_tEngLimLo_C "Untere Temperaturschwelle für Motortemperatur" VALUE 0xD912A Kw_Ws16 250.0000 Temp_Cels -50.14000 199.8600 FORMAT "%8.4" EXTENDED_LIMITS -3549.940 3003.560 /end CHARACTERISTIC
/begin CHARACTERISTIC FrmMng_tEng_Offset_C "#SSD Offset für Motortemperatur" VALUE 0xD9230 Kw_Ws16 65535.00 OneToOne -32768.00 32767.00 FORMAT "%8.2" /end CHARACTERISTIC
/begin CHARACTERISTIC FrmMng_tEng_Slope_C "#SSD Steigung für Motortemperatur" VALUE 0xD9232 Kw_Ws16 65.53500 SlopeRes1000 -32.76800 32.76700 FORMAT "%8.5" /end CHARACTERISTIC
/begin CHARACTERISTIC FrmMng_tEnvDef_C "Defektwert für FrmMng_tEnvDef_C Botschaft" VALUE 0xD912C Kw_Ws16 950.000 Temp_Cels -50.140 899.860 FORMAT "%8.3" EXTENDED_LIMITS -3549.940 3003.560 /end CHARACTERISTIC
/begin CHARACTERISTIC FrmMng_tEnvErr_C "Fehlerwert für Umgebungstemperatur" VALUE 0xD9234 Kw_Ws16 250.0000 Temp_Cels -50.1400 199.8600 FORMAT "%8.4" EXTENDED_LIMITS -3549.940 3003.560 /end CHARACTERISTIC
/begin CHARACTERISTIC FrmMng_tiCCAddLevlCycle_C "#SSD Transmit cycle time in s for Checkcontroll message 11" VALUE 0xD912E Kw_Wu8 13.00 Time_fulls 1.000 14.00 FORMAT "%5.2" EXTENDED_LIMITS 0.00 255.0 /end CHARACTERISTIC
/begin CHARACTERISTIC FrmMng_tiCCBrkDefCycle_C "Sendeart CC-Meldung Bremslichtschalter defekt" VALUE 0xD912F Kw_Wu8 13.00 Time_fulls 1.000 14.00 FORMAT "%5.2" EXTENDED_LIMITS 0.00 255.0 /end CHARACTERISTIC
/begin CHARACTERISTIC FrmMng_tiCCbtnachCycle_C "#SSD Transmit cycle time in s for Checkcontroll message 17" VALUE 0xD9130 Kw_Wu8 13.00 Time_fulls 1.000 14.00 FORMAT "%5.2" EXTENDED_LIMITS 0.00 255.0 /end CHARACTERISTIC
/begin CHARACTERISTIC FrmMng_tiCCbttdfkCycle_C "#SSD Transmit cycle time in s for Checkcontroll message 19" VALUE 0xD9131 Kw_Wu8 13.00 Time_fulls 1.000 14.00 FORMAT "%5.2" EXTENDED_LIMITS 0.00 255.0 /end CHARACTERISTIC
/begin CHARACTERISTIC FrmMng_tiCCbttkntCycle_C "#SSD Transmit cycle time in s for Checkcontroll message 20" VALUE 0xD9132 Kw_Wu8 13.00 Time_fulls 1.000 14.00 FORMAT "%5.2" EXTENDED_LIMITS 0.00 255.0 /end CHARACTERISTIC
/begin CHARACTERISTIC FrmMng_tiCCGenDef2Cycle_C "#SSD Transmit cycle time in s for Checkcontroll message 14" VALUE 0xD9133 Kw_Wu8 13.00 Time_fulls 1.000 14.00 FORMAT "%5.2" EXTENDED_LIMITS 0.00 255.0 /end CHARACTERISTIC
/begin CHARACTERISTIC FrmMng_tiCCNoCrCtlCycle_C "#SSD Sendeart der Checkcontrol Meldung Geschwindigkeitsregelung ohne Funktion" VALUE 0xD9134 Kw_Wu8 13.00 Time_fulls 1.000 14.00 FORMAT "%5.2" EXTENDED_LIMITS 0.00 255.0 /end CHARACTERISTIC
/begin CHARACTERISTIC FrmMng_tiCCOelLevlCycle_C "#SSD Transmit cycle time in s for Checkcontroll message 10" VALUE 0xD9135 Kw_Wu8 13.00 Time_fulls 1.000 14.00 FORMAT "%5.2" EXTENDED_LIMITS 0.00 255.0 /end CHARACTERISTIC
/begin CHARACTERISTIC FrmMng_tiCCOelVerbCycle_C "#SSD Transmit cycle time in s for Checkcontroll message 8" VALUE 0xD9136 Kw_Wu8 13.00 Time_fulls 1.000 14.00 FORMAT "%5.2" EXTENDED_LIMITS 0.00 255.0 /end CHARACTERISTIC
/begin CHARACTERISTIC FrmMng_tiCCOelVerlCycle_C "#SSD Transmit cycle time in s for Checkcontroll message 9" VALUE 0xD9137 Kw_Wu8 13.00 Time_fulls 1.000 14.00 FORMAT "%5.2" EXTENDED_LIMITS 0.00 255.0 /end CHARACTERISTIC
/begin CHARACTERISTIC FrmMng_tiCCOilPresCycle_C "#SSD Transmit cycle time in s for Checkcontroll message 4" VALUE 0xD9138 Kw_Wu8 13.00 Time_fulls 1.000 14.00 FORMAT "%5.2" EXTENDED_LIMITS 0.00 255.0 /end CHARACTERISTIC
/begin CHARACTERISTIC FrmMng_tiCCOvrTem2Cycle_C "#SSD Transmit cycle time in s for Checkcontroll message 6" VALUE 0xD9139 Kw_Wu8 13.00 Time_fulls 1.000 14.00 FORMAT "%5.2" EXTENDED_LIMITS 0.00 255.0 /end CHARACTERISTIC
/begin CHARACTERISTIC FrmMng_tiCCOvrTempCycle_C "#SSD Transmit cycle time in s for Checkcontroll message 5" VALUE 0xD913A Kw_Wu8 13.00 Time_fulls 1.000 14.00 FORMAT "%5.2" EXTENDED_LIMITS 0.00 255.0 /end CHARACTERISTIC
/begin CHARACTERISTIC FrmMng_tiCCPFltDefCycle_C "#SSD Transmit cycle time in s for Checkcontroll message 12" VALUE 0xD913B Kw_Wu8 13.00 Time_fulls 1.000 14.00 FORMAT "%5.2" EXTENDED_LIMITS 0.00 255.0 /end CHARACTERISTIC
/begin CHARACTERISTIC FrmMng_tiCCpmerrCycle_C "#SSD Transmit cycle time in s for Checkcontroll message 18" VALUE 0xD913C Kw_Wu8 13.00 Time_fulls 1.000 14.00 FORMAT "%5.2" EXTENDED_LIMITS 0.00 255.0 /end CHARACTERISTIC
/begin CHARACTERISTIC FrmMng_tiCCPreGlowCycle_C "#SSD Sendeart der Checkcontrol Meldung Vorglühen" VALUE 0xD913D Kw_Wu8 13.00 Time_fulls 1.000 14.00 FORMAT "%5.2" EXTENDED_LIMITS 0.00 255.0 /end CHARACTERISTIC
/begin CHARACTERISTIC FrmMng_tiCCprioCycle_C "#SSD Transmit cycle time in s for Checkcontroll message 21" VALUE 0xD913E Kw_Wu8 13.00 Time_fulls 1.000 14.00 FORMAT "%5.2" EXTENDED_LIMITS 0.00 255.0 /end CHARACTERISTIC
/begin CHARACTERISTIC FrmMng_tiCCruhverCycle_C "#SSD Transmit cycle time in s for Checkcontroll message 16" VALUE 0xD913F Kw_Wu8 13.00 Time_fulls 1.000 14.00 FORMAT "%5.2" EXTENDED_LIMITS 0.00 255.0 /end CHARACTERISTIC
/begin CHARACTERISTIC FrmMng_tiCCStatMilCycle_C "#SSD Transmit cycle time in s for Checkcontroll message 7" VALUE 0xD9140 Kw_Wu8 13.00 Time_fulls 1.000 14.00 FORMAT "%5.2" EXTENDED_LIMITS 0.00 255.0 /end CHARACTERISTIC
/begin CHARACTERISTIC FrmMng_tiCCStatMilLmpTstCycle_C "#SSD Transmit cycle time in s for Checkcontroll message 34" VALUE 0xD9141 Kw_Wu8 13.00 Time_fulls 1.000 14.00 FORMAT "%5.2" EXTENDED_LIMITS 0.00 255.0 /end CHARACTERISTIC
/begin CHARACTERISTIC FrmMng_tiCCSysLampCycle_C "#SSD Sendeart der Checkcontrol Meldung Motornotprogramm" VALUE 0xD9142 Kw_Wu8 13.00 Time_fulls 1.000 14.00 FORMAT "%5.2" EXTENDED_LIMITS 0.00 255.0 /end CHARACTERISTIC
/begin CHARACTERISTIC FrmMng_tiCCTxDeb_C "#SSD Mindestentprelldauer zwischen zwei aufeinanderfolgende Checkcontrol Meldungen" VALUE 0xD9144 Kw_Wu16 1000.000 Time_ms 0.00 1000.000 FORMAT "%8.3" EXTENDED_LIMITS 0.00 655350.0 /end CHARACTERISTIC
/begin CHARACTERISTIC FrmMng_tiDebARS_C "Delay time for debouncing ASCquit" VALUE 0xD9146 Kw_Wu16 655350.0 Time_ms 0.00 655350.0 FORMAT "%8.1" /end CHARACTERISTIC
/begin CHARACTERISTIC FrmMng_tiDebDSC_C "Delay time for debouncing ASCquit" VALUE 0xD9148 Kw_Wu16 655350.0 Time_ms 0.00 655350.0 FORMAT "%8.1" /end CHARACTERISTIC
/begin CHARACTERISTIC FrmMng_tiDebEGS_C "Delay time for debouncing ASCquit" VALUE 0xD914A Kw_Wu16 655350.0 Time_ms 0.00 655350.0 FORMAT "%8.1" /end CHARACTERISTIC
/begin CHARACTERISTIC FrmMng_tiDebHtgUpShutOff_C "Zeit Debounce für Heizungsabsperrvorrichtung" VALUE 0xD914C Kw_Wu16 655350.0 Time_ms 0.00 655350.0 FORMAT "%8.1" /end CHARACTERISTIC
/begin CHARACTERISTIC FrmMng_tiDebHtgUpShutOn_C "Zeit Debounce für Heizungsabsperrvorrichtung" VALUE 0xD914E Kw_Wu16 655350.0 Time_ms 0.00 655350.0 FORMAT "%8.1" /end CHARACTERISTIC
/begin CHARACTERISTIC FrmMng_tiDebSSGDebCltTO_C "Time duration for transmit debouncing" VALUE 0xD9150 Kw_Wu16 1000.000 Time_ms 0.00 1000.000 FORMAT "%8.3" EXTENDED_LIMITS 0.00 655350.0 /end CHARACTERISTIC
/begin CHARACTERISTIC FrmMng_tiDebSSGErrDef_C "defect time for SSG signals plausibility error" VALUE 0xD9152 Kw_Wu16 655350.0 Time_ms 0.00 655350.0 FORMAT "%8.1" /end CHARACTERISTIC
/begin CHARACTERISTIC FrmMng_tiDebSSGErrOk_C "Healing time for SSG signals plausibility error" VALUE 0xD9154 Kw_Wu16 655350.0 Time_ms 0.00 655350.0 FORMAT "%8.1" /end CHARACTERISTIC
/begin CHARACTERISTIC FrmMng_tiDebSSGShftPla_C "Time duration for transmit debouncing" VALUE 0xD9156 Kw_Wu16 1000.000 Time_ms 0.00 1000.000 FORMAT "%8.3" EXTENDED_LIMITS 0.00 655350.0 /end CHARACTERISTIC
/begin CHARACTERISTIC FrmMng_tiDebSSGShOffDef_C "Defect time for SSG signals plausibility error" VALUE 0xD9158 Kw_Wu16 655350.0 Time_ms 0.00 655350.0 FORMAT "%8.1" /end CHARACTERISTIC
/begin CHARACTERISTIC FrmMng_tiDebSSGShOffOk_C "Healing time for SSG signals plausibility error" VALUE 0xD915A Kw_Wu16 655350.0 Time_ms 0.00 655350.0 FORMAT "%8.1" /end CHARACTERISTIC
/begin CHARACTERISTIC FrmMng_tiDebSSGTrqIncPla_C "Time duration for transmit debouncing" VALUE 0xD915C Kw_Wu16 1000.000 Time_ms 0.00 1000.000 FORMAT "%8.3" EXTENDED_LIMITS 0.00 655350.0 /end CHARACTERISTIC
/begin CHARACTERISTIC FrmMng_tiDelayStEng_C "Wartezeit für Motor Status bis 0x04" VALUE 0xD915E Kw_Wu16 655140.0 Time_ms 0.00 655140.0 FORMAT "%8.1" EXTENDED_LIMITS 0.00 655350.0 /end CHARACTERISTIC
/begin CHARACTERISTIC FrmMng_tiDSCDelay1_C "Totzeit für DSC Eingriff" VALUE 0xD9236 Kw_Wu16 655350.0 Time_ms 0.00 655350.0 FORMAT "%8.1" /end CHARACTERISTIC
/begin CHARACTERISTIC FrmMng_tiDSCDelay2_C "Totzeit für DSC Regelung" VALUE 0xD9238 Kw_Wu16 655350.0 Time_ms 0.00 655350.0 FORMAT "%8.1" /end CHARACTERISTIC
/begin CHARACTERISTIC FrmMng_tiDSCDelay3_C "Totzeit für ASC Regelung" VALUE 0xD923A Kw_Wu16 655350.0 Time_ms 0.00 655350.0 FORMAT "%8.1" /end CHARACTERISTIC
/begin CHARACTERISTIC FrmMng_tiRecACCMax_C "Time 10 ms quantum" VALUE 0xD9160 Kw_Wu16 9980.000 Time_ms 20.00000 10000.00 FORMAT "%8.2" EXTENDED_LIMITS 0.00 655350.0 /end CHARACTERISTIC
/begin CHARACTERISTIC FrmMng_tiRecACMax_C "Selbsterkennungsschalter für Klimaanlage" VALUE 0xD9162 Kw_Wu16 9980.000 Time_ms 20.00000 10000.00 FORMAT "%8.2" EXTENDED_LIMITS 0.00 655350.0 /end CHARACTERISTIC
/begin CHARACTERISTIC FrmMng_tiRecAFSMax_C "Time 10 ms quantum" VALUE 0xD9164 Kw_Wu16 9980.000 Time_ms 20.00000 10000.00 FORMAT "%8.2" EXTENDED_LIMITS 0.00 655350.0 /end CHARACTERISTIC
/begin CHARACTERISTIC FrmMng_tiRecARSMax_C "Time 10 ms quantum - ARS" VALUE 0xD9166 Kw_Wu16 9980.000 Time_ms 20.00000 10000.00 FORMAT "%8.2" EXTENDED_LIMITS 0.00 655350.0 /end CHARACTERISTIC
/begin CHARACTERISTIC FrmMng_tiRecDCCMax_C "Zeitfenster für Erkennung Empfang Radmomentanforderung-Botschaft" VALUE 0xD9168 Kw_Wu8 2380. Time_ms 20.00 2400. FORMAT "%5.0" EXTENDED_LIMITS 0.00 2550. /end CHARACTERISTIC
/begin CHARACTERISTIC FrmMng_tiRecFDCMax_C "Zeitfenster für Erkennug Empfang Fahrzeugmodus Botschaft" VALUE 0xD916A Kw_Wu16 9980.000 Time_ms 20.00000 10000.00 FORMAT "%8.2" EXTENDED_LIMITS 0.00 655350.0 /end CHARACTERISTIC
/begin CHARACTERISTIC FrmMng_tiRecFGRMax_C "Maximum time for FGR recognition" VALUE 0xD916C Kw_Wu16 9980.000 Time_ms 20.00000 10000.00 FORMAT "%8.2" EXTENDED_LIMITS 0.00 655350.0 /end CHARACTERISTIC
/begin CHARACTERISTIC FrmMng_tiStartDelay_C "Verzögerungszeit des Start Systems" VALUE 0xD916E Kw_Wu16 655350.0 Time_ms 0.00 655350.0 FORMAT "%8.1" /end CHARACTERISTIC
/begin CHARACTERISTIC FrmMng_trqACErr_C "#SSD Klimakompressor Lastmoment im Fehlerfall" VALUE 0xD923C Kw_Ws16 31.00000 Trq 0.00 31.00000 FORMAT "%8.5" EXTENDED_LIMITS -3276.800 3276.700 /end CHARACTERISTIC
/begin CHARACTERISTIC FrmMng_trqARSCurDef_C "Error value for FrmMng_trqARSCur" VALUE 0xD9170 Kw_Ws16 11000.00 TrqPrp -5000.000 6000.000 FORMAT "%8.3" EXTENDED_LIMITS -6553.600 6553.400 /end CHARACTERISTIC
/begin CHARACTERISTIC FrmMng_trqARSDesDef_C "applicationvalue for desired torque ARS in case of message error" VALUE 0xD9172 Kw_Ws16 11000.00 TrqPrp -5000.000 6000.000 FORMAT "%8.3" EXTENDED_LIMITS -6553.600 6553.400 /end CHARACTERISTIC
/begin CHARACTERISTIC FrmMng_trqGearbxFrc_C "TORQ_TAR_ACC - Drehmoment-Ziel ACC" VALUE 0xD9174 Kw_Ws16 1500.000 Trq -500.0000 1000.000 FORMAT "%8.3" EXTENDED_LIMITS -3276.800 3276.700 /end CHARACTERISTIC
/begin CHARACTERISTIC FrmMng_trqGearbxMaxSubs_C "#SSD Ersatzwert für maximales Getriebemoment im heat modus bei ausgefallenen CAN" VALUE 0xD9176 Kw_Ws16 1500.000 Trq -500.0000 1000.000 FORMAT "%8.3" EXTENDED_LIMITS -3276.800 3276.700 /end CHARACTERISTIC
/begin CHARACTERISTIC FrmMng_trqLiGovMin_C "tarque switch for evaluating ST_SW_WAUP signal" VALUE 0xD9178 Kw_Ws16 1500.000 Trq -500.0000 1000.000 FORMAT "%8.3" EXTENDED_LIMITS -3276.800 3276.700 /end CHARACTERISTIC
/begin CHARACTERISTIC FrmMng_trqLim_CUR "torque limit at system error" CURVE 0xD923E Kl_Xs16_Ws16 11000.00 TrqPrp -5000.000 6000.000 FORMAT "%8.3" EXTENDED_LIMITS -6553.600 6553.400
 /begin AXIS_DESCR STD_AXIS Eng_nAvrg EngN 10 -32768.00 6000.000 FORMAT "%8.2" EXTENDED_LIMITS -32768.00 32767.00 DEPOSIT ABSOLUTE /end AXIS_DESCR
/end CHARACTERISTIC
/begin CHARACTERISTIC FrmMng_trqNorm_C "#SSD Normwert für Momente" VALUE 0xD9268 Kw_Wu16 1008.000 Trq 0.00 1008.000 FORMAT "%8.3" EXTENDED_LIMITS 0.00 6553.500 /end CHARACTERISTIC
/begin CHARACTERISTIC FrmMng_trqSSGPlaThres_C "torque threhold" VALUE 0xD917A Kw_Ws16 1500.000 Trq -500.0000 1000.000 FORMAT "%8.3" EXTENDED_LIMITS -3276.800 3276.700 /end CHARACTERISTIC
/begin CHARACTERISTIC FrmMng_trq_Offset_C "#SSD Offset Umrechung SG->CAN für Momente" VALUE 0xD926A Kw_Ws16 799.9878 Prc -400.0000 399.9878 FORMAT "%8.4" /end CHARACTERISTIC
/begin CHARACTERISTIC FrmMng_trq_Slope_C "#SSD Steigung Umrechung SG->CAN für Momente" VALUE 0xD926C Kw_Ws16 65.53500 SlopeRes1000 -32.76800 32.76700 FORMAT "%8.5" /end CHARACTERISTIC
/begin CHARACTERISTIC FrmMng_tWaterVlv_C "Schwellwert für CTSCD_tClnt" VALUE 0xD917C Kw_Ws16 950.0000 Temp_Cels -50.1400 899.8600 FORMAT "%8.4" EXTENDED_LIMITS -3549.940 3003.560 /end CHARACTERISTIC
/begin CHARACTERISTIC FrmMng_ubtMin_C "minimale Batteriespannungsänderung um POWERMGMT_BATTERIESPANNUNG zu versenden" VALUE 0xD917E Kw_Wu8 3.8250000 spg_uw_q0p015 0.00 3.8250000 FORMAT "%9.7" /end CHARACTERISTIC
/begin CHARACTERISTIC FrmMng_vHtgUpActMax_C "velocity threshold for evaluating ST_SW_WAUP signal" VALUE 0xD9180 Kw_Ws16 300.0000 Vel 0.00 300.0000 FORMAT "%8.4" EXTENDED_LIMITS -327.6800 327.6700 /end CHARACTERISTIC
/begin CHARACTERISTIC FrmMng_vNFltMax_C "Schwelle geschwindigkeit in Leerlauf" VALUE 0xD9182 Kw_Ws16 300.0000 Vel 0.00 300.0000 FORMAT "%8.4" EXTENDED_LIMITS -327.6800 327.6700 /end CHARACTERISTIC
/begin CHARACTERISTIC FrmMng_cnvvPrgNo_Offset_C "#SSD Offset for calculation V_PRGG_CCTR_IDX_NO_X from CAN" VALUE 0xD9184 Kw_Ws16 65535.00 OneToOne -32768.00 32767.00 FORMAT "%8.2" /end CHARACTERISTIC
/begin CHARACTERISTIC FrmMng_cnvvPrgNo_Slope_C "#SSD Slope for calculation V_PRGG_CCTR_IDX_NO_X from CAN" VALUE 0xD9186 Kw_Ws16 655.3500 SlopeRes100 -327.6800 327.6700 FORMAT "%8.4" /end CHARACTERISTIC
/begin CHARACTERISTIC FrmMng_vSSGPlaThres_C "vehicle speed threhold" VALUE 0xD9188 Kw_Wu16 300.0000 Vel 0.00 300.0000 FORMAT "%8.4" EXTENDED_LIMITS 0.00 655.3500 /end CHARACTERISTIC
/begin MEASUREMENT FrmMng_ctrIdxNo "index counter for velocities" UBYTE OneToOne 1 100 0.00 255.0 FORMAT "%5.1" ECU_ADDRESS 0x7F88AD /end MEASUREMENT
/begin MEASUREMENT FrmMng_dOBDCtl_mp "Measuring Point for OBD status" UBYTE OneToOne 1 100 0.00 255.0 FORMAT "%5.1" ECU_ADDRESS 0x8FF1AA /end MEASUREMENT
/begin MEASUREMENT FrmMng_nPSP "Ist-Drehzahl EKP" SWORD PSP_Spd 1 100 -32768.00 32767.00 FORMAT "%8.2" ECU_ADDRESS 0x7F8D38 /end MEASUREMENT
/begin MEASUREMENT FrmMng_numASC1byte0_mp "Rohwerte von der CAN-Botschaft ASC1" UBYTE OneToOne 1 100 0.00 255.0 FORMAT "%5.1" ECU_ADDRESS 0x8FF1AB /end MEASUREMENT
/begin MEASUREMENT FrmMng_numASC1byte1_mp "Rohwerte von der CAN-Botschaft ASC1" UBYTE OneToOne 1 100 0.00 255.0 FORMAT "%5.1" ECU_ADDRESS 0x8FF1AC /end MEASUREMENT
/begin MEASUREMENT FrmMng_numASC1byte2_mp "Rohwerte von der CAN-Botschaft ASC1" UBYTE OneToOne 1 100 0.00 255.0 FORMAT "%5.1" ECU_ADDRESS 0x8FF1AD /end MEASUREMENT
/begin MEASUREMENT FrmMng_numASC1byte3_mp "Rohwerte von der CAN-Botschaft ASC1" UBYTE OneToOne 1 100 0.00 255.0 FORMAT "%5.1" ECU_ADDRESS 0x8FF1AE /end MEASUREMENT
/begin MEASUREMENT FrmMng_numASC1byte4_mp "Rohwerte von der CAN-Botschaft ASC1" UBYTE OneToOne 1 100 0.00 255.0 FORMAT "%5.1" ECU_ADDRESS 0x8FF1AF /end MEASUREMENT
/begin MEASUREMENT FrmMng_numASC1byte5_mp "Rohwerte von der CAN-Botschaft ASC1" UBYTE OneToOne 1 100 0.00 255.0 FORMAT "%5.1" ECU_ADDRESS 0x8FF1B0 /end MEASUREMENT
/begin MEASUREMENT FrmMng_numASC1byte6_mp "Rohwerte von der CAN-Botschaft ASC1" UBYTE OneToOne 1 100 0.00 255.0 FORMAT "%5.1" ECU_ADDRESS 0x8FF1B1 /end MEASUREMENT
/begin MEASUREMENT FrmMng_numASC1byte7_mp "Rohwerte von der CAN-Botschaft ASC1" UBYTE OneToOne 1 100 0.00 255.0 FORMAT "%5.1" ECU_ADDRESS 0x8FF1B2 /end MEASUREMENT
/begin MEASUREMENT FrmMng_numASC2byte0_mp "Rohwerte von der CAN-Botschaft ASC2" UBYTE OneToOne 1 100 0.00 255.0 FORMAT "%5.1" ECU_ADDRESS 0x8FF1B3 /end MEASUREMENT
/begin MEASUREMENT FrmMng_numASC2byte1_mp "Rohwerte von der CAN-Botschaft ASC2" UBYTE OneToOne 1 100 0.00 255.0 FORMAT "%5.1" ECU_ADDRESS 0x8FF1B4 /end MEASUREMENT
/begin MEASUREMENT FrmMng_numASC2byte2_mp "Rohwerte von der CAN-Botschaft ASC2" UBYTE OneToOne 1 100 0.00 255.0 FORMAT "%5.1" ECU_ADDRESS 0x8FF1B5 /end MEASUREMENT
/begin MEASUREMENT FrmMng_numASC2byte3_mp "Rohwerte von der CAN-Botschaft ASC2" UBYTE OneToOne 1 100 0.00 255.0 FORMAT "%5.1" ECU_ADDRESS 0x8FF1B6 /end MEASUREMENT
/begin MEASUREMENT FrmMng_numASC2byte4_mp "Rohwerte von der CAN-Botschaft ASC2" UBYTE OneToOne 1 100 0.00 255.0 FORMAT "%5.1" ECU_ADDRESS 0x8FF1B7 /end MEASUREMENT
/begin MEASUREMENT FrmMng_numASC2byte5_mp "Rohwerte von der CAN-Botschaft ASC2" UBYTE OneToOne 1 100 0.00 255.0 FORMAT "%5.1" ECU_ADDRESS 0x8FF1B8 /end MEASUREMENT
/begin MEASUREMENT FrmMng_numASC2byte6_mp "Rohwerte von der CAN-Botschaft ASC2" UBYTE OneToOne 1 100 0.00 255.0 FORMAT "%5.1" ECU_ADDRESS 0x8FF1B9 /end MEASUREMENT
/begin MEASUREMENT FrmMng_numASC2byte7_mp "Rohwerte von der CAN-Botschaft ASC2" UBYTE OneToOne 1 100 0.00 255.0 FORMAT "%5.1" ECU_ADDRESS 0x8FF1BA /end MEASUREMENT
/begin MEASUREMENT FrmMng_numASC3byte0_mp "Rohwerte von der CAN-Botschaft ASC3" UBYTE OneToOne 1 100 0.00 255.0 FORMAT "%5.1" ECU_ADDRESS 0x8FF1BB /end MEASUREMENT
/begin MEASUREMENT FrmMng_numASC3byte1_mp "Rohwerte von der CAN-Botschaft ASC3" UBYTE OneToOne 1 100 0.00 255.0 FORMAT "%5.1" ECU_ADDRESS 0x8FF1BC /end MEASUREMENT
/begin MEASUREMENT FrmMng_numASC3byte2_mp "Rohwerte von der CAN-Botschaft ASC3" UBYTE OneToOne 1 100 0.00 255.0 FORMAT "%5.1" ECU_ADDRESS 0x8FF1BD /end MEASUREMENT
/begin MEASUREMENT FrmMng_numASC3byte3_mp "Rohwerte von der CAN-Botschaft ASC3" UBYTE OneToOne 1 100 0.00 255.0 FORMAT "%5.1" ECU_ADDRESS 0x8FF1BE /end MEASUREMENT
/begin MEASUREMENT FrmMng_numASC3byte4_mp "Rohwerte von der CAN-Botschaft ASC3" UBYTE OneToOne 1 100 0.00 255.0 FORMAT "%5.1" ECU_ADDRESS 0x8FF1BF /end MEASUREMENT
/begin MEASUREMENT FrmMng_numASC3byte5_mp "Rohwerte von der CAN-Botschaft ASC3" UBYTE OneToOne 1 100 0.00 255.0 FORMAT "%5.1" ECU_ADDRESS 0x8FF1C0 /end MEASUREMENT
/begin MEASUREMENT FrmMng_numASC3byte6_mp "Rohwerte von der CAN-Botschaft ASC3" UBYTE OneToOne 1 100 0.00 255.0 FORMAT "%5.1" ECU_ADDRESS 0x8FF1C1 /end MEASUREMENT
/begin MEASUREMENT FrmMng_numASC3byte7_mp "Rohwerte von der CAN-Botschaft ASC3" UBYTE OneToOne 1 100 0.00 255.0 FORMAT "%5.1" ECU_ADDRESS 0x8FF1C2 /end MEASUREMENT
/begin MEASUREMENT FrmMng_numASC4byte0_mp "Rohwerte von der CAN-Botschaft ASC4" UBYTE OneToOne 1 100 0.00 255.0 FORMAT "%5.1" ECU_ADDRESS 0x8FF1C3 /end MEASUREMENT
/begin MEASUREMENT FrmMng_numASC4byte1_mp "Rohwerte von der CAN-Botschaft ASC4" UBYTE OneToOne 1 100 0.00 255.0 FORMAT "%5.1" ECU_ADDRESS 0x8FF1C4 /end MEASUREMENT
/begin MEASUREMENT FrmMng_numASC4byte2_mp "Rohwerte von der CAN-Botschaft ASC4" UBYTE OneToOne 1 100 0.00 255.0 FORMAT "%5.1" ECU_ADDRESS 0x8FF1C5 /end MEASUREMENT
/begin MEASUREMENT FrmMng_numASC4byte3_mp "Rohwerte von der CAN-Botschaft ASC4" UBYTE OneToOne 1 100 0.00 255.0 FORMAT "%5.1" ECU_ADDRESS 0x8FF1C6 /end MEASUREMENT
/begin MEASUREMENT FrmMng_numASC4byte4_mp "Rohwerte von der CAN-Botschaft ASC4" UBYTE OneToOne 1 100 0.00 255.0 FORMAT "%5.1" ECU_ADDRESS 0x8FF1C7 /end MEASUREMENT
/begin MEASUREMENT FrmMng_numASC4byte5_mp "Rohwerte von der CAN-Botschaft ASC4" UBYTE OneToOne 1 100 0.00 255.0 FORMAT "%5.1" ECU_ADDRESS 0x8FF1C8 /end MEASUREMENT
/begin MEASUREMENT FrmMng_numASC4byte6_mp "Rohwerte von der CAN-Botschaft ASC4" UBYTE OneToOne 1 100 0.00 255.0 FORMAT "%5.1" ECU_ADDRESS 0x8FF1C9 /end MEASUREMENT
/begin MEASUREMENT FrmMng_numASC4byte7_mp "Rohwerte von der CAN-Botschaft ASC4" UBYTE OneToOne 1 100 0.00 255.0 FORMAT "%5.1" ECU_ADDRESS 0x8FF1CA /end MEASUREMENT
/begin MEASUREMENT FrmMng_numDDE1byte0_mp "Rohwerte für DDE1" UBYTE OneToOne 1 100 0.00 255.0 FORMAT "%5.1" ECU_ADDRESS 0x8FF1CB /end MEASUREMENT
/begin MEASUREMENT FrmMng_numDDE1byte1_mp "Rohwete für DDE1" UBYTE OneToOne 1 100 0.00 255.0 FORMAT "%5.1" ECU_ADDRESS 0x8FF1CC /end MEASUREMENT
/begin MEASUREMENT FrmMng_numDDE1byte2_mp "Rohwerte für DDE1" UBYTE OneToOne 1 100 0.00 255.0 FORMAT "%5.1" ECU_ADDRESS 0x8FF1CD /end MEASUREMENT
/begin MEASUREMENT FrmMng_numDDE1byte3_mp "Rohwerte für DDE1" UBYTE OneToOne 1 100 0.00 255.0 FORMAT "%5.1" ECU_ADDRESS 0x8FF1CE /end MEASUREMENT
/begin MEASUREMENT FrmMng_numDDE1byte4_mp "Rohwerte für DDE1" UBYTE OneToOne 1 100 0.00 255.0 FORMAT "%5.1" ECU_ADDRESS 0x8FF1CF /end MEASUREMENT
/begin MEASUREMENT FrmMng_numDDE1byte5_mp "Rohwerte für DDE1" UBYTE OneToOne 1 100 0.00 255.0 FORMAT "%5.1" ECU_ADDRESS 0x8FF1D0 /end MEASUREMENT
/begin MEASUREMENT FrmMng_numDDE1byte6_mp "Rohwerte für DDE1" UBYTE OneToOne 1 100 0.00 255.0 FORMAT "%5.1" ECU_ADDRESS 0x8FF1D1 /end MEASUREMENT
/begin MEASUREMENT FrmMng_numDDE1byte7_mp "Rohwerte für DDE1" UBYTE OneToOne 1 100 0.00 255.0 FORMAT "%5.1" ECU_ADDRESS 0x8FF1D2 /end MEASUREMENT
/begin MEASUREMENT FrmMng_numDDE2byte0_mp "Rohwerte für DDE2" UBYTE OneToOne 1 100 0.00 255.0 FORMAT "%5.1" ECU_ADDRESS 0x8FF1D3 /end MEASUREMENT
/begin MEASUREMENT FrmMng_numDDE2byte1_mp "Rohwerte für DDE2" UBYTE OneToOne 1 100 0.00 255.0 FORMAT "%5.1" ECU_ADDRESS 0x8FF1D4 /end MEASUREMENT
/begin MEASUREMENT FrmMng_numDDE2byte2_mp "Rohwerte für DDE2" UBYTE OneToOne 1 100 0.00 255.0 FORMAT "%5.1" ECU_ADDRESS 0x8FF1D5 /end MEASUREMENT
/begin MEASUREMENT FrmMng_numDDE2byte3_mp "Rohwerte für DDE2" UBYTE OneToOne 1 100 0.00 255.0 FORMAT "%5.1" ECU_ADDRESS 0x8FF1D6 /end MEASUREMENT
/begin MEASUREMENT FrmMng_numDDE2byte4_mp "Rohwerte für DDE2" UBYTE OneToOne 1 100 0.00 255.0 FORMAT "%5.1" ECU_ADDRESS 0x8FF1D7 /end MEASUREMENT
/begin MEASUREMENT FrmMng_numDDE2byte5_mp "Rohwerte für DDE2" UBYTE OneToOne 1 100 0.00 255.0 FORMAT "%5.1" ECU_ADDRESS 0x8FF1D8 /end MEASUREMENT
/begin MEASUREMENT FrmMng_numDDE2byte6_mp "Rohwerte für DDE2" UBYTE OneToOne 1 100 0.00 255.0 FORMAT "%5.1" ECU_ADDRESS 0x8FF1D9 /end MEASUREMENT
/begin MEASUREMENT FrmMng_numDDE2byte7_mp "Rohwerte für DDE2" UBYTE OneToOne 1 100 0.00 255.0 FORMAT "%5.1" ECU_ADDRESS 0x8FF1DA /end MEASUREMENT
/begin MEASUREMENT FrmMng_numDDE4byte0_mp "Rohwerte für DDE4" UBYTE OneToOne 1 100 0.00 255.0 FORMAT "%5.1" ECU_ADDRESS 0x8FF1DB /end MEASUREMENT
/begin MEASUREMENT FrmMng_numDDE4byte1_mp "Rohwerte für DDE4" UBYTE OneToOne 1 100 0.00 255.0 FORMAT "%5.1" ECU_ADDRESS 0x8FF1DC /end MEASUREMENT
/begin MEASUREMENT FrmMng_numDDE4byte2_mp "Rohwerte für DDE4" UBYTE OneToOne 1 100 0.00 255.0 FORMAT "%5.1" ECU_ADDRESS 0x8FF1DD /end MEASUREMENT
/begin MEASUREMENT FrmMng_numDDE4byte3_mp "Rohwerte für DDE4" UBYTE OneToOne 1 100 0.00 255.0 FORMAT "%5.1" ECU_ADDRESS 0x8FF1DE /end MEASUREMENT
/begin MEASUREMENT FrmMng_numDDE4byte4_mp "Rohwerte für DDE4" UBYTE OneToOne 1 100 0.00 255.0 FORMAT "%5.1" ECU_ADDRESS 0x8FF1DF /end MEASUREMENT
/begin MEASUREMENT FrmMng_numDDE4byte5_mp "Rohwerte für DDE4" UBYTE OneToOne 1 100 0.00 255.0 FORMAT "%5.1" ECU_ADDRESS 0x8FF1E0 /end MEASUREMENT
/begin MEASUREMENT FrmMng_numDDE4byte6_mp "Rohwerte für DDE4" UBYTE OneToOne 1 100 0.00 255.0 FORMAT "%5.1" ECU_ADDRESS 0x8FF1E1 /end MEASUREMENT
/begin MEASUREMENT FrmMng_numDDE4byte7_mp "Rohwerte für DDE4" UBYTE OneToOne 1 100 0.00 255.0 FORMAT "%5.1" ECU_ADDRESS 0x8FF1E2 /end MEASUREMENT
/begin MEASUREMENT FrmMng_numEGS1byte0_mp "Rohwerte von der Can-Botschaft EGS1" UBYTE OneToOne 1 100 0.00 255.0 FORMAT "%5.1" ECU_ADDRESS 0x8FF1E3 /end MEASUREMENT
/begin MEASUREMENT FrmMng_numEGS1byte1_mp "Rohwerte von der Can-Botschaft EGS1" UBYTE OneToOne 1 100 0.00 255.0 FORMAT "%5.1" ECU_ADDRESS 0x8FF1E4 /end MEASUREMENT
/begin MEASUREMENT FrmMng_numEGS1byte2_mp "Rohwerte von der Can-Botschaft EGS1" UBYTE OneToOne 1 100 0.00 255.0 FORMAT "%5.1" ECU_ADDRESS 0x8FF1E5 /end MEASUREMENT
/begin MEASUREMENT FrmMng_numEGS1byte3_mp "Rohwerte von der Can-Botschaft EGS1" UBYTE OneToOne 1 100 0.00 255.0 FORMAT "%5.1" ECU_ADDRESS 0x8FF1E6 /end MEASUREMENT
/begin MEASUREMENT FrmMng_numEGS1byte4_mp "Rohwerte von der Can - Botschaft EGS1" UBYTE OneToOne 1 100 0.00 255.0 FORMAT "%5.1" ECU_ADDRESS 0x8FF1E7 /end MEASUREMENT
/begin MEASUREMENT FrmMng_numEGS1byte5_mp "Rohwerte von der Can - Botschaft EGS1" UBYTE OneToOne 1 100 0.00 255.0 FORMAT "%5.1" ECU_ADDRESS 0x8FF1E8 /end MEASUREMENT
/begin MEASUREMENT FrmMng_numEGS1byte6_mp "Rohwerte von der Canbotschaft EGS1" UBYTE OneToOne 1 100 0.00 255.0 FORMAT "%5.1" ECU_ADDRESS 0x8FF1E9 /end MEASUREMENT
/begin MEASUREMENT FrmMng_numEGS1byte7_mp "Rohwerte von der Canbotschaft EGS1" UBYTE OneToOne 1 100 0.00 255.0 FORMAT "%5.1" ECU_ADDRESS 0x8FF1EA /end MEASUREMENT
/begin MEASUREMENT FrmMng_numEGS2byte0_mp "Rohwerte von der CAN-Botschaft EGS2" UBYTE OneToOne 1 100 0.00 255.0 FORMAT "%5.1" ECU_ADDRESS 0x8FF1EB /end MEASUREMENT
/begin MEASUREMENT FrmMng_numEGS2byte1_mp "Rohwerte von der CAN-Botschaft EGS2" UBYTE OneToOne 1 100 0.00 255.0 FORMAT "%5.1" ECU_ADDRESS 0x8FF1EC /end MEASUREMENT
/begin MEASUREMENT FrmMng_numEGS2byte2_mp "Rohwerte von der CAN-Botschaft EGS2" UBYTE OneToOne 1 100 0.00 255.0 FORMAT "%5.1" ECU_ADDRESS 0x8FF1ED /end MEASUREMENT
/begin MEASUREMENT FrmMng_numEGS2byte3_mp "Rohwerte von der CAN-Botschaft EGS2" UBYTE OneToOne 1 100 0.00 255.0 FORMAT "%5.1" ECU_ADDRESS 0x8FF1EE /end MEASUREMENT
/begin MEASUREMENT FrmMng_numEGS2byte4_mp "Rohwerte von der CAN-Botschaft EGS2" UBYTE OneToOne 1 100 0.00 255.0 FORMAT "%5.1" ECU_ADDRESS 0x8FF1EF /end MEASUREMENT
/begin MEASUREMENT FrmMng_numEGS2byte5_mp "Rohwerte von der CAN-Botschaft EGS2" UBYTE OneToOne 1 100 0.00 255.0 FORMAT "%5.1" ECU_ADDRESS 0x8FF1F0 /end MEASUREMENT
/begin MEASUREMENT FrmMng_numEGS2byte6_mp "Rohwerte von der CAN-Botschaft EGS2" UBYTE OneToOne 1 100 0.00 255.0 FORMAT "%5.1" ECU_ADDRESS 0x8FF1F1 /end MEASUREMENT
/begin MEASUREMENT FrmMng_numEGS2byte7_mp "Rohwerte von der CAN-Botschaft EGS2" UBYTE OneToOne 1 100 0.00 255.0 FORMAT "%5.1" ECU_ADDRESS 0x8FF1F2 /end MEASUREMENT
/begin MEASUREMENT FrmMng_numEKPbyte0_mp "Byte 1 von EKP-CAN-Botschaft" UBYTE OneToOne 1 100 0.00 255.0 FORMAT "%5.1" ECU_ADDRESS 0x8FF1F3 /end MEASUREMENT
/begin MEASUREMENT FrmMng_numEKPbyte1_mp "Byte 2 von EKP-CAN-Botschaft" UBYTE OneToOne 1 100 0.00 255.0 FORMAT "%5.1" ECU_ADDRESS 0x8FF1F4 /end MEASUREMENT
/begin MEASUREMENT FrmMng_numEKPbyte2_mp "Byte 3 von EKP-CAN-Botschaft" UBYTE OneToOne 1 100 0.00 255.0 FORMAT "%5.1" ECU_ADDRESS 0x8FF1F5 /end MEASUREMENT
/begin MEASUREMENT FrmMng_numEKPbyte3_mp "Byte 4 von EKP-CAN-Botschaft" UBYTE OneToOne 1 100 0.00 255.0 FORMAT "%5.1" ECU_ADDRESS 0x8FF1F6 /end MEASUREMENT
/begin MEASUREMENT FrmMng_numINSTR2byte0_mp "Rohwert INSTR2-Byte0" UBYTE OneToOne 1 100 0.00 255.0 FORMAT "%5.1" ECU_ADDRESS 0x8FF1F7 /end MEASUREMENT
/begin MEASUREMENT FrmMng_numINSTR2byte1_mp "Rohwert INSTR2-Byte1" UBYTE OneToOne 1 100 0.00 255.0 FORMAT "%5.1" ECU_ADDRESS 0x8FF1F8 /end MEASUREMENT
/begin MEASUREMENT FrmMng_numINSTR2byte2_mp "Rohwert INSTR2-Byte2" UBYTE OneToOne 1 100 0.00 255.0 FORMAT "%5.1" ECU_ADDRESS 0x8FF1F9 /end MEASUREMENT
/begin MEASUREMENT FrmMng_numINSTR2byte3_mp "Rohwert INSTR2-Byte3" UBYTE OneToOne 1 100 0.00 255.0 FORMAT "%5.1" ECU_ADDRESS 0x8FF1FA /end MEASUREMENT
/begin MEASUREMENT FrmMng_numINSTR2byte4_mp "Rohwert INSTR2-Byte4" UBYTE OneToOne 1 100 0.00 255.0 FORMAT "%5.1" ECU_ADDRESS 0x8FF1FB /end MEASUREMENT
/begin MEASUREMENT FrmMng_numINSTR2byte5_mp "Rohwert INSTR2-Byte5" UBYTE OneToOne 1 100 0.00 255.0 FORMAT "%5.1" ECU_ADDRESS 0x8FF1FC /end MEASUREMENT
/begin MEASUREMENT FrmMng_numINSTR2byte6_mp "Rohwert INSTR2-Byte6" UBYTE OneToOne 1 100 0.00 255.0 FORMAT "%5.1" ECU_ADDRESS 0x8FF1FD /end MEASUREMENT
/begin MEASUREMENT FrmMng_numINSTR2byte7_mp "Rohwert INSTR2-Byte7" UBYTE OneToOne 1 100 0.00 255.0 FORMAT "%5.1" ECU_ADDRESS 0x8FF1FE /end MEASUREMENT
/begin MEASUREMENT FrmMng_numINSTR3byte0_mp "Rohwert INSTR3-Byte0" UBYTE OneToOne 1 100 0.00 255.0 FORMAT "%5.1" ECU_ADDRESS 0x8FF1FF /end MEASUREMENT
/begin MEASUREMENT FrmMng_numINSTR3byte1_mp "Rohwert INSTR3-Byte1" UBYTE OneToOne 1 100 0.00 255.0 FORMAT "%5.1" ECU_ADDRESS 0x8FF200 /end MEASUREMENT
/begin MEASUREMENT FrmMng_numINSTR3byte2_mp "Rohwert INSTR3-Byte2" UBYTE OneToOne 1 100 0.00 255.0 FORMAT "%5.1" ECU_ADDRESS 0x8FF201 /end MEASUREMENT
/begin MEASUREMENT FrmMng_numINSTR3byte3_mp "Rohwert INSTR3-Byte3" UBYTE OneToOne 1 100 0.00 255.0 FORMAT "%5.1" ECU_ADDRESS 0x8FF202 /end MEASUREMENT
/begin MEASUREMENT FrmMng_numINSTR3byte4_mp "Rohwert INSTR3-Byte4" UBYTE OneToOne 1 100 0.00 255.0 FORMAT "%5.1" ECU_ADDRESS 0x8FF203 /end MEASUREMENT
/begin MEASUREMENT FrmMng_numINSTR3byte5_mp "Rohwert INSTR3-Byte5" UBYTE OneToOne 1 100 0.00 255.0 FORMAT "%5.1" ECU_ADDRESS 0x8FF204 /end MEASUREMENT
/begin MEASUREMENT FrmMng_numINSTR3byte6_mp "Rohwert INSTR3-Byte6" UBYTE OneToOne 1 100 0.00 255.0 FORMAT "%5.1" ECU_ADDRESS 0x8FF205 /end MEASUREMENT
/begin MEASUREMENT FrmMng_numINSTR3byte7_mp "Rohwert INSTR3-Byte7" UBYTE OneToOne 1 100 0.00 255.0 FORMAT "%5.1" ECU_ADDRESS 0x8FF206 /end MEASUREMENT
/begin MEASUREMENT FrmMng_pAir "Atmosphärendruck über CAN" SWORD Pres_hPa 1 100 -32768.00 32767.00 FORMAT "%8.2" ECU_ADDRESS 0x7F8D42 /end MEASUREMENT
/begin MEASUREMENT FrmMng_rPSPSetPoint "Aktuelle Stellgröße der EKP-Regelung" SWORD Prc 1 100 -400.0000 399.9878 FORMAT "%8.4" ECU_ADDRESS 0x7F8D4E /end MEASUREMENT
/begin MEASUREMENT FrmMng_rTrqDCS_mp "Meßpunkt für Verhältnis MSR-Anforderungsmoment / Maximalmoment" SWORD Prc 1 100 -400.0000 399.9878 FORMAT "%8.4" ECU_ADDRESS 0x8FF208 /end MEASUREMENT
/begin MEASUREMENT FrmMng_rTrqGearbxFrc_mp "MD_GETRIEBE nach Normalisation" SWORD Prc 1 100 -400.0000 399.9878 FORMAT "%8.4" ECU_ADDRESS 0x8FF20A /end MEASUREMENT
/begin MEASUREMENT FrmMng_rTrqGearbx_mp "MD_IND_GS nach Normalisation" SWORD Prc 1 100 -400.0000 399.9878 FORMAT "%8.4" ECU_ADDRESS 0x8FF20C /end MEASUREMENT
/begin MEASUREMENT FrmMng_rTrqTCS_mp "Meßpunkt für Verhältnis ASR-Anforderungsmoment / Maximalmoment" SWORD Prc 1 100 -400.0000 399.9878 FORMAT "%8.4" ECU_ADDRESS 0x8FF20E /end MEASUREMENT
/begin MEASUREMENT FrmMng_stAC "Klimaanlagenzustand über CAN" UWORD OneToOne 1 100 0.00 65535.00 FORMAT "%8.2" ECU_ADDRESS 0x7F8D52 /end MEASUREMENT
/begin MEASUREMENT FrmMng_stACHtgReq "Heizleistungsanforderung über CAN" UBYTE OneToOne 1 100 0.00 255.0 FORMAT "%5.1" ECU_ADDRESS 0x7F88BB /end MEASUREMENT
/begin MEASUREMENT FrmMng_stASC1Sig_mp "Signal-Error-Status ASC1" UWORD OneToOne 1 100 0.00 65535.00 FORMAT "%8.2" ECU_ADDRESS 0x8FF210 /end MEASUREMENT
/begin MEASUREMENT FrmMng_stASC2Sig_mp "Signal-Error-Status ASC2" UWORD OneToOne 1 100 0.00 65535.00 FORMAT "%8.2" ECU_ADDRESS 0x8FF212 /end MEASUREMENT
/begin MEASUREMENT FrmMng_stASC3Sig_mp "Signal-Error-Status ASC3" UWORD OneToOne 1 100 0.00 65535.00 FORMAT "%8.2" ECU_ADDRESS 0x8FF214 /end MEASUREMENT
/begin MEASUREMENT FrmMng_stASC4Sig_mp "Signalerrorstate ASC4" UWORD OneToOne 1 100 0.00 65535.00 FORMAT "%8.2" ECU_ADDRESS 0x8FF216 /end MEASUREMENT
/begin MEASUREMENT FrmMng_stASCok "status ASC Eingriff" UBYTE OneToOne 1 100 0.00 255.0 FORMAT "%5.1" ECU_ADDRESS 0x7F88BF /end MEASUREMENT
/begin MEASUREMENT FrmMng_stBrkTCS_mp "Bremsstatus TCS" UBYTE OneToOne 1 100 0.00 255.0 FORMAT "%5.1" ECU_ADDRESS 0x8FF218 /end MEASUREMENT
/begin MEASUREMENT FrmMng_stCrCCDKey_mp "Bediensignal FGR" UBYTE OneToOne 1 100 0.00 255.0 FORMAT "%5.1" ECU_ADDRESS 0x8FF219 /end MEASUREMENT
/begin MEASUREMENT FrmMng_stCrCtlOff_mp "FGR Abschaltung von DSC" UBYTE OneToOne 1 100 0.00 255.0 FORMAT "%5.1" ECU_ADDRESS 0x8FF21A /end MEASUREMENT
/begin MEASUREMENT FrmMng_stDCSActive_mp "Signal B_MSR von CAN, MSR Eingriff aktiv" UBYTE OneToOne 1 100 0.00 255.0 FORMAT "%5.1" ECU_ADDRESS 0x8FF21B /end MEASUREMENT
/begin MEASUREMENT FrmMng_stDSCCtrl_mp "DSC Eingriff" UBYTE OneToOne 1 100 0.00 255.0 FORMAT "%5.1" ECU_ADDRESS 0x8FF21C /end MEASUREMENT
/begin MEASUREMENT FrmMng_stDSCDelay_mp "Status für DSC delay" UBYTE OneToOne 1 100 0.00 255.0 FORMAT "%5.1" ECU_ADDRESS 0x8FF21D /end MEASUREMENT
/begin MEASUREMENT FrmMng_stEGS1Sig_mp "Zustand des Getriebes" UWORD OneToOne 1 100 0.00 65535.00 FORMAT "%8.2" ECU_ADDRESS 0x8FF21E /end MEASUREMENT
/begin MEASUREMENT FrmMng_stEGS2Sig_mp "Signal-Error-Status EGS2" UWORD OneToOne 1 100 0.00 65535.00 FORMAT "%8.2" ECU_ADDRESS 0x8FF220 /end MEASUREMENT
/begin MEASUREMENT FrmMng_stEngRun_mp "Motorlaufzustand über CAN" UBYTE OneToOne 1 100 0.00 255.0 FORMAT "%5.1" ECU_ADDRESS 0x8FF222 /end MEASUREMENT
/begin MEASUREMENT FrmMng_stExc_ASC1_mp "Exceptionstate von CAN-Botschaft (errors, freeze, ...)" UWORD OneToOne 1 100 0.00 65535.00 FORMAT "%8.2" ECU_ADDRESS 0x8FF224 /end MEASUREMENT
/begin MEASUREMENT FrmMng_stExc_ASC2_mp "Exceptionstate von CAN-Botschaft (errors, freeze, ...)" UWORD OneToOne 1 100 0.00 65535.00 FORMAT "%8.2" ECU_ADDRESS 0x8FF226 /end MEASUREMENT
/begin MEASUREMENT FrmMng_stExc_ASC3_mp "Exceptionstate von CAN-Botschaft (errors, freeze, ...)" UWORD OneToOne 1 100 0.00 65535.00 FORMAT "%8.2" ECU_ADDRESS 0x8FF228 /end MEASUREMENT
/begin MEASUREMENT FrmMng_stExc_ASC4_mp "Instrumente für CAN-Message ASC4" UWORD OneToOne 1 100 0.00 65535.00 FORMAT "%8.2" ECU_ADDRESS 0x8FF22A /end MEASUREMENT
/begin MEASUREMENT FrmMng_stExc_EGS1_mp "Exceptionstate von CAN-Botschaft ( errors, freeze, ... )" UWORD OneToOne 1 100 0.00 65535.00 FORMAT "%8.2" ECU_ADDRESS 0x8FF22C /end MEASUREMENT
/begin MEASUREMENT FrmMng_stExc_EGS2_mp "Exceptionstate von CAN-Botschaft (errors, freeze, ...)" UWORD OneToOne 1 100 0.00 65535.00 FORMAT "%8.2" ECU_ADDRESS 0x8FF22E /end MEASUREMENT
/begin MEASUREMENT FrmMng_stExc_INSTR2_mp "Exception-State INSTR2" UWORD OneToOne 1 100 0.00 65535.00 FORMAT "%8.2" ECU_ADDRESS 0x8FF230 /end MEASUREMENT
/begin MEASUREMENT FrmMng_stExc_INSTR3_mp "Exception-State INSTR3" UWORD OneToOne 1 100 0.00 65535.00 FORMAT "%8.2" ECU_ADDRESS 0x8FF232 /end MEASUREMENT
/begin MEASUREMENT FrmMng_stINSTR2Sig_mp "Signalerrorstatus INSTR2" UWORD OneToOne 1 100 0.00 65535.00 FORMAT "%8.2" ECU_ADDRESS 0x8FF234 /end MEASUREMENT
/begin MEASUREMENT FrmMng_stINSTR3Sig_mp "Signalerrorstatus INSTR3" UWORD OneToOne 1 100 0.00 65535.00 FORMAT "%8.2" ECU_ADDRESS 0x8FF236 /end MEASUREMENT
/begin MEASUREMENT FrmMng_stOldstStart "vorheriger Start-Status" UBYTE OneToOne 1 100 0.00 255.0 FORMAT "%5.1" ECU_ADDRESS 0x7F88E1 /end MEASUREMENT
/begin MEASUREMENT FrmMng_stPRGG_CCTRSig "signalerrorstatus-message PRGG_CCTR" UWORD OneToOne 1 100 0.00 65535.00 FORMAT "%8.2" ECU_ADDRESS 0x7F8D74 /end MEASUREMENT
/begin MEASUREMENT FrmMng_stPSP "status der Diagnose der geregelten elektronischen Kraftstoffpumpe" UBYTE OneToOne 1 100 0.00 255.0 FORMAT "%5.1" ECU_ADDRESS 0x7F88E3 /end MEASUREMENT
/begin MEASUREMENT FrmMng_stPSPOff "EKP Abschaltung im Crashfall" UBYTE OneToOne 1 100 0.00 255.0 FORMAT "%5.1" ECU_ADDRESS 0x7F88E4 /end MEASUREMENT
/begin MEASUREMENT FrmMng_stSTAT_HDC "Zustand CAN-Botschaft S_HDC" UBYTE OneToOne 1 100 0.00 255.0 FORMAT "%5.1" ECU_ADDRESS 0x7F88EE /end MEASUREMENT
/begin MEASUREMENT FrmMng_stTCSActive_mp "CAN-Signal B_ASC, ASC Eingriff aktiv" UBYTE OneToOne 1 100 0.00 255.0 FORMAT "%5.1" ECU_ADDRESS 0x8FF238 /end MEASUREMENT
/begin MEASUREMENT FrmMng_stTCSCtrl_mp "ASC Eingriff" UBYTE OneToOne 1 100 0.00 255.0 FORMAT "%5.1" ECU_ADDRESS 0x8FF239 /end MEASUREMENT
/begin MEASUREMENT FrmMng_stTrqDCSOk_mp "Status Freigabe MSR Eingriff" UBYTE OneToOne 1 100 0.00 255.0 FORMAT "%5.1" ECU_ADDRESS 0x8FF23A /end MEASUREMENT
/begin MEASUREMENT FrmMng_stTrqTCSOk_mp "Status Freigabe ASC Eingriff" UBYTE OneToOne 1 100 0.00 255.0 FORMAT "%5.1" ECU_ADDRESS 0x8FF23B /end MEASUREMENT
/begin MEASUREMENT FrmMng_stTSCDec "Status der reduzierenden Getriebeeingriffsanforderung vom Getriebesteuergerät (EGS)" UWORD OneToOne 1 100 0.00 65535.00 FORMAT "%8.2" ECU_ADDRESS 0x7F8D96 /end MEASUREMENT
/begin MEASUREMENT FrmMng_stTSCInc "Status der erhöhenden Getriebeeingriffsanforderung vom Getriebesteuergerät (EGS)" UWORD OneToOne 1 100 0.00 65535.00 FORMAT "%8.2" ECU_ADDRESS 0x7F8D98 /end MEASUREMENT
/begin MEASUREMENT FrmMng_tEnv "Umgebungstemperatur" SWORD Temp_Cels 1 100 -50.140 899.860 FORMAT "%8.3" ECU_ADDRESS 0x7F8DA6 /end MEASUREMENT
/begin MEASUREMENT FrmMng_tiDayCouAbsl "day counter" UWORD OneToOne 1 100 0.00 65535.00 FORMAT "%8.2" ECU_ADDRESS 0x7F8DAA /end MEASUREMENT
/begin MEASUREMENT FrmMng_trqDCS "vom MSR gefordertes Getriebeausgangsmoment" SWORD Trq 1 100 -3276.800 3276.700 FORMAT "%8.3" ECU_ADDRESS 0x7F8DB8 /end MEASUREMENT
/begin MEASUREMENT FrmMng_trqDCSRaw_mp "MSR Eingriff über CAN, Momentenrohwert" SWORD Trq 1 100 -3276.800 3276.700 FORMAT "%8.3" ECU_ADDRESS 0x8FF23C /end MEASUREMENT
/begin MEASUREMENT FrmMng_trqFrc "Reibmoment" SWORD Trq 1 100 -3276.800 3276.700 FORMAT "%8.3" ECU_ADDRESS 0x7F8DC2 /end MEASUREMENT
/begin MEASUREMENT FrmMng_trqGbx "Torque set value from Gearbox" SWORD Trq 1 100 -3276.800 3276.700 FORMAT "%8.3" ECU_ADDRESS 0x7F8DC4 /end MEASUREMENT
/begin MEASUREMENT FrmMng_trqGearbxDes_mp "Meßpunkt fuer Getriebe-Sollmoment" SWORD Trq 1 100 -3276.800 3276.700 FORMAT "%8.3" ECU_ADDRESS 0x8FF23E /end MEASUREMENT
/begin MEASUREMENT FrmMng_trqGearbxRaw_mp "= FrmMng_trqGearbxDec - EngM_trqFrc" SWORD Trq 1 100 -3276.800 3276.700 FORMAT "%8.3" ECU_ADDRESS 0x8FF240 /end MEASUREMENT
/begin MEASUREMENT FrmMng_trqTCS "vom ASR gefordertes Getriebeausgangsmoment" SWORD Trq 1 100 -3276.800 3276.700 FORMAT "%8.3" ECU_ADDRESS 0x7F8DD2 /end MEASUREMENT
/begin MEASUREMENT FrmMng_trqTCSRaw_mp "ASC Eingriff über CAN, Momentenrohwert" SWORD Trq 1 100 -3276.800 3276.700 FORMAT "%8.3" ECU_ADDRESS 0x8FF242 /end MEASUREMENT
/begin MEASUREMENT FrmMng_trqTSCDec "Gefordertes reduzierende Kupplungsmoment vom Getriebesteuergerät (EGS)" SWORD Trq 1 100 -3276.800 3276.700 FORMAT "%8.3" ECU_ADDRESS 0x7F8DD4 /end MEASUREMENT
/begin MEASUREMENT FrmMng_trqTSCInc "Gefordertes erhöhende Kupplungsmoment vom Getriebesteuergerät (EGS)" SWORD Trq 1 100 -3276.800 3276.700 FORMAT "%8.3" ECU_ADDRESS 0x7F8DD6 /end MEASUREMENT
/begin MEASUREMENT FrmMng_vPrgNo1 "velocity No. 0,3,6,9,12" UWORD vfzg_uw_b512 1 100 0.00 511.9922 FORMAT "%8.4" ECU_ADDRESS 0x7F8DE2 /end MEASUREMENT
/begin MEASUREMENT FrmMng_vPrgNo2 "velocity No. 1,4,7,10,13" UWORD vfzg_uw_b512 1 100 0.00 511.9922 FORMAT "%8.4" ECU_ADDRESS 0x7F8DE4 /end MEASUREMENT
/begin MEASUREMENT FrmMng_vPrgNo3 "velocity No. 2,5,8,11,14" UWORD vfzg_uw_b512 1 100 0.00 511.9922 FORMAT "%8.4" ECU_ADDRESS 0x7F8DE6 /end MEASUREMENT
/begin FUNCTION frmmng "CAN Message Frames für Übertragung und Empfang"
 /begin DEF_CHARACTERISTIC FrmMng_ACCSelfRec_C FrmMng_ACSelfRec_C FrmMng_aDirectDef_C FrmMng_AFSSelfRec_C FrmMng_ARSSelfRec_C FrmMng_aSideDef_C FrmMng_cnvAccmLimTrq_Offset_C FrmMng_cnvAccmLimTrq_Slope_C FrmMng_cnvACCtrq_Offset_C FrmMng_cnvACCtrq_Slope_C FrmMng_cnvAVA_DSC_Offset_C FrmMng_cnvAVA_DSC_Slope_C FrmMng_cnvLN_DSC_Offset_C FrmMng_cnvLN_DSC_Slope_C FrmMng_cnvAFStrq_Offset_C FrmMng_cnvAFStrq_Slope_C FrmMng_cnvAipEng_Offset_C FrmMng_cnvAipEng_Slope_C FrmMng_cnvAngAcpd_Offset_C FrmMng_cnvAngAcpd_Slope_C FrmMng_cnvAPP_Offset_C FrmMng_cnvAPP_Slope_C FrmMng_cnvARStrq_Offset_C FrmMng_cnvARStrq_Slope_C FrmMng_cnvDCCtrq_Offset_C FrmMng_cnvDCCtrq_Slope_C FrmMng_cnvdLRADWINKStrg_Offset_C FrmMng_cnvdLRADWINKStrg_Slope_C FrmMng_cnvDSCtrq_Offset_C FrmMng_cnvDSCtrq_Slope_C FrmMng_cnvIjvFu_Offset_C FrmMng_cnvIjvFu_Slope_C FrmMng_cnvKOMBIv_Offset_C FrmMng_cnvKOMBIv_Slope_C FrmMng_cnvLimRpmEng_Offset_C FrmMng_cnvLimRpmEng_Slope_C FrmMng_cnvLRADWINKStrg_Offset_C FrmMng_cnvLRADWINKStrg_Slope_C FrmMng_cnvnEngRpm_Offset_C FrmMng_cnvnEngRpm_Slope_C FrmMng_cnvnSetpoint_Offset_C FrmMng_cnvnSetpoint_Slope_C FrmMng_cnvpBrkSys_Offset_C FrmMng_cnvpBrkSys_Slope_C FrmMng_cnvrHtFlow_Offset_C FrmMng_cnvrHtFlow_Slope_C FrmMng_cnvRpmEng_Offset_C FrmMng_cnvRpmEng_Slope_C FrmMng_cnvRPM_GRB_TURB_Offset_C FrmMng_cnvRPM_GRB_TURB_Slope_C FrmMng_cnvRqamFu_Offset_C FrmMng_cnvRqamFu_Slope_C FrmMng_cnvrTransDT_Offset_C FrmMng_cnvrTransDT_Slope_C FrmMng_cnvrWaterVlv_Offset_C FrmMng_cnvrWaterVlv_Slope_C FrmMng_cnvTempEng_Offset_C FrmMng_cnvTempEng_Slope_C FrmMng_cnvtOil_Offset_C FrmMng_cnvtOil_Slope_C FrmMng_cnvTrqAvl_Offset_C FrmMng_cnvTrqAvl_Slope_C FrmMng_cnvTrqDvch_Offset_C FrmMng_cnvTrqDvch_Slope_C FrmMng_cnvtrqWheel_Offset_C FrmMng_cnvtrqWheel_Slope_C FrmMng_cnvtrq_Offset_C FrmMng_cnvtrq_Slope_C FrmMng_cnvvMrk_Offset_C FrmMng_cnvvMrk_Slope_C FrmMng_cnvV_VEH_Offset_C FrmMng_cnvV_VEH_Slope_C FrmMng_cnv_BattCls_Offset_C FrmMng_cnv_BattCls_Slope_C FrmMng_cnv_HiLimCurr_Offset_C FrmMng_cnv_HiLimCurr_Slope_C FrmMng_cnv_LoLimCurr_Offset_C FrmMng_cnv_LoLimCurr_Slope_C FrmMng_cnv_ZrCurrLim_Offset_C FrmMng_cnv_ZrCurrLim_Slope_C FrmMng_ctDebAlvDMANFAFSDef_C FrmMng_ctDebAlvDMANFAFSOk_C FrmMng_ctDebAlvDRMANFSSGDef_C FrmMng_ctDebAlvDRMANFSSGOk_C FrmMng_ctDebCsDMANFAFSDef_C FrmMng_ctDebCsDMANFAFSOk_C FrmMng_ctDebCsDRMANFSSGDef_C FrmMng_ctDebCsDRMANFSSGOk_C FrmMng_ctDebSigDMANFAFSDef_C FrmMng_ctDebSigDMANFAFSOk_C FrmMng_ctDebSigDRMANFSSGDef_C FrmMng_ctDebSigDRMANFSSGOk_C FrmMng_ctDebSigLRADWINKDef_C FrmMng_ctDebSigLRADWINKOk_C FrmMng_ctDebSigstCurrDef_C FrmMng_ctDebSigstCurrOk_C FrmMng_ctDebSigswtPSPOffDef_C FrmMng_ctDebSigswtPSPOffOk_C FrmMng_ctDebToDMANFAFSDef_C FrmMng_ctDebToDMANFAFSOk_C FrmMng_ctDebToDRMANFSSGDef_C FrmMng_ctDebToDRMANFSSGOk_C FrmMng_ctDebToLRADWINKDef_C FrmMng_ctDebToLRADWINKOk_C FrmMng_ctDebTostCurrDef_C FrmMng_ctDebTostCurrOk_C FrmMng_ctDebToswtPSPOffDef_C FrmMng_ctDebToswtPSPOffOk_C FrmMng_ctrRelDef_C FrmMng_cnvCTR_GEN_U_TAR_Offset_C FrmMng_cnvCTR_GEN_U_TAR_Slope_C FrmMng_DebACTrqDef_C FrmMng_DebACTrqOk_C FrmMng_DebAlvANFRADMOMPTDef_C FrmMng_DebAlvANFRADMOMPTOk_C FrmMng_DebAlvDMOMENT_ACCDef_C FrmMng_DebAlvDMOMENT_ACCOk_C FrmMng_DebAlvOPCRCTLACCDef_C FrmMng_DebAlvOPCRCTLACCOk_C FrmMng_DebAlvSTAT_ARSDef_C FrmMng_DebAlvSTAT_ARSOk_C FrmMng_DebAlvSTAT_KOMBIDef_C FrmMng_DebAlvSTAT_KOMBIOk_C FrmMng_DebAlvTERMINALDef_C FrmMng_DebAlvTERMINALOk_C FrmMng_DebAlvTORQUE_DSCDef_C FrmMng_DebAlvTORQUE_DSCOk_C FrmMng_DebAlvTORQUE_GEARBXDef_C FrmMng_DebAlvTORQUE_GEARBXOk_C FrmMng_DebAlvVEH_MODDef_C FrmMng_DebAlvVEH_MODOk_C FrmMng_DebCsANFRADMOMPTDef_C FrmMng_DebCsANFRADMOMPTOk_C FrmMng_DebCsDMOMENT_ACCDef_C FrmMng_DebCsDMOMENT_ACCOk_C FrmMng_DebCsOPCRCTLACCDef_C FrmMng_DebCsOPCRCTLACCOk_C FrmMng_DebCsTERMINALDef_C FrmMng_DebCsTERMINALOk_C FrmMng_DebCsTORQUE_DSCDef_C FrmMng_DebCsTORQUE_DSCOk_C FrmMng_DebCsTORQUE_GEARBXDef_C FrmMng_DebCsTORQUE_GEARBXOk_C FrmMng_DebCsVEH_MODDef_C FrmMng_DebCsVEH_MODOk_C FrmMng_DebGearbxRpmOk_C FrmMng_DebGearbxRpmRduc_C FrmMng_DebSigANFRADMOMPTDef_C FrmMng_DebSigANFRADMOMPTOk_C FrmMng_DebSigBOS_RESET_2Def_C FrmMng_DebSigBOS_RESET_2Ok_C FrmMng_DebSigBOS_RESETDef_C FrmMng_DebSigBOS_RESETOk_C FrmMng_DebSigDMOMENT_ACCDef_C FrmMng_DebSigDMOMENT_ACCOk_C FrmMng_DebSigGEARBX_DATA2Def_C FrmMng_DebSigGEARBX_DATA2Ok_C FrmMng_DebSigGEARBX_DATADef_C FrmMng_DebSigGEARBX_DATAOk_C FrmMng_DebSigHEAT_ACDef_C FrmMng_DebSigHEAT_ACOk_C FrmMng_DebSigMILEAGE_RANGEDef_C FrmMng_DebSigMILEAGE_RANGEOk_C FrmMng_DebSigOPCRCTLACCDef_C FrmMng_DebSigOPCRCTLACCOk_C FrmMng_DebSigParkConsumerDef_C FrmMng_DebSigParkConsumerOk_C FrmMng_DebSigPRGG_CCTRDef_C FrmMng_DebSigPRGG_CCTROk_C FrmMng_DebSigPWRMNG_LOADVDef_C FrmMng_DebSigPWRMNG_LOADVOk_C FrmMng_DebSigRQ_STG_EFANDef_C FrmMng_DebSigRQ_STG_EFANOk_C FrmMng_ctDebSigSITZGURTDef_C FrmMng_ctDebSigSITZGURTOk_C FrmMng_DebSigSTAT_ANHDef_C FrmMng_DebSigSTAT_ANHOk_C FrmMng_DebSigSTAT_ARSDef_C FrmMng_DebSigSTAT_ARSOk_C FrmMng_DebSigSTAT_DSCDef_C FrmMng_DebSigSTAT_DSCOk_C FrmMng_DebSigSTAT_EKPDef_C FrmMng_DebSigSTAT_EKPOk_C FrmMng_DebSigSTAT_KOMBIDef_C FrmMng_DebSigSTAT_KOMBIOk_C FrmMng_ctDebOBDGbxMilOfDef_C FrmMng_ctDebSigStOBDGbxMilOfOk_C FrmMng_ctDebOBDGbxMilOnDef_C FrmMng_ctDebSigStOBDGbxMilOnOk_C FrmMng_DebSigTEMPRELTIMEDef_C FrmMng_DebSigTEMPRELTIMEOk_C FrmMng_DebSigTERMINALDef_C FrmMng_DebSigTERMINALOk_C FrmMng_DebSigTIME_DATEDef_C FrmMng_DebSigTIME_DATEOk_C FrmMng_DebSigTORQUE_DSCDef_C FrmMng_DebSigTORQUE_DSCOk_C FrmMng_DebSigTORQUE_GEARBXDef_C FrmMng_DebSigTORQUE_GEARBXOk_C FrmMng_DebSigVEH_MODDef_C FrmMng_DebSigVEH_MODOk_C FrmMng_DebSigVELOCITYDef_C FrmMng_DebSigVELOCITYOk_C FrmMng_ctDebSigWHEEL_SPEEDDef_C FrmMng_ctDebSigWHEEL_SPEEDOk_C FrmMng_DebTGearbxDef_C FrmMng_DebTGearbxOk_C FrmMng_DebToANFRADMOMPTDef_C FrmMng_DebToANFRADMOMPTOk_C FrmMng_DebToBOS_RESET_2Def_C FrmMng_DebToBOS_RESET_2Ok_C FrmMng_DebToBOS_RESETDef_C FrmMng_DebToBOS_RESETOk_C FrmMng_DebToDMOMENT_ACCDef_C FrmMng_DebToDMOMENT_ACCOk_C FrmMng_DebToGEARBX_DATA2Def_C FrmMng_DebToGEARBX_DATA2Ok_C FrmMng_DebToGEARBX_DATADef_C FrmMng_DebToGEARBX_DATAOk_C FrmMng_DebToHEAT_ACDef_C FrmMng_DebToHEAT_ACOk_C FrmMng_DebToMILEAGE_RANGEDef_C FrmMng_DebToMILEAGE_RANGEOk_C FrmMng_DebToOPCRCTLACCDef_C FrmMng_DebToOPCRCTLACCOk_C FrmMng_DebToParkConsumerDef_C FrmMng_DebToParkConsumerOk_C FrmMng_DebToPRGG_CCTRDef_C FrmMng_DebToPRGG_CCTROk_C FrmMng_DebToPWRMNG_LOADVDef_C FrmMng_DebToPWRMNG_LOADVOk_C FrmMng_DebToRQ_STG_EFANDef_C FrmMng_DebToRQ_STG_EFANOk_C FrmMng_ctDebToSITZGURTDef_C FrmMng_ctDebToSITZGURTOk_C FrmMng_DebToSTAT_ANHDef_C FrmMng_DebToSTAT_ANHOk_C FrmMng_DebToSTAT_ARSDef_C FrmMng_DebToSTAT_ARSOk_C FrmMng_DebToSTAT_DSCDef_C FrmMng_DebToSTAT_DSCOk_C FrmMng_DebToSTAT_EKPDef_C FrmMng_DebToSTAT_EKPOk_C FrmMng_DebToSTAT_KOMBIDef_C FrmMng_DebToSTAT_KOMBIOk_C FrmMng_DebToTEMPRELTIMEDef_C FrmMng_DebToTEMPRELTIMEOk_C FrmMng_DebToTERMINALDef_C FrmMng_DebToTERMINALOk_C FrmMng_DebToTIME_DATEDef_C FrmMng_DebToTIME_DATEOk_C FrmMng_DebToTORQUE_DSCDef_C FrmMng_DebToTORQUE_DSCOk_C FrmMng_DebToTORQUE_GEARBXDef_C FrmMng_DebToTORQUE_GEARBXOk_C FrmMng_DebToVEH_MODDef_C FrmMng_DebToVEH_MODOk_C FrmMng_DebToVELOCITYDef_C FrmMng_DebToVELOCITYOk_C FrmMng_ctDebToWHEEL_SPEEDDef_C FrmMng_ctDebToWHEEL_SPEEDOk_C FrmMng_drAPP1Min_C FrmMng_dstGear_C FrmMng_dTrqWheelRmpUp_C FrmMng_dTrqWheelRmpDwn_C FrmMng_facTrqAC_MAP FrmMng_factrqInrStrt_C FrmMng_FDCSelfRec_C FrmMng_FGRSelfRec_C FrmMng_cnvFLLV_FUTA_Offset_C FrmMng_cnvFLLV_FUTA_Slope_C FrmMng_mskDM_ANF_ACC_C FrmMng_mskDM_ANF_AFS_C FrmMng_mskDM_ANF_SSG_C FrmMng_mskGEARBX_DATA_C FrmMng_mskHEAT_AC_C FrmMng_mskSTAT_ARS_C FrmMng_mskTORQUE_DSC_C FrmMng_mskTORQUE_GEARBX_C FrmMng_nEngOFF_C FrmMng_nEngON_C FrmMng_nEngRpm1_CUR FrmMng_nEngRpm2_CUR FrmMng_nFanDflt_C FrmMng_nFan_CUR FrmMng_nHtgUpActMax_C FrmMng_nHtgUpCrCtlMax_C FrmMng_nLIGovOffs_C FrmMng_nLimSSGErr_C FrmMng_nLLOfsNeg_C FrmMng_nLLOfsPos_C FrmMng_cnvnPSPSpd_Offset_C FrmMng_cnvnPSPSpd_Slope_C FrmMng_nRqStgEFan_CUR FrmMng_numACFanDesDef_C FrmMng_numCCAddLevlFlsh_C FrmMng_numCCAddLevlNum_C FrmMng_numCCBrkDefFlsh_C FrmMng_numCCBrkDefNum_C FrmMng_numCCbtnachFlsh_C FrmMng_numCCbtnachNum_C FrmMng_numCCbttdfkFlsh_C FrmMng_numCCbttdfkNum_C FrmMng_numCCbttkntFlsh_C FrmMng_numCCbttkntNum_C FrmMng_numCCGenDef2Flsh_C FrmMng_numCCGenDef2Num_C FrmMng_numCCNoCrCtlFlsh_C FrmMng_numCCNoCrCtlNum_C FrmMng_numCCOelLevlFlsh_C FrmMng_numCCOelLevlNum_C FrmMng_numCCOelVerbFlsh_C FrmMng_numCCOelVerbNum_C FrmMng_numCCOelVerlFlsh_C FrmMng_numCCOelVerlNum_C FrmMng_numCCOilPresFlsh_C FrmMng_numCCOilPresNum_C FrmMng_numCCOvrTem2Flsh_C FrmMng_numCCOvrTem2Num_C FrmMng_numCCOvrTempFlsh_C FrmMng_numCCOvrTempNum_C FrmMng_numCCPFltDefFlsh_C FrmMng_numCCPFltDefNum_C FrmMng_numCCpmerrFlsh_C FrmMng_numCCpmerrNum_C FrmMng_numCCPreGlowFlsh_C FrmMng_numCCPreGlowNum_C FrmMng_numCCprioFlsh_C FrmMng_numCCprioNum_C FrmMng_numCCruhverFlsh_C FrmMng_numCCruhverNum_C FrmMng_numCCStatMilFlsh_C FrmMng_numCCStatMilLmpTstFlsh_C FrmMng_numCCStatMilLmpTstNum_C FrmMng_numCCStatMilNum_C FrmMng_numCCSysLampFlsh_C FrmMng_numCCSysLampNum_C FrmMng_numInqyID_C FrmMng_numRecACCMax_C FrmMng_numRecACMax_C FrmMng_numRecAFSMax_C FrmMng_numRecARSMax_C FrmMng_numRecDCCMax_C FrmMng_numRecFDCMax_C FrmMng_numRecFGRMax_C FrmMng_dtrqOvrRunRmpUp_C FrmMng_dtrqOvrRunRmpDwn_C FrmMng_qOvrRun_C FrmMng_rAppMax_C FrmMng_cnvrPSPSetPoint_Offset_C FrmMng_cnvrPSPSetPoint_Slope_C FrmMng_rWaterVlvClose_C FrmMng_rWaterVlvCtl_C FrmMng_rWaterVlvOpen_C FrmMng_stBltbDrDef_C FrmMng_stClCtrDEF_C FrmMng_stConvErr_C FrmMng_stFDC_C FrmMng_stGbxErr_C Frmmng_stGearbxHtgUpActMsk_C Frmmng_stGearHtgUpAct_C FrmMng_stKeyVldDef_C FrmMng_stRgnHtgUp_C FrmMng_stT15Def_C FrmMng_stT50Def_C FrmMng_Sttorqavl_Errval_C FrmMng_stTRadioDef_C FrmMng_stWghSeatDrDef_C FrmMng_swtANFRADMOMPT_C FrmMng_swtANFRAGE_C FrmMng_swtASDdc_C FrmMng_swtBOS_Oil_2_C FrmMng_swtBOS_Oil_C FrmMng_swtBOS_PFlt_2_C FrmMng_swtBOS_PFlt_C FrmMng_swtBOS_RESET_2_C FrmMng_swtBOS_RESET_C FrmMng_swtCalcV_C FrmMng_swtCCMsg_C FrmMng_swtCCNoCrCtl_C FrmMng_swtCorTrqACC_C FrmMng_swtCorTrqDSC_C FrmMng_swtDCCSelfRec_C FrmMng_swtDMOMENT_ACC_C FrmMng_swtDM_ANF_AFS_C FrmMng_swtDRMANFSSG_C FrmMng_swtENGINE1_C FrmMng_swtENGINE_RPM_C FrmMng_swtEngRpmTempSel_C FrmMng_swtFDC_C FrmMng_swtGbxRepWTrqIntv_C FrmMng_swtGEARBX_DATA2_C FrmMng_swtGEARBX_DATA_C FrmMng_swtHEATINGCURRENT_C FrmMng_swtHEAT_AC_C FrmMng_swtLENKRADWINKEL_C FrmMng_swtMILEAGE_RANGE_C FrmMng_swtOEL_MESS_C FrmMng_swtOPCRCTLACC_C FrmMng_swtParkConsumer_C FrmMng_swtPlausOn_C FrmMng_swtPOWERMGMTBATTSP_C FrmMng_swtPRGG_CCTR_C FrmMng_swtPSPOffErr_C FrmMng_swtPSPOff_C FrmMng_swtPWRMNG_CTR_COS_C FrmMng_swtPWRMNG_LOADV_C FrmMng_swtRADMOM_PT1_C FrmMng_swtRADMOM_PT2_C FrmMng_swtRPM_STA_C FrmMng_swtRQ_STG_EFAN_C FrmMng_swtSITZGURT_C FrmMng_swtSPEED_CLCTR_C FrmMng_swtSTAT_ANH_C FrmMng_swtSTAT_ARS_C FrmMng_swtSTAT_DSC_C FrmMng_swtSTAT_EKP_C FrmMng_swtSTAT_KOMBI_C FrmMng_swtstCurr_C FrmMng_swtTEMPRELTIME_C FrmMng_swtTERMINAL_C FrmMng_swtTIME_DATE_C FrmMng_swtTORQUE1_C FrmMng_swtTORQUE2_C FrmMng_swtTORQUE3_C FrmMng_swtTORQUE_DSC_C FrmMng_swtTORQUE_GEARBX_C FrmMng_swtVEH_MOD_C FrmMng_swtVELOCITY_C FrmMng_swtWHEEL_SPEED_C FrmMng_cnvTEMP_EX_Offset_C FrmMng_cnvTEMP_EX_Slope_C FrmMng_tEngLimHi_C FrmMng_tEngLimLo_C FrmMng_tEnvDef_C FrmMng_tiCCAddLevlCycle_C FrmMng_tiCCBrkDefCycle_C FrmMng_tiCCbtnachCycle_C FrmMng_tiCCbttdfkCycle_C FrmMng_tiCCbttkntCycle_C FrmMng_tiCCGenDef2Cycle_C FrmMng_tiCCNoCrCtlCycle_C FrmMng_tiCCOelLevlCycle_C FrmMng_tiCCOelVerbCycle_C FrmMng_tiCCOelVerlCycle_C FrmMng_tiCCOilPresCycle_C FrmMng_tiCCOvrTem2Cycle_C FrmMng_tiCCOvrTempCycle_C FrmMng_tiCCPFltDefCycle_C FrmMng_tiCCpmerrCycle_C FrmMng_tiCCPreGlowCycle_C FrmMng_tiCCprioCycle_C FrmMng_tiCCruhverCycle_C FrmMng_tiCCStatMilCycle_C FrmMng_tiCCStatMilLmpTstCycle_C FrmMng_tiCCSysLampCycle_C FrmMng_tiCCTxDeb_C FrmMng_tiDebARS_C FrmMng_tiDebDSC_C FrmMng_tiDebEGS_C FrmMng_tiDebHtgUpShutOff_C FrmMng_tiDebHtgUpShutOn_C FrmMng_tiDebSSGDebCltTO_C FrmMng_tiDebSSGErrDef_C FrmMng_tiDebSSGErrOk_C FrmMng_tiDebSSGShftPla_C FrmMng_tiDebSSGShOffDef_C FrmMng_tiDebSSGShOffOk_C FrmMng_tiDebSSGTrqIncPla_C FrmMng_tiDelayStEng_C FrmMng_tiRecACCMax_C FrmMng_tiRecACMax_C FrmMng_tiRecAFSMax_C FrmMng_tiRecARSMax_C FrmMng_tiRecDCCMax_C FrmMng_tiRecFDCMax_C FrmMng_tiRecFGRMax_C FrmMng_tiStartDelay_C FrmMng_trqARSCurDef_C FrmMng_trqARSDesDef_C FrmMng_trqGearbxFrc_C FrmMng_trqGearbxMaxSubs_C FrmMng_trqLiGovMin_C FrmMng_trqSSGPlaThres_C FrmMng_tWaterVlv_C FrmMng_ubtMin_C FrmMng_vHtgUpActMax_C FrmMng_vNFltMax_C FrmMng_cnvvPrgNo_Offset_C FrmMng_cnvvPrgNo_Slope_C FrmMng_vSSGPlaThres_C /end DEF_CHARACTERISTIC
 /begin IN_MEASUREMENT Eng_nAvrg FrmMng_numACFanDes FrmMng_numRqStgEFan FrmMng_tEngRpm_mp FrmMng_trqAC_mp /end IN_MEASUREMENT
/end FUNCTION
/begin FUNCTION frmmng_11hex ""
 /begin DEF_CHARACTERISTIC FrmMng_ctASCDef_C FrmMng_ctMulDDE2_C FrmMng_dCanState_C FrmMng_ctDebSigASC1Def_C FrmMng_ctDebSigASC1Ok_C FrmMng_ctDebSigASC2Def_C FrmMng_ctDebSigASC2Ok_C FrmMng_ctDebSigASC3Def_C FrmMng_ctDebSigASC3Ok_C FrmMng_ctDebSigASC4Def_C FrmMng_ctDebSigASC4Ok_C FrmMng_ctDebSigEGS1Def_C FrmMng_ctDebSigEGS1Ok_C FrmMng_ctDebSigEGS2Def_C FrmMng_ctDebSigEGS2Ok_C FrmMng_ctDebSigINSTR2Def_C FrmMng_ctDebSigINSTR2Ok_C FrmMng_ctDebSigINSTR3Def_C FrmMng_ctDebSigINSTR3Ok_C FrmMng_ctDebToASC1Def_C FrmMng_ctDebToASC1Ok_C FrmMng_ctDebToASC2Def_C FrmMng_ctDebToASC2Ok_C FrmMng_ctDebToASC3Def_C FrmMng_ctDebToASC3Ok_C FrmMng_ctDebToASC4Def_C FrmMng_ctDebToASC4Ok_C FrmMng_ctDebToEGS1Def_C FrmMng_ctDebToEGS1Ok_C FrmMng_ctDebToEGS2Def_C FrmMng_ctDebToEGS2Ok_C FrmMng_ctDebToINSTR2Def_C FrmMng_ctDebToINSTR2Ok_C FrmMng_ctDebToINSTR3Def_C FrmMng_ctDebToINSTR3Ok_C FrmMng_dEngGearbox_C FrmMng_dOBDCtrl_C FrmMng_dstGearbx_C FrmMng_fst_Offset_C FrmMng_fst_Slope_C FrmMng_kmst_Offset_C FrmMng_kmst_Slope_C FrmMng_nAvrg_Def_C FrmMng_nAvrg_Slope_C FrmMng_nDiv_Fac_C FrmMng_nFanErr_C FrmMng_nFan_C FrmMng_nLISetPoint_Offset_C FrmMng_nLISetPoint_Slope_C FrmMng_nML_C FrmMng_nTSCErr_C FrmMng_nTSC_Offset_C FrmMng_nTSC_Slope_C FrmMng_pVal_Offset_C FrmMng_pVal_Slope_C FrmMng_rFlt_Offset_C FrmMng_rFlt_Slope_C FrmMng_stGearErr_C FrmMng_swtASC1_C FrmMng_swtASC2_C FrmMng_swtASC3_C FrmMng_swtASC4_C FrmMng_swtCANA_C FrmMng_swtDDE1_C FrmMng_swtDDE2_C FrmMng_swtDDE4_C FrmMng_swtDSCBrkAct_C FrmMng_swtEGS1_C FrmMng_swtEGS2_C FrmMng_swtEKP_C FrmMng_swtINSTR2_C FrmMng_swtINSTR3_C FrmMng_tEng_Offset_C FrmMng_tEng_Slope_C FrmMng_tEnvErr_C FrmMng_tiDSCDelay1_C FrmMng_tiDSCDelay2_C FrmMng_tiDSCDelay3_C FrmMng_trqACErr_C FrmMng_trqLim_CUR FrmMng_trqNorm_C FrmMng_trq_Offset_C FrmMng_trq_Slope_C /end DEF_CHARACTERISTIC
 /begin IN_MEASUREMENT Eng_nAvrg /end IN_MEASUREMENT
/end FUNCTION
/begin FUNCTION frmmng_11hex_rx100ms_msg ""
 /begin OUT_MEASUREMENT FrmMng_stAC FrmMng_stSTAT_HDC FrmMng_stTSCDec FrmMng_stTSCInc FrmMng_trqTSCDec FrmMng_trqTSCInc /end OUT_MEASUREMENT
/end FUNCTION
/begin FUNCTION frmmng_11hex_uic ""
 /begin OUT_MEASUREMENT FrmMng_dOBDCtl_mp FrmMng_numASC1byte0_mp FrmMng_numASC1byte1_mp FrmMng_numASC1byte2_mp FrmMng_numASC1byte3_mp FrmMng_numASC1byte4_mp FrmMng_numASC1byte5_mp FrmMng_numASC1byte6_mp FrmMng_numASC1byte7_mp FrmMng_numASC2byte0_mp FrmMng_numASC2byte1_mp FrmMng_numASC2byte2_mp FrmMng_numASC2byte3_mp FrmMng_numASC2byte4_mp FrmMng_numASC2byte5_mp FrmMng_numASC2byte6_mp FrmMng_numASC2byte7_mp FrmMng_numASC3byte0_mp FrmMng_numASC3byte1_mp FrmMng_numASC3byte2_mp FrmMng_numASC3byte3_mp FrmMng_numASC3byte4_mp FrmMng_numASC3byte5_mp FrmMng_numASC3byte6_mp FrmMng_numASC3byte7_mp FrmMng_numASC4byte0_mp FrmMng_numASC4byte1_mp FrmMng_numASC4byte2_mp FrmMng_numASC4byte3_mp FrmMng_numASC4byte4_mp FrmMng_numASC4byte5_mp FrmMng_numASC4byte6_mp FrmMng_numASC4byte7_mp FrmMng_numDDE1byte0_mp FrmMng_numDDE1byte1_mp FrmMng_numDDE1byte2_mp FrmMng_numDDE1byte3_mp FrmMng_numDDE1byte4_mp FrmMng_numDDE1byte5_mp FrmMng_numDDE1byte6_mp FrmMng_numDDE1byte7_mp FrmMng_numDDE2byte0_mp FrmMng_numDDE2byte1_mp FrmMng_numDDE2byte2_mp FrmMng_numDDE2byte3_mp FrmMng_numDDE2byte4_mp FrmMng_numDDE2byte5_mp FrmMng_numDDE2byte6_mp FrmMng_numDDE2byte7_mp FrmMng_numDDE4byte0_mp FrmMng_numDDE4byte1_mp FrmMng_numDDE4byte2_mp FrmMng_numDDE4byte3_mp FrmMng_numDDE4byte4_mp FrmMng_numDDE4byte5_mp FrmMng_numDDE4byte6_mp FrmMng_numDDE4byte7_mp FrmMng_numEGS1byte0_mp FrmMng_numEGS1byte1_mp FrmMng_numEGS1byte2_mp FrmMng_numEGS1byte3_mp FrmMng_numEGS1byte4_mp FrmMng_numEGS1byte5_mp FrmMng_numEGS1byte6_mp FrmMng_numEGS1byte7_mp FrmMng_numEGS2byte0_mp FrmMng_numEGS2byte1_mp FrmMng_numEGS2byte2_mp FrmMng_numEGS2byte3_mp FrmMng_numEGS2byte4_mp FrmMng_numEGS2byte5_mp FrmMng_numEGS2byte6_mp FrmMng_numEGS2byte7_mp FrmMng_numEKPbyte0_mp FrmMng_numEKPbyte1_mp FrmMng_numEKPbyte2_mp FrmMng_numEKPbyte3_mp FrmMng_numINSTR2byte0_mp FrmMng_numINSTR2byte1_mp FrmMng_numINSTR2byte2_mp FrmMng_numINSTR2byte3_mp FrmMng_numINSTR2byte4_mp FrmMng_numINSTR2byte5_mp FrmMng_numINSTR2byte6_mp FrmMng_numINSTR2byte7_mp FrmMng_numINSTR3byte0_mp FrmMng_numINSTR3byte1_mp FrmMng_numINSTR3byte2_mp FrmMng_numINSTR3byte3_mp FrmMng_numINSTR3byte4_mp FrmMng_numINSTR3byte5_mp FrmMng_numINSTR3byte6_mp FrmMng_numINSTR3byte7_mp FrmMng_rTrqDCS_mp FrmMng_rTrqGearbxFrc_mp FrmMng_rTrqGearbx_mp FrmMng_rTrqTCS_mp FrmMng_stASC1Sig_mp FrmMng_stASC2Sig_mp FrmMng_stASC3Sig_mp FrmMng_stASC4Sig_mp FrmMng_stBrkTCS_mp FrmMng_stCrCCDKey_mp FrmMng_stCrCtlOff_mp FrmMng_stDCSActive_mp FrmMng_stDSCCtrl_mp FrmMng_stDSCDelay_mp FrmMng_stEGS1Sig_mp FrmMng_stEGS2Sig_mp FrmMng_stEngRun_mp FrmMng_stExc_ASC1_mp FrmMng_stExc_ASC2_mp FrmMng_stExc_ASC3_mp FrmMng_stExc_ASC4_mp FrmMng_stExc_EGS1_mp FrmMng_stExc_EGS2_mp FrmMng_stExc_INSTR2_mp FrmMng_stExc_INSTR3_mp FrmMng_stINSTR2Sig_mp FrmMng_stINSTR3Sig_mp FrmMng_stTCSActive_mp FrmMng_stTCSCtrl_mp FrmMng_stTrqDCSOk_mp FrmMng_stTrqTCSOk_mp FrmMng_trqDCSRaw_mp FrmMng_trqGearbxDes_mp FrmMng_trqGearbxRaw_mp FrmMng_trqTCSRaw_mp /end OUT_MEASUREMENT
/end FUNCTION
/begin FUNCTION frmmng_11hex_var_msg ""
 /begin OUT_MEASUREMENT FrmMng_stACHtgReq FrmMng_stASCok FrmMng_stOldstStart FrmMng_stPSPOff FrmMng_trqFrc /end OUT_MEASUREMENT
/end FUNCTION
/begin FUNCTION frmmng_conv "" /end FUNCTION
/begin FUNCTION frmmng_mon "switch off the messages in inititalisation" /begin DEF_CHARACTERISTIC FrmMng_swtCarType_C /end DEF_CHARACTERISTIC /end FUNCTION
/begin FUNCTION frmmng_rx100ms_msg ""
 /begin OUT_MEASUREMENT FrmMng_ctrIdxNo FrmMng_nPSP FrmMng_pAir FrmMng_rPSPSetPoint FrmMng_stPRGG_CCTRSig FrmMng_stPSP FrmMng_tEnv FrmMng_tiDayCouAbsl FrmMng_trqDCS FrmMng_trqGbx FrmMng_trqTCS FrmMng_vPrgNo1 FrmMng_vPrgNo2 FrmMng_vPrgNo3 /end OUT_MEASUREMENT
/end FUNCTION
/begin COMPU_METHOD Acc "Fahrzeugbeschleunigung" RAT_FUNC "%6.5" "m/s^2" COEFFS 0 1000 0 0 0 1 /end COMPU_METHOD
/begin COMPU_METHOD AngleGrad "Winkelanzeige in Grad" RAT_FUNC "%6.4" "Grad" COEFFS 0 22.7531285551763 0 0 0 1 /end COMPU_METHOD
/begin COMPU_METHOD AngleGradPerSec "Winkelanzeige in Grad pro Sekunde" RAT_FUNC "%6.4" "Grad/s" COEFFS 0 22.7531285551763 0 0 0 1 /end COMPU_METHOD
/begin COMPU_METHOD CarType "" TAB_VERB "%6.3" "-" COMPU_TAB_REF CarType /end COMPU_METHOD
/begin COMPU_VTAB CarType "" TAB_VERB 6 0 "E60" 1 "E65" 2 "E90" 3 "E83" 4 "E87" 5 "E70" /end COMPU_VTAB
/begin COMPU_METHOD DEZ "K3 Umwandlungen" RAT_FUNC "%6.2" "-" COEFFS 0 1 0 0 0 1 /end COMPU_METHOD
/begin COMPU_METHOD EngN "Motordrehzahl" RAT_FUNC "%6.2" "rpm" COEFFS 0 1 0 0 0 1 /end COMPU_METHOD
/begin COMPU_METHOD Fact "Faktor mit Auflösung 1 / 8192, hauptsächlich für einen Faktorenbereich 0...1 verwendet" RAT_FUNC "%6.5" "-" COEFFS 0 8192 0 0 0 1 /end COMPU_METHOD
/begin COMPU_METHOD FanSpd "(MAXSINT16 / FANSPD_MAX) * phys" RAT_FUNC "%6.3" "1/min" COEFFS 0 10.9223333333333 0 0 0 1 /end COMPU_METHOD
/begin COMPU_METHOD FlConsum_l_h "Kraftstoffverbrauch" RAT_FUNC "%6.4" "l/h" COEFFS 0 100 0 0 0 1 /end COMPU_METHOD
/begin COMPU_METHOD FlConsum_ul "Verbrauchsintegral (in Mikroliter)" RAT_FUNC "%6.2" "ul" COEFFS 0 1 0 0 0 1 /end COMPU_METHOD
/begin COMPU_METHOD InjMass "Einspritzmenge" RAT_FUNC "%6.4" "mg/hub" COEFFS 0 100 0 0 0 1 /end COMPU_METHOD
/begin COMPU_METHOD i_ub_q0p001 "K3 Umwandlungen" RAT_FUNC "%5.4" "A" COEFFS 0 1 0 0 0 0.001 /end COMPU_METHOD
/begin COMPU_METHOD i_ub_q10p0 "K3 Umwandlungen" RAT_FUNC "%5.1" "A" COEFFS 0 1 0 0 0 10 /end COMPU_METHOD
/begin COMPU_METHOD OneToOne "eins zu eins (physikalischer Wert ist gleich dem internen Wert)" RAT_FUNC "%6.2" "-" COEFFS 0 1 0 0 0 1 /end COMPU_METHOD
/begin COMPU_METHOD Prc "Prozent, gleiche interne Auflösung wie Fact, aber Darstellung in Prozent (0...100%)" RAT_FUNC "%6.4" "%" COEFFS 0 81.92 0 0 0 1 /end COMPU_METHOD
/begin COMPU_METHOD PrcPerSec "Prozentänderung pro Sekunde für 20ms-Tasks" RAT_FUNC "%6.3" "%/s" COEFFS 0 1.6384 0 0 0 1 /end COMPU_METHOD
/begin COMPU_METHOD Pres_bar "Druck (angezeigt in bar)" RAT_FUNC "%6.2" "bar" COEFFS 0 1 0 0 0 1 /end COMPU_METHOD
/begin COMPU_METHOD Pres_hPa "Druck (angezeigt in [hPa])" RAT_FUNC "%6.2" "hPa" COEFFS 0 1 0 0 0 1 /end COMPU_METHOD
/begin COMPU_METHOD PSP_Spd "PSP speed in rpm" RAT_FUNC "%6.2" "rpm" COEFFS 0 1 0 0 0 1 /end COMPU_METHOD
/begin COMPU_METHOD RmpTrq "Rampengradient für Motormoment" RAT_FUNC "%6.4" "Nm/s" COEFFS 0 655.36 0 0 0 1 /end COMPU_METHOD
/begin COMPU_METHOD RmpTrqPrp "Rampenanstieg für Vortriebsmoment [Nm/s]" RAT_FUNC "%6.4" "Nm/s" COEFFS 0 327.68 0 0 0 1 /end COMPU_METHOD
/begin COMPU_METHOD SlopeRes10 "Umrechnung für Slope: Slopewert mit Verhältnis 0,1" RAT_FUNC "%6.3" "-" COEFFS 0 10 0 0 0 1 /end COMPU_METHOD
/begin COMPU_METHOD SlopeRes100 "Umrechnung für Slope: Slopewert mit Verhältnis 0,01" RAT_FUNC "%6.4" "-" COEFFS 0 100 0 0 0 1 /end COMPU_METHOD
/begin COMPU_METHOD SlopeRes1000 "Umrechnung für Slope: Slopewert mit Verhältnis 0,001" RAT_FUNC "%6.5" "-" COEFFS 0 1000 0 0 0 1 /end COMPU_METHOD
/begin COMPU_METHOD spg_uw_q0p015 "K3 Umwandlungen" RAT_FUNC "%9.5" "V" COEFFS 0 1 0 0 0 0.015 /end COMPU_METHOD
/begin COMPU_METHOD Temp_Cels "Temperatur dargestellt in °C (gleiche interne Darstellung wie Temp_Kelv)" RAT_FUNC "%6.1" "deg C" COEFFS 0 10 2731.4 0 0 1 /end COMPU_METHOD
/begin COMPU_METHOD Time_fulls "for application labels only in full seconds" RAT_FUNC "%6.2" "s" COEFFS 0 1 0 0 0 1 /end COMPU_METHOD
/begin COMPU_METHOD Time_ms "Zeit in ms für Fehlerentprellung (DSM) und SW-Timer" RAT_FUNC "%6.1" "ms" COEFFS 0 0.1 0 0 0 1 /end COMPU_METHOD
/begin COMPU_METHOD TransR "Übersetzungsverhältnis (Getriebe etc.)" RAT_FUNC "%6.4" "-" COEFFS 0 100 0 0 0 1 /end COMPU_METHOD
/begin COMPU_METHOD Trq "Motormoment" RAT_FUNC "%6.3" "Nm" COEFFS 0 10 0 0 0 1 /end COMPU_METHOD
/begin COMPU_METHOD TrqPrp "Vortriebsmoment" RAT_FUNC "%6.3" "Nm" COEFFS 0 5 0 0 0 1 /end COMPU_METHOD
/begin COMPU_METHOD TrqPrpHigh "vortriebsmoment" RAT_FUNC "%6.2" "Nm" COEFFS 0 1 0 0 0 1 /end COMPU_METHOD
/begin COMPU_METHOD Vel "Fahrzeuggeschwindigkeit, gleiche interne Auflösung wie Vel_SI" RAT_FUNC "%6.4" "km/h" COEFFS 0 100 0 0 0 1 /end COMPU_METHOD
/begin COMPU_METHOD vfzg_uw_b512 "ME9 Umwandlungen" RAT_FUNC "%6.4" "km/h" COEFFS 0 65536 0 0 0 512 /end COMPU_METHOD
/begin RECORD_LAYOUT Kf_Xs16_Ys16_Ws16 NO_AXIS_PTS_X 1 SWORD NO_AXIS_PTS_Y 2 SWORD AXIS_PTS_X 3 SWORD INDEX_INCR DIRECT AXIS_PTS_Y 4 SWORD INDEX_INCR DIRECT FNC_VALUES 5 SWORD COLUMN_DIR DIRECT /end RECORD_LAYOUT
/begin RECORD_LAYOUT Kl_Xs16_Ws16 NO_AXIS_PTS_X 1 SWORD AXIS_PTS_X 2 SWORD INDEX_INCR DIRECT FNC_VALUES 3 SWORD COLUMN_DIR DIRECT /end RECORD_LAYOUT
/begin RECORD_LAYOUT Kwb_Ws16 FNC_VALUES 1 SWORD COLUMN_DIR DIRECT /end RECORD_LAYOUT
/begin RECORD_LAYOUT Kwb_Wu8 FNC_VALUES 1 UBYTE COLUMN_DIR DIRECT /end RECORD_LAYOUT
/begin RECORD_LAYOUT Kw_Ws16 FNC_VALUES 1 SWORD COLUMN_DIR DIRECT /end RECORD_LAYOUT
/begin RECORD_LAYOUT Kw_Wu16 FNC_VALUES 1 UWORD COLUMN_DIR DIRECT /end RECORD_LAYOUT
/begin RECORD_LAYOUT Kw_Wu32 FNC_VALUES 1 ULONG COLUMN_DIR DIRECT /end RECORD_LAYOUT
/begin RECORD_LAYOUT Kw_Wu8 FNC_VALUES 1 UBYTE COLUMN_DIR DIRECT /end RECORD_LAYOUT
/end MODULE
/end PROJECT
