ASAP2_VERSION 1 3
/begin PROJECT P411 "BMW DDE6.0 6-Zylinder V96.2 14.10.2004"
/begin HEADER "" VERSION "V96.2_6Z" PROJECT_NO P411 /end HEADER
/begin MODULE DIM ""
/begin MOD_COMMON "" BYTE_ORDER MSB_FIRST ALIGNMENT_BYTE 1 ALIGNMENT_WORD 2 ALIGNMENT_LONG 4 ALIGNMENT_FLOAT32_IEEE 4 /end MOD_COMMON
/begin CHARACTERISTIC DSM_CDKDfp_Layer_TANS_C "Kundenspezifischer Fehlercode fuer Fehlerpfad Dfp_Layer_TANS" VAL_BLK 0xCBEF8 Kwb_Wu16 65535.00 OneToOne 0.00 65535.00 FORMAT "%8.2" NUMBER 4 /end CHARACTERISTIC
/begin CHARACTERISTIC DSM_CDKDfp_ACCDCmpr_C "Kundenspezifischer Fehlercode fuer Fehlerpfad Dfp_ACCDCmpr" VAL_BLK 0xCBF00 Kwb_Wu16 65535.00 OneToOne 0.00 65535.00 FORMAT "%8.2" NUMBER 4 /end CHARACTERISTIC
/begin CHARACTERISTIC DSM_CDKDfp_ACCDPres_C "Kundenspezifischer Fehlercode fuer Fehlerpfad Dfp_ACCDPres" VAL_BLK 0xCBF08 Kwb_Wu16 65535.00 OneToOne 0.00 65535.00 FORMAT "%8.2" NUMBER 4 /end CHARACTERISTIC
/begin CHARACTERISTIC DSM_CDKDfp_ACCDPres1_C "Kundenspezifischer Fehlercode fuer Fehlerpfad Dfp_ACCDPres1" VAL_BLK 0xCBF10 Kwb_Wu16 65535.00 OneToOne 0.00 65535.00 FORMAT "%8.2" NUMBER 4 /end CHARACTERISTIC
/begin CHARACTERISTIC DSM_CDKDfp_ACCDPresAna_C "Kundenspezifischer Fehlercode fuer Fehlerpfad Dfp_ACCDPresAna" VAL_BLK 0xCBF18 Kwb_Wu16 65535.00 OneToOne 0.00 65535.00 FORMAT "%8.2" NUMBER 4 /end CHARACTERISTIC
/begin CHARACTERISTIC DSM_CDKDfp_ACCDSwtin_C "Kundenspezifischer Fehlercode fuer Fehlerpfad Dfp_ACCDSwtin" VAL_BLK 0xCBF20 Kwb_Wu16 65535.00 OneToOne 0.00 65535.00 FORMAT "%8.2" NUMBER 4 /end CHARACTERISTIC
/begin CHARACTERISTIC DSM_CDKDfp_ACC_PlausTrqDes_C "Kundenspezifischer Fehlercode fuer Fehlerpfad Dfp_ACC_PlausTrqDes" VAL_BLK 0xCBF28 Kwb_Wu16 65535.00 OneToOne 0.00 65535.00 FORMAT "%8.2" NUMBER 4 /end CHARACTERISTIC
/begin CHARACTERISTIC DSM_CDKDfp_ACC_trqInr_C "Kundenspezifischer Fehlercode fuer Fehlerpfad Dfp_ACC_trqInr" VAL_BLK 0xCBF30 Kwb_Wu16 65535.00 OneToOne 0.00 65535.00 FORMAT "%8.2" NUMBER 4 /end CHARACTERISTIC
/begin CHARACTERISTIC DSM_CDKDfp_ACTrq_C "Kundenspezifischer Fehlercode fuer Fehlerpfad Dfp_ACTrq" VAL_BLK 0xCBF38 Kwb_Wu16 65535.00 OneToOne 0.00 65535.00 FORMAT "%8.2" NUMBER 4 /end CHARACTERISTIC
/begin CHARACTERISTIC DSM_CDKDfp_ADCMon_C "Kundenspezifischer Fehlercode fuer Fehlerpfad Dfp_ADCMon" VAL_BLK 0xCBF40 Kwb_Wu16 65535.00 OneToOne 0.00 65535.00 FORMAT "%8.2" NUMBER 4 /end CHARACTERISTIC
/begin CHARACTERISTIC DSM_CDKDfp_AFSCDIdlAdjVal_C "Kundenspezifischer Fehlercode fuer Fehlerpfad Dfp_AFSCDIdlAdjVal" VAL_BLK 0xCBF48 Kwb_Wu16 65535.00 OneToOne 0.00 65535.00 FORMAT "%8.2" NUMBER 4 /end CHARACTERISTIC
/begin CHARACTERISTIC DSM_CDKDfp_AFSCDLdAdjVal_C "Kundenspezifischer Fehlercode fuer Fehlerpfad Dfp_AFSCDLdAdjVal" VAL_BLK 0xCBF50 Kwb_Wu16 65535.00 OneToOne 0.00 65535.00 FORMAT "%8.2" NUMBER 4 /end CHARACTERISTIC
/begin CHARACTERISTIC DSM_CDKDfp_AFSCD_AirTempDcyc_C "Kundenspezifischer Fehlercode fuer Fehlerpfad Dfp_AFSCD_AirTempDcyc" VAL_BLK 0xCBF58 Kwb_Wu16 65535.00 OneToOne 0.00 65535.00 FORMAT "%8.2" NUMBER 4 /end CHARACTERISTIC
/begin CHARACTERISTIC DSM_CDKDfp_AFSCD_PlOffsDrft_C "Kundenspezifischer Fehlercode fuer Fehlerpfad Dfp_AFSCD_PlOffsDrft" VAL_BLK 0xCBF60 Kwb_Wu16 65535.00 OneToOne 0.00 65535.00 FORMAT "%8.2" NUMBER 4 /end CHARACTERISTIC
/begin CHARACTERISTIC DSM_CDKDfp_AFSCD_PlSetyDrft_C "Kundenspezifischer Fehlercode fuer Fehlerpfad Dfp_AFSCD_PlSetyDrft" VAL_BLK 0xCBF68 Kwb_Wu16 65535.00 OneToOne 0.00 65535.00 FORMAT "%8.2" NUMBER 4 /end CHARACTERISTIC
/begin CHARACTERISTIC DSM_CDKDfp_AFSCD_SRCAirTemp_C "Kundenspezifischer Fehlercode fuer Fehlerpfad Dfp_AFSCD_SRCAirTemp" VAL_BLK 0xCBF70 Kwb_Wu16 65535.00 OneToOne 0.00 65535.00 FORMAT "%8.2" NUMBER 4 /end CHARACTERISTIC
/begin CHARACTERISTIC DSM_CDKDfp_AFSCD_SRCBatt_C "Kundenspezifischer Fehlercode fuer Fehlerpfad Dfp_AFSCD_SRCBatt" VAL_BLK 0xCBF78 Kwb_Wu16 65535.00 OneToOne 0.00 65535.00 FORMAT "%8.2" NUMBER 4 /end CHARACTERISTIC
/begin CHARACTERISTIC DSM_CDKDfp_AFSCD_SRCCorrAirm_C "Kundenspezifischer Fehlercode fuer Fehlerpfad Dfp_AFSCD_SRCCorrAirm" VAL_BLK 0xCBF80 Kwb_Wu16 65535.00 OneToOne 0.00 65535.00 FORMAT "%8.2" NUMBER 4 /end CHARACTERISTIC
/begin CHARACTERISTIC DSM_CDKDfp_AFSCD_SRCRawAirm_C "Kundenspezifischer Fehlercode fuer Fehlerpfad Dfp_AFSCD_SRCRawAirm" VAL_BLK 0xCBF88 Kwb_Wu16 65535.00 OneToOne 0.00 65535.00 FORMAT "%8.2" NUMBER 4 /end CHARACTERISTIC
/begin CHARACTERISTIC DSM_CDKDfp_Layer_TUMG_C "Kundenspezifischer Fehlercode fuer Fehlerpfad Dfp_Layer_TUMG" VAL_BLK 0xCBF90 Kwb_Wu16 65535.00 OneToOne 0.00 65535.00 FORMAT "%8.2" NUMBER 4 /end CHARACTERISTIC
/begin CHARACTERISTIC DSM_CDKDfp_AFSCD_SRCRefSigPer_C "Kundenspezifischer Fehlercode fuer Fehlerpfad Dfp_AFSCD_SRCRefSigPer" VAL_BLK 0xCBF98 Kwb_Wu16 65535.00 OneToOne 0.00 65535.00 FORMAT "%8.2" NUMBER 4 /end CHARACTERISTIC
/begin CHARACTERISTIC DSM_CDKDfp_AOHtCD_C "Kundenspezifischer Fehlercode fuer Fehlerpfad Dfp_AOHtCD" VAL_BLK 0xCBFA0 Kwb_Wu16 65535.00 OneToOne 0.00 65535.00 FORMAT "%8.2" NUMBER 4 /end CHARACTERISTIC
/begin CHARACTERISTIC DSM_CDKDfp_Layer_GEN_C "Kundenspezifischer Fehlercode fuer Fehlerpfad Dfp_Layer_GEN" VAL_BLK 0xCBFA8 Kwb_Wu16 65535.00 OneToOne 0.00 65535.00 FORMAT "%8.2" NUMBER 4 /end CHARACTERISTIC
/begin CHARACTERISTIC DSM_CDKDfp_Layer_BSD_C "Kundenspezifischer Fehlercode fuer Fehlerpfad Dfp_Layer_BSD" VAL_BLK 0xCBFB0 Kwb_Wu16 65535.00 OneToOne 0.00 65535.00 FORMAT "%8.2" NUMBER 4 /end CHARACTERISTIC
/begin CHARACTERISTIC DSM_CDKDfp_AOHtCD_AOHtDia1_C "Kundenspezifischer Fehlercode fuer Fehlerpfad Dfp_AOHtCD_AOHtDia1" VAL_BLK 0xCBFB8 Kwb_Wu16 65535.00 OneToOne 0.00 65535.00 FORMAT "%8.2" NUMBER 4 /end CHARACTERISTIC
/begin CHARACTERISTIC DSM_CDKDfp_AOHtCD_AOHtDia2_C "Kundenspezifischer Fehlercode fuer Fehlerpfad Dfp_AOHtCD_AOHtDia2" VAL_BLK 0xCBFC0 Kwb_Wu16 65535.00 OneToOne 0.00 65535.00 FORMAT "%8.2" NUMBER 4 /end CHARACTERISTIC
/begin CHARACTERISTIC DSM_CDKDfp_AOHtCD_AOHtDia3_C "Kundenspezifischer Fehlercode fuer Fehlerpfad Dfp_AOHtCD_AOHtDia3" VAL_BLK 0xCBFC8 Kwb_Wu16 65535.00 OneToOne 0.00 65535.00 FORMAT "%8.2" NUMBER 4 /end CHARACTERISTIC
/begin CHARACTERISTIC DSM_CDKDfp_APP1_C "Kundenspezifischer Fehlercode fuer Fehlerpfad Dfp_APP1" VAL_BLK 0xCBFD0 Kwb_Wu16 65535.00 OneToOne 0.00 65535.00 FORMAT "%8.2" NUMBER 4 /end CHARACTERISTIC
/begin CHARACTERISTIC DSM_CDKDfp_APP2_C "Kundenspezifischer Fehlercode fuer Fehlerpfad Dfp_APP2" VAL_BLK 0xCBFD8 Kwb_Wu16 65535.00 OneToOne 0.00 65535.00 FORMAT "%8.2" NUMBER 4 /end CHARACTERISTIC
/begin CHARACTERISTIC DSM_CDKDfp_APPCDCmpd_C "Kundenspezifischer Fehlercode fuer Fehlerpfad Dfp_APPCDCmpd" VAL_BLK 0xCBFE0 Kwb_Wu16 65535.00 OneToOne 0.00 65535.00 FORMAT "%8.2" NUMBER 4 /end CHARACTERISTIC
/begin CHARACTERISTIC DSM_CDKDfp_APPSync_C "Kundenspezifischer Fehlercode fuer Fehlerpfad Dfp_APPSync" VAL_BLK 0xCBFE8 Kwb_Wu16 65535.00 OneToOne 0.00 65535.00 FORMAT "%8.2" NUMBER 4 /end CHARACTERISTIC
/begin CHARACTERISTIC DSM_CDKDfp_APSCD_C "Kundenspezifischer Fehlercode fuer Fehlerpfad Dfp_APSCD" VAL_BLK 0xCBFF0 Kwb_Wu16 65535.00 OneToOne 0.00 65535.00 FORMAT "%8.2" NUMBER 4 /end CHARACTERISTIC
/begin CHARACTERISTIC DSM_CDKDfp_ARS_C "Kundenspezifischer Fehlercode fuer Fehlerpfad Dfp_ARS" VAL_BLK 0xCBFF8 Kwb_Wu16 65535.00 OneToOne 0.00 65535.00 FORMAT "%8.2" NUMBER 4 /end CHARACTERISTIC
/begin CHARACTERISTIC DSM_CDKDfp_AccPedPlausBrk_C "Kundenspezifischer Fehlercode fuer Fehlerpfad Dfp_AccPedPlausBrk" VAL_BLK 0xCC000 Kwb_Wu16 65535.00 OneToOne 0.00 65535.00 FORMAT "%8.2" NUMBER 4 /end CHARACTERISTIC
/begin CHARACTERISTIC DSM_CDKDfp_Layer_QLT_C "Kundenspezifischer Fehlercode fuer Fehlerpfad Dfp_Layer_QLT" VAL_BLK 0xCC008 Kwb_Wu16 65535.00 OneToOne 0.00 65535.00 FORMAT "%8.2" NUMBER 4 /end CHARACTERISTIC
/begin CHARACTERISTIC DSM_CDKDfp_AirCtlGvnrDvtRgnMax_C "Kundenspezifischer Fehlercode fuer Fehlerpfad Dfp_AirCtlGvnrDvtRgnMax" VAL_BLK 0xCC010 Kwb_Wu16 65535.00 OneToOne 0.00 65535.00 FORMAT "%8.2" NUMBER 4 /end CHARACTERISTIC
/begin CHARACTERISTIC DSM_CDKDfp_Layer_IBS1_C "Kundenspezifischer Fehlercode fuer Fehlerpfad Dfp_Layer_IBS1" VAL_BLK 0xCC018 Kwb_Wu16 65535.00 OneToOne 0.00 65535.00 FORMAT "%8.2" NUMBER 4 /end CHARACTERISTIC
/begin CHARACTERISTIC DSM_CDKDfp_Layer_IBS2_C "Kundenspezifischer Fehlercode fuer Fehlerpfad Dfp_Layer_IBS2" VAL_BLK 0xCC020 Kwb_Wu16 65535.00 OneToOne 0.00 65535.00 FORMAT "%8.2" NUMBER 4 /end CHARACTERISTIC
/begin CHARACTERISTIC DSM_CDKDfp_Layer_IBS3_C "Kundenspezifischer Fehlercode fuer Fehlerpfad Dfp_Layer_IBS3" VAL_BLK 0xCC028 Kwb_Wu16 65535.00 OneToOne 0.00 65535.00 FORMAT "%8.2" NUMBER 4 /end CHARACTERISTIC
/begin CHARACTERISTIC DSM_CDKDfp_Layer_PMBN_C "Kundenspezifischer Fehlercode fuer Fehlerpfad Dfp_Layer_PMBN" VAL_BLK 0xCC030 Kwb_Wu16 65535.00 OneToOne 0.00 65535.00 FORMAT "%8.2" NUMBER 4 /end CHARACTERISTIC
/begin CHARACTERISTIC DSM_CDKDfp_Layer_PMBATT_C "Kundenspezifischer Fehlercode fuer Fehlerpfad Dfp_Layer_PMBATT" VAL_BLK 0xCC038 Kwb_Wu16 65535.00 OneToOne 0.00 65535.00 FORMAT "%8.2" NUMBER 4 /end CHARACTERISTIC
/begin CHARACTERISTIC DSM_CDKDfp_AirCtlGvnrDvtRgnMin_C "Kundenspezifischer Fehlercode fuer Fehlerpfad Dfp_AirCtlGvnrDvtRgnMin" VAL_BLK 0xCC040 Kwb_Wu16 65535.00 OneToOne 0.00 65535.00 FORMAT "%8.2" NUMBER 4 /end CHARACTERISTIC
/begin CHARACTERISTIC DSM_CDKDfp_AirCtlGvnrDvtRgnMn2_C "Kundenspezifischer Fehlercode fuer Fehlerpfad Dfp_AirCtlGvnrDvtRgnMn2" VAL_BLK 0xCC048 Kwb_Wu16 65535.00 OneToOne 0.00 65535.00 FORMAT "%8.2" NUMBER 4 /end CHARACTERISTIC
/begin CHARACTERISTIC DSM_CDKDfp_AirCtlGvnrDvtRgnMx2_C "Kundenspezifischer Fehlercode fuer Fehlerpfad Dfp_AirCtlGvnrDvtRgnMx2" VAL_BLK 0xCC050 Kwb_Wu16 65535.00 OneToOne 0.00 65535.00 FORMAT "%8.2" NUMBER 4 /end CHARACTERISTIC
/begin CHARACTERISTIC DSM_CDKDfp_AirCtlPlateBreak_C "DSM variable for Dfp_AirCtlPlateBreak_mp" VAL_BLK 0xCC058 Kwb_Wu16 65535.00 OneToOne 0.00 65535.00 FORMAT "%8.2" NUMBER 4 /end CHARACTERISTIC
/begin CHARACTERISTIC DSM_CDKDfp_AirCtlRmpTO_C "Kundenspezifischer Fehlercode fuer Fehlerpfad Dfp_AirCtlRmpTO" VAL_BLK 0xCC060 Kwb_Wu16 65535.00 OneToOne 0.00 65535.00 FORMAT "%8.2" NUMBER 4 /end CHARACTERISTIC
/begin CHARACTERISTIC DSM_CDKDfp_AirCtl_GovNegDev_C "Kundenspezifischer Fehlercode fuer Fehlerpfad Dfp_AirCtl_GovNegDev" VAL_BLK 0xCC068 Kwb_Wu16 65535.00 OneToOne 0.00 65535.00 FORMAT "%8.2" NUMBER 4 /end CHARACTERISTIC
/begin CHARACTERISTIC DSM_CDKDfp_AirCtl_GovNegDev2_C "Kundenspezifischer Fehlercode fuer Fehlerpfad Dfp_AirCtl_GovNegDev2" VAL_BLK 0xCC070 Kwb_Wu16 65535.00 OneToOne 0.00 65535.00 FORMAT "%8.2" NUMBER 4 /end CHARACTERISTIC
/begin CHARACTERISTIC DSM_CDKDfp_AirCtl_GovPosDev_C "Kundenspezifischer Fehlercode fuer Fehlerpfad Dfp_AirCtl_GovPosDev" VAL_BLK 0xCC078 Kwb_Wu16 65535.00 OneToOne 0.00 65535.00 FORMAT "%8.2" NUMBER 4 /end CHARACTERISTIC
/begin CHARACTERISTIC DSM_CDKDfp_AirCtl_GovPosDev2_C "Kundenspezifischer Fehlercode fuer Fehlerpfad Dfp_AirCtl_GovPosDev2" VAL_BLK 0xCC080 Kwb_Wu16 65535.00 OneToOne 0.00 65535.00 FORMAT "%8.2" NUMBER 4 /end CHARACTERISTIC
/begin CHARACTERISTIC DSM_CDKDfp_AltCD_C "Kundenspezifischer Fehlercode fuer Fehlerpfad Dfp_AltCD" VAL_BLK 0xCC088 Kwb_Wu16 65535.00 OneToOne 0.00 65535.00 FORMAT "%8.2" NUMBER 4 /end CHARACTERISTIC
/begin CHARACTERISTIC DSM_CDKDfp_AltCD_Load_C "Kundenspezifischer Fehlercode fuer Fehlerpfad Dfp_AltCD_Load" VAL_BLK 0xCC090 Kwb_Wu16 65535.00 OneToOne 0.00 65535.00 FORMAT "%8.2" NUMBER 4 /end CHARACTERISTIC
/begin CHARACTERISTIC DSM_CDKDfp_BPACD_BPADia1_C "Kundenspezifischer Fehlercode fuer Fehlerpfad Dfp_BPACD_BPADia1" VAL_BLK 0xCC098 Kwb_Wu16 65535.00 OneToOne 0.00 65535.00 FORMAT "%8.2" NUMBER 4 /end CHARACTERISTIC
/begin CHARACTERISTIC DSM_CDKDfp_BPACD_BPADia2_C "Kundenspezifischer Fehlercode fuer Fehlerpfad Dfp_BPACD_BPADia2" VAL_BLK 0xCC0A0 Kwb_Wu16 65535.00 OneToOne 0.00 65535.00 FORMAT "%8.2" NUMBER 4 /end CHARACTERISTIC
/begin CHARACTERISTIC DSM_CDKDfp_BPACD_BPADia3_C "Kundenspezifischer Fehlercode fuer Fehlerpfad Dfp_BPACD_BPADia3" VAL_BLK 0xCC0A8 Kwb_Wu16 65535.00 OneToOne 0.00 65535.00 FORMAT "%8.2" NUMBER 4 /end CHARACTERISTIC
/begin CHARACTERISTIC DSM_CDKDfp_BPACD_BPADia4_C "Kundenspezifischer Fehlercode fuer Fehlerpfad Dfp_BPACD_BPADia4" VAL_BLK 0xCC0B0 Kwb_Wu16 65535.00 OneToOne 0.00 65535.00 FORMAT "%8.2" NUMBER 4 /end CHARACTERISTIC
/begin CHARACTERISTIC DSM_CDKDfp_BPACD_Max_C "Kundenspezifischer Fehlercode fuer Fehlerpfad Dfp_BPACD_Max" VAL_BLK 0xCC0B8 Kwb_Wu16 65535.00 OneToOne 0.00 65535.00 FORMAT "%8.2" NUMBER 4 /end CHARACTERISTIC
/begin CHARACTERISTIC DSM_CDKDfp_BPACD_Min_C "Kundenspezifischer Fehlercode fuer Fehlerpfad Dfp_BPACD_Min" VAL_BLK 0xCC0C0 Kwb_Wu16 65535.00 OneToOne 0.00 65535.00 FORMAT "%8.2" NUMBER 4 /end CHARACTERISTIC
/begin CHARACTERISTIC DSM_CDKDfp_BPACD_PwmIn_C "Kundenspezifischer Fehlercode fuer Fehlerpfad Dfp_BPACD_PwmIn" VAL_BLK 0xCC0C8 Kwb_Wu16 65535.00 OneToOne 0.00 65535.00 FORMAT "%8.2" NUMBER 4 /end CHARACTERISTIC
/begin CHARACTERISTIC DSM_CDKDfp_BPACD_PwmInDia1_C "Kundenspezifischer Fehlercode fuer Fehlerpfad Dfp_BPACD_PwmInDia1" VAL_BLK 0xCC0D0 Kwb_Wu16 65535.00 OneToOne 0.00 65535.00 FORMAT "%8.2" NUMBER 4 /end CHARACTERISTIC
/begin CHARACTERISTIC DSM_CDKDfp_BPACD_PwmInDia2_C "Kundenspezifischer Fehlercode fuer Fehlerpfad Dfp_BPACD_PwmInDia2" VAL_BLK 0xCC0D8 Kwb_Wu16 65535.00 OneToOne 0.00 65535.00 FORMAT "%8.2" NUMBER 4 /end CHARACTERISTIC
/begin CHARACTERISTIC DSM_CDKDfp_BPACD_PwmInDia3_C "Kundenspezifischer Fehlercode fuer Fehlerpfad Dfp_BPACD_PwmInDia3" VAL_BLK 0xCC0E0 Kwb_Wu16 65535.00 OneToOne 0.00 65535.00 FORMAT "%8.2" NUMBER 4 /end CHARACTERISTIC
/begin CHARACTERISTIC DSM_CDKDfp_BPACD_PwmInDia4_C "Kundenspezifischer Fehlercode fuer Fehlerpfad Dfp_BPACD_PwmInDia4" VAL_BLK 0xCC0E8 Kwb_Wu16 65535.00 OneToOne 0.00 65535.00 FORMAT "%8.2" NUMBER 4 /end CHARACTERISTIC
/begin CHARACTERISTIC DSM_CDKDfp_BPACD_SigNpl_C "Kundenspezifischer Fehlercode fuer Fehlerpfad Dfp_BPACD_SigNpl" VAL_BLK 0xCC0F0 Kwb_Wu16 65535.00 OneToOne 0.00 65535.00 FORMAT "%8.2" NUMBER 4 /end CHARACTERISTIC
/begin CHARACTERISTIC DSM_CDKDfp_BPSCD_C "Kundenspezifischer Fehlercode fuer Fehlerpfad Dfp_BPSCD" VAL_BLK 0xCC0F8 Kwb_Wu16 65535.00 OneToOne 0.00 65535.00 FORMAT "%8.2" NUMBER 4 /end CHARACTERISTIC
/begin CHARACTERISTIC DSM_CDKDfp_BattCD_C "Kundenspezifischer Fehlercode fuer Fehlerpfad Dfp_BattCD" VAL_BLK 0xCC100 Kwb_Wu16 65535.00 OneToOne 0.00 65535.00 FORMAT "%8.2" NUMBER 4 /end CHARACTERISTIC
/begin CHARACTERISTIC DSM_CDKDfp_BrkCD_C "Kundenspezifischer Fehlercode fuer Fehlerpfad Dfp_BrkCD" VAL_BLK 0xCC108 Kwb_Wu16 65535.00 OneToOne 0.00 65535.00 FORMAT "%8.2" NUMBER 4 /end CHARACTERISTIC
/begin CHARACTERISTIC DSM_CDKDfp_Bss_C "Kundenspezifischer Fehlercode fuer Fehlerpfad Dfp_Bss" VAL_BLK 0xCC110 Kwb_Wu16 65535.00 OneToOne 0.00 65535.00 FORMAT "%8.2" NUMBER 4 /end CHARACTERISTIC
/begin CHARACTERISTIC DSM_CDKDfp_CBACD_C "Kundenspezifischer Fehlercode fuer Fehlerpfad Dfp_CBACD" VAL_BLK 0xCC118 Kwb_Wu16 65535.00 OneToOne 0.00 65535.00 FORMAT "%8.2" NUMBER 4 /end CHARACTERISTIC
/begin CHARACTERISTIC DSM_CDKDfp_CTSCD_C "Kundenspezifischer Fehlercode fuer Fehlerpfad Dfp_CTSCD" VAL_BLK 0xCC120 Kwb_Wu16 65535.00 OneToOne 0.00 65535.00 FORMAT "%8.2" NUMBER 4 /end CHARACTERISTIC
/begin CHARACTERISTIC DSM_CDKDfp_Clg_DynTst_C "Kundenspezifischer Fehlercode fuer Fehlerpfad Dfp_Clg_DynTst" VAL_BLK 0xCC128 Kwb_Wu16 65535.00 OneToOne 0.00 65535.00 FORMAT "%8.2" NUMBER 4 /end CHARACTERISTIC
/begin CHARACTERISTIC DSM_CDKDfp_CmbChbMisfire1_C "Kundenspezifischer Fehlercode fuer Fehlerpfad Dfp_CmbChbMisfire1" VAL_BLK 0xCC130 Kwb_Wu16 65535.00 OneToOne 0.00 65535.00 FORMAT "%8.2" NUMBER 4 /end CHARACTERISTIC
/begin CHARACTERISTIC DSM_CDKDfp_CmbChbMisfire2_C "Kundenspezifischer Fehlercode fuer Fehlerpfad Dfp_CmbChbMisfire2" VAL_BLK 0xCC138 Kwb_Wu16 65535.00 OneToOne 0.00 65535.00 FORMAT "%8.2" NUMBER 4 /end CHARACTERISTIC
/begin CHARACTERISTIC DSM_CDKDfp_Layer_PMRUHVERL_C "Kundenspezifischer Fehlercode fuer Fehlerpfad Dfp_Layer_PMRUHVERL" VAL_BLK 0xCC140 Kwb_Wu16 65535.00 OneToOne 0.00 65535.00 FORMAT "%8.2" NUMBER 4 /end CHARACTERISTIC
/begin CHARACTERISTIC DSM_CDKDfp_CmbChbMisfire3_C "Kundenspezifischer Fehlercode fuer Fehlerpfad Dfp_CmbChbMisfire3" VAL_BLK 0xCC148 Kwb_Wu16 65535.00 OneToOne 0.00 65535.00 FORMAT "%8.2" NUMBER 4 /end CHARACTERISTIC
/begin CHARACTERISTIC DSM_CDKDfp_CmbChbMisfire4_C "Kundenspezifischer Fehlercode fuer Fehlerpfad Dfp_CmbChbMisfire4" VAL_BLK 0xCC150 Kwb_Wu16 65535.00 OneToOne 0.00 65535.00 FORMAT "%8.2" NUMBER 4 /end CHARACTERISTIC
/begin CHARACTERISTIC DSM_CDKDfp_CmbChbMisfire5_C "Kundenspezifischer Fehlercode fuer Fehlerpfad Dfp_CmbChbMisfire5" VAL_BLK 0xCC158 Kwb_Wu16 65535.00 OneToOne 0.00 65535.00 FORMAT "%8.2" NUMBER 4 /end CHARACTERISTIC
/begin CHARACTERISTIC DSM_CDKDfp_CmbChbMisfire6_C "Kundenspezifischer Fehlercode fuer Fehlerpfad Dfp_CmbChbMisfire6" VAL_BLK 0xCC160 Kwb_Wu16 65535.00 OneToOne 0.00 65535.00 FORMAT "%8.2" NUMBER 4 /end CHARACTERISTIC
/begin CHARACTERISTIC DSM_CDKDfp_Layer_TOENS_C "Kundenspezifischer Fehlercode fuer Fehlerpfad Dfp_Layer_TOENS" VAL_BLK 0xCC168 Kwb_Wu16 65535.00 OneToOne 0.00 65535.00 FORMAT "%8.2" NUMBER 4 /end CHARACTERISTIC
/begin CHARACTERISTIC DSM_CDKDfp_Layer_MANHYDR_C "Kundenspezifischer Fehlercode fuer Fehlerpfad Dfp_Layer_MANHYDR" VAL_BLK 0xCC170 Kwb_Wu16 65535.00 OneToOne 0.00 65535.00 FORMAT "%8.2" NUMBER 4 /end CHARACTERISTIC
/begin CHARACTERISTIC DSM_CDKDfp_Layer_MANLUFT_C "Kundenspezifischer Fehlercode fuer Fehlerpfad Dfp_Layer_MANLUFT" VAL_BLK 0xCC178 Kwb_Wu16 65535.00 OneToOne 0.00 65535.00 FORMAT "%8.2" NUMBER 4 /end CHARACTERISTIC
/begin CHARACTERISTIC DSM_CDKDfp_CmbChbMisfireMul_C "Kundenspezifischer Fehlercode fuer Fehlerpfad Dfp_CmbChbMisfireMul" VAL_BLK 0xCC180 Kwb_Wu16 65535.00 OneToOne 0.00 65535.00 FORMAT "%8.2" NUMBER 4 /end CHARACTERISTIC
/begin CHARACTERISTIC DSM_CDKDfp_CoVMDCSh_C "Kundenspezifischer Fehlercode fuer Fehlerpfad Dfp_CoVMDCSh" VAL_BLK 0xCC188 Kwb_Wu16 65535.00 OneToOne 0.00 65535.00 FORMAT "%8.2" NUMBER 4 /end CHARACTERISTIC
/begin CHARACTERISTIC DSM_CDKDfp_ConvCD_C "Kundenspezifischer Fehlercode fuer Fehlerpfad Dfp_ConvCD" VAL_BLK 0xCC190 Kwb_Wu16 65535.00 OneToOne 0.00 65535.00 FORMAT "%8.2" NUMBER 4 /end CHARACTERISTIC
/begin CHARACTERISTIC DSM_CDKDfp_CrCCDMFL_C "Kundenspezifischer Fehlercode fuer Fehlerpfad Dfp_CrCCDMFL" VAL_BLK 0xCC198 Kwb_Wu16 65535.00 OneToOne 0.00 65535.00 FORMAT "%8.2" NUMBER 4 /end CHARACTERISTIC
/begin CHARACTERISTIC DSM_CDKDfp_CrCtl_vCrCtl_C "Kundenspezifischer Fehlercode fuer Fehlerpfad Dfp_CrCtl_vCrCtl" VAL_BLK 0xCC1A0 Kwb_Wu16 65535.00 OneToOne 0.00 65535.00 FORMAT "%8.2" NUMBER 4 /end CHARACTERISTIC
/begin CHARACTERISTIC DSM_CDKDfp_DCC_PlausTrqDes_C "Kundenspezifischer Fehlercode fuer Fehlerpfad Dfp_DCC_PlausTrqDes" VAL_BLK 0xCC1A8 Kwb_Wu16 65535.00 OneToOne 0.00 65535.00 FORMAT "%8.2" NUMBER 4 /end CHARACTERISTIC
/begin CHARACTERISTIC DSM_CDKDfp_Dummy1_C "Kundenspezifischer Fehlercode fuer Fehlerpfad Dfp_Dummy1" VAL_BLK 0xCC1B0 Kwb_Wu16 65535.00 OneToOne 0.00 65535.00 FORMAT "%8.2" NUMBER 4 /end CHARACTERISTIC
/begin CHARACTERISTIC DSM_CDKDfp_EATSCD_C "Kundenspezifischer Fehlercode fuer Fehlerpfad Dfp_EATSCD" VAL_BLK 0xCC1B8 Kwb_Wu16 65535.00 OneToOne 0.00 65535.00 FORMAT "%8.2" NUMBER 4 /end CHARACTERISTIC
/begin CHARACTERISTIC DSM_CDKDfp_EBAFCD_C "Kundenspezifischer Fehlercode fuer Fehlerpfad Dfp_EBAFCD" VAL_BLK 0xCC1C0 Kwb_Wu16 65535.00 OneToOne 0.00 65535.00 FORMAT "%8.2" NUMBER 4 /end CHARACTERISTIC
/begin CHARACTERISTIC DSM_CDKDfp_EBFCD_C "Kundenspezifischer Fehlercode fuer Fehlerpfad Dfp_EBFCD" VAL_BLK 0xCC1C8 Kwb_Wu16 65535.00 OneToOne 0.00 65535.00 FORMAT "%8.2" NUMBER 4 /end CHARACTERISTIC
/begin CHARACTERISTIC DSM_CDKDfp_EBTSCD_C "Kundenspezifischer Fehlercode fuer Fehlerpfad Dfp_EBTSCD" VAL_BLK 0xCC1D0 Kwb_Wu16 65535.00 OneToOne 0.00 65535.00 FORMAT "%8.2" NUMBER 4 /end CHARACTERISTIC
/begin CHARACTERISTIC DSM_CDKDfp_EBTSCD_OvrTemp_C "Kundenspezifischer Fehlercode fuer Fehlerpfad Dfp_EBTSCD_OvrTemp" VAL_BLK 0xCC1D8 Kwb_Wu16 65535.00 OneToOne 0.00 65535.00 FORMAT "%8.2" NUMBER 4 /end CHARACTERISTIC
/begin CHARACTERISTIC DSM_CDKDfp_ECBCD_C "Kundenspezifischer Fehlercode fuer Fehlerpfad Dfp_ECBCD" VAL_BLK 0xCC1E0 Kwb_Wu16 65535.00 OneToOne 0.00 65535.00 FORMAT "%8.2" NUMBER 4 /end CHARACTERISTIC
/begin CHARACTERISTIC DSM_CDKDfp_EEPCDVarMng_C "Kundenspezifischer Fehlercode fuer Fehlerpfad Dfp_EEPCD_VarMng" VAL_BLK 0xCC1E8 Kwb_Wu16 65535.00 OneToOne 0.00 65535.00 FORMAT "%8.2" NUMBER 4 /end CHARACTERISTIC
/begin CHARACTERISTIC DSM_CDKDfp_EGPpCD_C "Kundenspezifischer Fehlercode fuer Fehlerpfad Dfp_EGPpCD" VAL_BLK 0xCC1F0 Kwb_Wu16 65535.00 OneToOne 0.00 65535.00 FORMAT "%8.2" NUMBER 4 /end CHARACTERISTIC
/begin CHARACTERISTIC DSM_CDKDfp_EGPpCDTPreTrbn_C "Kundenspezifischer Fehlercode fuer Fehlerpfad Dfp_EgPpCDTPreTrbn" VAL_BLK 0xCC1F8 Kwb_Wu16 65535.00 OneToOne 0.00 65535.00 FORMAT "%8.2" NUMBER 4 /end CHARACTERISTIC
/begin CHARACTERISTIC DSM_CDKDfp_EGRCD_Max_C "Kundenspezifischer Fehlercode fuer Fehlerpfad Dfp_EGRCD_Max" VAL_BLK 0xCC200 Kwb_Wu16 65535.00 OneToOne 0.00 65535.00 FORMAT "%8.2" NUMBER 4 /end CHARACTERISTIC
/begin CHARACTERISTIC DSM_CDKDfp_EGRCD_Min_C "Kundenspezifischer Fehlercode fuer Fehlerpfad Dfp_EGRCD_Min" VAL_BLK 0xCC208 Kwb_Wu16 65535.00 OneToOne 0.00 65535.00 FORMAT "%8.2" NUMBER 4 /end CHARACTERISTIC
/begin CHARACTERISTIC DSM_CDKDfp_EGRCD_SigNpl_C "Kundenspezifischer Fehlercode fuer Fehlerpfad Dfp_EGRCD_SigNpl" VAL_BLK 0xCC210 Kwb_Wu16 65535.00 OneToOne 0.00 65535.00 FORMAT "%8.2" NUMBER 4 /end CHARACTERISTIC
/begin CHARACTERISTIC DSM_CDKDfp_EGTOilLvlCrit_C "Kundenspezifischer Fehlercode fuer Fehlerpfad Dfp_EGTOilLvlCrit" VAL_BLK 0xCC218 Kwb_Wu16 65535.00 OneToOne 0.00 65535.00 FORMAT "%8.2" NUMBER 4 /end CHARACTERISTIC
/begin CHARACTERISTIC DSM_CDKDfp_EGTOilVscCrit_C "Kundenspezifischer Fehlercode fuer Fehlerpfad Dfp_EGTOilVscCrit" VAL_BLK 0xCC220 Kwb_Wu16 65535.00 OneToOne 0.00 65535.00 FORMAT "%8.2" NUMBER 4 /end CHARACTERISTIC
/begin CHARACTERISTIC DSM_CDKDfp_EGTRgnOilDil_C "Kundenspezifischer Fehlercode fuer Fehlerpfad Dfp_EGTRgnOilDil" VAL_BLK 0xCC228 Kwb_Wu16 65535.00 OneToOne 0.00 65535.00 FORMAT "%8.2" NUMBER 4 /end CHARACTERISTIC
/begin CHARACTERISTIC DSM_CDKDfp_EGTTempGvnrInr_C "Kundenspezifischer Fehlercode fuer Fehlerpfad Dfp_EGTTempGvnrInr" VAL_BLK 0xCC230 Kwb_Wu16 65535.00 OneToOne 0.00 65535.00 FORMAT "%8.2" NUMBER 4 /end CHARACTERISTIC
/begin CHARACTERISTIC DSM_CDKDfp_EGTTempGvnrOutr_C "Kundenspezifischer Fehlercode fuer Fehlerpfad Dfp_EGTTempGvnrOutr" VAL_BLK 0xCC238 Kwb_Wu16 65535.00 OneToOne 0.00 65535.00 FORMAT "%8.2" NUMBER 4 /end CHARACTERISTIC
/begin CHARACTERISTIC DSM_CDKDfp_EMCCD1_C "Kundenspezifischer Fehlercode fuer Fehlerpfad Dfp_EMCCD1" VAL_BLK 0xCC240 Kwb_Wu16 65535.00 OneToOne 0.00 65535.00 FORMAT "%8.2" NUMBER 4 /end CHARACTERISTIC
/begin CHARACTERISTIC DSM_CDKDfp_EMCCD2_C "Kundenspezifischer Fehlercode fuer Fehlerpfad Dfp_EMCCD2" VAL_BLK 0xCC248 Kwb_Wu16 65535.00 OneToOne 0.00 65535.00 FORMAT "%8.2" NUMBER 4 /end CHARACTERISTIC
/begin CHARACTERISTIC DSM_CDKDfp_EMCCD_ADC1_C "Kundenspezifischer Fehlercode fuer Fehlerpfad Dfp_EMCCD_ADC1" VAL_BLK 0xCC250 Kwb_Wu16 65535.00 OneToOne 0.00 65535.00 FORMAT "%8.2" NUMBER 4 /end CHARACTERISTIC
/begin CHARACTERISTIC DSM_CDKDfp_EMCCD_ADC2_C "Kundenspezifischer Fehlercode fuer Fehlerpfad Dfp_EMCCD_ADC2" VAL_BLK 0xCC258 Kwb_Wu16 65535.00 OneToOne 0.00 65535.00 FORMAT "%8.2" NUMBER 4 /end CHARACTERISTIC
/begin CHARACTERISTIC DSM_CDKDfp_ETClbETFltInj1_C "Kundenspezifischer Fehlercode fuer Fehlerpfad Dfp_ETClbETFltInj1" VAL_BLK 0xCC260 Kwb_Wu16 65535.00 OneToOne 0.00 65535.00 FORMAT "%8.2" NUMBER 4 /end CHARACTERISTIC
/begin CHARACTERISTIC DSM_CDKDfp_ETClbETFltInj2_C "Kundenspezifischer Fehlercode fuer Fehlerpfad Dfp_ETClbETFltInj2" VAL_BLK 0xCC268 Kwb_Wu16 65535.00 OneToOne 0.00 65535.00 FORMAT "%8.2" NUMBER 4 /end CHARACTERISTIC
/begin CHARACTERISTIC DSM_CDKDfp_ETClbETFltInj3_C "Kundenspezifischer Fehlercode fuer Fehlerpfad Dfp_ETClbETFltInj3" VAL_BLK 0xCC270 Kwb_Wu16 65535.00 OneToOne 0.00 65535.00 FORMAT "%8.2" NUMBER 4 /end CHARACTERISTIC
/begin CHARACTERISTIC DSM_CDKDfp_ETClbETFltInj4_C "Kundenspezifischer Fehlercode fuer Fehlerpfad Dfp_ETClbETFltInj4" VAL_BLK 0xCC278 Kwb_Wu16 65535.00 OneToOne 0.00 65535.00 FORMAT "%8.2" NUMBER 4 /end CHARACTERISTIC
/begin CHARACTERISTIC DSM_CDKDfp_ETClbETFltInj5_C "Kundenspezifischer Fehlercode fuer Fehlerpfad Dfp_ETClbETFltInj5" VAL_BLK 0xCC280 Kwb_Wu16 65535.00 OneToOne 0.00 65535.00 FORMAT "%8.2" NUMBER 4 /end CHARACTERISTIC
/begin CHARACTERISTIC DSM_CDKDfp_ETClbETFltInj6_C "Kundenspezifischer Fehlercode fuer Fehlerpfad Dfp_ETClbETFltInj6" VAL_BLK 0xCC288 Kwb_Wu16 65535.00 OneToOne 0.00 65535.00 FORMAT "%8.2" NUMBER 4 /end CHARACTERISTIC
/begin CHARACTERISTIC DSM_CDKDfp_ETClbInj1_C "Kundenspezifischer Fehlercode fuer Fehlerpfad Dfp_ETClbInj1" VAL_BLK 0xCC290 Kwb_Wu16 65535.00 OneToOne 0.00 65535.00 FORMAT "%8.2" NUMBER 4 /end CHARACTERISTIC
/begin CHARACTERISTIC DSM_CDKDfp_ETClbInj2_C "Kundenspezifischer Fehlercode fuer Fehlerpfad Dfp_ETClbInj2" VAL_BLK 0xCC298 Kwb_Wu16 65535.00 OneToOne 0.00 65535.00 FORMAT "%8.2" NUMBER 4 /end CHARACTERISTIC
/begin CHARACTERISTIC DSM_CDKDfp_ETClbInj3_C "Kundenspezifischer Fehlercode fuer Fehlerpfad Dfp_ETClbInj3" VAL_BLK 0xCC2A0 Kwb_Wu16 65535.00 OneToOne 0.00 65535.00 FORMAT "%8.2" NUMBER 4 /end CHARACTERISTIC
/begin CHARACTERISTIC DSM_CDKDfp_ETClbInj4_C "Kundenspezifischer Fehlercode fuer Fehlerpfad Dfp_ETClbInj4" VAL_BLK 0xCC2A8 Kwb_Wu16 65535.00 OneToOne 0.00 65535.00 FORMAT "%8.2" NUMBER 4 /end CHARACTERISTIC
/begin CHARACTERISTIC DSM_CDKDfp_ETClbInj5_C "Kundenspezifischer Fehlercode fuer Fehlerpfad Dfp_ETClbInj5" VAL_BLK 0xCC2B0 Kwb_Wu16 65535.00 OneToOne 0.00 65535.00 FORMAT "%8.2" NUMBER 4 /end CHARACTERISTIC
/begin CHARACTERISTIC DSM_CDKDfp_ETClbInj6_C "Kundenspezifischer Fehlercode fuer Fehlerpfad Dfp_ETClbInj6" VAL_BLK 0xCC2B8 Kwb_Wu16 65535.00 OneToOne 0.00 65535.00 FORMAT "%8.2" NUMBER 4 /end CHARACTERISTIC
/begin CHARACTERISTIC DSM_CDKDfp_EngMCaS1_C "Kundenspezifischer Fehlercode fuer Fehlerpfad Dfp_EngMCaS1" VAL_BLK 0xCC2C0 Kwb_Wu16 65535.00 OneToOne 0.00 65535.00 FORMAT "%8.2" NUMBER 4 /end CHARACTERISTIC
/begin CHARACTERISTIC DSM_CDKDfp_EngMCrS1_C "Kundenspezifischer Fehlercode fuer Fehlerpfad Dfp_EngMCrS1" VAL_BLK 0xCC2C8 Kwb_Wu16 65535.00 OneToOne 0.00 65535.00 FORMAT "%8.2" NUMBER 4 /end CHARACTERISTIC
/begin CHARACTERISTIC DSM_CDKDfp_EngMOfsCaSCrS_C "Kundenspezifischer Fehlercode fuer Fehlerpfad Dfp_EngMOfsCaSCrS" VAL_BLK 0xCC2D0 Kwb_Wu16 65535.00 OneToOne 0.00 65535.00 FORMAT "%8.2" NUMBER 4 /end CHARACTERISTIC
/begin CHARACTERISTIC DSM_CDKDfp_EngPrtFWODet_C "Kundenspezifischer Fehlercode fuer Fehlerpfad Dfp_EngPrtFWODet" VAL_BLK 0xCC2D8 Kwb_Wu16 65535.00 OneToOne 0.00 65535.00 FORMAT "%8.2" NUMBER 4 /end CHARACTERISTIC
/begin CHARACTERISTIC DSM_CDKDfp_FBCqDvt_C "Kundenspezifischer Fehlercode fuer Fehlerpfad Dfp_FBCqDvt" VAL_BLK 0xCC2E0 Kwb_Wu16 65535.00 OneToOne 0.00 65535.00 FORMAT "%8.2" NUMBER 4 /end CHARACTERISTIC
/begin CHARACTERISTIC DSM_CDKDfp_FMAErrMod_C "Kundenspezifischer Fehlercode fuer Fehlerpfad Dfp_FMAErrMod" VAL_BLK 0xCC2E8 Kwb_Wu16 65535.00 OneToOne 0.00 65535.00 FORMAT "%8.2" NUMBER 4 /end CHARACTERISTIC
/begin CHARACTERISTIC DSM_CDKDfp_FMTC_NonMonotonMap_C "Kundenspezifischer Fehlercode fuer Fehlerpfad Dfp_FMTC_NonMonotonMap" VAL_BLK 0xCC2F0 Kwb_Wu16 65535.00 OneToOne 0.00 65535.00 FORMAT "%8.2" NUMBER 4 /end CHARACTERISTIC
/begin CHARACTERISTIC DSM_CDKDfp_FTSCD_C "Kundenspezifischer Fehlercode fuer Fehlerpfad Dfp_FTSCD" VAL_BLK 0xCC2F8 Kwb_Wu16 65535.00 OneToOne 0.00 65535.00 FORMAT "%8.2" NUMBER 4 /end CHARACTERISTIC
/begin CHARACTERISTIC DSM_CDKDfp_FanCD_C "Kundenspezifischer Fehlercode fuer Fehlerpfad Dfp_FanCD" VAL_BLK 0xCC300 Kwb_Wu16 65535.00 OneToOne 0.00 65535.00 FORMAT "%8.2" NUMBER 4 /end CHARACTERISTIC
/begin CHARACTERISTIC DSM_CDKDfp_FanCD_FanCtlr1_C "Kundenspezifischer Fehlercode fuer Fehlerpfad Dfp_FanCD_FanCtlr1" VAL_BLK 0xCC308 Kwb_Wu16 65535.00 OneToOne 0.00 65535.00 FORMAT "%8.2" NUMBER 4 /end CHARACTERISTIC
/begin CHARACTERISTIC DSM_CDKDfp_FanCD_FanCtlr2_C "Kundenspezifischer Fehlercode fuer Fehlerpfad Dfp_FanCD_FanCtlr2" VAL_BLK 0xCC310 Kwb_Wu16 65535.00 OneToOne 0.00 65535.00 FORMAT "%8.2" NUMBER 4 /end CHARACTERISTIC
/begin CHARACTERISTIC DSM_CDKDfp_FanCD_FanCtlr3_C "Kundenspezifischer Fehlercode fuer Fehlerpfad Dfp_FanCD_FanCtlr3" VAL_BLK 0xCC318 Kwb_Wu16 65535.00 OneToOne 0.00 65535.00 FORMAT "%8.2" NUMBER 4 /end CHARACTERISTIC
/begin CHARACTERISTIC DSM_CDKDfp_FlFCD_C "Kundenspezifischer Fehlercode fuer Fehlerpfad Dfp_FlFCD" VAL_BLK 0xCC320 Kwb_Wu16 65535.00 OneToOne 0.00 65535.00 FORMAT "%8.2" NUMBER 4 /end CHARACTERISTIC
/begin CHARACTERISTIC DSM_CDKDfp_FlMngSmkDefect_C "Kundenspezifischer Fehlercode fuer Fehlerpfad Dfp_FlMngSmkDefect" VAL_BLK 0xCC328 Kwb_Wu16 65535.00 OneToOne 0.00 65535.00 FORMAT "%8.2" NUMBER 4 /end CHARACTERISTIC
/begin CHARACTERISTIC DSM_CDKDfp_FrmMngANFRADMOMPT_C "Kundenspezifischer Fehlercode fuer Fehlerpfad Dfp_FrmMngANFRADMOMPT" VAL_BLK 0xCC330 Kwb_Wu16 65535.00 OneToOne 0.00 65535.00 FORMAT "%8.2" NUMBER 4 /end CHARACTERISTIC
/begin CHARACTERISTIC DSM_CDKDfp_FrmMngASC1_C "Kundenspezifischer Fehlercode fuer Fehlerpfad Dfp_FrmMngASC1" VAL_BLK 0xCC338 Kwb_Wu16 65535.00 OneToOne 0.00 65535.00 FORMAT "%8.2" NUMBER 4 /end CHARACTERISTIC
/begin CHARACTERISTIC DSM_CDKDfp_FrmMngASC2_C "Kundenspezifischer Fehlercode fuer Fehlerpfad Dfp_FrmMngASC2" VAL_BLK 0xCC340 Kwb_Wu16 65535.00 OneToOne 0.00 65535.00 FORMAT "%8.2" NUMBER 4 /end CHARACTERISTIC
/begin CHARACTERISTIC DSM_CDKDfp_FrmMngASC3_C "Kundenspezifischer Fehlercode fuer Fehlerpfad Dfp_FrmMngASC3" VAL_BLK 0xCC348 Kwb_Wu16 65535.00 OneToOne 0.00 65535.00 FORMAT "%8.2" NUMBER 4 /end CHARACTERISTIC
/begin CHARACTERISTIC DSM_CDKDfp_FrmMngASC4_C "Kundenspezifischer Fehlercode fuer Fehlerpfad Dfp_FrmMngASC4" VAL_BLK 0xCC350 Kwb_Wu16 65535.00 OneToOne 0.00 65535.00 FORMAT "%8.2" NUMBER 4 /end CHARACTERISTIC
/begin CHARACTERISTIC DSM_CDKDfp_FrmMngBOS_RESET_C "Kundenspezifischer Fehlercode fuer Fehlerpfad Dfp_FrmMngBOS_RESET" VAL_BLK 0xCC358 Kwb_Wu16 65535.00 OneToOne 0.00 65535.00 FORMAT "%8.2" NUMBER 4 /end CHARACTERISTIC
/begin CHARACTERISTIC DSM_CDKDfp_FrmMngBOS_RESET2_C "Kundenspezifischer Fehlercode fuer Fehlerpfad Dfp_FrmMngBOS_RESET2" VAL_BLK 0xCC360 Kwb_Wu16 65535.00 OneToOne 0.00 65535.00 FORMAT "%8.2" NUMBER 4 /end CHARACTERISTIC
/begin CHARACTERISTIC DSM_CDKDfp_FrmMngDMANFAFS_C "Kundenspezifischer Fehlercode fuer Fehlerpfad Dfp_FrmMngDMANFAFS" VAL_BLK 0xCC368 Kwb_Wu16 65535.00 OneToOne 0.00 65535.00 FORMAT "%8.2" NUMBER 4 /end CHARACTERISTIC
/begin CHARACTERISTIC DSM_CDKDfp_FrmMngDRMANFSSG_C "Kundenspezifischer Fehlercode fuer Fehlerpfad Dfp_FrmMngDRMANFSSG" VAL_BLK 0xCC370 Kwb_Wu16 65535.00 OneToOne 0.00 65535.00 FORMAT "%8.2" NUMBER 4 /end CHARACTERISTIC
/begin CHARACTERISTIC DSM_CDKDfp_FrmMngEGS1_C "Kundenspezifischer Fehlercode fuer Fehlerpfad Dfp_FrmMngEGS1" VAL_BLK 0xCC378 Kwb_Wu16 65535.00 OneToOne 0.00 65535.00 FORMAT "%8.2" NUMBER 4 /end CHARACTERISTIC
/begin CHARACTERISTIC DSM_CDKDfp_FrmMngEGS2_C "Kundenspezifischer Fehlercode fuer Fehlerpfad Dfp_FrmMngEGS2" VAL_BLK 0xCC380 Kwb_Wu16 65535.00 OneToOne 0.00 65535.00 FORMAT "%8.2" NUMBER 4 /end CHARACTERISTIC
/begin CHARACTERISTIC DSM_CDKDfp_FrmMngGEARBX_DATA_C "defect-code (customer-specific) for path" VAL_BLK 0xCC388 Kwb_Wu16 65535.00 OneToOne 0.00 65535.00 FORMAT "%8.2" NUMBER 4 /end CHARACTERISTIC
/begin CHARACTERISTIC DSM_CDKDfp_FrmMngGEARBX_DATA2_C "Kundenspezifischer Fehlercode fuer Fehlerpfad Dfp_FrmMngGEARBX_DATA2" VAL_BLK 0xCC390 Kwb_Wu16 65535.00 OneToOne 0.00 65535.00 FORMAT "%8.2" NUMBER 4 /end CHARACTERISTIC
/begin CHARACTERISTIC DSM_CDKDfp_FrmMngHEAT_AC_C "defect-code (customer-specific) for path" VAL_BLK 0xCC398 Kwb_Wu16 65535.00 OneToOne 0.00 65535.00 FORMAT "%8.2" NUMBER 4 /end CHARACTERISTIC
/begin CHARACTERISTIC DSM_CDKDfp_FrmMngINSTR2_C "Kundenspezifischer Fehlercode fuer Fehlerpfad Dfp_FrmMngINSTR2" VAL_BLK 0xCC3A0 Kwb_Wu16 65535.00 OneToOne 0.00 65535.00 FORMAT "%8.2" NUMBER 4 /end CHARACTERISTIC
/begin CHARACTERISTIC DSM_CDKDfp_FrmMngINSTR3_C "Kundenspezifischer Fehlercode fuer Fehlerpfad Dfp_FrmMngINSTR3" VAL_BLK 0xCC3A8 Kwb_Wu16 65535.00 OneToOne 0.00 65535.00 FORMAT "%8.2" NUMBER 4 /end CHARACTERISTIC
/begin CHARACTERISTIC DSM_CDKDfp_FrmMngLENKRADWINKEL_C "Kundenspezifischer Fehlercode fuer Fehlerpfad Dfp_FrmMngLENKRADWINKEL" VAL_BLK 0xCC3B0 Kwb_Wu16 65535.00 OneToOne 0.00 65535.00 FORMAT "%8.2" NUMBER 4 /end CHARACTERISTIC
/begin CHARACTERISTIC DSM_CDKDfp_FrmMngMILEAGE_RANGE_C "Kundenspezifischer Fehlercode fuer Fehlerpfad Dfp_FrmMngMILEAGE_RANGE" VAL_BLK 0xCC3B8 Kwb_Wu16 65535.00 OneToOne 0.00 65535.00 FORMAT "%8.2" NUMBER 4 /end CHARACTERISTIC
/begin CHARACTERISTIC DSM_CDKDfp_FrmMngOPCRCTLACC_C "Kundenspezifischer Fehlercode fuer Fehlerpfad Dfp_FrmMngOPCRCTLACC" VAL_BLK 0xCC3C0 Kwb_Wu16 65535.00 OneToOne 0.00 65535.00 FORMAT "%8.2" NUMBER 4 /end CHARACTERISTIC
/begin CHARACTERISTIC DSM_CDKDfp_FrmMngPRGG_CCTR_C "Kundenspezifischer Fehlercode fuer Fehlerpfad Dfp_FrmMngPRGG_CCTR" VAL_BLK 0xCC3C8 Kwb_Wu16 65535.00 OneToOne 0.00 65535.00 FORMAT "%8.2" NUMBER 4 /end CHARACTERISTIC
/begin CHARACTERISTIC DSM_CDKDfp_FrmMngPWRMNG_LOADV_C "Kundenspezifischer Fehlercode fuer Fehlerpfad Dfp_FrmMngPWRMNG_LOADV" VAL_BLK 0xCC3D0 Kwb_Wu16 65535.00 OneToOne 0.00 65535.00 FORMAT "%8.2" NUMBER 4 /end CHARACTERISTIC
/begin CHARACTERISTIC DSM_CDKDfp_FrmMngParkConsumer_C "Kundenspezifischer Fehlercode fuer Fehlerpfad Dfp_FrmMngParkConsumer" VAL_BLK 0xCC3D8 Kwb_Wu16 65535.00 OneToOne 0.00 65535.00 FORMAT "%8.2" NUMBER 4 /end CHARACTERISTIC
/begin CHARACTERISTIC DSM_CDKDfp_FrmMngRQSTGEFAN_C "Kundenspezifischer spezifischer Fehlercode fuer Fehlerpfad Dfp_FrmMngRQSTGEFAN_C" VAL_BLK 0xCC3E0 Kwb_Wu16 65535.00 OneToOne 0.00 65535.00 FORMAT "%8.2" NUMBER 4 /end CHARACTERISTIC
/begin CHARACTERISTIC DSM_CDKDfp_FrmMngSSGErr_C "Kundenspezifischer Fehlercode fuer Fehlerpfad Dfp_FrmMngSSGErr" VAL_BLK 0xCC3E8 Kwb_Wu16 65535.00 OneToOne 0.00 65535.00 FORMAT "%8.2" NUMBER 4 /end CHARACTERISTIC
/begin CHARACTERISTIC DSM_CDKDfp_FrmMngSSGShOff_C "Kundenspezifischer Fehlercode fuer Fehlerpfad Dfp_FrmMngSSGShOff" VAL_BLK 0xCC3F0 Kwb_Wu16 65535.00 OneToOne 0.00 65535.00 FORMAT "%8.2" NUMBER 4 /end CHARACTERISTIC
/begin CHARACTERISTIC DSM_CDKDfp_FrmMngSTAT_ANH_C "Kundenspezifischer Fehlercode fuer Fehlerpfad Dfp_FrmMngSTAT_ANH" VAL_BLK 0xCC3F8 Kwb_Wu16 65535.00 OneToOne 0.00 65535.00 FORMAT "%8.2" NUMBER 4 /end CHARACTERISTIC
/begin CHARACTERISTIC DSM_CDKDfp_FrmMngSTAT_ARS_C "defect-code (customer-specific) for path" VAL_BLK 0xCC400 Kwb_Wu16 65535.00 OneToOne 0.00 65535.00 FORMAT "%8.2" NUMBER 4 /end CHARACTERISTIC
/begin CHARACTERISTIC DSM_CDKDfp_FrmMngSTAT_DSC_C "defect-code (customer-specific) for path" VAL_BLK 0xCC408 Kwb_Wu16 65535.00 OneToOne 0.00 65535.00 FORMAT "%8.2" NUMBER 4 /end CHARACTERISTIC
/begin CHARACTERISTIC DSM_CDKDfp_FrmMngSTAT_EKP_C "Kundenspezifischer Fehlercode fuer Fehlerpfad Dfp_FrmMngSTAT_EKP" VAL_BLK 0xCC410 Kwb_Wu16 65535.00 OneToOne 0.00 65535.00 FORMAT "%8.2" NUMBER 4 /end CHARACTERISTIC
/begin CHARACTERISTIC DSM_CDKDfp_FrmMngSTAT_KOMBI_C "Kundenspezifischer Fehlercode fuer Fehlerpfad Dfp_FrmMngSTAT_KOMBI" VAL_BLK 0xCC418 Kwb_Wu16 65535.00 OneToOne 0.00 65535.00 FORMAT "%8.2" NUMBER 4 /end CHARACTERISTIC
/begin CHARACTERISTIC DSM_CDKDfp_FrmMngSTAT_SITZ_C "Kundenspezifischer Fehlercode fuer Fehlerpfad Dfp_FrmMngSTAT_SITZ" VAL_BLK 0xCC420 Kwb_Wu16 65535.00 OneToOne 0.00 65535.00 FORMAT "%8.2" NUMBER 4 /end CHARACTERISTIC
/begin CHARACTERISTIC DSM_CDKDfp_FrmMngStOBDGbxMilOf_C "Kundenspezifischer Fehlercode fuer Fehlerpfad Dfp_FrmMngStOBDGbxMilOf" VAL_BLK 0xCC428 Kwb_Wu16 65535.00 OneToOne 0.00 65535.00 FORMAT "%8.2" NUMBER 4 /end CHARACTERISTIC
/begin CHARACTERISTIC DSM_CDKDfp_FrmMngStOBDGbxMilOn_C "Kundenspezifischer Fehlercode fuer Fehlerpfad Dfp_FrmMngStOBDGbxMilOn" VAL_BLK 0xCC430 Kwb_Wu16 65535.00 OneToOne 0.00 65535.00 FORMAT "%8.2" NUMBER 4 /end CHARACTERISTIC
/begin CHARACTERISTIC DSM_CDKDfp_FrmMngTEMPRELTIME_C "Kundenspezifischer Fehlercode fuer Fehlerpfad Dfp_FrmMngTEMPRELTIME" VAL_BLK 0xCC438 Kwb_Wu16 65535.00 OneToOne 0.00 65535.00 FORMAT "%8.2" NUMBER 4 /end CHARACTERISTIC
/begin CHARACTERISTIC DSM_CDKDfp_FrmMngTERMINAL_C "defect-code (customer-specific) for path" VAL_BLK 0xCC440 Kwb_Wu16 65535.00 OneToOne 0.00 65535.00 FORMAT "%8.2" NUMBER 4 /end CHARACTERISTIC
/begin CHARACTERISTIC DSM_CDKDfp_FrmMngTIME_DATE_C "Kundenspezifischer Fehlercode fuer Fehlerpfad Dfp_FrmMngTIME_DATE" VAL_BLK 0xCC448 Kwb_Wu16 65535.00 OneToOne 0.00 65535.00 FORMAT "%8.2" NUMBER 4 /end CHARACTERISTIC
/begin CHARACTERISTIC DSM_CDKDfp_FrmMngTORQUE_DSC_C "defect-code (customer-specific) for path" VAL_BLK 0xCC450 Kwb_Wu16 65535.00 OneToOne 0.00 65535.00 FORMAT "%8.2" NUMBER 4 /end CHARACTERISTIC
/begin CHARACTERISTIC DSM_CDKDfp_FrmMngTORQUE_GEARBX_C "defect-code (customer-specific) for path" VAL_BLK 0xCC458 Kwb_Wu16 65535.00 OneToOne 0.00 65535.00 FORMAT "%8.2" NUMBER 4 /end CHARACTERISTIC
/begin CHARACTERISTIC DSM_CDKDfp_FrmMngTrq_ReqACC_C "Kundenspezifischer Fehlercode fuer Fehlerpfad Dfp_FrmMngTrq_ReqACC" VAL_BLK 0xCC460 Kwb_Wu16 65535.00 OneToOne 0.00 65535.00 FORMAT "%8.2" NUMBER 4 /end CHARACTERISTIC
/begin CHARACTERISTIC DSM_CDKDfp_FrmMngVEH_MOD_C "Kundenspezifischer spezifischer Fehlercode fuer Fehlerpfad Dfp_FrmMngVEH_MOD_C" VAL_BLK 0xCC468 Kwb_Wu16 65535.00 OneToOne 0.00 65535.00 FORMAT "%8.2" NUMBER 4 /end CHARACTERISTIC
/begin CHARACTERISTIC DSM_CDKDfp_FrmMngVELOCITY_C "defect-code (customer-specific) for path" VAL_BLK 0xCC470 Kwb_Wu16 65535.00 OneToOne 0.00 65535.00 FORMAT "%8.2" NUMBER 4 /end CHARACTERISTIC
/begin CHARACTERISTIC DSM_CDKDfp_FrmMngWHEEL_SPEED_C "Kundenspezifischer Fehlercode fuer Fehlerpfad Dfp_FrmMngWHEEL_SPEED" VAL_BLK 0xCC478 Kwb_Wu16 65535.00 OneToOne 0.00 65535.00 FORMAT "%8.2" NUMBER 4 /end CHARACTERISTIC
/begin CHARACTERISTIC DSM_CDKDfp_FrmMngstCurr_C "Fehlercode für Dfp_FrmMngstCurr" VAL_BLK 0xCC480 Kwb_Wu16 65535.00 OneToOne 0.00 65535.00 FORMAT "%8.2" NUMBER 4 /end CHARACTERISTIC
/begin CHARACTERISTIC DSM_CDKDfp_FrmMngswtPSPOff_C "Fehlercode Feld für Dfp_FrmMngswtPSP" VAL_BLK 0xCC488 Kwb_Wu16 65535.00 OneToOne 0.00 65535.00 FORMAT "%8.2" NUMBER 4 /end CHARACTERISTIC
/begin CHARACTERISTIC DSM_CDKDfp_GearbxIncMax_C "Kundenspezifischer Fehlercode fuer Fehlerpfad Dfp_GearbxIncMax" VAL_BLK 0xCC490 Kwb_Wu16 65535.00 OneToOne 0.00 65535.00 FORMAT "%8.2" NUMBER 4 /end CHARACTERISTIC
/begin CHARACTERISTIC DSM_CDKDfp_GlwCD_C "Kundenspezifischer Fehlercode fuer Fehlerpfad Dfp_GlwCD" VAL_BLK 0xCC498 Kwb_Wu16 65535.00 OneToOne 0.00 65535.00 FORMAT "%8.2" NUMBER 4 /end CHARACTERISTIC
/begin CHARACTERISTIC DSM_CDKDfp_GlwCDGlwCirc1_C "Kundenspezifischer Fehlercode fuer Fehlerpfad Dfp_GlwCDGlwCirc1" VAL_BLK 0xCC4A0 Kwb_Wu16 65535.00 OneToOne 0.00 65535.00 FORMAT "%8.2" NUMBER 4 /end CHARACTERISTIC
/begin CHARACTERISTIC DSM_CDKDfp_GlwCDGlwCirc2_C "Kundenspezifischer Fehlercode fuer Fehlerpfad Dfp_GlwCDGlwCirc2" VAL_BLK 0xCC4A8 Kwb_Wu16 65535.00 OneToOne 0.00 65535.00 FORMAT "%8.2" NUMBER 4 /end CHARACTERISTIC
/begin CHARACTERISTIC DSM_CDKDfp_GlwCDGlwCirc3_C "Kundenspezifischer Fehlercode fuer Fehlerpfad Dfp_GlwCDGlwCirc3" VAL_BLK 0xCC4B0 Kwb_Wu16 65535.00 OneToOne 0.00 65535.00 FORMAT "%8.2" NUMBER 4 /end CHARACTERISTIC
/begin CHARACTERISTIC DSM_CDKDfp_GlwCDGlwCirc4_C "Kundenspezifischer Fehlercode fuer Fehlerpfad Dfp_GlwCDGlwCirc4" VAL_BLK 0xCC4B8 Kwb_Wu16 65535.00 OneToOne 0.00 65535.00 FORMAT "%8.2" NUMBER 4 /end CHARACTERISTIC
/begin CHARACTERISTIC DSM_CDKDfp_GlwCDGlwCirc5_C "Kundenspezifischer Fehlercode fuer Fehlerpfad Dfp_GlwCDGlwCirc5" VAL_BLK 0xCC4C0 Kwb_Wu16 65535.00 OneToOne 0.00 65535.00 FORMAT "%8.2" NUMBER 4 /end CHARACTERISTIC
/begin CHARACTERISTIC DSM_CDKDfp_GlwCDGlwCirc6_C "Kundenspezifischer Fehlercode fuer Fehlerpfad Dfp_GlwCDGlwCirc6" VAL_BLK 0xCC4C8 Kwb_Wu16 65535.00 OneToOne 0.00 65535.00 FORMAT "%8.2" NUMBER 4 /end CHARACTERISTIC
/begin CHARACTERISTIC DSM_CDKDfp_GlwCDGlwCirc7_C "Kundenspezifischer Fehlercode fuer Fehlerpfad Dfp_GlwCDGlwCirc7" VAL_BLK 0xCC4D0 Kwb_Wu16 65535.00 OneToOne 0.00 65535.00 FORMAT "%8.2" NUMBER 4 /end CHARACTERISTIC
/begin CHARACTERISTIC DSM_CDKDfp_GlwCDGlwCirc8_C "Kundenspezifischer Fehlercode fuer Fehlerpfad Dfp_GlwCDGlwCirc8" VAL_BLK 0xCC4D8 Kwb_Wu16 65535.00 OneToOne 0.00 65535.00 FORMAT "%8.2" NUMBER 4 /end CHARACTERISTIC
/begin CHARACTERISTIC DSM_CDKDfp_GlwCtl_C "Kundenspezifischer Fehlercode fuer Fehlerpfad Dfp_GlwCtl" VAL_BLK 0xCC4E0 Kwb_Wu16 65535.00 OneToOne 0.00 65535.00 FORMAT "%8.2" NUMBER 4 /end CHARACTERISTIC
/begin CHARACTERISTIC DSM_CDKDfp_HWEMonCom_C "Kundenspezifischer Fehlercode fuer Fehlerpfad Dfp_HWEMonCom" VAL_BLK 0xCC4E8 Kwb_Wu16 65535.00 OneToOne 0.00 65535.00 FORMAT "%8.2" NUMBER 4 /end CHARACTERISTIC
/begin CHARACTERISTIC DSM_CDKDfp_HWEMonEEPROM_C "Kundenspezifischer Fehlercode fuer Fehlerpfad Dfp_HWEMonEEPROM" VAL_BLK 0xCC4F0 Kwb_Wu16 65535.00 OneToOne 0.00 65535.00 FORMAT "%8.2" NUMBER 4 /end CHARACTERISTIC
/begin CHARACTERISTIC DSM_CDKDfp_HWEMonRcyLocked_C "Kundenspezifischer Fehlercode fuer Fehlerpfad Dfp_HWEMonRcyLocked" VAL_BLK 0xCC4F8 Kwb_Wu16 65535.00 OneToOne 0.00 65535.00 FORMAT "%8.2" NUMBER 4 /end CHARACTERISTIC
/begin CHARACTERISTIC DSM_CDKDfp_HWEMonRcySuppressed_C "Kundenspezifischer Fehlercode fuer Fehlerpfad Dfp_HWEMonRcySuppressed" VAL_BLK 0xCC500 Kwb_Wu16 65535.00 OneToOne 0.00 65535.00 FORMAT "%8.2" NUMBER 4 /end CHARACTERISTIC
/begin CHARACTERISTIC DSM_CDKDfp_HWEMonRcyVisible_C "Kundenspezifischer Fehlercode fuer Fehlerpfad Dfp_HWEMonRcyVisible" VAL_BLK 0xCC508 Kwb_Wu16 65535.00 OneToOne 0.00 65535.00 FORMAT "%8.2" NUMBER 4 /end CHARACTERISTIC
/begin CHARACTERISTIC DSM_CDKDfp_HWEMonUMaxSupply_C "Kundenspezifischer Fehlercode fuer Fehlerpfad Dfp_HWEMonUMaxSupply" VAL_BLK 0xCC510 Kwb_Wu16 65535.00 OneToOne 0.00 65535.00 FORMAT "%8.2" NUMBER 4 /end CHARACTERISTIC
/begin CHARACTERISTIC DSM_CDKDfp_HWEMonUMinSupply_C "Kundenspezifischer Fehlercode fuer Fehlerpfad Dfp_HWEMonUMinSupply" VAL_BLK 0xCC518 Kwb_Wu16 65535.00 OneToOne 0.00 65535.00 FORMAT "%8.2" NUMBER 4 /end CHARACTERISTIC
/begin CHARACTERISTIC DSM_CDKDfp_IATSCD_C "Kundenspezifischer Fehlercode fuer Fehlerpfad Dfp_IATSCD" VAL_BLK 0xCC520 Kwb_Wu16 65535.00 OneToOne 0.00 65535.00 FORMAT "%8.2" NUMBER 4 /end CHARACTERISTIC
/begin CHARACTERISTIC DSM_CDKDfp_IATSCD_CATS_C "Kundenspezifischer Fehlercode fuer Fehlerpfad Dfp_IATSCD_CATS" VAL_BLK 0xCC528 Kwb_Wu16 65535.00 OneToOne 0.00 65535.00 FORMAT "%8.2" NUMBER 4 /end CHARACTERISTIC
/begin CHARACTERISTIC DSM_CDKDfp_ImmCtlImmCD_C "Kundenspezifischer Fehlercode fuer Fehlerpfad Dfp_ImmCtlImmCD" VAL_BLK 0xCC530 Kwb_Wu16 65535.00 OneToOne 0.00 65535.00 FORMAT "%8.2" NUMBER 4 /end CHARACTERISTIC
/begin CHARACTERISTIC DSM_CDKDfp_ImmCtlImmEep_C "Kundenspezifischer Fehlercode fuer Fehlerpfad Dfp_ImmCtlImmEep" VAL_BLK 0xCC538 Kwb_Wu16 65535.00 OneToOne 0.00 65535.00 FORMAT "%8.2" NUMBER 4 /end CHARACTERISTIC
/begin CHARACTERISTIC DSM_CDKDfp_ImmCtlMpl_C "Kundenspezifischer Fehlercode fuer Fehlerpfad Dfp_ImmCtlMpl" VAL_BLK 0xCC540 Kwb_Wu16 65535.00 OneToOne 0.00 65535.00 FORMAT "%8.2" NUMBER 4 /end CHARACTERISTIC
/begin CHARACTERISTIC DSM_CDKDfp_IndSys1_C "Kundenspezifischer Fehlercode fuer Fehlerpfad Dfp_IndSys1" VAL_BLK 0xCC548 Kwb_Wu16 65535.00 OneToOne 0.00 65535.00 FORMAT "%8.2" NUMBER 4 /end CHARACTERISTIC
/begin CHARACTERISTIC DSM_CDKDfp_IndSys2_C "Kundenspezifischer Fehlercode fuer Fehlerpfad Dfp_IndSys2" VAL_BLK 0xCC550 Kwb_Wu16 65535.00 OneToOne 0.00 65535.00 FORMAT "%8.2" NUMBER 4 /end CHARACTERISTIC
/begin CHARACTERISTIC DSM_CDKDfp_InjCrv_InjLim_C "Kundenspezifischer Fehlercode fuer Fehlerpfad Dfp_InjCrv_InjLim" VAL_BLK 0xCC558 Kwb_Wu16 65535.00 OneToOne 0.00 65535.00 FORMAT "%8.2" NUMBER 4 /end CHARACTERISTIC
/begin CHARACTERISTIC DSM_CDKDfp_InjCtlAdjQnt_C "Kundenspezifischer Fehlercode fuer Fehlerpfad Dfp_InjCtlAdjQnt" VAL_BLK 0xCC560 Kwb_Wu16 65535.00 OneToOne 0.00 65535.00 FORMAT "%8.2" NUMBER 4 /end CHARACTERISTIC
/begin CHARACTERISTIC DSM_CDKDfp_InjCtlDrift_C "Kundenspezifischer Fehlercode fuer Fehlerpfad Dfp_InjCtlDrift" VAL_BLK 0xCC568 Kwb_Wu16 65535.00 OneToOne 0.00 65535.00 FORMAT "%8.2" NUMBER 4 /end CHARACTERISTIC
/begin CHARACTERISTIC DSM_CDKDfp_InjVlvBnk1A_C "Kundenspezifischer Fehlercode fuer Fehlerpfad Dfp_InjVlvBnk1A" VAL_BLK 0xCC570 Kwb_Wu16 65535.00 OneToOne 0.00 65535.00 FORMAT "%8.2" NUMBER 4 /end CHARACTERISTIC
/begin CHARACTERISTIC DSM_CDKDfp_InjVlvBnk1B_C "Kundenspezifischer Fehlercode fuer Fehlerpfad Dfp_InjVlvBnk1B" VAL_BLK 0xCC578 Kwb_Wu16 65535.00 OneToOne 0.00 65535.00 FORMAT "%8.2" NUMBER 4 /end CHARACTERISTIC
/begin CHARACTERISTIC DSM_CDKDfp_InjVlvBnk2A_C "Kundenspezifischer Fehlercode fuer Fehlerpfad Dfp_InjVlvBnk2A" VAL_BLK 0xCC580 Kwb_Wu16 65535.00 OneToOne 0.00 65535.00 FORMAT "%8.2" NUMBER 4 /end CHARACTERISTIC
/begin CHARACTERISTIC DSM_CDKDfp_InjVlvBnk2B_C "Kundenspezifischer Fehlercode fuer Fehlerpfad Dfp_InjVlvBnk2B" VAL_BLK 0xCC588 Kwb_Wu16 65535.00 OneToOne 0.00 65535.00 FORMAT "%8.2" NUMBER 4 /end CHARACTERISTIC
/begin CHARACTERISTIC DSM_CDKDfp_InjVlvChipA_C "Kundenspezifischer Fehlercode fuer Fehlerpfad Dfp_InjVlvChipA" VAL_BLK 0xCC590 Kwb_Wu16 65535.00 OneToOne 0.00 65535.00 FORMAT "%8.2" NUMBER 4 /end CHARACTERISTIC
/begin CHARACTERISTIC DSM_CDKDfp_InjVlvChipB_C "Kundenspezifischer Fehlercode fuer Fehlerpfad Dfp_InjVlvChipB" VAL_BLK 0xCC598 Kwb_Wu16 65535.00 OneToOne 0.00 65535.00 FORMAT "%8.2" NUMBER 4 /end CHARACTERISTIC
/begin CHARACTERISTIC DSM_CDKDfp_InjVlvCyl1A_C "Kundenspezifischer Fehlercode fuer Fehlerpfad Dfp_InjVlvCyl1A" VAL_BLK 0xCC5A0 Kwb_Wu16 65535.00 OneToOne 0.00 65535.00 FORMAT "%8.2" NUMBER 4 /end CHARACTERISTIC
/begin CHARACTERISTIC DSM_CDKDfp_InjVlvCyl1B_C "Kundenspezifischer Fehlercode fuer Fehlerpfad Dfp_InjVlvCyl1B" VAL_BLK 0xCC5A8 Kwb_Wu16 65535.00 OneToOne 0.00 65535.00 FORMAT "%8.2" NUMBER 4 /end CHARACTERISTIC
/begin CHARACTERISTIC DSM_CDKDfp_InjVlvCyl2A_C "Kundenspezifischer Fehlercode fuer Fehlerpfad Dfp_InjVlvCyl2A" VAL_BLK 0xCC5B0 Kwb_Wu16 65535.00 OneToOne 0.00 65535.00 FORMAT "%8.2" NUMBER 4 /end CHARACTERISTIC
/begin CHARACTERISTIC DSM_CDKDfp_InjVlvCyl2B_C "Kundenspezifischer Fehlercode fuer Fehlerpfad Dfp_InjVlvCyl2B" VAL_BLK 0xCC5B8 Kwb_Wu16 65535.00 OneToOne 0.00 65535.00 FORMAT "%8.2" NUMBER 4 /end CHARACTERISTIC
/begin CHARACTERISTIC DSM_CDKDfp_InjVlvCyl3A_C "Kundenspezifischer Fehlercode fuer Fehlerpfad Dfp_InjVlvCyl3A" VAL_BLK 0xCC5C0 Kwb_Wu16 65535.00 OneToOne 0.00 65535.00 FORMAT "%8.2" NUMBER 4 /end CHARACTERISTIC
/begin CHARACTERISTIC DSM_CDKDfp_InjVlvCyl3B_C "Kundenspezifischer Fehlercode fuer Fehlerpfad Dfp_InjVlvCyl3B" VAL_BLK 0xCC5C8 Kwb_Wu16 65535.00 OneToOne 0.00 65535.00 FORMAT "%8.2" NUMBER 4 /end CHARACTERISTIC
/begin CHARACTERISTIC DSM_CDKDfp_InjVlvCyl4A_C "Kundenspezifischer Fehlercode fuer Fehlerpfad Dfp_InjVlvCyl4A" VAL_BLK 0xCC5D0 Kwb_Wu16 65535.00 OneToOne 0.00 65535.00 FORMAT "%8.2" NUMBER 4 /end CHARACTERISTIC
/begin CHARACTERISTIC DSM_CDKDfp_InjVlvCyl4B_C "Kundenspezifischer Fehlercode fuer Fehlerpfad Dfp_InjVlvCyl4B" VAL_BLK 0xCC5D8 Kwb_Wu16 65535.00 OneToOne 0.00 65535.00 FORMAT "%8.2" NUMBER 4 /end CHARACTERISTIC
/begin CHARACTERISTIC DSM_CDKDfp_InjVlvCyl5A_C "Kundenspezifischer Fehlercode fuer Fehlerpfad Dfp_InjVlvCyl5A" VAL_BLK 0xCC5E0 Kwb_Wu16 65535.00 OneToOne 0.00 65535.00 FORMAT "%8.2" NUMBER 4 /end CHARACTERISTIC
/begin CHARACTERISTIC DSM_CDKDfp_InjVlvCyl5B_C "Kundenspezifischer Fehlercode fuer Fehlerpfad Dfp_InjVlvCyl5B" VAL_BLK 0xCC5E8 Kwb_Wu16 65535.00 OneToOne 0.00 65535.00 FORMAT "%8.2" NUMBER 4 /end CHARACTERISTIC
/begin CHARACTERISTIC DSM_CDKDfp_InjVlvCyl6A_C "Kundenspezifischer Fehlercode fuer Fehlerpfad Dfp_InjVlvCyl6A" VAL_BLK 0xCC5F0 Kwb_Wu16 65535.00 OneToOne 0.00 65535.00 FORMAT "%8.2" NUMBER 4 /end CHARACTERISTIC
/begin CHARACTERISTIC DSM_CDKDfp_InjVlvCyl6B_C "Kundenspezifischer Fehlercode fuer Fehlerpfad Dfp_InjVlvCyl6B" VAL_BLK 0xCC5F8 Kwb_Wu16 65535.00 OneToOne 0.00 65535.00 FORMAT "%8.2" NUMBER 4 /end CHARACTERISTIC
/begin CHARACTERISTIC DSM_CDKDfp_KeyCheck_C "Kundenspezifischer Fehlercode fuer Fehlerpfad Dfp_KeyCheck" VAL_BLK 0xCC600 Kwb_Wu16 65535.00 OneToOne 0.00 65535.00 FORMAT "%8.2" NUMBER 4 /end CHARACTERISTIC
/begin CHARACTERISTIC DSM_CDKDfp_LIGovECUTransMode_C "Kundenspezifischer Fehlercode fuer Fehlerpfad Dfp_LIGovECUTransMode" VAL_BLK 0xCC608 Kwb_Wu16 65535.00 OneToOne 0.00 65535.00 FORMAT "%8.2" NUMBER 4 /end CHARACTERISTIC
/begin CHARACTERISTIC DSM_CDKDfp_LPACD_Max_C "Kundenspezifischer Fehlercode fuer Fehlerpfad Dfp_LPACD_Max" VAL_BLK 0xCC610 Kwb_Wu16 65535.00 OneToOne 0.00 65535.00 FORMAT "%8.2" NUMBER 4 /end CHARACTERISTIC
/begin CHARACTERISTIC DSM_CDKDfp_LPACD_Min_C "Kundenspezifischer Fehlercode fuer Fehlerpfad Dfp_LPACD_Min" VAL_BLK 0xCC618 Kwb_Wu16 65535.00 OneToOne 0.00 65535.00 FORMAT "%8.2" NUMBER 4 /end CHARACTERISTIC
/begin CHARACTERISTIC DSM_CDKDfp_LPACD_SigNpl_C "Kundenspezifischer Fehlercode fuer Fehlerpfad Dfp_LPACD_SigNpl" VAL_BLK 0xCC620 Kwb_Wu16 65535.00 OneToOne 0.00 65535.00 FORMAT "%8.2" NUMBER 4 /end CHARACTERISTIC
/begin CHARACTERISTIC DSM_CDKDfp_LSUCDCircNernst0_C "Kundenspezifischer Fehlercode fuer Fehlerpfad Dfp_LSUCDCircNernst0" VAL_BLK 0xCC628 Kwb_Wu16 65535.00 OneToOne 0.00 65535.00 FORMAT "%8.2" NUMBER 4 /end CHARACTERISTIC
/begin CHARACTERISTIC DSM_CDKDfp_LSUCDCircPumpCur0_C "Kundenspezifischer Fehlercode fuer Fehlerpfad Dfp_LSUCDCircPumpCur0" VAL_BLK 0xCC630 Kwb_Wu16 65535.00 OneToOne 0.00 65535.00 FORMAT "%8.2" NUMBER 4 /end CHARACTERISTIC
/begin CHARACTERISTIC DSM_CDKDfp_LSUCDCircVirtGnd0_C "Kundenspezifischer Fehlercode fuer Fehlerpfad Dfp_LSUCDCircVirtGnd0" VAL_BLK 0xCC638 Kwb_Wu16 65535.00 OneToOne 0.00 65535.00 FORMAT "%8.2" NUMBER 4 /end CHARACTERISTIC
/begin CHARACTERISTIC DSM_CDKDfp_LSUCDHeater0_C "Kundenspezifischer Fehlercode fuer Fehlerpfad Dfp_LSUCDHeater0" VAL_BLK 0xCC640 Kwb_Wu16 65535.00 OneToOne 0.00 65535.00 FORMAT "%8.2" NUMBER 4 /end CHARACTERISTIC
/begin CHARACTERISTIC DSM_CDKDfp_LSUCDHtCoup0_C "Kundenspezifischer Fehlercode fuer Fehlerpfad Dfp_LSUCDHtCoup0" VAL_BLK 0xCC648 Kwb_Wu16 65535.00 OneToOne 0.00 65535.00 FORMAT "%8.2" NUMBER 4 /end CHARACTERISTIC
/begin CHARACTERISTIC DSM_CDKDfp_LSUCDO20_C "Kundenspezifischer Fehlercode fuer Fehlerpfad Dfp_LSUCDO20" VAL_BLK 0xCC650 Kwb_Wu16 65535.00 OneToOne 0.00 65535.00 FORMAT "%8.2" NUMBER 4 /end CHARACTERISTIC
/begin CHARACTERISTIC DSM_CDKDfp_LSUCDO2Clb0_C "Kundenspezifischer Fehlercode fuer Fehlerpfad Dfp_LSUCDO2Clb0" VAL_BLK 0xCC658 Kwb_Wu16 65535.00 OneToOne 0.00 65535.00 FORMAT "%8.2" NUMBER 4 /end CHARACTERISTIC
/begin CHARACTERISTIC DSM_CDKDfp_LSUCDRiClb0_C "Kundenspezifischer Fehlercode fuer Fehlerpfad Dfp_LSUCDRiClb0" VAL_BLK 0xCC660 Kwb_Wu16 65535.00 OneToOne 0.00 65535.00 FORMAT "%8.2" NUMBER 4 /end CHARACTERISTIC
/begin CHARACTERISTIC DSM_CDKDfp_LSUCDSPI0_C "Kundenspezifischer Fehlercode fuer Fehlerpfad Dfp_LSUCDSPI0" VAL_BLK 0xCC668 Kwb_Wu16 65535.00 OneToOne 0.00 65535.00 FORMAT "%8.2" NUMBER 4 /end CHARACTERISTIC
/begin CHARACTERISTIC DSM_CDKDfp_LSUCDSPIBattLow0_C "Kundenspezifischer Fehlercode fuer Fehlerpfad Dfp_LSUCDSPIBattLow0" VAL_BLK 0xCC670 Kwb_Wu16 65535.00 OneToOne 0.00 65535.00 FORMAT "%8.2" NUMBER 4 /end CHARACTERISTIC
/begin CHARACTERISTIC DSM_CDKDfp_LSUCDWireIP0_C "Kundenspezifischer Fehlercode fuer Fehlerpfad Dfp_LSUCDWireIP0" VAL_BLK 0xCC678 Kwb_Wu16 65535.00 OneToOne 0.00 65535.00 FORMAT "%8.2" NUMBER 4 /end CHARACTERISTIC
/begin CHARACTERISTIC DSM_CDKDfp_LSUCtlRiExc0_C "Kundenspezifischer Fehlercode fuer Fehlerpfad Dfp_LSUCtlRiExc0" VAL_BLK 0xCC680 Kwb_Wu16 65535.00 OneToOne 0.00 65535.00 FORMAT "%8.2" NUMBER 4 /end CHARACTERISTIC
/begin CHARACTERISTIC DSM_CDKDfp_LSUMon1Sens_C "Kundenspezifischer Fehlercode fuer Fehlerpfad Dfp_LSUMon1Sens" VAL_BLK 0xCC688 Kwb_Wu16 65535.00 OneToOne 0.00 65535.00 FORMAT "%8.2" NUMBER 4 /end CHARACTERISTIC
/begin CHARACTERISTIC DSM_CDKDfp_LSUMon2Sens_C "Kundenspezifischer Fehlercode fuer Fehlerpfad Dfp_LSUMon2Sens" VAL_BLK 0xCC690 Kwb_Wu16 65535.00 OneToOne 0.00 65535.00 FORMAT "%8.2" NUMBER 4 /end CHARACTERISTIC
/begin CHARACTERISTIC DSM_CDKDfp_MIL_C "Kundenspezifischer Fehlercode fuer Fehlerpfad Dfp_MIL" VAL_BLK 0xCC698 Kwb_Wu16 65535.00 OneToOne 0.00 65535.00 FORMAT "%8.2" NUMBER 4 /end CHARACTERISTIC
/begin CHARACTERISTIC DSM_CDKDfp_MRlyCD_C "Kundenspezifischer Fehlercode fuer Fehlerpfad Dfp_MRlyCD" VAL_BLK 0xCC6A0 Kwb_Wu16 65535.00 OneToOne 0.00 65535.00 FORMAT "%8.2" NUMBER 4 /end CHARACTERISTIC
/begin CHARACTERISTIC DSM_CDKDfp_MSidCD_Comm_C "Kundenspezifischer Fehlercode fuer Fehlerpfad Dfp_MSidCD_Comm" VAL_BLK 0xCC6A8 Kwb_Wu16 65535.00 OneToOne 0.00 65535.00 FORMAT "%8.2" NUMBER 4 /end CHARACTERISTIC
/begin CHARACTERISTIC DSM_CDKDfp_MSidCD_Pin_C "Kundenspezifischer Fehlercode fuer Fehlerpfad Dfp_MSidCD_Pin" VAL_BLK 0xCC6B0 Kwb_Wu16 65535.00 OneToOne 0.00 65535.00 FORMAT "%8.2" NUMBER 4 /end CHARACTERISTIC
/begin CHARACTERISTIC DSM_CDKDfp_MSidCD_Sel_INI_C "Kundenspezifischer Fehlercode fuer Fehlerpfad Dfp_MSidCD_Sel_INI" VAL_BLK 0xCC6B8 Kwb_Wu16 65535.00 OneToOne 0.00 65535.00 FORMAT "%8.2" NUMBER 4 /end CHARACTERISTIC
/begin CHARACTERISTIC DSM_CDKDfp_MSidCD_Select_C "Kundenspezifischer Fehlercode fuer Fehlerpfad Dfp_MSidCD_Select" VAL_BLK 0xCC6C0 Kwb_Wu16 65535.00 OneToOne 0.00 65535.00 FORMAT "%8.2" NUMBER 4 /end CHARACTERISTIC
/begin CHARACTERISTIC DSM_CDKDfp_MeUnCDNoLoad_C "Kundenspezifischer Fehlercode fuer Fehlerpfad Dfp_MeUnCDNoLoad" VAL_BLK 0xCC6C8 Kwb_Wu16 65535.00 OneToOne 0.00 65535.00 FORMAT "%8.2" NUMBER 4 /end CHARACTERISTIC
/begin CHARACTERISTIC DSM_CDKDfp_MeUnCDSCBat_C "Kundenspezifischer Fehlercode fuer Fehlerpfad Dfp_MeUnCDSCBat" VAL_BLK 0xCC6D0 Kwb_Wu16 65535.00 OneToOne 0.00 65535.00 FORMAT "%8.2" NUMBER 4 /end CHARACTERISTIC
/begin CHARACTERISTIC DSM_CDKDfp_MeUnCDSCGnd_C "Kundenspezifischer Fehlercode fuer Fehlerpfad Dfp_MeUnCDSCGnd" VAL_BLK 0xCC6D8 Kwb_Wu16 65535.00 OneToOne 0.00 65535.00 FORMAT "%8.2" NUMBER 4 /end CHARACTERISTIC
/begin CHARACTERISTIC DSM_CDKDfp_MeUnCD_ADC_C "Kundenspezifischer Fehlercode fuer Fehlerpfad Dfp_MeUnCD_ADC" VAL_BLK 0xCC6E0 Kwb_Wu16 65535.00 OneToOne 0.00 65535.00 FORMAT "%8.2" NUMBER 4 /end CHARACTERISTIC
/begin CHARACTERISTIC DSM_CDKDfp_MeUnCD_SigTst_C "Kundenspezifischer Fehlercode fuer Fehlerpfad Dfp_MeUnCD_SigTst" VAL_BLK 0xCC6E8 Kwb_Wu16 65535.00 OneToOne 0.00 65535.00 FORMAT "%8.2" NUMBER 4 /end CHARACTERISTIC
/begin CHARACTERISTIC DSM_CDKDfp_Montr_C "Kundenspezifischer Fehlercode fuer Fehlerpfad Dfp_Montr" VAL_BLK 0xCC6F0 Kwb_Wu16 65535.00 OneToOne 0.00 65535.00 FORMAT "%8.2" NUMBER 4 /end CHARACTERISTIC
/begin CHARACTERISTIC DSM_CDKDfp_NetMngDeviceA_C "Kundenspezifischer Fehlercode fuer Fehlerpfad Dfp_NetMngDeviceB" VAL_BLK 0xCC6F8 Kwb_Wu16 65535.00 OneToOne 0.00 65535.00 FORMAT "%8.2" NUMBER 4 /end CHARACTERISTIC
/begin CHARACTERISTIC DSM_CDKDfp_NetMngDeviceB_C "Kundenspezifischer Fehlercode fuer Fehlerpfad Dfp_NetMngDeviceB" VAL_BLK 0xCC700 Kwb_Wu16 65535.00 OneToOne 0.00 65535.00 FORMAT "%8.2" NUMBER 4 /end CHARACTERISTIC
/begin CHARACTERISTIC DSM_CDKDfp_NetMngDeviceC_C "Kundenspezifischer Fehlercode fuer Fehlerpfad Dfp_NetMngDeviceC" VAL_BLK 0xCC708 Kwb_Wu16 65535.00 OneToOne 0.00 65535.00 FORMAT "%8.2" NUMBER 4 /end CHARACTERISTIC
/begin CHARACTERISTIC DSM_CDKDfp_NetMngPtCan_C "Kundenspezifischer Fehlercode fuer Fehlerpfad Dfp_NetMngPtCan" VAL_BLK 0xCC710 Kwb_Wu16 65535.00 OneToOne 0.00 65535.00 FORMAT "%8.2" NUMBER 4 /end CHARACTERISTIC
/begin CHARACTERISTIC DSM_CDKDfp_OPSCD_Lamp_C "Kundenspezifischer Fehlercode fuer Fehlerpfad Dfp_OPSCD_Lamp" VAL_BLK 0xCC718 Kwb_Wu16 65535.00 OneToOne 0.00 65535.00 FORMAT "%8.2" NUMBER 4 /end CHARACTERISTIC
/begin CHARACTERISTIC DSM_CDKDfp_OPSCD_anain_C "Kundenspezifischer Fehlercode fuer Fehlerpfad Dfp_OPSCD_anain" VAL_BLK 0xCC720 Kwb_Wu16 65535.00 OneToOne 0.00 65535.00 FORMAT "%8.2" NUMBER 4 /end CHARACTERISTIC
/begin CHARACTERISTIC DSM_CDKDfp_OTSCD_C "Kundenspezifischer Fehlercode fuer Fehlerpfad Dfp_OTSCD" VAL_BLK 0xCC728 Kwb_Wu16 65535.00 OneToOne 0.00 65535.00 FORMAT "%8.2" NUMBER 4 /end CHARACTERISTIC
/begin CHARACTERISTIC DSM_CDKDfp_OvRMon_C "Kundenspezifischer Fehlercode fuer Fehlerpfad Dfp_OvRMon" VAL_BLK 0xCC730 Kwb_Wu16 65535.00 OneToOne 0.00 65535.00 FORMAT "%8.2" NUMBER 4 /end CHARACTERISTIC
/begin CHARACTERISTIC DSM_CDKDfp_OvRMonSigA_C "Kundenspezifischer Fehlercode fuer Fehlerpfad Dfp_OvRMonSigA" VAL_BLK 0xCC738 Kwb_Wu16 65535.00 OneToOne 0.00 65535.00 FORMAT "%8.2" NUMBER 4 /end CHARACTERISTIC
/begin CHARACTERISTIC DSM_CDKDfp_OxiCCDTPre_C "Kundenspezifischer Fehlercode fuer Fehlerpfad Dfp_OxiCCDTPre" VAL_BLK 0xCC740 Kwb_Wu16 65535.00 OneToOne 0.00 65535.00 FORMAT "%8.2" NUMBER 4 /end CHARACTERISTIC
/begin CHARACTERISTIC DSM_CDKDfp_PCBS_C "Kundenspezifischer Fehlercode fuer Fehlerpfad Dfp_PCBS" VAL_BLK 0xCC748 Kwb_Wu16 65535.00 OneToOne 0.00 65535.00 FORMAT "%8.2" NUMBER 4 /end CHARACTERISTIC
/begin CHARACTERISTIC DSM_CDKDfp_PCR_GovDevNeg_C "Kundenspezifischer Fehlercode fuer Fehlerpfad Dfp_PCR_GovDevNeg" VAL_BLK 0xCC750 Kwb_Wu16 65535.00 OneToOne 0.00 65535.00 FORMAT "%8.2" NUMBER 4 /end CHARACTERISTIC
/begin CHARACTERISTIC DSM_CDKDfp_PCR_GovDevPos_C "Kundenspezifischer Fehlercode fuer Fehlerpfad Dfp_PCR_GovDevPos" VAL_BLK 0xCC758 Kwb_Wu16 65535.00 OneToOne 0.00 65535.00 FORMAT "%8.2" NUMBER 4 /end CHARACTERISTIC
/begin CHARACTERISTIC DSM_CDKDfp_PCR_LPGvnrDvtNeg_C "Kundenspezifischer Fehlercode fuer Fehlerpfad  Dfp_PCR_LPGvnrDvtNeg" VAL_BLK 0xCC760 Kwb_Wu16 65535.00 OneToOne 0.00 65535.00 FORMAT "%8.2" NUMBER 4 /end CHARACTERISTIC
/begin CHARACTERISTIC DSM_CDKDfp_PCR_LPGvnrDvtPos_C "Kundenspezifischer Fehlercode fuer Fehlerpfad Dfp_PCR_LPGvnrDvtPos" VAL_BLK 0xCC768 Kwb_Wu16 65535.00 OneToOne 0.00 65535.00 FORMAT "%8.2" NUMBER 4 /end CHARACTERISTIC
/begin CHARACTERISTIC DSM_CDKDfp_PCVCDNoLoad_C "Kundenspezifischer Fehlercode fuer Fehlerpfad Dfp_PCVCDNoLoad" VAL_BLK 0xCC770 Kwb_Wu16 65535.00 OneToOne 0.00 65535.00 FORMAT "%8.2" NUMBER 4 /end CHARACTERISTIC
/begin CHARACTERISTIC DSM_CDKDfp_PCVCDSCBat_C "Kundenspezifischer Fehlercode fuer Fehlerpfad Dfp_PCVCDSCBat" VAL_BLK 0xCC778 Kwb_Wu16 65535.00 OneToOne 0.00 65535.00 FORMAT "%8.2" NUMBER 4 /end CHARACTERISTIC
/begin CHARACTERISTIC DSM_CDKDfp_PCVCDSCGnd_C "Kundenspezifischer Fehlercode fuer Fehlerpfad Dfp_PCVCDSCGnd" VAL_BLK 0xCC780 Kwb_Wu16 65535.00 OneToOne 0.00 65535.00 FORMAT "%8.2" NUMBER 4 /end CHARACTERISTIC
/begin CHARACTERISTIC DSM_CDKDfp_PCVCD_ADC_C "Kundenspezifischer Fehlercode fuer Fehlerpfad Dfp_PCVCD_ADC" VAL_BLK 0xCC788 Kwb_Wu16 65535.00 OneToOne 0.00 65535.00 FORMAT "%8.2" NUMBER 4 /end CHARACTERISTIC
/begin CHARACTERISTIC DSM_CDKDfp_PCVCD_SigTst_C "Kundenspezifischer Fehlercode fuer Fehlerpfad Dfp_PCVCD_SigTst" VAL_BLK 0xCC790 Kwb_Wu16 65535.00 OneToOne 0.00 65535.00 FORMAT "%8.2" NUMBER 4 /end CHARACTERISTIC
/begin CHARACTERISTIC DSM_CDKDfp_PFltAPSPlaus_C "Kundenspezifischer Fehlercode fuer Fehlerpfad Dfp_PFltAPSPlaus" VAL_BLK 0xCC798 Kwb_Wu16 65535.00 OneToOne 0.00 65535.00 FORMAT "%8.2" NUMBER 4 /end CHARACTERISTIC
/begin CHARACTERISTIC DSM_CDKDfp_PFltAPSens_C "Kundenspezifischer Fehlercode fuer Fehlerpfad Dfp_PFltAPSens" VAL_BLK 0xCC7A0 Kwb_Wu16 65535.00 OneToOne 0.00 65535.00 FORMAT "%8.2" NUMBER 4 /end CHARACTERISTIC
/begin CHARACTERISTIC DSM_CDKDfp_PFltBPSPlaus_C "Kundenspezifischer Fehlercode fuer Fehlerpfad Dfp_PFltBPSPlaus" VAL_BLK 0xCC7A8 Kwb_Wu16 65535.00 OneToOne 0.00 65535.00 FORMAT "%8.2" NUMBER 4 /end CHARACTERISTIC
/begin CHARACTERISTIC DSM_CDKDfp_PFltCDPPre_C "Kundenspezifischer Fehlercode fuer Fehlerpfad Dfp_PFltCDPPre" VAL_BLK 0xCC7B0 Kwb_Wu16 65535.00 OneToOne 0.00 65535.00 FORMAT "%8.2" NUMBER 4 /end CHARACTERISTIC
/begin CHARACTERISTIC DSM_CDKDfp_PFltCDTempPre_C "Kundenspezifischer Fehlercode fuer Fehlerpfad Dfp_PFltCDTempPre" VAL_BLK 0xCC7B8 Kwb_Wu16 65535.00 OneToOne 0.00 65535.00 FORMAT "%8.2" NUMBER 4 /end CHARACTERISTIC
/begin CHARACTERISTIC DSM_CDKDfp_PFltChar_C "Kundenspezifischer Fehlercode fuer Fehlerpfad Dfp_PFltChar" VAL_BLK 0xCC7C0 Kwb_Wu16 65535.00 OneToOne 0.00 65535.00 FORMAT "%8.2" NUMBER 4 /end CHARACTERISTIC
/begin CHARACTERISTIC DSM_CDKDfp_PFltEngPrt_C "Kundenspezifischer Fehlercode fuer Fehlerpfad Dfp_PFltEngPrt" VAL_BLK 0xCC7C8 Kwb_Wu16 65535.00 OneToOne 0.00 65535.00 FORMAT "%8.2" NUMBER 4 /end CHARACTERISTIC
/begin CHARACTERISTIC DSM_CDKDfp_PFltOvldInhRgn_C "Kundenspezifischer Fehlercode fuer Fehlerpfad Dfp_PFltOvldInhRgn" VAL_BLK 0xCC7D0 Kwb_Wu16 65535.00 OneToOne 0.00 65535.00 FORMAT "%8.2" NUMBER 4 /end CHARACTERISTIC
/begin CHARACTERISTIC DSM_CDKDfp_PFltOvldTrqLim_C "Kundenspezifischer Fehlercode fuer Fehlerpfad Dfp_PFltOvldTrqLim" VAL_BLK 0xCC7D8 Kwb_Wu16 65535.00 OneToOne 0.00 65535.00 FORMAT "%8.2" NUMBER 4 /end CHARACTERISTIC
/begin CHARACTERISTIC DSM_CDKDfp_PFltPresDynPlaus_C "Kundenspezifischer Fehlercode fuer Fehlerpfad Dfp_PFltPresDynPlaus" VAL_BLK 0xCC7E0 Kwb_Wu16 65535.00 OneToOne 0.00 65535.00 FORMAT "%8.2" NUMBER 4 /end CHARACTERISTIC
/begin CHARACTERISTIC DSM_CDKDfp_PFltPresPlaus_C "Kundenspezifischer Fehlercode fuer Fehlerpfad Dfp_PFltPresPlaus" VAL_BLK 0xCC7E8 Kwb_Wu16 65535.00 OneToOne 0.00 65535.00 FORMAT "%8.2" NUMBER 4 /end CHARACTERISTIC
/begin CHARACTERISTIC DSM_CDKDfp_PFltPresSens_C "Kundenspezifischer Fehlercode fuer Fehlerpfad Dfp_PFltPresSens" VAL_BLK 0xCC7F0 Kwb_Wu16 65535.00 OneToOne 0.00 65535.00 FORMAT "%8.2" NUMBER 4 /end CHARACTERISTIC
/begin CHARACTERISTIC DSM_CDKDfp_PFltPresSensFrz_C "Kundenspezifischer Fehlercode fuer Fehlerpfad Dfp_PFltPresSensFrz" VAL_BLK 0xCC7F8 Kwb_Wu16 65535.00 OneToOne 0.00 65535.00 FORMAT "%8.2" NUMBER 4 /end CHARACTERISTIC
/begin CHARACTERISTIC DSM_CDKDfp_PFltPresSensHsLn_C "Kundenspezifischer Fehlercode fuer Fehlerpfad Dfp_PFltPresSensHsLn" VAL_BLK 0xCC800 Kwb_Wu16 65535.00 OneToOne 0.00 65535.00 FORMAT "%8.2" NUMBER 4 /end CHARACTERISTIC
/begin CHARACTERISTIC DSM_CDKDfp_PFltPresSensSot_C "Kundenspezifischer Fehlercode fuer Fehlerpfad Dfp_PFltPresSensSot" VAL_BLK 0xCC808 Kwb_Wu16 65535.00 OneToOne 0.00 65535.00 FORMAT "%8.2" NUMBER 4 /end CHARACTERISTIC
/begin CHARACTERISTIC DSM_CDKDfp_PFltRgnPerm_C "Kundenspezifischer Fehlercode fuer Fehlerpfad Dfp_PFltRgnPerm" VAL_BLK 0xCC810 Kwb_Wu16 65535.00 OneToOne 0.00 65535.00 FORMAT "%8.2" NUMBER 4 /end CHARACTERISTIC
/begin CHARACTERISTIC DSM_CDKDfp_PFltTempDwnStrm_C "Kundenspezifischer Fehlercode fuer Fehlerpfad Dfp_PFltTempDwnStrm" VAL_BLK 0xCC818 Kwb_Wu16 65535.00 OneToOne 0.00 65535.00 FORMAT "%8.2" NUMBER 4 /end CHARACTERISTIC
/begin CHARACTERISTIC DSM_CDKDfp_PFltTempSens_C "Kundenspezifischer Fehlercode fuer Fehlerpfad Dfp_PFltTempSens" VAL_BLK 0xCC820 Kwb_Wu16 65535.00 OneToOne 0.00 65535.00 FORMAT "%8.2" NUMBER 4 /end CHARACTERISTIC
/begin CHARACTERISTIC DSM_CDKDfp_PFltTempUpStrm_C "Kundenspezifischer Fehlercode fuer Fehlerpfad Dfp_PFltTempUpStrm" VAL_BLK 0xCC828 Kwb_Wu16 65535.00 OneToOne 0.00 65535.00 FORMAT "%8.2" NUMBER 4 /end CHARACTERISTIC
/begin CHARACTERISTIC DSM_CDKDfp_PFlt_tOxiPreMax_C "Kundenspezifischer Fehlercode fuer Fehlerpfad Dfp_PFlt_tOxiPreMax" VAL_BLK 0xCC830 Kwb_Wu16 65535.00 OneToOne 0.00 65535.00 FORMAT "%8.2" NUMBER 4 /end CHARACTERISTIC
/begin CHARACTERISTIC DSM_CDKDfp_PFlt_tOxiPreMxRgn_C "Kundenspezifischer Fehlercode fuer Fehlerpfad Dfp_PFlt_tOxiPreMxRgn" VAL_BLK 0xCC838 Kwb_Wu16 65535.00 OneToOne 0.00 65535.00 FORMAT "%8.2" NUMBER 4 /end CHARACTERISTIC
/begin CHARACTERISTIC DSM_CDKDfp_PFlt_tPreMax_C "Kundenspezifischer Fehlercode fuer Fehlerpfad Dfp_PFlt_tPreMax" VAL_BLK 0xCC840 Kwb_Wu16 65535.00 OneToOne 0.00 65535.00 FORMAT "%8.2" NUMBER 4 /end CHARACTERISTIC
/begin CHARACTERISTIC DSM_CDKDfp_PFlt_tPreMaxRgn_C "Kundenspezifischer Fehlercode fuer Fehlerpfad Dfp_PFlt_tPreMaxRgn" VAL_BLK 0xCC848 Kwb_Wu16 65535.00 OneToOne 0.00 65535.00 FORMAT "%8.2" NUMBER 4 /end CHARACTERISTIC
/begin CHARACTERISTIC DSM_CDKDfp_PFltmSotDiffMax_C "Kundenspezifischer Fehlercode fuer Fehlerpfad Dfp_PFltmSotDiffMax" VAL_BLK 0xCC850 Kwb_Wu16 65535.00 OneToOne 0.00 65535.00 FORMAT "%8.2" NUMBER 4 /end CHARACTERISTIC
/begin CHARACTERISTIC DSM_CDKDfp_PSPCD_Actr_C "Kundenspezifischer Fehlercode fuer Fehlerpfad Dfp_PSPCD_Actr" VAL_BLK 0xCC858 Kwb_Wu16 65535.00 OneToOne 0.00 65535.00 FORMAT "%8.2" NUMBER 4 /end CHARACTERISTIC
/begin CHARACTERISTIC DSM_CDKDfp_PresPlausDblDef_C "Kundenspezifischer Fehlercode fuer Fehlerpfad Dfp_PresPlausDblDef" VAL_BLK 0xCC860 Kwb_Wu16 65535.00 OneToOne 0.00 65535.00 FORMAT "%8.2" NUMBER 4 /end CHARACTERISTIC
/begin CHARACTERISTIC DSM_CDKDfp_QLTCD_C "Kundenspezifischer Fehlercode fuer Fehlerpfad Dfp_QLTCD" VAL_BLK 0xCC868 Kwb_Wu16 65535.00 OneToOne 0.00 65535.00 FORMAT "%8.2" NUMBER 4 /end CHARACTERISTIC
/begin CHARACTERISTIC DSM_CDKDfp_RailCD_C "Kundenspezifischer Fehlercode fuer Fehlerpfad Dfp_RailCD" VAL_BLK 0xCC870 Kwb_Wu16 65535.00 OneToOne 0.00 65535.00 FORMAT "%8.2" NUMBER 4 /end CHARACTERISTIC
/begin CHARACTERISTIC DSM_CDKDfp_RailCDOfsTst_C "Kundenspezifischer Fehlercode fuer Fehlerpfad Dfp_RailCDOfsTst" VAL_BLK 0xCC878 Kwb_Wu16 65535.00 OneToOne 0.00 65535.00 FORMAT "%8.2" NUMBER 4 /end CHARACTERISTIC
/begin CHARACTERISTIC DSM_CDKDfp_RailCD_PMonStrt_C "Kundenspezifischer Fehlercode fuer Fehlerpfad Dfp_RailCD_PMonStrt" VAL_BLK 0xCC880 Kwb_Wu16 65535.00 OneToOne 0.00 65535.00 FORMAT "%8.2" NUMBER 4 /end CHARACTERISTIC
/begin CHARACTERISTIC DSM_CDKDfp_RailCtlModeMeUnDiag_C "Kundenspezifischer Fehlercode fuer Fehlerpfad Dfp_RailCtlModeMeUnDiag" VAL_BLK 0xCC888 Kwb_Wu16 65535.00 OneToOne 0.00 65535.00 FORMAT "%8.2" NUMBER 4 /end CHARACTERISTIC
/begin CHARACTERISTIC DSM_CDKDfp_RailCtlModePCVDiag_C "Kundenspezifischer Fehlercode fuer Fehlerpfad Dfp_RailCtlModePCVDiag" VAL_BLK 0xCC890 Kwb_Wu16 65535.00 OneToOne 0.00 65535.00 FORMAT "%8.2" NUMBER 4 /end CHARACTERISTIC
/begin CHARACTERISTIC DSM_CDKDfp_RailMeUn0_C "Kundenspezifischer Fehlercode fuer Fehlerpfad Dfp_RailMeUn0" VAL_BLK 0xCC898 Kwb_Wu16 65535.00 OneToOne 0.00 65535.00 FORMAT "%8.2" NUMBER 4 /end CHARACTERISTIC
/begin CHARACTERISTIC DSM_CDKDfp_RailMeUn1_C "Kundenspezifischer Fehlercode fuer Fehlerpfad Dfp_RailMeUn1" VAL_BLK 0xCC8A0 Kwb_Wu16 65535.00 OneToOne 0.00 65535.00 FORMAT "%8.2" NUMBER 4 /end CHARACTERISTIC
/begin CHARACTERISTIC DSM_CDKDfp_RailMeUn2_C "Kundenspezifischer Fehlercode fuer Fehlerpfad Dfp_RailMeUn2" VAL_BLK 0xCC8A8 Kwb_Wu16 65535.00 OneToOne 0.00 65535.00 FORMAT "%8.2" NUMBER 4 /end CHARACTERISTIC
/begin CHARACTERISTIC DSM_CDKDfp_RailMeUn3_C "Kundenspezifischer Fehlercode fuer Fehlerpfad Dfp_RailMeUn3" VAL_BLK 0xCC8B0 Kwb_Wu16 65535.00 OneToOne 0.00 65535.00 FORMAT "%8.2" NUMBER 4 /end CHARACTERISTIC
/begin CHARACTERISTIC DSM_CDKDfp_RailMeUn4_C "Kundenspezifischer Fehlercode fuer Fehlerpfad Dfp_RailMeUn4" VAL_BLK 0xCC8B8 Kwb_Wu16 65535.00 OneToOne 0.00 65535.00 FORMAT "%8.2" NUMBER 4 /end CHARACTERISTIC
/begin CHARACTERISTIC DSM_CDKDfp_RailPCV0_C "Kundenspezifischer Fehlercode fuer Fehlerpfad Dfp_RailPCV0" VAL_BLK 0xCC8C0 Kwb_Wu16 65535.00 OneToOne 0.00 65535.00 FORMAT "%8.2" NUMBER 4 /end CHARACTERISTIC
/begin CHARACTERISTIC DSM_CDKDfp_RailPCV1_C "Kundenspezifischer Fehlercode fuer Fehlerpfad Dfp_RailPCV1" VAL_BLK 0xCC8C8 Kwb_Wu16 65535.00 OneToOne 0.00 65535.00 FORMAT "%8.2" NUMBER 4 /end CHARACTERISTIC
/begin CHARACTERISTIC DSM_CDKDfp_RailPCV2_C "Kundenspezifischer Fehlercode fuer Fehlerpfad Dfp_RailPCV2" VAL_BLK 0xCC8D0 Kwb_Wu16 65535.00 OneToOne 0.00 65535.00 FORMAT "%8.2" NUMBER 4 /end CHARACTERISTIC
/begin CHARACTERISTIC DSM_CDKDfp_RailPCV3_C "Kundenspezifischer Fehlercode fuer Fehlerpfad Dfp_RailPCV3" VAL_BLK 0xCC8D8 Kwb_Wu16 65535.00 OneToOne 0.00 65535.00 FORMAT "%8.2" NUMBER 4 /end CHARACTERISTIC
/begin CHARACTERISTIC DSM_CDKDfp_RailPCV4_C "Kundenspezifischer Fehlercode fuer Fehlerpfad Dfp_RailPCV4" VAL_BLK 0xCC8E0 Kwb_Wu16 65535.00 OneToOne 0.00 65535.00 FORMAT "%8.2" NUMBER 4 /end CHARACTERISTIC
/begin CHARACTERISTIC DSM_CDKDfp_RailPCV5_C "Kundenspezifischer Fehlercode fuer Fehlerpfad Dfp_RailPCV5" VAL_BLK 0xCC8E8 Kwb_Wu16 65535.00 OneToOne 0.00 65535.00 FORMAT "%8.2" NUMBER 4 /end CHARACTERISTIC
/begin CHARACTERISTIC DSM_CDKDfp_SOPTst_C "Kundenspezifischer Fehlercode fuer Fehlerpfad Dfp_SOPTst" VAL_BLK 0xCC8F0 Kwb_Wu16 65535.00 OneToOne 0.00 65535.00 FORMAT "%8.2" NUMBER 4 /end CHARACTERISTIC
/begin CHARACTERISTIC DSM_CDKDfp_SSpMon1_C "Kundenspezifischer Fehlercode fuer Fehlerpfad Dfp_SSpMon1" VAL_BLK 0xCC8F8 Kwb_Wu16 65535.00 OneToOne 0.00 65535.00 FORMAT "%8.2" NUMBER 4 /end CHARACTERISTIC
/begin CHARACTERISTIC DSM_CDKDfp_SSpMon2_C "Kundenspezifischer Fehlercode fuer Fehlerpfad Dfp_SSpMon2" VAL_BLK 0xCC900 Kwb_Wu16 65535.00 OneToOne 0.00 65535.00 FORMAT "%8.2" NUMBER 4 /end CHARACTERISTIC
/begin CHARACTERISTIC DSM_CDKDfp_SSpMon3_C "Kundenspezifischer Fehlercode fuer Fehlerpfad Dfp_SSpMon3" VAL_BLK 0xCC908 Kwb_Wu16 65535.00 OneToOne 0.00 65535.00 FORMAT "%8.2" NUMBER 4 /end CHARACTERISTIC
/begin CHARACTERISTIC DSM_CDKDfp_SWChk_CycSigChkDat_C "Kundenspezifischer Fehlercode fuer Fehlerpfad Dfp_SWChk_CycSigChkDat" VAL_BLK 0xCC910 Kwb_Wu16 65535.00 OneToOne 0.00 65535.00 FORMAT "%8.2" NUMBER 4 /end CHARACTERISTIC
/begin CHARACTERISTIC DSM_CDKDfp_SWChk_CycSigChkPrg_C "Kundenspezifischer Fehlercode fuer Fehlerpfad Dfp_SWChk_CycSigChkPrg" VAL_BLK 0xCC918 Kwb_Wu16 65535.00 OneToOne 0.00 65535.00 FORMAT "%8.2" NUMBER 4 /end CHARACTERISTIC
/begin CHARACTERISTIC DSM_CDKDfp_ShutCD_C "Kundenspezifischer Fehlercode fuer Fehlerpfad Dfp_ShutCD" VAL_BLK 0xCC920 Kwb_Wu16 65535.00 OneToOne 0.00 65535.00 FORMAT "%8.2" NUMBER 4 /end CHARACTERISTIC
/begin CHARACTERISTIC DSM_CDKDfp_StSysTrqShutOff_C "Kundenspezifischer Fehlercode fuer Fehlerpfad Dfp_StSysTrqShutOff" VAL_BLK 0xCC928 Kwb_Wu16 65535.00 OneToOne 0.00 65535.00 FORMAT "%8.2" NUMBER 4 /end CHARACTERISTIC
/begin CHARACTERISTIC DSM_CDKDfp_StrtCD_Actr_C "Kundenspezifischer Fehlercode fuer Fehlerpfad Dfp_StrtCD_Actr" VAL_BLK 0xCC930 Kwb_Wu16 65535.00 OneToOne 0.00 65535.00 FORMAT "%8.2" NUMBER 4 /end CHARACTERISTIC
/begin CHARACTERISTIC DSM_CDKDfp_SysLamp_C "Kundenspezifischer Fehlercode fuer Fehlerpfad Dfp_SysLamp" VAL_BLK 0xCC938 Kwb_Wu16 65535.00 OneToOne 0.00 65535.00 FORMAT "%8.2" NUMBER 4 /end CHARACTERISTIC
/begin CHARACTERISTIC DSM_CDKDfp_T15CD_C "Kundenspezifischer Fehlercode fuer Fehlerpfad Dfp_T15CD" VAL_BLK 0xCC940 Kwb_Wu16 65535.00 OneToOne 0.00 65535.00 FORMAT "%8.2" NUMBER 4 /end CHARACTERISTIC
/begin CHARACTERISTIC DSM_CDKDfp_TGearbx_C "Kundenspezifischer Fehlercode fuer Fehlerpfad Dfp_TGearbx" VAL_BLK 0xCC948 Kwb_Wu16 65535.00 OneToOne 0.00 65535.00 FORMAT "%8.2" NUMBER 4 /end CHARACTERISTIC
/begin CHARACTERISTIC DSM_CDKDfp_TPUMon_C "Kundenspezifischer Fehlercode fuer Fehlerpfad Dfp_TPUMon" VAL_BLK 0xCC950 Kwb_Wu16 65535.00 OneToOne 0.00 65535.00 FORMAT "%8.2" NUMBER 4 /end CHARACTERISTIC
/begin CHARACTERISTIC DSM_CDKDfp_TVACD_Max_C "Kundenspezifischer Fehlercode fuer Fehlerpfad Dfp_TVACD_Max" VAL_BLK 0xCC958 Kwb_Wu16 65535.00 OneToOne 0.00 65535.00 FORMAT "%8.2" NUMBER 4 /end CHARACTERISTIC
/begin CHARACTERISTIC DSM_CDKDfp_TVACD_Min_C "Kundenspezifischer Fehlercode fuer Fehlerpfad Dfp_TVACD_Min" VAL_BLK 0xCC960 Kwb_Wu16 65535.00 OneToOne 0.00 65535.00 FORMAT "%8.2" NUMBER 4 /end CHARACTERISTIC
/begin CHARACTERISTIC DSM_CDKDfp_TVACD_SigNpl_C "Kundenspezifischer Fehlercode fuer Fehlerpfad Dfp_TVACD_SigNpl" VAL_BLK 0xCC968 Kwb_Wu16 65535.00 OneToOne 0.00 65535.00 FORMAT "%8.2" NUMBER 4 /end CHARACTERISTIC
/begin CHARACTERISTIC DSM_CDKDfp_TVACD_TVADia1_C "Kundenspezifischer Fehlercode fuer Fehlerpfad Dfp_TVACD_TVADia1" VAL_BLK 0xCC970 Kwb_Wu16 65535.00 OneToOne 0.00 65535.00 FORMAT "%8.2" NUMBER 4 /end CHARACTERISTIC
/begin CHARACTERISTIC DSM_CDKDfp_TVACD_TVADia2_C "Kundenspezifischer Fehlercode fuer Fehlerpfad Dfp_TVACD_TVADia2" VAL_BLK 0xCC978 Kwb_Wu16 65535.00 OneToOne 0.00 65535.00 FORMAT "%8.2" NUMBER 4 /end CHARACTERISTIC
/begin CHARACTERISTIC DSM_CDKDfp_TVACD_TVADia3_C "Kundenspezifischer Fehlercode fuer Fehlerpfad Dfp_TVACD_TVADia3" VAL_BLK 0xCC980 Kwb_Wu16 65535.00 OneToOne 0.00 65535.00 FORMAT "%8.2" NUMBER 4 /end CHARACTERISTIC
/begin CHARACTERISTIC DSM_CDKDfp_TVACD_TVADia4_C "Kundenspezifischer Fehlercode fuer Fehlerpfad Dfp_TVACD_TVADia4" VAL_BLK 0xCC988 Kwb_Wu16 65535.00 OneToOne 0.00 65535.00 FORMAT "%8.2" NUMBER 4 /end CHARACTERISTIC
/begin CHARACTERISTIC DSM_CDKDfp_ThrVlvMon_C "Kundenspezifischer Fehlercode fuer Fehlerpfad Dfp_ThrVlvMon" VAL_BLK 0xCC990 Kwb_Wu16 65535.00 OneToOne 0.00 65535.00 FORMAT "%8.2" NUMBER 4 /end CHARACTERISTIC
/begin CHARACTERISTIC DSM_CDKDfp_VSACD_DiaDet_C "Kundenspezifischer Fehlercode fuer Fehlerpfad Dfp_VSACD_DiaDet" VAL_BLK 0xCC998 Kwb_Wu16 65535.00 OneToOne 0.00 65535.00 FORMAT "%8.2" NUMBER 4 /end CHARACTERISTIC
/begin CHARACTERISTIC DSM_CDKDfp_VSACD_DioInDia1_C "Kundenspezifischer Fehlercode fuer Fehlerpfad Dfp_VSACD_DioInDia1" VAL_BLK 0xCC9A0 Kwb_Wu16 65535.00 OneToOne 0.00 65535.00 FORMAT "%8.2" NUMBER 4 /end CHARACTERISTIC
/begin CHARACTERISTIC DSM_CDKDfp_VSACD_DioInDia2_C "Kundenspezifischer Fehlercode fuer Fehlerpfad Dfp_VSACD_DioInDia2" VAL_BLK 0xCC9A8 Kwb_Wu16 65535.00 OneToOne 0.00 65535.00 FORMAT "%8.2" NUMBER 4 /end CHARACTERISTIC
/begin CHARACTERISTIC DSM_CDKDfp_VSACD_DioInDia3_C "Kundenspezifischer Fehlercode fuer Fehlerpfad Dfp_VSACD_DioInDia3" VAL_BLK 0xCC9B0 Kwb_Wu16 65535.00 OneToOne 0.00 65535.00 FORMAT "%8.2" NUMBER 4 /end CHARACTERISTIC
/begin CHARACTERISTIC DSM_CDKDfp_VSACD_DioInDia4_C "Kundenspezifischer Fehlercode fuer Fehlerpfad Dfp_VSACD_DioInDia4" VAL_BLK 0xCC9B8 Kwb_Wu16 65535.00 OneToOne 0.00 65535.00 FORMAT "%8.2" NUMBER 4 /end CHARACTERISTIC
/begin CHARACTERISTIC DSM_CDKDfp_VSACD_DioInMin_C "Kundenspezifischer Fehlercode fuer Fehlerpfad Dfp_VSACD_DioInMin" VAL_BLK 0xCC9C0 Kwb_Wu16 65535.00 OneToOne 0.00 65535.00 FORMAT "%8.2" NUMBER 4 /end CHARACTERISTIC
/begin CHARACTERISTIC DSM_CDKDfp_VSACD_Max_C "Kundenspezifischer Fehlercode fuer Fehlerpfad Dfp_VSACD_Max" VAL_BLK 0xCC9C8 Kwb_Wu16 65535.00 OneToOne 0.00 65535.00 FORMAT "%8.2" NUMBER 4 /end CHARACTERISTIC
/begin CHARACTERISTIC DSM_CDKDfp_VSACD_Min_C "Kundenspezifischer Fehlercode fuer Fehlerpfad Dfp_VSACD_Min" VAL_BLK 0xCC9D0 Kwb_Wu16 65535.00 OneToOne 0.00 65535.00 FORMAT "%8.2" NUMBER 4 /end CHARACTERISTIC
/begin CHARACTERISTIC DSM_CDKDfp_VSACD_SigNpl_C "Kundenspezifischer Fehlercode fuer Fehlerpfad Dfp_VSACD_SigNpl" VAL_BLK 0xCC9D8 Kwb_Wu16 65535.00 OneToOne 0.00 65535.00 FORMAT "%8.2" NUMBER 4 /end CHARACTERISTIC
/begin CHARACTERISTIC DSM_CDKDfp_VSACD_VSADia1_C "Kundenspezifischer Fehlercode fuer Fehlerpfad Dfp_VSACD_VSADia1" VAL_BLK 0xCC9E0 Kwb_Wu16 65535.00 OneToOne 0.00 65535.00 FORMAT "%8.2" NUMBER 4 /end CHARACTERISTIC
/begin CHARACTERISTIC DSM_CDKDfp_VSACD_VSADia2_C "Kundenspezifischer Fehlercode fuer Fehlerpfad Dfp_VSACD_VSADia2" VAL_BLK 0xCC9E8 Kwb_Wu16 65535.00 OneToOne 0.00 65535.00 FORMAT "%8.2" NUMBER 4 /end CHARACTERISTIC
/begin CHARACTERISTIC DSM_CDKDfp_VSACD_VSADia3_C "Kundenspezifischer Fehlercode fuer Fehlerpfad Dfp_VSACD_VSADia3" VAL_BLK 0xCC9F0 Kwb_Wu16 65535.00 OneToOne 0.00 65535.00 FORMAT "%8.2" NUMBER 4 /end CHARACTERISTIC
/begin CHARACTERISTIC DSM_CDKDfp_VSACD_VSADia4_C "Kundenspezifischer Fehlercode fuer Fehlerpfad Dfp_VSACD_VSADia4" VAL_BLK 0xCC9F8 Kwb_Wu16 65535.00 OneToOne 0.00 65535.00 FORMAT "%8.2" NUMBER 4 /end CHARACTERISTIC
/begin CHARACTERISTIC DSM_CDKDfp_VSSCD1_C "Kundenspezifischer Fehlercode fuer Fehlerpfad Dfp_VSSCD1" VAL_BLK 0xCCA00 Kwb_Wu16 65535.00 OneToOne 0.00 65535.00 FORMAT "%8.2" NUMBER 4 /end CHARACTERISTIC
/begin CHARACTERISTIC DSM_CDKDfp_VSSCD2_C "Kundenspezifischer Fehlercode fuer Fehlerpfad Dfp_VSSCD2" VAL_BLK 0xCCA08 Kwb_Wu16 65535.00 OneToOne 0.00 65535.00 FORMAT "%8.2" NUMBER 4 /end CHARACTERISTIC
/begin CHARACTERISTIC DSM_CDKDfp_WdCom_C "Kundenspezifischer Fehlercode fuer Fehlerpfad Dfp_WdCom" VAL_BLK 0xCCA10 Kwb_Wu16 65535.00 OneToOne 0.00 65535.00 FORMAT "%8.2" NUMBER 4 /end CHARACTERISTIC
/begin CHARACTERISTIC DSM_ClaDfp_Layer_TANS_C "Fehlerklasse fuer Fehlerpfad Dfp_Layer_TANS" VALUE 0xCCA18 Kw_Wu8 20.00 OneToOne 0.00 20.00 FORMAT "%5.2" EXTENDED_LIMITS 0.00 255.0 /end CHARACTERISTIC
/begin CHARACTERISTIC DSM_ClaDfp_ACCDCmpr_C "Fehlerklasse fuer Fehlerpfad Dfp_ACCDCmpr" VALUE 0xCCA19 Kw_Wu8 20.00 OneToOne 0.00 20.00 FORMAT "%5.2" EXTENDED_LIMITS 0.00 255.0 /end CHARACTERISTIC
/begin CHARACTERISTIC DSM_ClaDfp_ACCDPres_C "Fehlerklasse fuer Fehlerpfad Dfp_ACCDPres" VALUE 0xCCA1A Kw_Wu8 20.00 OneToOne 0.00 20.00 FORMAT "%5.2" EXTENDED_LIMITS 0.00 255.0 /end CHARACTERISTIC
/begin CHARACTERISTIC DSM_ClaDfp_ACCDPres1_C "Fehlerklasse fuer Fehlerpfad Dfp_ACCDPres1" VALUE 0xCCA1B Kw_Wu8 20.00 OneToOne 0.00 20.00 FORMAT "%5.2" EXTENDED_LIMITS 0.00 255.0 /end CHARACTERISTIC
/begin CHARACTERISTIC DSM_ClaDfp_ACCDPresAna_C "Fehlerklasse fuer Fehlerpfad Dfp_ACCDPresAna" VALUE 0xCCA1C Kw_Wu8 20.00 OneToOne 0.00 20.00 FORMAT "%5.2" EXTENDED_LIMITS 0.00 255.0 /end CHARACTERISTIC
/begin CHARACTERISTIC DSM_ClaDfp_ACCDSwtin_C "Fehlerklasse fuer Fehlerpfad Dfp_ACCDSwtin" VALUE 0xCCA1D Kw_Wu8 20.00 OneToOne 0.00 20.00 FORMAT "%5.2" EXTENDED_LIMITS 0.00 255.0 /end CHARACTERISTIC
/begin CHARACTERISTIC DSM_ClaDfp_ACC_PlausTrqDes_C "Fehlerklasse fuer Fehlerpfad Dfp_ACC_PlausTrqDes" VALUE 0xCCA1E Kw_Wu8 20.00 OneToOne 0.00 20.00 FORMAT "%5.2" EXTENDED_LIMITS 0.00 255.0 /end CHARACTERISTIC
/begin CHARACTERISTIC DSM_ClaDfp_ACC_trqInr_C "Fehlerklasse fuer Fehlerpfad Dfp_ACC_trqInr" VALUE 0xCCA1F Kw_Wu8 20.00 OneToOne 0.00 20.00 FORMAT "%5.2" EXTENDED_LIMITS 0.00 255.0 /end CHARACTERISTIC
/begin CHARACTERISTIC DSM_ClaDfp_ACTrq_C "Fehlerklasse fuer Fehlerpfad Dfp_ACTrq" VALUE 0xCCA20 Kw_Wu8 20.00 OneToOne 0.00 20.00 FORMAT "%5.2" EXTENDED_LIMITS 0.00 255.0 /end CHARACTERISTIC
/begin CHARACTERISTIC DSM_ClaDfp_ADCMon_C "Fehlerklasse fuer Fehlerpfad Dfp_ADCMon" VALUE 0xCCA21 Kw_Wu8 20.00 OneToOne 0.00 20.00 FORMAT "%5.2" EXTENDED_LIMITS 0.00 255.0 /end CHARACTERISTIC
/begin CHARACTERISTIC DSM_ClaDfp_AFSCDIdlAdjVal_C "Fehlerklasse fuer Fehlerpfad Dfp_AFSCDIdlAdjVal" VALUE 0xCCA22 Kw_Wu8 20.00 OneToOne 0.00 20.00 FORMAT "%5.2" EXTENDED_LIMITS 0.00 255.0 /end CHARACTERISTIC
/begin CHARACTERISTIC DSM_ClaDfp_AFSCDLdAdjVal_C "Fehlerklasse fuer Fehlerpfad Dfp_AFSCDLdAdjVal" VALUE 0xCCA23 Kw_Wu8 20.00 OneToOne 0.00 20.00 FORMAT "%5.2" EXTENDED_LIMITS 0.00 255.0 /end CHARACTERISTIC
/begin CHARACTERISTIC DSM_ClaDfp_AFSCD_AirTempDcyc_C "Fehlerklasse fuer Fehlerpfad Dfp_AFSCD_AirTempDcyc" VALUE 0xCCA24 Kw_Wu8 20.00 OneToOne 0.00 20.00 FORMAT "%5.2" EXTENDED_LIMITS 0.00 255.0 /end CHARACTERISTIC
/begin CHARACTERISTIC DSM_ClaDfp_AFSCD_PlOffsDrft_C "Fehlerklasse fuer Fehlerpfad Dfp_AFSCD_PlOffsDrft" VALUE 0xCCA25 Kw_Wu8 20.00 OneToOne 0.00 20.00 FORMAT "%5.2" EXTENDED_LIMITS 0.00 255.0 /end CHARACTERISTIC
/begin CHARACTERISTIC DSM_ClaDfp_AFSCD_PlSetyDrft_C "Fehlerklasse fuer Fehlerpfad Dfp_AFSCD_PlSetyDrft" VALUE 0xCCA26 Kw_Wu8 20.00 OneToOne 0.00 20.00 FORMAT "%5.2" EXTENDED_LIMITS 0.00 255.0 /end CHARACTERISTIC
/begin CHARACTERISTIC DSM_ClaDfp_AFSCD_SRCAirTemp_C "Fehlerklasse fuer Fehlerpfad Dfp_AFSCD_SRCAirTemp" VALUE 0xCCA27 Kw_Wu8 20.00 OneToOne 0.00 20.00 FORMAT "%5.2" EXTENDED_LIMITS 0.00 255.0 /end CHARACTERISTIC
/begin CHARACTERISTIC DSM_ClaDfp_AFSCD_SRCBatt_C "Fehlerklasse fuer Fehlerpfad Dfp_AFSCD_SRCBatt" VALUE 0xCCA28 Kw_Wu8 20.00 OneToOne 0.00 20.00 FORMAT "%5.2" EXTENDED_LIMITS 0.00 255.0 /end CHARACTERISTIC
/begin CHARACTERISTIC DSM_ClaDfp_AFSCD_SRCCorrAirm_C "Fehlerklasse fuer Fehlerpfad Dfp_AFSCD_SRCCorrAirm" VALUE 0xCCA29 Kw_Wu8 20.00 OneToOne 0.00 20.00 FORMAT "%5.2" EXTENDED_LIMITS 0.00 255.0 /end CHARACTERISTIC
/begin CHARACTERISTIC DSM_ClaDfp_AFSCD_SRCRawAirm_C "Fehlerklasse fuer Fehlerpfad Dfp_AFSCD_SRCRawAirm" VALUE 0xCCA2A Kw_Wu8 20.00 OneToOne 0.00 20.00 FORMAT "%5.2" EXTENDED_LIMITS 0.00 255.0 /end CHARACTERISTIC
/begin CHARACTERISTIC DSM_ClaDfp_Layer_TUMG_C "Fehlerklasse fuer Fehlerpfad Dfp_Layer_TUMG" VALUE 0xCCA2B Kw_Wu8 20.00 OneToOne 0.00 20.00 FORMAT "%5.2" EXTENDED_LIMITS 0.00 255.0 /end CHARACTERISTIC
/begin CHARACTERISTIC DSM_ClaDfp_AFSCD_SRCRefSigPer_C "Fehlerklasse fuer Fehlerpfad Dfp_AFSCD_SRCRefSigPer" VALUE 0xCCA2C Kw_Wu8 20.00 OneToOne 0.00 20.00 FORMAT "%5.2" EXTENDED_LIMITS 0.00 255.0 /end CHARACTERISTIC
/begin CHARACTERISTIC DSM_ClaDfp_AOHtCD_C "Fehlerklasse fuer Fehlerpfad Dfp_AOHtCD" VALUE 0xCCA2D Kw_Wu8 20.00 OneToOne 0.00 20.00 FORMAT "%5.2" EXTENDED_LIMITS 0.00 255.0 /end CHARACTERISTIC
/begin CHARACTERISTIC DSM_ClaDfp_Layer_GEN_C "Fehlerklasse fuer Fehlerpfad Dfp_Layer_GEN" VALUE 0xCCA2E Kw_Wu8 20.00 OneToOne 0.00 20.00 FORMAT "%5.2" EXTENDED_LIMITS 0.00 255.0 /end CHARACTERISTIC
/begin CHARACTERISTIC DSM_ClaDfp_Layer_BSD_C "Fehlerklasse fuer Fehlerpfad Dfp_Layer_BSD" VALUE 0xCCA2F Kw_Wu8 20.00 OneToOne 0.00 20.00 FORMAT "%5.2" EXTENDED_LIMITS 0.00 255.0 /end CHARACTERISTIC
/begin CHARACTERISTIC DSM_ClaDfp_AOHtCD_AOHtDia1_C "Fehlerklasse fuer Fehlerpfad Dfp_AOHtCD_AOHtDia1" VALUE 0xCCA30 Kw_Wu8 20.00 OneToOne 0.00 20.00 FORMAT "%5.2" EXTENDED_LIMITS 0.00 255.0 /end CHARACTERISTIC
/begin CHARACTERISTIC DSM_ClaDfp_AOHtCD_AOHtDia2_C "Fehlerklasse fuer Fehlerpfad Dfp_AOHtCD_AOHtDia2" VALUE 0xCCA31 Kw_Wu8 20.00 OneToOne 0.00 20.00 FORMAT "%5.2" EXTENDED_LIMITS 0.00 255.0 /end CHARACTERISTIC
/begin CHARACTERISTIC DSM_ClaDfp_AOHtCD_AOHtDia3_C "Fehlerklasse fuer Fehlerpfad Dfp_AOHtCD_AOHtDia3" VALUE 0xCCA32 Kw_Wu8 20.00 OneToOne 0.00 20.00 FORMAT "%5.2" EXTENDED_LIMITS 0.00 255.0 /end CHARACTERISTIC
/begin CHARACTERISTIC DSM_ClaDfp_APP1_C "Fehlerklasse fuer Fehlerpfad Dfp_APP1" VALUE 0xCCA33 Kw_Wu8 20.00 OneToOne 0.00 20.00 FORMAT "%5.2" EXTENDED_LIMITS 0.00 255.0 /end CHARACTERISTIC
/begin CHARACTERISTIC DSM_ClaDfp_APP2_C "Fehlerklasse fuer Fehlerpfad Dfp_APP2" VALUE 0xCCA34 Kw_Wu8 20.00 OneToOne 0.00 20.00 FORMAT "%5.2" EXTENDED_LIMITS 0.00 255.0 /end CHARACTERISTIC
/begin CHARACTERISTIC DSM_ClaDfp_APPCDCmpd_C "Fehlerklasse fuer Fehlerpfad Dfp_APPCDCmpd" VALUE 0xCCA35 Kw_Wu8 20.00 OneToOne 0.00 20.00 FORMAT "%5.2" EXTENDED_LIMITS 0.00 255.0 /end CHARACTERISTIC
/begin CHARACTERISTIC DSM_ClaDfp_APPSync_C "Fehlerklasse fuer Fehlerpfad Dfp_APPSync" VALUE 0xCCA36 Kw_Wu8 20.00 OneToOne 0.00 20.00 FORMAT "%5.2" EXTENDED_LIMITS 0.00 255.0 /end CHARACTERISTIC
/begin CHARACTERISTIC DSM_ClaDfp_APSCD_C "Fehlerklasse fuer Fehlerpfad Dfp_APSCD" VALUE 0xCCA37 Kw_Wu8 20.00 OneToOne 0.00 20.00 FORMAT "%5.2" EXTENDED_LIMITS 0.00 255.0 /end CHARACTERISTIC
/begin CHARACTERISTIC DSM_ClaDfp_ARS_C "Fehlerklasse fuer Fehlerpfad Dfp_ARS" VALUE 0xCCA38 Kw_Wu8 20.00 OneToOne 0.00 20.00 FORMAT "%5.2" EXTENDED_LIMITS 0.00 255.0 /end CHARACTERISTIC
/begin CHARACTERISTIC DSM_ClaDfp_AccPedPlausBrk_C "Fehlerklasse fuer Fehlerpfad Dfp_AccPedPlausBrk" VALUE 0xCCA39 Kw_Wu8 20.00 OneToOne 0.00 20.00 FORMAT "%5.2" EXTENDED_LIMITS 0.00 255.0 /end CHARACTERISTIC
/begin CHARACTERISTIC DSM_ClaDfp_Layer_QLT_C "Fehlerklasse fuer Fehlerpfad Dfp_Layer_QLT" VALUE 0xCCA3A Kw_Wu8 20.00 OneToOne 0.00 20.00 FORMAT "%5.2" EXTENDED_LIMITS 0.00 255.0 /end CHARACTERISTIC
/begin CHARACTERISTIC DSM_ClaDfp_AirCtlGvnrDvtRgnMax_C "Fehlerklasse fuer Fehlerpfad Dfp_AirCtlGvnrDvtRgnMax" VALUE 0xCCA3B Kw_Wu8 20.00 OneToOne 0.00 20.00 FORMAT "%5.2" EXTENDED_LIMITS 0.00 255.0 /end CHARACTERISTIC
/begin CHARACTERISTIC DSM_ClaDfp_Layer_IBS1_C "Fehlerklasse fuer Fehlerpfad Dfp_Layer_IBS1" VALUE 0xCCA3C Kw_Wu8 20.00 OneToOne 0.00 20.00 FORMAT "%5.2" EXTENDED_LIMITS 0.00 255.0 /end CHARACTERISTIC
/begin CHARACTERISTIC DSM_ClaDfp_Layer_IBS2_C "Fehlerklasse fuer Fehlerpfad Dfp_Layer_IBS2" VALUE 0xCCA3D Kw_Wu8 20.00 OneToOne 0.00 20.00 FORMAT "%5.2" EXTENDED_LIMITS 0.00 255.0 /end CHARACTERISTIC
/begin CHARACTERISTIC DSM_ClaDfp_Layer_IBS3_C "Fehlerklasse fuer Fehlerpfad Dfp_Layer_IBS3" VALUE 0xCCA3E Kw_Wu8 20.00 OneToOne 0.00 20.00 FORMAT "%5.2" EXTENDED_LIMITS 0.00 255.0 /end CHARACTERISTIC
/begin CHARACTERISTIC DSM_ClaDfp_Layer_PMBN_C "Fehlerklasse fuer Fehlerpfad Dfp_Layer_PMBN" VALUE 0xCCA3F Kw_Wu8 20.00 OneToOne 0.00 20.00 FORMAT "%5.2" EXTENDED_LIMITS 0.00 255.0 /end CHARACTERISTIC
/begin CHARACTERISTIC DSM_ClaDfp_Layer_PMBATT_C "Fehlerklasse fuer Fehlerpfad Dfp_Layer_PMBATT" VALUE 0xCCA40 Kw_Wu8 20.00 OneToOne 0.00 20.00 FORMAT "%5.2" EXTENDED_LIMITS 0.00 255.0 /end CHARACTERISTIC
/begin CHARACTERISTIC DSM_ClaDfp_AirCtlGvnrDvtRgnMin_C "Fehlerklasse fuer Fehlerpfad Dfp_AirCtlGvnrDvtRgnMin" VALUE 0xCCA41 Kw_Wu8 20.00 OneToOne 0.00 20.00 FORMAT "%5.2" EXTENDED_LIMITS 0.00 255.0 /end CHARACTERISTIC
/begin CHARACTERISTIC DSM_ClaDfp_AirCtlGvnrDvtRgnMn2_C "Fehlerklasse fuer Fehlerpfad Dfp_AirCtlGvnrDvtRgnMn2" VALUE 0xCCA42 Kw_Wu8 20.00 OneToOne 0.00 20.00 FORMAT "%5.2" EXTENDED_LIMITS 0.00 255.0 /end CHARACTERISTIC
/begin CHARACTERISTIC DSM_ClaDfp_AirCtlGvnrDvtRgnMx2_C "Fehlerklasse fuer Fehlerpfad Dfp_AirCtlGvnrDvtRgnMx2" VALUE 0xCCA43 Kw_Wu8 20.00 OneToOne 0.00 20.00 FORMAT "%5.2" EXTENDED_LIMITS 0.00 255.0 /end CHARACTERISTIC
/begin CHARACTERISTIC DSM_ClaDfp_AirCtlPlateBreak_C "DSM variable for Dfp_AirCtlPlateBreak_mp" VALUE 0xCCA44 Kw_Wu8 20.00 OneToOne 0.00 20.00 FORMAT "%5.2" EXTENDED_LIMITS 0.00 255.0 /end CHARACTERISTIC
/begin CHARACTERISTIC DSM_ClaDfp_AirCtlRmpTO_C "Fehlerklasse fuer Fehlerpfad Dfp_AirCtlRmpTO" VALUE 0xCCA45 Kw_Wu8 20.00 OneToOne 0.00 20.00 FORMAT "%5.2" EXTENDED_LIMITS 0.00 255.0 /end CHARACTERISTIC
/begin CHARACTERISTIC DSM_ClaDfp_AirCtl_GovNegDev_C "Fehlerklasse fuer Fehlerpfad Dfp_AirCtl_GovNegDev" VALUE 0xCCA46 Kw_Wu8 20.00 OneToOne 0.00 20.00 FORMAT "%5.2" EXTENDED_LIMITS 0.00 255.0 /end CHARACTERISTIC
/begin CHARACTERISTIC DSM_ClaDfp_AirCtl_GovNegDev2_C "Fehlerklasse fuer Fehlerpfad Dfp_AirCtl_GovNegDev2" VALUE 0xCCA47 Kw_Wu8 20.00 OneToOne 0.00 20.00 FORMAT "%5.2" EXTENDED_LIMITS 0.00 255.0 /end CHARACTERISTIC
/begin CHARACTERISTIC DSM_ClaDfp_AirCtl_GovPosDev_C "Fehlerklasse fuer Fehlerpfad Dfp_AirCtl_GovPosDev" VALUE 0xCCA48 Kw_Wu8 20.00 OneToOne 0.00 20.00 FORMAT "%5.2" EXTENDED_LIMITS 0.00 255.0 /end CHARACTERISTIC
/begin CHARACTERISTIC DSM_ClaDfp_AirCtl_GovPosDev2_C "Fehlerklasse fuer Fehlerpfad Dfp_AirCtl_GovPosDev2" VALUE 0xCCA49 Kw_Wu8 20.00 OneToOne 0.00 20.00 FORMAT "%5.2" EXTENDED_LIMITS 0.00 255.0 /end CHARACTERISTIC
/begin CHARACTERISTIC DSM_ClaDfp_AltCD_C "Fehlerklasse fuer Fehlerpfad Dfp_AltCD" VALUE 0xCCA4A Kw_Wu8 20.00 OneToOne 0.00 20.00 FORMAT "%5.2" EXTENDED_LIMITS 0.00 255.0 /end CHARACTERISTIC
/begin CHARACTERISTIC DSM_ClaDfp_AltCD_Load_C "Fehlerklasse fuer Fehlerpfad Dfp_AltCD_Load" VALUE 0xCCA4B Kw_Wu8 20.00 OneToOne 0.00 20.00 FORMAT "%5.2" EXTENDED_LIMITS 0.00 255.0 /end CHARACTERISTIC
/begin CHARACTERISTIC DSM_ClaDfp_BPACD_BPADia1_C "Fehlerklasse fuer Fehlerpfad Dfp_BPACD_BPADia1" VALUE 0xCCA4C Kw_Wu8 20.00 OneToOne 0.00 20.00 FORMAT "%5.2" EXTENDED_LIMITS 0.00 255.0 /end CHARACTERISTIC
/begin CHARACTERISTIC DSM_ClaDfp_BPACD_BPADia2_C "Fehlerklasse fuer Fehlerpfad Dfp_BPACD_BPADia2" VALUE 0xCCA4D Kw_Wu8 20.00 OneToOne 0.00 20.00 FORMAT "%5.2" EXTENDED_LIMITS 0.00 255.0 /end CHARACTERISTIC
/begin CHARACTERISTIC DSM_ClaDfp_BPACD_BPADia3_C "Fehlerklasse fuer Fehlerpfad Dfp_BPACD_BPADia3" VALUE 0xCCA4E Kw_Wu8 20.00 OneToOne 0.00 20.00 FORMAT "%5.2" EXTENDED_LIMITS 0.00 255.0 /end CHARACTERISTIC
/begin CHARACTERISTIC DSM_ClaDfp_BPACD_BPADia4_C "Fehlerklasse fuer Fehlerpfad Dfp_BPACD_BPADia4" VALUE 0xCCA4F Kw_Wu8 20.00 OneToOne 0.00 20.00 FORMAT "%5.2" EXTENDED_LIMITS 0.00 255.0 /end CHARACTERISTIC
/begin CHARACTERISTIC DSM_ClaDfp_BPACD_Max_C "Fehlerklasse fuer Fehlerpfad Dfp_BPACD_Max" VALUE 0xCCA50 Kw_Wu8 20.00 OneToOne 0.00 20.00 FORMAT "%5.2" EXTENDED_LIMITS 0.00 255.0 /end CHARACTERISTIC
/begin CHARACTERISTIC DSM_ClaDfp_BPACD_Min_C "Fehlerklasse fuer Fehlerpfad Dfp_BPACD_Min" VALUE 0xCCA51 Kw_Wu8 20.00 OneToOne 0.00 20.00 FORMAT "%5.2" EXTENDED_LIMITS 0.00 255.0 /end CHARACTERISTIC
/begin CHARACTERISTIC DSM_ClaDfp_BPACD_PwmIn_C "Fehlerklasse fuer Fehlerpfad Dfp_BPACD_PwmIn" VALUE 0xCCA52 Kw_Wu8 20.00 OneToOne 0.00 20.00 FORMAT "%5.2" EXTENDED_LIMITS 0.00 255.0 /end CHARACTERISTIC
/begin CHARACTERISTIC DSM_ClaDfp_BPACD_PwmInDia1_C "Fehlerklasse fuer Fehlerpfad Dfp_BPACD_PwmInDia1" VALUE 0xCCA53 Kw_Wu8 20.00 OneToOne 0.00 20.00 FORMAT "%5.2" EXTENDED_LIMITS 0.00 255.0 /end CHARACTERISTIC
/begin CHARACTERISTIC DSM_ClaDfp_BPACD_PwmInDia2_C "Fehlerklasse fuer Fehlerpfad Dfp_BPACD_PwmInDia2" VALUE 0xCCA54 Kw_Wu8 20.00 OneToOne 0.00 20.00 FORMAT "%5.2" EXTENDED_LIMITS 0.00 255.0 /end CHARACTERISTIC
/begin CHARACTERISTIC DSM_ClaDfp_BPACD_PwmInDia3_C "Fehlerklasse fuer Fehlerpfad Dfp_BPACD_PwmInDia3" VALUE 0xCCA55 Kw_Wu8 20.00 OneToOne 0.00 20.00 FORMAT "%5.2" EXTENDED_LIMITS 0.00 255.0 /end CHARACTERISTIC
/begin CHARACTERISTIC DSM_ClaDfp_BPACD_PwmInDia4_C "Fehlerklasse fuer Fehlerpfad Dfp_BPACD_PwmInDia4" VALUE 0xCCA56 Kw_Wu8 20.00 OneToOne 0.00 20.00 FORMAT "%5.2" EXTENDED_LIMITS 0.00 255.0 /end CHARACTERISTIC
/begin CHARACTERISTIC DSM_ClaDfp_BPACD_SigNpl_C "Fehlerklasse fuer Fehlerpfad Dfp_BPACD_SigNpl" VALUE 0xCCA57 Kw_Wu8 20.00 OneToOne 0.00 20.00 FORMAT "%5.2" EXTENDED_LIMITS 0.00 255.0 /end CHARACTERISTIC
/begin CHARACTERISTIC DSM_ClaDfp_BPSCD_C "Fehlerklasse fuer Fehlerpfad Dfp_BPSCD" VALUE 0xCCA58 Kw_Wu8 20.00 OneToOne 0.00 20.00 FORMAT "%5.2" EXTENDED_LIMITS 0.00 255.0 /end CHARACTERISTIC
/begin CHARACTERISTIC DSM_ClaDfp_BattCD_C "Fehlerklasse fuer Fehlerpfad Dfp_BattCD" VALUE 0xCCA59 Kw_Wu8 20.00 OneToOne 0.00 20.00 FORMAT "%5.2" EXTENDED_LIMITS 0.00 255.0 /end CHARACTERISTIC
/begin CHARACTERISTIC DSM_ClaDfp_BrkCD_C "Fehlerklasse fuer Fehlerpfad Dfp_BrkCD" VALUE 0xCCA5A Kw_Wu8 20.00 OneToOne 0.00 20.00 FORMAT "%5.2" EXTENDED_LIMITS 0.00 255.0 /end CHARACTERISTIC
/begin CHARACTERISTIC DSM_ClaDfp_Bss_C "Fehlerklasse fuer Fehlerpfad Dfp_Bss" VALUE 0xCCA5B Kw_Wu8 20.00 OneToOne 0.00 20.00 FORMAT "%5.2" EXTENDED_LIMITS 0.00 255.0 /end CHARACTERISTIC
/begin CHARACTERISTIC DSM_ClaDfp_CBACD_C "Fehlerklasse fuer Fehlerpfad Dfp_CBACD" VALUE 0xCCA5C Kw_Wu8 20.00 OneToOne 0.00 20.00 FORMAT "%5.2" EXTENDED_LIMITS 0.00 255.0 /end CHARACTERISTIC
/begin CHARACTERISTIC DSM_ClaDfp_CTSCD_C "Fehlerklasse fuer Fehlerpfad Dfp_CTSCD" VALUE 0xCCA5D Kw_Wu8 20.00 OneToOne 0.00 20.00 FORMAT "%5.2" EXTENDED_LIMITS 0.00 255.0 /end CHARACTERISTIC
/begin CHARACTERISTIC DSM_ClaDfp_Clg_DynTst_C "Fehlerklasse fuer Fehlerpfad Dfp_Clg_DynTst" VALUE 0xCCA5E Kw_Wu8 20.00 OneToOne 0.00 20.00 FORMAT "%5.2" EXTENDED_LIMITS 0.00 255.0 /end CHARACTERISTIC
/begin CHARACTERISTIC DSM_ClaDfp_CmbChbMisfire1_C "Fehlerklasse fuer Fehlerpfad Dfp_CmbChbMisfire1" VALUE 0xCCA5F Kw_Wu8 20.00 OneToOne 0.00 20.00 FORMAT "%5.2" EXTENDED_LIMITS 0.00 255.0 /end CHARACTERISTIC
/begin CHARACTERISTIC DSM_ClaDfp_CmbChbMisfire2_C "Fehlerklasse fuer Fehlerpfad Dfp_CmbChbMisfire2" VALUE 0xCCA60 Kw_Wu8 20.00 OneToOne 0.00 20.00 FORMAT "%5.2" EXTENDED_LIMITS 0.00 255.0 /end CHARACTERISTIC
/begin CHARACTERISTIC DSM_ClaDfp_Layer_PMRUHVERL_C "Fehlerklasse fuer Fehlerpfad Dfp_Layer_PMRUHVERL" VALUE 0xCCA61 Kw_Wu8 20.00 OneToOne 0.00 20.00 FORMAT "%5.2" EXTENDED_LIMITS 0.00 255.0 /end CHARACTERISTIC
/begin CHARACTERISTIC DSM_ClaDfp_CmbChbMisfire3_C "Fehlerklasse fuer Fehlerpfad Dfp_CmbChbMisfire3" VALUE 0xCCA62 Kw_Wu8 20.00 OneToOne 0.00 20.00 FORMAT "%5.2" EXTENDED_LIMITS 0.00 255.0 /end CHARACTERISTIC
/begin CHARACTERISTIC DSM_ClaDfp_CmbChbMisfire4_C "Fehlerklasse fuer Fehlerpfad Dfp_CmbChbMisfire4" VALUE 0xCCA63 Kw_Wu8 20.00 OneToOne 0.00 20.00 FORMAT "%5.2" EXTENDED_LIMITS 0.00 255.0 /end CHARACTERISTIC
/begin CHARACTERISTIC DSM_ClaDfp_CmbChbMisfire5_C "Fehlerklasse fuer Fehlerpfad Dfp_CmbChbMisfire5" VALUE 0xCCA64 Kw_Wu8 20.00 OneToOne 0.00 20.00 FORMAT "%5.2" EXTENDED_LIMITS 0.00 255.0 /end CHARACTERISTIC
/begin CHARACTERISTIC DSM_ClaDfp_CmbChbMisfire6_C "Fehlerklasse fuer Fehlerpfad Dfp_CmbChbMisfire6" VALUE 0xCCA65 Kw_Wu8 20.00 OneToOne 0.00 20.00 FORMAT "%5.2" EXTENDED_LIMITS 0.00 255.0 /end CHARACTERISTIC
/begin CHARACTERISTIC DSM_ClaDfp_Layer_TOENS_C "Fehlerklasse fuer Fehlerpfad Dfp_Layer_TOENS" VALUE 0xCCA66 Kw_Wu8 20.00 OneToOne 0.00 20.00 FORMAT "%5.2" EXTENDED_LIMITS 0.00 255.0 /end CHARACTERISTIC
/begin CHARACTERISTIC DSM_ClaDfp_Layer_MANHYDR_C "Fehlerklasse fuer Fehlerpfad Dfp_Layer_MANHYDR" VALUE 0xCCA67 Kw_Wu8 20.00 OneToOne 0.00 20.00 FORMAT "%5.2" EXTENDED_LIMITS 0.00 255.0 /end CHARACTERISTIC
/begin CHARACTERISTIC DSM_ClaDfp_Layer_MANLUFT_C "Fehlerklasse fuer Fehlerpfad Dfp_Layer_MANLUFT" VALUE 0xCCA68 Kw_Wu8 20.00 OneToOne 0.00 20.00 FORMAT "%5.2" EXTENDED_LIMITS 0.00 255.0 /end CHARACTERISTIC
/begin CHARACTERISTIC DSM_ClaDfp_CmbChbMisfireMul_C "Fehlerklasse fuer Fehlerpfad Dfp_CmbChb_MisfireMul" VALUE 0xCCA69 Kw_Wu8 20.00 OneToOne 0.00 20.00 FORMAT "%5.2" EXTENDED_LIMITS 0.00 255.0 /end CHARACTERISTIC
/begin CHARACTERISTIC DSM_ClaDfp_CoVMDCSh_C "Fehlerklasse fuer Fehlerpfad Dfp_CoVMDCSh" VALUE 0xCCA6A Kw_Wu8 20.00 OneToOne 0.00 20.00 FORMAT "%5.2" EXTENDED_LIMITS 0.00 255.0 /end CHARACTERISTIC
/begin CHARACTERISTIC DSM_ClaDfp_ConvCD_C "Fehlerklasse fuer Fehlerpfad Dfp_ConvCD" VALUE 0xCCA6B Kw_Wu8 20.00 OneToOne 0.00 20.00 FORMAT "%5.2" EXTENDED_LIMITS 0.00 255.0 /end CHARACTERISTIC
/begin CHARACTERISTIC DSM_ClaDfp_CrCCDMFL_C "Fehlerklasse fuer Fehlerpfad Dfp_CrCCDMFL" VALUE 0xCCA6C Kw_Wu8 20.00 OneToOne 0.00 20.00 FORMAT "%5.2" EXTENDED_LIMITS 0.00 255.0 /end CHARACTERISTIC
/begin CHARACTERISTIC DSM_ClaDfp_CrCtl_vCrCtl_C "Fehlerklasse fuer Fehlerpfad Dfp_CrCtl_vCrCtl" VALUE 0xCCA6D Kw_Wu8 20.00 OneToOne 0.00 20.00 FORMAT "%5.2" EXTENDED_LIMITS 0.00 255.0 /end CHARACTERISTIC
/begin CHARACTERISTIC DSM_ClaDfp_DCC_PlausTrqDes_C "Fehlerklasse fuer Fehlerpfad Dfp_DCC_PlausTrqDes" VALUE 0xCCA6E Kw_Wu8 20.00 OneToOne 0.00 20.00 FORMAT "%5.2" EXTENDED_LIMITS 0.00 255.0 /end CHARACTERISTIC
/begin CHARACTERISTIC DSM_ClaDfp_Dummy1_C "Fehlerklasse fuer Fehlerpfad Dfp_Dummy1" VALUE 0xCCA6F Kw_Wu8 20.00 OneToOne 0.00 20.00 FORMAT "%5.2" EXTENDED_LIMITS 0.00 255.0 /end CHARACTERISTIC
/begin CHARACTERISTIC DSM_ClaDfp_EATSCD_C "Fehlerklasse fuer Fehlerpfad Dfp_EATSCD" VALUE 0xCCA70 Kw_Wu8 20.00 OneToOne 0.00 20.00 FORMAT "%5.2" EXTENDED_LIMITS 0.00 255.0 /end CHARACTERISTIC
/begin CHARACTERISTIC DSM_ClaDfp_EBAFCD_C "Fehlerklasse fuer Fehlerpfad Dfp_EBAFCD" VALUE 0xCCA71 Kw_Wu8 20.00 OneToOne 0.00 20.00 FORMAT "%5.2" EXTENDED_LIMITS 0.00 255.0 /end CHARACTERISTIC
/begin CHARACTERISTIC DSM_ClaDfp_EBFCD_C "Fehlerklasse fuer Fehlerpfad Dfp_EBFCD" VALUE 0xCCA72 Kw_Wu8 20.00 OneToOne 0.00 20.00 FORMAT "%5.2" EXTENDED_LIMITS 0.00 255.0 /end CHARACTERISTIC
/begin CHARACTERISTIC DSM_ClaDfp_EBTSCD_C "Fehlerklasse fuer Fehlerpfad Dfp_EBTSCD" VALUE 0xCCA73 Kw_Wu8 20.00 OneToOne 0.00 20.00 FORMAT "%5.2" EXTENDED_LIMITS 0.00 255.0 /end CHARACTERISTIC
/begin CHARACTERISTIC DSM_ClaDfp_EBTSCD_OvrTemp_C "Fehlerklasse fuer Fehlerpfad Dfp_EBTSCD_OvrTemp" VALUE 0xCCA74 Kw_Wu8 20.00 OneToOne 0.00 20.00 FORMAT "%5.2" EXTENDED_LIMITS 0.00 255.0 /end CHARACTERISTIC
/begin CHARACTERISTIC DSM_ClaDfp_ECBCD_C "Fehlerklasse fuer Fehlerpfad Dfp_ECBCD" VALUE 0xCCA75 Kw_Wu8 20.00 OneToOne 0.00 20.00 FORMAT "%5.2" EXTENDED_LIMITS 0.00 255.0 /end CHARACTERISTIC
/begin CHARACTERISTIC DSM_ClaDfp_EEPCDVarMng_C "Fehlerklasse fuer Fehlerpfad Dfp_EEPCDVarMng" VALUE 0xCCA76 Kw_Wu8 20.00 OneToOne 0.00 20.00 FORMAT "%5.2" EXTENDED_LIMITS 0.00 255.0 /end CHARACTERISTIC
/begin CHARACTERISTIC DSM_ClaDfp_EGPpCD_C "Fehlerklassen fuer Fehlerpfad Dfp_EGPpCD" VALUE 0xCCA77 Kw_Wu8 20.00 OneToOne 0.00 20.00 FORMAT "%5.2" EXTENDED_LIMITS 0.00 255.0 /end CHARACTERISTIC
/begin CHARACTERISTIC DSM_ClaDfp_EGPpCDTPreTrbn_C "Fehlerklasse fuer Fehlerpfad Dfp_EgPpCDTPreTrbn" VALUE 0xCCA78 Kw_Wu8 20.00 OneToOne 0.00 20.00 FORMAT "%5.2" EXTENDED_LIMITS 0.00 255.0 /end CHARACTERISTIC
/begin CHARACTERISTIC DSM_ClaDfp_EGRCD_Max_C "Fehlerklasse fuer Fehlerpfad Dfp_EGRCD_Max" VALUE 0xCCA79 Kw_Wu8 20.00 OneToOne 0.00 20.00 FORMAT "%5.2" EXTENDED_LIMITS 0.00 255.0 /end CHARACTERISTIC
/begin CHARACTERISTIC DSM_ClaDfp_EGRCD_Min_C "Fehlerklasse fuer Fehlerpfad Dfp_EGRCD_Min" VALUE 0xCCA7A Kw_Wu8 20.00 OneToOne 0.00 20.00 FORMAT "%5.2" EXTENDED_LIMITS 0.00 255.0 /end CHARACTERISTIC
/begin CHARACTERISTIC DSM_ClaDfp_EGRCD_SigNpl_C "Fehlerklasse fuer Fehlerpfad Dfp_EGRCD_SigNpl" VALUE 0xCCA7B Kw_Wu8 20.00 OneToOne 0.00 20.00 FORMAT "%5.2" EXTENDED_LIMITS 0.00 255.0 /end CHARACTERISTIC
/begin CHARACTERISTIC DSM_ClaDfp_EGTOilLvlCrit_C "Fehlerklasse fuer Fehlerpfad Dfp_EGTOilLvlCrit" VALUE 0xCCA7C Kw_Wu8 20.00 OneToOne 0.00 20.00 FORMAT "%5.2" EXTENDED_LIMITS 0.00 255.0 /end CHARACTERISTIC
/begin CHARACTERISTIC DSM_ClaDfp_EGTOilVscCrit_C "Fehlerklasse fuer Fehlerpfad Dfp_EGTOilVscCrit" VALUE 0xCCA7D Kw_Wu8 20.00 OneToOne 0.00 20.00 FORMAT "%5.2" EXTENDED_LIMITS 0.00 255.0 /end CHARACTERISTIC
/begin CHARACTERISTIC DSM_ClaDfp_EGTRgnOilDil_C "Fehlerklasse fuer Fehlerpfad Dfp_EGTRgnOilDil" VALUE 0xCCA7E Kw_Wu8 20.00 OneToOne 0.00 20.00 FORMAT "%5.2" EXTENDED_LIMITS 0.00 255.0 /end CHARACTERISTIC
/begin CHARACTERISTIC DSM_ClaDfp_EGTTempGvnrInr_C "Fehlerklasse fuer Fehlerpfad Dfp_EGTTempGvnrInr" VALUE 0xCCA7F Kw_Wu8 20.00 OneToOne 0.00 20.00 FORMAT "%5.2" EXTENDED_LIMITS 0.00 255.0 /end CHARACTERISTIC
/begin CHARACTERISTIC DSM_ClaDfp_EGTTempGvnrOutr_C "Fehlerklasse fuer Fehlerpfad Dfp_EGTTempGvnrOutr" VALUE 0xCCA80 Kw_Wu8 20.00 OneToOne 0.00 20.00 FORMAT "%5.2" EXTENDED_LIMITS 0.00 255.0 /end CHARACTERISTIC
/begin CHARACTERISTIC DSM_ClaDfp_EMCCD1_C "Fehlerklasse fuer Fehlerpfad Dfp_EMCCD1" VALUE 0xCCA81 Kw_Wu8 20.00 OneToOne 0.00 20.00 FORMAT "%5.2" EXTENDED_LIMITS 0.00 255.0 /end CHARACTERISTIC
/begin CHARACTERISTIC DSM_ClaDfp_EMCCD2_C "Fehlerklasse fuer Fehlerpfad Dfp_EMCCD2" VALUE 0xCCA82 Kw_Wu8 20.00 OneToOne 0.00 20.00 FORMAT "%5.2" EXTENDED_LIMITS 0.00 255.0 /end CHARACTERISTIC
/begin CHARACTERISTIC DSM_ClaDfp_EMCCD_ADC1_C "Fehlerklasse fuer Fehlerpfad Dfp_EMCCD_ADC1" VALUE 0xCCA83 Kw_Wu8 20.00 OneToOne 0.00 20.00 FORMAT "%5.2" EXTENDED_LIMITS 0.00 255.0 /end CHARACTERISTIC
/begin CHARACTERISTIC DSM_ClaDfp_EMCCD_ADC2_C "Fehlerklasse fuer Fehlerpfad Dfp_EMCCD_ADC2" VALUE 0xCCA84 Kw_Wu8 20.00 OneToOne 0.00 20.00 FORMAT "%5.2" EXTENDED_LIMITS 0.00 255.0 /end CHARACTERISTIC
/begin CHARACTERISTIC DSM_ClaDfp_ETClbETFltInj1_C "Fehlerklasse fuer Fehlerpfad Dfp_ETClbETFltInj1" VALUE 0xCCA85 Kw_Wu8 20.00 OneToOne 0.00 20.00 FORMAT "%5.2" EXTENDED_LIMITS 0.00 255.0 /end CHARACTERISTIC
/begin CHARACTERISTIC DSM_ClaDfp_ETClbETFltInj2_C "Fehlerklasse fuer Fehlerpfad Dfp_ETClbETFltInj2" VALUE 0xCCA86 Kw_Wu8 20.00 OneToOne 0.00 20.00 FORMAT "%5.2" EXTENDED_LIMITS 0.00 255.0 /end CHARACTERISTIC
/begin CHARACTERISTIC DSM_ClaDfp_ETClbETFltInj3_C "Fehlerklasse fuer Fehlerpfad Dfp_ETClbETFltInj3" VALUE 0xCCA87 Kw_Wu8 20.00 OneToOne 0.00 20.00 FORMAT "%5.2" EXTENDED_LIMITS 0.00 255.0 /end CHARACTERISTIC
/begin CHARACTERISTIC DSM_ClaDfp_ETClbETFltInj4_C "Fehlerklasse fuer Fehlerpfad Dfp_ETClbETFltInj4" VALUE 0xCCA88 Kw_Wu8 20.00 OneToOne 0.00 20.00 FORMAT "%5.2" EXTENDED_LIMITS 0.00 255.0 /end CHARACTERISTIC
/begin CHARACTERISTIC DSM_ClaDfp_ETClbETFltInj5_C "Fehlerklasse fuer Fehlerpfad Dfp_ETClbETFltInj5" VALUE 0xCCA89 Kw_Wu8 20.00 OneToOne 0.00 20.00 FORMAT "%5.2" EXTENDED_LIMITS 0.00 255.0 /end CHARACTERISTIC
/begin CHARACTERISTIC DSM_ClaDfp_ETClbETFltInj6_C "Fehlerklasse fuer Fehlerpfad Dfp_ETClbETFltInj6" VALUE 0xCCA8A Kw_Wu8 20.00 OneToOne 0.00 20.00 FORMAT "%5.2" EXTENDED_LIMITS 0.00 255.0 /end CHARACTERISTIC
/begin CHARACTERISTIC DSM_ClaDfp_ETClbInj1_C "Fehlerklasse fuer Fehlerpfad Dfp_ETClbInj1" VALUE 0xCCA8B Kw_Wu8 20.00 OneToOne 0.00 20.00 FORMAT "%5.2" EXTENDED_LIMITS 0.00 255.0 /end CHARACTERISTIC
/begin CHARACTERISTIC DSM_ClaDfp_ETClbInj2_C "Fehlerklasse fuer Fehlerpfad Dfp_ETClbInj2" VALUE 0xCCA8C Kw_Wu8 20.00 OneToOne 0.00 20.00 FORMAT "%5.2" EXTENDED_LIMITS 0.00 255.0 /end CHARACTERISTIC
/begin CHARACTERISTIC DSM_ClaDfp_ETClbInj3_C "Fehlerklasse fuer Fehlerpfad Dfp_ETClbInj3" VALUE 0xCCA8D Kw_Wu8 20.00 OneToOne 0.00 20.00 FORMAT "%5.2" EXTENDED_LIMITS 0.00 255.0 /end CHARACTERISTIC
/begin CHARACTERISTIC DSM_ClaDfp_ETClbInj4_C "Fehlerklasse fuer Fehlerpfad Dfp_ETClbInj4" VALUE 0xCCA8E Kw_Wu8 20.00 OneToOne 0.00 20.00 FORMAT "%5.2" EXTENDED_LIMITS 0.00 255.0 /end CHARACTERISTIC
/begin CHARACTERISTIC DSM_ClaDfp_ETClbInj5_C "Fehlerklasse fuer Fehlerpfad Dfp_ETClbInj5" VALUE 0xCCA8F Kw_Wu8 20.00 OneToOne 0.00 20.00 FORMAT "%5.2" EXTENDED_LIMITS 0.00 255.0 /end CHARACTERISTIC
/begin CHARACTERISTIC DSM_ClaDfp_ETClbInj6_C "Fehlerklasse fuer Fehlerpfad Dfp_ETClbInj6" VALUE 0xCCA90 Kw_Wu8 20.00 OneToOne 0.00 20.00 FORMAT "%5.2" EXTENDED_LIMITS 0.00 255.0 /end CHARACTERISTIC
/begin CHARACTERISTIC DSM_ClaDfp_EngMCaS1_C "Fehlerklasse fuer Fehlerpfad Dfp_EngMCaS1" VALUE 0xCCA91 Kw_Wu8 20.00 OneToOne 0.00 20.00 FORMAT "%5.2" EXTENDED_LIMITS 0.00 255.0 /end CHARACTERISTIC
/begin CHARACTERISTIC DSM_ClaDfp_EngMCrS1_C "Fehlerklasse fuer Fehlerpfad Dfp_EngMCrS1" VALUE 0xCCA92 Kw_Wu8 20.00 OneToOne 0.00 20.00 FORMAT "%5.2" EXTENDED_LIMITS 0.00 255.0 /end CHARACTERISTIC
/begin CHARACTERISTIC DSM_ClaDfp_EngMOfsCaSCrS_C "Fehlerklasse fuer Fehlerpfad Dfp_EngMOfsCaSCrS" VALUE 0xCCA93 Kw_Wu8 20.00 OneToOne 0.00 20.00 FORMAT "%5.2" EXTENDED_LIMITS 0.00 255.0 /end CHARACTERISTIC
/begin CHARACTERISTIC DSM_ClaDfp_EngPrtFWODet_C "Fehlerklasse fuer Fehlerpfad Dfp_EngPrtFWODet" VALUE 0xCCA94 Kw_Wu8 20.00 OneToOne 0.00 20.00 FORMAT "%5.2" EXTENDED_LIMITS 0.00 255.0 /end CHARACTERISTIC
/begin CHARACTERISTIC DSM_ClaDfp_FBCqDvt_C "Fehlerklasse fuer Fehlerpfad Dfp_FBCqDvt" VALUE 0xCCA95 Kw_Wu8 20.00 OneToOne 0.00 20.00 FORMAT "%5.2" EXTENDED_LIMITS 0.00 255.0 /end CHARACTERISTIC
/begin CHARACTERISTIC DSM_ClaDfp_FMAErrMod_C "Fehlerklasse fuer Fehlerpfad Dfp_FMAErrMod" VALUE 0xCCA96 Kw_Wu8 20.00 OneToOne 0.00 20.00 FORMAT "%5.2" EXTENDED_LIMITS 0.00 255.0 /end CHARACTERISTIC
/begin CHARACTERISTIC DSM_ClaDfp_FMTC_NonMonotonMap_C "Fehlerklasse fuer Fehlerpfad Dfp_FMTC_NonMonotonMap" VALUE 0xCCA97 Kw_Wu8 20.00 OneToOne 0.00 20.00 FORMAT "%5.2" EXTENDED_LIMITS 0.00 255.0 /end CHARACTERISTIC
/begin CHARACTERISTIC DSM_ClaDfp_FTSCD_C "Fehlerklasse fuer Fehlerpfad Dfp_FTSCD" VALUE 0xCCA98 Kw_Wu8 20.00 OneToOne 0.00 20.00 FORMAT "%5.2" EXTENDED_LIMITS 0.00 255.0 /end CHARACTERISTIC
/begin CHARACTERISTIC DSM_ClaDfp_FanCD_C "Fehlerklasse fuer Fehlerpfad Dfp_FanCD" VALUE 0xCCA99 Kw_Wu8 20.00 OneToOne 0.00 20.00 FORMAT "%5.2" EXTENDED_LIMITS 0.00 255.0 /end CHARACTERISTIC
/begin CHARACTERISTIC DSM_ClaDfp_FanCD_FanCtlr1_C "Fehlerklasse fuer Fehlerpfad Dfp_FanCD_FanCtlr1" VALUE 0xCCA9A Kw_Wu8 20.00 OneToOne 0.00 20.00 FORMAT "%5.2" EXTENDED_LIMITS 0.00 255.0 /end CHARACTERISTIC
/begin CHARACTERISTIC DSM_ClaDfp_FanCD_FanCtlr2_C "Fehlerklasse fuer Fehlerpfad Dfp_FanCD_FanCtlr2" VALUE 0xCCA9B Kw_Wu8 20.00 OneToOne 0.00 20.00 FORMAT "%5.2" EXTENDED_LIMITS 0.00 255.0 /end CHARACTERISTIC
/begin CHARACTERISTIC DSM_ClaDfp_FanCD_FanCtlr3_C "Fehlerklasse fuer Fehlerpfad Dfp_FanCD_FanCtlr3" VALUE 0xCCA9C Kw_Wu8 20.00 OneToOne 0.00 20.00 FORMAT "%5.2" EXTENDED_LIMITS 0.00 255.0 /end CHARACTERISTIC
/begin CHARACTERISTIC DSM_ClaDfp_FlFCD_C "Fehlerklasse fuer Fehlerpfad Dfp_FlFCD" VALUE 0xCCA9D Kw_Wu8 20.00 OneToOne 0.00 20.00 FORMAT "%5.2" EXTENDED_LIMITS 0.00 255.0 /end CHARACTERISTIC
/begin CHARACTERISTIC DSM_ClaDfp_FlMngSmkDefect_C "Fehlerklasse fuer Fehlerpfad Dfp_FlMngSmkDefect" VALUE 0xCCA9E Kw_Wu8 20.00 OneToOne 0.00 20.00 FORMAT "%5.2" EXTENDED_LIMITS 0.00 255.0 /end CHARACTERISTIC
/begin CHARACTERISTIC DSM_ClaDfp_FrmMngANFRADMOMPT_C "Fehlerklasse fuer Fehlerpfad Dfp_FrmMngANFRADMOMPT" VALUE 0xCCA9F Kw_Wu8 20.00 OneToOne 0.00 20.00 FORMAT "%5.2" EXTENDED_LIMITS 0.00 255.0 /end CHARACTERISTIC
/begin CHARACTERISTIC DSM_ClaDfp_FrmMngASC1_C "Fehlerklasse fuer Fehlerpfad Dfp_FrmMngASC1" VALUE 0xCCAA0 Kw_Wu8 20.00 OneToOne 0.00 20.00 FORMAT "%5.2" EXTENDED_LIMITS 0.00 255.0 /end CHARACTERISTIC
/begin CHARACTERISTIC DSM_ClaDfp_FrmMngASC2_C "Fehlerklasse fuer Fehlerpfad Dfp_FrmMngASC2" VALUE 0xCCAA1 Kw_Wu8 20.00 OneToOne 0.00 20.00 FORMAT "%5.2" EXTENDED_LIMITS 0.00 255.0 /end CHARACTERISTIC
/begin CHARACTERISTIC DSM_ClaDfp_FrmMngASC3_C "Fehlerklasse fuer Fehlerpfad Dfp_FrmMngASC3" VALUE 0xCCAA2 Kw_Wu8 20.00 OneToOne 0.00 20.00 FORMAT "%5.2" EXTENDED_LIMITS 0.00 255.0 /end CHARACTERISTIC
/begin CHARACTERISTIC DSM_ClaDfp_FrmMngASC4_C "Fehlerklasse fuer Fehlerpfad Dfp_FrmMngASC4" VALUE 0xCCAA3 Kw_Wu8 20.00 OneToOne 0.00 20.00 FORMAT "%5.2" EXTENDED_LIMITS 0.00 255.0 /end CHARACTERISTIC
/begin CHARACTERISTIC DSM_ClaDfp_FrmMngBOS_RESET_C "Fehlerklasse fuer Fehlerpfad Dfp_FrmMngBOS_RESET" VALUE 0xCCAA4 Kw_Wu8 20.00 OneToOne 0.00 20.00 FORMAT "%5.2" EXTENDED_LIMITS 0.00 255.0 /end CHARACTERISTIC
/begin CHARACTERISTIC DSM_ClaDfp_FrmMngBOS_RESET2_C "Fehlerklasse fuer Fehlerpfad Dfp_FrmMngBOS_RESET2" VALUE 0xCCAA5 Kw_Wu8 20.00 OneToOne 0.00 20.00 FORMAT "%5.2" EXTENDED_LIMITS 0.00 255.0 /end CHARACTERISTIC
/begin CHARACTERISTIC DSM_ClaDfp_FrmMngDMANFAFS_C "Fehlerklasse fuer Fehlerpfad Dfp_FrmMngDMANFAFS" VALUE 0xCCAA6 Kw_Wu8 20.00 OneToOne 0.00 20.00 FORMAT "%5.2" EXTENDED_LIMITS 0.00 255.0 /end CHARACTERISTIC
/begin CHARACTERISTIC DSM_ClaDfp_FrmMngDRMANFSSG_C "Fehlerklasse fuer Fehlerpfad Dfp_FrmMngDRMANFSSG" VALUE 0xCCAA7 Kw_Wu8 20.00 OneToOne 0.00 20.00 FORMAT "%5.2" EXTENDED_LIMITS 0.00 255.0 /end CHARACTERISTIC
/begin CHARACTERISTIC DSM_ClaDfp_FrmMngEGS1_C "Fehlerklasse fuer Fehlerpfad Dfp_FrmMngEGS1" VALUE 0xCCAA8 Kw_Wu8 20.00 OneToOne 0.00 20.00 FORMAT "%5.2" EXTENDED_LIMITS 0.00 255.0 /end CHARACTERISTIC
/begin CHARACTERISTIC DSM_ClaDfp_FrmMngEGS2_C "Fehlerklasse fuer Fehlerpfad Dfp_FrmMngEGS2" VALUE 0xCCAA9 Kw_Wu8 20.00 OneToOne 0.00 20.00 FORMAT "%5.2" EXTENDED_LIMITS 0.00 255.0 /end CHARACTERISTIC
/begin CHARACTERISTIC DSM_ClaDfp_FrmMngGEARBX_DATA_C "class for path" VALUE 0xCCAAA Kw_Wu8 20.00 OneToOne 0.00 20.00 FORMAT "%5.2" EXTENDED_LIMITS 0.00 255.0 /end CHARACTERISTIC
/begin CHARACTERISTIC DSM_ClaDfp_FrmMngGEARBX_DATA2_C "Fehlerklasse fuer Fehlerpfad Dfp_FrmMngGEARBX_DATA2" VALUE 0xCCAAB Kw_Wu8 20.00 OneToOne 0.00 20.00 FORMAT "%5.2" EXTENDED_LIMITS 0.00 255.0 /end CHARACTERISTIC
/begin CHARACTERISTIC DSM_ClaDfp_FrmMngHEAT_AC_C "class for path" VALUE 0xCCAAC Kw_Wu8 20.00 OneToOne 0.00 20.00 FORMAT "%5.2" EXTENDED_LIMITS 0.00 255.0 /end CHARACTERISTIC
/begin CHARACTERISTIC DSM_ClaDfp_FrmMngINSTR2_C "Fehlerklasse fuer Fehlerpfad Dfp_FrmMngINSTR2" VALUE 0xCCAAD Kw_Wu8 20.00 OneToOne 0.00 20.00 FORMAT "%5.2" EXTENDED_LIMITS 0.00 255.0 /end CHARACTERISTIC
/begin CHARACTERISTIC DSM_ClaDfp_FrmMngINSTR3_C "Fehlerklasse fuer Fehlerpfad Dfp_FrmMngINSTR3" VALUE 0xCCAAE Kw_Wu8 20.00 OneToOne 0.00 20.00 FORMAT "%5.2" EXTENDED_LIMITS 0.00 255.0 /end CHARACTERISTIC
/begin CHARACTERISTIC DSM_ClaDfp_FrmMngLENKRADWINKEL_C "Fehlerklasse fuer Fehlerpfad Dfp_FrmMngLENKRADWINKEL" VALUE 0xCCAAF Kw_Wu8 20.00 OneToOne 0.00 20.00 FORMAT "%5.2" EXTENDED_LIMITS 0.00 255.0 /end CHARACTERISTIC
/begin CHARACTERISTIC DSM_ClaDfp_FrmMngMILEAGE_RANGE_C "Fehlerklasse fuer Fehlerpfad Dfp_FrmMngMILEAGE_RANGE" VALUE 0xCCAB0 Kw_Wu8 20.00 OneToOne 0.00 20.00 FORMAT "%5.2" EXTENDED_LIMITS 0.00 255.0 /end CHARACTERISTIC
/begin CHARACTERISTIC DSM_ClaDfp_FrmMngOPCRCTLACC_C "Fehlerklasse fuer Fehlerpfad Dfp_FrmMngOPCRCTLACC" VALUE 0xCCAB1 Kw_Wu8 20.00 OneToOne 0.00 20.00 FORMAT "%5.2" EXTENDED_LIMITS 0.00 255.0 /end CHARACTERISTIC
/begin CHARACTERISTIC DSM_ClaDfp_FrmMngPRGG_CCTR_C "Fehlerklasse fuer Fehlerpfad Dfp_FrmMngPRGG_CCTR" VALUE 0xCCAB2 Kw_Wu8 20.00 OneToOne 0.00 20.00 FORMAT "%5.2" EXTENDED_LIMITS 0.00 255.0 /end CHARACTERISTIC
/begin CHARACTERISTIC DSM_ClaDfp_FrmMngPWRMNG_LOADV_C "Fehlerklasse fuer Fehlerpfad Dfp_FrmMngPWRMNG_LOADV" VALUE 0xCCAB3 Kw_Wu8 20.00 OneToOne 0.00 20.00 FORMAT "%5.2" EXTENDED_LIMITS 0.00 255.0 /end CHARACTERISTIC
/begin CHARACTERISTIC DSM_ClaDfp_FrmMngParkConsumer_C "Fehlerklasse fuer Fehlerpfad Dfp_FrmMngParkConsumer" VALUE 0xCCAB4 Kw_Wu8 20.00 OneToOne 0.00 20.00 FORMAT "%5.2" EXTENDED_LIMITS 0.00 255.0 /end CHARACTERISTIC
/begin CHARACTERISTIC DSM_ClaDfp_FrmMngRQSTGEFAN_C "Fehlerklasse fuer Fehlerpfad Dfp_FrmMngRQSTGEFAN_C" VALUE 0xCCAB5 Kw_Wu8 20.00 OneToOne 0.00 20.00 FORMAT "%5.2" EXTENDED_LIMITS 0.00 255.0 /end CHARACTERISTIC
/begin CHARACTERISTIC DSM_ClaDfp_FrmMngSSGErr_C "Fehlerklasse fuer Fehlerpfad Dfp_FrmMngSSGErr" VALUE 0xCCAB6 Kw_Wu8 20.00 OneToOne 0.00 20.00 FORMAT "%5.2" EXTENDED_LIMITS 0.00 255.0 /end CHARACTERISTIC
/begin CHARACTERISTIC DSM_ClaDfp_FrmMngSSGShOff_C "Fehlerklasse fuer Fehlerpfad Dfp_FrmMngSSGShOff" VALUE 0xCCAB7 Kw_Wu8 20.00 OneToOne 0.00 20.00 FORMAT "%5.2" EXTENDED_LIMITS 0.00 255.0 /end CHARACTERISTIC
/begin CHARACTERISTIC DSM_ClaDfp_FrmMngSTAT_ANH_C "Fehlerklasse fuer Fehlerpfad Dfp_FrmMngSTAT_ANH" VALUE 0xCCAB8 Kw_Wu8 20.00 OneToOne 0.00 20.00 FORMAT "%5.2" EXTENDED_LIMITS 0.00 255.0 /end CHARACTERISTIC
/begin CHARACTERISTIC DSM_ClaDfp_FrmMngSTAT_ARS_C "class for path" VALUE 0xCCAB9 Kw_Wu8 20.00 OneToOne 0.00 20.00 FORMAT "%5.2" EXTENDED_LIMITS 0.00 255.0 /end CHARACTERISTIC
/begin CHARACTERISTIC DSM_ClaDfp_FrmMngSTAT_DSC_C "class for path" VALUE 0xCCABA Kw_Wu8 20.00 OneToOne 0.00 20.00 FORMAT "%5.2" EXTENDED_LIMITS 0.00 255.0 /end CHARACTERISTIC
/begin CHARACTERISTIC DSM_ClaDfp_FrmMngSTAT_EKP_C "Fehlerklasse fuer Fehlerpfad Dfp_FrmMngSTAT_EKP" VALUE 0xCCABB Kw_Wu8 20.00 OneToOne 0.00 20.00 FORMAT "%5.2" EXTENDED_LIMITS 0.00 255.0 /end CHARACTERISTIC
/begin CHARACTERISTIC DSM_ClaDfp_FrmMngSTAT_KOMBI_C "Fehlerklasse fuer Fehlerpfad Dfp_FrmMngSTAT_KOMBI" VALUE 0xCCABC Kw_Wu8 20.00 OneToOne 0.00 20.00 FORMAT "%5.2" EXTENDED_LIMITS 0.00 255.0 /end CHARACTERISTIC
/begin CHARACTERISTIC DSM_ClaDfp_FrmMngSTAT_SITZ_C "Fehlerklasse fuer Fehlerpfad Dfp_FrmMngSTAT_SITZ" VALUE 0xCCABD Kw_Wu8 20.00 OneToOne 0.00 20.00 FORMAT "%5.2" EXTENDED_LIMITS 0.00 255.0 /end CHARACTERISTIC
/begin CHARACTERISTIC DSM_ClaDfp_FrmMngStOBDGbxMilOf_C "Fehlerklasse fuer Fehlerpfad Dfp_FrmMngStOBDGbxMilOf" VALUE 0xCCABE Kw_Wu8 20.00 OneToOne 0.00 20.00 FORMAT "%5.2" EXTENDED_LIMITS 0.00 255.0 /end CHARACTERISTIC
/begin CHARACTERISTIC DSM_ClaDfp_FrmMngStOBDGbxMilOn_C "Fehlerklasse fuer Fehlerpfad Dfp_FrmMngStOBDGbxMilOn" VALUE 0xCCABF Kw_Wu8 20.00 OneToOne 0.00 20.00 FORMAT "%5.2" EXTENDED_LIMITS 0.00 255.0 /end CHARACTERISTIC
/begin CHARACTERISTIC DSM_ClaDfp_FrmMngTEMPRELTIME_C "Fehlerklasse fuer Fehlerpfad Dfp_FrmMngTEMPRELTIME" VALUE 0xCCAC0 Kw_Wu8 20.00 OneToOne 0.00 20.00 FORMAT "%5.2" EXTENDED_LIMITS 0.00 255.0 /end CHARACTERISTIC
/begin CHARACTERISTIC DSM_ClaDfp_FrmMngTERMINAL_C "class for path" VALUE 0xCCAC1 Kw_Wu8 20.00 OneToOne 0.00 20.00 FORMAT "%5.2" EXTENDED_LIMITS 0.00 255.0 /end CHARACTERISTIC
/begin CHARACTERISTIC DSM_ClaDfp_FrmMngTIME_DATE_C "Fehlerklasse fuer Fehlerpfad Dfp_FrmMngTIME_DATE" VALUE 0xCCAC2 Kw_Wu8 20.00 OneToOne 0.00 20.00 FORMAT "%5.2" EXTENDED_LIMITS 0.00 255.0 /end CHARACTERISTIC
/begin CHARACTERISTIC DSM_ClaDfp_FrmMngTORQUE_DSC_C "class for path" VALUE 0xCCAC3 Kw_Wu8 20.00 OneToOne 0.00 20.00 FORMAT "%5.2" EXTENDED_LIMITS 0.00 255.0 /end CHARACTERISTIC
/begin CHARACTERISTIC DSM_ClaDfp_FrmMngTORQUE_GEARBX_C "class for path" VALUE 0xCCAC4 Kw_Wu8 20.00 OneToOne 0.00 20.00 FORMAT "%5.2" EXTENDED_LIMITS 0.00 255.0 /end CHARACTERISTIC
/begin CHARACTERISTIC DSM_ClaDfp_FrmMngTrq_ReqACC_C "Fehlerklasse fuer Fehlerpfad Dfp_FrmMngTrq_ReqACC" VALUE 0xCCAC5 Kw_Wu8 20.00 OneToOne 0.00 20.00 FORMAT "%5.2" EXTENDED_LIMITS 0.00 255.0 /end CHARACTERISTIC
/begin CHARACTERISTIC DSM_ClaDfp_FrmMngVEH_MOD_C "Fehlerklasse fuer Fehlerpfad Dfp_FrmMngVEH_MOD_C" VALUE 0xCCAC6 Kw_Wu8 20.00 OneToOne 0.00 20.00 FORMAT "%5.2" EXTENDED_LIMITS 0.00 255.0 /end CHARACTERISTIC
/begin CHARACTERISTIC DSM_ClaDfp_FrmMngVELOCITY_C "class for path" VALUE 0xCCAC7 Kw_Wu8 20.00 OneToOne 0.00 20.00 FORMAT "%5.2" EXTENDED_LIMITS 0.00 255.0 /end CHARACTERISTIC
/begin CHARACTERISTIC DSM_ClaDfp_FrmMngWHEEL_SPEED_C "Fehlerklasse fuer Fehlerpfad Dfp_FrmMngWHEEL_SPEED" VALUE 0xCCAC8 Kw_Wu8 20.00 OneToOne 0.00 20.00 FORMAT "%5.2" EXTENDED_LIMITS 0.00 255.0 /end CHARACTERISTIC
/begin CHARACTERISTIC DSM_ClaDfp_FrmMngstCurr_C "Fehlerklasse für Dfp_FrmMngstCurr" VALUE 0xCCAC9 Kw_Wu8 20.00 OneToOne 0.00 20.00 FORMAT "%5.2" EXTENDED_LIMITS 0.00 255.0 /end CHARACTERISTIC
/begin CHARACTERISTIC DSM_ClaDfp_FrmMngswtPSPOff_C "Fehlerklasse für Dfp_FrmMngswtPSPOff" VALUE 0xCCACA Kw_Wu8 20.00 OneToOne 0.00 20.00 FORMAT "%5.2" EXTENDED_LIMITS 0.00 255.0 /end CHARACTERISTIC
/begin CHARACTERISTIC DSM_ClaDfp_GearbxIncMax_C "Fehlerklasse fuer Fehlerpfad Dfp_GearbxIncMax" VALUE 0xCCACB Kw_Wu8 20.00 OneToOne 0.00 20.00 FORMAT "%5.2" EXTENDED_LIMITS 0.00 255.0 /end CHARACTERISTIC
/begin CHARACTERISTIC DSM_ClaDfp_GlwCD_C "Fehlerklasse fuer Fehlerpfad Dfp_GlwCD" VALUE 0xCCACC Kw_Wu8 20.00 OneToOne 0.00 20.00 FORMAT "%5.2" EXTENDED_LIMITS 0.00 255.0 /end CHARACTERISTIC
/begin CHARACTERISTIC DSM_ClaDfp_GlwCDGlwCirc1_C "Fehlerklasse fuer Fehlerpfad Dfp_GlwCDGlwCirc1" VALUE 0xCCACD Kw_Wu8 20.00 OneToOne 0.00 20.00 FORMAT "%5.2" EXTENDED_LIMITS 0.00 255.0 /end CHARACTERISTIC
/begin CHARACTERISTIC DSM_ClaDfp_GlwCDGlwCirc2_C "Fehlerklasse fuer Fehlerpfad Dfp_GlwCDGlwCirc2" VALUE 0xCCACE Kw_Wu8 20.00 OneToOne 0.00 20.00 FORMAT "%5.2" EXTENDED_LIMITS 0.00 255.0 /end CHARACTERISTIC
/begin CHARACTERISTIC DSM_ClaDfp_GlwCDGlwCirc3_C "Fehlerklasse fuer Fehlerpfad Dfp_GlwCDGlwCirc3" VALUE 0xCCACF Kw_Wu8 20.00 OneToOne 0.00 20.00 FORMAT "%5.2" EXTENDED_LIMITS 0.00 255.0 /end CHARACTERISTIC
/begin CHARACTERISTIC DSM_ClaDfp_GlwCDGlwCirc4_C "Fehlerklasse fuer Fehlerpfad Dfp_GlwCDGlwCirc4" VALUE 0xCCAD0 Kw_Wu8 20.00 OneToOne 0.00 20.00 FORMAT "%5.2" EXTENDED_LIMITS 0.00 255.0 /end CHARACTERISTIC
/begin CHARACTERISTIC DSM_ClaDfp_GlwCDGlwCirc5_C "Fehlerklasse fuer Fehlerpfad Dfp_GlwCDGlwCirc5" VALUE 0xCCAD1 Kw_Wu8 20.00 OneToOne 0.00 20.00 FORMAT "%5.2" EXTENDED_LIMITS 0.00 255.0 /end CHARACTERISTIC
/begin CHARACTERISTIC DSM_ClaDfp_GlwCDGlwCirc6_C "Fehlerklasse fuer Fehlerpfad Dfp_GlwCDGlwCirc6" VALUE 0xCCAD2 Kw_Wu8 20.00 OneToOne 0.00 20.00 FORMAT "%5.2" EXTENDED_LIMITS 0.00 255.0 /end CHARACTERISTIC
/begin CHARACTERISTIC DSM_ClaDfp_GlwCDGlwCirc7_C "Fehlerklasse fuer Fehlerpfad Dfp_GlwCDGlwCirc7" VALUE 0xCCAD3 Kw_Wu8 20.00 OneToOne 0.00 20.00 FORMAT "%5.2" EXTENDED_LIMITS 0.00 255.0 /end CHARACTERISTIC
/begin CHARACTERISTIC DSM_ClaDfp_GlwCDGlwCirc8_C "Fehlerklasse fuer Fehlerpfad Dfp_GlwCDGlwCirc8" VALUE 0xCCAD4 Kw_Wu8 20.00 OneToOne 0.00 20.00 FORMAT "%5.2" EXTENDED_LIMITS 0.00 255.0 /end CHARACTERISTIC
/begin CHARACTERISTIC DSM_ClaDfp_GlwCtl_C "Fehlerklasse fuer Fehlerpfad Dfp_GlwCtl" VALUE 0xCCAD5 Kw_Wu8 20.00 OneToOne 0.00 20.00 FORMAT "%5.2" EXTENDED_LIMITS 0.00 255.0 /end CHARACTERISTIC
/begin CHARACTERISTIC DSM_ClaDfp_HWEMonCom_C "Fehlerklasse fuer Fehlerpfad Dfp_HWEMonCom" VALUE 0xCCAD6 Kw_Wu8 20.00 OneToOne 0.00 20.00 FORMAT "%5.2" EXTENDED_LIMITS 0.00 255.0 /end CHARACTERISTIC
/begin CHARACTERISTIC DSM_ClaDfp_HWEMonEEPROM_C "Fehlerklasse fuer Fehlerpfad Dfp_HWEMonEEPROM" VALUE 0xCCAD7 Kw_Wu8 20.00 OneToOne 0.00 20.00 FORMAT "%5.2" EXTENDED_LIMITS 0.00 255.0 /end CHARACTERISTIC
/begin CHARACTERISTIC DSM_ClaDfp_HWEMonRcyLocked_C "Fehlerklasse fuer Fehlerpfad Dfp_HWEMonRcyLocked" VALUE 0xCCAD8 Kw_Wu8 20.00 OneToOne 0.00 20.00 FORMAT "%5.2" EXTENDED_LIMITS 0.00 255.0 /end CHARACTERISTIC
/begin CHARACTERISTIC DSM_ClaDfp_HWEMonRcySuppressed_C "Fehlerklasse fuer Fehlerpfad Dfp_HWEMonRcySuppressed" VALUE 0xCCAD9 Kw_Wu8 20.00 OneToOne 0.00 20.00 FORMAT "%5.2" EXTENDED_LIMITS 0.00 255.0 /end CHARACTERISTIC
/begin CHARACTERISTIC DSM_ClaDfp_HWEMonRcyVisible_C "Fehlerklasse fuer Fehlerpfad Dfp_HWEMonRcyVisible" VALUE 0xCCADA Kw_Wu8 20.00 OneToOne 0.00 20.00 FORMAT "%5.2" EXTENDED_LIMITS 0.00 255.0 /end CHARACTERISTIC
/begin CHARACTERISTIC DSM_ClaDfp_HWEMonUMaxSupply_C "Fehlerklasse fuer Fehlerpfad Dfp_HWEMonUMaxSupply" VALUE 0xCCADB Kw_Wu8 20.00 OneToOne 0.00 20.00 FORMAT "%5.2" EXTENDED_LIMITS 0.00 255.0 /end CHARACTERISTIC
/begin CHARACTERISTIC DSM_ClaDfp_HWEMonUMinSupply_C "Fehlerklasse fuer Fehlerpfad Dfp_HWEMonUMinSupply" VALUE 0xCCADC Kw_Wu8 20.00 OneToOne 0.00 20.00 FORMAT "%5.2" EXTENDED_LIMITS 0.00 255.0 /end CHARACTERISTIC
/begin CHARACTERISTIC DSM_ClaDfp_IATSCD_C "Fehlerklasse fuer Fehlerpfad Dfp_IATSCD" VALUE 0xCCADD Kw_Wu8 20.00 OneToOne 0.00 20.00 FORMAT "%5.2" EXTENDED_LIMITS 0.00 255.0 /end CHARACTERISTIC
/begin CHARACTERISTIC DSM_ClaDfp_IATSCD_CATS_C "Fehlerklasse fuer Fehlerpfad Dfp_IATSCD_CATS" VALUE 0xCCADE Kw_Wu8 20.00 OneToOne 0.00 20.00 FORMAT "%5.2" EXTENDED_LIMITS 0.00 255.0 /end CHARACTERISTIC
/begin CHARACTERISTIC DSM_ClaDfp_ImmCtlImmCD_C "Fehlerklasse fuer Fehlerpfad Dfp_ImmCtlImmCD" VALUE 0xCCADF Kw_Wu8 20.00 OneToOne 0.00 20.00 FORMAT "%5.2" EXTENDED_LIMITS 0.00 255.0 /end CHARACTERISTIC
/begin CHARACTERISTIC DSM_ClaDfp_ImmCtlImmEep_C "Fehlerklasse fuer Fehlerpfad Dfp_ImmCtlImmEep" VALUE 0xCCAE0 Kw_Wu8 20.00 OneToOne 0.00 20.00 FORMAT "%5.2" EXTENDED_LIMITS 0.00 255.0 /end CHARACTERISTIC
/begin CHARACTERISTIC DSM_ClaDfp_ImmCtlMpl_C "Fehlerklasse fuer Fehlerpfad Dfp_ImmCtlMpl" VALUE 0xCCAE1 Kw_Wu8 20.00 OneToOne 0.00 20.00 FORMAT "%5.2" EXTENDED_LIMITS 0.00 255.0 /end CHARACTERISTIC
/begin CHARACTERISTIC DSM_ClaDfp_IndSys1_C "Fehlerklasse fuer Fehlerpfad Dfp_IndSys1" VALUE 0xCCAE2 Kw_Wu8 20.00 OneToOne 0.00 20.00 FORMAT "%5.2" EXTENDED_LIMITS 0.00 255.0 /end CHARACTERISTIC
/begin CHARACTERISTIC DSM_ClaDfp_IndSys2_C "Fehlerklasse fuer Fehlerpfad Dfp_IndSys2" VALUE 0xCCAE3 Kw_Wu8 20.00 OneToOne 0.00 20.00 FORMAT "%5.2" EXTENDED_LIMITS 0.00 255.0 /end CHARACTERISTIC
/begin CHARACTERISTIC DSM_ClaDfp_InjCrv_InjLim_C "Fehlerklasse fuer Fehlerpfad Dfp_InjCrv_injLim" VALUE 0xCCAE4 Kw_Wu8 20.00 OneToOne 0.00 20.00 FORMAT "%5.2" EXTENDED_LIMITS 0.00 255.0 /end CHARACTERISTIC
/begin CHARACTERISTIC DSM_ClaDfp_InjCtlAdjQnt_C "Fehlerklasse fuer Fehlerpfad Dfp_InjCtlAdjQnt" VALUE 0xCCAE5 Kw_Wu8 20.00 OneToOne 0.00 20.00 FORMAT "%5.2" EXTENDED_LIMITS 0.00 255.0 /end CHARACTERISTIC
/begin CHARACTERISTIC DSM_ClaDfp_InjCtlDrift_C "Fehlerklasse fuer Fehlerpfad Dfp_InjCtlDrift" VALUE 0xCCAE6 Kw_Wu8 20.00 OneToOne 0.00 20.00 FORMAT "%5.2" EXTENDED_LIMITS 0.00 255.0 /end CHARACTERISTIC
/begin CHARACTERISTIC DSM_ClaDfp_InjVlvBnk1A_C "Fehlerklasse fuer Fehlerpfad Dfp_InjVlvBnk1A" VALUE 0xCCAE7 Kw_Wu8 20.00 OneToOne 0.00 20.00 FORMAT "%5.2" EXTENDED_LIMITS 0.00 255.0 /end CHARACTERISTIC
/begin CHARACTERISTIC DSM_ClaDfp_InjVlvBnk1B_C "Fehlerklasse fuer Fehlerpfad Dfp_InjVlvBnk1B" VALUE 0xCCAE8 Kw_Wu8 20.00 OneToOne 0.00 20.00 FORMAT "%5.2" EXTENDED_LIMITS 0.00 255.0 /end CHARACTERISTIC
/begin CHARACTERISTIC DSM_ClaDfp_InjVlvBnk2A_C "Fehlerklasse fuer Fehlerpfad Dfp_InjVlvBnk2A" VALUE 0xCCAE9 Kw_Wu8 20.00 OneToOne 0.00 20.00 FORMAT "%5.2" EXTENDED_LIMITS 0.00 255.0 /end CHARACTERISTIC
/begin CHARACTERISTIC DSM_ClaDfp_InjVlvBnk2B_C "Fehlerklasse fuer Fehlerpfad Dfp_InjVlvBnk2B" VALUE 0xCCAEA Kw_Wu8 20.00 OneToOne 0.00 20.00 FORMAT "%5.2" EXTENDED_LIMITS 0.00 255.0 /end CHARACTERISTIC
/begin CHARACTERISTIC DSM_ClaDfp_InjVlvChipA_C "Fehlerklasse fuer Fehlerpfad Dfp_InjVlvChipA" VALUE 0xCCAEB Kw_Wu8 20.00 OneToOne 0.00 20.00 FORMAT "%5.2" EXTENDED_LIMITS 0.00 255.0 /end CHARACTERISTIC
/begin CHARACTERISTIC DSM_ClaDfp_InjVlvChipB_C "Fehlerklasse fuer Fehlerpfad Dfp_InjVlvChipB" VALUE 0xCCAEC Kw_Wu8 20.00 OneToOne 0.00 20.00 FORMAT "%5.2" EXTENDED_LIMITS 0.00 255.0 /end CHARACTERISTIC
/begin CHARACTERISTIC DSM_ClaDfp_InjVlvCyl1A_C "Fehlerklasse fuer Fehlerpfad Dfp_InjVlvCyl1A" VALUE 0xCCAED Kw_Wu8 20.00 OneToOne 0.00 20.00 FORMAT "%5.2" EXTENDED_LIMITS 0.00 255.0 /end CHARACTERISTIC
/begin CHARACTERISTIC DSM_ClaDfp_InjVlvCyl1B_C "Fehlerklasse fuer Fehlerpfad Dfp_InjVlvCyl1B" VALUE 0xCCAEE Kw_Wu8 20.00 OneToOne 0.00 20.00 FORMAT "%5.2" EXTENDED_LIMITS 0.00 255.0 /end CHARACTERISTIC
/begin CHARACTERISTIC DSM_ClaDfp_InjVlvCyl2A_C "Fehlerklasse fuer Fehlerpfad Dfp_InjVlvCyl2A" VALUE 0xCCAEF Kw_Wu8 20.00 OneToOne 0.00 20.00 FORMAT "%5.2" EXTENDED_LIMITS 0.00 255.0 /end CHARACTERISTIC
/begin CHARACTERISTIC DSM_ClaDfp_InjVlvCyl2B_C "Fehlerklasse fuer Fehlerpfad Dfp_InjVlvCyl2B" VALUE 0xCCAF0 Kw_Wu8 20.00 OneToOne 0.00 20.00 FORMAT "%5.2" EXTENDED_LIMITS 0.00 255.0 /end CHARACTERISTIC
/begin CHARACTERISTIC DSM_ClaDfp_InjVlvCyl3A_C "Fehlerklasse fuer Fehlerpfad Dfp_InjVlvCyl3A" VALUE 0xCCAF1 Kw_Wu8 20.00 OneToOne 0.00 20.00 FORMAT "%5.2" EXTENDED_LIMITS 0.00 255.0 /end CHARACTERISTIC
/begin CHARACTERISTIC DSM_ClaDfp_InjVlvCyl3B_C "Fehlerklasse fuer Fehlerpfad Dfp_InjVlvCyl3B" VALUE 0xCCAF2 Kw_Wu8 20.00 OneToOne 0.00 20.00 FORMAT "%5.2" EXTENDED_LIMITS 0.00 255.0 /end CHARACTERISTIC
/begin CHARACTERISTIC DSM_ClaDfp_InjVlvCyl4A_C "Fehlerklasse fuer Fehlerpfad Dfp_InjVlvCyl4A" VALUE 0xCCAF3 Kw_Wu8 20.00 OneToOne 0.00 20.00 FORMAT "%5.2" EXTENDED_LIMITS 0.00 255.0 /end CHARACTERISTIC
/begin CHARACTERISTIC DSM_ClaDfp_InjVlvCyl4B_C "Fehlerklasse fuer Fehlerpfad Dfp_InjVlvCyl4B" VALUE 0xCCAF4 Kw_Wu8 20.00 OneToOne 0.00 20.00 FORMAT "%5.2" EXTENDED_LIMITS 0.00 255.0 /end CHARACTERISTIC
/begin CHARACTERISTIC DSM_ClaDfp_InjVlvCyl5A_C "Fehlerklasse fuer Fehlerpfad Dfp_InjVlvCyl5A" VALUE 0xCCAF5 Kw_Wu8 20.00 OneToOne 0.00 20.00 FORMAT "%5.2" EXTENDED_LIMITS 0.00 255.0 /end CHARACTERISTIC
/begin CHARACTERISTIC DSM_ClaDfp_InjVlvCyl5B_C "Fehlerklasse fuer Fehlerpfad Dfp_InjVlvCyl5B" VALUE 0xCCAF6 Kw_Wu8 20.00 OneToOne 0.00 20.00 FORMAT "%5.2" EXTENDED_LIMITS 0.00 255.0 /end CHARACTERISTIC
/begin CHARACTERISTIC DSM_ClaDfp_InjVlvCyl6A_C "Fehlerklasse fuer Fehlerpfad Dfp_InjVlvCyl6A" VALUE 0xCCAF7 Kw_Wu8 20.00 OneToOne 0.00 20.00 FORMAT "%5.2" EXTENDED_LIMITS 0.00 255.0 /end CHARACTERISTIC
/begin CHARACTERISTIC DSM_ClaDfp_InjVlvCyl6B_C "Fehlerklasse fuer Fehlerpfad Dfp_InjVlvCyl6B" VALUE 0xCCAF8 Kw_Wu8 20.00 OneToOne 0.00 20.00 FORMAT "%5.2" EXTENDED_LIMITS 0.00 255.0 /end CHARACTERISTIC
/begin CHARACTERISTIC DSM_ClaDfp_KeyCheck_C "Fehlerklasse fuer Fehlerpfad Dfp_KeyCheck" VALUE 0xCCAF9 Kw_Wu8 20.00 OneToOne 0.00 20.00 FORMAT "%5.2" EXTENDED_LIMITS 0.00 255.0 /end CHARACTERISTIC
/begin CHARACTERISTIC DSM_ClaDfp_LIGovECUTransMode_C "Fehlerklasse fuer Fehlerpfad Dfp_LIGovECUTransMode" VALUE 0xCCAFA Kw_Wu8 20.00 OneToOne 0.00 20.00 FORMAT "%5.2" EXTENDED_LIMITS 0.00 255.0 /end CHARACTERISTIC
/begin CHARACTERISTIC DSM_ClaDfp_LPACD_Max_C "Fehlerklasse fuer Fehlerpfad Dfp_LPACD_Max" VALUE 0xCCAFB Kw_Wu8 20.00 OneToOne 0.00 20.00 FORMAT "%5.2" EXTENDED_LIMITS 0.00 255.0 /end CHARACTERISTIC
/begin CHARACTERISTIC DSM_ClaDfp_LPACD_Min_C "Fehlerklasse fuer Fehlerpfad Dfp_LPACD_Min" VALUE 0xCCAFC Kw_Wu8 20.00 OneToOne 0.00 20.00 FORMAT "%5.2" EXTENDED_LIMITS 0.00 255.0 /end CHARACTERISTIC
/begin CHARACTERISTIC DSM_ClaDfp_LPACD_SigNpl_C "Fehlerklasse fuer Fehlerpfad Dfp_LPACD_SigNpl" VALUE 0xCCAFD Kw_Wu8 20.00 OneToOne 0.00 20.00 FORMAT "%5.2" EXTENDED_LIMITS 0.00 255.0 /end CHARACTERISTIC
/begin CHARACTERISTIC DSM_ClaDfp_LSUCDCircNernst0_C "Fehlerklasse fuer Fehlerpfad Dfp_LSUCDCircNernst0" VALUE 0xCCAFE Kw_Wu8 20.00 OneToOne 0.00 20.00 FORMAT "%5.2" EXTENDED_LIMITS 0.00 255.0 /end CHARACTERISTIC
/begin CHARACTERISTIC DSM_ClaDfp_LSUCDCircPumpCur0_C "Fehlerklasse fuer Fehlerpfad Dfp_LSUCDCircPumpCur0" VALUE 0xCCAFF Kw_Wu8 20.00 OneToOne 0.00 20.00 FORMAT "%5.2" EXTENDED_LIMITS 0.00 255.0 /end CHARACTERISTIC
/begin CHARACTERISTIC DSM_ClaDfp_LSUCDCircVirtGnd0_C "Fehlerklasse fuer Fehlerpfad Dfp_LSUCDCircVirtGnd0" VALUE 0xCCB00 Kw_Wu8 20.00 OneToOne 0.00 20.00 FORMAT "%5.2" EXTENDED_LIMITS 0.00 255.0 /end CHARACTERISTIC
/begin CHARACTERISTIC DSM_ClaDfp_LSUCDHeater0_C "Fehlerklasse fuer Fehlerpfad Dfp_LSUCDHeater0" VALUE 0xCCB01 Kw_Wu8 20.00 OneToOne 0.00 20.00 FORMAT "%5.2" EXTENDED_LIMITS 0.00 255.0 /end CHARACTERISTIC
/begin CHARACTERISTIC DSM_ClaDfp_LSUCDHtCoup0_C "Fehlerklasse fuer Fehlerpfad Dfp_LSUCDHtCoup0" VALUE 0xCCB02 Kw_Wu8 20.00 OneToOne 0.00 20.00 FORMAT "%5.2" EXTENDED_LIMITS 0.00 255.0 /end CHARACTERISTIC
/begin CHARACTERISTIC DSM_ClaDfp_LSUCDO20_C "Fehlerklasse fuer Fehlerpfad Dfp_LSUCDO20" VALUE 0xCCB03 Kw_Wu8 20.00 OneToOne 0.00 20.00 FORMAT "%5.2" EXTENDED_LIMITS 0.00 255.0 /end CHARACTERISTIC
/begin CHARACTERISTIC DSM_ClaDfp_LSUCDO2Clb0_C "Fehlerklasse fuer Fehlerpfad Dfp_LSUCDO2Clb0" VALUE 0xCCB04 Kw_Wu8 20.00 OneToOne 0.00 20.00 FORMAT "%5.2" EXTENDED_LIMITS 0.00 255.0 /end CHARACTERISTIC
/begin CHARACTERISTIC DSM_ClaDfp_LSUCDRiClb0_C "Fehlerklasse fuer Fehlerpfad Dfp_LSUCDRiClb0" VALUE 0xCCB05 Kw_Wu8 20.00 OneToOne 0.00 20.00 FORMAT "%5.2" EXTENDED_LIMITS 0.00 255.0 /end CHARACTERISTIC
/begin CHARACTERISTIC DSM_ClaDfp_LSUCDSPI0_C "Fehlerklasse fuer Fehlerpfad Dfp_LSUCDSPI0" VALUE 0xCCB06 Kw_Wu8 20.00 OneToOne 0.00 20.00 FORMAT "%5.2" EXTENDED_LIMITS 0.00 255.0 /end CHARACTERISTIC
/begin CHARACTERISTIC DSM_ClaDfp_LSUCDSPIBattLow0_C "Fehlerklasse fuer Fehlerpfad Dfp_LSUCDSPIBattLow0" VALUE 0xCCB07 Kw_Wu8 20.00 OneToOne 0.00 20.00 FORMAT "%5.2" EXTENDED_LIMITS 0.00 255.0 /end CHARACTERISTIC
/begin CHARACTERISTIC DSM_ClaDfp_LSUCDWireIP0_C "Fehlerklasse fuer Fehlerpfad Dfp_LSUCDWireIP0" VALUE 0xCCB08 Kw_Wu8 20.00 OneToOne 0.00 20.00 FORMAT "%5.2" EXTENDED_LIMITS 0.00 255.0 /end CHARACTERISTIC
/begin CHARACTERISTIC DSM_ClaDfp_LSUCtlRiExc0_C "Fehlerklasse fuer Fehlerpfad Dfp_LSUCtlRiExc0" VALUE 0xCCB09 Kw_Wu8 20.00 OneToOne 0.00 20.00 FORMAT "%5.2" EXTENDED_LIMITS 0.00 255.0 /end CHARACTERISTIC
/begin CHARACTERISTIC DSM_ClaDfp_LSUMon1Sens_C "Fehlerklasse fuer Fehlerpfad Dfp_LSUMon1Sens" VALUE 0xCCB0A Kw_Wu8 20.00 OneToOne 0.00 20.00 FORMAT "%5.2" EXTENDED_LIMITS 0.00 255.0 /end CHARACTERISTIC
/begin CHARACTERISTIC DSM_ClaDfp_LSUMon2Sens_C "Fehlerklasse fuer Fehlerpfad Dfp_LSUMon2Sens" VALUE 0xCCB0B Kw_Wu8 20.00 OneToOne 0.00 20.00 FORMAT "%5.2" EXTENDED_LIMITS 0.00 255.0 /end CHARACTERISTIC
/begin CHARACTERISTIC DSM_ClaDfp_MIL_C "Fehlerklasse fuer Fehlerpfad Dfp_MIL" VALUE 0xCCB0C Kw_Wu8 20.00 OneToOne 0.00 20.00 FORMAT "%5.2" EXTENDED_LIMITS 0.00 255.0 /end CHARACTERISTIC
/begin CHARACTERISTIC DSM_ClaDfp_MRlyCD_C "Fehlerklasse fuer Fehlerpfad Dfp_MRlyCD" VALUE 0xCCB0D Kw_Wu8 20.00 OneToOne 0.00 20.00 FORMAT "%5.2" EXTENDED_LIMITS 0.00 255.0 /end CHARACTERISTIC
/begin CHARACTERISTIC DSM_ClaDfp_MSidCD_Comm_C "Fehlerklasse fuer Fehlerpfad Dfp_MSidCD_Comm" VALUE 0xCCB0E Kw_Wu8 20.00 OneToOne 0.00 20.00 FORMAT "%5.2" EXTENDED_LIMITS 0.00 255.0 /end CHARACTERISTIC
/begin CHARACTERISTIC DSM_ClaDfp_MSidCD_Pin_C "Fehlerklasse fuer Fehlerpfad Dfp_MSidCD_Pin" VALUE 0xCCB0F Kw_Wu8 20.00 OneToOne 0.00 20.00 FORMAT "%5.2" EXTENDED_LIMITS 0.00 255.0 /end CHARACTERISTIC
/begin CHARACTERISTIC DSM_ClaDfp_MSidCD_Sel_INI_C "Fehlerklasse fuer Fehlerpfad Dfp_MSidCD_Sel_INI" VALUE 0xCCB10 Kw_Wu8 20.00 OneToOne 0.00 20.00 FORMAT "%5.2" EXTENDED_LIMITS 0.00 255.0 /end CHARACTERISTIC
/begin CHARACTERISTIC DSM_ClaDfp_MSidCD_Select_C "Fehlerklasse fuer Fehlerpfad Dfp_MSidCD_Select" VALUE 0xCCB11 Kw_Wu8 20.00 OneToOne 0.00 20.00 FORMAT "%5.2" EXTENDED_LIMITS 0.00 255.0 /end CHARACTERISTIC
/begin CHARACTERISTIC DSM_ClaDfp_MeUnCDNoLoad_C "Fehlerklasse fuer Fehlerpfad Dfp_MeUnCDNoLoad" VALUE 0xCCB12 Kw_Wu8 20.00 OneToOne 0.00 20.00 FORMAT "%5.2" EXTENDED_LIMITS 0.00 255.0 /end CHARACTERISTIC
/begin CHARACTERISTIC DSM_ClaDfp_MeUnCDSCBat_C "Fehlerklasse fuer Fehlerpfad Dfp_MeUnCDSCBat" VALUE 0xCCB13 Kw_Wu8 20.00 OneToOne 0.00 20.00 FORMAT "%5.2" EXTENDED_LIMITS 0.00 255.0 /end CHARACTERISTIC
/begin CHARACTERISTIC DSM_ClaDfp_MeUnCDSCGnd_C "Fehlerklasse fuer Fehlerpfad Dfp_MeUnCDSCGnd" VALUE 0xCCB14 Kw_Wu8 20.00 OneToOne 0.00 20.00 FORMAT "%5.2" EXTENDED_LIMITS 0.00 255.0 /end CHARACTERISTIC
/begin CHARACTERISTIC DSM_ClaDfp_MeUnCD_ADC_C "Fehlerklasse fuer Fehlerpfad Dfp_MeUnCD_ADC" VALUE 0xCCB15 Kw_Wu8 20.00 OneToOne 0.00 20.00 FORMAT "%5.2" EXTENDED_LIMITS 0.00 255.0 /end CHARACTERISTIC
/begin CHARACTERISTIC DSM_ClaDfp_MeUnCD_SigTst_C "Fehlerklasse fuer Fehlerpfad Dfp_MeUnCD_SigTst" VALUE 0xCCB16 Kw_Wu8 20.00 OneToOne 0.00 20.00 FORMAT "%5.2" EXTENDED_LIMITS 0.00 255.0 /end CHARACTERISTIC
/begin CHARACTERISTIC DSM_ClaDfp_Montr_C "Fehlerklasse fuer Fehlerpfad Dfp_Montr" VALUE 0xCCB17 Kw_Wu8 20.00 OneToOne 0.00 20.00 FORMAT "%5.2" EXTENDED_LIMITS 0.00 255.0 /end CHARACTERISTIC
/begin CHARACTERISTIC DSM_ClaDfp_NetMngDeviceA_C "Fehlerklasse fuer Fehlerpfad Dfp_NetMngDeviceA" VALUE 0xCCB18 Kw_Wu8 20.00 OneToOne 0.00 20.00 FORMAT "%5.2" EXTENDED_LIMITS 0.00 255.0 /end CHARACTERISTIC
/begin CHARACTERISTIC DSM_ClaDfp_NetMngDeviceB_C "Fehlerklasse fuer Fehlerpfad Dfp_NetMngDeviceB" VALUE 0xCCB19 Kw_Wu8 20.00 OneToOne 0.00 20.00 FORMAT "%5.2" EXTENDED_LIMITS 0.00 255.0 /end CHARACTERISTIC
/begin CHARACTERISTIC DSM_ClaDfp_NetMngDeviceC_C "Fehlerklasse fuer Fehlerpfad Dfp_NetMngDeviceC" VALUE 0xCCB1A Kw_Wu8 20.00 OneToOne 0.00 20.00 FORMAT "%5.2" EXTENDED_LIMITS 0.00 255.0 /end CHARACTERISTIC
/begin CHARACTERISTIC DSM_ClaDfp_NetMngPtCan_C "Fehlerklasse fuer Fehlerpfad Dfp_NetMngPtCan" VALUE 0xCCB1B Kw_Wu8 20.00 OneToOne 0.00 20.00 FORMAT "%5.2" EXTENDED_LIMITS 0.00 255.0 /end CHARACTERISTIC
/begin CHARACTERISTIC DSM_ClaDfp_OPSCD_Lamp_C "Fehlerklasse fuer Fehlerpfad Dfp_OPSCD_Lamp" VALUE 0xCCB1C Kw_Wu8 20.00 OneToOne 0.00 20.00 FORMAT "%5.2" EXTENDED_LIMITS 0.00 255.0 /end CHARACTERISTIC
/begin CHARACTERISTIC DSM_ClaDfp_OPSCD_anain_C "Fehlerklasse fuer Fehlerpfad Dfp_OPSCD_anain" VALUE 0xCCB1D Kw_Wu8 20.00 OneToOne 0.00 20.00 FORMAT "%5.2" EXTENDED_LIMITS 0.00 255.0 /end CHARACTERISTIC
/begin CHARACTERISTIC DSM_ClaDfp_OTSCD_C "Fehlerklasse fuer Fehlerpfad Dfp_OTSCD" VALUE 0xCCB1E Kw_Wu8 20.00 OneToOne 0.00 20.00 FORMAT "%5.2" EXTENDED_LIMITS 0.00 255.0 /end CHARACTERISTIC
/begin CHARACTERISTIC DSM_ClaDfp_OvRMon_C "Fehlerklasse fuer Fehlerpfad Dfp_OvRMon" VALUE 0xCCB1F Kw_Wu8 20.00 OneToOne 0.00 20.00 FORMAT "%5.2" EXTENDED_LIMITS 0.00 255.0 /end CHARACTERISTIC
/begin CHARACTERISTIC DSM_ClaDfp_OvRMonSigA_C "Fehlerklasse fuer Fehlerpfad Dfp_OvRMonSigA" VALUE 0xCCB20 Kw_Wu8 20.00 OneToOne 0.00 20.00 FORMAT "%5.2" EXTENDED_LIMITS 0.00 255.0 /end CHARACTERISTIC
/begin CHARACTERISTIC DSM_ClaDfp_OxiCCDTPre_C "Fehlerklasse fuer Fehlerpfad Dfp_OxiCCDTPre" VALUE 0xCCB21 Kw_Wu8 20.00 OneToOne 0.00 20.00 FORMAT "%5.2" EXTENDED_LIMITS 0.00 255.0 /end CHARACTERISTIC
/begin CHARACTERISTIC DSM_ClaDfp_PCBS_C "Fehlerklasse fuer Fehlerpfad Dfp_PCBS" VALUE 0xCCB22 Kw_Wu8 20.00 OneToOne 0.00 20.00 FORMAT "%5.2" EXTENDED_LIMITS 0.00 255.0 /end CHARACTERISTIC
/begin CHARACTERISTIC DSM_ClaDfp_PCR_GovDevNeg_C "Fehlerklasse fuer Fehlerpfad Dfp_PCR_GovDevNeg" VALUE 0xCCB23 Kw_Wu8 20.00 OneToOne 0.00 20.00 FORMAT "%5.2" EXTENDED_LIMITS 0.00 255.0 /end CHARACTERISTIC
/begin CHARACTERISTIC DSM_ClaDfp_PCR_GovDevPos_C "Fehlerklasse fuer Fehlerpfad Dfp_PCR_GovDevPos" VALUE 0xCCB24 Kw_Wu8 20.00 OneToOne 0.00 20.00 FORMAT "%5.2" EXTENDED_LIMITS 0.00 255.0 /end CHARACTERISTIC
/begin CHARACTERISTIC DSM_ClaDfp_PCR_LPGvnrDvtNeg_C "Fehlerklasse fuer Fehlerpfad Dfp_PCR_LPGvnrDvtNeg" VALUE 0xCCB25 Kw_Wu8 20.00 OneToOne 0.00 20.00 FORMAT "%5.2" EXTENDED_LIMITS 0.00 255.0 /end CHARACTERISTIC
/begin CHARACTERISTIC DSM_ClaDfp_PCR_LPGvnrDvtPos_C "Fehlerklasse fuer Fehlerpfad Dfp_PCR_LPGvnrDvtPos" VALUE 0xCCB26 Kw_Wu8 20.00 OneToOne 0.00 20.00 FORMAT "%5.2" EXTENDED_LIMITS 0.00 255.0 /end CHARACTERISTIC
/begin CHARACTERISTIC DSM_ClaDfp_PCVCDNoLoad_C "Fehlerklasse fuer Fehlerpfad Dfp_PCVCDNoLoad" VALUE 0xCCB27 Kw_Wu8 20.00 OneToOne 0.00 20.00 FORMAT "%5.2" EXTENDED_LIMITS 0.00 255.0 /end CHARACTERISTIC
/begin CHARACTERISTIC DSM_ClaDfp_PCVCDSCBat_C "Fehlerklasse fuer Fehlerpfad Dfp_PCVCDSCBat" VALUE 0xCCB28 Kw_Wu8 20.00 OneToOne 0.00 20.00 FORMAT "%5.2" EXTENDED_LIMITS 0.00 255.0 /end CHARACTERISTIC
/begin CHARACTERISTIC DSM_ClaDfp_PCVCDSCGnd_C "Fehlerklasse fuer Fehlerpfad Dfp_PCVCDSCGnd" VALUE 0xCCB29 Kw_Wu8 20.00 OneToOne 0.00 20.00 FORMAT "%5.2" EXTENDED_LIMITS 0.00 255.0 /end CHARACTERISTIC
/begin CHARACTERISTIC DSM_ClaDfp_PCVCD_ADC_C "Fehlerklasse fuer Fehlerpfad Dfp_PCVCD_ADC" VALUE 0xCCB2A Kw_Wu8 20.00 OneToOne 0.00 20.00 FORMAT "%5.2" EXTENDED_LIMITS 0.00 255.0 /end CHARACTERISTIC
/begin CHARACTERISTIC DSM_ClaDfp_PCVCD_SigTst_C "Fehlerklasse fuer Fehlerpfad Dfp_PCVCD_SigTst" VALUE 0xCCB2B Kw_Wu8 20.00 OneToOne 0.00 20.00 FORMAT "%5.2" EXTENDED_LIMITS 0.00 255.0 /end CHARACTERISTIC
/begin CHARACTERISTIC DSM_ClaDfp_PFltAPSPlaus_C "Fehlerklasse fuer Fehlerpfad Dfp_PFltAPSPlaus" VALUE 0xCCB2C Kw_Wu8 20.00 OneToOne 0.00 20.00 FORMAT "%5.2" EXTENDED_LIMITS 0.00 255.0 /end CHARACTERISTIC
/begin CHARACTERISTIC DSM_ClaDfp_PFltAPSens_C "Fehlerklasse fuer Fehlerpfad Dfp_PFltAPSens" VALUE 0xCCB2D Kw_Wu8 20.00 OneToOne 0.00 20.00 FORMAT "%5.2" EXTENDED_LIMITS 0.00 255.0 /end CHARACTERISTIC
/begin CHARACTERISTIC DSM_ClaDfp_PFltBPSPlaus_C "Fehlerklasse fuer Fehlerpfad Dfp_PFltBPSPlaus" VALUE 0xCCB2E Kw_Wu8 20.00 OneToOne 0.00 20.00 FORMAT "%5.2" EXTENDED_LIMITS 0.00 255.0 /end CHARACTERISTIC
/begin CHARACTERISTIC DSM_ClaDfp_PFltCDPPre_C "Fehlerklasse fuer Fehlerpfad Dfp_PFltCDPPre" VALUE 0xCCB2F Kw_Wu8 20.00 OneToOne 0.00 20.00 FORMAT "%5.2" EXTENDED_LIMITS 0.00 255.0 /end CHARACTERISTIC
/begin CHARACTERISTIC DSM_ClaDfp_PFltCDTempPre_C "Fehlerklasse fuer Fehlerpfad Dfp_PFltCDTempPre" VALUE 0xCCB30 Kw_Wu8 20.00 OneToOne 0.00 20.00 FORMAT "%5.2" EXTENDED_LIMITS 0.00 255.0 /end CHARACTERISTIC
/begin CHARACTERISTIC DSM_ClaDfp_PFltChar_C "Fehlerklasse fuer Fehlerpfad Dfp_PFltChar" VALUE 0xCCB31 Kw_Wu8 20.00 OneToOne 0.00 20.00 FORMAT "%5.2" EXTENDED_LIMITS 0.00 255.0 /end CHARACTERISTIC
/begin CHARACTERISTIC DSM_ClaDfp_PFltEngPrt_C "Fehlerklasse fuer Fehlerpfad Dfp_PFltEngPrt" VALUE 0xCCB32 Kw_Wu8 20.00 OneToOne 0.00 20.00 FORMAT "%5.2" EXTENDED_LIMITS 0.00 255.0 /end CHARACTERISTIC
/begin CHARACTERISTIC DSM_ClaDfp_PFltOvldInhRgn_C "Fehlerklasse fuer Fehlerpfad Dfp_PFltOvldInhRgn" VALUE 0xCCB33 Kw_Wu8 20.00 OneToOne 0.00 20.00 FORMAT "%5.2" EXTENDED_LIMITS 0.00 255.0 /end CHARACTERISTIC
/begin CHARACTERISTIC DSM_ClaDfp_PFltOvldTrqLim_C "Fehlerklasse fuer Fehlerpfad Dfp_PFltOvldTrqLim" VALUE 0xCCB34 Kw_Wu8 20.00 OneToOne 0.00 20.00 FORMAT "%5.2" EXTENDED_LIMITS 0.00 255.0 /end CHARACTERISTIC
/begin CHARACTERISTIC DSM_ClaDfp_PFltPresDynPlaus_C "Fehlerklasse fuer Fehlerpfad Dfp_PFltPresDynPlaus" VALUE 0xCCB35 Kw_Wu8 20.00 OneToOne 0.00 20.00 FORMAT "%5.2" EXTENDED_LIMITS 0.00 255.0 /end CHARACTERISTIC
/begin CHARACTERISTIC DSM_ClaDfp_PFltPresPlaus_C "Fehlerklasse fuer Fehlerpfad Dfp_PFltPresPlaus" VALUE 0xCCB36 Kw_Wu8 20.00 OneToOne 0.00 20.00 FORMAT "%5.2" EXTENDED_LIMITS 0.00 255.0 /end CHARACTERISTIC
/begin CHARACTERISTIC DSM_ClaDfp_PFltPresSens_C "Fehlerklasse fuer Fehlerpfad Dfp_PFltPresSens" VALUE 0xCCB37 Kw_Wu8 20.00 OneToOne 0.00 20.00 FORMAT "%5.2" EXTENDED_LIMITS 0.00 255.0 /end CHARACTERISTIC
/begin CHARACTERISTIC DSM_ClaDfp_PFltPresSensFrz_C "Fehlerklasse fuer Fehlerpfad Dfp_PFltPresSensFrz" VALUE 0xCCB38 Kw_Wu8 20.00 OneToOne 0.00 20.00 FORMAT "%5.2" EXTENDED_LIMITS 0.00 255.0 /end CHARACTERISTIC
/begin CHARACTERISTIC DSM_ClaDfp_PFltPresSensHsLn_C "Fehlerklasse fuer Fehlerpfad Dfp_PFltPresSensHsLn" VALUE 0xCCB39 Kw_Wu8 20.00 OneToOne 0.00 20.00 FORMAT "%5.2" EXTENDED_LIMITS 0.00 255.0 /end CHARACTERISTIC
/begin CHARACTERISTIC DSM_ClaDfp_PFltPresSensSot_C "Fehlerklasse fuer Fehlerpfad Dfp_PFltPresSensSot" VALUE 0xCCB3A Kw_Wu8 20.00 OneToOne 0.00 20.00 FORMAT "%5.2" EXTENDED_LIMITS 0.00 255.0 /end CHARACTERISTIC
/begin CHARACTERISTIC DSM_ClaDfp_PFltRgnPerm_C "Fehlerklasse fuer Fehlerpfad Dfp_PFltRgnPerm" VALUE 0xCCB3B Kw_Wu8 20.00 OneToOne 0.00 20.00 FORMAT "%5.2" EXTENDED_LIMITS 0.00 255.0 /end CHARACTERISTIC
/begin CHARACTERISTIC DSM_ClaDfp_PFltTempDwnStrm_C "Fehlerklasse fuer Fehlerpfad Dfp_PFltTempDwnStrm" VALUE 0xCCB3C Kw_Wu8 20.00 OneToOne 0.00 20.00 FORMAT "%5.2" EXTENDED_LIMITS 0.00 255.0 /end CHARACTERISTIC
/begin CHARACTERISTIC DSM_ClaDfp_PFltTempSens_C "Fehlerklasse fuer Fehlerpfad Dfp_PFltTempSens" VALUE 0xCCB3D Kw_Wu8 20.00 OneToOne 0.00 20.00 FORMAT "%5.2" EXTENDED_LIMITS 0.00 255.0 /end CHARACTERISTIC
/begin CHARACTERISTIC DSM_ClaDfp_PFltTempUpStrm_C "Fehlerklasse fuer Fehlerpfad Dfp_PFltTempUpStrm" VALUE 0xCCB3E Kw_Wu8 20.00 OneToOne 0.00 20.00 FORMAT "%5.2" EXTENDED_LIMITS 0.00 255.0 /end CHARACTERISTIC
/begin CHARACTERISTIC DSM_ClaDfp_PFlt_tOxiPreMax_C "Fehlerklasse fuer Fehlerpfad Dfp_PFlt_tOxiPreMax" VALUE 0xCCB3F Kw_Wu8 20.00 OneToOne 0.00 20.00 FORMAT "%5.2" EXTENDED_LIMITS 0.00 255.0 /end CHARACTERISTIC
/begin CHARACTERISTIC DSM_ClaDfp_PFlt_tOxiPreMxRgn_C "Fehlerklasse fuer Fehlerpfad Dfp_PFlt_tOxiPreMxRgn" VALUE 0xCCB40 Kw_Wu8 20.00 OneToOne 0.00 20.00 FORMAT "%5.2" EXTENDED_LIMITS 0.00 255.0 /end CHARACTERISTIC
/begin CHARACTERISTIC DSM_ClaDfp_PFlt_tPreMax_C "Fehlerklasse fuer Fehlerpfad Dfp_PFlt_tPreMax" VALUE 0xCCB41 Kw_Wu8 20.00 OneToOne 0.00 20.00 FORMAT "%5.2" EXTENDED_LIMITS 0.00 255.0 /end CHARACTERISTIC
/begin CHARACTERISTIC DSM_ClaDfp_PFlt_tPreMaxRgn_C "Fehlerklasse fuer Fehlerpfad Dfp_PFlt_tPreMaxRgn" VALUE 0xCCB42 Kw_Wu8 20.00 OneToOne 0.00 20.00 FORMAT "%5.2" EXTENDED_LIMITS 0.00 255.0 /end CHARACTERISTIC
/begin CHARACTERISTIC DSM_ClaDfp_PFltmSotDiffMax_C "Fehlerklasse fuer Fehlerpfad Dfp_PFltmSotDiffMax" VALUE 0xCCB43 Kw_Wu8 20.00 OneToOne 0.00 20.00 FORMAT "%5.2" EXTENDED_LIMITS 0.00 255.0 /end CHARACTERISTIC
/begin CHARACTERISTIC DSM_ClaDfp_PSPCD_Actr_C "Fehlerklasse fuer Fehlerpfad Dfp_PSPCD_Actr" VALUE 0xCCB44 Kw_Wu8 20.00 OneToOne 0.00 20.00 FORMAT "%5.2" EXTENDED_LIMITS 0.00 255.0 /end CHARACTERISTIC
/begin CHARACTERISTIC DSM_ClaDfp_PresPlausDblDef_C "Fehlerklasse fuer Fehlerpfad Dfp_PresPlausDblDef" VALUE 0xCCB45 Kw_Wu8 20.00 OneToOne 0.00 20.00 FORMAT "%5.2" EXTENDED_LIMITS 0.00 255.0 /end CHARACTERISTIC
/begin CHARACTERISTIC DSM_ClaDfp_QLTCD_C "Fehlerklasse fuer Fehlerpfad Dfp_QLTCD" VALUE 0xCCB46 Kw_Wu8 20.00 OneToOne 0.00 20.00 FORMAT "%5.2" EXTENDED_LIMITS 0.00 255.0 /end CHARACTERISTIC
/begin CHARACTERISTIC DSM_ClaDfp_RailCD_C "Fehlerklasse fuer Fehlerpfad Dfp_RailCD" VALUE 0xCCB47 Kw_Wu8 20.00 OneToOne 0.00 20.00 FORMAT "%5.2" EXTENDED_LIMITS 0.00 255.0 /end CHARACTERISTIC
/begin CHARACTERISTIC DSM_ClaDfp_RailCDOfsTst_C "Fehlerklasse fuer Fehlerpfad Dfp_RailCDOfsTst" VALUE 0xCCB48 Kw_Wu8 20.00 OneToOne 0.00 20.00 FORMAT "%5.2" EXTENDED_LIMITS 0.00 255.0 /end CHARACTERISTIC
/begin CHARACTERISTIC DSM_ClaDfp_RailCD_PMonStrt_C "Fehlerklasse fuer Fehlerpfad Dfp_RailCD_PMonStrt" VALUE 0xCCB49 Kw_Wu8 20.00 OneToOne 0.00 20.00 FORMAT "%5.2" EXTENDED_LIMITS 0.00 255.0 /end CHARACTERISTIC
/begin CHARACTERISTIC DSM_ClaDfp_RailCtlModeMeUnDiag_C "Fehlerklasse fuer Fehlerpfad Dfp_RailCtlModeMeUnDiag" VALUE 0xCCB4A Kw_Wu8 20.00 OneToOne 0.00 20.00 FORMAT "%5.2" EXTENDED_LIMITS 0.00 255.0 /end CHARACTERISTIC
/begin CHARACTERISTIC DSM_ClaDfp_RailCtlModePCVDiag_C "Fehlerklasse fuer Fehlerpfad Dfp_RailCtlModePCVDiag" VALUE 0xCCB4B Kw_Wu8 20.00 OneToOne 0.00 20.00 FORMAT "%5.2" EXTENDED_LIMITS 0.00 255.0 /end CHARACTERISTIC
/begin CHARACTERISTIC DSM_ClaDfp_RailMeUn0_C "Fehlerklasse fuer Fehlerpfad Dfp_RailMeUn0" VALUE 0xCCB4C Kw_Wu8 20.00 OneToOne 0.00 20.00 FORMAT "%5.2" EXTENDED_LIMITS 0.00 255.0 /end CHARACTERISTIC
/begin CHARACTERISTIC DSM_ClaDfp_RailMeUn1_C "Fehlerklasse fuer Fehlerpfad Dfp_RailMeUn1" VALUE 0xCCB4D Kw_Wu8 20.00 OneToOne 0.00 20.00 FORMAT "%5.2" EXTENDED_LIMITS 0.00 255.0 /end CHARACTERISTIC
/begin CHARACTERISTIC DSM_ClaDfp_RailMeUn2_C "Fehlerklasse fuer Fehlerpfad Dfp_RailMeUn2" VALUE 0xCCB4E Kw_Wu8 20.00 OneToOne 0.00 20.00 FORMAT "%5.2" EXTENDED_LIMITS 0.00 255.0 /end CHARACTERISTIC
/begin CHARACTERISTIC DSM_ClaDfp_RailMeUn3_C "Fehlerklasse fuer Fehlerpfad Dfp_RailMeUn3" VALUE 0xCCB4F Kw_Wu8 20.00 OneToOne 0.00 20.00 FORMAT "%5.2" EXTENDED_LIMITS 0.00 255.0 /end CHARACTERISTIC
/begin CHARACTERISTIC DSM_ClaDfp_RailMeUn4_C "Fehlerklasse fuer Fehlerpfad Dfp_RailMeUn4" VALUE 0xCCB50 Kw_Wu8 20.00 OneToOne 0.00 20.00 FORMAT "%5.2" EXTENDED_LIMITS 0.00 255.0 /end CHARACTERISTIC
/begin CHARACTERISTIC DSM_ClaDfp_RailPCV0_C "Fehlerklasse fuer Fehlerpfad Dfp_RailPCV0" VALUE 0xCCB51 Kw_Wu8 20.00 OneToOne 0.00 20.00 FORMAT "%5.2" EXTENDED_LIMITS 0.00 255.0 /end CHARACTERISTIC
/begin CHARACTERISTIC DSM_ClaDfp_RailPCV1_C "Fehlerklasse fuer Fehlerpfad Dfp_RailPCV1" VALUE 0xCCB52 Kw_Wu8 20.00 OneToOne 0.00 20.00 FORMAT "%5.2" EXTENDED_LIMITS 0.00 255.0 /end CHARACTERISTIC
/begin CHARACTERISTIC DSM_ClaDfp_RailPCV2_C "Fehlerklasse fuer Fehlerpfad Dfp_RailPCV2" VALUE 0xCCB53 Kw_Wu8 20.00 OneToOne 0.00 20.00 FORMAT "%5.2" EXTENDED_LIMITS 0.00 255.0 /end CHARACTERISTIC
/begin CHARACTERISTIC DSM_ClaDfp_RailPCV3_C "Fehlerklasse fuer Fehlerpfad Dfp_RailPCV3" VALUE 0xCCB54 Kw_Wu8 20.00 OneToOne 0.00 20.00 FORMAT "%5.2" EXTENDED_LIMITS 0.00 255.0 /end CHARACTERISTIC
/begin CHARACTERISTIC DSM_ClaDfp_RailPCV4_C "Fehlerklasse fuer Fehlerpfad Dfp_RailPCV4" VALUE 0xCCB55 Kw_Wu8 20.00 OneToOne 0.00 20.00 FORMAT "%5.2" EXTENDED_LIMITS 0.00 255.0 /end CHARACTERISTIC
/begin CHARACTERISTIC DSM_ClaDfp_RailPCV5_C "Fehlerklasse fuer Fehlerpfad Dfp_RailPCV5" VALUE 0xCCB56 Kw_Wu8 20.00 OneToOne 0.00 20.00 FORMAT "%5.2" EXTENDED_LIMITS 0.00 255.0 /end CHARACTERISTIC
/begin CHARACTERISTIC DSM_ClaDfp_SOPTst_C "Fehlerklasse fuer Fehlerpfad Dfp_SOPTst" VALUE 0xCCB57 Kw_Wu8 20.00 OneToOne 0.00 20.00 FORMAT "%5.2" EXTENDED_LIMITS 0.00 255.0 /end CHARACTERISTIC
/begin CHARACTERISTIC DSM_ClaDfp_SSpMon1_C "Fehlerklasse fuer Fehlerpfad Dfp_SSpMon1" VALUE 0xCCB58 Kw_Wu8 20.00 OneToOne 0.00 20.00 FORMAT "%5.2" EXTENDED_LIMITS 0.00 255.0 /end CHARACTERISTIC
/begin CHARACTERISTIC DSM_ClaDfp_SSpMon2_C "Fehlerklasse fuer Fehlerpfad Dfp_SSpMon2" VALUE 0xCCB59 Kw_Wu8 20.00 OneToOne 0.00 20.00 FORMAT "%5.2" EXTENDED_LIMITS 0.00 255.0 /end CHARACTERISTIC
/begin CHARACTERISTIC DSM_ClaDfp_SSpMon3_C "Fehlerklasse fuer Fehlerpfad Dfp_SSpMon3" VALUE 0xCCB5A Kw_Wu8 20.00 OneToOne 0.00 20.00 FORMAT "%5.2" EXTENDED_LIMITS 0.00 255.0 /end CHARACTERISTIC
/begin CHARACTERISTIC DSM_ClaDfp_SWChk_CycSigChkDat_C "Fehlerklasse fuer Fehlerpfad Dfp_SWChk_CycSigChkDat" VALUE 0xCCB5B Kw_Wu8 20.00 OneToOne 0.00 20.00 FORMAT "%5.2" EXTENDED_LIMITS 0.00 255.0 /end CHARACTERISTIC
/begin CHARACTERISTIC DSM_ClaDfp_SWChk_CycSigChkPrg_C "Fehlerklasse fuer Fehlerpfad Dfp_SWChk_CycSigChkPrg" VALUE 0xCCB5C Kw_Wu8 20.00 OneToOne 0.00 20.00 FORMAT "%5.2" EXTENDED_LIMITS 0.00 255.0 /end CHARACTERISTIC
/begin CHARACTERISTIC DSM_ClaDfp_ShutCD_C "Fehlerklasse fuer Fehlerpfad Dfp_ShutCD" VALUE 0xCCB5D Kw_Wu8 20.00 OneToOne 0.00 20.00 FORMAT "%5.2" EXTENDED_LIMITS 0.00 255.0 /end CHARACTERISTIC
/begin CHARACTERISTIC DSM_ClaDfp_StSysTrqShutOff_C "Fehlerklasse fuer Fehlerpfad Dfp_StSysTrqShutOff" VALUE 0xCCB5E Kw_Wu8 20.00 OneToOne 0.00 20.00 FORMAT "%5.2" EXTENDED_LIMITS 0.00 255.0 /end CHARACTERISTIC
/begin CHARACTERISTIC DSM_ClaDfp_StrtCD_Actr_C "Fehlerklasse fuer Fehlerpfad Dfp_StrtCD_Actr" VALUE 0xCCB5F Kw_Wu8 20.00 OneToOne 0.00 20.00 FORMAT "%5.2" EXTENDED_LIMITS 0.00 255.0 /end CHARACTERISTIC
/begin CHARACTERISTIC DSM_ClaDfp_SysLamp_C "Fehlerklasse fuer Fehlerpfad Dfp_SysLamp" VALUE 0xCCB60 Kw_Wu8 20.00 OneToOne 0.00 20.00 FORMAT "%5.2" EXTENDED_LIMITS 0.00 255.0 /end CHARACTERISTIC
/begin CHARACTERISTIC DSM_ClaDfp_T15CD_C "Fehlerklasse fuer Fehlerpfad Dfp_T15CD" VALUE 0xCCB61 Kw_Wu8 20.00 OneToOne 0.00 20.00 FORMAT "%5.2" EXTENDED_LIMITS 0.00 255.0 /end CHARACTERISTIC
/begin CHARACTERISTIC DSM_ClaDfp_TGearbx_C "Fehlerklasse fuer Fehlerpfad Dfp_TGearbx" VALUE 0xCCB62 Kw_Wu8 20.00 OneToOne 0.00 20.00 FORMAT "%5.2" EXTENDED_LIMITS 0.00 255.0 /end CHARACTERISTIC
/begin CHARACTERISTIC DSM_ClaDfp_TPUMon_C "Fehlerklasse fuer Fehlerpfad Dfp_TPUMon" VALUE 0xCCB63 Kw_Wu8 20.00 OneToOne 0.00 20.00 FORMAT "%5.2" EXTENDED_LIMITS 0.00 255.0 /end CHARACTERISTIC
/begin CHARACTERISTIC DSM_ClaDfp_TVACD_Max_C "Fehlerklasse fuer Fehlerpfad Dfp_TVACD_Max" VALUE 0xCCB64 Kw_Wu8 20.00 OneToOne 0.00 20.00 FORMAT "%5.2" EXTENDED_LIMITS 0.00 255.0 /end CHARACTERISTIC
/begin CHARACTERISTIC DSM_ClaDfp_TVACD_Min_C "Fehlerklasse fuer Fehlerpfad Dfp_TVACD_Min" VALUE 0xCCB65 Kw_Wu8 20.00 OneToOne 0.00 20.00 FORMAT "%5.2" EXTENDED_LIMITS 0.00 255.0 /end CHARACTERISTIC
/begin CHARACTERISTIC DSM_ClaDfp_TVACD_SigNpl_C "Fehlerklasse fuer Fehlerpfad Dfp_TVACD_SigNpl" VALUE 0xCCB66 Kw_Wu8 20.00 OneToOne 0.00 20.00 FORMAT "%5.2" EXTENDED_LIMITS 0.00 255.0 /end CHARACTERISTIC
/begin CHARACTERISTIC DSM_ClaDfp_TVACD_TVADia1_C "Fehlerklasse fuer Fehlerpfad Dfp_TVACD_TVADia1" VALUE 0xCCB67 Kw_Wu8 20.00 OneToOne 0.00 20.00 FORMAT "%5.2" EXTENDED_LIMITS 0.00 255.0 /end CHARACTERISTIC
/begin CHARACTERISTIC DSM_ClaDfp_TVACD_TVADia2_C "Fehlerklasse fuer Fehlerpfad Dfp_TVACD_TVADia2" VALUE 0xCCB68 Kw_Wu8 20.00 OneToOne 0.00 20.00 FORMAT "%5.2" EXTENDED_LIMITS 0.00 255.0 /end CHARACTERISTIC
/begin CHARACTERISTIC DSM_ClaDfp_TVACD_TVADia3_C "Fehlerklasse fuer Fehlerpfad Dfp_TVACD_TVADia3" VALUE 0xCCB69 Kw_Wu8 20.00 OneToOne 0.00 20.00 FORMAT "%5.2" EXTENDED_LIMITS 0.00 255.0 /end CHARACTERISTIC
/begin CHARACTERISTIC DSM_ClaDfp_TVACD_TVADia4_C "Fehlerklasse fuer Fehlerpfad Dfp_TVACD_TVADia4" VALUE 0xCCB6A Kw_Wu8 20.00 OneToOne 0.00 20.00 FORMAT "%5.2" EXTENDED_LIMITS 0.00 255.0 /end CHARACTERISTIC
/begin CHARACTERISTIC DSM_ClaDfp_ThrVlvMon_C "Fehlerklasse fuer Fehlerpfad Dfp_ThrVlvMon" VALUE 0xCCB6B Kw_Wu8 20.00 OneToOne 0.00 20.00 FORMAT "%5.2" EXTENDED_LIMITS 0.00 255.0 /end CHARACTERISTIC
/begin CHARACTERISTIC DSM_ClaDfp_VSACD_DiaDet_C "Fehlerklasse fuer Fehlerpfad Dfp_VSACD_DiaDet" VALUE 0xCCB6C Kw_Wu8 20.00 OneToOne 0.00 20.00 FORMAT "%5.2" EXTENDED_LIMITS 0.00 255.0 /end CHARACTERISTIC
/begin CHARACTERISTIC DSM_ClaDfp_VSACD_DioInDia1_C "Fehlerklasse fuer Fehlerpfad Dfp_VSACD_DioInDia1" VALUE 0xCCB6D Kw_Wu8 20.00 OneToOne 0.00 20.00 FORMAT "%5.2" EXTENDED_LIMITS 0.00 255.0 /end CHARACTERISTIC
/begin CHARACTERISTIC DSM_ClaDfp_VSACD_DioInDia2_C "Fehlerklasse fuer Fehlerpfad Dfp_VSACD_DioInDia2" VALUE 0xCCB6E Kw_Wu8 20.00 OneToOne 0.00 20.00 FORMAT "%5.2" EXTENDED_LIMITS 0.00 255.0 /end CHARACTERISTIC
/begin CHARACTERISTIC DSM_ClaDfp_VSACD_DioInDia3_C "Fehlerklasse fuer Fehlerpfad Dfp_VSACD_DioInDia3" VALUE 0xCCB6F Kw_Wu8 20.00 OneToOne 0.00 20.00 FORMAT "%5.2" EXTENDED_LIMITS 0.00 255.0 /end CHARACTERISTIC
/begin CHARACTERISTIC DSM_ClaDfp_VSACD_DioInDia4_C "Fehlerklasse fuer Fehlerpfad Dfp_VSACD_DioInDia4" VALUE 0xCCB70 Kw_Wu8 20.00 OneToOne 0.00 20.00 FORMAT "%5.2" EXTENDED_LIMITS 0.00 255.0 /end CHARACTERISTIC
/begin CHARACTERISTIC DSM_ClaDfp_VSACD_DioInMin_C "Fehlerklasse fuer Fehlerpfad Dfp_VSACD_DioInMin" VALUE 0xCCB71 Kw_Wu8 20.00 OneToOne 0.00 20.00 FORMAT "%5.2" EXTENDED_LIMITS 0.00 255.0 /end CHARACTERISTIC
/begin CHARACTERISTIC DSM_ClaDfp_VSACD_Max_C "Fehlerklasse fuer Fehlerpfad Dfp_VSACD_Max" VALUE 0xCCB72 Kw_Wu8 20.00 OneToOne 0.00 20.00 FORMAT "%5.2" EXTENDED_LIMITS 0.00 255.0 /end CHARACTERISTIC
/begin CHARACTERISTIC DSM_ClaDfp_VSACD_Min_C "Fehlerklasse fuer Fehlerpfad Dfp_VSACD_Min" VALUE 0xCCB73 Kw_Wu8 20.00 OneToOne 0.00 20.00 FORMAT "%5.2" EXTENDED_LIMITS 0.00 255.0 /end CHARACTERISTIC
/begin CHARACTERISTIC DSM_ClaDfp_VSACD_SigNpl_C "Fehlerklasse fuer Fehlerpfad Dfp_VSACD_SigNpl" VALUE 0xCCB74 Kw_Wu8 20.00 OneToOne 0.00 20.00 FORMAT "%5.2" EXTENDED_LIMITS 0.00 255.0 /end CHARACTERISTIC
/begin CHARACTERISTIC DSM_ClaDfp_VSACD_VSADia1_C "Fehlerklasse fuer Fehlerpfad Dfp_VSACD_VSADia1" VALUE 0xCCB75 Kw_Wu8 20.00 OneToOne 0.00 20.00 FORMAT "%5.2" EXTENDED_LIMITS 0.00 255.0 /end CHARACTERISTIC
/begin CHARACTERISTIC DSM_ClaDfp_VSACD_VSADia2_C "Fehlerklasse fuer Fehlerpfad Dfp_VSACD_VSADia2" VALUE 0xCCB76 Kw_Wu8 20.00 OneToOne 0.00 20.00 FORMAT "%5.2" EXTENDED_LIMITS 0.00 255.0 /end CHARACTERISTIC
/begin CHARACTERISTIC DSM_ClaDfp_VSACD_VSADia3_C "Fehlerklasse fuer Fehlerpfad Dfp_VSACD_VSADia3" VALUE 0xCCB77 Kw_Wu8 20.00 OneToOne 0.00 20.00 FORMAT "%5.2" EXTENDED_LIMITS 0.00 255.0 /end CHARACTERISTIC
/begin CHARACTERISTIC DSM_ClaDfp_VSACD_VSADia4_C "Fehlerklasse fuer Fehlerpfad Dfp_VSACD_VSADia4" VALUE 0xCCB78 Kw_Wu8 20.00 OneToOne 0.00 20.00 FORMAT "%5.2" EXTENDED_LIMITS 0.00 255.0 /end CHARACTERISTIC
/begin CHARACTERISTIC DSM_ClaDfp_VSSCD1_C "Fehlerklasse fuer Fehlerpfad Dfp_VSSCD1" VALUE 0xCCB79 Kw_Wu8 20.00 OneToOne 0.00 20.00 FORMAT "%5.2" EXTENDED_LIMITS 0.00 255.0 /end CHARACTERISTIC
/begin CHARACTERISTIC DSM_ClaDfp_VSSCD2_C "Fehlerklasse fuer Fehlerpfad Dfp_VSSCD2" VALUE 0xCCB7A Kw_Wu8 20.00 OneToOne 0.00 20.00 FORMAT "%5.2" EXTENDED_LIMITS 0.00 255.0 /end CHARACTERISTIC
/begin CHARACTERISTIC DSM_ClaDfp_WdCom_C "Fehlerklasse fuer Fehlerpfad Dfp_WdCom" VALUE 0xCCB7B Kw_Wu8 20.00 OneToOne 0.00 20.00 FORMAT "%5.2" EXTENDED_LIMITS 0.00 255.0 /end CHARACTERISTIC
/begin FUNCTION dsm_auto_cdk ""
 /begin DEF_CHARACTERISTIC DSM_CDKDfp_Layer_TANS_C DSM_CDKDfp_ACCDCmpr_C DSM_CDKDfp_ACCDPres_C DSM_CDKDfp_ACCDPres1_C DSM_CDKDfp_ACCDPresAna_C DSM_CDKDfp_ACCDSwtin_C DSM_CDKDfp_ACC_PlausTrqDes_C DSM_CDKDfp_ACC_trqInr_C DSM_CDKDfp_ACTrq_C DSM_CDKDfp_ADCMon_C DSM_CDKDfp_AFSCDIdlAdjVal_C DSM_CDKDfp_AFSCDLdAdjVal_C DSM_CDKDfp_AFSCD_AirTempDcyc_C DSM_CDKDfp_AFSCD_PlOffsDrft_C DSM_CDKDfp_AFSCD_PlSetyDrft_C DSM_CDKDfp_AFSCD_SRCAirTemp_C DSM_CDKDfp_AFSCD_SRCBatt_C DSM_CDKDfp_AFSCD_SRCCorrAirm_C DSM_CDKDfp_AFSCD_SRCRawAirm_C DSM_CDKDfp_Layer_TUMG_C DSM_CDKDfp_AFSCD_SRCRefSigPer_C DSM_CDKDfp_AOHtCD_C DSM_CDKDfp_Layer_GEN_C DSM_CDKDfp_Layer_BSD_C DSM_CDKDfp_AOHtCD_AOHtDia1_C DSM_CDKDfp_AOHtCD_AOHtDia2_C DSM_CDKDfp_AOHtCD_AOHtDia3_C DSM_CDKDfp_APP1_C DSM_CDKDfp_APP2_C DSM_CDKDfp_APPCDCmpd_C DSM_CDKDfp_APPSync_C DSM_CDKDfp_APSCD_C DSM_CDKDfp_ARS_C DSM_CDKDfp_AccPedPlausBrk_C DSM_CDKDfp_Layer_QLT_C DSM_CDKDfp_AirCtlGvnrDvtRgnMax_C DSM_CDKDfp_Layer_IBS1_C DSM_CDKDfp_Layer_IBS2_C DSM_CDKDfp_Layer_IBS3_C DSM_CDKDfp_Layer_PMBN_C DSM_CDKDfp_Layer_PMBATT_C DSM_CDKDfp_AirCtlGvnrDvtRgnMin_C DSM_CDKDfp_AirCtlGvnrDvtRgnMn2_C DSM_CDKDfp_AirCtlGvnrDvtRgnMx2_C DSM_CDKDfp_AirCtlPlateBreak_C DSM_CDKDfp_AirCtlRmpTO_C DSM_CDKDfp_AirCtl_GovNegDev_C DSM_CDKDfp_AirCtl_GovNegDev2_C DSM_CDKDfp_AirCtl_GovPosDev_C DSM_CDKDfp_AirCtl_GovPosDev2_C DSM_CDKDfp_AltCD_C DSM_CDKDfp_AltCD_Load_C DSM_CDKDfp_BPACD_BPADia1_C DSM_CDKDfp_BPACD_BPADia2_C DSM_CDKDfp_BPACD_BPADia3_C DSM_CDKDfp_BPACD_BPADia4_C DSM_CDKDfp_BPACD_Max_C DSM_CDKDfp_BPACD_Min_C DSM_CDKDfp_BPACD_PwmIn_C DSM_CDKDfp_BPACD_PwmInDia1_C DSM_CDKDfp_BPACD_PwmInDia2_C DSM_CDKDfp_BPACD_PwmInDia3_C DSM_CDKDfp_BPACD_PwmInDia4_C DSM_CDKDfp_BPACD_SigNpl_C DSM_CDKDfp_BPSCD_C DSM_CDKDfp_BattCD_C DSM_CDKDfp_BrkCD_C DSM_CDKDfp_Bss_C DSM_CDKDfp_CBACD_C DSM_CDKDfp_CTSCD_C DSM_CDKDfp_Clg_DynTst_C DSM_CDKDfp_CmbChbMisfire1_C DSM_CDKDfp_CmbChbMisfire2_C DSM_CDKDfp_Layer_PMRUHVERL_C DSM_CDKDfp_CmbChbMisfire3_C DSM_CDKDfp_CmbChbMisfire4_C DSM_CDKDfp_CmbChbMisfire5_C DSM_CDKDfp_CmbChbMisfire6_C DSM_CDKDfp_Layer_TOENS_C DSM_CDKDfp_Layer_MANHYDR_C DSM_CDKDfp_Layer_MANLUFT_C DSM_CDKDfp_CmbChbMisfireMul_C DSM_CDKDfp_CoVMDCSh_C DSM_CDKDfp_ConvCD_C DSM_CDKDfp_CrCCDMFL_C DSM_CDKDfp_CrCtl_vCrCtl_C DSM_CDKDfp_DCC_PlausTrqDes_C DSM_CDKDfp_Dummy1_C DSM_CDKDfp_EATSCD_C DSM_CDKDfp_EBAFCD_C DSM_CDKDfp_EBFCD_C DSM_CDKDfp_EBTSCD_C DSM_CDKDfp_EBTSCD_OvrTemp_C DSM_CDKDfp_ECBCD_C DSM_CDKDfp_EEPCDVarMng_C DSM_CDKDfp_EGPpCD_C DSM_CDKDfp_EGPpCDTPreTrbn_C DSM_CDKDfp_EGRCD_Max_C DSM_CDKDfp_EGRCD_Min_C DSM_CDKDfp_EGRCD_SigNpl_C DSM_CDKDfp_EGTOilLvlCrit_C DSM_CDKDfp_EGTOilVscCrit_C DSM_CDKDfp_EGTRgnOilDil_C DSM_CDKDfp_EGTTempGvnrInr_C DSM_CDKDfp_EGTTempGvnrOutr_C DSM_CDKDfp_EMCCD1_C DSM_CDKDfp_EMCCD2_C DSM_CDKDfp_EMCCD_ADC1_C DSM_CDKDfp_EMCCD_ADC2_C DSM_CDKDfp_ETClbETFltInj1_C DSM_CDKDfp_ETClbETFltInj2_C DSM_CDKDfp_ETClbETFltInj3_C DSM_CDKDfp_ETClbETFltInj4_C DSM_CDKDfp_ETClbETFltInj5_C DSM_CDKDfp_ETClbETFltInj6_C DSM_CDKDfp_ETClbInj1_C DSM_CDKDfp_ETClbInj2_C DSM_CDKDfp_ETClbInj3_C DSM_CDKDfp_ETClbInj4_C DSM_CDKDfp_ETClbInj5_C DSM_CDKDfp_ETClbInj6_C DSM_CDKDfp_EngMCaS1_C DSM_CDKDfp_EngMCrS1_C DSM_CDKDfp_EngMOfsCaSCrS_C DSM_CDKDfp_EngPrtFWODet_C DSM_CDKDfp_FBCqDvt_C DSM_CDKDfp_FMAErrMod_C DSM_CDKDfp_FMTC_NonMonotonMap_C DSM_CDKDfp_FTSCD_C DSM_CDKDfp_FanCD_C DSM_CDKDfp_FanCD_FanCtlr1_C DSM_CDKDfp_FanCD_FanCtlr2_C DSM_CDKDfp_FanCD_FanCtlr3_C DSM_CDKDfp_FlFCD_C DSM_CDKDfp_FlMngSmkDefect_C DSM_CDKDfp_FrmMngANFRADMOMPT_C DSM_CDKDfp_FrmMngASC1_C DSM_CDKDfp_FrmMngASC2_C DSM_CDKDfp_FrmMngASC3_C DSM_CDKDfp_FrmMngASC4_C DSM_CDKDfp_FrmMngBOS_RESET_C DSM_CDKDfp_FrmMngBOS_RESET2_C DSM_CDKDfp_FrmMngDMANFAFS_C DSM_CDKDfp_FrmMngDRMANFSSG_C DSM_CDKDfp_FrmMngEGS1_C DSM_CDKDfp_FrmMngEGS2_C DSM_CDKDfp_FrmMngGEARBX_DATA_C DSM_CDKDfp_FrmMngGEARBX_DATA2_C DSM_CDKDfp_FrmMngHEAT_AC_C DSM_CDKDfp_FrmMngINSTR2_C DSM_CDKDfp_FrmMngINSTR3_C DSM_CDKDfp_FrmMngLENKRADWINKEL_C DSM_CDKDfp_FrmMngMILEAGE_RANGE_C DSM_CDKDfp_FrmMngOPCRCTLACC_C DSM_CDKDfp_FrmMngPRGG_CCTR_C DSM_CDKDfp_FrmMngPWRMNG_LOADV_C DSM_CDKDfp_FrmMngParkConsumer_C DSM_CDKDfp_FrmMngRQSTGEFAN_C DSM_CDKDfp_FrmMngSSGErr_C DSM_CDKDfp_FrmMngSSGShOff_C DSM_CDKDfp_FrmMngSTAT_ANH_C DSM_CDKDfp_FrmMngSTAT_ARS_C DSM_CDKDfp_FrmMngSTAT_DSC_C DSM_CDKDfp_FrmMngSTAT_EKP_C DSM_CDKDfp_FrmMngSTAT_KOMBI_C DSM_CDKDfp_FrmMngSTAT_SITZ_C DSM_CDKDfp_FrmMngStOBDGbxMilOf_C DSM_CDKDfp_FrmMngStOBDGbxMilOn_C DSM_CDKDfp_FrmMngTEMPRELTIME_C DSM_CDKDfp_FrmMngTERMINAL_C DSM_CDKDfp_FrmMngTIME_DATE_C DSM_CDKDfp_FrmMngTORQUE_DSC_C DSM_CDKDfp_FrmMngTORQUE_GEARBX_C DSM_CDKDfp_FrmMngTrq_ReqACC_C DSM_CDKDfp_FrmMngVEH_MOD_C DSM_CDKDfp_FrmMngVELOCITY_C DSM_CDKDfp_FrmMngWHEEL_SPEED_C DSM_CDKDfp_FrmMngstCurr_C DSM_CDKDfp_FrmMngswtPSPOff_C DSM_CDKDfp_GearbxIncMax_C DSM_CDKDfp_GlwCD_C DSM_CDKDfp_GlwCDGlwCirc1_C DSM_CDKDfp_GlwCDGlwCirc2_C DSM_CDKDfp_GlwCDGlwCirc3_C DSM_CDKDfp_GlwCDGlwCirc4_C DSM_CDKDfp_GlwCDGlwCirc5_C DSM_CDKDfp_GlwCDGlwCirc6_C DSM_CDKDfp_GlwCDGlwCirc7_C DSM_CDKDfp_GlwCDGlwCirc8_C DSM_CDKDfp_GlwCtl_C DSM_CDKDfp_HWEMonCom_C DSM_CDKDfp_HWEMonEEPROM_C DSM_CDKDfp_HWEMonRcyLocked_C DSM_CDKDfp_HWEMonRcySuppressed_C DSM_CDKDfp_HWEMonRcyVisible_C DSM_CDKDfp_HWEMonUMaxSupply_C DSM_CDKDfp_HWEMonUMinSupply_C DSM_CDKDfp_IATSCD_C DSM_CDKDfp_IATSCD_CATS_C DSM_CDKDfp_ImmCtlImmCD_C DSM_CDKDfp_ImmCtlImmEep_C DSM_CDKDfp_ImmCtlMpl_C DSM_CDKDfp_IndSys1_C DSM_CDKDfp_IndSys2_C DSM_CDKDfp_InjCrv_InjLim_C DSM_CDKDfp_InjCtlAdjQnt_C DSM_CDKDfp_InjCtlDrift_C DSM_CDKDfp_InjVlvBnk1A_C DSM_CDKDfp_InjVlvBnk1B_C DSM_CDKDfp_InjVlvBnk2A_C DSM_CDKDfp_InjVlvBnk2B_C DSM_CDKDfp_InjVlvChipA_C DSM_CDKDfp_InjVlvChipB_C DSM_CDKDfp_InjVlvCyl1A_C DSM_CDKDfp_InjVlvCyl1B_C DSM_CDKDfp_InjVlvCyl2A_C DSM_CDKDfp_InjVlvCyl2B_C DSM_CDKDfp_InjVlvCyl3A_C DSM_CDKDfp_InjVlvCyl3B_C DSM_CDKDfp_InjVlvCyl4A_C DSM_CDKDfp_InjVlvCyl4B_C DSM_CDKDfp_InjVlvCyl5A_C DSM_CDKDfp_InjVlvCyl5B_C DSM_CDKDfp_InjVlvCyl6A_C DSM_CDKDfp_InjVlvCyl6B_C DSM_CDKDfp_KeyCheck_C DSM_CDKDfp_LIGovECUTransMode_C DSM_CDKDfp_LPACD_Max_C DSM_CDKDfp_LPACD_Min_C DSM_CDKDfp_LPACD_SigNpl_C DSM_CDKDfp_LSUCDCircNernst0_C DSM_CDKDfp_LSUCDCircPumpCur0_C DSM_CDKDfp_LSUCDCircVirtGnd0_C DSM_CDKDfp_LSUCDHeater0_C DSM_CDKDfp_LSUCDHtCoup0_C DSM_CDKDfp_LSUCDO20_C DSM_CDKDfp_LSUCDO2Clb0_C DSM_CDKDfp_LSUCDRiClb0_C DSM_CDKDfp_LSUCDSPI0_C DSM_CDKDfp_LSUCDSPIBattLow0_C DSM_CDKDfp_LSUCDWireIP0_C DSM_CDKDfp_LSUCtlRiExc0_C DSM_CDKDfp_LSUMon1Sens_C DSM_CDKDfp_LSUMon2Sens_C DSM_CDKDfp_MIL_C DSM_CDKDfp_MRlyCD_C DSM_CDKDfp_MSidCD_Comm_C DSM_CDKDfp_MSidCD_Pin_C DSM_CDKDfp_MSidCD_Sel_INI_C DSM_CDKDfp_MSidCD_Select_C DSM_CDKDfp_MeUnCDNoLoad_C DSM_CDKDfp_MeUnCDSCBat_C DSM_CDKDfp_MeUnCDSCGnd_C DSM_CDKDfp_MeUnCD_ADC_C DSM_CDKDfp_MeUnCD_SigTst_C DSM_CDKDfp_Montr_C DSM_CDKDfp_NetMngDeviceA_C DSM_CDKDfp_NetMngDeviceB_C DSM_CDKDfp_NetMngDeviceC_C DSM_CDKDfp_NetMngPtCan_C DSM_CDKDfp_OPSCD_Lamp_C DSM_CDKDfp_OPSCD_anain_C DSM_CDKDfp_OTSCD_C DSM_CDKDfp_OvRMon_C DSM_CDKDfp_OvRMonSigA_C DSM_CDKDfp_OxiCCDTPre_C DSM_CDKDfp_PCBS_C DSM_CDKDfp_PCR_GovDevNeg_C DSM_CDKDfp_PCR_GovDevPos_C DSM_CDKDfp_PCR_LPGvnrDvtNeg_C DSM_CDKDfp_PCR_LPGvnrDvtPos_C DSM_CDKDfp_PCVCDNoLoad_C DSM_CDKDfp_PCVCDSCBat_C DSM_CDKDfp_PCVCDSCGnd_C DSM_CDKDfp_PCVCD_ADC_C DSM_CDKDfp_PCVCD_SigTst_C DSM_CDKDfp_PFltAPSPlaus_C DSM_CDKDfp_PFltAPSens_C DSM_CDKDfp_PFltBPSPlaus_C DSM_CDKDfp_PFltCDPPre_C DSM_CDKDfp_PFltCDTempPre_C DSM_CDKDfp_PFltChar_C DSM_CDKDfp_PFltEngPrt_C DSM_CDKDfp_PFltOvldInhRgn_C DSM_CDKDfp_PFltOvldTrqLim_C DSM_CDKDfp_PFltPresDynPlaus_C DSM_CDKDfp_PFltPresPlaus_C DSM_CDKDfp_PFltPresSens_C DSM_CDKDfp_PFltPresSensFrz_C DSM_CDKDfp_PFltPresSensHsLn_C DSM_CDKDfp_PFltPresSensSot_C DSM_CDKDfp_PFltRgnPerm_C DSM_CDKDfp_PFltTempDwnStrm_C DSM_CDKDfp_PFltTempSens_C DSM_CDKDfp_PFltTempUpStrm_C DSM_CDKDfp_PFlt_tOxiPreMax_C DSM_CDKDfp_PFlt_tOxiPreMxRgn_C DSM_CDKDfp_PFlt_tPreMax_C DSM_CDKDfp_PFlt_tPreMaxRgn_C DSM_CDKDfp_PFltmSotDiffMax_C DSM_CDKDfp_PSPCD_Actr_C DSM_CDKDfp_PresPlausDblDef_C DSM_CDKDfp_QLTCD_C DSM_CDKDfp_RailCD_C DSM_CDKDfp_RailCDOfsTst_C DSM_CDKDfp_RailCD_PMonStrt_C DSM_CDKDfp_RailCtlModeMeUnDiag_C DSM_CDKDfp_RailCtlModePCVDiag_C DSM_CDKDfp_RailMeUn0_C DSM_CDKDfp_RailMeUn1_C DSM_CDKDfp_RailMeUn2_C DSM_CDKDfp_RailMeUn3_C DSM_CDKDfp_RailMeUn4_C DSM_CDKDfp_RailPCV0_C DSM_CDKDfp_RailPCV1_C DSM_CDKDfp_RailPCV2_C DSM_CDKDfp_RailPCV3_C DSM_CDKDfp_RailPCV4_C DSM_CDKDfp_RailPCV5_C DSM_CDKDfp_SOPTst_C DSM_CDKDfp_SSpMon1_C DSM_CDKDfp_SSpMon2_C DSM_CDKDfp_SSpMon3_C DSM_CDKDfp_SWChk_CycSigChkDat_C DSM_CDKDfp_SWChk_CycSigChkPrg_C DSM_CDKDfp_ShutCD_C DSM_CDKDfp_StSysTrqShutOff_C DSM_CDKDfp_StrtCD_Actr_C DSM_CDKDfp_SysLamp_C DSM_CDKDfp_T15CD_C DSM_CDKDfp_TGearbx_C DSM_CDKDfp_TPUMon_C DSM_CDKDfp_TVACD_Max_C DSM_CDKDfp_TVACD_Min_C DSM_CDKDfp_TVACD_SigNpl_C DSM_CDKDfp_TVACD_TVADia1_C DSM_CDKDfp_TVACD_TVADia2_C DSM_CDKDfp_TVACD_TVADia3_C DSM_CDKDfp_TVACD_TVADia4_C DSM_CDKDfp_ThrVlvMon_C DSM_CDKDfp_VSACD_DiaDet_C DSM_CDKDfp_VSACD_DioInDia1_C DSM_CDKDfp_VSACD_DioInDia2_C DSM_CDKDfp_VSACD_DioInDia3_C DSM_CDKDfp_VSACD_DioInDia4_C DSM_CDKDfp_VSACD_DioInMin_C DSM_CDKDfp_VSACD_Max_C DSM_CDKDfp_VSACD_Min_C DSM_CDKDfp_VSACD_SigNpl_C DSM_CDKDfp_VSACD_VSADia1_C DSM_CDKDfp_VSACD_VSADia2_C DSM_CDKDfp_VSACD_VSADia3_C DSM_CDKDfp_VSACD_VSADia4_C DSM_CDKDfp_VSSCD1_C DSM_CDKDfp_VSSCD2_C DSM_CDKDfp_WdCom_C /end DEF_CHARACTERISTIC
/end FUNCTION
/begin FUNCTION dsm_auto_debclass ""
 /begin DEF_CHARACTERISTIC DSM_ClaDfp_Layer_TANS_C DSM_ClaDfp_ACCDCmpr_C DSM_ClaDfp_ACCDPres_C DSM_ClaDfp_ACCDPres1_C DSM_ClaDfp_ACCDPresAna_C DSM_ClaDfp_ACCDSwtin_C DSM_ClaDfp_ACC_PlausTrqDes_C DSM_ClaDfp_ACC_trqInr_C DSM_ClaDfp_ACTrq_C DSM_ClaDfp_ADCMon_C DSM_ClaDfp_AFSCDIdlAdjVal_C DSM_ClaDfp_AFSCDLdAdjVal_C DSM_ClaDfp_AFSCD_AirTempDcyc_C DSM_ClaDfp_AFSCD_PlOffsDrft_C DSM_ClaDfp_AFSCD_PlSetyDrft_C DSM_ClaDfp_AFSCD_SRCAirTemp_C DSM_ClaDfp_AFSCD_SRCBatt_C DSM_ClaDfp_AFSCD_SRCCorrAirm_C DSM_ClaDfp_AFSCD_SRCRawAirm_C DSM_ClaDfp_Layer_TUMG_C DSM_ClaDfp_AFSCD_SRCRefSigPer_C DSM_ClaDfp_AOHtCD_C DSM_ClaDfp_Layer_GEN_C DSM_ClaDfp_Layer_BSD_C DSM_ClaDfp_AOHtCD_AOHtDia1_C DSM_ClaDfp_AOHtCD_AOHtDia2_C DSM_ClaDfp_AOHtCD_AOHtDia3_C DSM_ClaDfp_APP1_C DSM_ClaDfp_APP2_C DSM_ClaDfp_APPCDCmpd_C DSM_ClaDfp_APPSync_C DSM_ClaDfp_APSCD_C DSM_ClaDfp_ARS_C DSM_ClaDfp_AccPedPlausBrk_C DSM_ClaDfp_Layer_QLT_C DSM_ClaDfp_AirCtlGvnrDvtRgnMax_C DSM_ClaDfp_Layer_IBS1_C DSM_ClaDfp_Layer_IBS2_C DSM_ClaDfp_Layer_IBS3_C DSM_ClaDfp_Layer_PMBN_C DSM_ClaDfp_Layer_PMBATT_C DSM_ClaDfp_AirCtlGvnrDvtRgnMin_C DSM_ClaDfp_AirCtlGvnrDvtRgnMn2_C DSM_ClaDfp_AirCtlGvnrDvtRgnMx2_C DSM_ClaDfp_AirCtlPlateBreak_C DSM_ClaDfp_AirCtlRmpTO_C DSM_ClaDfp_AirCtl_GovNegDev_C DSM_ClaDfp_AirCtl_GovNegDev2_C DSM_ClaDfp_AirCtl_GovPosDev_C DSM_ClaDfp_AirCtl_GovPosDev2_C DSM_ClaDfp_AltCD_C DSM_ClaDfp_AltCD_Load_C DSM_ClaDfp_BPACD_BPADia1_C DSM_ClaDfp_BPACD_BPADia2_C DSM_ClaDfp_BPACD_BPADia3_C DSM_ClaDfp_BPACD_BPADia4_C DSM_ClaDfp_BPACD_Max_C DSM_ClaDfp_BPACD_Min_C DSM_ClaDfp_BPACD_PwmIn_C DSM_ClaDfp_BPACD_PwmInDia1_C DSM_ClaDfp_BPACD_PwmInDia2_C DSM_ClaDfp_BPACD_PwmInDia3_C DSM_ClaDfp_BPACD_PwmInDia4_C DSM_ClaDfp_BPACD_SigNpl_C DSM_ClaDfp_BPSCD_C DSM_ClaDfp_BattCD_C DSM_ClaDfp_BrkCD_C DSM_ClaDfp_Bss_C DSM_ClaDfp_CBACD_C DSM_ClaDfp_CTSCD_C DSM_ClaDfp_Clg_DynTst_C DSM_ClaDfp_CmbChbMisfire1_C DSM_ClaDfp_CmbChbMisfire2_C DSM_ClaDfp_Layer_PMRUHVERL_C DSM_ClaDfp_CmbChbMisfire3_C DSM_ClaDfp_CmbChbMisfire4_C DSM_ClaDfp_CmbChbMisfire5_C DSM_ClaDfp_CmbChbMisfire6_C DSM_ClaDfp_Layer_TOENS_C DSM_ClaDfp_Layer_MANHYDR_C DSM_ClaDfp_Layer_MANLUFT_C DSM_ClaDfp_CmbChbMisfireMul_C DSM_ClaDfp_CoVMDCSh_C DSM_ClaDfp_ConvCD_C DSM_ClaDfp_CrCCDMFL_C DSM_ClaDfp_CrCtl_vCrCtl_C DSM_ClaDfp_DCC_PlausTrqDes_C DSM_ClaDfp_Dummy1_C DSM_ClaDfp_EATSCD_C DSM_ClaDfp_EBAFCD_C DSM_ClaDfp_EBFCD_C DSM_ClaDfp_EBTSCD_C DSM_ClaDfp_EBTSCD_OvrTemp_C DSM_ClaDfp_ECBCD_C DSM_ClaDfp_EEPCDVarMng_C DSM_ClaDfp_EGPpCD_C DSM_ClaDfp_EGPpCDTPreTrbn_C DSM_ClaDfp_EGRCD_Max_C DSM_ClaDfp_EGRCD_Min_C DSM_ClaDfp_EGRCD_SigNpl_C DSM_ClaDfp_EGTOilLvlCrit_C DSM_ClaDfp_EGTOilVscCrit_C DSM_ClaDfp_EGTRgnOilDil_C DSM_ClaDfp_EGTTempGvnrInr_C DSM_ClaDfp_EGTTempGvnrOutr_C DSM_ClaDfp_EMCCD1_C DSM_ClaDfp_EMCCD2_C DSM_ClaDfp_EMCCD_ADC1_C DSM_ClaDfp_EMCCD_ADC2_C DSM_ClaDfp_ETClbETFltInj1_C DSM_ClaDfp_ETClbETFltInj2_C DSM_ClaDfp_ETClbETFltInj3_C DSM_ClaDfp_ETClbETFltInj4_C DSM_ClaDfp_ETClbETFltInj5_C DSM_ClaDfp_ETClbETFltInj6_C DSM_ClaDfp_ETClbInj1_C DSM_ClaDfp_ETClbInj2_C DSM_ClaDfp_ETClbInj3_C DSM_ClaDfp_ETClbInj4_C DSM_ClaDfp_ETClbInj5_C DSM_ClaDfp_ETClbInj6_C DSM_ClaDfp_EngMCaS1_C DSM_ClaDfp_EngMCrS1_C DSM_ClaDfp_EngMOfsCaSCrS_C DSM_ClaDfp_EngPrtFWODet_C DSM_ClaDfp_FBCqDvt_C DSM_ClaDfp_FMAErrMod_C DSM_ClaDfp_FMTC_NonMonotonMap_C DSM_ClaDfp_FTSCD_C DSM_ClaDfp_FanCD_C DSM_ClaDfp_FanCD_FanCtlr1_C DSM_ClaDfp_FanCD_FanCtlr2_C DSM_ClaDfp_FanCD_FanCtlr3_C DSM_ClaDfp_FlFCD_C DSM_ClaDfp_FlMngSmkDefect_C DSM_ClaDfp_FrmMngANFRADMOMPT_C DSM_ClaDfp_FrmMngASC1_C DSM_ClaDfp_FrmMngASC2_C DSM_ClaDfp_FrmMngASC3_C DSM_ClaDfp_FrmMngASC4_C DSM_ClaDfp_FrmMngBOS_RESET_C DSM_ClaDfp_FrmMngBOS_RESET2_C DSM_ClaDfp_FrmMngDMANFAFS_C DSM_ClaDfp_FrmMngDRMANFSSG_C DSM_ClaDfp_FrmMngEGS1_C DSM_ClaDfp_FrmMngEGS2_C DSM_ClaDfp_FrmMngGEARBX_DATA_C DSM_ClaDfp_FrmMngGEARBX_DATA2_C DSM_ClaDfp_FrmMngHEAT_AC_C DSM_ClaDfp_FrmMngINSTR2_C DSM_ClaDfp_FrmMngINSTR3_C DSM_ClaDfp_FrmMngLENKRADWINKEL_C DSM_ClaDfp_FrmMngMILEAGE_RANGE_C DSM_ClaDfp_FrmMngOPCRCTLACC_C DSM_ClaDfp_FrmMngPRGG_CCTR_C DSM_ClaDfp_FrmMngPWRMNG_LOADV_C DSM_ClaDfp_FrmMngParkConsumer_C DSM_ClaDfp_FrmMngRQSTGEFAN_C DSM_ClaDfp_FrmMngSSGErr_C DSM_ClaDfp_FrmMngSSGShOff_C DSM_ClaDfp_FrmMngSTAT_ANH_C DSM_ClaDfp_FrmMngSTAT_ARS_C DSM_ClaDfp_FrmMngSTAT_DSC_C DSM_ClaDfp_FrmMngSTAT_EKP_C DSM_ClaDfp_FrmMngSTAT_KOMBI_C DSM_ClaDfp_FrmMngSTAT_SITZ_C DSM_ClaDfp_FrmMngStOBDGbxMilOf_C DSM_ClaDfp_FrmMngStOBDGbxMilOn_C DSM_ClaDfp_FrmMngTEMPRELTIME_C DSM_ClaDfp_FrmMngTERMINAL_C DSM_ClaDfp_FrmMngTIME_DATE_C DSM_ClaDfp_FrmMngTORQUE_DSC_C DSM_ClaDfp_FrmMngTORQUE_GEARBX_C DSM_ClaDfp_FrmMngTrq_ReqACC_C DSM_ClaDfp_FrmMngVEH_MOD_C DSM_ClaDfp_FrmMngVELOCITY_C DSM_ClaDfp_FrmMngWHEEL_SPEED_C DSM_ClaDfp_FrmMngstCurr_C DSM_ClaDfp_FrmMngswtPSPOff_C DSM_ClaDfp_GearbxIncMax_C DSM_ClaDfp_GlwCD_C DSM_ClaDfp_GlwCDGlwCirc1_C DSM_ClaDfp_GlwCDGlwCirc2_C DSM_ClaDfp_GlwCDGlwCirc3_C DSM_ClaDfp_GlwCDGlwCirc4_C DSM_ClaDfp_GlwCDGlwCirc5_C DSM_ClaDfp_GlwCDGlwCirc6_C DSM_ClaDfp_GlwCDGlwCirc7_C DSM_ClaDfp_GlwCDGlwCirc8_C DSM_ClaDfp_GlwCtl_C DSM_ClaDfp_HWEMonCom_C DSM_ClaDfp_HWEMonEEPROM_C DSM_ClaDfp_HWEMonRcyLocked_C DSM_ClaDfp_HWEMonRcySuppressed_C DSM_ClaDfp_HWEMonRcyVisible_C DSM_ClaDfp_HWEMonUMaxSupply_C DSM_ClaDfp_HWEMonUMinSupply_C DSM_ClaDfp_IATSCD_C DSM_ClaDfp_IATSCD_CATS_C DSM_ClaDfp_ImmCtlImmCD_C DSM_ClaDfp_ImmCtlImmEep_C DSM_ClaDfp_ImmCtlMpl_C DSM_ClaDfp_IndSys1_C DSM_ClaDfp_IndSys2_C DSM_ClaDfp_InjCrv_InjLim_C DSM_ClaDfp_InjCtlAdjQnt_C DSM_ClaDfp_InjCtlDrift_C DSM_ClaDfp_InjVlvBnk1A_C DSM_ClaDfp_InjVlvBnk1B_C DSM_ClaDfp_InjVlvBnk2A_C DSM_ClaDfp_InjVlvBnk2B_C DSM_ClaDfp_InjVlvChipA_C DSM_ClaDfp_InjVlvChipB_C DSM_ClaDfp_InjVlvCyl1A_C DSM_ClaDfp_InjVlvCyl1B_C DSM_ClaDfp_InjVlvCyl2A_C DSM_ClaDfp_InjVlvCyl2B_C DSM_ClaDfp_InjVlvCyl3A_C DSM_ClaDfp_InjVlvCyl3B_C DSM_ClaDfp_InjVlvCyl4A_C DSM_ClaDfp_InjVlvCyl4B_C DSM_ClaDfp_InjVlvCyl5A_C DSM_ClaDfp_InjVlvCyl5B_C DSM_ClaDfp_InjVlvCyl6A_C DSM_ClaDfp_InjVlvCyl6B_C DSM_ClaDfp_KeyCheck_C DSM_ClaDfp_LIGovECUTransMode_C DSM_ClaDfp_LPACD_Max_C DSM_ClaDfp_LPACD_Min_C DSM_ClaDfp_LPACD_SigNpl_C DSM_ClaDfp_LSUCDCircNernst0_C DSM_ClaDfp_LSUCDCircPumpCur0_C DSM_ClaDfp_LSUCDCircVirtGnd0_C DSM_ClaDfp_LSUCDHeater0_C DSM_ClaDfp_LSUCDHtCoup0_C DSM_ClaDfp_LSUCDO20_C DSM_ClaDfp_LSUCDO2Clb0_C DSM_ClaDfp_LSUCDRiClb0_C DSM_ClaDfp_LSUCDSPI0_C DSM_ClaDfp_LSUCDSPIBattLow0_C DSM_ClaDfp_LSUCDWireIP0_C DSM_ClaDfp_LSUCtlRiExc0_C DSM_ClaDfp_LSUMon1Sens_C DSM_ClaDfp_LSUMon2Sens_C DSM_ClaDfp_MIL_C DSM_ClaDfp_MRlyCD_C DSM_ClaDfp_MSidCD_Comm_C DSM_ClaDfp_MSidCD_Pin_C DSM_ClaDfp_MSidCD_Sel_INI_C DSM_ClaDfp_MSidCD_Select_C DSM_ClaDfp_MeUnCDNoLoad_C DSM_ClaDfp_MeUnCDSCBat_C DSM_ClaDfp_MeUnCDSCGnd_C DSM_ClaDfp_MeUnCD_ADC_C DSM_ClaDfp_MeUnCD_SigTst_C DSM_ClaDfp_Montr_C DSM_ClaDfp_NetMngDeviceA_C DSM_ClaDfp_NetMngDeviceB_C DSM_ClaDfp_NetMngDeviceC_C DSM_ClaDfp_NetMngPtCan_C DSM_ClaDfp_OPSCD_Lamp_C DSM_ClaDfp_OPSCD_anain_C DSM_ClaDfp_OTSCD_C DSM_ClaDfp_OvRMon_C DSM_ClaDfp_OvRMonSigA_C DSM_ClaDfp_OxiCCDTPre_C DSM_ClaDfp_PCBS_C DSM_ClaDfp_PCR_GovDevNeg_C DSM_ClaDfp_PCR_GovDevPos_C DSM_ClaDfp_PCR_LPGvnrDvtNeg_C DSM_ClaDfp_PCR_LPGvnrDvtPos_C DSM_ClaDfp_PCVCDNoLoad_C DSM_ClaDfp_PCVCDSCBat_C DSM_ClaDfp_PCVCDSCGnd_C DSM_ClaDfp_PCVCD_ADC_C DSM_ClaDfp_PCVCD_SigTst_C DSM_ClaDfp_PFltAPSPlaus_C DSM_ClaDfp_PFltAPSens_C DSM_ClaDfp_PFltBPSPlaus_C DSM_ClaDfp_PFltCDPPre_C DSM_ClaDfp_PFltCDTempPre_C DSM_ClaDfp_PFltChar_C DSM_ClaDfp_PFltEngPrt_C DSM_ClaDfp_PFltOvldInhRgn_C DSM_ClaDfp_PFltOvldTrqLim_C DSM_ClaDfp_PFltPresDynPlaus_C DSM_ClaDfp_PFltPresPlaus_C DSM_ClaDfp_PFltPresSens_C DSM_ClaDfp_PFltPresSensFrz_C DSM_ClaDfp_PFltPresSensHsLn_C DSM_ClaDfp_PFltPresSensSot_C DSM_ClaDfp_PFltRgnPerm_C DSM_ClaDfp_PFltTempDwnStrm_C DSM_ClaDfp_PFltTempSens_C DSM_ClaDfp_PFltTempUpStrm_C DSM_ClaDfp_PFlt_tOxiPreMax_C DSM_ClaDfp_PFlt_tOxiPreMxRgn_C DSM_ClaDfp_PFlt_tPreMax_C DSM_ClaDfp_PFlt_tPreMaxRgn_C DSM_ClaDfp_PFltmSotDiffMax_C DSM_ClaDfp_PSPCD_Actr_C DSM_ClaDfp_PresPlausDblDef_C DSM_ClaDfp_QLTCD_C DSM_ClaDfp_RailCD_C DSM_ClaDfp_RailCDOfsTst_C DSM_ClaDfp_RailCD_PMonStrt_C DSM_ClaDfp_RailCtlModeMeUnDiag_C DSM_ClaDfp_RailCtlModePCVDiag_C DSM_ClaDfp_RailMeUn0_C DSM_ClaDfp_RailMeUn1_C DSM_ClaDfp_RailMeUn2_C DSM_ClaDfp_RailMeUn3_C DSM_ClaDfp_RailMeUn4_C DSM_ClaDfp_RailPCV0_C DSM_ClaDfp_RailPCV1_C DSM_ClaDfp_RailPCV2_C DSM_ClaDfp_RailPCV3_C DSM_ClaDfp_RailPCV4_C DSM_ClaDfp_RailPCV5_C DSM_ClaDfp_SOPTst_C DSM_ClaDfp_SSpMon1_C DSM_ClaDfp_SSpMon2_C DSM_ClaDfp_SSpMon3_C DSM_ClaDfp_SWChk_CycSigChkDat_C DSM_ClaDfp_SWChk_CycSigChkPrg_C DSM_ClaDfp_ShutCD_C DSM_ClaDfp_StSysTrqShutOff_C DSM_ClaDfp_StrtCD_Actr_C DSM_ClaDfp_SysLamp_C DSM_ClaDfp_T15CD_C DSM_ClaDfp_TGearbx_C DSM_ClaDfp_TPUMon_C DSM_ClaDfp_TVACD_Max_C DSM_ClaDfp_TVACD_Min_C DSM_ClaDfp_TVACD_SigNpl_C DSM_ClaDfp_TVACD_TVADia1_C DSM_ClaDfp_TVACD_TVADia2_C DSM_ClaDfp_TVACD_TVADia3_C DSM_ClaDfp_TVACD_TVADia4_C DSM_ClaDfp_ThrVlvMon_C DSM_ClaDfp_VSACD_DiaDet_C DSM_ClaDfp_VSACD_DioInDia1_C DSM_ClaDfp_VSACD_DioInDia2_C DSM_ClaDfp_VSACD_DioInDia3_C DSM_ClaDfp_VSACD_DioInDia4_C DSM_ClaDfp_VSACD_DioInMin_C DSM_ClaDfp_VSACD_Max_C DSM_ClaDfp_VSACD_Min_C DSM_ClaDfp_VSACD_SigNpl_C DSM_ClaDfp_VSACD_VSADia1_C DSM_ClaDfp_VSACD_VSADia2_C DSM_ClaDfp_VSACD_VSADia3_C DSM_ClaDfp_VSACD_VSADia4_C DSM_ClaDfp_VSSCD1_C DSM_ClaDfp_VSSCD2_C DSM_ClaDfp_WdCom_C /end DEF_CHARACTERISTIC
/end FUNCTION
/begin COMPU_METHOD FactHigh "Faktor mit Auflösung 1/4096, hauptsächlich für einen Faktorenbereich 0.1...10 verwendet" RAT_FUNC "%6.5" "-" COEFFS 0 8192 0 0 0 1 /end COMPU_METHOD
/begin COMPU_METHOD OneToOne "eins zu eins (physikalischer Wert ist gleich dem internen Wert)" RAT_FUNC "%6.2" "-" COEFFS 0 1 0 0 0 1 /end COMPU_METHOD
/begin RECORD_LAYOUT Kwb_Wu16 FNC_VALUES 1 UWORD COLUMN_DIR DIRECT /end RECORD_LAYOUT
/begin RECORD_LAYOUT Kw_Wu8 FNC_VALUES 1 UBYTE COLUMN_DIR DIRECT /end RECORD_LAYOUT
/end MODULE
/end PROJECT
