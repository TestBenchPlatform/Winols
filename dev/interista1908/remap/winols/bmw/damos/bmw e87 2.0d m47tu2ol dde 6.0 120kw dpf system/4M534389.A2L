ASAP2_VERSION 1 3
/begin PROJECT P389 "BMW DDE6.0 4-Zylinder V53.4 01.04.2004 CAN12H"
/begin HEADER "" VERSION "V53.4_4Z_CAN12H" PROJECT_NO P389 /end HEADER
/begin MODULE DIM ""
/begin MOD_COMMON "" BYTE_ORDER MSB_FIRST ALIGNMENT_BYTE 1 ALIGNMENT_WORD 2 ALIGNMENT_LONG 4 ALIGNMENT_FLOAT32_IEEE 4 /end MOD_COMMON
/begin CHARACTERISTIC FrmMng_ACCSelfRec_C "Switch to disable/enable ACC self recognition" VALUE 0xD43A4 Kw_Wu8 1.000 OneToOne 0.00 1.000 FORMAT "%5.3" EXTENDED_LIMITS 0.00 255.0 /end CHARACTERISTIC
/begin CHARACTERISTIC FrmMng_ACSelfRec_C "" VALUE 0xD43A5 Kw_Wu8 1.000 OneToOne 0.00 1.000 FORMAT "%5.3" EXTENDED_LIMITS 0.00 255.0 /end CHARACTERISTIC
/begin CHARACTERISTIC FrmMng_aDirectDef_C "" VALUE 0xD43A6 Kw_Ws16 65.53500 Acc -32.76800 32.76700 FORMAT "%8.5" /end CHARACTERISTIC
/begin CHARACTERISTIC FrmMng_AFSSelfRec_C "Switch for enabling self recognition of AFS" VALUE 0xD43A8 Kw_Wu8 1.000 OneToOne 0.00 1.000 FORMAT "%5.3" EXTENDED_LIMITS 0.00 255.0 /end CHARACTERISTIC
/begin CHARACTERISTIC FrmMng_ARSSelfRec_C "Switch to disable ARS recognition" VALUE 0xD43A9 Kw_Wu8 1.000 OneToOne 0.00 1.000 FORMAT "%5.3" EXTENDED_LIMITS 0.00 255.0 /end CHARACTERISTIC
/begin CHARACTERISTIC FrmMng_aSideDef_C "#SSD Defektwert für FrmMng_aSideDef_C Botschaft" VALUE 0xD43AA Kw_Ws16 65.53500 Acc -32.76800 32.76700 FORMAT "%8.5" /end CHARACTERISTIC
/begin CHARACTERISTIC FrmMng_cnvAccmLimTrq_Offset_C "#SSD HEATING_CURRENT" VALUE 0xD43AC Kw_Ws16 6553.500 Trq -3276.800 3276.700 FORMAT "%8.3" /end CHARACTERISTIC
/begin CHARACTERISTIC FrmMng_cnvAccmLimTrq_Slope_C "#SSD HEATING_CURRENT" VALUE 0xD43AE Kw_Ws16 65.53500 SlopeRes1000 -32.76800 32.76700 FORMAT "%8.5" /end CHARACTERISTIC
/begin CHARACTERISTIC FrmMng_cnvACCtrq_Offset_C "#SSD DREHMOMENT_ANF_ACC   Signal: TORQ_TAR_ACC" VALUE 0xD43B0 Kw_Ws16 6553.500 Trq -3276.800 3276.700 FORMAT "%8.3" /end CHARACTERISTIC
/begin CHARACTERISTIC FrmMng_cnvACCtrq_Slope_C "#SSD DREHMOMENT_ANF_ACC   Signal: TORQ_TAR_ACC" VALUE 0xD43B2 Kw_Ws16 65.53500 SlopeRes1000 -32.76800 32.76700 FORMAT "%8.5" /end CHARACTERISTIC
/begin CHARACTERISTIC FrmMng_cnvAVA_DSC_Offset_C "#SSD Offset for conversion of ACLN_VEH_ACRO_DSC" VALUE 0xD43B4 Kw_Ws16 65.53500 Acc -32.76800 32.76700 FORMAT "%8.5" /end CHARACTERISTIC
/begin CHARACTERISTIC FrmMng_cnvAVA_DSC_Slope_C "#SSD slope for conversion of ACLN_VEH_ACRO_DSC" VALUE 0xD43B6 Kw_Ws16 65.53500 SlopeRes1000 -32.76800 32.76700 FORMAT "%8.5" /end CHARACTERISTIC
/begin CHARACTERISTIC FrmMng_cnvLN_DSC_Offset_C "" VALUE 0xD43B8 Kw_Ws16 65.53500 Acc -32.76800 32.76700 FORMAT "%8.5" /end CHARACTERISTIC
/begin CHARACTERISTIC FrmMng_cnvLN_DSC_Slope_C "" VALUE 0xD43BA Kw_Ws16 65.53500 SlopeRes1000 -32.76800 32.76700 FORMAT "%8.5" /end CHARACTERISTIC
/begin CHARACTERISTIC FrmMng_cnvAFStrq_Offset_C "#SSD Offset for calculation of ST_TORQ_AVL & TORQ_TAR_AFS" VALUE 0xD43BC Kw_Ws16 6553.500 Trq -3276.800 3276.700 FORMAT "%8.3" /end CHARACTERISTIC
/begin CHARACTERISTIC FrmMng_cnvAFStrq_Slope_C "#SSD Slope for calculation of ST_TORQ_AVL & TORQ_TAR_AFS" VALUE 0xD43BE Kw_Ws16 65.53500 SlopeRes1000 -32.76800 32.76700 FORMAT "%8.5" /end CHARACTERISTIC
/begin CHARACTERISTIC FrmMng_cnvAipEng_Offset_C "#SSD Offset fuer Umwandlung von AIP_ENG" VALUE 0xD43C0 Kw_Ws16 65535.00 Pres_hPa -32768.00 32767.00 FORMAT "%8.2" /end CHARACTERISTIC
/begin CHARACTERISTIC FrmMng_cnvAipEng_Slope_C "#SSD Steigung fuer Umwandlung von AIP_ENG" VALUE 0xD43C2 Kw_Ws16 65.53500 SlopeRes1000 -32.76800 32.76700 FORMAT "%8.5" /end CHARACTERISTIC
/begin CHARACTERISTIC FrmMng_cnvAngAcpd_Offset_C "#SSD Offset fuer Umwandlung von ANG_ACPD" VALUE 0xD43C4 Kw_Ws16 799.9878 Prc -400.0000 399.9878 FORMAT "%8.4" /end CHARACTERISTIC
/begin CHARACTERISTIC FrmMng_cnvAngAcpd_Slope_C "#SSD Steigung fuer Umwandlung von ANG_ACPD" VALUE 0xD43C6 Kw_Ws16 65.53500 SlopeRes1000 -32.76800 32.76700 FORMAT "%8.5" /end CHARACTERISTIC
/begin CHARACTERISTIC FrmMng_cnvARStrq_Offset_C "#SSD offset for conversion of ARS-torque" VALUE 0xD43C8 Kw_Ws16 13107.00 TrqPrp -6553.600 6553.400 FORMAT "%8.3" /end CHARACTERISTIC
/begin CHARACTERISTIC FrmMng_cnvARStrq_Slope_C "#SSD slope for conversion of ARS-torque" VALUE 0xD43CA Kw_Ws16 65.53500 SlopeRes1000 -32.76800 32.76700 FORMAT "%8.5" /end CHARACTERISTIC
/begin CHARACTERISTIC FrmMng_cnvdLRADWINKStrg_Offset_C "Offset for calculation dphiStrg from CAN" VALUE 0xD43CC Kw_Ws16 2880.263 AngleGradPerSec -1440.154 1440.110 FORMAT "%8.3" /end CHARACTERISTIC
/begin CHARACTERISTIC FrmMng_cnvdLRADWINKStrg_Slope_C "Slope for calculation  dphiStrg from CAN" VALUE 0xD43CE Kw_Ws16 65.53500 SlopeRes1000 -32.76800 32.76700 FORMAT "%8.5" /end CHARACTERISTIC
/begin CHARACTERISTIC FrmMng_cnvDSCtrq_Offset_C "#SSD offset for conversion of DSC-torque" VALUE 0xD43D0 Kw_Ws16 6553.500 Trq -3276.800 3276.700 FORMAT "%8.3" /end CHARACTERISTIC
/begin CHARACTERISTIC FrmMng_cnvDSCtrq_Slope_C "#SSD slope for conversion of DSC-torque" VALUE 0xD43D2 Kw_Ws16 65.53500 SlopeRes1000 -32.76800 32.76700 FORMAT "%8.5" /end CHARACTERISTIC
/begin CHARACTERISTIC FrmMng_cnvIjvFu_Offset_C "#SSD Offset fuer Umwandlung von IJV_FU" VALUE 0xD43D4 Kw_Ws16 65535.00 FlConsum_ul -32768.00 32767.00 FORMAT "%8.2" /end CHARACTERISTIC
/begin CHARACTERISTIC FrmMng_cnvIjvFu_Slope_C "#SSD Steigung fuer Umwandlung von IJV_FU" VALUE 0xD43D6 Kw_Ws16 65.53500 SlopeRes1000 -32.76800 32.76700 FORMAT "%8.5" /end CHARACTERISTIC
/begin CHARACTERISTIC FrmMng_cnvKOMBIv_Offset_C "#SSD Conversion V_VEH_SPDM -> FrmMng_vDisp" VALUE 0xD43D8 Kw_Ws16 655.3500 Vel -327.6800 327.6700 FORMAT "%8.4" /end CHARACTERISTIC
/begin CHARACTERISTIC FrmMng_cnvKOMBIv_Slope_C "#SSD Conversion V_VEH_SPDM -> FrmMng_vDisp" VALUE 0xD43DA Kw_Ws16 65.53500 SlopeRes1000 -32.76800 32.76700 FORMAT "%8.5" /end CHARACTERISTIC
/begin CHARACTERISTIC FrmMng_cnvLimRpmEng_Offset_C "Offset for conversion of LIM_RPM_ENG" VALUE 0xD43DC Kw_Ws16 65535.00 EngN -32768.00 32767.00 FORMAT "%8.2" /end CHARACTERISTIC
/begin CHARACTERISTIC FrmMng_cnvLimRpmEng_Slope_C "Slope for the conversion of LIM_RPM_ENG" VALUE 0xD43DE Kw_Ws16 65.53500 SlopeRes1000 -32.76800 32.76700 FORMAT "%8.5" /end CHARACTERISTIC
/begin CHARACTERISTIC FrmMng_cnvLRADWINKStrg_Offset_C "Offset for calculation of LRADWINK signal" VALUE 0xD43E0 Kw_Ws16 2880.263 AngleGrad -1440.154 1440.110 FORMAT "%8.3" /end CHARACTERISTIC
/begin CHARACTERISTIC FrmMng_cnvLRADWINKStrg_Slope_C "Slope for calculation of LRADWINK signal" VALUE 0xD43E2 Kw_Ws16 65.53500 SlopeRes1000 -32.76800 32.76700 FORMAT "%8.5" /end CHARACTERISTIC
/begin CHARACTERISTIC FrmMng_cnvnEngRpm_Offset_C "Offset for the calculation of RPM_TEMP_DOM_1 and RPM_TEMP_DOM_2" VALUE 0xD43E4 Kw_Ws16 65535.00 EngN -32768.00 32767.00 FORMAT "%8.2" /end CHARACTERISTIC
/begin CHARACTERISTIC FrmMng_cnvnEngRpm_Slope_C "Slope for the calculation of RPM_TEMP_DOM_1 &  RPM_TEMP_DOM_2 signals" VALUE 0xD43E6 Kw_Ws16 655.3500 SlopeRes100 -327.6800 327.6700 FORMAT "%8.4" /end CHARACTERISTIC
/begin CHARACTERISTIC FrmMng_cnvnSetpoint_Offset_C "Offset Wert für Byte 7 der ENGINE1 CAN Botschaft" VALUE 0xD43E8 Kw_Ws16 65535.00 EngN -32768.00 32767.00 FORMAT "%8.2" /end CHARACTERISTIC
/begin CHARACTERISTIC FrmMng_cnvnSetpoint_Slope_C "Steigungs Wert für Byte 7 der ENGINE1 CAN Botschaft" VALUE 0xD43EA Kw_Ws16 65.53500 SlopeRes1000 -32.76800 32.76700 FORMAT "%8.5" /end CHARACTERISTIC
/begin CHARACTERISTIC FrmMng_cnvrHtFlow_Offset_C "Conversion HTFL_RQ_AIC -> FrmMng_rHtFlowReq" VALUE 0xD43EC Kw_Ws16 799.9878 Prc -400.0000 399.9878 FORMAT "%8.4" /end CHARACTERISTIC
/begin CHARACTERISTIC FrmMng_cnvrHtFlow_Slope_C "Conversion HTFL_RQ_AIC -> FrmMng_rHtFlowReq" VALUE 0xD43EE Kw_Ws16 655.3500 SlopeRes100 -327.6800 327.6700 FORMAT "%8.4" /end CHARACTERISTIC
/begin CHARACTERISTIC FrmMng_cnvRpmEng_Offset_C "#SSD Offset fuer Umwandlung von RPM_ENG" VALUE 0xD43F0 Kw_Ws16 65535.00 EngN -32768.00 32767.00 FORMAT "%8.2" /end CHARACTERISTIC
/begin CHARACTERISTIC FrmMng_cnvRpmEng_Slope_C "#SSD Steigung fuer Umwandlung von RPM_ENG" VALUE 0xD43F2 Kw_Ws16 65.53500 SlopeRes1000 -32.76800 32.76700 FORMAT "%8.5" /end CHARACTERISTIC
/begin CHARACTERISTIC FrmMng_cnvRPM_GRB_TURB_Offset_C "" VALUE 0xD43F4 Kw_Ws16 65535.00 EngN -32768.00 32767.00 FORMAT "%8.2" /end CHARACTERISTIC
/begin CHARACTERISTIC FrmMng_cnvRPM_GRB_TURB_Slope_C "" VALUE 0xD43F6 Kw_Ws16 65.53500 SlopeRes1000 -32.76800 32.76700 FORMAT "%8.5" /end CHARACTERISTIC
/begin CHARACTERISTIC FrmMng_cnvRqamFu_Offset_C "#SSD required-amount fuel Offset" VALUE 0xD43F8 Kw_Ws16 655.3500 FlConsum_l_h -327.6800 327.6700 FORMAT "%8.4" /end CHARACTERISTIC
/begin CHARACTERISTIC FrmMng_cnvRqamFu_Slope_C "#SSD required-amount fuel Slope" VALUE 0xD43FA Kw_Ws16 655.3500 SlopeRes100 -327.6800 327.6700 FORMAT "%8.4" /end CHARACTERISTIC
/begin CHARACTERISTIC FrmMng_cnvrWaterVlv_Offset_C "Offset value for CTR_APE_WV" VALUE 0xD43FC Kw_Ws16 799.9878 Prc -400.0000 399.9878 FORMAT "%8.4" /end CHARACTERISTIC
/begin CHARACTERISTIC FrmMng_cnvrWaterVlv_Slope_C "Slope value for CTR_APE_WV" VALUE 0xD43FE Kw_Ws16 6553.500 SlopeRes10 -3276.800 3276.700 FORMAT "%8.3" /end CHARACTERISTIC
/begin CHARACTERISTIC FrmMng_cnvTempEng_Offset_C "#SSD Offset fuer Umwandlung von TEMP_ENG" VALUE 0xD4400 Kw_Ws16 950.000 Temp_Cels -50.140 899.860 FORMAT "%8.3" EXTENDED_LIMITS -3549.940 3003.560 /end CHARACTERISTIC
/begin CHARACTERISTIC FrmMng_cnvTempEng_Slope_C "#SSD Steigung fuer Umwandlung von TEMP_ENG" VALUE 0xD4402 Kw_Ws16 65.53500 SlopeRes1000 -32.76800 32.76700 FORMAT "%8.5" /end CHARACTERISTIC
/begin CHARACTERISTIC FrmMng_cnvtOil_Offset_C "#SSD Conversion TEMP_GRB -> FrmMng_tOil" VALUE 0xD4404 Kw_Ws16 950.000 Temp_Cels -50.140 899.860 FORMAT "%8.3" EXTENDED_LIMITS -3549.940 3003.560 /end CHARACTERISTIC
/begin CHARACTERISTIC FrmMng_cnvtOil_Slope_C "#SSD Conversion TEMP_GRB -> FrmMng_tOil" VALUE 0xD4406 Kw_Ws16 65.53500 SlopeRes1000 -32.76800 32.76700 FORMAT "%8.5" /end CHARACTERISTIC
/begin CHARACTERISTIC FrmMng_cnvTrqAvl_Offset_C "#SSD Offset fuer Umwandlung von TORQ_AVL" VALUE 0xD4408 Kw_Ws16 6553.500 Trq -3276.800 3276.700 FORMAT "%8.3" /end CHARACTERISTIC
/begin CHARACTERISTIC FrmMng_cnvTrqAvl_Slope_C "#SSD Steigung fuer Umwandlung von TORQ_AVL" VALUE 0xD440A Kw_Ws16 65.53500 SlopeRes1000 -32.76800 32.76700 FORMAT "%8.5" /end CHARACTERISTIC
/begin CHARACTERISTIC FrmMng_cnvTrqDvch_Offset_C "#SSD Offset fuer Umwandlung von TORQ_DVCH" VALUE 0xD440C Kw_Ws16 6553.500 Trq -3276.800 3276.700 FORMAT "%8.3" /end CHARACTERISTIC
/begin CHARACTERISTIC FrmMng_cnvTrqDvch_Slope_C "#SSD Steigung fuer Umwandlung von TORQ_DVCH" VALUE 0xD440E Kw_Ws16 65.53500 SlopeRes1000 -32.76800 32.76700 FORMAT "%8.5" /end CHARACTERISTIC
/begin CHARACTERISTIC FrmMng_cnvtrq_Offset_C "#SSD offset for message FrmMng_trqGearbxFrc" VALUE 0xD4410 Kw_Ws16 6553.500 Trq -3276.800 3276.700 FORMAT "%8.3" /end CHARACTERISTIC
/begin CHARACTERISTIC FrmMng_cnvtrq_Slope_C "#SSD Slope for the message FrmMng_trqGearbxFrc" VALUE 0xD4412 Kw_Ws16 65.53500 SlopeRes1000 -32.76800 32.76700 FORMAT "%8.5" /end CHARACTERISTIC
/begin CHARACTERISTIC FrmMng_cnvvMrk_Offset_C "#SSD SPEED_CLCTR" VALUE 0xD4414 Kw_Ws16 655.3500 Vel -327.6800 327.6700 FORMAT "%8.4" /end CHARACTERISTIC
/begin CHARACTERISTIC FrmMng_cnvvMrk_Slope_C "#SSD SPEED_CLCTR" VALUE 0xD4416 Kw_Ws16 65.53500 SlopeRes1000 -32.76800 32.76700 FORMAT "%8.5" /end CHARACTERISTIC
/begin CHARACTERISTIC FrmMng_cnvV_VEH_Offset_C "#SSD Offset für Fahrgeschwindigkeitsumrechnung" VALUE 0xD4418 Kw_Ws16 655.3500 Vel -327.6800 327.6700 FORMAT "%8.4" /end CHARACTERISTIC
/begin CHARACTERISTIC FrmMng_cnvV_VEH_Slope_C "#SSD Steigung für Geschwindigkeitsumrechnung" VALUE 0xD441A Kw_Ws16 65.53500 SlopeRes1000 -32.76800 32.76700 FORMAT "%8.5" /end CHARACTERISTIC
/begin CHARACTERISTIC FrmMng_cnv_BattCls_Offset_C "#SSD Offsetwert für FrmMng_nBattCls" VALUE 0xD441C Kw_Ws16 65535.00 DEZ -32768.00 32767.00 FORMAT "%8.2" /end CHARACTERISTIC
/begin CHARACTERISTIC FrmMng_cnv_BattCls_Slope_C "#SSD Steigungswert für FrmMng_nBattCls" VALUE 0xD441E Kw_Ws16 65.53500 SlopeRes1000 -32.76800 32.76700 FORMAT "%8.5" /end CHARACTERISTIC
/begin CHARACTERISTIC FrmMng_cnv_HiLimCurr_Offset_C "#SSD Offsetwert für FrmMng_iHiLimCurr" VALUE 0xD4420 Kw_Ws16 655350. i_ub_q10p0 -327680. 327670. FORMAT "%5.0" /end CHARACTERISTIC
/begin CHARACTERISTIC FrmMng_cnv_HiLimCurr_Slope_C "#SSD Steigungswert für FrmMng_iHiLimCurr" VALUE 0xD4422 Kw_Ws16 65.53500 SlopeRes1000 -32.76800 32.76700 FORMAT "%8.5" /end CHARACTERISTIC
/begin CHARACTERISTIC FrmMng_cnv_LoLimCurr_Offset_C "#SSD Offsetwert für FrmMng_iLoLimCurr" VALUE 0xD4424 Kw_Ws16 655350. i_ub_q10p0 -327680. 327670. FORMAT "%5.0" /end CHARACTERISTIC
/begin CHARACTERISTIC FrmMng_cnv_LoLimCurr_Slope_C "#SSD Steigungswert für FrmMng_iLoLimCurr" VALUE 0xD4426 Kw_Ws16 65.53500 SlopeRes1000 -32.76800 32.76700 FORMAT "%8.5" /end CHARACTERISTIC
/begin CHARACTERISTIC FrmMng_cnv_ZrCurrLim_Offset_C "#SSD Offsetwert für FrmMng_iZrCurrLim" VALUE 0xD4428 Kw_Ws16 65.53 i_ub_q0p001 -32.77 32.77 FORMAT "%5.2" /end CHARACTERISTIC
/begin CHARACTERISTIC FrmMng_cnv_ZrCurrLim_Slope_C "#SSD Steigungswert für FrmMng_iZrCurrLim" VALUE 0xD442A Kw_Ws16 65.53500 SlopeRes1000 -32.76800 32.76700 FORMAT "%8.5" /end CHARACTERISTIC
/begin CHARACTERISTIC FrmMng_ctDebAlvDMANFAFSDef_C "#SSD Defect time for DREHMOMENT_ANF_AFS  message alive counter error" VALUE 0xD442C Kw_Wu16 65535.00 OneToOne 0.00 65535.00 FORMAT "%8.2" /end CHARACTERISTIC
/begin CHARACTERISTIC FrmMng_ctDebAlvDMANFAFSOk_C "Healing time for DREHMOMENT_ANF_AFS  message alive counter error" VALUE 0xD442E Kw_Wu16 65535.00 OneToOne 0.00 65535.00 FORMAT "%8.2" /end CHARACTERISTIC
/begin CHARACTERISTIC FrmMng_ctDebAlvDRMANFSSGDef_C "measuring point for evluating ST_SW_WAUP signal" VALUE 0xD4430 Kw_Wu16 65535.00 OneToOne 0.00 65535.00 FORMAT "%8.2" /end CHARACTERISTIC
/begin CHARACTERISTIC FrmMng_ctDebAlvDRMANFSSGOk_C "Healing time" VALUE 0xD4432 Kw_Wu16 65535.00 OneToOne 0.00 65535.00 FORMAT "%8.2" /end CHARACTERISTIC
/begin CHARACTERISTIC FrmMng_ctDebCsDMANFAFSDef_C "#SSD Defect time for DREHMOMENT_ANF_AFS message check sum error" VALUE 0xD4434 Kw_Wu16 65535.00 OneToOne 0.00 65535.00 FORMAT "%8.2" /end CHARACTERISTIC
/begin CHARACTERISTIC FrmMng_ctDebCsDMANFAFSOk_C "Healing time for DREHMOMENT_ANF_AFS message check sum error" VALUE 0xD4436 Kw_Wu16 65535.00 OneToOne 0.00 65535.00 FORMAT "%8.2" /end CHARACTERISTIC
/begin CHARACTERISTIC FrmMng_ctDebCsDRMANFSSGDef_C " Defect time" VALUE 0xD4438 Kw_Wu16 65535.00 OneToOne 0.00 65535.00 FORMAT "%8.2" /end CHARACTERISTIC
/begin CHARACTERISTIC FrmMng_ctDebCsDRMANFSSGOk_C "Healing time" VALUE 0xD443A Kw_Wu16 65535.00 OneToOne 0.00 65535.00 FORMAT "%8.2" /end CHARACTERISTIC
/begin CHARACTERISTIC FrmMng_ctDebSigDMANFAFSDef_C "#SSD Defect time for DREHMOMENT_ANF_AFS message signal error" VALUE 0xD443C Kw_Wu16 65535.00 OneToOne 0.00 65535.00 FORMAT "%8.2" /end CHARACTERISTIC
/begin CHARACTERISTIC FrmMng_ctDebSigDMANFAFSOk_C "Healing time for DREHMOMENT_ANF_AFS message signal error" VALUE 0xD443E Kw_Wu16 65535.00 OneToOne 0.00 65535.00 FORMAT "%8.2" /end CHARACTERISTIC
/begin CHARACTERISTIC FrmMng_ctDebSigDRMANFSSGDef_C "Defect time for DREHMOMENT_ANF_SSG message signal error" VALUE 0xD4440 Kw_Wu16 65535.00 OneToOne 0.00 65535.00 FORMAT "%8.2" /end CHARACTERISTIC
/begin CHARACTERISTIC FrmMng_ctDebSigDRMANFSSGOk_C "Healing time for DREHMOMENT_ANF_SSG messages signal error" VALUE 0xD4442 Kw_Wu16 65535.00 OneToOne 0.00 65535.00 FORMAT "%8.2" /end CHARACTERISTIC
/begin CHARACTERISTIC FrmMng_ctDebSigLRADWINKDef_C "Defect time for LENKRADWINKEL messages signal error" VALUE 0xD4444 Kw_Wu16 65535.00 OneToOne 0.00 65535.00 FORMAT "%8.2" /end CHARACTERISTIC
/begin CHARACTERISTIC FrmMng_ctDebSigLRADWINKOk_C "Healing time for LENKRADWINKEL messages signal error" VALUE 0xD4446 Kw_Wu16 65535.00 OneToOne 0.00 65535.00 FORMAT "%8.2" /end CHARACTERISTIC
/begin CHARACTERISTIC FrmMng_ctDebSigstCurrDef_C "Defektentprellung für Signal Fehler von CODIERUNG_PM Botschaft" VALUE 0xD4448 Kw_Wu16 65535.00 OneToOne 0.00 65535.00 FORMAT "%8.2" /end CHARACTERISTIC
/begin CHARACTERISTIC FrmMng_ctDebSigstCurrOk_C "Heilentprellung für Signal Fehler von CODIERUNG_PM Botschaft" VALUE 0xD444A Kw_Wu16 65535.00 OneToOne 0.00 65535.00 FORMAT "%8.2" /end CHARACTERISTIC
/begin CHARACTERISTIC FrmMng_ctDebSigswtPSPOffDef_C "Defektentprellung für Signal Fehler von  CTR_CRASH_SWO_EKP Botschaft" VALUE 0xD444C Kw_Wu16 65535.00 OneToOne 0.00 65535.00 FORMAT "%8.2" /end CHARACTERISTIC
/begin CHARACTERISTIC FrmMng_ctDebSigswtPSPOffOk_C "Heilentprellung für Signal Fehler von  CTR_CRASH_SWO_EKP Botschaft" VALUE 0xD444E Kw_Wu16 65535.00 OneToOne 0.00 65535.00 FORMAT "%8.2" /end CHARACTERISTIC
/begin CHARACTERISTIC FrmMng_ctDebToDMANFAFSDef_C "#SSD Defect time for DREHMOMENT_ANF_AFS messages Timeout" VALUE 0xD4450 Kw_Wu16 65535.00 OneToOne 0.00 65535.00 FORMAT "%8.2" /end CHARACTERISTIC
/begin CHARACTERISTIC FrmMng_ctDebToDMANFAFSOk_C "Healing time for DREHMOMENT_ANF_AFS messages Timeout" VALUE 0xD4452 Kw_Wu16 65535.00 OneToOne 0.00 65535.00 FORMAT "%8.2" /end CHARACTERISTIC
/begin CHARACTERISTIC FrmMng_ctDebToDRMANFSSGDef_C "Defect time for DREHMOMENT_ANF_SSG messages Timeout" VALUE 0xD4454 Kw_Wu16 65535.00 OneToOne 0.00 65535.00 FORMAT "%8.2" /end CHARACTERISTIC
/begin CHARACTERISTIC FrmMng_ctDebToDRMANFSSGOk_C "Healing time for DREHMOMENT_ANF_SSG messages Timeout" VALUE 0xD4456 Kw_Wu16 65535.00 OneToOne 0.00 65535.00 FORMAT "%8.2" /end CHARACTERISTIC
/begin CHARACTERISTIC FrmMng_ctDebToLRADWINKDef_C "Defect time for LENKRADWINKEL messages time out error" VALUE 0xD4458 Kw_Wu16 65535.00 OneToOne 0.00 65535.00 FORMAT "%8.2" /end CHARACTERISTIC
/begin CHARACTERISTIC FrmMng_ctDebToLRADWINKOk_C "Healing  time for LENKRADWINKEL messages time out error" VALUE 0xD445A Kw_Wu16 65535.00 OneToOne 0.00 65535.00 FORMAT "%8.2" /end CHARACTERISTIC
/begin CHARACTERISTIC FrmMng_ctDebTostCurrDef_C "Defektentprellung für Timeout-Fehler von  CODIERUNG_PM Botschaft" VALUE 0xD445C Kw_Wu16 65535.00 OneToOne 0.00 65535.00 FORMAT "%8.2" /end CHARACTERISTIC
/begin CHARACTERISTIC FrmMng_ctDebTostCurrOk_C "Heilentprellung für Timeout-Fehler von  CODIERUNG_PM Botschaft" VALUE 0xD445E Kw_Wu16 65535.00 OneToOne 0.00 65535.00 FORMAT "%8.2" /end CHARACTERISTIC
/begin CHARACTERISTIC FrmMng_ctDebToswtPSPOffDef_C "Defect time for ASC2-messages Timeout" VALUE 0xD4460 Kw_Wu16 65535.00 OneToOne 0.00 65535.00 FORMAT "%8.2" /end CHARACTERISTIC
/begin CHARACTERISTIC FrmMng_ctDebToswtPSPOffOk_C "Heilentprellung für Timeout-Fehler von  CTR_CRASH_SWO_EKP Botschaft" VALUE 0xD4462 Kw_Wu16 65535.00 OneToOne 0.00 65535.00 FORMAT "%8.2" /end CHARACTERISTIC
/begin CHARACTERISTIC FrmMng_ctrRelDef_C "Defektwert für FrmMng_tRelDef_C Botschaft" VALUE 0xD4464 Kw_Wu32 4294967295.00 OneToOne 0.00 4294967295.00 FORMAT "%13.2" /end CHARACTERISTIC
/begin CHARACTERISTIC FrmMng_cnvCTR_GEN_U_TAR_Offset_C "" VALUE 0xD4468 Kw_Ws16 65535.00 OneToOne -32768.00 32767.00 FORMAT "%8.2" /end CHARACTERISTIC
/begin CHARACTERISTIC FrmMng_cnvCTR_GEN_U_TAR_Slope_C "" VALUE 0xD446A Kw_Ws16 65.53500 SlopeRes1000 -32.76800 32.76700 FORMAT "%8.5" /end CHARACTERISTIC
/begin CHARACTERISTIC FrmMng_DebACTrqDef_C "#SSD debouncing of ACTrq for defect detection" VALUE 0xD446C Kw_Wu16 65535.00 OneToOne 0.00 65535.00 FORMAT "%8.2" /end CHARACTERISTIC
/begin CHARACTERISTIC FrmMng_DebACTrqOk_C "debouncing of ACTrq for healing" VALUE 0xD446E Kw_Wu16 65535.00 OneToOne 0.00 65535.00 FORMAT "%8.2" /end CHARACTERISTIC
/begin CHARACTERISTIC FrmMng_DebAlvDMOMENT_ACCDef_C "#SSD Defect time of DMOMENT_ACC aliv" VALUE 0xD4470 Kw_Wu16 65535.00 OneToOne 0.00 65535.00 FORMAT "%8.2" /end CHARACTERISTIC
/begin CHARACTERISTIC FrmMng_DebAlvDMOMENT_ACCOk_C "Healing time  of  DMOMENT_ACC aliv" VALUE 0xD4472 Kw_Wu16 65535.00 OneToOne 0.00 65535.00 FORMAT "%8.2" /end CHARACTERISTIC
/begin CHARACTERISTIC FrmMng_DebAlvOPCRCTLACCDef_C "#SSD debouncing of alive-ctr.-error OPCRCTLACC (no.of events)" VALUE 0xD4474 Kw_Wu16 65535.00 OneToOne 0.00 65535.00 FORMAT "%8.2" /end CHARACTERISTIC
/begin CHARACTERISTIC FrmMng_DebAlvOPCRCTLACCOk_C "debouncing of alive-ctr.-error OPCRCTLACC (no.of events)" VALUE 0xD4476 Kw_Wu16 65535.00 OneToOne 0.00 65535.00 FORMAT "%8.2" /end CHARACTERISTIC
/begin CHARACTERISTIC FrmMng_DebAlvSTAT_ARSDef_C "#SSD debouncing of alive-ctr.-error STAT_ARS (no.of events)" VALUE 0xD4478 Kw_Wu16 65535.00 OneToOne 0.00 65535.00 FORMAT "%8.2" /end CHARACTERISTIC
/begin CHARACTERISTIC FrmMng_DebAlvSTAT_ARSOk_C "debouncing of alive-ctr.-error STAT_ARS (no.of events)" VALUE 0xD447A Kw_Wu16 65535.00 OneToOne 0.00 65535.00 FORMAT "%8.2" /end CHARACTERISTIC
/begin CHARACTERISTIC FrmMng_DebAlvSTAT_KOMBIDef_C "#SSD debouncing of alive-ctr.-error STAT_KOMBI (no.of events)" VALUE 0xD447C Kw_Wu16 65535.00 OneToOne 0.00 65535.00 FORMAT "%8.2" /end CHARACTERISTIC
/begin CHARACTERISTIC FrmMng_DebAlvSTAT_KOMBIOk_C "debouncing of alive-ctr.-error STAT_KOMBI (no.of events)" VALUE 0xD447E Kw_Wu16 65535.00 OneToOne 0.00 65535.00 FORMAT "%8.2" /end CHARACTERISTIC
/begin CHARACTERISTIC FrmMng_DebAlvTERMINALDef_C "debouncing of alive-ctr.-error TERMINAL (no.of events)" VALUE 0xD4480 Kw_Wu16 65535.00 OneToOne 0.00 65535.00 FORMAT "%8.2" /end CHARACTERISTIC
/begin CHARACTERISTIC FrmMng_DebAlvTERMINALOk_C "debouncing of alive-ctr.-error TERMINAL (no.of events)" VALUE 0xD4482 Kw_Wu16 65535.00 OneToOne 0.00 65535.00 FORMAT "%8.2" /end CHARACTERISTIC
/begin CHARACTERISTIC FrmMng_DebAlvTORQUE_DSCDef_C "#SSD debouncing of alive-ctr.-error TORQUE_DSC (no.of events)" VALUE 0xD4484 Kw_Wu16 65535.00 OneToOne 0.00 65535.00 FORMAT "%8.2" /end CHARACTERISTIC
/begin CHARACTERISTIC FrmMng_DebAlvTORQUE_DSCOk_C "debouncing of alive-ctr.-error TORQUE_DSC (no.of events)" VALUE 0xD4486 Kw_Wu16 65535.00 OneToOne 0.00 65535.00 FORMAT "%8.2" /end CHARACTERISTIC
/begin CHARACTERISTIC FrmMng_DebAlvTORQUE_GEARBXDef_C "#SSD debouncing of alive-ctr.-error TORQUE_GEARBX (no.of events)" VALUE 0xD4488 Kw_Wu16 65535.00 OneToOne 0.00 65535.00 FORMAT "%8.2" /end CHARACTERISTIC
/begin CHARACTERISTIC FrmMng_DebAlvTORQUE_GEARBXOk_C "debouncing of alive-ctr.-error TORQUE_GEARBX (no.of events)" VALUE 0xD448A Kw_Wu16 65535.00 OneToOne 0.00 65535.00 FORMAT "%8.2" /end CHARACTERISTIC
/begin CHARACTERISTIC FrmMng_DebAlvVEH_MODDef_C "Defect time for VEH_MOD signal" VALUE 0xD448C Kw_Wu16 65535.00 OneToOne 0.00 65535.00 FORMAT "%8.2" /end CHARACTERISTIC
/begin CHARACTERISTIC FrmMng_DebAlvVEH_MODOk_C "debounce OK time for alive counter for VEH_MOD signal" VALUE 0xD448E Kw_Wu16 65535.00 OneToOne 0.00 65535.00 FORMAT "%8.2" /end CHARACTERISTIC
/begin CHARACTERISTIC FrmMng_DebCsDMOMENT_ACCDef_C "#SSD Defect time of DMOMENT_ACC   check sum" VALUE 0xD4490 Kw_Wu16 65535.00 OneToOne 0.00 65535.00 FORMAT "%8.2" /end CHARACTERISTIC
/begin CHARACTERISTIC FrmMng_DebCsDMOMENT_ACCOk_C "Healing time  of  DMOMENT_ACC check sum" VALUE 0xD4492 Kw_Wu16 65535.00 OneToOne 0.00 65535.00 FORMAT "%8.2" /end CHARACTERISTIC
/begin CHARACTERISTIC FrmMng_DebCsOPCRCTLACCDef_C "#SSD debouncing of checksum-error OPCRCTLACC (no.of events)" VALUE 0xD4494 Kw_Wu16 65535.00 OneToOne 0.00 65535.00 FORMAT "%8.2" /end CHARACTERISTIC
/begin CHARACTERISTIC FrmMng_DebCsOPCRCTLACCOk_C "debouncing of checksum-error OPCRCTLACC (no.of events)" VALUE 0xD4496 Kw_Wu16 65535.00 OneToOne 0.00 65535.00 FORMAT "%8.2" /end CHARACTERISTIC
/begin CHARACTERISTIC FrmMng_DebCsTERMINALDef_C "debouncing of checksum-error TERMINAL (no.of events)" VALUE 0xD4498 Kw_Wu16 65535.00 OneToOne 0.00 65535.00 FORMAT "%8.2" /end CHARACTERISTIC
/begin CHARACTERISTIC FrmMng_DebCsTERMINALOk_C "debouncing of checksum-error TERMINAL (no.of events)" VALUE 0xD449A Kw_Wu16 65535.00 OneToOne 0.00 65535.00 FORMAT "%8.2" /end CHARACTERISTIC
/begin CHARACTERISTIC FrmMng_DebCsTORQUE_DSCDef_C "#SSD debouncing of checksum-error TORQUE_DSC (no.of events)" VALUE 0xD449C Kw_Wu16 65535.00 OneToOne 0.00 65535.00 FORMAT "%8.2" /end CHARACTERISTIC
/begin CHARACTERISTIC FrmMng_DebCsTORQUE_DSCOk_C "debouncing of checksum-error TORQUE_DSC (no.of events)" VALUE 0xD449E Kw_Wu16 65535.00 OneToOne 0.00 65535.00 FORMAT "%8.2" /end CHARACTERISTIC
/begin CHARACTERISTIC FrmMng_DebCsTORQUE_GEARBXDef_C "#SSD debouncing of checksum-error TORQUE_GEARBX (no.of events)" VALUE 0xD44A0 Kw_Wu16 65535.00 OneToOne 0.00 65535.00 FORMAT "%8.2" /end CHARACTERISTIC
/begin CHARACTERISTIC FrmMng_DebCsTORQUE_GEARBXOk_C "debouncing of checksum-error TORQUE_GEARBX (no.of events)" VALUE 0xD44A2 Kw_Wu16 65535.00 OneToOne 0.00 65535.00 FORMAT "%8.2" /end CHARACTERISTIC
/begin CHARACTERISTIC FrmMng_DebCsVEH_MODDef_C "defect time for VEH_MOD" VALUE 0xD44A4 Kw_Wu16 65535.00 OneToOne 0.00 65535.00 FORMAT "%8.2" /end CHARACTERISTIC
/begin CHARACTERISTIC FrmMng_DebCsVEH_MODOk_C "Defect debouncing for check sum for VEH_MOD signal" VALUE 0xD44A6 Kw_Wu16 65535.00 OneToOne 0.00 65535.00 FORMAT "%8.2" /end CHARACTERISTIC
/begin CHARACTERISTIC FrmMng_DebSigBOS_RESET_2Def_C "" VALUE 0xD44A8 Kw_Wu16 65535.00 OneToOne 0.00 65535.00 FORMAT "%8.2" /end CHARACTERISTIC
/begin CHARACTERISTIC FrmMng_DebSigBOS_RESET_2Ok_C "" VALUE 0xD44AA Kw_Wu16 65535.00 OneToOne 0.00 65535.00 FORMAT "%8.2" /end CHARACTERISTIC
/begin CHARACTERISTIC FrmMng_DebSigBOS_RESETDef_C "debouncing of signal-error BOS_RESET (no.of events)" VALUE 0xD44AC Kw_Wu16 65535.00 OneToOne 0.00 65535.00 FORMAT "%8.2" /end CHARACTERISTIC
/begin CHARACTERISTIC FrmMng_DebSigBOS_RESETOk_C "debouncing of signal-error BOS_RESET (no.of events)" VALUE 0xD44AE Kw_Wu16 65535.00 OneToOne 0.00 65535.00 FORMAT "%8.2" /end CHARACTERISTIC
/begin CHARACTERISTIC FrmMng_DebSigDMOMENT_ACCDef_C "#SSD Defect time of DMOMENT_ACC sig" VALUE 0xD44B0 Kw_Wu16 65535.00 OneToOne 0.00 65535.00 FORMAT "%8.2" /end CHARACTERISTIC
/begin CHARACTERISTIC FrmMng_DebSigDMOMENT_ACCOk_C "Healing time of  DMOMENT_ACC sig" VALUE 0xD44B2 Kw_Wu16 65535.00 OneToOne 0.00 65535.00 FORMAT "%8.2" /end CHARACTERISTIC
/begin CHARACTERISTIC FrmMng_DebSigGEARBX_DATA2Def_C "debouncing of signal-error GEARBX_DATA2 (no.of events)" VALUE 0xD44B4 Kw_Wu16 65535.00 OneToOne 0.00 65535.00 FORMAT "%8.2" /end CHARACTERISTIC
/begin CHARACTERISTIC FrmMng_DebSigGEARBX_DATA2Ok_C "debouncing of signal-error GEARBX_DATA (no.of events)" VALUE 0xD44B6 Kw_Wu16 65535.00 OneToOne 0.00 65535.00 FORMAT "%8.2" /end CHARACTERISTIC
/begin CHARACTERISTIC FrmMng_DebSigGEARBX_DATADef_C "debouncing of signal-error GEARBX_DATA (no.of events)" VALUE 0xD44B8 Kw_Wu16 65535.00 OneToOne 0.00 65535.00 FORMAT "%8.2" /end CHARACTERISTIC
/begin CHARACTERISTIC FrmMng_DebSigGEARBX_DATAOk_C "debouncing of signal-error GEARBX_DATA (no.of events)" VALUE 0xD44BA Kw_Wu16 65535.00 OneToOne 0.00 65535.00 FORMAT "%8.2" /end CHARACTERISTIC
/begin CHARACTERISTIC FrmMng_DebSigHEAT_ACDef_C "debouncing of signal-error HEAT_AC (no.of events)" VALUE 0xD44BC Kw_Wu16 65535.00 OneToOne 0.00 65535.00 FORMAT "%8.2" /end CHARACTERISTIC
/begin CHARACTERISTIC FrmMng_DebSigHEAT_ACOk_C "debouncing of signal-error HEAT_AC (no.of events)" VALUE 0xD44BE Kw_Wu16 65535.00 OneToOne 0.00 65535.00 FORMAT "%8.2" /end CHARACTERISTIC
/begin CHARACTERISTIC FrmMng_DebSigMILEAGE_RANGEDef_C "#SSD debouncing of signal-error MILEAGE_RANGE ( no of events )" VALUE 0xD44C0 Kw_Wu16 65535.00 OneToOne 0.00 65535.00 FORMAT "%8.2" /end CHARACTERISTIC
/begin CHARACTERISTIC FrmMng_DebSigMILEAGE_RANGEOk_C "debounce of signal - error MILEAGE_RANGE( no of events)" VALUE 0xD44C2 Kw_Wu16 65535.00 OneToOne 0.00 65535.00 FORMAT "%8.2" /end CHARACTERISTIC
/begin CHARACTERISTIC FrmMng_DebSigOPCRCTLACCDef_C "#SSD debouncing of signal OPCRCTLACC (no.of events)" VALUE 0xD44C4 Kw_Wu16 65535.00 OneToOne 0.00 65535.00 FORMAT "%8.2" /end CHARACTERISTIC
/begin CHARACTERISTIC FrmMng_DebSigOPCRCTLACCOk_C "debouncing of signal OPCRCTLACC (no.of events)" VALUE 0xD44C6 Kw_Wu16 65535.00 OneToOne 0.00 65535.00 FORMAT "%8.2" /end CHARACTERISTIC
/begin CHARACTERISTIC FrmMng_DebSigParkConsumerDef_C "Defektentprellzeit des Signalfehlers der CAN-Botschaft PWMG_STANDVERBR" VALUE 0xD44C8 Kw_Wu16 65535.00 OneToOne 0.00 65535.00 FORMAT "%8.2" /end CHARACTERISTIC
/begin CHARACTERISTIC FrmMng_DebSigParkConsumerOk_C "Heilungsentprellzeit des Signalfehlers der CAN-Botschaft PWMG_STANDVERBR" VALUE 0xD44CA Kw_Wu16 65535.00 OneToOne 0.00 65535.00 FORMAT "%8.2" /end CHARACTERISTIC
/begin CHARACTERISTIC FrmMng_DebSigPRGG_CCTRDef_C "Defect time for PRGG_CCTR-signalerror" VALUE 0xD44CC Kw_Wu16 65535.00 OneToOne 0.00 65535.00 FORMAT "%8.2" /end CHARACTERISTIC
/begin CHARACTERISTIC FrmMng_DebSigPRGG_CCTROk_C "Healing time for PRGG_CCTR-signalerror" VALUE 0xD44CE Kw_Wu16 65535.00 OneToOne 0.00 65535.00 FORMAT "%8.2" /end CHARACTERISTIC
/begin CHARACTERISTIC FrmMng_DebSigPWRMNG_LOADVDef_C "" VALUE 0xD44D0 Kw_Wu16 65535.00 OneToOne 0.00 65535.00 FORMAT "%8.2" /end CHARACTERISTIC
/begin CHARACTERISTIC FrmMng_DebSigPWRMNG_LOADVOk_C "" VALUE 0xD44D2 Kw_Wu16 65535.00 OneToOne 0.00 65535.00 FORMAT "%8.2" /end CHARACTERISTIC
/begin CHARACTERISTIC FrmMng_DebSigRQ_STG_EFANDef_C "Defektentprellung für RQ_STG_EFAN-messages Signalfehler" VALUE 0xD44D4 Kw_Wu16 65535.00 OneToOne 0.00 65535.00 FORMAT "%8.2" /end CHARACTERISTIC
/begin CHARACTERISTIC FrmMng_DebSigRQ_STG_EFANOk_C "Heilentprellung für RQ_STG_EFAN messages Signalfehler" VALUE 0xD44D6 Kw_Wu16 65535.00 OneToOne 0.00 65535.00 FORMAT "%8.2" /end CHARACTERISTIC
/begin CHARACTERISTIC FrmMng_ctDebSigSITZGURTDef_C "STAT_SITZBELEGUNG_GURT rohes messagebyte 0" VALUE 0xD44D8 Kw_Wu16 65535.00 OneToOne 0.00 65535.00 FORMAT "%8.2" /end CHARACTERISTIC
/begin CHARACTERISTIC FrmMng_ctDebSigSITZGURTOk_C "Heilentprellung für STAT_SITZBELEGUNG_GURT-messages Signalfehler" VALUE 0xD44DA Kw_Wu16 65535.00 OneToOne 0.00 65535.00 FORMAT "%8.2" /end CHARACTERISTIC
/begin CHARACTERISTIC FrmMng_DebSigSTAT_ANHDef_C "" VALUE 0xD44DC Kw_Wu16 65535.00 OneToOne 0.00 65535.00 FORMAT "%8.2" /end CHARACTERISTIC
/begin CHARACTERISTIC FrmMng_DebSigSTAT_ANHOk_C "" VALUE 0xD44DE Kw_Wu16 65535.00 OneToOne 0.00 65535.00 FORMAT "%8.2" /end CHARACTERISTIC
/begin CHARACTERISTIC FrmMng_DebSigSTAT_ARSDef_C "#SSD debouncing of signal-error STAT_ARS (no.of events)" VALUE 0xD44E0 Kw_Wu16 65535.00 OneToOne 0.00 65535.00 FORMAT "%8.2" /end CHARACTERISTIC
/begin CHARACTERISTIC FrmMng_DebSigSTAT_ARSOk_C "debouncing of signal-error STAT_ARS (no.of events)" VALUE 0xD44E2 Kw_Wu16 65535.00 OneToOne 0.00 65535.00 FORMAT "%8.2" /end CHARACTERISTIC
/begin CHARACTERISTIC FrmMng_DebSigSTAT_DSCDef_C "#SSD debouncing of signal-error STAT_DSC (no.of events)" VALUE 0xD44E4 Kw_Wu16 65535.00 OneToOne 0.00 65535.00 FORMAT "%8.2" /end CHARACTERISTIC
/begin CHARACTERISTIC FrmMng_DebSigSTAT_DSCOk_C "debouncing of signal-error STAT_DSC (no.of events)" VALUE 0xD44E6 Kw_Wu16 65535.00 OneToOne 0.00 65535.00 FORMAT "%8.2" /end CHARACTERISTIC
/begin CHARACTERISTIC FrmMng_DebSigSTAT_EKPDef_C "Defektentprellung für STAT_EKP-messages Signalfehler" VALUE 0xD44E8 Kw_Wu16 65535.00 OneToOne 0.00 65535.00 FORMAT "%8.2" /end CHARACTERISTIC
/begin CHARACTERISTIC FrmMng_DebSigSTAT_EKPOk_C "Heilentprellung für STAT_EKP messages Signalfehler" VALUE 0xD44EA Kw_Wu16 65535.00 OneToOne 0.00 65535.00 FORMAT "%8.2" /end CHARACTERISTIC
/begin CHARACTERISTIC FrmMng_DebSigSTAT_KOMBIDef_C "#SSD debouncing of signal-error STAT_KOMBI (no.of events)" VALUE 0xD44EC Kw_Wu16 65535.00 OneToOne 0.00 65535.00 FORMAT "%8.2" /end CHARACTERISTIC
/begin CHARACTERISTIC FrmMng_DebSigSTAT_KOMBIOk_C "debouncing of signal-error STAT_KOMBI (no.of events)" VALUE 0xD44EE Kw_Wu16 65535.00 OneToOne 0.00 65535.00 FORMAT "%8.2" /end CHARACTERISTIC
/begin CHARACTERISTIC FrmMng_ctDebOBDGbxMilOfDef_C "Defektl-Entprellzähler für MilOf" VALUE 0xD44F0 Kw_Wu16 655350.0 Time_ms 0.00 655350.0 FORMAT "%8.1" /end CHARACTERISTIC
/begin CHARACTERISTIC FrmMng_ctDebSigStOBDGbxMilOfOk_C "Healing time for MIL off" VALUE 0xD44F2 Kw_Wu16 655350.0 Time_ms 0.00 655350.0 FORMAT "%8.1" /end CHARACTERISTIC
/begin CHARACTERISTIC FrmMng_ctDebOBDGbxMilOnDef_C "Defekt-Entprellzähler für MilOn" VALUE 0xD44F4 Kw_Wu16 655350.0 Time_ms 0.00 655350.0 FORMAT "%8.1" /end CHARACTERISTIC
/begin CHARACTERISTIC FrmMng_ctDebSigStOBDGbxMilOnOk_C "Healing time for MIL on" VALUE 0xD44F6 Kw_Wu16 655350.0 Time_ms 0.00 655350.0 FORMAT "%8.1" /end CHARACTERISTIC
/begin CHARACTERISTIC FrmMng_DebSigTEMPRELTIMEDef_C "debouncing of signal-error PWRMNGLOADV (no.of events)" VALUE 0xD44F8 Kw_Wu16 65535.00 OneToOne 0.00 65535.00 FORMAT "%8.2" /end CHARACTERISTIC
/begin CHARACTERISTIC FrmMng_DebSigTEMPRELTIMEOk_C "debouncing of signal-error PWRMNGLOADV (no.of events)" VALUE 0xD44FA Kw_Wu16 65535.00 OneToOne 0.00 65535.00 FORMAT "%8.2" /end CHARACTERISTIC
/begin CHARACTERISTIC FrmMng_DebSigTERMINALDef_C "debouncing of signal-error TERMINAL(no.of events)" VALUE 0xD44FC Kw_Wu16 65535.00 OneToOne 0.00 65535.00 FORMAT "%8.2" /end CHARACTERISTIC
/begin CHARACTERISTIC FrmMng_DebSigTERMINALOk_C "debouncing of signal-error TERMINAL(no.of events)" VALUE 0xD44FE Kw_Wu16 65535.00 OneToOne 0.00 65535.00 FORMAT "%8.2" /end CHARACTERISTIC
/begin CHARACTERISTIC FrmMng_DebSigTIME_DATEDef_C "" VALUE 0xD4500 Kw_Wu16 65535.00 OneToOne 0.00 65535.00 FORMAT "%8.2" /end CHARACTERISTIC
/begin CHARACTERISTIC FrmMng_DebSigTIME_DATEOk_C "" VALUE 0xD4502 Kw_Wu16 65535.00 OneToOne 0.00 65535.00 FORMAT "%8.2" /end CHARACTERISTIC
/begin CHARACTERISTIC FrmMng_DebSigTORQUE_DSCDef_C "#SSD debouncing of signal-error TORQUE_DSC (no.of events)" VALUE 0xD4504 Kw_Wu16 65535.00 OneToOne 0.00 65535.00 FORMAT "%8.2" /end CHARACTERISTIC
/begin CHARACTERISTIC FrmMng_DebSigTORQUE_DSCOk_C "debouncing of signal-error TORQUE_DSC (no.of events)" VALUE 0xD4506 Kw_Wu16 65535.00 OneToOne 0.00 65535.00 FORMAT "%8.2" /end CHARACTERISTIC
/begin CHARACTERISTIC FrmMng_DebSigTORQUE_GEARBXDef_C "#SSD debouncing of signal-error TORQUE_GEARBX (no.of events)" VALUE 0xD4508 Kw_Wu16 65535.00 OneToOne 0.00 65535.00 FORMAT "%8.2" /end CHARACTERISTIC
/begin CHARACTERISTIC FrmMng_DebSigTORQUE_GEARBXOk_C "debouncing of signal-error TORQUE_GEARBX (no.of events)" VALUE 0xD450A Kw_Wu16 65535.00 OneToOne 0.00 65535.00 FORMAT "%8.2" /end CHARACTERISTIC
/begin CHARACTERISTIC FrmMng_DebSigVEH_MODDef_C "defect debouncing time for signal error for VEH_MOD signal" VALUE 0xD450C Kw_Wu16 65535.00 OneToOne 0.00 65535.00 FORMAT "%8.2" /end CHARACTERISTIC
/begin CHARACTERISTIC FrmMng_DebSigVEH_MODOk_C "Debouncing time for sig error for VEH_MOD signal" VALUE 0xD450E Kw_Wu16 65535.00 OneToOne 0.00 65535.00 FORMAT "%8.2" /end CHARACTERISTIC
/begin CHARACTERISTIC FrmMng_DebSigVELOCITYDef_C "debouncing of signal-error VELOCITY (no.of events)" VALUE 0xD4510 Kw_Wu16 65535.00 OneToOne 0.00 65535.00 FORMAT "%8.2" /end CHARACTERISTIC
/begin CHARACTERISTIC FrmMng_DebSigVELOCITYOk_C "debouncing of signal-error VELOCITY (no.of events)" VALUE 0xD4512 Kw_Wu16 65535.00 OneToOne 0.00 65535.00 FORMAT "%8.2" /end CHARACTERISTIC
/begin CHARACTERISTIC FrmMng_ctDebSigWHEEL_SPEEDDef_C "Fehlerentprellzeit für CAN message Wheel Speed (Signalfehler)" VALUE 0xD4514 Kw_Wu16 65535.00 OneToOne 0.00 65535.00 FORMAT "%8.2" /end CHARACTERISTIC
/begin CHARACTERISTIC FrmMng_ctDebSigWHEEL_SPEEDOk_C "Heilungsentprellzeit für CAN message Wheel Speed (Signalfehler)" VALUE 0xD4516 Kw_Wu16 65535.00 OneToOne 0.00 65535.00 FORMAT "%8.2" /end CHARACTERISTIC
/begin CHARACTERISTIC FrmMng_DebTGearbxDef_C "debouncing of TGearbx for defect detection" VALUE 0xD4518 Kw_Wu16 65535.00 OneToOne 0.00 65535.00 FORMAT "%8.2" /end CHARACTERISTIC
/begin CHARACTERISTIC FrmMng_DebTGearbxOk_C "debouncing of TGearbx for healing" VALUE 0xD451A Kw_Wu16 65535.00 OneToOne 0.00 65535.00 FORMAT "%8.2" /end CHARACTERISTIC
/begin CHARACTERISTIC FrmMng_DebToBOS_RESET_2Def_C "" VALUE 0xD451C Kw_Wu16 65535.00 OneToOne 0.00 65535.00 FORMAT "%8.2" /end CHARACTERISTIC
/begin CHARACTERISTIC FrmMng_DebToBOS_RESET_2Ok_C "" VALUE 0xD451E Kw_Wu16 65535.00 OneToOne 0.00 65535.00 FORMAT "%8.2" /end CHARACTERISTIC
/begin CHARACTERISTIC FrmMng_DebToBOS_RESETDef_C "debouncing of timeout-error BOS_RESET (no.of events)" VALUE 0xD4520 Kw_Wu16 65535.00 OneToOne 0.00 65535.00 FORMAT "%8.2" /end CHARACTERISTIC
/begin CHARACTERISTIC FrmMng_DebToBOS_RESETOk_C "debouncing of timeout-error BOS_RESET (no.of events)" VALUE 0xD4522 Kw_Wu16 65535.00 OneToOne 0.00 65535.00 FORMAT "%8.2" /end CHARACTERISTIC
/begin CHARACTERISTIC FrmMng_DebToDMOMENT_ACCDef_C "#SSD Defect time of DMOMENT_ACC time out" VALUE 0xD4524 Kw_Wu16 65535.00 OneToOne 0.00 65535.00 FORMAT "%8.2" /end CHARACTERISTIC
/begin CHARACTERISTIC FrmMng_DebToDMOMENT_ACCOk_C "Healing time  of  DMOMENT_ACC  time out" VALUE 0xD4526 Kw_Wu16 65535.00 OneToOne 0.00 65535.00 FORMAT "%8.2" /end CHARACTERISTIC
/begin CHARACTERISTIC FrmMng_DebToGEARBX_DATA2Def_C "debouncing of timeout-error GEARBX_DATA2 (no.of events)" VALUE 0xD4528 Kw_Wu16 65535.00 OneToOne 0.00 65535.00 FORMAT "%8.2" /end CHARACTERISTIC
/begin CHARACTERISTIC FrmMng_DebToGEARBX_DATA2Ok_C "Healing time for GEARBX_DATA2-messages Timeout" VALUE 0xD452A Kw_Wu16 65535.00 OneToOne 0.00 65535.00 FORMAT "%8.2" /end CHARACTERISTIC
/begin CHARACTERISTIC FrmMng_DebToGEARBX_DATADef_C "debouncing of timeout-error GEARBX_DATA (no.of events)" VALUE 0xD452C Kw_Wu16 65535.00 OneToOne 0.00 65535.00 FORMAT "%8.2" /end CHARACTERISTIC
/begin CHARACTERISTIC FrmMng_DebToGEARBX_DATAOk_C "debouncing of timeout-error GEARBX_DATA (no.of events)" VALUE 0xD452E Kw_Wu16 65535.00 OneToOne 0.00 65535.00 FORMAT "%8.2" /end CHARACTERISTIC
/begin CHARACTERISTIC FrmMng_DebToHEAT_ACDef_C "debouncing of timeout-error HEAT_AC (no.of events)" VALUE 0xD4530 Kw_Wu16 65535.00 OneToOne 0.00 65535.00 FORMAT "%8.2" /end CHARACTERISTIC
/begin CHARACTERISTIC FrmMng_DebToHEAT_ACOk_C "debouncing of timeout-error HEAT_AC (no.of events)" VALUE 0xD4532 Kw_Wu16 65535.00 OneToOne 0.00 65535.00 FORMAT "%8.2" /end CHARACTERISTIC
/begin CHARACTERISTIC FrmMng_DebToMILEAGE_RANGEDef_C "#SSD debouncing of timeout - error MILEAGE_RANGE(no of events)" VALUE 0xD4534 Kw_Wu16 65535.00 OneToOne 0.00 65535.00 FORMAT "%8.2" /end CHARACTERISTIC
/begin CHARACTERISTIC FrmMng_DebToMILEAGE_RANGEOk_C "debouncing of timeout - error MILEAGE_RANGE (no of events)" VALUE 0xD4536 Kw_Wu16 65535.00 OneToOne 0.00 65535.00 FORMAT "%8.2" /end CHARACTERISTIC
/begin CHARACTERISTIC FrmMng_DebToOPCRCTLACCDef_C "#SSD debouncing of timeout-error OPCRCTLACC (no.of events)" VALUE 0xD4538 Kw_Wu16 65535.00 OneToOne 0.00 65535.00 FORMAT "%8.2" /end CHARACTERISTIC
/begin CHARACTERISTIC FrmMng_DebToOPCRCTLACCOk_C "debouncing of timeout-error OPCRCTLACC (no.of events)" VALUE 0xD453A Kw_Wu16 65535.00 OneToOne 0.00 65535.00 FORMAT "%8.2" /end CHARACTERISTIC
/begin CHARACTERISTIC FrmMng_DebToParkConsumerDef_C "Defektentprellzeit Botschaftsausfall PWMG_STANDVERBR" VALUE 0xD453C Kw_Wu16 65535.00 OneToOne 0.00 65535.00 FORMAT "%8.2" /end CHARACTERISTIC
/begin CHARACTERISTIC FrmMng_DebToParkConsumerOk_C "Heilentprellzeit Botschaftsausfall PWMG_STANDVERBR" VALUE 0xD453E Kw_Wu16 65535.00 OneToOne 0.00 65535.00 FORMAT "%8.2" /end CHARACTERISTIC
/begin CHARACTERISTIC FrmMng_DebToPRGG_CCTRDef_C "Defect time for PRGG_CCTR-messages Timeout" VALUE 0xD4540 Kw_Wu16 65535.00 OneToOne 0.00 65535.00 FORMAT "%8.2" /end CHARACTERISTIC
/begin CHARACTERISTIC FrmMng_DebToPRGG_CCTROk_C "Healing time for PRGG_CCTR-messages Timeout" VALUE 0xD4542 Kw_Wu16 65535.00 OneToOne 0.00 65535.00 FORMAT "%8.2" /end CHARACTERISTIC
/begin CHARACTERISTIC FrmMng_DebToPWRMNG_LOADVDef_C "" VALUE 0xD4544 Kw_Wu16 65535.00 OneToOne 0.00 65535.00 FORMAT "%8.2" /end CHARACTERISTIC
/begin CHARACTERISTIC FrmMng_DebToPWRMNG_LOADVOk_C "" VALUE 0xD4546 Kw_Wu16 65535.00 OneToOne 0.00 65535.00 FORMAT "%8.2" /end CHARACTERISTIC
/begin CHARACTERISTIC FrmMng_DebToRQ_STG_EFANDef_C "Defektentprellung für RQ_STG_EFAN - messages timeout" VALUE 0xD4548 Kw_Wu16 65535.00 OneToOne 0.00 65535.00 FORMAT "%8.2" /end CHARACTERISTIC
/begin CHARACTERISTIC FrmMng_DebToRQ_STG_EFANOk_C "Heilentprellung für RQ_STG_EFAN - messages timeout" VALUE 0xD454A Kw_Wu16 65535.00 OneToOne 0.00 65535.00 FORMAT "%8.2" /end CHARACTERISTIC
/begin CHARACTERISTIC FrmMng_ctDebToSITZGURTDef_C "Defektentprellung für STAT_SITZBELEGUNG_GURT-messages Timeout" VALUE 0xD454C Kw_Wu16 65535.00 OneToOne 0.00 65535.00 FORMAT "%8.2" /end CHARACTERISTIC
/begin CHARACTERISTIC FrmMng_ctDebToSITZGURTOk_C "Heilentprellung für STAT_SITZBELEGUNG_GURT-messages Timeout" VALUE 0xD454E Kw_Wu16 65535.00 OneToOne 0.00 65535.00 FORMAT "%8.2" /end CHARACTERISTIC
/begin CHARACTERISTIC FrmMng_DebToSTAT_ANHDef_C "" VALUE 0xD4550 Kw_Wu16 65535.00 OneToOne 0.00 65535.00 FORMAT "%8.2" /end CHARACTERISTIC
/begin CHARACTERISTIC FrmMng_DebToSTAT_ANHOk_C "" VALUE 0xD4552 Kw_Wu16 65535.00 OneToOne 0.00 65535.00 FORMAT "%8.2" /end CHARACTERISTIC
/begin CHARACTERISTIC FrmMng_DebToSTAT_ARSDef_C "#SSD debouncing of timeout-error STAT_ARS (no.of events)" VALUE 0xD4554 Kw_Wu16 65535.00 OneToOne 0.00 65535.00 FORMAT "%8.2" /end CHARACTERISTIC
/begin CHARACTERISTIC FrmMng_DebToSTAT_ARSOk_C "debouncing of timeout-error STAT_ARS (no.of events)" VALUE 0xD4556 Kw_Wu16 65535.00 OneToOne 0.00 65535.00 FORMAT "%8.2" /end CHARACTERISTIC
/begin CHARACTERISTIC FrmMng_DebToSTAT_DSCDef_C "#SSD debouncing of timeout-error STAT_DSC (no.of events)" VALUE 0xD4558 Kw_Wu16 65535.00 OneToOne 0.00 65535.00 FORMAT "%8.2" /end CHARACTERISTIC
/begin CHARACTERISTIC FrmMng_DebToSTAT_DSCOk_C "debouncing of timeout-error STAT_DSC (no.of events)" VALUE 0xD455A Kw_Wu16 65535.00 OneToOne 0.00 65535.00 FORMAT "%8.2" /end CHARACTERISTIC
/begin CHARACTERISTIC FrmMng_DebToSTAT_EKPDef_C "Defektentprellung für STAT_EKPmessages  Timeout fehler" VALUE 0xD455C Kw_Wu16 65535.00 OneToOne 0.00 65535.00 FORMAT "%8.2" /end CHARACTERISTIC
/begin CHARACTERISTIC FrmMng_DebToSTAT_EKPOk_C "Heilentprellung  für STAT_EKP-messages Timeout lfehler" VALUE 0xD455E Kw_Wu16 65535.00 OneToOne 0.00 65535.00 FORMAT "%8.2" /end CHARACTERISTIC
/begin CHARACTERISTIC FrmMng_DebToSTAT_KOMBIDef_C "#SSD debouncing of timeout - error STAT_KOMBI (no of events)" VALUE 0xD4560 Kw_Wu16 65535.00 OneToOne 0.00 65535.00 FORMAT "%8.2" /end CHARACTERISTIC
/begin CHARACTERISTIC FrmMng_DebToSTAT_KOMBIOk_C "debouncing of timeout - error STAT_KOMBI (no of events)" VALUE 0xD4562 Kw_Wu16 65535.00 OneToOne 0.00 65535.00 FORMAT "%8.2" /end CHARACTERISTIC
/begin CHARACTERISTIC FrmMng_DebToTEMPRELTIMEDef_C "debouncing of timeout-error TEMPRELTIME (no.of events)" VALUE 0xD4564 Kw_Wu16 65535.00 OneToOne 0.00 65535.00 FORMAT "%8.2" /end CHARACTERISTIC
/begin CHARACTERISTIC FrmMng_DebToTEMPRELTIMEOk_C "debouncing of timeout-error TEMPRELTIME (no.of events)" VALUE 0xD4566 Kw_Wu16 65535.00 OneToOne 0.00 65535.00 FORMAT "%8.2" /end CHARACTERISTIC
/begin CHARACTERISTIC FrmMng_DebToTERMINALDef_C "debouncing of timeout-error TERMINAL (no.of events)" VALUE 0xD4568 Kw_Wu16 65535.00 OneToOne 0.00 65535.00 FORMAT "%8.2" /end CHARACTERISTIC
/begin CHARACTERISTIC FrmMng_DebToTERMINALOk_C "debouncing of timeout-error TERMINAL (no.of events)" VALUE 0xD456A Kw_Wu16 65535.00 OneToOne 0.00 65535.00 FORMAT "%8.2" /end CHARACTERISTIC
/begin CHARACTERISTIC FrmMng_DebToTIME_DATEDef_C "" VALUE 0xD456C Kw_Wu16 65535.00 OneToOne 0.00 65535.00 FORMAT "%8.2" /end CHARACTERISTIC
/begin CHARACTERISTIC FrmMng_DebToTIME_DATEOk_C "" VALUE 0xD456E Kw_Wu16 65535.00 OneToOne 0.00 65535.00 FORMAT "%8.2" /end CHARACTERISTIC
/begin CHARACTERISTIC FrmMng_DebToTORQUE_DSCDef_C "#SSD debouncing of timeout-error TORQUE_DSC (no.of events)" VALUE 0xD4570 Kw_Wu16 65535.00 OneToOne 0.00 65535.00 FORMAT "%8.2" /end CHARACTERISTIC
/begin CHARACTERISTIC FrmMng_DebToTORQUE_DSCOk_C "debouncing of timeout-error TORQUE_DSC (no.of events)" VALUE 0xD4572 Kw_Wu16 65535.00 OneToOne 0.00 65535.00 FORMAT "%8.2" /end CHARACTERISTIC
/begin CHARACTERISTIC FrmMng_DebToTORQUE_GEARBXDef_C "#SSD debouncing of timeout-error TORQUE_GEARBX (no.of events)" VALUE 0xD4574 Kw_Wu16 65535.00 OneToOne 0.00 65535.00 FORMAT "%8.2" /end CHARACTERISTIC
/begin CHARACTERISTIC FrmMng_DebToTORQUE_GEARBXOk_C "debouncing of timeout-error TORQUE_GEARBX (no.of events)" VALUE 0xD4576 Kw_Wu16 65535.00 OneToOne 0.00 65535.00 FORMAT "%8.2" /end CHARACTERISTIC
/begin CHARACTERISTIC FrmMng_DebToVEH_MODDef_C "Defect debouncing time VEH_MOD" VALUE 0xD4578 Kw_Wu16 65535.00 OneToOne 0.00 65535.00 FORMAT "%8.2" /end CHARACTERISTIC
/begin CHARACTERISTIC FrmMng_DebToVEH_MODOk_C "Debouncing OK time for VEH_MOD signal" VALUE 0xD457A Kw_Wu16 65535.00 OneToOne 0.00 65535.00 FORMAT "%8.2" /end CHARACTERISTIC
/begin CHARACTERISTIC FrmMng_DebToVELOCITYDef_C "debouncing of timeout-error VELOCITY (no.of events)" VALUE 0xD457C Kw_Wu16 65535.00 OneToOne 0.00 65535.00 FORMAT "%8.2" /end CHARACTERISTIC
/begin CHARACTERISTIC FrmMng_DebToVELOCITYOk_C "debouncing of timeout-error VELOCITY (no.of events)" VALUE 0xD457E Kw_Wu16 65535.00 OneToOne 0.00 65535.00 FORMAT "%8.2" /end CHARACTERISTIC
/begin CHARACTERISTIC FrmMng_ctDebToWHEEL_SPEEDDef_C "#SSD Fehlerentprellzeit für CAN message Wheel Speed (timeout)" VALUE 0xD4580 Kw_Wu16 65535.00 OneToOne 0.00 65535.00 FORMAT "%8.2" /end CHARACTERISTIC
/begin CHARACTERISTIC FrmMng_ctDebToWHEEL_SPEEDOk_C "Fehlerheilungszeit für CAN message Wheel Speed (timeout)" VALUE 0xD4582 Kw_Wu16 65535.00 OneToOne 0.00 65535.00 FORMAT "%8.2" /end CHARACTERISTIC
/begin CHARACTERISTIC FrmMng_drAPP1Min_C "threshold for accelerator padel 1 value" VALUE 0xD4584 Kw_Ws16 5000.000 PrcPerSec 0.00 5000.000 FORMAT "%8.3" EXTENDED_LIMITS -20000.00 19999.39 /end CHARACTERISTIC
/begin CHARACTERISTIC FrmMng_dstGear_C "#SSD translationtable ST_GR_GRB to FrmMng_stGear" VAL_BLK 0xD4586 Kwb_Wu8 14.00 OneToOne 0.00 14.00 FORMAT "%5.2" EXTENDED_LIMITS 0.00 255.0 NUMBER 15 /end CHARACTERISTIC
/begin CHARACTERISTIC FrmMng_factrqInrStrt_C "Faktor zur Minimierung des inneren Moments im Startfall" VALUE 0xD4596 Kw_Wu16 7.999878 Fact 0.00 7.999878 FORMAT "%8.6" /end CHARACTERISTIC
/begin CHARACTERISTIC FrmMng_FDCSelfRec_C "Schalter zur Auswahl des FDC Selbstanerkennung" VALUE 0xD4598 Kw_Wu8 1.000 OneToOne 0.00 1.000 FORMAT "%5.3" EXTENDED_LIMITS 0.00 255.0 /end CHARACTERISTIC
/begin CHARACTERISTIC FrmMng_FGRSelfRec_C "Switch to disable/enable FGR self recognition" VALUE 0xD4599 Kw_Wu8 1.000 OneToOne 0.00 1.000 FORMAT "%5.3" EXTENDED_LIMITS 0.00 255.0 /end CHARACTERISTIC
/begin CHARACTERISTIC FrmMng_cnvFLLV_FUTA_Offset_C "#SSD Offset to calculate FST from CAN" VALUE 0xD459A Kw_Ws16 65535.00 OneToOne -32768.00 32767.00 FORMAT "%8.2" /end CHARACTERISTIC
/begin CHARACTERISTIC FrmMng_cnvFLLV_FUTA_Slope_C "#SSD Slope to calculate FST from CAN" VALUE 0xD459C Kw_Ws16 65.53500 SlopeRes1000 -32.76800 32.76700 FORMAT "%8.5" /end CHARACTERISTIC
/begin CHARACTERISTIC FrmMng_mskDM_ANF_ACC_0x800_C "" VALUE 0xD459E Kw_Wu8 255.0 OneToOne 0.00 255.0 FORMAT "%5.1" /end CHARACTERISTIC
/begin CHARACTERISTIC FrmMng_mskDM_ANF_AFS_C "mask for the status bits to supress unwanted errors" VALUE 0xD459F Kw_Wu8 255.0 OneToOne 0.00 255.0 FORMAT "%5.1" /end CHARACTERISTIC
/begin CHARACTERISTIC FrmMng_mskDM_ANF_SSG_C "Maske um mittels Status Bits div. Fehler auszublenden" VALUE 0xD45A0 Kw_Wu8 255.0 OneToOne 0.00 255.0 FORMAT "%5.1" /end CHARACTERISTIC
/begin CHARACTERISTIC FrmMng_mskSTAT_ARS_C "mask signalerrors" VALUE 0xD45A1 Kw_Wu8 255.0 OneToOne 0.00 255.0 FORMAT "%5.1" /end CHARACTERISTIC
/begin CHARACTERISTIC FrmMng_mskTORQUE_DSC_C "mask signal errors" VALUE 0xD45A2 Kw_Wu8 255.0 OneToOne 0.00 255.0 FORMAT "%5.1" /end CHARACTERISTIC
/begin CHARACTERISTIC FrmMng_mskTORQUE_GEARBX_C " mask signalerrors" VALUE 0xD45A3 Kw_Wu8 255.0 OneToOne 0.00 255.0 FORMAT "%5.1" /end CHARACTERISTIC
/begin CHARACTERISTIC FrmMng_nEngOFF_C "Engine speed threshold for engine state" VALUE 0xD45A4 Kw_Ws16 8000.000 EngN 0.00 8000.000 FORMAT "%8.3" EXTENDED_LIMITS -32768.00 32767.00 /end CHARACTERISTIC
/begin CHARACTERISTIC FrmMng_nEngRpm1_CUR "Curve for calculating the engine speed threshold 1" CURVE 0xD45A6 Kl_Xs16_Ws16 5960.000 EngN 40.00000 6000.000 FORMAT "%8.3" EXTENDED_LIMITS -32768.00 32767.00
 /begin AXIS_DESCR STD_AXIS FrmMng_tEngRpm_mp Temp_Cels 6 -50.14000 199.8600 FORMAT "%8.4" EXTENDED_LIMITS -3549.940 3003.560 DEPOSIT ABSOLUTE /end AXIS_DESCR
/end CHARACTERISTIC
/begin CHARACTERISTIC FrmMng_nEngRpm2_CUR "Curve for calculating the engine speed threshold 2" CURVE 0xD45C0 Kl_Xs16_Ws16 5960.000 EngN 40.00000 6000.000 FORMAT "%8.3" EXTENDED_LIMITS -32768.00 32767.00
 /begin AXIS_DESCR STD_AXIS FrmMng_tEngRpm_mp Temp_Cels 6 -50.14000 199.8600 FORMAT "%8.4" EXTENDED_LIMITS -3549.940 3003.560 DEPOSIT ABSOLUTE /end AXIS_DESCR
/end CHARACTERISTIC
/begin CHARACTERISTIC FrmMng_nFanDflt_C "Unterlassungs-Fan eilt" VALUE 0xD45DA Kw_Wu16 3000.000 FanSpd 0.00 3000.000 FORMAT "%8.3" EXTENDED_LIMITS 0.00 6000.092 /end CHARACTERISTIC
/begin CHARACTERISTIC FrmMng_nFan_CUR "Umsetzungstabelle Lüfterstufe --> Lüfterdrehzahl" CURVE 0xD45DC Kl_Xs16_Ws16 3000.000 FanSpd 0.00 3000.000 FORMAT "%8.3" EXTENDED_LIMITS -3000.092 3000.000
 /begin AXIS_DESCR STD_AXIS FrmMng_numACFanDes OneToOne 4 0.00 15.00 FORMAT "%5.2" EXTENDED_LIMITS 0.00 255.0 DEPOSIT ABSOLUTE /end AXIS_DESCR
/end CHARACTERISTIC
/begin CHARACTERISTIC FrmMng_nHtgUpActMax_C "speed threshold for evaluating ST_SW_WAUP signal" VALUE 0xD45EE Kw_Ws16 5960.000 EngN 40.00000 6000.000 FORMAT "%8.3" EXTENDED_LIMITS -32768.00 32767.00 /end CHARACTERISTIC
/begin CHARACTERISTIC FrmMng_nHtgUpCrCtlMax_C "max cruise control speed switch" VALUE 0xD45F0 Kw_Ws16 5960.000 EngN 40.00000 6000.000 FORMAT "%8.3" EXTENDED_LIMITS -32768.00 32767.00 /end CHARACTERISTIC
/begin CHARACTERISTIC FrmMng_nLIGovOffs_C "ST_SW_LEV_RPM - status switch level RPM" VALUE 0xD45F2 Kw_Ws16 5960.000 EngN 40.00000 6000.000 FORMAT "%8.3" EXTENDED_LIMITS -32768.00 32767.00 /end CHARACTERISTIC
/begin CHARACTERISTIC FrmMng_nLimSSGErr_C "Error value for Maximum engine speed in phase 2 of the switching process" VALUE 0xD45F4 Kw_Ws16 5960.000 EngN 40.00000 6000.000 FORMAT "%8.3" EXTENDED_LIMITS -32768.00 32767.00 /end CHARACTERISTIC
/begin CHARACTERISTIC FrmMng_cnvnPSPSpd_Offset_C "Offset for the calculation of RPM_FU_PP_EL signal" VALUE 0xD45F6 Kw_Ws16 65535.00 PSP_Spd -32768.00 32767.00 FORMAT "%8.2" /end CHARACTERISTIC
/begin CHARACTERISTIC FrmMng_cnvnPSPSpd_Slope_C "Slope for the calculation of RPM_FU_PP_EL signal" VALUE 0xD45F8 Kw_Ws16 655.3500 SlopeRes100 -327.6800 327.6700 FORMAT "%8.4" /end CHARACTERISTIC
/begin CHARACTERISTIC FrmMng_nRqStgEFan_CUR "Kennlinie zur Berechnung der Lüfterdrehzal aus der Lüfterstufe" CURVE 0xD45FA Kl_Xs16_Ws16 3000.000 FanSpd 0.00 3000.000 FORMAT "%8.3" EXTENDED_LIMITS -3000.092 3000.000
 /begin AXIS_DESCR STD_AXIS FrmMng_numRqStgEFan OneToOne 4 0.00 15.00 FORMAT "%5.2" EXTENDED_LIMITS 0.00 255.0 DEPOSIT ABSOLUTE /end AXIS_DESCR
/end CHARACTERISTIC
/begin CHARACTERISTIC FrmMng_numACFanDesDef_C "Defektwert für FrmMng_numACFanDesDef_C Botschaft" VALUE 0xD460C Kw_Wu8 255.0 OneToOne 0.00 255.0 FORMAT "%5.1" /end CHARACTERISTIC
/begin CHARACTERISTIC FrmMng_numCCAddLevlFlsh_C "State flash cycle for Checkcontroll message 11" VALUE 0xD460D Kw_Wu8 3.000 OneToOne 0.00 3.000 FORMAT "%5.3" EXTENDED_LIMITS 0.00 255.0 /end CHARACTERISTIC
/begin CHARACTERISTIC FrmMng_numCCAddLevlNum_C "#SSD Number Checkcontroll message 11" VALUE 0xD460E Kw_Wu16 65535.00 OneToOne 0.00 65535.00 FORMAT "%8.2" /end CHARACTERISTIC
/begin CHARACTERISTIC FrmMng_numCCBrkDefFlsh_C "Status Blinken Takt CC-Meldung Bremslichtschalter defekt" VALUE 0xD4610 Kw_Wu8 3.000 OneToOne 0.00 3.000 FORMAT "%5.3" EXTENDED_LIMITS 0.00 255.0 /end CHARACTERISTIC
/begin CHARACTERISTIC FrmMng_numCCBrkDefNum_C "Nummer CC-Meldung Bremslichtschalter defekt" VALUE 0xD4612 Kw_Wu16 65535.00 OneToOne 0.00 65535.00 FORMAT "%8.2" /end CHARACTERISTIC
/begin CHARACTERISTIC FrmMng_numCCbtnachFlsh_C "State flash cycle for Checkcontroll message 17" VALUE 0xD4614 Kw_Wu8 3.000 OneToOne 0.00 3.000 FORMAT "%5.3" EXTENDED_LIMITS 0.00 255.0 /end CHARACTERISTIC
/begin CHARACTERISTIC FrmMng_numCCbtnachNum_C "#SSD Number Checkcontroll message 17" VALUE 0xD4616 Kw_Wu16 65535.00 OneToOne 0.00 65535.00 FORMAT "%8.2" /end CHARACTERISTIC
/begin CHARACTERISTIC FrmMng_numCCbttdfkFlsh_C "State flash cycle for Checkcontroll message 19" VALUE 0xD4618 Kw_Wu8 3.000 OneToOne 0.00 3.000 FORMAT "%5.3" EXTENDED_LIMITS 0.00 255.0 /end CHARACTERISTIC
/begin CHARACTERISTIC FrmMng_numCCbttdfkNum_C "#SSD Number Checkcontroll message 19" VALUE 0xD461A Kw_Wu16 65535.00 OneToOne 0.00 65535.00 FORMAT "%8.2" /end CHARACTERISTIC
/begin CHARACTERISTIC FrmMng_numCCbttkntFlsh_C "State flash cycle for Checkcontroll message 20" VALUE 0xD461C Kw_Wu8 3.000 OneToOne 0.00 3.000 FORMAT "%5.3" EXTENDED_LIMITS 0.00 255.0 /end CHARACTERISTIC
/begin CHARACTERISTIC FrmMng_numCCbttkntNum_C "#SSD Number Checkcontroll message 20" VALUE 0xD461E Kw_Wu16 65535.00 OneToOne 0.00 65535.00 FORMAT "%8.2" /end CHARACTERISTIC
/begin CHARACTERISTIC FrmMng_numCCGenDef2Flsh_C "State flash cycle for Checkcontroll message 14" VALUE 0xD4620 Kw_Wu8 3.000 OneToOne 0.00 3.000 FORMAT "%5.3" EXTENDED_LIMITS 0.00 255.0 /end CHARACTERISTIC
/begin CHARACTERISTIC FrmMng_numCCGenDef2Num_C "#SSD Number Checkcontroll message 14" VALUE 0xD4622 Kw_Wu16 65535.00 OneToOne 0.00 65535.00 FORMAT "%8.2" /end CHARACTERISTIC
/begin CHARACTERISTIC FrmMng_numCCNoCrCtlFlsh_C "Status Blinken Takt der Checkcontrol Meldung Geschwindigkeitsregelung ohne Funktion" VALUE 0xD4624 Kw_Wu8 3.000 OneToOne 0.00 3.000 FORMAT "%5.3" EXTENDED_LIMITS 0.00 255.0 /end CHARACTERISTIC
/begin CHARACTERISTIC FrmMng_numCCNoCrCtlNum_C "#SSD Nummer der Checkcontrol Meldung Geschwindigkeitsregelung ohne Funktion" VALUE 0xD4626 Kw_Wu16 65535.00 OneToOne 0.00 65535.00 FORMAT "%8.2" /end CHARACTERISTIC
/begin CHARACTERISTIC FrmMng_numCCOelLevlFlsh_C "State flash cycle for Checkcontroll message 10" VALUE 0xD4628 Kw_Wu8 3.000 OneToOne 0.00 3.000 FORMAT "%5.3" EXTENDED_LIMITS 0.00 255.0 /end CHARACTERISTIC
/begin CHARACTERISTIC FrmMng_numCCOelLevlNum_C "#SSD Number Checkcontroll message 10" VALUE 0xD462A Kw_Wu16 65535.00 OneToOne 0.00 65535.00 FORMAT "%8.2" /end CHARACTERISTIC
/begin CHARACTERISTIC FrmMng_numCCOelVerbFlsh_C "State flash cycle for Checkcontroll message 8" VALUE 0xD462C Kw_Wu8 3.000 OneToOne 0.00 3.000 FORMAT "%5.3" EXTENDED_LIMITS 0.00 255.0 /end CHARACTERISTIC
/begin CHARACTERISTIC FrmMng_numCCOelVerbNum_C "#SSD Number Checkcontroll message 8" VALUE 0xD462E Kw_Wu16 65535.00 OneToOne 0.00 65535.00 FORMAT "%8.2" /end CHARACTERISTIC
/begin CHARACTERISTIC FrmMng_numCCOelVerlFlsh_C "State flash cycle for Checkcontroll message 9" VALUE 0xD4630 Kw_Wu8 3.000 OneToOne 0.00 3.000 FORMAT "%5.3" EXTENDED_LIMITS 0.00 255.0 /end CHARACTERISTIC
/begin CHARACTERISTIC FrmMng_numCCOelVerlNum_C "#SSD Number Checkcontroll message 9" VALUE 0xD4632 Kw_Wu16 65535.00 OneToOne 0.00 65535.00 FORMAT "%8.2" /end CHARACTERISTIC
/begin CHARACTERISTIC FrmMng_numCCOilPresFlsh_C "State flash cycle for Checkcontroll message 4" VALUE 0xD4634 Kw_Wu8 3.000 OneToOne 0.00 3.000 FORMAT "%5.3" EXTENDED_LIMITS 0.00 255.0 /end CHARACTERISTIC
/begin CHARACTERISTIC FrmMng_numCCOilPresNum_C "#SSD Number Checkcontroll message 4" VALUE 0xD4636 Kw_Wu16 65535.00 OneToOne 0.00 65535.00 FORMAT "%8.2" /end CHARACTERISTIC
/begin CHARACTERISTIC FrmMng_numCCOvrTem2Flsh_C "State flash cycle for Checkcontroll message 6" VALUE 0xD4638 Kw_Wu8 3.000 OneToOne 0.00 3.000 FORMAT "%5.3" EXTENDED_LIMITS 0.00 255.0 /end CHARACTERISTIC
/begin CHARACTERISTIC FrmMng_numCCOvrTem2Num_C "#SSD Number Checkcontroll message 6" VALUE 0xD463A Kw_Wu16 65535.00 OneToOne 0.00 65535.00 FORMAT "%8.2" /end CHARACTERISTIC
/begin CHARACTERISTIC FrmMng_numCCOvrTempFlsh_C "State flash cycle for Checkcontroll message 5" VALUE 0xD463C Kw_Wu8 3.000 OneToOne 0.00 3.000 FORMAT "%5.3" EXTENDED_LIMITS 0.00 255.0 /end CHARACTERISTIC
/begin CHARACTERISTIC FrmMng_numCCOvrTempNum_C "#SSD Number Checkcontroll message 5" VALUE 0xD463E Kw_Wu16 65535.00 OneToOne 0.00 65535.00 FORMAT "%8.2" /end CHARACTERISTIC
/begin CHARACTERISTIC FrmMng_numCCPFltDefFlsh_C "State flash cycle for Checkcontroll message 12" VALUE 0xD4640 Kw_Wu8 3.000 OneToOne 0.00 3.000 FORMAT "%5.3" EXTENDED_LIMITS 0.00 255.0 /end CHARACTERISTIC
/begin CHARACTERISTIC FrmMng_numCCPFltDefNum_C "#SSD Number Checkcontroll message 12" VALUE 0xD4642 Kw_Wu16 65535.00 OneToOne 0.00 65535.00 FORMAT "%8.2" /end CHARACTERISTIC
/begin CHARACTERISTIC FrmMng_numCCpmerrFlsh_C "State flash cycle for Checkcontroll message 18" VALUE 0xD4644 Kw_Wu8 3.000 OneToOne 0.00 3.000 FORMAT "%5.3" EXTENDED_LIMITS 0.00 255.0 /end CHARACTERISTIC
/begin CHARACTERISTIC FrmMng_numCCpmerrNum_C "#SSD Number Checkcontroll message 18" VALUE 0xD4646 Kw_Wu16 65535.00 OneToOne 0.00 65535.00 FORMAT "%8.2" /end CHARACTERISTIC
/begin CHARACTERISTIC FrmMng_numCCPreGlowFlsh_C "Status Blinken Takt der Checkcontrol Meldung Vorglühen" VALUE 0xD4648 Kw_Wu8 3.000 OneToOne 0.00 3.000 FORMAT "%5.3" EXTENDED_LIMITS 0.00 255.0 /end CHARACTERISTIC
/begin CHARACTERISTIC FrmMng_numCCPreGlowNum_C "#SSD Nummer der Checkcontrol Meldung Vorglühen" VALUE 0xD464A Kw_Wu16 65535.00 OneToOne 0.00 65535.00 FORMAT "%8.2" /end CHARACTERISTIC
/begin CHARACTERISTIC FrmMng_numCCprioFlsh_C "State flash cycle for Checkcontroll message 21" VALUE 0xD464C Kw_Wu8 3.000 OneToOne 0.00 3.000 FORMAT "%5.3" EXTENDED_LIMITS 0.00 255.0 /end CHARACTERISTIC
/begin CHARACTERISTIC FrmMng_numCCprioNum_C "#SSD Number Checkcontroll message 21" VALUE 0xD464E Kw_Wu16 65535.00 OneToOne 0.00 65535.00 FORMAT "%8.2" /end CHARACTERISTIC
/begin CHARACTERISTIC FrmMng_numCCruhverFlsh_C "State flash cycle for Checkcontroll message 16" VALUE 0xD4650 Kw_Wu8 3.000 OneToOne 0.00 3.000 FORMAT "%5.3" EXTENDED_LIMITS 0.00 255.0 /end CHARACTERISTIC
/begin CHARACTERISTIC FrmMng_numCCruhverNum_C "#SSD Number Checkcontroll message 16" VALUE 0xD4652 Kw_Wu16 65535.00 OneToOne 0.00 65535.00 FORMAT "%8.2" /end CHARACTERISTIC
/begin CHARACTERISTIC FrmMng_numCCStatMilFlsh_C "State flash cycle for Checkcontroll message 7" VALUE 0xD4654 Kw_Wu8 3.000 OneToOne 0.00 3.000 FORMAT "%5.3" EXTENDED_LIMITS 0.00 255.0 /end CHARACTERISTIC
/begin CHARACTERISTIC FrmMng_numCCStatMilLmpTstFlsh_C "State flash cycle for Checkcontroll message 34" VALUE 0xD4655 Kw_Wu8 3.000 OneToOne 0.00 3.000 FORMAT "%5.3" EXTENDED_LIMITS 0.00 255.0 /end CHARACTERISTIC
/begin CHARACTERISTIC FrmMng_numCCStatMilLmpTstNum_C "#SSD Number Checkcontroll message 34" VALUE 0xD4656 Kw_Wu16 65535.00 OneToOne 0.00 65535.00 FORMAT "%8.2" /end CHARACTERISTIC
/begin CHARACTERISTIC FrmMng_numCCStatMilNum_C "Number Checkcontroll message 7" VALUE 0xD4658 Kw_Wu16 65535.00 OneToOne 0.00 65535.00 FORMAT "%8.2" /end CHARACTERISTIC
/begin CHARACTERISTIC FrmMng_numCCSysLampFlsh_C "Status Blinken Takt der Checkcontrol Meldung Motornotprogramm" VALUE 0xD465A Kw_Wu8 3.000 OneToOne 0.00 3.000 FORMAT "%5.3" EXTENDED_LIMITS 0.00 255.0 /end CHARACTERISTIC
/begin CHARACTERISTIC FrmMng_numCCSysLampNum_C "#SSD Nummer der Checkcontrolmessage Motornotprogramm" VALUE 0xD465C Kw_Wu16 65535.00 OneToOne 0.00 65535.00 FORMAT "%8.2" /end CHARACTERISTIC
/begin CHARACTERISTIC FrmMng_numInqyID_C "#SSD Number Inquiry message 1" VALUE 0xD465E Kw_Wu16 65535.00 OneToOne 0.00 65535.00 FORMAT "%8.2" /end CHARACTERISTIC
/begin CHARACTERISTIC FrmMng_numRecACCMax_C "Number of allowed errors for ACC recognition" VALUE 0xD4660 Kw_Wu8 119.0 OneToOne 1.000 120.0 FORMAT "%5.1" EXTENDED_LIMITS 0.00 255.0 /end CHARACTERISTIC
/begin CHARACTERISTIC FrmMng_numRecACMax_C "" VALUE 0xD4661 Kw_Wu8 119.0 OneToOne 1.000 120.0 FORMAT "%5.1" EXTENDED_LIMITS 0.00 255.0 /end CHARACTERISTIC
/begin CHARACTERISTIC FrmMng_numRecAFSMax_C "Maximum number of messages received" VALUE 0xD4662 Kw_Wu8 119.0 OneToOne 1.000 120.0 FORMAT "%5.1" EXTENDED_LIMITS 0.00 255.0 /end CHARACTERISTIC
/begin CHARACTERISTIC FrmMng_numRecARSMax_C "No of errors for ARS detection" VALUE 0xD4664 Kw_Wu16 119.0000 OneToOne 1.000000 120.0000 FORMAT "%8.4" EXTENDED_LIMITS 0.00 65535.00 /end CHARACTERISTIC
/begin CHARACTERISTIC FrmMng_numRecFDCMax_C "Z" VALUE 0xD4666 Kw_Wu8 119.0 OneToOne 1.000 120.0 FORMAT "%5.1" EXTENDED_LIMITS 0.00 255.0 /end CHARACTERISTIC
/begin CHARACTERISTIC FrmMng_numRecFGRMax_C "Number of allowed errors for FGR recognition" VALUE 0xD4667 Kw_Wu8 119.0 OneToOne 1.000 120.0 FORMAT "%5.1" EXTENDED_LIMITS 0.00 255.0 /end CHARACTERISTIC
/begin CHARACTERISTIC FrmMng_dtrqOvrRunRmpUp_C "parameter for overrun shut off ramp up  slope" VALUE 0xD4668 Kw_Wu32 6553584.99908 RmpTrq 14.9993896484 6553599.99847 FORMAT "%13.5" EXTENDED_LIMITS 0.00 6553599.99847 READ_ONLY /end CHARACTERISTIC
/begin CHARACTERISTIC FrmMng_dtrqOvrRunRmpDwn_C "#SSD parameter for overrun shut off ramp down  slope" VALUE 0xD466C Kw_Wu32 6553584.99908 RmpTrq 14.9993896484 6553599.99847 FORMAT "%13.5" EXTENDED_LIMITS 0.00 6553599.99847 /end CHARACTERISTIC
/begin CHARACTERISTIC FrmMng_qOvrRun_C "ST_INFS - status over-run-fuel-shutoff" VALUE 0xD4670 Kw_Ws16 327.6700 InjMass 0.00 327.6700 FORMAT "%8.4" EXTENDED_LIMITS -327.6800 327.6700 /end CHARACTERISTIC
/begin CHARACTERISTIC FrmMng_cnvrPSPSetPoint_Offset_C "Offset Wert für die SETQ_FU_PP_EL signale" VALUE 0xD4672 Kw_Ws16 799.9878 Prc -400.0000 399.9878 FORMAT "%8.4" /end CHARACTERISTIC
/begin CHARACTERISTIC FrmMng_cnvrPSPSetPoint_Slope_C "Steigungs Wert für SETQ_FU_PP_EL der STAT_EKP  CAN Botschaft" VALUE 0xD4674 Kw_Ws16 655.3500 SlopeRes100 -327.6800 327.6700 FORMAT "%8.4" /end CHARACTERISTIC
/begin CHARACTERISTIC FrmMng_rWaterVlvClose_C "value for water valve fully closed" VALUE 0xD4676 Kw_Wu16 100.0000 Prc 0.00 100.0000 FORMAT "%8.4" EXTENDED_LIMITS 0.00 799.9878 /end CHARACTERISTIC
/begin CHARACTERISTIC FrmMng_rWaterVlvCtl_C "Control value for water valve" VALUE 0xD4678 Kw_Wu16 100.0000 Prc 0.00 100.0000 FORMAT "%8.4" EXTENDED_LIMITS 0.00 799.9878 /end CHARACTERISTIC
/begin CHARACTERISTIC FrmMng_rWaterVlvOpen_C "value for water valve fully open" VALUE 0xD467A Kw_Wu16 100.0000 Prc 0.00 100.0000 FORMAT "%8.4" EXTENDED_LIMITS 0.00 799.9878 /end CHARACTERISTIC
/begin CHARACTERISTIC FrmMng_stBltbDrDef_C "Ersatzwert" VALUE 0xD467C Kw_Wu8 255.0 OneToOne 0.00 255.0 FORMAT "%5.1" /end CHARACTERISTIC
/begin CHARACTERISTIC FrmMng_stClCtrDEF_C "#SSD defekt value for FrmMng_stClCtr (CAN message ST_CLCTR)" VALUE 0xD467D Kw_Wu8 255.0 OneToOne 0.00 255.0 FORMAT "%5.1" /end CHARACTERISTIC
/begin CHARACTERISTIC FrmMng_stConvErr_C "#SSD Status der Wandlerkupplung, Wert im Fehlerfall" VALUE 0xD467E Kw_Wu8 15.00 OneToOne 0.00 15.00 FORMAT "%5.2" EXTENDED_LIMITS 0.00 255.0 /end CHARACTERISTIC
/begin CHARACTERISTIC FrmMng_stFDC_C "application parameter for FrmMng_stFDC value" VALUE 0xD467F Kw_Wu8 2.000 OneToOne 0.00 2.000 FORMAT "%5.3" EXTENDED_LIMITS 0.00 255.0 /end CHARACTERISTIC
/begin CHARACTERISTIC FrmMng_stGbxErr_C "Schaltung aktiv, Vorgabewert im Fehlerfall" VALUE 0xD4680 Kw_Wu8 15.00 OneToOne 0.00 15.00 FORMAT "%5.2" EXTENDED_LIMITS 0.00 255.0 /end CHARACTERISTIC
/begin CHARACTERISTIC Frmmng_stGearbxHtgUpActMsk_C "Masking value for measuring point  Frmmng_stGearbxHtgUpAct_mp" VALUE 0xD4681 Kw_Wu8 255.0 OneToOne 0.00 255.0 FORMAT "%5.1" /end CHARACTERISTIC
/begin CHARACTERISTIC Frmmng_stGearHtgUpAct_C "velocity threshold for evaluating ST_SW_WAUP signal" VALUE 0xD4682 Kw_Wu8 6.000 OneToOne 0.00 6.000 FORMAT "%5.3" EXTENDED_LIMITS 0.00 255.0 /end CHARACTERISTIC
/begin CHARACTERISTIC FrmMng_stKeyVldDef_C "Ersatzwert" VALUE 0xD4683 Kw_Wu8 255.0 OneToOne 0.00 255.0 FORMAT "%5.1" /end CHARACTERISTIC
/begin CHARACTERISTIC FrmMng_stRgnHtgUp_C "Masking for EGT_CmpSt function" VALUE 0xD4684 Kw_Wu32 2147483647.00 OneToOne 0.00 2147483647.00 FORMAT "%13.2" EXTENDED_LIMITS 0.00 4294967295.00 /end CHARACTERISTIC
/begin CHARACTERISTIC FrmMng_stT15Def_C "Intern Fehlerwert für T15" VALUE 0xD4688 Kw_Wu8 255.0 OneToOne 0.00 255.0 FORMAT "%5.1" /end CHARACTERISTIC
/begin CHARACTERISTIC FrmMng_stT50Def_C "#SSD Defektwert für FrmMng_numACFanDesDef_C Botschaft" VALUE 0xD4689 Kw_Wu8 255.0 OneToOne 0.00 255.0 FORMAT "%5.1" /end CHARACTERISTIC
/begin CHARACTERISTIC FrmMng_Sttorqavl_Errval_C "Error value for status torque actual-value" VALUE 0xD468A Kw_Wu8 10.00 OneToOne 0.00 10.00 FORMAT "%5.2" EXTENDED_LIMITS 0.00 255.0 /end CHARACTERISTIC
/begin CHARACTERISTIC FrmMng_stTRadioDef_C "defekt value for FrmMng_stTRadio" VALUE 0xD468B Kw_Wu8 255.0 OneToOne 0.00 255.0 FORMAT "%5.1" /end CHARACTERISTIC
/begin CHARACTERISTIC FrmMng_stWghSeatDrDef_C "Ersatzwert" VALUE 0xD468C Kw_Wu8 255.0 OneToOne 0.00 255.0 FORMAT "%5.1" /end CHARACTERISTIC
/begin CHARACTERISTIC FrmMng_swtANFRAGE_C "Schalter, um die Verarbeitung der Message zu deaktivieren (1: aktiviert, 0: deaktiviert)" VALUE 0xD468D Kw_Wu8 1.000 OneToOne 0.00 1.000 FORMAT "%5.3" EXTENDED_LIMITS 0.00 255.0 /end CHARACTERISTIC
/begin CHARACTERISTIC FrmMng_swtASDdc_C "Schalter um die ASDdc message zu deaktivieren (1...enabled, 0...disabled)" VALUE 0xD468E Kw_Wu8 1.000 OneToOne 0.00 1.000 FORMAT "%5.3" EXTENDED_LIMITS 0.00 255.0 /end CHARACTERISTIC
/begin CHARACTERISTIC FrmMng_swtBOS_Oil_2_C "Aktivieren der CAN-Botschaft BOS Meldung Oil 2 (1...aktiev, 0...inaktiev)" VALUE 0xD468F Kw_Wu8 1.000 OneToOne 0.00 1.000 FORMAT "%5.3" EXTENDED_LIMITS 0.00 255.0 /end CHARACTERISTIC
/begin CHARACTERISTIC FrmMng_swtBOS_Oil_C "Schalter zum deaktivieren der Message (0: aktiev, 1: inaktiev)" VALUE 0xD4690 Kw_Wu8 1.000 OneToOne 0.00 1.000 FORMAT "%5.3" EXTENDED_LIMITS 0.00 255.0 /end CHARACTERISTIC
/begin CHARACTERISTIC FrmMng_swtBOS_PFlt_C "Schalter, um die Message BOS_MELDUNG_PFLT zu aktivieren (1...enabled,. 0...disabled)" VALUE 0xD4691 Kw_Wu8 1.000 OneToOne 0.00 1.000 FORMAT "%5.3" EXTENDED_LIMITS 0.00 255.0 /end CHARACTERISTIC
/begin CHARACTERISTIC FrmMng_swtBOS_RESET_2_C "Schalter zum deaktivieren der Auswertung der Message (1: aktiev, 0: inaktiev)" VALUE 0xD4692 Kw_Wu8 1.000 OneToOne 0.00 1.000 FORMAT "%5.3" EXTENDED_LIMITS 0.00 255.0 /end CHARACTERISTIC
/begin CHARACTERISTIC FrmMng_swtBOS_RESET_C "Schalter zum deaktivieren der auswertung von BOS_RESET (1: aktiev, 0: deaktiev)" VALUE 0xD4693 Kw_Wu8 1.000 OneToOne 0.00 1.000 FORMAT "%5.3" EXTENDED_LIMITS 0.00 255.0 /end CHARACTERISTIC
/begin CHARACTERISTIC FrmMng_swtCalcV_C "Radgeschwindigkeiten zur Mitelwertsbildung herangezogen (0...nicht, 1...herangezogen)  Bit0: LV, Bit1: RV, Bit2: LH, Bit3: RH" VALUE 0xD4694 Kw_Wu8 15.00 OneToOne 0.00 15.00 FORMAT "%5.2" EXTENDED_LIMITS 0.00 255.0 /end CHARACTERISTIC
/begin CHARACTERISTIC FrmMng_swtCarType_C "Schaltet CAN zwischen 0: E60, 1: E65 und 2: E90" VALUE 0xD4695 Kw_Wu8 2.00000000000 CarType 0.00 2.00000000000 FORMAT "%13.11" /end CHARACTERISTIC
/begin CHARACTERISTIC FrmMng_swtCCMsg_C "Unterdrücken aller Checkcontrol Meldungen (0=AUS, 1...EIN)" VALUE 0xD4696 Kw_Wu8 1.000 OneToOne 0.00 1.000 FORMAT "%5.3" EXTENDED_LIMITS 0.00 255.0 /end CHARACTERISTIC
/begin CHARACTERISTIC FrmMng_swtCCNoCrCtl_C "Setzten/Löschen der Checkcontrol Meldung Geschwindigkeitsregelung ohne Funktion (1...setzen,. 0...löschen)" VALUE 0xD4697 Kw_Wu8 1.000 OneToOne 0.00 1.000 FORMAT "%5.3" EXTENDED_LIMITS 0.00 255.0 /end CHARACTERISTIC
/begin CHARACTERISTIC FrmMng_swtCorTrqACC_C "Schalter zur Korrektur von FrmMng_trqACC_TrqDes mit Gearbx_trqFrc (1...Korrektur, 0...keine Korrektur)" VALUE 0xD4698 Kw_Wu8 1.000 OneToOne 0.00 1.000 FORMAT "%5.3" EXTENDED_LIMITS 0.00 255.0 /end CHARACTERISTIC
/begin CHARACTERISTIC FrmMng_swtCorTrqDSC_C "Schalter zur Korrektur des DSC-Moment durch Gearbx_trqFrc (1...Korrektur, 0...keine Korrektur)" VALUE 0xD4699 Kw_Wu8 1.000 OneToOne 0.00 1.000 FORMAT "%5.3" EXTENDED_LIMITS 0.00 255.0 /end CHARACTERISTIC
/begin CHARACTERISTIC FrmMng_swtDMOMENT_ACC_C "#SSD Schalter zum deaktivieren der Message DREHMOMENT_ANF_ACC (1...enabled, 0...disabled)" VALUE 0xD469A Kw_Wu8 1.000 OneToOne 0.00 1.000 FORMAT "%5.3" EXTENDED_LIMITS 0.00 255.0 /end CHARACTERISTIC
/begin CHARACTERISTIC FrmMng_swtDM_ANF_AFS_C "Schalter zum aktivieren der Message DREHMOMENT_ANF_AFS (1...enabled, 0...disabled)" VALUE 0xD469B Kw_Wu8 1.000 OneToOne 0.00 1.000 FORMAT "%5.3" EXTENDED_LIMITS 0.00 255.0 /end CHARACTERISTIC
/begin CHARACTERISTIC FrmMng_swtDRMANFSSG_C "#SSD SChalter zum aktivieren der Message DREHMOMENT_ANF_SSG  (1...enabled, 0...disabled)" VALUE 0xD469C Kw_Wu8 1.000 OneToOne 0.00 1.000 FORMAT "%5.3" EXTENDED_LIMITS 0.00 255.0 /end CHARACTERISTIC
/begin CHARACTERISTIC FrmMng_swtELKTR_M_OEL_MESS_C "" VALUE 0xD469D Kw_Wu8 1.000 OneToOne 0.00 1.000 FORMAT "%5.3" EXTENDED_LIMITS 0.00 255.0 /end CHARACTERISTIC
/begin CHARACTERISTIC FrmMng_swtENGINE1_C "Schalter zur Abschaltung der Berechnung von ENGINE1 (1...enabled, 0...disabled)" VALUE 0xD469E Kw_Wu8 1.000 OneToOne 0.00 1.000 FORMAT "%5.3" EXTENDED_LIMITS 0.00 255.0 /end CHARACTERISTIC
/begin CHARACTERISTIC FrmMng_swtENGINE_RPM_C "Aktivierung Botschaft ENGINE_RPM (1...enabled, 0...disableb)" VALUE 0xD469F Kw_Wu8 1.000 OneToOne 0.00 1.000 FORMAT "%5.3" EXTENDED_LIMITS 0.00 255.0 /end CHARACTERISTIC
/begin CHARACTERISTIC FrmMng_swtEngRpmTempSel_C "Schalter, um die Kuehler- oder die Motor Oel Temperatur auszuwaehlen (1...oel, 0...Kuehler)" VALUE 0xD46A0 Kw_Wu8 1.000 OneToOne 0.00 1.000 FORMAT "%5.3" EXTENDED_LIMITS 0.00 255.0 /end CHARACTERISTIC
/begin CHARACTERISTIC FrmMng_swtFDC_C "Schalter, um den FrmMng_stFDC- Wert auszuwählen (1...Applikationswert, 0...lokaler Wert)" VALUE 0xD46A1 Kw_Wu8 1.000 OneToOne 0.00 1.000 FORMAT "%5.3" EXTENDED_LIMITS 0.00 255.0 /end CHARACTERISTIC
/begin CHARACTERISTIC FrmMng_swtGEARBX_DATA2_C "Schalter, um die Message GEARBX_DATA2 zu aktivieren (1...enabled,. 0...disabled)" VALUE 0xD46A2 Kw_Wu8 1.000 OneToOne 0.00 1.000 FORMAT "%5.3" EXTENDED_LIMITS 0.00 255.0 /end CHARACTERISTIC
/begin CHARACTERISTIC FrmMng_swtGEARBX_DATA_C "Schalter um die Message  GEARBX_DATA zu aktivieren (1...enabled,. 0...disabled)" VALUE 0xD46A3 Kw_Wu8 1.000 OneToOne 0.00 1.000 FORMAT "%5.3" EXTENDED_LIMITS 0.00 255.0 /end CHARACTERISTIC
/begin CHARACTERISTIC FrmMng_swtHEATINGCURRENT_C "Aktivierung und deaktivierung der Message HEATING_CURRENT (1...enabled,. 0...disabled)" VALUE 0xD46A4 Kw_Wu8 1.000 OneToOne 0.00 1.000 FORMAT "%5.3" EXTENDED_LIMITS 0.00 255.0 /end CHARACTERISTIC
/begin CHARACTERISTIC FrmMng_swtHEAT_AC_C "Schalter, um die Message HEAT_AC zu aktivieren (1...enabled,. 0...disabled)" VALUE 0xD46A5 Kw_Wu8 1.000 OneToOne 0.00 1.000 FORMAT "%5.3" EXTENDED_LIMITS 0.00 255.0 /end CHARACTERISTIC
/begin CHARACTERISTIC FrmMng_swtLENKRADWINKEL_C "Schalter, um die Message LENKRADWINKEL zu aktivieren (1...enabled,. 0...disabled)" VALUE 0xD46A6 Kw_Wu8 1.000 OneToOne 0.00 1.000 FORMAT "%5.3" EXTENDED_LIMITS 0.00 255.0 /end CHARACTERISTIC
/begin CHARACTERISTIC FrmMng_swtMILEAGE_RANGE_C "Schalter, um die Message MILEAGE_RANGE zu aktivieren (1...enabled,. 0...disabled)" VALUE 0xD46A7 Kw_Wu8 1.000 OneToOne 0.00 1.000 FORMAT "%5.3" EXTENDED_LIMITS 0.00 255.0 /end CHARACTERISTIC
/begin CHARACTERISTIC FrmMng_swtOPCRCTLACC_C "Schalter, um die Message OP_CRCTLACC zu aktivieren (1...enabled,. 0...disabled)" VALUE 0xD46A8 Kw_Wu8 1.000 OneToOne 0.00 1.000 FORMAT "%5.3" EXTENDED_LIMITS 0.00 255.0 /end CHARACTERISTIC
/begin CHARACTERISTIC FrmMng_swtParkConsumer_C "Schalter, um die Message PWRMNG_STANDVBR zu aktivieren (1...enabled,. 0...disabled)" VALUE 0xD46A9 Kw_Wu8 1.000 OneToOne 0.00 1.000 FORMAT "%5.3" EXTENDED_LIMITS 0.00 255.0 /end CHARACTERISTIC
/begin CHARACTERISTIC FrmMng_swtPlausOn_C "Schalter, um die Momenteneingriffsmessage zu aktivieren (1...enabled,. 0...disabled)" VALUE 0xD46AA Kw_Wu8 1.000 OneToOne 0.00 1.000 FORMAT "%5.3" EXTENDED_LIMITS 0.00 255.0 /end CHARACTERISTIC
/begin CHARACTERISTIC FrmMng_swtPOWERMGMTBATTSP_C "Schalter, um die Message POWERMGMT_BATTERIESPANNUNG zu aktivieren (1...enabled,. 0...disabled)" VALUE 0xD46AB Kw_Wu8 1.000 OneToOne 0.00 1.000 FORMAT "%5.3" EXTENDED_LIMITS 0.00 255.0 /end CHARACTERISTIC
/begin CHARACTERISTIC FrmMng_swtPRGG_CCTR_C "Schalter, um die Message PRGG_CCTR zu aktivieren (1...enabled,. 0...disabled)" VALUE 0xD46AC Kw_Wu8 1.000 OneToOne 0.00 1.000 FORMAT "%5.3" EXTENDED_LIMITS 0.00 255.0 /end CHARACTERISTIC
/begin CHARACTERISTIC FrmMng_swtPSPOffErr_C "Schalter, um die Message CTR_CR_SWO_EKP zu aktivieren (1...enabled,. 0...disabled)" VALUE 0xD46AD Kw_Wu8 255.0 OneToOne 0.00 255.0 FORMAT "%5.1" /end CHARACTERISTIC
/begin CHARACTERISTIC FrmMng_swtPSPOff_C "Schalter, um die Message CTR_CRASH_SWO_EKP zu aktivieren (1...enabled,. 0...disabled)" VALUE 0xD46AE Kw_Wu8 1.000 OneToOne 0.00 1.000 FORMAT "%5.3" EXTENDED_LIMITS 0.00 255.0 /end CHARACTERISTIC
/begin CHARACTERISTIC FrmMng_swtPWRMNG_CTR_COS_C "Schalter, um die Message PWRMNG_CTR_COS zu aktivieren (1...enabled,. 0...disabled)" VALUE 0xD46AF Kw_Wu8 1.000 OneToOne 0.00 1.000 FORMAT "%5.3" EXTENDED_LIMITS 0.00 255.0 /end CHARACTERISTIC
/begin CHARACTERISTIC FrmMng_swtPWRMNG_LOADV_C "Schalter, um die Message PWRMNG_LOADV zu aktivieren (1...enabled,. 0...disabled)" VALUE 0xD46B0 Kw_Wu8 1.000 OneToOne 0.00 1.000 FORMAT "%5.3" EXTENDED_LIMITS 0.00 255.0 /end CHARACTERISTIC
/begin CHARACTERISTIC FrmMng_swtRPM_STA_C "Schalter, um die Message RPM_STA zu aktivieren (1...enabled,. 0...disabled)" VALUE 0xD46B1 Kw_Wu8 1.000 OneToOne 0.00 1.000 FORMAT "%5.3" EXTENDED_LIMITS 0.00 255.0 /end CHARACTERISTIC
/begin CHARACTERISTIC FrmMng_swtRQ_STG_EFAN_C "Schalter, um die Message PRQ_STG_EFAN zu aktivieren (1...enabled,. 0...disabled)" VALUE 0xD46B2 Kw_Wu8 1.000 OneToOne 0.00 1.000 FORMAT "%5.3" EXTENDED_LIMITS 0.00 255.0 /end CHARACTERISTIC
/begin CHARACTERISTIC FrmMng_swtSITZGURT_C "Schalter, um die Message STAT_SITZBELEGUNG_GURT zu aktivieren (1...enabled,. 0...disabled)" VALUE 0xD46B3 Kw_Wu8 1.000 OneToOne 0.00 1.000 FORMAT "%5.3" EXTENDED_LIMITS 0.00 255.0 /end CHARACTERISTIC
/begin CHARACTERISTIC FrmMng_swtSPEED_CLCTR_C "Schalter, um die cruise control Message zu aktivieren (1...enabled,. 0...disabled)" VALUE 0xD46B4 Kw_Wu8 1.000 OneToOne 0.00 1.000 FORMAT "%5.3" EXTENDED_LIMITS 0.00 255.0 /end CHARACTERISTIC
/begin CHARACTERISTIC FrmMng_swtSTAT_ANH_C "Schalter, um die Message STAT_ANH zu aktivieren (1...enabled,. 0...disabled)" VALUE 0xD46B5 Kw_Wu8 1.000 OneToOne 0.00 1.000 FORMAT "%5.3" EXTENDED_LIMITS 0.00 255.0 /end CHARACTERISTIC
/begin CHARACTERISTIC FrmMng_swtSTAT_ARS_C "Schalter, um die Message STAT_ARS zu aktivieren (1...enabled,. 0...disabled)" VALUE 0xD46B6 Kw_Wu8 1.000 OneToOne 0.00 1.000 FORMAT "%5.3" EXTENDED_LIMITS 0.00 255.0 /end CHARACTERISTIC
/begin CHARACTERISTIC FrmMng_swtSTAT_DSC_C "Schalter, um die Message STAT_DSC zu aktivieren (1...enabled,. 0...disabled)" VALUE 0xD46B7 Kw_Wu8 1.000 OneToOne 0.00 1.000 FORMAT "%5.3" EXTENDED_LIMITS 0.00 255.0 /end CHARACTERISTIC
/begin CHARACTERISTIC FrmMng_swtSTAT_EKP_C "Schalter, um die Message STAT_EKP zu aktivieren (1...enabled,. 0...disabled)" VALUE 0xD46B8 Kw_Wu8 1.000 OneToOne 0.00 1.000 FORMAT "%5.3" EXTENDED_LIMITS 0.00 255.0 /end CHARACTERISTIC
/begin CHARACTERISTIC FrmMng_swtSTAT_KOMBI_C "Schalter, um die Message STAT_KOMBI zu aktivieren (1...enabled,. 0...disabled)" VALUE 0xD46B9 Kw_Wu8 1.000 OneToOne 0.00 1.000 FORMAT "%5.3" EXTENDED_LIMITS 0.00 255.0 /end CHARACTERISTIC
/begin CHARACTERISTIC FrmMng_swtstCurr_C "Schalter, um die Message CODIERUNG_PM zu aktivieren (1...enabled,. 0...disabled)" VALUE 0xD46BA Kw_Wu8 1.000 OneToOne 0.00 1.000 FORMAT "%5.3" EXTENDED_LIMITS 0.00 255.0 /end CHARACTERISTIC
/begin CHARACTERISTIC FrmMng_swtTEMPRELTIME_C "Schalter, um die Message A_TEMP_RELATIVZEIT zu aktivieren (1...enabled,. 0...disabled)" VALUE 0xD46BB Kw_Wu8 1.000 OneToOne 0.00 1.000 FORMAT "%5.3" EXTENDED_LIMITS 0.00 255.0 /end CHARACTERISTIC
/begin CHARACTERISTIC FrmMng_swtTERMINAL_C "Schalter, um die Message TERMINAL zu aktivieren (1...enabled,. 0...disabled)" VALUE 0xD46BC Kw_Wu8 1.000 OneToOne 0.00 1.000 FORMAT "%5.3" EXTENDED_LIMITS 0.00 255.0 /end CHARACTERISTIC
/begin CHARACTERISTIC FrmMng_swtTIME_DATE_C "Schalter, um die Message TIME_DATE zu aktivieren (1...enabled,. 0...disabled)" VALUE 0xD46BD Kw_Wu8 1.000 OneToOne 0.00 1.000 FORMAT "%5.3" EXTENDED_LIMITS 0.00 255.0 /end CHARACTERISTIC
/begin CHARACTERISTIC FrmMng_swtTORQUE1_C "Schalter, um die Message TORQUE1 zu aktivieren (1...enabled,. 0...disabled)" VALUE 0xD46BE Kw_Wu8 1.000 OneToOne 0.00 1.000 FORMAT "%5.3" EXTENDED_LIMITS 0.00 255.0 /end CHARACTERISTIC
/begin CHARACTERISTIC FrmMng_swtTORQUE2_C "Schalter, um die Message TORQUE2 zu aktivieren (1...enabled,. 0...disabled)" VALUE 0xD46BF Kw_Wu8 1.000 OneToOne 0.00 1.000 FORMAT "%5.3" EXTENDED_LIMITS 0.00 255.0 /end CHARACTERISTIC
/begin CHARACTERISTIC FrmMng_swtTORQUE3_C "Schalter, um die Message TORQUE3 zu aktivieren (1...enabled,. 0...disabled)" VALUE 0xD46C0 Kw_Wu8 1.000 OneToOne 0.00 1.000 FORMAT "%5.3" EXTENDED_LIMITS 0.00 255.0 /end CHARACTERISTIC
/begin CHARACTERISTIC FrmMng_swtTORQUE_DSC_C "Schalter, um die Message TORQUE_DSC zu aktivieren (1...enabled,. 0...disabled)" VALUE 0xD46C1 Kw_Wu8 1.000 OneToOne 0.00 1.000 FORMAT "%5.3" EXTENDED_LIMITS 0.00 255.0 /end CHARACTERISTIC
/begin CHARACTERISTIC FrmMng_swtTORQUE_GEARBX_C "Schalter, um die Message TORQUE_GEARBX zu aktivieren (1...enabled,. 0...disabled)" VALUE 0xD46C2 Kw_Wu8 1.000 OneToOne 0.00 1.000 FORMAT "%5.3" EXTENDED_LIMITS 0.00 255.0 /end CHARACTERISTIC
/begin CHARACTERISTIC FrmMng_swtVEH_MOD_C "Schalter, um die Message VEH_MOD zu aktivieren (1...enabled,. 0...disabled)" VALUE 0xD46C3 Kw_Wu8 1.000 OneToOne 0.00 1.000 FORMAT "%5.3" EXTENDED_LIMITS 0.00 255.0 /end CHARACTERISTIC
/begin CHARACTERISTIC FrmMng_swtVELOCITY_C "Schalter, um die Message VELOCITY zu aktivieren (1...enabled,. 0...disabled)" VALUE 0xD46C4 Kw_Wu8 1.000 OneToOne 0.00 1.000 FORMAT "%5.3" EXTENDED_LIMITS 0.00 255.0 /end CHARACTERISTIC
/begin CHARACTERISTIC FrmMng_swtWHEEL_SPEED_C "Schalter, um die Wheel Speed Message zu aktivieren (1...enabled,. 0...disabled)" VALUE 0xD46C5 Kw_Wu8 1.000 OneToOne 0.00 1.000 FORMAT "%5.3" EXTENDED_LIMITS 0.00 255.0 /end CHARACTERISTIC
/begin CHARACTERISTIC FrmMng_cnvTEMP_EX_Offset_C "#SSD Offset to calculate TEMP_EX from CAN" VALUE 0xD46C6 Kw_Ws16 65535.00 OneToOne -32768.00 32767.00 FORMAT "%8.2" /end CHARACTERISTIC
/begin CHARACTERISTIC FrmMng_cnvTEMP_EX_Slope_C "#SSD Slope to calculate TEMP_EX from CAN" VALUE 0xD46C8 Kw_Ws16 655.3500 SlopeRes100 -327.6800 327.6700 FORMAT "%8.4" /end CHARACTERISTIC
/begin CHARACTERISTIC FrmMng_tEngLimHi_C "obere Temperaturschwelle für Motortemperatur" VALUE 0xD46CA Kw_Ws16 250.0000 Temp_Cels -50.14000 199.8600 FORMAT "%8.4" EXTENDED_LIMITS -3549.940 3003.560 /end CHARACTERISTIC
/begin CHARACTERISTIC FrmMng_tEngLimLo_C "Untere Temperaturschwelle für Motortemperatur" VALUE 0xD46CC Kw_Ws16 250.0000 Temp_Cels -50.14000 199.8600 FORMAT "%8.4" EXTENDED_LIMITS -3549.940 3003.560 /end CHARACTERISTIC
/begin CHARACTERISTIC FrmMng_tEnvDef_C "Defektwert für FrmMng_tEnvDef_C Botschaft" VALUE 0xD46CE Kw_Ws16 950.000 Temp_Cels -50.140 899.860 FORMAT "%8.3" EXTENDED_LIMITS -3549.940 3003.560 /end CHARACTERISTIC
/begin CHARACTERISTIC FrmMng_tiCCAddLevlCycle_C "#SSD Transmit cycle time in s for Checkcontroll message 11" VALUE 0xD46D0 Kw_Wu8 13.00 Time_fulls 1.000 14.00 FORMAT "%5.2" EXTENDED_LIMITS 0.00 255.0 /end CHARACTERISTIC
/begin CHARACTERISTIC FrmMng_tiCCBrkDefCycle_C "Sendeart CC-Meldung Bremslichtschalter defekt" VALUE 0xD46D1 Kw_Wu8 13.00 Time_fulls 1.000 14.00 FORMAT "%5.2" EXTENDED_LIMITS 0.00 255.0 /end CHARACTERISTIC
/begin CHARACTERISTIC FrmMng_tiCCbtnachCycle_C "#SSD Transmit cycle time in s for Checkcontroll message 17" VALUE 0xD46D2 Kw_Wu8 13.00 Time_fulls 1.000 14.00 FORMAT "%5.2" EXTENDED_LIMITS 0.00 255.0 /end CHARACTERISTIC
/begin CHARACTERISTIC FrmMng_tiCCbttdfkCycle_C "#SSD Transmit cycle time in s for Checkcontroll message 19" VALUE 0xD46D3 Kw_Wu8 13.00 Time_fulls 1.000 14.00 FORMAT "%5.2" EXTENDED_LIMITS 0.00 255.0 /end CHARACTERISTIC
/begin CHARACTERISTIC FrmMng_tiCCbttkntCycle_C "#SSD Transmit cycle time in s for Checkcontroll message 20" VALUE 0xD46D4 Kw_Wu8 13.00 Time_fulls 1.000 14.00 FORMAT "%5.2" EXTENDED_LIMITS 0.00 255.0 /end CHARACTERISTIC
/begin CHARACTERISTIC FrmMng_tiCCGenDef2Cycle_C "#SSD Transmit cycle time in s for Checkcontroll message 14" VALUE 0xD46D5 Kw_Wu8 13.00 Time_fulls 1.000 14.00 FORMAT "%5.2" EXTENDED_LIMITS 0.00 255.0 /end CHARACTERISTIC
/begin CHARACTERISTIC FrmMng_tiCCNoCrCtlCycle_C "#SSD Sendeart der Checkcontrol Meldung Geschwindigkeitsregelung ohne Funktion" VALUE 0xD46D6 Kw_Wu8 13.00 Time_fulls 1.000 14.00 FORMAT "%5.2" EXTENDED_LIMITS 0.00 255.0 /end CHARACTERISTIC
/begin CHARACTERISTIC FrmMng_tiCCOelLevlCycle_C "#SSD Transmit cycle time in s for Checkcontroll message 10" VALUE 0xD46D7 Kw_Wu8 13.00 Time_fulls 1.000 14.00 FORMAT "%5.2" EXTENDED_LIMITS 0.00 255.0 /end CHARACTERISTIC
/begin CHARACTERISTIC FrmMng_tiCCOelVerbCycle_C "#SSD Transmit cycle time in s for Checkcontroll message 8" VALUE 0xD46D8 Kw_Wu8 13.00 Time_fulls 1.000 14.00 FORMAT "%5.2" EXTENDED_LIMITS 0.00 255.0 /end CHARACTERISTIC
/begin CHARACTERISTIC FrmMng_tiCCOelVerlCycle_C "#SSD Transmit cycle time in s for Checkcontroll message 9" VALUE 0xD46D9 Kw_Wu8 13.00 Time_fulls 1.000 14.00 FORMAT "%5.2" EXTENDED_LIMITS 0.00 255.0 /end CHARACTERISTIC
/begin CHARACTERISTIC FrmMng_tiCCOilPresCycle_C "#SSD Transmit cycle time in s for Checkcontroll message 4" VALUE 0xD46DA Kw_Wu8 13.00 Time_fulls 1.000 14.00 FORMAT "%5.2" EXTENDED_LIMITS 0.00 255.0 /end CHARACTERISTIC
/begin CHARACTERISTIC FrmMng_tiCCOvrTem2Cycle_C "#SSD Transmit cycle time in s for Checkcontroll message 6" VALUE 0xD46DB Kw_Wu8 13.00 Time_fulls 1.000 14.00 FORMAT "%5.2" EXTENDED_LIMITS 0.00 255.0 /end CHARACTERISTIC
/begin CHARACTERISTIC FrmMng_tiCCOvrTempCycle_C "#SSD Transmit cycle time in s for Checkcontroll message 5" VALUE 0xD46DC Kw_Wu8 13.00 Time_fulls 1.000 14.00 FORMAT "%5.2" EXTENDED_LIMITS 0.00 255.0 /end CHARACTERISTIC
/begin CHARACTERISTIC FrmMng_tiCCPFltDefCycle_C "#SSD Transmit cycle time in s for Checkcontroll message 12" VALUE 0xD46DD Kw_Wu8 13.00 Time_fulls 1.000 14.00 FORMAT "%5.2" EXTENDED_LIMITS 0.00 255.0 /end CHARACTERISTIC
/begin CHARACTERISTIC FrmMng_tiCCpmerrCycle_C "#SSD Transmit cycle time in s for Checkcontroll message 18" VALUE 0xD46DE Kw_Wu8 13.00 Time_fulls 1.000 14.00 FORMAT "%5.2" EXTENDED_LIMITS 0.00 255.0 /end CHARACTERISTIC
/begin CHARACTERISTIC FrmMng_tiCCPreGlowCycle_C "#SSD Sendeart der Checkcontrol Meldung Vorglühen" VALUE 0xD46DF Kw_Wu8 13.00 Time_fulls 1.000 14.00 FORMAT "%5.2" EXTENDED_LIMITS 0.00 255.0 /end CHARACTERISTIC
/begin CHARACTERISTIC FrmMng_tiCCprioCycle_C "#SSD Transmit cycle time in s for Checkcontroll message 21" VALUE 0xD46E0 Kw_Wu8 13.00 Time_fulls 1.000 14.00 FORMAT "%5.2" EXTENDED_LIMITS 0.00 255.0 /end CHARACTERISTIC
/begin CHARACTERISTIC FrmMng_tiCCruhverCycle_C "#SSD Transmit cycle time in s for Checkcontroll message 16" VALUE 0xD46E1 Kw_Wu8 13.00 Time_fulls 1.000 14.00 FORMAT "%5.2" EXTENDED_LIMITS 0.00 255.0 /end CHARACTERISTIC
/begin CHARACTERISTIC FrmMng_tiCCStatMilCycle_C "#SSD Transmit cycle time in s for Checkcontroll message 7" VALUE 0xD46E2 Kw_Wu8 13.00 Time_fulls 1.000 14.00 FORMAT "%5.2" EXTENDED_LIMITS 0.00 255.0 /end CHARACTERISTIC
/begin CHARACTERISTIC FrmMng_tiCCStatMilLmpTstCycle_C "#SSD Transmit cycle time in s for Checkcontroll message 34" VALUE 0xD46E3 Kw_Wu8 13.00 Time_fulls 1.000 14.00 FORMAT "%5.2" EXTENDED_LIMITS 0.00 255.0 /end CHARACTERISTIC
/begin CHARACTERISTIC FrmMng_tiCCSysLampCycle_C "#SSD Sendeart der Checkcontrol Meldung Motornotprogramm" VALUE 0xD46E4 Kw_Wu8 13.00 Time_fulls 1.000 14.00 FORMAT "%5.2" EXTENDED_LIMITS 0.00 255.0 /end CHARACTERISTIC
/begin CHARACTERISTIC FrmMng_tiCCTxDeb_C "#SSD Mindestentprelldauer zwischen zwei aufeinanderfolgende Checkcontrol Meldungen" VALUE 0xD46E6 Kw_Wu16 1000.000 Time_ms 0.00 1000.000 FORMAT "%8.3" EXTENDED_LIMITS 0.00 655350.0 /end CHARACTERISTIC
/begin CHARACTERISTIC FrmMng_tiDebARS_C "Delay time for debouncing ASCquit" VALUE 0xD46E8 Kw_Wu16 655350.0 Time_ms 0.00 655350.0 FORMAT "%8.1" /end CHARACTERISTIC
/begin CHARACTERISTIC FrmMng_tiDebDSC_C "Delay time for debouncing ASCquit" VALUE 0xD46EA Kw_Wu16 655350.0 Time_ms 0.00 655350.0 FORMAT "%8.1" /end CHARACTERISTIC
/begin CHARACTERISTIC FrmMng_tiDebEGS_C "Delay time for debouncing ASCquit" VALUE 0xD46EC Kw_Wu16 655350.0 Time_ms 0.00 655350.0 FORMAT "%8.1" /end CHARACTERISTIC
/begin CHARACTERISTIC FrmMng_tiDebHtgUpShutOff_C "Zeit Debounce für Heizungsabsperrvorrichtung" VALUE 0xD46EE Kw_Wu16 655350.0 Time_ms 0.00 655350.0 FORMAT "%8.1" /end CHARACTERISTIC
/begin CHARACTERISTIC FrmMng_tiDebHtgUpShutOn_C "Zeit Debounce für Heizungsabsperrvorrichtung" VALUE 0xD46F0 Kw_Wu16 655350.0 Time_ms 0.00 655350.0 FORMAT "%8.1" /end CHARACTERISTIC
/begin CHARACTERISTIC FrmMng_tiDebSSGDebCltTO_C "Time duration for transmit debouncing" VALUE 0xD46F2 Kw_Wu16 1000.000 Time_ms 0.00 1000.000 FORMAT "%8.3" EXTENDED_LIMITS 0.00 655350.0 /end CHARACTERISTIC
/begin CHARACTERISTIC FrmMng_tiDebSSGErrDef_C "defect time for SSG signals plausibility error" VALUE 0xD46F4 Kw_Wu16 655350.0 Time_ms 0.00 655350.0 FORMAT "%8.1" /end CHARACTERISTIC
/begin CHARACTERISTIC FrmMng_tiDebSSGErrOk_C "Healing time for SSG signals plausibility error" VALUE 0xD46F6 Kw_Wu16 655350.0 Time_ms 0.00 655350.0 FORMAT "%8.1" /end CHARACTERISTIC
/begin CHARACTERISTIC FrmMng_tiDebSSGShftPla_C "Time duration for transmit debouncing" VALUE 0xD46F8 Kw_Wu16 1000.000 Time_ms 0.00 1000.000 FORMAT "%8.3" EXTENDED_LIMITS 0.00 655350.0 /end CHARACTERISTIC
/begin CHARACTERISTIC FrmMng_tiDebSSGShOffDef_C "Defect time for SSG signals plausibility error" VALUE 0xD46FA Kw_Wu16 655350.0 Time_ms 0.00 655350.0 FORMAT "%8.1" /end CHARACTERISTIC
/begin CHARACTERISTIC FrmMng_tiDebSSGShOffOk_C "Healing time for SSG signals plausibility error" VALUE 0xD46FC Kw_Wu16 655350.0 Time_ms 0.00 655350.0 FORMAT "%8.1" /end CHARACTERISTIC
/begin CHARACTERISTIC FrmMng_tiDebSSGTrqIncPla_C "Time duration for transmit debouncing" VALUE 0xD46FE Kw_Wu16 1000.000 Time_ms 0.00 1000.000 FORMAT "%8.3" EXTENDED_LIMITS 0.00 655350.0 /end CHARACTERISTIC
/begin CHARACTERISTIC FrmMng_tiRecACCMax_C "Time 10 ms quantum" VALUE 0xD4700 Kw_Wu16 9980.000 Time_ms 20.00000 10000.00 FORMAT "%8.2" EXTENDED_LIMITS 0.00 655350.0 /end CHARACTERISTIC
/begin CHARACTERISTIC FrmMng_tiRecACMax_C "" VALUE 0xD4702 Kw_Wu16 9980.000 Time_ms 20.00000 10000.00 FORMAT "%8.2" EXTENDED_LIMITS 0.00 655350.0 /end CHARACTERISTIC
/begin CHARACTERISTIC FrmMng_tiRecAFSMax_C "Time 10 ms quantum" VALUE 0xD4704 Kw_Wu16 9980.000 Time_ms 20.00000 10000.00 FORMAT "%8.2" EXTENDED_LIMITS 0.00 655350.0 /end CHARACTERISTIC
/begin CHARACTERISTIC FrmMng_tiRecARSMax_C "Time 10 ms quantum - ARS" VALUE 0xD4706 Kw_Wu16 9980.000 Time_ms 20.00000 10000.00 FORMAT "%8.2" EXTENDED_LIMITS 0.00 655350.0 /end CHARACTERISTIC
/begin CHARACTERISTIC FrmMng_tiRecFDCMax_C "Zeitfenster für Erkennug Empfang Fahrzeugmodus Botschaft" VALUE 0xD4708 Kw_Wu16 9980.000 Time_ms 20.00000 10000.00 FORMAT "%8.2" EXTENDED_LIMITS 0.00 655350.0 /end CHARACTERISTIC
/begin CHARACTERISTIC FrmMng_tiRecFGRMax_C "Maximum time for FGR recognition" VALUE 0xD470A Kw_Wu16 9980.000 Time_ms 20.00000 10000.00 FORMAT "%8.2" EXTENDED_LIMITS 0.00 655350.0 /end CHARACTERISTIC
/begin CHARACTERISTIC FrmMng_tiStartDelay_C "Verzögerungszeit des Start Systems" VALUE 0xD470C Kw_Wu16 655350.0 Time_ms 0.00 655350.0 FORMAT "%8.1" /end CHARACTERISTIC
/begin CHARACTERISTIC FrmMng_trqARSCurDef_C "Error value for FrmMng_trqARSCur" VALUE 0xD470E Kw_Ws16 11000.00 TrqPrp -5000.000 6000.000 FORMAT "%8.3" EXTENDED_LIMITS -6553.600 6553.400 /end CHARACTERISTIC
/begin CHARACTERISTIC FrmMng_trqARSDesDef_C "applicationvalue for desired torque ARS in case of message error" VALUE 0xD4710 Kw_Ws16 11000.00 TrqPrp -5000.000 6000.000 FORMAT "%8.3" EXTENDED_LIMITS -6553.600 6553.400 /end CHARACTERISTIC
/begin CHARACTERISTIC FrmMng_trqGearbxFrc_C "" VALUE 0xD4712 Kw_Ws16 1500.000 Trq -500.0000 1000.000 FORMAT "%8.3" EXTENDED_LIMITS -3276.800 3276.700 /end CHARACTERISTIC
/begin CHARACTERISTIC FrmMng_trqGearbxMaxSubs_C "#SSD Ersatzwert für maximales Getriebemoment im heat modus bei ausgefallenen CAN" VALUE 0xD4714 Kw_Ws16 1500.000 Trq -500.0000 1000.000 FORMAT "%8.3" EXTENDED_LIMITS -3276.800 3276.700 /end CHARACTERISTIC
/begin CHARACTERISTIC FrmMng_trqLiGovMin_C "tarque switch for evaluating ST_SW_WAUP signal" VALUE 0xD4716 Kw_Ws16 1500.000 Trq -500.0000 1000.000 FORMAT "%8.3" EXTENDED_LIMITS -3276.800 3276.700 /end CHARACTERISTIC
/begin CHARACTERISTIC FrmMng_trqSSGPlaThres_C "torque threhold" VALUE 0xD4718 Kw_Ws16 1500.000 Trq -500.0000 1000.000 FORMAT "%8.3" EXTENDED_LIMITS -3276.800 3276.700 /end CHARACTERISTIC
/begin CHARACTERISTIC FrmMng_tWaterVlv_C "" VALUE 0xD471A Kw_Ws16 950.0000 Temp_Cels -50.1400 899.8600 FORMAT "%8.4" EXTENDED_LIMITS -3549.940 3003.560 /end CHARACTERISTIC
/begin CHARACTERISTIC FrmMng_ubtMin_C "minimale Batteriespannungsänderung um POWERMGMT_BATTERIESPANNUNG zu versenden" VALUE 0xD471C Kw_Wu8 3.8250000 spg_uw_q0p015 0.00 3.8250000 FORMAT "%9.7" /end CHARACTERISTIC
/begin CHARACTERISTIC FrmMng_vHtgUpActMax_C "velocity threshold for evaluating ST_SW_WAUP signal" VALUE 0xD471E Kw_Ws16 300.0000 Vel 0.00 300.0000 FORMAT "%8.4" EXTENDED_LIMITS -327.6800 327.6700 /end CHARACTERISTIC
/begin CHARACTERISTIC FrmMng_cnvvPrgNo_Offset_C "#SSD Offset for calculation V_PRGG_CCTR_IDX_NO_X from CAN" VALUE 0xD4720 Kw_Ws16 65535.00 OneToOne -32768.00 32767.00 FORMAT "%8.2" /end CHARACTERISTIC
/begin CHARACTERISTIC FrmMng_cnvvPrgNo_Slope_C "#SSD Slope for calculation V_PRGG_CCTR_IDX_NO_X from CAN" VALUE 0xD4722 Kw_Ws16 655.3500 SlopeRes100 -327.6800 327.6700 FORMAT "%8.4" /end CHARACTERISTIC
/begin CHARACTERISTIC FrmMng_vSSGPlaThres_C "vehicle speed threhold" VALUE 0xD4724 Kw_Wu16 300.0000 Vel 0.00 300.0000 FORMAT "%8.4" EXTENDED_LIMITS 0.00 655.3500 /end CHARACTERISTIC
/begin MEASUREMENT FrmMng_ctBOS_RESETalv_mp "alive-counter BOS_RESET" UWORD OneToOne 1 100 0.00 65535.00 FORMAT "%8.2" ECU_ADDRESS 0x8FEF30 /end MEASUREMENT
/begin MEASUREMENT FrmMng_ctDM_ANF_AFSalv_mp "alive-counter DMANFAFS" UBYTE OneToOne 1 100 0.00 255.0 FORMAT "%5.1" ECU_ADDRESS 0x8FEF32 /end MEASUREMENT
/begin MEASUREMENT FrmMng_ctDRMANFSSGalv_mp "alive-counter DRMANFSSG" UBYTE OneToOne 1 100 0.00 255.0 FORMAT "%5.1" ECU_ADDRESS 0x8FEF33 /end MEASUREMENT
/begin MEASUREMENT FrmMng_ctENGINE1alv_mp "Lebenszeichen-Zähler fuer CAN-Botschaft ENGINE1" UBYTE OneToOne 1 100 0.00 255.0 FORMAT "%5.1" ECU_ADDRESS 0x8FEF34 /end MEASUREMENT
/begin MEASUREMENT FrmMng_ctOPCRCTLACCalv_mp "alive-counter OP_CRCTLACC" UBYTE OneToOne 1 100 0.00 255.0 FORMAT "%5.1" ECU_ADDRESS 0x8FEF35 /end MEASUREMENT
/begin MEASUREMENT FrmMng_ctrIdxNo "index counter for velocities" UBYTE OneToOne 1 100 0.00 255.0 FORMAT "%5.1" ECU_ADDRESS 0x7F887F /end MEASUREMENT
/begin MEASUREMENT FrmMng_ctSTAT_ARSalv_mp "STAT_ARS alivecounter" UBYTE OneToOne 1 100 0.00 255.0 FORMAT "%5.1" ECU_ADDRESS 0x8FEF36 /end MEASUREMENT
/begin MEASUREMENT FrmMng_ctTERMINALalv_mp "alive-counter TERMINAL" UBYTE OneToOne 1 100 0.00 255.0 FORMAT "%5.1" ECU_ADDRESS 0x8FEF37 /end MEASUREMENT
/begin MEASUREMENT FrmMng_ctTORQUE1alv_mp "Lebenszeichen-Zähler fuer CAN-Botschaft TORQUE1" UWORD OneToOne 1 100 0.00 65535.00 FORMAT "%8.2" ECU_ADDRESS 0x8FEF38 /end MEASUREMENT
/begin MEASUREMENT FrmMng_ctTORQUE2alv_mp "Lebenszeichen-Zähler fuer CAN-Botschaft TORQUE2" UWORD OneToOne 1 100 0.00 65535.00 FORMAT "%8.2" ECU_ADDRESS 0x8FEF3A /end MEASUREMENT
/begin MEASUREMENT FrmMng_ctTORQUE3alv_mp "Lebenszeichen-Zähler fuer CAN-Botschaft TORQUE3" UWORD OneToOne 1 100 0.00 65535.00 FORMAT "%8.2" ECU_ADDRESS 0x8FEF3C /end MEASUREMENT
/begin MEASUREMENT FrmMng_ctTORQUE_DSCalv_mp "TORQUE_DSC alivecounter" UBYTE OneToOne 1 100 0.00 255.0 FORMAT "%5.1" ECU_ADDRESS 0x8FEF3E /end MEASUREMENT
/begin MEASUREMENT FrmMng_ctTORQUE_GEARBXalv_mp "TORQUE_GEARBX alivecounter" UBYTE OneToOne 1 100 0.00 255.0 FORMAT "%5.1" ECU_ADDRESS 0x8FEF3F /end MEASUREMENT
/begin MEASUREMENT FrmMng_ctVEH_MODalv_mp "alive-counter for VEH_MOD signal" UBYTE OneToOne 1 100 0.00 255.0 FORMAT "%5.1" ECU_ADDRESS 0x8FEF40 /end MEASUREMENT
/begin MEASUREMENT FrmMng_dDM_ANF_AFScs_mp "calculated checksum DMANFAFS" UBYTE OneToOne 1 100 0.00 255.0 FORMAT "%5.1" ECU_ADDRESS 0x8FEF41 /end MEASUREMENT
/begin MEASUREMENT FrmMng_dDRMANFSSGcs_mp "checksum DRMANFSSG" UBYTE OneToOne 1 100 0.00 255.0 FORMAT "%5.1" ECU_ADDRESS 0x8FEF42 /end MEASUREMENT
/begin MEASUREMENT FrmMng_dOBDCtl_mp "Measuring Point for OBD status" UBYTE OneToOne 1 100 0.00 255.0 FORMAT "%5.1" ECU_ADDRESS 0x8FEF43 /end MEASUREMENT
/begin MEASUREMENT FrmMng_dOPCRCTLACCcs_mp "checksum OP_CRCTLACC" UBYTE OneToOne 1 100 0.00 255.0 FORMAT "%5.1" ECU_ADDRESS 0x8FEF44 /end MEASUREMENT
/begin MEASUREMENT FrmMng_dTERMINALcs_mp "checksum TERMINAL" UBYTE OneToOne 1 100 0.00 255.0 FORMAT "%5.1" ECU_ADDRESS 0x8FEF45 /end MEASUREMENT
/begin MEASUREMENT FrmMng_dTORQUE1cs_mp "Checksumme der CAN-Botschaft TORQUE1" UWORD OneToOne 1 100 0.00 65535.00 FORMAT "%8.2" ECU_ADDRESS 0x8FEF46 /end MEASUREMENT
/begin MEASUREMENT FrmMng_dTORQUE2cs_mp "Checksumme der CAN-Botschaft TORQUE2" UWORD OneToOne 1 100 0.00 65535.00 FORMAT "%8.2" ECU_ADDRESS 0x8FEF48 /end MEASUREMENT
/begin MEASUREMENT FrmMng_dTORQUE3cs_mp "Checksumme der CAN-Botschaft TORQUE3" UWORD OneToOne 1 100 0.00 65535.00 FORMAT "%8.2" ECU_ADDRESS 0x8FEF4A /end MEASUREMENT
/begin MEASUREMENT FrmMng_dTORQUE_DSCcs_mp "TORQUE_DSC checksum" UBYTE OneToOne 1 100 0.00 255.0 FORMAT "%5.1" ECU_ADDRESS 0x8FEF4C /end MEASUREMENT
/begin MEASUREMENT FrmMng_dTORQUE_GEARBXcs_mp "TORQUE_GEARBX checksum" UBYTE OneToOne 1 100 0.00 255.0 FORMAT "%5.1" ECU_ADDRESS 0x8FEF4D /end MEASUREMENT
/begin MEASUREMENT FrmMng_dVEH_MODcs_mp "checksum for VEH_MOD signal" UBYTE OneToOne 1 100 0.00 255.0 FORMAT "%5.1" ECU_ADDRESS 0x8FEF4E /end MEASUREMENT
/begin MEASUREMENT FrmMng_nPSP "Ist-Drehzahl EKP" SWORD PSP_Spd 1 100 -32768.00 32767.00 FORMAT "%8.2" ECU_ADDRESS 0x7F8CA0 /end MEASUREMENT
/begin MEASUREMENT FrmMng_numAnfrageByte0_mp "" UBYTE OneToOne 1 100 0.00 255.0 FORMAT "%5.1" ECU_ADDRESS 0x8FEF4F /end MEASUREMENT
/begin MEASUREMENT FrmMng_numAnfrageByte1_mp "" UBYTE OneToOne 1 100 0.00 255.0 FORMAT "%5.1" ECU_ADDRESS 0x8FEF50 /end MEASUREMENT
/begin MEASUREMENT FrmMng_numAnfrageByte2_mp "" UBYTE OneToOne 1 100 0.00 255.0 FORMAT "%5.1" ECU_ADDRESS 0x8FEF51 /end MEASUREMENT
/begin MEASUREMENT FrmMng_numBOS_MELDUNG2_OILbyte0_mp "" UBYTE OneToOne 1 100 0.00 255.0 FORMAT "%5.1" ECU_ADDRESS 0x8FEF52 /end MEASUREMENT
/begin MEASUREMENT FrmMng_numBOS_MELDUNG2_OILbyte1_mp "" UBYTE OneToOne 1 100 0.00 255.0 FORMAT "%5.1" ECU_ADDRESS 0x8FEF53 /end MEASUREMENT
/begin MEASUREMENT FrmMng_numBOS_MELDUNG2_OILbyte2_mp "" UBYTE OneToOne 1 100 0.00 255.0 FORMAT "%5.1" ECU_ADDRESS 0x8FEF54 /end MEASUREMENT
/begin MEASUREMENT FrmMng_numBOS_MELDUNG2_OILbyte3_mp "" UBYTE OneToOne 1 100 0.00 255.0 FORMAT "%5.1" ECU_ADDRESS 0x8FEF55 /end MEASUREMENT
/begin MEASUREMENT FrmMng_numBOS_MELDUNG2_OILbyte4_mp "" UBYTE OneToOne 1 100 0.00 255.0 FORMAT "%5.1" ECU_ADDRESS 0x8FEF56 /end MEASUREMENT
/begin MEASUREMENT FrmMng_numBOS_MELDUNG2_OILbyte5_mp "" UBYTE OneToOne 1 100 0.00 255.0 FORMAT "%5.1" ECU_ADDRESS 0x8FEF57 /end MEASUREMENT
/begin MEASUREMENT FrmMng_numBOS_MELDUNG2_OILbyte6_mp "" UBYTE OneToOne 1 100 0.00 255.0 FORMAT "%5.1" ECU_ADDRESS 0x8FEF58 /end MEASUREMENT
/begin MEASUREMENT FrmMng_numBOS_MELDUNG_OILbyte0_mp "" UBYTE OneToOne 1 100 0.00 255.0 FORMAT "%5.1" ECU_ADDRESS 0x8FEF59 /end MEASUREMENT
/begin MEASUREMENT FrmMng_numBOS_MELDUNG_OILbyte1_mp "" UBYTE OneToOne 1 100 0.00 255.0 FORMAT "%5.1" ECU_ADDRESS 0x8FEF5A /end MEASUREMENT
/begin MEASUREMENT FrmMng_numBOS_MELDUNG_OILbyte2_mp "" UBYTE OneToOne 1 100 0.00 255.0 FORMAT "%5.1" ECU_ADDRESS 0x8FEF5B /end MEASUREMENT
/begin MEASUREMENT FrmMng_numBOS_MELDUNG_OILbyte3_mp "" UBYTE OneToOne 1 100 0.00 255.0 FORMAT "%5.1" ECU_ADDRESS 0x8FEF5C /end MEASUREMENT
/begin MEASUREMENT FrmMng_numBOS_MELDUNG_OILbyte4_mp "" UBYTE OneToOne 1 100 0.00 255.0 FORMAT "%5.1" ECU_ADDRESS 0x8FEF5D /end MEASUREMENT
/begin MEASUREMENT FrmMng_numBOS_MELDUNG_OILbyte5_mp "" UBYTE OneToOne 1 100 0.00 255.0 FORMAT "%5.1" ECU_ADDRESS 0x8FEF5E /end MEASUREMENT
/begin MEASUREMENT FrmMng_numBOS_MELDUNG_OILbyte6_mp "" UBYTE OneToOne 1 100 0.00 255.0 FORMAT "%5.1" ECU_ADDRESS 0x8FEF5F /end MEASUREMENT
/begin MEASUREMENT FrmMng_numBOS_MELDUNG_OILbyte7_mp "" UBYTE OneToOne 1 100 0.00 255.0 FORMAT "%5.1" ECU_ADDRESS 0x8FEF60 /end MEASUREMENT
/begin MEASUREMENT FrmMng_numBOS_PFLTbyte0_mp "" UBYTE OneToOne 1 100 0.00 255.0 FORMAT "%5.1" ECU_ADDRESS 0x8FEF61 /end MEASUREMENT
/begin MEASUREMENT FrmMng_numBOS_PFLTbyte1_mp "" UBYTE OneToOne 1 100 0.00 255.0 FORMAT "%5.1" ECU_ADDRESS 0x8FEF62 /end MEASUREMENT
/begin MEASUREMENT FrmMng_numBOS_PFLTbyte2_mp "" UBYTE OneToOne 1 100 0.00 255.0 FORMAT "%5.1" ECU_ADDRESS 0x8FEF63 /end MEASUREMENT
/begin MEASUREMENT FrmMng_numBOS_PFLTbyte3_mp "" UBYTE OneToOne 1 100 0.00 255.0 FORMAT "%5.1" ECU_ADDRESS 0x8FEF64 /end MEASUREMENT
/begin MEASUREMENT FrmMng_numBOS_PFLTbyte4_mp "" UBYTE OneToOne 1 100 0.00 255.0 FORMAT "%5.1" ECU_ADDRESS 0x8FEF65 /end MEASUREMENT
/begin MEASUREMENT FrmMng_numBOS_PFLTbyte5_mp "" UBYTE OneToOne 1 100 0.00 255.0 FORMAT "%5.1" ECU_ADDRESS 0x8FEF66 /end MEASUREMENT
/begin MEASUREMENT FrmMng_numBOS_PFLTbyte6_mp "" UBYTE OneToOne 1 100 0.00 255.0 FORMAT "%5.1" ECU_ADDRESS 0x8FEF67 /end MEASUREMENT
/begin MEASUREMENT FrmMng_numBOS_PFLTbyte7_mp "" UBYTE OneToOne 1 100 0.00 255.0 FORMAT "%5.1" ECU_ADDRESS 0x8FEF68 /end MEASUREMENT
/begin MEASUREMENT FrmMng_numBOS_RESETbyte0_mp "BOS_RESET Byte0" UBYTE OneToOne 1 100 0.00 255.0 FORMAT "%5.1" ECU_ADDRESS 0x8FEF69 /end MEASUREMENT
/begin MEASUREMENT FrmMng_numBOS_RESETbyte1_mp "BOS_RESET Byte1" UBYTE OneToOne 1 100 0.00 255.0 FORMAT "%5.1" ECU_ADDRESS 0x8FEF6A /end MEASUREMENT
/begin MEASUREMENT FrmMng_numBOS_RESETbyte2_mp "BOS_RESET Byte2" UBYTE OneToOne 1 100 0.00 255.0 FORMAT "%5.1" ECU_ADDRESS 0x8FEF6B /end MEASUREMENT
/begin MEASUREMENT FrmMng_numBOS_RESETbyte3_mp "BOS_RESET Byte3" UBYTE OneToOne 1 100 0.00 255.0 FORMAT "%5.1" ECU_ADDRESS 0x8FEF6C /end MEASUREMENT
/begin MEASUREMENT FrmMng_numBOS_RESETbyte4_mp "BOS_RESET Byte4" UBYTE OneToOne 1 100 0.00 255.0 FORMAT "%5.1" ECU_ADDRESS 0x8FEF6D /end MEASUREMENT
/begin MEASUREMENT FrmMng_numBOS_RESETbyte5_mp "BOS_RESET Byte5" UBYTE OneToOne 1 100 0.00 255.0 FORMAT "%5.1" ECU_ADDRESS 0x8FEF6E /end MEASUREMENT
/begin MEASUREMENT FrmMng_numBOS_RESETbyte6_mp "BOS_RESET Byte6" UBYTE OneToOne 1 100 0.00 255.0 FORMAT "%5.1" ECU_ADDRESS 0x8FEF6F /end MEASUREMENT
/begin MEASUREMENT FrmMng_numBOS_RESETbyte7_mp "BOS_RESET Byte7" UBYTE OneToOne 1 100 0.00 255.0 FORMAT "%5.1" ECU_ADDRESS 0x8FEF70 /end MEASUREMENT
/begin MEASUREMENT FrmMng_numBOS_RESET_2byte0_mp "" UBYTE OneToOne 1 100 0.00 255.0 FORMAT "%5.1" ECU_ADDRESS 0x8FEF71 /end MEASUREMENT
/begin MEASUREMENT FrmMng_numBOS_RESET_2byte1_mp "" UBYTE OneToOne 1 100 0.00 255.0 FORMAT "%5.1" ECU_ADDRESS 0x8FEF72 /end MEASUREMENT
/begin MEASUREMENT FrmMng_numBOS_RESET_2byte2_mp "" UBYTE OneToOne 1 100 0.00 255.0 FORMAT "%5.1" ECU_ADDRESS 0x8FEF73 /end MEASUREMENT
/begin MEASUREMENT FrmMng_numBOS_RESET_2byte3_mp "" UBYTE OneToOne 1 100 0.00 255.0 FORMAT "%5.1" ECU_ADDRESS 0x8FEF74 /end MEASUREMENT
/begin MEASUREMENT FrmMng_numBOS_RESET_2byte4_mp "" UBYTE OneToOne 1 100 0.00 255.0 FORMAT "%5.1" ECU_ADDRESS 0x8FEF75 /end MEASUREMENT
/begin MEASUREMENT FrmMng_numBOS_RESET_2byte5_mp "" UBYTE OneToOne 1 100 0.00 255.0 FORMAT "%5.1" ECU_ADDRESS 0x8FEF76 /end MEASUREMENT
/begin MEASUREMENT FrmMng_numBOS_RESET_2byte6_mp "" UBYTE OneToOne 1 100 0.00 255.0 FORMAT "%5.1" ECU_ADDRESS 0x8FEF77 /end MEASUREMENT
/begin MEASUREMENT FrmMng_numCCMsgbyte0_mp "Byte 0 Rohwert in der Can Nachricht  der letzten gesendeten Checkcontrol Meldung" UBYTE OneToOne 1 100 0.00 255.0 FORMAT "%5.1" ECU_ADDRESS 0x8FEF78 /end MEASUREMENT
/begin MEASUREMENT FrmMng_numCCMsgbyte1_mp "Byte 1 Rohwert in der Can Nachricht  der letzten gesendeten Checkcontrol Meldung" UBYTE OneToOne 1 100 0.00 255.0 FORMAT "%5.1" ECU_ADDRESS 0x8FEF79 /end MEASUREMENT
/begin MEASUREMENT FrmMng_numCCMsgbyte2_mp "Byte 2 Rohwert in der Can Nachricht  der letzten gesendeten Checkcontrol Meldung" UBYTE OneToOne 1 100 0.00 255.0 FORMAT "%5.1" ECU_ADDRESS 0x8FEF7A /end MEASUREMENT
/begin MEASUREMENT FrmMng_numCCMsgbyte3_mp "Byte 3 Rohwert in der Can Nachricht  der letzten gesendeten Checkcontrol Meldung" UBYTE OneToOne 1 100 0.00 255.0 FORMAT "%5.1" ECU_ADDRESS 0x8FEF7B /end MEASUREMENT
/begin MEASUREMENT FrmMng_numCCMsgbyte4_mp "Byte 4 Rohwert in der Can Nachricht  der letzten gesendeten Checkcontrol Meldung" UBYTE OneToOne 1 100 0.00 255.0 FORMAT "%5.1" ECU_ADDRESS 0x8FEF7C /end MEASUREMENT
/begin MEASUREMENT FrmMng_numCCMsgbyte5_mp "Byte 5 Rohwert in der Can Nachricht  der letzten gesendeten Checkcontrol Meldung" UBYTE OneToOne 1 100 0.00 255.0 FORMAT "%5.1" ECU_ADDRESS 0x8FEF7D /end MEASUREMENT
/begin MEASUREMENT FrmMng_numCCMsgbyte6_mp "Byte 6 Rohwert in der Can Nachricht  der letzten gesendeten Checkcontrol Meldung" UBYTE OneToOne 1 100 0.00 255.0 FORMAT "%5.1" ECU_ADDRESS 0x8FEF7E /end MEASUREMENT
/begin MEASUREMENT FrmMng_numCCMsgbyte7_mp "Byte 7 Rohwert in der Can Nachricht  der letzten gesendeten Checkcontrol Meldung" UBYTE OneToOne 1 100 0.00 255.0 FORMAT "%5.1" ECU_ADDRESS 0x8FEF7F /end MEASUREMENT
/begin MEASUREMENT FrmMng_numDMANFAFSbyte0_mp "Byte0 of raw messagebyte of DMANFAFS" UBYTE OneToOne 1 100 0.00 255.0 FORMAT "%5.1" ECU_ADDRESS 0x8FEF80 /end MEASUREMENT
/begin MEASUREMENT FrmMng_numDMANFAFSbyte1_mp "Byte1 of raw messagebyte of DMANFAFS" UBYTE OneToOne 1 100 0.00 255.0 FORMAT "%5.1" ECU_ADDRESS 0x8FEF81 /end MEASUREMENT
/begin MEASUREMENT FrmMng_numDMANFAFSbyte2_mp "Byte2 of raw messagebyte of DMANFAFS" UBYTE OneToOne 1 100 0.00 255.0 FORMAT "%5.1" ECU_ADDRESS 0x8FEF82 /end MEASUREMENT
/begin MEASUREMENT FrmMng_numDMANFAFSbyte3_mp "Byte3 of raw messagebyte of DMANFAFS" UBYTE OneToOne 1 100 0.00 255.0 FORMAT "%5.1" ECU_ADDRESS 0x8FEF83 /end MEASUREMENT
/begin MEASUREMENT FrmMng_numDMANFAFSbyte4_mp "Byte4 of raw messagebyte of DMANFAFS" UBYTE OneToOne 1 100 0.00 255.0 FORMAT "%5.1" ECU_ADDRESS 0x8FEF84 /end MEASUREMENT
/begin MEASUREMENT FrmMng_numDMANFAFSbyte5_mp "Byte5 of raw messagebyte of DMANFAFS" UBYTE OneToOne 1 100 0.00 255.0 FORMAT "%5.1" ECU_ADDRESS 0x8FEF85 /end MEASUREMENT
/begin MEASUREMENT FrmMng_numDM_ANF_ACCbyte0_mp "Byte0 of raw messagebyte of DREHMOMENT_ANF_ACC" UBYTE OneToOne 1 100 0.00 255.0 FORMAT "%5.1" ECU_ADDRESS 0x8FEF86 /end MEASUREMENT
/begin MEASUREMENT FrmMng_numDM_ANF_ACCbyte1_mp "Byte1 of raw messagebyte of DREHMOMENT_ANF_ACC" UBYTE OneToOne 1 100 0.00 255.0 FORMAT "%5.1" ECU_ADDRESS 0x8FEF87 /end MEASUREMENT
/begin MEASUREMENT FrmMng_numDM_ANF_ACCbyte2_mp "Byte2 of raw messagebyte of DREHMOMENT_ANF_ACC" UBYTE OneToOne 1 100 0.00 255.0 FORMAT "%5.1" ECU_ADDRESS 0x8FEF88 /end MEASUREMENT
/begin MEASUREMENT FrmMng_numDM_ANF_ACCbyte3_mp "Byte3 of raw messagebyte of DREHMOMENT_ANF_ACC" UBYTE OneToOne 1 100 0.00 255.0 FORMAT "%5.1" ECU_ADDRESS 0x8FEF89 /end MEASUREMENT
/begin MEASUREMENT FrmMng_numDM_ANF_ACCbyte4_mp "Byte4 of raw messagebyte of DREHMOMENT_ANF_ACC" UBYTE OneToOne 1 100 0.00 255.0 FORMAT "%5.1" ECU_ADDRESS 0x8FEF8A /end MEASUREMENT
/begin MEASUREMENT FrmMng_numDM_ANF_ACCbyte5_mp "Byte5 of raw messagebyte of DREHMOMENT_ANF_ACC" UBYTE OneToOne 1 100 0.00 255.0 FORMAT "%5.1" ECU_ADDRESS 0x8FEF8B /end MEASUREMENT
/begin MEASUREMENT FrmMng_numDM_ANF_ACCbyte6_mp "Byte6 of raw messagebyte of DREHMOMENT_ANF_ACC" UBYTE OneToOne 1 100 0.00 255.0 FORMAT "%5.1" ECU_ADDRESS 0x8FEF8C /end MEASUREMENT
/begin MEASUREMENT FrmMng_numDM_ANF_ACCbyte7_mp "Byte7 of raw messagebyte of DREHMOMENT_ANF_ACC" UBYTE OneToOne 1 100 0.00 255.0 FORMAT "%5.1" ECU_ADDRESS 0x8FEF8D /end MEASUREMENT
/begin MEASUREMENT FrmMng_numDRMANFSSGbyte0_mp "Byte0 of raw messagebyte of DRMANFSSG" UBYTE OneToOne 1 100 0.00 255.0 FORMAT "%5.1" ECU_ADDRESS 0x8FEF8E /end MEASUREMENT
/begin MEASUREMENT FrmMng_numDRMANFSSGbyte1_mp "Byte1 of raw messagebyte of DRMANFSSG" UBYTE OneToOne 1 100 0.00 255.0 FORMAT "%5.1" ECU_ADDRESS 0x8FEF8F /end MEASUREMENT
/begin MEASUREMENT FrmMng_numDRMANFSSGbyte2_mp "Byte2 of raw messagebyte of DRMANFSSG" UBYTE OneToOne 1 100 0.00 255.0 FORMAT "%5.1" ECU_ADDRESS 0x8FEF90 /end MEASUREMENT
/begin MEASUREMENT FrmMng_numDRMANFSSGbyte3_mp "Byte3 of raw messagebyte of DRMANFSSG" UBYTE OneToOne 1 100 0.00 255.0 FORMAT "%5.1" ECU_ADDRESS 0x8FEF91 /end MEASUREMENT
/begin MEASUREMENT FrmMng_numDRMANFSSGbyte4_mp "Byte4 of raw messagebyte of DRMANFSSG" UBYTE OneToOne 1 100 0.00 255.0 FORMAT "%5.1" ECU_ADDRESS 0x8FEF92 /end MEASUREMENT
/begin MEASUREMENT FrmMng_numDRMANFSSGbyte5_mp "Byte5 of raw messagebyte of DRMANFSSG" UBYTE OneToOne 1 100 0.00 255.0 FORMAT "%5.1" ECU_ADDRESS 0x8FEF93 /end MEASUREMENT
/begin MEASUREMENT FrmMng_numDRMANFSSGbyte6_mp "Byte6 of raw messagebyte of DRMANFSSG" UBYTE OneToOne 1 100 0.00 255.0 FORMAT "%5.1" ECU_ADDRESS 0x8FEF94 /end MEASUREMENT
/begin MEASUREMENT FrmMng_numDRMANFSSGbyte7_mp "Byte7 of raw messagebyte of DRMANFSSG" UBYTE OneToOne 1 100 0.00 255.0 FORMAT "%5.1" ECU_ADDRESS 0x8FEF95 /end MEASUREMENT
/begin MEASUREMENT FrmMng_numELKTR_M_OEL_MESSbyte0_mp "" UBYTE OneToOne 1 100 0.00 255.0 FORMAT "%5.1" ECU_ADDRESS 0x8FEF96 /end MEASUREMENT
/begin MEASUREMENT FrmMng_numELKTR_M_OEL_MESSbyte1_mp "" UBYTE OneToOne 1 100 0.00 255.0 FORMAT "%5.1" ECU_ADDRESS 0x8FEF97 /end MEASUREMENT
/begin MEASUREMENT FrmMng_numENGINE1byte0_mp "Byte_0 Rohwerte in CAN-Botschaft ENGINE1" UBYTE OneToOne 1 100 0.00 255.0 FORMAT "%5.1" ECU_ADDRESS 0x8FEF98 /end MEASUREMENT
/begin MEASUREMENT FrmMng_numENGINE1byte1_mp "Byte_1 Rohwerte in CAN-Botschaft ENGINE1" UBYTE OneToOne 1 100 0.00 255.0 FORMAT "%5.1" ECU_ADDRESS 0x8FEF99 /end MEASUREMENT
/begin MEASUREMENT FrmMng_numENGINE1byte2_mp "Byte_2 Rohwerte in CAN-Botschaft ENGINE1" UBYTE OneToOne 1 100 0.00 255.0 FORMAT "%5.1" ECU_ADDRESS 0x8FEF9A /end MEASUREMENT
/begin MEASUREMENT FrmMng_numENGINE1byte3_mp "Byte_3 Rohwerte in CAN-Botschaft ENGINE1" UBYTE OneToOne 1 100 0.00 255.0 FORMAT "%5.1" ECU_ADDRESS 0x8FEF9B /end MEASUREMENT
/begin MEASUREMENT FrmMng_numENGINE1byte4_mp "Byte_4 Rohwerte in CAN-Botschaft ENGINE1" UBYTE OneToOne 1 100 0.00 255.0 FORMAT "%5.1" ECU_ADDRESS 0x8FEF9C /end MEASUREMENT
/begin MEASUREMENT FrmMng_numENGINE1byte5_mp "Byte_5 Rohwerte in CAN-Botschaft ENGINE1" UBYTE OneToOne 1 100 0.00 255.0 FORMAT "%5.1" ECU_ADDRESS 0x8FEF9D /end MEASUREMENT
/begin MEASUREMENT FrmMng_numENGINE1byte6_mp "Byte_6 Rohwerte in CAN-Botschaft ENGINE1" UBYTE OneToOne 1 100 0.00 255.0 FORMAT "%5.1" ECU_ADDRESS 0x8FEF9E /end MEASUREMENT
/begin MEASUREMENT FrmMng_numENGINE1byte7_mp "Byte_7 Rohwerte in CAN-Botschaft ENGINE1" UBYTE OneToOne 1 100 0.00 255.0 FORMAT "%5.1" ECU_ADDRESS 0x8FEF9F /end MEASUREMENT
/begin MEASUREMENT FrmMng_numEngRpmbyte0_mp "Rohwerte von der CAN-Botschaft ENGINE_RPM - Byte0" UBYTE OneToOne 1 100 0.00 255.0 FORMAT "%5.1" ECU_ADDRESS 0x8FEFA0 /end MEASUREMENT
/begin MEASUREMENT FrmMng_numEngRpmbyte1_mp "Rohwerte von der CAN-Botschaft ENGINE_RPM - Byte1" UBYTE OneToOne 1 100 0.00 255.0 FORMAT "%5.1" ECU_ADDRESS 0x8FEFA1 /end MEASUREMENT
/begin MEASUREMENT FrmMng_numGEARBX_DATA2byte0_mp "GEARBX_DATA2 Byte0" UBYTE OneToOne 1 100 0.00 255.0 FORMAT "%5.1" ECU_ADDRESS 0x8FEFA2 /end MEASUREMENT
/begin MEASUREMENT FrmMng_numGEARBX_DATA2byte1_mp "GEARBX_DATA2 Byte1" UBYTE OneToOne 1 100 0.00 255.0 FORMAT "%5.1" ECU_ADDRESS 0x8FEFA3 /end MEASUREMENT
/begin MEASUREMENT FrmMng_numGEARBX_DATAbyte0_mp "Byte_x raw data in CAN-message" UBYTE OneToOne 1 100 0.00 255.0 FORMAT "%5.1" ECU_ADDRESS 0x8FEFA4 /end MEASUREMENT
/begin MEASUREMENT FrmMng_numGEARBX_DATAbyte1_mp "Byte_x raw data in CAN-message" UBYTE OneToOne 1 100 0.00 255.0 FORMAT "%5.1" ECU_ADDRESS 0x8FEFA5 /end MEASUREMENT
/begin MEASUREMENT FrmMng_numGEARBX_DATAbyte2_mp "Byte_x raw data in CAN-message" UBYTE OneToOne 1 100 0.00 255.0 FORMAT "%5.1" ECU_ADDRESS 0x8FEFA6 /end MEASUREMENT
/begin MEASUREMENT FrmMng_numGEARBX_DATAbyte3_mp "Byte_x raw data in CAN-message" UBYTE OneToOne 1 100 0.00 255.0 FORMAT "%5.1" ECU_ADDRESS 0x8FEFA7 /end MEASUREMENT
/begin MEASUREMENT FrmMng_numGEARBX_DATAbyte4_mp "Byte_x raw data in CAN-message" UBYTE OneToOne 1 100 0.00 255.0 FORMAT "%5.1" ECU_ADDRESS 0x8FEFA8 /end MEASUREMENT
/begin MEASUREMENT FrmMng_numGEARBX_DATAbyte5_mp "Byte_x raw data in CAN-message" UBYTE OneToOne 1 100 0.00 255.0 FORMAT "%5.1" ECU_ADDRESS 0x8FEFA9 /end MEASUREMENT
/begin MEASUREMENT FrmMng_numGEARBX_DATAbyte6_mp "Byte_x raw data in CAN-message" UBYTE OneToOne 1 100 0.00 255.0 FORMAT "%5.1" ECU_ADDRESS 0x8FEFAA /end MEASUREMENT
/begin MEASUREMENT FrmMng_numGEARBX_DATAbyte7_mp "Byte_x raw data in CAN-message" UBYTE OneToOne 1 100 0.00 255.0 FORMAT "%5.1" ECU_ADDRESS 0x8FEFAB /end MEASUREMENT
/begin MEASUREMENT FrmMng_numHEATCURbyte0_mp "HEATING_CURRENT Byte0" UBYTE OneToOne 1 100 0.00 255.0 FORMAT "%5.1" ECU_ADDRESS 0x8FEFAC /end MEASUREMENT
/begin MEASUREMENT FrmMng_numHEATCURbyte1_mp "HEATING_CURRENT Byte1" UBYTE OneToOne 1 100 0.00 255.0 FORMAT "%5.1" ECU_ADDRESS 0x8FEFAD /end MEASUREMENT
/begin MEASUREMENT FrmMng_numHEATCURbyte2_mp "HEATING_CURRENT Byte2" UBYTE OneToOne 1 100 0.00 255.0 FORMAT "%5.1" ECU_ADDRESS 0x8FEFAE /end MEASUREMENT
/begin MEASUREMENT FrmMng_numHEATCURbyte3_mp "HEATING_CURRENT Byte3" UBYTE OneToOne 1 100 0.00 255.0 FORMAT "%5.1" ECU_ADDRESS 0x8FEFAF /end MEASUREMENT
/begin MEASUREMENT FrmMng_numHEATCURbyte4_mp "HEATING_CURRENT Byte3" UBYTE OneToOne 1 100 0.00 255.0 FORMAT "%5.1" ECU_ADDRESS 0x8FEFB0 /end MEASUREMENT
/begin MEASUREMENT FrmMng_numHEATCURbyte5_mp "HEATING_CURRENT Byte5" UBYTE OneToOne 1 100 0.00 255.0 FORMAT "%5.1" ECU_ADDRESS 0x8FEFB1 /end MEASUREMENT
/begin MEASUREMENT FrmMng_numHEATCURbyte6_mp "HEATING_CURRENT Byte6" UBYTE OneToOne 1 100 0.00 255.0 FORMAT "%5.1" ECU_ADDRESS 0x8FEFB2 /end MEASUREMENT
/begin MEASUREMENT FrmMng_numHEAT_ACbyte0_mp "Byte_x raw data in CAN-message" UBYTE OneToOne 1 100 0.00 255.0 FORMAT "%5.1" ECU_ADDRESS 0x8FEFB3 /end MEASUREMENT
/begin MEASUREMENT FrmMng_numHEAT_ACbyte1_mp "Byte_x raw data in CAN-message" UBYTE OneToOne 1 100 0.00 255.0 FORMAT "%5.1" ECU_ADDRESS 0x8FEFB4 /end MEASUREMENT
/begin MEASUREMENT FrmMng_numHEAT_ACbyte2_mp "Byte_x raw data in CAN-message" UBYTE OneToOne 1 100 0.00 255.0 FORMAT "%5.1" ECU_ADDRESS 0x8FEFB5 /end MEASUREMENT
/begin MEASUREMENT FrmMng_numHEAT_ACbyte3_mp "Byte_x raw data in CAN-message" UBYTE OneToOne 1 100 0.00 255.0 FORMAT "%5.1" ECU_ADDRESS 0x8FEFB6 /end MEASUREMENT
/begin MEASUREMENT FrmMng_numHEAT_ACbyte4_mp "Byte_x raw data in CAN-message" UBYTE OneToOne 1 100 0.00 255.0 FORMAT "%5.1" ECU_ADDRESS 0x8FEFB7 /end MEASUREMENT
/begin MEASUREMENT FrmMng_numLRADWINKbyte0_mp "Byte0 of raw messagebyte of LRADWINK" UBYTE OneToOne 1 100 0.00 255.0 FORMAT "%5.1" ECU_ADDRESS 0x8FEFB8 /end MEASUREMENT
/begin MEASUREMENT FrmMng_numLRADWINKbyte1_mp "Byte1 of raw messagebyte of LRADWINK" UBYTE OneToOne 1 100 0.00 255.0 FORMAT "%5.1" ECU_ADDRESS 0x8FEFB9 /end MEASUREMENT
/begin MEASUREMENT FrmMng_numLRADWINKbyte2_mp "Byte2 of raw messagebyte of LRADWINK" UBYTE OneToOne 1 100 0.00 255.0 FORMAT "%5.1" ECU_ADDRESS 0x8FEFBA /end MEASUREMENT
/begin MEASUREMENT FrmMng_numLRADWINKbyte3_mp "Byte3 of raw messagebyte of LRADWINK" UBYTE OneToOne 1 100 0.00 255.0 FORMAT "%5.1" ECU_ADDRESS 0x8FEFBB /end MEASUREMENT
/begin MEASUREMENT FrmMng_numLRADWINKbyte4_mp "Byte4 of raw messagebyte of LRADWINK" UBYTE OneToOne 1 100 0.00 255.0 FORMAT "%5.1" ECU_ADDRESS 0x8FEFBC /end MEASUREMENT
/begin MEASUREMENT FrmMng_numLRADWINKbyte5_mp "Byte5 of raw messagebyte of LRADWINK" UBYTE OneToOne 1 100 0.00 255.0 FORMAT "%5.1" ECU_ADDRESS 0x8FEFBD /end MEASUREMENT
/begin MEASUREMENT FrmMng_numLRADWINKbyte6_mp "Byte6 of raw messagebyte of LRADWINK" UBYTE OneToOne 1 100 0.00 255.0 FORMAT "%5.1" ECU_ADDRESS 0x8FEFBE /end MEASUREMENT
/begin MEASUREMENT FrmMng_numMILEAGE_RANGEbyte0_mp "MILEAGE_RANGE Byte0" UBYTE OneToOne 1 100 0.00 255.0 FORMAT "%5.1" ECU_ADDRESS 0x8FEFBF /end MEASUREMENT
/begin MEASUREMENT FrmMng_numMILEAGE_RANGEbyte1_mp "MILEAGE_RANGE Byte1" UBYTE OneToOne 1 100 0.00 255.0 FORMAT "%5.1" ECU_ADDRESS 0x8FEFC0 /end MEASUREMENT
/begin MEASUREMENT FrmMng_numMILEAGE_RANGEbyte2_mp "MILEAGE_RANGE Byte2" UBYTE OneToOne 1 100 0.00 255.0 FORMAT "%5.1" ECU_ADDRESS 0x8FEFC1 /end MEASUREMENT
/begin MEASUREMENT FrmMng_numMILEAGE_RANGEbyte3_mp "MILEAGE_RANGE Byte3" UBYTE OneToOne 1 100 0.00 255.0 FORMAT "%5.1" ECU_ADDRESS 0x8FEFC2 /end MEASUREMENT
/begin MEASUREMENT FrmMng_numMILEAGE_RANGEbyte4_mp "MILEAGE_RANGE Byte4" UBYTE OneToOne 1 100 0.00 255.0 FORMAT "%5.1" ECU_ADDRESS 0x8FEFC3 /end MEASUREMENT
/begin MEASUREMENT FrmMng_numMILEAGE_RANGEbyte5_mp "MILEAGE_RANGE Byte5" UBYTE OneToOne 1 100 0.00 255.0 FORMAT "%5.1" ECU_ADDRESS 0x8FEFC4 /end MEASUREMENT
/begin MEASUREMENT FrmMng_numMILEAGE_RANGEbyte6_mp "MILEAGE_RANGE Byte6" UBYTE OneToOne 1 100 0.00 255.0 FORMAT "%5.1" ECU_ADDRESS 0x8FEFC5 /end MEASUREMENT
/begin MEASUREMENT FrmMng_numMILEAGE_RANGEbyte7_mp "MILEAGE_RANGE Byte7" UBYTE OneToOne 1 100 0.00 255.0 FORMAT "%5.1" ECU_ADDRESS 0x8FEFC6 /end MEASUREMENT
/begin MEASUREMENT FrmMng_numMsgACC_mp "counter for self recognition of ACC" UBYTE OneToOne 1 100 0.00 255.0 FORMAT "%5.1" ECU_ADDRESS 0x8FEFC7 /end MEASUREMENT
/begin MEASUREMENT FrmMng_numMsgAC_mp "" UBYTE OneToOne 1 100 0.00 255.0 FORMAT "%5.1" ECU_ADDRESS 0x8FEFC8 /end MEASUREMENT
/begin MEASUREMENT FrmMng_numMsgAFS_mp "Counter for self recognition of AFS" UBYTE OneToOne 1 100 0.00 255.0 FORMAT "%5.1" ECU_ADDRESS 0x8FEFC9 /end MEASUREMENT
/begin MEASUREMENT FrmMng_numMsgARS_mp "Counter for ARS recognition" UBYTE OneToOne 1 100 0.00 255.0 FORMAT "%5.1" ECU_ADDRESS 0x8FEFCA /end MEASUREMENT
/begin MEASUREMENT FrmMng_numMsgFGR_mp "Counter for self recognition of FGR" UBYTE OneToOne 1 100 0.00 255.0 FORMAT "%5.1" ECU_ADDRESS 0x8FEFCB /end MEASUREMENT
/begin MEASUREMENT FrmMng_numOPCRCTLACCbyte0_mp "OP_CRCTLACC Byte0" UBYTE OneToOne 1 100 0.00 255.0 FORMAT "%5.1" ECU_ADDRESS 0x8FEFCC /end MEASUREMENT
/begin MEASUREMENT FrmMng_numOPCRCTLACCbyte1_mp "OP_CRCTLACC Byte1" UBYTE OneToOne 1 100 0.00 255.0 FORMAT "%5.1" ECU_ADDRESS 0x8FEFCD /end MEASUREMENT
/begin MEASUREMENT FrmMng_numOPCRCTLACCbyte2_mp "OP_CRCTLACC Byte2" UBYTE OneToOne 1 100 0.00 255.0 FORMAT "%5.1" ECU_ADDRESS 0x8FEFCE /end MEASUREMENT
/begin MEASUREMENT FrmMng_numOPCRCTLACCbyte3_mp "OP_CRCTLACC Byte3" UBYTE OneToOne 1 100 0.00 255.0 FORMAT "%5.1" ECU_ADDRESS 0x8FEFCF /end MEASUREMENT
/begin MEASUREMENT FrmMng_numParkConsumerByte0_mp "ParkConsumer Byte0" UBYTE OneToOne 1 100 0.00 255.0 FORMAT "%5.1" ECU_ADDRESS 0x8FEFD0 /end MEASUREMENT
/begin MEASUREMENT FrmMng_numParkConsumerByte1_mp "ParkConsumer Byte1" UBYTE OneToOne 1 100 0.00 255.0 FORMAT "%5.1" ECU_ADDRESS 0x8FEFD1 /end MEASUREMENT
/begin MEASUREMENT FrmMng_numParkConsumerByte2_mp "ParkConsumer Byte2" UBYTE OneToOne 1 100 0.00 255.0 FORMAT "%5.1" ECU_ADDRESS 0x8FEFD2 /end MEASUREMENT
/begin MEASUREMENT FrmMng_numParkConsumerByte3_mp "ParkConsumer Byte3" UBYTE OneToOne 1 100 0.00 255.0 FORMAT "%5.1" ECU_ADDRESS 0x8FEFD3 /end MEASUREMENT
/begin MEASUREMENT FrmMng_numPMCTRCOSbyte0_mp "POWERMGMT_CTR_COS Byte0" UBYTE OneToOne 1 100 0.00 255.0 FORMAT "%5.1" ECU_ADDRESS 0x8FEFD4 /end MEASUREMENT
/begin MEASUREMENT FrmMng_numPMCTRCOSbyte1_mp "POWERMGMT_CTR_COS Byte1" UBYTE OneToOne 1 100 0.00 255.0 FORMAT "%5.1" ECU_ADDRESS 0x8FEFD5 /end MEASUREMENT
/begin MEASUREMENT FrmMng_numPMCTRCOSbyte2_mp "POWERMGMT_CTR_COS Byte2" UBYTE OneToOne 1 100 0.00 255.0 FORMAT "%5.1" ECU_ADDRESS 0x8FEFD6 /end MEASUREMENT
/begin MEASUREMENT FrmMng_numPMCTRCOSbyte3_mp "POWERMGMT_CTR_COS Byte3" UBYTE OneToOne 1 100 0.00 255.0 FORMAT "%5.1" ECU_ADDRESS 0x8FEFD7 /end MEASUREMENT
/begin MEASUREMENT FrmMng_numPMCTRCOSbyte4_mp "POWERMGMT_CTR_COS Byte4" UBYTE OneToOne 1 100 0.00 255.0 FORMAT "%5.1" ECU_ADDRESS 0x8FEFD8 /end MEASUREMENT
/begin MEASUREMENT FrmMng_numPMCTRCOSbyte5_mp "POWERMGMT_CTR_COS Byte5" UBYTE OneToOne 1 100 0.00 255.0 FORMAT "%5.1" ECU_ADDRESS 0x8FEFD9 /end MEASUREMENT
/begin MEASUREMENT FrmMng_numPMUBattbyte0_mp "POWERMGNT_BATTERIESPANNUNG Byte0" UBYTE OneToOne 1 100 0.00 255.0 FORMAT "%5.1" ECU_ADDRESS 0x8FEFDA /end MEASUREMENT
/begin MEASUREMENT FrmMng_numPMUBattbyte1_mp "POWERMGNT_BATTERIESPANNUNG Byte1" UBYTE OneToOne 1 100 0.00 255.0 FORMAT "%5.1" ECU_ADDRESS 0x8FEFDB /end MEASUREMENT
/begin MEASUREMENT FrmMng_numPMUBattbyte2_mp "POWERMGNT_BATTERIESPANNUNG Byte2" UBYTE OneToOne 1 100 0.00 255.0 FORMAT "%5.1" ECU_ADDRESS 0x8FEFDC /end MEASUREMENT
/begin MEASUREMENT FrmMng_numPMUBattbyte3_mp "POWERMGNT_BATTERIESPANNUNG Byte3" UBYTE OneToOne 1 100 0.00 255.0 FORMAT "%5.1" ECU_ADDRESS 0x8FEFDD /end MEASUREMENT
/begin MEASUREMENT FrmMng_numPMUBattbyte4_mp "POWERMGNT_BATTERIESPANNUNG Byte4" UBYTE OneToOne 1 100 0.00 255.0 FORMAT "%5.1" ECU_ADDRESS 0x8FEFDE /end MEASUREMENT
/begin MEASUREMENT FrmMng_numPMUBattbyte5_mp "POWERMGNT_BATTERIESPANNUNG Byte5" UBYTE OneToOne 1 100 0.00 255.0 FORMAT "%5.1" ECU_ADDRESS 0x8FEFDF /end MEASUREMENT
/begin MEASUREMENT FrmMng_numPMUBattbyte6_mp "POWERMGNT_BATTERIESPANNUNG Byte6" UBYTE OneToOne 1 100 0.00 255.0 FORMAT "%5.1" ECU_ADDRESS 0x8FEFE0 /end MEASUREMENT
/begin MEASUREMENT FrmMng_numPMUBattbyte7_mp "POWERMGNT_BATTERIESPANNUNG Byte7" UBYTE OneToOne 1 100 0.00 255.0 FORMAT "%5.1" ECU_ADDRESS 0x8FEFE1 /end MEASUREMENT
/begin MEASUREMENT FrmMng_numPRGG_CCTRbyte0_mp "Byte0 of raw messagebyte of PRGG_CCTR" UBYTE OneToOne 1 100 0.00 255.0 FORMAT "%5.1" ECU_ADDRESS 0x8FEFE2 /end MEASUREMENT
/begin MEASUREMENT FrmMng_numPRGG_CCTRbyte1_mp "Byte1 of raw messagebyte of PRGG_CCTR" UBYTE OneToOne 1 100 0.00 255.0 FORMAT "%5.1" ECU_ADDRESS 0x8FEFE3 /end MEASUREMENT
/begin MEASUREMENT FrmMng_numPRGG_CCTRbyte2_mp "Byte2 of raw messagebyte of PRGG_CCTR" UBYTE OneToOne 1 100 0.00 255.0 FORMAT "%5.1" ECU_ADDRESS 0x8FEFE4 /end MEASUREMENT
/begin MEASUREMENT FrmMng_numPRGG_CCTRbyte3_mp "Byte3 of raw messagebyte of PRGG_CCTR" UBYTE OneToOne 1 100 0.00 255.0 FORMAT "%5.1" ECU_ADDRESS 0x8FEFE5 /end MEASUREMENT
/begin MEASUREMENT FrmMng_numPRGG_CCTRbyte4_mp "Byte4 of raw messagebyte of PRGG_CCTR" UBYTE OneToOne 1 100 0.00 255.0 FORMAT "%5.1" ECU_ADDRESS 0x8FEFE6 /end MEASUREMENT
/begin MEASUREMENT FrmMng_numPWRMNG_LOADVbyte0_mp "" UBYTE OneToOne 1 100 0.00 255.0 FORMAT "%5.1" ECU_ADDRESS 0x8FEFE7 /end MEASUREMENT
/begin MEASUREMENT FrmMng_numPWRMNG_LOADVbyte1_mp "" UBYTE OneToOne 1 100 0.00 255.0 FORMAT "%5.1" ECU_ADDRESS 0x8FEFE8 /end MEASUREMENT
/begin MEASUREMENT FrmMng_numPWRMNG_LOADVbyte2_mp "" UBYTE OneToOne 1 100 0.00 255.0 FORMAT "%5.1" ECU_ADDRESS 0x8FEFE9 /end MEASUREMENT
/begin MEASUREMENT FrmMng_numPWRMNG_LOADVbyte3_mp "" UBYTE OneToOne 1 100 0.00 255.0 FORMAT "%5.1" ECU_ADDRESS 0x8FEFEA /end MEASUREMENT
/begin MEASUREMENT FrmMng_numPWRMNG_LOADVbyte4_mp "" UBYTE OneToOne 1 100 0.00 255.0 FORMAT "%5.1" ECU_ADDRESS 0x8FEFEB /end MEASUREMENT
/begin MEASUREMENT FrmMng_numPWRMNG_LOADVbyte5_mp "" UBYTE OneToOne 1 100 0.00 255.0 FORMAT "%5.1" ECU_ADDRESS 0x8FEFEC /end MEASUREMENT
/begin MEASUREMENT FrmMng_numPWRMNG_LOADVbyte6_mp "" UBYTE OneToOne 1 100 0.00 255.0 FORMAT "%5.1" ECU_ADDRESS 0x8FEFED /end MEASUREMENT
/begin MEASUREMENT FrmMng_numPWRMNG_LOADVbyte7_mp "" UBYTE OneToOne 1 100 0.00 255.0 FORMAT "%5.1" ECU_ADDRESS 0x8FEFEE /end MEASUREMENT
/begin MEASUREMENT FrmMng_numRPM_STAByte0_mp "" UBYTE OneToOne 1 100 0.00 255.0 FORMAT "%5.1" ECU_ADDRESS 0x8FEFEF /end MEASUREMENT
/begin MEASUREMENT FrmMng_numRPM_STAByte1_mp "" UBYTE OneToOne 1 100 0.00 255.0 FORMAT "%5.1" ECU_ADDRESS 0x8FEFF0 /end MEASUREMENT
/begin MEASUREMENT FrmMng_numRQ_STG_EFANbyte0_mp "RQ_STG_EFAN Raw wert byte 0" UBYTE OneToOne 1 100 0.00 255.0 FORMAT "%5.1" ECU_ADDRESS 0x8FEFF1 /end MEASUREMENT
/begin MEASUREMENT FrmMng_numRQ_STG_EFANbyte1_mp "RQ_STG_EFAN Raw wert byte 1" UBYTE OneToOne 1 100 0.00 255.0 FORMAT "%5.1" ECU_ADDRESS 0x8FEFF2 /end MEASUREMENT
/begin MEASUREMENT FrmMng_numRQ_STG_EFANbyte2_mp "RQ_STG_EFAN Raw wert byte 2" UBYTE OneToOne 1 100 0.00 255.0 FORMAT "%5.1" ECU_ADDRESS 0x8FEFF3 /end MEASUREMENT
/begin MEASUREMENT FrmMng_numSITZGURTbyte0_mp "STAT_SITZBELEGUNG_GURT rohes messagebyte 0" UBYTE OneToOne 1 100 0.00 255.0 FORMAT "%5.1" ECU_ADDRESS 0x8FEFF4 /end MEASUREMENT
/begin MEASUREMENT FrmMng_numSITZGURTbyte1_mp "STAT_SITZBELEGUNG_GURT  rohes messagebyte 1" UBYTE OneToOne 1 100 0.00 255.0 FORMAT "%5.1" ECU_ADDRESS 0x8FEFF5 /end MEASUREMENT
/begin MEASUREMENT FrmMng_numSITZGURTbyte2_mp "STAT_SITZBELEGUNG_GURT  rohes messagebyte 2" UBYTE OneToOne 1 100 0.00 255.0 FORMAT "%5.1" ECU_ADDRESS 0x8FEFF6 /end MEASUREMENT
/begin MEASUREMENT FrmMng_numSITZGURTbyte3_mp "STAT_SITZBELEGUNG_GURT  rohes messagebyte 3" UBYTE OneToOne 1 100 0.00 255.0 FORMAT "%5.1" ECU_ADDRESS 0x8FEFF7 /end MEASUREMENT
/begin MEASUREMENT FrmMng_numSITZGURTbyte4_mp "STAT_SITZBELEGUNG_GURT  rohes messagebyte 4" UBYTE OneToOne 1 100 0.00 255.0 FORMAT "%5.1" ECU_ADDRESS 0x8FEFF8 /end MEASUREMENT
/begin MEASUREMENT FrmMng_numSPEED_CLCTRbyte0_mp "SPEED_CLCTR Byte0" UBYTE OneToOne 1 100 0.00 255.0 FORMAT "%5.1" ECU_ADDRESS 0x8FEFF9 /end MEASUREMENT
/begin MEASUREMENT FrmMng_numSPEED_CLCTRbyte1_mp "SPEED_CLCTR Byte1" UBYTE OneToOne 1 100 0.00 255.0 FORMAT "%5.1" ECU_ADDRESS 0x8FEFFA /end MEASUREMENT
/begin MEASUREMENT FrmMng_numSPEED_CLCTRbyte2_mp "SPEED_CLCTR Byte2" UBYTE OneToOne 1 100 0.00 255.0 FORMAT "%5.1" ECU_ADDRESS 0x8FEFFB /end MEASUREMENT
/begin MEASUREMENT FrmMng_numSPEED_CLCTRbyte3_mp "SPEED_CLCTR Byte2" UBYTE OneToOne 1 100 0.00 255.0 FORMAT "%5.1" ECU_ADDRESS 0x8FEFFC /end MEASUREMENT
/begin MEASUREMENT FrmMng_numSPEED_CLCTRbyte4_mp " SPEED_CLCTR Byte4" UBYTE OneToOne 1 100 0.00 255.0 FORMAT "%5.1" ECU_ADDRESS 0x8FEFFD /end MEASUREMENT
/begin MEASUREMENT FrmMng_numSPEED_CLCTRbyte5_mp "SPEED_CLCTR Byte5" UBYTE OneToOne 1 100 0.00 255.0 FORMAT "%5.1" ECU_ADDRESS 0x8FEFFE /end MEASUREMENT
/begin MEASUREMENT FrmMng_numSPEED_CLCTRbyte6_mp "SPEED_CLCTR Byte6" UBYTE OneToOne 1 100 0.00 255.0 FORMAT "%5.1" ECU_ADDRESS 0x8FEFFF /end MEASUREMENT
/begin MEASUREMENT FrmMng_numSPEED_CLCTRbyte7_mp "SPEED_CLCTR Byte7" UBYTE OneToOne 1 100 0.00 255.0 FORMAT "%5.1" ECU_ADDRESS 0x8FF000 /end MEASUREMENT
/begin MEASUREMENT FrmMng_numSTAT_ANHbyte0_mp "" UBYTE OneToOne 1 100 0.00 255.0 FORMAT "%5.1" ECU_ADDRESS 0x8FF001 /end MEASUREMENT
/begin MEASUREMENT FrmMng_numSTAT_ARSbyte0_mp "Byte_x raw data in CAN-message" UBYTE OneToOne 1 100 0.00 255.0 FORMAT "%5.1" ECU_ADDRESS 0x8FF002 /end MEASUREMENT
/begin MEASUREMENT FrmMng_numSTAT_ARSbyte1_mp "Byte_x raw data in CAN-message" UBYTE OneToOne 1 100 0.00 255.0 FORMAT "%5.1" ECU_ADDRESS 0x8FF003 /end MEASUREMENT
/begin MEASUREMENT FrmMng_numSTAT_ARSbyte2_mp "Byte_x raw data in CAN-message" UBYTE OneToOne 1 100 0.00 255.0 FORMAT "%5.1" ECU_ADDRESS 0x8FF004 /end MEASUREMENT
/begin MEASUREMENT FrmMng_numSTAT_ARSbyte3_mp "Byte_x raw data in CAN-message" UBYTE OneToOne 1 100 0.00 255.0 FORMAT "%5.1" ECU_ADDRESS 0x8FF005 /end MEASUREMENT
/begin MEASUREMENT FrmMng_numSTAT_ARSbyte4_mp "Byte_x raw data in CAN-message" UBYTE OneToOne 1 100 0.00 255.0 FORMAT "%5.1" ECU_ADDRESS 0x8FF006 /end MEASUREMENT
/begin MEASUREMENT FrmMng_numSTAT_ARSbyte5_mp "Byte_x raw data in CAN-message" UBYTE OneToOne 1 100 0.00 255.0 FORMAT "%5.1" ECU_ADDRESS 0x8FF007 /end MEASUREMENT
/begin MEASUREMENT FrmMng_numSTAT_ARSbyte6_mp "Byte_x raw data in CAN-message" UBYTE OneToOne 1 100 0.00 255.0 FORMAT "%5.1" ECU_ADDRESS 0x8FF008 /end MEASUREMENT
/begin MEASUREMENT FrmMng_numSTAT_ARSbyte7_mp "Byte_x raw data in CAN-message" UBYTE OneToOne 1 100 0.00 255.0 FORMAT "%5.1" ECU_ADDRESS 0x8FF009 /end MEASUREMENT
/begin MEASUREMENT FrmMng_numSTAT_DSCbyte0_mp "Byte_x raw data in CAN-message" UBYTE OneToOne 1 100 0.00 255.0 FORMAT "%5.1" ECU_ADDRESS 0x8FF00A /end MEASUREMENT
/begin MEASUREMENT FrmMng_numSTAT_DSCbyte1_mp "Byte_x raw data in CAN-message" UBYTE OneToOne 1 100 0.00 255.0 FORMAT "%5.1" ECU_ADDRESS 0x8FF00B /end MEASUREMENT
/begin MEASUREMENT FrmMng_numSTAT_DSCbyte2_mp "Byte_x raw data in CAN-message" UBYTE OneToOne 1 100 0.00 255.0 FORMAT "%5.1" ECU_ADDRESS 0x8FF00C /end MEASUREMENT
/begin MEASUREMENT FrmMng_numSTAT_DSCbyte3_mp "Byte_x raw data in CAN-message" UBYTE OneToOne 1 100 0.00 255.0 FORMAT "%5.1" ECU_ADDRESS 0x8FF00D /end MEASUREMENT
/begin MEASUREMENT FrmMng_numSTAT_DSCbyte4_mp "Byte_x raw data in CAN-message" UBYTE OneToOne 1 100 0.00 255.0 FORMAT "%5.1" ECU_ADDRESS 0x8FF00E /end MEASUREMENT
/begin MEASUREMENT FrmMng_numSTAT_DSCbyte5_mp "Byte_x raw data in CAN-message" UBYTE OneToOne 1 100 0.00 255.0 FORMAT "%5.1" ECU_ADDRESS 0x8FF00F /end MEASUREMENT
/begin MEASUREMENT FrmMng_numSTAT_DSCbyte6_mp "Byte_x raw data in CAN-message" UBYTE OneToOne 1 100 0.00 255.0 FORMAT "%5.1" ECU_ADDRESS 0x8FF010 /end MEASUREMENT
/begin MEASUREMENT FrmMng_numSTAT_DSCbyte7_mp "Byte_x raw data in CAN-message" UBYTE OneToOne 1 100 0.00 255.0 FORMAT "%5.1" ECU_ADDRESS 0x8FF011 /end MEASUREMENT
/begin MEASUREMENT FrmMng_numSTAT_EKPbyte0_mp "STAT_EKP  Byte0" UBYTE OneToOne 1 100 0.00 255.0 FORMAT "%5.1" ECU_ADDRESS 0x8FF012 /end MEASUREMENT
/begin MEASUREMENT FrmMng_numSTAT_EKPbyte1_mp "STAT_EKP  Byte1" UBYTE OneToOne 1 100 0.00 255.0 FORMAT "%5.1" ECU_ADDRESS 0x8FF013 /end MEASUREMENT
/begin MEASUREMENT FrmMng_numSTAT_EKPbyte2_mp "STAT_EKP  Byte2" UBYTE OneToOne 1 100 0.00 255.0 FORMAT "%5.1" ECU_ADDRESS 0x8FF014 /end MEASUREMENT
/begin MEASUREMENT FrmMng_numSTAT_EKPbyte3_mp "STAT_EKP  Byte3" UBYTE OneToOne 1 100 0.00 255.0 FORMAT "%5.1" ECU_ADDRESS 0x8FF015 /end MEASUREMENT
/begin MEASUREMENT FrmMng_numSTAT_EKPbyte4_mp "STAT_EKP  Byte4" UBYTE OneToOne 1 100 0.00 255.0 FORMAT "%5.1" ECU_ADDRESS 0x8FF016 /end MEASUREMENT
/begin MEASUREMENT FrmMng_numSTAT_EKPbyte5_mp "STAT_EKP  Byte5" UBYTE OneToOne 1 100 0.00 255.0 FORMAT "%5.1" ECU_ADDRESS 0x8FF017 /end MEASUREMENT
/begin MEASUREMENT FrmMng_numSTAT_EKPbyte6_mp "STAT_EKP  Byte6" UBYTE OneToOne 1 100 0.00 255.0 FORMAT "%5.1" ECU_ADDRESS 0x8FF018 /end MEASUREMENT
/begin MEASUREMENT FrmMng_numSTAT_EKPbyte7_mp "STAT_EKP  Byte7" UBYTE OneToOne 1 100 0.00 255.0 FORMAT "%5.1" ECU_ADDRESS 0x8FF019 /end MEASUREMENT
/begin MEASUREMENT FrmMng_numSTAT_KOMBIbyte0_mp "STAT_KOMBI Byte0" UBYTE OneToOne 1 100 0.00 255.0 FORMAT "%5.1" ECU_ADDRESS 0x8FF01A /end MEASUREMENT
/begin MEASUREMENT FrmMng_numSTAT_KOMBIbyte1_mp "STAT_KOMBI Byte1" UBYTE OneToOne 1 100 0.00 255.0 FORMAT "%5.1" ECU_ADDRESS 0x8FF01B /end MEASUREMENT
/begin MEASUREMENT FrmMng_numSTAT_KOMBIbyte2_mp "STAT_KOMBI Byte2" UBYTE OneToOne 1 100 0.00 255.0 FORMAT "%5.1" ECU_ADDRESS 0x8FF01C /end MEASUREMENT
/begin MEASUREMENT FrmMng_numSTAT_KOMBIbyte3_mp "STAT_KOMBI Byte3" UBYTE OneToOne 1 100 0.00 255.0 FORMAT "%5.1" ECU_ADDRESS 0x8FF01D /end MEASUREMENT
/begin MEASUREMENT FrmMng_numSTAT_KOMBIbyte4_mp "STAT_KOMBI Byte4" UBYTE OneToOne 1 100 0.00 255.0 FORMAT "%5.1" ECU_ADDRESS 0x8FF01E /end MEASUREMENT
/begin MEASUREMENT FrmMng_numSTAT_KOMBIbyte5_mp "STAT_KOMBI Byte5" UBYTE OneToOne 1 100 0.00 255.0 FORMAT "%5.1" ECU_ADDRESS 0x8FF01F /end MEASUREMENT
/begin MEASUREMENT FrmMng_numSTAT_KOMBIbyte6_mp "STAT_KOMBI Byte6" UBYTE OneToOne 1 100 0.00 255.0 FORMAT "%5.1" ECU_ADDRESS 0x8FF020 /end MEASUREMENT
/begin MEASUREMENT FrmMng_numSTAT_KOMBIbyte7_mp "STAT_KOMBI Byte7" UBYTE OneToOne 1 100 0.00 255.0 FORMAT "%5.1" ECU_ADDRESS 0x8FF021 /end MEASUREMENT
/begin MEASUREMENT FrmMng_numTEMPRELTIMEbyte0_mp "TEMPRELTIME Byte0" UBYTE OneToOne 1 100 0.00 255.0 FORMAT "%5.1" ECU_ADDRESS 0x8FF022 /end MEASUREMENT
/begin MEASUREMENT FrmMng_numTEMPRELTIMEbyte1_mp "TEMPRELTIME Byte1" UBYTE OneToOne 1 100 0.00 255.0 FORMAT "%5.1" ECU_ADDRESS 0x8FF023 /end MEASUREMENT
/begin MEASUREMENT FrmMng_numTEMPRELTIMEbyte2_mp "TEMPRELTIME Byte2" UBYTE OneToOne 1 100 0.00 255.0 FORMAT "%5.1" ECU_ADDRESS 0x8FF024 /end MEASUREMENT
/begin MEASUREMENT FrmMng_numTEMPRELTIMEbyte3_mp "TEMPRELTIME Byte3" UBYTE OneToOne 1 100 0.00 255.0 FORMAT "%5.1" ECU_ADDRESS 0x8FF025 /end MEASUREMENT
/begin MEASUREMENT FrmMng_numTEMPRELTIMEbyte4_mp "TEMPRELTIME Byte4" UBYTE OneToOne 1 100 0.00 255.0 FORMAT "%5.1" ECU_ADDRESS 0x8FF026 /end MEASUREMENT
/begin MEASUREMENT FrmMng_numTEMPRELTIMEbyte5_mp "TEMPRELTIME Byte5" UBYTE OneToOne 1 100 0.00 255.0 FORMAT "%5.1" ECU_ADDRESS 0x8FF027 /end MEASUREMENT
/begin MEASUREMENT FrmMng_numTEMPRELTIMEbyte6_mp "TEMPRELTIME Byte6" UBYTE OneToOne 1 100 0.00 255.0 FORMAT "%5.1" ECU_ADDRESS 0x8FF028 /end MEASUREMENT
/begin MEASUREMENT FrmMng_numTERMINALbyte0_mp "Byte_x raw data in CAN-message" UBYTE OneToOne 1 100 0.00 255.0 FORMAT "%5.1" ECU_ADDRESS 0x8FF029 /end MEASUREMENT
/begin MEASUREMENT FrmMng_numTERMINALbyte1_mp "Byte_x raw data in CAN-message" UBYTE OneToOne 1 100 0.00 255.0 FORMAT "%5.1" ECU_ADDRESS 0x8FF02A /end MEASUREMENT
/begin MEASUREMENT FrmMng_numTERMINALbyte2_mp "Byte_x raw data in CAN-message" UBYTE OneToOne 1 100 0.00 255.0 FORMAT "%5.1" ECU_ADDRESS 0x8FF02B /end MEASUREMENT
/begin MEASUREMENT FrmMng_numTERMINALbyte3_mp "Byte_x raw data in CAN-message" UBYTE OneToOne 1 100 0.00 255.0 FORMAT "%5.1" ECU_ADDRESS 0x8FF02C /end MEASUREMENT
/begin MEASUREMENT FrmMng_numTERMINALbyte4_mp "Byte_x raw data in CAN-message" UBYTE OneToOne 1 100 0.00 255.0 FORMAT "%5.1" ECU_ADDRESS 0x8FF02D /end MEASUREMENT
/begin MEASUREMENT FrmMng_numTIME_DATEbyte0_mp "" UBYTE OneToOne 1 100 0.00 255.0 FORMAT "%5.1" ECU_ADDRESS 0x8FF02E /end MEASUREMENT
/begin MEASUREMENT FrmMng_numTIME_DATEbyte1_mp "" UBYTE OneToOne 1 100 0.00 255.0 FORMAT "%5.1" ECU_ADDRESS 0x8FF02F /end MEASUREMENT
/begin MEASUREMENT FrmMng_numTIME_DATEbyte2_mp "" UBYTE OneToOne 1 100 0.00 255.0 FORMAT "%5.1" ECU_ADDRESS 0x8FF030 /end MEASUREMENT
/begin MEASUREMENT FrmMng_numTIME_DATEbyte3_mp "" UBYTE OneToOne 1 100 0.00 255.0 FORMAT "%5.1" ECU_ADDRESS 0x8FF031 /end MEASUREMENT
/begin MEASUREMENT FrmMng_numTIME_DATEbyte4_mp "" UBYTE OneToOne 1 100 0.00 255.0 FORMAT "%5.1" ECU_ADDRESS 0x8FF032 /end MEASUREMENT
/begin MEASUREMENT FrmMng_numTIME_DATEbyte5_mp "" UBYTE OneToOne 1 100 0.00 255.0 FORMAT "%5.1" ECU_ADDRESS 0x8FF033 /end MEASUREMENT
/begin MEASUREMENT FrmMng_numTIME_DATEbyte6_mp "" UBYTE OneToOne 1 100 0.00 255.0 FORMAT "%5.1" ECU_ADDRESS 0x8FF034 /end MEASUREMENT
/begin MEASUREMENT FrmMng_numTORQUE1byte0_mp "Byte_0 Rohwerte in CAN-message TORQUE1" UBYTE OneToOne 1 100 0.00 255.0 FORMAT "%5.1" ECU_ADDRESS 0x8FF035 /end MEASUREMENT
/begin MEASUREMENT FrmMng_numTORQUE1byte1_mp "Byte_1 Rohwerte in CAN-Botschaft TORQUE1" UBYTE OneToOne 1 100 0.00 255.0 FORMAT "%5.1" ECU_ADDRESS 0x8FF036 /end MEASUREMENT
/begin MEASUREMENT FrmMng_numTORQUE1byte2_mp "Byte_2 Rohwerte in CAN-Botschaft TORQUE1" UBYTE OneToOne 1 100 0.00 255.0 FORMAT "%5.1" ECU_ADDRESS 0x8FF037 /end MEASUREMENT
/begin MEASUREMENT FrmMng_numTORQUE1byte3_mp "Byte_3 Rohwerte in CAN-Botschaft TORQUE1" UBYTE OneToOne 1 100 0.00 255.0 FORMAT "%5.1" ECU_ADDRESS 0x8FF038 /end MEASUREMENT
/begin MEASUREMENT FrmMng_numTORQUE1byte4_mp "Byte_4 Rohwerte in CAN-Botschaft TORQUE1" UBYTE OneToOne 1 100 0.00 255.0 FORMAT "%5.1" ECU_ADDRESS 0x8FF039 /end MEASUREMENT
/begin MEASUREMENT FrmMng_numTORQUE1byte5_mp "Byte_5 Rohwerte in CAN-Botschaft TORQUE1" UBYTE OneToOne 1 100 0.00 255.0 FORMAT "%5.1" ECU_ADDRESS 0x8FF03A /end MEASUREMENT
/begin MEASUREMENT FrmMng_numTORQUE1byte6_mp "Byte_6 Rohwerte in CAN-Botschaft TORQUE1" UBYTE OneToOne 1 100 0.00 255.0 FORMAT "%5.1" ECU_ADDRESS 0x8FF03B /end MEASUREMENT
/begin MEASUREMENT FrmMng_numTORQUE1byte7_mp "Byte_7 Rohwerte in CAN-Botschaft TORQUE1" UBYTE OneToOne 1 100 0.00 255.0 FORMAT "%5.1" ECU_ADDRESS 0x8FF03C /end MEASUREMENT
/begin MEASUREMENT FrmMng_numTORQUE2byte0_mp "Byte_0 Rohwerte in CAN-Botschaft TORQUE2" UBYTE OneToOne 1 100 0.00 255.0 FORMAT "%5.1" ECU_ADDRESS 0x8FF03D /end MEASUREMENT
/begin MEASUREMENT FrmMng_numTORQUE2byte1_mp "Byte_1 Rohwerte in CAN-Botschaft TORQUE2" UBYTE OneToOne 1 100 0.00 255.0 FORMAT "%5.1" ECU_ADDRESS 0x8FF03E /end MEASUREMENT
/begin MEASUREMENT FrmMng_numTORQUE2byte2_mp "Byte_2 Rohwerte in CAN-Botschaft TORQUE2" UBYTE OneToOne 1 100 0.00 255.0 FORMAT "%5.1" ECU_ADDRESS 0x8FF03F /end MEASUREMENT
/begin MEASUREMENT FrmMng_numTORQUE2byte3_mp "Byte_3 Rohwerte in CAN-Botschaft TORQUE2" UBYTE OneToOne 1 100 0.00 255.0 FORMAT "%5.1" ECU_ADDRESS 0x8FF040 /end MEASUREMENT
/begin MEASUREMENT FrmMng_numTORQUE2byte4_mp "Byte_4 Rohwerte in CAN-Botschaft TORQUE2" UBYTE OneToOne 1 100 0.00 255.0 FORMAT "%5.1" ECU_ADDRESS 0x8FF041 /end MEASUREMENT
/begin MEASUREMENT FrmMng_numTORQUE2byte5_mp "Byte_5 Rohwerte in CAN-Botschaft TORQUE2" UBYTE OneToOne 1 100 0.00 255.0 FORMAT "%5.1" ECU_ADDRESS 0x8FF042 /end MEASUREMENT
/begin MEASUREMENT FrmMng_numTORQUE2byte6_mp "Byte_6 Rohwerte in CAN-Botschaft TORQUE2" UBYTE OneToOne 1 100 0.00 255.0 FORMAT "%5.1" ECU_ADDRESS 0x8FF043 /end MEASUREMENT
/begin MEASUREMENT FrmMng_numTORQUE2byte7_mp "Byte_7 Rohwerte in CAN-Botschaft TORQUE2" UBYTE OneToOne 1 100 0.00 255.0 FORMAT "%5.1" ECU_ADDRESS 0x8FF044 /end MEASUREMENT
/begin MEASUREMENT FrmMng_numTORQUE3byte0_mp "Byte_0 Rohwerte in CAN-message TORQUE3" UBYTE OneToOne 1 100 0.00 255.0 FORMAT "%5.1" ECU_ADDRESS 0x8FF045 /end MEASUREMENT
/begin MEASUREMENT FrmMng_numTORQUE3byte1_mp "Byte_1 Rohwerte in CAN-Botschaft TORQUE3" UBYTE OneToOne 1 100 0.00 255.0 FORMAT "%5.1" ECU_ADDRESS 0x8FF046 /end MEASUREMENT
/begin MEASUREMENT FrmMng_numTORQUE3byte2_mp "Byte_2 Rohwerte in CAN-Botschaft TORQUE3" UBYTE OneToOne 1 100 0.00 255.0 FORMAT "%5.1" ECU_ADDRESS 0x8FF047 /end MEASUREMENT
/begin MEASUREMENT FrmMng_numTORQUE3byte3_mp "Byte_3 Rohwerte in CAN-Botschaft TORQUE3" UBYTE OneToOne 1 100 0.00 255.0 FORMAT "%5.1" ECU_ADDRESS 0x8FF048 /end MEASUREMENT
/begin MEASUREMENT FrmMng_numTORQUE3byte4_mp "Byte_4 Rohwerte in CAN-Botschaft TORQUE3" UBYTE OneToOne 1 100 0.00 255.0 FORMAT "%5.1" ECU_ADDRESS 0x8FF049 /end MEASUREMENT
/begin MEASUREMENT FrmMng_numTORQUE3byte5_mp "Byte_5 Rohwerte in CAN-Botschaft TORQUE3" UBYTE OneToOne 1 100 0.00 255.0 FORMAT "%5.1" ECU_ADDRESS 0x8FF04A /end MEASUREMENT
/begin MEASUREMENT FrmMng_numTORQUE3byte6_mp "Byte_6 Rohwerte in CAN-Botschaft TORQUE3" UBYTE OneToOne 1 100 0.00 255.0 FORMAT "%5.1" ECU_ADDRESS 0x8FF04B /end MEASUREMENT
/begin MEASUREMENT FrmMng_numTORQUE3byte7_mp "Byte_7 Rohwerte in CAN-Botschaft TORQUE3" UBYTE OneToOne 1 100 0.00 255.0 FORMAT "%5.1" ECU_ADDRESS 0x8FF04C /end MEASUREMENT
/begin MEASUREMENT FrmMng_numTORQUE_DSCbyte0_mp "Byte_x raw data in CAN-message" UBYTE OneToOne 1 100 0.00 255.0 FORMAT "%5.1" ECU_ADDRESS 0x8FF04D /end MEASUREMENT
/begin MEASUREMENT FrmMng_numTORQUE_DSCbyte1_mp "Byte_x raw data in CAN-message" UBYTE OneToOne 1 100 0.00 255.0 FORMAT "%5.1" ECU_ADDRESS 0x8FF04E /end MEASUREMENT
/begin MEASUREMENT FrmMng_numTORQUE_DSCbyte2_mp "Byte_x raw data in CAN-message" UBYTE OneToOne 1 100 0.00 255.0 FORMAT "%5.1" ECU_ADDRESS 0x8FF04F /end MEASUREMENT
/begin MEASUREMENT FrmMng_numTORQUE_DSCbyte3_mp "Byte_x raw data in CAN-message" UBYTE OneToOne 1 100 0.00 255.0 FORMAT "%5.1" ECU_ADDRESS 0x8FF050 /end MEASUREMENT
/begin MEASUREMENT FrmMng_numTORQUE_DSCbyte4_mp "Byte_x raw data in CAN-message" UBYTE OneToOne 1 100 0.00 255.0 FORMAT "%5.1" ECU_ADDRESS 0x8FF051 /end MEASUREMENT
/begin MEASUREMENT FrmMng_numTORQUE_DSCbyte5_mp "Byte_x raw data in CAN-message" UBYTE OneToOne 1 100 0.00 255.0 FORMAT "%5.1" ECU_ADDRESS 0x8FF052 /end MEASUREMENT
/begin MEASUREMENT FrmMng_numTORQUE_DSCbyte6_mp "Byte_x raw data in CAN-message" UBYTE OneToOne 1 100 0.00 255.0 FORMAT "%5.1" ECU_ADDRESS 0x8FF053 /end MEASUREMENT
/begin MEASUREMENT FrmMng_numTORQUE_DSCbyte7_mp "Byte_x raw data in CAN-message" UBYTE OneToOne 1 100 0.00 255.0 FORMAT "%5.1" ECU_ADDRESS 0x8FF054 /end MEASUREMENT
/begin MEASUREMENT FrmMng_numTORQUE_GEARBXbyte0_mp "Byte_x raw data in CAN-message" UBYTE OneToOne 1 100 0.00 255.0 FORMAT "%5.1" ECU_ADDRESS 0x8FF055 /end MEASUREMENT
/begin MEASUREMENT FrmMng_numTORQUE_GEARBXbyte1_mp "Byte_x raw data in CAN-message" UBYTE OneToOne 1 100 0.00 255.0 FORMAT "%5.1" ECU_ADDRESS 0x8FF056 /end MEASUREMENT
/begin MEASUREMENT FrmMng_numTORQUE_GEARBXbyte2_mp "Byte_x raw data in CAN-message" UBYTE OneToOne 1 100 0.00 255.0 FORMAT "%5.1" ECU_ADDRESS 0x8FF057 /end MEASUREMENT
/begin MEASUREMENT FrmMng_numTORQUE_GEARBXbyte3_mp "Byte_x raw data in CAN-message" UBYTE OneToOne 1 100 0.00 255.0 FORMAT "%5.1" ECU_ADDRESS 0x8FF058 /end MEASUREMENT
/begin MEASUREMENT FrmMng_numTORQUE_GEARBXbyte4_mp "Byte_x raw data in CAN-message" UBYTE OneToOne 1 100 0.00 255.0 FORMAT "%5.1" ECU_ADDRESS 0x8FF059 /end MEASUREMENT
/begin MEASUREMENT FrmMng_numTORQUE_GEARBXbyte5_mp "Byte_x raw data in CAN-message" UBYTE OneToOne 1 100 0.00 255.0 FORMAT "%5.1" ECU_ADDRESS 0x8FF05A /end MEASUREMENT
/begin MEASUREMENT FrmMng_numTORQUE_GEARBXbyte6_mp "Byte_x raw data in CAN-message" UBYTE OneToOne 1 100 0.00 255.0 FORMAT "%5.1" ECU_ADDRESS 0x8FF05B /end MEASUREMENT
/begin MEASUREMENT FrmMng_numTORQUE_GEARBXbyte7_mp "Byte_x raw data in CAN-message" UBYTE OneToOne 1 100 0.00 255.0 FORMAT "%5.1" ECU_ADDRESS 0x8FF05C /end MEASUREMENT
/begin MEASUREMENT FrmMng_numVEH_MODbyte0_mp "VEH_MOD Byte0" UBYTE OneToOne 1 100 0.00 255.0 FORMAT "%5.1" ECU_ADDRESS 0x8FF05D /end MEASUREMENT
/begin MEASUREMENT FrmMng_numVEH_MODbyte1_mp "VEH_MOD Byte1" UBYTE OneToOne 1 100 0.00 255.0 FORMAT "%5.1" ECU_ADDRESS 0x8FF05E /end MEASUREMENT
/begin MEASUREMENT FrmMng_numVELOCITYbyte0_mp "Byte_x raw data in CAN-message" UBYTE OneToOne 1 100 0.00 255.0 FORMAT "%5.1" ECU_ADDRESS 0x8FF05F /end MEASUREMENT
/begin MEASUREMENT FrmMng_numVELOCITYbyte1_mp "Byte_x raw data in CAN-message" UBYTE OneToOne 1 100 0.00 255.0 FORMAT "%5.1" ECU_ADDRESS 0x8FF060 /end MEASUREMENT
/begin MEASUREMENT FrmMng_numVELOCITYbyte2_mp "Byte_x raw data in CAN-message" UBYTE OneToOne 1 100 0.00 255.0 FORMAT "%5.1" ECU_ADDRESS 0x8FF061 /end MEASUREMENT
/begin MEASUREMENT FrmMng_numVELOCITYbyte3_mp "Byte_x raw data in CAN-message" UBYTE OneToOne 1 100 0.00 255.0 FORMAT "%5.1" ECU_ADDRESS 0x8FF062 /end MEASUREMENT
/begin MEASUREMENT FrmMng_numVELOCITYbyte4_mp "Byte_x raw data in CAN-message" UBYTE OneToOne 1 100 0.00 255.0 FORMAT "%5.1" ECU_ADDRESS 0x8FF063 /end MEASUREMENT
/begin MEASUREMENT FrmMng_numVELOCITYbyte5_mp "Byte_x raw data in CAN-message" UBYTE OneToOne 1 100 0.00 255.0 FORMAT "%5.1" ECU_ADDRESS 0x8FF064 /end MEASUREMENT
/begin MEASUREMENT FrmMng_numVELOCITYbyte6_mp "Byte_x raw data in CAN-message" UBYTE OneToOne 1 100 0.00 255.0 FORMAT "%5.1" ECU_ADDRESS 0x8FF065 /end MEASUREMENT
/begin MEASUREMENT FrmMng_numVELOCITYbyte7_mp "Byte_x raw data in CAN-message" UBYTE OneToOne 1 100 0.00 255.0 FORMAT "%5.1" ECU_ADDRESS 0x8FF066 /end MEASUREMENT
/begin MEASUREMENT FrmMng_numWHEEL_SPEEDbyte0_mp "Wheel Speed Rohwerte" UBYTE OneToOne 1 100 0.00 255.0 FORMAT "%5.1" ECU_ADDRESS 0x8FF067 /end MEASUREMENT
/begin MEASUREMENT FrmMng_numWHEEL_SPEEDbyte1_mp "Wheel Speed Rohwerte" UBYTE OneToOne 1 100 0.00 255.0 FORMAT "%5.1" ECU_ADDRESS 0x8FF068 /end MEASUREMENT
/begin MEASUREMENT FrmMng_numWHEEL_SPEEDbyte2_mp "Wheel Speed Rohwerte" UBYTE OneToOne 1 100 0.00 255.0 FORMAT "%5.1" ECU_ADDRESS 0x8FF069 /end MEASUREMENT
/begin MEASUREMENT FrmMng_numWHEEL_SPEEDbyte3_mp "Wheel Speed Rohwerte" UBYTE OneToOne 1 100 0.00 255.0 FORMAT "%5.1" ECU_ADDRESS 0x8FF06A /end MEASUREMENT
/begin MEASUREMENT FrmMng_numWHEEL_SPEEDbyte4_mp "Wheel Speed Rohwerte" UBYTE OneToOne 1 100 0.00 255.0 FORMAT "%5.1" ECU_ADDRESS 0x8FF06B /end MEASUREMENT
/begin MEASUREMENT FrmMng_numWHEEL_SPEEDbyte5_mp "Wheel Speed Rohwerte" UBYTE OneToOne 1 100 0.00 255.0 FORMAT "%5.1" ECU_ADDRESS 0x8FF06C /end MEASUREMENT
/begin MEASUREMENT FrmMng_numWHEEL_SPEEDbyte6_mp "Wheel Speed Rohwerte" UBYTE OneToOne 1 100 0.00 255.0 FORMAT "%5.1" ECU_ADDRESS 0x8FF06D /end MEASUREMENT
/begin MEASUREMENT FrmMng_numWHEEL_SPEEDbyte7_mp "Wheel Speed Rohwerte" UBYTE OneToOne 1 100 0.00 255.0 FORMAT "%5.1" ECU_ADDRESS 0x8FF06E /end MEASUREMENT
/begin MEASUREMENT FrmMng_pAir "Atmosphärendruck über CAN" SWORD Pres_hPa 1 100 -32768.00 32767.00 FORMAT "%8.2" ECU_ADDRESS 0x7F8CAA /end MEASUREMENT
/begin MEASUREMENT FrmMng_pBoost "Ladedruck über CAN" SWORD Pres_hPa 1 100 -32768.00 32767.00 FORMAT "%8.2" ECU_ADDRESS 0x7F8CAC /end MEASUREMENT
/begin MEASUREMENT FrmMng_rPSPSetPoint "Aktuelle Stellgröße der EKP-Regelung" SWORD Prc 1 100 -400.0000 399.9878 FORMAT "%8.4" ECU_ADDRESS 0x7F8CB4 /end MEASUREMENT
/begin MEASUREMENT FrmMng_rWaterVlv_mp "measuring point fot CTR_APE_WV" UWORD Prc 1 100 0.00 799.9878 FORMAT "%8.4" ECU_ADDRESS 0x8FF070 /end MEASUREMENT
/begin MEASUREMENT FrmMng_service_index_Byte0_mp "Byte0 of raw messagebyte of logon and logout message" UBYTE OneToOne 1 100 0.00 255.0 FORMAT "%5.1" ECU_ADDRESS 0x8FF072 /end MEASUREMENT
/begin MEASUREMENT FrmMng_service_index_Byte10_mp "Byte10 of raw messagebyte of logon and logout message" UBYTE OneToOne 1 100 0.00 255.0 FORMAT "%5.1" ECU_ADDRESS 0x8FF073 /end MEASUREMENT
/begin MEASUREMENT FrmMng_service_index_Byte11_mp "Byte11 of raw messagebyte of logon and logout message" UBYTE OneToOne 1 100 0.00 255.0 FORMAT "%5.1" ECU_ADDRESS 0x8FF074 /end MEASUREMENT
/begin MEASUREMENT FrmMng_service_index_Byte12_mp "Byte12 of raw messagebyte of logon and logout message" UBYTE OneToOne 1 100 0.00 255.0 FORMAT "%5.1" ECU_ADDRESS 0x8FF075 /end MEASUREMENT
/begin MEASUREMENT FrmMng_service_index_Byte13_mp "Byte13 of raw messagebyte of logon and logout message" UBYTE OneToOne 1 100 0.00 255.0 FORMAT "%5.1" ECU_ADDRESS 0x8FF076 /end MEASUREMENT
/begin MEASUREMENT FrmMng_service_index_Byte14_mp "Byte14 of raw messagebyte of logon and logout message" UBYTE OneToOne 1 100 0.00 255.0 FORMAT "%5.1" ECU_ADDRESS 0x8FF077 /end MEASUREMENT
/begin MEASUREMENT FrmMng_service_index_Byte1_mp "Byte1 of raw messagebyte of logon and logout message" UBYTE OneToOne 1 100 0.00 255.0 FORMAT "%5.1" ECU_ADDRESS 0x8FF078 /end MEASUREMENT
/begin MEASUREMENT FrmMng_service_index_Byte2_mp "Byte2 of raw messagebyte of logon and logout message" UBYTE OneToOne 1 100 0.00 255.0 FORMAT "%5.1" ECU_ADDRESS 0x8FF079 /end MEASUREMENT
/begin MEASUREMENT FrmMng_service_index_Byte3_mp "Byte3 of raw messagebyte of logon and logout message" UBYTE OneToOne 1 100 0.00 255.0 FORMAT "%5.1" ECU_ADDRESS 0x8FF07A /end MEASUREMENT
/begin MEASUREMENT FrmMng_service_index_Byte4_mp "Byte4 of raw messagebyte of logon and logout message" UBYTE OneToOne 1 100 0.00 255.0 FORMAT "%5.1" ECU_ADDRESS 0x8FF07B /end MEASUREMENT
/begin MEASUREMENT FrmMng_service_index_Byte5_mp "Byte5 of raw messagebyte of logon and logout message" UBYTE OneToOne 1 100 0.00 255.0 FORMAT "%5.1" ECU_ADDRESS 0x8FF07C /end MEASUREMENT
/begin MEASUREMENT FrmMng_service_index_Byte6_mp "Byte6 of raw messagebyte of logon and logout message" UBYTE OneToOne 1 100 0.00 255.0 FORMAT "%5.1" ECU_ADDRESS 0x8FF07D /end MEASUREMENT
/begin MEASUREMENT FrmMng_service_index_Byte7_mp "Byte7 of raw messagebyte of logon and logout message" UBYTE OneToOne 1 100 0.00 255.0 FORMAT "%5.1" ECU_ADDRESS 0x8FF07E /end MEASUREMENT
/begin MEASUREMENT FrmMng_service_index_Byte8_mp "Byte8 of raw messagebyte of logon and logout message" UBYTE OneToOne 1 100 0.00 255.0 FORMAT "%5.1" ECU_ADDRESS 0x8FF07F /end MEASUREMENT
/begin MEASUREMENT FrmMng_service_index_Byte9_mp "Byte9 of raw messagebyte of logon and logout message" UBYTE OneToOne 1 100 0.00 255.0 FORMAT "%5.1" ECU_ADDRESS 0x8FF080 /end MEASUREMENT
/begin MEASUREMENT FrmMng_stAC "Klimaanlagenzustand über CAN" UWORD OneToOne 1 100 0.00 65535.00 FORMAT "%8.2" ECU_ADDRESS 0x7F8CB8 /end MEASUREMENT
/begin MEASUREMENT FrmMng_stARSquit_mp "Bestaetigung ARS-Momenteneingriff" UBYTE OneToOne 1 100 0.00 255.0 FORMAT "%5.1" ECU_ADDRESS 0x8FF081 /end MEASUREMENT
/begin MEASUREMENT FrmMng_stBrk "Bremsschalterinformation über CAN" UBYTE OneToOne 1 100 0.00 255.0 FORMAT "%5.1" ECU_ADDRESS 0x7F8894 /end MEASUREMENT
/begin MEASUREMENT FrmMng_stBrk_mp "Status Bremslicht-Schalter" UBYTE OneToOne 1 100 0.00 255.0 FORMAT "%5.1" ECU_ADDRESS 0x8FF082 /end MEASUREMENT
/begin MEASUREMENT FrmMng_stCrCtl_mp "Status FGR" UBYTE OneToOne 1 100 0.00 255.0 FORMAT "%5.1" ECU_ADDRESS 0x8FF083 /end MEASUREMENT
/begin MEASUREMENT FrmMng_stCurrSig_mp "Botschaftsstatus für CODIERUNG_PM Botschaft" UWORD OneToOne 1 100 0.00 65535.00 FORMAT "%8.2" ECU_ADDRESS 0x8FF084 /end MEASUREMENT
/begin MEASUREMENT FrmMng_stCurr_byte0_mp "Rohwert von MAG_BT signal" UBYTE OneToOne 1 100 0.00 255.0 FORMAT "%5.1" ECU_ADDRESS 0x8FF086 /end MEASUREMENT
/begin MEASUREMENT FrmMng_stCurr_byte1_mp "Rohwert von QC_VEH CAN signal" UBYTE OneToOne 1 100 0.00 255.0 FORMAT "%5.1" ECU_ADDRESS 0x8FF087 /end MEASUREMENT
/begin MEASUREMENT FrmMng_stCurr_byte2_mp "Rohwert von I_SC_MAX_VEH signal" UBYTE OneToOne 1 100 0.00 255.0 FORMAT "%5.1" ECU_ADDRESS 0x8FF088 /end MEASUREMENT
/begin MEASUREMENT FrmMng_stCurr_byte3_mp "Rohwert von I_SC_MAX_VEH signal" UBYTE OneToOne 1 100 0.00 255.0 FORMAT "%5.1" ECU_ADDRESS 0x8FF089 /end MEASUREMENT
/begin MEASUREMENT FrmMng_stDebValT15CDold_mp "" UBYTE OneToOne 1 100 0.00 255.0 FORMAT "%5.1" ECU_ADDRESS 0x8FF08A /end MEASUREMENT
/begin MEASUREMENT FrmMng_stDSCquit_mp "Bestaetigung DSC-Momenteneingriff" UBYTE OneToOne 1 100 0.00 255.0 FORMAT "%5.1" ECU_ADDRESS 0x8FF08B /end MEASUREMENT
/begin MEASUREMENT FrmMng_stEng_mp "Status Motorlauf" UBYTE OneToOne 1 100 0.00 255.0 FORMAT "%5.1" ECU_ADDRESS 0x8FF08C /end MEASUREMENT
/begin MEASUREMENT FrmMng_stExcStateCan_mp "" ULONG OneToOne 1 100 0.00 4294967295.00 FORMAT "%13.2" ECU_ADDRESS 0x8FF090 /end MEASUREMENT
/begin MEASUREMENT FrmMng_stExc_BOS_RESET_2_mp "" UWORD OneToOne 1 100 0.00 65535.00 FORMAT "%8.2" ECU_ADDRESS 0x8FF094 /end MEASUREMENT
/begin MEASUREMENT FrmMng_stExc_BOS_RESET_mp "exceptionstate BOS_RESET" UWORD OneToOne 1 100 0.00 65535.00 FORMAT "%8.2" ECU_ADDRESS 0x8FF096 /end MEASUREMENT
/begin MEASUREMENT FrmMng_stExc_DM_ANF_ACC_mp "Exception state von CAN Botschaft (error & freeze)" UWORD OneToOne 1 100 0.00 65535.00 FORMAT "%8.2" ECU_ADDRESS 0x8FF098 /end MEASUREMENT
/begin MEASUREMENT FrmMng_stExc_DM_ANF_AFS_mp "Exception state von CAN Botschaft (error & freeze)" UWORD OneToOne 1 100 0.00 65535.00 FORMAT "%8.2" ECU_ADDRESS 0x8FF09A /end MEASUREMENT
/begin MEASUREMENT FrmMng_stExc_DRMANFSSG_mp "exceptionstate DRMANFSSG" UWORD OneToOne 1 100 0.00 65535.00 FORMAT "%8.2" ECU_ADDRESS 0x8FF09C /end MEASUREMENT
/begin MEASUREMENT FrmMng_stExc_GEARBX_DATA2_mp "exceptionstate GEARBX_DATA2" UWORD OneToOne 1 100 0.00 65535.00 FORMAT "%8.2" ECU_ADDRESS 0x8FF09E /end MEASUREMENT
/begin MEASUREMENT FrmMng_stExc_GEARBX_DATA_mp "exceptionstate of CAN-message ( errors, freeze, ... )" UWORD OneToOne 1 100 0.00 65535.00 FORMAT "%8.2" ECU_ADDRESS 0x8FF0A0 /end MEASUREMENT
/begin MEASUREMENT FrmMng_stExc_HEAT_AC_mp "exceptionstate of CAN-message ( errors, freeze, ... )" UWORD OneToOne 1 100 0.00 65535.00 FORMAT "%8.2" ECU_ADDRESS 0x8FF0A2 /end MEASUREMENT
/begin MEASUREMENT FrmMng_stExc_LRADWINK_mp "exceptionstate LENKRADWINKEL" UWORD OneToOne 1 100 0.00 65535.00 FORMAT "%8.2" ECU_ADDRESS 0x8FF0A4 /end MEASUREMENT
/begin MEASUREMENT FrmMng_stExc_MILEAGE_RANGE_mp "exceptionstate MILEAGE_RANGE" UWORD OneToOne 1 100 0.00 65535.00 FORMAT "%8.2" ECU_ADDRESS 0x8FF0A6 /end MEASUREMENT
/begin MEASUREMENT FrmMng_stExc_OPCRCTLACC_mp "exceptionstate OP_CRCTLACC" UWORD OneToOne 1 100 0.00 65535.00 FORMAT "%8.2" ECU_ADDRESS 0x8FF0A8 /end MEASUREMENT
/begin MEASUREMENT FrmMng_stExc_ParkConsumer_mp "exceptionstate ParkConsumer" UWORD OneToOne 1 100 0.00 65535.00 FORMAT "%8.2" ECU_ADDRESS 0x8FF0AA /end MEASUREMENT
/begin MEASUREMENT FrmMng_stExc_PRGG_CCTR_mp "exceptionstate PRGG_CCTR" UWORD OneToOne 1 100 0.00 65535.00 FORMAT "%8.2" ECU_ADDRESS 0x8FF0AC /end MEASUREMENT
/begin MEASUREMENT FrmMng_stExc_PWRMNG_LOADV_mp "" UWORD OneToOne 1 100 0.00 65535.00 FORMAT "%8.2" ECU_ADDRESS 0x8FF0AE /end MEASUREMENT
/begin MEASUREMENT FrmMng_stExc_RQ_STG_EFAN_mp "Exception state von CAN Botschaft (error & freeze)" UWORD OneToOne 1 100 0.00 65535.00 FORMAT "%8.2" ECU_ADDRESS 0x8FF0B0 /end MEASUREMENT
/begin MEASUREMENT FrmMng_stExc_SERVICE_mp "exceptionstate SERVICE" UWORD OneToOne 1 100 0.00 65535.00 FORMAT "%8.2" ECU_ADDRESS 0x8FF0B2 /end MEASUREMENT
/begin MEASUREMENT FrmMng_stExc_SITZGURT_mp "Exception State für STAT_SITZBELEGUNG_GURT" UWORD OneToOne 1 100 0.00 65535.00 FORMAT "%8.2" ECU_ADDRESS 0x8FF0B4 /end MEASUREMENT
/begin MEASUREMENT FrmMng_stExc_STAT_ANH_mp "" UWORD OneToOne 1 100 0.00 65535.00 FORMAT "%8.2" ECU_ADDRESS 0x8FF0B6 /end MEASUREMENT
/begin MEASUREMENT FrmMng_stExc_STAT_ARS_mp "exceptionstate of CAN-message ( errors, freeze, ... )" UWORD OneToOne 1 100 0.00 65535.00 FORMAT "%8.2" ECU_ADDRESS 0x8FF0B8 /end MEASUREMENT
/begin MEASUREMENT FrmMng_stExc_STAT_DSC_mp "exceptionstate of CAN-message ( errors, freeze, ... )" UWORD OneToOne 1 100 0.00 65535.00 FORMAT "%8.2" ECU_ADDRESS 0x8FF0BA /end MEASUREMENT
/begin MEASUREMENT FrmMng_stExc_STAT_EKP_mp "exceptionstate STAT_EKP" UWORD OneToOne 1 100 0.00 65535.00 FORMAT "%8.2" ECU_ADDRESS 0x8FF0BC /end MEASUREMENT
/begin MEASUREMENT FrmMng_stExc_STAT_KOMBI_mp "exceptionstate STAT_KOMB" UWORD OneToOne 1 100 0.00 65535.00 FORMAT "%8.2" ECU_ADDRESS 0x8FF0BE /end MEASUREMENT
/begin MEASUREMENT FrmMng_stExc_stCurr_mp "Exception Status von CODIERUNG_PM message" UWORD OneToOne 1 100 0.00 65535.00 FORMAT "%8.2" ECU_ADDRESS 0x8FF0C0 /end MEASUREMENT
/begin MEASUREMENT FrmMng_stExc_swtPSPOff_mp "Exception Status von CTR_CRASH_SWO_EKP message" UWORD OneToOne 1 100 0.00 65535.00 FORMAT "%8.2" ECU_ADDRESS 0x8FF0C2 /end MEASUREMENT
/begin MEASUREMENT FrmMng_stExc_TEMPRELTIME_mp "exceptionstate TEMPRELTIME" UWORD OneToOne 1 100 0.00 65535.00 FORMAT "%8.2" ECU_ADDRESS 0x8FF0C4 /end MEASUREMENT
/begin MEASUREMENT FrmMng_stExc_TERMINAL_mp "exceptionstate of CAN-message ( errors, freeze, ... )" UWORD OneToOne 1 100 0.00 65535.00 FORMAT "%8.2" ECU_ADDRESS 0x8FF0C6 /end MEASUREMENT
/begin MEASUREMENT FrmMng_stExc_TIME_DATE_mp "" UWORD OneToOne 1 100 0.00 65535.00 FORMAT "%8.2" ECU_ADDRESS 0x8FF0C8 /end MEASUREMENT
/begin MEASUREMENT FrmMng_stExc_TORQUE_DSC_mp "exceptionstate of CAN-message ( errors, freeze, ... )" UWORD OneToOne 1 100 0.00 65535.00 FORMAT "%8.2" ECU_ADDRESS 0x8FF0CA /end MEASUREMENT
/begin MEASUREMENT FrmMng_stExc_TORQUE_GEARBX_mp "exceptionstate of CAN-message ( errors, freeze, ... )" UWORD OneToOne 1 100 0.00 65535.00 FORMAT "%8.2" ECU_ADDRESS 0x8FF0CC /end MEASUREMENT
/begin MEASUREMENT FrmMng_stExc_VEH_MOD_mp "exception state for  VEH_MOD" UWORD OneToOne 1 100 0.00 65535.00 FORMAT "%8.2" ECU_ADDRESS 0x8FF0CE /end MEASUREMENT
/begin MEASUREMENT FrmMng_stExc_VELOCITY_mp "exceptionstate of CAN-message ( errors, freeze, ... )" UWORD OneToOne 1 100 0.00 65535.00 FORMAT "%8.2" ECU_ADDRESS 0x8FF0D0 /end MEASUREMENT
/begin MEASUREMENT FrmMng_stExc_WHEEL_SPEED_mp "exceptionstate WHEEL_SPEED" UWORD OneToOne 1 100 0.00 65535.00 FORMAT "%8.2" ECU_ADDRESS 0x8FF0D2 /end MEASUREMENT
/begin MEASUREMENT FrmMng_stFDC_mp "Measuring point for state of vehicle mode" UBYTE OneToOne 1 100 0.00 255.0 FORMAT "%5.1" ECU_ADDRESS 0x8FF0D4 /end MEASUREMENT
/begin MEASUREMENT FrmMng_stGearbxHtgUpAct_mp "measuring point for evluating ST_SW_WAUP signal" UBYTE OneToOne 1 100 0.00 255.0 FORMAT "%5.1" ECU_ADDRESS 0x8FF0D5 /end MEASUREMENT
/begin MEASUREMENT FrmMng_stGearbxquit_mp "Bestaetigung EGS-Momenteneingriff" UBYTE OneToOne 1 100 0.00 255.0 FORMAT "%5.1" ECU_ADDRESS 0x8FF0D6 /end MEASUREMENT
/begin MEASUREMENT FrmMng_stHtgUp_mp "status for heating up" UBYTE OneToOne 1 100 0.00 255.0 FORMAT "%5.1" ECU_ADDRESS 0x8FF0D7 /end MEASUREMENT
/begin MEASUREMENT FrmMng_stLIGov_mp "Status Low idle speed" UBYTE OneToOne 1 100 0.00 255.0 FORMAT "%5.1" ECU_ADDRESS 0x8FF0D8 /end MEASUREMENT
/begin MEASUREMENT FrmMng_stnErr_mp "Motordrehzahl-Fehler" UBYTE OneToOne 1 100 0.00 255.0 FORMAT "%5.1" ECU_ADDRESS 0x8FF0D9 /end MEASUREMENT
/begin MEASUREMENT FrmMng_stOBDGbx_mp "Measuring point for Gear Box status" UBYTE OneToOne 1 100 0.00 255.0 FORMAT "%5.1" ECU_ADDRESS 0x8FF0DA /end MEASUREMENT
/begin MEASUREMENT FrmMng_stOpPubuCctrAcc_mp "state operation push-button cruise-control ACC" UBYTE OneToOne 1 100 0.00 255.0 FORMAT "%5.1" ECU_ADDRESS 0x8FF0DB /end MEASUREMENT
/begin MEASUREMENT FrmMng_stOvrRun_mp "Status over-run-fuel-shutoff ST_INFS" UBYTE OneToOne 1 100 0.00 255.0 FORMAT "%5.1" ECU_ADDRESS 0x8FF0DC /end MEASUREMENT
/begin MEASUREMENT FrmMng_stpmsv_mp "status pmsv" UBYTE OneToOne 1 100 0.00 255.0 FORMAT "%5.1" ECU_ADDRESS 0x8FF0DD /end MEASUREMENT
/begin MEASUREMENT FrmMng_stpmsv_old_mp "status pmsv" UBYTE OneToOne 1 100 0.00 255.0 FORMAT "%5.1" ECU_ADDRESS 0x8FF0DE /end MEASUREMENT
/begin MEASUREMENT FrmMng_stPRGG_CCTRSig "signalerrorstatus-message PRGG_CCTR" UWORD OneToOne 1 100 0.00 65535.00 FORMAT "%8.2" ECU_ADDRESS 0x7F8CD8 /end MEASUREMENT
/begin MEASUREMENT FrmMng_stPSP "status der Diagnose der geregelten elektronischen Kraftstoffpumpe" UBYTE OneToOne 1 100 0.00 255.0 FORMAT "%5.1" ECU_ADDRESS 0x7F88B0 /end MEASUREMENT
/begin MEASUREMENT FrmMng_stRmp_mp "current ramp state overrun shutoff" UBYTE OneToOne 1 100 0.00 255.0 FORMAT "%5.1" ECU_ADDRESS 0x8FF0DF /end MEASUREMENT
/begin MEASUREMENT FrmMng_stShutOffHtgUp_mp "Status der Heizung abgestellt" UBYTE OneToOne 1 100 0.00 255.0 FORMAT "%5.1" ECU_ADDRESS 0x8FF0E0 /end MEASUREMENT
/begin MEASUREMENT FrmMng_stSLckAdjVal_mp "Adjustment value for status of steering lock" UBYTE OneToOne 1 100 0.00 255.0 FORMAT "%5.1" ECU_ADDRESS 0x8FF0E1 /end MEASUREMENT
/begin MEASUREMENT FrmMng_stSLck_mp "Status of steering lock" UBYTE OneToOne 1 100 0.00 255.0 FORMAT "%5.1" ECU_ADDRESS 0x8FF0E2 /end MEASUREMENT
/begin MEASUREMENT FrmMng_stSwClt_mp "status of clutch" UBYTE OneToOne 1 100 0.00 255.0 FORMAT "%5.1" ECU_ADDRESS 0x8FF0E3 /end MEASUREMENT
/begin MEASUREMENT FrmMng_stSwLevRpm_mp "Status switch level RPM ST_SW_LEV_RPM" UBYTE OneToOne 1 100 0.00 255.0 FORMAT "%5.1" ECU_ADDRESS 0x8FF0E4 /end MEASUREMENT
/begin MEASUREMENT FrmMng_stTrqDisable_mp "state overrun shut off" SBYTE OneToOne 1 100 -128.0 127.0 FORMAT "%5.1" ECU_ADDRESS 0x8FF0E5 /end MEASUREMENT
/begin MEASUREMENT FrmMng_stTrqInr_mp "Status Drehmoment aktueller Wert" UBYTE OneToOne 1 100 0.00 255.0 FORMAT "%5.1" ECU_ADDRESS 0x8FF0E6 /end MEASUREMENT
/begin MEASUREMENT FrmMng_stTxRequest "" UWORD CarType 1 100 0.00 2.00000000000 FORMAT "%13.11" ECU_ADDRESS 0x7F8CFC /end MEASUREMENT
/begin MEASUREMENT FrmMng_stWHEEL_SPEEDSig_mp "Signalfehler der Can Botschaft Wheel Speed" UWORD OneToOne 1 100 0.00 65535.00 FORMAT "%8.2" ECU_ADDRESS 0x8FF0E8 /end MEASUREMENT
/begin MEASUREMENT FrmMng_swtAC_mp "Schalter Klimakompressor" UBYTE OneToOne 1 100 0.00 255.0 FORMAT "%5.1" ECU_ADDRESS 0x6F815C /end MEASUREMENT
/begin MEASUREMENT FrmMng_swtCarType "" UBYTE CarType 1 100 0.00 2.00000000000 FORMAT "%13.11" ECU_ADDRESS 0x7F88CD /end MEASUREMENT
/begin MEASUREMENT FrmMng_swtPSPOffSig_mp "Botschaftsstatus für CTR_CRASH_SWO_EKP Botschaft" UWORD OneToOne 1 100 0.00 65535.00 FORMAT "%8.2" ECU_ADDRESS 0x8FF0EA /end MEASUREMENT
/begin MEASUREMENT FrmMng_swtPSPOff_byte0_mp "Rohwert von CTR_CRASH_SWO_EKP signal" UBYTE OneToOne 1 100 0.00 255.0 FORMAT "%5.1" ECU_ADDRESS 0x8FF0EC /end MEASUREMENT
/begin MEASUREMENT FrmMng_tAir "Ansauglufttemperatur über CAN" SWORD Temp_Cels 1 100 -50.140 899.860 FORMAT "%8.3" ECU_ADDRESS 0x7F8D02 /end MEASUREMENT
/begin MEASUREMENT FrmMng_tClnt "Kühlmitteltemperatur" SWORD Temp_Cels 1 100 -50.140 899.860 FORMAT "%8.3" ECU_ADDRESS 0x7F8D06 /end MEASUREMENT
/begin MEASUREMENT FrmMng_tEngRpm_mp "temperature adjusted to a resolution of  approx. 1 deg C  for engine rpm calculation" SWORD Temp_Cels 1 100 -50.140 899.860 FORMAT "%8.3" ECU_ADDRESS 0x8FF0EE /end MEASUREMENT
/begin MEASUREMENT FrmMng_tEnv "Umgebungstemperatur" SWORD Temp_Cels 1 100 -50.140 899.860 FORMAT "%8.3" ECU_ADDRESS 0x7F8D08 /end MEASUREMENT
/begin MEASUREMENT FrmMng_tiDayCouAbsl "day counter" UWORD OneToOne 1 100 0.00 65535.00 FORMAT "%8.2" ECU_ADDRESS 0x7F8D0C /end MEASUREMENT
/begin MEASUREMENT FrmMng_tiRecACC_mp "Time elapsed for the self recognition of ACC" UWORD Time_ms 1 100 0.00 655350.0 FORMAT "%8.1" ECU_ADDRESS 0x8FF0F0 /end MEASUREMENT
/begin MEASUREMENT FrmMng_tiRecAC_mp "" UWORD Time_ms 1 100 0.00 655350.0 FORMAT "%8.1" ECU_ADDRESS 0x8FF0F2 /end MEASUREMENT
/begin MEASUREMENT FrmMng_tiRecAFS_mp "Time elapsed for the self recognition of AFS" UWORD Time_ms 1 100 0.00 655350.0 FORMAT "%8.1" ECU_ADDRESS 0x8FF0F4 /end MEASUREMENT
/begin MEASUREMENT FrmMng_tiRecARS_mp "Error Counter for ARS recognition" UBYTE Time_ms 1 100 0.00 2550. FORMAT "%5.0" ECU_ADDRESS 0x8FF0F6 /end MEASUREMENT
/begin MEASUREMENT FrmMng_tiRecFGR_mp "Time elapsed for the self recognition of FGR" UWORD Time_ms 1 100 0.00 655350.0 FORMAT "%8.1" ECU_ADDRESS 0x8FF0F8 /end MEASUREMENT
/begin MEASUREMENT FrmMng_tmrDSMFadeoutTERMINAL_mp "Timer for measuring Fadeout of TERMINAL frame" UWORD OneToOne 1 100 0.00 65535.00 FORMAT "%8.2" ECU_ADDRESS 0x8FF0FA /end MEASUREMENT
/begin MEASUREMENT FrmMng_tmrDSMToTERMINAL_mp "Timer for measuring Timeout of TERMINAL frame" UWORD OneToOne 1 100 0.00 65535.00 FORMAT "%8.2" ECU_ADDRESS 0x8FF0FC /end MEASUREMENT
/begin MEASUREMENT FrmMng_torque1RetVal_mp "" UBYTE OneToOne 1 100 0.00 255.0 FORMAT "%5.1" ECU_ADDRESS 0x8FF0FE /end MEASUREMENT
/begin MEASUREMENT FrmMng_torque2RetVal_mp "" UBYTE OneToOne 1 100 0.00 255.0 FORMAT "%5.1" ECU_ADDRESS 0x8FF0FF /end MEASUREMENT
/begin MEASUREMENT FrmMng_torque3RetVal_mp "" UBYTE OneToOne 1 100 0.00 255.0 FORMAT "%5.1" ECU_ADDRESS 0x8FF100 /end MEASUREMENT
/begin MEASUREMENT FrmMng_trqACC_TrqDes_mp "Angefordertes ACC-Moment vor Hinzufügung von Gearbx_trqFrc" SWORD Trq 1 100 -3276.800 3276.700 FORMAT "%8.3" ECU_ADDRESS 0x8FF102 /end MEASUREMENT
/begin MEASUREMENT FrmMng_trqBefRmp_mp "current inner set torque before overrun shut off" SWORD Trq 1 100 -3276.800 3276.700 FORMAT "%8.3" ECU_ADDRESS 0x8FF104 /end MEASUREMENT
/begin MEASUREMENT FrmMng_trqDCS "vom MSR gefordertes Getriebeausgangsmoment" SWORD Trq 1 100 -3276.800 3276.700 FORMAT "%8.3" ECU_ADDRESS 0x7F8D1A /end MEASUREMENT
/begin MEASUREMENT FrmMng_trqDes_mp "Driver request torque for CAN [Nm] <SBYTE>" SWORD Trq 1 100 -3276.800 3276.700 FORMAT "%8.3" ECU_ADDRESS 0x8FF106 /end MEASUREMENT
/begin MEASUREMENT FrmMng_trqDSCDes_mp "Drehmoment Soll DSC vor Hinzufügung von Gearbx_trqFrc" SWORD Trq 1 100 -3276.800 3276.700 FORMAT "%8.3" ECU_ADDRESS 0x8FF108 /end MEASUREMENT
/begin MEASUREMENT FrmMng_trqFMTCInr_mp "Incremental torque" SWORD Trq 1 100 -3276.800 3276.700 FORMAT "%8.3" ECU_ADDRESS 0x8FF10A /end MEASUREMENT
/begin MEASUREMENT FrmMng_trqGbx "Torque set value from Gearbox" SWORD Trq 1 100 -3276.800 3276.700 FORMAT "%8.3" ECU_ADDRESS 0x7F8D22 /end MEASUREMENT
/begin MEASUREMENT FrmMng_trqGbx_mp "Engine torque without MMT" SWORD Trq 1 100 -3276.800 3276.700 FORMAT "%8.3" ECU_ADDRESS 0x8FF10C /end MEASUREMENT
/begin MEASUREMENT FrmMng_trqGearbxMax_mp "maximum Gear Box torque" SWORD Trq 1 100 -3276.800 3276.700 FORMAT "%8.3" ECU_ADDRESS 0x8FF10E /end MEASUREMENT
/begin MEASUREMENT FrmMng_trqInrGearbxOut_mp "Kurbelwellen-Drehmoment ohne EGS-Engriff" SWORD Trq 1 100 -3276.800 3276.700 FORMAT "%8.3" ECU_ADDRESS 0x8FF110 /end MEASUREMENT
/begin MEASUREMENT FrmMng_trqInrSet_mp "output torque value" SWORD Trq 1 100 -3276.800 3276.700 FORMAT "%8.3" ECU_ADDRESS 0x8FF112 /end MEASUREMENT
/begin MEASUREMENT FrmMng_trqMax_mp "Normiertes und begrenztes maximales Motormoment" SWORD Trq 1 100 -3276.800 3276.700 FORMAT "%8.3" ECU_ADDRESS 0x8FF114 /end MEASUREMENT
/begin MEASUREMENT FrmMng_trqMin_mp "Normiertes und begrenztes minimales Motormoment" SWORD Trq 1 100 -3276.800 3276.700 FORMAT "%8.3" ECU_ADDRESS 0x8FF116 /end MEASUREMENT
/begin MEASUREMENT FrmMng_trqResPos_mp "torque actual-value spare positive" SWORD Trq 1 100 -3276.800 3276.700 FORMAT "%8.3" ECU_ADDRESS 0x8FF118 /end MEASUREMENT
/begin MEASUREMENT FrmMng_trqRmp_mp "current ramp output torque" SWORD Trq 1 100 -3276.800 3276.700 FORMAT "%8.3" ECU_ADDRESS 0x8FF11A /end MEASUREMENT
/begin MEASUREMENT FrmMng_trqSet_mp "Torque setpoint value" SWORD Trq 1 100 -3276.800 3276.700 FORMAT "%8.3" ECU_ADDRESS 0x8FF11C /end MEASUREMENT
/begin MEASUREMENT FrmMng_trqTCS "vom ASR gefordertes Getriebeausgangsmoment" SWORD Trq 1 100 -3276.800 3276.700 FORMAT "%8.3" ECU_ADDRESS 0x7F8D30 /end MEASUREMENT
/begin MEASUREMENT FrmMng_vPrgNo1 "velocity No. 0,3,6,9,12" UWORD vfzg_uw_b512 1 100 0.00 511.9922 FORMAT "%8.4" ECU_ADDRESS 0x7F8D3E /end MEASUREMENT
/begin MEASUREMENT FrmMng_vPrgNo2 "velocity No. 1,4,7,10,13" UWORD vfzg_uw_b512 1 100 0.00 511.9922 FORMAT "%8.4" ECU_ADDRESS 0x7F8D40 /end MEASUREMENT
/begin MEASUREMENT FrmMng_vPrgNo3 "velocity No. 2,5,8,11,14" UWORD vfzg_uw_b512 1 100 0.00 511.9922 FORMAT "%8.4" ECU_ADDRESS 0x7F8D42 /end MEASUREMENT
/begin FUNCTION frmmng "CAN Message Frames für Übertragung und Empfang"
 /begin DEF_CHARACTERISTIC FrmMng_ACCSelfRec_C FrmMng_ACSelfRec_C FrmMng_aDirectDef_C FrmMng_AFSSelfRec_C FrmMng_ARSSelfRec_C FrmMng_aSideDef_C FrmMng_cnvAccmLimTrq_Offset_C FrmMng_cnvAccmLimTrq_Slope_C FrmMng_cnvACCtrq_Offset_C FrmMng_cnvACCtrq_Slope_C FrmMng_cnvAVA_DSC_Offset_C FrmMng_cnvAVA_DSC_Slope_C FrmMng_cnvLN_DSC_Offset_C FrmMng_cnvLN_DSC_Slope_C FrmMng_cnvAFStrq_Offset_C FrmMng_cnvAFStrq_Slope_C FrmMng_cnvAipEng_Offset_C FrmMng_cnvAipEng_Slope_C FrmMng_cnvAngAcpd_Offset_C FrmMng_cnvAngAcpd_Slope_C FrmMng_cnvARStrq_Offset_C FrmMng_cnvARStrq_Slope_C FrmMng_cnvdLRADWINKStrg_Offset_C FrmMng_cnvdLRADWINKStrg_Slope_C FrmMng_cnvDSCtrq_Offset_C FrmMng_cnvDSCtrq_Slope_C FrmMng_cnvIjvFu_Offset_C FrmMng_cnvIjvFu_Slope_C FrmMng_cnvKOMBIv_Offset_C FrmMng_cnvKOMBIv_Slope_C FrmMng_cnvLimRpmEng_Offset_C FrmMng_cnvLimRpmEng_Slope_C FrmMng_cnvLRADWINKStrg_Offset_C FrmMng_cnvLRADWINKStrg_Slope_C FrmMng_cnvnEngRpm_Offset_C FrmMng_cnvnEngRpm_Slope_C FrmMng_cnvnSetpoint_Offset_C FrmMng_cnvnSetpoint_Slope_C FrmMng_cnvrHtFlow_Offset_C FrmMng_cnvrHtFlow_Slope_C FrmMng_cnvRpmEng_Offset_C FrmMng_cnvRpmEng_Slope_C FrmMng_cnvRPM_GRB_TURB_Offset_C FrmMng_cnvRPM_GRB_TURB_Slope_C FrmMng_cnvRqamFu_Offset_C FrmMng_cnvRqamFu_Slope_C FrmMng_cnvrWaterVlv_Offset_C FrmMng_cnvrWaterVlv_Slope_C FrmMng_cnvTempEng_Offset_C FrmMng_cnvTempEng_Slope_C FrmMng_cnvtOil_Offset_C FrmMng_cnvtOil_Slope_C FrmMng_cnvTrqAvl_Offset_C FrmMng_cnvTrqAvl_Slope_C FrmMng_cnvTrqDvch_Offset_C FrmMng_cnvTrqDvch_Slope_C FrmMng_cnvtrq_Offset_C FrmMng_cnvtrq_Slope_C FrmMng_cnvvMrk_Offset_C FrmMng_cnvvMrk_Slope_C FrmMng_cnvV_VEH_Offset_C FrmMng_cnvV_VEH_Slope_C FrmMng_cnv_BattCls_Offset_C FrmMng_cnv_BattCls_Slope_C FrmMng_cnv_HiLimCurr_Offset_C FrmMng_cnv_HiLimCurr_Slope_C FrmMng_cnv_LoLimCurr_Offset_C FrmMng_cnv_LoLimCurr_Slope_C FrmMng_cnv_ZrCurrLim_Offset_C FrmMng_cnv_ZrCurrLim_Slope_C FrmMng_ctDebAlvDMANFAFSDef_C FrmMng_ctDebAlvDMANFAFSOk_C FrmMng_ctDebAlvDRMANFSSGDef_C FrmMng_ctDebAlvDRMANFSSGOk_C FrmMng_ctDebCsDMANFAFSDef_C FrmMng_ctDebCsDMANFAFSOk_C FrmMng_ctDebCsDRMANFSSGDef_C FrmMng_ctDebCsDRMANFSSGOk_C FrmMng_ctDebSigDMANFAFSDef_C FrmMng_ctDebSigDMANFAFSOk_C FrmMng_ctDebSigDRMANFSSGDef_C FrmMng_ctDebSigDRMANFSSGOk_C FrmMng_ctDebSigLRADWINKDef_C FrmMng_ctDebSigLRADWINKOk_C FrmMng_ctDebSigstCurrDef_C FrmMng_ctDebSigstCurrOk_C FrmMng_ctDebSigswtPSPOffDef_C FrmMng_ctDebSigswtPSPOffOk_C FrmMng_ctDebToDMANFAFSDef_C FrmMng_ctDebToDMANFAFSOk_C FrmMng_ctDebToDRMANFSSGDef_C FrmMng_ctDebToDRMANFSSGOk_C FrmMng_ctDebToLRADWINKDef_C FrmMng_ctDebToLRADWINKOk_C FrmMng_ctDebTostCurrDef_C FrmMng_ctDebTostCurrOk_C FrmMng_ctDebToswtPSPOffDef_C FrmMng_ctDebToswtPSPOffOk_C FrmMng_ctrRelDef_C FrmMng_cnvCTR_GEN_U_TAR_Offset_C FrmMng_cnvCTR_GEN_U_TAR_Slope_C FrmMng_DebACTrqDef_C FrmMng_DebACTrqOk_C FrmMng_DebAlvDMOMENT_ACCDef_C FrmMng_DebAlvDMOMENT_ACCOk_C FrmMng_DebAlvOPCRCTLACCDef_C FrmMng_DebAlvOPCRCTLACCOk_C FrmMng_DebAlvSTAT_ARSDef_C FrmMng_DebAlvSTAT_ARSOk_C FrmMng_DebAlvSTAT_KOMBIDef_C FrmMng_DebAlvSTAT_KOMBIOk_C FrmMng_DebAlvTERMINALDef_C FrmMng_DebAlvTERMINALOk_C FrmMng_DebAlvTORQUE_DSCDef_C FrmMng_DebAlvTORQUE_DSCOk_C FrmMng_DebAlvTORQUE_GEARBXDef_C FrmMng_DebAlvTORQUE_GEARBXOk_C FrmMng_DebAlvVEH_MODDef_C FrmMng_DebAlvVEH_MODOk_C FrmMng_DebCsDMOMENT_ACCDef_C FrmMng_DebCsDMOMENT_ACCOk_C FrmMng_DebCsOPCRCTLACCDef_C FrmMng_DebCsOPCRCTLACCOk_C FrmMng_DebCsTERMINALDef_C FrmMng_DebCsTERMINALOk_C FrmMng_DebCsTORQUE_DSCDef_C FrmMng_DebCsTORQUE_DSCOk_C FrmMng_DebCsTORQUE_GEARBXDef_C FrmMng_DebCsTORQUE_GEARBXOk_C FrmMng_DebCsVEH_MODDef_C FrmMng_DebCsVEH_MODOk_C FrmMng_DebSigBOS_RESET_2Def_C FrmMng_DebSigBOS_RESET_2Ok_C FrmMng_DebSigBOS_RESETDef_C FrmMng_DebSigBOS_RESETOk_C FrmMng_DebSigDMOMENT_ACCDef_C FrmMng_DebSigDMOMENT_ACCOk_C FrmMng_DebSigGEARBX_DATA2Def_C FrmMng_DebSigGEARBX_DATA2Ok_C FrmMng_DebSigGEARBX_DATADef_C FrmMng_DebSigGEARBX_DATAOk_C FrmMng_DebSigHEAT_ACDef_C FrmMng_DebSigHEAT_ACOk_C FrmMng_DebSigMILEAGE_RANGEDef_C FrmMng_DebSigMILEAGE_RANGEOk_C FrmMng_DebSigOPCRCTLACCDef_C FrmMng_DebSigOPCRCTLACCOk_C FrmMng_DebSigParkConsumerDef_C FrmMng_DebSigParkConsumerOk_C FrmMng_DebSigPRGG_CCTRDef_C FrmMng_DebSigPRGG_CCTROk_C FrmMng_DebSigPWRMNG_LOADVDef_C FrmMng_DebSigPWRMNG_LOADVOk_C FrmMng_DebSigRQ_STG_EFANDef_C FrmMng_DebSigRQ_STG_EFANOk_C FrmMng_ctDebSigSITZGURTDef_C FrmMng_ctDebSigSITZGURTOk_C FrmMng_DebSigSTAT_ANHDef_C FrmMng_DebSigSTAT_ANHOk_C FrmMng_DebSigSTAT_ARSDef_C FrmMng_DebSigSTAT_ARSOk_C FrmMng_DebSigSTAT_DSCDef_C FrmMng_DebSigSTAT_DSCOk_C FrmMng_DebSigSTAT_EKPDef_C FrmMng_DebSigSTAT_EKPOk_C FrmMng_DebSigSTAT_KOMBIDef_C FrmMng_DebSigSTAT_KOMBIOk_C FrmMng_ctDebOBDGbxMilOfDef_C FrmMng_ctDebSigStOBDGbxMilOfOk_C FrmMng_ctDebOBDGbxMilOnDef_C FrmMng_ctDebSigStOBDGbxMilOnOk_C FrmMng_DebSigTEMPRELTIMEDef_C FrmMng_DebSigTEMPRELTIMEOk_C FrmMng_DebSigTERMINALDef_C FrmMng_DebSigTERMINALOk_C FrmMng_DebSigTIME_DATEDef_C FrmMng_DebSigTIME_DATEOk_C FrmMng_DebSigTORQUE_DSCDef_C FrmMng_DebSigTORQUE_DSCOk_C FrmMng_DebSigTORQUE_GEARBXDef_C FrmMng_DebSigTORQUE_GEARBXOk_C FrmMng_DebSigVEH_MODDef_C FrmMng_DebSigVEH_MODOk_C FrmMng_DebSigVELOCITYDef_C FrmMng_DebSigVELOCITYOk_C FrmMng_ctDebSigWHEEL_SPEEDDef_C FrmMng_ctDebSigWHEEL_SPEEDOk_C FrmMng_DebTGearbxDef_C FrmMng_DebTGearbxOk_C FrmMng_DebToBOS_RESET_2Def_C FrmMng_DebToBOS_RESET_2Ok_C FrmMng_DebToBOS_RESETDef_C FrmMng_DebToBOS_RESETOk_C FrmMng_DebToDMOMENT_ACCDef_C FrmMng_DebToDMOMENT_ACCOk_C FrmMng_DebToGEARBX_DATA2Def_C FrmMng_DebToGEARBX_DATA2Ok_C FrmMng_DebToGEARBX_DATADef_C FrmMng_DebToGEARBX_DATAOk_C FrmMng_DebToHEAT_ACDef_C FrmMng_DebToHEAT_ACOk_C FrmMng_DebToMILEAGE_RANGEDef_C FrmMng_DebToMILEAGE_RANGEOk_C FrmMng_DebToOPCRCTLACCDef_C FrmMng_DebToOPCRCTLACCOk_C FrmMng_DebToParkConsumerDef_C FrmMng_DebToParkConsumerOk_C FrmMng_DebToPRGG_CCTRDef_C FrmMng_DebToPRGG_CCTROk_C FrmMng_DebToPWRMNG_LOADVDef_C FrmMng_DebToPWRMNG_LOADVOk_C FrmMng_DebToRQ_STG_EFANDef_C FrmMng_DebToRQ_STG_EFANOk_C FrmMng_ctDebToSITZGURTDef_C FrmMng_ctDebToSITZGURTOk_C FrmMng_DebToSTAT_ANHDef_C FrmMng_DebToSTAT_ANHOk_C FrmMng_DebToSTAT_ARSDef_C FrmMng_DebToSTAT_ARSOk_C FrmMng_DebToSTAT_DSCDef_C FrmMng_DebToSTAT_DSCOk_C FrmMng_DebToSTAT_EKPDef_C FrmMng_DebToSTAT_EKPOk_C FrmMng_DebToSTAT_KOMBIDef_C FrmMng_DebToSTAT_KOMBIOk_C FrmMng_DebToTEMPRELTIMEDef_C FrmMng_DebToTEMPRELTIMEOk_C FrmMng_DebToTERMINALDef_C FrmMng_DebToTERMINALOk_C FrmMng_DebToTIME_DATEDef_C FrmMng_DebToTIME_DATEOk_C FrmMng_DebToTORQUE_DSCDef_C FrmMng_DebToTORQUE_DSCOk_C FrmMng_DebToTORQUE_GEARBXDef_C FrmMng_DebToTORQUE_GEARBXOk_C FrmMng_DebToVEH_MODDef_C FrmMng_DebToVEH_MODOk_C FrmMng_DebToVELOCITYDef_C FrmMng_DebToVELOCITYOk_C FrmMng_ctDebToWHEEL_SPEEDDef_C FrmMng_ctDebToWHEEL_SPEEDOk_C FrmMng_drAPP1Min_C FrmMng_dstGear_C FrmMng_factrqInrStrt_C FrmMng_FDCSelfRec_C FrmMng_FGRSelfRec_C FrmMng_cnvFLLV_FUTA_Offset_C FrmMng_cnvFLLV_FUTA_Slope_C FrmMng_mskDM_ANF_ACC_0x800_C FrmMng_mskDM_ANF_AFS_C FrmMng_mskDM_ANF_SSG_C FrmMng_mskSTAT_ARS_C FrmMng_mskTORQUE_DSC_C FrmMng_mskTORQUE_GEARBX_C FrmMng_nEngOFF_C FrmMng_nEngRpm1_CUR FrmMng_nEngRpm2_CUR FrmMng_nFanDflt_C FrmMng_nFan_CUR FrmMng_nHtgUpActMax_C FrmMng_nHtgUpCrCtlMax_C FrmMng_nLIGovOffs_C FrmMng_nLimSSGErr_C FrmMng_cnvnPSPSpd_Offset_C FrmMng_cnvnPSPSpd_Slope_C FrmMng_nRqStgEFan_CUR FrmMng_numACFanDesDef_C FrmMng_numCCAddLevlFlsh_C FrmMng_numCCAddLevlNum_C FrmMng_numCCBrkDefFlsh_C FrmMng_numCCBrkDefNum_C FrmMng_numCCbtnachFlsh_C FrmMng_numCCbtnachNum_C FrmMng_numCCbttdfkFlsh_C FrmMng_numCCbttdfkNum_C FrmMng_numCCbttkntFlsh_C FrmMng_numCCbttkntNum_C FrmMng_numCCGenDef2Flsh_C FrmMng_numCCGenDef2Num_C FrmMng_numCCNoCrCtlFlsh_C FrmMng_numCCNoCrCtlNum_C FrmMng_numCCOelLevlFlsh_C FrmMng_numCCOelLevlNum_C FrmMng_numCCOelVerbFlsh_C FrmMng_numCCOelVerbNum_C FrmMng_numCCOelVerlFlsh_C FrmMng_numCCOelVerlNum_C FrmMng_numCCOilPresFlsh_C FrmMng_numCCOilPresNum_C FrmMng_numCCOvrTem2Flsh_C FrmMng_numCCOvrTem2Num_C FrmMng_numCCOvrTempFlsh_C FrmMng_numCCOvrTempNum_C FrmMng_numCCPFltDefFlsh_C FrmMng_numCCPFltDefNum_C FrmMng_numCCpmerrFlsh_C FrmMng_numCCpmerrNum_C FrmMng_numCCPreGlowFlsh_C FrmMng_numCCPreGlowNum_C FrmMng_numCCprioFlsh_C FrmMng_numCCprioNum_C FrmMng_numCCruhverFlsh_C FrmMng_numCCruhverNum_C FrmMng_numCCStatMilFlsh_C FrmMng_numCCStatMilLmpTstFlsh_C FrmMng_numCCStatMilLmpTstNum_C FrmMng_numCCStatMilNum_C FrmMng_numCCSysLampFlsh_C FrmMng_numCCSysLampNum_C FrmMng_numInqyID_C FrmMng_numRecACCMax_C FrmMng_numRecACMax_C FrmMng_numRecAFSMax_C FrmMng_numRecARSMax_C FrmMng_numRecFDCMax_C FrmMng_numRecFGRMax_C FrmMng_dtrqOvrRunRmpUp_C FrmMng_dtrqOvrRunRmpDwn_C FrmMng_qOvrRun_C FrmMng_cnvrPSPSetPoint_Offset_C FrmMng_cnvrPSPSetPoint_Slope_C FrmMng_rWaterVlvClose_C FrmMng_rWaterVlvCtl_C FrmMng_rWaterVlvOpen_C FrmMng_stBltbDrDef_C FrmMng_stClCtrDEF_C FrmMng_stConvErr_C FrmMng_stFDC_C FrmMng_stGbxErr_C Frmmng_stGearbxHtgUpActMsk_C Frmmng_stGearHtgUpAct_C FrmMng_stKeyVldDef_C FrmMng_stRgnHtgUp_C FrmMng_stT15Def_C FrmMng_stT50Def_C FrmMng_Sttorqavl_Errval_C FrmMng_stTRadioDef_C FrmMng_stWghSeatDrDef_C FrmMng_swtANFRAGE_C FrmMng_swtASDdc_C FrmMng_swtBOS_Oil_2_C FrmMng_swtBOS_Oil_C FrmMng_swtBOS_PFlt_C FrmMng_swtBOS_RESET_2_C FrmMng_swtBOS_RESET_C FrmMng_swtCalcV_C FrmMng_swtCarType_C FrmMng_swtCCMsg_C FrmMng_swtCCNoCrCtl_C FrmMng_swtCorTrqACC_C FrmMng_swtCorTrqDSC_C FrmMng_swtDMOMENT_ACC_C FrmMng_swtDM_ANF_AFS_C FrmMng_swtDRMANFSSG_C FrmMng_swtELKTR_M_OEL_MESS_C FrmMng_swtENGINE1_C FrmMng_swtENGINE_RPM_C FrmMng_swtEngRpmTempSel_C FrmMng_swtFDC_C FrmMng_swtGEARBX_DATA2_C FrmMng_swtGEARBX_DATA_C FrmMng_swtHEATINGCURRENT_C FrmMng_swtHEAT_AC_C FrmMng_swtLENKRADWINKEL_C FrmMng_swtMILEAGE_RANGE_C FrmMng_swtOPCRCTLACC_C FrmMng_swtParkConsumer_C FrmMng_swtPlausOn_C FrmMng_swtPOWERMGMTBATTSP_C FrmMng_swtPRGG_CCTR_C FrmMng_swtPSPOffErr_C FrmMng_swtPSPOff_C FrmMng_swtPWRMNG_CTR_COS_C FrmMng_swtPWRMNG_LOADV_C FrmMng_swtRPM_STA_C FrmMng_swtRQ_STG_EFAN_C FrmMng_swtSITZGURT_C FrmMng_swtSPEED_CLCTR_C FrmMng_swtSTAT_ANH_C FrmMng_swtSTAT_ARS_C FrmMng_swtSTAT_DSC_C FrmMng_swtSTAT_EKP_C FrmMng_swtSTAT_KOMBI_C FrmMng_swtstCurr_C FrmMng_swtTEMPRELTIME_C FrmMng_swtTERMINAL_C FrmMng_swtTIME_DATE_C FrmMng_swtTORQUE1_C FrmMng_swtTORQUE2_C FrmMng_swtTORQUE3_C FrmMng_swtTORQUE_DSC_C FrmMng_swtTORQUE_GEARBX_C FrmMng_swtVEH_MOD_C FrmMng_swtVELOCITY_C FrmMng_swtWHEEL_SPEED_C FrmMng_cnvTEMP_EX_Offset_C FrmMng_cnvTEMP_EX_Slope_C FrmMng_tEngLimHi_C FrmMng_tEngLimLo_C FrmMng_tEnvDef_C FrmMng_tiCCAddLevlCycle_C FrmMng_tiCCBrkDefCycle_C FrmMng_tiCCbtnachCycle_C FrmMng_tiCCbttdfkCycle_C FrmMng_tiCCbttkntCycle_C FrmMng_tiCCGenDef2Cycle_C FrmMng_tiCCNoCrCtlCycle_C FrmMng_tiCCOelLevlCycle_C FrmMng_tiCCOelVerbCycle_C FrmMng_tiCCOelVerlCycle_C FrmMng_tiCCOilPresCycle_C FrmMng_tiCCOvrTem2Cycle_C FrmMng_tiCCOvrTempCycle_C FrmMng_tiCCPFltDefCycle_C FrmMng_tiCCpmerrCycle_C FrmMng_tiCCPreGlowCycle_C FrmMng_tiCCprioCycle_C FrmMng_tiCCruhverCycle_C FrmMng_tiCCStatMilCycle_C FrmMng_tiCCStatMilLmpTstCycle_C FrmMng_tiCCSysLampCycle_C FrmMng_tiCCTxDeb_C FrmMng_tiDebARS_C FrmMng_tiDebDSC_C FrmMng_tiDebEGS_C FrmMng_tiDebHtgUpShutOff_C FrmMng_tiDebHtgUpShutOn_C FrmMng_tiDebSSGDebCltTO_C FrmMng_tiDebSSGErrDef_C FrmMng_tiDebSSGErrOk_C FrmMng_tiDebSSGShftPla_C FrmMng_tiDebSSGShOffDef_C FrmMng_tiDebSSGShOffOk_C FrmMng_tiDebSSGTrqIncPla_C FrmMng_tiRecACCMax_C FrmMng_tiRecACMax_C FrmMng_tiRecAFSMax_C FrmMng_tiRecARSMax_C FrmMng_tiRecFDCMax_C FrmMng_tiRecFGRMax_C FrmMng_tiStartDelay_C FrmMng_trqARSCurDef_C FrmMng_trqARSDesDef_C FrmMng_trqGearbxFrc_C FrmMng_trqGearbxMaxSubs_C FrmMng_trqLiGovMin_C FrmMng_trqSSGPlaThres_C FrmMng_tWaterVlv_C FrmMng_ubtMin_C FrmMng_vHtgUpActMax_C FrmMng_cnvvPrgNo_Offset_C FrmMng_cnvvPrgNo_Slope_C FrmMng_vSSGPlaThres_C /end DEF_CHARACTERISTIC
 /begin IN_MEASUREMENT FrmMng_numACFanDes FrmMng_numRqStgEFan FrmMng_tEngRpm_mp /end IN_MEASUREMENT
/end FUNCTION
/begin FUNCTION frmmng_conv "" /end FUNCTION
/begin FUNCTION frmmng_rx100ms_msg ""
 /begin OUT_MEASUREMENT FrmMng_ctrIdxNo FrmMng_nPSP FrmMng_pAir FrmMng_pBoost FrmMng_rPSPSetPoint FrmMng_stAC FrmMng_stBrk FrmMng_stPRGG_CCTRSig FrmMng_stPSP FrmMng_stTxRequest FrmMng_swtCarType FrmMng_tAir FrmMng_tClnt FrmMng_tEnv FrmMng_tiDayCouAbsl FrmMng_trqDCS FrmMng_trqGbx FrmMng_trqTCS FrmMng_vPrgNo1 FrmMng_vPrgNo2 FrmMng_vPrgNo3 /end OUT_MEASUREMENT
/end FUNCTION
/begin FUNCTION frmmng_uic ""
 /begin OUT_MEASUREMENT FrmMng_ctBOS_RESETalv_mp FrmMng_ctDM_ANF_AFSalv_mp FrmMng_ctDRMANFSSGalv_mp FrmMng_ctENGINE1alv_mp FrmMng_ctOPCRCTLACCalv_mp FrmMng_ctSTAT_ARSalv_mp FrmMng_ctTERMINALalv_mp FrmMng_ctTORQUE1alv_mp FrmMng_ctTORQUE2alv_mp FrmMng_ctTORQUE3alv_mp FrmMng_ctTORQUE_DSCalv_mp FrmMng_ctTORQUE_GEARBXalv_mp FrmMng_ctVEH_MODalv_mp FrmMng_dDM_ANF_AFScs_mp FrmMng_dDRMANFSSGcs_mp FrmMng_dOBDCtl_mp FrmMng_dOPCRCTLACCcs_mp FrmMng_dTERMINALcs_mp FrmMng_dTORQUE1cs_mp FrmMng_dTORQUE2cs_mp FrmMng_dTORQUE3cs_mp FrmMng_dTORQUE_DSCcs_mp FrmMng_dTORQUE_GEARBXcs_mp FrmMng_dVEH_MODcs_mp FrmMng_numAnfrageByte0_mp FrmMng_numAnfrageByte1_mp FrmMng_numAnfrageByte2_mp FrmMng_numBOS_MELDUNG2_OILbyte0_mp FrmMng_numBOS_MELDUNG2_OILbyte1_mp FrmMng_numBOS_MELDUNG2_OILbyte2_mp FrmMng_numBOS_MELDUNG2_OILbyte3_mp FrmMng_numBOS_MELDUNG2_OILbyte4_mp FrmMng_numBOS_MELDUNG2_OILbyte5_mp FrmMng_numBOS_MELDUNG2_OILbyte6_mp FrmMng_numBOS_MELDUNG_OILbyte0_mp FrmMng_numBOS_MELDUNG_OILbyte1_mp FrmMng_numBOS_MELDUNG_OILbyte2_mp FrmMng_numBOS_MELDUNG_OILbyte3_mp FrmMng_numBOS_MELDUNG_OILbyte4_mp FrmMng_numBOS_MELDUNG_OILbyte5_mp FrmMng_numBOS_MELDUNG_OILbyte6_mp FrmMng_numBOS_MELDUNG_OILbyte7_mp FrmMng_numBOS_PFLTbyte0_mp FrmMng_numBOS_PFLTbyte1_mp FrmMng_numBOS_PFLTbyte2_mp FrmMng_numBOS_PFLTbyte3_mp FrmMng_numBOS_PFLTbyte4_mp FrmMng_numBOS_PFLTbyte5_mp FrmMng_numBOS_PFLTbyte6_mp FrmMng_numBOS_PFLTbyte7_mp FrmMng_numBOS_RESETbyte0_mp FrmMng_numBOS_RESETbyte1_mp FrmMng_numBOS_RESETbyte2_mp FrmMng_numBOS_RESETbyte3_mp FrmMng_numBOS_RESETbyte4_mp FrmMng_numBOS_RESETbyte5_mp FrmMng_numBOS_RESETbyte6_mp FrmMng_numBOS_RESETbyte7_mp FrmMng_numBOS_RESET_2byte0_mp FrmMng_numBOS_RESET_2byte1_mp FrmMng_numBOS_RESET_2byte2_mp FrmMng_numBOS_RESET_2byte3_mp FrmMng_numBOS_RESET_2byte4_mp FrmMng_numBOS_RESET_2byte5_mp FrmMng_numBOS_RESET_2byte6_mp FrmMng_numCCMsgbyte0_mp FrmMng_numCCMsgbyte1_mp FrmMng_numCCMsgbyte2_mp FrmMng_numCCMsgbyte3_mp FrmMng_numCCMsgbyte4_mp FrmMng_numCCMsgbyte5_mp FrmMng_numCCMsgbyte6_mp FrmMng_numCCMsgbyte7_mp FrmMng_numDMANFAFSbyte0_mp FrmMng_numDMANFAFSbyte1_mp FrmMng_numDMANFAFSbyte2_mp FrmMng_numDMANFAFSbyte3_mp FrmMng_numDMANFAFSbyte4_mp FrmMng_numDMANFAFSbyte5_mp FrmMng_numDM_ANF_ACCbyte0_mp FrmMng_numDM_ANF_ACCbyte1_mp FrmMng_numDM_ANF_ACCbyte2_mp FrmMng_numDM_ANF_ACCbyte3_mp FrmMng_numDM_ANF_ACCbyte4_mp FrmMng_numDM_ANF_ACCbyte5_mp FrmMng_numDM_ANF_ACCbyte6_mp FrmMng_numDM_ANF_ACCbyte7_mp FrmMng_numDRMANFSSGbyte0_mp FrmMng_numDRMANFSSGbyte1_mp FrmMng_numDRMANFSSGbyte2_mp FrmMng_numDRMANFSSGbyte3_mp FrmMng_numDRMANFSSGbyte4_mp FrmMng_numDRMANFSSGbyte5_mp FrmMng_numDRMANFSSGbyte6_mp FrmMng_numDRMANFSSGbyte7_mp FrmMng_numELKTR_M_OEL_MESSbyte0_mp FrmMng_numELKTR_M_OEL_MESSbyte1_mp FrmMng_numENGINE1byte0_mp FrmMng_numENGINE1byte1_mp FrmMng_numENGINE1byte2_mp FrmMng_numENGINE1byte3_mp FrmMng_numENGINE1byte4_mp FrmMng_numENGINE1byte5_mp FrmMng_numENGINE1byte6_mp FrmMng_numENGINE1byte7_mp FrmMng_numEngRpmbyte0_mp FrmMng_numEngRpmbyte1_mp FrmMng_numGEARBX_DATA2byte0_mp FrmMng_numGEARBX_DATA2byte1_mp FrmMng_numGEARBX_DATAbyte0_mp FrmMng_numGEARBX_DATAbyte1_mp FrmMng_numGEARBX_DATAbyte2_mp FrmMng_numGEARBX_DATAbyte3_mp FrmMng_numGEARBX_DATAbyte4_mp FrmMng_numGEARBX_DATAbyte5_mp FrmMng_numGEARBX_DATAbyte6_mp FrmMng_numGEARBX_DATAbyte7_mp FrmMng_numHEATCURbyte0_mp FrmMng_numHEATCURbyte1_mp FrmMng_numHEATCURbyte2_mp FrmMng_numHEATCURbyte3_mp FrmMng_numHEATCURbyte4_mp FrmMng_numHEATCURbyte5_mp FrmMng_numHEATCURbyte6_mp FrmMng_numHEAT_ACbyte0_mp FrmMng_numHEAT_ACbyte1_mp FrmMng_numHEAT_ACbyte2_mp FrmMng_numHEAT_ACbyte3_mp FrmMng_numHEAT_ACbyte4_mp FrmMng_numLRADWINKbyte0_mp FrmMng_numLRADWINKbyte1_mp FrmMng_numLRADWINKbyte2_mp FrmMng_numLRADWINKbyte3_mp FrmMng_numLRADWINKbyte4_mp FrmMng_numLRADWINKbyte5_mp FrmMng_numLRADWINKbyte6_mp FrmMng_numMILEAGE_RANGEbyte0_mp FrmMng_numMILEAGE_RANGEbyte1_mp FrmMng_numMILEAGE_RANGEbyte2_mp FrmMng_numMILEAGE_RANGEbyte3_mp FrmMng_numMILEAGE_RANGEbyte4_mp FrmMng_numMILEAGE_RANGEbyte5_mp FrmMng_numMILEAGE_RANGEbyte6_mp FrmMng_numMILEAGE_RANGEbyte7_mp FrmMng_numMsgACC_mp FrmMng_numMsgAC_mp FrmMng_numMsgAFS_mp FrmMng_numMsgARS_mp FrmMng_numMsgFGR_mp FrmMng_numOPCRCTLACCbyte0_mp FrmMng_numOPCRCTLACCbyte1_mp FrmMng_numOPCRCTLACCbyte2_mp FrmMng_numOPCRCTLACCbyte3_mp FrmMng_numParkConsumerByte0_mp FrmMng_numParkConsumerByte1_mp FrmMng_numParkConsumerByte2_mp FrmMng_numParkConsumerByte3_mp FrmMng_numPMCTRCOSbyte0_mp FrmMng_numPMCTRCOSbyte1_mp FrmMng_numPMCTRCOSbyte2_mp FrmMng_numPMCTRCOSbyte3_mp FrmMng_numPMCTRCOSbyte4_mp FrmMng_numPMCTRCOSbyte5_mp FrmMng_numPMUBattbyte0_mp FrmMng_numPMUBattbyte1_mp FrmMng_numPMUBattbyte2_mp FrmMng_numPMUBattbyte3_mp FrmMng_numPMUBattbyte4_mp FrmMng_numPMUBattbyte5_mp FrmMng_numPMUBattbyte6_mp FrmMng_numPMUBattbyte7_mp FrmMng_numPRGG_CCTRbyte0_mp FrmMng_numPRGG_CCTRbyte1_mp FrmMng_numPRGG_CCTRbyte2_mp FrmMng_numPRGG_CCTRbyte3_mp FrmMng_numPRGG_CCTRbyte4_mp FrmMng_numPWRMNG_LOADVbyte0_mp FrmMng_numPWRMNG_LOADVbyte1_mp FrmMng_numPWRMNG_LOADVbyte2_mp FrmMng_numPWRMNG_LOADVbyte3_mp FrmMng_numPWRMNG_LOADVbyte4_mp FrmMng_numPWRMNG_LOADVbyte5_mp FrmMng_numPWRMNG_LOADVbyte6_mp FrmMng_numPWRMNG_LOADVbyte7_mp FrmMng_numRPM_STAByte0_mp FrmMng_numRPM_STAByte1_mp FrmMng_numRQ_STG_EFANbyte0_mp FrmMng_numRQ_STG_EFANbyte1_mp FrmMng_numRQ_STG_EFANbyte2_mp FrmMng_numSITZGURTbyte0_mp FrmMng_numSITZGURTbyte1_mp FrmMng_numSITZGURTbyte2_mp FrmMng_numSITZGURTbyte3_mp FrmMng_numSITZGURTbyte4_mp FrmMng_numSPEED_CLCTRbyte0_mp FrmMng_numSPEED_CLCTRbyte1_mp FrmMng_numSPEED_CLCTRbyte2_mp FrmMng_numSPEED_CLCTRbyte3_mp FrmMng_numSPEED_CLCTRbyte4_mp FrmMng_numSPEED_CLCTRbyte5_mp FrmMng_numSPEED_CLCTRbyte6_mp FrmMng_numSPEED_CLCTRbyte7_mp FrmMng_numSTAT_ANHbyte0_mp FrmMng_numSTAT_ARSbyte0_mp FrmMng_numSTAT_ARSbyte1_mp FrmMng_numSTAT_ARSbyte2_mp FrmMng_numSTAT_ARSbyte3_mp FrmMng_numSTAT_ARSbyte4_mp FrmMng_numSTAT_ARSbyte5_mp FrmMng_numSTAT_ARSbyte6_mp FrmMng_numSTAT_ARSbyte7_mp FrmMng_numSTAT_DSCbyte0_mp FrmMng_numSTAT_DSCbyte1_mp FrmMng_numSTAT_DSCbyte2_mp FrmMng_numSTAT_DSCbyte3_mp FrmMng_numSTAT_DSCbyte4_mp FrmMng_numSTAT_DSCbyte5_mp FrmMng_numSTAT_DSCbyte6_mp FrmMng_numSTAT_DSCbyte7_mp FrmMng_numSTAT_EKPbyte0_mp FrmMng_numSTAT_EKPbyte1_mp FrmMng_numSTAT_EKPbyte2_mp FrmMng_numSTAT_EKPbyte3_mp FrmMng_numSTAT_EKPbyte4_mp FrmMng_numSTAT_EKPbyte5_mp FrmMng_numSTAT_EKPbyte6_mp FrmMng_numSTAT_EKPbyte7_mp FrmMng_numSTAT_KOMBIbyte0_mp FrmMng_numSTAT_KOMBIbyte1_mp FrmMng_numSTAT_KOMBIbyte2_mp FrmMng_numSTAT_KOMBIbyte3_mp FrmMng_numSTAT_KOMBIbyte4_mp FrmMng_numSTAT_KOMBIbyte5_mp FrmMng_numSTAT_KOMBIbyte6_mp FrmMng_numSTAT_KOMBIbyte7_mp FrmMng_numTEMPRELTIMEbyte0_mp FrmMng_numTEMPRELTIMEbyte1_mp FrmMng_numTEMPRELTIMEbyte2_mp FrmMng_numTEMPRELTIMEbyte3_mp FrmMng_numTEMPRELTIMEbyte4_mp FrmMng_numTEMPRELTIMEbyte5_mp FrmMng_numTEMPRELTIMEbyte6_mp FrmMng_numTERMINALbyte0_mp FrmMng_numTERMINALbyte1_mp FrmMng_numTERMINALbyte2_mp FrmMng_numTERMINALbyte3_mp FrmMng_numTERMINALbyte4_mp FrmMng_numTIME_DATEbyte0_mp FrmMng_numTIME_DATEbyte1_mp FrmMng_numTIME_DATEbyte2_mp FrmMng_numTIME_DATEbyte3_mp FrmMng_numTIME_DATEbyte4_mp FrmMng_numTIME_DATEbyte5_mp FrmMng_numTIME_DATEbyte6_mp FrmMng_numTORQUE1byte0_mp FrmMng_numTORQUE1byte1_mp FrmMng_numTORQUE1byte2_mp FrmMng_numTORQUE1byte3_mp FrmMng_numTORQUE1byte4_mp FrmMng_numTORQUE1byte5_mp FrmMng_numTORQUE1byte6_mp FrmMng_numTORQUE1byte7_mp FrmMng_numTORQUE2byte0_mp FrmMng_numTORQUE2byte1_mp FrmMng_numTORQUE2byte2_mp FrmMng_numTORQUE2byte3_mp FrmMng_numTORQUE2byte4_mp FrmMng_numTORQUE2byte5_mp FrmMng_numTORQUE2byte6_mp FrmMng_numTORQUE2byte7_mp FrmMng_numTORQUE3byte0_mp FrmMng_numTORQUE3byte1_mp FrmMng_numTORQUE3byte2_mp FrmMng_numTORQUE3byte3_mp FrmMng_numTORQUE3byte4_mp FrmMng_numTORQUE3byte5_mp FrmMng_numTORQUE3byte6_mp FrmMng_numTORQUE3byte7_mp FrmMng_numTORQUE_DSCbyte0_mp FrmMng_numTORQUE_DSCbyte1_mp FrmMng_numTORQUE_DSCbyte2_mp FrmMng_numTORQUE_DSCbyte3_mp FrmMng_numTORQUE_DSCbyte4_mp FrmMng_numTORQUE_DSCbyte5_mp FrmMng_numTORQUE_DSCbyte6_mp FrmMng_numTORQUE_DSCbyte7_mp FrmMng_numTORQUE_GEARBXbyte0_mp FrmMng_numTORQUE_GEARBXbyte1_mp FrmMng_numTORQUE_GEARBXbyte2_mp FrmMng_numTORQUE_GEARBXbyte3_mp FrmMng_numTORQUE_GEARBXbyte4_mp FrmMng_numTORQUE_GEARBXbyte5_mp FrmMng_numTORQUE_GEARBXbyte6_mp FrmMng_numTORQUE_GEARBXbyte7_mp FrmMng_numVEH_MODbyte0_mp FrmMng_numVEH_MODbyte1_mp FrmMng_numVELOCITYbyte0_mp FrmMng_numVELOCITYbyte1_mp FrmMng_numVELOCITYbyte2_mp FrmMng_numVELOCITYbyte3_mp FrmMng_numVELOCITYbyte4_mp FrmMng_numVELOCITYbyte5_mp FrmMng_numVELOCITYbyte6_mp FrmMng_numVELOCITYbyte7_mp FrmMng_numWHEEL_SPEEDbyte0_mp FrmMng_numWHEEL_SPEEDbyte1_mp FrmMng_numWHEEL_SPEEDbyte2_mp FrmMng_numWHEEL_SPEEDbyte3_mp FrmMng_numWHEEL_SPEEDbyte4_mp FrmMng_numWHEEL_SPEEDbyte5_mp FrmMng_numWHEEL_SPEEDbyte6_mp FrmMng_numWHEEL_SPEEDbyte7_mp FrmMng_rWaterVlv_mp FrmMng_service_index_Byte0_mp FrmMng_service_index_Byte10_mp FrmMng_service_index_Byte11_mp FrmMng_service_index_Byte12_mp FrmMng_service_index_Byte13_mp FrmMng_service_index_Byte14_mp FrmMng_service_index_Byte1_mp FrmMng_service_index_Byte2_mp FrmMng_service_index_Byte3_mp FrmMng_service_index_Byte4_mp FrmMng_service_index_Byte5_mp FrmMng_service_index_Byte6_mp FrmMng_service_index_Byte7_mp FrmMng_service_index_Byte8_mp FrmMng_service_index_Byte9_mp FrmMng_stARSquit_mp FrmMng_stBrk_mp FrmMng_stCrCtl_mp FrmMng_stCurrSig_mp FrmMng_stCurr_byte0_mp FrmMng_stCurr_byte1_mp FrmMng_stCurr_byte2_mp FrmMng_stCurr_byte3_mp FrmMng_stDebValT15CDold_mp FrmMng_stDSCquit_mp FrmMng_stEng_mp FrmMng_stExcStateCan_mp FrmMng_stExc_BOS_RESET_2_mp FrmMng_stExc_BOS_RESET_mp FrmMng_stExc_DM_ANF_ACC_mp FrmMng_stExc_DM_ANF_AFS_mp FrmMng_stExc_DRMANFSSG_mp FrmMng_stExc_GEARBX_DATA2_mp FrmMng_stExc_GEARBX_DATA_mp FrmMng_stExc_HEAT_AC_mp FrmMng_stExc_LRADWINK_mp FrmMng_stExc_MILEAGE_RANGE_mp FrmMng_stExc_OPCRCTLACC_mp FrmMng_stExc_ParkConsumer_mp FrmMng_stExc_PRGG_CCTR_mp FrmMng_stExc_PWRMNG_LOADV_mp FrmMng_stExc_RQ_STG_EFAN_mp FrmMng_stExc_SERVICE_mp FrmMng_stExc_SITZGURT_mp FrmMng_stExc_STAT_ANH_mp FrmMng_stExc_STAT_ARS_mp FrmMng_stExc_STAT_DSC_mp FrmMng_stExc_STAT_EKP_mp FrmMng_stExc_STAT_KOMBI_mp FrmMng_stExc_stCurr_mp FrmMng_stExc_swtPSPOff_mp FrmMng_stExc_TEMPRELTIME_mp FrmMng_stExc_TERMINAL_mp FrmMng_stExc_TIME_DATE_mp FrmMng_stExc_TORQUE_DSC_mp FrmMng_stExc_TORQUE_GEARBX_mp FrmMng_stExc_VEH_MOD_mp FrmMng_stExc_VELOCITY_mp FrmMng_stExc_WHEEL_SPEED_mp FrmMng_stFDC_mp FrmMng_stGearbxHtgUpAct_mp FrmMng_stGearbxquit_mp FrmMng_stHtgUp_mp FrmMng_stLIGov_mp FrmMng_stnErr_mp FrmMng_stOBDGbx_mp FrmMng_stOpPubuCctrAcc_mp FrmMng_stOvrRun_mp FrmMng_stpmsv_mp FrmMng_stpmsv_old_mp FrmMng_stRmp_mp FrmMng_stShutOffHtgUp_mp FrmMng_stSLckAdjVal_mp FrmMng_stSLck_mp FrmMng_stSwClt_mp FrmMng_stSwLevRpm_mp FrmMng_stTrqDisable_mp FrmMng_stTrqInr_mp FrmMng_stWHEEL_SPEEDSig_mp FrmMng_swtAC_mp FrmMng_swtPSPOffSig_mp FrmMng_swtPSPOff_byte0_mp FrmMng_tEngRpm_mp FrmMng_tiRecACC_mp FrmMng_tiRecAC_mp FrmMng_tiRecAFS_mp FrmMng_tiRecARS_mp FrmMng_tiRecFGR_mp FrmMng_tmrDSMFadeoutTERMINAL_mp FrmMng_tmrDSMToTERMINAL_mp FrmMng_torque1RetVal_mp FrmMng_torque2RetVal_mp FrmMng_torque3RetVal_mp FrmMng_trqACC_TrqDes_mp FrmMng_trqBefRmp_mp FrmMng_trqDes_mp FrmMng_trqDSCDes_mp FrmMng_trqFMTCInr_mp FrmMng_trqGbx_mp FrmMng_trqGearbxMax_mp FrmMng_trqInrGearbxOut_mp FrmMng_trqInrSet_mp FrmMng_trqMax_mp FrmMng_trqMin_mp FrmMng_trqResPos_mp FrmMng_trqRmp_mp FrmMng_trqSet_mp /end OUT_MEASUREMENT
/end FUNCTION
/begin COMPU_METHOD Acc "Fahrzeugbeschleunigung" RAT_FUNC "%6.5" "m/s^2" COEFFS 0 1000 0 0 0 1 /end COMPU_METHOD
/begin COMPU_METHOD AngleGrad "Winkelanzeige in Grad" RAT_FUNC "%6.4" "Grad" COEFFS 0 22.7531285551763 0 0 0 1 /end COMPU_METHOD
/begin COMPU_METHOD AngleGradPerSec "Winkelanzeige in Grad pro Sekunde" RAT_FUNC "%6.4" "Grad/s" COEFFS 0 22.7531285551763 0 0 0 1 /end COMPU_METHOD
/begin COMPU_METHOD CarType "" TAB_VERB "%6.3" "-" COMPU_TAB_REF CarType /end COMPU_METHOD
/begin COMPU_VTAB CarType "" TAB_VERB 3 0 "E60" 1 "E65" 2 "E90" /end COMPU_VTAB
/begin COMPU_METHOD DEZ "K3 Umwandlungen" RAT_FUNC "%6.2" "-" COEFFS 0 1 0 0 0 1 /end COMPU_METHOD
/begin COMPU_METHOD EngN "Motordrehzahl" RAT_FUNC "%6.2" "rpm" COEFFS 0 1 0 0 0 1 /end COMPU_METHOD
/begin COMPU_METHOD Fact "Faktor mit Auflösung 1 / 8192, hauptsächlich für einen Faktorenbereich 0...1 verwendet" RAT_FUNC "%6.5" "-" COEFFS 0 8192 0 0 0 1 /end COMPU_METHOD
/begin COMPU_METHOD FanSpd "(MAXSINT16 / FANSPD_MAX) * phys" RAT_FUNC "%6.3" "1/min" COEFFS 0 10.9223333333333 0 0 0 1 /end COMPU_METHOD
/begin COMPU_METHOD FlConsum_l_h "Kraftstoffverbrauch" RAT_FUNC "%6.4" "l/h" COEFFS 0 100 0 0 0 1 /end COMPU_METHOD
/begin COMPU_METHOD FlConsum_ul "Verbrauchsintegral (in Mikroliter)" RAT_FUNC "%6.2" "ul" COEFFS 0 1 0 0 0 1 /end COMPU_METHOD
/begin COMPU_METHOD InjMass "Einspritzmenge" RAT_FUNC "%6.4" "mg/hub" COEFFS 0 100 0 0 0 1 /end COMPU_METHOD
/begin COMPU_METHOD i_ub_q0p001 "K3 Umwandlungen" RAT_FUNC "%5.4" "A" COEFFS 0 1 0 0 0 0.001 /end COMPU_METHOD
/begin COMPU_METHOD i_ub_q10p0 "K3 Umwandlungen" RAT_FUNC "%5.1" "A" COEFFS 0 1 0 0 0 10 /end COMPU_METHOD
/begin COMPU_METHOD OneToOne "eins zu eins (physikalischer Wert ist gleich dem internen Wert)" RAT_FUNC "%6.2" "-" COEFFS 0 1 0 0 0 1 /end COMPU_METHOD
/begin COMPU_METHOD Prc "Prozent, gleiche interne Auflösung wie Fact, aber Darstellung in Prozent (0...100%)" RAT_FUNC "%6.4" "%" COEFFS 0 81.92 0 0 0 1 /end COMPU_METHOD
/begin COMPU_METHOD PrcPerSec "Prozentänderung pro Sekunde für 20ms-Tasks" RAT_FUNC "%6.3" "%/s" COEFFS 0 1.6384 0 0 0 1 /end COMPU_METHOD
/begin COMPU_METHOD Pres_hPa "Druck (angezeigt in [hPa])" RAT_FUNC "%6.2" "hPa" COEFFS 0 1 0 0 0 1 /end COMPU_METHOD
/begin COMPU_METHOD PSP_Spd "PSP speed in rpm" RAT_FUNC "%6.2" "rpm" COEFFS 0 1 0 0 0 1 /end COMPU_METHOD
/begin COMPU_METHOD RmpTrq "Rampengradient für Motormoment" RAT_FUNC "%6.4" "Nm/s" COEFFS 0 655.36 0 0 0 1 /end COMPU_METHOD
/begin COMPU_METHOD SlopeRes10 "Umrechnung für Slope: Slopewert mit Verhältnis 0,1" RAT_FUNC "%6.3" "-" COEFFS 0 10 0 0 0 1 /end COMPU_METHOD
/begin COMPU_METHOD SlopeRes100 "Umrechnung für Slope: Slopewert mit Verhältnis 0,01" RAT_FUNC "%6.4" "-" COEFFS 0 100 0 0 0 1 /end COMPU_METHOD
/begin COMPU_METHOD SlopeRes1000 "Umrechnung für Slope: Slopewert mit Verhältnis 0,001" RAT_FUNC "%6.5" "-" COEFFS 0 1000 0 0 0 1 /end COMPU_METHOD
/begin COMPU_METHOD spg_uw_q0p015 "K3 Umwandlungen" RAT_FUNC "%9.5" "V" COEFFS 0 1 0 0 0 0.015 /end COMPU_METHOD
/begin COMPU_METHOD Temp_Cels "Temperatur dargestellt in °C (gleiche interne Darstellung wie Temp_Kelv)" RAT_FUNC "%6.1" "deg C" COEFFS 0 10 2731.4 0 0 1 /end COMPU_METHOD
/begin COMPU_METHOD Time_fulls "for application labels only in full seconds" RAT_FUNC "%6.2" "s" COEFFS 0 1 0 0 0 1 /end COMPU_METHOD
/begin COMPU_METHOD Time_ms "Zeit in ms für Fehlerentprellung (DSM) und SW-Timer" RAT_FUNC "%6.1" "ms" COEFFS 0 0.1 0 0 0 1 /end COMPU_METHOD
/begin COMPU_METHOD Trq "Motormoment" RAT_FUNC "%6.3" "Nm" COEFFS 0 10 0 0 0 1 /end COMPU_METHOD
/begin COMPU_METHOD TrqPrp "Vortriebsmoment" RAT_FUNC "%6.3" "Nm" COEFFS 0 5 0 0 0 1 /end COMPU_METHOD
/begin COMPU_METHOD Vel "Fahrzeuggeschwindigkeit, gleiche interne Auflösung wie Vel_SI" RAT_FUNC "%6.4" "km/h" COEFFS 0 100 0 0 0 1 /end COMPU_METHOD
/begin COMPU_METHOD vfzg_uw_b512 "ME9 Umwandlungen" RAT_FUNC "%6.4" "km/h" COEFFS 0 65536 0 0 0 512 /end COMPU_METHOD
/begin RECORD_LAYOUT Kl_Xs16_Ws16 NO_AXIS_PTS_X 1 SWORD AXIS_PTS_X 2 SWORD INDEX_INCR DIRECT FNC_VALUES 3 SWORD COLUMN_DIR DIRECT /end RECORD_LAYOUT
/begin RECORD_LAYOUT Kwb_Wu8 FNC_VALUES 1 UBYTE COLUMN_DIR DIRECT /end RECORD_LAYOUT
/begin RECORD_LAYOUT Kw_Ws16 FNC_VALUES 1 SWORD COLUMN_DIR DIRECT /end RECORD_LAYOUT
/begin RECORD_LAYOUT Kw_Wu16 FNC_VALUES 1 UWORD COLUMN_DIR DIRECT /end RECORD_LAYOUT
/begin RECORD_LAYOUT Kw_Wu32 FNC_VALUES 1 ULONG COLUMN_DIR DIRECT /end RECORD_LAYOUT
/begin RECORD_LAYOUT Kw_Wu8 FNC_VALUES 1 UBYTE COLUMN_DIR DIRECT /end RECORD_LAYOUT
/end MODULE
/end PROJECT
