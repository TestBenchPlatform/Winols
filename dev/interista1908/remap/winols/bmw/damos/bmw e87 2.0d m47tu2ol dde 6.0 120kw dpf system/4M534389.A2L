ASAP2_VERSION 1 3
/begin PROJECT P389 "BMW DDE6.0 4-Zylinder V53.4 01.04.2004 CAN12H"
/begin HEADER "" VERSION "V53.4_4Z_CAN12H" PROJECT_NO P389 /end HEADER
/begin MODULE DIM ""
/begin MOD_COMMON "" BYTE_ORDER MSB_FIRST ALIGNMENT_BYTE 1 ALIGNMENT_WORD 2 ALIGNMENT_LONG 4 ALIGNMENT_FLOAT32_IEEE 4 /end MOD_COMMON
/begin CHARACTERISTIC APPCD_uAPP1_SRCMin_C "#SSD Spannung SRC-low" VALUE 0xC7238 Kw_Ws16 5200.391 Volt 0.00 5200.391 FORMAT "%8.3" EXTENDED_LIMITS -160156.4 160151.5 /end CHARACTERISTIC
/begin CHARACTERISTIC APPCD_uAPP1_SRCMax_C "#SSD Spannung SRC-high" VALUE 0xC723A Kw_Ws16 5200.391 Volt 0.00 5200.391 FORMAT "%8.3" EXTENDED_LIMITS -160156.4 160151.5 /end CHARACTERISTIC
/begin CHARACTERISTIC APPCD_rLinAPP1_CUR "#SSD Linerisierungs-Kennlinie APP1" CURVE 0xC723C Kl_Xs16_Ws16 100.0000 Prc 0.00 100.0000 FORMAT "%8.4" EXTENDED_LIMITS -400.0000 399.9878
 /begin AXIS_DESCR STD_AXIS APPCD_uRawAPP1 Volt 2 0.00 5200.391 FORMAT "%8.3" EXTENDED_LIMITS -160156.4 160151.5 DEPOSIT ABSOLUTE /end AXIS_DESCR
/end CHARACTERISTIC
/begin CHARACTERISTIC APPCD_uAPP2_SRCMin_C "#SSD Spannung SRC-low" VALUE 0xC7246 Kw_Ws16 5200.391 Volt 0.00 5200.391 FORMAT "%8.3" EXTENDED_LIMITS -160156.4 160151.5 /end CHARACTERISTIC
/begin CHARACTERISTIC APPCD_uAPP2_SRCMax_C "#SSD Spannung SRC-high" VALUE 0xC7248 Kw_Ws16 5200.391 Volt 0.00 5200.391 FORMAT "%8.3" EXTENDED_LIMITS -160156.4 160151.5 /end CHARACTERISTIC
/begin CHARACTERISTIC APPCD_rLinAPP2_CUR "#SSD Linerisierungs-Kennlinie APP2" CURVE 0xC724A Kl_Xs16_Ws16 100.0000 Prc 0.00 100.0000 FORMAT "%8.4" EXTENDED_LIMITS -400.0000 399.9878
 /begin AXIS_DESCR STD_AXIS APPCD_uRawAPP2 Volt 2 0.00 2600.196 FORMAT "%8.3" EXTENDED_LIMITS -160156.4 160151.5 DEPOSIT ABSOLUTE /end AXIS_DESCR
/end CHARACTERISTIC
/begin CHARACTERISTIC APPCD_DebPlaDef_C "#SSD Defektzeit Plausibilitätsfehler" VALUE 0xC7254 Kw_Wu16 655350.0 Time_ms 0.00 655350.0 FORMAT "%8.1" /end CHARACTERISTIC
/begin CHARACTERISTIC APPCD_DebPlaOk_C "#SSD Heilungszeit Plausibilitätsfehler" VALUE 0xC7256 Kw_Wu16 655350.0 Time_ms 0.00 655350.0 FORMAT "%8.1" /end CHARACTERISTIC
/begin CHARACTERISTIC APPCD_DebSRCHighDef_C "#SSD Defektzeit SRC-high" VALUE 0xC7258 Kw_Wu16 655350.0 Time_ms 0.00 655350.0 FORMAT "%8.1" /end CHARACTERISTIC
/begin CHARACTERISTIC APPCD_DebSRCHighOk_C "#SSD Heilungszeit SRC-high" VALUE 0xC725A Kw_Wu16 655350.0 Time_ms 0.00 655350.0 FORMAT "%8.1" /end CHARACTERISTIC
/begin CHARACTERISTIC APPCD_DebSRCLowDef_C "#SSD Defektzeit SRC-low" VALUE 0xC725C Kw_Wu16 655350.0 Time_ms 0.00 655350.0 FORMAT "%8.1" /end CHARACTERISTIC
/begin CHARACTERISTIC APPCD_DebSRCLowOk_C "#SSD Heilungszeit SRC-low" VALUE 0xC725E Kw_Wu16 655350.0 Time_ms 0.00 655350.0 FORMAT "%8.1" /end CHARACTERISTIC
/begin CHARACTERISTIC APPCD_rThrFltFDCLowPos_C "upper threshold for filter parameter ""low_pos""" VALUE 0xC7260 Kw_Ws16 100.0000 Prc 0.00 100.0000 FORMAT "%8.4" EXTENDED_LIMITS -400.0000 399.9878 /end CHARACTERISTIC
/begin CHARACTERISTIC APPCD_rThrFltFDCMidPos_C "upper threshold for filter parameter ""mid_neg""" VALUE 0xC7262 Kw_Ws16 100.0000 Prc 0.00 100.0000 FORMAT "%8.4" EXTENDED_LIMITS -400.0000 399.9878 /end CHARACTERISTIC
/begin CHARACTERISTIC APPCD_rThrFltFDCLowNeg_C "upper threshold for filter parameter ""low_neg""" VALUE 0xC7264 Kw_Ws16 100.0000 Prc 0.00 100.0000 FORMAT "%8.4" EXTENDED_LIMITS -400.0000 399.9878 /end CHARACTERISTIC
/begin CHARACTERISTIC APPCD_rThrFltFDCMidNeg_C "upper threshold for filter parameter ""mid_neg""" VALUE 0xC7266 Kw_Ws16 100.0000 Prc 0.00 100.0000 FORMAT "%8.4" EXTENDED_LIMITS -400.0000 399.9878 /end CHARACTERISTIC
/begin CHARACTERISTIC APPCD_tiLowNegFDCPT1_C "APP filter time constant neg. slope low range" VALUE 0xC7268 Kw_Wu32 4294.9673 TimeDelay_s 0.0000010000000 4294.9673 FORMAT "%9.4" /end CHARACTERISTIC
/begin CHARACTERISTIC APPCD_tiLowNegPT1_C "Filterzeit low position, neg. Steig" VALUE 0xC726C Kw_Wu32 4294.9673 TimeDelay_s 0.0000010000000 4294.9673 FORMAT "%9.4" /end CHARACTERISTIC
/begin CHARACTERISTIC APPCD_tiLowPosFDCPT1_C "APP filter time constant pos. slope low range" VALUE 0xC7270 Kw_Wu32 4294.9673 TimeDelay_s 0.0000010000000 4294.9673 FORMAT "%9.4" /end CHARACTERISTIC
/begin CHARACTERISTIC APPCD_tiLowPosPT1_C "Filterzeit low position, pos. Steig." VALUE 0xC7274 Kw_Wu32 4294.9673 TimeDelay_s 0.0000010000000 4294.9673 FORMAT "%9.4" /end CHARACTERISTIC
/begin CHARACTERISTIC APPCD_tiMidNegFDCPT1_C "APP filter time constant neg. slope mid. range" VALUE 0xC7278 Kw_Wu32 4294.9673 TimeDelay_s 0.0000010000000 4294.9673 FORMAT "%9.4" /end CHARACTERISTIC
/begin CHARACTERISTIC APPCD_tiMidNegPT1_C "Filterzeit mid. position, neg. Steig." VALUE 0xC727C Kw_Wu32 4294.9673 TimeDelay_s 0.0000010000000 4294.9673 FORMAT "%9.4" /end CHARACTERISTIC
/begin CHARACTERISTIC APPCD_tiMidPosFDCPT1_C "APP filter time constant pos. slope mid. range" VALUE 0xC7280 Kw_Wu32 4294.9673 TimeDelay_s 0.0000010000000 4294.9673 FORMAT "%9.4" /end CHARACTERISTIC
/begin CHARACTERISTIC APPCD_tiMidPosPT1_C "Filterzeit mid. position, pos. Steig." VALUE 0xC7284 Kw_Wu32 4294.9673 TimeDelay_s 0.0000010000000 4294.9673 FORMAT "%9.4" /end CHARACTERISTIC
/begin CHARACTERISTIC APPCD_tiUppNegFDCPT1_C "APP filter time constant neg. slope upp. range" VALUE 0xC7288 Kw_Wu32 4294.9673 TimeDelay_s 0.0000010000000 4294.9673 FORMAT "%9.4" /end CHARACTERISTIC
/begin CHARACTERISTIC APPCD_tiUppNegPT1_C "Filterzeit upper position, neg. Steig." VALUE 0xC728C Kw_Wu32 4294.9673 TimeDelay_s 0.0000010000000 4294.9673 FORMAT "%9.4" /end CHARACTERISTIC
/begin CHARACTERISTIC APPCD_tiUppPosFDCPT1_C "APP filter time constant pos. slope upp. range" VALUE 0xC7290 Kw_Wu32 4294.9673 TimeDelay_s 0.0000010000000 4294.9673 FORMAT "%9.4" /end CHARACTERISTIC
/begin CHARACTERISTIC APPCD_tiUppPosPT1_C "Filterzeit upper position, pos. Steig.:" VALUE 0xC7294 Kw_Wu32 4294.9673 TimeDelay_s 0.0000010000000 4294.9673 FORMAT "%9.4" /end CHARACTERISTIC
/begin CHARACTERISTIC APPCD_swtNoFlt_C "#SSD Schalter für Filter AUS bei betätigter Kupplung (0 = Filter ein bei betätigter Kupplung, 1 = Filter aus bei betätigter Kupplung)" VALUE 0xC7298 Kw_Wu8 1.000 OneToOne 0.00 1.000 FORMAT "%5.3" EXTENDED_LIMITS 0.00 255.0 /end CHARACTERISTIC
/begin CHARACTERISTIC APPCD_rThrFltLowPos_C "Schwelle Filterzeit low position, pos. Steig." VALUE 0xC729A Kw_Ws16 100.0000 Prc 0.00 100.0000 FORMAT "%8.4" EXTENDED_LIMITS -400.0000 399.9878 /end CHARACTERISTIC
/begin CHARACTERISTIC APPCD_rThrFltMidPos_C "APPSchwelle Filterzeit mid. position, pos. Steig." VALUE 0xC729C Kw_Ws16 100.0000 Prc 0.00 100.0000 FORMAT "%8.4" EXTENDED_LIMITS -400.0000 399.9878 /end CHARACTERISTIC
/begin CHARACTERISTIC APPCD_rThrFltLowNeg_C "Schwelle Filterzeit low position, neg. Steig." VALUE 0xC729E Kw_Ws16 100.0000 Prc 0.00 100.0000 FORMAT "%8.4" EXTENDED_LIMITS -400.0000 399.9878 /end CHARACTERISTIC
/begin CHARACTERISTIC APPCD_rThrFltMidNeg_C "Schwelle Filterzeit mid position, neg. Steig." VALUE 0xC72A0 Kw_Ws16 100.0000 Prc 0.00 100.0000 FORMAT "%8.4" EXTENDED_LIMITS -400.0000 399.9878 /end CHARACTERISTIC
/begin CHARACTERISTIC APPCD_drHealRmpUp_C "#SSD Heilung pos. Rampe" VALUE 0xC72A4 Kw_Wu32 799999.999814 RmpPrc 0.00 799999.999814 FORMAT "%13.6" /end CHARACTERISTIC
/begin CHARACTERISTIC APPCD_drHealRmpDwn_C "Heilung neg. Rampe" VALUE 0xC72A8 Kw_Wu32 799999.999814 RmpPrc 0.00 799999.999814 FORMAT "%13.6" READ_ONLY /end CHARACTERISTIC
/begin CHARACTERISTIC APPCD_numAdcAPP1_C "#SSD Applikationsparameter  fuer den Fahrpedal 1 position -Fuehler" VALUE 0xC72AC Kw_Wu8 24.0000000000 NumPinAdc 0.00 24.0000000000 FORMAT "%13.10" /end CHARACTERISTIC
/begin CHARACTERISTIC APPCD_numAdcAPP2_C "#SSD Applikationsparameter  fuer den Fahrpedal 2 position -Fuehler" VALUE 0xC72AD Kw_Wu8 24.0000000000 NumPinAdc 0.00 24.0000000000 FORMAT "%13.10" /end CHARACTERISTIC
/begin CHARACTERISTIC APPCD_uPlaWinIdle_C "#SSD Plaus.-Window Leerlauf" VALUE 0xC72AE Kw_Ws16 5200.391 Volt 0.00 5200.391 FORMAT "%8.3" EXTENDED_LIMITS -160156.4 160151.5 /end CHARACTERISTIC
/begin CHARACTERISTIC APPCD_uPlaWinPar_C "#SSD Plaus.-Window Teillast" VALUE 0xC72B0 Kw_Ws16 5200.391 Volt 0.00 5200.391 FORMAT "%8.3" EXTENDED_LIMITS -160156.4 160151.5 /end CHARACTERISTIC
/begin CHARACTERISTIC APPCD_uPlaWinFull_C "#SSD Plaus.-Window Vollast" VALUE 0xC72B2 Kw_Ws16 5200.391 Volt 0.00 5200.391 FORMAT "%8.3" EXTENDED_LIMITS -160156.4 160151.5 /end CHARACTERISTIC
/begin CHARACTERISTIC APPCD_rPlaWinLowIdleXHigh_C "#SSD obere Hys.-Schwelle Plaus-Win. (Leerlauf)" VALUE 0xC72B4 Kw_Ws16 100.0000 Prc 0.00 100.0000 FORMAT "%8.4" EXTENDED_LIMITS -400.0000 399.9878 /end CHARACTERISTIC
/begin CHARACTERISTIC APPCD_rPlaWinLowIdleXLow_C "#SSD untere Hys.-Schwelle Plaus-Win. (Leerlauf):" VALUE 0xC72B6 Kw_Ws16 100.0000 Prc 0.00 100.0000 FORMAT "%8.4" EXTENDED_LIMITS -400.0000 399.9878 /end CHARACTERISTIC
/begin CHARACTERISTIC APPCD_rPlaWinParLoadXHigh_C "#SSD obere Hys.-Schwelle Plaus-Win. (Teillast)" VALUE 0xC72B8 Kw_Ws16 100.0000 Prc 0.00 100.0000 FORMAT "%8.4" EXTENDED_LIMITS -400.0000 399.9878 /end CHARACTERISTIC
/begin CHARACTERISTIC APPCD_rPlaWinParLoadXLow_C "#SSD untere Hys.-Schwelle Plaus-Win. (Teillast)" VALUE 0xC72BA Kw_Ws16 100.0000 Prc 0.00 100.0000 FORMAT "%8.4" EXTENDED_LIMITS -400.0000 399.9878 /end CHARACTERISTIC
/begin CHARACTERISTIC APPCD_SSpMonAPP1_C "#SSD Auswahl der Sensor-Versorgungs-Spannung für APP1" VALUE 0xC72BC Kw_Wu8 2.000 OneToOne 1.000 3.000 FORMAT "%5.3" EXTENDED_LIMITS 0.00 255.0 /end CHARACTERISTIC
/begin CHARACTERISTIC APPCD_SSpMonAPP2_C "#SSD Auswahl der Sensor-Versorgungs-Spannung für APP2" VALUE 0xC72BD Kw_Wu8 2.000 OneToOne 1.000 3.000 FORMAT "%5.3" EXTENDED_LIMITS 0.00 255.0 /end CHARACTERISTIC
/begin CHARACTERISTIC APPCD_stCfgAccPed_C "#SSD Pedalwertgeberkonfiguration (Bit 0: 0 = Potentiometertechnik, 1 = Berührunglose Technik)" VALUE 0xC72BE Kw_Wu8 1.000 OneToOne 0.00 1.000 FORMAT "%5.3" EXTENDED_LIMITS 0.00 255.0 /end CHARACTERISTIC
/begin CHARACTERISTIC APPCD_swtStepLim_C "Schalter um die Schrittbegrentzungsfunktion zu aktivieren (1: aktieviert, 0: deaktiviert)" VALUE 0xC72BF Kw_Wu8 1.000 OneToOne 0.00 1.000 FORMAT "%5.3" EXTENDED_LIMITS 0.00 255.0 /end CHARACTERISTIC
/begin CHARACTERISTIC APPCD_uKickDownHighAPP1_C "#SSD obere Hys.-Kick-Down-Spg.-Schwelle für APP1" VALUE 0xC72C0 Kw_Ws16 5200.391 Volt 0.00 5200.391 FORMAT "%8.3" EXTENDED_LIMITS -160156.4 160151.5 /end CHARACTERISTIC
/begin CHARACTERISTIC APPCD_uKickDownHighAPP2_C "#SSD obere Hys.-Kick-Down-Spg.-Schwelle für APP2" VALUE 0xC72C2 Kw_Ws16 5200.391 Volt 0.00 5200.391 FORMAT "%8.3" EXTENDED_LIMITS -160156.4 160151.5 /end CHARACTERISTIC
/begin CHARACTERISTIC APPCD_uKickDownLowAPP1_C "#SSD untere Hys.-Kick-Down-Spg.-Schwelle für APP1" VALUE 0xC72C4 Kw_Ws16 5200.391 Volt 0.00 5200.391 FORMAT "%8.3" EXTENDED_LIMITS -160156.4 160151.5 /end CHARACTERISTIC
/begin CHARACTERISTIC APPCD_uKickDownLowAPP2_C "#SSD untere Hys.-Kick-Down-Spg.-Schwelle für APP2" VALUE 0xC72C6 Kw_Ws16 5200.391 Volt 0.00 5200.391 FORMAT "%8.3" EXTENDED_LIMITS -160156.4 160151.5 /end CHARACTERISTIC
/begin CHARACTERISTIC APSCD_uSRCMin_C "#SSD Atmosphaerendruckfuehler SRC-Min Fehlerschwelle" VALUE 0xC72C8 Kw_Ws16 5200.391 Volt 0.00 5200.391 FORMAT "%8.3" EXTENDED_LIMITS -160156.4 160151.5 /end CHARACTERISTIC
/begin CHARACTERISTIC APSCD_uSRCMax_C "#SSD Atmosphaerendruckfuehler SRC-Max Fehlerschwelle" VALUE 0xC72CA Kw_Ws16 5200.391 Volt 0.00 5200.391 FORMAT "%8.3" EXTENDED_LIMITS -160156.4 160151.5 /end CHARACTERISTIC
/begin CHARACTERISTIC APSCD_pLin_CUR "#SSD Atmosphaerendruck Liniarisierungskennlinie" CURVE 0xC72CC Kl_Xs16_Ws16 3500.000 Pres_hPa 0.00 3500.000 FORMAT "%8.3" EXTENDED_LIMITS -32768.00 32767.00
 /begin AXIS_DESCR STD_AXIS APSCD_uRaw Volt 2 0.00 5000.000 FORMAT "%8.3" EXTENDED_LIMITS -160156.4 160151.5 DEPOSIT ABSOLUTE /end AXIS_DESCR
/end CHARACTERISTIC
/begin CHARACTERISTIC APSCD_DebNplDef_C "Defektentprellung zur Plausibilitaetsfehler Erkennung ( zur Zeit nicht applizierbar )" VALUE 0xC72D6 Kw_Wu16 65535.00 OneToOne 0.00 65535.00 FORMAT "%8.2" /end CHARACTERISTIC
/begin CHARACTERISTIC APSCD_DebNplOk_C "Heilungsentprellung fuer Plausibilitaetsfehler ( zur Zeit nicht applizierbar )" VALUE 0xC72D8 Kw_Wu16 65535.00 OneToOne 0.00 65535.00 FORMAT "%8.2" /end CHARACTERISTIC
/begin CHARACTERISTIC APSCD_DebSigDef_C "Entprellzeit defekt für ungültiges CAN-Signal für Atmosphärendruck" VALUE 0xC72DA Kw_Wu16 655350.0 Time_ms 0.00 655350.0 FORMAT "%8.1" /end CHARACTERISTIC
/begin CHARACTERISTIC APSCD_DebSigOk_C "Heilungsentprellzeit für ungültiges CAN-Signal Atmosphärendruck" VALUE 0xC72DC Kw_Wu16 655350.0 Time_ms 0.00 655350.0 FORMAT "%8.1" /end CHARACTERISTIC
/begin CHARACTERISTIC APSCD_DebSRCDef_C "Entprellzeit fuer SRC Defektzeit" VALUE 0xC72DE Kw_Wu16 655350.0 Time_ms 0.00 655350.0 FORMAT "%8.1" /end CHARACTERISTIC
/begin CHARACTERISTIC APSCD_DebSRCOk_C "Entprellzeit fuer SRC-Heilzeit" VALUE 0xC72E0 Kw_Wu16 655350.0 Time_ms 0.00 655350.0 FORMAT "%8.1" /end CHARACTERISTIC
/begin CHARACTERISTIC APSCD_nLimHigh_C "obere Drehzahlgrenze zur Berechnung des Luftdrucks aus dem Ladedruck" VALUE 0xC72E2 Kw_Ws16 6000.000 EngN 0.00 6000.000 FORMAT "%8.3" EXTENDED_LIMITS -32768.00 32767.00 /end CHARACTERISTIC
/begin CHARACTERISTIC APSCD_numAdc_C "#SSD Applikationsparameter fuer Atmosphaerdruck-Fuehler" VALUE 0xC72E4 Kw_Wu8 24.0000000000 NumPinAdc 0.00 24.0000000000 FORMAT "%13.10" /end CHARACTERISTIC
/begin CHARACTERISTIC APSCD_pCor_MAP "Atmosphaerendruck Korrekturkennfeld (Drehzahlabhaengig)" MAP 0xC72E6 Kf_Xs16_Ys16_Ws16 3850.000 Pres_hPa -350.0000 3500.000 FORMAT "%8.3" EXTENDED_LIMITS -32768.00 32767.00
 /begin AXIS_DESCR STD_AXIS Eng_nAvrg EngN 1 0.00 6000.000 FORMAT "%8.3" EXTENDED_LIMITS -32768.00 32767.00 DEPOSIT ABSOLUTE /end AXIS_DESCR
 /begin AXIS_DESCR STD_AXIS Eng_dnAvrg dn_dZ20 1 -6000.000 6000.000 FORMAT "%8.3" EXTENDED_LIMITS -327680.0 327670.0 DEPOSIT ABSOLUTE /end AXIS_DESCR
/end CHARACTERISTIC
/begin CHARACTERISTIC APSCD_dpRmpSlpUp_C "positive Atmosphaerendruck - Rampensteigung" VALUE 0xC72F0 Kw_Wu32 65535949.9817 RmpPres_hPa 50.0030517578 65535999.9847 FORMAT "%13.4" EXTENDED_LIMITS 0.00 65535999.9847 /end CHARACTERISTIC
/begin CHARACTERISTIC APSCD_dpRmpSlpDwn_C "negative Atmosphaerendruck - Rampensteigung" VALUE 0xC72F4 Kw_Wu32 65535949.9817 RmpPres_hPa 50.0030517578 65535999.9847 FORMAT "%13.4" EXTENDED_LIMITS 0.00 65535999.9847 /end CHARACTERISTIC
/begin CHARACTERISTIC APSCD_swtInst_C "Atmosphaerendruck Funktionsschalter (1: verbaut, 0: nicht verbaut)" VALUE 0xC72F8 Kw_Wu8 1.000 OneToOne 0.00 1.000 FORMAT "%5.3" EXTENDED_LIMITS 0.00 255.0 /end CHARACTERISTIC
/begin CHARACTERISTIC APSCD_swtSigVal_C "Schalter zur Umschaltung der Signalquelle ADC/CAN (0 = ADC, 1 = CAN)" VALUE 0xC72F9 Kw_Wu8 1.000 OneToOne 0.00 1.000 FORMAT "%5.3" EXTENDED_LIMITS 0.00 255.0 /end CHARACTERISTIC
/begin CHARACTERISTIC APSCD_swtSrcpVal_C "Schalter ob APSCD_pVal aus Ladedruck berechnet wird (1) oder nicht (0)" VALUE 0xC72FA Kw_Wu8 1.000 OneToOne 0.00 1.000 FORMAT "%5.3" EXTENDED_LIMITS 0.00 255.0 /end CHARACTERISTIC
/begin CHARACTERISTIC APSCD_tiDel_C "Atmosphaerendruck Verzögerungszeit bis Berechnung von Ladedruck beginnt" VALUE 0xC72FC Kw_Wu16 655350.0 Time_ms 0.00 655350.0 FORMAT "%8.1" /end CHARACTERISTIC
/begin CHARACTERISTIC APSCD_stSensIDWord_C "Atmosphaerendruck Geberkennwort" VALUE 0xC72FE Kw_Wu16 65535.00 OneToOne 0.00 65535.00 FORMAT "%8.2" /end CHARACTERISTIC
/begin CHARACTERISTIC APSCD_pDfl_C "#SSD Atmosphaerendruck Vorgabewert" VALUE 0xC7300 Kw_Ws16 3500.000 Pres_hPa 0.00 3500.000 FORMAT "%8.3" EXTENDED_LIMITS -32768.00 32767.00 /end CHARACTERISTIC
/begin CHARACTERISTIC ARS_tiDebSigDef_C "Defect time for declaring an error" VALUE 0xC7304 Kw_Wu16 655350.0 Time_ms 0.00 655350.0 FORMAT "%8.1" /end CHARACTERISTIC
/begin CHARACTERISTIC ARS_tiDebSigOk_C "Time for declaring an error healed" VALUE 0xC7306 Kw_Wu16 655350.0 Time_ms 0.00 655350.0 FORMAT "%8.1" /end CHARACTERISTIC
/begin CHARACTERISTIC ARS_facDesCor_C "Correction factor for torque correction over setpoint torque" VALUE 0xC7308 Kw_Ws16 20.00000 Fact1 0.00 20.00000 FORMAT "%8.5" EXTENDED_LIMITS -256.0000 255.9922 /end CHARACTERISTIC
/begin CHARACTERISTIC ARS_facDesOldCor_C "Correction factor for the torque correction over setpoint torque change" VALUE 0xC730A Kw_Ws16 20.00000 Fact1 0.00 20.00000 FORMAT "%8.5" EXTENDED_LIMITS -256.0000 255.9922 /end CHARACTERISTIC
/begin CHARACTERISTIC ARS_nDia_C "Engine speed threshold for detecting diagnostic operation" VALUE 0xC730C Kw_Ws16 4950.000 EngN 50.00000 5000.000 FORMAT "%8.3" EXTENDED_LIMITS -32768.00 32767.00 /end CHARACTERISTIC
/begin CHARACTERISTIC ARS_rTrans_C "Translation ratio of ARS" VALUE 0xC730E Kw_Ws16 200.0000 TransR 0.00 200.0000 FORMAT "%8.4" EXTENDED_LIMITS -327.6800 327.6700 /end CHARACTERISTIC
/begin CHARACTERISTIC ARS_trqCurMax_MAP "Maximum actual torque for plausability monitoring" MAP 0xC7310 Kf_Xs16_Ys16_Ws16 900.0000 Trq 100.0000 1000.000 FORMAT "%8.3" EXTENDED_LIMITS -3276.800 3276.700
 /begin AXIS_DESCR STD_AXIS VSSCD_v Vel 7 0.00 300.0000 FORMAT "%8.4" EXTENDED_LIMITS -327.6800 327.6700 DEPOSIT ABSOLUTE /end AXIS_DESCR
 /begin AXIS_DESCR STD_AXIS FrmMng_aSide Acc 7 0.00 10.00000 FORMAT "%8.5" EXTENDED_LIMITS -32.76800 32.76700 DEPOSIT ABSOLUTE /end AXIS_DESCR
/end CHARACTERISTIC
/begin CHARACTERISTIC ARS_trqDesMax_MAP "Maximum setpoint torque for plausibility monitoring" MAP 0xC7392 Kf_Xs16_Ys16_Ws16 900.0000 Trq 100.0000 1000.000 FORMAT "%8.3" EXTENDED_LIMITS -3276.800 3276.700
 /begin AXIS_DESCR STD_AXIS VSSCD_v Vel 7 0.00 300.0000 FORMAT "%8.4" EXTENDED_LIMITS -327.6800 327.6700 DEPOSIT ABSOLUTE /end AXIS_DESCR
 /begin AXIS_DESCR STD_AXIS FrmMng_aSide Acc 7 0.00 10.00000 FORMAT "%8.5" EXTENDED_LIMITS -32.76800 32.76700 DEPOSIT ABSOLUTE /end AXIS_DESCR
/end CHARACTERISTIC
/begin CHARACTERISTIC ARS_trqDiaMaxOfs_C "Diagnostic offset of the maximum value limits" VALUE 0xC7414 Kw_Ws16 200.0000 Trq -100.0000 100.0000 FORMAT "%8.4" EXTENDED_LIMITS -3276.800 3276.700 /end CHARACTERISTIC
/begin CHARACTERISTIC ARS_trqDiaMax_C "Limitation of maximum values on diagnostics" VALUE 0xC7416 Kw_Ws16 200.0000 Trq -100.0000 100.0000 FORMAT "%8.4" EXTENDED_LIMITS -3276.800 3276.700 /end CHARACTERISTIC
/begin CHARACTERISTIC ARS_vDia_C "Speed threshold for detection of diagnostic operation" VALUE 0xC7418 Kw_Ws16 300.0000 Vel 0.00 300.0000 FORMAT "%8.4" EXTENDED_LIMITS -327.6800 327.6700 /end CHARACTERISTIC
/begin CHARACTERISTIC ASDdc_T1Clu_C "ARD Störungsregler T1, ausgekuppelt" VALUE 0xC741C Kw_Wr32 1.50000000 ASD_GvrnDT1T1_float 0.00 1.50000000 FORMAT "%10.8" EXTENDED_LIMITS -1.00000000E+37 1.00000000E+37 /end CHARACTERISTIC
/begin CHARACTERISTIC ASDdc_KdClu_C "ARD Störungsregler Kd=sqrt(Td)/T1, ausgekuppelt" VALUE 0xC7420 Kw_Wr32 5.00000000 ASD_GvrnDT1Kd_float 0.00 5.00000000 FORMAT "%10.8" EXTENDED_LIMITS -1.00000000E+37 1.00000000E+37 /end CHARACTERISTIC
/begin CHARACTERISTIC ASDdc_T1ExtInt_C "ARD Störungsregler T1, externer Eingriff" VALUE 0xC7424 Kw_Wr32 1.50000000 ASD_GvrnDT1T1_float 0.00 1.50000000 FORMAT "%10.8" EXTENDED_LIMITS -1.00000000E+37 1.00000000E+37 /end CHARACTERISTIC
/begin CHARACTERISTIC ASDdc_KdExtInt_C "ARD Störungsregler Kd=sqrt(Td)/T1, externer Eingriff" VALUE 0xC7428 Kw_Wr32 5.00000000 ASD_GvrnDT1Kd_float 0.00 5.00000000 FORMAT "%10.8" EXTENDED_LIMITS -1.00000000E+37 1.00000000E+37 /end CHARACTERISTIC
/begin CHARACTERISTIC ASDdc_KdFDC_MAP "Map for r, n dependent time constant for ASDdc for sport mode" MAP 0xC7510 Kf_Xs16_Ys16_Ws16 1.500000 Kd16_sqr_rpm2Nm 0.00 1.500000 FORMAT "%8.6" EXTENDED_LIMITS -32.00000 31.99902
 /begin AXIS_DESCR STD_AXIS DrvTrn_rTransDT TransR 6 0.00 100.0000 FORMAT "%8.4" EXTENDED_LIMITS -327.6800 327.6700 DEPOSIT ABSOLUTE /end AXIS_DESCR
 /begin AXIS_DESCR STD_AXIS ASDdc_nAvrg_mp EngN 5 -32768.00 32767.00 FORMAT "%8.2" DEPOSIT ABSOLUTE /end AXIS_DESCR
/end CHARACTERISTIC
/begin CHARACTERISTIC ASDdc_KdGrip_MAP "Zeitkonstante Kd des ARD-SR (ASDdc) für den Zustand Kraftschluss" MAP 0xC742C Kf_Xs16_Ys16_Ws16 1.500000 Kd16_sqr_rpm2Nm 0.00 1.500000 FORMAT "%8.6" EXTENDED_LIMITS -32.00000 31.99902
 /begin AXIS_DESCR STD_AXIS DrvTrn_rTransDT TransR 6 0.00 100.0000 FORMAT "%8.4" EXTENDED_LIMITS -327.6800 327.6700 DEPOSIT ABSOLUTE /end AXIS_DESCR
 /begin AXIS_DESCR STD_AXIS ASDdc_nAvrg_mp EngN 5 -32768.00 32767.00 FORMAT "%8.2" DEPOSIT ABSOLUTE /end AXIS_DESCR
/end CHARACTERISTIC
/begin CHARACTERISTIC ASDdc_KdSlip_MAP "Map for r, n dependent gain for ASDdc" MAP 0xC7566 Kf_Xs16_Ys16_Ws16 1.500000 Kd16_sqr_rpm2Nm 0.00 1.500000 FORMAT "%8.6" EXTENDED_LIMITS -32.00000 31.99902
 /begin AXIS_DESCR STD_AXIS DrvTrn_rTransDT TransR 6 0.00 100.0000 FORMAT "%8.4" EXTENDED_LIMITS -327.6800 327.6700 DEPOSIT ABSOLUTE /end AXIS_DESCR
 /begin AXIS_DESCR STD_AXIS ASDdc_nAvrg_mp EngN 5 -32768.00 32767.00 FORMAT "%8.2" DEPOSIT ABSOLUTE /end AXIS_DESCR
/end CHARACTERISTIC
/begin CHARACTERISTIC ASDdc_numDefaultState_C "Nummer des Default-Primärzustandes" VALUE 0xC7482 Kw_Wu16 6.000000 OneToOne 0.00 6.000000 FORMAT "%8.6" EXTENDED_LIMITS 0.00 65535.00 /end CHARACTERISTIC
/begin CHARACTERISTIC ASDdc_numPrio_C "Prioritäten der Primärzustände" VAL_BLK 0xC75BC Kwb_Wu8 255.0 OneToOne 0.00 255.0 FORMAT "%5.1" NUMBER 7 /end CHARACTERISTIC
/begin CHARACTERISTIC ASDdc_T1State3_C "ARD Störungsregler T1, Primärzustand 3" VALUE 0xC7484 Kw_Wr32 1.50000000 ASD_GvrnDT1T1_float 0.00 1.50000000 FORMAT "%10.8" EXTENDED_LIMITS -1.00000000E+37 1.00000000E+37 /end CHARACTERISTIC
/begin CHARACTERISTIC ASDdc_KdState3_C "ARD Störungsregler Kd, Primärzustand 3" VALUE 0xC7488 Kw_Wr32 5.00000000 ASD_GvrnDT1Kd_float 0.00 5.00000000 FORMAT "%10.8" EXTENDED_LIMITS -1.00000000E+37 1.00000000E+37 /end CHARACTERISTIC
/begin CHARACTERISTIC ASDdc_T1State4_C "ARD Störungsregler T1, Primärzustand 4" VALUE 0xC748C Kw_Wr32 1.50000000 ASD_GvrnDT1T1_float 0.00 1.50000000 FORMAT "%10.8" EXTENDED_LIMITS -1.00000000E+37 1.00000000E+37 /end CHARACTERISTIC
/begin CHARACTERISTIC ASDdc_KdState4_C "ARD Störungsregler Kd=sqrt(Td)/T1, Primärzustand 4" VALUE 0xC7490 Kw_Wr32 5.00000000 ASD_GvrnDT1Kd_float 0.00 5.00000000 FORMAT "%10.8" EXTENDED_LIMITS -1.00000000E+37 1.00000000E+37 /end CHARACTERISTIC
/begin CHARACTERISTIC ASDdc_stConfCluEng_C "Angeforderte Zustände der Eingangsbedingung geschlossene Wandlerkupplung" VALUE 0xC7494 Kw_Wu16 65535.00 OneToOne 0.00 65535.00 FORMAT "%8.2" /end CHARACTERISTIC
/begin CHARACTERISTIC ASDdc_stConfCluOff_C "Angeforderte Zustände der Eingangsbedingung offener Wandlerkupplung" VALUE 0xC7496 Kw_Wu16 65535.00 OneToOne 0.00 65535.00 FORMAT "%8.2" /end CHARACTERISTIC
/begin CHARACTERISTIC ASDdc_stConfCluSlip_C "Angeforderte Zustände der Eingangsbedingung geregelter Wandlerkupplung" VALUE 0xC7498 Kw_Wu16 65535.00 OneToOne 0.00 65535.00 FORMAT "%8.2" /end CHARACTERISTIC
/begin CHARACTERISTIC ASDdc_stConv1_C "Die Eingangsbedingung ist erfüllt, wenn FrmMng_stConv == ASDdc_stConv1_C" VALUE 0xC749A Kw_Wu8 255.0 OneToOne 0.00 255.0 FORMAT "%5.1" /end CHARACTERISTIC
/begin CHARACTERISTIC ASDdc_stConv2_C "Die Eingangsbedingung ist erfüllt, wenn FrmMng_stConv == ASDdc_stConv2_C" VALUE 0xC749B Kw_Wu8 255.0 OneToOne 0.00 255.0 FORMAT "%5.1" /end CHARACTERISTIC
/begin CHARACTERISTIC ASDdc_stConv3_C "Die Eingangsbedingung ist erfüllt, wenn FrmMng_stConv == ASDdc_stConv3_C" VALUE 0xC749C Kw_Wu8 255.0 OneToOne 0.00 255.0 FORMAT "%5.1" /end CHARACTERISTIC
/begin CHARACTERISTIC ASDdc_stExtInt_C "Angeforderte Zustände der Eingangsbedingung ""Externer Eingriff""" VALUE 0xC749E Kw_Wu16 65535.00 OneToOne 0.00 65535.00 FORMAT "%8.2" /end CHARACTERISTIC
/begin CHARACTERISTIC ASDdc_stFDC_C "Vehicle mode switch" VALUE 0xC74A0 Kw_Wu16 65535.00 OneToOne 0.00 65535.00 FORMAT "%8.2" /end CHARACTERISTIC
/begin CHARACTERISTIC ASDdc_stGearswitch_C "Angeforderte Zustände der Eingangangsbedingung Gangumschaltung aktiv" VALUE 0xC74A2 Kw_Wu16 65535.00 OneToOne 0.00 65535.00 FORMAT "%8.2" /end CHARACTERISTIC
/begin CHARACTERISTIC ASDdc_stGripRaw_C "Angeforderte Zustände der Eingangsbedingung ""Kraftschluss""" VALUE 0xC74A4 Kw_Wu16 65535.00 OneToOne 0.00 65535.00 FORMAT "%8.2" /end CHARACTERISTIC
/begin CHARACTERISTIC ASDdc_stGrip_C "Angeforderte Zustände der Eingangsbedingung ""Kraftschluss und Nulldurchgang des Störungsreglers""" VALUE 0xC74A6 Kw_Wu16 65535.00 OneToOne 0.00 65535.00 FORMAT "%8.2" /end CHARACTERISTIC
/begin CHARACTERISTIC ASDdc_swtCalcN_C "Wählt Motorgeschwindigkeit für Parameter- Map. 1: ASDdc_nAvrg_mp = Eng_nAvrg;   0: ASDdc_nAvrg_mp = Eng_nAvrg - LIGov_nSetpoint" VALUE 0xC74A8 Kw_Wu8 255.0 OneToOne 0.00 255.0 FORMAT "%5.1" /end CHARACTERISTIC
/begin CHARACTERISTIC ASDdc_swtInitPS_C "Schalter zur 1: Aktivierung, 0: Deaktivierung der kontinuierlichen Initialisierung aufgrund Parametersatzwechsels" VALUE 0xC74A9 Kw_Wu8 255.0 OneToOne 0.00 255.0 FORMAT "%5.1" /end CHARACTERISTIC
/begin CHARACTERISTIC ASDdc_swtOpr_C "Schalter des Verknüpfungsoperators  (00=OR : 01=AND : 10=NAND : 11=NOR)" VALUE 0xC74AA Kw_Wu16 65535.00 OneToOne 0.00 65535.00 FORMAT "%8.2" /end CHARACTERISTIC
/begin CHARACTERISTIC ASDdc_T1FDC_MAP "Map for r, n dependent time constant for ASDdc for sport mode" MAP 0xC75C4 Kf_Xs16_Ys16_Ws16 1.498917 TimeDelay_s_Lin_16 0.001068148 1.499985 FORMAT "%8.6" EXTENDED_LIMITS -5.000153 5.000000
 /begin AXIS_DESCR STD_AXIS DrvTrn_rTransDT TransR 6 0.00 100.0000 FORMAT "%8.4" EXTENDED_LIMITS -327.6800 327.6700 DEPOSIT ABSOLUTE /end AXIS_DESCR
 /begin AXIS_DESCR STD_AXIS ASDdc_nAvrg_mp EngN 5 -32768.00 32767.00 FORMAT "%8.2" DEPOSIT ABSOLUTE /end AXIS_DESCR
/end CHARACTERISTIC
/begin CHARACTERISTIC ASDdc_T1Grip_MAP "Zeitkonstante T1 des ARD-SR (ASDdc) für den Zustand Kraftschluss" MAP 0xC74AC Kf_Xs16_Ys16_Ws16 1.498917 TimeDelay_s_Lin_16 0.001068148 1.499985 FORMAT "%8.6" EXTENDED_LIMITS -5.000153 5.000000
 /begin AXIS_DESCR STD_AXIS DrvTrn_rTransDT TransR 6 0.00 100.0000 FORMAT "%8.4" EXTENDED_LIMITS -327.6800 327.6700 DEPOSIT ABSOLUTE /end AXIS_DESCR
 /begin AXIS_DESCR STD_AXIS ASDdc_nAvrg_mp EngN 5 -32768.00 32767.00 FORMAT "%8.2" DEPOSIT ABSOLUTE /end AXIS_DESCR
/end CHARACTERISTIC
/begin CHARACTERISTIC ASDdc_T1Slip_MAP "Map for r, n dependent time constant for ASDdc" MAP 0xC761A Kf_Xs16_Ys16_Ws16 1.498917 TimeDelay_s_Lin_16 0.001068148 1.499985 FORMAT "%8.6" EXTENDED_LIMITS -5.000153 5.000000
 /begin AXIS_DESCR STD_AXIS DrvTrn_rTransDT TransR 6 0.00 100.0000 FORMAT "%8.4" EXTENDED_LIMITS -327.6800 327.6700 DEPOSIT ABSOLUTE /end AXIS_DESCR
 /begin AXIS_DESCR STD_AXIS ASDdc_nAvrg_mp EngN 5 -32768.00 32767.00 FORMAT "%8.2" DEPOSIT ABSOLUTE /end AXIS_DESCR
/end CHARACTERISTIC
/begin CHARACTERISTIC ASDdc_trqLimMax_C "ARD Begrenzung Ausgang Störregler MAX" VALUE 0xC7504 Kw_Wr32 1500.00000 Trq_float -500.000000 1000.00000 FORMAT "%10.5" EXTENDED_LIMITS -1.00000000E+37 1.00000000E+37 /end CHARACTERISTIC
/begin CHARACTERISTIC ASDdc_trqLimMin_C "ARD Begrenzung Ausgang Störregler MIN" VALUE 0xC7508 Kw_Wr32 1500.00000 Trq_float -500.000000 1000.00000 FORMAT "%10.5" EXTENDED_LIMITS -1.00000000E+37 1.00000000E+37 /end CHARACTERISTIC
/begin CHARACTERISTIC ASDdc_trq_Vector "#SSD Bypass Label, nicht ändern!" VALUE 0xC3070 Kw_Wu8 255.0 OneToOne 0.00 255.0 FORMAT "%5.1" /end CHARACTERISTIC
/begin CHARACTERISTIC ASDdc_trq_Channel "#SSD Bypass Label, nicht ändern!" VALUE 0xC3071 Kw_Wu8 255.0 OneToOne 0.00 255.0 FORMAT "%5.1" /end CHARACTERISTIC
/begin CHARACTERISTIC ASDdc_vLimIni_C "ARD Geschwindigkeitsschwelle f. Initialisierung Störregler" VALUE 0xC750C Kw_Ws16 655.3500 Vel -327.6800 327.6700 FORMAT "%8.4" /end CHARACTERISTIC
/begin CHARACTERISTIC ASDrf_T1CluNeg_C "ARD Führungsformer T1 Kupplung neg. Gradient" VALUE 0xC76B8 Kw_Wu32 4294.9673 TimeDelay_s 0.0000010000000 4294.9673 FORMAT "%9.4" /end CHARACTERISTIC
/begin CHARACTERISTIC ASDrf_KdCluNeg_C "ARD Führungsformer Kd=Td/T1 Kupplung neg. Gradient" VALUE 0xC76BC Kw_Ws32 32769.0000000 Kd -32768.0000000 1.00000000000 FORMAT "%13.7" EXTENDED_LIMITS -32768.0000000 32767.9999847 /end CHARACTERISTIC
/begin CHARACTERISTIC ASDrf_T1CluPos_C "ARD Führungsformer T1 Kupplung pos. Gradient" VALUE 0xC76C0 Kw_Wu32 4294.9673 TimeDelay_s 0.0000010000000 4294.9673 FORMAT "%9.4" /end CHARACTERISTIC
/begin CHARACTERISTIC ASDrf_KdCluPos_C "ARD Führungsformer Kd=Td/T1 Kupplung Ganggruppe pos. Gradient" VALUE 0xC76C4 Kw_Ws32 32769.0000000 Kd -32768.0000000 1.00000000000 FORMAT "%13.7" EXTENDED_LIMITS -32768.0000000 32767.9999847 /end CHARACTERISTIC
/begin CHARACTERISTIC ASDrf_CoeffADecLim_C "Koeffitient A der Parabel y = a*x^2 + b der Steigungsbegrenzung für Drehmomentabsenkung." VALUE 0xC7670 Kw_Ws16 159.9951 CoeffA 0.00 159.9951 FORMAT "%8.4" EXTENDED_LIMITS -160.0000 159.9951 /end CHARACTERISTIC
/begin CHARACTERISTIC ASDrf_CoeffAFDCLossNeg_CUR "Curve for 2nd order parable coeffitient for lad for sport mode" CURVE 0xC7784 Kl_Xs16_Ws16 319.9951 CoeffA -160.0000 159.9951 FORMAT "%8.4"
 /begin AXIS_DESCR STD_AXIS DrvTrn_rTransDT TransR 8 0.00 100.0000 FORMAT "%8.4" EXTENDED_LIMITS -327.6800 327.6700 DEPOSIT ABSOLUTE /end AXIS_DESCR
/end CHARACTERISTIC
/begin CHARACTERISTIC ASDrf_CoeffAFDCLossPos_CUR "Curve for 2nd order parable coeffitient for lad" CURVE 0xC77A6 Kl_Xs16_Ws16 319.9951 CoeffA -160.0000 159.9951 FORMAT "%8.4"
 /begin AXIS_DESCR STD_AXIS DrvTrn_rTransDT TransR 8 0.00 100.0000 FORMAT "%8.4" EXTENDED_LIMITS -327.6800 327.6700 DEPOSIT ABSOLUTE /end AXIS_DESCR
/end CHARACTERISTIC
/begin CHARACTERISTIC ASDrf_CoeffAGripLossNeg_CUR "Kennlinie für den Koeffitienten zweiter Ordnung der LSD Steigungsbegrenzung." CURVE 0xC77C8 Kl_Xs16_Ws16 319.9951 CoeffA -160.0000 159.9951 FORMAT "%8.4"
 /begin AXIS_DESCR STD_AXIS DrvTrn_rTransDT TransR 6 0.00 100.0000 FORMAT "%8.4" EXTENDED_LIMITS -327.6800 327.6700 DEPOSIT ABSOLUTE /end AXIS_DESCR
/end CHARACTERISTIC
/begin CHARACTERISTIC ASDrf_CoeffAGripLossPos_CUR "Kennlinie für den Koeffitienten zweiter Ordnung der LSD Steigungsbegrenzung." CURVE 0xC77E2 Kl_Xs16_Ws16 319.9951 CoeffA -160.0000 159.9951 FORMAT "%8.4"
 /begin AXIS_DESCR STD_AXIS DrvTrn_rTransDT TransR 6 0.00 100.0000 FORMAT "%8.4" EXTENDED_LIMITS -327.6800 327.6700 DEPOSIT ABSOLUTE /end AXIS_DESCR
/end CHARACTERISTIC
/begin CHARACTERISTIC ASDrf_CoeffBDecLim_C "Koeffitient B der Parabel y = a*x^2 + b der Steigungsbegrenzung für Drehmomentabsenkung." VALUE 0xC7672 Kw_Ws16 3276.700 dTrq 0.00 3276.700 FORMAT "%8.3" EXTENDED_LIMITS -3276.800 3276.700 /end CHARACTERISTIC
/begin CHARACTERISTIC ASDrf_CoeffBFDCLossNeg_CUR "Curve for 0th order parable coeffitient for lad" CURVE 0xC77FC Kl_Xs16_Ws16 6553.500 dTrq -3276.800 3276.700 FORMAT "%8.3"
 /begin AXIS_DESCR STD_AXIS DrvTrn_rTransDT TransR 8 0.00 100.0000 FORMAT "%8.4" EXTENDED_LIMITS -327.6800 327.6700 DEPOSIT ABSOLUTE /end AXIS_DESCR
/end CHARACTERISTIC
/begin CHARACTERISTIC ASDrf_CoeffBFDCLossPos_CUR "Curve for 0th order parable coeffitient for lad" CURVE 0xC781E Kl_Xs16_Ws16 6553.500 dTrq -3276.800 3276.700 FORMAT "%8.3"
 /begin AXIS_DESCR STD_AXIS DrvTrn_rTransDT TransR 8 0.00 100.0000 FORMAT "%8.4" EXTENDED_LIMITS -327.6800 327.6700 DEPOSIT ABSOLUTE /end AXIS_DESCR
/end CHARACTERISTIC
/begin CHARACTERISTIC ASDrf_CoeffBGripLossNeg_CUR "Kennlinie für den Koeffitienten nullter Ordnung der LSD Steigungsbegrenzung." CURVE 0xC7840 Kl_Xs16_Ws16 6553.500 dTrq -3276.800 3276.700 FORMAT "%8.3"
 /begin AXIS_DESCR STD_AXIS DrvTrn_rTransDT TransR 6 0.00 100.0000 FORMAT "%8.4" EXTENDED_LIMITS -327.6800 327.6700 DEPOSIT ABSOLUTE /end AXIS_DESCR
/end CHARACTERISTIC
/begin CHARACTERISTIC ASDrf_CoeffBGripLossPos_CUR "Kennlinie für den Koeffitienten nullter Ordnung der LSD Steigungsbegrenzung." CURVE 0xC785A Kl_Xs16_Ws16 6553.500 dTrq -3276.800 3276.700 FORMAT "%8.3"
 /begin AXIS_DESCR STD_AXIS DrvTrn_rTransDT TransR 6 0.00 100.0000 FORMAT "%8.4" EXTENDED_LIMITS -327.6800 327.6700 DEPOSIT ABSOLUTE /end AXIS_DESCR
/end CHARACTERISTIC
/begin CHARACTERISTIC ASDrf_dtrqIncLimLow_C "Hystereseschwelle unten zur Erkennung von nicht steilen Drehmoment Gradienten." VALUE 0xC7674 Kw_Ws16 3276.700 dTrq 0.00 3276.700 FORMAT "%8.3" EXTENDED_LIMITS -3276.800 3276.700 /end CHARACTERISTIC
/begin CHARACTERISTIC ASDrf_dtrqIncLimHigh_C "Hysterese Schwelle oben für steile Drehmomentanstiege." VALUE 0xC7676 Kw_Ws16 3276.700 dTrq 0.00 3276.700 FORMAT "%8.3" EXTENDED_LIMITS -3276.800 3276.700 /end CHARACTERISTIC
/begin CHARACTERISTIC ASDrf_stIncLimLow_C "Hysteresewert für flachen Drehmomentenanstieg." VALUE 0xC7678 Kw_Ws16 65535.00 OneToOne -32768.00 32767.00 FORMAT "%8.2" READ_ONLY /end CHARACTERISTIC
/begin CHARACTERISTIC ASDrf_stIncLimHigh_C "Hysteresewert für steilen Drehmomentenanstieg." VALUE 0xC767A Kw_Ws16 65535.00 OneToOne -32768.00 32767.00 FORMAT "%8.2" READ_ONLY /end CHARACTERISTIC
/begin CHARACTERISTIC ASDrf_dtrqIncLim_C "Momentensteigung zur deaktivierung der Steigungsbegrenzung bei steigendem Eingangssignal." VALUE 0xC767C Kw_Ws16 3276.700 dTrq 0.00 3276.700 FORMAT "%8.3" EXTENDED_LIMITS -3276.800 3276.700 /end CHARACTERISTIC
/begin CHARACTERISTIC ASDrf_dtrqInrLtdLim_CUR "Kurve zur Begrenzung der zeitl. Ableitung von CoEng_trqInrLtd" CURVE 0xC767E Kl_Xs16_Ws16 4000.000 dTrq -2000.000 2000.000 FORMAT "%8.3" EXTENDED_LIMITS -3276.800 3276.700
 /begin AXIS_DESCR STD_AXIS ASDrf_dtrqInrLtd_mp dTrq 7 -2000.000 2000.000 FORMAT "%8.3" EXTENDED_LIMITS -3276.800 3276.700 DEPOSIT ABSOLUTE /end AXIS_DESCR
/end CHARACTERISTIC
/begin CHARACTERISTIC ASDrf_dtrqSteepNeg_C "Obergrenze für Initialisierung bei steilen Eingangssignalgradienten" VALUE 0xC769C Kw_Ws16 2000.000 dTrq -2000.000 0.00 FORMAT "%8.3" EXTENDED_LIMITS -3276.800 3276.700 /end CHARACTERISTIC
/begin CHARACTERISTIC ASDrf_dtrqSteepPos_C "Untergrenze für Initialisierung bei steilen Eingangssignalgradienten" VALUE 0xC769E Kw_Ws16 2000.000 dTrq 0.00 2000.000 FORMAT "%8.3" EXTENDED_LIMITS -3276.800 3276.700 /end CHARACTERISTIC
/begin CHARACTERISTIC ASDrf_T1ExtInt_C "ARD Führungsformer T1, externer Eingriff" VALUE 0xC76C8 Kw_Wu32 4294.9673 TimeDelay_s 0.0000010000000 4294.9673 FORMAT "%9.4" /end CHARACTERISTIC
/begin CHARACTERISTIC ASDrf_KdExtInt_C "ARD Führungsformer Kd=Td/T1, externer Eingriff" VALUE 0xC76CC Kw_Ws32 32769.0000000 Kd -32768.0000000 1.00000000000 FORMAT "%13.7" EXTENDED_LIMITS -32768.0000000 32767.9999847 /end CHARACTERISTIC
/begin CHARACTERISTIC ASDrf_T1Flt_C "Zeitkonstante PT1 Glied zur Filterung von CoEng_trqInrLtd vor der Ableitung." VALUE 0xC76A0 Kw_Wu32 4294.9673 TimeDelay_s 0.0000010000000 4294.9673 FORMAT "%9.4" /end CHARACTERISTIC
/begin CHARACTERISTIC ASDrf_KdFDCNeg_CUR "Curve for n dependent gain for PDT1 filtering for negative i/p gradient" CURVE 0xC7874 Kl_Xs16_Ws16 1.000000 Kd_Lin_16 0.00 1.000000 FORMAT "%8.6" EXTENDED_LIMITS -1.000031 1.000000
 /begin AXIS_DESCR STD_AXIS DrvTrn_rTransDT TransR 8 0.00 100.0000 FORMAT "%8.4" EXTENDED_LIMITS -327.6800 327.6700 DEPOSIT ABSOLUTE /end AXIS_DESCR
/end CHARACTERISTIC
/begin CHARACTERISTIC ASDrf_KdFDCPos_CUR "Curve for n dependent gain for PDT1 filtering for positive i/p gradient" CURVE 0xC7896 Kl_Xs16_Ws16 1.000000 Kd_Lin_16 0.00 1.000000 FORMAT "%8.6" EXTENDED_LIMITS -1.000031 1.000000
 /begin AXIS_DESCR STD_AXIS DrvTrn_rTransDT TransR 8 0.00 100.0000 FORMAT "%8.4" EXTENDED_LIMITS -327.6800 327.6700 DEPOSIT ABSOLUTE /end AXIS_DESCR
/end CHARACTERISTIC
/begin CHARACTERISTIC ASDrf_KdGripNeg_CUR "Kd bei geschlosenem Antreibsstrang und negativem Gradienten" CURVE 0xC78B8 Kl_Xs16_Ws16 1.000000 Kd_Lin_16 0.00 1.000000 FORMAT "%8.6" EXTENDED_LIMITS -1.000031 1.000000
 /begin AXIS_DESCR STD_AXIS DrvTrn_rTransDT TransR 6 0.00 100.0000 FORMAT "%8.4" EXTENDED_LIMITS -327.6800 327.6700 DEPOSIT ABSOLUTE /end AXIS_DESCR
/end CHARACTERISTIC
/begin CHARACTERISTIC ASDrf_KdGripPos_CUR "Kd bei geschlosenem Antreibsstrang und positivem Gradienten" CURVE 0xC78D2 Kl_Xs16_Ws16 1.000000 Kd_Lin_16 0.00 1.000000 FORMAT "%8.6" EXTENDED_LIMITS -1.000031 1.000000
 /begin AXIS_DESCR STD_AXIS DrvTrn_rTransDT TransR 6 0.00 100.0000 FORMAT "%8.4" EXTENDED_LIMITS -327.6800 327.6700 DEPOSIT ABSOLUTE /end AXIS_DESCR
/end CHARACTERISTIC
/begin CHARACTERISTIC ASDrf_numDefaultState_C "Vorgabestatus" VALUE 0xC76D0 Kw_Wu16 5.00000000000 ASDrf_numDefaultState 0.00 5.00000000000 FORMAT "%13.11" /end CHARACTERISTIC
/begin CHARACTERISTIC ASDrf_numPrio_C "Statuspriorität" VAL_BLK 0xC78EC Kwb_Wu8 255.0 OneToOne 0.00 255.0 FORMAT "%5.1" NUMBER 6 /end CHARACTERISTIC
/begin CHARACTERISTIC ASDrf_CoeffACluLossNeg_C "Kennwert für den Koeffitienten zweiter Ordnung der LSD Steigungsbegrenzung." VALUE 0xC76D2 Kw_Ws16 159.9951 CoeffA 0.00 159.9951 FORMAT "%8.4" EXTENDED_LIMITS -160.0000 159.9951 /end CHARACTERISTIC
/begin CHARACTERISTIC ASDrf_CoeffBCluLossNeg_C "Kennlinie für den Koeffitienten nullter Ordnung der LSD Steigungsbegrenzung." VALUE 0xC76D4 Kw_Ws16 3276.700 dTrq 0.00 3276.700 FORMAT "%8.3" EXTENDED_LIMITS -3276.800 3276.700 /end CHARACTERISTIC
/begin CHARACTERISTIC ASDrf_CoeffACluLossPos_C "Kennwert für den Koeffitienten zweiter Ordnung der LSD Steigungsbegrenzung." VALUE 0xC76D6 Kw_Ws16 159.9951 CoeffA 0.00 159.9951 FORMAT "%8.4" EXTENDED_LIMITS -160.0000 159.9951 /end CHARACTERISTIC
/begin CHARACTERISTIC ASDrf_CoeffBCluLossPos_C "Kennwert für den Koeffitienten nullter Ordnung der LSD Steigungsbegrenzung." VALUE 0xC76D8 Kw_Ws16 3276.700 dTrq 0.00 3276.700 FORMAT "%8.3" EXTENDED_LIMITS -3276.800 3276.700 /end CHARACTERISTIC
/begin CHARACTERISTIC ASDrf_CoeffAExtIntLoss_C "Kennwert für den Koeffitienten zweiter Ordnung der LSD Steigungsbegrenzung." VALUE 0xC76DA Kw_Ws16 159.9951 CoeffA 0.00 159.9951 FORMAT "%8.4" EXTENDED_LIMITS -160.0000 159.9951 /end CHARACTERISTIC
/begin CHARACTERISTIC ASDrf_CoeffBExtIntLoss_C "Kennwert für den Koeffitienten nullter Ordnung der LSD Steigungsbegrenzung." VALUE 0xC76DC Kw_Ws16 3276.700 dTrq 0.00 3276.700 FORMAT "%8.3" EXTENDED_LIMITS -3276.800 3276.700 /end CHARACTERISTIC
/begin CHARACTERISTIC ASDrf_CoeffAState3LossNeg_C "Kennwert für den Koeffitienten zweiter Ordnung der LSD Steigungsbegrenzung." VALUE 0xC76DE Kw_Ws16 159.9951 CoeffA 0.00 159.9951 FORMAT "%8.4" EXTENDED_LIMITS -160.0000 159.9951 /end CHARACTERISTIC
/begin CHARACTERISTIC ASDrf_CoeffBState3LossNeg_C "Kennwert für den Koeffitienten nullter Ordnung der LSD Steigungsbegrenzung." VALUE 0xC76E0 Kw_Ws16 3276.700 dTrq 0.00 3276.700 FORMAT "%8.3" EXTENDED_LIMITS -3276.800 3276.700 /end CHARACTERISTIC
/begin CHARACTERISTIC ASDrf_CoeffAState3LossPos_C "Kennwert für den Koeffitienten zweiter Ordnung der LSD Steigungsbegrenzung." VALUE 0xC76E2 Kw_Ws16 159.9951 CoeffA 0.00 159.9951 FORMAT "%8.4" EXTENDED_LIMITS -160.0000 159.9951 /end CHARACTERISTIC
/begin CHARACTERISTIC ASDrf_CoeffBState3LossPos_C "Kennwert für den Koeffitienten nullter Ordnung der LSD Steigungsbegrenzung." VALUE 0xC76E4 Kw_Ws16 3276.700 dTrq 0.00 3276.700 FORMAT "%8.3" EXTENDED_LIMITS -3276.800 3276.700 /end CHARACTERISTIC
/begin CHARACTERISTIC ASDrf_CoeffAState4LossNeg_C "Kennwert für den Koeffitienten zweiter Ordnung der LSD Steigungsbegrenzung." VALUE 0xC76E6 Kw_Ws16 159.9951 CoeffA 0.00 159.9951 FORMAT "%8.4" EXTENDED_LIMITS -160.0000 159.9951 /end CHARACTERISTIC
/begin CHARACTERISTIC ASDrf_CoeffBState4LossNeg_C "Kennwert für den Koeffitienten nullter Ordnung der LSD Steigungsbegrenzung." VALUE 0xC76E8 Kw_Ws16 3276.700 dTrq 0.00 3276.700 FORMAT "%8.3" EXTENDED_LIMITS -3276.800 3276.700 /end CHARACTERISTIC
/begin CHARACTERISTIC ASDrf_CoeffAState4LossPos_C "Kennwert für den Koeffitienten zweiter Ordnung der LSD Steigungsbegrenzung." VALUE 0xC76EA Kw_Ws16 159.9951 CoeffA 0.00 159.9951 FORMAT "%8.4" EXTENDED_LIMITS -160.0000 159.9951 /end CHARACTERISTIC
/begin CHARACTERISTIC ASDrf_CoeffBState4LossPos_C "Kennwert für den Koeffitienten nullter Ordnung der LSD Steigungsbegrenzung." VALUE 0xC76EC Kw_Ws16 3276.700 dTrq 0.00 3276.700 FORMAT "%8.3" EXTENDED_LIMITS -3276.800 3276.700 /end CHARACTERISTIC
/begin CHARACTERISTIC ASDrf_T1State3Neg_C "ARD Führungsformer T1 frei wählbarer Zustand 3 neg. Gradient" VALUE 0xC76F0 Kw_Wu32 4294.9673 TimeDelay_s 0.0000010000000 4294.9673 FORMAT "%9.4" /end CHARACTERISTIC
/begin CHARACTERISTIC ASDrf_KdState3Neg_C "ARD Führungsformer Kd=Td/T1 frei wählbarer Zustand 3 neg. Gradient" VALUE 0xC76F4 Kw_Ws32 32769.0000000 Kd -32768.0000000 1.00000000000 FORMAT "%13.7" EXTENDED_LIMITS -32768.0000000 32767.9999847 /end CHARACTERISTIC
/begin CHARACTERISTIC ASDrf_T1State3Pos_C "ARD Führungsformer T1 frei wählbarer Zustand 3 pos. Gradient" VALUE 0xC76F8 Kw_Wu32 4294.9673 TimeDelay_s 0.0000010000000 4294.9673 FORMAT "%9.4" /end CHARACTERISTIC
/begin CHARACTERISTIC ASDrf_KdState3Pos_C "ARD Führungsformer Kd=Td/T1 frei wählbarer Zustand 3 pos. Gradient" VALUE 0xC76FC Kw_Ws32 32769.0000000 Kd -32768.0000000 1.00000000000 FORMAT "%13.7" EXTENDED_LIMITS -32768.0000000 32767.9999847 /end CHARACTERISTIC
/begin CHARACTERISTIC ASDrf_T1State4Neg_C "ARD Führungsformer T1 frei wählbarer Zustand 4 neg. Gradient" VALUE 0xC7700 Kw_Wu32 4294.9673 TimeDelay_s 0.0000010000000 4294.9673 FORMAT "%9.4" /end CHARACTERISTIC
/begin CHARACTERISTIC ASDrf_KdState4Neg_C "ARD Führungsformer Kd=Td/T1 frei wählbarer Zustand 4 neg. Gradient" VALUE 0xC7704 Kw_Ws32 32769.0000000 Kd -32768.0000000 1.00000000000 FORMAT "%13.7" EXTENDED_LIMITS -32768.0000000 32767.9999847 /end CHARACTERISTIC
/begin CHARACTERISTIC ASDrf_T1State4Pos_C "ARD Führungsformer T1 frei wählbarer Zustand 4 pos. Gradient" VALUE 0xC7708 Kw_Wu32 4294.9673 TimeDelay_s 0.0000010000000 4294.9673 FORMAT "%9.4" /end CHARACTERISTIC
/begin CHARACTERISTIC ASDrf_KdState4Pos_C "ARD Führungsformer Kd=Td/T1 frei wählbarer Zustand 4 pos. Gradient" VALUE 0xC770C Kw_Ws32 32769.0000000 Kd -32768.0000000 1.00000000000 FORMAT "%13.7" EXTENDED_LIMITS -32768.0000000 32767.9999847 /end CHARACTERISTIC
/begin CHARACTERISTIC ASDrf_stConv1_C "Eingangsbedingung ""Wandlerkupplung geschlossen""" VALUE 0xC7710 Kw_Wu8 255.0 OneToOne 0.00 255.0 FORMAT "%5.1" /end CHARACTERISTIC
/begin CHARACTERISTIC ASDrf_stConv2_C "Eingangsbedingung ""Wandlerkupplung geöffnet""" VALUE 0xC7711 Kw_Wu8 255.0 OneToOne 0.00 255.0 FORMAT "%5.1" /end CHARACTERISTIC
/begin CHARACTERISTIC ASDrf_stConv3_C "Eingangsbedingung ""Wandlerkupplung geregelt""" VALUE 0xC7712 Kw_Wu8 255.0 OneToOne 0.00 255.0 FORMAT "%5.1" /end CHARACTERISTIC
/begin CHARACTERISTIC ASDrf_stConvCluEng_C "Bitmuster der Eingangsbedingung für ""geschlossene"" Wandlerkupplung." VALUE 0xC7714 Kw_Wu16 65535.00 OneToOne 0.00 65535.00 FORMAT "%8.2" /end CHARACTERISTIC
/begin CHARACTERISTIC ASDrf_stConvCluOff_C "Bitmuster der Eingangsbedingung für ""geöffnete"" Wandlerkupplung." VALUE 0xC7716 Kw_Wu16 65535.00 OneToOne 0.00 65535.00 FORMAT "%8.2" /end CHARACTERISTIC
/begin CHARACTERISTIC ASDrf_stConvCluSlip_C "Bitmuster der Eingangsbedingung für ""geregelte"" Wandlerkupplung." VALUE 0xC7718 Kw_Wu16 65535.00 OneToOne 0.00 65535.00 FORMAT "%8.2" /end CHARACTERISTIC
/begin CHARACTERISTIC ASDrf_stEntcClu_C "Initialisierungsanforderung beim Eintritt in den Zustand ""offener Antriebsstrang""" VALUE 0xC771A Kw_Wu8 3.000 OneToOne 0.00 3.000 FORMAT "%5.3" EXTENDED_LIMITS 0.00 255.0 /end CHARACTERISTIC
/begin CHARACTERISTIC ASDrf_stEntcExtInt_C "Initialisierungsanforderung beim Eintritt in den Zustand ""externer Momenteneingriff""" VALUE 0xC771B Kw_Wu8 3.000 OneToOne 0.00 3.000 FORMAT "%5.3" EXTENDED_LIMITS 0.00 255.0 /end CHARACTERISTIC
/begin CHARACTERISTIC ASDrf_stEntcFDC_C "status of Vehicle mode" VALUE 0xC771C Kw_Wu8 3.000 OneToOne 0.00 3.000 FORMAT "%5.3" EXTENDED_LIMITS 0.00 255.0 /end CHARACTERISTIC
/begin CHARACTERISTIC ASDrf_stEntcGrip_C "Initialisierungsanforderung beim Eintritt in den Zustand ""Vortrieb""" VALUE 0xC771D Kw_Wu8 3.000 OneToOne 0.00 3.000 FORMAT "%5.3" EXTENDED_LIMITS 0.00 255.0 /end CHARACTERISTIC
/begin CHARACTERISTIC ASDrf_stEntcState3_C "Initialisierungsanforderung beim Eintritt in den Zustand 3" VALUE 0xC771E Kw_Wu8 3.000 OneToOne 0.00 3.000 FORMAT "%5.3" EXTENDED_LIMITS 0.00 255.0 /end CHARACTERISTIC
/begin CHARACTERISTIC ASDrf_stEntcState4_C "Initialisierungsanforderung beim Eintritt in den Zustand 4" VALUE 0xC771F Kw_Wu8 3.000 OneToOne 0.00 3.000 FORMAT "%5.3" EXTENDED_LIMITS 0.00 255.0 /end CHARACTERISTIC
/begin CHARACTERISTIC ASDrf_stExClu_C "Initialisierungsanforderung beim Verlassen des Zustands ""offener Antriebsstrang""" VALUE 0xC7720 Kw_Wu8 3.000 OneToOne 0.00 3.000 FORMAT "%5.3" EXTENDED_LIMITS 0.00 255.0 /end CHARACTERISTIC
/begin CHARACTERISTIC ASDrf_stExExtInt_C "Initialisierungsanforderung beim Verlassen des Zustands ""externer Momenteneingriff""" VALUE 0xC7721 Kw_Wu8 3.000 OneToOne 0.00 3.000 FORMAT "%5.3" EXTENDED_LIMITS 0.00 255.0 /end CHARACTERISTIC
/begin CHARACTERISTIC ASDrf_stExFDC_C "status of exit init flag" VALUE 0xC7722 Kw_Wu8 3.000 OneToOne 0.00 3.000 FORMAT "%5.3" EXTENDED_LIMITS 0.00 255.0 /end CHARACTERISTIC
/begin CHARACTERISTIC ASDrf_stExGrip_C "Initialisierungsanforderung beim Verlasssen des Zustands ""Vortrieb""" VALUE 0xC7723 Kw_Wu8 3.000 OneToOne 0.00 3.000 FORMAT "%5.3" EXTENDED_LIMITS 0.00 255.0 /end CHARACTERISTIC
/begin CHARACTERISTIC ASDrf_stExState3_C "Initialisierungsanforderung beim Verlassen des Zustands 3" VALUE 0xC7724 Kw_Wu8 3.000 OneToOne 0.00 3.000 FORMAT "%5.3" EXTENDED_LIMITS 0.00 255.0 /end CHARACTERISTIC
/begin CHARACTERISTIC ASDrf_stExState4_C "Initialisierungsanforderung beim Verlassen des Zustands 4" VALUE 0xC7725 Kw_Wu8 3.000 OneToOne 0.00 3.000 FORMAT "%5.3" EXTENDED_LIMITS 0.00 255.0 /end CHARACTERISTIC
/begin CHARACTERISTIC ASDrf_stExtInt_C "Konfiguration der Eingangsbedingung ""externer Momenteneingriff""" VALUE 0xC7726 Kw_Wu16 65535.00 OneToOne 0.00 65535.00 FORMAT "%8.2" /end CHARACTERISTIC
/begin CHARACTERISTIC ASDrf_stFDC_C "modulation on i/p condition for sport vehicle mode" VALUE 0xC7728 Kw_Wu16 65535.00 OneToOne 0.00 65535.00 FORMAT "%8.2" /end CHARACTERISTIC
/begin CHARACTERISTIC ASDrf_stGrip_C "Konfiguration der Eingangsbedingung ""offener Antriebsstrang""" VALUE 0xC772A Kw_Wu16 65535.00 OneToOne 0.00 65535.00 FORMAT "%8.2" /end CHARACTERISTIC
/begin CHARACTERISTIC ASDrf_stReliablAdpt_C "Flags zur Bestimmung einer vertrauenswürdigen Verlustmomentadaption." VALUE 0xC772C Kw_Wu8 255.0 OneToOne 0.00 255.0 FORMAT "%5.1" /end CHARACTERISTIC
/begin CHARACTERISTIC ASDrf_swtCalcTrq_C "Schalter für die Berechnung des aktuellen ASD Moments (1: berücksichtigt ASDdc Moment, 0: ASDdc Moment nicht berücksichtigt)" VALUE 0xC76A4 Kw_Wu8 1.000 OneToOne 0.00 1.000 FORMAT "%5.3" EXTENDED_LIMITS 0.00 255.0 /end CHARACTERISTIC
/begin CHARACTERISTIC ASDrf_swtFlt_C "Schalter zur Auswahl des Filters für CoEng_trqInrLtd (0  Filterung / >0 keine Filterung)." VALUE 0xC76A5 Kw_Wu8 255.0 OneToOne 0.00 255.0 FORMAT "%5.1" /end CHARACTERISTIC
/begin CHARACTERISTIC ASDrf_swtFrzLoss_C "Schalter für die Berechnung des Verlustmoments bei aktiver Steigungsbegrenzung (1=eingefroren)" VALUE 0xC76A6 Kw_Wu8 1.000 OneToOne 0.00 1.000 FORMAT "%5.3" EXTENDED_LIMITS 0.00 255.0 /end CHARACTERISTIC
/begin CHARACTERISTIC ASDrf_swtInitPS_C "Schalter zur Aktivierung/Deaktivierung der kontinuierlichen Initialisierung aufgrund Parametersatzwechsels (>128: keine init.)" VALUE 0xC76A7 Kw_Wu8 255.0 OneToOne 0.00 255.0 FORMAT "%5.1" /end CHARACTERISTIC
/begin CHARACTERISTIC ASDrf_swtLim_C "Schalter zur Begrenzung von ASDrf_trqIn. (Bit0 gesetzt: verhindere <0, Bit1 gesetzt: verhindere >CoEng_trqInrLim)" VALUE 0xC76A8 Kw_Wu8 3.000 OneToOne 0.00 3.000 FORMAT "%5.3" EXTENDED_LIMITS 0.00 255.0 /end CHARACTERISTIC
/begin CHARACTERISTIC ASDrf_swtLossClcNoRel_C "Verlustmoment wenn keine Verlustmomentadaption. Applikationsdaten als 0: absolut, 1: offset, 2: offset zum angepassten Moment" VALUE 0xC772D Kw_Wu8 2.000 OneToOne 0.00 2.000 FORMAT "%5.3" EXTENDED_LIMITS 0.00 255.0 /end CHARACTERISTIC
/begin CHARACTERISTIC ASDrf_swtLossClcRel_C " Verlustmoment bei Verlustmomentadaption. Verw. Applikationsdaten als 0: absolut, 1: offset, 2: offset zum angepassten Moment" VALUE 0xC772E Kw_Wu8 2.000 OneToOne 0.00 2.000 FORMAT "%5.3" EXTENDED_LIMITS 0.00 255.0 /end CHARACTERISTIC
/begin CHARACTERISTIC ASDrf_swtOpr_C "Auswahl des Operators für die Primärzustände. (00=OR, 01=AND, 10=NAND, 11=NOR)" VALUE 0xC7730 Kw_Wu16 65535.00 OneToOne 0.00 65535.00 FORMAT "%8.2" /end CHARACTERISTIC
/begin CHARACTERISTIC ASDrf_T1FDCNeg_CUR "Curve for n dependent time constant for PDT1 filtering for negative i/p" CURVE 0xC78F2 Kl_Xs16_Ws16 1.499985 TimeDelay_s_Lin_16 0.00 1.499985 FORMAT "%8.6" EXTENDED_LIMITS -5.000153 5.000000
 /begin AXIS_DESCR STD_AXIS DrvTrn_rTransDT TransR 8 0.00 100.0000 FORMAT "%8.4" EXTENDED_LIMITS -327.6800 327.6700 DEPOSIT ABSOLUTE /end AXIS_DESCR
/end CHARACTERISTIC
/begin CHARACTERISTIC ASDrf_T1FDCPos_CUR "Curve for n dependent time constant for PDT1 filtering for positive i/p" CURVE 0xC7914 Kl_Xs16_Ws16 1.499985 TimeDelay_s_Lin_16 0.00 1.499985 FORMAT "%8.6" EXTENDED_LIMITS -5.000153 5.000000
 /begin AXIS_DESCR STD_AXIS DrvTrn_rTransDT TransR 8 0.00 100.0000 FORMAT "%8.4" EXTENDED_LIMITS -327.6800 327.6700 DEPOSIT ABSOLUTE /end AXIS_DESCR
/end CHARACTERISTIC
/begin CHARACTERISTIC ASDrf_T1GripNeg_CUR "T1 bei geshchlosenem Antreibsstrang und negativem Gradienten" CURVE 0xC7936 Kl_Xs16_Ws16 1.499985 TimeDelay_s_Lin_16 0.00 1.499985 FORMAT "%8.6" EXTENDED_LIMITS -5.000153 5.000000
 /begin AXIS_DESCR STD_AXIS DrvTrn_rTransDT TransR 6 0.00 100.0000 FORMAT "%8.4" EXTENDED_LIMITS -327.6800 327.6700 DEPOSIT ABSOLUTE /end AXIS_DESCR
/end CHARACTERISTIC
/begin CHARACTERISTIC ASDrf_T1GripPos_CUR "T1 bei geschlosenem Antriebstrang und positivem Gradienten" CURVE 0xC7950 Kl_Xs16_Ws16 1.499985 TimeDelay_s_Lin_16 0.00 1.499985 FORMAT "%8.6" EXTENDED_LIMITS -5.000153 5.000000
 /begin AXIS_DESCR STD_AXIS DrvTrn_rTransDT TransR 6 0.00 100.0000 FORMAT "%8.4" EXTENDED_LIMITS -327.6800 327.6700 DEPOSIT ABSOLUTE /end AXIS_DESCR
/end CHARACTERISTIC
/begin CHARACTERISTIC ASDrf_tiTrqSty_C "Zeit für die Erkennung des stationären Zustands, wenn das Moment innerhalb des Intervalls liegt." VALUE 0xC76AA Kw_Wu16 655350.0 Time_ms 0.00 655350.0 FORMAT "%8.1" /end CHARACTERISTIC
/begin CHARACTERISTIC ASDrf_trqDecHigh_C "Offset der oberen Intervallgrenze zur Bestimmung des stationären Zustands." VALUE 0xC76AC Kw_Ws16 1500.000 Trq -500.0000 1000.000 FORMAT "%8.3" EXTENDED_LIMITS -3276.800 3276.700 /end CHARACTERISTIC
/begin CHARACTERISTIC ASDrf_trqDecLow_C "Offset der unteren Intervallgrenze zur Bestimmung des stationären Zustands." VALUE 0xC76AE Kw_Ws16 1500.000 Trq -500.0000 1000.000 FORMAT "%8.3" EXTENDED_LIMITS -3276.800 3276.700 /end CHARACTERISTIC
/begin CHARACTERISTIC ASDrf_trqInr_Vector "#SSD Bypass Label, nicht ändern!" VALUE 0xC3072 Kw_Wu8 255.0 OneToOne 0.00 255.0 FORMAT "%5.1" /end CHARACTERISTIC
/begin CHARACTERISTIC ASDrf_trqInr_Channel "#SSD Bypass Label, nicht ändern!" VALUE 0xC3073 Kw_Wu8 255.0 OneToOne 0.00 255.0 FORMAT "%5.1" /end CHARACTERISTIC
/begin CHARACTERISTIC ASDrf_trqLossNeg_CUR "Drehzahlabhängige Kennlinie der Verlustmomente für negative Eingangsänderungen." CURVE 0xC7732 Kl_Xs16_Ws16 1500.000 Trq -500.0000 1000.000 FORMAT "%8.3" EXTENDED_LIMITS -3276.800 3276.700
 /begin AXIS_DESCR STD_AXIS Eng_nAvrg EngN 8 0.00 6000.000 FORMAT "%8.3" EXTENDED_LIMITS -32768.00 32767.00 DEPOSIT ABSOLUTE /end AXIS_DESCR
/end CHARACTERISTIC
/begin CHARACTERISTIC ASDrf_trqLossPos_CUR "Drehzahlabhängige Kennlinie der Verlustmomente für positive Eingangsänderungen." CURVE 0xC7754 Kl_Xs16_Ws16 1500.000 Trq -500.0000 1000.000 FORMAT "%8.3" EXTENDED_LIMITS -3276.800 3276.700
 /begin AXIS_DESCR STD_AXIS Eng_nAvrg EngN 8 0.00 6000.000 FORMAT "%8.3" EXTENDED_LIMITS -32768.00 32767.00 DEPOSIT ABSOLUTE /end AXIS_DESCR
/end CHARACTERISTIC
/begin CHARACTERISTIC ASDrf_trqOfsNegHigh_C "Annäherungsschwelle zum Verlustmoment." VALUE 0xC7776 Kw_Ws16 1500.000 Trq -500.0000 1000.000 FORMAT "%8.3" EXTENDED_LIMITS -3276.800 3276.700 /end CHARACTERISTIC
/begin CHARACTERISTIC ASDrf_trqOfsNegLow_C "Offset zum Verlustmoment für die Beendigung des Zustands ""Steigungsbegrenzung""." VALUE 0xC7778 Kw_Ws16 1500.000 Trq -500.0000 1000.000 FORMAT "%8.3" EXTENDED_LIMITS -3276.800 3276.700 /end CHARACTERISTIC
/begin CHARACTERISTIC ASDrf_trqOfsNegMid_C "Offset zum Verslustmoment für die Annäherungserkennung und Aktivierung des Zustands ""Steigungsbegrenzung""" VALUE 0xC777A Kw_Ws16 1500.000 Trq -500.0000 1000.000 FORMAT "%8.3" EXTENDED_LIMITS -3276.800 3276.700 /end CHARACTERISTIC
/begin CHARACTERISTIC ASDrf_trqOfsPosHigh_C "Offset zum Verlustmoment für die Beendigung des Zustands ""Steigungsbegrenzung""." VALUE 0xC777C Kw_Ws16 1500.000 Trq -500.0000 1000.000 FORMAT "%8.3" EXTENDED_LIMITS -3276.800 3276.700 /end CHARACTERISTIC
/begin CHARACTERISTIC ASDrf_trqOfsPosLow_C "Annäherungsschwelle zum Verlustmoment." VALUE 0xC777E Kw_Ws16 1500.000 Trq -500.0000 1000.000 FORMAT "%8.3" EXTENDED_LIMITS -3276.800 3276.700 /end CHARACTERISTIC
/begin CHARACTERISTIC ASDrf_trqOfsPosMid_C "Offset zum Verslustmoment für die Annäherungserkennung und Aktivierung des Zustands ""Steigungsbegrenzung""" VALUE 0xC7780 Kw_Ws16 1500.000 Trq -500.0000 1000.000 FORMAT "%8.3" EXTENDED_LIMITS -3276.800 3276.700 /end CHARACTERISTIC
/begin CHARACTERISTIC ASDrf_trqThresDecLim_C "Abstand zum Startpunt zur Deaktivierung der Steigungsbegrenzung durch Drehmomentabsenkung." VALUE 0xC76B0 Kw_Ws16 1500.000 Trq -500.0000 1000.000 FORMAT "%8.3" EXTENDED_LIMITS -3276.800 3276.700 /end CHARACTERISTIC
/begin CHARACTERISTIC ASDrf_trqThresNeg_C "ARD Führungsformer Hystereseschwelle Wunschmomentgradient 'neg' alle Ganggrp." VALUE 0xC76B2 Kw_Ws16 1500.000 Trq -500.0000 1000.000 FORMAT "%8.3" EXTENDED_LIMITS -3276.800 3276.700 /end CHARACTERISTIC
/begin CHARACTERISTIC ASDrf_trqThresPos_C "ARD Führungsformer Hystereseschwelle Wunschmomentgradient 'pos' alle Ganggrp." VALUE 0xC76B4 Kw_Ws16 1500.000 Trq -500.0000 1000.000 FORMAT "%8.3" EXTENDED_LIMITS -3276.800 3276.700 /end CHARACTERISTIC
/begin CHARACTERISTIC ASMod_dmIndAirRef_MAP "Referenz des Gasmassenstroms als Funktion der Drehzahl und der verbrannten Kraftstoffmasse" MAP 0xC796A Kf_Xs16_Ys16_Ws16 1400.000 AirMassPerTime 0.00 1400.000 FORMAT "%8.3" EXTENDED_LIMITS -3276.800 3276.700
 /begin AXIS_DESCR STD_AXIS Eng_nAvrg EngN 8 0.00 6000.000 FORMAT "%8.3" EXTENDED_LIMITS -32768.00 32767.00 DEPOSIT ABSOLUTE /end AXIS_DESCR
 /begin AXIS_DESCR STD_AXIS ASMod_qLmbdCtlCorr_mp InjMass 8 0.00 150.0000 FORMAT "%8.4" EXTENDED_LIMITS -327.6800 327.6700 DEPOSIT ABSOLUTE /end AXIS_DESCR
/end CHARACTERISTIC
/begin CHARACTERISTIC ASMod_facDdTm_C "Faktor zur Berechnung der Gaslaufzeit durch den Motor" VALUE 0xC7A0E Kw_Ws16 7.000000 Fact1 1.000000 8.000000 FORMAT "%8.6" EXTENDED_LIMITS -256.0000 255.9922 /end CHARACTERISTIC
/begin CHARACTERISTIC ASMod_facDMCorTDiff_CUR "Korrekturfaktor der Temperaturerhöhung aufgrund des aktuellen Gasmassenstroms" CURVE 0xC7A10 Kl_Xs16_Ws16 2.000000 Fact 0.00 2.000000 FORMAT "%8.6" EXTENDED_LIMITS -4.000000 3.999878
 /begin AXIS_DESCR STD_AXIS ASMod_rDMIndAir_mp RatAirMass 8 -1.000000 1.000000 FORMAT "%8.6" EXTENDED_LIMITS -32.76800 32.76700 DEPOSIT ABSOLUTE /end AXIS_DESCR
/end CHARACTERISTIC
/begin CHARACTERISTIC ASMod_facSOICorTDiff_CUR "Korrekturfaktor der Temperaturerhöhung aufgrund des aktuellen Spritzbeginns" CURVE 0xC7A32 Kl_Xs16_Ws16 2.000000 Fact 0.00 2.000000 FORMAT "%8.6" EXTENDED_LIMITS -4.000000 3.999878
 /begin AXIS_DESCR STD_AXIS InjCrv_phiMI1Des AngleCrS 8 -19.99219 19.99219 FORMAT "%8.5" EXTENDED_LIMITS -768.0000 767.9766 DEPOSIT ABSOLUTE /end AXIS_DESCR
/end CHARACTERISTIC
/begin CHARACTERISTIC ASMod_facTCorVolEff_C "Korrekturfaktor zur Kompensation der Abhängigkeit des Luftaufwands von der Gastemperatur vor Einlass" VALUE 0xC7BC8 Kw_Ws16 2.000000 RatAirMass 0.00 2.000000 FORMAT "%8.6" EXTENDED_LIMITS -32.76800 32.76700 /end CHARACTERISTIC
/begin CHARACTERISTIC ASMod_facVolEff_MAP "Luftaufwand des Motors als Funktion von Drehzahl und aktueller Einspritzmenge" MAP 0xC7BCA Kf_Xs16_Ys16_Ws16 1.000000 RatAirMass 0.00 1.000000 FORMAT "%8.6" EXTENDED_LIMITS -32.76800 32.76700
 /begin AXIS_DESCR STD_AXIS Eng_nAvrg EngN 10 0.00 6000.000 FORMAT "%8.3" EXTENDED_LIMITS -32768.00 32767.00 DEPOSIT ABSOLUTE /end AXIS_DESCR
 /begin AXIS_DESCR STD_AXIS InjCtl_qCurr InjMassCyc 15 0.00 327.6700 FORMAT "%8.4" EXTENDED_LIMITS -327.6800 327.6700 DEPOSIT ABSOLUTE /end AXIS_DESCR
/end CHARACTERISTIC
/begin CHARACTERISTIC ASMod_facVSACorVolEff_MAP "Korrekturfaktor für Luftaufwand als Funktion von Drehzahl und relativer Drallklappenposition" MAP 0xC7D2C Kf_Xs16_Ys16_Ws16 2.000000 RatAirMass 0.00 2.000000 FORMAT "%8.6" EXTENDED_LIMITS -32.76800 32.76700
 /begin AXIS_DESCR STD_AXIS Eng_nAvrg EngN 10 0.00 6000.000 FORMAT "%8.3" EXTENDED_LIMITS -32768.00 32767.00 DEPOSIT ABSOLUTE /end AXIS_DESCR
 /begin AXIS_DESCR STD_AXIS ASMod_rRelPosVSA Prc 10 0.00 100.0000 FORMAT "%8.4" EXTENDED_LIMITS -400.0000 399.9878 DEPOSIT ABSOLUTE /end AXIS_DESCR
/end CHARACTERISTIC
/begin CHARACTERISTIC ASMod_phiSOIRef_MAP "Referenz des Spritzbeginns der MI1 als Funktion der Dehzahl und der verbrannten Kraftstoffmenge" MAP 0xC7A54 Kf_Xs16_Ys16_Ws16 60.00000 AngleCrS -19.99219 40.00781 FORMAT "%8.5" EXTENDED_LIMITS -768.0000 767.9766
 /begin AXIS_DESCR STD_AXIS Eng_nAvrg EngN 8 0.00 6000.000 FORMAT "%8.3" EXTENDED_LIMITS -32768.00 32767.00 DEPOSIT ABSOLUTE /end AXIS_DESCR
 /begin AXIS_DESCR STD_AXIS ASMod_qLmbdCtlCorr_mp InjMass 8 0.00 150.0000 FORMAT "%8.4" EXTENDED_LIMITS -327.6800 327.6700 DEPOSIT ABSOLUTE /end AXIS_DESCR
/end CHARACTERISTIC
/begin CHARACTERISTIC ASMod_swtT_C "Schalter für Lufttemperatursenor (0 = Aufnahme der Lufttemperatur vom HFM6 Sensor, 1 = Lufttemperatur nach Kühler)" VALUE 0xC7E20 Kw_Wu8 1.000 OneToOne 0.00 1.000 FORMAT "%5.3" EXTENDED_LIMITS 0.00 255.0 /end CHARACTERISTIC
/begin CHARACTERISTIC ASMod_tDiffEng_MAP "Grundkennfeld der Temperaturerhöhung als Funktion der Drehzahl und der verbrannten Kraftstoffmenge" MAP 0xC7AF8 Kf_Xs16_Ys16_Ws16 1200.000 TempDiff_Cels -600.0000 600.0000 FORMAT "%8.4" EXTENDED_LIMITS -3276.800 3276.700
 /begin AXIS_DESCR STD_AXIS Eng_nAvrg EngN 8 0.00 6000.000 FORMAT "%8.3" EXTENDED_LIMITS -32768.00 32767.00 DEPOSIT ABSOLUTE /end AXIS_DESCR
 /begin AXIS_DESCR STD_AXIS ASMod_qBurned_mp InjMass 8 0.00 150.0000 FORMAT "%8.4" EXTENDED_LIMITS -327.6800 327.6700 DEPOSIT ABSOLUTE /end AXIS_DESCR
/end CHARACTERISTIC
/begin CHARACTERISTIC ASMod_tEngCorTDiff_CUR "Korrektur der Temperaturerhöhung aufgrund der Motortemperatur" CURVE 0xC7B9C Kl_Xs16_Ws16 950.0000 Temp_Cels -50.1400 899.8600 FORMAT "%8.4" EXTENDED_LIMITS -3549.8000 3003.7000
 /begin AXIS_DESCR STD_AXIS ASMod_tEngCorTDiff_mp TempDiff_Cels 8 -20.00000 120.0000 FORMAT "%8.4" EXTENDED_LIMITS -3276.800 3276.700 DEPOSIT ABSOLUTE /end AXIS_DESCR
/end CHARACTERISTIC
/begin CHARACTERISTIC ASMod_tEngRef_C "Referenz der Motoretemperatur" VALUE 0xC7BBE Kw_Ws16 950.0000 Temp_Cels -50.1400 899.8600 FORMAT "%8.4" EXTENDED_LIMITS -3549.940 3003.560 /end CHARACTERISTIC
/begin CHARACTERISTIC ASMod_tiDT1_C "Zeitkonstante des DT1-Glieds in der Funktion Einlaßvolumen (induction volume)" VALUE 0xC7BC0 Kw_Wu32 4.9499617 TimeDelay_s 0.050000201 4.9999619 FORMAT "%9.7" EXTENDED_LIMITS 0.0000010000000 4294.9673 /end CHARACTERISTIC
/begin CHARACTERISTIC ASMod_tIndAirRef_MAP "Referenz der Gastemperatur vor Einlass als Funktion von Drehzahl und aktueller Einspritzmenge" MAP 0xC7E22 Kf_Xs16_Ys16_Ws16 250.0000 Temp_Cels -50.1400 199.8600 FORMAT "%8.4" EXTENDED_LIMITS -3549.940 3003.560
 /begin AXIS_DESCR STD_AXIS Eng_nAvrg EngN 10 0.00 6000.000 FORMAT "%8.3" EXTENDED_LIMITS -32768.00 32767.00 DEPOSIT ABSOLUTE /end AXIS_DESCR
 /begin AXIS_DESCR STD_AXIS InjCtl_qCurr InjMassCyc 10 0.00 327.6700 FORMAT "%8.4" EXTENDED_LIMITS -327.6800 327.6700 DEPOSIT ABSOLUTE /end AXIS_DESCR
/end CHARACTERISTIC
/begin CHARACTERISTIC ASMod_volEng_C "Hubvolumen des Motors" VALUE 0xC7F16 Kw_Ws16 20.00000 Vol 0.00 20.00000 FORMAT "%8.5" EXTENDED_LIMITS -327.6800 327.6700 /end CHARACTERISTIC
/begin CHARACTERISTIC ASMod_volIndVol_C "Einlaßvolumen (effektives Volumen zwischen Turbolader und Mischstelle)" VALUE 0xC7BC4 Kw_Ws16 50.00000 Vol 0.00 50.00000 FORMAT "%8.5" EXTENDED_LIMITS -327.6800 327.6700 /end CHARACTERISTIC
/begin CHARACTERISTIC BattCD_uSRCMin_C "SRC-Min der Batteriespannung" VALUE 0xC7F1C Kw_Ws16 5200.391 Volt 0.00 5200.391 FORMAT "%8.3" EXTENDED_LIMITS -160156.4 160151.5 /end CHARACTERISTIC
/begin CHARACTERISTIC BattCD_uSRCMax_C "SRC-Max der Batteriespannung" VALUE 0xC7F1E Kw_Ws16 5200.391 Volt 0.00 5200.391 FORMAT "%8.3" EXTENDED_LIMITS -160156.4 160151.5 /end CHARACTERISTIC
/begin CHARACTERISTIC BattCD_uLin_CUR "Linearisierungskennlinie" CURVE 0xC7F20 Kl_Xs16_Ws16 28602.15 Volt_Batt 0.00 28602.15 FORMAT "%8.2" EXTENDED_LIMITS -640625.6 640606.1
 /begin AXIS_DESCR STD_AXIS BattCD_uRaw Volt 25 0.00 5200.391 FORMAT "%8.3" EXTENDED_LIMITS -160156.4 160151.5 DEPOSIT ABSOLUTE /end AXIS_DESCR
/end CHARACTERISTIC
/begin CHARACTERISTIC BattCD_DebSRCHighDef_C "Entprellzeit für Fehlererkennung des SRC-High-Fehlers der Batteriespannung" VALUE 0xC7F86 Kw_Wu16 655350.0 Time_ms 0.00 655350.0 FORMAT "%8.1" /end CHARACTERISTIC
/begin CHARACTERISTIC BattCD_DebSRCHighOk_C "Entprellzeit für Heilung des SRC-High-Fehlers der Batteriespannung" VALUE 0xC7F88 Kw_Wu16 655350.0 Time_ms 0.00 655350.0 FORMAT "%8.1" /end CHARACTERISTIC
/begin CHARACTERISTIC BattCD_DebSRCLowDef_C "Entprellzeit für Fehlererkennung des SRC-Low-Fehlers der Batteriespannung" VALUE 0xC7F8A Kw_Wu16 655350.0 Time_ms 0.00 655350.0 FORMAT "%8.1" /end CHARACTERISTIC
/begin CHARACTERISTIC BattCD_DebSRCLowOk_C "Entprellzeit für Heilung des SRC-Low-Fehlers der Batteriespannung" VALUE 0xC7F8C Kw_Wu16 655350.0 Time_ms 0.00 655350.0 FORMAT "%8.1" /end CHARACTERISTIC
/begin CHARACTERISTIC BattCD_numAdc_C "#SSD Applikationsparameter" VALUE 0xC7F8E Kw_Wu8 24.0000000000 NumPinAdc 0.00 24.0000000000 FORMAT "%13.10" /end CHARACTERISTIC
/begin CHARACTERISTIC BattCD_duRmpSlpUp_C "Rampe Zunahme Batteriespannung negative Steigung" VALUE 0xC7F90 Kw_Wu32 1281250244.02 RmpVoltBatt 977.576769459 1281251221.60 FORMAT "%13.2" EXTENDED_LIMITS 0.00 1281251221.60 /end CHARACTERISTIC
/begin CHARACTERISTIC BattCD_duRmpSlpDwn_C "Rampe Zunahme Batteriespannung positive Steigung" VALUE 0xC7F94 Kw_Wu32 1281250244.02 RmpVoltBatt 977.576769459 1281251221.60 FORMAT "%13.2" EXTENDED_LIMITS 0.00 1281251221.60 /end CHARACTERISTIC
/begin CHARACTERISTIC BattCD_stSensIDWord_C "Kennung Batteriespannungserfassung" VALUE 0xC7F98 Kw_Wu16 65535.00 OneToOne 0.00 65535.00 FORMAT "%8.2" /end CHARACTERISTIC
/begin CHARACTERISTIC BattCD_uDfl_C "Vorgabewert Batteriespannung" VALUE 0xC7F9A Kw_Ws16 28602.15 Volt_Batt 0.00 28602.15 FORMAT "%8.2" EXTENDED_LIMITS -640625.6 640606.1 /end CHARACTERISTIC
/begin CHARACTERISTIC Batt_uNrm_C "#SSD Normierte Batteriespannung" VALUE 0xC7F18 Kw_Ws16 1281232. Volt_Batt -640625.6 640606.1 FORMAT "%8.1" /end CHARACTERISTIC
/begin CHARACTERISTIC BPACD_ctPwrStgOnMax_C "Maximum der Endstufen aktivierungen im Fahrzyklus bei SCB oder Übertemperatur Fehler" VALUE 0xC7F9C Kw_Wu16 65535.00 OneToOne 0.00 65535.00 FORMAT "%8.2" /end CHARACTERISTIC
/begin CHARACTERISTIC BPACD_tiDebBPADia1Def_C "debounce duration for boost pressure actor diagnosis error detection" VALUE 0xC7F9E Kw_Wu16 655350.0 Time_ms 0.00 655350.0 FORMAT "%8.1" /end CHARACTERISTIC
/begin CHARACTERISTIC BPACD_tiDebBPADia1Ok_C "debounce duration for boost pressure actor diagnosis error healing" VALUE 0xC7FA0 Kw_Wu16 655350.0 Time_ms 0.00 655350.0 FORMAT "%8.1" /end CHARACTERISTIC
/begin CHARACTERISTIC BPACD_tiDebBPADia2Def_C "debounce duration for boost pressure actor diagnosis error detection" VALUE 0xC7FA2 Kw_Wu16 655350.0 Time_ms 0.00 655350.0 FORMAT "%8.1" /end CHARACTERISTIC
/begin CHARACTERISTIC BPACD_tiDebBPADia2Ok_C "debounce duration for boost pressure actor diagnosis error healing" VALUE 0xC7FA4 Kw_Wu16 655350.0 Time_ms 0.00 655350.0 FORMAT "%8.1" /end CHARACTERISTIC
/begin CHARACTERISTIC BPACD_tiDebBPADia3Def_C "debounce duration for boost pressure actor diagnosis error detection" VALUE 0xC7FA6 Kw_Wu16 655350.0 Time_ms 0.00 655350.0 FORMAT "%8.1" /end CHARACTERISTIC
/begin CHARACTERISTIC BPACD_tiDebBPADia3Ok_C "debounce duration for boost pressure actor diagnosis error healing" VALUE 0xC7FA8 Kw_Wu16 655350.0 Time_ms 0.00 655350.0 FORMAT "%8.1" /end CHARACTERISTIC
/begin CHARACTERISTIC BPACD_DebExcTempDef_C "#SSD Fehlerentprellzeit für Übertemperatur" VALUE 0xC7FAA Kw_Wu16 655350.0 Time_ms 0.00 655350.0 FORMAT "%8.1" /end CHARACTERISTIC
/begin CHARACTERISTIC BPACD_DebExcTempOk_C "Heilungsentprellzeit für Übertemperatur" VALUE 0xC7FAC Kw_Wu16 655350.0 Time_ms 0.00 655350.0 FORMAT "%8.1" /end CHARACTERISTIC
/begin CHARACTERISTIC BPACD_DebNoLoadDef_C "#SSD Fehlerentprellzeit für Lastabfall" VALUE 0xC7FAE Kw_Wu16 655350.0 Time_ms 0.00 655350.0 FORMAT "%8.1" /end CHARACTERISTIC
/begin CHARACTERISTIC BPACD_DebNoLoadOk_C "Heilungsentprellzeit für Lastabfall" VALUE 0xC7FB0 Kw_Wu16 655350.0 Time_ms 0.00 655350.0 FORMAT "%8.1" /end CHARACTERISTIC
/begin CHARACTERISTIC BPACD_DebShortCircBatDef_C "#SSD Fehlerentprellzeitzeit für Kurzschluß nach Batteriespannung" VALUE 0xC7FB2 Kw_Wu16 655350.0 Time_ms 0.00 655350.0 FORMAT "%8.1" /end CHARACTERISTIC
/begin CHARACTERISTIC BPACD_DebShortCircBatOk_C "Heilungsentprellzeit für Kurzschluß nach Batteriespannung" VALUE 0xC7FB4 Kw_Wu16 655350.0 Time_ms 0.00 655350.0 FORMAT "%8.1" /end CHARACTERISTIC
/begin CHARACTERISTIC BPACD_DebShortCircGndDef_C "#SSD Fehlerentprellzeit für Kurzschluß nach Masse" VALUE 0xC7FB6 Kw_Wu16 655350.0 Time_ms 0.00 655350.0 FORMAT "%8.1" /end CHARACTERISTIC
/begin CHARACTERISTIC BPACD_DebShortCircGndOk_C "Heilungsentprellzeit für Kurzschluß nach Masse" VALUE 0xC7FB8 Kw_Wu16 655350.0 Time_ms 0.00 655350.0 FORMAT "%8.1" /end CHARACTERISTIC
/begin CHARACTERISTIC BPACD_numDia_C "#SSD Applikationsparameter fuer Diagnose Signal :BP-Steller" VALUE 0xC7FBA Kw_Wu8 27.0000000000 NumPinDia 0.00 27.0000000000 FORMAT "%13.10" /end CHARACTERISTIC
/begin CHARACTERISTIC BPACD_numPwmOut_C "#SSD Applikationsparameter fuer Ladedruck-Steller" VALUE 0xC7FBB Kw_Wu8 12.0000000000 NumPinPwmOut 0.00 12.0000000000 FORMAT "%13.10" /end CHARACTERISTIC
/begin CHARACTERISTIC BPACD_stInvOut_C "Invertierungsparameter für das Signal der Ladedruckstellerendstufe" VALUE 0xC7FBC Kw_Wu8 1.000 OneToOne 0.00 1.000 FORMAT "%5.3" EXTENDED_LIMITS 0.00 255.0 /end CHARACTERISTIC
/begin CHARACTERISTIC BPACD_tiPer_C "Periodendauer Ladedrucksteller." VALUE 0xC7FBE Kw_Ws16 6553.500 Period -3276.800 3276.700 FORMAT "%8.3" /end CHARACTERISTIC
/begin CHARACTERISTIC BPACD_rCnv_CUR "Kennlinie zur konvertierung von Öffnungsgrad in Tastverhältnis" CURVE 0xC7FC0 Kl_Xs16_Ws16 100.0000 DtyCyc 0.00 100.0000 FORMAT "%8.4" EXTENDED_LIMITS -327.6800 327.6700
 /begin AXIS_DESCR STD_AXIS BPA_rBPACD Prc 25 -100.0000 200.0000 FORMAT "%8.4" EXTENDED_LIMITS -400.0000 399.9878 DEPOSIT ABSOLUTE /end AXIS_DESCR
/end CHARACTERISTIC
/begin CHARACTERISTIC BPACD_rOutMax_C "Maximal auszugebendes Tastverhältnis" VALUE 0xC8026 Kw_Ws16 655.3500 DtyCyc -327.6800 327.6700 FORMAT "%8.4" /end CHARACTERISTIC
/begin CHARACTERISTIC BPACD_rOutMin_C "Minimal auszugebendes Tastverhältnis" VALUE 0xC8028 Kw_Ws16 655.3500 DtyCyc -327.6800 327.6700 FORMAT "%8.4" /end CHARACTERISTIC
/begin CHARACTERISTIC BPACD_stPwrStgActv_C "Aktivierung der Abschaltbedingungen der Endstufe" VALUE 0xC802A Kw_Wu8 255.0 OneToOne 0.00 255.0 FORMAT "%5.1" /end CHARACTERISTIC
/begin CHARACTERISTIC BPACD_stPwrStgDia_C "#SSD Aktivierung der Abschaltbedingungen der Endstufediagnose" VALUE 0xC802B Kw_Wu8 255.0 OneToOne 0.00 255.0 FORMAT "%5.1" /end CHARACTERISTIC
/begin CHARACTERISTIC BPACD_stSPICtl_C "Parameter zur Auswahl des Endstufentypes  ( 1 = SPI Endstufe, 0 = Nicht SPI Endstufe )" VALUE 0xC802C Kw_Wu8 1.000 OneToOne 0.00 1.000 FORMAT "%5.3" EXTENDED_LIMITS 0.00 255.0 /end CHARACTERISTIC
/begin CHARACTERISTIC BPACD_swt_C "Schalter für Batteriespannungskorrektur (0 = AUS, 1 = EIN)" VALUE 0xC802D Kw_Wu8 255.0 OneToOne 0.00 255.0 FORMAT "%5.1" /end CHARACTERISTIC
/begin CHARACTERISTIC BPACD_tiBtwTst_C "#SSD Zeitabstand, in dem im Fehlerfall die Endstufe getestet wird" VALUE 0xC802E Kw_Wu16 29980.00 Time_ms 20.00000 30000.00 FORMAT "%8.2" EXTENDED_LIMITS 0.00 655350.0 /end CHARACTERISTIC
/begin CHARACTERISTIC BPACD_tiDiag1Max_C "window 1 max. time" VALUE 0xC8030 Kw_Wu16 655350.0 Time_ms 0.00 655350.0 FORMAT "%8.1" /end CHARACTERISTIC
/begin CHARACTERISTIC BPACD_tiDiag1Min_C "window 1 min. time" VALUE 0xC8032 Kw_Wu16 655350.0 Time_ms 0.00 655350.0 FORMAT "%8.1" /end CHARACTERISTIC
/begin CHARACTERISTIC BPACD_tiDiag2Max_C "window 2 max. time" VALUE 0xC8034 Kw_Wu16 655350.0 Time_ms 0.00 655350.0 FORMAT "%8.1" /end CHARACTERISTIC
/begin CHARACTERISTIC BPACD_tiDiag2Min_C "window 2 min. time" VALUE 0xC8036 Kw_Wu16 655350.0 Time_ms 0.00 655350.0 FORMAT "%8.1" /end CHARACTERISTIC
/begin CHARACTERISTIC BPACD_tiDiag3Max_C "window 3 max. time" VALUE 0xC8038 Kw_Wu16 655350.0 Time_ms 0.00 655350.0 FORMAT "%8.1" /end CHARACTERISTIC
/begin CHARACTERISTIC BPACD_tiDiag3Min_C "window 3 min. time" VALUE 0xC803A Kw_Wu16 655350.0 Time_ms 0.00 655350.0 FORMAT "%8.1" /end CHARACTERISTIC
/begin CHARACTERISTIC BPACD_tiPwrStgOn_C "Zeit für die die Endstufe eingeschalten wird bei nicht SPI Endstufen" VALUE 0xC803C Kw_Wu16 655140.0 Time_ms 0.00 655140.0 FORMAT "%8.1" EXTENDED_LIMITS 0.00 655350.0 /end CHARACTERISTIC
/begin CHARACTERISTIC BPA_rBPACD_Vector "#SSD Bypass-Label für BPA_rBPA" VALUE 0xC3074 Kw_Wu8 255.0 OneToOne 0.00 255.0 FORMAT "%5.1" /end CHARACTERISTIC
/begin CHARACTERISTIC BPA_rBPACD_Channel "#SSD Bypass-Label für BPA_rBPA" VALUE 0xC3075 Kw_Wu8 255.0 OneToOne 0.00 255.0 FORMAT "%5.1" /end CHARACTERISTIC
/begin CHARACTERISTIC BPA_rLPACD_Vector "Konfigurationslabel für Bypass Freischnitt" VALUE 0xC3076 Kw_Wu8 255.0 OneToOne 0.00 255.0 FORMAT "%5.1" /end CHARACTERISTIC
/begin CHARACTERISTIC BPA_rLPACD_Channel "Konfigurationslabel für Bypass Freischnitt" VALUE 0xC3077 Kw_Wu8 255.0 OneToOne 0.00 255.0 FORMAT "%5.1" /end CHARACTERISTIC
/begin CHARACTERISTIC BPSCD_uSRCMin_C "#SSD SRC-Min-Wert für Ladedruck." VALUE 0xC8040 Kw_Ws16 5200.391 Volt 0.00 5200.391 FORMAT "%8.3" EXTENDED_LIMITS -160156.4 160151.5 /end CHARACTERISTIC
/begin CHARACTERISTIC BPSCD_uSRCMax_C "#SSD SRC-Max-Wert für Ladedruck." VALUE 0xC8042 Kw_Ws16 5200.391 Volt 0.00 5200.391 FORMAT "%8.3" EXTENDED_LIMITS -160156.4 160151.5 /end CHARACTERISTIC
/begin CHARACTERISTIC BPSCD_pLin_CUR "Linearisierungskennlinie" CURVE 0xC8044 Kl_Xs16_Ws16 5000.000 Pres_hPa 0.00 5000.000 FORMAT "%8.3" EXTENDED_LIMITS -32768.00 32767.00
 /begin AXIS_DESCR STD_AXIS BPSCD_uRawVal Volt 25 0.00 5000.000 FORMAT "%8.3" EXTENDED_LIMITS -160156.4 160151.5 DEPOSIT ABSOLUTE /end AXIS_DESCR
/end CHARACTERISTIC
/begin CHARACTERISTIC BPSCD_DebNplDef_C "#SSD Fehlerentprellung Plausbilitätsfehler" VALUE 0xC80AA Kw_Wu16 655350.0 Time_ms 0.00 655350.0 FORMAT "%8.1" /end CHARACTERISTIC
/begin CHARACTERISTIC BPSCD_DebNplOK_C "Heilungsentprellung Plausbilitätsfehler" VALUE 0xC80AC Kw_Wu16 655350.0 Time_ms 0.00 655350.0 FORMAT "%8.1" /end CHARACTERISTIC
/begin CHARACTERISTIC BPSCD_DebSigDef_C "#SSD Defektentprellzeit fuer CAN Signal defekt" VALUE 0xC80AE Kw_Wu16 655350.0 Time_ms 0.00 655350.0 FORMAT "%8.1" /end CHARACTERISTIC
/begin CHARACTERISTIC BPSCD_DebSigOK_C "Heilungsentprellzeit fuer CAN Signal defekt" VALUE 0xC80B0 Kw_Wu16 655350.0 Time_ms 0.00 655350.0 FORMAT "%8.1" /end CHARACTERISTIC
/begin CHARACTERISTIC BPSCD_DebSRCHighDef_C "#SSD Fehlerentprellzeit fuer SRC-High Fehler" VALUE 0xC80B2 Kw_Wu16 655350.0 Time_ms 0.00 655350.0 FORMAT "%8.1" /end CHARACTERISTIC
/begin CHARACTERISTIC BPSCD_DebSRCHighOK_C "Heilungsentprellzeit fuer SRC-High Fehler" VALUE 0xC80B4 Kw_Wu16 655350.0 Time_ms 0.00 655350.0 FORMAT "%8.1" /end CHARACTERISTIC
/begin CHARACTERISTIC BPSCD_DebSRCLowDef_C "#SSD Fehlerentprellzeit fuer SRC-Low Fehler" VALUE 0xC80B6 Kw_Wu16 655350.0 Time_ms 0.00 655350.0 FORMAT "%8.1" /end CHARACTERISTIC
/begin CHARACTERISTIC BPSCD_DebSRCLowOK_C "Heilungsentprellzeit fuer SRC-Low Fehler" VALUE 0xC80B8 Kw_Wu16 655350.0 Time_ms 0.00 655350.0 FORMAT "%8.1" /end CHARACTERISTIC
/begin CHARACTERISTIC BPSCD_tiDT1_C "Reciprocal of time delay" VALUE 0xC80BC Kw_Wu32 4294.9663 TimeDelay_s 0.0010000001 4294.9673 FORMAT "%9.4" EXTENDED_LIMITS 0.0000010000000 4294.9673 /end CHARACTERISTIC
/begin CHARACTERISTIC BPSCD_dDT1Kd_C "Reciprocal of time delay" VALUE 0xC80C0 Kw_Ws32 10.0000000000 Kd 0.00 10.0000000000 FORMAT "%13.10" EXTENDED_LIMITS -32768.0000000 32767.9999847 /end CHARACTERISTIC
/begin CHARACTERISTIC BPSCD_tiLPFiltPT1_C "Zeitkonstante Tiefpass fuer Ladedruck_Fuehler" VALUE 0xC0494 Kw_Wu32 4294.9673 TimeDelay_s 0.0000010000000 4294.9673 FORMAT "%9.4" /end CHARACTERISTIC
/begin CHARACTERISTIC BPSCD_nLim_C "Obere Grenze Motordrehzahl." VALUE 0xC80C4 Kw_Ws16 6000.000 EngN 0.00 6000.000 FORMAT "%8.3" EXTENDED_LIMITS -32768.00 32767.00 /end CHARACTERISTIC
/begin CHARACTERISTIC BPSCD_numAdc_C "#SSD Applikationsparameter fuer Ladedruck-Steller" VALUE 0xC80C6 Kw_Wu8 24.0000000000 NumPinAdc 0.00 24.0000000000 FORMAT "%13.10" /end CHARACTERISTIC
/begin CHARACTERISTIC BPSCD_pDiffLim_C "Grenzwert für absolute Differenz zwischen LD und AD" VALUE 0xC80C8 Kw_Ws16 3500.000 Pres_hPa 0.00 3500.000 FORMAT "%8.3" EXTENDED_LIMITS -32768.00 32767.00 /end CHARACTERISTIC
/begin CHARACTERISTIC BPSCD_tiOutValDT1_C "Totzeit für  Ladedruck DT1 filter" VALUE 0xC80CC Kw_Wu32 4294.9673 TimeDelay_s 0.0000010000000 4294.9673 FORMAT "%9.4" /end CHARACTERISTIC
/begin CHARACTERISTIC BPSCD_dDT1KdOutVal_C "Verstärkungskonstante des DT1 filters für  Ladedrucksignal" VALUE 0xC80D0 Kw_Ws32 32767.9999847 Kd 0.00 32767.9999847 FORMAT "%13.7" EXTENDED_LIMITS -32768.0000000 32767.9999847 /end CHARACTERISTIC
/begin CHARACTERISTIC BPSCD_tiPT1_C "Verzugszeit. (für PT1 Filter )" VALUE 0xC80D4 Kw_Wu32 4294.9673 TimeDelay_s 0.0000010000000 4294.9673 FORMAT "%9.4" /end CHARACTERISTIC
/begin CHARACTERISTIC BPSCD_dpRmpSlpUp_C "Rampensteigung bei Heilung/Vorgabewert für LDF" VALUE 0xC80D8 Kw_Wu32 65535899.9786 RmpPres_hPa 100.006103516 65535999.9847 FORMAT "%13.4" EXTENDED_LIMITS 0.00 65535999.9847 /end CHARACTERISTIC
/begin CHARACTERISTIC BPSCD_dpRmpSlpDwn_C "Rampensteigung bei Heilung/Vorgabewert für LDF" VALUE 0xC80DC Kw_Wu32 65535899.9786 RmpPres_hPa 100.006103516 65535999.9847 FORMAT "%13.4" EXTENDED_LIMITS 0.00 65535999.9847 /end CHARACTERISTIC
/begin CHARACTERISTIC BPSCD_swtSigVal_C "#SSD Schalter ob Signal ueber CAN/ADC (0 = ADC, 1 = CAN)" VALUE 0xC80E0 Kw_Wu8 1.000 OneToOne 0.00 1.000 FORMAT "%5.3" EXTENDED_LIMITS 0.00 255.0 /end CHARACTERISTIC
/begin CHARACTERISTIC BPSCD_stSensIDWord_C "Geberkennwort LDF" VALUE 0xC80E2 Kw_Wu16 65535.00 OneToOne 0.00 65535.00 FORMAT "%8.2" /end CHARACTERISTIC
/begin CHARACTERISTIC BPSCD_pDfl_C "Ladedruck Vorgabewert" VALUE 0xC80E4 Kw_Ws16 65535.00 Pres_hPa -32768.00 32767.00 FORMAT "%8.2" /end CHARACTERISTIC
/begin CHARACTERISTIC BrkCD_ctUnPlausDef_C "Defektschwelle dese Unplausibilitätszählers" VALUE 0xC80E8 Kw_Wu8 255.0 OneToOne 0.00 255.0 FORMAT "%5.1" /end CHARACTERISTIC
/begin CHARACTERISTIC BrkCD_DebPlaDef_C "#SSD Fehlerentprellzeit Plausibilitätsfehler" VALUE 0xC80EA Kw_Wu16 655350.0 Time_ms 0.00 655350.0 FORMAT "%8.1" /end CHARACTERISTIC
/begin CHARACTERISTIC BrkCD_DebPlaOk_C "#SSD Heilzeit Plausibilitätsfehler" VALUE 0xC80EC Kw_Wu16 655350.0 Time_ms 0.00 655350.0 FORMAT "%8.1" /end CHARACTERISTIC
/begin CHARACTERISTIC BrkCD_DebSigDef_C "Entprellzeit für CAN-Signal Defekterkennung" VALUE 0xC80EE Kw_Wu16 655350.0 Time_ms 0.00 655350.0 FORMAT "%8.1" /end CHARACTERISTIC
/begin CHARACTERISTIC BrkCD_DebSigOk_C "Entprellzeit für Heilung des CAN-Signalfehler" VALUE 0xC80F0 Kw_Wu16 655350.0 Time_ms 0.00 655350.0 FORMAT "%8.1" /end CHARACTERISTIC
/begin CHARACTERISTIC BrkCD_tiMnSwtDebNeg_C "#SSD Entprellzeit Bremskontakt - abfallende Flanke" VALUE 0xC80F2 Kw_Wu16 655350.0 TimeDeb 0.00 655350.0 FORMAT "%8.1" /end CHARACTERISTIC
/begin CHARACTERISTIC BrkCD_tiMnSwtDebPos_C "#SSD Entprellzeit Bremskontakt - aufsteigende Flanke" VALUE 0xC80F4 Kw_Wu16 655350.0 TimeDeb 0.00 655350.0 FORMAT "%8.1" /end CHARACTERISTIC
/begin CHARACTERISTIC BrkCD_numDioInMn_C "#SSD Applikationsparameter fuer Bremspedal" VALUE 0xC80F6 Kw_Wu8 14.0000000000 NumPinDioIn 0.00 14.0000000000 FORMAT "%13.10" /end CHARACTERISTIC
/begin CHARACTERISTIC BrkCD_numDioInRed_C "#SSD Apllikationsparameter fuer redundante Bremssignal" VALUE 0xC80F7 Kw_Wu8 14.0000000000 NumPinDioIn 0.00 14.0000000000 FORMAT "%13.10" /end CHARACTERISTIC
/begin CHARACTERISTIC BrkCD_tiRedSwtDebNeg_C "#SSD Entprellzeit redundanter Bremskontakt - abfallende Flanke" VALUE 0xC80F8 Kw_Wu16 655350.0 TimeDeb 0.00 655350.0 FORMAT "%8.1" /end CHARACTERISTIC
/begin CHARACTERISTIC BrkCD_tiRedSwtDebPos_C "#SSD Entprellzeit redundanter Bremskontakt - aufsteigende Flanke" VALUE 0xC80FA Kw_Wu16 655350.0 TimeDeb 0.00 655350.0 FORMAT "%8.1" /end CHARACTERISTIC
/begin CHARACTERISTIC BrkCD_stDflVal_C "Redundanter Bremskontakt-Vorgabewert" VALUE 0xC80FC Kw_Wu8 3.000 OneToOne 0.00 3.000 FORMAT "%5.3" EXTENDED_LIMITS 0.00 255.0 /end CHARACTERISTIC
/begin CHARACTERISTIC BrkCD_stMnSwtInvIn_C "#SSD Signal Bremskontakt invertiert" VALUE 0xC80FD Kw_Wu8 1.000 OneToOne 0.00 1.000 FORMAT "%5.3" EXTENDED_LIMITS 0.00 255.0 /end CHARACTERISTIC
/begin CHARACTERISTIC BrkCD_stRedSwtInvIn_C "#SSD Signal redundanter Bremskontakt invertiert" VALUE 0xC80FE Kw_Wu8 1.000 OneToOne 0.00 1.000 FORMAT "%5.3" EXTENDED_LIMITS 0.00 255.0 /end CHARACTERISTIC
/begin CHARACTERISTIC BrkCD_swtRedSwtPresent_C "#SSD Schalter redundanter Bremskontakt vorhanden (1 = vorhanden, 0 = nicht vorhanden)" VALUE 0xC80FF Kw_Wu8 1.000 OneToOne 0.00 1.000 FORMAT "%5.3" EXTENDED_LIMITS 0.00 255.0 /end CHARACTERISTIC
/begin CHARACTERISTIC BrkCD_swtSigVal_C "Schalterwert, Signal von HW DIO/CAN (1=CAN, 0=DIO)" VALUE 0xC8100 Kw_Wu8 3.000 OneToOne 0.00 3.000 FORMAT "%5.3" EXTENDED_LIMITS 0.00 255.0 /end CHARACTERISTIC
/begin CHARACTERISTIC BrkCD_tiDebResUnPlaus_C "Entprellzeit zur Erkennung auf Plausibilität" VALUE 0xC8102 Kw_Wu16 655350.0 Time_ms 0.00 655350.0 FORMAT "%8.1" /end CHARACTERISTIC
/begin CHARACTERISTIC BrkCD_tiDebUnPlausStat_C "Entprellzeit zur Erkennung auf statische Unplausibilität" VALUE 0xC8104 Kw_Wu16 655350.0 Time_ms 0.00 655350.0 FORMAT "%8.1" /end CHARACTERISTIC
/begin CHARACTERISTIC BrkCD_tiDebUnPlaus_C "Entprellzeit zur Erkennung auf Unplausibilität" VALUE 0xC8106 Kw_Wu16 655350.0 Time_ms 0.00 655350.0 FORMAT "%8.1" /end CHARACTERISTIC
/begin CHARACTERISTIC Bss_tiDebDefect_C "Fehlerentprellzeit bei Kommunikationsfehler im BSS Interface" VALUE 0xC8108 Kw_Wu16 655350.0 Time_ms 0.00 655350.0 FORMAT "%8.1" /end CHARACTERISTIC
/begin CHARACTERISTIC Bss_tiDebOk_C "Heilungsentprellung bei Kommunikationsfehler in BSS Interface" VALUE 0xC810A Kw_Wu16 655350.0 Time_ms 0.00 655350.0 FORMAT "%8.1" /end CHARACTERISTIC
/begin CHARACTERISTIC BypEtk_dNsyncStimuli64_C "#SSD Bypass, nicht ändern. Anzahl der winkelsynchron übertragenen Acht-Byte-Größen von ASCET zur ECU." VALUE 0xC810C Kw_Wu8 255.0 OneToOne 0.00 255.0 FORMAT "%5.1" /end CHARACTERISTIC
/begin CHARACTERISTIC BypEtk_dNsyncStimuli32_C "#SSD Bypass, nicht ändern. Anzahl der winkelsynchron übertragenen Vier-Byte-Größen von ASCET zur ECU." VALUE 0xC810D Kw_Wu8 255.0 OneToOne 0.00 255.0 FORMAT "%5.1" /end CHARACTERISTIC
/begin CHARACTERISTIC BypEtk_dNsyncStimuli16_C "#SSD Bypass, nicht ändern. Anzahl der winkelsynchron übertragenen Zwei-Byte-Größen von ASCET zur ECU." VALUE 0xC810E Kw_Wu8 255.0 OneToOne 0.00 255.0 FORMAT "%5.1" /end CHARACTERISTIC
/begin CHARACTERISTIC BypEtk_dNsyncStimuli8_C "#SSD Bypass, nicht ändern. Anzahl der winkelsynchron übertragenen Ein-Byte-Größen von ASCET zur ECU." VALUE 0xC810F Kw_Wu8 255.0 OneToOne 0.00 255.0 FORMAT "%5.1" /end CHARACTERISTIC
/begin CHARACTERISTIC BypEtk_stAscet_C "#SSD Status ASCET ETK Bypass (0: deaktiviert; 1: ETK-Bypass starten, wenn Wert vorher 0; 2: sofort starten)" VALUE 0xC8110 Kw_Wu8 2.000 OneToOne 0.00 2.000 FORMAT "%5.3" EXTENDED_LIMITS 0.00 255.0 /end CHARACTERISTIC
/begin CHARACTERISTIC BypEtk_dTsyncStimuli64_C "#SSD Bypass, nicht ändern. Anzahl der zeitsynchron übertragenen Acht-Byte-Größen von ASCET zur ECU." VALUE 0xC8111 Kw_Wu8 255.0 OneToOne 0.00 255.0 FORMAT "%5.1" /end CHARACTERISTIC
/begin CHARACTERISTIC BypEtk_dTsyncStimuli32_C "#SSD Bypass, nicht ändern. Anzahl der zeitsynchron übertragenen Vier-Byte-Größen von ASCET zur ECU." VALUE 0xC8112 Kw_Wu8 255.0 OneToOne 0.00 255.0 FORMAT "%5.1" /end CHARACTERISTIC
/begin CHARACTERISTIC BypEtk_dTsyncStimuli16_C "#SSD Bypass, nicht ändern. Anzahl der zeitsynchron übertragenen Zwei-Byte-Größen von ASCET zur ECU." VALUE 0xC8113 Kw_Wu8 255.0 OneToOne 0.00 255.0 FORMAT "%5.1" /end CHARACTERISTIC
/begin CHARACTERISTIC BypEtk_dTsyncStimuli8_C "#SSD Bypass, nicht ändern. Anzahl der zeitsynchron übertragenen Ein-Byte-Größen von ASCET zur ECU." VALUE 0xC8114 Kw_Wu8 255.0 OneToOne 0.00 255.0 FORMAT "%5.1" /end CHARACTERISTIC
/begin CHARACTERISTIC BypInt_adFunc_C "#SSD Feld von Funktionszeigern auf interne Bypass Funktionen" VAL_BLK 0xC8118 Kwb_Wu32 4294967295.00 OneToOne 0.00 4294967295.00 FORMAT "%13.2" NUMBER 11 /end CHARACTERISTIC
/begin CHARACTERISTIC BypInt_stAscet_C "#SSD Status interner ASCET Bypass (0: deaktiviert; 1: internen Bypass starten, wenn Wert vorher 0; 2: sofort starten)" VALUE 0xC8144 Kw_Wu8 2.000 OneToOne 0.00 2.000 FORMAT "%5.3" EXTENDED_LIMITS 0.00 255.0 /end CHARACTERISTIC
/begin CHARACTERISTIC Carb_Mode1PID_CA "Feld von unterstützen Carb Mode $1 PID's" VAL_BLK 0xC0498 Kwb_Wu8 254.0 OneToOne 1.000 255.0 FORMAT "%5.1" EXTENDED_LIMITS 0.00 255.0 NUMBER 9 /end CHARACTERISTIC
/begin CHARACTERISTIC Carb_Mode1Signal_CA "Feld der Signale von Carb Mode $1 welche mit den PID's verbunden sind" VAL_BLK 0xC04A2 Kwb_Wu16 255.000000000 SigName 0.00 255.000000000 FORMAT "%13.9" NUMBER 9 /end CHARACTERISTIC
/begin CHARACTERISTIC Carb_Mode2PID_CA "Feld von unterstützen Carb Mode $2 PID's" VAL_BLK 0xC04B4 Kwb_Wu8 254.0 OneToOne 1.000 255.0 FORMAT "%5.1" EXTENDED_LIMITS 0.00 255.0 NUMBER 9 /end CHARACTERISTIC
/begin CHARACTERISTIC Carb_Mode2Signal_CA "Feld der Signale von Carb Mode $2 welche mit den PID's verbunden sind" VAL_BLK 0xC04BE Kwb_Wu16 255.000000000 SigName 0.00 255.000000000 FORMAT "%13.9" NUMBER 9 /end CHARACTERISTIC
/begin CHARACTERISTIC Carb_Mode3SwtDia_C "Anzeigen der Fehler nur für Carb Mode 3(0) oder für Carb Mode 3 und 7 (1)" VALUE 0xC04D0 Kw_Wu8 255.0 OneToOne 0.00 255.0 FORMAT "%5.1" /end CHARACTERISTIC
/begin CHARACTERISTIC Carb_Mode4RefVal_C "Ist Carb_Mode4SigNum_C größer als dieser Referenzwert erfolgt kein Reset" VALUE 0xC04D4 Kw_Ws32 4294967295.00 OneToOne -2147483648.00 2147483647.00 FORMAT "%13.2" /end CHARACTERISTIC
/begin CHARACTERISTIC Carb_Mode4SigNum_C "Vergleiche Carb_Mode4SigNum_C mit dem Referenzwert Carb_Mode4RefVal_C" VALUE 0xC04D8 Kw_Wu16 65535.00 OneToOne 0.00 65535.00 FORMAT "%8.2" /end CHARACTERISTIC
/begin CHARACTERISTIC Carb_Mode6TstComp_CUR "Komponente des Carb Mode 6 Subtests" VAL_BLK 0xC04DA Kwb_Wu8 255.0 OneToOne 0.00 255.0 FORMAT "%5.1" NUMBER 10 /end CHARACTERISTIC
/begin CHARACTERISTIC Carb_Mode6TstNum_CUR "Test Nummer des Carb Mode 6 Subtests" VAL_BLK 0xC04E4 Kwb_Wu8 254.0 OneToOne 1.000 255.0 FORMAT "%5.1" EXTENDED_LIMITS 0.00 255.0 NUMBER 10 /end CHARACTERISTIC
/begin CHARACTERISTIC Carb_Mode6TstRefMax_CUR "Maximaler Referenzwert des Carb Mode 6 Subtest" VAL_BLK 0xC04EE Kwb_Wu16 65534.00 OneToOne 1.000000 65535.00 FORMAT "%8.2" EXTENDED_LIMITS 0.00 65535.00 NUMBER 10 /end CHARACTERISTIC
/begin CHARACTERISTIC Carb_Mode6TstRefMin_CUR "Minimaler Referenzwert des Carb Mode 6 Subtest" VAL_BLK 0xC0502 Kwb_Wu16 65534.00 OneToOne 1.000000 65535.00 FORMAT "%8.2" EXTENDED_LIMITS 0.00 65535.00 NUMBER 10 /end CHARACTERISTIC
/begin CHARACTERISTIC Carb_Mode6TstTestId_CUR "Test Identifier für OBD über CAN" VAL_BLK 0xC0516 Kwb_Wu8 255.0 OneToOne 0.00 255.0 FORMAT "%5.1" NUMBER 10 /end CHARACTERISTIC
/begin CHARACTERISTIC Carb_Mode6TstUnitId_CUR "Einheits und Skalierungs Identifier der Datenbytes" VAL_BLK 0xC0520 Kwb_Wu8 255.0 OneToOne 0.00 255.0 FORMAT "%5.1" NUMBER 10 /end CHARACTERISTIC
/begin CHARACTERISTIC Carb_Mode6TstVal_CUR "Testwert des Carb Mode 6 Subtests" VAL_BLK 0xC052A Kwb_Wu16 65534.00 OneToOne 1.000000 65535.00 FORMAT "%8.2" EXTENDED_LIMITS 0.00 65535.00 NUMBER 10 /end CHARACTERISTIC
/begin CHARACTERISTIC Carb_Mode9PID0_C "Support-Status des Infotype 0x00. Liefert alle ünterstützten Infotypes ( immer 0 für supported)" VALUE 0xC053E Kw_Wu8 255.0 OneToOne 0.00 255.0 FORMAT "%5.1" /end CHARACTERISTIC
/begin CHARACTERISTIC Carb_Mode9PID1_C "Support-Status des Infotype 0x01 (1 für supported, 0 für nicht supported)" VALUE 0xC053F Kw_Wu8 255.0 OneToOne 0.00 255.0 FORMAT "%5.1" /end CHARACTERISTIC
/begin CHARACTERISTIC Carb_Mode9PID2_C "Support-Status des Infotype 0x02 ""Vehicle Identification"" ( 2 für supported, 0 für nicht supported)" VALUE 0xC0540 Kw_Wu8 255.0 OneToOne 0.00 255.0 FORMAT "%5.1" /end CHARACTERISTIC
/begin CHARACTERISTIC Carb_Mode9PID3_C "Support-Status des Infotype 0x03 ( 3 für supported, 0 für nicht supported)" VALUE 0xC0541 Kw_Wu8 255.0 OneToOne 0.00 255.0 FORMAT "%5.1" /end CHARACTERISTIC
/begin CHARACTERISTIC Carb_Mode9PID4_C "Support-Status des Infotype 0x04 ""Calibration Identification"" ( 4 für supported, 0 für nicht supported)" VALUE 0xC0542 Kw_Wu8 255.0 OneToOne 0.00 255.0 FORMAT "%5.1" /end CHARACTERISTIC
/begin CHARACTERISTIC Carb_Mode9PID5_C "Support-Status des Infotype 0x05 ( 5 für supported, 0 für nicht supported)" VALUE 0xC0543 Kw_Wu8 255.0 OneToOne 0.00 255.0 FORMAT "%5.1" /end CHARACTERISTIC
/begin CHARACTERISTIC Carb_Mode9PID6_C "Support-Status des Infotype 0x06 ""Calibration Verification Number"" ( 6 für supported, 0 für nicht supported)" VALUE 0xC0544 Kw_Wu8 6.000 OneToOne 0.00 6.000 FORMAT "%5.3" EXTENDED_LIMITS 0.00 255.0 /end CHARACTERISTIC
/begin CHARACTERISTIC CaSCD_ctEdgOfs_C "#SSD Anzahl von Nockenwellenflanken mit erkannter CaS/CrS Verdrehung" VALUE 0xC8148 Kw_Wu8 255.0 default 0.00 255.0 FORMAT "%5.1" /end CHARACTERISTIC
/begin CHARACTERISTIC CaSCD_ctErrSync_C "#SSD maximale Anzahl von Störungen auf dem Phasengebersystem während einer Nockenwellenumdrehung" VALUE 0xC8149 Kw_Wu8 255.0 default 0.00 255.0 FORMAT "%5.1" /end CHARACTERISTIC
/begin CHARACTERISTIC CaSCD_ctShftSync_C "#SSD Anzahl falscher Nockenwellenflanken bis neue Positionssuche" VALUE 0xC814A Kw_Wu8 255.0 default 0.00 255.0 FORMAT "%5.1" /end CHARACTERISTIC
/begin CHARACTERISTIC CaSCD_dSegSeries_C "#SSD Segmentfolge der Phasengebersegmente" VAL_BLK 0xC0546 Kwb_Wu8 31.00 OneToOne 0.00 31.00 FORMAT "%5.2" EXTENDED_LIMITS 0.00 255.0 NUMBER 16 /end CHARACTERISTIC
/begin CHARACTERISTIC CaSCD_facPlausHigh_CUR "#SSD Obere Grenze der Plausibilitätsprüfung des Phasengebersignals" CURVE 0xC814C Kl_Xs16_Ws16 19.00000 Fact1 1.000000 20.00000 FORMAT "%8.5" EXTENDED_LIMITS -256.0000 255.9922
 /begin AXIS_DESCR STD_AXIS CaSCD_tiPeriodRev Period_ms 12 0.00 3276.700 FORMAT "%8.3" EXTENDED_LIMITS -3276.800 3276.700 DEPOSIT ABSOLUTE /end AXIS_DESCR
/end CHARACTERISTIC
/begin CHARACTERISTIC CaSCD_facPlausLow_CUR "#SSD Untere Grenze der Plausibilitätsprüfung des Phasengebersignals" CURVE 0xC817E Kl_Xs16_Ws16 1.000000 Fact1 0.00 1.000000 FORMAT "%8.6" EXTENDED_LIMITS -256.0000 255.9922
 /begin AXIS_DESCR STD_AXIS CaSCD_tiPeriodRevHold Period_ms 12 0.00 3276.700 FORMAT "%8.3" EXTENDED_LIMITS -3276.800 3276.700 DEPOSIT ABSOLUTE /end AXIS_DESCR
/end CHARACTERISTIC
/begin CHARACTERISTIC CaSCD_nMinSpeed_C "#SSD Kleinster Wert für Phasengeberraddrehzahl" VALUE 0xC0556 Kw_Ws16 5960.000 EngN 40.00000 6000.000 FORMAT "%8.3" EXTENDED_LIMITS -32768.00 32767.00 /end CHARACTERISTIC
/begin CHARACTERISTIC CaSCD_phiSegLenTolc_C "#SSD Toleranz für jede Segmentlänge" VAL_BLK 0xC0558 Kwb_Ws16 360.0000 AngleCaS 0.00 360.0000 FORMAT "%8.4" EXTENDED_LIMITS -384.0000 383.9883 NUMBER 16 /end CHARACTERISTIC
/begin CHARACTERISTIC CaSCD_phiSegLen_C "#SSD Länge der Phasensegmente" VAL_BLK 0xC0578 Kwb_Ws16 360.0000 AngleCaS 0.00 360.0000 FORMAT "%8.4" EXTENDED_LIMITS -384.0000 383.9883 NUMBER 16 /end CHARACTERISTIC
/begin CHARACTERISTIC CaSCD_phiSegOfs_C "#SSD Winkel zwischen physikalischer Nulllage und Beginn Referenztabelle" VALUE 0xC0598 Kw_Ws16 360.0000 AngleCaS 0.00 360.0000 FORMAT "%8.4" EXTENDED_LIMITS -384.0000 383.9883 /end CHARACTERISTIC
/begin CHARACTERISTIC CaSCD_phiSpeedCalcTolc_C "#SSD Toleranzwinkel für Segmenterkennung bei der Berechnung der Phasengeberdrehzahl" VALUE 0xC059A Kw_Ws16 360.0000 AngleCaS 0.00 360.0000 FORMAT "%8.4" EXTENDED_LIMITS -384.0000 383.9883 /end CHARACTERISTIC
/begin CHARACTERISTIC CaSCD_phiSpeedSegLen_C "#SSD Winkel einer Segmentlänge zur Berechnung der Phasengeberraddrehzahl" VALUE 0xC059C Kw_Ws16 360.0000 AngleCaS 0.00 360.0000 FORMAT "%8.4" EXTENDED_LIMITS -384.0000 383.9883 /end CHARACTERISTIC
/begin CHARACTERISTIC CaSCD_phiSpeedSegOfs_C "#SSD Winkel zwischen phys. Nullposition und dem Beginn der Segmente zur Phasenraddrehzahlberechnung" VALUE 0xC059E Kw_Ws16 360.0000 AngleCaS 0.00 360.0000 FORMAT "%8.4" EXTENDED_LIMITS -384.0000 383.9883 /end CHARACTERISTIC
/begin CHARACTERISTIC CaSCD_stCalc_C "#SSD Abschalten von unterschiedlichen Funktionen des Phasensystems" VALUE 0xC05A0 Kw_Wu8 255.0 OneToOne 0.00 255.0 FORMAT "%5.1" /end CHARACTERISTIC
/begin CHARACTERISTIC CaSCD_stEdgeTrig_C "#SSD Triggerbedingung für die Phasenflankenerfassung" VALUE 0xC05A1 Kw_Wu8 2.000 OneToOne 1.000 3.000 FORMAT "%5.3" EXTENDED_LIMITS 0.00 255.0 /end CHARACTERISTIC
/begin CHARACTERISTIC CaSCD_stPinState_C "#SSD Signalpegel zur Auswertung der Phasensegmente verwenden" VALUE 0xC05A2 Kw_Wu8 1.000 OneToOne 0.00 1.000 FORMAT "%5.3" EXTENDED_LIMITS 0.00 255.0 /end CHARACTERISTIC
/begin CHARACTERISTIC CaSCD_stTPO_C "#SSD True Power On Funktion des Phasengebersensors" VALUE 0xC05A3 Kw_Wu8 1.000 OneToOne 0.00 1.000 FORMAT "%5.3" EXTENDED_LIMITS 0.00 255.0 /end CHARACTERISTIC
/begin CHARACTERISTIC CaSCD_tiPeriodRev1Max_C "#SSD Max. Zeit der vorletzten Periode einer Phasengeberradumdrehung" VALUE 0xC05A4 Kw_Ws16 3276.700 Period_ms 0.00 3276.700 FORMAT "%8.3" EXTENDED_LIMITS -3276.800 3276.700 /end CHARACTERISTIC
/begin CHARACTERISTIC CaSCD_tiPeriodRev2Max_C "#SSD Max. Zeit der letzten Periode einer Phasengeberradumdrehung" VALUE 0xC05A6 Kw_Ws16 3276.700 Period_ms 0.00 3276.700 FORMAT "%8.3" EXTENDED_LIMITS -3276.800 3276.700 /end CHARACTERISTIC
/begin CHARACTERISTIC CaSCD_tiTimOutOfs_C "#SSD Offset zur Berechnung des Timeout-Wertes der Plausibilitätsprüfung" VALUE 0xC05A8 Kw_Ws16 3276.700 Period_ms 0.00 3276.700 FORMAT "%8.3" EXTENDED_LIMITS -3276.800 3276.700 /end CHARACTERISTIC
/begin CHARACTERISTIC CBACD_ctPwrStgOnMax_C "Maximal Einschalt Anzahl der Endstufe bei SCB oder Übertemperaturfehler" VALUE 0xC81B0 Kw_Wu16 65535.00 OneToOne 0.00 65535.00 FORMAT "%8.2" /end CHARACTERISTIC
/begin CHARACTERISTIC CBACD_numDia_C "Parameter fuer Hardware Diagnose-Pin Auswahl" VALUE 0xC81B2 Kw_Wu8 27.0000000000 NumPinDia 0.00 27.0000000000 FORMAT "%13.10" /end CHARACTERISTIC
/begin CHARACTERISTIC CBACD_numDioOut_C "Parameter fuer Hardware Digitalausgang-Pin Auswahl" VALUE 0xC81B3 Kw_Wu8 11.0000000000 NumPinDioOut 0.00 11.0000000000 FORMAT "%13.10" /end CHARACTERISTIC
/begin CHARACTERISTIC CBACD_stInvOut_C "Invertierung des Digitalausgangs ja/nein" VALUE 0xC81B4 Kw_Wu8 1.000 OneToOne 0.00 1.000 FORMAT "%5.3" EXTENDED_LIMITS 0.00 255.0 /end CHARACTERISTIC
/begin CHARACTERISTIC CBACD_stPwrStgActv_C "Spezifikation des Abschaltverhaltens der Endstufe" VALUE 0xC81B5 Kw_Wu8 255.0 OneToOne 0.00 255.0 FORMAT "%5.1" /end CHARACTERISTIC
/begin CHARACTERISTIC CBACD_stPwrStgDia_C "Spezifikation des Diagnoseverhaltens der Endstufe" VALUE 0xC81B6 Kw_Wu8 255.0 OneToOne 0.00 255.0 FORMAT "%5.1" /end CHARACTERISTIC
/begin CHARACTERISTIC CBACD_stSPICtl_C "Parameter zur Kennzeichnung ob Endstufe SPI oder nicht SPI fähig ( 1 = SPI Endstufe, 0 = Nicht SPI Endstufe )" VALUE 0xC81B7 Kw_Wu8 1.000 OneToOne 0.00 1.000 FORMAT "%5.3" EXTENDED_LIMITS 0.00 255.0 /end CHARACTERISTIC
/begin CHARACTERISTIC CBACD_tiBtwTst_C "Zeit zwischen zwei Test wenn Endstufe defekt" VALUE 0xC81B8 Kw_Wu16 29980.00 Time_ms 20.00000 30000.00 FORMAT "%8.2" EXTENDED_LIMITS 0.00 655350.0 /end CHARACTERISTIC
/begin CHARACTERISTIC CBACD_tiDebExcTempDef_C "Fehlerentprellzeit Uebertemperatur" VALUE 0xC81BA Kw_Wu16 655350.0 Time_ms 0.00 655350.0 FORMAT "%8.1" /end CHARACTERISTIC
/begin CHARACTERISTIC CBACD_tiDebExcTempOk_C "Heilungsentprellzeit Uebertemperatur" VALUE 0xC81BC Kw_Wu16 655350.0 Time_ms 0.00 655350.0 FORMAT "%8.1" /end CHARACTERISTIC
/begin CHARACTERISTIC CBACD_tiDebNoLoadDef_C "Fehlerentprellzeit keine Last" VALUE 0xC81BE Kw_Wu16 655350.0 Time_ms 0.00 655350.0 FORMAT "%8.1" /end CHARACTERISTIC
/begin CHARACTERISTIC CBACD_tiDebNoLoadOk_C "Heilungsentprellzeit keine Last" VALUE 0xC81C0 Kw_Wu16 655350.0 Time_ms 0.00 655350.0 FORMAT "%8.1" /end CHARACTERISTIC
/begin CHARACTERISTIC CBACD_tiDebShortCircBatDef_C "Fehlerentprellzzeit Kurzschluss nach UBatt" VALUE 0xC81C2 Kw_Wu16 655350.0 Time_ms 0.00 655350.0 FORMAT "%8.1" /end CHARACTERISTIC
/begin CHARACTERISTIC CBACD_tiDebShortCircBatOk_C "Heilungsentprellzeit Kurzschluss nach UBatt" VALUE 0xC81C4 Kw_Wu16 655350.0 Time_ms 0.00 655350.0 FORMAT "%8.1" /end CHARACTERISTIC
/begin CHARACTERISTIC CBACD_tiDebShortCircGndDef_C "Fehlerentprellzeit Kurzschluss nach Masse" VALUE 0xC81C6 Kw_Wu16 655350.0 Time_ms 0.00 655350.0 FORMAT "%8.1" /end CHARACTERISTIC
/begin CHARACTERISTIC CBACD_tiDebShortCircGndOk_C "Heilungsentprellzeit Kurzschluss nach Masse" VALUE 0xC81C8 Kw_Wu16 655350.0 Time_ms 0.00 655350.0 FORMAT "%8.1" /end CHARACTERISTIC
/begin CHARACTERISTIC CBACD_tiPwrStgOn_C "Zeit für welche die Endstufe eingeschalten wird bei nicht SPI Endstufen" VALUE 0xC81CA Kw_Wu16 655140.0 Time_ms 0.00 655140.0 FORMAT "%8.1" EXTENDED_LIMITS 0.00 655350.0 /end CHARACTERISTIC
/begin CHARACTERISTIC Clg_dtMinDynTst_C "Minimaler Anstieg der Wassertemperatur zur Verifizierung derPlausibilität der Wassertemperatur" VALUE 0xC81CC Kw_Ws16 6553.500 TempDiff_Cels -3276.800 3276.700 FORMAT "%8.3" /end CHARACTERISTIC
/begin CHARACTERISTIC Clg_nMinEnaDynTst_C "Minimale Drehzahl zur Aktivierung des dynamischen Plausibilitätstests" VALUE 0xC81CE Kw_Ws16 65535.00 EngN -32768.00 32767.00 FORMAT "%8.2" /end CHARACTERISTIC
/begin CHARACTERISTIC Clg_qMinEnaDynTst_C "Minimale Einspritzmenge zur Aktivierung des dynamischen Plausibilitätstests" VALUE 0xC81D0 Kw_Ws16 655.3500 InjMass -327.6800 327.6700 FORMAT "%8.4" /end CHARACTERISTIC
/begin CHARACTERISTIC Clg_tiInitTmr_C "Zeitspanne nach Motorstatrt bis die Wassertemperatur erfasst wird" VALUE 0xC81D2 Kw_Ws16 655.3500 Time_s -327.6800 327.6700 FORMAT "%8.4" /end CHARACTERISTIC
/begin CHARACTERISTIC Clg_tiMaxDynTst_CUR "Kennlinie der maximal zulässigen Testzeit des dynamischen Plausibilitätstest" CURVE 0xC81D4 Kl_Xs16_Ws16 167769.6 Time_DynTst -83886.08 83883.52 FORMAT "%8.2"
 /begin AXIS_DESCR STD_AXIS Clg_tClntStrtVal_mp Temp_Cels 10 -50.140 899.860 FORMAT "%8.3" EXTENDED_LIMITS -3549.940 3003.560 DEPOSIT ABSOLUTE /end AXIS_DESCR
/end CHARACTERISTIC
/begin CHARACTERISTIC Clg_tMinClntDynTst_C "Minimale Wassertemperatur zur Verifizierung der Plausibilitäts der Wassertemperatur" VALUE 0xC81FE Kw_Ws16 950.000 Temp_Cels -50.140 899.860 FORMAT "%8.3" EXTENDED_LIMITS -3549.940 3003.560 /end CHARACTERISTIC
/begin CHARACTERISTIC CmbChb_nAvrgThrHi_C "maximale Drehzahl fuer Ueberwachung" VALUE 0xC8200 Kw_Ws16 6000.000 EngN 0.00 6000.000 FORMAT "%8.3" EXTENDED_LIMITS -32768.00 32767.00 /end CHARACTERISTIC
/begin CHARACTERISTIC CmbChb_nAvrgThrLo_C "minimale Drehzahl fuer Ueberwachung" VALUE 0xC8202 Kw_Ws16 6000.000 EngN 0.00 6000.000 FORMAT "%8.3" EXTENDED_LIMITS -32768.00 32767.00 /end CHARACTERISTIC
/begin CHARACTERISTIC CmbChb_qRawThrHi_C "maximale Menge fuer Ueberwachung" VALUE 0xC8204 Kw_Ws16 655.3500 InjMass -327.6800 327.6700 FORMAT "%8.4" /end CHARACTERISTIC
/begin CHARACTERISTIC CmbChb_qRawThrLo_C "minimale Menge fuer Ueberwachung" VALUE 0xC8206 Kw_Ws16 655.3500 InjMass -327.6800 327.6700 FORMAT "%8.4" /end CHARACTERISTIC
/begin CHARACTERISTIC CmbChb_tClntThrLo_C "minimale Wassertemperatur fuer Ueberwachung" VALUE 0xC8208 Kw_Ws16 950.000 Temp_Cels -50.140 899.860 FORMAT "%8.3" EXTENDED_LIMITS -3549.940 3003.560 /end CHARACTERISTIC
/begin CHARACTERISTIC CmbChb_vThrHi_C "maximale Geschwindigkeit fuer Ueberwachung" VALUE 0xC820A Kw_Ws16 327.6700 Vel 0.00 327.6700 FORMAT "%8.4" EXTENDED_LIMITS -327.6800 327.6700 /end CHARACTERISTIC
/begin CHARACTERISTIC CmbChb_tiDebClutchChng_C "Entprellzeit für die Zustandsänderung des Kupplungssignals" VALUE 0xC820C Kw_Wu16 655350.0 Time_ms 0.00 655350.0 FORMAT "%8.1" /end CHARACTERISTIC
/begin CHARACTERISTIC CmbChb_tiDlyStr_C "Startausblendezeit" VALUE 0xC820E Kw_Wu16 655350.0 Time_ms 0.00 655350.0 FORMAT "%8.1" /end CHARACTERISTIC
/begin CHARACTERISTIC CmbChb_ctEngRevPerBlk_C "Blockgroesse (UpM) f. Ausbl./Test/Ausw.verz." VALUE 0xC8210 Kw_Wu16 65535.00 OneToOne 0.00 65535.00 FORMAT "%8.2" /end CHARACTERISTIC
/begin CHARACTERISTIC CmbChb_ctSegTDC1_C "Offset für internen Segmentzähler in Aussetzererkennung" VALUE 0xC8212 Kw_Wu16 0.00 OneToOne 0.00 0.00 FORMAT "%8.2" EXTENDED_LIMITS 0.00 65535.00 /end CHARACTERISTIC
/begin CHARACTERISTIC CmbChb_numBlk_C "Blockanzahl fuer Test" VALUE 0xC8214 Kw_Wu16 65535.00 OneToOne 0.00 65535.00 FORMAT "%8.2" /end CHARACTERISTIC
/begin CHARACTERISTIC CmbChb_dnSegMin_C "Prozentuelle Komponente des durchschnittlichen minimalen Drehzahlanstieges" VALUE 0xC8216 Kw_Ws16 799.9878 Prc -400.0000 399.9878 FORMAT "%8.4" /end CHARACTERISTIC
/begin CHARACTERISTIC CmbChb_ctMisfireMax_C "maximale Anzahl von Aussetzern pro Test" VALUE 0xC8218 Kw_Wu16 65535.00 OneToOne 0.00 65535.00 FORMAT "%8.2" /end CHARACTERISTIC
/begin CHARACTERISTIC CmbChb_swtMonClutchVal_C "DS-Wert für SW-Schalter CmbChb_swtMonClutch, De/Aktivierung Überwachung Zündaussetzererkennung" VALUE 0xC821A Kw_Wu8 3.000 OneToOne 0.00 3.000 FORMAT "%5.3" EXTENDED_LIMITS 0.00 255.0 /end CHARACTERISTIC
/begin CHARACTERISTIC CmbChb_swtMonClutchType_C "Typ SW-Schalter CmbChb_swtMonClutch (1: EEPROM, 2: DS-Wert CrCCD_swtMonClutchVal_C)" VALUE 0xC821B Kw_Wu8 1.000 OneToOne 1.000 2.000 FORMAT "%5.3" EXTENDED_LIMITS 0.00 255.0 /end CHARACTERISTIC
/begin CHARACTERISTIC CoDT_tiChkGrpDT1_C "Time delay for DT1 filter" VALUE 0xC8234 Kw_Wu32 4294.9673 TimeDelay_s 0.0000010000000 4294.9673 FORMAT "%9.4" /end CHARACTERISTIC
/begin CHARACTERISTIC CoDT_dChkGrpDT1Kd_C "Kd value for DT1 fliter" VALUE 0xC8238 Kw_Ws32 65535.9999847 Kd -32768.0000000 32767.9999847 FORMAT "%13.7" /end CHARACTERISTIC
/begin CHARACTERISTIC CoDT_tiChkGrpPT1_C "Time delay for PT1 filter" VALUE 0xC823C Kw_Wu32 4294.9673 TimeDelay_s 0.0000010000000 4294.9673 FORMAT "%9.4" /end CHARACTERISTIC
/begin CHARACTERISTIC CoDT_dOfsGripDet_C "Offset for dn/dt calculation for grip detection" VALUE 0xC8240 Kw_Ws16 65535.00 dn_dZfine -32768.00 32767.00 FORMAT "%8.2" /end CHARACTERISTIC
/begin CHARACTERISTIC CoDT_dOfsNoGripDet_C "Offset for dn/dt calculation for no grip detection" VALUE 0xC8242 Kw_Ws16 65535.00 dn_dZfine -32768.00 32767.00 FORMAT "%8.2" /end CHARACTERISTIC
/begin CHARACTERISTIC CoDT_dThetaGripDet_C "Theta for dn/dt calculation for grip detection" VALUE 0xC8244 Kw_Ws16 655.3500 Moment_Inertia -327.6800 327.6700 FORMAT "%8.4" /end CHARACTERISTIC
/begin CHARACTERISTIC CoDT_dThetaNoGripDet_C "Theta for dn/dt calculation for no grip detection" VALUE 0xC8246 Kw_Ws16 655.3500 Moment_Inertia -327.6800 327.6700 FORMAT "%8.4" /end CHARACTERISTIC
/begin CHARACTERISTIC CoDT_dtrqLimDwnCurr_C "negative Steigung für einen Rampenschalter im Curr-Pfad" VALUE 0xC821C Kw_Wu32 6553599.99847 RmpTrq 0.00 6553599.99847 FORMAT "%13.5" /end CHARACTERISTIC
/begin CHARACTERISTIC CoDT_dtrqLimDwnLead_C "negative Steigung für einen Rampenschalter im Lead-Pfad" VALUE 0xC8220 Kw_Wu32 6553599.99847 RmpTrq 0.00 6553599.99847 FORMAT "%13.5" /end CHARACTERISTIC
/begin CHARACTERISTIC CoDT_dtrqLimUpCurr_C "positive Steigung für einen Rampenschalter im Curr-Pfad" VALUE 0xC8224 Kw_Wu32 6553599.99847 RmpTrq 0.00 6553599.99847 FORMAT "%13.5" /end CHARACTERISTIC
/begin CHARACTERISTIC CoDT_dtrqLimUpLead_C "positive Steigung für Rampenschalter im Lead-Pfad" VALUE 0xC8228 Kw_Wu32 6553599.99847 RmpTrq 0.00 6553599.99847 FORMAT "%13.5" /end CHARACTERISTIC
/begin CHARACTERISTIC CoDT_swtAcsFltEna_C "Schalter um Filterwert zu aktivieren (1 = Filterung, 0 = keine Filterung)" VALUE 0xC8254 Kw_Wu8 1.000 OneToOne 0.00 1.000 FORMAT "%5.3" EXTENDED_LIMITS 0.00 255.0 /end CHARACTERISTIC
/begin CHARACTERISTIC CoDT_swtCoTypeVal_C "#SSD Sollmoment im Schub über Fahrpedalstellung (0: conventional; 1: mastershift)" VALUE 0xC822C Kw_Wu8 1.000 OneToOne 0.00 1.000 FORMAT "%5.3" EXTENDED_LIMITS 0.00 255.0 /end CHARACTERISTIC
/begin CHARACTERISTIC CoDT_swtCoTypeType_C "#SSD CoDT_swtCoType 0: bed. Spez. ; 1: form E2PROM; 2: Applikation" VALUE 0xC822D Kw_Wu8 1.000 OneToOne 1.000 2.000 FORMAT "%5.3" EXTENDED_LIMITS 0.00 255.0 /end CHARACTERISTIC
/begin CHARACTERISTIC CoDT_swtNoGripDet_C "Schalter zur deaktivierung der Kraftschlusserkennung mittels Trägheitsmoment (1 = deaktiviert, 0 = aktiviert)" VALUE 0xC8248 Kw_Wu8 255.0 OneToOne 0.00 255.0 FORMAT "%5.1" /end CHARACTERISTIC
/begin CHARACTERISTIC CoDT_tiDebGearUnVal_C "Delay time for debouncing neutral condition" VALUE 0xC824A Kw_Wu16 655350.0 Time_ms 0.00 655350.0 FORMAT "%8.1" /end CHARACTERISTIC
/begin CHARACTERISTIC CoDT_tiDebNoGrip_C "Delay time for debouncing No Grip" VALUE 0xC824C Kw_Wu16 655350.0 Time_ms 0.00 655350.0 FORMAT "%8.1" /end CHARACTERISTIC
/begin CHARACTERISTIC CoDT_tiFltPT1_C "Parameter für Filterung des Momentenbands" VALUE 0xC8258 Kw_Wu32 4294.9673 TimeDelay_s 0.0000010000000 4294.9673 FORMAT "%9.4" /end CHARACTERISTIC
/begin CHARACTERISTIC CoDT_tiGripDeb_C "Entprellzeit für die Kraftschlußerkennung im Triebstrang" VALUE 0xC824E Kw_Wu16 655350.0 Time_ms 0.00 655350.0 FORMAT "%8.1" /end CHARACTERISTIC
/begin CHARACTERISTIC CoDT_tiTrqRedMaxCurr_C "Zeitschwelle für ""langen"" Getriebeeingriff im Curr-Pfad" VALUE 0xC822E Kw_Wu16 655350.0 Time_ms 0.00 655350.0 FORMAT "%8.1" /end CHARACTERISTIC
/begin CHARACTERISTIC CoDT_tiTrqRedMaxLead_C "Zeitschwell für ""langen"" Getriebeeingriff im Lead-Pfad" VALUE 0xC8230 Kw_Wu16 655350.0 Time_ms 0.00 655350.0 FORMAT "%8.1" /end CHARACTERISTIC
/begin CHARACTERISTIC CoDT_trqMinInit_C "#SSD Initialwert für minimales Vortriebsmoment" VALUE 0xC825C Kw_Ws16 11000.00 TrqPrp -5000.000 6000.000 FORMAT "%8.3" EXTENDED_LIMITS -6553.600 6553.400 /end CHARACTERISTIC
/begin CHARACTERISTIC CoDT_vGrip_C "Geschwindigkeitsschwelle für Kraftschlußerkennung im Triebstrang" VALUE 0xC8250 Kw_Ws16 400.0000 Vel -100.0000 300.0000 FORMAT "%8.4" EXTENDED_LIMITS -327.6800 327.6700 /end CHARACTERISTIC
/begin CHARACTERISTIC CoEng_nActrRelease_C "#SSD Mindestdrehzahl für Stellerfreigabe" VALUE 0xC8260 Kw_Ws16 32727.00 EngN 40.00000 32767.00 FORMAT "%8.2" EXTENDED_LIMITS -32768.00 32767.00 /end CHARACTERISTIC
/begin CHARACTERISTIC CoEng_stAftRunSel_C "Schalterauswahl für den Nachlauf" VALUE 0xC8264 Kw_Wu8 255.0 OneToOne 0.00 255.0 FORMAT "%5.1" /end CHARACTERISTIC
/begin CHARACTERISTIC CoEng_tiActrPrt_C "#SSD maximale Zeit für Stellerbestromung" VALUE 0xC8262 Kw_Wu16 655350.0 Time_ms 0.00 655350.0 FORMAT "%8.1" /end CHARACTERISTIC
/begin CHARACTERISTIC CoEng_tiPwrStgDiaRdy_C "#SSD Verzoegerungszeit, um im Nachlauf abgeschaltete Steller zu diagnostizieren" VALUE 0xC8266 Kw_Wu16 655350.0 Time_ms 0.00 655350.0 FORMAT "%8.1" /end CHARACTERISTIC
/begin MEASUREMENT APPCD_drAPP1UnFlt "Differenz der Fahrpedal 1 Position ungefilterter Wert" SWORD PrcPerSec 1 100 -20000.00 19999.39 FORMAT "%8.2" ECU_ADDRESS 0x7F89F8 /end MEASUREMENT
/begin MEASUREMENT APPCD_rAPP1 "Ungefilterter APP1, wird während Testimpuls aktualisiert" SWORD Prc 1 100 -400.0000 399.9878 FORMAT "%8.4" ECU_ADDRESS 0x7F89FA /end MEASUREMENT
/begin MEASUREMENT APPCD_rAPP1UnFlt "Fahrpedal 1 position ungefilterter Rohwert" SWORD Prc 1 100 -400.0000 399.9878 FORMAT "%8.4" ECU_ADDRESS 0x7F89FC /end MEASUREMENT
/begin MEASUREMENT APPCD_rFlt "gefiltertes Pedalwertgebersignal" SWORD Prc 1 100 -400.0000 399.9878 FORMAT "%8.4" ECU_ADDRESS 0x7F89FE /end MEASUREMENT
/begin MEASUREMENT APPCD_rFlt_mp "gefilterter PWG Positions Wert ohne PTO Eingriff" SWORD Prc 1 100 -400.0000 399.9878 FORMAT "%8.4" ECU_ADDRESS 0x8FE39A /end MEASUREMENT
/begin MEASUREMENT APPCD_rLinAPP1 "linearisierter APP1" SWORD Prc 1 100 -400.0000 399.9878 FORMAT "%8.4" ECU_ADDRESS 0x7F8A00 /end MEASUREMENT
/begin MEASUREMENT APPCD_rLinAPP2 "Linearisierter APP2" SWORD Prc 1 100 -400.0000 399.9878 FORMAT "%8.4" ECU_ADDRESS 0x7F8A02 /end MEASUREMENT
/begin MEASUREMENT APPCD_rNextThr "Berechneter Wert des nächsten Schwellwertes" SWORD Prc 1 100 -400.0000 399.9878 FORMAT "%8.4" ECU_ADDRESS 0x7F8A04 /end MEASUREMENT
/begin MEASUREMENT APPCD_rStepLim_mp "Limitierter Stufen-Wert" SWORD Prc 1 100 -400.0000 399.9878 FORMAT "%8.4" ECU_ADDRESS 0x8FE39C /end MEASUREMENT
/begin MEASUREMENT APPCD_SRCErrInfo_mp "Status der SRC-Fehler für APP1 und APP2" UBYTE OneToOne 1 100 0.00 255.0 FORMAT "%5.1" ECU_ADDRESS 0x8FE39E /end MEASUREMENT
/begin MEASUREMENT APPCD_stADCMonbit15RE_mp "the status of rising edge on the test impulse" UBYTE OneToOne 1 100 0.00 255.0 FORMAT "%5.1" ECU_ADDRESS 0x8FE39F /end MEASUREMENT
/begin MEASUREMENT APPCD_stErr1_mp "Fehlerzustand von APP1/2 Signal" UWORD OneToOne 1 100 0.00 65535.00 FORMAT "%8.2" ECU_ADDRESS 0x8FE3A0 /end MEASUREMENT
/begin MEASUREMENT APPCD_stKickDown "Kick Down Zustand des Fahrpedals" UBYTE OneToOne 1 100 0.00 255.0 FORMAT "%5.1" ECU_ADDRESS 0x7F87B1 /end MEASUREMENT
/begin MEASUREMENT APPCD_stPos "Status der PWG Position" UBYTE OneToOne 1 100 0.00 255.0 FORMAT "%5.1" ECU_ADDRESS 0x7F87B2 /end MEASUREMENT
/begin MEASUREMENT APPCD_u0PrcAPP1_mp "Ermittelte Spannung bei 0% APP1" SWORD Volt 1 100 -160156.4 160151.5 FORMAT "%8.1" ECU_ADDRESS 0x8FE3A2 /end MEASUREMENT
/begin MEASUREMENT APPCD_u0PrcAPP2_mp "Ermittelte Spannung bei 0% APP2" SWORD Volt 1 100 -160156.4 160151.5 FORMAT "%8.1" ECU_ADDRESS 0x8FE3A4 /end MEASUREMENT
/begin MEASUREMENT APPCD_uDiffMax_mp "Maximal zulässige Differenz der Rohspannungen" SWORD Volt 1 100 -160156.4 160151.5 FORMAT "%8.1" ECU_ADDRESS 0x8FE3A6 /end MEASUREMENT
/begin MEASUREMENT APPCD_uRawAPP1 "Fahrpedal 1 Position Rohwert" SWORD Volt 1 100 -160156.4 160151.5 FORMAT "%8.1" ECU_ADDRESS 0x7F8A06 /end MEASUREMENT
/begin MEASUREMENT APPCD_uRawAPP2 "Fahrpedal 2 Position Rohwert" SWORD Volt 1 100 -160156.4 160151.5 FORMAT "%8.1" ECU_ADDRESS 0x7F8A08 /end MEASUREMENT
/begin MEASUREMENT APPCD_uRawDiff_mp "Betrag der Differenz der Rohspannungen von APP1 und APP2" SWORD Volt 1 100 -160156.4 160151.5 FORMAT "%8.1" ECU_ADDRESS 0x8FE3A8 /end MEASUREMENT
/begin MEASUREMENT APSCD_BpsAllowed_mp "Wahlschalter - Atmosphaerendruck gemessen (wenn verbaut) od. gerechnet von Ladedrucksensor" UWORD OneToOne 1 100 0.00 65535.00 FORMAT "%8.2" ECU_ADDRESS 0x8FE3AA /end MEASUREMENT
/begin MEASUREMENT APSCD_pCorVal_mp "Korrekturwert fuer Atmosphaerendruck von Ladedrucksensor" SWORD Pres_hPa 1 100 -32768.00 32767.00 FORMAT "%8.2" ECU_ADDRESS 0x8FE3AC /end MEASUREMENT
/begin MEASUREMENT APSCD_pLinVal "Rohwert Atmosphärendruck über ADC" SWORD Pres_hPa 1 100 -32768.00 32767.00 FORMAT "%8.2" ECU_ADDRESS 0x7F8A0A /end MEASUREMENT
/begin MEASUREMENT APSCD_pPhyVal_mp "Rohwert Atmosphärendruck über ADC" SWORD Pres_hPa 1 100 -32768.00 32767.00 FORMAT "%8.2" ECU_ADDRESS 0x8FE3AE /end MEASUREMENT
/begin MEASUREMENT APSCD_pSensorVal "Atmosphaerendruck Sensorwert" SWORD Pres_hPa 1 100 -32768.00 32767.00 FORMAT "%8.2" ECU_ADDRESS 0x7F8A0C /end MEASUREMENT
/begin MEASUREMENT APSCD_pVal "Atmosphärendruck" SWORD Pres_hPa 1 100 -32768.00 32767.00 FORMAT "%8.2" ECU_ADDRESS 0x7F8A0E /end MEASUREMENT
/begin MEASUREMENT APSCD_stSensorInst "Status, ob Atmosphärendrucksensor eingebaut ist (0 == nicht eingebaut)" UBYTE OneToOne 1 100 0.00 255.0 FORMAT "%5.1" ECU_ADDRESS 0x7F87B3 /end MEASUREMENT
/begin MEASUREMENT APSCD_swtSig "Atmosphaerendruck Funktionsschalter - Signalwert von CAN od. ADC" UBYTE OneToOne 1 100 0.00 255.0 FORMAT "%5.1" ECU_ADDRESS 0x7F87B4 /end MEASUREMENT
/begin MEASUREMENT APSCD_uRaw "Rohspannung ADC-Signal Atmosphärendruck" SWORD Volt 1 100 -160156.4 160151.5 FORMAT "%8.1" ECU_ADDRESS 0x7F8A10 /end MEASUREMENT
/begin MEASUREMENT ARS_pwrDes "Current power requirement of ARS module" SWORD Pwr 1 100 -308831.1 308821.7 FORMAT "%8.1" ECU_ADDRESS 0x7F8A12 /end MEASUREMENT
/begin MEASUREMENT ARS_pwrLead "Current power requirement of ARS module for monitoring" SWORD Pwr 1 100 -308831.1 308821.7 FORMAT "%8.1" ECU_ADDRESS 0x7F8A14 /end MEASUREMENT
/begin MEASUREMENT ARS_st "Status of power requirement of ARS" UBYTE OneToOne 1 100 0.00 255.0 FORMAT "%5.1" ECU_ADDRESS 0x7F87B5 /end MEASUREMENT
/begin MEASUREMENT ARS_stRecARS "Status of ARS detection" UBYTE OneToOne 1 100 0.00 255.0 FORMAT "%5.1" ECU_ADDRESS 0x7F87B6 /end MEASUREMENT
/begin MEASUREMENT ARS_trqCor_mp "Corrected current torque" SWORD Trq 1 100 -3276.800 3276.700 FORMAT "%8.3" ECU_ADDRESS 0x8FE3B0 /end MEASUREMENT
/begin MEASUREMENT ARS_trqCurMax_mp "corrected maximum torque" SWORD Trq 1 100 -3276.800 3276.700 FORMAT "%8.3" ECU_ADDRESS 0x8FE3B2 /end MEASUREMENT
/begin MEASUREMENT ARS_trqDesMax_mp "Maximum desired torque" SWORD Trq 1 100 -3276.800 3276.700 FORMAT "%8.3" ECU_ADDRESS 0x8FE3B4 /end MEASUREMENT
/begin MEASUREMENT ARS_trqDesOld_mp "Desired torque of previous cycle" SWORD Trq 1 100 -3276.800 3276.700 FORMAT "%8.3" ECU_ADDRESS 0x8FE3B6 /end MEASUREMENT
/begin MEASUREMENT ARS_trqDes_mp "Desired torque after correction" SWORD Trq 1 100 -3276.800 3276.700 FORMAT "%8.3" ECU_ADDRESS 0x8FE3B8 /end MEASUREMENT
/begin MEASUREMENT ASDdc_KdCurr_mp "Aktueller Parameter Kd des Störungsreglers" FLOAT32_IEEE ASD_GvrnDT1Kd_float 1 100 -1.00000000 100.000000 FORMAT "%10.6" ECU_ADDRESS 0x8FE3BC /end MEASUREMENT
/begin MEASUREMENT ASDdc_nAvrg_mp "Motordrehzahl für die Parametersatzauswahl beim ASDdc" SWORD EngN 1 100 -32768.00 32767.00 FORMAT "%8.2" ECU_ADDRESS 0x8FE3C4 /end MEASUREMENT
/begin MEASUREMENT ASDdc_stCluPS_mp "Kupplungs PS aktiv/nicht aktiv" UBYTE OneToOne 1 100 0.00 255.0 FORMAT "%5.1" ECU_ADDRESS 0x8FE3C6 /end MEASUREMENT
/begin MEASUREMENT ASDdc_stCond_mp "Zustand der Eingangsbedingungen" UWORD OneToOne 1 100 0.00 65535.00 FORMAT "%8.2" ECU_ADDRESS 0x8FE3C8 /end MEASUREMENT
/begin MEASUREMENT ASDdc_stPrioState_mp "Primärzustand mit der höchsten Priorität" UWORD OneToOne 1 100 0.00 65535.00 FORMAT "%8.2" ECU_ADDRESS 0x8FE3CA /end MEASUREMENT
/begin MEASUREMENT ASDdc_stREinit_mp "Zustand Reinit (deaktivieren)" UBYTE OneToOne 1 100 0.00 255.0 FORMAT "%5.1" ECU_ADDRESS 0x8FE3CC /end MEASUREMENT
/begin MEASUREMENT ASDdc_stSelectState_mp "Ausgewählter Primärzustand" UWORD ASDdcState 1 100 0.00 65535.00 FORMAT "%8.2" ECU_ADDRESS 0x8FE3CE /end MEASUREMENT
/begin MEASUREMENT ASDdc_stStates_mp "Zustand der Primärzustände" UWORD OneToOne 1 100 0.00 65535.00 FORMAT "%8.2" ECU_ADDRESS 0x8FE3D0 /end MEASUREMENT
/begin MEASUREMENT ASDdc_T1Curr_mp "Aktueller Parameter T1 des Störungsreglers" FLOAT32_IEEE ASD_GvrnDT1T1_float 1 100 -1.00000000 100.000000 FORMAT "%10.6" ECU_ADDRESS 0x8FE3C0 /end MEASUREMENT
/begin MEASUREMENT ASDdc_trq "Momentforderung Aktiver Ruckeldämpfer (Störungsregler)" SWORD Trq 1 100 -3276.800 3276.700 FORMAT "%8.3" ECU_ADDRESS 0x7F8A16 /end MEASUREMENT
/begin MEASUREMENT ASDrf_CoeffALossCurr_mp "Aktueller Kennwert für den Koeffitienten zweiter Ordnung der LSD Steigungsbegrenzung." SWORD CoeffA 1 100 -160.0000 159.9951 FORMAT "%8.4" ECU_ADDRESS 0x8FE3D4 /end MEASUREMENT
/begin MEASUREMENT ASDrf_CoeffBLossCurr_mp "Aktueller Kennwert für den Koeffitienten nullter Ordnung der LSD Steigungsbegrenzung." SWORD dTrq 1 100 -3276.800 3276.700 FORMAT "%8.3" ECU_ADDRESS 0x8FE3D6 /end MEASUREMENT
/begin MEASUREMENT ASDrf_dtrqDecMax_mp "Max. Drehmomentsteigung aufgrund der Gradientenbegrenzung bei Momentenabsenkung." SWORD dTrq 1 100 -3276.800 3276.700 FORMAT "%8.3" ECU_ADDRESS 0x8FE3D8 /end MEASUREMENT
/begin MEASUREMENT ASDrf_dtrqDecMin_mp "Min. Drehmomentsteigung aufgrund der Gradientenbegrenzung bei Momentenabsenkung." SWORD dTrq 1 100 -3276.800 3276.700 FORMAT "%8.3" ECU_ADDRESS 0x8FE3DA /end MEASUREMENT
/begin MEASUREMENT ASDrf_dtrqInrLtd_mp "zeitliche Ableitung von CoEng_trqInrLtd" SWORD dTrq 1 100 -3276.800 3276.700 FORMAT "%8.3" ECU_ADDRESS 0x8FE3DC /end MEASUREMENT
/begin MEASUREMENT ASDrf_dtrqLim_mp "durch ASDrf_dtrqInrLtdLim_CUR begrenzte zeitliche Ableitung von CoEng_trqInrLtd" SLONG dTrq 1 100 -214748364.800 214748364.700 FORMAT "%13.3" ECU_ADDRESS 0x8FE3E0 /end MEASUREMENT
/begin MEASUREMENT ASDrf_dtrqLossMax_mp "Maximale Drehmomentsteigung der Steigungsbegrenzung um das Verlustmoment." SWORD dTrq 1 100 -3276.800 3276.700 FORMAT "%8.3" ECU_ADDRESS 0x8FE3E4 /end MEASUREMENT
/begin MEASUREMENT ASDrf_dtrqLossMin_mp "Maximale Drehmomentsteigung der Steigungsbegrenzung um das Verlustmoment." SWORD dTrq 1 100 -3276.800 3276.700 FORMAT "%8.3" ECU_ADDRESS 0x8FE3E6 /end MEASUREMENT
/begin MEASUREMENT ASDrf_dtrqMax_mp "Max. Drehmomentsteigung in der Umgebung des Verlustmoments oder durch die Begrenzung bei Drehmomentabsenkung." SWORD dTrq 1 100 -3276.800 3276.700 FORMAT "%8.3" ECU_ADDRESS 0x8FE3E8 /end MEASUREMENT
/begin MEASUREMENT ASDrf_dtrqMin_mp "Min. Drehmomentsteigung in der Umgebung des Verlustmoments oder durch die Begrenzung bei Drehmomentabsenkung." SWORD dTrq 1 100 -3276.800 3276.700 FORMAT "%8.3" ECU_ADDRESS 0x8FE3EA /end MEASUREMENT
/begin MEASUREMENT ASDrf_KdCurr_mp "Aktueller Parameter Kd des ARD-FF (ASDrf)" SLONG Kd 1 100 -32768.0000000 32767.9999847 FORMAT "%13.7" ECU_ADDRESS 0x8FE3EC /end MEASUREMENT
/begin MEASUREMENT ASDrf_stCond_mp "Status der Eingangsbedingungen" UWORD OneToOne 1 100 0.00 65535.00 FORMAT "%8.2" ECU_ADDRESS 0x8FE42E /end MEASUREMENT
/begin MEASUREMENT ASDrf_stDecLimState_mp "Status des Zustandsautomaten für Steigungsbegrenzung bei Momentenabsenkung." UBYTE OneToOne 1 100 0.00 255.0 FORMAT "%5.1" ECU_ADDRESS 0x8FE3F0 /end MEASUREMENT
/begin MEASUREMENT ASDrf_stIncLim_mp "Aktueller Zustand für flachen(=1) / steilen(=0) Drehmoment Anstieg." SWORD OneToOne 1 100 -32768.00 32767.00 FORMAT "%8.2" ECU_ADDRESS 0x8FE3F2 /end MEASUREMENT
/begin MEASUREMENT ASDrf_stInit "Initialisierungsanforderungen/Quittierungen an PT1, PDT1-Glieder" UBYTE OneToOne 1 100 0.00 255.0 FORMAT "%5.1" ECU_ADDRESS 0x6F800A /end MEASUREMENT
/begin MEASUREMENT ASDrf_stInitdtrqSteep_mp "Reinitialisierung bei Parametersatzänderung aktiv/inaktiv" UBYTE OneToOne 1 100 0.00 255.0 FORMAT "%5.1" ECU_ADDRESS 0x8FE3F4 /end MEASUREMENT
/begin MEASUREMENT ASDrf_stLAD "Zustandsvariable für den Automaten zur LSD Steuerung." UBYTE OneToOne 1 100 0.00 255.0 FORMAT "%5.1" ECU_ADDRESS 0x7F87B7 /end MEASUREMENT
/begin MEASUREMENT ASDrf_stPosNeg_mp "aktueller pos/neg Zustand" UBYTE OneToOne 1 100 0.00 255.0 FORMAT "%5.1" ECU_ADDRESS 0x8FE3F5 /end MEASUREMENT
/begin MEASUREMENT ASDrf_stPrioState_mp "Aktiver Zustand nach der Priorisierung" UWORD OneToOne 1 100 0.00 65535.00 FORMAT "%8.2" ECU_ADDRESS 0x8FE430 /end MEASUREMENT
/begin MEASUREMENT ASDrf_stSelectState_mp "Aktiver Zustand, genau ein Primärzustand ist aktive" UWORD ASDrf_stPrimState 1 100 0.00 32.0000000000 FORMAT "%13.10" ECU_ADDRESS 0x8FE432 /end MEASUREMENT
/begin MEASUREMENT ASDrf_stStates_mp "Auswertung der Primärzustände (konkurrierende Zustände möglich)" UWORD OneToOne 1 100 0.00 65535.00 FORMAT "%8.2" ECU_ADDRESS 0x8FE434 /end MEASUREMENT
/begin MEASUREMENT ASDrf_stTrqLim_mp "Zustand der Drehmoment Gradientenbegrenzung (0=inaktiv, 1=aktiv)" UBYTE OneToOne 1 100 0.00 255.0 FORMAT "%5.1" ECU_ADDRESS 0x8FE3F6 /end MEASUREMENT
/begin MEASUREMENT ASDrf_T1Curr_mp "Aktueller Parameter T1 des ARD-FF (ASDrf)" ULONG TimeDelay_s 1 100 0.0000010000000 4294.9673 FORMAT "%9.4" ECU_ADDRESS 0x8FE3F8 /end MEASUREMENT
/begin MEASUREMENT ASDrf_trqASDSum_mp "Aktuelles ASD Moment (Berechnung abhängig von ASDrf_swtCalcTrq_C)" SWORD Trq 1 100 -3276.800 3276.700 FORMAT "%8.3" ECU_ADDRESS 0x8FE3FC /end MEASUREMENT
/begin MEASUREMENT ASDrf_trqCompOfs_mp "Offset auf den PT1 Eingang zur Polkompensation." SLONG Trq 1 100 -214748364.800 214748364.700 FORMAT "%13.3" ECU_ADDRESS 0x8FE400 /end MEASUREMENT
/begin MEASUREMENT ASDrf_trqDecLimStrt_mp "Startpunkt / Scheitelpunkt für die Steigungsbegrenzung bei Drehmomentabsenkung" SWORD Trq 1 100 -3276.800 3276.700 FORMAT "%8.3" ECU_ADDRESS 0x8FE404 /end MEASUREMENT
/begin MEASUREMENT ASDrf_trqInit_mp "berechneter Initialisierungswert für PT1 Zustandsvariable" SWORD Trq 1 100 -3276.800 3276.700 FORMAT "%8.3" ECU_ADDRESS 0x8FE406 /end MEASUREMENT
/begin MEASUREMENT ASDrf_trqInr "ARD Führungsformer Momentausgang (inneres Moment)" SWORD Trq 1 100 -3276.800 3276.700 FORMAT "%8.3" ECU_ADDRESS 0x7F8A18 /end MEASUREMENT
/begin MEASUREMENT ASDrf_trqInrLtdFlt_mp "Gefiltertes Eingangssignal CoEng_trqInrLtd" SWORD Trq 1 100 -3276.800 3276.700 FORMAT "%8.3" ECU_ADDRESS 0x8FE408 /end MEASUREMENT
/begin MEASUREMENT ASDrf_trqInrMaxUnLim_mp "Aktuelle Obergrenze für ASDrf_trqInr vor der Begrenzung mit CoEng_trqInrLim (abhängig von ASDrf_swtLim_C)." SLONG Trq32 1 100 -3276.80000000 3276.79999847 FORMAT "%13.8" ECU_ADDRESS 0x8FE40C /end MEASUREMENT
/begin MEASUREMENT ASDrf_trqInrMax_mp "Max. zulässiges Moment durch Steigungsbegrenzung." SLONG Trq32 1 100 -3276.80000000 3276.79999847 FORMAT "%13.8" ECU_ADDRESS 0x8FE410 /end MEASUREMENT
/begin MEASUREMENT ASDrf_trqInrMinUnLim_mp "Aktuelle Untergrenze für ASDrf_trqInr vor der Begrenzung mit 0 (abhängig von ASDrf_swtLim_C)." SLONG Trq32 1 100 -3276.80000000 3276.79999847 FORMAT "%13.8" ECU_ADDRESS 0x8FE414 /end MEASUREMENT
/begin MEASUREMENT ASDrf_trqInrMin_mp "Min. zulässiges Moment durch Steigungsbegrenzung." SLONG Trq32 1 100 -3276.80000000 3276.79999847 FORMAT "%13.8" ECU_ADDRESS 0x8FE418 /end MEASUREMENT
/begin MEASUREMENT ASDrf_trqInrUnLim_mp "Ausgang des PDT1-Glieds, vor der Steigungsbegrenzung des Führungsformers." SWORD Trq 1 100 -3276.800 3276.700 FORMAT "%8.3" ECU_ADDRESS 0x8FE41C /end MEASUREMENT
/begin MEASUREMENT ASDrf_trqLossNeg "Verlustmoment bei negativem Zustand von ASDrf_stPosNeg." SWORD Trq 1 100 -3276.800 3276.700 FORMAT "%8.3" ECU_ADDRESS 0x7F8A1A /end MEASUREMENT
/begin MEASUREMENT ASDrf_trqLossPos "Verlustmoment bei positivem Zustand von ASDrf_stPosNeg." SWORD Trq 1 100 -3276.800 3276.700 FORMAT "%8.3" ECU_ADDRESS 0x7F8A1C /end MEASUREMENT
/begin MEASUREMENT ASDrf_trqLoss_mp "Reibmoment inc. Nebenaggregate" SWORD Trq 1 100 -3276.800 3276.700 FORMAT "%8.3" ECU_ADDRESS 0x8FE41E /end MEASUREMENT
/begin MEASUREMENT ASDrf_trqPT1In_mp "aktueller PT1 Eingangswert" SLONG Trq 1 100 -214748364.800 214748364.700 FORMAT "%13.3" ECU_ADDRESS 0x8FE420 /end MEASUREMENT
/begin MEASUREMENT ASDrf_trqPT1Out_mp "aktueller PT1 Ausgangswert" SWORD Trq 1 100 -3276.800 3276.700 FORMAT "%8.3" ECU_ADDRESS 0x8FE424 /end MEASUREMENT
/begin MEASUREMENT ASDrf_trqPT1P_mp "Ausgang P-Anteil in PT1 gefiltertem Signal" SWORD Trq 1 100 -3276.800 3276.700 FORMAT "%8.3" ECU_ADDRESS 0x8FE426 /end MEASUREMENT
/begin MEASUREMENT ASDrf_trqP_mp "Ausgang ASDrf P-Anteil" SWORD Trq 1 100 -3276.800 3276.700 FORMAT "%8.3" ECU_ADDRESS 0x8FE428 /end MEASUREMENT
/begin MEASUREMENT ASDrf_trqStyHigh_mp "Obere Grenze des Momentenintervalls für die Erkennung eines stationären Zustands." SWORD Trq 1 100 -3276.800 3276.700 FORMAT "%8.3" ECU_ADDRESS 0x8FE42A /end MEASUREMENT
/begin MEASUREMENT ASDrf_trqStyLow_mp "Untere Grenze des Momentenintervalls für die Erkennung eines stationären Zustands." SWORD Trq 1 100 -3276.800 3276.700 FORMAT "%8.3" ECU_ADDRESS 0x8FE42C /end MEASUREMENT
/begin MEASUREMENT ASMod_dmAirPerTimeCorr "dynamisch korrigierter Frischluftmassenstrom vor Mischstelle" SWORD AirMassPerTime 1 100 -3276.800 3276.700 FORMAT "%8.3" ECU_ADDRESS 0x7F8A1E /end MEASUREMENT
/begin MEASUREMENT ASMod_dmEGR_mp "rückgeführter Abgasmassenstrom" SWORD AirMassPerTime 1 100 -3276.800 3276.700 FORMAT "%8.3" ECU_ADDRESS 0x8FE436 /end MEASUREMENT
/begin MEASUREMENT ASMod_dmEG_mp "Abgasmassenstrom nach Verbrennung" SWORD AirMassPerTime 1 100 -3276.800 3276.700 FORMAT "%8.3" ECU_ADDRESS 0x8FE440 /end MEASUREMENT
/begin MEASUREMENT ASMod_dmExhMnfPre "Abgasmassenstrom am Eintritt des Abgaskrümmers" SWORD AirMassPerTime 1 100 -3276.800 3276.700 FORMAT "%8.3" ECU_ADDRESS 0x7F8A20 /end MEASUREMENT
/begin MEASUREMENT ASMod_dmExhMnfPst "Abgasmassenstrom am Austritt des Abgaskrümmers" SWORD AirMassPerTime 1 100 -3276.800 3276.700 FORMAT "%8.3" ECU_ADDRESS 0x7F8A22 /end MEASUREMENT
/begin MEASUREMENT ASMod_dmFlBurned_mp "Massenstrom des verbrannten Kraftstoffs" SWORD InjMassPerTime 1 100 -327.6800 327.6700 FORMAT "%8.4" ECU_ADDRESS 0x8FE442 /end MEASUREMENT
/begin MEASUREMENT ASMod_dmFlPerTime_mp "eingespritzter Kraftstoffmassenstrom" SWORD InjMassPerTime 1 100 -327.6800 327.6700 FORMAT "%8.4" ECU_ADDRESS 0x8FE444 /end MEASUREMENT
/begin MEASUREMENT ASMod_dmIndAir "Gasmassenstrom in den Motor" SWORD AirMassPerTime 1 100 -3276.800 3276.700 FORMAT "%8.3" ECU_ADDRESS 0x7F8A24 /end MEASUREMENT
/begin MEASUREMENT ASMod_dmIndAirRef "Referenz des Gasmassenstroms in den Motor während geschlossener Abgasrückführung" SWORD AirMassPerTime 1 100 -3276.800 3276.700 FORMAT "%8.3" ECU_ADDRESS 0x7F8A26 /end MEASUREMENT
/begin MEASUREMENT ASMod_dmIndAirRef_mp "Referenz des Gasmassenstroms in den Motor" SWORD AirMassPerTime 1 100 -3276.800 3276.700 FORMAT "%8.3" ECU_ADDRESS 0x8FE446 /end MEASUREMENT
/begin MEASUREMENT ASMod_dmIndAir_mp "Gasmassenstrom in den Motor" SWORD AirMassPerTime 1 100 -3276.800 3276.700 FORMAT "%8.3" ECU_ADDRESS 0x8FE438 /end MEASUREMENT
/begin MEASUREMENT ASMod_dmIndVol_mp "zeitliche Änderung der Gasmasse im Ansaugvolumen" SWORD AirMassPerTime 1 100 -3276.800 3276.700 FORMAT "%8.3" ECU_ADDRESS 0x8FE464 /end MEASUREMENT
/begin MEASUREMENT ASMod_dmO2EG_mp "Sauerstoffmassenstrom nach Verbrennung" SWORD O2MassPerTime 1 100 -327.6800 327.6700 FORMAT "%8.4" ECU_ADDRESS 0x8FE448 /end MEASUREMENT
/begin MEASUREMENT ASMod_dmO2IndAir "Sauerstoffmassenstrom in den Motor" SWORD O2MassPerTime 1 100 -327.6800 327.6700 FORMAT "%8.4" ECU_ADDRESS 0x7F8A28 /end MEASUREMENT
/begin MEASUREMENT ASMod_dvolIndAirRef "Referenz des Gasvolumenstroms in den Motor" SWORD AirVolPerTime 1 100 -3276.800 3276.700 FORMAT "%8.3" ECU_ADDRESS 0x7F8A2A /end MEASUREMENT
/begin MEASUREMENT ASMod_facAMCor "Korrekturfaktor für Luftmassensignal" SWORD Fact 1 100 -4.000000 3.999878 FORMAT "%8.6" ECU_ADDRESS 0x7F8A2C /end MEASUREMENT
/begin MEASUREMENT ASMod_facDMCorTDiff_mp "Korrekturfaktor der Temperaturerhöhung aufgrund des aktuellen Gasmassenstroms" SWORD Fact 1 100 -4.000000 3.999878 FORMAT "%8.6" ECU_ADDRESS 0x8FE44A /end MEASUREMENT
/begin MEASUREMENT ASMod_facSOICorTDiff_mp "Korrekturfaktor der Temperaturerhöhung aufgrund des aktuellen Spritzbeginns" SWORD Fact 1 100 -4.000000 3.999878 FORMAT "%8.6" ECU_ADDRESS 0x8FE44C /end MEASUREMENT
/begin MEASUREMENT ASMod_facTIndAirCor_mp "Korrekturfaktor für Luftaufwand" SWORD RatAirMass 1 100 -32.76800 32.76700 FORMAT "%8.5" ECU_ADDRESS 0x8FE468 /end MEASUREMENT
/begin MEASUREMENT ASMod_facVolEff_mp "Luftaufwand aus Grundkennfeld" SWORD RatAirMass 1 100 -32.76800 32.76700 FORMAT "%8.5" ECU_ADDRESS 0x8FE46A /end MEASUREMENT
/begin MEASUREMENT ASMod_facVSACorVolEff_mp "Korrekturfaktor für Luftaufwand aufgrund aktueller Drallklappenposition" SWORD RatAirMass 1 100 -32.76800 32.76700 FORMAT "%8.5" ECU_ADDRESS 0x8FE46C /end MEASUREMENT
/begin MEASUREMENT ASMod_mAirPerCylCorr "dynamisch korrigierte Luftmasse pro Zylinder vor Mischstelle" SWORD AirMassPerCyl 1 100 -3276.800 3276.700 FORMAT "%8.3" ECU_ADDRESS 0x7F8A2E /end MEASUREMENT
/begin MEASUREMENT ASMod_mIndVol_mp "Gasmasse im Einlassvolumen" SWORD AirMass 1 100 -327.6800 327.6700 FORMAT "%8.4" ECU_ADDRESS 0x8FE466 /end MEASUREMENT
/begin MEASUREMENT ASMod_phiSOIRef_mp "Referenz des Spritzbeginns der MI1" SWORD AngleCrS 1 100 -768.0000 767.9766 FORMAT "%8.4" ECU_ADDRESS 0x8FE44E /end MEASUREMENT
/begin MEASUREMENT ASMod_qBurned_mp "Menge des verbrannten Kraftstoffes" SWORD InjMass 1 100 -327.6800 327.6700 FORMAT "%8.4" ECU_ADDRESS 0x8FE450 /end MEASUREMENT
/begin MEASUREMENT ASMod_qCor "Korrekturmenge für Mengensignal" SWORD InjMass 1 100 -327.6800 327.6700 FORMAT "%8.4" ECU_ADDRESS 0x7F8A30 /end MEASUREMENT
/begin MEASUREMENT ASMod_qLmbdCtlCorr_mp "korrigierte Lambdakontrollmenge" SWORD InjMass 1 100 -327.6800 327.6700 FORMAT "%8.4" ECU_ADDRESS 0x8FE452 /end MEASUREMENT
/begin MEASUREMENT ASMod_rDMIndAir_mp "relative Abweichung von der Referenz des Gasmassenstroms" SWORD RatAirMass 1 100 -32.76800 32.76700 FORMAT "%8.5" ECU_ADDRESS 0x8FE454 /end MEASUREMENT
/begin MEASUREMENT ASMod_rFlBurned_mp "Verhältnis der verbrannten zur eingespritzten Kraftstoffmasse" SWORD RatFuelMass 1 100 -327.6800 327.6700 FORMAT "%8.4" ECU_ADDRESS 0x8FE456 /end MEASUREMENT
/begin MEASUREMENT ASMod_rLmbdRecEG "schnelles reziprokes Lambda-Signal nach Verbrennung" SWORD lambdaRecVal 1 100 -32.76800 32.76700 FORMAT "%8.5" ECU_ADDRESS 0x7F8A32 /end MEASUREMENT
/begin MEASUREMENT ASMod_rLmbdRecExhMnfPst "reziprokes Lambdasignal am Ausgang des Abgaskrümmers" SWORD lambdaRecVal 1 100 -32.76800 32.76700 FORMAT "%8.5" ECU_ADDRESS 0x7F8A34 /end MEASUREMENT
/begin MEASUREMENT ASMod_rO2EG_mp "Sauerstoffmassenanteil des Abgases nach Verbrennung" SWORD O2 1 100 -0.3276800 0.3276700 FORMAT "%9.7" ECU_ADDRESS 0x8FE458 /end MEASUREMENT
/begin MEASUREMENT ASMod_rO2ExhMnfPre "Sauerstoffmassenanteil des Abgases am Eintritt des Abgaskrümmers" SWORD O2 1 100 -0.3276800 0.3276700 FORMAT "%9.7" ECU_ADDRESS 0x7F8A36 /end MEASUREMENT
/begin MEASUREMENT ASMod_rO2ExhMnfPst_mp "Sauerstoffmassenanteil des Abgases am Austritt des Abgaskrümmers" SWORD O2 1 100 -0.3276800 0.3276700 FORMAT "%9.7" ECU_ADDRESS 0x8FE43A /end MEASUREMENT
/begin MEASUREMENT ASMod_rO2IndAir_mp "Sauerstoffmassenanteil des Massenstroms in den Motor" SWORD O2 1 100 -0.3276800 0.3276700 FORMAT "%9.7" ECU_ADDRESS 0x8FE43C /end MEASUREMENT
/begin MEASUREMENT ASMod_rRelPosVSA "relative Position der Drallklappe" SWORD Prc 1 100 -400.0000 399.9878 FORMAT "%8.4" ECU_ADDRESS 0x7F8A38 /end MEASUREMENT
/begin MEASUREMENT ASMod_tDiffEG_mp "Temperaturerhöhung des Gasmassenstroms durch Verbrennung" SWORD TempDiff_Cels 1 100 -3276.800 3276.700 FORMAT "%8.3" ECU_ADDRESS 0x8FE45A /end MEASUREMENT
/begin MEASUREMENT ASMod_tDiffEng_mp "Temperaturerhöhung des Gasmassenstroms aus dem Grundkennfeld" SWORD TempDiff_Cels 1 100 -3276.800 3276.700 FORMAT "%8.3" ECU_ADDRESS 0x8FE45C /end MEASUREMENT
/begin MEASUREMENT ASMod_tEG_mp "Temperatur des Abgases nach Verbrennung" SWORD Temp_Cels 1 100 -50.140 899.860 FORMAT "%8.3" ECU_ADDRESS 0x8FE45E /end MEASUREMENT
/begin MEASUREMENT ASMod_tEngCorTDiff_mp "Korrektur der Temperaturerhöhung aufgrund der Motortemperatur" SWORD TempDiff_Cels 1 100 -3276.800 3276.700 FORMAT "%8.3" ECU_ADDRESS 0x8FE460 /end MEASUREMENT
/begin MEASUREMENT ASMod_tExhMnfPre "Abgastemperatur am Eintritt des Abgaskrümmers" SWORD Temp_Cels 1 100 -50.140 899.860 FORMAT "%8.3" ECU_ADDRESS 0x7F8A3A /end MEASUREMENT
/begin MEASUREMENT ASMod_tExhMnfPst_mp "Temperatur des Gasmassenstroms am Austritt des Abgaskrümmers" SWORD Temp_Cels 1 100 -50.140 899.860 FORMAT "%8.3" ECU_ADDRESS 0x8FE43E /end MEASUREMENT
/begin MEASUREMENT ASMod_tiDdTm_mp "Gaslaufzeit durch den Motor" SWORD TimeDeb 1 100 -327680.0 327670.0 FORMAT "%8.1" ECU_ADDRESS 0x8FE462 /end MEASUREMENT
/begin MEASUREMENT ASMod_tIndAir "Temperatur des Gasmassenstroms in den Motor" SWORD Temp_Cels 1 100 -50.140 899.860 FORMAT "%8.3" ECU_ADDRESS 0x7F8A3C /end MEASUREMENT
/begin MEASUREMENT ASMod_tIndAirRef "Referenz der Gastemperatur vor Einlass" SWORD Temp_Cels 1 100 -50.140 899.860 FORMAT "%8.3" ECU_ADDRESS 0x7F8A3E /end MEASUREMENT
/begin MEASUREMENT ASMod_tIntakeAir_mp "Ansauglufttemperatur" SWORD Temp_Cels 1 100 -50.140 899.860 FORMAT "%8.3" ECU_ADDRESS 0x8FE46E /end MEASUREMENT
/begin MEASUREMENT BattCD_u "Batteriespannung" SWORD Volt_Batt 1 100 -640625.6 640606.1 FORMAT "%8.1" ECU_ADDRESS 0x7F8AA4 /end MEASUREMENT
/begin MEASUREMENT BattCD_uLin "Linearisierter Wert der Batteriespannung" SWORD Volt_Batt 1 100 -640625.6 640606.1 FORMAT "%8.1" ECU_ADDRESS 0x7F8AA6 /end MEASUREMENT
/begin MEASUREMENT BattCD_uRaw "Rohwert ADC-Signalspannung für Batteriespannung" SWORD Volt 1 100 -160156.4 160151.5 FORMAT "%8.1" ECU_ADDRESS 0x7F8AA8 /end MEASUREMENT
/begin MEASUREMENT Batt_facCor "Faktor für Batteriespannungskorrektur" SWORD Fact 1 100 -4.000000 3.999878 FORMAT "%8.6" ECU_ADDRESS 0x7F8AAA /end MEASUREMENT
/begin MEASUREMENT BdInt_nMax "Schutzdrehzahl für Karosserie und Innenraum" SWORD EngN 1 100 -32768.00 32767.00 FORMAT "%8.2" ECU_ADDRESS 0x7F8AAC /end MEASUREMENT
/begin MEASUREMENT BdInt_nMin "Anforderung Leerlaufdrehzahl durch Karosserie & Innenraum" SWORD EngN 1 100 -32768.00 32767.00 FORMAT "%8.2" ECU_ADDRESS 0x7F8AAE /end MEASUREMENT
/begin MEASUREMENT BdInt_pwrDes "Leistungsanforderung Wunsch Karosserie & Innenraum" SWORD Pwr 1 100 -308831.1 308821.7 FORMAT "%8.1" ECU_ADDRESS 0x7F8AB0 /end MEASUREMENT
/begin MEASUREMENT BdInt_pwrLead "Leistungsanforderung Vorhalt Karosserie & Innenraum" SWORD Pwr 1 100 -308831.1 308821.7 FORMAT "%8.1" ECU_ADDRESS 0x7F8AB2 /end MEASUREMENT
/begin MEASUREMENT BPACD_rCnv_mp "Tastverhältnis basierend auf dem Ausgang des Ladedrucksreglers" SWORD DtyCyc 1 100 -327.6800 327.6700 FORMAT "%8.4" ECU_ADDRESS 0x8FE474 /end MEASUREMENT
/begin MEASUREMENT BPACD_rOut "Tastverhältnis zür Endstufenansteuerung" SWORD DtyCyc 1 100 -327.6800 327.6700 FORMAT "%8.4" ECU_ADDRESS 0x7F8A8C /end MEASUREMENT
/begin MEASUREMENT BPA_rBPAByp_mp "Bypass-Label, Kopie von BPA_rBPA" SWORD Prc 1 100 -400.0000 399.9878 FORMAT "%8.4" ECU_ADDRESS 0x8FE470 /end MEASUREMENT
/begin MEASUREMENT BPA_rBPACD "Stellgröße für Ladedrucksteller (Stellerkoordinatorausgang)" SWORD Prc 1 100 -400.0000 399.9878 FORMAT "%8.4" ECU_ADDRESS 0x7F8A90 /end MEASUREMENT
/begin MEASUREMENT BPA_rLPAByp_mp "LPACD TV rohwert vor ASCET bypass" SWORD Prc 1 100 -400.0000 399.9878 FORMAT "%8.4" ECU_ADDRESS 0x8FE472 /end MEASUREMENT
/begin MEASUREMENT BPA_rLPACD "Sollwert Ladedrucksteller Koordinator Niederdruckstufe" SWORD Prc 1 100 -400.0000 399.9878 FORMAT "%8.4" ECU_ADDRESS 0x7F8A92 /end MEASUREMENT
/begin MEASUREMENT BPSCD_dFltValDT1 "differentiated value of Filtered value of Boost pressure" SWORD dp_dZ10 1 100 -327680.0 327670.0 FORMAT "%8.1" ECU_ADDRESS 0x7F8A94 /end MEASUREMENT
/begin MEASUREMENT BPSCD_dpOutVal "Ladedruckgradient" SWORD dp_dZ10 1 100 -327680.0 327670.0 FORMAT "%8.1" ECU_ADDRESS 0x7F8A96 /end MEASUREMENT
/begin MEASUREMENT BPSCD_pFltVal "gefilterter Wert des Ladedrucks" SWORD Pres_hPa 1 100 -32768.00 32767.00 FORMAT "%8.2" ECU_ADDRESS 0x7F8A98 /end MEASUREMENT
/begin MEASUREMENT BPSCD_pIntVal "aktueller Ladedruck" SWORD Pres_hPa 1 100 -32768.00 32767.00 FORMAT "%8.2" ECU_ADDRESS 0x7F8A9A /end MEASUREMENT
/begin MEASUREMENT BPSCD_pLin "Mittelere Ladedruck-Wert (liniarisiert)" SWORD Pres_hPa 1 100 -32768.00 32767.00 FORMAT "%8.2" ECU_ADDRESS 0x7F8A9C /end MEASUREMENT
/begin MEASUREMENT BPSCD_pOutVal "Ladedruckwert" SWORD Pres_hPa 1 100 -32768.00 32767.00 FORMAT "%8.2" ECU_ADDRESS 0x7F8A9E /end MEASUREMENT
/begin MEASUREMENT BPSCD_pPhyVal "Ladedruck in diesem Zyklus" SWORD Pres_hPa 1 100 -32768.00 32767.00 FORMAT "%8.2" ECU_ADDRESS 0x7F8AA0 /end MEASUREMENT
/begin MEASUREMENT BPSCD_stErr "Fehlererkennung (falls einer auftritt) des Ladedrucksensors in einem Zyklus" UBYTE OneToOne 1 100 0.00 255.0 FORMAT "%5.1" ECU_ADDRESS 0x7F87C8 /end MEASUREMENT
/begin MEASUREMENT BPSCD_stPlausErr "Plausibilitaetsfehler Status ( zwischen BPSCD und APSCD )" UBYTE OneToOne 1 100 0.00 255.0 FORMAT "%5.1" ECU_ADDRESS 0x7F87C9 /end MEASUREMENT
/begin MEASUREMENT BPSCD_uRawVal "Spannungsrohwert des Ladedrucksensors" SWORD Volt 1 100 -160156.4 160151.5 FORMAT "%8.1" ECU_ADDRESS 0x7F8AA2 /end MEASUREMENT
/begin MEASUREMENT BrkCD_ctUnPlaus_mp "Unplausibilitätszähler" UWORD OneToOne 1 100 0.00 65535.00 FORMAT "%8.2" ECU_ADDRESS 0x6F800C /end MEASUREMENT
/begin MEASUREMENT BrkCD_stDeb_mp "Bremskontaktschalter - Status Fehlerentprellung Plausibilitaetspruefung" UBYTE OneToOne 1 100 0.00 255.0 FORMAT "%5.1" ECU_ADDRESS 0x8FE476 /end MEASUREMENT
/begin MEASUREMENT BrkCD_stMnSwtDebVal "Digitalsignal Bremskontakt entprellt" UBYTE OneToOne 1 100 0.00 255.0 FORMAT "%5.1" ECU_ADDRESS 0x7F87E9 /end MEASUREMENT
/begin MEASUREMENT BrkCD_stMnSwtLastDebVal "Letzter logischer Entprellwert vom Bremspedal" UBYTE OneToOne 1 100 0.00 255.0 FORMAT "%5.1" ECU_ADDRESS 0x7F87EA /end MEASUREMENT
/begin MEASUREMENT BrkCD_stMnSwtLogVal_mp "Digitalsignal redundanter Bremskontakt nicht entprellt" UBYTE OneToOne 1 100 0.00 255.0 FORMAT "%5.1" ECU_ADDRESS 0x8FE477 /end MEASUREMENT
/begin MEASUREMENT BrkCD_stMnSwtRawVal "Rohwert Bremskontakt nicht entprellt" UBYTE OneToOne 1 100 0.00 255.0 FORMAT "%5.1" ECU_ADDRESS 0x7F87EB /end MEASUREMENT
/begin MEASUREMENT BrkCD_stPressed "Meldung Bremse betätigt" UBYTE OneToOne 1 100 0.00 255.0 FORMAT "%5.1" ECU_ADDRESS 0x7F87EC /end MEASUREMENT
/begin MEASUREMENT BrkCD_stRedSwtDebVal "Digitalsignal redundanter Bremskontakt entprellt" UBYTE OneToOne 1 100 0.00 255.0 FORMAT "%5.1" ECU_ADDRESS 0x7F87ED /end MEASUREMENT
/begin MEASUREMENT BrkCD_stRedSwtLastDebVal "Letzter logischer Entprellwert vom redundanten Bremspedal" UBYTE OneToOne 1 100 0.00 255.0 FORMAT "%5.1" ECU_ADDRESS 0x7F87EE /end MEASUREMENT
/begin MEASUREMENT BrkCD_stRedSwtLogVal_mp "Digitalsignal redundanter Bremskontakt nicht entprellt" UBYTE OneToOne 1 100 0.00 255.0 FORMAT "%5.1" ECU_ADDRESS 0x8FE478 /end MEASUREMENT
/begin MEASUREMENT BrkCD_stRedSwtPresent "Redundanter Bremskontakt Aktivinformation" UBYTE OneToOne 1 100 0.00 255.0 FORMAT "%5.1" ECU_ADDRESS 0x7F87EF /end MEASUREMENT
/begin MEASUREMENT BrkCD_stRedSwtRawVal "Rohwert redundanter Bremskontakt nicht entprellt" UBYTE OneToOne 1 100 0.00 255.0 FORMAT "%5.1" ECU_ADDRESS 0x7F87F0 /end MEASUREMENT
/begin MEASUREMENT BrkCD_stResUnPlaus_mp "Zustandsbits zum Rücksetzen der Unplausibilität" UBYTE OneToOne 1 100 0.00 255.0 FORMAT "%5.1" ECU_ADDRESS 0x8FE479 /end MEASUREMENT
/begin MEASUREMENT BrkCD_stRun_mp "Laufzeitmesspunkt" UWORD OneToOne 1 100 0.00 65535.00 FORMAT "%8.2" ECU_ADDRESS 0x8FE47A /end MEASUREMENT
/begin MEASUREMENT BrkCD_swtSig "Signalquelle Schalter - DIO/CAN" UBYTE OneToOne 1 100 0.00 255.0 FORMAT "%5.1" ECU_ADDRESS 0x7F87F1 /end MEASUREMENT
/begin MEASUREMENT BypEtk_ctStepDelayNsync_u8 "ETK Bypass Schritt drehzahlsynchron" UBYTE OneToOne 1 100 0.00 255.0 FORMAT "%5.1" ECU_ADDRESS 0x7FD382 /end MEASUREMENT
/begin MEASUREMENT BypEtk_ctStepDelayTsync_u8 "ETK Bypass Schritt zeitsynchron" UBYTE OneToOne 1 100 0.00 255.0 FORMAT "%5.1" ECU_ADDRESS 0x7FD383 /end MEASUREMENT
/begin MEASUREMENT BypEtk_stEcu_u8 "Status ETK-Bypass in SG (0: inaktiv im SG; 1: aktiv im SG; 2: wartet auf Kommunikation)" UBYTE OneToOne 1 100 0.00 255.0 FORMAT "%5.1" ECU_ADDRESS 0x7FD381 /end MEASUREMENT
/begin MEASUREMENT BypInt_stEcu_u8 "Status interner Bypass in SG (0: inaktiv im SG; 1: aktiv im SG; 2: wartet auf Kommunikation)" UBYTE OneToOne 1 100 0.00 255.0 FORMAT "%5.1" ECU_ADDRESS 0x7FD38D /end MEASUREMENT
/begin MEASUREMENT CaSCD_ctEdgCaSRev_mp "Anzahl sämtlicher Phasensignale während einer Nockenwellenumdrehung" UBYTE OneToOne 1 100 0.00 255.0 FORMAT "%5.1" ECU_ADDRESS 0x8FE47C /end MEASUREMENT
/begin MEASUREMENT CaSCD_ctEdgOfs_mp "Zähler erkannter Nockenwellenflanken mit Verdrehung" UBYTE OneToOne 1 100 0.00 255.0 FORMAT "%5.1" ECU_ADDRESS 0x8FE47D /end MEASUREMENT
/begin MEASUREMENT CaSCD_ctEdgOrd_mp "Zähler erkannter Nockenwellenflanken in korrekter Reihenfolge" UBYTE OneToOne 1 100 0.00 255.0 FORMAT "%5.1" ECU_ADDRESS 0x8FE47E /end MEASUREMENT
/begin MEASUREMENT CaSCD_ctErrEdg_mp "Anzahl erkannter Störungen auf einer Nockenwellenumdrehung" UBYTE OneToOne 1 100 0.00 255.0 FORMAT "%5.1" ECU_ADDRESS 0x8FE47F /end MEASUREMENT
/begin MEASUREMENT CaSCD_ctPhRevEdges_mp "Zähler der Phasengeberflanken über einer Phasengeberradumdrehung" UBYTE OneToOne 1 100 0.00 255.0 FORMAT "%5.1" ECU_ADDRESS 0x8FE480 /end MEASUREMENT
/begin MEASUREMENT CaSCD_ctPhRev_mp "Umdrehungszähler des Phasengeberrades" UBYTE OneToOne 1 100 0.00 255.0 FORMAT "%5.1" ECU_ADDRESS 0x8FE481 /end MEASUREMENT
/begin MEASUREMENT CaSCD_ctSegEdg_mp "Anzahl erkannter SEG Flanken" UBYTE OneToOne 1 100 0.00 255.0 FORMAT "%5.1" ECU_ADDRESS 0x8FE482 /end MEASUREMENT
/begin MEASUREMENT CaSCD_ctShftPos_mp "Zähler verschobene Nockenwellenflanken" UBYTE OneToOne 1 100 0.00 255.0 FORMAT "%5.1" ECU_ADDRESS 0x8FE483 /end MEASUREMENT
/begin MEASUREMENT CaSCD_ctSyncEdg_mp "Anzahl erkannter SYNC Flanken" UBYTE OneToOne 1 100 0.00 255.0 FORMAT "%5.1" ECU_ADDRESS 0x8FE484 /end MEASUREMENT
/begin MEASUREMENT CaSCD_nPeriod "Phasengeberraddrehzahl basierent auf einer konstanten Phasengebersegmentlänge" SWORD EngN 1 100 -32768.00 32767.00 FORMAT "%8.2" ECU_ADDRESS 0x7F8ABE /end MEASUREMENT
/begin MEASUREMENT CaSCD_nSeg "Die aktuelle Nockenwellensegmentdrehzahl im BackUp-Modus" SWORD EngN 1 100 -32768.00 32767.00 FORMAT "%8.2" ECU_ADDRESS 0x7F8AC0 /end MEASUREMENT
/begin MEASUREMENT CaSCD_numFrstInt_mp "Interruptart bei Start der Verifikation CaS/CrS" UBYTE OneToOne 1 100 0.00 255.0 FORMAT "%5.1" ECU_ADDRESS 0x8FE485 /end MEASUREMENT
/begin MEASUREMENT CaSCD_numFrstTDC_mp "Zylinderzählerstand bei Start der Verifikation CaS/CrS" UBYTE OneToOne 1 100 0.00 255.0 FORMAT "%5.1" ECU_ADDRESS 0x8FE486 /end MEASUREMENT
/begin MEASUREMENT CaSCD_phiCurr_mp "Aktuelle Winkelposition des Phasengebers" SWORD AngleCrS 1 100 -768.0000 767.9766 FORMAT "%8.4" ECU_ADDRESS 0x8FE488 /end MEASUREMENT
/begin MEASUREMENT CaSCD_phiLstEdge_mp "Position der letzten Phasengeberflanke" SWORD AngleCrS 1 100 -768.0000 767.9766 FORMAT "%8.4" ECU_ADDRESS 0x8FE48A /end MEASUREMENT
/begin MEASUREMENT CaSCD_stPhaseErr_mp "Fehlerstatus des Phasensystems" UWORD OneToOne 1 100 0.00 65535.00 FORMAT "%8.2" ECU_ADDRESS 0x8FE48C /end MEASUREMENT
/begin MEASUREMENT CaSCD_stPhaseSig_mp "Status des Phasengebersignals (Signalgüte)" UWORD OneToOne 1 100 0.00 65535.00 FORMAT "%8.2" ECU_ADDRESS 0x8FE48E /end MEASUREMENT
/begin MEASUREMENT CaSCD_stPhaseSync_mp "Status der Phasengebersynchronisation (Signalformerkennung)" UWORD OneToOne 1 100 0.00 65535.00 FORMAT "%8.2" ECU_ADDRESS 0x8FE490 /end MEASUREMENT
/begin MEASUREMENT CaSCD_stSegCylEdg_mp "Status erkannter SEG Flanken" UWORD OneToOne 1 100 0.00 65535.00 FORMAT "%8.2" ECU_ADDRESS 0x8FE492 /end MEASUREMENT
/begin MEASUREMENT CaSCD_stSyncCylEdg_mp "Status erkannter SYNC Flanken" UWORD OneToOne 1 100 0.00 65535.00 FORMAT "%8.2" ECU_ADDRESS 0x8FE494 /end MEASUREMENT
/begin MEASUREMENT CaSCD_tiPeriodRev "Periodendauer einer Umdrehung des Phasengeberrades" SWORD Period_ms 1 100 -3276.800 3276.700 FORMAT "%8.3" ECU_ADDRESS 0x7F8AC2 /end MEASUREMENT
/begin MEASUREMENT CaSCD_tiPeriodRevHold "Vorletzte Periodendauer einer Umdrehung des Phasengeberrades" SWORD Period_ms 1 100 -3276.800 3276.700 FORMAT "%8.3" ECU_ADDRESS 0x7F8AC4 /end MEASUREMENT
/begin MEASUREMENT CaSCD_tiSeg "aktuelle Segmentzeit der Nockenwelle im Backup Mode" ULONG Per_Dur 1 100 0.00 4294967295.00 FORMAT "%13.2" ECU_ADDRESS 0x7F90B0 /end MEASUREMENT
/begin MEASUREMENT CaSCD_tiSigTimOut_mp "Timeoutwert des Phasengebersignals" SWORD Period_ms 1 100 -3276.800 3276.700 FORMAT "%8.3" ECU_ADDRESS 0x8FE496 /end MEASUREMENT
/begin MEASUREMENT CBACD_stLogicOut_mp "duty-cycle given to the actuator" UBYTE OneToOne 1 100 0.00 255.0 FORMAT "%5.1" ECU_ADDRESS 0x6F800E /end MEASUREMENT
/begin MEASUREMENT Clg_dtDynTst "Ansteig der Wassertemperatur seit start" SWORD TempDiff_Cels 1 100 -3276.800 3276.700 FORMAT "%8.3" ECU_ADDRESS 0x7F8AC6 /end MEASUREMENT
/begin MEASUREMENT Clg_dtMinDynTst "Kopie von Clg_dtMinDynTst_C fuer Tester" SWORD TempDiff_Cels 1 100 -3276.800 3276.700 FORMAT "%8.3" ECU_ADDRESS 0x7F8AC8 /end MEASUREMENT
/begin MEASUREMENT Clg_tClntStrtVal_mp "Wassertemperatur zu Beginn des dynamischen Plausibilitätstests" SWORD Temp_Cels 1 100 -50.140 899.860 FORMAT "%8.3" ECU_ADDRESS 0x8FE498 /end MEASUREMENT
/begin MEASUREMENT Clg_tEndDynTst "CTSCD_tClnt am Ende des Tests" SWORD Temp_Cels 1 100 -50.140 899.860 FORMAT "%8.3" ECU_ADDRESS 0x7F8ACA /end MEASUREMENT
/begin MEASUREMENT Clg_tiDynTst "Abgelaufene Zeit, seit der der dynamische plausibilitätstest aktiv ist" ULONG Time_s 1 100 0.00 42949672.9500 FORMAT "%13.4" ECU_ADDRESS 0x7F90B4 /end MEASUREMENT
/begin MEASUREMENT Clg_tiMaxDynTst "Maximal zulässige Testzeit des dynamischen Plausibilitätstest" ULONG Time_s 1 100 0.00 42949672.9500 FORMAT "%13.4" ECU_ADDRESS 0x7F90B8 /end MEASUREMENT
/begin MEASUREMENT Clg_tMinClntDynTst "Kopie von Clg_tMinClntDynTst_C fuer Tester" SWORD Temp_Cels 1 100 -50.140 899.860 FORMAT "%8.3" ECU_ADDRESS 0x7F8ACC /end MEASUREMENT
/begin MEASUREMENT CmbChb_ctEngRevLogBuf1_mp "Meßpunkt für die Anzahl bewerteten Motorumdrehungen der Kurbelwelle des Puffer1" UWORD OneToOne 1 100 0.00 65535.00 FORMAT "%8.2" ECU_ADDRESS 0x8FE4C4 /end MEASUREMENT
/begin MEASUREMENT CmbChb_ctEngRevLogBuf2_mp "Meßpunkt für die Anzahl bewerteten Motorumdrehungen der Kurbelwelle des Puffer2" UWORD OneToOne 1 100 0.00 65535.00 FORMAT "%8.2" ECU_ADDRESS 0x8FE4C6 /end MEASUREMENT
/begin MEASUREMENT CmbChb_ctEngRevLogMem_mp "Kurbelwellen-Umdrehungszähler" UWORD OneToOne 1 100 0.00 65535.00 FORMAT "%8.2" ECU_ADDRESS 0x8FE4C8 /end MEASUREMENT
/begin MEASUREMENT CmbChb_ctEngRevPerBlk_mp "Meßpunkt für die Anzahl der Blockgroesse für die bewerteten Motorumdrehungen der Kurbelwelle" UWORD OneToOne 1 100 0.00 65535.00 FORMAT "%8.2" ECU_ADDRESS 0x8FE4CA /end MEASUREMENT
/begin MEASUREMENT CmbChb_ctMifBuf1_mp "Meßpunkt für die Erkennung der Fehlzündungen der einzelnen Zylinder, Puffer1" UWORD OneToOne 1 100 0.00 65535.00 FORMAT "%8.2" ARRAY_SIZE 7 ECU_ADDRESS 0x8FE49A /end MEASUREMENT
/begin MEASUREMENT CmbChb_ctMifBuf2_mp "Meßpunkt für die Erkennung der Fehlzündungen der einzelnen Zylinder, Puffer2" UWORD OneToOne 1 100 0.00 65535.00 FORMAT "%8.2" ARRAY_SIZE 7 ECU_ADDRESS 0x8FE4A8 /end MEASUREMENT
/begin MEASUREMENT CmbChb_ctMifMem_mp "Meßpunkt für die Erkennung der Fehlzündungen der einzelnen Zylinder, Logging Speicher" UWORD OneToOne 1 100 0.00 65535.00 FORMAT "%8.2" ARRAY_SIZE 7 ECU_ADDRESS 0x8FE4B6 /end MEASUREMENT
/begin MEASUREMENT CmbChb_dnSegMinPerCyl_mp "minimaler Drehzahlanstiege pro Zylinder" SWORD EngN 1 100 -32768.00 32767.00 FORMAT "%8.2" ECU_ADDRESS 0x8FE4CC /end MEASUREMENT
/begin MEASUREMENT CmbChb_nSegEven_mp "Summe der Drehzahl fuer jede gerade Segmentnummer (von zwei Umdrehungen)" SWORD EngN 1 100 -32768.00 32767.00 FORMAT "%8.2" ECU_ADDRESS 0x8FE4CE /end MEASUREMENT
/begin MEASUREMENT CmbChb_nSegOdd_mp "Summe der Drehzahl fuer jede ungerade Segmentnummer (von zwei Umdrehungen)" SWORD EngN 1 100 -32768.00 32767.00 FORMAT "%8.2" ECU_ADDRESS 0x8FE4D0 /end MEASUREMENT
/begin MEASUREMENT CmbChb_st "Status der Fehlzündungserkennung" UBYTE OneToOne 1 100 0.00 255.0 FORMAT "%5.1" ECU_ADDRESS 0x7F87F5 /end MEASUREMENT
/begin MEASUREMENT CmbChb_swtMonClutch "SW-Schalter Aktivierung/Deaktivierung Überwachung Zündaussetzererkennung" UBYTE OneToOne 1 100 0.00 3.000 FORMAT "%5.3" ECU_ADDRESS 0x7F87F6 /end MEASUREMENT
/begin MEASUREMENT CoDT_dnAbsEng_mp "Absolute value of DT1 filtered engine speed" SWORD dn_dZfine 1 100 -32768.00 32767.00 FORMAT "%8.2" ECU_ADDRESS 0x8FE4D8 /end MEASUREMENT
/begin MEASUREMENT CoDT_dnEng_mp "DT1 filtered Engine speed" SWORD dn_dZfine 1 100 -32768.00 32767.00 FORMAT "%8.2" ECU_ADDRESS 0x8FE4DA /end MEASUREMENT
/begin MEASUREMENT CoDT_dnGrip_mp "Expected change in torque" SWORD dn_dZfine 1 100 -32768.00 32767.00 FORMAT "%8.2" ECU_ADDRESS 0x8FE4DC /end MEASUREMENT
/begin MEASUREMENT CoDT_dnNoGrip_mp "Expected change in engine speed" SWORD dn_dZfine 1 100 -32768.00 32767.00 FORMAT "%8.2" ECU_ADDRESS 0x8FE4DE /end MEASUREMENT
/begin MEASUREMENT CoDT_Grip "Kraftschluß innerhalb Antrieb" UBYTE OneToOne 1 100 0.00 255.0 FORMAT "%5.1" ECU_ADDRESS 0x7F87F7 /end MEASUREMENT
/begin MEASUREMENT CoDT_nMax "Drehzahlforderung Maximalwert Triebstrangkoordinator" SWORD EngN 1 100 -32768.00 32767.00 FORMAT "%8.2" ECU_ADDRESS 0x7F8AD0 /end MEASUREMENT
/begin MEASUREMENT CoDT_nMin "Drehzahlforderung Minimalwert Triebstrangkoordinator" SWORD EngN 1 100 -32768.00 32767.00 FORMAT "%8.2" ECU_ADDRESS 0x7F8AD2 /end MEASUREMENT
/begin MEASUREMENT CoDT_stGripDeb "Zustand der Kraftschlußentprellung" UBYTE OneToOne 1 100 0.00 255.0 FORMAT "%5.1" ECU_ADDRESS 0x7F87F8 /end MEASUREMENT
/begin MEASUREMENT CoDT_stNoGripDet_mp "Bit coded status message" UBYTE OneToOne 1 100 0.00 255.0 FORMAT "%5.1" ECU_ADDRESS 0x8FE4E0 /end MEASUREMENT
/begin MEASUREMENT CoDT_stOrd "Randbedingungen für physikalischen Auftrag" UBYTE OneToOne 1 100 0.00 255.0 FORMAT "%5.1" ECU_ADDRESS 0x7F87F9 /end MEASUREMENT
/begin MEASUREMENT CoDT_swtCoType "0: conventional; 1: mastershift" UBYTE OneToOne 1 100 0.00 255.0 FORMAT "%5.1" ECU_ADDRESS 0x7F87FA /end MEASUREMENT
/begin MEASUREMENT CoDT_trq "aktuelles Getriebeausgangsmoment" SWORD TrqPrp 1 100 -6553.600 6553.400 FORMAT "%8.3" ECU_ADDRESS 0x7F8AD4 /end MEASUREMENT
/begin MEASUREMENT CoDT_trqAbsGbxPT1_mp "Absolute value of delayed gearbox torque input" SWORD Trq 1 100 -3276.800 3276.700 FORMAT "%8.3" ECU_ADDRESS 0x8FE4E2 /end MEASUREMENT
/begin MEASUREMENT CoDT_trqAcsDes "torque electrical components" SWORD Trq 1 100 -3276.800 3276.700 FORMAT "%8.3" ECU_ADDRESS 0x7F8AD6 /end MEASUREMENT
/begin MEASUREMENT CoDT_trqAcsMax_mp "maximales Nebenaggregatmoment" SWORD Trq 1 100 -3276.800 3276.700 FORMAT "%8.3" ECU_ADDRESS 0x8FE4E8 /end MEASUREMENT
/begin MEASUREMENT CoDT_trqAcsMin "minimaler Momentenbedarf der Nebenaggregate" SWORD Trq 1 100 -3276.800 3276.700 FORMAT "%8.3" ECU_ADDRESS 0x7F8AD8 /end MEASUREMENT
/begin MEASUREMENT CoDT_trqAcs_mp "ungefilterter Momentenbedarf der Nebenaggregate" SWORD Trq 1 100 -3276.800 3276.700 FORMAT "%8.3" ECU_ADDRESS 0x8FE4EA /end MEASUREMENT
/begin MEASUREMENT CoDT_trqActAcs_mp "aktuelle Momentenanforderung der Nebenaggregate" SWORD Trq 1 100 -3276.800 3276.700 FORMAT "%8.3" ECU_ADDRESS 0x8FE4E6 /end MEASUREMENT
/begin MEASUREMENT CoDT_trqCurr "Momentenanforderung Triebstrang Vorhaltewert" SWORD Trq 1 100 -3276.800 3276.700 FORMAT "%8.3" ECU_ADDRESS 0x7F8ADA /end MEASUREMENT
/begin MEASUREMENT CoDT_trqCurrLim "Minimum aller Begrenzungen im Getriebeausgangsmoment" SWORD TrqPrp 1 100 -6553.600 6553.400 FORMAT "%8.3" ECU_ADDRESS 0x7F8ADC /end MEASUREMENT
/begin MEASUREMENT CoDT_trqDes "Momentenanforderung Triebstrangkoordinator Wunschwert" SWORD Trq 1 100 -3276.800 3276.700 FORMAT "%8.3" ECU_ADDRESS 0x7F8AE4 /end MEASUREMENT
/begin MEASUREMENT CoDT_trqDTInCurr "Momentenanforderung Vorhalt Triebstrangkoordinator (Kupplungseingang) (curr-Pfad)" SWORD Trq 1 100 -3276.800 3276.700 FORMAT "%8.3" ECU_ADDRESS 0x7F8ADE /end MEASUREMENT
/begin MEASUREMENT CoDT_trqDTInDecLead_mp "Momentenanforderung Triebstrang nach reduzierenden Getriebeeingriffen" SWORD Trq 1 100 -3276.800 3276.700 FORMAT "%8.3" ECU_ADDRESS 0x8FE4D2 /end MEASUREMENT
/begin MEASUREMENT CoDT_trqDTInDes "Momentenanforderung Triebstrang (Kupplungseingang) Wunschwert" SWORD Trq 1 100 -3276.800 3276.700 FORMAT "%8.3" ECU_ADDRESS 0x7F8AE0 /end MEASUREMENT
/begin MEASUREMENT CoDT_trqDTInIncLead_mp "Momentenanforderung Triebstrang nach erhöhenden Getriebeeingriffen" SWORD Trq 1 100 -3276.800 3276.700 FORMAT "%8.3" ECU_ADDRESS 0x8FE4D4 /end MEASUREMENT
/begin MEASUREMENT CoDT_trqDTInLead "Momentenanforderung Triebstrang (Kupplungseingang) Vorhaltewert" SWORD Trq 1 100 -3276.800 3276.700 FORMAT "%8.3" ECU_ADDRESS 0x7F8AE2 /end MEASUREMENT
/begin MEASUREMENT CoDT_trqGbx "aktuelles Eingangsmoment Getriebe" SWORD Trq 1 100 -3276.800 3276.700 FORMAT "%8.3" ECU_ADDRESS 0x7F8AE6 /end MEASUREMENT
/begin MEASUREMENT CoDT_trqGbxMax "maximales Getriebeeingangsmoment" SWORD Trq 1 100 -3276.800 3276.700 FORMAT "%8.3" ECU_ADDRESS 0x7F8AE8 /end MEASUREMENT
/begin MEASUREMENT CoDT_trqGbxMin "minimales Getriebeeingangsmoment" SWORD Trq 1 100 -3276.800 3276.700 FORMAT "%8.3" ECU_ADDRESS 0x7F8AEA /end MEASUREMENT
/begin MEASUREMENT CoDT_trqGbxPT1_mp "Delayed gearbox torque input" SWORD Trq 1 100 -3276.800 3276.700 FORMAT "%8.3" ECU_ADDRESS 0x8FE4E4 /end MEASUREMENT
/begin MEASUREMENT CoDT_trqGearbxDes "Getriebeeingangsmoment Fahrerwunsch" SWORD Trq 1 100 -3276.800 3276.700 FORMAT "%8.3" ECU_ADDRESS 0x7F8AEC /end MEASUREMENT
/begin MEASUREMENT CoDT_trqGearbxLead_mp "Getriebeeingangsmoment Vorhaltewert" SWORD Trq 1 100 -3276.800 3276.700 FORMAT "%8.3" ECU_ADDRESS 0x8FE4D6 /end MEASUREMENT
/begin MEASUREMENT CoDT_trqLead "Momentenanforderung Vorhaltewert" SWORD Trq 1 100 -3276.800 3276.700 FORMAT "%8.3" ECU_ADDRESS 0x7F8AEE /end MEASUREMENT
/begin MEASUREMENT CoDT_trqMax "maximal mögliches Antriebsmoment (Getriebeausgang)" SWORD TrqPrp 1 100 -6553.600 6553.400 FORMAT "%8.3" ECU_ADDRESS 0x7F8AF0 /end MEASUREMENT
/begin MEASUREMENT CoDT_trqMin "minimal mögliches Antriebsmoment (Getriebeausgang)" SWORD TrqPrp 1 100 -6553.600 6553.400 FORMAT "%8.3" ECU_ADDRESS 0x7F8AF2 /end MEASUREMENT
/begin FUNCTION appcd "Fahrpedal Komponententreiber"
 /begin DEF_CHARACTERISTIC APPCD_uAPP1_SRCMin_C APPCD_uAPP1_SRCMax_C APPCD_rLinAPP1_CUR APPCD_uAPP2_SRCMin_C APPCD_uAPP2_SRCMax_C APPCD_rLinAPP2_CUR APPCD_DebPlaDef_C APPCD_DebPlaOk_C APPCD_DebSRCHighDef_C APPCD_DebSRCHighOk_C APPCD_DebSRCLowDef_C APPCD_DebSRCLowOk_C APPCD_rThrFltFDCLowPos_C APPCD_rThrFltFDCMidPos_C APPCD_rThrFltFDCLowNeg_C APPCD_rThrFltFDCMidNeg_C APPCD_tiLowNegFDCPT1_C APPCD_tiLowNegPT1_C APPCD_tiLowPosFDCPT1_C APPCD_tiLowPosPT1_C APPCD_tiMidNegFDCPT1_C APPCD_tiMidNegPT1_C APPCD_tiMidPosFDCPT1_C APPCD_tiMidPosPT1_C APPCD_tiUppNegFDCPT1_C APPCD_tiUppNegPT1_C APPCD_tiUppPosFDCPT1_C APPCD_tiUppPosPT1_C APPCD_swtNoFlt_C APPCD_rThrFltLowPos_C APPCD_rThrFltMidPos_C APPCD_rThrFltLowNeg_C APPCD_rThrFltMidNeg_C APPCD_drHealRmpUp_C APPCD_drHealRmpDwn_C APPCD_numAdcAPP1_C APPCD_numAdcAPP2_C APPCD_uPlaWinIdle_C APPCD_uPlaWinPar_C APPCD_uPlaWinFull_C APPCD_rPlaWinLowIdleXHigh_C APPCD_rPlaWinLowIdleXLow_C APPCD_rPlaWinParLoadXHigh_C APPCD_rPlaWinParLoadXLow_C APPCD_SSpMonAPP1_C APPCD_SSpMonAPP2_C APPCD_stCfgAccPed_C APPCD_swtStepLim_C APPCD_uKickDownHighAPP1_C APPCD_uKickDownHighAPP2_C APPCD_uKickDownLowAPP1_C APPCD_uKickDownLowAPP2_C /end DEF_CHARACTERISTIC
 /begin IN_MEASUREMENT APPCD_uRawAPP1 APPCD_uRawAPP2 /end IN_MEASUREMENT
/end FUNCTION
/begin FUNCTION appcd_msg ""
 /begin OUT_MEASUREMENT APPCD_drAPP1UnFlt APPCD_rAPP1 APPCD_rAPP1UnFlt APPCD_rFlt APPCD_rLinAPP1 APPCD_rLinAPP2 APPCD_rNextThr APPCD_stKickDown APPCD_stPos APPCD_uRawAPP1 APPCD_uRawAPP2 /end OUT_MEASUREMENT
/end FUNCTION
/begin FUNCTION appcd_uic ""
 /begin OUT_MEASUREMENT APPCD_rFlt_mp APPCD_rStepLim_mp APPCD_SRCErrInfo_mp APPCD_stADCMonbit15RE_mp APPCD_stErr1_mp APPCD_u0PrcAPP1_mp APPCD_u0PrcAPP2_mp APPCD_uDiffMax_mp APPCD_uRawDiff_mp /end OUT_MEASUREMENT
/end FUNCTION
/begin FUNCTION applib "" /end FUNCTION
/begin FUNCTION apscd "Atmosphärendruckfühler Komponententreiber"
 /begin DEF_CHARACTERISTIC APSCD_uSRCMin_C APSCD_uSRCMax_C APSCD_pLin_CUR APSCD_DebNplDef_C APSCD_DebNplOk_C APSCD_DebSigDef_C APSCD_DebSigOk_C APSCD_DebSRCDef_C APSCD_DebSRCOk_C APSCD_nLimHigh_C APSCD_numAdc_C APSCD_pCor_MAP APSCD_dpRmpSlpUp_C APSCD_dpRmpSlpDwn_C APSCD_swtInst_C APSCD_swtSigVal_C APSCD_swtSrcpVal_C APSCD_tiDel_C APSCD_stSensIDWord_C APSCD_pDfl_C /end DEF_CHARACTERISTIC
 /begin IN_MEASUREMENT APSCD_uRaw Eng_dnAvrg Eng_nAvrg /end IN_MEASUREMENT
/end FUNCTION
/begin FUNCTION apscd_msg ""
 /begin OUT_MEASUREMENT APSCD_pLinVal APSCD_pSensorVal APSCD_pVal APSCD_stSensorInst APSCD_swtSig APSCD_uRaw /end OUT_MEASUREMENT
/end FUNCTION
/begin FUNCTION apscd_uic "" /begin OUT_MEASUREMENT APSCD_BpsAllowed_mp APSCD_pCorVal_mp APSCD_pPhyVal_mp /end OUT_MEASUREMENT /end FUNCTION
/begin FUNCTION apscd_variant "" /end FUNCTION
/begin FUNCTION ars_detarspwr "Calculation of desired and the lead power of ARS"
 /begin DEF_CHARACTERISTIC ARS_tiDebSigDef_C ARS_tiDebSigOk_C ARS_facDesCor_C ARS_facDesOldCor_C ARS_nDia_C ARS_rTrans_C ARS_trqCurMax_MAP ARS_trqDesMax_MAP ARS_trqDiaMaxOfs_C ARS_trqDiaMax_C ARS_vDia_C /end DEF_CHARACTERISTIC
 /begin IN_MEASUREMENT FrmMng_aSide VSSCD_v /end IN_MEASUREMENT
/end FUNCTION
/begin FUNCTION ars_detarspwr_msg "" /begin OUT_MEASUREMENT ARS_pwrDes ARS_pwrLead ARS_st ARS_stRecARS /end OUT_MEASUREMENT /end FUNCTION
/begin FUNCTION ars_detarspwr_uic ""
 /begin OUT_MEASUREMENT ARS_trqCor_mp ARS_trqCurMax_mp ARS_trqDesMax_mp ARS_trqDesOld_mp ARS_trqDes_mp /end OUT_MEASUREMENT
/end FUNCTION
/begin FUNCTION asddc "Aktive Ruckeldämpfung Störgrößenregler (ARD)"
 /begin DEF_CHARACTERISTIC ASDdc_T1Clu_C ASDdc_KdClu_C ASDdc_T1ExtInt_C ASDdc_KdExtInt_C ASDdc_KdGrip_MAP ASDdc_numDefaultState_C ASDdc_T1State3_C ASDdc_KdState3_C ASDdc_T1State4_C ASDdc_KdState4_C ASDdc_stConfCluEng_C ASDdc_stConfCluOff_C ASDdc_stConfCluSlip_C ASDdc_stConv1_C ASDdc_stConv2_C ASDdc_stConv3_C ASDdc_stExtInt_C ASDdc_stFDC_C ASDdc_stGearswitch_C ASDdc_stGripRaw_C ASDdc_stGrip_C ASDdc_swtCalcN_C ASDdc_swtInitPS_C ASDdc_swtOpr_C ASDdc_T1Grip_MAP ASDdc_trqLimMax_C ASDdc_trqLimMin_C ASDdc_vLimIni_C /end DEF_CHARACTERISTIC
 /begin IN_MEASUREMENT ASDdc_nAvrg_mp DrvTrn_rTransDT /end IN_MEASUREMENT
 /begin OUT_MEASUREMENT ASDdc_KdCurr_mp ASDdc_T1Curr_mp /end OUT_MEASUREMENT
/end FUNCTION
/begin FUNCTION asddc_msg "" /begin OUT_MEASUREMENT ASDdc_trq /end OUT_MEASUREMENT /end FUNCTION
/begin FUNCTION asddc_uic "" /begin DEF_CHARACTERISTIC ASDdc_trq_Vector ASDdc_trq_Channel /end DEF_CHARACTERISTIC
 /begin OUT_MEASUREMENT ASDdc_nAvrg_mp ASDdc_stCluPS_mp ASDdc_stCond_mp ASDdc_stPrioState_mp ASDdc_stREinit_mp ASDdc_stSelectState_mp ASDdc_stStates_mp /end OUT_MEASUREMENT
/end FUNCTION
/begin FUNCTION asddc_var ""
 /begin DEF_CHARACTERISTIC ASDdc_KdFDC_MAP ASDdc_KdSlip_MAP ASDdc_numPrio_C ASDdc_T1FDC_MAP ASDdc_T1Slip_MAP /end DEF_CHARACTERISTIC
 /begin IN_MEASUREMENT ASDdc_nAvrg_mp DrvTrn_rTransDT /end IN_MEASUREMENT
/end FUNCTION
/begin FUNCTION asddc_var_uic "" /end FUNCTION
/begin FUNCTION asdrf_governor "ARD-Regelalgoithmus, Führungsformer"
 /begin DEF_CHARACTERISTIC ASDrf_CoeffADecLim_C ASDrf_CoeffBDecLim_C ASDrf_dtrqIncLimLow_C ASDrf_dtrqIncLimHigh_C ASDrf_stIncLimLow_C ASDrf_stIncLimHigh_C ASDrf_dtrqIncLim_C ASDrf_dtrqInrLtdLim_CUR ASDrf_dtrqSteepNeg_C ASDrf_dtrqSteepPos_C ASDrf_T1Flt_C ASDrf_swtCalcTrq_C ASDrf_swtFlt_C ASDrf_swtFrzLoss_C ASDrf_swtInitPS_C ASDrf_swtLim_C ASDrf_tiTrqSty_C ASDrf_trqDecHigh_C ASDrf_trqDecLow_C ASDrf_trqThresDecLim_C ASDrf_trqThresNeg_C ASDrf_trqThresPos_C /end DEF_CHARACTERISTIC
 /begin IN_MEASUREMENT ASDrf_dtrqInrLtd_mp /end IN_MEASUREMENT
/end FUNCTION
/begin FUNCTION asdrf_governor_msg "" /begin OUT_MEASUREMENT ASDrf_stLAD ASDrf_trqInr /end OUT_MEASUREMENT /end FUNCTION
/begin FUNCTION asdrf_governor_uic "" /begin DEF_CHARACTERISTIC ASDrf_trqInr_Vector ASDrf_trqInr_Channel /end DEF_CHARACTERISTIC
 /begin OUT_MEASUREMENT ASDrf_CoeffALossCurr_mp ASDrf_CoeffBLossCurr_mp ASDrf_dtrqDecMax_mp ASDrf_dtrqDecMin_mp ASDrf_dtrqInrLtd_mp ASDrf_dtrqLim_mp ASDrf_dtrqLossMax_mp ASDrf_dtrqLossMin_mp ASDrf_dtrqMax_mp ASDrf_dtrqMin_mp ASDrf_KdCurr_mp ASDrf_stDecLimState_mp ASDrf_stIncLim_mp ASDrf_stInitdtrqSteep_mp ASDrf_stPosNeg_mp ASDrf_stTrqLim_mp ASDrf_T1Curr_mp ASDrf_trqASDSum_mp ASDrf_trqCompOfs_mp ASDrf_trqDecLimStrt_mp ASDrf_trqInit_mp ASDrf_trqInrLtdFlt_mp ASDrf_trqInrMaxUnLim_mp ASDrf_trqInrMax_mp ASDrf_trqInrMinUnLim_mp ASDrf_trqInrMin_mp ASDrf_trqInrUnLim_mp ASDrf_trqLoss_mp ASDrf_trqPT1In_mp ASDrf_trqPT1Out_mp ASDrf_trqPT1P_mp ASDrf_trqP_mp ASDrf_trqStyHigh_mp ASDrf_trqStyLow_mp /end OUT_MEASUREMENT
/end FUNCTION
/begin FUNCTION asdrf_selectparameter "Parametersatzauswahl ARD Führungsformer"
 /begin DEF_CHARACTERISTIC ASDrf_T1CluNeg_C ASDrf_KdCluNeg_C ASDrf_T1CluPos_C ASDrf_KdCluPos_C ASDrf_T1ExtInt_C ASDrf_KdExtInt_C ASDrf_numDefaultState_C ASDrf_CoeffACluLossNeg_C ASDrf_CoeffBCluLossNeg_C ASDrf_CoeffACluLossPos_C ASDrf_CoeffBCluLossPos_C ASDrf_CoeffAExtIntLoss_C ASDrf_CoeffBExtIntLoss_C ASDrf_CoeffAState3LossNeg_C ASDrf_CoeffBState3LossNeg_C ASDrf_CoeffAState3LossPos_C ASDrf_CoeffBState3LossPos_C ASDrf_CoeffAState4LossNeg_C ASDrf_CoeffBState4LossNeg_C ASDrf_CoeffAState4LossPos_C ASDrf_CoeffBState4LossPos_C ASDrf_T1State3Neg_C ASDrf_KdState3Neg_C ASDrf_T1State3Pos_C ASDrf_KdState3Pos_C ASDrf_T1State4Neg_C ASDrf_KdState4Neg_C ASDrf_T1State4Pos_C ASDrf_KdState4Pos_C ASDrf_stConv1_C ASDrf_stConv2_C ASDrf_stConv3_C ASDrf_stConvCluEng_C ASDrf_stConvCluOff_C ASDrf_stConvCluSlip_C ASDrf_stEntcClu_C ASDrf_stEntcExtInt_C ASDrf_stEntcFDC_C ASDrf_stEntcGrip_C ASDrf_stEntcState3_C ASDrf_stEntcState4_C ASDrf_stExClu_C ASDrf_stExExtInt_C ASDrf_stExFDC_C ASDrf_stExGrip_C ASDrf_stExState3_C ASDrf_stExState4_C ASDrf_stExtInt_C ASDrf_stFDC_C ASDrf_stGrip_C ASDrf_stReliablAdpt_C ASDrf_swtLossClcNoRel_C ASDrf_swtLossClcRel_C ASDrf_swtOpr_C ASDrf_trqLossNeg_CUR ASDrf_trqLossPos_CUR ASDrf_trqOfsNegHigh_C ASDrf_trqOfsNegLow_C ASDrf_trqOfsNegMid_C ASDrf_trqOfsPosHigh_C ASDrf_trqOfsPosLow_C ASDrf_trqOfsPosMid_C /end DEF_CHARACTERISTIC
 /begin IN_MEASUREMENT Eng_nAvrg /end IN_MEASUREMENT
 /begin OUT_MEASUREMENT ASDrf_stInit /end OUT_MEASUREMENT
/end FUNCTION
/begin FUNCTION asdrf_selectparameter_msg "" /begin OUT_MEASUREMENT ASDrf_trqLossNeg ASDrf_trqLossPos /end OUT_MEASUREMENT /end FUNCTION
/begin FUNCTION asdrf_selectparameter_uic ""
 /begin OUT_MEASUREMENT ASDrf_stCond_mp ASDrf_stPrioState_mp ASDrf_stSelectState_mp ASDrf_stStates_mp /end OUT_MEASUREMENT
/end FUNCTION
/begin FUNCTION asdrf_selectparameter_var ""
 /begin DEF_CHARACTERISTIC ASDrf_CoeffAFDCLossNeg_CUR ASDrf_CoeffAFDCLossPos_CUR ASDrf_CoeffAGripLossNeg_CUR ASDrf_CoeffAGripLossPos_CUR ASDrf_CoeffBFDCLossNeg_CUR ASDrf_CoeffBFDCLossPos_CUR ASDrf_CoeffBGripLossNeg_CUR ASDrf_CoeffBGripLossPos_CUR ASDrf_KdFDCNeg_CUR ASDrf_KdFDCPos_CUR ASDrf_KdGripNeg_CUR ASDrf_KdGripPos_CUR ASDrf_numPrio_C ASDrf_T1FDCNeg_CUR ASDrf_T1FDCPos_CUR ASDrf_T1GripNeg_CUR ASDrf_T1GripPos_CUR /end DEF_CHARACTERISTIC
 /begin IN_MEASUREMENT DrvTrn_rTransDT /end IN_MEASUREMENT
/end FUNCTION
/begin FUNCTION asmod_co "interface coordinator" /end FUNCTION
/begin FUNCTION asmod_co_msg "" /begin OUT_MEASUREMENT ASMod_facAMCor ASMod_qCor ASMod_rRelPosVSA /end OUT_MEASUREMENT /end FUNCTION
/begin FUNCTION asmod_co_uic "" /end FUNCTION
/begin FUNCTION asmod_detcylch "Füllungserfassung" /end FUNCTION
/begin FUNCTION asmod_detcylch_msg ""
 /begin OUT_MEASUREMENT ASMod_dmExhMnfPst ASMod_dmIndAir ASMod_dmO2IndAir ASMod_rLmbdRecExhMnfPst ASMod_tIndAir /end OUT_MEASUREMENT
/end FUNCTION
/begin FUNCTION asmod_detcylch_uic ""
 /begin OUT_MEASUREMENT ASMod_dmEGR_mp ASMod_dmIndAir_mp ASMod_rO2ExhMnfPst_mp ASMod_rO2IndAir_mp ASMod_tExhMnfPst_mp /end OUT_MEASUREMENT
/end FUNCTION
/begin FUNCTION asmod_eng "Motor"
 /begin DEF_CHARACTERISTIC ASMod_dmIndAirRef_MAP ASMod_facDdTm_C ASMod_facDMCorTDiff_CUR ASMod_facSOICorTDiff_CUR ASMod_phiSOIRef_MAP ASMod_tDiffEng_MAP ASMod_tEngCorTDiff_CUR ASMod_tEngRef_C /end DEF_CHARACTERISTIC
 /begin IN_MEASUREMENT ASMod_qBurned_mp ASMod_qLmbdCtlCorr_mp ASMod_rDMIndAir_mp ASMod_tEngCorTDiff_mp Eng_nAvrg InjCrv_phiMI1Des /end IN_MEASUREMENT
/end FUNCTION
/begin FUNCTION asmod_eng_msg ""
 /begin OUT_MEASUREMENT ASMod_dmExhMnfPre ASMod_rLmbdRecEG ASMod_rO2ExhMnfPre ASMod_tExhMnfPre /end OUT_MEASUREMENT
/end FUNCTION
/begin FUNCTION asmod_eng_uic ""
 /begin OUT_MEASUREMENT ASMod_dmEG_mp ASMod_dmFlBurned_mp ASMod_dmFlPerTime_mp ASMod_dmIndAirRef_mp ASMod_dmO2EG_mp ASMod_facDMCorTDiff_mp ASMod_facSOICorTDiff_mp ASMod_phiSOIRef_mp ASMod_qBurned_mp ASMod_qLmbdCtlCorr_mp ASMod_rDMIndAir_mp ASMod_rFlBurned_mp ASMod_rO2EG_mp ASMod_tDiffEG_mp ASMod_tDiffEng_mp ASMod_tEG_mp ASMod_tEngCorTDiff_mp ASMod_tiDdTm_mp /end OUT_MEASUREMENT
/end FUNCTION
/begin FUNCTION asmod_indvol "Modell des Einlaßvolumens" /begin DEF_CHARACTERISTIC ASMod_tiDT1_C ASMod_volIndVol_C /end DEF_CHARACTERISTIC /end FUNCTION
/begin FUNCTION asmod_indvol_msg "" /begin OUT_MEASUREMENT ASMod_dmAirPerTimeCorr ASMod_mAirPerCylCorr /end OUT_MEASUREMENT /end FUNCTION
/begin FUNCTION asmod_indvol_uic "" /begin OUT_MEASUREMENT ASMod_dmIndVol_mp ASMod_mIndVol_mp /end OUT_MEASUREMENT /end FUNCTION
/begin FUNCTION asmod_voleff "Luftaufwand"
 /begin DEF_CHARACTERISTIC ASMod_facTCorVolEff_C ASMod_facVolEff_MAP ASMod_facVSACorVolEff_MAP ASMod_swtT_C ASMod_tIndAirRef_MAP ASMod_volEng_C /end DEF_CHARACTERISTIC
 /begin IN_MEASUREMENT ASMod_rRelPosVSA Eng_nAvrg InjCtl_qCurr /end IN_MEASUREMENT
/end FUNCTION
/begin FUNCTION asmod_voleff_msg "" /begin OUT_MEASUREMENT ASMod_dmIndAirRef ASMod_dvolIndAirRef ASMod_tIndAirRef /end OUT_MEASUREMENT /end FUNCTION
/begin FUNCTION asmod_voleff_uic ""
 /begin OUT_MEASUREMENT ASMod_facTIndAirCor_mp ASMod_facVolEff_mp ASMod_facVSACorVolEff_mp ASMod_tIntakeAir_mp /end OUT_MEASUREMENT
/end FUNCTION
/begin FUNCTION battcd "Komponententreiber Batteriespannung"
 /begin DEF_CHARACTERISTIC BattCD_uSRCMin_C BattCD_uSRCMax_C BattCD_uLin_CUR BattCD_DebSRCHighDef_C BattCD_DebSRCHighOk_C BattCD_DebSRCLowDef_C BattCD_DebSRCLowOk_C BattCD_numAdc_C BattCD_duRmpSlpUp_C BattCD_duRmpSlpDwn_C BattCD_stSensIDWord_C BattCD_uDfl_C /end DEF_CHARACTERISTIC
 /begin IN_MEASUREMENT BattCD_uRaw /end IN_MEASUREMENT
/end FUNCTION
/begin FUNCTION battcd_msg "" /begin OUT_MEASUREMENT BattCD_u BattCD_uLin BattCD_uRaw /end OUT_MEASUREMENT /end FUNCTION
/begin FUNCTION battcd_uic "" /end FUNCTION
/begin FUNCTION batt_corfac "" /begin DEF_CHARACTERISTIC Batt_uNrm_C /end DEF_CHARACTERISTIC /end FUNCTION
/begin FUNCTION batt_corfac_msg "" /begin OUT_MEASUREMENT Batt_facCor /end OUT_MEASUREMENT /end FUNCTION
/begin FUNCTION bdint "Karosserie und Innenraum" /end FUNCTION
/begin FUNCTION bdint_msg "" /begin OUT_MEASUREMENT BdInt_nMax BdInt_nMin BdInt_pwrDes BdInt_pwrLead /end OUT_MEASUREMENT /end FUNCTION
/begin FUNCTION bpacd "Komponententreiber des Ladedruckstellers"
 /begin DEF_CHARACTERISTIC BPACD_ctPwrStgOnMax_C BPACD_tiDebBPADia1Def_C BPACD_tiDebBPADia1Ok_C BPACD_tiDebBPADia2Def_C BPACD_tiDebBPADia2Ok_C BPACD_tiDebBPADia3Def_C BPACD_tiDebBPADia3Ok_C BPACD_DebExcTempDef_C BPACD_DebExcTempOk_C BPACD_DebNoLoadDef_C BPACD_DebNoLoadOk_C BPACD_DebShortCircBatDef_C BPACD_DebShortCircBatOk_C BPACD_DebShortCircGndDef_C BPACD_DebShortCircGndOk_C BPACD_numDia_C BPACD_numPwmOut_C BPACD_stInvOut_C BPACD_tiPer_C BPACD_rCnv_CUR BPACD_rOutMax_C BPACD_rOutMin_C BPACD_stPwrStgActv_C BPACD_stPwrStgDia_C BPACD_stSPICtl_C BPACD_swt_C BPACD_tiBtwTst_C BPACD_tiDiag1Max_C BPACD_tiDiag1Min_C BPACD_tiDiag2Max_C BPACD_tiDiag2Min_C BPACD_tiDiag3Max_C BPACD_tiDiag3Min_C BPACD_tiPwrStgOn_C /end DEF_CHARACTERISTIC
 /begin IN_MEASUREMENT BPA_rBPACD /end IN_MEASUREMENT
/end FUNCTION
/begin FUNCTION bpacd_msg "" /begin OUT_MEASUREMENT BPACD_rOut /end OUT_MEASUREMENT /end FUNCTION
/begin FUNCTION bpacd_uic "" /begin OUT_MEASUREMENT BPACD_rCnv_mp /end OUT_MEASUREMENT /end FUNCTION
/begin FUNCTION bpa_co "Stellerkoordinator für Ladedrucksteller" /end FUNCTION
/begin FUNCTION bpa_co_msg "" /begin OUT_MEASUREMENT BPA_rBPACD /end OUT_MEASUREMENT /end FUNCTION
/begin FUNCTION bpa_co_uic "" /begin DEF_CHARACTERISTIC BPA_rBPACD_Vector BPA_rBPACD_Channel /end DEF_CHARACTERISTIC /begin OUT_MEASUREMENT BPA_rBPAByp_mp /end OUT_MEASUREMENT /end FUNCTION
/begin FUNCTION bpa_lpco "" /end FUNCTION
/begin FUNCTION bpa_lpco_msg "" /begin OUT_MEASUREMENT BPA_rLPACD /end OUT_MEASUREMENT /end FUNCTION
/begin FUNCTION bpa_lpco_uic "" /begin DEF_CHARACTERISTIC BPA_rLPACD_Vector BPA_rLPACD_Channel /end DEF_CHARACTERISTIC /begin OUT_MEASUREMENT BPA_rLPAByp_mp /end OUT_MEASUREMENT /end FUNCTION
/begin FUNCTION bpscd "Komponententreiber des Ladedruckfühlers"
 /begin DEF_CHARACTERISTIC BPSCD_uSRCMin_C BPSCD_uSRCMax_C BPSCD_pLin_CUR BPSCD_DebNplDef_C BPSCD_DebNplOK_C BPSCD_DebSigDef_C BPSCD_DebSigOK_C BPSCD_DebSRCHighDef_C BPSCD_DebSRCHighOK_C BPSCD_DebSRCLowDef_C BPSCD_DebSRCLowOK_C BPSCD_tiDT1_C BPSCD_dDT1Kd_C BPSCD_tiLPFiltPT1_C BPSCD_nLim_C BPSCD_numAdc_C BPSCD_pDiffLim_C BPSCD_tiOutValDT1_C BPSCD_dDT1KdOutVal_C BPSCD_tiPT1_C BPSCD_dpRmpSlpUp_C BPSCD_dpRmpSlpDwn_C BPSCD_swtSigVal_C BPSCD_stSensIDWord_C BPSCD_pDfl_C /end DEF_CHARACTERISTIC
 /begin IN_MEASUREMENT BPSCD_uRawVal /end IN_MEASUREMENT
/end FUNCTION
/begin FUNCTION bpscd_msg ""
 /begin OUT_MEASUREMENT BPSCD_dFltValDT1 BPSCD_dpOutVal BPSCD_pFltVal BPSCD_pIntVal BPSCD_pLin BPSCD_pOutVal BPSCD_pPhyVal BPSCD_stErr BPSCD_stPlausErr BPSCD_uRawVal /end OUT_MEASUREMENT
/end FUNCTION
/begin FUNCTION bpscd_uic "" /end FUNCTION
/begin FUNCTION brkcd "Komponententreiber zur Erfassung aller Bremssignale"
 /begin DEF_CHARACTERISTIC BrkCD_ctUnPlausDef_C BrkCD_DebPlaDef_C BrkCD_DebPlaOk_C BrkCD_DebSigDef_C BrkCD_DebSigOk_C BrkCD_tiMnSwtDebNeg_C BrkCD_tiMnSwtDebPos_C BrkCD_numDioInMn_C BrkCD_numDioInRed_C BrkCD_tiRedSwtDebNeg_C BrkCD_tiRedSwtDebPos_C BrkCD_stDflVal_C BrkCD_stMnSwtInvIn_C BrkCD_stRedSwtInvIn_C BrkCD_swtRedSwtPresent_C BrkCD_swtSigVal_C BrkCD_tiDebResUnPlaus_C BrkCD_tiDebUnPlausStat_C BrkCD_tiDebUnPlaus_C /end DEF_CHARACTERISTIC
/end FUNCTION
/begin FUNCTION brkcd_msg ""
 /begin OUT_MEASUREMENT BrkCD_stMnSwtDebVal BrkCD_stMnSwtLastDebVal BrkCD_stMnSwtRawVal BrkCD_stPressed BrkCD_stRedSwtDebVal BrkCD_stRedSwtLastDebVal BrkCD_stRedSwtPresent BrkCD_stRedSwtRawVal BrkCD_swtSig /end OUT_MEASUREMENT
/end FUNCTION
/begin FUNCTION brkcd_uic ""
 /begin OUT_MEASUREMENT BrkCD_ctUnPlaus_mp BrkCD_stDeb_mp BrkCD_stMnSwtLogVal_mp BrkCD_stRedSwtLogVal_mp BrkCD_stResUnPlaus_mp BrkCD_stRun_mp /end OUT_MEASUREMENT
/end FUNCTION
/begin FUNCTION bss "Servicetask für Bit Serielle Schnittstelle" /begin DEF_CHARACTERISTIC Bss_tiDebDefect_C Bss_tiDebOk_C /end DEF_CHARACTERISTIC /end FUNCTION
/begin FUNCTION bypetk ""
 /begin DEF_CHARACTERISTIC BypEtk_dNsyncStimuli64_C BypEtk_dNsyncStimuli32_C BypEtk_dNsyncStimuli16_C BypEtk_dNsyncStimuli8_C BypEtk_stAscet_C BypEtk_dTsyncStimuli64_C BypEtk_dTsyncStimuli32_C BypEtk_dTsyncStimuli16_C BypEtk_dTsyncStimuli8_C /end DEF_CHARACTERISTIC
/end FUNCTION
/begin FUNCTION bypetk_msg ""
 /begin OUT_MEASUREMENT BypEtk_ctStepDelayNsync_u8 BypEtk_ctStepDelayTsync_u8 BypEtk_stEcu_u8 /end OUT_MEASUREMENT
/end FUNCTION
/begin FUNCTION bypint "" /begin DEF_CHARACTERISTIC BypInt_adFunc_C BypInt_stAscet_C /end DEF_CHARACTERISTIC /end FUNCTION
/begin FUNCTION bypint_msg "" /begin OUT_MEASUREMENT BypInt_stEcu_u8 /end OUT_MEASUREMENT /end FUNCTION
/begin FUNCTION carb "CARB Einstellungen"
 /begin DEF_CHARACTERISTIC Carb_Mode1PID_CA Carb_Mode1Signal_CA Carb_Mode2PID_CA Carb_Mode2Signal_CA Carb_Mode3SwtDia_C Carb_Mode4RefVal_C Carb_Mode4SigNum_C Carb_Mode6TstComp_CUR Carb_Mode6TstNum_CUR Carb_Mode6TstRefMax_CUR Carb_Mode6TstRefMin_CUR Carb_Mode6TstTestId_CUR Carb_Mode6TstUnitId_CUR Carb_Mode6TstVal_CUR Carb_Mode9PID0_C Carb_Mode9PID1_C Carb_Mode9PID2_C Carb_Mode9PID3_C Carb_Mode9PID4_C Carb_Mode9PID5_C Carb_Mode9PID6_C /end DEF_CHARACTERISTIC
/end FUNCTION
/begin FUNCTION cascd "Komponententreiber Nockenwelle"
 /begin DEF_CHARACTERISTIC CaSCD_ctEdgOfs_C CaSCD_ctErrSync_C CaSCD_ctShftSync_C CaSCD_dSegSeries_C CaSCD_facPlausHigh_CUR CaSCD_facPlausLow_CUR CaSCD_nMinSpeed_C CaSCD_phiSegLenTolc_C CaSCD_phiSegLen_C CaSCD_phiSegOfs_C CaSCD_phiSpeedCalcTolc_C CaSCD_phiSpeedSegLen_C CaSCD_phiSpeedSegOfs_C CaSCD_stCalc_C CaSCD_stEdgeTrig_C CaSCD_stPinState_C CaSCD_stTPO_C CaSCD_tiPeriodRev1Max_C CaSCD_tiPeriodRev2Max_C CaSCD_tiTimOutOfs_C /end DEF_CHARACTERISTIC
 /begin IN_MEASUREMENT CaSCD_tiPeriodRev CaSCD_tiPeriodRevHold /end IN_MEASUREMENT
/end FUNCTION
/begin FUNCTION cascd_backup "" /end FUNCTION
/begin FUNCTION cascd_msg ""
 /begin OUT_MEASUREMENT CaSCD_nPeriod CaSCD_nSeg CaSCD_tiPeriodRev CaSCD_tiPeriodRevHold CaSCD_tiSeg /end OUT_MEASUREMENT
/end FUNCTION
/begin FUNCTION cascd_uic ""
 /begin OUT_MEASUREMENT CaSCD_ctEdgCaSRev_mp CaSCD_ctEdgOfs_mp CaSCD_ctEdgOrd_mp CaSCD_ctErrEdg_mp CaSCD_ctPhRevEdges_mp CaSCD_ctPhRev_mp CaSCD_ctSegEdg_mp CaSCD_ctShftPos_mp CaSCD_ctSyncEdg_mp CaSCD_numFrstInt_mp CaSCD_numFrstTDC_mp CaSCD_phiCurr_mp CaSCD_phiLstEdge_mp CaSCD_stPhaseErr_mp CaSCD_stPhaseSig_mp CaSCD_stPhaseSync_mp CaSCD_stSegCylEdg_mp CaSCD_stSyncCylEdg_mp CaSCD_tiSigTimOut_mp /end OUT_MEASUREMENT
/end FUNCTION
/begin FUNCTION cbacd ""
 /begin DEF_CHARACTERISTIC CBACD_ctPwrStgOnMax_C CBACD_numDia_C CBACD_numDioOut_C CBACD_stInvOut_C CBACD_stPwrStgActv_C CBACD_stPwrStgDia_C CBACD_stSPICtl_C CBACD_tiBtwTst_C CBACD_tiDebExcTempDef_C CBACD_tiDebExcTempOk_C CBACD_tiDebNoLoadDef_C CBACD_tiDebNoLoadOk_C CBACD_tiDebShortCircBatDef_C CBACD_tiDebShortCircBatOk_C CBACD_tiDebShortCircGndDef_C CBACD_tiDebShortCircGndOk_C CBACD_tiPwrStgOn_C /end DEF_CHARACTERISTIC
/end FUNCTION
/begin FUNCTION cbacd_uic "" /begin OUT_MEASUREMENT CBACD_stLogicOut_mp /end OUT_MEASUREMENT /end FUNCTION
/begin FUNCTION clg "Kühlung"
 /begin DEF_CHARACTERISTIC Clg_dtMinDynTst_C Clg_nMinEnaDynTst_C Clg_qMinEnaDynTst_C Clg_tiInitTmr_C Clg_tiMaxDynTst_CUR Clg_tMinClntDynTst_C /end DEF_CHARACTERISTIC
 /begin IN_MEASUREMENT Clg_tClntStrtVal_mp /end IN_MEASUREMENT
/end FUNCTION
/begin FUNCTION clg_msg ""
 /begin OUT_MEASUREMENT Clg_dtDynTst Clg_dtMinDynTst Clg_tEndDynTst Clg_tiDynTst Clg_tiMaxDynTst Clg_tMinClntDynTst /end OUT_MEASUREMENT
/end FUNCTION
/begin FUNCTION clg_uic "" /begin OUT_MEASUREMENT Clg_tClntStrtVal_mp /end OUT_MEASUREMENT /end FUNCTION
/begin FUNCTION cmbchb_misfire "Brennräume Fehlzündungserkennung"
 /begin DEF_CHARACTERISTIC CmbChb_nAvrgThrHi_C CmbChb_nAvrgThrLo_C CmbChb_qRawThrHi_C CmbChb_qRawThrLo_C CmbChb_tClntThrLo_C CmbChb_vThrHi_C CmbChb_tiDebClutchChng_C CmbChb_tiDlyStr_C CmbChb_ctEngRevPerBlk_C CmbChb_ctSegTDC1_C CmbChb_numBlk_C CmbChb_dnSegMin_C CmbChb_ctMisfireMax_C CmbChb_swtMonClutchVal_C CmbChb_swtMonClutchType_C /end DEF_CHARACTERISTIC
 /begin OUT_MEASUREMENT CmbChb_ctMifBuf1_mp CmbChb_ctMifBuf2_mp CmbChb_ctMifMem_mp /end OUT_MEASUREMENT
/end FUNCTION
/begin FUNCTION cmbchb_misfire_msg "" /begin OUT_MEASUREMENT CmbChb_st CmbChb_swtMonClutch /end OUT_MEASUREMENT /end FUNCTION
/begin FUNCTION cmbchb_misfire_uic ""
 /begin OUT_MEASUREMENT CmbChb_ctEngRevLogBuf1_mp CmbChb_ctEngRevLogBuf2_mp CmbChb_ctEngRevLogMem_mp CmbChb_ctEngRevPerBlk_mp CmbChb_dnSegMinPerCyl_mp CmbChb_nSegEven_mp CmbChb_nSegOdd_mp /end OUT_MEASUREMENT
/end FUNCTION
/begin FUNCTION codt_drvtrncord "Antriebs-Koordination"
 /begin DEF_CHARACTERISTIC CoDT_dtrqLimDwnCurr_C CoDT_dtrqLimDwnLead_C CoDT_dtrqLimUpCurr_C CoDT_dtrqLimUpLead_C CoDT_swtCoTypeVal_C CoDT_swtCoTypeType_C CoDT_tiTrqRedMaxCurr_C CoDT_tiTrqRedMaxLead_C /end DEF_CHARACTERISTIC
/end FUNCTION
/begin FUNCTION codt_drvtrncordlead_uic ""
 /begin OUT_MEASUREMENT CoDT_trqDTInDecLead_mp CoDT_trqDTInIncLead_mp CoDT_trqGearbxLead_mp /end OUT_MEASUREMENT
/end FUNCTION
/begin FUNCTION codt_drvtrncord_msg ""
 /begin OUT_MEASUREMENT CoDT_nMax CoDT_nMin CoDT_stOrd CoDT_swtCoType CoDT_trqAcsDes CoDT_trqCurr CoDT_trqDes CoDT_trqDTInCurr CoDT_trqDTInDes CoDT_trqDTInLead CoDT_trqGearbxDes CoDT_trqLead /end OUT_MEASUREMENT
/end FUNCTION
/begin FUNCTION codt_drvtrncord_uic "" /end FUNCTION
/begin FUNCTION codt_grip "Kraftschluß innerhalb Antrieb"
 /begin DEF_CHARACTERISTIC CoDT_tiChkGrpDT1_C CoDT_dChkGrpDT1Kd_C CoDT_tiChkGrpPT1_C CoDT_dOfsGripDet_C CoDT_dOfsNoGripDet_C CoDT_dThetaGripDet_C CoDT_dThetaNoGripDet_C CoDT_swtNoGripDet_C CoDT_tiDebGearUnVal_C CoDT_tiDebNoGrip_C CoDT_tiGripDeb_C CoDT_vGrip_C /end DEF_CHARACTERISTIC
/end FUNCTION
/begin FUNCTION codt_grip_msg "" /begin OUT_MEASUREMENT CoDT_Grip CoDT_stGripDeb /end OUT_MEASUREMENT /end FUNCTION
/begin FUNCTION codt_grip_uic ""
 /begin OUT_MEASUREMENT CoDT_dnAbsEng_mp CoDT_dnEng_mp CoDT_dnGrip_mp CoDT_dnNoGrip_mp CoDT_stNoGripDet_mp CoDT_trqAbsGbxPT1_mp CoDT_trqGbxPT1_mp /end OUT_MEASUREMENT
/end FUNCTION
/begin FUNCTION codt_prptrqcurrcalc "Antriebsmoment-Berechnung" /end FUNCTION
/begin FUNCTION codt_prptrqcurrcalc_msg "" /begin OUT_MEASUREMENT CoDT_trq CoDT_trqCurrLim CoDT_trqGbx /end OUT_MEASUREMENT /end FUNCTION
/begin FUNCTION codt_prptrqcurrcalc_uic "" /begin OUT_MEASUREMENT CoDT_trqActAcs_mp /end OUT_MEASUREMENT /end FUNCTION
/begin FUNCTION codt_prptrqrngcalc "Bereitstellung Momentenintervall" /begin DEF_CHARACTERISTIC CoDT_swtAcsFltEna_C CoDT_tiFltPT1_C CoDT_trqMinInit_C /end DEF_CHARACTERISTIC /end FUNCTION
/begin FUNCTION codt_prptrqrngcalc_msg ""
 /begin OUT_MEASUREMENT CoDT_trqAcsMin CoDT_trqGbxMax CoDT_trqGbxMin CoDT_trqMax CoDT_trqMin /end OUT_MEASUREMENT
/end FUNCTION
/begin FUNCTION codt_prptrqrngcalc_uic "" /begin OUT_MEASUREMENT CoDT_trqAcsMax_mp CoDT_trqAcs_mp /end OUT_MEASUREMENT /end FUNCTION
/begin FUNCTION coeng_actrprt "Steuerung Stellerschutz" /begin DEF_CHARACTERISTIC CoEng_nActrRelease_C CoEng_tiActrPrt_C /end DEF_CHARACTERISTIC /end FUNCTION
/begin FUNCTION coeng_actrprt_uic "" /end FUNCTION
/begin FUNCTION coeng_aftrun "" /begin DEF_CHARACTERISTIC CoEng_stAftRunSel_C CoEng_tiPwrStgDiaRdy_C /end DEF_CHARACTERISTIC /end FUNCTION
/begin COMPU_METHOD Acc "Fahrzeugbeschleunigung" RAT_FUNC "%6.5" "m/s^2" COEFFS 0 1000 0 0 0 1 /end COMPU_METHOD
/begin COMPU_METHOD AirMass "Luftmasse" RAT_FUNC "%6.4" "g" COEFFS 0 100 0 0 0 1 /end COMPU_METHOD
/begin COMPU_METHOD AirMassPerCyl "Luftmasse pro Zylinder" RAT_FUNC "%6.3" "mg/Hub" COEFFS 0 10 0 0 0 1 /end COMPU_METHOD
/begin COMPU_METHOD AirMassPerTime "Luftmasse pro Zeit" RAT_FUNC "%6.3" "Kg/h" COEFFS 0 10 0 0 0 1 /end COMPU_METHOD
/begin COMPU_METHOD AirVolPerTime "Umrechnungsformel für Luftvolumenstrom" RAT_FUNC "%6.3" "m^3/h" COEFFS 0 10 0 0 0 1 /end COMPU_METHOD
/begin COMPU_METHOD AngleCaS "Winkel Nockenwelle" RAT_FUNC "%6.4" "deg CaS" COEFFS 0 85.3333333333334 0 0 0 1 /end COMPU_METHOD
/begin COMPU_METHOD AngleCrS "Winkel Kurbelwelle" RAT_FUNC "%6.4" "deg CrS" COEFFS 0 42.6666666666667 0 0 0 1 /end COMPU_METHOD
/begin COMPU_METHOD ASDrf_numDefaultState "Nummer des Default-Primärzustandes" TAB_VERB "%6.3" "-" COMPU_TAB_REF ASDrf_numDefaultState /end COMPU_METHOD
/begin COMPU_VTAB ASDrf_numDefaultState "Nummer des Default-Primärzustandes" TAB_VERB 6 0 "ExtInt" 1 "Clutch" 2 "Grip" 3 "State3" 4 "State4" 5 "Sport mode" /end COMPU_VTAB
/begin COMPU_METHOD ASDrf_stPrimState "Auswahl des Primärstatus in der Statusvariabel sollte übereinstimmedn mit der in der Definition asdrf_selectparemeter.col sein" TAB_VERB "%6.3" "-" COMPU_TAB_REF ASDrf_stPrimState /end COMPU_METHOD
/begin COMPU_VTAB ASDrf_stPrimState "Auswahl des Primärstatus in der Statusvariabel sollte übereinstimmedn mit der in der Definition asdrf_selectparemeter.col sein" TAB_VERB 7 0 "Void" 1 "ExtInt" 2 "Clutch" 4 "Grip" 8 "State3" 16 "State4" 32 "Sport mode" /end COMPU_VTAB
/begin COMPU_METHOD ASDdcState "Verbale Umrechnung für ADSdc-Parametersatzwahl" TAB_VERB "%6.3" "-" COMPU_TAB_REF dcState /end COMPU_METHOD
/begin COMPU_VTAB dcState "Verbale Umrechnung für ADSdc-Parametersatzwahl" TAB_VERB 7 1 "GripMAP" 2 "Clutch " 4 "ExtInt " 8 "State3 " 16 "State4 " 32 "SlipMAP" 64 "SportMAP" /end COMPU_VTAB
/begin COMPU_METHOD ASD_GvrnDT1Kd_float "Differentialverstärkung Kd (Motordrehzahl EngN zu Motormoment Trq)" RAT_FUNC "%6.2" "(Nm/rpm)^0.5" COEFFS 0 1 0 0 0 1 /end COMPU_METHOD
/begin COMPU_METHOD ASD_GvrnDT1T1_float "Zeitkonstante T1 (in s) für PT1, DT1 beim ARD" RAT_FUNC "%6.2" "s" COEFFS 0 1 0 0 0 1 /end COMPU_METHOD
/begin COMPU_METHOD Can1 "Umsetzungsfaktor fuer CAN verwandte Groeßen" RAT_FUNC "%7.6" "-" COEFFS 0 10000 0 0 0 1 /end COMPU_METHOD
/begin COMPU_METHOD CoeffA "Koeffizient A in der Parabel dTrq = A * Trq^2 + Trq" RAT_FUNC "%6.4" "1/(s*Nm)" COEFFS 0 204.8 0 0 0 1 /end COMPU_METHOD
/begin COMPU_METHOD Curr_10mA "Spannung in mA" RAT_FUNC "%6.1" "mA" COEFFS 0 0.1 0 0 0 1 /end COMPU_METHOD
/begin COMPU_METHOD dn_dZ20 "Motorbeschleunigung pro Zeit (dn/dt) (im 20 ms Raster)" RAT_FUNC "%6.1" "rmp/s" COEFFS 0 0.1 0 0 0 1 /end COMPU_METHOD
/begin COMPU_METHOD dn_dZfine "Engine acceleration per time (dn/dt) fine resolution" RAT_FUNC "%6.2" "rpm/s" COEFFS 0 1 0 0 0 1 /end COMPU_METHOD
/begin COMPU_METHOD dp_dZ10 "boost pressure per time (dp/dt) every 10ms" RAT_FUNC "%6.1" "hPa/s" COEFFS 0 0.1 0 0 0 1 /end COMPU_METHOD
/begin COMPU_METHOD dTrq "Umrtechnungsformel dTrq/dTime" RAT_FUNC "%6.3" "Nm/s" COEFFS 0 10 0 0 0 1 /end COMPU_METHOD
/begin COMPU_METHOD DtyCyc "Tastverhaeltnis" RAT_FUNC "%6.4" "%" COEFFS 0 100 0 0 0 1 /end COMPU_METHOD
/begin COMPU_METHOD EngN "Motordrehzahl" RAT_FUNC "%6.2" "rpm" COEFFS 0 1 0 0 0 1 /end COMPU_METHOD
/begin COMPU_METHOD Fact "Faktor mit Auflösung 1 / 8192, hauptsächlich für einen Faktorenbereich 0...1 verwendet" RAT_FUNC "%6.5" "-" COEFFS 0 8192 0 0 0 1 /end COMPU_METHOD
/begin COMPU_METHOD Fact1 "Faktor mit Auflösung 0,01 (100 mal höherer Bereich als Fact)" RAT_FUNC "%6.4" "-" COEFFS 0 128 0 0 0 1 /end COMPU_METHOD
/begin COMPU_METHOD InjMass "Einspritzmenge" RAT_FUNC "%6.4" "mg/hub" COEFFS 0 100 0 0 0 1 /end COMPU_METHOD
/begin COMPU_METHOD InjMassCyc "Einspritzmenge pro Zyklus (mg/Zyklus)" RAT_FUNC "%6.4" "mg/cyc" COEFFS 0 100 0 0 0 1 /end COMPU_METHOD
/begin COMPU_METHOD InjMassPerTime "Kraftstoffmassenstrom" RAT_FUNC "%6.4" "kg/h" COEFFS 0 100 0 0 0 1 /end COMPU_METHOD
/begin COMPU_METHOD Kd "Differentialverstärkung Kd (gleiche Einheit/Umrechnungsformel an Ein- und Ausgang)" RAT_FUNC "%7.6" "1/1" COEFFS 0 65536 0 0 0 1 /end COMPU_METHOD
/begin COMPU_METHOD Kd16_sqr_rpm2Nm "Wurzeldifferentialverstärkung Kd^0,5 für D2T2 (zweifach DT1), Motordrehzahl EngN zu Motormoment Trq" RAT_FUNC "%6.5" "(Nm/rpm)^0.5" COEFFS 0 1024 0 0 0 1 /end COMPU_METHOD
/begin COMPU_METHOD Kd_Lin_16 "Kd Verstärkung von linearen Kennlinien/-feldern" RAT_FUNC "%7.6" "1/1" COEFFS 0 32767 0 0 0 1 /end COMPU_METHOD
/begin COMPU_METHOD lambdaRecVal "Reziproker Lambda Wert" RAT_FUNC "%6.5" "-" COEFFS 0 1000 0 0 0 1 /end COMPU_METHOD
/begin COMPU_METHOD Moment_Inertia "Moment of Inertia" RAT_FUNC "%6.4" "kg * m^2" COEFFS 0 100 0 0 0 1 /end COMPU_METHOD
/begin COMPU_METHOD NumPinAdc "verbale Umrechnung für ADC Signale" TAB_VERB "%6.3" "-" COMPU_TAB_REF NumPinAdc /end COMPU_METHOD
/begin COMPU_VTAB NumPinAdc "verbale Umrechnung für ADC Signale" TAB_VERB 25 0 "Water_Temperature_Sensor_182" 1 "Intake_Air_Temperature_Sensor_157" 2 "Charge_Air_Temperature_Sensor_183" 3 "Exhaust_Temperature_Sensor_2_134" 4 "Exhaust_Temperature_Sensor_1_158" 5 "1st_APP_Sensor_252" 6 "2nd_APP_Sensor_239" 7 "ADC_REF" 8 "Boost_Pressure_Sensor_154" 9 "Atmospheric_Pressure_Sensor" 10 "Battery_Voltage_Sensor" 11 "Rail_Pressure_Sensor_156" 12 "Rail_Pressure_Peak_Value_156" 13 "Booster_Voltage_Sensor" 14 "Current_MeUn_Sensor" 15 "Current_PCV_Sensor" 16 "Voltage_Bank_1" 17 "Voltage_Bank_2" 18 "Pressure_Upstream_Particle_Filter_159" 19 "Engine_Oil_Pressure_110" 20 "Temperature_ECU_PCB" 21 "Voltage_Lambda_Ua" 22 "Voltage_Lambda_Ri" 23 "ADC_DUMMY_NOT_USED" 24 "ADC_DUMMY_A_NOT_USED" /end COMPU_VTAB
/begin COMPU_METHOD NumPinDia "Verbale Umrechnung für Diagnose Signale" TAB_VERB "%6.3" "-" COMPU_TAB_REF NumPinDia /end COMPU_METHOD
/begin COMPU_VTAB NumPinDia "Verbale Umrechnung für Diagnose Signale" TAB_VERB 28 0 "CJ945_Diagnostic_Signal" 1 "AC_Compressor_DiaSig" 2 "Fuel_Pump_Diagnostic_Signal_232" 3 "Starter_234" 4 "Oil_Pressure_Lamp_Switch_245" 5 "Engine_Bay_Air_Flaps_123" 6 "Ebox_Fan_Actuator_Diagnostic_Signal_219" 7 "Shuttr_Actuator_Diagnostic_Signal_231" 8 "Twostage_TurboLoading_SW_DiaSig" 9 "DIO_OUT_DIAGNOSTIC_DUMMY_NOT_USED" 10 "Alternator" 11 "Boost_Pressure_Actuator_Diagnostic_Signal_193" 12 "EGR_Actuator_Diagnostic_Signal_194" 13 "1st_Pressure_Control_Valve_Diagnostic_Signal_172" 14 "2nd_Pressure_Control_Valve_Diagnostic_Signal_172" 15 "1st_Metering_Unit_Diagnostic_Signal_171" 16 "2nd_Metering_Unit_Diagnostic_Signal_171" 17 "Variable_Swirl_Actuator_Diagnostic_Signal_195" 18 "FAN_240" 19 "Add_On_Heater_244" 20 "EngM_Bearing_Actuator_Diagnostic_Signal_124" 21 "EngM_Bearing_Actuator_Diagnostic_Signal_121" 22 "Throttle_Valve_Diagnostic_Signal_196" 23 "Low pressure stage BPA_Diagnostic_Signal_117" 24 "PWM_DIAGNOSTIC_DUMMY_NOT_USED" 25 "1st_Sensor_Supply_Voltage_DiaSig" 26 "2nd_Sensor_Supply_Voltage_DiaSig" 27 "3rd_Sensor_Supply_Voltage_DiaSig" /end COMPU_VTAB
/begin COMPU_METHOD NumPinDioIn "Verbale Umrechnung für Digitaleingang Signale" TAB_VERB "%6.3" "-" COMPU_TAB_REF NumPinDioIn /end COMPU_METHOD
/begin COMPU_VTAB NumPinDioIn "Verbale Umrechnung für Digitaleingang Signale" TAB_VERB 15 0 "Terminal_15_207" 1 "Main_Brake_Switch_236" 2 "Redundant_Brake_Switch_223" 3 "Clutch_Switch" 4 "Terminal_50_224" 5 "ECU_selection_Switch_251" 6 "FlFlt_Switch_211" 7 "Coolant-heater_212" 8 "Redundant_Terminal_15_209(118)" 9 "AC-compressor_overboost_213" 10 "Additive_tank_level_switch_235" 11 "Terminal_61_113" 12 "Lambda_Regeneration" 13 "Oil_Level_sensor_138" 14 "DIO_IN_DUMMY_NOT_USED" /end COMPU_VTAB
/begin COMPU_METHOD NumPinDioOut "Verbale Umrechnung für Digitalausgang Signale" TAB_VERB "%6.3" "-" COMPU_TAB_REF NumPinDioOut /end COMPU_METHOD
/begin COMPU_VTAB NumPinDioOut "Verbale Umrechnung für Digitalausgang Signale" TAB_VERB 12 0 "Main_Relay_220(144)" 1 "AC_Compressor" 2 "Fuel_Pump_232" 3 "Starter_234" 4 "OPS_Lamp_245" 5 "EBAF_123" 6 "Ebox_Fan_Actuator_219" 7 "Shuttr_Actuator_231" 8 "STATREG_PSOFF_Bit" 9 "Twostage_TurboLoading_120" 10 "TD_Signal_253" 11 "DIO_OUT_DUMMY_NOT_USED" /end COMPU_VTAB
/begin COMPU_METHOD NumPinPwmOut "Verbale Umrechnung für PWM-Ausgang Signale" TAB_VERB "%6.3" "-" COMPU_TAB_REF NumPinPwmOut /end COMPU_METHOD
/begin COMPU_VTAB NumPinPwmOut "Verbale Umrechnung für PWM-Ausgang Signale" TAB_VERB 13 0 "Boost_Pressure_Actuator_193" 1 "EGR_Actuator_194" 2 "PCV_Actuator_172" 3 "MeUn_Actuator_171" 4 "Variable_Swirl_Actuator_195" 5 "Fan_Actuator_240" 6 "Add_On_Heater_244" 7 "EngM_Bearing_Actuator_124" 8 "EngM_Bearing_Actuator_121" 9 "Throttle_Valve_196" 10 "LSU_Heater_PWMOutput" 11 "Low pressure stage BPA_117" 12 "PWM_DUMMY_NOT_USED" /end COMPU_VTAB
/begin COMPU_METHOD O2 "Sauerstoffkonzentration" RAT_FUNC "%8.7" "-" COEFFS 0 100000 0 0 0 1 /end COMPU_METHOD
/begin COMPU_METHOD O2MassPerTime "Sauerstoffmassenstrom" RAT_FUNC "%6.4" "kg/h" COEFFS 0 100 0 0 0 1 /end COMPU_METHOD
/begin COMPU_METHOD OneToOne "eins zu eins (physikalischer Wert ist gleich dem internen Wert)" RAT_FUNC "%6.2" "-" COEFFS 0 1 0 0 0 1 /end COMPU_METHOD
/begin COMPU_METHOD Period "Periodendauer" RAT_FUNC "%6.3" "ms" COEFFS 0 10 0 0 0 1 /end COMPU_METHOD
/begin COMPU_METHOD Period_ms "Periodendauer in ms" RAT_FUNC "%6.3" "ms" COEFFS 0 10 0 0 0 1 /end COMPU_METHOD
/begin COMPU_METHOD Per_Dur "Periodendauer Segmentzeit" RAT_FUNC "%6.2" "usec" COEFFS 0 1 0 0 0 1 /end COMPU_METHOD
/begin COMPU_METHOD Prc "Prozent, gleiche interne Auflösung wie Fact, aber Darstellung in Prozent (0...100%)" RAT_FUNC "%6.4" "%" COEFFS 0 81.92 0 0 0 1 /end COMPU_METHOD
/begin COMPU_METHOD PrcPerSec "Prozentänderung pro Sekunde für 20ms-Tasks" RAT_FUNC "%6.3" "%/s" COEFFS 0 1.6384 0 0 0 1 /end COMPU_METHOD
/begin COMPU_METHOD Pres_hPa "Druck (angezeigt in [hPa])" RAT_FUNC "%6.2" "hPa" COEFFS 0 1 0 0 0 1 /end COMPU_METHOD
/begin COMPU_METHOD Pwr "Leistung" RAT_FUNC "%6.2" "W" COEFFS 0 0.10610329539459 0 0 0 1 /end COMPU_METHOD
/begin COMPU_METHOD RatAirMass "Luftmassenverhältnis" RAT_FUNC "%6.5" "-" COEFFS 0 1000 0 0 0 1 /end COMPU_METHOD
/begin COMPU_METHOD RatFuelMass "Kraftstoffmassenverhältnis" RAT_FUNC "%6.4" "-" COEFFS 0 100 0 0 0 1 /end COMPU_METHOD
/begin COMPU_METHOD RmpPrc "Prozent Rampengradient" RAT_FUNC "%6.5" "%/s" COEFFS 0 5368.70912 0 0 0 1 /end COMPU_METHOD
/begin COMPU_METHOD RmpPres_hPa "Rampengradient für Druck angezeigt in [hPa/s]" RAT_FUNC "%6.4" "hPa/s" COEFFS 0 65.536 0 0 0 1 /end COMPU_METHOD
/begin COMPU_METHOD RmpTrq "Rampengradient für Motormoment" RAT_FUNC "%6.4" "Nm/s" COEFFS 0 655.36 0 0 0 1 /end COMPU_METHOD
/begin COMPU_METHOD RmpVoltBatt "Rampengradient für Batteriespannung" RAT_FUNC "%6.3" "mV/s" COEFFS 0 3.3521664 0 0 0 1 /end COMPU_METHOD
/begin COMPU_METHOD SigName "Verbale Umrechnung für Signal Referenz Nummern" TAB_VERB "%6.3" "-" COMPU_TAB_REF SigName /end COMPU_METHOD
/begin COMPU_VTAB SigName "Verbale Umrechnung für Signal Referenz Nummern" TAB_VERB 118 0 "Sig_unused" 4 "CoEng_rTrq__Carb_r_DLen1" 5 "CTSCD_tClntLin__Carb_t_DLen1" 11 "BPSCD_pLin__Carb_p_DLen1" 12 "Eng_nAvrg__Carb_n_DLen2" 13 "VSSCD_vSensVal__Carb_v_DLen1" 15 "AFSCD_tAir_mp__Carb_t_DLen1" 16 "AFSCD_dmAirRawPerTime__Carb_mAirTim_DLen2" 28 "Signals_PID0x1C_C__OneToOne_DLen1" 33 "DSMDur_ctDfctDur1__Carb_l_DLen2" 128 "AFSCD_dmAirPerTime__mAirTim_DLen2" 129 "AFSCD_mAirPerCyl__mAirCyl_DLen2" 131 "AFSCD_rAir__dcyc_DLen2" 133 "AOHtCD_rOut_mp__dcyc_DLen2" 134 "APPCD_rFlt__r_DLen2" 137 "APPCD_uRawAPP1__u_DLen2" 138 "APPCD_uRawAPP2__u_DLen2" 139 "APSCD_pVal__p_DLen2" 140 "APSCD_uRaw__u_DLen2" 141 "AirCtl_mDesVal__mAirCyl_DLen2" 142 "AltCD_rAltLoad__r_DLen2" 143 "BPACD_rOut__dcyc_DLen2" 145 "BPSCD_pOutVal__p_DLen2" 146 "BPSCD_uRawVal__u_DLen2" 147 "BattCD_u__uBatt_DLen2" 148 "CBACD_stLogicOut_mp__OneToOne_DLen1" 149 "CTSCD_tClnt__t_DLen2" 150 "CTSCD_uRaw__u_DLen2" 151 "CoEng_trq__trq_DLen2" 152 "EBAFCD_stSigOut__OneToOne_DLen1" 153 "EGRCD_rOut__dcyc_DLen2" 155 "EGT_st__ShftRght0Byte_DLen2" 156 "EngM_stOut__OneToOne_DLen1" 157 "EngM_stSync__OneToOne_DLen1" 158 "Eng_nAvrg__n_DLen2" 159 "FMTC_trqInr__trq_DLen2" 160 "FTSCD_tFuel__t_DLen2" 161 "FTSCD_uRaw__u_DLen2" 162 "FanCD_dcycRaw_mp__dcyc_DLen2" 163 "FlFCD_stFlFltRawVal__OneToOne_DLen1" 164 "FrmMng_nPSP__nPSPSpd_DLen2" 165 "FrmMng_rPSPSetPoint__r_DLen2" 166 "GlwCtl_rPwrOut__OneToOne_DLen1" 167 "GlwCtl_stLampOut__OneToOne_DLen1" 168 "HWEMon_numRecovery__ShftRght0Byte_DLen2" 169 "HWEMon_numRecovery__ShftRght1Byte_DLen2" 170 "HWEMon_recLocLow_mp__ShftRght0Byte_DLen2" 171 "HWEMon_recLocLow_mp__ShftRght1Byte_DLen2" 172 "HWEMon_recLocHigh_mp__ShftRght0Byte_DLen2" 173 "IATSCD_tAir__t_DLen2" 174 "IATSCD_tAirCats__t_DLen2" 176 "IATSCD_uRawCats__u_DLen2" 178 "Tn_abstell__DezUwQ1_DLen2" 179 "U_gen__UUwQ0p1_DLen2" 181 "InjCtl_qCurr__qInjMassCyc_DLen2" 182 "InjCtl_qSetUnBal__qInjMassCyc_DLen2" 183 "LIGov_nSetpoint__n_DLen2" 184 "LIGov_trq__trq_DLen2" 185 "LPACD_rOut__dcyc_DLen2" 186 "LSUCD_rO2Raw[0]__O2_DLen2" 187 "LSUCD_uO2Raw[0]__u_DLen2" 188 "LSU_rLmbd[0]__Lambda_DLen2" 189 "LSU_rO2Adpt[0]__O2_DLen2" 190 "MeUnCD_dcycOut_mp__dcyc_DLen2" 191 "OPSCD_stSigOut__OneToOne_DLen1" 192 "OPSCD_stpOEL__OneToOne_DLen1" 193 "OTSCD_tEngOil__t_DLen2" 194 "OxiCCD_tPre__tExhaustgas_DLen2" 196 "OxiCCD_uRawTempPre__u_DLen2" 198 "PCR_pDesVal__p_DLen2" 199 "PCVCD_dcycOut_mp__dcyc_DLen2" 200 "PFltCD_pPre__p_DLen2" 202 "PFltCD_tPre__tExhaustgas_DLen2" 204 "PFltCD_uRawPresPre_mp__u_DLen2" 206 "PFltCD_uRawTempPre__u_DLen2" 208 "PFlt_dvol__volph_DLen2" 209 "PFlt_lSnceRgnu16_mp__lenrgnu16PFlt_DLen2" 211 "PFlt_mAshOil__mSoot_DLen2" 212 "PFlt_mSot__mSoot_DLen2" 213 "PFlt_mSotSim__mSoot_DLen2" 214 "PFlt_numEngPOp__OneToOne_DLen1" 215 "PFlt_numRgn_mp__OneToOne_DLen1" 216 "PFlt_pDiff__p_DLen2" 217 "PFlt_qFl_mp__FlConPFlt_DLen2" 219 "PFlt_stEngPOp__OneToOne_DLen1" 220 "PFlt_stIntr_mp__OneToOne_DLen1" 221 "PFlt_stLck_mp__OneToOne_DLen1" 222 "PSPCD_dvolOut__FlCon_DLen2" 223 "RailCD_pPeak__pRail_DLen2" 224 "RailCD_uPeakRaw__u_DLen2" 225 "Rail_pSetPoint__pRail_DLen2" 226 "TVACD_rOut__dcyc_DLen2" 228 "VSACD_rOut__dcyc_DLen2" 229 "VSSCD_v__v_DLen2" 230 "VehDa_tiEngOn__timEng_DLen2" 231 "PFlt_pPreCorr_mp__p_DLen2" 232 "PFlt_stPresPlaus_mp__OneToOne_DLen1" 234 "EGPpCD_stActrOut__OneToOne_DLen1" 236 "OvRMon_tiTDCAvrg__InjTim_DLen2" 237 "OvRMon_tiOvRMonActive_mp__tims_DLen2" 238 "CoEng_trqInrSet__trq_DLen2" 239 "InjCtl_qSet__qInjMassCyc_DLen2" 240 "Absch_korr__FSwQ0p00153_DLen2" 241 "D_soc__FSwB100_DLen2" 242 "I_batt__IUwQ0p08O200_DLen2" 243 "Oz_oelkm__KmUwQ10_DLen2" 244 "Oz_oelnivkurz__TdUbQ0p5_DLen1" 245 "Oz_oelnivnorm__TdUbQ0p5_DLen1" 246 "Oz_oelnivori__TdUbQ0p5_DLen1" 247 "Pm_klemmstat__DezUbQ1_DLen1" 248 "Stat_sv_reg1__DezUbQ1_DLen1" 249 "Stat_sv_reg2__DezUbQ1_DLen1" 250 "T2histshort__TdUbQ14p9333_DLen1" 251 "T3histshort__TdUbQ14p9333_DLen1" 252 "T4histshort__TdUbQ14p9333_DLen1" 253 "Toel__TSwQ0p1_DLen2" 254 "T_batt__TSwQ0p1_DLen2" 255 "U_batt__UUwQ0p25em3_DLen2" /end COMPU_VTAB
/begin COMPU_METHOD TempDiff_Cels "difference/offset temperature displayed in degree celcius" RAT_FUNC "%6.3" "deg C" COEFFS 0 10 0 0 0 1 /end COMPU_METHOD
/begin COMPU_METHOD Temp_Cels "Temperatur dargestellt in °C (gleiche interne Darstellung wie Temp_Kelv)" RAT_FUNC "%6.1" "deg C" COEFFS 0 10 2731.4 0 0 1 /end COMPU_METHOD
/begin COMPU_METHOD TimeDeb "Entprellzeit in Millisekunden für Libraryfunktion Debounce" RAT_FUNC "%6.1" "ms" COEFFS 0 0.1 0 0 0 1 /end COMPU_METHOD
/begin COMPU_METHOD TimeDelay_s "Zeitkonstante T1 (in s) für PT1, DT1, etc." RAT_FUNC "%9.3" "s" COEFFS 0 0 1 0 0.00023283064365387 0 /end COMPU_METHOD
/begin COMPU_METHOD TimeDelay_s_Lin_16 "Zeitkonstante T1 (in s) für PT1, DT1, etc. für SINT16, kein Kehrwert" RAT_FUNC "%6.5" "s" COEFFS 0 6553.4 0 0 0 1 /end COMPU_METHOD
/begin COMPU_METHOD Time_DynTst "Zeitumrechung für dynamischen test mit geringerer Auflösung, damit es für KL Ausgang passt" RAT_FUNC "%6.2" "s" COEFFS 0 0.390625 0 0 0 1 /end COMPU_METHOD
/begin COMPU_METHOD Time_ms "Zeit in ms für Fehlerentprellung (DSM) und SW-Timer" RAT_FUNC "%6.1" "ms" COEFFS 0 0.1 0 0 0 1 /end COMPU_METHOD
/begin COMPU_METHOD Time_s "Zeit in s für Fehlerentprellung (DSM) und SW-Timer" RAT_FUNC "%6.4" "s" COEFFS 0 100 0 0 0 1 /end COMPU_METHOD
/begin COMPU_METHOD TransR "Übersetzungsverhältnis (Getriebe etc.)" RAT_FUNC "%6.4" "-" COEFFS 0 100 0 0 0 1 /end COMPU_METHOD
/begin COMPU_METHOD Trq "Motormoment" RAT_FUNC "%6.3" "Nm" COEFFS 0 10 0 0 0 1 /end COMPU_METHOD
/begin COMPU_METHOD Trq32 "Umrechungsformel für inneres Moment in 32bit Zahlendarstellung" RAT_FUNC "%8.7" "Nm" COEFFS 0 655360 0 0 0 1 /end COMPU_METHOD
/begin COMPU_METHOD TrqPrp "Vortriebsmoment" RAT_FUNC "%6.3" "Nm" COEFFS 0 5 0 0 0 1 /end COMPU_METHOD
/begin COMPU_METHOD Trq_float "Motormoment" RAT_FUNC "%6.2" "Nm" COEFFS 0 1 0 0 0 1 /end COMPU_METHOD
/begin COMPU_METHOD Vel "Fahrzeuggeschwindigkeit, gleiche interne Auflösung wie Vel_SI" RAT_FUNC "%6.4" "km/h" COEFFS 0 100 0 0 0 1 /end COMPU_METHOD
/begin COMPU_METHOD Vol "Volumen" RAT_FUNC "%6.4" "l" COEFFS 0 100 0 0 0 1 /end COMPU_METHOD
/begin COMPU_METHOD Volt "Spannung in V (von ADC)" RAT_FUNC "%6.2" "mV" COEFFS 0 0.2046 0 0 0 1 /end COMPU_METHOD
/begin COMPU_METHOD Volt_Batt "Batteriespannung" RAT_FUNC "%6.1" "mV" COEFFS 0 0.05115 0 0 0 1 /end COMPU_METHOD
/begin COMPU_METHOD default "" RAT_FUNC "%6.2" "-" COEFFS 0 1 0 0 0 1 /end COMPU_METHOD
/begin RECORD_LAYOUT Kf_Xs16_Ys16_Ws16 NO_AXIS_PTS_X 1 SWORD NO_AXIS_PTS_Y 2 SWORD AXIS_PTS_X 3 SWORD INDEX_INCR DIRECT AXIS_PTS_Y 4 SWORD INDEX_INCR DIRECT FNC_VALUES 5 SWORD COLUMN_DIR DIRECT /end RECORD_LAYOUT
/begin RECORD_LAYOUT Kl_Xs16_Ws16 NO_AXIS_PTS_X 1 SWORD AXIS_PTS_X 2 SWORD INDEX_INCR DIRECT FNC_VALUES 3 SWORD COLUMN_DIR DIRECT /end RECORD_LAYOUT
/begin RECORD_LAYOUT Kwb_Ws16 FNC_VALUES 1 SWORD COLUMN_DIR DIRECT /end RECORD_LAYOUT
/begin RECORD_LAYOUT Kwb_Wu16 FNC_VALUES 1 UWORD COLUMN_DIR DIRECT /end RECORD_LAYOUT
/begin RECORD_LAYOUT Kwb_Wu32 FNC_VALUES 1 ULONG COLUMN_DIR DIRECT /end RECORD_LAYOUT
/begin RECORD_LAYOUT Kwb_Wu8 FNC_VALUES 1 UBYTE COLUMN_DIR DIRECT /end RECORD_LAYOUT
/begin RECORD_LAYOUT Kw_Wr32 FNC_VALUES 1 FLOAT32_IEEE COLUMN_DIR DIRECT /end RECORD_LAYOUT
/begin RECORD_LAYOUT Kw_Ws16 FNC_VALUES 1 SWORD COLUMN_DIR DIRECT /end RECORD_LAYOUT
/begin RECORD_LAYOUT Kw_Ws32 FNC_VALUES 1 SLONG COLUMN_DIR DIRECT /end RECORD_LAYOUT
/begin RECORD_LAYOUT Kw_Wu16 FNC_VALUES 1 UWORD COLUMN_DIR DIRECT /end RECORD_LAYOUT
/begin RECORD_LAYOUT Kw_Wu32 FNC_VALUES 1 ULONG COLUMN_DIR DIRECT /end RECORD_LAYOUT
/begin RECORD_LAYOUT Kw_Wu8 FNC_VALUES 1 UBYTE COLUMN_DIR DIRECT /end RECORD_LAYOUT
/end MODULE
/end PROJECT
