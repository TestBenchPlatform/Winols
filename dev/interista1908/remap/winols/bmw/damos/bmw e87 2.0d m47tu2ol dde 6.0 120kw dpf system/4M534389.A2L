ASAP2_VERSION 1 3
/begin PROJECT P389 "BMW DDE6.0 4-Zylinder V53.4 01.04.2004 CAN12H"
/begin HEADER "" VERSION "V53.4_4Z_CAN12H" PROJECT_NO P389 /end HEADER
/begin MODULE DIM ""
/begin MOD_COMMON "" BYTE_ORDER MSB_FIRST ALIGNMENT_BYTE 1 ALIGNMENT_WORD 2 ALIGNMENT_LONG 4 ALIGNMENT_FLOAT32_IEEE 4 /end MOD_COMMON
/begin CHARACTERISTIC CrSCD_numGlFilter_C "Wert Glitch Filter (MCy315)" VALUE 0xC0635 Kw_Wu8 3.000 OneToOne 0.00 3.000 FORMAT "%5.3" EXTENDED_LIMITS 0.00 255.0 /end CHARACTERISTIC
/begin CHARACTERISTIC CrSCD_numThresCtlHigh_C "obere Schwelle (MCy315)" VALUE 0xC0636 Kw_Wu8 7.000 OneToOne 0.00 7.000 FORMAT "%5.3" EXTENDED_LIMITS 0.00 255.0 /end CHARACTERISTIC
/begin CHARACTERISTIC CrSCD_numThresCtlLow_C "untere Schwelle (MCy315)" VALUE 0xC0637 Kw_Wu8 7.000 OneToOne 0.00 7.000 FORMAT "%5.3" EXTENDED_LIMITS 0.00 255.0 /end CHARACTERISTIC
/begin CHARACTERISTIC InjVlv_iLvlHi1_C "#SSD Oberes Stromniveau 1 (Boosterstrom)" VAL_BLK 0xC0638 Kwb_Wu16 30.00000 UC_Curr 0.00 30.00000 FORMAT "%8.5" EXTENDED_LIMITS 0.00 6553.500 NUMBER 4 /end CHARACTERISTIC
/begin CHARACTERISTIC InjVlv_iLvlHi2_C "#SSD Oberes Stromniveau 2 (Anzugstrom)" VAL_BLK 0xC0640 Kwb_Wu16 30.00000 UC_Curr 0.00 30.00000 FORMAT "%8.5" EXTENDED_LIMITS 0.00 6553.500 NUMBER 4 /end CHARACTERISTIC
/begin CHARACTERISTIC InjVlv_iLvlHi3_C "Oberes Stromniveau 3 (Haltestrom)" VAL_BLK 0xC0648 Kwb_Wu16 30.00000 UC_Curr 0.00 30.00000 FORMAT "%8.5" EXTENDED_LIMITS 0.00 6553.500 NUMBER 4 /end CHARACTERISTIC
/begin CHARACTERISTIC InjVlv_iLvlLo1_C "Unteres Stromniveau 1 (Boosterstrom)" VAL_BLK 0xC0650 Kwb_Wu16 30.00000 UC_Curr 0.00 30.00000 FORMAT "%8.5" EXTENDED_LIMITS 0.00 6553.500 NUMBER 4 /end CHARACTERISTIC
/begin CHARACTERISTIC InjVlv_iLvlLo2_C "Unteres Stromniveau 2 (Haltestrom)" VAL_BLK 0xC0658 Kwb_Wu16 30.00000 UC_Curr 0.00 30.00000 FORMAT "%8.5" EXTENDED_LIMITS 0.00 6553.500 NUMBER 4 /end CHARACTERISTIC
/begin CHARACTERISTIC InjVlv_iLvlLo3_C "Unteres Stromniveau 3 (Haltestrom)" VAL_BLK 0xC0660 Kwb_Wu16 30.00000 UC_Curr 0.00 30.00000 FORMAT "%8.5" EXTENDED_LIMITS 0.00 6553.500 NUMBER 4 /end CHARACTERISTIC
/begin CHARACTERISTIC InjVlv_iThresMax_C "Schwelle für Überstromerkennung" VALUE 0xC0668 Kw_Wu16 30.00000 UC_Curr 0.00 30.00000 FORMAT "%8.5" EXTENDED_LIMITS 0.00 6553.500 /end CHARACTERISTIC
/begin CHARACTERISTIC InjVlv_stInj_C "#SSD interne Einspritzbefehlsfolge des CY33x" VAL_BLK 0xC066A Kwb_Wu16 255.0000 OneToOne 0.00 255.0000 FORMAT "%8.4" EXTENDED_LIMITS 0.00 65535.00 NUMBER 16 /end CHARACTERISTIC
/begin CHARACTERISTIC InjVlv_stRatRchgOff_C "#SSD PWM zum automatischen Unterbrechen des Nachladens, um Bootstrap-C am HS-Treiber nachzuladen" VALUE 0xC068A Kw_Wu16 255.0000 OneToOne 0.00 255.0000 FORMAT "%8.4" EXTENDED_LIMITS 0.00 65535.00 /end CHARACTERISTIC
/begin CHARACTERISTIC InjVlv_stRegCfg_C "#SSD Inhalt des CY33x CFG Registers (SMR- / RCHG- / LS- mode)" VALUE 0xC068C Kw_Wu16 255.0000 OneToOne 0.00 255.0000 FORMAT "%8.4" EXTENDED_LIMITS 0.00 65535.00 /end CHARACTERISTIC
/begin CHARACTERISTIC InjVlv_stRegDcc_C "#SSD Inhalt des CY33x DCC registers (enable / err / I low / I high / I max)" VALUE 0xC068E Kw_Wu16 255.0000 OneToOne 0.00 255.0000 FORMAT "%8.4" EXTENDED_LIMITS 0.00 65535.00 /end CHARACTERISTIC
/begin CHARACTERISTIC InjVlv_stRegDmsk_C "#SSD Inhalt des CY33x DMSK Registers (Stromniveau 1-3 / Differenzstrom 1-3 / Umin )" VALUE 0xC0690 Kw_Wu16 255.0000 OneToOne 0.00 255.0000 FORMAT "%8.4" EXTENDED_LIMITS 0.00 65535.00 /end CHARACTERISTIC
/begin CHARACTERISTIC InjVlv_stRegMode_C "#SSD Inhalt des CY33x Mode Registers ( CP / CP1 / CP2 / 1-2 Bank )" VALUE 0xC0692 Kw_Wu16 255.0000 OneToOne 0.00 255.0000 FORMAT "%8.4" EXTENDED_LIMITS 0.00 65535.00 /end CHARACTERISTIC
/begin CHARACTERISTIC InjVlv_stTiBstErrMax_C "#SSD maximal zulässige Zeit einer Boosterphase" VALUE 0xC0694 Kw_Wu16 63.00000 OneToOne 0.00 63.00000 FORMAT "%8.5" EXTENDED_LIMITS 0.00 65535.00 /end CHARACTERISTIC
/begin CHARACTERISTIC InjVlv_stTiBstErrMin_C "#SSD minimale Zeit bis ein Stromanstieg während einer Boosterphase erkannt sein muss" VALUE 0xC0696 Kw_Wu16 63.00000 OneToOne 0.00 63.00000 FORMAT "%8.5" EXTENDED_LIMITS 0.00 65535.00 /end CHARACTERISTIC
/begin CHARACTERISTIC InjVlv_stTiCY330Del_C "#SSD Interne Wartezeit des CY33x für Schnellöschprüfung" VALUE 0xC0698 Kw_Wu16 63.00000 OneToOne 0.00 63.00000 FORMAT "%8.5" EXTENDED_LIMITS 0.00 65535.00 /end CHARACTERISTIC
/begin CHARACTERISTIC InjVlv_stTiDelAftFastIDec_C "#SSD Wartezeit vor Beginn der Messung der Schnellöschzeit" VALUE 0xC069A Kw_Wu16 63.00000 OneToOne 0.00 63.00000 FORMAT "%8.5" EXTENDED_LIMITS 0.00 65535.00 /end CHARACTERISTIC
/begin CHARACTERISTIC InjVlv_stTiDelAftRchg_C "#SSD Wartezeit, bevor ein neuer Nachladepuls gestartet wird" VALUE 0xC069C Kw_Wu16 63.00000 OneToOne 0.00 63.00000 FORMAT "%8.5" EXTENDED_LIMITS 0.00 65535.00 /end CHARACTERISTIC
/begin CHARACTERISTIC InjVlv_stTiDelBefLSMode_C "#SSD Wartezeit bevor der LS mode aktiviert wird (für CRIPx: Stromunterdrückung nach Einspritzung)" VALUE 0xC069E Kw_Wu16 63.00000 OneToOne 0.00 63.00000 FORMAT "%8.5" EXTENDED_LIMITS 0.00 65535.00 /end CHARACTERISTIC
/begin CHARACTERISTIC InjVlv_stTiFastIDecErrMax_C "#SSD maximal zulässige Zeit für eine Schnellöschung" VALUE 0xC06A0 Kw_Wu16 63.00000 OneToOne 0.00 63.00000 FORMAT "%8.5" EXTENDED_LIMITS 0.00 65535.00 /end CHARACTERISTIC
/begin CHARACTERISTIC InjVlv_stTiInjMax_C "#SSD maximal zulässige Zeit für aktives ON-Signal" VALUE 0xC06A2 Kw_Wu16 255.0000 OneToOne 0.00 255.0000 FORMAT "%8.4" EXTENDED_LIMITS 0.00 65535.00 /end CHARACTERISTIC
/begin CHARACTERISTIC InjVlv_stTiMaxRchg_C "#SSD CY331 : max. zulaessige Zeit für einen Rechargepuls" VALUE 0xC06A4 Kw_Wu16 63.00000 OneToOne 0.00 63.00000 FORMAT "%8.5" EXTENDED_LIMITS 0.00 65535.00 /end CHARACTERISTIC
/begin CHARACTERISTIC InjVlv_uCMax_C "#SSD CY33x : Schwelle für Boosterüberspannung" VALUE 0xC06A6 Kw_Wu16 80.00000 UC_Volt 0.00 80.00000 FORMAT "%8.5" EXTENDED_LIMITS 0.00 6553.500 /end CHARACTERISTIC
/begin CHARACTERISTIC InjVlv_uCMin_C "#SSD (Adr:0x31)CY33x : Schwelle für Booster-Voltage-Error" VALUE 0xC06A8 Kw_Wu16 80.00000 UC_Volt 0.00 80.00000 FORMAT "%8.5" EXTENDED_LIMITS 0.00 6553.500 /end CHARACTERISTIC
/begin CHARACTERISTIC InjVlv_uCSetPoint_C "#SSD Sollspannung des Boosterkondensators" VALUE 0xC06AA Kw_Wu16 80.00000 UC_Volt 0.00 80.00000 FORMAT "%8.5" EXTENDED_LIMITS 0.00 6553.500 /end CHARACTERISTIC
/begin CHARACTERISTIC InjVlv_uCThresBstStop_C "#SSD wenn die Boosterkondensatorspannung unter diese Schwelle fällt, wird eine Boosterphase beendet" VALUE 0xC06AC Kw_Wu16 80.00000 UC_Volt 0.00 80.00000 FORMAT "%8.5" EXTENDED_LIMITS 0.00 6553.500 /end CHARACTERISTIC
/begin CHARACTERISTIC LIGov_tiCldCltchDT1_C "Koeffizient D-Glied (T)" VALUE 0xE3D10 Kw_Wu32 4294.9673 TimeDelay_s 0.0000010000000 4294.9673 FORMAT "%9.4" /end CHARACTERISTIC
/begin CHARACTERISTIC LIGov_CldCltchDKd_C "Koeffizient D-Glied (K)" VALUE 0xE3D14 Kw_Ws32 6553.59999847 Kd_rpm2Nm -3276.80000000 3276.79999847 FORMAT "%13.8" /end CHARACTERISTIC
/begin CHARACTERISTIC LIGov_dnLimHighTrm_C "obere dn-Grenze für Abgleich" VALUE 0xE3AE0 Kw_Ws16 65535.00 EngN -32768.00 32767.00 FORMAT "%8.2" /end CHARACTERISTIC
/begin CHARACTERISTIC LIGov_dnLimLowTrm_C "untere dn-Grenze für Abgleich" VALUE 0xE3AE2 Kw_Ws16 65535.00 EngN -32768.00 32767.00 FORMAT "%8.2" /end CHARACTERISTIC
/begin CHARACTERISTIC LIGov_nDeltaSec_C "#SSD Delta allgemein zu Drehzahlschwelle Sicherheitsrampe" VALUE 0xE3AE4 Kw_Ws16 32767.00 EngN 0.00 32767.00 FORMAT "%8.2" EXTENDED_LIMITS -32768.00 32767.00 /end CHARACTERISTIC
/begin CHARACTERISTIC LIGov_nDiffDelta_C "#SSD Delta zur Drehzahlschwelle Sicherheitsrampe" VALUE 0xE3AE6 Kw_Ws16 32767.00 EngN 0.00 32767.00 FORMAT "%8.2" EXTENDED_LIMITS -32768.00 32767.00 /end CHARACTERISTIC
/begin CHARACTERISTIC LIGov_nHDC_C "Applizierbare LL-Solldrehzahl aufgrund HDC" VALUE 0xE3AE8 Kw_Ws16 32767.00 EngN 0.00 32767.00 FORMAT "%8.2" EXTENDED_LIMITS -32768.00 32767.00 /end CHARACTERISTIC
/begin CHARACTERISTIC LIGov_nLimHighOfs_C "Offset from the high engine speed limit for low-idle governor" VALUE 0xE3AEA Kw_Ws16 32767.00 EngN 0.00 32767.00 FORMAT "%8.2" EXTENDED_LIMITS -32768.00 32767.00 /end CHARACTERISTIC
/begin CHARACTERISTIC LIGov_nLimHighTrmAct_C "Überdrehzahllimit Trimmung für den Leerlaufregler" VALUE 0xE3AEC Kw_Ws16 65535.00 EngN -32768.00 32767.00 FORMAT "%8.2" /end CHARACTERISTIC
/begin CHARACTERISTIC LIGov_nRmpBaseDwn_C "Schrittweite der Rampe bei Absenkung LL-Solldrehzahl aus LL-Grundfunktion" VALUE 0xE3AEE Kw_Ws16 32767.00 dn_dZfine 0.00 32767.00 FORMAT "%8.2" EXTENDED_LIMITS -32768.00 32767.00 /end CHARACTERISTIC
/begin CHARACTERISTIC LIGov_nRmpBaseUp_C "Schrittweite der Rampe bei Erhöhung LL-Solldrehzahl aus LL-Grundfunktion" VALUE 0xE3AF0 Kw_Ws16 32767.00 dn_dZfine 0.00 32767.00 FORMAT "%8.2" EXTENDED_LIMITS -32768.00 32767.00 /end CHARACTERISTIC
/begin CHARACTERISTIC LIGov_nRmpCoEngDwn_C "Schrittweite der Rampe bei Absenkung LL-Solldrehzahl aus CoEng_nMin" VALUE 0xE3AF2 Kw_Ws16 32767.00 dn_dZfine 0.00 32767.00 FORMAT "%8.2" EXTENDED_LIMITS -32768.00 32767.00 /end CHARACTERISTIC
/begin CHARACTERISTIC LIGov_nRmpCoEngUp_C "Schrittweite der Rampe bei Erhöhung LL-Solldrehzahl aus CoEng_nMin" VALUE 0xE3AF4 Kw_Ws16 32767.00 dn_dZfine 0.00 32767.00 FORMAT "%8.2" EXTENDED_LIMITS -32768.00 32767.00 /end CHARACTERISTIC
/begin CHARACTERISTIC LIGov_nRmpCutOutUp_C "Ramp by raising setpoint" VALUE 0xE3AF8 Kw_Wu32 65535999.9847 RmpEngN 0.00 65535999.9847 FORMAT "%13.4" /end CHARACTERISTIC
/begin CHARACTERISTIC LIGov_nRmpCutOutDwn_C "Ramp by lowing setpoint" VALUE 0xE3AFC Kw_Wu32 65535999.9847 RmpEngN 0.00 65535999.9847 FORMAT "%13.4" /end CHARACTERISTIC
/begin CHARACTERISTIC LIGov_nRmpGearbxDwn_C "Schrittweite der Rampe bei Absenkung LL-Solldrehzahl aus Getriebe" VALUE 0xE3B00 Kw_Ws16 32767.00 dn_dZfine 0.00 32767.00 FORMAT "%8.2" EXTENDED_LIMITS -32768.00 32767.00 /end CHARACTERISTIC
/begin CHARACTERISTIC LIGov_nRmpGearbxUp_C "Schrittweite der Rampe bei Absenkung LL-Solldrehzahl aus Getriebe" VALUE 0xE3B02 Kw_Ws16 32767.00 dn_dZfine 0.00 32767.00 FORMAT "%8.2" EXTENDED_LIMITS -32768.00 32767.00 /end CHARACTERISTIC
/begin CHARACTERISTIC LIGov_nRmpHDCDwn_C "Drehzahl Rampenschritt für HDC Eingriff - fallende Drehzahl" VALUE 0xE3B04 Kw_Ws16 32767.00 dn_dZfine 0.00 32767.00 FORMAT "%8.2" EXTENDED_LIMITS -32768.00 32767.00 /end CHARACTERISTIC
/begin CHARACTERISTIC LIGov_nRmpHDCUp_C "Drehzahl Rampenschrittweite des HDC-Eingriffes - steigende Drehzahl" VALUE 0xE3B06 Kw_Ws16 32767.00 dn_dZfine 0.00 32767.00 FORMAT "%8.2" EXTENDED_LIMITS -32768.00 32767.00 /end CHARACTERISTIC
/begin CHARACTERISTIC LIGov_nRmpPwrMngDwn_C "Schrittweite der Rampe bei Absenkung LL-Solldrehzahl aus Getriebe" VALUE 0xE3B08 Kw_Ws16 32767.00 dn_dZfine 0.00 32767.00 FORMAT "%8.2" EXTENDED_LIMITS -32768.00 32767.00 /end CHARACTERISTIC
/begin CHARACTERISTIC LIGov_nRmpPwrMngUp_C "Schrittweite der Rampe bei Absenkung LL-Solldrehzahl aus PwrMng" VALUE 0xE3B0A Kw_Ws16 32767.00 dn_dZfine 0.00 32767.00 FORMAT "%8.2" EXTENDED_LIMITS -32768.00 32767.00 /end CHARACTERISTIC
/begin CHARACTERISTIC LIGov_nRmpSecDelta_C "Schrittweite der SicherheitsRampe bei Erhöhung LL-Solldrehzahl" VALUE 0xE3B0C Kw_Ws16 32767.00 dn_dZfine 0.00 32767.00 FORMAT "%8.2" EXTENDED_LIMITS -32768.00 32767.00 /end CHARACTERISTIC
/begin CHARACTERISTIC LIGov_nRmpSurgeDwn_C "Schrittweite der Rampe bei Absenkung LL-Solldrehzahl aus AntiSurge" VALUE 0xE3B0E Kw_Ws16 32767.00 dn_dZfine 0.00 32767.00 FORMAT "%8.2" EXTENDED_LIMITS -32768.00 32767.00 /end CHARACTERISTIC
/begin CHARACTERISTIC LIGov_nRmpSurgeUp_C "Schrittweite der Rampe bei Erhöhung LL-Solldrehzahl aus AntiSurge" VALUE 0xE3B10 Kw_Ws16 32767.00 dn_dZfine 0.00 32767.00 FORMAT "%8.2" EXTENDED_LIMITS -32768.00 32767.00 /end CHARACTERISTIC
/begin CHARACTERISTIC LIGov_nSetpointDia_C "Sollwert des LLR über Diagnoseschnittstelle" VALUE 0xE3B12 Kw_Ws16 32767.00 EngN 0.00 32767.00 FORMAT "%8.2" EXTENDED_LIMITS -32768.00 32767.00 /end CHARACTERISTIC
/begin CHARACTERISTIC LIGov_nSetpointDriveAway_C "LL-Solldrehzahl Fahrzeug fährt (V > 0)" VALUE 0xE3B14 Kw_Ws16 65535.00 EngN -32768.00 32767.00 FORMAT "%8.2" /end CHARACTERISTIC
/begin CHARACTERISTIC LIGov_nSetpointInit2_MAP "Initialisierungskennfeld des Leerlaufreglers - abhängig von der Kühlmitteltemperatur und dem Atmosphärendruck" MAP 0xE3B16 Kf_Xs16_Ys16_Ws16 6000.000 EngN 0.00 6000.000 FORMAT "%8.3" EXTENDED_LIMITS -32768.00 32767.00
 /begin AXIS_DESCR STD_AXIS CTSCD_tClnt Temp_Cels 8 -50.1400 199.8600 FORMAT "%8.4" EXTENDED_LIMITS -3549.940 3003.560 DEPOSIT ABSOLUTE /end AXIS_DESCR
 /begin AXIS_DESCR STD_AXIS APSCD_pVal Pres_hPa 8 0.00 3500.0000 FORMAT "%8.4" EXTENDED_LIMITS -32768.00 32767.00 DEPOSIT ABSOLUTE /end AXIS_DESCR
/end CHARACTERISTIC
/begin CHARACTERISTIC LIGov_nSetpointInit_MAP "Initialisierungskennfeld zur Berechnung der Leerlaufsolldrehzahl" MAP 0xE3BBA Kf_Xs16_Ys16_Ws16 6000.000 EngN 0.00 6000.000 FORMAT "%8.3" EXTENDED_LIMITS -32768.00 32767.00
 /begin AXIS_DESCR STD_AXIS CTSCD_tClnt Temp_Cels 8 -50.1400 199.8600 FORMAT "%8.4" EXTENDED_LIMITS -3549.940 3003.560 DEPOSIT ABSOLUTE /end AXIS_DESCR
 /begin AXIS_DESCR STD_AXIS APSCD_pVal Pres_hPa 8 0.00 3500.0000 FORMAT "%8.4" EXTENDED_LIMITS -32768.00 32767.00 DEPOSIT ABSOLUTE /end AXIS_DESCR
/end CHARACTERISTIC
/begin CHARACTERISTIC LIGov_nSetpointTrmLim_C "Schwelle für LL-Drehzahlanhebungserkennung" VALUE 0xE3C5E Kw_Ws16 65535.00 EngN -32768.00 32767.00 FORMAT "%8.2" /end CHARACTERISTIC
/begin CHARACTERISTIC LIGov_nSetpointTrm_C "Ersatzwert für LL-Drehzahlanhebung" VALUE 0xE3C60 Kw_Ws16 65535.00 EngN -32768.00 32767.00 FORMAT "%8.2" /end CHARACTERISTIC
/begin CHARACTERISTIC LIGov_nSetPointWarm_C "LL-Solldrehzahl Fahrzeug steht / warmer Motor" VALUE 0xE3C62 Kw_Ws16 65535.00 EngN -32768.00 32767.00 FORMAT "%8.2" /end CHARACTERISTIC
/begin CHARACTERISTIC LIGov_nSetpoint_Vector "#SSD Bypass label, nicht editieren" VALUE 0xC312A Kw_Wu8 255.0 OneToOne 0.00 255.0 FORMAT "%5.1" /end CHARACTERISTIC
/begin CHARACTERISTIC LIGov_nSetpoint_Channel "Bypass Label, nicht editieren!" VALUE 0xC312B Kw_Wu8 255.0 OneToOne 0.00 255.0 FORMAT "%5.1" /end CHARACTERISTIC
/begin CHARACTERISTIC LIGov_stActiveHDC_C "Applizierbarer Zustand für aktivierte LL-Solldrehzahl aufgrund HDC" VALUE 0xE3C64 Kw_Wu8 3.000 OneToOne 0.00 3.000 FORMAT "%5.3" EXTENDED_LIMITS 0.00 255.0 /end CHARACTERISTIC
/begin CHARACTERISTIC LIGov_stReleaseHDC_C "Bitweises Freischalten der LL-Solldrehzahl aufgrund HDC über CAN" VALUE 0xE3C65 Kw_Wu8 127.0 OneToOne 0.00 127.0 FORMAT "%5.1" EXTENDED_LIMITS 0.00 255.0 /end CHARACTERISTIC
/begin CHARACTERISTIC LIGov_swtGear_C "Konstante zur Auswahl des Initialisierungsfeldes der Leerlaufdrehzahl" VALUE 0xE3C66 Kw_Wu8 255.0 OneToOne 0.00 255.0 FORMAT "%5.1" /end CHARACTERISTIC
/begin CHARACTERISTIC LIGov_tiTW_C "Zeit nach Start für T_W-abh. LL-Solldrehzahl" VALUE 0xE3C68 Kw_Wu16 655.3500 Time_s 0.00 655.3500 FORMAT "%8.4" /end CHARACTERISTIC
/begin CHARACTERISTIC LIGov_trqInitI_MAP "Kennfeld zur integrator Initialisierung" MAP 0xE3C6A Kf_Xs16_Ys16_Ws16 400.0000 Trq 0.00 400.0000 FORMAT "%8.4" EXTENDED_LIMITS -3276.800 3276.700
 /begin AXIS_DESCR STD_AXIS CTSCD_tClnt Temp_Cels 8 -50.1400 899.8600 FORMAT "%8.4" EXTENDED_LIMITS -3549.940 3003.560 DEPOSIT ABSOLUTE /end AXIS_DESCR
 /begin AXIS_DESCR STD_AXIS APSCD_pVal Pres_hPa 8 0.00 3500.000 FORMAT "%8.3" EXTENDED_LIMITS -32768.00 32767.00 DEPOSIT ABSOLUTE /end AXIS_DESCR
/end CHARACTERISTIC
/begin CHARACTERISTIC LIGov_trq_Vector "#SSD Bypasslabel, nicht editieren!" VALUE 0xC312C Kw_Wu8 255.0 OneToOne 0.00 255.0 FORMAT "%5.1" /end CHARACTERISTIC
/begin CHARACTERISTIC LIGov_trq_Channel "#SSD Bypasslabel, nicht editieren!" VALUE 0xC312D Kw_Wu8 255.0 OneToOne 0.00 255.0 FORMAT "%5.1" /end CHARACTERISTIC
/begin CHARACTERISTIC LIGov_tiWrmCltchDT1_C "Koeffizient D-Glied (T)" VALUE 0xE3D18 Kw_Wu32 4294.9673 TimeDelay_s 0.0000010000000 4294.9673 FORMAT "%9.4" /end CHARACTERISTIC
/begin CHARACTERISTIC LIGov_WrmCltchDKd_C "Koeffizient D-Glied (K)" VALUE 0xE3D1C Kw_Ws32 6553.59999847 Kd_rpm2Nm -3276.80000000 3276.79999847 FORMAT "%13.8" /end CHARACTERISTIC
/begin CHARACTERISTIC LPACD_ctPwrStgOnMax_C "Maximale Anzahl der Endstufenaktivierung im Fehlerfall" VALUE 0xE3D20 Kw_Wu16 65535.00 OneToOne 0.00 65535.00 FORMAT "%8.2" /end CHARACTERISTIC
/begin CHARACTERISTIC LPACD_DebExcTempDef_C "Fehlerentprellzeit fuer Uebertemperatur" VALUE 0xE3D22 Kw_Wu16 655350.0 Time_ms 0.00 655350.0 FORMAT "%8.1" /end CHARACTERISTIC
/begin CHARACTERISTIC LPACD_DebExcTempOk_C "Heilungsentprellzeit fuer Uebertemperatur" VALUE 0xE3D24 Kw_Wu16 655350.0 Time_ms 0.00 655350.0 FORMAT "%8.1" /end CHARACTERISTIC
/begin CHARACTERISTIC LPACD_DebNoLoadDef_C "Fehlerentprellzeit fuer Lastabfall" VALUE 0xE3D26 Kw_Wu16 655350.0 Time_ms 0.00 655350.0 FORMAT "%8.1" /end CHARACTERISTIC
/begin CHARACTERISTIC LPACD_DebNoLoadOk_C "Heilungsentprellzeit fuer Lastabfall" VALUE 0xE3D28 Kw_Wu16 655350.0 Time_ms 0.00 655350.0 FORMAT "%8.1" /end CHARACTERISTIC
/begin CHARACTERISTIC LPACD_DebShortCircBatDef_C "Fehlerentprellzeit fuer Kurzschluss nach Batteriespannung" VALUE 0xE3D2A Kw_Wu16 655350.0 Time_ms 0.00 655350.0 FORMAT "%8.1" /end CHARACTERISTIC
/begin CHARACTERISTIC LPACD_DebShortCircBatOk_C "Heilungsentprellzeit fuer Kurzschluss nach Batteriespannung" VALUE 0xE3D2C Kw_Wu16 655350.0 Time_ms 0.00 655350.0 FORMAT "%8.1" /end CHARACTERISTIC
/begin CHARACTERISTIC LPACD_DebShortCircGndDef_C "Fehlerentprellzeit fuer Kurzschluss nach Masse" VALUE 0xE3D2E Kw_Wu16 655350.0 Time_ms 0.00 655350.0 FORMAT "%8.1" /end CHARACTERISTIC
/begin CHARACTERISTIC LPACD_DebShortCircGndOk_C "Heilungsentprellzeit fuer Kurzschluss nach Masse" VALUE 0xE3D30 Kw_Wu16 655350.0 Time_ms 0.00 655350.0 FORMAT "%8.1" /end CHARACTERISTIC
/begin CHARACTERISTIC LPACD_numDia_C "Parameter fuer Hardware Diagnose-Pin Auswahl" VALUE 0xE3D32 Kw_Wu8 27.0000000000 NumPinDia 0.00 27.0000000000 FORMAT "%13.10" /end CHARACTERISTIC
/begin CHARACTERISTIC LPACD_numPwmOut_C "Parameter fuer Hardware Endstufen-Pin Auswahl" VALUE 0xE3D33 Kw_Wu8 12.0000000000 NumPinPwmOut 0.00 12.0000000000 FORMAT "%13.10" /end CHARACTERISTIC
/begin CHARACTERISTIC LPACD_stInvOut_C "Invertierungsparameter fuer das Signal der Ladedruckstellerendstufe" VALUE 0xE3D34 Kw_Wu8 1.000 OneToOne 0.00 1.000 FORMAT "%5.3" EXTENDED_LIMITS 0.00 255.0 /end CHARACTERISTIC
/begin CHARACTERISTIC LPACD_tiPer_C "Periodendauer des Ladedruckstellers" VALUE 0xE3D36 Kw_Ws16 6553.500 Period -3276.800 3276.700 FORMAT "%8.3" /end CHARACTERISTIC
/begin CHARACTERISTIC LPACD_rCnv_CUR "Kennlinie zur Konvertierung von Oeffnungsgrad in Tastverhaeltnis" CURVE 0xE3D38 Kl_Xs16_Ws16 100.0000 DtyCyc 0.00 100.0000 FORMAT "%8.4" EXTENDED_LIMITS -327.6800 327.6700
 /begin AXIS_DESCR STD_AXIS BPA_rLPACD Prc 25 -100.0000 200.0000 FORMAT "%8.4" EXTENDED_LIMITS -400.0000 399.9878 DEPOSIT ABSOLUTE /end AXIS_DESCR
/end CHARACTERISTIC
/begin CHARACTERISTIC LPACD_rOutMax_C "Maximal auszugebendes Tastverhaeltnis" VALUE 0xE3D9E Kw_Ws16 655.3500 DtyCyc -327.6800 327.6700 FORMAT "%8.4" /end CHARACTERISTIC
/begin CHARACTERISTIC LPACD_rOutMin_C "Minimal auszugebendes Tastverhaeltnis" VALUE 0xE3DA0 Kw_Ws16 655.3500 DtyCyc -327.6800 327.6700 FORMAT "%8.4" /end CHARACTERISTIC
/begin CHARACTERISTIC LPACD_stPwrStgActv_C "Aktivierung der Abschaltbedingungen der Endstufe" VALUE 0xE3DA2 Kw_Wu8 255.0 OneToOne 0.00 255.0 FORMAT "%5.1" /end CHARACTERISTIC
/begin CHARACTERISTIC LPACD_stPwrStgDia_C "Aktivierung der Abschaltbedingungen der Endstufendiagnose" VALUE 0xE3DA3 Kw_Wu8 255.0 OneToOne 0.00 255.0 FORMAT "%5.1" /end CHARACTERISTIC
/begin CHARACTERISTIC LPACD_stSPICtl_C "Status ob Endstufe SPI = 1 oder nicht SPI = 0 ist" VALUE 0xE3DA4 Kw_Wu8 1.000 OneToOne 0.00 1.000 FORMAT "%5.3" EXTENDED_LIMITS 0.00 255.0 /end CHARACTERISTIC
/begin CHARACTERISTIC LPACD_swt_C "Schalter fuer Batteriespannungskorrektur (0 = AUS, 1 = EIN)" VALUE 0xE3DA5 Kw_Wu8 255.0 OneToOne 0.00 255.0 FORMAT "%5.1" /end CHARACTERISTIC
/begin CHARACTERISTIC LPACD_tiBtwTst_C "Zeitabstand, in dem im Fehlerfall die Endstufe getestet wird" VALUE 0xE3DA6 Kw_Wu16 29980.00 Time_ms 20.00000 30000.00 FORMAT "%8.2" EXTENDED_LIMITS 0.00 655350.0 /end CHARACTERISTIC
/begin CHARACTERISTIC LPACD_tiPwrStgOn_C "Zeit für die Endstufe aktiviert wird, wenn keine SPI Endstufe" VALUE 0xE3DA8 Kw_Wu16 655140.0 Time_ms 0.00 655140.0 FORMAT "%8.1" EXTENDED_LIMITS 0.00 655350.0 /end CHARACTERISTIC
/begin CHARACTERISTIC LSUCD_tiAdptFltInit_C "Zeitkonstante Adaptionsfilter für nicht adaptierten Zustand" VALUE 0xE3E84 Kw_Wu32 4294.9673 TimeDelay_s 0.0000010000000 4294.9673 FORMAT "%9.4" /end CHARACTERISTIC
/begin CHARACTERISTIC LSUCD_tiAdptFlt_C "Zeitkonstante Adaptionsfilter für adaptierten Zustand" VALUE 0xE3E88 Kw_Wu32 4294.9673 TimeDelay_s 0.0000010000000 4294.9673 FORMAT "%9.4" /end CHARACTERISTIC
/begin CHARACTERISTIC LSUCD_d2rInit_C "Initialisierungswert Bewertungsfilter" VALUE 0xE3E8C Kw_Ws16 0.6553500 O2 -0.3276800 0.3276700 FORMAT "%9.7" /end CHARACTERISTIC
/begin CHARACTERISTIC LSUCD_dcycMinGrad_C "Minimale Änderung des Tastverhältnisses zur Freigabe der Diagnose der Heizungskopplung" VALUE 0xE4008 Kw_Ws16 655.3500 DtyCyc -327.6800 327.6700 FORMAT "%8.4" /end CHARACTERISTIC
/begin CHARACTERISTIC LSUCD_DebHtCoupDef_C "Fehlerentprellzeit für Heizungskopplung" VALUE 0xE400A Kw_Wu16 65535.00 OneToOne 0.00 65535.00 FORMAT "%8.2" /end CHARACTERISTIC
/begin CHARACTERISTIC LSUCD_DebHtCoupOk_C "Fehlerheilungszeit für Heizungskopplung" VALUE 0xE400C Kw_Wu16 65535.00 OneToOne 0.00 65535.00 FORMAT "%8.2" /end CHARACTERISTIC
/begin CHARACTERISTIC LSUCD_DebO2ClbDef_C "Defektentprellzähler für O2-Kalibrierungsfehler" VALUE 0xE3ED8 Kw_Wu16 65535.00 OneToOne 0.00 65535.00 FORMAT "%8.2" /end CHARACTERISTIC
/begin CHARACTERISTIC LSUCD_DebO2ClbOk_C "Heilungsentprellzähler für O2-Kalibrierungsfehler" VALUE 0xE3EDA Kw_Wu16 65535.00 OneToOne 0.00 65535.00 FORMAT "%8.2" /end CHARACTERISTIC
/begin CHARACTERISTIC LSUCD_DebRiClbDef_C "Defektentprellzähler des Ri-Kalibrierungsfehlers" VALUE 0xE3F9C Kw_Wu16 65535.00 OneToOne 0.00 65535.00 FORMAT "%8.2" /end CHARACTERISTIC
/begin CHARACTERISTIC LSUCD_DebRiClbOk_C "Heilungsentprellzähler des Ri-Kalibrierungsfehlers" VALUE 0xE3F9E Kw_Wu16 65535.00 OneToOne 0.00 65535.00 FORMAT "%8.2" /end CHARACTERISTIC
/begin CHARACTERISTIC LSUCD_DebWireIpDef_C "Defektentprellzähler der Nebenschlusserkennung" VALUE 0xE400E Kw_Wu16 65535.00 OneToOne 0.00 65535.00 FORMAT "%8.2" /end CHARACTERISTIC
/begin CHARACTERISTIC LSUCD_DebWireIpOk_C "Heilungsentprellzähler der Nebenschlusserkennung" VALUE 0xE4010 Kw_Wu16 65535.00 OneToOne 0.00 65535.00 FORMAT "%8.2" /end CHARACTERISTIC
/begin CHARACTERISTIC LSUCD_dmAirIKi_C "Verstärkung I-Regler bei Kleinsignalen" VALUE 0xE3E90 Kw_Wu32 5.00003807247 Ki 0.00 5.00003807247 FORMAT "%13.11" EXTENDED_LIMITS 0.00 999999.999767 READ_ONLY /end CHARACTERISTIC
/begin CHARACTERISTIC LSUCD_dmAirIKiPos_C "Verstärkung I-Regler bei positiven Großsignalen" VALUE 0xE3E94 Kw_Wu32 5.00003807247 Ki 0.00 5.00003807247 FORMAT "%13.11" EXTENDED_LIMITS 0.00 999999.999767 READ_ONLY /end CHARACTERISTIC
/begin CHARACTERISTIC LSUCD_dmAirIKiNeg_C "Verstärkung I-Regler bei negativen Großsignalen" VALUE 0xE3E98 Kw_Wu32 5.00003807247 Ki 0.00 5.00003807247 FORMAT "%13.11" EXTENDED_LIMITS 0.00 999999.999767 READ_ONLY /end CHARACTERISTIC
/begin CHARACTERISTIC LSUCD_dmAirIWinPos_C "Obere Kleinsignalgrenze für  den I-Regler" VALUE 0xE3E9C Kw_Ws16 250.0000 AirMassPerTime 223.0000 473.0000 FORMAT "%8.4" EXTENDED_LIMITS -3276.800 3276.700 READ_ONLY /end CHARACTERISTIC
/begin CHARACTERISTIC LSUCD_dmAirIWinNeg_C "Untere Kleinsignalgrenze für den I-Regler" VALUE 0xE3E9E Kw_Ws16 250.0000 AirMassPerTime 223.0000 473.0000 FORMAT "%8.4" EXTENDED_LIMITS -3276.800 3276.700 READ_ONLY /end CHARACTERISTIC
/begin CHARACTERISTIC LSUCD_dNumHtCoup_C "Anzahl der für ein signifikantes Resultat notwendigen Aktivierungen der Heizungskoplungsprüfung" VALUE 0xE4012 Kw_Wu16 65535.00 OneToOne 0.00 65535.00 FORMAT "%8.2" /end CHARACTERISTIC
/begin CHARACTERISTIC LSUCD_EvalMaxVal_C "Oberer Grenzwert für Lernfortschrittsbewertung" VALUE 0xE3EA0 Kw_Ws16 0.6553500 O2 -0.3276800 0.3276700 FORMAT "%9.7" /end CHARACTERISTIC
/begin CHARACTERISTIC LSUCD_EvalMinVal_C "Unterer Grenzwert für Lernfortschrittsbewertung" VALUE 0xE3EA2 Kw_Ws16 0.6553500 O2 -0.3276800 0.3276700 FORMAT "%9.7" /end CHARACTERISTIC
/begin CHARACTERISTIC LSUCD_tiEvalFltInit_C "Zeitkonstante Bewertungsfilter für nicht adaptierten Zustand" VALUE 0xE3EA4 Kw_Wu32 4294.9673 TimeDelay_s 0.0000010000000 4294.9673 FORMAT "%9.4" /end CHARACTERISTIC
/begin CHARACTERISTIC LSUCD_tiEvalFlt_C "Zeitkonstante Bewertungsfilter für adaptierten Zustand" VALUE 0xE3EA8 Kw_Wu32 4294.9673 TimeDelay_s 0.0000010000000 4294.9673 FORMAT "%9.4" /end CHARACTERISTIC
/begin CHARACTERISTIC LSUCD_facPresCompLean_CUR "#SSD Kennlinie für Druckkorrekturfaktor bei magerem Luft-Kraftstoff-Gemisch" CURVE 0xE3F44 Kl_Xs16_Ws16 7.999878 Fact -4.000000 3.999878 FORMAT "%8.6"
 /begin AXIS_DESCR STD_AXIS LSUCD_pExhGasLstVal_mp Pres_hPa 10 -32768.00 32767.00 FORMAT "%8.2" DEPOSIT ABSOLUTE /end AXIS_DESCR
/end CHARACTERISTIC
/begin CHARACTERISTIC LSUCD_facPresCompRich_CUR "#SSD Kennlinie für Druckkorrekturfaktor bei fettem Luft-Kraftstoff-Gemisch" CURVE 0xE3F6E Kl_Xs16_Ws16 7.999878 Fact -4.000000 3.999878 FORMAT "%8.6"
 /begin AXIS_DESCR STD_AXIS LSUCD_pExhGasLstVal_mp Pres_hPa 10 -32768.00 32767.00 FORMAT "%8.2" DEPOSIT ABSOLUTE /end AXIS_DESCR
/end CHARACTERISTIC
/begin CHARACTERISTIC LSUCD_mAirAdptActv_C "Minimalwert für Integral über Luftmassenstrom seit Schubbeginn für Aktivierung der Adaption" VAL_BLK 0xE3EAC Kwb_Ws16 6553.500 AirMass_2 -3276.800 3276.700 FORMAT "%8.3" NUMBER 1 /end CHARACTERISTIC
/begin CHARACTERISTIC LSUCD_stHtInvOut_C "Lambdas Sensor Heizerendstufe Invertierungsstatus" VALUE 0xE3EB4 Kw_Wu8 1.000 OneToOne 0.00 1.000 FORMAT "%5.3" EXTENDED_LIMITS 0.00 255.0 /end CHARACTERISTIC
/begin CHARACTERISTIC LSUCD_tiHtPer_C "#SSD Periodendauer PWM Signal Heizwiderstand Ansteuerung" VALUE 0xE3EB6 Kw_Ws16 6553.500 Period -3276.800 3276.700 FORMAT "%8.3" /end CHARACTERISTIC
/begin CHARACTERISTIC LSUCD_resRiMaxGrad_C "Maximale Änderung des Innenwiderstands zur Freigabe der Diagnose der Heizungskopplung" VALUE 0xE4014 Kw_Ws16 6553.500 Resist -3276.800 3276.700 FORMAT "%8.3" /end CHARACTERISTIC
/begin CHARACTERISTIC LSUCD_rO2IsolChkMax_C "Maximal zulässige Sauerstoffanzeige für kalte Sonde" VALUE 0xE4016 Kw_Ws16 0.6553500 O2 -0.3276800 0.3276700 FORMAT "%9.7" /end CHARACTERISTIC
/begin CHARACTERISTIC LSUCD_rO2IsolChkMin_C "Minimal zulässige Sauerstoffanzeige für kalte Sonde" VALUE 0xE4018 Kw_Ws16 0.6553500 O2 -0.3276800 0.3276700 FORMAT "%9.7" /end CHARACTERISTIC
/begin CHARACTERISTIC LSUCD_rO2SwtPresComp_C "Sauerstoffkonzentrationsgrenzwert für Umschaltung zwischen Druckkompensation für mageres und fettes Luft-Ktraftstoff-Gemisch" VALUE 0xE3F98 Kw_Ws16 0.6553500 O2 -0.3276800 0.3276700 FORMAT "%9.7" /end CHARACTERISTIC
/begin CHARACTERISTIC LSUCD_rO2_CUR "#SSD Kennlinie zur Umrechnung von Spannung in Sauerstoffkonzentration" CURVE 0xE3EDC Kl_Xs16_Ws16 0.6000000 O2 -0.3000000 0.3000000 FORMAT "%9.7" EXTENDED_LIMITS -0.3276800 0.3276700
 /begin AXIS_DESCR STD_AXIS LSUCD_uO2OfsCor_mp Volt 15 -1598.240 3998.045 FORMAT "%8.3" EXTENDED_LIMITS -160156.4 160151.5 DEPOSIT ABSOLUTE /end AXIS_DESCR
/end CHARACTERISTIC
/begin CHARACTERISTIC LSUCD_stCJ125CS_C "CJ125 chip select letzter Eintrag 0xC: LSU Funktionalität, 0xF: keine LSU Funktionalität" VAL_BLK 0xE4000 Kwb_Wu8 15.00 OneToOne 0.00 15.00 FORMAT "%5.2" EXTENDED_LIMITS 0.00 255.0 NUMBER 5 /end CHARACTERISTIC
/begin CHARACTERISTIC LSUCD_stCJChpSel_C "Applikationskonstante zur Auswahl von CJ120 (=0) oder CJ125 (=1)" VALUE 0xE3DD4 Kw_Wu16 1.000000 OneToOne 0.00 1.000000 FORMAT "%8.6" EXTENDED_LIMITS 0.00 65535.00 /end CHARACTERISTIC
/begin CHARACTERISTIC LSUCD_stPumpCtlDis_C "#SSD Maske zur Auswahl der Betriebsart abhängigen Abschaltbedingungen für den Pumpstromregler" VALUE 0xE3F9A Kw_Wu8 255.0 OneToOne 0.00 255.0 FORMAT "%5.1" /end CHARACTERISTIC
/begin CHARACTERISTIC LSUCD_stRefCurHigh_C "Applikationskonstante zur Konfiguration des hohen Referenzpumpstroms von 0 bis 150uA" VALUE 0xE4005 Kw_Wu8 15.0000000000 CurRefPump 0.00 15.0000000000 FORMAT "%13.10" /end CHARACTERISTIC
/begin CHARACTERISTIC LSUCD_stRefCurNormal_C "Applikationskonstante zur Konfiguration des normalen Referenzpumpstroms von 0 bis 150uA" VALUE 0xE4006 Kw_Wu8 15.0000000000 CurRefPump 0.00 15.0000000000 FORMAT "%13.10" /end CHARACTERISTIC
/begin CHARACTERISTIC LSUCD_stRgnEna_C "Applikationskonstante zur Aktivierung oder Deaktivierung der Regeneration" VALUE 0xE3DD6 Kw_Wu8 1.000 OneToOne 0.00 1.000 FORMAT "%5.3" EXTENDED_LIMITS 0.00 255.0 /end CHARACTERISTIC
/begin CHARACTERISTIC LSUCD_stWireDiaActv_C "Ansteuerungsflags für Diagnoseroutinen" VALUE 0xE401A Kw_Wu16 65535.00 OneToOne 0.00 65535.00 FORMAT "%8.2" /end CHARACTERISTIC
/begin CHARACTERISTIC LSUCD_swtAdptVal_C "Schalterwert für Adaption der Lambda-Sonde (0= keine Adaption/ 1=Adaption)" VALUE 0xE3EAE Kw_Wu8 1.000 OneToOne 0.00 1.000 FORMAT "%5.3" EXTENDED_LIMITS 0.00 255.0 /end CHARACTERISTIC
/begin CHARACTERISTIC LSUCD_swtAdptType_C "SW-Schaltertyp für Adaption der Lambda-Sonde (0=Datensatzwert, nicht applizierbar/1=EEPROM-Wert/2=Datensatzwert)" VALUE 0xE3EAF Kw_Wu8 0.00 OneToOne 2.000 2.000 FORMAT "%5.3" EXTENDED_LIMITS 0.00 255.0 /end CHARACTERISTIC
/begin CHARACTERISTIC LSUCD_tAirAdptActv_C "Maximale Lufttemperatur für Aktivierung der Adaption" VALUE 0xE3EB0 Kw_Ws16 950.000 Temp_Cels -50.140 899.860 FORMAT "%8.3" EXTENDED_LIMITS -3549.940 3003.560 /end CHARACTERISTIC
/begin CHARACTERISTIC LSUCD_tiHtCoupChk_C "Zeitdauer der Heizungsabschaltung für Diagnose der Heizungskopplung" VALUE 0xE401C Kw_Wu16 655.3500 Time_s 0.00 655.3500 FORMAT "%8.4" /end CHARACTERISTIC
/begin CHARACTERISTIC LSUCD_tiHtCoupPer_C "Zeitspanne zur Ansteuerung der Diagnose der Heizungskopplung" VALUE 0xE401E Kw_Wu16 655.3500 Time_s 0.00 655.3500 FORMAT "%8.4" /end CHARACTERISTIC
/begin CHARACTERISTIC LSUCD_tiIsolChkErr_C "Maximale Abkühlzeit LSU" VALUE 0xE4020 Kw_Wu16 655.3500 Time_s 0.00 655.3500 FORMAT "%8.4" /end CHARACTERISTIC
/begin CHARACTERISTIC LSUCD_tiIsolChkPer_C "Periodendauer zur Einschaltung des Pumpstroms zur Nebenschlusserkennung" VALUE 0xE4022 Kw_Wu16 655.3500 Time_s 0.00 655.3500 FORMAT "%8.4" /end CHARACTERISTIC
/begin CHARACTERISTIC LSUCD_tiIsolChkPump_C "Einschaltdauer für Pumpstrom bei Nebenschlusserkennung" VALUE 0xE4024 Kw_Wu16 655.3500 Time_s 0.00 655.3500 FORMAT "%8.4" /end CHARACTERISTIC
/begin CHARACTERISTIC LSUCD_tiO2ClbPT1_C "Filterzeitkonstante für Lernen Abgleichwert" VALUE 0xE3F1C Kw_Wu32 4294.9673 TimeDelay_s 0.0000010000000 4294.9673 FORMAT "%9.4" /end CHARACTERISTIC
/begin CHARACTERISTIC LSUCD_tiO2PT1_C "Filterzeitkonstante für O2 Rohwertfilterung" VALUE 0xE3F20 Kw_Wu32 4294.9673 TimeDelay_s 0.0000010000000 4294.9673 FORMAT "%9.4" /end CHARACTERISTIC
/begin CHARACTERISTIC LSUCD_tiOpnLdTstActv_C "Zeitdauer der Kabelunterbrechungsdiagnose am Anschluss Nernst-Zelle(UN) und virtuelle Masse(VM)" VALUE 0xE4030 Kw_Wu16 655.3500 Time_s 0.00 655.3500 FORMAT "%8.4" /end CHARACTERISTIC
/begin CHARACTERISTIC LSUCD_tiRiClbPT1_C "Zeitkonstante Ri Abgleichfilter" VALUE 0xE3FA0 Kw_Wu32 4294.9673 TimeDelay_s 0.0000010000000 4294.9673 FORMAT "%9.4" /end CHARACTERISTIC
/begin CHARACTERISTIC LSUCD_tiRiMeasDisa_C "Zeitdauer der Abschaltung der Ri-Messfrequenz" VALUE 0xE4032 Kw_Wu16 655.3500 Time_s 0.00 655.3500 FORMAT "%8.4" /end CHARACTERISTIC
/begin CHARACTERISTIC LSUCD_tiRiPT1_C "Zeitkonstante Ri Filter" VALUE 0xE3FA4 Kw_Wu32 4294.9673 TimeDelay_s 0.0000010000000 4294.9673 FORMAT "%9.4" /end CHARACTERISTIC
/begin CHARACTERISTIC LSUCD_tRi_CUR "#SSD Kennlinie zur Umrechnung des Innenwiderstands auf Äquivalenztemperatur" CURVE 0xE3FA8 Kl_Xs16_Ws16 950.000 Temp_Cels -50.140 899.860 FORMAT "%8.3" EXTENDED_LIMITS -3549.940 3003.560
 /begin AXIS_DESCR STD_AXIS LSUCD_resRi_mp Resist 16 0.00 3000.000 FORMAT "%8.3" EXTENDED_LIMITS -3276.800 3276.700 DEPOSIT ABSOLUTE /end AXIS_DESCR
/end CHARACTERISTIC
/begin CHARACTERISTIC LSUCD_tiHtCoupFlt_C "Zeitkonstante Glättungsfilter in Diagnose der Heizungskopplung" VALUE 0xE4028 Kw_Wu32 4294.9673 TimeDelay_s 0.0000010000000 4294.9673 FORMAT "%9.4" /end CHARACTERISTIC
/begin CHARACTERISTIC LSUCD_uO2MaxGrad_C "Maximale Änderung des Sauerstoff-Spannungssignals zur Freigabe der Diagnose der Heizungskopplung" VALUE 0xE402C Kw_Ws16 320307.9 Volt -160156.4 160151.5 FORMAT "%8.1" /end CHARACTERISTIC
/begin CHARACTERISTIC LSUCD_uO2MaxRippel_C "Maximal zulässige Änderung des Sauerstoff-Spannungssignals zur Abschaltung der Heizung" VALUE 0xE402E Kw_Ws16 320307.9 Volt -160156.4 160151.5 FORMAT "%8.1" /end CHARACTERISTIC
/begin CHARACTERISTIC LSUCD_uO2OpnLdNernstMax_C "Maximalspannung der Kabelunterbrechungsdiagnose am Anschluss Nerns-Zelle (UN)" VALUE 0xE4034 Kw_Ws16 5000.000 Volt 0.00 5000.000 FORMAT "%8.3" EXTENDED_LIMITS -160156.4 160151.5 /end CHARACTERISTIC
/begin CHARACTERISTIC LSUCD_uO2OpnLdNernstMin_C "Minimalspannung der Kabelunterbrechungsdiagnose am Anschluss Nerns-Zelle (UN)" VALUE 0xE4036 Kw_Ws16 6999.022 Volt -1999.022 5000.000 FORMAT "%8.3" EXTENDED_LIMITS -160156.4 160151.5 /end CHARACTERISTIC
/begin CHARACTERISTIC LSUCD_uO2OpnLdVirtGndMax_C "SRC-Maximalwert der Kabelunterbrechungsdiagnose am Anschluss virtuelle Masse (VM)" VALUE 0xE4038 Kw_Ws16 5097.752 Volt -97.75171 5000.000 FORMAT "%8.3" EXTENDED_LIMITS -160156.4 160151.5 /end CHARACTERISTIC
/begin CHARACTERISTIC LSUCD_uO2OpnLdVirtGndMin_C "SRC-Minimalwert der Kabelunterbrechungsdiagnose am Anschluss virtuelle Masse (VM)" VALUE 0xE403A Kw_Ws16 5498.534 Volt -498.5337 5000.000 FORMAT "%8.3" EXTENDED_LIMITS -160156.4 160151.5 /end CHARACTERISTIC
/begin CHARACTERISTIC LSUCD_uRiOpnLdTstMax_C "Maximalwert der Ri-Spannung für Kabelunterbrechungsdiagnose am Anschluss Nernst-Zelle und virtuelle Masse" VALUE 0xE403C Kw_Ws16 5200.391 Volt 0.00 5200.391 FORMAT "%8.3" EXTENDED_LIMITS -160156.4 160151.5 /end CHARACTERISTIC
/begin CHARACTERISTIC LSUCtl_tUpLim_C "Obere Widerstandsgrenze für eingeregelten Zustand" VALUE 0xE405C Kw_Ws16 950.000 Temp_Cels -50.140 899.860 FORMAT "%8.3" EXTENDED_LIMITS -3549.940 3003.560 /end CHARACTERISTIC
/begin CHARACTERISTIC LSUCtl_tLowLim_C "Untere Widerstandsgrenze für eingeregelten Zustand" VALUE 0xE405E Kw_Ws16 950.000 Temp_Cels -50.140 899.860 FORMAT "%8.3" EXTENDED_LIMITS -3549.940 3003.560 /end CHARACTERISTIC
/begin CHARACTERISTIC LSUCtl_tRiSetPoint_C "#SSD Sollwert der LSU-Heizungsregelung" VALUE 0xE4060 Kw_Ws16 950.000 Temp_Cels -50.140 899.860 FORMAT "%8.3" EXTENDED_LIMITS -3549.940 3003.560 /end CHARACTERISTIC
/begin CHARACTERISTIC LSUCtl_tHtCtlEna_C "Temperaturminimalwert für Freigabe der Regelung" VALUE 0xE4062 Kw_Ws16 950.000 Temp_Cels -50.140 899.860 FORMAT "%8.3" EXTENDED_LIMITS -3549.940 3003.560 /end CHARACTERISTIC
/begin CHARACTERISTIC LSUCtl_nHtCtlEna_C "Mindestdrehzahl für Freigabe Aufheizrampe" VALUE 0xE4064 Kw_Ws16 32767.00 EngN 0.00 32767.00 FORMAT "%8.2" EXTENDED_LIMITS -32768.00 32767.00 /end CHARACTERISTIC
/begin CHARACTERISTIC LSUCtl_dcycHtMin_C "#SSD Tastverhältnis Heizeransteuerung vor Taupunktende (Vorwärmen)" VALUE 0xE4066 Kw_Ws16 100.0000 DtyCyc 0.00 100.0000 FORMAT "%8.4" EXTENDED_LIMITS -327.6800 327.6700 /end CHARACTERISTIC
/begin CHARACTERISTIC LSUCtl_tExcMax_C "Grenzwert zur Erkennung von ""obere Schwelle bleibend überschritten""" VALUE 0xE4068 Kw_Ws16 950.000 Temp_Cels -50.140 899.860 FORMAT "%8.3" EXTENDED_LIMITS -3549.940 3003.560 /end CHARACTERISTIC
/begin CHARACTERISTIC LSUCtl_tExcMin_C "Grenzwert zur Erkennung von ""untere Schwelle bleibend nicht erreicht""" VALUE 0xE406A Kw_Ws16 950.000 Temp_Cels -50.140 899.860 FORMAT "%8.3" EXTENDED_LIMITS -3549.940 3003.560 /end CHARACTERISTIC
/begin CHARACTERISTIC LSUCtl_tiDelIniVal_C "Verzögerungszeit für die Erfassung der initialen Ansauglufttemperatur" VALUE 0xE406C Kw_Wu16 655350.0 Time_ms 0.00 655350.0 FORMAT "%8.1" /end CHARACTERISTIC
/begin CHARACTERISTIC LSUCtl_dcycRmpUp_C "#SSD Anstiegsgeschwindigkeit Aufheizkurvenrampe" VALUE 0xE4070 Kw_Wu32 655359.999847 RmpDtyCyc 0.00 655359.999847 FORMAT "%13.6" /end CHARACTERISTIC
/begin CHARACTERISTIC LSUCtl_dcycRmpDwn_C "Fallgeschwindigkeit Aufheizrampe" VALUE 0xE4074 Kw_Wu32 655359.999847 RmpDtyCyc 0.00 655359.999847 FORMAT "%13.6" /end CHARACTERISTIC
/begin CHARACTERISTIC LSUCtl_dcycStrt_CUR "#SSD Kennlinie Anfangsheizungs Tastverhältnis in Abhängigkeit von Ansauglufttemperatur bei Start" CURVE 0xE4078 Kl_Xs16_Ws16 100.0000 DtyCyc 0.00 100.0000 FORMAT "%8.4" EXTENDED_LIMITS -327.6800 327.6700
 /begin AXIS_DESCR STD_AXIS LSUCtl_tAirStrt_mp Temp_Cels 5 -50.1400 199.8600 FORMAT "%8.4" EXTENDED_LIMITS -3549.940 3003.560 DEPOSIT ABSOLUTE /end AXIS_DESCR
/end CHARACTERISTIC
/begin CHARACTERISTIC LSUCtl_tiDebRiExcMaxDef_C "Defekterkennungszeit bleibend obere Ri Schwelle überschritten" VALUE 0xE408E Kw_Wu16 655350.0 Time_ms 0.00 655350.0 FORMAT "%8.1" /end CHARACTERISTIC
/begin CHARACTERISTIC LSUCtl_tiDebRiExcMaxOk_C "Heilungszeit bleibend obere Ri Schwelle überschritten" VALUE 0xE4090 Kw_Wu16 655350.0 Time_ms 0.00 655350.0 FORMAT "%8.1" /end CHARACTERISTIC
/begin CHARACTERISTIC LSUCtl_tiDebRiExcMinDef_C "Defekterkennungszeit bleibend untere Ri Schwelle unterschritten" VALUE 0xE4092 Kw_Wu16 655350.0 Time_ms 0.00 655350.0 FORMAT "%8.1" /end CHARACTERISTIC
/begin CHARACTERISTIC LSUCtl_tiDebRiExcMinOk_C "Heilungszeit bleibend untere Ri Schwelle unterschritten" VALUE 0xE4094 Kw_Wu16 655350.0 Time_ms 0.00 655350.0 FORMAT "%8.1" /end CHARACTERISTIC
/begin CHARACTERISTIC LSUCtl_tiSens1HtDT1_C "Verzugszeit T1 des D-Gliedes der LSU Heizungsregelung Sensoren vor Katalysator" VALUE 0xE4098 Kw_Wu32 4294.9673 TimeDelay_s 0.0000010000000 4294.9673 FORMAT "%9.4" /end CHARACTERISTIC
/begin CHARACTERISTIC LSUCtl_Sens1HtDT1Kd_C "Kd Parameter der Heizungsregelung für die Sensoren vor Katalysator" VALUE 0xE409C Kw_Ws32 6553.59999847 Kd_Temp_Kelv2Dcyc -3276.80000000 3276.79999847 FORMAT "%13.8" /end CHARACTERISTIC
/begin CHARACTERISTIC LSUCtl_Sens1HtIKi_C "Ki Parameter der Heizungsregelung für die Sensoren vor Katalysator (Kleinsignalbereich)" VALUE 0xE40A0 Kw_Wu32 99999.9999767 Ki_Temp_Kelv2Dcyc 0.00 99999.9999767 FORMAT "%13.7" /end CHARACTERISTIC
/begin CHARACTERISTIC LSUCtl_Sens1HtIKiPos_C "Ki Parameter der Heizungsregelung für die Sensoren vor Katalysator (positiver Großsignalbereich)" VALUE 0xE40A4 Kw_Wu32 99999.9999767 Ki_Temp_Kelv2Dcyc 0.00 99999.9999767 FORMAT "%13.7" /end CHARACTERISTIC
/begin CHARACTERISTIC LSUCtl_Sens1HtIKiNeg_C "Ki Parameter der Heizungsregelung für die Sensoren vor Katalysator (negativer Großsignalbereich)" VALUE 0xE40A8 Kw_Wu32 99999.9999767 Ki_Temp_Kelv2Dcyc 0.00 99999.9999767 FORMAT "%13.7" /end CHARACTERISTIC
/begin CHARACTERISTIC LSUCtl_tSens1HtIWinPos_C "Obere Fenstergrenze des I-Anteils der LSU-Heizungsregelung (Sensoren vor Katalysator)" VALUE 0xE40AC Kw_Ws16 6553.500 TempDiff_Cels -3276.800 3276.700 FORMAT "%8.3" /end CHARACTERISTIC
/begin CHARACTERISTIC LSUCtl_tSens1HtIWinNeg_C "Untere Fenstergrenze des I-Anteils der LSU-Heizungsregelung (Sensoren vor Katalysator)" VALUE 0xE40AE Kw_Ws16 6553.500 TempDiff_Cels -3276.800 3276.700 FORMAT "%8.3" /end CHARACTERISTIC
/begin CHARACTERISTIC LSUCtl_Sens1HtPKp_C "Kp Parameter der Heizungsregelung für die Sensoren vor Katalysator (Kleinsignalbereich)" VALUE 0xE40B0 Kw_Wu32 6553.59999847 Kp_Temp_Kelv2Dcyc 0.00 6553.59999847 FORMAT "%13.8" /end CHARACTERISTIC
/begin CHARACTERISTIC LSUCtl_Sens1HtPKpPos_C "Kp Parameter der Heizungsregelung für die Sensoren vor Katalysator (positiver Großsignalbereich)" VALUE 0xE40B4 Kw_Wu32 6553.59999847 Kp_Temp_Kelv2Dcyc 0.00 6553.59999847 FORMAT "%13.8" /end CHARACTERISTIC
/begin CHARACTERISTIC LSUCtl_Sens1HtPKpNeg_C "Kp Parameter der Heizungsregelung für die Sensoren vor Katalysator (negativer Großsignalbereich)" VALUE 0xE40B8 Kw_Wu32 6553.59999847 Kp_Temp_Kelv2Dcyc 0.00 6553.59999847 FORMAT "%13.8" /end CHARACTERISTIC
/begin CHARACTERISTIC LSUCtl_tSens1HtPWinPos_C "Obere Fenstergrenze des P-Anteils der LSU-Heizungsregelung (Sensoren vor Katalysator)" VALUE 0xE40BC Kw_Ws16 6553.500 TempDiff_Cels -3276.800 3276.700 FORMAT "%8.3" /end CHARACTERISTIC
/begin CHARACTERISTIC LSUCtl_tSens1HtPWinNeg_C "Untere Fenstergrenze des P-Anteils der LSU-Heizungsregelung (Sensoren vor Katalysator)" VALUE 0xE40BE Kw_Ws16 6553.500 TempDiff_Cels -3276.800 3276.700 FORMAT "%8.3" /end CHARACTERISTIC
/begin CHARACTERISTIC LSUCtl_tiSens2HtDT1_C "Verzugszeit T1 des D-Gliedes der LSU Heizungsregelung Sensoren nach Katalysator" VALUE 0xE40C0 Kw_Wu32 4294.9673 TimeDelay_s 0.0000010000000 4294.9673 FORMAT "%9.4" /end CHARACTERISTIC
/begin CHARACTERISTIC LSUCtl_Sens2HtDT1Kd_C "Kd Parameter der Heizungsregelung für die Sensoren nach Katalysator" VALUE 0xE40C4 Kw_Ws32 6553.59999847 Kd_Temp_Kelv2Dcyc -3276.80000000 3276.79999847 FORMAT "%13.8" /end CHARACTERISTIC
/begin CHARACTERISTIC LSUCtl_Sens2HtIKi_C "Ki Parameter der Heizungsregelung für die Sensoren nach Katalysator (Kleinsignalbereich)" VALUE 0xE40C8 Kw_Wu32 99999.9999767 Ki_Temp_Kelv2Dcyc 0.00 99999.9999767 FORMAT "%13.7" /end CHARACTERISTIC
/begin CHARACTERISTIC LSUCtl_Sens2HtIKiPos_C "Ki Parameter der Heizungsregelung für die Sensoren nach Katalysator (positiver Großsignalbereich)" VALUE 0xE40CC Kw_Wu32 99999.9999767 Ki_Temp_Kelv2Dcyc 0.00 99999.9999767 FORMAT "%13.7" /end CHARACTERISTIC
/begin CHARACTERISTIC LSUCtl_Sens2HtIKiNeg_C "Ki Parameter der Heizungsregelung für die Sensoren nach Katalysator (negativer Großsignalbereich)" VALUE 0xE40D0 Kw_Wu32 99999.9999767 Ki_Temp_Kelv2Dcyc 0.00 99999.9999767 FORMAT "%13.7" /end CHARACTERISTIC
/begin CHARACTERISTIC LSUCtl_tSens2HtIWinPos_C "Obere Fenstergrenze des I-Anteils der LSU-Heizungsregelung (Sensoren nach Katalysator)" VALUE 0xE40D4 Kw_Ws16 6553.500 TempDiff_Cels -3276.800 3276.700 FORMAT "%8.3" /end CHARACTERISTIC
/begin CHARACTERISTIC LSUCtl_tSens2HtIWinNeg_C "Untere Fenstergrenze des I-Anteils der LSU-Heizungsregelung (Sensoren nach Katalysator)" VALUE 0xE40D6 Kw_Ws16 6553.500 TempDiff_Cels -3276.800 3276.700 FORMAT "%8.3" /end CHARACTERISTIC
/begin CHARACTERISTIC LSUCtl_Sens2HtPKp_C "Kp Parameter der Heizungsregelung für die Sensoren nach Katalysator (Kleinsignalbereich)" VALUE 0xE40D8 Kw_Wu32 6553.59999847 Kp_Temp_Kelv2Dcyc 0.00 6553.59999847 FORMAT "%13.8" /end CHARACTERISTIC
/begin CHARACTERISTIC LSUCtl_Sens2HtPKpPos_C "Kp Parameter der Heizungsregelung für die Sensoren nach Katalysator (positiver Großsignalbereich)" VALUE 0xE40DC Kw_Wu32 6553.59999847 Kp_Temp_Kelv2Dcyc 0.00 6553.59999847 FORMAT "%13.8" /end CHARACTERISTIC
/begin CHARACTERISTIC LSUCtl_Sens2HtPKpNeg_C "Kp Parameter der Heizungsregelung für die Sensoren nach Katalysator (negativer Großsignalbereich)" VALUE 0xE40E0 Kw_Wu32 6553.59999847 Kp_Temp_Kelv2Dcyc 0.00 6553.59999847 FORMAT "%13.8" /end CHARACTERISTIC
/begin CHARACTERISTIC LSUCtl_tSens2HtPWinPos_C "Obere Fenstergrenze des P-Anteils der LSU-Heizungsregelung (Sensoren nach Katalysator)" VALUE 0xE40E4 Kw_Ws16 6553.500 TempDiff_Cels -3276.800 3276.700 FORMAT "%8.3" /end CHARACTERISTIC
/begin CHARACTERISTIC LSUCtl_tSens2HtPWinNeg_C "Untere Fenstergrenze des P-Anteils der LSU-Heizungsregelung (Sensoren nach Katalysator)" VALUE 0xE40E6 Kw_Ws16 6553.500 TempDiff_Cels -3276.800 3276.700 FORMAT "%8.3" /end CHARACTERISTIC
/begin CHARACTERISTIC LSU_ctRgnEna_C "Zahl von Kalibrierungs-Zyklen, nach der Regeneration vorkommen soll" VALUE 0xE3DAC Kw_Wu8 255.0 OneToOne 0.00 255.0 FORMAT "%5.1" /end CHARACTERISTIC
/begin CHARACTERISTIC LSU_dcycMax_C "minimale Tastverhältnis-Änderung für Aktivierung Heizereinkopplungs-Diagnose" VALUE 0xE3DD8 Kw_Ws16 655.3500 DtyCyc -327.6800 327.6700 FORMAT "%8.4" /end CHARACTERISTIC
/begin CHARACTERISTIC LSU_tiBattHighDebNeg_C "Entprellzeit (Übergang von high nach low) der Batteriespannungsüberwachung" VALUE 0xE3DDA Kw_Wu16 655350.0 TimeDeb 0.00 655350.0 FORMAT "%8.1" /end CHARACTERISTIC
/begin CHARACTERISTIC LSU_tiBattHighDebPos_C "Entprellzeit (Übergang von low nach high) der Batteriespannungsüberwachung" VALUE 0xE3DDC Kw_Wu16 655350.0 TimeDeb 0.00 655350.0 FORMAT "%8.1" /end CHARACTERISTIC
/begin CHARACTERISTIC LSU_DebDynErrDef_C "Zählerstand zur Defektentprellung Dynamikfehler" VALUE 0xE3E18 Kw_Wu16 65535.00 OneToOne 0.00 65535.00 FORMAT "%8.2" /end CHARACTERISTIC
/begin CHARACTERISTIC LSU_DebDynErrOk_C "Zählerstand zur Heilungsentprellung Dynamikfehler" VALUE 0xE3E1A Kw_Wu16 65535.00 OneToOne 0.00 65535.00 FORMAT "%8.2" /end CHARACTERISTIC
/begin CHARACTERISTIC LSUCD_tiDebNoLdErrIPDef_C "Defekterkennungszeit der Kabelunterbrechungsdiagnose am Anschluss Pumpzelle (IP)" VALUE 0xE403E Kw_Wu16 655350.0 Time_ms 0.00 655350.0 FORMAT "%8.1" /end CHARACTERISTIC
/begin CHARACTERISTIC LSUCD_tiDebNoLdErrIPOk_C "Heilungsdauer der Kabelunterbrechungsdiagnose am Anschluss Pumpzelle (IP)" VALUE 0xE4040 Kw_Wu16 655350.0 Time_ms 0.00 655350.0 FORMAT "%8.1" /end CHARACTERISTIC
/begin CHARACTERISTIC LSUCD_DebOpnLdVirtGndDef_C "Defektentprellzeit der Kabelabfallerkennung am Pin Virtuelle Masse" VALUE 0xE4042 Kw_Wu16 655350.0 Time_ms 0.00 655350.0 FORMAT "%8.1" /end CHARACTERISTIC
/begin CHARACTERISTIC LSUCD_DebOpnLdVirtGndOk_C "Heilungsentprellzeit der Kabelabfallerkennung am Pin Virtuelle Masse" VALUE 0xE4044 Kw_Wu16 655350.0 Time_ms 0.00 655350.0 FORMAT "%8.1" /end CHARACTERISTIC
/begin CHARACTERISTIC LSUCD_DebOpnLdNernstDef_C "Defektentprellzeit der Kabelabfallerkennung am Pin UN" VALUE 0xE4046 Kw_Wu16 655350.0 Time_ms 0.00 655350.0 FORMAT "%8.1" /end CHARACTERISTIC
/begin CHARACTERISTIC LSUCD_DebOpnLdNernstOk_C "Heilungsentprellzeit der Kabelabfallerkennung am Pin UN" VALUE 0xE4048 Kw_Wu16 655350.0 Time_ms 0.00 655350.0 FORMAT "%8.1" /end CHARACTERISTIC
/begin CHARACTERISTIC LSU_DebO2ConcHighDef_C "Zählerstand zur Defektentprellung unplausibel hohe O2-Konzentration" VALUE 0xE3E1C Kw_Wu16 65535.00 OneToOne 0.00 65535.00 FORMAT "%8.2" /end CHARACTERISTIC
/begin CHARACTERISTIC LSU_DebO2ConcHighOk_C "Zählerstand zur Heilungsentprellung unplausibel hohe O2-Konzentration" VALUE 0xE3E1E Kw_Wu16 65535.00 OneToOne 0.00 65535.00 FORMAT "%8.2" /end CHARACTERISTIC
/begin CHARACTERISTIC LSU_DebO2ConcLowDef_C "Zählerstand zur Defektentprellung unplausibel niedrige O2-Konzentration" VALUE 0xE3E20 Kw_Wu16 65535.00 OneToOne 0.00 65535.00 FORMAT "%8.2" /end CHARACTERISTIC
/begin CHARACTERISTIC LSU_DebO2ConcLowOk_C "Zählerstand zur Heilungsentprellung unplausibel niedrige O2-Konzentration" VALUE 0xE3E22 Kw_Wu16 65535.00 OneToOne 0.00 65535.00 FORMAT "%8.2" /end CHARACTERISTIC
/begin CHARACTERISTIC LSU_tiOvrRunDebNeg_C "Entprellzeit (Übergang von high nach low) der Schuberkennung" VALUE 0xE3DDE Kw_Wu16 655350.0 TimeDeb 0.00 655350.0 FORMAT "%8.1" /end CHARACTERISTIC
/begin CHARACTERISTIC LSU_tiOvrRunDebPos_C "Entprellzeit (Übergang von low nach high) der Schuberkennung" VALUE 0xE3DE0 Kw_Wu16 655350.0 TimeDeb 0.00 655350.0 FORMAT "%8.1" /end CHARACTERISTIC
/begin CHARACTERISTIC LSUCD_tiDebHeaterDef_C "Defektentprellung Lambdasonden Heizerendstufe" VALUE 0xE3EB8 Kw_Wu16 655350.0 Time_ms 0.00 655350.0 FORMAT "%8.1" /end CHARACTERISTIC
/begin CHARACTERISTIC LSUCD_tiDebHeaterOk_C "Heilungsentprellung der Heizerendstufe Lambdasensor" VALUE 0xE3EBA Kw_Wu16 655350.0 Time_ms 0.00 655350.0 FORMAT "%8.1" /end CHARACTERISTIC
/begin CHARACTERISTIC LSUCD_uBattNominal_C "#SSD Nominale Batteriespannung für Heizleistungskorrektur (= Spannung die 100 % entspricht)" VALUE 0xE3EBC Kw_Wu16 15992.18 Volt_Batt 0.00 15992.18 FORMAT "%8.2" EXTENDED_LIMITS 0.00 1281232. /end CHARACTERISTIC
/begin CHARACTERISTIC LSUCD_uBattMaxHigh_C "#SSD Schwelle für Abschaltung Heizeransteuern aufgrund zu hoher Batteriespannung" VALUE 0xE3EBE Kw_Ws16 665630.5 Volt_Batt -640625.6 25004.89 FORMAT "%8.1" EXTENDED_LIMITS -640625.6 640606.1 /end CHARACTERISTIC
/begin CHARACTERISTIC LSUCD_uBattMaxLow_C "#SSD Schwelle für Rücknahme Abschaltung Heizeransteuern aufgrund zu hoher Batteriespannung" VALUE 0xE3EC0 Kw_Ws16 665630.5 Volt_Batt -640625.6 25004.89 FORMAT "%8.1" EXTENDED_LIMITS -640625.6 640606.1 /end CHARACTERISTIC
/begin CHARACTERISTIC LSUCD_stPwrStgDia_C "#SSD Verriegelungsmaske für Heizer Endstufen Diagnose" VALUE 0xE3EC2 Kw_Wu8 255.0 OneToOne 0.00 255.0 FORMAT "%5.1" /end CHARACTERISTIC
/begin CHARACTERISTIC LSUCD_dcycTstPowerStage_C "Tastverhältnis zum Einschalten der nicht-SPI-steuerbare Endstufe bei einem SCB-Fehler" VALUE 0xE3EC4 Kw_Ws16 50.00000 DtyCyc 0.00 50.00000 FORMAT "%8.5" EXTENDED_LIMITS -327.6800 327.6700 /end CHARACTERISTIC
/begin CHARACTERISTIC LSUCD_tiDebReset_C "Zeitverzögerung für zurücksetzen PWM Fehlerentprellung bei nicht aktiver Ansteuerung" VALUE 0xE3EC6 Kw_Wu16 655350.0 Time_ms 0.00 655350.0 FORMAT "%8.1" /end CHARACTERISTIC
/begin CHARACTERISTIC LSUCD_stHtDis_C "#SSD Maske zur Auswahl der Betriebsmode abhängigen Abschaltbedingungen der Heizer Endstufe" VALUE 0xE3EC8 Kw_Wu8 255.0 OneToOne 0.00 255.0 FORMAT "%5.1" /end CHARACTERISTIC
/begin CHARACTERISTIC LSUCD_stHeaterPwrStgSel_C "Applikationsparameter für die Heizerendstufe (1 für TLE6232)" VALUE 0xE3EC9 Kw_Wu8 255.0 OneToOne 0.00 255.0 FORMAT "%5.1" /end CHARACTERISTIC
/begin CHARACTERISTIC LSUCD_tiHeaterBattDefDelay_C "Zeitverzögerung der Heizerdiagnose nachdem der Heizungsregeler aktiv ist" VALUE 0xE3ECA Kw_Wu16 655350.0 Time_ms 0.00 655350.0 FORMAT "%8.1" /end CHARACTERISTIC
/begin CHARACTERISTIC LSUCD_stRefPumpDis_C "#SSD Maske zur Auswahl der Betriebsart abhängigen Abschaltbedingungen für den Referenzpumpstrom" VALUE 0xE3ECC Kw_Wu8 255.0 OneToOne 0.00 255.0 FORMAT "%5.1" /end CHARACTERISTIC
/begin CHARACTERISTIC LSUCD_tiRefPumpHigh_C "Zeit für Regeneration Referenzzelle mit erhöhtem Pumpstrom" VALUE 0xE3ECE Kw_Wu16 655350.0 Time_ms 0.00 655350.0 FORMAT "%8.1" /end CHARACTERISTIC
/begin CHARACTERISTIC LSUCD_tiRefTransLow_C "Verzögerungszeit bis zum Setzen des Bits in LSUCD_stRefPmp nach Übergang von hohem zu niedrigem Referenzpumpstrom" VALUE 0xE3ED0 Kw_Wu16 655350.0 Time_ms 0.00 655350.0 FORMAT "%8.1" /end CHARACTERISTIC
/begin CHARACTERISTIC LSUCD_tiRgnEna_C "Zeit-Periode für Regeneration" VALUE 0xE3ED2 Kw_Wu16 655350.0 Time_ms 0.00 655350.0 FORMAT "%8.1" /end CHARACTERISTIC
/begin CHARACTERISTIC LSUCD_tiRgnIpSettle_C "Zeitdauer zum Ausregeln des Pumpstroms nach Regeneration (nur für CJ125)" VALUE 0xE3ED4 Kw_Wu16 655350.0 Time_ms 0.00 655350.0 FORMAT "%8.1" /end CHARACTERISTIC
/begin CHARACTERISTIC LSUCD_swtRgnChngCirct_C "Schalter der geänderten Hardware für die Pumpstromumkehr (T1120-->1, sonst-->0)" VALUE 0xE3ED6 Kw_Wu8 255.0 OneToOne 0.00 255.0 FORMAT "%5.1" /end CHARACTERISTIC
/begin CHARACTERISTIC LSUCD_tiDebLowBattErrDef_C "Defekterkennungszeit für Fehler niedrige Batteriespannung" VALUE 0xE404A Kw_Wu16 655350.0 Time_ms 0.00 655350.0 FORMAT "%8.1" /end CHARACTERISTIC
/begin CHARACTERISTIC LSUCD_tiDebLowBattErrOk_C "Heilungszeit für Fehler niedrige Batteriespannung" VALUE 0xE404C Kw_Wu16 655350.0 Time_ms 0.00 655350.0 FORMAT "%8.1" /end CHARACTERISTIC
/begin CHARACTERISTIC LSU_mAirMaxClb1_C "upper air mass threshold for calibration/regeneration of  CJ120/125 (for operating point1)" VALUE 0xE3DAE Kw_Ws16 6553.500 AirMassPerCyl -3276.800 3276.700 FORMAT "%8.3" /end CHARACTERISTIC
/begin CHARACTERISTIC LSU_mAirMaxClb2_C "upper air mass threshold for calibration/regeneration of CJ120/125 (for operating point2)" VALUE 0xE3DB0 Kw_Ws16 6553.500 AirMassPerCyl -3276.800 3276.700 FORMAT "%8.3" /end CHARACTERISTIC
/begin CHARACTERISTIC LSU_mAirMax_C "obere Luftmassen-Schwelle für Plausibilitätscheck (0 - Vollast, 1 - Teillast, 2 - Schub)" VAL_BLK 0xE3E24 Kwb_Ws16 6553.500 AirMassPerCyl -3276.800 3276.700 FORMAT "%8.3" NUMBER 3 /end CHARACTERISTIC
/begin CHARACTERISTIC LSU_mAirMinClb1_C "lower air mass threshold for calibration/regeneration of CJ120/125 (for operating point1)" VALUE 0xE3DB2 Kw_Ws16 6553.500 AirMassPerCyl -3276.800 3276.700 FORMAT "%8.3" /end CHARACTERISTIC
/begin CHARACTERISTIC LSU_mAirMinClb2_C "lower air mass threshold for calibration/regeneration of  CJ120/125 (for operating point2)" VALUE 0xE3DB4 Kw_Ws16 6553.500 AirMassPerCyl -3276.800 3276.700 FORMAT "%8.3" /end CHARACTERISTIC
/begin CHARACTERISTIC LSU_mAirMin_C "untere Luftmassenschwelle für Plausibilitäts-Check (0 - Vollast, 1 - Teillast, 2 - Schub)" VAL_BLK 0xE3E2A Kwb_Ws16 6553.500 AirMassPerCyl -3276.800 3276.700 FORMAT "%8.3" NUMBER 3 /end CHARACTERISTIC
/begin CHARACTERISTIC LSUCD_tiDebO2MaxTstDef_C "Defekt Entprellung der oberen Grenze  Sauerstoffsignal mit reduzierter Verstärkung" VALUE 0xE3F24 Kw_Wu16 655350.0 Time_ms 0.00 655350.0 FORMAT "%8.1" /end CHARACTERISTIC
/begin CHARACTERISTIC LSUCD_tiDebO2MaxTstOk_C "Heilungs Entprellung der oberen Grenze  Sauerstoffsignal mit reduzierter Verstärkung" VALUE 0xE3F26 Kw_Wu16 655350.0 Time_ms 0.00 655350.0 FORMAT "%8.1" /end CHARACTERISTIC
/begin CHARACTERISTIC LSUCD_tiDebO2MinDef_C "Defekt Entprellung der unteren Genze Sauerstoffsignal" VALUE 0xE3F28 Kw_Wu16 655350.0 Time_ms 0.00 655350.0 FORMAT "%8.1" /end CHARACTERISTIC
/begin CHARACTERISTIC LSUCD_tiDebO2MinOk_C "Heilungsentprellung untere Grenze Sauerstoffsignal" VALUE 0xE3F2A Kw_Wu16 655350.0 Time_ms 0.00 655350.0 FORMAT "%8.1" /end CHARACTERISTIC
/begin CHARACTERISTIC LSUCD_tiDebCircNernstDef_C "Defekt Entprellung des Nernst Anschlusses der Lambdasonde" VALUE 0xE404E Kw_Wu16 655350.0 Time_ms 0.00 655350.0 FORMAT "%8.1" /end CHARACTERISTIC
/begin CHARACTERISTIC LSUCD_tiDebCircNernstOk_C "Heilungsentprellung des Nernst Anschlusses Lambdasensor" VALUE 0xE4050 Kw_Wu16 655350.0 Time_ms 0.00 655350.0 FORMAT "%8.1" /end CHARACTERISTIC
/begin CHARACTERISTIC LSU_nMaxClb1_C "upper engine speed  threshold for calibration/regeneration of  CJ120/125 (for operating point1)" VALUE 0xE3DB6 Kw_Ws16 65535.00 EngN -32768.00 32767.00 FORMAT "%8.2" /end CHARACTERISTIC
/begin CHARACTERISTIC LSU_nMaxClb2_C "lower engine speed  threshold for calibration/regeneration of CJ120/125 (for operating point2)" VALUE 0xE3DB8 Kw_Ws16 65535.00 EngN -32768.00 32767.00 FORMAT "%8.2" /end CHARACTERISTIC
/begin CHARACTERISTIC LSU_nMax_C "obere Drehzahlschwelle für Plausibilitäts-Check (0 - Vollast, 1 - Teillast, 2 - Schub)" VAL_BLK 0xE3E30 Kwb_Ws16 65535.00 EngN -32768.00 32767.00 FORMAT "%8.2" NUMBER 3 /end CHARACTERISTIC
/begin CHARACTERISTIC LSU_nMinChkDyn_C "minimale Drehzahl zur Aktivierung Dynamiküberwachung" VALUE 0xE3E36 Kw_Ws16 65535.00 EngN -32768.00 32767.00 FORMAT "%8.2" /end CHARACTERISTIC
/begin CHARACTERISTIC LSU_nMinClb1_C "lower engine speed threshold for for calibration/regeneration of  CJ120/125 (for operating point1)" VALUE 0xE3DBA Kw_Ws16 65535.00 EngN -32768.00 32767.00 FORMAT "%8.2" /end CHARACTERISTIC
/begin CHARACTERISTIC LSU_nMinClb2_C "lower engine speed  threshold for for calibration/regeneration of  CJ120/125 (for operating point2)" VALUE 0xE3DBC Kw_Ws16 65535.00 EngN -32768.00 32767.00 FORMAT "%8.2" /end CHARACTERISTIC
/begin CHARACTERISTIC LSU_nMin_C "untere Drehzahlschwelle für Plausibilitäts-Check (0 - Vollast, 1 - Teillast, 2 - Schub)" VAL_BLK 0xE3E38 Kwb_Ws16 65535.00 EngN -32768.00 32767.00 FORMAT "%8.2" NUMBER 3 /end CHARACTERISTIC
/begin CHARACTERISTIC LSUCD_tiDelO2Clb_C "Wartezeit auf Einschwingen O2 Abgleichwert" VALUE 0xE3F2C Kw_Wu16 100.0000 Time_ms 0.00 100.0000 FORMAT "%8.4" EXTENDED_LIMITS 0.00 655350.0 /end CHARACTERISTIC
/begin CHARACTERISTIC LSUCD_tiO2Clb_C "Lernzeit O2 Abgleichwert" VALUE 0xE3F2E Kw_Wu16 100.0000 Time_ms 0.00 100.0000 FORMAT "%8.4" EXTENDED_LIMITS 0.00 655350.0 /end CHARACTERISTIC
/begin CHARACTERISTIC LSUCD_tiDelO2Val_C "Wartezeit auf Einschwingen O2 Meßwert nach Abgleich" VALUE 0xE3F30 Kw_Wu16 100.0000 Time_ms 0.00 100.0000 FORMAT "%8.4" EXTENDED_LIMITS 0.00 655350.0 /end CHARACTERISTIC
/begin CHARACTERISTIC LSUCD_uO2Ref_C "#SSD Sollspannung Auswerteschaltung bei Lambda = 1" VALUE 0xE3F32 Kw_Ws16 5000.000 Volt 0.00 5000.000 FORMAT "%8.3" EXTENDED_LIMITS -160156.4 160151.5 /end CHARACTERISTIC
/begin CHARACTERISTIC LSUCD_uO2ClbMax_C "Maximal zulässiger O2 Spannungskorrekturwert" VALUE 0xE3F34 Kw_Ws16 320307.9 Volt -160156.4 160151.5 FORMAT "%8.1" /end CHARACTERISTIC
/begin CHARACTERISTIC LSUCD_uO2ClbMin_C "Minimal zulässiger O2 Spannungskorrekturwert" VALUE 0xE3F36 Kw_Ws16 320307.9 Volt -160156.4 160151.5 FORMAT "%8.1" /end CHARACTERISTIC
/begin CHARACTERISTIC LSUCD_swtO2Filter_C "Schalter zur aktivierung der O2 Rohspannungs Filterung (0= Filter aus, 1 = Filter an)" VALUE 0xE3F38 Kw_Wu8 1.000 OneToOne 0.00 1.000 FORMAT "%5.3" EXTENDED_LIMITS 0.00 255.0 /end CHARACTERISTIC
/begin CHARACTERISTIC LSUCD_uO2MaxNorm_C "Zulässige obere Spannungsgrenze für Normalkennlinie" VALUE 0xE3F3A Kw_Ws16 5000.000 Volt 0.00 5000.000 FORMAT "%8.3" EXTENDED_LIMITS -160156.4 160151.5 /end CHARACTERISTIC
/begin CHARACTERISTIC LSUCD_uO2MaxTst_C "Zulässige obere Spannungsgrenze für Fettkennlinie (Nur für Test verwendet)" VALUE 0xE3F3C Kw_Ws16 5000.000 Volt 0.00 5000.000 FORMAT "%8.3" EXTENDED_LIMITS -160156.4 160151.5 /end CHARACTERISTIC
/begin CHARACTERISTIC LSUCD_uO2Min_C "Unter Grenze Signalbereich" VALUE 0xE3F3E Kw_Ws16 5000.000 Volt 0.00 5000.000 FORMAT "%8.3" EXTENDED_LIMITS -160156.4 160151.5 /end CHARACTERISTIC
/begin CHARACTERISTIC LSUCD_swtSensDrftComp_C "Schalter zur Driftkompensation bei Auswahl eines Sensors hoher Empfindlichkeit[-]" VALUE 0xE3F40 Kw_Wu8 1.000 OneToOne 0.00 1.000 FORMAT "%5.3" EXTENDED_LIMITS 0.00 255.0 /end CHARACTERISTIC
/begin CHARACTERISTIC LSUCD_tiDebCircPumpDef_C "Defekt Entrpellung des Pumpstromanschlusses der Lambdasonde" VALUE 0xE4052 Kw_Wu16 655350.0 Time_ms 0.00 655350.0 FORMAT "%8.1" /end CHARACTERISTIC
/begin CHARACTERISTIC LSUCD_tiDebCircPumpOk_C "Heilungsentprellung des Pumpstromanschlusses Lambdasensor" VALUE 0xE4054 Kw_Wu16 655350.0 Time_ms 0.00 655350.0 FORMAT "%8.1" /end CHARACTERISTIC
/begin CHARACTERISTIC LSU_qDiffMax_C "Toleranzband Einspritzmenge für Stationärerkennung" VALUE 0xE3E3E Kw_Ws16 655.3500 InjMass -327.6800 327.6700 FORMAT "%8.4" /end CHARACTERISTIC
/begin CHARACTERISTIC LSU_qMaxClb1_C "upper fuel quantity threshold for calibration/regeneration of  CJ120/125 (for operating point1)" VALUE 0xE3DBE Kw_Ws16 655.3500 InjMass -327.6800 327.6700 FORMAT "%8.4" /end CHARACTERISTIC
/begin CHARACTERISTIC LSU_qMaxClb2_C "upper fuel quantity threshold for calibration/regeneration of CJ120/125 (for operating point2)" VALUE 0xE3DC0 Kw_Ws16 655.3500 InjMass -327.6800 327.6700 FORMAT "%8.4" /end CHARACTERISTIC
/begin CHARACTERISTIC LSU_qMax_C "obere Mengenschwelle für Plausibilitäts-Check (0 - Vollast, 1 - Teillast, 2 - Schub)" VAL_BLK 0xE3E40 Kwb_Ws16 655.3500 InjMass -327.6800 327.6700 FORMAT "%8.4" NUMBER 3 /end CHARACTERISTIC
/begin CHARACTERISTIC LSU_qMinClb1_C "lower fuel quantity threshold for calibration/regeneration of CJ120/125 (for operating point1)" VALUE 0xE3DC2 Kw_Ws16 655.3500 InjMass -327.6800 327.6700 FORMAT "%8.4" /end CHARACTERISTIC
/begin CHARACTERISTIC LSU_qMinClb2_C "lower fuel quantity threshold for calibration/regeneration of CJ120/125 (for operating point2)" VALUE 0xE3DC4 Kw_Ws16 655.3500 InjMass -327.6800 327.6700 FORMAT "%8.4" /end CHARACTERISTIC
/begin CHARACTERISTIC LSU_qMin_C "untere Mengenschwelle für Plausibilitäts-Check (0 - Vollast, 1 - Teillast, 2 - Schub)" VAL_BLK 0xE3E46 Kwb_Ws16 655.3500 InjMass -327.6800 327.6700 FORMAT "%8.4" NUMBER 3 /end CHARACTERISTIC
/begin CHARACTERISTIC LSU_qThresChkDyn_C "minimale Kraftstoffmenge für Aktivierung Dynamiküberwachung" VALUE 0xE3E4C Kw_Ws16 655.3500 InjMass -327.6800 327.6700 FORMAT "%8.4" /end CHARACTERISTIC
/begin CHARACTERISTIC LSU_qThresOvrRun_C "Mengenschwelle zur Schuberkennung" VALUE 0xE3E4E Kw_Ws16 655.3500 InjMass -327.6800 327.6700 FORMAT "%8.4" /end CHARACTERISTIC
/begin CHARACTERISTIC LSUCD_tiDelRiClb_C "Wartezeit auf Einschwingen Ri Abgleichwert" VALUE 0xE3FEA Kw_Wu16 100.0000 Time_ms 0.00 100.0000 FORMAT "%8.4" EXTENDED_LIMITS 0.00 655350.0 /end CHARACTERISTIC
/begin CHARACTERISTIC LSUCD_tiRiClb_C "Lernzeit Ri Abgleichwert" VALUE 0xE3FEC Kw_Wu16 150.0000 Time_ms 0.00 150.0000 FORMAT "%8.4" EXTENDED_LIMITS 0.00 655350.0 /end CHARACTERISTIC
/begin CHARACTERISTIC LSUCD_tiDelRiVal_C "Wartezeit auf Einschwingen Ri Meßwert nach Abgleich" VALUE 0xE3FEE Kw_Wu16 100.0000 Time_ms 0.00 100.0000 FORMAT "%8.4" EXTENDED_LIMITS 0.00 655350.0 /end CHARACTERISTIC
/begin CHARACTERISTIC LSUCD_tiRiFltSettle_C "Maximale Zeitdauer zur Deaktivierung der Störungsunterdrückung" VALUE 0xE3FF0 Kw_Wu16 3000.000 Time_ms 0.00 3000.000 FORMAT "%8.3" EXTENDED_LIMITS 0.00 655350.0 /end CHARACTERISTIC
/begin CHARACTERISTIC LSUCD_resRiMaxJmp_C "Maximal zulässige Ri-Änderung zwischen gemessenem und zuletzt gefiltertem Wert" VALUE 0xE3FF2 Kw_Wu16 6553.500 Resist 0.00 6553.500 FORMAT "%8.3" /end CHARACTERISTIC
/begin CHARACTERISTIC LSUCD_uRiOfs_C "#SSD Sollspannung während Ri Offsetabgleich" VALUE 0xE3FF4 Kw_Ws16 5000.000 Volt 0.00 5000.000 FORMAT "%8.3" EXTENDED_LIMITS -160156.4 160151.5 /end CHARACTERISTIC
/begin CHARACTERISTIC LSUCD_facUToRi_C "#SSD Umrechnungsfaktor Meßspannung in Ri" VALUE 0xE3FF6 Kw_Ws16 1.289275 VoltToRes -0.6446474 0.6446277 FORMAT "%9.7" /end CHARACTERISTIC
/begin CHARACTERISTIC LSUCD_resRiClbRef_C "Wert Ri Referenzwiderstand" VALUE 0xE3FF8 Kw_Ws16 6553.500 Resist -3276.800 3276.700 FORMAT "%8.3" /end CHARACTERISTIC
/begin CHARACTERISTIC LSUCD_resRiClbMax_C "Maximal zulässiger Ri Korrekturwert" VALUE 0xE3FFA Kw_Ws16 6553.500 Resist -3276.800 3276.700 FORMAT "%8.3" /end CHARACTERISTIC
/begin CHARACTERISTIC LSUCD_resRiClbMin_C "Minimal zulässiger Ri Korrekturwert" VALUE 0xE3FFC Kw_Ws16 6553.500 Resist -3276.800 3276.700 FORMAT "%8.3" /end CHARACTERISTIC
/begin CHARACTERISTIC LSUCD_numRiDistSupp_C "Anzahl der aufeinanderfolgenden Zyklen zur Störungsunterdrückung" VALUE 0xE3FFE Kw_Wu8 255.0 OneToOne 0.00 255.0 FORMAT "%5.1" /end CHARACTERISTIC
/begin CHARACTERISTIC LSU_rLmbdRec_CUR "#SSD Kennlinie für Kehrwert von Lambda" CURVE 0xE3DE6 Kl_Xs16_Ws16 65.53500 lambdaRecVal -32.76800 32.76700 FORMAT "%8.5"
 /begin AXIS_DESCR STD_AXIS LSU_rO2AdptLastLSU_mp O2 12 -0.3276800 0.3276700 FORMAT "%9.7" DEPOSIT ABSOLUTE /end AXIS_DESCR
/end CHARACTERISTIC
/begin CHARACTERISTIC LSU_rO2ConstVal_C "Mitte Toleranzband für Lambda-1-Erkennung" VALUE 0xE3E50 Kw_Ws16 0.6553500 O2 -0.3276800 0.3276700 FORMAT "%9.7" /end CHARACTERISTIC
/begin CHARACTERISTIC LSU_tiDvtFlt_C "Filterzeitkonstante Lambda-1-Erkennung" VALUE 0xE3E54 Kw_Wu32 4294.9673 TimeDelay_s 0.0000010000000 4294.9673 FORMAT "%9.4" /end CHARACTERISTIC
/begin CHARACTERISTIC LSU_rO2Lmbd1Thres_C "Toleranzband für Lambda-1-Erkennung" VALUE 0xE3E58 Kw_Ws16 0.6553500 O2 -0.3276800 0.3276700 FORMAT "%9.7" /end CHARACTERISTIC
/begin CHARACTERISTIC LSU_rO2MaxVar_C "Breite des Toleranzbands für O2-Stationärerkennung" VALUE 0xE3E5A Kw_Ws16 0.6553500 O2 -0.3276800 0.3276700 FORMAT "%9.7" /end CHARACTERISTIC
/begin CHARACTERISTIC LSU_rO2Min_C "minimaler O2-Sollwert für Aktivierung der Lambda-1-Erkennung" VALUE 0xE3E5C Kw_Ws16 0.6553500 O2 -0.3276800 0.3276700 FORMAT "%9.7" /end CHARACTERISTIC
/begin CHARACTERISTIC LSU_rO2NegDvt_C "negative O2-Toleranz (0 - Vollast, 1 - Teillast, 2 - Schub)" VAL_BLK 0xE3E5E Kwb_Ws16 0.6553500 O2 -0.3276800 0.3276700 FORMAT "%9.7" NUMBER 3 /end CHARACTERISTIC
/begin CHARACTERISTIC LSU_rO2PosDvt_C "positive O2-Toleranz (0 - Vollast, 1 - Teillast, 2 - Schub)" VAL_BLK 0xE3E64 Kwb_Ws16 0.6553500 O2 -0.3276800 0.3276700 FORMAT "%9.7" NUMBER 3 /end CHARACTERISTIC
/begin CHARACTERISTIC LSU_stChpClbActv_C "Aktivierungsflags für O2- und Ri-Kalibrierung" VALUE 0xE3DC6 Kw_Wu8 3.000 OneToOne 0.00 3.000 FORMAT "%5.3" EXTENDED_LIMITS 0.00 255.0 /end CHARACTERISTIC
/begin CHARACTERISTIC LSU_stEGTClbOff_C "Bitmaske zur Unterdrückung der CJ12x-Kalibrierung bei Regenerationsanforderung Abgasnachbehandlung" VALUE 0xE3DC8 Kw_Wu32 4294967295.00 OneToOne 0.00 4294967295.00 FORMAT "%13.2" /end CHARACTERISTIC
/begin CHARACTERISTIC LSU_stMonActv_C "Aktivierungsflags für Diagnoseroutinen" VALUE 0xE3E6A Kw_Wu16 65535.00 OneToOne 0.00 65535.00 FORMAT "%8.2" /end CHARACTERISTIC
/begin CHARACTERISTIC LSU_stMonMsk_C "Bitmaske zur Unterdrückung der Diagnosen im Fall einer Regenerationsanforderung der Abgasnachbehandlung" VALUE 0xE3E6C Kw_Wu32 4294967295.00 OneToOne 0.00 4294967295.00 FORMAT "%13.2" /end CHARACTERISTIC
/begin CHARACTERISTIC LSU_stSelPlausChkSig_C "Auswahl O2-Signal für Plausibilisierung" VALUE 0xE3E70 Kw_Wu16 65535.00 OneToOne 0.00 65535.00 FORMAT "%8.2" /end CHARACTERISTIC
/begin CHARACTERISTIC LSU_swtVal_C "Freigabe oder Sperren der LSU-Funktionen - 1: ON,  0: OFF" VALUE 0xE3DE2 Kw_Wu8 1.000 OneToOne 0.00 1.000 FORMAT "%5.3" EXTENDED_LIMITS 0.00 255.0 /end CHARACTERISTIC
/begin CHARACTERISTIC LSU_swtType_C "Datensatz oder EEPROM-Wert Freigabe LSU Funktion" VALUE 0xE3DE3 Kw_Wu8 0.00 OneToOne 2.000 2.000 FORMAT "%5.3" EXTENDED_LIMITS 0.00 255.0 /end CHARACTERISTIC
/begin CHARACTERISTIC LSU_ti1stClb_C "Zeitdauer von SG-Start bis zu erster Kalibrierung CJ120" VALUE 0xE3DCC Kw_Wu16 655.3500 Time_s 0.00 655.3500 FORMAT "%8.4" /end CHARACTERISTIC
/begin CHARACTERISTIC LSU_tiDvt1Flt_C "Filterzeitkonstante für Lambda-1-Erkennung" VALUE 0xE3E72 Kw_Wu16 655.3500 Time_s 0.00 655.3500 FORMAT "%8.4" /end CHARACTERISTIC
/begin CHARACTERISTIC LSU_tiO2CalcFlt_C "Filterzeitkonstante für berechneten O2-Wert" VAL_BLK 0xE3E74 Kwb_Wu32 4294.9673 TimeDelay_s 0.0000010000000 4294.9673 FORMAT "%9.4" NUMBER 1 /end CHARACTERISTIC
/begin CHARACTERISTIC LSU_tiO2Eval_C "erforderliche Dauer für O2-Stationärerkennung" VALUE 0xE3E78 Kw_Wu16 655.3500 Time_s 0.00 655.3500 FORMAT "%8.4" /end CHARACTERISTIC
/begin CHARACTERISTIC LSU_tiPerClb_C "Periodendauer CJ120-Kalibrierung" VALUE 0xE3DCE Kw_Wu16 655.3500 Time_s 0.00 655.3500 FORMAT "%8.4" /end CHARACTERISTIC
/begin CHARACTERISTIC LSU_tiSwitch_CA "maximal zulässige Werte für Flankenzeit Last->Schub" VAL_BLK 0xE3E7A Kwb_Wu16 655.3500 Time_s 0.00 655.3500 FORMAT "%8.4" NUMBER 1 /end CHARACTERISTIC
/begin CHARACTERISTIC LSU_tiWait1_CA "Zeitdauer für Stationärerkennung Dynamiküberwachung" VAL_BLK 0xE3E7C Kwb_Wu16 655.3500 Time_s 0.00 655.3500 FORMAT "%8.4" NUMBER 1 /end CHARACTERISTIC
/begin CHARACTERISTIC LSU_tiWait2_CA "maximale Zeitdauer zum Erreichen der oberen O2-Schwelle in Dynamiküberwachung" VAL_BLK 0xE3E7E Kwb_Wu16 655.3500 Time_s 0.00 655.3500 FORMAT "%8.4" NUMBER 1 /end CHARACTERISTIC
/begin CHARACTERISTIC LSU_tiWait3_CA "maximale Zeitdauer zum Erreichen der oberen O2-Schwelle in Dynamiküberwachung" VAL_BLK 0xE3E80 Kwb_Wu16 655.3500 Time_s 0.00 655.3500 FORMAT "%8.4" NUMBER 1 /end CHARACTERISTIC
/begin CHARACTERISTIC LSU_uBattMin_C "minimale Batteriespannung" VALUE 0xE3DE4 Kw_Wu16 15992.18 Volt_Batt 0.00 15992.18 FORMAT "%8.2" EXTENDED_LIMITS 0.00 1281232. /end CHARACTERISTIC
/begin CHARACTERISTIC LSU_uMinClb_C "Minimalwert zur Erkennung einer niedrigen Batteriespannung" VALUE 0xE3DD0 Kw_Wu16 15992.18 Volt_Batt 0.00 15992.18 FORMAT "%8.2" EXTENDED_LIMITS 0.00 1281232. /end CHARACTERISTIC
/begin CHARACTERISTIC LSUCD_tiDebCircVirtGndDef_C "Defekt Entprellung der virtuellen Masse Lambdasensor" VALUE 0xE4056 Kw_Wu16 655350.0 Time_ms 0.00 655350.0 FORMAT "%8.1" /end CHARACTERISTIC
/begin CHARACTERISTIC LSUCD_tiDebCircVirtGndOk_C "Heilungsentprellung der virtuellen Masse Lambdasensor" VALUE 0xE4058 Kw_Wu16 655350.0 Time_ms 0.00 655350.0 FORMAT "%8.1" /end CHARACTERISTIC
/begin CHARACTERISTIC LSU_volMinFl_C "Minimales Kraftstoffvolumen im Tank" VALUE 0xE3E82 Kw_Ws16 300.0000 Fl_Half_L 0.00 300.0000 FORMAT "%8.4" EXTENDED_LIMITS -1638.400 1638.350 /end CHARACTERISTIC
/begin CHARACTERISTIC LubCD_ctInitDly_C "counter for delay after initialisation" VALUE 0xE40E8 Kw_Wu16 65535.00 OneToOne 0.00 65535.00 FORMAT "%8.2" /end CHARACTERISTIC
/begin CHARACTERISTIC LubCD_ctTogErr_C "debounce counter for interface error" VALUE 0xE40EA Kw_Wu8 255.0 OneToOne 0.00 255.0 FORMAT "%5.1" /end CHARACTERISTIC
/begin CHARACTERISTIC LubCD_numDioIn_C "Digitaler Eingang für Schmierungsteiltreiber" VALUE 0xE40EB Kw_Wu8 14.0000000000 NumPinDioIn 0.00 14.0000000000 FORMAT "%13.10" /end CHARACTERISTIC
/begin CHARACTERISTIC LubCD_stLoadPwmInInv_C "PWM Input to be inverted" VALUE 0xE40EC Kw_Wu8 1.000 OneToOne 0.00 1.000 FORMAT "%5.3" EXTENDED_LIMITS 0.00 255.0 /end CHARACTERISTIC
/begin CHARACTERISTIC LubCD_swtTogVer_C "Version des Ölniveausensors (1: Temperatur und Korrekturwert)" VALUE 0xE40ED Kw_Wu8 2.000 OneToOne 0.00 2.000 FORMAT "%5.3" EXTENDED_LIMITS 0.00 255.0 /end CHARACTERISTIC
/begin CHARACTERISTIC Lub_tiDebNplDef_C "Entprellzeit für nicht plausibles Signal der Schmierung" VALUE 0xE40EE Kw_Wu16 655350.0 Time_ms 0.00 655350.0 FORMAT "%8.1" /end CHARACTERISTIC
/begin CHARACTERISTIC Lub_tiDebNplOk_C "Fehler Rücksetzzeit für nicht plausibles Signal, Schmierung" VALUE 0xE40F0 Kw_Wu16 655350.0 Time_ms 0.00 655350.0 FORMAT "%8.1" /end CHARACTERISTIC
/begin CHARACTERISTIC Lub_tiDebSigDef_C "SIG fault debouncing time" VALUE 0xE40F2 Kw_Wu16 655350.0 Time_ms 0.00 655350.0 FORMAT "%8.1" /end CHARACTERISTIC
/begin CHARACTERISTIC Lub_tiDebSigOk_C "SIG fault Healing   time" VALUE 0xE40F4 Kw_Wu16 655350.0 Time_ms 0.00 655350.0 FORMAT "%8.1" /end CHARACTERISTIC
/begin CHARACTERISTIC MemMon_numErrChkRam_C "#SSD Fehlertoleranzschwelle für Doppelablage und zyklischen RAM-Test" VALUE 0xC33D4 Kw_Wu8 255.0 OneToOne 0.00 255.0 FORMAT "%5.1" /end CHARACTERISTIC
/begin CHARACTERISTIC MemMon_numErrChkRom_C "#SSD Fehlertoleranzschwelle für zyklischen ROM-Test" VALUE 0xC33D5 Kw_Wu8 255.0 OneToOne 0.00 255.0 FORMAT "%5.1" /end CHARACTERISTIC
/begin CHARACTERISTIC MemMon_tiHealChkRam_C "#SSD Heilungszeit für Fehler in der Doppelablage und im zyklischen RAM-Test" VALUE 0xC33D6 Kw_Wu8 10200. Time_ms_40ms 0.00 10200. FORMAT "%5.0" /end CHARACTERISTIC
/begin CHARACTERISTIC MemMon_tiHealChkRom_C "#SSD Heilungszeit für Fehler im zyklischen ROM-Test" VALUE 0xC33D7 Kw_Wu8 10200. Time_ms_40ms 0.00 10200. FORMAT "%5.0" /end CHARACTERISTIC
/begin CHARACTERISTIC MeUnCD_uSRCMin_C "#SSD Analogeingang, Signal Range Check Min-Spannungswert" VALUE 0xE4128 Kw_Ws16 5200.391 Volt 0.00 5200.391 FORMAT "%8.3" EXTENDED_LIMITS -160156.4 160151.5 /end CHARACTERISTIC
/begin CHARACTERISTIC MeUnCD_uSRCMax_C "#SSD Analogeingang, Signal Range Check Max-Spannungswert" VALUE 0xE412A Kw_Ws16 5200.391 Volt 0.00 5200.391 FORMAT "%8.3" EXTENDED_LIMITS -160156.4 160151.5 /end CHARACTERISTIC
/begin CHARACTERISTIC MeUnCD_iLin_CUR "#SSD Analogeingang, Linearisierungskennlinie" CURVE 0xE412C Kl_Xs16_Ws16 5000.000 Curr 0.00 5000.000 FORMAT "%8.3" EXTENDED_LIMITS -32768.00 32767.00
 /begin AXIS_DESCR STD_AXIS MeUnCD_uRawVal_mp Volt 2 0.00 5200.391 FORMAT "%8.3" EXTENDED_LIMITS -160156.4 160151.5 DEPOSIT ABSOLUTE /end AXIS_DESCR
/end CHARACTERISTIC
/begin CHARACTERISTIC MeUnCD_ctPwrStgOnMax_C "maximale Anzahl von Endstufen-Einschaltungen pro Fahrzyklus bei SCB oder Übertemperatur" VALUE 0xE4136 Kw_Wu16 65535.00 OneToOne 0.00 65535.00 FORMAT "%8.2" /end CHARACTERISTIC
/begin CHARACTERISTIC MeUnCD_dcycMax_C "#SSD Max-Wert, Ausgangstastverhältnis" VALUE 0xE4138 Kw_Ws16 100.0000 DtyCyc 0.00 100.0000 FORMAT "%8.4" EXTENDED_LIMITS -327.6800 327.6700 /end CHARACTERISTIC
/begin CHARACTERISTIC MeUnCD_dcycMin_C "#SSD Min-Wert, Ausgangstastverhältnis" VALUE 0xE413A Kw_Ws16 100.0000 DtyCyc 0.00 100.0000 FORMAT "%8.4" EXTENDED_LIMITS -327.6800 327.6700 /end CHARACTERISTIC
/begin CHARACTERISTIC MeUnCD_dcycSetValLin_CUR "#SSD Linearisierungskurve des Tastverhältnisses der  Zumesseinheit" CURVE 0xE413C Kl_Xs16_Ws16 100.0000 DtyCyc 0.00 100.0000 FORMAT "%8.4" EXTENDED_LIMITS -327.6800 327.6700
 /begin AXIS_DESCR STD_AXIS MeUnCD_dcycSetVal_mp DtyCyc 4 -327.6800 327.6700 FORMAT "%8.4" DEPOSIT ABSOLUTE /end AXIS_DESCR
/end CHARACTERISTIC
/begin CHARACTERISTIC MeUnCD_dcycTst_C "#SSD Tastverhältnis, das im Fehlerfall zyklisch ausgegeben wird" VALUE 0xE414E Kw_Ws16 100.0000 DtyCyc 0.00 100.0000 FORMAT "%8.4" EXTENDED_LIMITS -327.6800 327.6700 /end CHARACTERISTIC
/begin CHARACTERISTIC MeUnCD_DebExcTempDef_C "#SSD Fehlerentprellzeit Übertemperatur" VALUE 0xE4150 Kw_Wu16 655350.0 Time_ms 0.00 655350.0 FORMAT "%8.1" /end CHARACTERISTIC
/begin CHARACTERISTIC MeUnCD_DebExcTempOk_C "#SSD Heilungsentprellzeit Übertemperatur" VALUE 0xE4152 Kw_Wu16 655350.0 Time_ms 0.00 655350.0 FORMAT "%8.1" /end CHARACTERISTIC
/begin CHARACTERISTIC MeUnCD_DebNoLoadDef_C "#SSD Fehlerentprellzeit Leerlauf" VALUE 0xE4154 Kw_Wu16 655350.0 Time_ms 0.00 655350.0 FORMAT "%8.1" /end CHARACTERISTIC
/begin CHARACTERISTIC MeUnCD_DebNoLoadOk_C "#SSD Heilungszeit Leerlauf" VALUE 0xE4156 Kw_Wu16 655350.0 Time_ms 0.00 655350.0 FORMAT "%8.1" /end CHARACTERISTIC
/begin CHARACTERISTIC MeUnCD_DebShortCircBatDef_C "#SSD Fehlerentprellzeit Kurzschluss Batterie" VALUE 0xE4158 Kw_Wu16 655350.0 Time_ms 0.00 655350.0 FORMAT "%8.1" /end CHARACTERISTIC
/begin CHARACTERISTIC MeUnCD_DebShortCircBatOk_C "#SSD Heilungsentprellzeit Kurzschluss Batterie" VALUE 0xE415A Kw_Wu16 655350.0 Time_ms 0.00 655350.0 FORMAT "%8.1" /end CHARACTERISTIC
/begin CHARACTERISTIC MeUnCD_DebShortCircGndDef_C "#SSD Fehlerentprellzeit Kurzschluss Masse" VALUE 0xE415C Kw_Wu16 655350.0 Time_ms 0.00 655350.0 FORMAT "%8.1" /end CHARACTERISTIC
/begin CHARACTERISTIC MeUnCD_DebShortCircGndOk_C "#SSD Heilungsentprellzeit Kurzschluss Masse" VALUE 0xE415E Kw_Wu16 655350.0 Time_ms 0.00 655350.0 FORMAT "%8.1" /end CHARACTERISTIC
/begin CHARACTERISTIC MeUnCD_DebSRCHighDef_C "#SSD Fehlerentprellzeit für Analogeingang SRC-High Fehler" VALUE 0xE4160 Kw_Wu16 655350.0 Time_ms 0.00 655350.0 FORMAT "%8.1" /end CHARACTERISTIC
/begin CHARACTERISTIC MeUnCD_DebSRCHighOk_C "#SSD Heilungsentprellzeit für Analogeingang SRC-High Fehler" VALUE 0xE4162 Kw_Wu16 655350.0 Time_ms 0.00 655350.0 FORMAT "%8.1" /end CHARACTERISTIC
/begin CHARACTERISTIC MeUnCD_DebSRCLowDef_C "#SSD Fehlerentprellzeit Analogeingang SRC-Low Fehler" VALUE 0xE4164 Kw_Wu16 655350.0 Time_ms 0.00 655350.0 FORMAT "%8.1" /end CHARACTERISTIC
/begin CHARACTERISTIC MeUnCD_DebSRCLowOk_C "#SSD Heilungsentprellzeit für Analogeingang SRC-Low Fehler" VALUE 0xE4166 Kw_Wu16 655350.0 Time_ms 0.00 655350.0 FORMAT "%8.1" /end CHARACTERISTIC
/begin CHARACTERISTIC MeUnCD_facIGovInit_CUR "#SSD Initialisierungsfaktor für I-Anteil des Stromreglers als Funktion der Systemtemperatur" CURVE 0xE4168 Kl_Xs16_Ws16 2.000000 Fact 0.00 2.000000 FORMAT "%8.6" EXTENDED_LIMITS -4.000000 3.999878
 /begin AXIS_DESCR STD_AXIS FlSys_t Temp_Cels 3 -50.14000 199.8600 FORMAT "%8.4" EXTENDED_LIMITS -3549.940 3003.560 DEPOSIT ABSOLUTE /end AXIS_DESCR
/end CHARACTERISTIC
/begin CHARACTERISTIC MeUnCD_facIGovMax_C "#SSD maximaler I-Anteil" VALUE 0xE4176 Kw_Ws16 1.000000 Fact 1.000000 2.000000 FORMAT "%8.6" EXTENDED_LIMITS -4.000000 3.999878 /end CHARACTERISTIC
/begin CHARACTERISTIC MeUnCD_facIGovMin_C "#SSD minimaler I-Anteil" VALUE 0xE4178 Kw_Ws16 0.5000000 Fact 0.5000000 1.000000 FORMAT "%8.6" EXTENDED_LIMITS -4.000000 3.999878 /end CHARACTERISTIC
/begin CHARACTERISTIC MeUnCD_tiFlt1PT1_C "#SSD PT1 Filter Zeitkonstante für Strom-Istwert" VALUE 0xE417C Kw_Wu32 4294.9673 TimeDelay_s 0.0000010000000 4294.9673 FORMAT "%9.4" /end CHARACTERISTIC
/begin CHARACTERISTIC MeUnCD_tiFlt2PT1_C "#SSD PT1 Filter Zeitkonstante für Strom-Sollwert" VALUE 0xE4180 Kw_Wu32 4294.9673 TimeDelay_s 0.0000010000000 4294.9673 FORMAT "%9.4" /end CHARACTERISTIC
/begin CHARACTERISTIC MeUnCD_tiIGovDT1_C "#SSD DT1 Zeitkonstante" VALUE 0xE4184 Kw_Wu32 4294.9673 TimeDelay_s 0.0000010000000 4294.9673 FORMAT "%9.4" /end CHARACTERISTIC
/begin CHARACTERISTIC MeUnCD_IGovDKd_C "#SSD DT1 Differenziationsfaktor" VALUE 0xE4188 Kw_Ws32 65535.9999847 Kd -32768.0000000 32767.9999847 FORMAT "%13.7" /end CHARACTERISTIC
/begin CHARACTERISTIC MeUnCD_IGovIKi_C "#SSD I-Glied, Kleinsignalverstärkung" VALUE 0xE418C Kw_Wu32 122.070312472 Ki_curr2fact 0.00 122.070312472 FORMAT "%13.9" /end CHARACTERISTIC
/begin CHARACTERISTIC MeUnCD_IGovIKiPos_C "#SSD I-Glied, Verstärkung für positive Großsignale" VALUE 0xE4190 Kw_Wu32 122.070312472 Ki_curr2fact 0.00 122.070312472 FORMAT "%13.9" /end CHARACTERISTIC
/begin CHARACTERISTIC MeUnCD_IGovIKiNeg_C "#SSD I-Glied, Verstärkung für negative Großsignale" VALUE 0xE4194 Kw_Wu32 122.070312472 Ki_curr2fact 0.00 122.070312472 FORMAT "%13.9" /end CHARACTERISTIC
/begin CHARACTERISTIC MeUnCD_iIGovIWinPos_C "#SSD I-Glied, Kleinsignalfenster positiv" VALUE 0xE4198 Kw_Ws16 65535.00 Curr -32768.00 32767.00 FORMAT "%8.2" /end CHARACTERISTIC
/begin CHARACTERISTIC MeUnCD_iIGovIWinNeg_C "#SSD I-Glied, Kleinsignalfenster negativ" VALUE 0xE419A Kw_Ws16 65535.00 Curr -32768.00 32767.00 FORMAT "%8.2" /end CHARACTERISTIC
/begin CHARACTERISTIC MeUnCD_tiFltPT1Init_C "#SSD PT1 Filter Zeitkonstante während Initialisierungsphase des Stromreglers" VALUE 0xE419C Kw_Wu32 4294.9673 TimeDelay_s 0.0000010000000 4294.9673 FORMAT "%9.4" /end CHARACTERISTIC
/begin CHARACTERISTIC MeUnCD_nDiffMax_C "#SSD maximale Differenz zwischen gefilterter Drehzahl für Kennlinie und aktueller Drehzahl um neuen Drehzahlwert zu übernehmen" VALUE 0xE41A0 Kw_Ws16 6000.000 EngN 0.00 6000.000 FORMAT "%8.3" EXTENDED_LIMITS -32768.00 32767.00 /end CHARACTERISTIC
/begin CHARACTERISTIC MeUnCD_numAdc_C "#SSD Parameter für die Auswahl des Analogkanals für die Zumesseinheit" VALUE 0xE41A2 Kw_Wu8 24.0000000000 NumPinAdc 0.00 24.0000000000 FORMAT "%13.10" /end CHARACTERISTIC
/begin CHARACTERISTIC MeUnCD_numDia1_C "#SSD Parameter für Zuordnung der Diagnose zur 1. Endstufe der Zumesseinheit" VALUE 0xE41A3 Kw_Wu8 27.0000000000 NumPinDia 0.00 27.0000000000 FORMAT "%13.10" /end CHARACTERISTIC
/begin CHARACTERISTIC MeUnCD_numDia2_C "#SSD Parameter für Zuordnung der Diagnose zur 2. Endstufe der Zumesseinheit" VALUE 0xE41A4 Kw_Wu8 27.0000000000 NumPinDia 0.00 27.0000000000 FORMAT "%13.10" /end CHARACTERISTIC
/begin CHARACTERISTIC MeUnCD_numPwmOut_C "#SSD Parameter für die Auswahl des Hardware-Pins für die Zumesseinheit" VALUE 0xE41A5 Kw_Wu8 12.0000000000 NumPinPwmOut 0.00 12.0000000000 FORMAT "%13.10" /end CHARACTERISTIC
/begin CHARACTERISTIC MeUnCD_resCoil_C "#SSD Widerstandswert der Spule für die Zumesseinheit" VALUE 0xE41A6 Kw_Ws16 5000.000 Resist_1 0.00 5000.000 FORMAT "%8.3" EXTENDED_LIMITS -32768.00 32767.00 /end CHARACTERISTIC
/begin CHARACTERISTIC MeUnCD_stInvOut_C "#SSD Invertierungsparameter der PWM Endstufe" VALUE 0xE41A8 Kw_Wu8 1.000 OneToOne 0.00 1.000 FORMAT "%5.3" EXTENDED_LIMITS 0.00 255.0 /end CHARACTERISTIC
/begin CHARACTERISTIC MeUnCD_stPwrStgDia_C "#SSD Statuswort zur Spezifikation des Abschaltverhaltens der Endstufenfehlerdiagnose Zumesseinheit" VALUE 0xE41A9 Kw_Wu8 255.0 OneToOne 0.00 255.0 FORMAT "%5.1" /end CHARACTERISTIC
/begin CHARACTERISTIC MeUnCD_stSPICtl_C "Parameter zur Anzeige der verwendeten Endstufenart ( 1 = SPI fähige Endstufe, 0 = nicht SPI fähige Endstufe )" VALUE 0xE41AA Kw_Wu8 1.000 OneToOne 0.00 1.000 FORMAT "%5.3" EXTENDED_LIMITS 0.00 255.0 /end CHARACTERISTIC
/begin CHARACTERISTIC MeUnCD_swt_C "#SSD allgemeine Schalterfunktionen der Endstufe für die Zumesseinheit (Bit0: 1...Korrektur ein, 0...aus; Bit1-7: reserviert)" VALUE 0xE41AB Kw_Wu8 255.0 OneToOne 0.00 255.0 FORMAT "%5.1" /end CHARACTERISTIC
/begin CHARACTERISTIC MeUnCD_tiBtwTst_C "#SSD Zeitabstand, in dem im Fehlerfall die Endstufe getestet wird" VALUE 0xE41AC Kw_Wu16 29990.00 Time_ms 10.00000 30000.00 FORMAT "%8.2" EXTENDED_LIMITS 0.00 655350.0 /end CHARACTERISTIC
/begin CHARACTERISTIC MeUnCD_tiIGovInit_C "#SSD maximale Zeitdauer der Initialisierungsphase" VALUE 0xE41AE Kw_Wu16 655350.0 Time_ms 0.00 655350.0 FORMAT "%8.1" /end CHARACTERISTIC
/begin CHARACTERISTIC MeUnCD_tiPer_CUR "#SSD Kennlinie für Periodendauer der PWM-Endstufe" CURVE 0xE41B0 Kl_Xs16_Ws16 6.400000 Period 0.1000000 6.500000 FORMAT "%8.6" EXTENDED_LIMITS -3276.800 3276.700
 /begin AXIS_DESCR STD_AXIS MeUnCD_nDiffRef_mp EngN 30 -32768.00 32767.00 FORMAT "%8.2" DEPOSIT ABSOLUTE /end AXIS_DESCR
/end CHARACTERISTIC
/begin CHARACTERISTIC MeUnCD_tiPwrStgOn_C "Zeit, für welche die Endstufe beim Fall der nicht SPI fähige Endstufe eingeschaltet wird." VALUE 0xE422A Kw_Wu16 655140.0 Time_ms 0.00 655140.0 FORMAT "%8.1" EXTENDED_LIMITS 0.00 655350.0 /end CHARACTERISTIC
/begin CHARACTERISTIC MeUnCD_tiDebSigDefSigTst_C "Fehlerentprellzeit fuer Fehlerpfad Dfp_MeUnCD_SigTst" VALUE 0xE422C Kw_Wu16 655350.0 Time_ms 0.00 655350.0 FORMAT "%8.1" /end CHARACTERISTIC
/begin CHARACTERISTIC MeUnCD_tiDebSigOkSigTst_C "Heilungsentprellzeit fuer Fehlerpfad Dfp_MeUnCD_SigTst" VALUE 0xE422E Kw_Wu16 655350.0 Time_ms 0.00 655350.0 FORMAT "%8.1" /end CHARACTERISTIC
/begin CHARACTERISTIC MeUn_iCnvFlowRate_CUR "#SSD Kennlinie zur Umrechnung von Volumenstrom nach Strom" CURVE 0xE40F6 Kl_Xs16_Ws16 5000.000 Curr 0.00 5000.000 FORMAT "%8.3" EXTENDED_LIMITS -32768.00 32767.00
 /begin AXIS_DESCR STD_AXIS Rail_dvolMeUnSet Qp_mm3_sec 10 -10000.00 50000.00 FORMAT "%8.2" EXTENDED_LIMITS -327680.0 327670.0 DEPOSIT ABSOLUTE /end AXIS_DESCR
/end CHARACTERISTIC
/begin CHARACTERISTIC MeUn_iSetMin_C "#SSD Sollstrom bei elektrischer Abschaltung der Zumesseinheit" VALUE 0xE4120 Kw_Ws16 65535.00 Curr -32768.00 32767.00 FORMAT "%8.2" /end CHARACTERISTIC
/begin CHARACTERISTIC MeUn_iSet_Vector "#SSD Bypass-Label für MeUn_iSet (Nicht verstellen!)" VALUE 0xC312E Kw_Wu8 255.0 OneToOne 0.00 255.0 FORMAT "%5.1" /end CHARACTERISTIC
/begin CHARACTERISTIC MeUn_iSet_Channel "#SSD Bypass-Label für MeUn_iSet, nicht editieren !" VALUE 0xC312F Kw_Wu8 255.0 OneToOne 0.00 255.0 FORMAT "%5.1" /end CHARACTERISTIC
/begin CHARACTERISTIC MeUn_pActrPrt_C "#SSD Raildruckschwelle für die Freigabe der Stellerschutzfunktion" VALUE 0xE4122 Kw_Ws16 6553.500 Pres_Rail -3276.800 3276.700 FORMAT "%5.3" /end CHARACTERISTIC
/begin CHARACTERISTIC MeUn_pFlowOfFl_C "#SSD Raildruckschwelle zum Rückschalten auf Stellwertvorgabe der Hochdruckregelung" VALUE 0xE4124 Kw_Ws16 6553.500 Pres_Rail -3276.800 3276.700 FORMAT "%5.3" /end CHARACTERISTIC
/begin CHARACTERISTIC MRlyCD_ctTooEarlyThres_C "#SSD Schwelle die MRlyCD_ctTooEarly_mp überschreiten muß bis Fehler Hauptrelais öffnet zu früh gemeldet wird" VALUE 0xE4230 Kw_Wu8 255.0 OneToOne 0.00 255.0 FORMAT "%5.1" /end CHARACTERISTIC
/begin CHARACTERISTIC MRlyCD_numDioOutMnRly_C "#SSD application parameter for main relay" VALUE 0xE4231 Kw_Wu8 11.0000000000 NumPinDioOut 0.00 11.0000000000 FORMAT "%13.10" /end CHARACTERISTIC
/begin CHARACTERISTIC MRlyCD_numDioOutPSOFF_C "#SSD application parameter for CY310 PSOFF bit" VALUE 0xE4232 Kw_Wu8 11.0000000000 NumPinDioOut 0.00 11.0000000000 FORMAT "%13.10" /end CHARACTERISTIC
/begin CHARACTERISTIC MRlyCD_stInvOut_C "#SSD Invertierungsparameter für Hauptrelais Ausgangssignal" VALUE 0xE4233 Kw_Wu8 1.000 OneToOne 0.00 1.000 FORMAT "%5.3" EXTENDED_LIMITS 0.00 255.0 READ_ONLY /end CHARACTERISTIC
/begin CHARACTERISTIC MRlyCD_tiNotOpen_C "#SSD Zeit nach dem Öffnen des Hauptrelais bis Fehler Hauptrelais öffnet nicht rechtzeitig erkannt wird" VALUE 0xE4234 Kw_Wu16 655350.0 Time_ms 0.00 655350.0 FORMAT "%8.1" /end CHARACTERISTIC
/begin CHARACTERISTIC MSidCD_Comm_DebNplDef_C "#SSD Fehlererkennungszeit Fehler Plausibilisierung privater CAN" VALUE 0xE4236 Kw_Wu16 655350.0 Time_ms 0.00 655350.0 FORMAT "%8.1" /end CHARACTERISTIC
/begin CHARACTERISTIC MSidCD_Comm_DebNplOk_C "Heilungszeit SG-Auswahl, Fehler Plausibilisierung privater CAN" VALUE 0xE4238 Kw_Wu16 655350.0 Time_ms 0.00 655350.0 FORMAT "%8.1" /end CHARACTERISTIC
/begin CHARACTERISTIC MSidCD_numECUS_C "#SSD Anzahl der ECU in diesem system: 1 - 4 (Master/Slave)" VALUE 0xE423A Kw_Wu8 3.000 OneToOne 1.000 4.000 FORMAT "%5.3" EXTENDED_LIMITS 0.00 255.0 /end CHARACTERISTIC
/begin CHARACTERISTIC MSidCD_Pin_DebSigDef_C "Defekterkennungszeit SG-Asuwahl, Pinfehler" VALUE 0xE423C Kw_Wu16 655350.0 Time_ms 0.00 655350.0 FORMAT "%8.1" /end CHARACTERISTIC
/begin CHARACTERISTIC MSidCD_Pin_DebSigOk_C "Heilungszeit SG-Auswahl, Pinfehler" VALUE 0xE423E Kw_Wu16 655350.0 Time_ms 0.00 655350.0 FORMAT "%8.1" /end CHARACTERISTIC
/begin CHARACTERISTIC MSidCD_Select_DebNplDef_C "#SSD Defekterkennungszeit ECU Selection (Botschaften nicht plausibel)" VALUE 0xE4240 Kw_Wu16 655350.0 Time_ms 0.00 655350.0 FORMAT "%8.1" /end CHARACTERISTIC
/begin CHARACTERISTIC MSidCD_Select_DebNplOk_C "#SSD Heilungszeit SG-Auswahl (Botschaften nicht plausibel)" VALUE 0xE4242 Kw_Wu16 655350.0 Time_ms 0.00 655350.0 FORMAT "%8.1" /end CHARACTERISTIC
/begin CHARACTERISTIC MSidCD_Sel_INI_DebNplDef_C "Defekterkennungszeit SG-Auswahl (NeuLernen ist nicht erlaubt)" VALUE 0xE4244 Kw_Wu16 655350.0 Time_ms 0.00 655350.0 FORMAT "%8.1" /end CHARACTERISTIC
/begin CHARACTERISTIC MSidCD_Sel_INI_DebNplOk_C "Heilungszeit SG-Auswahl (NeuLernen ist nicht erlaubt)" VALUE 0xE4246 Kw_Wu16 655350.0 Time_ms 0.00 655350.0 FORMAT "%8.1" /end CHARACTERISTIC
/begin CHARACTERISTIC MSidCD_Sel_INI_DebSigDef_C "Defekterkennungszeit SG-Auswahl (1.Plaus. am Beginn jedes Fahrzyklus)" VALUE 0xE4248 Kw_Wu16 655350.0 Time_ms 0.00 655350.0 FORMAT "%8.1" /end CHARACTERISTIC
/begin CHARACTERISTIC MSidCD_Sel_INI_DebSigOk_C "Heilungszeit SG-Auswahl (1.Plaus. am Beginn des Fahrzyklus)" VALUE 0xE424A Kw_Wu16 655350.0 Time_ms 0.00 655350.0 FORMAT "%8.1" /end CHARACTERISTIC
/begin CHARACTERISTIC MSidCD_stCANprivErrMsk_C "Maske für Auswahl Error-Stati Kommunikation priv. CAN" VALUE 0xE424C Kw_Wu16 255.0000 OneToOne 0.00 255.0000 FORMAT "%8.4" EXTENDED_LIMITS 0.00 65535.00 /end CHARACTERISTIC
/begin CHARACTERISTIC MSidCD_stErrInjOFF_C "#SSD Maske für Abschaltung Einspritzung im Fehlerfall SG-Auswahl" VALUE 0xE424E Kw_Wu8 255.0 OneToOne 0.00 255.0 FORMAT "%5.1" /end CHARACTERISTIC
/begin CHARACTERISTIC MSidCD_stInv_C "Schalter zur Invertierung des digitalen Eingangsignals" VALUE 0xE424F Kw_Wu8 1.000 OneToOne 0.00 1.000 FORMAT "%5.3" EXTENDED_LIMITS 0.00 255.0 /end CHARACTERISTIC
/begin CHARACTERISTIC MSidCD_swtCanDeb_C "#SSD Entprellmodus Zustandsautomat priv. CAN (1...Entprellen, 0...kein Entprellen)" VALUE 0xE4250 Kw_Ws8 255.0 OneToOne -128.0 127.0 FORMAT "%5.1" /end CHARACTERISTIC
/begin CHARACTERISTIC MSidCD_swtLearn_C "Schalter Lern-Modus Neulernen SG-Auswahl (1...lernen erlaubt, 0...lernen nicht erlaubt)" VALUE 0xE4251 Kw_Ws8 255.0 OneToOne -128.0 127.0 FORMAT "%5.1" /end CHARACTERISTIC
/begin CHARACTERISTIC MSidCD_swtMAIN_C "#SSD ID SG-Auswahl (-1/FFh...Single, 0...Master, 1...Slave, 64/40h...detection with pin)" VALUE 0xE4252 Kw_Ws8 255.0 OneToOne -128.0 127.0 FORMAT "%5.1" /end CHARACTERISTIC
/begin CHARACTERISTIC MSidCD_tiCanDeb_C "#SSD Entprelltimer Status privater CAN" VALUE 0xE4254 Kw_Wu16 655350.0 Time_ms 0.00 655350.0 FORMAT "%8.1" /end CHARACTERISTIC
/begin CHARACTERISTIC NetMng_CANFadeOutMaskA_C "#SSD CAN-Ausblendmaske CAN A" VALUE 0xE4258 Kw_Wu8 255.0 OneToOne 0.00 255.0 FORMAT "%5.1" /end CHARACTERISTIC
/begin CHARACTERISTIC NetMng_CANFadeOutMaskB_C "#SSD CAN-Ausblendmaske CAN B" VALUE 0xE4259 Kw_Wu8 255.0 OneToOne 0.00 255.0 FORMAT "%5.1" /end CHARACTERISTIC
/begin CHARACTERISTIC NetMng_CANFadeOutMaskC_C "CAN-Ausblendmaske CAN C" VALUE 0xE425A Kw_Wu8 255.0 OneToOne 0.00 255.0 FORMAT "%5.1" /end CHARACTERISTIC
/begin CHARACTERISTIC NetMng_ctBusOffRetriesA_C "#SSD Zählergrenze für Recoveries nach Busoff CAN A" VALUE 0xE425B Kw_Wu8 255.0 OneToOne 0.00 255.0 FORMAT "%5.1" /end CHARACTERISTIC
/begin CHARACTERISTIC NetMng_ctBusOffRetriesB_C "#SSD Zählergrenze für Recoveries nach Busoff CAN B" VALUE 0xE425C Kw_Wu8 255.0 OneToOne 0.00 255.0 FORMAT "%5.1" /end CHARACTERISTIC
/begin CHARACTERISTIC NetMng_ctBusOffRetriesC_C "Zählergrenze für Recoveries nach Busoff CAN C" VALUE 0xE425D Kw_Wu8 255.0 OneToOne 0.00 255.0 FORMAT "%5.1" /end CHARACTERISTIC
/begin CHARACTERISTIC NetMng_ctInitRetryCanA_C "#SSD Zählergrenze für Initretries CAN A" VALUE 0xE425E Kw_Wu8 255.0 OneToOne 0.00 255.0 FORMAT "%5.1" /end CHARACTERISTIC
/begin CHARACTERISTIC NetMng_ctInitRetryCanB_C "#SSD Zählergrenze für Initretries CAN B" VALUE 0xE425F Kw_Wu8 255.0 OneToOne 0.00 255.0 FORMAT "%5.1" /end CHARACTERISTIC
/begin CHARACTERISTIC NetMng_ctInitRetryCanC_C "Zählergrenze für Initretries CAN C" VALUE 0xE4260 Kw_Wu8 255.0 OneToOne 0.00 255.0 FORMAT "%5.1" /end CHARACTERISTIC
/begin CHARACTERISTIC NetMng_tiDebPosBusMonCanA_C "#SSD Entprellzeit CAN-Ausblendung ein Can A" VALUE 0xE4262 Kw_Wu16 2000.000 TimeDeb 0.00 2000.000 FORMAT "%8.3" EXTENDED_LIMITS 0.00 655350.0 /end CHARACTERISTIC
/begin CHARACTERISTIC NetMng_tiDebNegBusMonCanA_C "#SSD Entprellzeit CAN-Ausblendung aus Can A" VALUE 0xE4264 Kw_Wu16 2000.000 TimeDeb 0.00 2000.000 FORMAT "%8.3" EXTENDED_LIMITS 0.00 655350.0 /end CHARACTERISTIC
/begin CHARACTERISTIC NetMng_tiDebPosBusMonCanB_C "#SSD Entprellzeit CAN-Ausblendung ein Can B" VALUE 0xE4266 Kw_Wu16 2000.000 TimeDeb 0.00 2000.000 FORMAT "%8.3" EXTENDED_LIMITS 0.00 655350.0 /end CHARACTERISTIC
/begin CHARACTERISTIC NetMng_tiDebNegBusMonCanB_C "#SSD Entprellzeit CAN-Ausblendung aus Can B" VALUE 0xE4268 Kw_Wu16 2000.000 TimeDeb 0.00 2000.000 FORMAT "%8.3" EXTENDED_LIMITS 0.00 655350.0 /end CHARACTERISTIC
/begin CHARACTERISTIC NetMng_tiDebPosBusMonCanC_C "Entprellzeit CAN-Ausblendung ein Can C" VALUE 0xE426A Kw_Wu16 2000.000 TimeDeb 0.00 2000.000 FORMAT "%8.3" EXTENDED_LIMITS 0.00 655350.0 /end CHARACTERISTIC
/begin CHARACTERISTIC NetMng_tiDebNegBusMonCanC_C "Entprellzeit CAN-Ausblendung aus Can C" VALUE 0xE426C Kw_Wu16 2000.000 TimeDeb 0.00 2000.000 FORMAT "%8.3" EXTENDED_LIMITS 0.00 655350.0 /end CHARACTERISTIC
/begin CHARACTERISTIC NetMng_tiDebPosBusOffCanA_C "#SSD Defektzeit Busoff Can A" VALUE 0xE426E Kw_Wu16 2000.000 TimeDeb 0.00 2000.000 FORMAT "%8.3" EXTENDED_LIMITS 0.00 655350.0 /end CHARACTERISTIC
/begin CHARACTERISTIC NetMng_tiDebNegBusOffCanA_C "#SSD Heilzeit Busoff Can A" VALUE 0xE4270 Kw_Wu16 2000.000 TimeDeb 0.00 2000.000 FORMAT "%8.3" EXTENDED_LIMITS 0.00 655350.0 /end CHARACTERISTIC
/begin CHARACTERISTIC NetMng_tiDebPosBusOffCanB_C "#SSD Defektzeit Busoff Can B" VALUE 0xE4272 Kw_Wu16 2000.000 TimeDeb 0.00 2000.000 FORMAT "%8.3" EXTENDED_LIMITS 0.00 655350.0 /end CHARACTERISTIC
/begin CHARACTERISTIC NetMng_tiDebNegBusOffCanB_C "#SSD Heilzeit Busoff Can B" VALUE 0xE4274 Kw_Wu16 2000.000 TimeDeb 0.00 2000.000 FORMAT "%8.3" EXTENDED_LIMITS 0.00 655350.0 /end CHARACTERISTIC
/begin CHARACTERISTIC NetMng_tiDebPosBusOffCanC_C "Defektzeit Busoff Can C" VALUE 0xE4276 Kw_Wu16 2000.000 TimeDeb 0.00 2000.000 FORMAT "%8.3" EXTENDED_LIMITS 0.00 655350.0 /end CHARACTERISTIC
/begin CHARACTERISTIC NetMng_tiDebNegBusOffCanC_C "Heilzeit Busoff Can C" VALUE 0xE4278 Kw_Wu16 2000.000 TimeDeb 0.00 2000.000 FORMAT "%8.3" EXTENDED_LIMITS 0.00 655350.0 /end CHARACTERISTIC
/begin CHARACTERISTIC NetMng_tiDebPosErrCanA_C "#SSD Defektzeit ""error active"" Can A" VALUE 0xE427A Kw_Wu16 2000.000 TimeDeb 0.00 2000.000 FORMAT "%8.3" EXTENDED_LIMITS 0.00 655350.0 /end CHARACTERISTIC
/begin CHARACTERISTIC NetMng_tiDebNegErrCanA_C "#SSD Heilzeit ""error active"" Can A" VALUE 0xE427C Kw_Wu16 2000.000 TimeDeb 0.00 2000.000 FORMAT "%8.3" EXTENDED_LIMITS 0.00 655350.0 /end CHARACTERISTIC
/begin CHARACTERISTIC NetMng_tiDebPosErrCanB_C "#SSD Defektzeit ""error active"" Can B" VALUE 0xE427E Kw_Wu16 2000.000 TimeDeb 0.00 2000.000 FORMAT "%8.3" EXTENDED_LIMITS 0.00 655350.0 /end CHARACTERISTIC
/begin CHARACTERISTIC NetMng_tiDebNegErrCanB_C "#SSD Heilzeit ""error active"" Can B" VALUE 0xE4280 Kw_Wu16 2000.000 TimeDeb 0.00 2000.000 FORMAT "%8.3" EXTENDED_LIMITS 0.00 655350.0 /end CHARACTERISTIC
/begin CHARACTERISTIC NetMng_tiDebPosErrCanC_C "Defektzeit ""error active"" Can C" VALUE 0xE4282 Kw_Wu16 2000.000 TimeDeb 0.00 2000.000 FORMAT "%8.3" EXTENDED_LIMITS 0.00 655350.0 /end CHARACTERISTIC
/begin CHARACTERISTIC NetMng_tiDebNegErrCanC_C "Heilzeit ""error active"" Can C" VALUE 0xE4284 Kw_Wu16 2000.000 TimeDeb 0.00 2000.000 FORMAT "%8.3" EXTENDED_LIMITS 0.00 655350.0 /end CHARACTERISTIC
/begin CHARACTERISTIC NetMng_tiDebPosMonCanA_C "#SSD Entprellzeit Ausblendung für SW ein Can A" VALUE 0xE4286 Kw_Wu16 2000.000 TimeDeb 0.00 2000.000 FORMAT "%8.3" EXTENDED_LIMITS 0.00 655350.0 /end CHARACTERISTIC
/begin CHARACTERISTIC NetMng_tiDebNegMonCanA_C "#SSD Entprellzeit Ausblendung für SW aus Can A" VALUE 0xE4288 Kw_Wu16 2000.000 TimeDeb 0.00 2000.000 FORMAT "%8.3" EXTENDED_LIMITS 0.00 655350.0 /end CHARACTERISTIC
/begin CHARACTERISTIC NetMng_tiDebPosMonCanB_C "#SSD Entprellzeit Ausblendung für SW ein Can B" VALUE 0xE428A Kw_Wu16 2000.000 TimeDeb 0.00 2000.000 FORMAT "%8.3" EXTENDED_LIMITS 0.00 655350.0 /end CHARACTERISTIC
/begin CHARACTERISTIC NetMng_tiDebNegMonCanB_C "#SSD Entprellzeit Ausblendung für SW aus Can B" VALUE 0xE428C Kw_Wu16 2000.000 TimeDeb 0.00 2000.000 FORMAT "%8.3" EXTENDED_LIMITS 0.00 655350.0 /end CHARACTERISTIC
/begin CHARACTERISTIC NetMng_tiDebPosMonCanC_C "Entprellzeit Ausblendung für SW ein Can C" VALUE 0xE428E Kw_Wu16 2000.000 TimeDeb 0.00 2000.000 FORMAT "%8.3" EXTENDED_LIMITS 0.00 655350.0 /end CHARACTERISTIC
/begin CHARACTERISTIC NetMng_tiDebNegMonCanC_C "Entprellzeit Ausblendung für SW aus Can C" VALUE 0xE4290 Kw_Wu16 2000.000 TimeDeb 0.00 2000.000 FORMAT "%8.3" EXTENDED_LIMITS 0.00 655350.0 /end CHARACTERISTIC
/begin CHARACTERISTIC NetMng_FadeOutMaskA_C "#SSD SW-Ausblendmaske CAN A" VALUE 0xE4292 Kw_Wu16 65535.00 OneToOne 0.00 65535.00 FORMAT "%8.2" /end CHARACTERISTIC
/begin CHARACTERISTIC NetMng_FadeOutMaskB_C "#SSD SW-Ausblendmaske CAN B" VALUE 0xE4294 Kw_Wu16 65535.00 OneToOne 0.00 65535.00 FORMAT "%8.2" /end CHARACTERISTIC
/begin CHARACTERISTIC NetMng_FadeOutMaskC_C "SW-Ausblendmaske CAN C" VALUE 0xE4296 Kw_Wu16 65535.00 OneToOne 0.00 65535.00 FORMAT "%8.2" /end CHARACTERISTIC
/begin CHARACTERISTIC NetMng_SplyVltgHysXLow_C "Untere Grenze Hysterese Versorgungsspannung" VALUE 0xE4298 Kw_Ws16 13998.04 Volt_Batt 0.00 13998.04 FORMAT "%8.2" EXTENDED_LIMITS -640625.6 640606.1 /end CHARACTERISTIC
/begin CHARACTERISTIC NetMng_SplyVltgHysXHigh_C "Obere Grenze Hysterese Versorgungsspannung" VALUE 0xE429A Kw_Ws16 13998.04 Volt_Batt 0.00 13998.04 FORMAT "%8.2" EXTENDED_LIMITS -640625.6 640606.1 /end CHARACTERISTIC
/begin CHARACTERISTIC NetMng_SplyVltgHysYLow_C "#SSD Unterer Ausgangswert Hysterese Versorgungsspannung" VALUE 0xE429C Kw_Ws16 0.00 OneToOne 1.000000 1.000000 FORMAT "%8.6" EXTENDED_LIMITS -32768.00 32767.00 READ_ONLY /end CHARACTERISTIC
/begin CHARACTERISTIC NetMng_SplyVltgHysYHigh_C "#SSD Oberer Ausgangswert Hysterese Versorgungsspannung" VALUE 0xE429E Kw_Ws16 0.00 OneToOne 0.00 0.00 FORMAT "%8.2" EXTENDED_LIMITS -32768.00 32767.00 READ_ONLY /end CHARACTERISTIC
/begin CHARACTERISTIC NetMng_swtONWM_C "#SSD Enable/disable OSEK Netzwerkmanagement (0...NWM disabled, >0...NWM enabled)" VALUE 0xE4256 Kw_Wu8 1.000 OneToOne 0.00 1.000 FORMAT "%5.3" EXTENDED_LIMITS 0.00 255.0 /end CHARACTERISTIC
/begin CHARACTERISTIC NetMng_tiFadeoutLowBat_C "#SSD Ausblendzeit nach Unterspannung Versorgung" VALUE 0xE42A0 Kw_Wu16 327670.0 Time_ms 0.00 327670.0 FORMAT "%8.1" EXTENDED_LIMITS 0.00 655350.0 /end CHARACTERISTIC
/begin CHARACTERISTIC NetMng_tiFadeoutMin_C "Ausblendzeit nach Initialisierung" VALUE 0xE42A2 Kw_Wu16 327670.0 Time_ms 0.00 327670.0 FORMAT "%8.1" EXTENDED_LIMITS 0.00 655350.0 /end CHARACTERISTIC
/begin CHARACTERISTIC NetMng_tiRecoverA_C "#SSD Zeit zwischen den Recoveries Can A" VALUE 0xE42A4 Kw_Wu16 327670.0 Time_ms 0.00 327670.0 FORMAT "%8.1" EXTENDED_LIMITS 0.00 655350.0 /end CHARACTERISTIC
/begin CHARACTERISTIC NetMng_tiRecoverB_C "#SSD Zeit zwischen den Recoveries Can B" VALUE 0xE42A6 Kw_Wu16 327670.0 Time_ms 0.00 327670.0 FORMAT "%8.1" EXTENDED_LIMITS 0.00 655350.0 /end CHARACTERISTIC
/begin CHARACTERISTIC NetMng_tiRecoverC_C "Zeit zwischen den Recoveries Can C" VALUE 0xE42A8 Kw_Wu16 327670.0 Time_ms 0.00 327670.0 FORMAT "%8.1" EXTENDED_LIMITS 0.00 655350.0 /end CHARACTERISTIC
/begin CHARACTERISTIC NetMng_tiTimeoutDNMT_C "Timeout for Tester Present after Disable Normal Message Transmission" VALUE 0xE42AA Kw_Wu16 16000.00 Time_ms 0.00 16000.00 FORMAT "%8.2" EXTENDED_LIMITS 0.00 655350.0 /end CHARACTERISTIC
/begin CHARACTERISTIC NSC_numPrio_C "#SSD Applikationswert für Testzwecke" VALUE 0xE42AC Kw_Wu16 65535.00 OneToOne 0.00 65535.00 FORMAT "%8.2" /end CHARACTERISTIC
/begin CHARACTERISTIC NSC_st_C "#SSD Applikationswert für Testzwecke" VALUE 0xE42B0 Kw_Wu32 4294967295.00 OneToOne 0.00 4294967295.00 FORMAT "%13.2" /end CHARACTERISTIC
/begin CHARACTERISTIC OPSCD_uSRCMin_C "#SSD Threshold low value for SRC low error : Oil pressure sensor" VALUE 0xE42F0 Kw_Ws16 5200.391 Volt 0.00 5200.391 FORMAT "%8.3" EXTENDED_LIMITS -160156.4 160151.5 /end CHARACTERISTIC
/begin CHARACTERISTIC OPSCD_uSRCMax_C "#SSD Threshold high value for SRC High error: Oil pressure sensor" VALUE 0xE42F2 Kw_Ws16 5200.391 Volt 0.00 5200.391 FORMAT "%8.3" EXTENDED_LIMITS -160156.4 160151.5 /end CHARACTERISTIC
/begin CHARACTERISTIC OPSCD_pLin_CUR "Linearization curve : oil pressure sensor" CURVE 0xE42F4 Kl_Xs16_Ws16 1.000000 OneToOne 0.00 1.000000 FORMAT "%8.6" EXTENDED_LIMITS -32768.00 32767.00
 /begin AXIS_DESCR STD_AXIS OPSCD_uRaw_POEL_mp Volt 25 0.00 5200.391 FORMAT "%8.3" EXTENDED_LIMITS -160156.4 160151.5 DEPOSIT ABSOLUTE /end AXIS_DESCR
/end CHARACTERISTIC
/begin CHARACTERISTIC OPSCD_aMinBack_C "Statuswort für Deaktivierung der Endstufe" VALUE 0xE42B4 Kw_Ws16 65.53500 Acc -32.76800 32.76700 FORMAT "%8.5" /end CHARACTERISTIC
/begin CHARACTERISTIC OPSCD_aMinFor_C "Statuswort für Auflösung des Powerstages" VALUE 0xE42B6 Kw_Ws16 65.53500 Acc -32.76800 32.76700 FORMAT "%8.5" /end CHARACTERISTIC
/begin CHARACTERISTIC OPSCD_ctPwrStgOnMax_C "Maximaler Zähler für Powerstage On im Fehlerfall" VALUE 0xE42B8 Kw_Wu16 65535.00 OneToOne 0.00 65535.00 FORMAT "%8.2" /end CHARACTERISTIC
/begin CHARACTERISTIC OPSCD_DebSRCHiDef_C "Error debounce for SRC-High error" VALUE 0xE435A Kw_Wu16 655350.0 Time_ms 0.00 655350.0 FORMAT "%8.1" /end CHARACTERISTIC
/begin CHARACTERISTIC OPSCD_DebSRCHiOk_C "Healing debounce for SRC-High error" VALUE 0xE435C Kw_Wu16 655350.0 Time_ms 0.00 655350.0 FORMAT "%8.1" /end CHARACTERISTIC
/begin CHARACTERISTIC OPSCD_DebSRCLoDef_C "#SSD Error debounce for SRC-Low error" VALUE 0xE435E Kw_Wu16 655350.0 Time_ms 0.00 655350.0 FORMAT "%8.1" /end CHARACTERISTIC
/begin CHARACTERISTIC OPSCD_DebSRCLoOk_C "Healing debounce for SRC-Low error" VALUE 0xE4360 Kw_Wu16 655350.0 Time_ms 0.00 655350.0 FORMAT "%8.1" /end CHARACTERISTIC
/begin CHARACTERISTIC OPSCD_dtRmpSlpUp_C "Ramp slope up parameter" VALUE 0xE4364 Kw_Wu32 65535999.9847 RmpPres 0.00 65535999.9847 FORMAT "%14.4" /end CHARACTERISTIC
/begin CHARACTERISTIC OPSCD_dtRmpSlpDwn_C "Ramp slope down parameter" VALUE 0xE4368 Kw_Wu32 65535999.9847 RmpPres 0.00 65535999.9847 FORMAT "%14.4" /end CHARACTERISTIC
/begin CHARACTERISTIC OPSCD_LampDebExcTempDef_C "endstufen fehlerentprellung" VALUE 0xE42BA Kw_Wu16 655350.0 Time_ms 0.00 655350.0 FORMAT "%8.1" /end CHARACTERISTIC
/begin CHARACTERISTIC OPSCD_LampDebExcTempOk_C "Endstufen Fehlerentprellung" VALUE 0xE42BC Kw_Wu16 655350.0 Time_ms 0.00 655350.0 FORMAT "%8.1" /end CHARACTERISTIC
/begin CHARACTERISTIC OPSCD_LampDebNoLoadDef_C "endstufen fehlerentprellung" VALUE 0xE42BE Kw_Wu16 655350.0 Time_ms 0.00 655350.0 FORMAT "%8.1" /end CHARACTERISTIC
/begin CHARACTERISTIC OPSCD_LampDebNoLoadOk_C "Endstufen Fehlerentprellung" VALUE 0xE42C0 Kw_Wu16 655350.0 Time_ms 0.00 655350.0 FORMAT "%8.1" /end CHARACTERISTIC
/begin CHARACTERISTIC OPSCD_LampDebShortCircBatDef_C "endstufen fehlerentprellung" VALUE 0xE42C2 Kw_Wu16 655350.0 Time_ms 0.00 655350.0 FORMAT "%8.1" /end CHARACTERISTIC
/begin CHARACTERISTIC OPSCD_LampDebShortCircBatOk_C "Endstufen Fehlerentprellung" VALUE 0xE42C4 Kw_Wu16 655350.0 Time_ms 0.00 655350.0 FORMAT "%8.1" /end CHARACTERISTIC
/begin CHARACTERISTIC OPSCD_LampDebShortCircGndDef_C "Endstufen Fehlerentprellung" VALUE 0xE42C6 Kw_Wu16 655350.0 Time_ms 0.00 655350.0 FORMAT "%8.1" /end CHARACTERISTIC
/begin CHARACTERISTIC OPSCD_LampDebShortCircGndOk_C "Endstufen Fehlerentprellung" VALUE 0xE42C8 Kw_Wu16 655350.0 Time_ms 0.00 655350.0 FORMAT "%8.1" /end CHARACTERISTIC
/begin CHARACTERISTIC OPSCD_nStart_C "Drehzahlschwelle beim Starten" VALUE 0xE42CA Kw_Ws16 5960.000 EngN 40.00000 6000.000 FORMAT "%8.3" EXTENDED_LIMITS -32768.00 32767.00 /end CHARACTERISTIC
/begin CHARACTERISTIC OPSCD_numAdc_C "#SSD application parameter for Engine Oil Pressure input" VALUE 0xE436C Kw_Wu8 24.0000000000 NumPinAdc 0.00 24.0000000000 FORMAT "%13.10" /end CHARACTERISTIC
/begin CHARACTERISTIC OPSCD_numDia_C "#SSD application parameter for Oil Pressure Lamp Switch" VALUE 0xE42CC Kw_Wu8 27.0000000000 NumPinDia 0.00 27.0000000000 FORMAT "%13.10" /end CHARACTERISTIC
/begin CHARACTERISTIC OPSCD_numDioOut_C "#SSD application parameter for DPF_Regeneration" VALUE 0xE42CD Kw_Wu8 11.0000000000 NumPinDioOut 0.00 11.0000000000 FORMAT "%13.10" /end CHARACTERISTIC
/begin CHARACTERISTIC OPSCD_nZero_C "engine speed value threshold in starting case" VALUE 0xE42CE Kw_Ws16 5960.000 EngN 40.00000 6000.000 FORMAT "%8.3" EXTENDED_LIMITS -32768.00 32767.00 /end CHARACTERISTIC
/begin CHARACTERISTIC OPSCD_stLampInvOut_C "Zustand der Öldrucklampe invertiert" VALUE 0xE42D0 Kw_Wu8 1.000 OneToOne 0.00 1.000 FORMAT "%5.3" EXTENDED_LIMITS 0.00 255.0 /end CHARACTERISTIC
/begin CHARACTERISTIC OPSCD_stPwrStgLampDia_C "Spezifikation des Abschaltverhaltens der Endstufendiagnose" VALUE 0xE42D1 Kw_Wu8 255.0 OneToOne 0.00 255.0 FORMAT "%5.1" /end CHARACTERISTIC
/begin CHARACTERISTIC OPSCD_stSPICtl_C "Schalter ob Endstufe SPI kontrollierbar = 1 oder nicht SPI kontrollierbar = 0" VALUE 0xE42D2 Kw_Wu8 1.000 OneToOne 0.00 1.000 FORMAT "%5.3" EXTENDED_LIMITS 0.00 255.0 /end CHARACTERISTIC
/begin CHARACTERISTIC OPSCD_swtSigOut_C "Ölsensor Signal über CAN(1) oder DIO(0)" VALUE 0xE42D3 Kw_Wu8 1.000 OneToOne 0.00 1.000 FORMAT "%5.3" EXTENDED_LIMITS 0.00 255.0 /end CHARACTERISTIC
/begin CHARACTERISTIC OPSCD_tiABSDebNegBack_C "debouncezeit für fallende Flanke" VALUE 0xE42D4 Kw_Wu16 655350.0 TimeDeb 0.00 655350.0 FORMAT "%8.1" /end CHARACTERISTIC
/begin CHARACTERISTIC OPSCD_tiABSDebPosBack_C "Debouncezeit für positive Flanke" VALUE 0xE42D6 Kw_Wu16 655350.0 TimeDeb 0.00 655350.0 FORMAT "%8.1" /end CHARACTERISTIC
/begin CHARACTERISTIC OPSCD_tiABSDebNegFor_C "debouncezeit für fallende Flanke" VALUE 0xE42D8 Kw_Wu16 655350.0 TimeDeb 0.00 655350.0 FORMAT "%8.1" /end CHARACTERISTIC
/begin CHARACTERISTIC OPSCD_tiABSDebPosFor_C "Debouncezeit für positive Flanke" VALUE 0xE42DA Kw_Wu16 655350.0 TimeDeb 0.00 655350.0 FORMAT "%8.1" /end CHARACTERISTIC
/begin CHARACTERISTIC OPSCD_tiBtwTst_C "Zeitabstand, in dem die Endstufe im Fehlerfall getestet wird" VALUE 0xE42DC Kw_Wu16 29980.00 Time_ms 20.00000 30000.00 FORMAT "%8.2" EXTENDED_LIMITS 0.00 655350.0 /end CHARACTERISTIC
/begin CHARACTERISTIC OPSCD_tiInactiv1Back_C "status word for timer (inactivate in ABS case)" VALUE 0xE42DE Kw_Wu16 655350.0 Time_ms 0.00 655350.0 FORMAT "%8.1" /end CHARACTERISTIC
/begin CHARACTERISTIC OPSCD_tiInactiv1For_C "status word for timer (inactivate in ABS case)" VALUE 0xE42E0 Kw_Wu16 655350.0 Time_ms 0.00 655350.0 FORMAT "%8.1" /end CHARACTERISTIC
/begin CHARACTERISTIC OPSCD_tiInactivStart_C "status word for timer inactivate in starting case" VALUE 0xE42E2 Kw_Wu16 655350.0 Time_ms 0.00 655350.0 FORMAT "%8.1" /end CHARACTERISTIC
/begin CHARACTERISTIC OPSCD_tipOELDebNeg_C "debounce time for negative edge of glow control unit feedback" VALUE 0xE42E4 Kw_Wu16 655350.0 TimeDeb 0.00 655350.0 FORMAT "%8.1" /end CHARACTERISTIC
/begin CHARACTERISTIC OPSCD_tipOELDebPos_C "debounce time for positive edge of glow control unit feedback" VALUE 0xE42E6 Kw_Wu16 655350.0 TimeDeb 0.00 655350.0 FORMAT "%8.1" /end CHARACTERISTIC
/begin CHARACTERISTIC OPSCD_tiPwrStgOn_C "Zeit für welche die Endstufe im Fehlerfall eingeschalten wird (nur nicht SPI kontrolliert)" VALUE 0xE42E8 Kw_Wu16 655140.0 Time_ms 0.00 655140.0 FORMAT "%8.1" EXTENDED_LIMITS 0.00 655350.0 /end CHARACTERISTIC
/begin CHARACTERISTIC OPSCD_stSensIDWord_C "ID-Word for transition stage for oil pressure" VALUE 0xE436E Kw_Wu16 65535.00 OneToOne 0.00 65535.00 FORMAT "%8.2" /end CHARACTERISTIC
/begin CHARACTERISTIC OPSCD_stPDfl_C "default value if error" VALUE 0xE4370 Kw_Ws16 1.000000 OneToOne 0.00 1.000000 FORMAT "%8.6" EXTENDED_LIMITS -32768.00 32767.00 /end CHARACTERISTIC
/begin CHARACTERISTIC OPSCD_vMinBack_C "status word for deactivation of the powerstage" VALUE 0xE42EA Kw_Ws16 655.3500 Vel -327.6800 327.6700 FORMAT "%8.4" /end CHARACTERISTIC
/begin CHARACTERISTIC OPSCD_vMinFor_C "status word for deactivation of the powerstage" VALUE 0xE42EC Kw_Ws16 655.3500 Vel -327.6800 327.6700 FORMAT "%8.4" /end CHARACTERISTIC
/begin MEASUREMENT ctHigh "" UWORD OneToOne 1 100 0.00 65535.00 FORMAT "%8.2" ECU_ADDRESS 0x7FC31E /end MEASUREMENT
/begin MEASUREMENT ctLow "" UWORD OneToOne 1 100 0.00 65535.00 FORMAT "%8.2" ECU_ADDRESS 0x7FC320 /end MEASUREMENT
/begin MEASUREMENT LIGov_CurrDKd_mp "Aktueller Parametersatzwert kp für den D-Anteil" SLONG Kd_rpm2Nm 1 100 -3276.80000000 3276.79999847 FORMAT "%13.8" ECU_ADDRESS 0x8FF4EC /end MEASUREMENT
/begin MEASUREMENT LIGov_CurrDT1_mp "Aktueller Parametersatzwert T1 für den D-Anteil" ULONG TimeDelay_s 1 100 0.0000010000000 4294.9673 FORMAT "%9.4" ECU_ADDRESS 0x8FF4F0 /end MEASUREMENT
/begin MEASUREMENT LIGov_CurrFlt1T1_mp "Aktueller Parametersatzwert T1 für erstes PT1-Filter (n-Filterung)" ULONG TimeDelay_s 1 100 0.0000010000000 4294.9673 FORMAT "%9.4" ECU_ADDRESS 0x8FF4F4 /end MEASUREMENT
/begin MEASUREMENT LIGov_CurrFlt2T1_mp "Aktueller Parametersatzwert T1 für zweites PT1-Filter (n-Filterung)" ULONG TimeDelay_s 1 100 0.0000010000000 4294.9673 FORMAT "%9.4" ECU_ADDRESS 0x8FF4F8 /end MEASUREMENT
/begin MEASUREMENT LIGov_CurrIKiNeg_mp "Aktueller Parametersatzwert ki (negatives Großsignal) für den I-Anteil" SLONG Ki_rpm2Nm 1 100 -400000.000000 399999.999814 FORMAT "%13.6" ECU_ADDRESS 0x8FF4FC /end MEASUREMENT
/begin MEASUREMENT LIGov_CurrIKiPos_mp "Aktueller Parametersatzwert ki (positives Großsignal) für den I-Anteil" SLONG Ki_rpm2Nm 1 100 -400000.000000 399999.999814 FORMAT "%13.6" ECU_ADDRESS 0x8FF500 /end MEASUREMENT
/begin MEASUREMENT LIGov_CurrIKi_mp "Aktueller Parametersatzwert ki (Kleinsignal) für den I-Anteil" SLONG Ki_rpm2Nm 1 100 -400000.000000 399999.999814 FORMAT "%13.6" ECU_ADDRESS 0x8FF504 /end MEASUREMENT
/begin MEASUREMENT LIGov_CurrIWinNeg_mp "Aktueller Parametersatzwert Fensterbreite (negatives Großsignal) für den I-Anteil" SWORD EngN_HiRes 1 100 -4096.000 4095.875 FORMAT "%8.3" ECU_ADDRESS 0x8FF508 /end MEASUREMENT
/begin MEASUREMENT LIGov_CurrIWinPos_mp "Aktueller Parametersatzwert Fensterbreite (positives Großsignal) für den I-Anteil" SWORD EngN_HiRes 1 100 -4096.000 4095.875 FORMAT "%8.3" ECU_ADDRESS 0x8FF50A /end MEASUREMENT
/begin MEASUREMENT LIGov_CurrPKpNeg_mp "Aktueller Parametersatzwert kp (negatives Großsignal) für den P-Anteil" SLONG Kp_rpm2Nm 1 100 -26214.4000000 26214.3999878 FORMAT "%13.7" ECU_ADDRESS 0x8FF50C /end MEASUREMENT
/begin MEASUREMENT LIGov_CurrPKpPos_mp "Aktueller Parametersatzwert kp (positives Großsignal) für den P-Anteil" SLONG Kp_rpm2Nm 1 100 -26214.4000000 26214.3999878 FORMAT "%13.7" ECU_ADDRESS 0x8FF510 /end MEASUREMENT
/begin MEASUREMENT LIGov_CurrPKp_mp "Aktueller Parametersatzwert kp (Kleinsignal) für P-Anteil" SLONG Kp_rpm2Nm 1 100 -26214.4000000 26214.3999878 FORMAT "%13.7" ECU_ADDRESS 0x8FF514 /end MEASUREMENT
/begin MEASUREMENT LIGov_CurrPWinNeg_mp "Aktueller Parametersatzwert Fensterbreite (negatives Großsignal) für den P-Anteil" SWORD EngN_HiRes 1 100 -4096.000 4095.875 FORMAT "%8.3" ECU_ADDRESS 0x8FF518 /end MEASUREMENT
/begin MEASUREMENT LIGov_CurrPWinPos_mp "Aktueller Parametersatzwert Fensterbreite (positives Großsignal) für den P-Anteil" SWORD EngN_HiRes 1 100 -4096.000 4095.875 FORMAT "%8.3" ECU_ADDRESS 0x8FF51A /end MEASUREMENT
/begin MEASUREMENT LIGov_nAvrg_mp "OLDA-Größe für Eng_nAvrg" SWORD EngN 1 100 -32768.00 32767.00 FORMAT "%8.2" ECU_ADDRESS 0x8FF51C /end MEASUREMENT
/begin MEASUREMENT LIGov_nDiffDelta_mp "Delta zur Drehzahlschwelle Sicherheitsrampe" SWORD EngN 1 100 -32768.00 32767.00 FORMAT "%8.2" ECU_ADDRESS 0x8FF4C0 /end MEASUREMENT
/begin MEASUREMENT LIGov_nDiffFlt1_mp "Regelabweichung hinter dem ersten PT1-Filter" SWORD EngN_HiRes 1 100 -4096.000 4095.875 FORMAT "%8.3" ECU_ADDRESS 0x8FF51E /end MEASUREMENT
/begin MEASUREMENT LIGov_nDiffFlt2_mp "Regelabweichung hinter zweitem PT1-Filter" SWORD EngN_HiRes 1 100 -4096.000 4095.875 FORMAT "%8.3" ECU_ADDRESS 0x8FF520 /end MEASUREMENT
/begin MEASUREMENT LIGov_nDiff_mp "n Regelabweichung" SWORD EngN 1 100 -32768.00 32767.00 FORMAT "%8.2" ECU_ADDRESS 0x8FF522 /end MEASUREMENT
/begin MEASUREMENT LIGov_nHDC_mp "LL-Solldrehzahl aufgrund HDC" SWORD EngN 1 100 -32768.00 32767.00 FORMAT "%8.2" ECU_ADDRESS 0x8FF4C2 /end MEASUREMENT
/begin MEASUREMENT LIGov_nLimHigh "" SWORD EngN 1 100 -32768.00 32767.00 FORMAT "%8.2" ECU_ADDRESS 0x7F8EA8 /end MEASUREMENT
/begin MEASUREMENT LIGov_nMaxTrq "Drehzahldifferenz zur Vermeidung von Momentensprüngen aufgrund sprungförmiger LL-Solldrehzahl" SWORD EngN 1 100 -32768.00 32767.00 FORMAT "%8.2" ECU_ADDRESS 0x7F8EAA /end MEASUREMENT
/begin MEASUREMENT LIGov_nSetCoEngOld_mp "Vorhergehende LL-Solldrehzahl aus CoEng_nMin (nach Rampe)" SWORD EngN 1 100 -32768.00 32767.00 FORMAT "%8.2" ECU_ADDRESS 0x8FF4C4 /end MEASUREMENT
/begin MEASUREMENT LIGov_nSetCoEng_mp "LL-Solldrehzahl aus CoEng_nMin (nach Rampe)" SWORD EngN 1 100 -32768.00 32767.00 FORMAT "%8.2" ECU_ADDRESS 0x8FF4C6 /end MEASUREMENT
/begin MEASUREMENT LIGov_nSetGearbxOld_mp "Vorhergehende LL-Solldrehzahl aus Gearbx_nMin (nach Rampe)" SWORD EngN 1 100 -32768.00 32767.00 FORMAT "%8.2" ECU_ADDRESS 0x8FF4C8 /end MEASUREMENT
/begin MEASUREMENT LIGov_nSetGearbx_mp "LL-Solldrehzahl aus Gearbx_nMin (nach Rampe)" SWORD EngN 1 100 -32768.00 32767.00 FORMAT "%8.2" ECU_ADDRESS 0x8FF4CA /end MEASUREMENT
/begin MEASUREMENT LIGov_nSetHDCOld_mp "Vorhergehende LL-Solldrehzahl aufgrund HDC (nach Rampe)" SWORD EngN 1 100 -32768.00 32767.00 FORMAT "%8.2" ECU_ADDRESS 0x8FF4CC /end MEASUREMENT
/begin MEASUREMENT LIGov_nSetHDC_mp "LL-Solldrehzahl aufgrund HDC (nach Rampe)" SWORD EngN 1 100 -32768.00 32767.00 FORMAT "%8.2" ECU_ADDRESS 0x8FF4CE /end MEASUREMENT
/begin MEASUREMENT LIGov_nSetLocal0_mp "LIGov set point before adding trimming setpoint" SWORD EngN 1 100 -32768.00 32767.00 FORMAT "%8.2" ECU_ADDRESS 0x8FF4D0 /end MEASUREMENT
/begin MEASUREMENT LIGov_nSetLocal2 "LL-Solldrehzahl aus ""langsamen' Anforderem"" (Startabwurf, temp.abhängig, Diagnoseabgleich)" SWORD EngN 1 100 -32768.00 32767.00 FORMAT "%8.2" ECU_ADDRESS 0x7F8EAC /end MEASUREMENT
/begin MEASUREMENT LIGov_nSetLocalRampOld_mp "Vorhergegangene LL-Solldrehzahl aus ""langsamen Anforderern"" (nach Rampe)" SWORD EngN 1 100 -32768.00 32767.00 FORMAT "%8.2" ECU_ADDRESS 0x8FF4D2 /end MEASUREMENT
/begin MEASUREMENT LIGov_nSetLocalRamp_mp "LL-Solldrehzahl aus ""langsamen' Anforderem"" (nach Rampe)" SWORD EngN 1 100 -32768.00 32767.00 FORMAT "%8.2" ECU_ADDRESS 0x8FF4D4 /end MEASUREMENT
/begin MEASUREMENT LIGov_nSetpoint "Leerlaufsolldrehzahl" SWORD EngN 1 100 -32768.00 32767.00 FORMAT "%8.2" ECU_ADDRESS 0x7F8EAE /end MEASUREMENT
/begin MEASUREMENT LIGov_nSetpointOld_mp "Vorhergegangene LL-Solldrehzahl" SWORD EngN 1 100 -32768.00 32767.00 FORMAT "%8.2" ECU_ADDRESS 0x8FF4D6 /end MEASUREMENT
/begin MEASUREMENT LIGov_nSetpointTemp_mp "Sollwert Leerlaufregler temperaturabhängig" SWORD EngN 1 100 -32768.00 32767.00 FORMAT "%8.2" ECU_ADDRESS 0x8FF4D8 /end MEASUREMENT
/begin MEASUREMENT LIGov_nSetpointTrm "Abgleich LLR-Solldrehzahl" SWORD EngN 1 100 -32768.00 32767.00 FORMAT "%8.2" ECU_ADDRESS 0x7F8EB0 /end MEASUREMENT
/begin MEASUREMENT LIGov_nSetpointTrm_mp "Meßpunkt zeigt den Leerlaufsollwert nach der Korrektur mit dem Abgleichwert" SWORD EngN 1 100 -32768.00 32767.00 FORMAT "%8.2" ECU_ADDRESS 0x8FF4DA /end MEASUREMENT
/begin MEASUREMENT LIGov_nSetPwrMngOld_mp "Vorhergegangene LL-Solldrehzahl aus PwrMng_nMin (nach Rampe)" SWORD EngN 1 100 -32768.00 32767.00 FORMAT "%8.2" ECU_ADDRESS 0x8FF4DC /end MEASUREMENT
/begin MEASUREMENT LIGov_nSetPwrMng_mp "LL-Solldrehzahl aus PwrMng_nMin (nach Rampe)" SWORD EngN 1 100 -32768.00 32767.00 FORMAT "%8.2" ECU_ADDRESS 0x8FF4DE /end MEASUREMENT
/begin MEASUREMENT LIGov_nSetSec1_mp "Erster Sicherheitswert zur Begrenzung der LL-Solldrehzahl" SWORD EngN 1 100 -32768.00 32767.00 FORMAT "%8.2" ECU_ADDRESS 0x8FF4E0 /end MEASUREMENT
/begin MEASUREMENT LIGov_nSetSec2_mp "Zweiter Sicherheitswert zur Begrenzung der LL-Solldrehzahl" SWORD EngN 1 100 -32768.00 32767.00 FORMAT "%8.2" ECU_ADDRESS 0x8FF4E2 /end MEASUREMENT
/begin MEASUREMENT LIGov_nSetSec4_mp "Viertter Sicherheitswert zur Begrenzung der LL-Solldrehzahl" SWORD EngN 1 100 -32768.00 32767.00 FORMAT "%8.2" ECU_ADDRESS 0x8FF4E4 /end MEASUREMENT
/begin MEASUREMENT LIGov_nSetSurgeOld_mp "Vorhergegangene LL-Solldrehzahl aus PCR_nSetPointSurge (nach Rampe)" SWORD EngN 1 100 -32768.00 32767.00 FORMAT "%8.2" ECU_ADDRESS 0x8FF4E6 /end MEASUREMENT
/begin MEASUREMENT LIGov_nSetSurge_mp "LL-Solldrehzahl aus PCR_nSetPointSurge (nach Rampe)" SWORD EngN 1 100 -32768.00 32767.00 FORMAT "%8.2" ECU_ADDRESS 0x8FF4E8 /end MEASUREMENT
/begin MEASUREMENT LIGov_rIpoConvPS_mp "Verhältnis für die Interpolation zwischen Kalt- und Warmparametersatz" SWORD Fact 1 100 -4.000000 3.999878 FORMAT "%8.6" ECU_ADDRESS 0x8FF524 /end MEASUREMENT
/begin MEASUREMENT LIGov_stActiveHDC "Zustand für aktivierte LL-Solldrehzahl aufgrund HDC" UBYTE OneToOne 1 100 0.00 255.0 FORMAT "%5.1" ECU_ADDRESS 0x7F88FF /end MEASUREMENT
/begin MEASUREMENT LIGov_stSetPoint "Status Leerlauf-Solldrehzahl-Anforderung" UWORD OneToOne 1 100 0.00 65535.00 FORMAT "%8.2" ECU_ADDRESS 0x7F8EB4 /end MEASUREMENT
/begin MEASUREMENT LIGov_stSetpointTrmActive "" UBYTE OneToOne 1 100 0.00 255.0 FORMAT "%5.1" ECU_ADDRESS 0x7F8901 /end MEASUREMENT
/begin MEASUREMENT LIGov_stSetpointTrmAlw_mp "" UBYTE OneToOne 1 100 0.00 255.0 FORMAT "%5.1" ECU_ADDRESS 0x8FF4EA /end MEASUREMENT
/begin MEASUREMENT LIGov_stSetTrqAlw_mp "Status zum Erlauben oder nicht Erlauben der Moment anforderung über Diagnose für NMK Schnellernen" UBYTE OneToOne 1 100 0.00 255.0 FORMAT "%5.1" ECU_ADDRESS 0x8FF526 /end MEASUREMENT
/begin MEASUREMENT LIGov_tiPT1_mp "aktuelle PT1 Zeitkonstante für PT1 filtern des LLR Ausgangs" SWORD TimeDelay_s_Lin_16 1 100 -5.000153 5.000000 FORMAT "%8.6" ECU_ADDRESS 0x8FF528 /end MEASUREMENT
/begin MEASUREMENT LIGov_trqDRaw_mp "LLR D-Anteil Rohwert (ohne Gewichtsfaktor)" SWORD Trq 1 100 -3276.800 3276.700 FORMAT "%8.3" ECU_ADDRESS 0x8FF52A /end MEASUREMENT
/begin MEASUREMENT LIGov_trqD_mp "Messpunkt für den Wert des D-Anteils des LLR" SWORD Trq 1 100 -3276.800 3276.700 FORMAT "%8.3" ECU_ADDRESS 0x8FF52C /end MEASUREMENT
/begin MEASUREMENT LIGov_trqInitI "Initialisierungsmoment für I-Anteil nach Start" SWORD Trq 1 100 -3276.800 3276.700 FORMAT "%8.3" ECU_ADDRESS 0x7F8EBE /end MEASUREMENT
/begin MEASUREMENT LIGov_trqLISetRdDIAG_mp "Begrenzt Moment anforderung über Diagnose für NMK Schnellernen" SWORD Trq 1 100 -3276.800 3276.700 FORMAT "%8.3" ECU_ADDRESS 0x8FF52E /end MEASUREMENT
/begin MEASUREMENT LIGov_trqMax_mp "aktueller LLR Begrenzungswert" SWORD Trq 1 100 -3276.800 3276.700 FORMAT "%8.3" ECU_ADDRESS 0x8FF530 /end MEASUREMENT
/begin MEASUREMENT LIGov_trqPreInitI_mp "Initialisierungswert für Integrator als Ergebnis der Integrator-Rückrechnung" SLONG Trq32 1 100 -3276.80000000 3276.79999847 FORMAT "%13.8" ECU_ADDRESS 0x8FF534 /end MEASUREMENT
/begin MEASUREMENT LIGov_trqSet_mp "Begrenzt Moment anforderung über Diagnose für NMK Schnellernen" SWORD Trq 1 100 -3276.800 3276.700 FORMAT "%8.3" ECU_ADDRESS 0x8FF538 /end MEASUREMENT
/begin MEASUREMENT LIGov_trq_mp "" SWORD Trq 1 100 -3276.800 3276.700 FORMAT "%8.3" ECU_ADDRESS 0x8FF53A /end MEASUREMENT
/begin MEASUREMENT LPACD_rCnv_mp "TV on steller" SWORD DtyCyc 1 100 -327.6800 327.6700 FORMAT "%8.4" ECU_ADDRESS 0x8FF53C /end MEASUREMENT
/begin MEASUREMENT LPACD_rOut "Ausgabewert on PWM-EST nach batteriespannung korrectur" SWORD DtyCyc 1 100 -327.6800 327.6700 FORMAT "%8.4" ECU_ADDRESS 0x7F8EC4 /end MEASUREMENT
/begin MEASUREMENT LSUCD_ctHtCoup "Zähler für LSU Diagnose Heizerkopplung" UWORD OneToOne 1 100 0.00 65535.00 FORMAT "%8.2" ARRAY_SIZE 1 ECU_ADDRESS 0x7F8EC6 /end MEASUREMENT
/begin MEASUREMENT LSUCD_d2rO2Eval_mp "Bewertungsgröße für Lernfortschritt" SWORD O2 1 100 -0.3276800 0.3276700 FORMAT "%9.7" ARRAY_SIZE 1 ECU_ADDRESS 0x8FF55E /end MEASUREMENT
/begin MEASUREMENT LSUCD_d2rO2_mp "Eingangsgröße des Bewertungsfilters" SWORD O2 1 100 -0.3276800 0.3276700 FORMAT "%9.7" ARRAY_SIZE 1 ECU_ADDRESS 0x8FF560 /end MEASUREMENT
/begin MEASUREMENT LSUCD_dcycHtCor "Tastverhältnis Heizer Endstufe nach Batteriespannungs Korrektur" SWORD DtyCyc 1 100 -327.6800 327.6700 FORMAT "%8.4" ARRAY_SIZE 1 ECU_ADDRESS 0x7F8EC8 /end MEASUREMENT
/begin MEASUREMENT LSUCD_dcycHtCoupStep1 "Heizungs-Aufgabe fährt im ersten Signalerwerbungs-Zyklus rad" SWORD DtyCyc 1 100 -327.6800 327.6700 FORMAT "%8.4" ARRAY_SIZE 1 ECU_ADDRESS 0x7F8ECA /end MEASUREMENT
/begin MEASUREMENT LSUCD_dcycHtCoupStep2 "Heizungs-Aufgabe fährt im zweiten Signalerwerbungs-Zyklus rad" SWORD DtyCyc 1 100 -327.6800 327.6700 FORMAT "%8.4" ARRAY_SIZE 1 ECU_ADDRESS 0x7F8ECC /end MEASUREMENT
/begin MEASUREMENT LSUCD_dcycHtCoupStep3 "Heizungs-Aufgabe fährt im dritten Signalerwerbungs-Zyklus rad" SWORD DtyCyc 1 100 -327.6800 327.6700 FORMAT "%8.4" ARRAY_SIZE 1 ECU_ADDRESS 0x7F8ECE /end MEASUREMENT
/begin MEASUREMENT LSUCD_dcycLimActHt "Aktuelle Tastverhältnisgrenze Heizeransteuerung für nominales Tastverhältnis (vor Korrektur)" SWORD DtyCyc 1 100 -327.6800 327.6700 FORMAT "%8.4" ECU_ADDRESS 0x7F8ED0 /end MEASUREMENT
/begin MEASUREMENT LSUCD_dcycRippel_mp "Änderung des Heizungs-Tastverhältnisses bei Diagnose der Heizungskopplung" SWORD DtyCyc 1 100 -327.6800 327.6700 FORMAT "%8.4" ARRAY_SIZE 1 ECU_ADDRESS 0x8FF582 /end MEASUREMENT
/begin MEASUREMENT LSUCD_dHtCoupStep "Schieberegister für die Aufzeichnung der Werte" UBYTE OneToOne 1 100 0.00 255.0 FORMAT "%5.1" ECU_ADDRESS 0x7F8902 /end MEASUREMENT
/begin MEASUREMENT LSUCD_dHtCoupStepLast "Letzter Wert des Schieberegisters" UBYTE OneToOne 1 100 0.00 255.0 FORMAT "%5.1" ECU_ADDRESS 0x7F8903 /end MEASUREMENT
/begin MEASUREMENT LSUCD_drO2Adpt "Eingelernter absoluter Messfehler der Sauerstoffkonzentration" SWORD O2 1 100 -0.3276800 0.3276700 FORMAT "%9.7" ARRAY_SIZE 1 ECU_ADDRESS 0x7F8ED2 /end MEASUREMENT
/begin MEASUREMENT LSUCD_drO2Flt_mp "Ausgangsgröße des Adaptionsfilters" SWORD O2 1 100 -0.3276800 0.3276700 FORMAT "%9.7" ARRAY_SIZE 1 ECU_ADDRESS 0x8FF562 /end MEASUREMENT
/begin MEASUREMENT LSUCD_facO2Corr_mp "Aktueller Korrekturfaktor der Adaption" SWORD Fact 1 100 -4.000000 3.999878 FORMAT "%8.6" ARRAY_SIZE 1 ECU_ADDRESS 0x6F81A6 /end MEASUREMENT
/begin MEASUREMENT LSUCD_facPresComp_mp "Druckkorrekturfaktor" SWORD Fact 1 100 -4.000000 3.999878 FORMAT "%8.6" ARRAY_SIZE 1 ECU_ADDRESS 0x8FF576 /end MEASUREMENT
/begin MEASUREMENT LSUCD_facUCor_mp "Korrektur Faktor für Heizeranforderung" SWORD Fact 1 100 -4.000000 3.999878 FORMAT "%8.6" ECU_ADDRESS 0x8FF56A /end MEASUREMENT
/begin MEASUREMENT LSUCD_mAirAftOvrRun_mp "Integral über Luftmassenstrom seit Beginn der Schubphase" SWORD AirMass_2 1 100 -3276.800 3276.700 FORMAT "%8.3" ECU_ADDRESS 0x8FF564 /end MEASUREMENT
/begin MEASUREMENT LSUCD_pExhGasLstVal_mp "Abgas-Wert des letzten geschätzten Sensors" SWORD Pres_hPa 1 100 -32768.00 32767.00 FORMAT "%8.2" ECU_ADDRESS 0x8FF578 /end MEASUREMENT
/begin MEASUREMENT LSUCD_resRi "Ri Meßwert (gefiltert und korrigiert)" SWORD Resist 1 100 -3276.800 3276.700 FORMAT "%8.3" ARRAY_SIZE 1 ECU_ADDRESS 0x7F8EDC /end MEASUREMENT
/begin MEASUREMENT LSUCD_resRiChange_mp "Betrag der Ri-Änderung mit dem letzten gefilterten Wert" SWORD Resist 1 100 -3276.800 3276.700 FORMAT "%8.3" ARRAY_SIZE 1 ECU_ADDRESS 0x8FF57A /end MEASUREMENT
/begin MEASUREMENT LSUCD_resRiClb "Korrekturwert Ri Offset" SWORD Resist 1 100 -3276.800 3276.700 FORMAT "%8.3" ARRAY_SIZE 1 ECU_ADDRESS 0x7F8EDE /end MEASUREMENT
/begin MEASUREMENT LSUCD_resRiClbRaw_mp "Rohwert Ri Korrektur ohne Filterung" SWORD Resist 1 100 -3276.800 3276.700 FORMAT "%8.3" ARRAY_SIZE 1 ECU_ADDRESS 0x8FF57C /end MEASUREMENT
/begin MEASUREMENT LSUCD_resRiHtCoupStep1 "Innerer Wiederstand im ersten Datenakquisitionszyklus" SWORD Resist 1 100 -3276.800 3276.700 FORMAT "%8.3" ARRAY_SIZE 1 ECU_ADDRESS 0x7F8EE0 /end MEASUREMENT
/begin MEASUREMENT LSUCD_resRiHtCoupStep2 "Innerer Wiederstand im zweiten Datenakquisitionszyklus" SWORD Resist 1 100 -3276.800 3276.700 FORMAT "%8.3" ARRAY_SIZE 1 ECU_ADDRESS 0x7F8EE2 /end MEASUREMENT
/begin MEASUREMENT LSUCD_resRiHtCoupStep3 "Innerer Wiederstand im dritten Datenakquisitionszyklus" SWORD Resist 1 100 -3276.800 3276.700 FORMAT "%8.3" ARRAY_SIZE 1 ECU_ADDRESS 0x7F8EE4 /end MEASUREMENT
/begin MEASUREMENT LSUCD_resRiRaw "Ri Meßwert ohne Korrektur" SWORD Resist 1 100 -3276.800 3276.700 FORMAT "%8.3" ARRAY_SIZE 1 ECU_ADDRESS 0x7F8EE6 /end MEASUREMENT
/begin MEASUREMENT LSUCD_resRiRippel_mp "Änderung des Innenwiderstands bei Freigabe der Heizung" SWORD Resist 1 100 -3276.800 3276.700 FORMAT "%8.3" ARRAY_SIZE 1 ECU_ADDRESS 0x8FF584 /end MEASUREMENT
/begin MEASUREMENT LSUCD_resRi_mp "Ri-Messwert gefiltert und korrigiert" SWORD Resist 1 100 -3276.800 3276.700 FORMAT "%8.3" ECU_ADDRESS 0x8FF57E /end MEASUREMENT
/begin MEASUREMENT LSUCD_rO2Act "Aktueller O2 Meßwert ohne Ausblendung Abgleichvorgang" SWORD O2 1 100 -0.3276800 0.3276700 FORMAT "%9.7" ARRAY_SIZE 1 ECU_ADDRESS 0x7F8ED4 /end MEASUREMENT
/begin MEASUREMENT LSUCD_rO2Adpt "Adaptierte Sauerstoffkonzentration" SWORD O2 1 100 -0.3276800 0.3276700 FORMAT "%9.7" ARRAY_SIZE 1 ECU_ADDRESS 0x7F8ED6 /end MEASUREMENT
/begin MEASUREMENT LSUCD_rO2PresComp "Druckkompensierte Sauerstoffkonzentration" SWORD O2 1 100 -0.3276800 0.3276700 FORMAT "%9.7" ARRAY_SIZE 1 ECU_ADDRESS 0x7F8ED8 /end MEASUREMENT
/begin MEASUREMENT LSUCD_rO2Raw "O2 Wert ohne Druck- und Empfindlichkeitskorrektur" SWORD O2 1 100 -0.3276800 0.3276700 FORMAT "%9.7" ARRAY_SIZE 1 ECU_ADDRESS 0x7F8EDA /end MEASUREMENT
/begin MEASUREMENT LSUCD_rOutHWE_mp "Tastverhältnis Heizerendstufe nach Stellertest Anforderung und Endstufen Diagnose." SWORD DtyCyc 1 100 -327.6800 327.6700 FORMAT "%8.4" ARRAY_SIZE 1 ECU_ADDRESS 0x8FF56C /end MEASUREMENT
/begin MEASUREMENT LSUCD_stAdpt "Zustandsgröße der Adaption (adaptiert / nicht adaptiert)" UBYTE OneToOne 1 100 0.00 255.0 FORMAT "%5.1" ARRAY_SIZE 1 ECU_ADDRESS 0x7F8904 /end MEASUREMENT
/begin MEASUREMENT LSUCD_stAdptActv_mp "Zustand der Lernphase (aktiv / nicht aktiv)" UBYTE OneToOne 1 100 0.00 255.0 FORMAT "%5.1" ARRAY_SIZE 1 ECU_ADDRESS 0x8FF566 /end MEASUREMENT
/begin MEASUREMENT LSUCD_stChange_mp "Neues Lernergebnis im aktuellen Fahrzyklus" UBYTE OneToOne 1 100 0.00 255.0 FORMAT "%5.1" ARRAY_SIZE 1 ECU_ADDRESS 0x8FF567 /end MEASUREMENT
/begin MEASUREMENT LSUCD_stCircModeNew "Aktueller Wert des Auswerteschaltungs Modes (CJ 120 Konfiguration)" UWORD OneToOne 1 100 0.00 65535.00 FORMAT "%8.2" ARRAY_SIZE 1 ECU_ADDRESS 0x7F8EE8 /end MEASUREMENT
/begin MEASUREMENT LSUCD_stDiaIAEna "Message um die Erkennung von IA oder IP Kurzschluss nach Masse freizugeben" UBYTE OneToOne 1 100 0.00 255.0 FORMAT "%5.1" ARRAY_SIZE 1 ECU_ADDRESS 0x7F8905 /end MEASUREMENT
/begin MEASUREMENT LSUCD_stHold_mp "Zustandsgröße der Adaption (gestört / nicht gestört)" UBYTE OneToOne 1 100 0.00 255.0 FORMAT "%5.1" ARRAY_SIZE 1 ECU_ADDRESS 0x8FF568 /end MEASUREMENT
/begin MEASUREMENT LSUCD_stHtCoupActv "Statusbotschaft für Heizungskopplung aktiv" UBYTE OneToOne 1 100 0.00 255.0 FORMAT "%5.1" ECU_ADDRESS 0x7F8906 /end MEASUREMENT
/begin MEASUREMENT LSUCD_stHtDis "Zustand Heizerabschaltung wegen Batteriespannung oder Betriebsmodus" UBYTE OneToOne 1 100 0.00 255.0 FORMAT "%5.1" ECU_ADDRESS 0x7F8907 /end MEASUREMENT
/begin MEASUREMENT LSUCD_stInitClb "Erste CJ120-Kalibrierung wurde angefordert" UBYTE OneToOne 1 100 0.00 255.0 FORMAT "%5.1" ECU_ADDRESS 0x7F8908 /end MEASUREMENT
/begin MEASUREMENT LSUCD_stIpHighCurEna "Status-Message für hohen (0 bis 150ua) Referenzpumpstrom für CJ125" UBYTE OneToOne 1 100 0.00 255.0 FORMAT "%5.1" ARRAY_SIZE 1 ECU_ADDRESS 0x7F8909 /end MEASUREMENT
/begin MEASUREMENT LSUCD_stIpNormCurEna "Status-Message für normalen (0 bis 150ua) Referenzpumpstrom für CJ125" UBYTE OneToOne 1 100 0.00 255.0 FORMAT "%5.1" ARRAY_SIZE 1 ECU_ADDRESS 0x7F890A /end MEASUREMENT
/begin MEASUREMENT LSUCD_stIsolChkActv "Nebenschlußerkennung ist momentan aktiv" UBYTE OneToOne 1 100 0.00 255.0 FORMAT "%5.1" ARRAY_SIZE 1 ECU_ADDRESS 0x7F890B /end MEASUREMENT
/begin MEASUREMENT LSUCD_stIsolChkO2Last "Status ob die O2 Konzentration im letzten Zyklus innerhalb des vorgegebenen Fensters war" UBYTE OneToOne 1 100 0.00 255.0 FORMAT "%5.1" ARRAY_SIZE 1 ECU_ADDRESS 0x7F890C /end MEASUREMENT
/begin MEASUREMENT LSUCD_stIsolChkStrt "Statusmessage zum Starten der Nebenschlusserkennung" UBYTE OneToOne 1 100 0.00 255.0 FORMAT "%5.1" ARRAY_SIZE 1 ECU_ADDRESS 0x7F890D /end MEASUREMENT
/begin MEASUREMENT LSUCD_stO2Act "Gültigkeitsstatus des aktuellen O2 Signals (0 = ungültig, 1 = gültig)" UBYTE OneToOne 1 100 0.00 255.0 FORMAT "%5.1" ARRAY_SIZE 1 ECU_ADDRESS 0x7F890E /end MEASUREMENT
/begin MEASUREMENT LSUCD_stO2ClbEna "Auslösesignal für O2 Offsetspannung Kalibriersequenz" UBYTE OneToOne 1 100 0.00 255.0 FORMAT "%5.1" ECU_ADDRESS 0x7F890F /end MEASUREMENT
/begin MEASUREMENT LSUCD_stO2Clb_mp "Zusatands Bits der O2 Offset Abgleich Sequenz" UBYTE OneToOne 1 100 0.00 255.0 FORMAT "%5.1" ECU_ADDRESS 0x8FF570 /end MEASUREMENT
/begin MEASUREMENT LSUCD_stO2IntValid "Status des internen O2-Rohsignals (gültig/ungültig)" UBYTE OneToOne 1 100 0.00 255.0 FORMAT "%5.1" ARRAY_SIZE 1 ECU_ADDRESS 0x7F8910 /end MEASUREMENT
/begin MEASUREMENT LSUCD_stO2SPICalDem "SPI Status-Message um die Schaltung in den Kalibriermodus zu versetzen" UBYTE OneToOne 1 100 0.00 255.0 FORMAT "%5.1" ECU_ADDRESS 0x7F8911 /end MEASUREMENT
/begin MEASUREMENT LSUCD_stO2SPISens "Modus-Bits zum Setzen der Empfindlichkeit der O2-Auswertung" UWORD OneToOne 1 100 0.00 65535.00 FORMAT "%8.2" ARRAY_SIZE 1 ECU_ADDRESS 0x7F8EEA /end MEASUREMENT
/begin MEASUREMENT LSUCD_stO2Valid "Zustand O2 Signal (0 = ungültig, 1 = gültig)" UBYTE OneToOne 1 100 0.00 255.0 FORMAT "%5.1" ARRAY_SIZE 1 ECU_ADDRESS 0x7F8912 /end MEASUREMENT
/begin MEASUREMENT LSUCD_stOpnErrIP "Status Leerlauf-Fehler Pumpstrom Pin (IP)" UBYTE OneToOne 1 100 0.00 255.0 FORMAT "%5.1" ARRAY_SIZE 1 ECU_ADDRESS 0x7F8913 /end MEASUREMENT
/begin MEASUREMENT LSUCD_stOpnLdTstActv "Message von LSU_WireDiagnosis, die anzeigt, ob die Kabelunterbrechungsdiagnose für Nernst-Zelle und virtuelle Masse aktiv ist" UBYTE OneToOne 1 100 0.00 255.0 FORMAT "%5.1" ARRAY_SIZE 1 ECU_ADDRESS 0x7F8914 /end MEASUREMENT
/begin MEASUREMENT LSUCD_stPumpCtl "Status der Pumpensteuerung (ein/aus)" UBYTE OneToOne 1 100 0.00 255.0 FORMAT "%5.1" ARRAY_SIZE 1 ECU_ADDRESS 0x7F8915 /end MEASUREMENT
/begin MEASUREMENT LSUCD_stPumpDemRef "externe Anforderung Referenzpumpströme" UBYTE OneToOne 1 100 0.00 255.0 FORMAT "%5.1" ARRAY_SIZE 1 ECU_ADDRESS 0x7F8916 /end MEASUREMENT
/begin MEASUREMENT LSUCD_stPumpEna "Zustand der CJ 120 Pumpstromregelung (0 = abgeschaltet, 1 = aktiv = Strom angeschaltet)" UBYTE OneToOne 1 100 0.00 255.0 FORMAT "%5.1" ARRAY_SIZE 1 ECU_ADDRESS 0x7F8917 /end MEASUREMENT
/begin MEASUREMENT LSUCD_stRecValEval_mp "Messpunkt für den Status der Auswertung erfasster Werte in der Heizungskopplung" UBYTE OneToOne 1 100 0.00 255.0 FORMAT "%5.1" ARRAY_SIZE 1 ECU_ADDRESS 0x8FF586 /end MEASUREMENT
/begin MEASUREMENT LSUCD_stRefCurTrans_mp "Status des Übergangs von hohem zu niedrigem Strom" UBYTE OneToOne 1 100 0.00 255.0 FORMAT "%5.1" ARRAY_SIZE 1 ECU_ADDRESS 0x8FF56E /end MEASUREMENT
/begin MEASUREMENT LSUCD_stRefPump "Status der Referenz Pumpströme (0 = off, 1 = 20 uA, 2 = 40 uA, 3 = 60 uA)" UBYTE OneToOne 1 100 0.00 255.0 FORMAT "%5.1" ARRAY_SIZE 1 ECU_ADDRESS 0x7F8918 /end MEASUREMENT
/begin MEASUREMENT LSUCD_stRgnEna "Nachricht, um Regeneration zu befähigen" UBYTE OneToOne 1 100 0.00 255.0 FORMAT "%5.1" ECU_ADDRESS 0x7F8919 /end MEASUREMENT
/begin MEASUREMENT LSUCD_stRgnIpSettle "Status des Pumpe-Stromes, der nach Regeneration setzt" UBYTE OneToOne 1 100 0.00 255.0 FORMAT "%5.1" ECU_ADDRESS 0x7F891A /end MEASUREMENT
/begin MEASUREMENT LSUCD_stRiClb "Status der Ri-Kalibrierungssequenz" UBYTE OneToOne 1 100 0.00 255.0 FORMAT "%5.1" ECU_ADDRESS 0x7F891B /end MEASUREMENT
/begin MEASUREMENT LSUCD_stRiClbEna "Auslöser für Ri Abgleichsequenz" UBYTE OneToOne 1 100 0.00 255.0 FORMAT "%5.1" ECU_ADDRESS 0x7F891C /end MEASUREMENT
/begin MEASUREMENT LSUCD_stRiFltAct_mp "Messpunkt für den Status der Filteraktivierung" UBYTE OneToOne 1 100 0.00 255.0 FORMAT "%5.1" ARRAY_SIZE 1 ECU_ADDRESS 0x8FF580 /end MEASUREMENT
/begin MEASUREMENT LSUCD_stRiLimSlp_mp "Zustand der Ri Störungsunterdrückung" UBYTE OneToOne 1 100 0.00 255.0 FORMAT "%5.1" ARRAY_SIZE 1 ECU_ADDRESS 0x8FF581 /end MEASUREMENT
/begin MEASUREMENT LSUCD_stRiSPICalDem "Anforderung der Ri-Regelung Einschaltung des Lern- oder Messmodus" UBYTE OneToOne 1 100 0.00 255.0 FORMAT "%5.1" ECU_ADDRESS 0x7F891D /end MEASUREMENT
/begin MEASUREMENT LSUCD_stRiValid "Zustand Ri Signals (0 = ungültig, 1 = gültig)" UBYTE OneToOne 1 100 0.00 255.0 FORMAT "%5.1" ARRAY_SIZE 1 ECU_ADDRESS 0x7F891E /end MEASUREMENT
/begin MEASUREMENT LSUCD_stSPIDiaInfo "Status der SPI Chip Diagnose" UWORD OneToOne 1 100 0.00 65535.00 FORMAT "%8.2" ARRAY_SIZE 1 ECU_ADDRESS 0x7F8EEC /end MEASUREMENT
/begin MEASUREMENT LSUCD_stSPIInitVal "Wert des CJ12x Initialisierungsregisters" UWORD OneToOne 1 100 0.00 65535.00 FORMAT "%8.2" ARRAY_SIZE 1 ECU_ADDRESS 0x7F8EEE /end MEASUREMENT
/begin MEASUREMENT LSUCD_stSRCState_mp "Status der SRC Überwachung des O2 Rohsignales" UBYTE OneToOne 1 100 0.00 255.0 FORMAT "%5.1" ARRAY_SIZE 1 ECU_ADDRESS 0x8FF571 /end MEASUREMENT
/begin MEASUREMENT LSUCD_stTstTrigger_mp "Messpunkt für den Status zur Auslösung des Tests der Nebenschlusserkennung" UBYTE OneToOne 1 100 0.00 255.0 FORMAT "%5.1" ARRAY_SIZE 1 ECU_ADDRESS 0x8FF587 /end MEASUREMENT
/begin MEASUREMENT LSUCD_stWireDiaChk_mp "Bitfeld: Unterdiagnosen ausgeführt" UBYTE OneToOne 1 100 0.00 255.0 FORMAT "%5.1" ARRAY_SIZE 1 ECU_ADDRESS 0x8FF588 /end MEASUREMENT
/begin MEASUREMENT LSUCD_stWireDiaErr_mp "Status des Fehlers Nebenschlusserkennung" UBYTE OneToOne 1 100 0.00 255.0 FORMAT "%5.1" ARRAY_SIZE 1 ECU_ADDRESS 0x8FF589 /end MEASUREMENT
/begin MEASUREMENT LSUCD_swtAdpt "Schalter für Adaption der Lambda-Sonde" UBYTE OneToOne 1 100 0.00 255.0 FORMAT "%5.1" ECU_ADDRESS 0x7F891F /end MEASUREMENT
/begin MEASUREMENT LSUCD_tRi "Äquivalenztemperatur des gemessenen Ri-Werts" SWORD Temp_Cels 1 100 -50.140 899.860 FORMAT "%8.3" ARRAY_SIZE 1 ECU_ADDRESS 0x7F8EF0 /end MEASUREMENT
/begin MEASUREMENT LSUCD_uO2Clb "Offsetspannungs Korrekturwert für Lambda Spannungswert" SWORD Volt 1 100 -160156.4 160151.5 FORMAT "%8.1" ARRAY_SIZE 1 ECU_ADDRESS 0x7F8EF2 /end MEASUREMENT
/begin MEASUREMENT LSUCD_uO2FltRippel_mp "Gefilterte, überlagerte Sauerstoff-Wechselspannung bei Diagnose der Heizungskopplung" SWORD Volt 1 100 -160156.4 160151.5 FORMAT "%8.1" ARRAY_SIZE 1 ECU_ADDRESS 0x8FF58A /end MEASUREMENT
/begin MEASUREMENT LSUCD_uO2Grad_mp "Gradient der Sauerstoff-Spannung bei Diagnose der Heizungskopplung" SWORD Volt 1 100 -160156.4 160151.5 FORMAT "%8.1" ARRAY_SIZE 1 ECU_ADDRESS 0x8FF58C /end MEASUREMENT
/begin MEASUREMENT LSUCD_uO2HtCoupStep1 "O2 Konzentration im ersten Datenakquisitionszyklus" SWORD Volt 1 100 -160156.4 160151.5 FORMAT "%8.1" ARRAY_SIZE 1 ECU_ADDRESS 0x7F8EF4 /end MEASUREMENT
/begin MEASUREMENT LSUCD_uO2HtCoupStep2 "O2 Konzentration im zweiten Datenakquisitionszyklus" SWORD Volt 1 100 -160156.4 160151.5 FORMAT "%8.1" ARRAY_SIZE 1 ECU_ADDRESS 0x7F8EF6 /end MEASUREMENT
/begin MEASUREMENT LSUCD_uO2HtCoupStep3 "O2 Konzentration im dritten Datenakquisitionszyklus" SWORD Volt 1 100 -160156.4 160151.5 FORMAT "%8.1" ARRAY_SIZE 1 ECU_ADDRESS 0x7F8EF8 /end MEASUREMENT
/begin MEASUREMENT LSUCD_uO2OfsCor_mp "O2 Spannungswert nach Offset Kompensation" SWORD Volt 1 100 -160156.4 160151.5 FORMAT "%8.1" ECU_ADDRESS 0x8FF572 /end MEASUREMENT
/begin MEASUREMENT LSUCD_uO2Raw "Spannungsrohwert Lambdasignal nach Mittelung und Subtraktion Referenzwert" SWORD Volt 1 100 -160156.4 160151.5 FORMAT "%8.1" ARRAY_SIZE 1 ECU_ADDRESS 0x7F8EFA /end MEASUREMENT
/begin MEASUREMENT LSUCD_uO2Raw_mp "O2 Spannung nach Mittelwertbildung" SWORD Volt 1 100 -160156.4 160151.5 FORMAT "%8.1" ARRAY_SIZE 1 ECU_ADDRESS 0x8FF574 /end MEASUREMENT
/begin MEASUREMENT LSUCD_uO2Rippel_mp "Sauerstoff-Wechselspannung bei Diagnose der Heizungskopplung" SWORD Volt 1 100 -160156.4 160151.5 FORMAT "%8.1" ARRAY_SIZE 1 ECU_ADDRESS 0x8FF58E /end MEASUREMENT
/begin MEASUREMENT LSUCD_uRiRaw "Spannungsrohwert Ri nach Mittelung" SWORD Volt 1 100 -160156.4 160151.5 FORMAT "%8.1" ARRAY_SIZE 1 ECU_ADDRESS 0x7F8EFC /end MEASUREMENT
/begin MEASUREMENT LSUCtl_dcycDT1_mp "DT1 Anteil der Heizungsregler Tastverhältnisanforderung" SWORD DtyCyc 1 100 -327.6800 327.6700 FORMAT "%8.4" ARRAY_SIZE 1 ECU_ADDRESS 0x8FF590 /end MEASUREMENT
/begin MEASUREMENT LSUCtl_dcycHt "Heizertastverhältnis Anforderung durch Ri Regelung" SWORD DtyCyc 1 100 -327.6800 327.6700 FORMAT "%8.4" ARRAY_SIZE 1 ECU_ADDRESS 0x7F8EFE /end MEASUREMENT
/begin MEASUREMENT LSUCtl_dcycHtIniRamp "Startwert für Aufheizkurven Rampe" SWORD DtyCyc 1 100 -327.6800 327.6700 FORMAT "%8.4" ECU_ADDRESS 0x7F8F00 /end MEASUREMENT
/begin MEASUREMENT LSUCtl_dcycHtStrt "Tastverhältnisvorgabe Heizung durch Aufheizstrategie" SWORD DtyCyc 1 100 -327.6800 327.6700 FORMAT "%8.4" ARRAY_SIZE 1 ECU_ADDRESS 0x7F8F02 /end MEASUREMENT
/begin MEASUREMENT LSUCtl_dcycPI_mp "Tastverhältnisforderung aus dem P I Regelglied" SWORD DtyCyc 1 100 -327.6800 327.6700 FORMAT "%8.4" ARRAY_SIZE 1 ECU_ADDRESS 0x8FF592 /end MEASUREMENT
/begin MEASUREMENT LSUCtl_stHtCtl "Statusbits Zustand Heizungsregelung" UBYTE OneToOne 1 100 0.00 255.0 FORMAT "%5.1" ARRAY_SIZE 1 ECU_ADDRESS 0x7F8920 /end MEASUREMENT
/begin MEASUREMENT LSUCtl_stHtDisable "High level Diagnose Anforderung Heizungsregelungsabschaltung (0 = nicht abgeschaltet, >0 Ausgang = 0 %)" UBYTE OneToOne 1 100 0.00 255.0 FORMAT "%5.1" ARRAY_SIZE 1 ECU_ADDRESS 0x7F8921 /end MEASUREMENT
/begin MEASUREMENT LSUCtl_stRmp_mp "Ansteuerstatus für geschaltete Rampe" UBYTE OneToOne 1 100 0.00 255.0 FORMAT "%5.1" ARRAY_SIZE 1 ECU_ADDRESS 0x8FF594 /end MEASUREMENT
/begin MEASUREMENT LSUCtl_stSCUNEna "Message um Test für Erkennung von Kurzschluss nach Vbat bei UNI freizugeben" UBYTE OneToOne 1 100 0.00 255.0 FORMAT "%5.1" ARRAY_SIZE 1 ECU_ADDRESS 0x7F8922 /end MEASUREMENT
/begin MEASUREMENT LSUCtl_tAirStrt_mp "Ansauglufttemperatur nach Zündung an (mit Verzögerung erfasst!)" SWORD Temp_Cels 1 100 -50.140 899.860 FORMAT "%8.3" ECU_ADDRESS 0x8FF596 /end MEASUREMENT
/begin MEASUREMENT LSUCtl_tDvt_mp "Regelabweichung Sensortemperatur" SWORD TempDiff_Cels 1 100 -3276.800 3276.700 FORMAT "%8.3" ARRAY_SIZE 1 ECU_ADDRESS 0x8FF598 /end MEASUREMENT
/begin MEASUREMENT LSU_bpPlausSetPoint_mp "Bitposition für Zugriff auf LSU_stO2Err(_mp)" UBYTE OneToOne 1 100 0.00 255.0 FORMAT "%5.1" ECU_ADDRESS 0x8FF554 /end MEASUREMENT
/begin MEASUREMENT LSU_qStrt_mp "anfängliche Kraftstoffmenge in Dynamik-Überwachung" SWORD InjMass 1 100 -327.6800 327.6700 FORMAT "%8.4" ECU_ADDRESS 0x8FF556 /end MEASUREMENT
/begin MEASUREMENT LSU_rLmbd "Lambda" SWORD lambda 1 100 -32.76800 32.76700 FORMAT "%8.5" ARRAY_SIZE 1 ECU_ADDRESS 0x7F8F04 /end MEASUREMENT
/begin MEASUREMENT LSU_rLmbdRec "Kehrwert von Lambda" SWORD lambdaRecVal 1 100 -32.76800 32.76700 FORMAT "%8.5" ARRAY_SIZE 1 ECU_ADDRESS 0x7F8F06 /end MEASUREMENT
/begin MEASUREMENT LSU_rO2ActVal "Aktuell von Plausibilisierung verwendete O2-Konzentration" SWORD O2 1 100 -0.3276800 0.3276700 FORMAT "%9.7" ARRAY_SIZE 1 ECU_ADDRESS 0x7F8F08 /end MEASUREMENT
/begin MEASUREMENT LSU_rO2Adpt "Adaptierte Sauerstoffkonzentration die an externe Module übertragen wird" SWORD O2 1 100 -0.3276800 0.3276700 FORMAT "%9.7" ARRAY_SIZE 1 ECU_ADDRESS 0x7F8F0A /end MEASUREMENT
/begin MEASUREMENT LSU_rO2AdptLastLSU_mp "Adaptierte Sauerstoffkonzentration des Sensors mit der höchsten Nummer" SWORD O2 1 100 -0.3276800 0.3276700 FORMAT "%9.7" ECU_ADDRESS 0x8FF542 /end MEASUREMENT
/begin MEASUREMENT LSU_rO2Calc_mp "aktuelle O2-Konzentration aus Luftmasse und Einspritzmenge" SWORD O2 1 100 -0.3276800 0.3276700 FORMAT "%9.7" ECU_ADDRESS 0x8FF558 /end MEASUREMENT
/begin MEASUREMENT LSU_rO2DiffCmpChk "O2-Unterscheid eines Sondenpaars" SWORD O2 1 100 -0.3276800 0.3276700 FORMAT "%9.7" ECU_ADDRESS 0x7FF458 /end MEASUREMENT
/begin MEASUREMENT LSU_rO2DvtNeg_mp "Minustoleranz für Plausibilisierung O2-Signal LSU" SWORD O2 1 100 -0.3276800 0.3276700 FORMAT "%9.7" ECU_ADDRESS 0x8FF55A /end MEASUREMENT
/begin MEASUREMENT LSU_rO2DvtPos_mp "Plustoleranz für Plausibilisierung O2-Signal LSU" SWORD O2 1 100 -0.3276800 0.3276700 FORMAT "%9.7" ECU_ADDRESS 0x8FF55C /end MEASUREMENT
/begin MEASUREMENT LSU_rO2Lmbd1Thres "Message: Toleranzband für Lambda-1-Erkennung" SWORD O2 1 100 -0.3276800 0.3276700 FORMAT "%9.7" ECU_ADDRESS 0x7F8F0C /end MEASUREMENT
/begin MEASUREMENT LSU_rO2MaxDiff "Maximale O2 Differenz zwischen ausgewählten Lambdasonden" SWORD O2 1 100 -0.3276800 0.3276700 FORMAT "%9.7" ECU_ADDRESS 0x7FF458 /end MEASUREMENT
/begin MEASUREMENT LSU_rO2MaxVal "Oberer Grenzwert der Plausibilisierung" SWORD O2 1 100 -0.3276800 0.3276700 FORMAT "%9.7" ARRAY_SIZE 1 ECU_ADDRESS 0x7F8F0E /end MEASUREMENT
/begin MEASUREMENT LSU_rO2MinVal "Unterer Grenzwert der Plausibilisierung" SWORD O2 1 100 -0.3276800 0.3276700 FORMAT "%9.7" ARRAY_SIZE 1 ECU_ADDRESS 0x7F8F10 /end MEASUREMENT
/begin MEASUREMENT LSU_rO2RawFlt "Gefilterte O2Raw-Sauerstoffkonzentration in Lambda-1-Erkennung" SWORD O2 1 100 -0.3276800 0.3276700 FORMAT "%9.7" ARRAY_SIZE 1 ECU_ADDRESS 0x7F8F12 /end MEASUREMENT
/begin MEASUREMENT LSU_rO2Stat_mp "gefilterte O2-Konzentration aus Luftmasse und Einspritzmenge" SWORD O2 1 100 -0.3276800 0.3276700 FORMAT "%9.7" ARRAY_SIZE 1 ECU_ADDRESS 0x8FF544 /end MEASUREMENT
/begin MEASUREMENT LSU_rO2Thres1_mp "untere O2-Schwelle für Messung der Anstiegszeit" SWORD O2 1 100 -0.3276800 0.3276700 FORMAT "%9.7" ARRAY_SIZE 1 ECU_ADDRESS 0x8FF546 /end MEASUREMENT
/begin MEASUREMENT LSU_rO2Thres2_mp "obere O2-Schwelle für Messung der Anstiegszeit" SWORD O2 1 100 -0.3276800 0.3276700 FORMAT "%9.7" ARRAY_SIZE 1 ECU_ADDRESS 0x8FF548 /end MEASUREMENT
/begin MEASUREMENT LSU_stChkDyn_mp "Nummer der zuletzt erreichten O2-Schwelle" UBYTE OneToOne 1 100 0.00 255.0 FORMAT "%5.1" ARRAY_SIZE 1 ECU_ADDRESS 0x8FF54A /end MEASUREMENT
/begin MEASUREMENT LSU_stClbDisable "Disable-Signal für CJ120-Kalibrierung" UBYTE OneToOne 1 100 0.00 255.0 FORMAT "%5.1" ECU_ADDRESS 0x7F8923 /end MEASUREMENT
/begin MEASUREMENT LSU_stClbTrg_mp "CJ125-Kalibrierung bzw. Pumpstromumkehr ist freigegeben" UBYTE OneToOne 1 100 0.00 255.0 FORMAT "%5.1" ECU_ADDRESS 0x8FF53E /end MEASUREMENT
/begin MEASUREMENT LSU_stConstPOp "Statusmessage konstanter Betriebspunkt" UBYTE OneToOne 1 100 0.00 255.0 FORMAT "%5.1" ECU_ADDRESS 0x7F8924 /end MEASUREMENT
/begin MEASUREMENT LSU_stNotOpPoint1_mp "Messen des Punktes für Status des Betriebsgebiets 1" UBYTE OneToOne 1 100 0.00 255.0 FORMAT "%5.1" ECU_ADDRESS 0x8FF53F /end MEASUREMENT
/begin MEASUREMENT LSU_stNotOpPoint2_mp "Messen des Punktes für Status des Betriebsgebiets 2" UBYTE OneToOne 1 100 0.00 255.0 FORMAT "%5.1" ECU_ADDRESS 0x8FF540 /end MEASUREMENT
/begin MEASUREMENT LSU_stO2Chk_mp "Bitfeld :: Teildiagnosen durchgeführt" UWORD OneToOne 1 100 0.00 65535.00 FORMAT "%8.2" ARRAY_SIZE 1 ECU_ADDRESS 0x8FF54C /end MEASUREMENT
/begin MEASUREMENT LSU_stO2Err_mp "Statuswort :: Diagnoseergebnisse" UWORD OneToOne 1 100 0.00 65535.00 FORMAT "%8.2" ARRAY_SIZE 1 ECU_ADDRESS 0x8FF54E /end MEASUREMENT
/begin MEASUREMENT LSU_stPlausChkCon_mp "Statuswort Zustand der Voraussetzungen für Plausibilitätscheck" UBYTE OneToOne 1 100 0.00 255.0 FORMAT "%5.1" ECU_ADDRESS 0x8FF550 /end MEASUREMENT
/begin MEASUREMENT LSU_stPlausChk_mp "Statuswort Zustand Plausibilitäts-Check" UBYTE OneToOne 1 100 0.00 255.0 FORMAT "%5.1" ARRAY_SIZE 1 ECU_ADDRESS 0x8FF551 /end MEASUREMENT
/begin MEASUREMENT LSU_stStrtClb "Hilfsvariable für Kalibrierungs-Scheduler" UBYTE OneToOne 1 100 0.00 255.0 FORMAT "%5.1" ECU_ADDRESS 0x7F8925 /end MEASUREMENT
/begin MEASUREMENT LSU_stTmrClbPerRun "Status des Kalibrier-Timers" UBYTE OneToOne 1 100 0.00 255.0 FORMAT "%5.1" ECU_ADDRESS 0x7F8926 /end MEASUREMENT
/begin MEASUREMENT LSU_swtEna "Status-Message zu Freigabe oder Sperren der gesamten LSU-Funktionen" UBYTE OneToOne 1 100 0.00 255.0 FORMAT "%5.1" ECU_ADDRESS 0x7F8927 /end MEASUREMENT
/begin MEASUREMENT LSU_tiState1_mp "Timervariable: Kraftstoffmenge liegt innerhalb Toleranzband" UWORD Time_s 1 100 0.00 655.3500 FORMAT "%8.4" ARRAY_SIZE 1 ECU_ADDRESS 0x8FF552 /end MEASUREMENT
/begin MEASUREMENT LSU_tiState2 "Message: Anstiegszeit O2-Signal beim Übergang Last-Schub (Dynamiküberwachung)" UWORD Time_s 1 100 0.00 655.3500 FORMAT "%8.4" ARRAY_SIZE 1 ECU_ADDRESS 0x7F8F14 /end MEASUREMENT
/begin MEASUREMENT LSU_tiState3 "Message: Zeitdauer bis zum Erreichen des Schubs (Kraftstoffmenge kleiner als Schwellwert)" UWORD Time_s 1 100 0.00 655.3500 FORMAT "%8.4" ARRAY_SIZE 1 ECU_ADDRESS 0x7F8F16 /end MEASUREMENT
/begin MEASUREMENT LSU_tiSwitch "Message: Maximal zulässiger Wert für O2-Flankenzeit Last -> Schub" UWORD Time_s 1 100 0.00 655.3500 FORMAT "%8.4" ARRAY_SIZE 1 ECU_ADDRESS 0x7F8F18 /end MEASUREMENT
/begin MEASUREMENT LSU_tiWait3 "Message: maximale Zeitdauer zum erreichen der oberen O2-Schwelle in Dynamiküberwachung" UWORD Time_s 1 100 0.00 655.3500 FORMAT "%8.4" ARRAY_SIZE 1 ECU_ADDRESS 0x7F8F1A /end MEASUREMENT
/begin MEASUREMENT LubCD_ctHigh "" UWORD OneToOne 1 100 0.00 65535.00 FORMAT "%8.2" ECU_ADDRESS 0x7F8F26 /end MEASUREMENT
/begin MEASUREMENT LubCD_ctLow "" UWORD OneToOne 1 100 0.00 65535.00 FORMAT "%8.2" ECU_ADDRESS 0x7F8F28 /end MEASUREMENT
/begin MEASUREMENT LubCD_ctTog "Counter für fallende Flanken" UBYTE OneToOne 1 100 0.00 255.0 FORMAT "%5.1" ECU_ADDRESS 0x7F8939 /end MEASUREMENT
/begin MEASUREMENT LubCD_dioIn "" UBYTE OneToOne 1 100 0.00 255.0 FORMAT "%5.1" ECU_ADDRESS 0x7F893A /end MEASUREMENT
/begin MEASUREMENT LubCD_st "Status LubCD" UBYTE OneToOne 1 100 0.00 255.0 FORMAT "%5.1" ECU_ADDRESS 0x7F893B /end MEASUREMENT
/begin MEASUREMENT LubCD_stErr_mp "error status" UBYTE OneToOne 1 100 0.00 255.0 FORMAT "%5.1" ECU_ADDRESS 0x8FF59A /end MEASUREMENT
/begin MEASUREMENT LubCD_stOelTog "condition oil niveau not valid" UBYTE OneToOne 1 100 0.00 255.0 FORMAT "%5.1" ECU_ADDRESS 0x7F893C /end MEASUREMENT
/begin MEASUREMENT LubCD_stTOel "Öltemperatur ist valid" UBYTE OneToOne 1 100 0.00 255.0 FORMAT "%5.1" ECU_ADDRESS 0x7F893D /end MEASUREMENT
/begin MEASUREMENT LubCD_stTog "condition oil niveau valid" UBYTE OneToOne 1 100 0.00 255.0 FORMAT "%5.1" ECU_ADDRESS 0x7F893E /end MEASUREMENT
/begin MEASUREMENT LubCD_tiHigh_mp "Hightime" UWORD Period_ms 1 100 0.00 6553.500 FORMAT "%8.3" ECU_ADDRESS 0x8FF59C /end MEASUREMENT
/begin MEASUREMENT LubCD_tiLow_mp "Lowtime" UWORD Period_ms 1 100 0.00 6553.500 FORMAT "%8.3" ECU_ADDRESS 0x8FF59E /end MEASUREMENT
/begin MEASUREMENT LubCD_titk "Periodendauer für Ölniveau" UWORD Period_ms 1 100 0.00 6553.500 FORMAT "%8.3" ECU_ADDRESS 0x7F8F2A /end MEASUREMENT
/begin MEASUREMENT LubCD_titr "Periodendauer Öltemperatur Referenzsignal" UWORD Period_ms 1 100 0.00 6553.500 FORMAT "%8.3" ECU_ADDRESS 0x7F8F2C /end MEASUREMENT
/begin MEASUREMENT LubCD_titv "Periodendauer für Öltemperatur" UWORD Period_ms 1 100 0.00 6553.500 FORMAT "%8.3" ECU_ADDRESS 0x7F8F2E /end MEASUREMENT
/begin MEASUREMENT LubCD_Tog_icnt "" UWORD OneToOne 1 100 0.00 65535.00 FORMAT "%8.2" ECU_ADDRESS 0x7F8F24 /end MEASUREMENT
/begin MEASUREMENT LubCD_Tog_uplcnt "" UBYTE OneToOne 1 100 0.00 255.0 FORMAT "%5.1" ECU_ADDRESS 0x7F8938 /end MEASUREMENT
/begin MEASUREMENT MemMon_ctErrChkRam "Fehlerzähler für Doppelablage und zyklischen RAM-Test" UBYTE OneToOne 1 100 0.00 255.0 FORMAT "%5.1" ECU_ADDRESS 0x7F9989 /end MEASUREMENT
/begin MEASUREMENT MemMon_ctErrChkRom "Fehlerzähler für zyklischen ROM-Test" UBYTE OneToOne 1 100 0.00 255.0 FORMAT "%5.1" ECU_ADDRESS 0x7F998A /end MEASUREMENT
/begin MEASUREMENT MemMon_ctHealChkRam "Heilungszähler für Doppelablage und zyklischen RAM-Test" UBYTE Time_ms_40ms 1 100 0.00 10200. FORMAT "%5.0" ECU_ADDRESS 0x7F998B /end MEASUREMENT
/begin MEASUREMENT MemMon_ctHealChkRom "Heilungszähler für zyklischen ROM-Test" UBYTE Time_ms_40ms 1 100 0.00 10200. FORMAT "%5.0" ECU_ADDRESS 0x7F998C /end MEASUREMENT
/begin MEASUREMENT MemMon_st "Status der Speicherüberwachung" UBYTE OneToOne 1 100 0.00 255.0 FORMAT "%5.1" ECU_ADDRESS 0x7F9988 /end MEASUREMENT
/begin MEASUREMENT MeUnCD_dcycDT1_mp "Sollwert Tastverhältnis mit DT1-Anteil" SWORD DtyCyc 1 100 -327.6800 327.6700 FORMAT "%8.4" ECU_ADDRESS 0x8FF5A2 /end MEASUREMENT
/begin MEASUREMENT MeUnCD_dcycOut_mp "Ausgangstastverhältnis" SWORD DtyCyc 1 100 -327.6800 327.6700 FORMAT "%8.4" ECU_ADDRESS 0x6F81AA /end MEASUREMENT
/begin MEASUREMENT MeUnCD_dcycSetValLin_mp "linearisierter Sollwert der Zumesseinheit" SWORD DtyCyc 1 100 -327.6800 327.6700 FORMAT "%8.4" ECU_ADDRESS 0x8FF5A4 /end MEASUREMENT
/begin MEASUREMENT MeUnCD_dcycSetVal_mp "Sollwert Tastverhältnis für Zumesseinheit" SWORD DtyCyc 1 100 -327.6800 327.6700 FORMAT "%8.4" ECU_ADDRESS 0x8FF5A6 /end MEASUREMENT
/begin MEASUREMENT MeUnCD_facIGov_mp "Zumesseinheit-Stromregelung I-Anteil" SWORD Fact 1 100 -4.000000 3.999878 FORMAT "%8.6" ECU_ADDRESS 0x8FF5A8 /end MEASUREMENT
/begin MEASUREMENT MeUnCD_iActFlt_mp "Zumesseinheit-Stromregelung gefilterter Strom-Istwert" SWORD Curr 1 100 -32768.00 32767.00 FORMAT "%8.2" ECU_ADDRESS 0x6F81AC /end MEASUREMENT
/begin MEASUREMENT MeUnCD_iDvt_mp "Zumesseinheit-Stromregelung Regelabweichung" SWORD Curr 1 100 -32768.00 32767.00 FORMAT "%8.2" ECU_ADDRESS 0x8FF5AA /end MEASUREMENT
/begin MEASUREMENT MeUnCD_iGovActVal "Analogeingang Strom-Istwert" SWORD Curr 1 100 -32768.00 32767.00 FORMAT "%8.2" ECU_ADDRESS 0x7F8F32 /end MEASUREMENT
/begin MEASUREMENT MeUnCD_iSetFlt "Zumesseinheit-Stromregelung gefilterter Strom-Sollwert" SWORD Curr 1 100 -32768.00 32767.00 FORMAT "%8.2" ECU_ADDRESS 0x7F8F34 /end MEASUREMENT
/begin MEASUREMENT MeUnCD_nDiffRef_mp "gefilterte Drehzahl für Kennlinie" SWORD EngN 1 100 -32768.00 32767.00 FORMAT "%8.2" ECU_ADDRESS 0x8FF5AC /end MEASUREMENT
/begin MEASUREMENT MeUnCD_tiPer_mp "Periodendauer der PWM-Endstufe" SWORD Period 1 100 -3276.800 3276.700 FORMAT "%8.3" ECU_ADDRESS 0x8FF5AE /end MEASUREMENT
/begin MEASUREMENT MeUnCD_uRawVal_mp "Analogeingang Spannungsrohwert" SWORD Volt 1 100 -160156.4 160151.5 FORMAT "%8.1" ECU_ADDRESS 0x8FF5B0 /end MEASUREMENT
/begin MEASUREMENT MeUn_iSet_mp "Sollstrom für die Zumesseinheit" SWORD Curr 1 100 -32768.00 32767.00 FORMAT "%8.2" ECU_ADDRESS 0x6F81A8 /end MEASUREMENT
/begin MEASUREMENT MeUn_stActrCtl_mp "Zustand der Stellwertsteuerung für die Zumesseinheit" UBYTE OneToOne 1 100 0.00 255.0 FORMAT "%5.1" ECU_ADDRESS 0x8FF5A0 /end MEASUREMENT
/begin MEASUREMENT MRlyCD_ctTooEarlyInit_mp "Fehlerzähler ""Hauptrelais öffnet zu früh"",Zählerwert nach SG Ini." UBYTE OneToOne 1 100 0.00 255.0 FORMAT "%5.1" ECU_ADDRESS 0x8FF5B2 /end MEASUREMENT
/begin MEASUREMENT MRlyCD_ctTooEarly_mp "Fehlerzähler für ""Hauptrelais öffnet zu früh"" Fehler" UBYTE OneToOne 1 100 0.00 255.0 FORMAT "%5.1" ECU_ADDRESS 0x8FF5B3 /end MEASUREMENT
/begin MEASUREMENT MRlyCD_stMon "aktueller Zustand der Hauptrelaisüberwachung" UBYTE OneToOne 1 100 0.00 255.0 FORMAT "%5.1" ECU_ADDRESS 0x7F893F /end MEASUREMENT
/begin MEASUREMENT MRlyCD_stPrevOpening "Bedingung / Grund für das Öffnen des Hauptrelais während letztem Steuergerätelauf" UBYTE OneToOne 1 100 0.00 255.0 FORMAT "%5.1" ECU_ADDRESS 0x7F8940 /end MEASUREMENT
/begin MEASUREMENT MSidCD_numECUS "Anzahl der ECU in diesem system: 1 - 4 (Master/Slave)" UBYTE OneToOne 1 100 0.00 255.0 FORMAT "%5.1" ECU_ADDRESS 0x7F8941 /end MEASUREMENT
/begin MEASUREMENT MSidCD_stCANpriv_mp "Status Plausibilisierung über priv. CAN (entprellt)" UBYTE OneToOne 1 100 0.00 255.0 FORMAT "%5.1" ECU_ADDRESS 0x8FF5B4 /end MEASUREMENT
/begin MEASUREMENT MSidCD_stECUCANpriv_mp "Status privater CAN (nicht entprellt)" UWORD OneToOne 1 100 0.00 65535.00 FORMAT "%8.2" ECU_ADDRESS 0x8FF5B6 /end MEASUREMENT
/begin MEASUREMENT MSidCD_stECUCANPtHelp_mp "Olda privater CAN Fehler-Status Senden um Empfangen" UWORD OneToOne 1 100 0.00 65535.00 FORMAT "%8.2" ECU_ADDRESS 0x8FF5B8 /end MEASUREMENT
/begin MEASUREMENT MSidCD_stECULearned_mp "Status SG-Auswahl gelernt (EEPROM-info)" UBYTE OneToOne 1 100 0.00 255.0 FORMAT "%5.1" ECU_ADDRESS 0x8FF5BA /end MEASUREMENT
/begin MEASUREMENT MSidCD_stECULTmp_mp "Status SG-Auswahl vorläufig gelernt" UBYTE OneToOne 1 100 0.00 255.0 FORMAT "%5.1" ECU_ADDRESS 0x8FF5BB /end MEASUREMENT
/begin MEASUREMENT MSidCD_stECUPlaus_mp "Status Plausibilisierung SG-Auswahl" UBYTE OneToOne 1 100 0.00 255.0 FORMAT "%5.1" ECU_ADDRESS 0x8FF5BC /end MEASUREMENT
/begin MEASUREMENT MSidCD_stECUSelect_mp "Zusammenfassung Stati SG-Auswahl" UBYTE OneToOne 1 100 0.00 255.0 FORMAT "%5.1" ECU_ADDRESS 0x8FF5BD /end MEASUREMENT
/begin MEASUREMENT MSidCD_stECUStatus_mp "Zustandsautomat SG-Auswahl" UBYTE OneToOne 1 100 0.00 255.0 FORMAT "%5.1" ECU_ADDRESS 0x8FF5BE /end MEASUREMENT
/begin MEASUREMENT MSidCD_stErrEcuPinComm_mp "State of ECU pin error" UBYTE OneToOne 1 100 0.00 255.0 FORMAT "%5.1" ECU_ADDRESS 0x8FF5BF /end MEASUREMENT
/begin MEASUREMENT MSidCD_stErrECUSelect_mp "Errorflag SG-Auswahl nicht plausibel" UBYTE OneToOne 1 100 0.00 255.0 FORMAT "%5.1" ECU_ADDRESS 0x8FF5C0 /end MEASUREMENT
/begin MEASUREMENT MSidCD_stInjOffECU "Einspritzverbot durch SG-Auswahl" UBYTE OneToOne 1 100 0.00 255.0 FORMAT "%5.1" ECU_ADDRESS 0x7F8942 /end MEASUREMENT
/begin MEASUREMENT MSidCD_stSetEEPROM_mp "Status EEPROM (Schreiben) Lernen (SG-Auswahl)" UBYTE OneToOne 1 100 0.00 255.0 FORMAT "%5.1" ECU_ADDRESS 0x8FF5C1 /end MEASUREMENT
/begin MEASUREMENT MSidCD_swtECUinfo_mp "Input SG-Auswahl Info-EEPROM" UBYTE OneToOne 1 100 0.00 255.0 FORMAT "%5.1" ECU_ADDRESS 0x8FF5C2 /end MEASUREMENT
/begin MEASUREMENT MSidCD_swtECUnum_mp "storing EEPROM-info" UBYTE OneToOne 1 100 0.00 255.0 FORMAT "%5.1" ECU_ADDRESS 0x8FF5C3 /end MEASUREMENT
/begin MEASUREMENT MSidCD_swtMAIN "Typ der ECU: Single ECU=0xFF, Master Slave - Master: 0, Master Slave - Slave: 1,2,3 or 4" SBYTE OneToOne 1 100 -128.0 127.0 FORMAT "%5.1" ECU_ADDRESS 0x7F8944 /end MEASUREMENT
/begin MEASUREMENT MSidCD_swtMasterHW_mp "Info SG-Auswahl (plausibilisiert)" SBYTE OneToOne 1 100 -128.0 127.0 FORMAT "%5.1" ECU_ADDRESS 0x8FF5C4 /end MEASUREMENT
/begin MEASUREMENT MSidCD_swtPinDrive_mp "Status SGA-Pin Rohwert" SBYTE OneToOne 1 100 -128.0 127.0 FORMAT "%5.1" ECU_ADDRESS 0x8FF5C5 /end MEASUREMENT
/begin MEASUREMENT MSidCD_swtPinECU_mp "Input HW-Pin" SBYTE OneToOne 1 100 -128.0 127.0 FORMAT "%5.1" ECU_ADDRESS 0x8FF5C6 /end MEASUREMENT
/begin MEASUREMENT NetMng_stCANBus "Status der CAN Controller" ULONG OneToOne 1 100 0.00 4294967295.00 FORMAT "%13.2" ECU_ADDRESS 0x7F91A0 /end MEASUREMENT
/begin MEASUREMENT NetMng_stDfpCanA_mp "" UBYTE OneToOne 1 100 0.00 255.0 FORMAT "%5.1" ECU_ADDRESS 0x8FF5C7 /end MEASUREMENT
/begin MEASUREMENT NetMng_stDfpCanB_mp "" UBYTE OneToOne 1 100 0.00 255.0 FORMAT "%5.1" ECU_ADDRESS 0x8FF5C8 /end MEASUREMENT
/begin MEASUREMENT NetMng_stDfpCanC_mp "" UBYTE OneToOne 1 100 0.00 255.0 FORMAT "%5.1" ECU_ADDRESS 0x8FF5C9 /end MEASUREMENT
/begin MEASUREMENT NetMng_stDfpMaskPtCan_mp "" UBYTE OneToOne 1 100 0.00 255.0 FORMAT "%5.1" ECU_ADDRESS 0x8FF5CA /end MEASUREMENT
/begin MEASUREMENT NetMng_stDisableMsg "disable message by diagnosis" UBYTE OneToOne 1 100 0.00 255.0 FORMAT "%5.1" ECU_ADDRESS 0x7F8945 /end MEASUREMENT
/begin MEASUREMENT NetMng_stFadeOut "Status der CAN Ausblendung" UWORD OneToOne 1 100 0.00 65535.00 FORMAT "%8.2" ECU_ADDRESS 0x7F8F38 /end MEASUREMENT
/begin MEASUREMENT NetMng_stONWM "Aktueller Zustand des OSEK Netzwerkmanagements" UWORD OneToOne 1 100 0.00 65535.00 FORMAT "%8.2" ECU_ADDRESS 0x7F8F3A /end MEASUREMENT
/begin MEASUREMENT NSC_numPrio "Prioritätszahl des Regenerationsanforderungslevel des NOx-Specherkat" UWORD OneToOne 1 100 0.00 65535.00 FORMAT "%8.2" ECU_ADDRESS 0x7F8F36 /end MEASUREMENT
/begin MEASUREMENT NSC_st "von NOx-Speicherkatalysator angeforderter Regenerationsstatus" ULONG OneToOne 1 100 0.00 4294967295.00 FORMAT "%13.2" ECU_ADDRESS 0x7F919C /end MEASUREMENT
/begin MEASUREMENT OPSCD_stInactive_mp "Status Abschaltung (Nachlauf,  ABS-Bremsung, Startfall)" UWORD OneToOne 1 100 0.00 65535.00 FORMAT "%8.2" ECU_ADDRESS 0x8FF5CE /end MEASUREMENT
/begin MEASUREMENT OPSCD_stLampRun_mp "Meßpunkt für Laufzeitmessung" UWORD OneToOne 1 100 0.00 65535.00 FORMAT "%8.2" ECU_ADDRESS 0x8FF5D0 /end MEASUREMENT
/begin MEASUREMENT OPSCD_stpOEL "oil pressure sensor signal" UBYTE OneToOne 1 100 0.00 255.0 FORMAT "%5.1" ECU_ADDRESS 0x7F8947 /end MEASUREMENT
/begin MEASUREMENT OPSCD_stSigOut "Ausgangssignal Öldruckschalter" UBYTE OneToOne 1 100 0.00 255.0 FORMAT "%5.1" ECU_ADDRESS 0x7F8946 /end MEASUREMENT
/begin MEASUREMENT OPSCD_uRaw_POEL_mp "Voltage raw value of the oil pressure sensor" SWORD Volt 1 100 -160156.4 160151.5 FORMAT "%8.1" ECU_ADDRESS 0x8FF5CC /end MEASUREMENT
/begin FUNCTION ligov_setpoint ""
 /begin DEF_CHARACTERISTIC LIGov_dnLimHighTrm_C LIGov_dnLimLowTrm_C LIGov_nDeltaSec_C LIGov_nDiffDelta_C LIGov_nHDC_C LIGov_nLimHighOfs_C LIGov_nLimHighTrmAct_C LIGov_nRmpBaseDwn_C LIGov_nRmpBaseUp_C LIGov_nRmpCoEngDwn_C LIGov_nRmpCoEngUp_C LIGov_nRmpCutOutUp_C LIGov_nRmpCutOutDwn_C LIGov_nRmpGearbxDwn_C LIGov_nRmpGearbxUp_C LIGov_nRmpHDCDwn_C LIGov_nRmpHDCUp_C LIGov_nRmpPwrMngDwn_C LIGov_nRmpPwrMngUp_C LIGov_nRmpSecDelta_C LIGov_nRmpSurgeDwn_C LIGov_nRmpSurgeUp_C LIGov_nSetpointDia_C LIGov_nSetpointDriveAway_C LIGov_nSetpointInit2_MAP LIGov_nSetpointInit_MAP LIGov_nSetpointTrmLim_C LIGov_nSetpointTrm_C LIGov_nSetPointWarm_C LIGov_stActiveHDC_C LIGov_stReleaseHDC_C LIGov_swtGear_C LIGov_tiTW_C LIGov_trqInitI_MAP /end DEF_CHARACTERISTIC
 /begin IN_MEASUREMENT APSCD_pVal CTSCD_tClnt /end IN_MEASUREMENT
/end FUNCTION
/begin FUNCTION ligov_setpoint_msg ""
 /begin OUT_MEASUREMENT LIGov_nLimHigh LIGov_nMaxTrq LIGov_nSetLocal2 LIGov_nSetpoint LIGov_nSetpointTrm LIGov_stActiveHDC LIGov_stSetPoint LIGov_stSetpointTrmActive LIGov_trqInitI /end OUT_MEASUREMENT
/end FUNCTION
/begin FUNCTION ligov_setpoint_uic "" /begin DEF_CHARACTERISTIC LIGov_nSetpoint_Vector LIGov_nSetpoint_Channel /end DEF_CHARACTERISTIC
 /begin OUT_MEASUREMENT LIGov_nDiffDelta_mp LIGov_nHDC_mp LIGov_nSetCoEngOld_mp LIGov_nSetCoEng_mp LIGov_nSetGearbxOld_mp LIGov_nSetGearbx_mp LIGov_nSetHDCOld_mp LIGov_nSetHDC_mp LIGov_nSetLocal0_mp LIGov_nSetLocalRampOld_mp LIGov_nSetLocalRamp_mp LIGov_nSetpointOld_mp LIGov_nSetpointTemp_mp LIGov_nSetpointTrm_mp LIGov_nSetPwrMngOld_mp LIGov_nSetPwrMng_mp LIGov_nSetSec1_mp LIGov_nSetSec2_mp LIGov_nSetSec4_mp LIGov_nSetSurgeOld_mp LIGov_nSetSurge_mp LIGov_stSetpointTrmAlw_mp /end OUT_MEASUREMENT
/end FUNCTION
/begin FUNCTION ligov_tsync_ps_conv ""
 /begin DEF_CHARACTERISTIC LIGov_tiCldCltchDT1_C LIGov_CldCltchDKd_C LIGov_tiWrmCltchDT1_C LIGov_WrmCltchDKd_C /end DEF_CHARACTERISTIC
/end FUNCTION
/begin FUNCTION ligov_uic "" /begin DEF_CHARACTERISTIC LIGov_trq_Vector LIGov_trq_Channel /end DEF_CHARACTERISTIC
 /begin OUT_MEASUREMENT LIGov_CurrDKd_mp LIGov_CurrDT1_mp LIGov_CurrFlt1T1_mp LIGov_CurrFlt2T1_mp LIGov_CurrIKiNeg_mp LIGov_CurrIKiPos_mp LIGov_CurrIKi_mp LIGov_CurrIWinNeg_mp LIGov_CurrIWinPos_mp LIGov_CurrPKpNeg_mp LIGov_CurrPKpPos_mp LIGov_CurrPKp_mp LIGov_CurrPWinNeg_mp LIGov_CurrPWinPos_mp LIGov_nAvrg_mp LIGov_nDiffFlt1_mp LIGov_nDiffFlt2_mp LIGov_nDiff_mp LIGov_rIpoConvPS_mp LIGov_stSetTrqAlw_mp LIGov_tiPT1_mp LIGov_trqDRaw_mp LIGov_trqD_mp LIGov_trqLISetRdDIAG_mp LIGov_trqMax_mp LIGov_trqPreInitI_mp LIGov_trqSet_mp LIGov_trq_mp /end OUT_MEASUREMENT
/end FUNCTION
/begin FUNCTION lpacd ""
 /begin DEF_CHARACTERISTIC LPACD_ctPwrStgOnMax_C LPACD_DebExcTempDef_C LPACD_DebExcTempOk_C LPACD_DebNoLoadDef_C LPACD_DebNoLoadOk_C LPACD_DebShortCircBatDef_C LPACD_DebShortCircBatOk_C LPACD_DebShortCircGndDef_C LPACD_DebShortCircGndOk_C LPACD_numDia_C LPACD_numPwmOut_C LPACD_stInvOut_C LPACD_tiPer_C LPACD_rCnv_CUR LPACD_rOutMax_C LPACD_rOutMin_C LPACD_stPwrStgActv_C LPACD_stPwrStgDia_C LPACD_stSPICtl_C LPACD_swt_C LPACD_tiBtwTst_C LPACD_tiPwrStgOn_C /end DEF_CHARACTERISTIC
 /begin IN_MEASUREMENT BPA_rLPACD /end IN_MEASUREMENT
/end FUNCTION
/begin FUNCTION lpacd_msg "" /begin OUT_MEASUREMENT LPACD_rOut /end OUT_MEASUREMENT /end FUNCTION
/begin FUNCTION lpacd_uic "" /begin OUT_MEASUREMENT LPACD_rCnv_mp /end OUT_MEASUREMENT /end FUNCTION
/begin FUNCTION lsucd_adaption "Adaption des Lambdasondensignals"
 /begin DEF_CHARACTERISTIC LSUCD_tiAdptFltInit_C LSUCD_tiAdptFlt_C LSUCD_d2rInit_C LSUCD_dmAirIKi_C LSUCD_dmAirIKiPos_C LSUCD_dmAirIKiNeg_C LSUCD_dmAirIWinPos_C LSUCD_dmAirIWinNeg_C LSUCD_EvalMaxVal_C LSUCD_EvalMinVal_C LSUCD_tiEvalFltInit_C LSUCD_tiEvalFlt_C LSUCD_mAirAdptActv_C LSUCD_swtAdptVal_C LSUCD_swtAdptType_C LSUCD_tAirAdptActv_C /end DEF_CHARACTERISTIC
 /begin OUT_MEASUREMENT LSUCD_d2rO2Eval_mp LSUCD_d2rO2_mp LSUCD_drO2Flt_mp LSUCD_facO2Corr_mp LSUCD_mAirAftOvrRun_mp LSUCD_stAdptActv_mp LSUCD_stChange_mp LSUCD_stHold_mp /end OUT_MEASUREMENT
/end FUNCTION
/begin FUNCTION lsucd_adaption_msg "" /begin OUT_MEASUREMENT LSUCD_drO2Adpt LSUCD_rO2Adpt LSUCD_stAdpt LSUCD_swtAdpt /end OUT_MEASUREMENT /end FUNCTION
/begin FUNCTION lsucd_adaption_uic "" /end FUNCTION
/begin FUNCTION lsucd_heater "Heizung der Lambdasonde"
 /begin DEF_CHARACTERISTIC LSUCD_stHtInvOut_C LSUCD_tiHtPer_C LSUCD_tiDebHeaterDef_C LSUCD_tiDebHeaterOk_C LSUCD_uBattNominal_C LSUCD_uBattMaxHigh_C LSUCD_uBattMaxLow_C LSUCD_stPwrStgDia_C LSUCD_dcycTstPowerStage_C LSUCD_tiDebReset_C LSUCD_stHtDis_C LSUCD_stHeaterPwrStgSel_C LSUCD_tiHeaterBattDefDelay_C /end DEF_CHARACTERISTIC
 /begin OUT_MEASUREMENT LSUCD_facUCor_mp LSUCD_rOutHWE_mp /end OUT_MEASUREMENT
/end FUNCTION
/begin FUNCTION lsucd_heater_msg "" /begin OUT_MEASUREMENT LSUCD_dcycHtCor LSUCD_dcycLimActHt LSUCD_stHtDis /end OUT_MEASUREMENT /end FUNCTION
/begin FUNCTION lsucd_iprefctl "Controlling of the reference pump current"
 /begin DEF_CHARACTERISTIC LSUCD_stRefPumpDis_C LSUCD_tiRefPumpHigh_C LSUCD_tiRefTransLow_C LSUCD_tiRgnEna_C LSUCD_tiRgnIpSettle_C LSUCD_swtRgnChngCirct_C /end DEF_CHARACTERISTIC
 /begin OUT_MEASUREMENT LSUCD_stRefCurTrans_mp /end OUT_MEASUREMENT
/end FUNCTION
/begin FUNCTION lsucd_iprefctl_msg ""
 /begin OUT_MEASUREMENT LSUCD_stIpHighCurEna LSUCD_stIpNormCurEna LSUCD_stPumpDemRef LSUCD_stRefPump LSUCD_stRgnEna LSUCD_stRgnIpSettle /end OUT_MEASUREMENT
/end FUNCTION
/begin FUNCTION lsucd_iprefctl_uic "" /end FUNCTION
/begin FUNCTION lsucd_o2raw "Sauerstoffrohwert der Lambdasonde"
 /begin DEF_CHARACTERISTIC LSUCD_DebO2ClbDef_C LSUCD_DebO2ClbOk_C LSUCD_rO2_CUR LSUCD_tiO2ClbPT1_C LSUCD_tiO2PT1_C LSUCD_tiDebO2MaxTstDef_C LSUCD_tiDebO2MaxTstOk_C LSUCD_tiDebO2MinDef_C LSUCD_tiDebO2MinOk_C LSUCD_tiDelO2Clb_C LSUCD_tiO2Clb_C LSUCD_tiDelO2Val_C LSUCD_uO2Ref_C LSUCD_uO2ClbMax_C LSUCD_uO2ClbMin_C LSUCD_swtO2Filter_C LSUCD_uO2MaxNorm_C LSUCD_uO2MaxTst_C LSUCD_uO2Min_C LSUCD_swtSensDrftComp_C /end DEF_CHARACTERISTIC
 /begin OUT_MEASUREMENT LSUCD_stO2Clb_mp LSUCD_stSRCState_mp LSUCD_uO2OfsCor_mp LSUCD_uO2Raw_mp /end OUT_MEASUREMENT
/end FUNCTION
/begin FUNCTION lsucd_o2raw_msg ""
 /begin OUT_MEASUREMENT LSUCD_rO2Act LSUCD_rO2Raw LSUCD_stO2Act LSUCD_stO2ClbEna LSUCD_stO2IntValid LSUCD_stO2SPICalDem LSUCD_stO2SPISens LSUCD_uO2Clb LSUCD_uO2Raw LSU_swtEna /end OUT_MEASUREMENT
/end FUNCTION
/begin FUNCTION lsucd_o2raw_msg_var "" /begin OUT_MEASUREMENT LSUCD_stO2Valid /end OUT_MEASUREMENT /end FUNCTION
/begin FUNCTION lsucd_prescomp "Druckkompensation der mit Lambdasonde gemessenen Sauerstoffkonzentration"
 /begin DEF_CHARACTERISTIC LSUCD_facPresCompLean_CUR LSUCD_facPresCompRich_CUR LSUCD_rO2SwtPresComp_C /end DEF_CHARACTERISTIC
 /begin OUT_MEASUREMENT LSUCD_facPresComp_mp LSUCD_pExhGasLstVal_mp /end OUT_MEASUREMENT
/end FUNCTION
/begin FUNCTION lsucd_prescomp_msg "" /begin OUT_MEASUREMENT LSUCD_rO2PresComp /end OUT_MEASUREMENT /end FUNCTION
/begin FUNCTION lsucd_prescomp_uic "" /end FUNCTION
/begin FUNCTION lsucd_pumpctl "Pump current control" /begin DEF_CHARACTERISTIC LSUCD_stPumpCtlDis_C /end DEF_CHARACTERISTIC /end FUNCTION
/begin FUNCTION lsucd_pumpctl_msg "" /begin OUT_MEASUREMENT LSUCD_stPumpCtl /end OUT_MEASUREMENT /end FUNCTION
/begin FUNCTION lsucd_pumpctl_uic "" /end FUNCTION
/begin FUNCTION lsucd_ri "Ri der Lambdasonde"
 /begin DEF_CHARACTERISTIC LSUCD_DebRiClbDef_C LSUCD_DebRiClbOk_C LSUCD_tiRiClbPT1_C LSUCD_tiRiPT1_C LSUCD_tRi_CUR LSUCD_tiDelRiClb_C LSUCD_tiRiClb_C LSUCD_tiDelRiVal_C LSUCD_tiRiFltSettle_C LSUCD_resRiMaxJmp_C LSUCD_uRiOfs_C LSUCD_facUToRi_C LSUCD_resRiClbRef_C LSUCD_resRiClbMax_C LSUCD_resRiClbMin_C LSUCD_numRiDistSupp_C /end DEF_CHARACTERISTIC
 /begin OUT_MEASUREMENT LSUCD_resRiChange_mp LSUCD_resRiClbRaw_mp LSUCD_resRi_mp LSUCD_stRiFltAct_mp LSUCD_stRiLimSlp_mp /end OUT_MEASUREMENT
/end FUNCTION
/begin FUNCTION lsucd_ri_msg ""
 /begin OUT_MEASUREMENT LSUCD_resRi LSUCD_resRiClb LSUCD_resRiRaw LSUCD_stRiClb LSUCD_stRiClbEna LSUCD_stRiSPICalDem LSUCD_stRiValid LSUCD_tRi LSUCD_uRiRaw /end OUT_MEASUREMENT
/end FUNCTION
/begin FUNCTION lsucd_spictl "SPI Chip control"
 /begin DEF_CHARACTERISTIC LSUCD_stCJ125CS_C LSUCD_stRefCurHigh_C LSUCD_stRefCurNormal_C /end DEF_CHARACTERISTIC
/end FUNCTION
/begin FUNCTION lsucd_spictl_msg "" /begin OUT_MEASUREMENT LSUCD_stCircModeNew LSUCD_stSPIDiaInfo LSUCD_stSPIInitVal /end OUT_MEASUREMENT /end FUNCTION
/begin FUNCTION lsucd_spictl_uic "" /end FUNCTION
/begin FUNCTION lsucd_wiredia "Überwachung und Fehlererkennung von Kabel"
 /begin DEF_CHARACTERISTIC LSUCD_dcycMinGrad_C LSUCD_DebHtCoupDef_C LSUCD_DebHtCoupOk_C LSUCD_DebWireIpDef_C LSUCD_DebWireIpOk_C LSUCD_dNumHtCoup_C LSUCD_resRiMaxGrad_C LSUCD_rO2IsolChkMax_C LSUCD_rO2IsolChkMin_C LSUCD_stWireDiaActv_C LSUCD_tiHtCoupChk_C LSUCD_tiHtCoupPer_C LSUCD_tiIsolChkErr_C LSUCD_tiIsolChkPer_C LSUCD_tiIsolChkPump_C LSUCD_tiHtCoupFlt_C LSUCD_uO2MaxGrad_C LSUCD_uO2MaxRippel_C /end DEF_CHARACTERISTIC
 /begin OUT_MEASUREMENT LSUCD_dcycRippel_mp LSUCD_resRiRippel_mp LSUCD_stRecValEval_mp LSUCD_stTstTrigger_mp LSUCD_stWireDiaChk_mp LSUCD_stWireDiaErr_mp LSUCD_uO2FltRippel_mp LSUCD_uO2Grad_mp LSUCD_uO2Rippel_mp /end OUT_MEASUREMENT
/end FUNCTION
/begin FUNCTION lsucd_wiredia_100ms ""
 /begin DEF_CHARACTERISTIC LSUCD_tiOpnLdTstActv_C LSUCD_tiRiMeasDisa_C LSUCD_uO2OpnLdNernstMax_C LSUCD_uO2OpnLdNernstMin_C LSUCD_uO2OpnLdVirtGndMax_C LSUCD_uO2OpnLdVirtGndMin_C LSUCD_uRiOpnLdTstMax_C LSUCD_tiDebNoLdErrIPDef_C LSUCD_tiDebNoLdErrIPOk_C LSUCD_DebOpnLdVirtGndDef_C LSUCD_DebOpnLdVirtGndOk_C LSUCD_DebOpnLdNernstDef_C LSUCD_DebOpnLdNernstOk_C LSUCD_tiDebLowBattErrDef_C LSUCD_tiDebLowBattErrOk_C LSUCD_tiDebCircNernstDef_C LSUCD_tiDebCircNernstOk_C LSUCD_tiDebCircPumpDef_C LSUCD_tiDebCircPumpOk_C LSUCD_tiDebCircVirtGndDef_C LSUCD_tiDebCircVirtGndOk_C /end DEF_CHARACTERISTIC
/end FUNCTION
/begin FUNCTION lsucd_wiredia_100ms_msg "" /begin OUT_MEASUREMENT LSUCD_stOpnErrIP LSUCD_stOpnLdTstActv /end OUT_MEASUREMENT /end FUNCTION
/begin FUNCTION lsucd_wiredia_msg ""
 /begin OUT_MEASUREMENT LSUCD_ctHtCoup LSUCD_dcycHtCoupStep1 LSUCD_dcycHtCoupStep2 LSUCD_dcycHtCoupStep3 LSUCD_dHtCoupStep LSUCD_dHtCoupStepLast LSUCD_resRiHtCoupStep1 LSUCD_resRiHtCoupStep2 LSUCD_resRiHtCoupStep3 LSUCD_stDiaIAEna LSUCD_stHtCoupActv LSUCD_stInitClb LSUCD_stIsolChkActv LSUCD_stIsolChkO2Last LSUCD_stIsolChkStrt LSUCD_stPumpEna LSUCD_uO2HtCoupStep1 LSUCD_uO2HtCoupStep2 LSUCD_uO2HtCoupStep3 /end OUT_MEASUREMENT
/end FUNCTION
/begin FUNCTION lsucd_wiredia_uic "" /end FUNCTION
/begin FUNCTION lsuctl "Regelung zur Lambdaerfassung"
 /begin DEF_CHARACTERISTIC LSUCtl_tUpLim_C LSUCtl_tLowLim_C LSUCtl_tRiSetPoint_C LSUCtl_tHtCtlEna_C LSUCtl_nHtCtlEna_C LSUCtl_dcycHtMin_C LSUCtl_tExcMax_C LSUCtl_tExcMin_C LSUCtl_tiDelIniVal_C LSUCtl_dcycRmpUp_C LSUCtl_dcycRmpDwn_C LSUCtl_dcycStrt_CUR LSUCtl_tiDebRiExcMaxDef_C LSUCtl_tiDebRiExcMaxOk_C LSUCtl_tiDebRiExcMinDef_C LSUCtl_tiDebRiExcMinOk_C LSUCtl_tiSens1HtDT1_C LSUCtl_Sens1HtDT1Kd_C LSUCtl_Sens1HtIKi_C LSUCtl_Sens1HtIKiPos_C LSUCtl_Sens1HtIKiNeg_C LSUCtl_tSens1HtIWinPos_C LSUCtl_tSens1HtIWinNeg_C LSUCtl_Sens1HtPKp_C LSUCtl_Sens1HtPKpPos_C LSUCtl_Sens1HtPKpNeg_C LSUCtl_tSens1HtPWinPos_C LSUCtl_tSens1HtPWinNeg_C LSUCtl_tiSens2HtDT1_C LSUCtl_Sens2HtDT1Kd_C LSUCtl_Sens2HtIKi_C LSUCtl_Sens2HtIKiPos_C LSUCtl_Sens2HtIKiNeg_C LSUCtl_tSens2HtIWinPos_C LSUCtl_tSens2HtIWinNeg_C LSUCtl_Sens2HtPKp_C LSUCtl_Sens2HtPKpPos_C LSUCtl_Sens2HtPKpNeg_C LSUCtl_tSens2HtPWinPos_C LSUCtl_tSens2HtPWinNeg_C /end DEF_CHARACTERISTIC
 /begin OUT_MEASUREMENT LSUCtl_dcycDT1_mp LSUCtl_dcycPI_mp LSUCtl_stRmp_mp LSUCtl_tAirStrt_mp LSUCtl_tDvt_mp /end OUT_MEASUREMENT
/end FUNCTION
/begin FUNCTION lsuctl_msg ""
 /begin OUT_MEASUREMENT LSUCtl_dcycHt LSUCtl_dcycHtIniRamp LSUCtl_dcycHtStrt LSUCtl_stHtCtl LSUCtl_stHtDisable LSUCtl_stSCUNEna /end OUT_MEASUREMENT
/end FUNCTION
/begin FUNCTION lsu_clbsched "Lambda-Sensor Universal-Kalibrierungs-Scheduler"
 /begin DEF_CHARACTERISTIC LSU_ctRgnEna_C LSU_mAirMaxClb1_C LSU_mAirMaxClb2_C LSU_mAirMinClb1_C LSU_mAirMinClb2_C LSU_nMaxClb1_C LSU_nMaxClb2_C LSU_nMinClb1_C LSU_nMinClb2_C LSU_qMaxClb1_C LSU_qMaxClb2_C LSU_qMinClb1_C LSU_qMinClb2_C LSU_stChpClbActv_C LSU_stEGTClbOff_C LSU_ti1stClb_C LSU_tiPerClb_C LSU_uMinClb_C /end DEF_CHARACTERISTIC
 /begin OUT_MEASUREMENT LSU_stClbTrg_mp LSU_stNotOpPoint1_mp LSU_stNotOpPoint2_mp /end OUT_MEASUREMENT
/end FUNCTION
/begin FUNCTION lsu_clbsched_msg "" /begin OUT_MEASUREMENT LSU_stClbDisable LSU_stStrtClb LSU_stTmrClbPerRun /end OUT_MEASUREMENT /end FUNCTION
/begin FUNCTION lsu_conf ""
 /begin DEF_CHARACTERISTIC LSUCD_stCJChpSel_C LSUCD_stRgnEna_C LSU_dcycMax_C LSU_tiBattHighDebNeg_C LSU_tiBattHighDebPos_C LSU_tiOvrRunDebNeg_C LSU_tiOvrRunDebPos_C LSU_swtVal_C LSU_swtType_C LSU_uBattMin_C /end DEF_CHARACTERISTIC
/end FUNCTION
/begin FUNCTION lsu_lmbdcalc "Berechnung Lambda und 1/Lambda" /begin DEF_CHARACTERISTIC LSU_rLmbdRec_CUR /end DEF_CHARACTERISTIC /begin OUT_MEASUREMENT LSU_rO2AdptLastLSU_mp /end OUT_MEASUREMENT /end FUNCTION
/begin FUNCTION lsu_lmbdcalc_msg "" /end FUNCTION
/begin FUNCTION lsu_lmbdcalc_msg_var "" /begin OUT_MEASUREMENT LSU_rLmbd LSU_rLmbdRec LSU_rO2Adpt /end OUT_MEASUREMENT /end FUNCTION
/begin FUNCTION lsu_lmbdcalc_uic "" /end FUNCTION
/begin FUNCTION lsu_mon "Lambda-Sensor Universal-Diagnosefunktion"
 /begin DEF_CHARACTERISTIC LSU_DebDynErrDef_C LSU_DebDynErrOk_C LSU_DebO2ConcHighDef_C LSU_DebO2ConcHighOk_C LSU_DebO2ConcLowDef_C LSU_DebO2ConcLowOk_C LSU_mAirMax_C LSU_mAirMin_C LSU_nMax_C LSU_nMinChkDyn_C LSU_nMin_C LSU_qDiffMax_C LSU_qMax_C LSU_qMin_C LSU_qThresChkDyn_C LSU_qThresOvrRun_C LSU_rO2ConstVal_C LSU_tiDvtFlt_C LSU_rO2Lmbd1Thres_C LSU_rO2MaxVar_C LSU_rO2Min_C LSU_rO2NegDvt_C LSU_rO2PosDvt_C LSU_stMonActv_C LSU_stMonMsk_C LSU_stSelPlausChkSig_C LSU_tiDvt1Flt_C LSU_tiO2CalcFlt_C LSU_tiO2Eval_C LSU_tiSwitch_CA LSU_tiWait1_CA LSU_tiWait2_CA LSU_tiWait3_CA LSU_volMinFl_C /end DEF_CHARACTERISTIC
 /begin OUT_MEASUREMENT LSU_rO2Stat_mp LSU_rO2Thres1_mp LSU_rO2Thres2_mp LSU_stChkDyn_mp LSU_stO2Chk_mp LSU_stO2Err_mp LSU_stPlausChkCon_mp LSU_stPlausChk_mp LSU_tiState1_mp /end OUT_MEASUREMENT
/end FUNCTION
/begin FUNCTION lsu_mon_msg ""
 /begin OUT_MEASUREMENT LSU_rO2ActVal LSU_rO2DiffCmpChk LSU_rO2Lmbd1Thres LSU_rO2MaxDiff LSU_rO2MaxVal LSU_rO2MinVal LSU_rO2RawFlt LSU_stConstPOp LSU_tiState2 LSU_tiState3 LSU_tiSwitch LSU_tiWait3 /end OUT_MEASUREMENT
/end FUNCTION
/begin FUNCTION lsu_mon_uic ""
 /begin OUT_MEASUREMENT LSU_bpPlausSetPoint_mp LSU_qStrt_mp LSU_rO2Calc_mp LSU_rO2DvtNeg_mp LSU_rO2DvtPos_mp /end OUT_MEASUREMENT
/end FUNCTION
/begin FUNCTION lubcd_co ""
 /begin DEF_CHARACTERISTIC LubCD_ctInitDly_C LubCD_ctTogErr_C LubCD_numDioIn_C LubCD_stLoadPwmInInv_C LubCD_swtTogVer_C Lub_tiDebNplDef_C Lub_tiDebNplOk_C Lub_tiDebSigDef_C Lub_tiDebSigOk_C /end DEF_CHARACTERISTIC
/end FUNCTION
/begin FUNCTION lubcd_co_msg ""
 /begin OUT_MEASUREMENT ctHigh ctLow LubCD_ctHigh LubCD_ctLow LubCD_ctTog LubCD_dioIn LubCD_st LubCD_stOelTog LubCD_stTOel LubCD_stTog LubCD_titk LubCD_titr LubCD_titv LubCD_Tog_icnt LubCD_Tog_uplcnt /end OUT_MEASUREMENT
/end FUNCTION
/begin FUNCTION lubcd_co_uic "" /begin OUT_MEASUREMENT LubCD_stErr_mp LubCD_tiHigh_mp LubCD_tiLow_mp /end OUT_MEASUREMENT /end FUNCTION
/begin FUNCTION mcy315_conf ""
 /begin DEF_CHARACTERISTIC CrSCD_numGlFilter_C CrSCD_numThresCtlHigh_C CrSCD_numThresCtlLow_C /end DEF_CHARACTERISTIC
/end FUNCTION
/begin FUNCTION mcy33x_conf ""
 /begin DEF_CHARACTERISTIC InjVlv_iLvlHi1_C InjVlv_iLvlHi2_C InjVlv_iLvlHi3_C InjVlv_iLvlLo1_C InjVlv_iLvlLo2_C InjVlv_iLvlLo3_C InjVlv_iThresMax_C InjVlv_stInj_C InjVlv_stRatRchgOff_C InjVlv_stRegCfg_C InjVlv_stRegDcc_C InjVlv_stRegDmsk_C InjVlv_stRegMode_C InjVlv_stTiBstErrMax_C InjVlv_stTiBstErrMin_C InjVlv_stTiCY330Del_C InjVlv_stTiDelAftFastIDec_C InjVlv_stTiDelAftRchg_C InjVlv_stTiDelBefLSMode_C InjVlv_stTiFastIDecErrMax_C InjVlv_stTiInjMax_C InjVlv_stTiMaxRchg_C InjVlv_uCMax_C InjVlv_uCMin_C InjVlv_uCSetPoint_C InjVlv_uCThresBstStop_C /end DEF_CHARACTERISTIC
/end FUNCTION
/begin FUNCTION memmon "Überwachung des Speichers"
 /begin DEF_CHARACTERISTIC MemMon_numErrChkRam_C MemMon_numErrChkRom_C MemMon_tiHealChkRam_C MemMon_tiHealChkRom_C /end DEF_CHARACTERISTIC
/end FUNCTION
/begin FUNCTION memmon_msg ""
 /begin OUT_MEASUREMENT MemMon_ctErrChkRam MemMon_ctErrChkRom MemMon_ctHealChkRam MemMon_ctHealChkRom MemMon_st /end OUT_MEASUREMENT
/end FUNCTION
/begin FUNCTION meuncd_co "Zumeßeinheit"
 /begin DEF_CHARACTERISTIC MeUnCD_uSRCMin_C MeUnCD_uSRCMax_C MeUnCD_iLin_CUR MeUnCD_ctPwrStgOnMax_C MeUnCD_dcycMax_C MeUnCD_dcycMin_C MeUnCD_dcycSetValLin_CUR MeUnCD_dcycTst_C MeUnCD_DebExcTempDef_C MeUnCD_DebExcTempOk_C MeUnCD_DebNoLoadDef_C MeUnCD_DebNoLoadOk_C MeUnCD_DebShortCircBatDef_C MeUnCD_DebShortCircBatOk_C MeUnCD_DebShortCircGndDef_C MeUnCD_DebShortCircGndOk_C MeUnCD_DebSRCHighDef_C MeUnCD_DebSRCHighOk_C MeUnCD_DebSRCLowDef_C MeUnCD_DebSRCLowOk_C MeUnCD_facIGovInit_CUR MeUnCD_facIGovMax_C MeUnCD_facIGovMin_C MeUnCD_tiFlt1PT1_C MeUnCD_tiFlt2PT1_C MeUnCD_tiIGovDT1_C MeUnCD_IGovDKd_C MeUnCD_IGovIKi_C MeUnCD_IGovIKiPos_C MeUnCD_IGovIKiNeg_C MeUnCD_iIGovIWinPos_C MeUnCD_iIGovIWinNeg_C MeUnCD_tiFltPT1Init_C MeUnCD_nDiffMax_C MeUnCD_numAdc_C MeUnCD_numDia1_C MeUnCD_numDia2_C MeUnCD_numPwmOut_C MeUnCD_resCoil_C MeUnCD_stInvOut_C MeUnCD_stPwrStgDia_C MeUnCD_stSPICtl_C MeUnCD_swt_C MeUnCD_tiBtwTst_C MeUnCD_tiIGovInit_C MeUnCD_tiPer_CUR MeUnCD_tiPwrStgOn_C MeUnCD_tiDebSigDefSigTst_C MeUnCD_tiDebSigOkSigTst_C /end DEF_CHARACTERISTIC
 /begin IN_MEASUREMENT FlSys_t MeUnCD_dcycSetVal_mp MeUnCD_nDiffRef_mp MeUnCD_uRawVal_mp /end IN_MEASUREMENT
/end FUNCTION
/begin FUNCTION meuncd_co_msg "" /begin OUT_MEASUREMENT MeUnCD_iGovActVal MeUnCD_iSetFlt /end OUT_MEASUREMENT /end FUNCTION
/begin FUNCTION meuncd_co_uic ""
 /begin OUT_MEASUREMENT MeUnCD_dcycDT1_mp MeUnCD_dcycOut_mp MeUnCD_dcycSetValLin_mp MeUnCD_dcycSetVal_mp MeUnCD_facIGov_mp MeUnCD_iActFlt_mp MeUnCD_iDvt_mp MeUnCD_nDiffRef_mp MeUnCD_tiPer_mp MeUnCD_uRawVal_mp /end OUT_MEASUREMENT
/end FUNCTION
/begin FUNCTION meun_setcurr "Berechnung elektrischer Sollstrom für die Zumesseinheit"
 /begin DEF_CHARACTERISTIC MeUn_iCnvFlowRate_CUR MeUn_iSetMin_C MeUn_pActrPrt_C MeUn_pFlowOfFl_C /end DEF_CHARACTERISTIC
 /begin IN_MEASUREMENT Rail_dvolMeUnSet /end IN_MEASUREMENT
/end FUNCTION
/begin FUNCTION meun_setcurr_uic "" /begin DEF_CHARACTERISTIC MeUn_iSet_Vector MeUn_iSet_Channel /end DEF_CHARACTERISTIC /begin OUT_MEASUREMENT MeUn_iSet_mp MeUn_stActrCtl_mp /end OUT_MEASUREMENT /end FUNCTION
/begin FUNCTION models "" /end FUNCTION
/begin FUNCTION mrlycd "Hauptrelais Komponententreiber"
 /begin DEF_CHARACTERISTIC MRlyCD_ctTooEarlyThres_C MRlyCD_numDioOutMnRly_C MRlyCD_numDioOutPSOFF_C MRlyCD_stInvOut_C MRlyCD_tiNotOpen_C /end DEF_CHARACTERISTIC
/end FUNCTION
/begin FUNCTION mrlycd_msg "" /begin OUT_MEASUREMENT MRlyCD_stMon MRlyCD_stPrevOpening /end OUT_MEASUREMENT /end FUNCTION
/begin FUNCTION mrlycd_uic "" /begin OUT_MEASUREMENT MRlyCD_ctTooEarlyInit_mp MRlyCD_ctTooEarly_mp /end OUT_MEASUREMENT /end FUNCTION
/begin FUNCTION msid "Master-Slave-Erkennung (Steuergeräteauswahl)"
 /begin DEF_CHARACTERISTIC MSidCD_Comm_DebNplDef_C MSidCD_Comm_DebNplOk_C MSidCD_numECUS_C MSidCD_Pin_DebSigDef_C MSidCD_Pin_DebSigOk_C MSidCD_Select_DebNplDef_C MSidCD_Select_DebNplOk_C MSidCD_Sel_INI_DebNplDef_C MSidCD_Sel_INI_DebNplOk_C MSidCD_Sel_INI_DebSigDef_C MSidCD_Sel_INI_DebSigOk_C MSidCD_stCANprivErrMsk_C MSidCD_stErrInjOFF_C MSidCD_stInv_C MSidCD_swtCanDeb_C MSidCD_swtLearn_C MSidCD_swtMAIN_C MSidCD_tiCanDeb_C /end DEF_CHARACTERISTIC
/end FUNCTION
/begin FUNCTION msid_msg "" /begin OUT_MEASUREMENT MSidCD_numECUS MSidCD_stInjOffECU MSidCD_swtMAIN /end OUT_MEASUREMENT /end FUNCTION
/begin FUNCTION msid_uic ""
 /begin OUT_MEASUREMENT MSidCD_stCANpriv_mp MSidCD_stECUCANpriv_mp MSidCD_stECUCANPtHelp_mp MSidCD_stECULearned_mp MSidCD_stECULTmp_mp MSidCD_stECUPlaus_mp MSidCD_stECUSelect_mp MSidCD_stECUStatus_mp MSidCD_stErrEcuPinComm_mp MSidCD_stErrECUSelect_mp MSidCD_stSetEEPROM_mp MSidCD_swtECUinfo_mp MSidCD_swtECUnum_mp MSidCD_swtMasterHW_mp MSidCD_swtPinDrive_mp MSidCD_swtPinECU_mp /end OUT_MEASUREMENT
/end FUNCTION
/begin FUNCTION netmng "Netzwerk Manager" /begin DEF_CHARACTERISTIC NetMng_swtONWM_C /end DEF_CHARACTERISTIC /end FUNCTION
/begin FUNCTION netmng_errhndl "Fehlerhandler"
 /begin DEF_CHARACTERISTIC NetMng_CANFadeOutMaskA_C NetMng_CANFadeOutMaskB_C NetMng_CANFadeOutMaskC_C NetMng_ctBusOffRetriesA_C NetMng_ctBusOffRetriesB_C NetMng_ctBusOffRetriesC_C NetMng_ctInitRetryCanA_C NetMng_ctInitRetryCanB_C NetMng_ctInitRetryCanC_C NetMng_tiDebPosBusMonCanA_C NetMng_tiDebNegBusMonCanA_C NetMng_tiDebPosBusMonCanB_C NetMng_tiDebNegBusMonCanB_C NetMng_tiDebPosBusMonCanC_C NetMng_tiDebNegBusMonCanC_C NetMng_tiDebPosBusOffCanA_C NetMng_tiDebNegBusOffCanA_C NetMng_tiDebPosBusOffCanB_C NetMng_tiDebNegBusOffCanB_C NetMng_tiDebPosBusOffCanC_C NetMng_tiDebNegBusOffCanC_C NetMng_tiDebPosErrCanA_C NetMng_tiDebNegErrCanA_C NetMng_tiDebPosErrCanB_C NetMng_tiDebNegErrCanB_C NetMng_tiDebPosErrCanC_C NetMng_tiDebNegErrCanC_C NetMng_tiDebPosMonCanA_C NetMng_tiDebNegMonCanA_C NetMng_tiDebPosMonCanB_C NetMng_tiDebNegMonCanB_C NetMng_tiDebPosMonCanC_C NetMng_tiDebNegMonCanC_C NetMng_FadeOutMaskA_C NetMng_FadeOutMaskB_C NetMng_FadeOutMaskC_C NetMng_SplyVltgHysXLow_C NetMng_SplyVltgHysXHigh_C NetMng_SplyVltgHysYLow_C NetMng_SplyVltgHysYHigh_C NetMng_tiFadeoutLowBat_C NetMng_tiFadeoutMin_C NetMng_tiRecoverA_C NetMng_tiRecoverB_C NetMng_tiRecoverC_C NetMng_tiTimeoutDNMT_C /end DEF_CHARACTERISTIC
/end FUNCTION
/begin FUNCTION netmng_msg ""
 /begin OUT_MEASUREMENT NetMng_stCANBus NetMng_stDisableMsg NetMng_stFadeOut NetMng_stONWM /end OUT_MEASUREMENT
/end FUNCTION
/begin FUNCTION netmng_uic ""
 /begin OUT_MEASUREMENT NetMng_stDfpCanA_mp NetMng_stDfpCanB_mp NetMng_stDfpCanC_mp NetMng_stDfpMaskPtCan_mp /end OUT_MEASUREMENT
/end FUNCTION
/begin FUNCTION nsc_corgn "coordinator for NOx cat regeneration" /begin DEF_CHARACTERISTIC NSC_numPrio_C NSC_st_C /end DEF_CHARACTERISTIC /end FUNCTION
/begin FUNCTION nsc_corgn_msg "" /begin OUT_MEASUREMENT NSC_numPrio NSC_st /end OUT_MEASUREMENT /end FUNCTION
/begin FUNCTION nsc_corgn_uic "" /end FUNCTION
/begin FUNCTION nvclb_calibration "" /end FUNCTION
/begin FUNCTION nvclb_calibration_uic "" /end FUNCTION
/begin FUNCTION opscd "Öldruckerfassung"
 /begin DEF_CHARACTERISTIC OPSCD_aMinBack_C OPSCD_aMinFor_C OPSCD_ctPwrStgOnMax_C OPSCD_LampDebExcTempDef_C OPSCD_LampDebExcTempOk_C OPSCD_LampDebNoLoadDef_C OPSCD_LampDebNoLoadOk_C OPSCD_LampDebShortCircBatDef_C OPSCD_LampDebShortCircBatOk_C OPSCD_LampDebShortCircGndDef_C OPSCD_LampDebShortCircGndOk_C OPSCD_nStart_C OPSCD_numDia_C OPSCD_numDioOut_C OPSCD_nZero_C OPSCD_stLampInvOut_C OPSCD_stPwrStgLampDia_C OPSCD_stSPICtl_C OPSCD_swtSigOut_C OPSCD_tiABSDebNegBack_C OPSCD_tiABSDebPosBack_C OPSCD_tiABSDebNegFor_C OPSCD_tiABSDebPosFor_C OPSCD_tiBtwTst_C OPSCD_tiInactiv1Back_C OPSCD_tiInactiv1For_C OPSCD_tiInactivStart_C OPSCD_tipOELDebNeg_C OPSCD_tipOELDebPos_C OPSCD_tiPwrStgOn_C OPSCD_vMinBack_C OPSCD_vMinFor_C /end DEF_CHARACTERISTIC
/end FUNCTION
/begin FUNCTION opscd_anain ""
 /begin DEF_CHARACTERISTIC OPSCD_uSRCMin_C OPSCD_uSRCMax_C OPSCD_pLin_CUR OPSCD_DebSRCHiDef_C OPSCD_DebSRCHiOk_C OPSCD_DebSRCLoDef_C OPSCD_DebSRCLoOk_C OPSCD_dtRmpSlpUp_C OPSCD_dtRmpSlpDwn_C OPSCD_numAdc_C OPSCD_stSensIDWord_C OPSCD_stPDfl_C /end DEF_CHARACTERISTIC
 /begin IN_MEASUREMENT OPSCD_uRaw_POEL_mp /end IN_MEASUREMENT
/end FUNCTION
/begin FUNCTION opscd_anain_msg "" /begin OUT_MEASUREMENT OPSCD_stpOEL /end OUT_MEASUREMENT /end FUNCTION
/begin FUNCTION opscd_anain_uic "" /begin OUT_MEASUREMENT OPSCD_uRaw_POEL_mp /end OUT_MEASUREMENT /end FUNCTION
/begin FUNCTION opscd_msg "" /begin OUT_MEASUREMENT OPSCD_stSigOut /end OUT_MEASUREMENT /end FUNCTION
/begin FUNCTION opscd_uic "" /begin OUT_MEASUREMENT OPSCD_stInactive_mp OPSCD_stLampRun_mp /end OUT_MEASUREMENT /end FUNCTION
/begin COMPU_METHOD Acc "Fahrzeugbeschleunigung" RAT_FUNC "%6.5" "m/s^2" COEFFS 0 1000 0 0 0 1 /end COMPU_METHOD
/begin COMPU_METHOD AirMassPerCyl "Luftmasse pro Zylinder" RAT_FUNC "%6.3" "mg/Hub" COEFFS 0 10 0 0 0 1 /end COMPU_METHOD
/begin COMPU_METHOD AirMassPerTime "Luftmasse pro Zeit" RAT_FUNC "%6.3" "Kg/h" COEFFS 0 10 0 0 0 1 /end COMPU_METHOD
/begin COMPU_METHOD AirMass_2 "Luftmasse (geringere Auflösung)" RAT_FUNC "%6.3" "g" COEFFS 0 10 0 0 0 1 /end COMPU_METHOD
/begin COMPU_METHOD Curr "Strom" RAT_FUNC "%6.2" "mA" COEFFS 0 1 0 0 0 1 /end COMPU_METHOD
/begin COMPU_METHOD CurRefPump "Applizierbarer Pumpreferenzstrom" TAB_VERB "%6.3" "-" COMPU_TAB_REF CurRefPump /end COMPU_METHOD
/begin COMPU_VTAB CurRefPump "Applizierbarer Pumpreferenzstrom" TAB_VERB 16 0 "0 uA" 1 "10 uA" 2 "20 uA" 3 "30 uA" 4 "40 uA" 5 "50 uA" 6 "60 uA" 7 "70 uA" 8 "80 uA" 9 "90 uA" 10 "100 uA" 11 "110 uA" 12 "120 uA" 13 "130 uA" 14 "140 uA" 15 "150 uA" /end COMPU_VTAB
/begin COMPU_METHOD dn_dZfine "Engine acceleration per time (dn/dt) fine resolution" RAT_FUNC "%6.2" "rpm/s" COEFFS 0 1 0 0 0 1 /end COMPU_METHOD
/begin COMPU_METHOD DtyCyc "Tastverhaeltnis" RAT_FUNC "%6.4" "%" COEFFS 0 100 0 0 0 1 /end COMPU_METHOD
/begin COMPU_METHOD EngN "Motordrehzahl" RAT_FUNC "%6.2" "rpm" COEFFS 0 1 0 0 0 1 /end COMPU_METHOD
/begin COMPU_METHOD EngN_HiRes "Motordrehzahl, höhere Auflösung als EngM" RAT_FUNC "%6.3" "rpm" COEFFS 0 8 0 0 0 1 /end COMPU_METHOD
/begin COMPU_METHOD Fact "Faktor mit Auflösung 1 / 8192, hauptsächlich für einen Faktorenbereich 0...1 verwendet" RAT_FUNC "%6.5" "-" COEFFS 0 8192 0 0 0 1 /end COMPU_METHOD
/begin COMPU_METHOD Fl_Half_L "Kraftstoffverbrauchsintegral" RAT_FUNC "%6.4" "l" COEFFS 0 20 0 0 0 1 /end COMPU_METHOD
/begin COMPU_METHOD InjMass "Einspritzmenge" RAT_FUNC "%6.4" "mg/hub" COEFFS 0 100 0 0 0 1 /end COMPU_METHOD
/begin COMPU_METHOD Kd "Differentialverstärkung Kd (gleiche Einheit/Umrechnungsformel an Ein- und Ausgang)" RAT_FUNC "%7.6" "1/1" COEFFS 0 65536 0 0 0 1 /end COMPU_METHOD
/begin COMPU_METHOD Kd_rpm2Nm "Differentialverstärkung Kd (Motordrehzahl EngN zu Motormoment Trq)" RAT_FUNC "%8.7" "Nm/rpm" COEFFS 0 655360 0 0 0 1 /end COMPU_METHOD
/begin COMPU_METHOD Kd_Temp_Kelv2Dcyc "Differentialverstärkung Kd (Temperatur zu Tastverhältnis)" RAT_FUNC "%8.7" "%/(K)" COEFFS 0 655360 0 0 0 1 /end COMPU_METHOD
/begin COMPU_METHOD Ki "Integrale Verstärkung Ki (gleiche Einheit/Umrechnungsregel an Ein- und Ausgang)" RAT_FUNC "%6.5" "1/s" COEFFS 0 4294.967296 0 0 0 1 /end COMPU_METHOD
/begin COMPU_METHOD Ki_curr2fact "Integralverstärkung (Strom Curr zu Faktor Fact)" RAT_FUNC "%10.9" "1/mA*s" COEFFS 0 35184372.088832 0 0 0 1 /end COMPU_METHOD
/begin COMPU_METHOD Ki_rpm2Nm "Integralverstärkung Ki (Motordrehzahl EngN zu Motormoment Trq)" RAT_FUNC "%6.5" "Nm/(rpm*s)" COEFFS 0 5368.70912 0 0 0 1 /end COMPU_METHOD
/begin COMPU_METHOD Ki_Temp_Kelv2Dcyc "Integralverstärkung (Temperatur zu Tastverhältnis)" RAT_FUNC "%7.6" "%/(K)" COEFFS 0 42949.67296 0 0 0 1 /end COMPU_METHOD
/begin COMPU_METHOD Kp_rpm2Nm "Proportionale Verstärkung Kp (Motordrehzahl EngN zu Moment Trq)" RAT_FUNC "%7.6" "Nm/rpm" COEFFS 0 81920 0 0 0 1 /end COMPU_METHOD
/begin COMPU_METHOD Kp_Temp_Kelv2Dcyc "Proportionalverstärkung (Temperatur zu Tastverhältnis)" RAT_FUNC "%8.7" "%/(K)" COEFFS 0 655360 0 0 0 1 /end COMPU_METHOD
/begin COMPU_METHOD lambda "Lambda" RAT_FUNC "%6.5" "-" COEFFS 0 1000 0 0 0 1 /end COMPU_METHOD
/begin COMPU_METHOD lambdaRecVal "Reziproker Lambda Wert" RAT_FUNC "%6.5" "-" COEFFS 0 1000 0 0 0 1 /end COMPU_METHOD
/begin COMPU_METHOD NumPinAdc "verbale Umrechnung für ADC Signale" TAB_VERB "%6.3" "-" COMPU_TAB_REF NumPinAdc /end COMPU_METHOD
/begin COMPU_VTAB NumPinAdc "verbale Umrechnung für ADC Signale" TAB_VERB 25 0 "Water_Temperature_Sensor_182" 1 "Intake_Air_Temperature_Sensor_157" 2 "Charge_Air_Temperature_Sensor_183" 3 "Exhaust_Temperature_Sensor_2_134" 4 "Exhaust_Temperature_Sensor_1_158" 5 "1st_APP_Sensor_252" 6 "2nd_APP_Sensor_239" 7 "ADC_REF" 8 "Boost_Pressure_Sensor_154" 9 "Atmospheric_Pressure_Sensor" 10 "Battery_Voltage_Sensor" 11 "Rail_Pressure_Sensor_156" 12 "Rail_Pressure_Peak_Value_156" 13 "Booster_Voltage_Sensor" 14 "Current_MeUn_Sensor" 15 "Current_PCV_Sensor" 16 "Voltage_Bank_1" 17 "Voltage_Bank_2" 18 "Pressure_Upstream_Particle_Filter_159" 19 "Engine_Oil_Pressure_110" 20 "Temperature_ECU_PCB" 21 "Voltage_Lambda_Ua" 22 "Voltage_Lambda_Ri" 23 "ADC_DUMMY_NOT_USED" 24 "ADC_DUMMY_A_NOT_USED" /end COMPU_VTAB
/begin COMPU_METHOD NumPinDia "Verbale Umrechnung für Diagnose Signale" TAB_VERB "%6.3" "-" COMPU_TAB_REF NumPinDia /end COMPU_METHOD
/begin COMPU_VTAB NumPinDia "Verbale Umrechnung für Diagnose Signale" TAB_VERB 28 0 "CJ945_Diagnostic_Signal" 1 "AC_Compressor_DiaSig" 2 "Fuel_Pump_Diagnostic_Signal_232" 3 "Starter_234" 4 "Oil_Pressure_Lamp_Switch_245" 5 "Engine_Bay_Air_Flaps_123" 6 "Ebox_Fan_Actuator_Diagnostic_Signal_219" 7 "Shuttr_Actuator_Diagnostic_Signal_231" 8 "Twostage_TurboLoading_SW_DiaSig" 9 "DIO_OUT_DIAGNOSTIC_DUMMY_NOT_USED" 10 "Alternator" 11 "Boost_Pressure_Actuator_Diagnostic_Signal_193" 12 "EGR_Actuator_Diagnostic_Signal_194" 13 "1st_Pressure_Control_Valve_Diagnostic_Signal_172" 14 "2nd_Pressure_Control_Valve_Diagnostic_Signal_172" 15 "1st_Metering_Unit_Diagnostic_Signal_171" 16 "2nd_Metering_Unit_Diagnostic_Signal_171" 17 "Variable_Swirl_Actuator_Diagnostic_Signal_195" 18 "FAN_240" 19 "Add_On_Heater_244" 20 "EngM_Bearing_Actuator_Diagnostic_Signal_124" 21 "EngM_Bearing_Actuator_Diagnostic_Signal_121" 22 "Throttle_Valve_Diagnostic_Signal_196" 23 "Low pressure stage BPA_Diagnostic_Signal_117" 24 "PWM_DIAGNOSTIC_DUMMY_NOT_USED" 25 "1st_Sensor_Supply_Voltage_DiaSig" 26 "2nd_Sensor_Supply_Voltage_DiaSig" 27 "3rd_Sensor_Supply_Voltage_DiaSig" /end COMPU_VTAB
/begin COMPU_METHOD NumPinDioIn "Verbale Umrechnung für Digitaleingang Signale" TAB_VERB "%6.3" "-" COMPU_TAB_REF NumPinDioIn /end COMPU_METHOD
/begin COMPU_VTAB NumPinDioIn "Verbale Umrechnung für Digitaleingang Signale" TAB_VERB 15 0 "Terminal_15_207" 1 "Main_Brake_Switch_236" 2 "Redundant_Brake_Switch_223" 3 "Clutch_Switch" 4 "Terminal_50_224" 5 "ECU_selection_Switch_251" 6 "FlFlt_Switch_211" 7 "Coolant-heater_212" 8 "Redundant_Terminal_15_209(118)" 9 "AC-compressor_overboost_213" 10 "Additive_tank_level_switch_235" 11 "Terminal_61_113" 12 "Lambda_Regeneration" 13 "Oil_Level_sensor_138" 14 "DIO_IN_DUMMY_NOT_USED" /end COMPU_VTAB
/begin COMPU_METHOD NumPinDioOut "Verbale Umrechnung für Digitalausgang Signale" TAB_VERB "%6.3" "-" COMPU_TAB_REF NumPinDioOut /end COMPU_METHOD
/begin COMPU_VTAB NumPinDioOut "Verbale Umrechnung für Digitalausgang Signale" TAB_VERB 12 0 "Main_Relay_220(144)" 1 "AC_Compressor" 2 "Fuel_Pump_232" 3 "Starter_234" 4 "OPS_Lamp_245" 5 "EBAF_123" 6 "Ebox_Fan_Actuator_219" 7 "Shuttr_Actuator_231" 8 "STATREG_PSOFF_Bit" 9 "Twostage_TurboLoading_120" 10 "TD_Signal_253" 11 "DIO_OUT_DUMMY_NOT_USED" /end COMPU_VTAB
/begin COMPU_METHOD NumPinPwmOut "Verbale Umrechnung für PWM-Ausgang Signale" TAB_VERB "%6.3" "-" COMPU_TAB_REF NumPinPwmOut /end COMPU_METHOD
/begin COMPU_VTAB NumPinPwmOut "Verbale Umrechnung für PWM-Ausgang Signale" TAB_VERB 13 0 "Boost_Pressure_Actuator_193" 1 "EGR_Actuator_194" 2 "PCV_Actuator_172" 3 "MeUn_Actuator_171" 4 "Variable_Swirl_Actuator_195" 5 "Fan_Actuator_240" 6 "Add_On_Heater_244" 7 "EngM_Bearing_Actuator_124" 8 "EngM_Bearing_Actuator_121" 9 "Throttle_Valve_196" 10 "LSU_Heater_PWMOutput" 11 "Low pressure stage BPA_117" 12 "PWM_DUMMY_NOT_USED" /end COMPU_VTAB
/begin COMPU_METHOD O2 "Sauerstoffkonzentration" RAT_FUNC "%8.7" "-" COEFFS 0 100000 0 0 0 1 /end COMPU_METHOD
/begin COMPU_METHOD OneToOne "eins zu eins (physikalischer Wert ist gleich dem internen Wert)" RAT_FUNC "%6.2" "-" COEFFS 0 1 0 0 0 1 /end COMPU_METHOD
/begin COMPU_METHOD Period "Periodendauer" RAT_FUNC "%6.3" "ms" COEFFS 0 10 0 0 0 1 /end COMPU_METHOD
/begin COMPU_METHOD Period_ms "Periodendauer in ms" RAT_FUNC "%6.3" "ms" COEFFS 0 10 0 0 0 1 /end COMPU_METHOD
/begin COMPU_METHOD Prc "Prozent, gleiche interne Auflösung wie Fact, aber Darstellung in Prozent (0...100%)" RAT_FUNC "%6.4" "%" COEFFS 0 81.92 0 0 0 1 /end COMPU_METHOD
/begin COMPU_METHOD Pres_hPa "Druck (angezeigt in [hPa])" RAT_FUNC "%6.2" "hPa" COEFFS 0 1 0 0 0 1 /end COMPU_METHOD
/begin COMPU_METHOD Pres_Rail "Raildruck in hPa" RAT_FUNC "%4.3" "bar" COEFFS 0 10.000000 0 0 0 1 /end COMPU_METHOD
/begin COMPU_METHOD Pwr_kW "Leistung in kW" RAT_FUNC "%6.4" "kW" COEFFS 0 100 0 0 0 1 /end COMPU_METHOD
/begin COMPU_METHOD Qp_mm3_sec "Umrechnung für Volumenstrom" RAT_FUNC "%6.1" "mm3/s" COEFFS 0 0.1 0 0 0 1 /end COMPU_METHOD
/begin COMPU_METHOD Resist "Widerstand" RAT_FUNC "%6.3" "Ohm" COEFFS 0 10 0 0 0 1 /end COMPU_METHOD
/begin COMPU_METHOD Resist_1 "1. Widerstandsvariante" RAT_FUNC "%6.2" "mOhm" COEFFS 0 1 0 0 0 1 /end COMPU_METHOD
/begin COMPU_METHOD Rk "conversion formula for gas constant" RAT_FUNC "%6.5" "kJ/(kg*K)" COEFFS 0 1000 0 0 0 1 /end COMPU_METHOD
/begin COMPU_METHOD RmpDtyCyc "Rampengradient für Tastverhältnis" RAT_FUNC "%6.5" "%/s" COEFFS 0 6553.6 0 0 0 1 /end COMPU_METHOD
/begin COMPU_METHOD RmpEngN "Rampengradient für Motordrehzahl" RAT_FUNC "%6.4" "rpm/s" COEFFS 0 65.536 0 0 0 1 /end COMPU_METHOD
/begin COMPU_METHOD RmpPres "Rampengradient für Druck" RAT_FUNC "%7.3" "hPa/s" COEFFS 0 65.536000 0 0 0 1 /end COMPU_METHOD
/begin COMPU_METHOD TempDiff_Cels "difference/offset temperature displayed in degree celcius" RAT_FUNC "%6.3" "deg C" COEFFS 0 10 0 0 0 1 /end COMPU_METHOD
/begin COMPU_METHOD Temp_Cels "Temperatur dargestellt in °C (gleiche interne Darstellung wie Temp_Kelv)" RAT_FUNC "%6.1" "deg C" COEFFS 0 10 2731.4 0 0 1 /end COMPU_METHOD
/begin COMPU_METHOD TimeDeb "Entprellzeit in Millisekunden für Libraryfunktion Debounce" RAT_FUNC "%6.1" "ms" COEFFS 0 0.1 0 0 0 1 /end COMPU_METHOD
/begin COMPU_METHOD TimeDelay_s "Zeitkonstante T1 (in s) für PT1, DT1, etc." RAT_FUNC "%9.3" "s" COEFFS 0 0 1 0 0.00023283064365387 0 /end COMPU_METHOD
/begin COMPU_METHOD TimeDelay_s_Lin_16 "Zeitkonstante T1 (in s) für PT1, DT1, etc. für SINT16, kein Kehrwert" RAT_FUNC "%6.5" "s" COEFFS 0 6553.4 0 0 0 1 /end COMPU_METHOD
/begin COMPU_METHOD Time_ms "Zeit in ms für Fehlerentprellung (DSM) und SW-Timer" RAT_FUNC "%6.1" "ms" COEFFS 0 0.1 0 0 0 1 /end COMPU_METHOD
/begin COMPU_METHOD Time_ms_40ms "Aktuelle Zaehler in 40 ms Takt" RAT_FUNC "%6.1" "ms" COEFFS 0 0.025 0 0 0 1 /end COMPU_METHOD
/begin COMPU_METHOD Time_s "Zeit in s für Fehlerentprellung (DSM) und SW-Timer" RAT_FUNC "%6.4" "s" COEFFS 0 100 0 0 0 1 /end COMPU_METHOD
/begin COMPU_METHOD Trq "Motormoment" RAT_FUNC "%6.3" "Nm" COEFFS 0 10 0 0 0 1 /end COMPU_METHOD
/begin COMPU_METHOD Trq32 "Umrechungsformel für inneres Moment in 32bit Zahlendarstellung" RAT_FUNC "%8.7" "Nm" COEFFS 0 655360 0 0 0 1 /end COMPU_METHOD
/begin COMPU_METHOD UC_Curr "Hardwarekapselung Kondensator : MCy330" RAT_FUNC "%6.3" "A" COEFFS 0 10 0 0 0 1 /end COMPU_METHOD
/begin COMPU_METHOD UC_Volt "Hardwarekapselung: Kondensatorspannung fuer MCy330" RAT_FUNC "%6.3" "V" COEFFS 0 10 0 0 0 1 /end COMPU_METHOD
/begin COMPU_METHOD Vel "Fahrzeuggeschwindigkeit, gleiche interne Auflösung wie Vel_SI" RAT_FUNC "%6.4" "km/h" COEFFS 0 100 0 0 0 1 /end COMPU_METHOD
/begin COMPU_METHOD Volt "Spannung in V (von ADC)" RAT_FUNC "%6.2" "mV" COEFFS 0 0.2046 0 0 0 1 /end COMPU_METHOD
/begin COMPU_METHOD VoltToRes "Umrechnung für Faktor Spannung zu Widerstand" RAT_FUNC "%7.6" "Ohm/mV" COEFFS 0 50830.889540567 0 0 0 1 /end COMPU_METHOD
/begin COMPU_METHOD Volt_Batt "Batteriespannung" RAT_FUNC "%6.1" "mV" COEFFS 0 0.05115 0 0 0 1 /end COMPU_METHOD
/begin RECORD_LAYOUT Kf_Xs16_Ys16_Ws16 NO_AXIS_PTS_X 1 SWORD NO_AXIS_PTS_Y 2 SWORD AXIS_PTS_X 3 SWORD INDEX_INCR DIRECT AXIS_PTS_Y 4 SWORD INDEX_INCR DIRECT FNC_VALUES 5 SWORD COLUMN_DIR DIRECT /end RECORD_LAYOUT
/begin RECORD_LAYOUT Kl_Xs16_Ws16 NO_AXIS_PTS_X 1 SWORD AXIS_PTS_X 2 SWORD INDEX_INCR DIRECT FNC_VALUES 3 SWORD COLUMN_DIR DIRECT /end RECORD_LAYOUT
/begin RECORD_LAYOUT Kwb_Ws16 FNC_VALUES 1 SWORD COLUMN_DIR DIRECT /end RECORD_LAYOUT
/begin RECORD_LAYOUT Kwb_Wu16 FNC_VALUES 1 UWORD COLUMN_DIR DIRECT /end RECORD_LAYOUT
/begin RECORD_LAYOUT Kwb_Wu32 FNC_VALUES 1 ULONG COLUMN_DIR DIRECT /end RECORD_LAYOUT
/begin RECORD_LAYOUT Kwb_Wu8 FNC_VALUES 1 UBYTE COLUMN_DIR DIRECT /end RECORD_LAYOUT
/begin RECORD_LAYOUT Kw_Ws16 FNC_VALUES 1 SWORD COLUMN_DIR DIRECT /end RECORD_LAYOUT
/begin RECORD_LAYOUT Kw_Ws32 FNC_VALUES 1 SLONG COLUMN_DIR DIRECT /end RECORD_LAYOUT
/begin RECORD_LAYOUT Kw_Ws8 FNC_VALUES 1 SBYTE COLUMN_DIR DIRECT /end RECORD_LAYOUT
/begin RECORD_LAYOUT Kw_Wu16 FNC_VALUES 1 UWORD COLUMN_DIR DIRECT /end RECORD_LAYOUT
/begin RECORD_LAYOUT Kw_Wu32 FNC_VALUES 1 ULONG COLUMN_DIR DIRECT /end RECORD_LAYOUT
/begin RECORD_LAYOUT Kw_Wu8 FNC_VALUES 1 UBYTE COLUMN_DIR DIRECT /end RECORD_LAYOUT
/end MODULE
/end PROJECT
