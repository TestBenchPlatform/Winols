ASAP2_VERSION 1 3
/begin PROJECT P389 "BMW DDE6.0 4-Zylinder V53.4 01.04.2004 CAN12H"
/begin HEADER "" VERSION "V53.4_4Z_CAN12H" PROJECT_NO P389 /end HEADER
/begin MODULE DIM ""
/begin MOD_COMMON "" BYTE_ORDER MSB_FIRST ALIGNMENT_BYTE 1 ALIGNMENT_WORD 2 ALIGNMENT_LONG 4 ALIGNMENT_FLOAT32_IEEE 4 /end MOD_COMMON
/begin CHARACTERISTIC K_UBW_TNSTART "Wartezeit nach Start" VALUE 0x000C17D8 TKW_VV_VV_UW 100.0 Def_td_uw_q0p01 0.0 655.3500 /begin FUNCTION_LIST LAYER /end FUNCTION_LIST FORMAT "%5.2" /end CHARACTERISTIC
/begin CHARACTERISTIC K_LBATTMAXK "maximale Batterieladespannung Kofferraum" VALUE 0x000C17DA TKW_VV_VV_SW 100.0 Def_u_sw_b128 0.0 127.9960 /begin FUNCTION_LIST LBATTCAL /end FUNCTION_LIST FORMAT "%6.3" /end CHARACTERISTIC
/begin CHARACTERISTIC K_LBATTMAXM "maximale Batterieladespannung" VALUE 0x000C17DC TKW_VV_VV_SW 100.0 Def_u_sw_b128 0.0 127.9960 /begin FUNCTION_LIST LBATTCAL /end FUNCTION_LIST FORMAT "%6.3" /end CHARACTERISTIC
/begin CHARACTERISTIC K_LBATTMIN "minmale Batterieladespannung Licht an" VALUE 0x000C17DE TKW_VV_VV_SW 100.0 Def_u_sw_b128 0.0 127.9960 /begin FUNCTION_LIST LBATTCAL /end FUNCTION_LIST FORMAT "%6.3" /end CHARACTERISTIC
/begin CHARACTERISTIC K_LBATTTUMG "" VALUE 0x000C17E0 TKW_VV_VV_SW 100.0 Def_t_sw_q0p1 -3276.8000 3276.7000 /begin FUNCTION_LIST LBATTCAL /end FUNCTION_LIST FORMAT "%4.1" /end CHARACTERISTIC
/begin CHARACTERISTIC K_LBATTTUMGBA "" VALUE 0x000C17E2 TKW_VV_VV_SW 100.0 Def_t_sw_q0p1 -3276.8000 3276.7000 /begin FUNCTION_LIST LBATTCAL /end FUNCTION_LIST FORMAT "%4.1" /end CHARACTERISTIC
/begin CHARACTERISTIC K_UKOMPK "Applikationswert Kompensationsspannung Kafferraum" VALUE 0x000C17E4 TKW_VV_VV_SW 100.0 Def_u_sw_b128 0.0 127.9960 /begin FUNCTION_LIST LBATTCAL /end FUNCTION_LIST FORMAT "%6.3" /end CHARACTERISTIC
/begin CHARACTERISTIC K_UKOMPM "Applikationswert Kompensationsspannung Motorraum" VALUE 0x000C17E6 TKW_VV_VV_SW 100.0 Def_u_sw_b128 0.0 127.9960 /begin FUNCTION_LIST LBATTCAL /end FUNCTION_LIST FORMAT "%6.3" /end CHARACTERISTIC
/begin CHARACTERISTIC K_RLEITUNGK "Widerstand Ladeleitung Batterie Kofferraum" VALUE 0x000C1814 TKW_VV_VV_UB 100.0 Def_f_ub_b32 0.0 31.8750 /begin FUNCTION_LIST LBATTCAL /end FUNCTION_LIST /end CHARACTERISTIC
/begin CHARACTERISTIC K_RLEITUNGM "Widerstand Ladeleitung Batterie Motorraum" VALUE 0x000C1815 TKW_VV_VV_UB 100.0 Def_f_ub_b32 0.0 31.8750 /begin FUNCTION_LIST LBATTCAL /end FUNCTION_LIST /end CHARACTERISTIC
/begin CHARACTERISTIC K_TIMERDLY "Verzoegerungszeit für Startwertberechnung" VALUE 0x000C1816 TKW_VV_VV_UB 100.0 Def_dez_ub_q1 0.0 255.0000 /begin FUNCTION_LIST LBATTCAL /end FUNCTION_LIST /end CHARACTERISTIC
/begin CHARACTERISTIC S_LBATT1 "Applikationsschalter1 Auswahl Ersatztemperatur" VALUE 0x000C1817 TKW_VV_VV_UB 100.0 Identity 0.0 1.0000 /begin FUNCTION_LIST LBATTCAL /end FUNCTION_LIST /end CHARACTERISTIC
/begin CHARACTERISTIC S_LBATT2 "Applikationsschalter2 Auswahl Ersatztemperatur" VALUE 0x000C1818 TKW_VV_VV_UB 100.0 Identity 0.0 1.0000 /begin FUNCTION_LIST LBATTCAL /end FUNCTION_LIST /end CHARACTERISTIC
/begin CHARACTERISTIC K_DTANSKOR "Ansaugluftmodelloffset Aussentemperatur" VALUE 0x000C17E8 TKW_VV_VV_SW 100.0 Def_t_sw_q0p1 -3276.8000 3276.7000 /begin FUNCTION_LIST LBATTCAL /end FUNCTION_LIST FORMAT "%4.1" /end CHARACTERISTIC
/begin CHARACTERISTIC K_NMINUMG "Drehzahlschwelle Aussentemperaturmodell" VALUE 0x000C17EA TKW_VV_VV_SW 100.0 Def_n_sw_q1p0 0.0 32767.0000 /begin FUNCTION_LIST LBATTCAL /end FUNCTION_LIST /end CHARACTERISTIC
/begin CHARACTERISTIC K_OFTUMGCAN "Offset Umgebungstemperatur CAN" VALUE 0x000C17EC TKW_VV_VV_SW 100.0 Def_t_sw_q0p1 -3276.8000 3276.7000 /begin FUNCTION_LIST LBATTCAL /end FUNCTION_LIST FORMAT "%4.1" /end CHARACTERISTIC
/begin CHARACTERISTIC K_OFULADE "Offset Ladekennlinie Batthinten" VALUE 0x000C17EE TKW_VV_VV_SW 100.0 Def_u_sw_b128 -128.0000 127.9960 /begin FUNCTION_LIST LBATTCAL /end FUNCTION_LIST FORMAT "%6.3" /end CHARACTERISTIC
/begin CHARACTERISTIC K_PLBATTUMG "Plausibilisierung-Schwelle Batterieumgebungstemperatur" VALUE 0x000C17F0 TKW_VV_VV_SW 100.0 Def_t_sw_q0p1 0.0 3276.7000 /begin FUNCTION_LIST LBATTCAL /end FUNCTION_LIST FORMAT "%4.1" /end CHARACTERISTIC
/begin CHARACTERISTIC K_TBATINIMAN "Applikation INITWERT Batterietemperatur" VALUE 0x000C17F2 TKW_VV_VV_SW 100.0 Def_t_sw_q0p1 0.0 3276.7000 /begin FUNCTION_LIST LBATTCAL /end FUNCTION_LIST FORMAT "%4.1" /end CHARACTERISTIC
/begin CHARACTERISTIC K_TUMGINI "Initialisierungswert Aussentemperaturmodell" VALUE 0x000C17F4 TKW_VV_VV_SW 100.0 Def_t_sw_q0p1 -3276.8000 3276.7000 /begin FUNCTION_LIST LBATTCAL /end FUNCTION_LIST FORMAT "%4.1" /end CHARACTERISTIC
/begin CHARACTERISTIC K_UBATTNORM "Batterienormspannung" VALUE 0x000C17F6 TKW_VV_VV_SW 100.0 Def_u_sw_b128 -128.0000 127.9960 /begin FUNCTION_LIST LBATTCAL /end FUNCTION_LIST FORMAT "%6.3" /end CHARACTERISTIC
/begin CHARACTERISTIC K_BATTHTAUVG "Zeitkonstante Batterie hinten bei VFZG>" VALUE 0x000C17F8 TKW_VV_VV_UW 100.0 Def_f_uw_b1 0.0 9.99984741210938e-1 /begin FUNCTION_LIST LBATTCAL /end FUNCTION_LIST /end CHARACTERISTIC
/begin CHARACTERISTIC K_BATTHTAUVK "Zeitkonstante Batterie hinten bei VFZG<" VALUE 0x000C17FA TKW_VV_VV_UW 100.0 Def_f_uw_b1 0.0 9.99984741210938e-1 /begin FUNCTION_LIST LBATTCAL /end FUNCTION_LIST /end CHARACTERISTIC
/begin CHARACTERISTIC K_BATTVTAUVG "Zeitkonstante Batterie vorne bei VFZG>" VALUE 0x000C17FC TKW_VV_VV_UW 100.0 Def_f_uw_b1 0.0 9.99984741210938e-1 /begin FUNCTION_LIST LBATTCAL /end FUNCTION_LIST /end CHARACTERISTIC
/begin CHARACTERISTIC K_BATTVTAUVK "Zeitkonstante Batterie bei VFZG<Zeitkonstante Batterie bei VFZG>" VALUE 0x000C17FE TKW_VV_VV_UW 100.0 Def_f_uw_b1 0.0 9.99984741210938e-1 /begin FUNCTION_LIST LBATTCAL /end FUNCTION_LIST /end CHARACTERISTIC
/begin CHARACTERISTIC K_BATT_ALFAH "Alphatau-Wert Batterie hinten" VALUE 0x000C1800 TKW_VV_VV_UW 100.0 Def_f_uw_b1 1.52587890625e-5 9.99984741210938e-1 /begin FUNCTION_LIST LBATTCAL /end FUNCTION_LIST /end CHARACTERISTIC
/begin CHARACTERISTIC K_BATT_ALFAV "Alphatau-Wert Batterie vorne" VALUE 0x000C1802 TKW_VV_VV_UW 100.0 Def_f_uw_b1 1.52587890625e-5 9.99984741210938e-1 /begin FUNCTION_LIST LBATTCAL /end FUNCTION_LIST /end CHARACTERISTIC
/begin CHARACTERISTIC K_BATT_BETAV "Beta-Wert Batterie vorne" VALUE 0x000C1804 TKW_VV_VV_UW 100.0 Def_f_uw_b1 1.52587890625e-5 9.99984741210938e-1 /begin FUNCTION_LIST LBATTCAL /end FUNCTION_LIST /end CHARACTERISTIC
/begin CHARACTERISTIC K_BATVFZGTAU "VFZG-Umschaltschwelle TAU Batterie" VALUE 0x000C1806 TKW_VV_VV_UW 100.0 Def_v_uw_q1p0 0.0 65535.0000 /begin FUNCTION_LIST LBATTCAL /end FUNCTION_LIST /end CHARACTERISTIC
/begin CHARACTERISTIC K_ILMINUMG "integrierte Lufmassenschwelle Aussentemperaturmodell" VALUE 0x000C1808 TKW_VV_VV_UW 100.0 Def_lm_uw_q0p000444 0.0 29.1266 /begin FUNCTION_LIST LBATTCAL /end FUNCTION_LIST FORMAT "%7.4" /end CHARACTERISTIC
/begin CHARACTERISTIC K_TBATTFTAUV "Zeitkonstante 5*Tau Batterievorne" VALUE 0x000C180A TKW_VV_VV_UW 100.0 Def_st_uw_q1 0.0 65535.0000 /begin FUNCTION_LIST LBATTCAL /end FUNCTION_LIST /end CHARACTERISTIC
/begin CHARACTERISTIC K_TBATTTAUFH "Zeitkonstante Batterie 5*Tau hinten" VALUE 0x000C180C TKW_VV_VV_UW 100.0 Def_st_uw_q1 0.0 65535.0000 /begin FUNCTION_LIST LBATTCAL /end FUNCTION_LIST /end CHARACTERISTIC
/begin CHARACTERISTIC K_TUMGTAU "Zeitkonstante 5*Tau Aussentemperatur" VALUE 0x000C180E TKW_VV_VV_UW 100.0 Def_st_uw_q1 0.0 65535.0000 /begin FUNCTION_LIST LBATTCAL /end FUNCTION_LIST /end CHARACTERISTIC
/begin CHARACTERISTIC K_ULADE_TAU "Batterieladespannungs Zeitkonstante" VALUE 0x000C1810 TKW_VV_VV_UW 100.0 Def_f_uw_b1 0.0 9.99984741210938e-1 /begin FUNCTION_LIST LBATTCAL /end FUNCTION_LIST /end CHARACTERISTIC
/begin CHARACTERISTIC K_VMINUMG "Fahrzeuggeschwindigkeitsschwelle Aussentemperaturmodell" VALUE 0x000C1812 TKW_VV_VV_UW 100.0 Def_v_uw_q1p0 0.0 65535.0000 /begin FUNCTION_LIST LBATTCAL /end FUNCTION_LIST /end CHARACTERISTIC
/begin CHARACTERISTIC CW_BATTCOD "Enable Handcodierung" VALUE 0x000C1819 TKW_VV_VV_UB 100.0 Def_st_ub_q1 0.0 2.0000 /begin FUNCTION_LIST LBATTCAL /end FUNCTION_LIST /end CHARACTERISTIC
/begin CHARACTERISTIC K_APPTBATINI "Enable Applikation Initwert Batterietemperatur" VALUE 0x000C181A TKW_VV_VV_UB 100.0 Def_st_ub_q1 0.0 255.0000 /begin FUNCTION_LIST LBATTCAL /end FUNCTION_LIST /end CHARACTERISTIC
/begin CHARACTERISTIC K_BATTORT0 "Batterieeinbauort No1" VALUE 0x000C181B TKW_VV_VV_UB 100.0 Def_st_ub_q1 0.0 2.0000 /begin FUNCTION_LIST LBATTCAL /end FUNCTION_LIST /end CHARACTERISTIC
/begin CHARACTERISTIC K_BATTORT2 "Batterieeinbauort No2" VALUE 0x000C181C TKW_VV_VV_UB 100.0 Def_st_ub_q1 0.0 2.0000 /begin FUNCTION_LIST LBATTCAL /end FUNCTION_LIST /end CHARACTERISTIC
/begin CHARACTERISTIC K_MCOBATTORT "Codierung Hand Batterieeinbauort" VALUE 0x000C181D TKW_VV_VV_UB 100.0 Def_st_ub_q1 0.0 2.0000 /begin FUNCTION_LIST LBATTCAL /end FUNCTION_LIST /end CHARACTERISTIC
/begin CHARACTERISTIC S_LBATTAPPL "" VALUE 0x000C181E TKW_VV_VV_UB 100.0 Identity 0.0 1.0000 /begin FUNCTION_LIST LBATTCAL /end FUNCTION_LIST /end CHARACTERISTIC
/begin CHARACTERISTIC KL_LADEKENNL "Batterieladespannungskennlinie" CURVE 0x000C1820 TKL_SW_VV_SW 100.0 Def_u_sw_b128 0.0 127.9960 /begin FUNCTION_LIST LBATTCAL /end FUNCTION_LIST
 /begin AXIS_DESCR STD_AXIS T_battabst Def_t_sw_q0p1 6 -3276.8000 3276.7000 FORMAT "%4.1" /end AXIS_DESCR
 FORMAT "%6.3" /end CHARACTERISTIC
/begin CHARACTERISTIC KL_EXPBETAV "Funktion EXP (-BETA*tabst_w)" CURVE 0x000C183A TKL_UW_VV_UW 100.0 Def_f_uw_b1 0.0 9.99984741210938e-1 /begin FUNCTION_LIST LBATTCAL /end FUNCTION_LIST /begin AXIS_DESCR STD_AXIS NO_INPUT_QUANTITY Def_st_uw_q1 11 0.0 65535.0000 /end AXIS_DESCR /end CHARACTERISTIC
/begin CHARACTERISTIC KL_BATTLSTR "Geschwindigkeitsfaktor Batterieumgebungstemperatur" CURVE 0x000C1868 TKL_UW_VV_UW 100.0 Def_f_uw_b256 0.0 255.9960 /begin FUNCTION_LIST LBATTCAL /end FUNCTION_LIST /begin AXIS_DESCR STD_AXIS NO_INPUT_QUANTITY Def_v_uw_q1p0 6 0.0 360.0000 /end AXIS_DESCR FORMAT "%6.3" /end CHARACTERISTIC
/begin CHARACTERISTIC KL_EXPALV "Funktion EXP(-ALPHA*tabst_w) hinten" CURVE 0x000C1882 TKL_UW_VV_UW 100.0 Def_f_uw_b1 0.0 9.99984741210938e-1 /begin FUNCTION_LIST LBATTCAL /end FUNCTION_LIST /begin AXIS_DESCR STD_AXIS Tn_abstell Def_st_uw_q1 11 0.0 65535.0000 /end AXIS_DESCR /end CHARACTERISTIC
/begin CHARACTERISTIC KL_EXPALH "Funktion EXP(-ALPHA*tabst_w) hinten" CURVE 0x000C18B0 TKL_UW_VV_UW 100.0 Def_f_uw_b1 0.0 9.99984741210938e-1 /begin FUNCTION_LIST LBATTCAL /end FUNCTION_LIST /begin AXIS_DESCR STD_AXIS NO_INPUT_QUANTITY Def_st_uw_q1 11 0.0 65535.0000 /end AXIS_DESCR /end CHARACTERISTIC
/begin CHARACTERISTIC K_TNNSTART "Zeittriggerschwelle nach Motorstart" VALUE 0x000C18DE TKW_VV_VV_UW 100.0 Def_td_uw_q0p01 0.0 655.3500 /begin FUNCTION_LIST LDSTGEN /end FUNCTION_LIST FORMAT "%5.2" /end CHARACTERISTIC
/begin CHARACTERISTIC K_APPUPLLDST "Applikationswert St_ldstgen für Nachlauf" VALUE 0x000C18E0 TKW_VV_VV_UB 100.0 Def_st_ub_q1 0.0 255.0000 /begin FUNCTION_LIST LDSTGEN /end FUNCTION_LIST /end CHARACTERISTIC
/begin CHARACTERISTIC K_DFMODE "DF-Mode-Schalter themermisch/elektrisch" VALUE 0x000C18E1 TKW_VV_VV_UB 100.0 Def_st_ub_q1 0.0 255.0000 /begin FUNCTION_LIST LDSTGEN /end FUNCTION_LIST /end CHARACTERISTIC
/begin CHARACTERISTIC K_DFS_MAX "DF-Auslastung Maximalschwelle" VALUE 0x000C18E2 TKW_VV_VV_UB 100.0 Def_f_ub_b100 0.0 99.6093 /begin FUNCTION_LIST LDSTGEN /end FUNCTION_LIST /end CHARACTERISTIC
/begin CHARACTERISTIC K_DFS_MIN "DF-Auslastung Minimalschwelle" VALUE 0x000C18E3 TKW_VV_VV_UB 100.0 Def_f_ub_b100 0.0 99.6093 /begin FUNCTION_LIST LDSTGEN /end FUNCTION_LIST /end CHARACTERISTIC
/begin CHARACTERISTIC K_DFS_MITT "DF-Auslastung Mittelschwelle" VALUE 0x000C18E4 TKW_VV_VV_UB 100.0 Def_f_ub_b100 0.0 99.6093 /begin FUNCTION_LIST LDSTGEN /end FUNCTION_LIST /end CHARACTERISTIC
/begin CHARACTERISTIC K_GENLDDFMAX "Schwell Anzeige maximaler Auslastungsgrad Generator" VALUE 0x000C18E5 TKW_VV_VV_UB 100.0 Def_f_ub_b100 0.0 99.6093 /begin FUNCTION_LIST LDSTGEN /end FUNCTION_LIST /end CHARACTERISTIC
/begin CHARACTERISTIC K_IERRFIL "Filterkonstante für Filterung Erregerstrom" VALUE 0x000C18E6 TKW_VV_VV_UB 100.0 Def_f_ub_b1 0.0040 0.9960 /begin FUNCTION_LIST LDSTGEN /end FUNCTION_LIST /end CHARACTERISTIC
/begin CHARACTERISTIC KL_GENLDST "Auslastungsgrad Generator" CURVE 0x000C18E8 TKL_SW_VV_UB 100.0 Def_f_ub_b100 0.0 99.6093 /begin FUNCTION_LIST LDSTGEN /end FUNCTION_LIST
 /begin AXIS_DESCR STD_AXIS Tgen Def_t_sw_q0p1 6 -3276.8000 3276.7000 FORMAT "%4.1" /end AXIS_DESCR
/end CHARACTERISTIC
/begin CHARACTERISTIC K_DSOCHYST "Hystereschwelle SOC" VALUE 0x000C18FC TKW_VV_VV_SW 100.0 Def_f_sw_b100 -100.0000 99.9969 /begin FUNCTION_LIST LLPMCTRL /end FUNCTION_LIST FORMAT "%6.3" /end CHARACTERISTIC
/begin CHARACTERISTIC K_DSOCLLANH "Abstand zur Stfgrz, bei der die LLDZanh aktiviert wird." VALUE 0x000C18FE TKW_VV_VV_SW 100.0 Def_f_sw_b100 -100.0000 99.9969 /begin FUNCTION_LIST LLPMCTRL /end FUNCTION_LIST FORMAT "%6.3" /end CHARACTERISTIC
/begin CHARACTERISTIC K_NLLMIN "Motordrehzahl unterhalb derer die LLDZanh. zurueckgenommen wird." VALUE 0x000C1900 TKW_VV_VV_SW 100.0 Def_n_sw_q1p0 -32768.0000 32767.0000 /begin FUNCTION_LIST LLPMCTRL /end FUNCTION_LIST /end CHARACTERISTIC
/begin CHARACTERISTIC K_DFLLMIN "DF unterhalb derer die LLDZanh. zurueckgenommen wird." VALUE 0x000C1902 TKW_VV_VV_UB 100.0 Def_f_ub_b100 0.0 99.6093 /begin FUNCTION_LIST LLPMCTRL /end FUNCTION_LIST /end CHARACTERISTIC
/begin CHARACTERISTIC K_DFMAX "Obere Schwelle DF Signal" VALUE 0x000C1903 TKW_VV_VV_UB 100.0 Def_f_ub_b100 0.0 99.6093 /begin FUNCTION_LIST LLPMCTRL /end FUNCTION_LIST /end CHARACTERISTIC
/begin CHARACTERISTIC K_LLANHAPP "LLDZanh.-level, falls Generator fehlerhaft ist." VALUE 0x000C1904 TKW_VV_VV_UB 100.0 Def_st_ub_q1 0.0 255.0000 /begin FUNCTION_LIST LLPMCTRL /end FUNCTION_LIST /end CHARACTERISTIC
/begin CHARACTERISTIC K_LLPMAPP "Handapplikationswert für Leerlaufdrehzahlvorgabe" VALUE 0x000C1905 TKW_VV_VV_UB 100.0 Def_st_ub_q1 0.0 255.0000 /begin FUNCTION_LIST LLPMCTRL /end FUNCTION_LIST /end CHARACTERISTIC
/begin CHARACTERISTIC S_N_IDLIBS "Schalter zum manuellen Setzen von LL aktiv" VALUE 0x000C1906 TKW_VV_VV_UB 100.0 Identity 0.0 1.0000 /begin FUNCTION_LIST LLPMCTRL /end FUNCTION_LIST /end CHARACTERISTIC
/begin CHARACTERISTIC K_NSUBO "N_soll bei Batterieladebilanz zu niedrig" VALUE 0x000C1908 TKW_VV_VV_SW 100.0 Def_n_sw_q1p0 0.0 32767.0000 /begin FUNCTION_LIST LLRANH /end FUNCTION_LIST /end CHARACTERISTIC
/begin CHARACTERISTIC K_NSUBU "N_soll bei Ladebilanz iO" VALUE 0x000C190A TKW_VV_VV_SW 100.0 Def_n_sw_q1p0 0.0 32767.0000 /begin FUNCTION_LIST LLRANH /end FUNCTION_LIST /end CHARACTERISTIC
/begin CHARACTERISTIC K_APP_LLAH "Kennwert zum Umschalten auf Applikationskonstante" VALUE 0x000C190C TKW_VV_VV_UB 100.0 Def_st_ub_q1 0.0 255.0000 /begin FUNCTION_LIST LLRANH /end FUNCTION_LIST /end CHARACTERISTIC
/begin CHARACTERISTIC K_GENLLAHAPP "Applikationskonstente zum Setzen B_idlespec" VALUE 0x000C190D TKW_VV_VV_UB 100.0 Def_st_ub_q1 0.0 255.0000 /begin FUNCTION_LIST LLRANH /end FUNCTION_LIST /end CHARACTERISTIC
/begin CHARACTERISTIC K_NKW_SCH "" VALUE 0x000C190E TKW_VV_VV_SW 100.0 Def_n_sw_q1p0 0.0 32767.0000 /begin FUNCTION_LIST LOADRESP /end FUNCTION_LIST /end CHARACTERISTIC
/begin CHARACTERISTIC K_DSOCMIN "" VALUE 0x000C1910 TKW_VV_VV_SW 100.0 Def_f_sw_b100 -100.0000 99.9969 /begin FUNCTION_LIST LOADRESP /end FUNCTION_LIST FORMAT "%6.3" /end CHARACTERISTIC
/begin CHARACTERISTIC K_MDGNHYS "Hysterese für Drehzahlschwelle Generator-Maximalmomentbegrenzung" VALUE 0x000C1912 TKW_VV_VV_SW 100.0 Def_n_sw_q1p0 -32768.0000 32767.0000 /begin FUNCTION_LIST LOADRESP /end FUNCTION_LIST /end CHARACTERISTIC
/begin CHARACTERISTIC K_MDGNMAX "Maximaldrehzahl für Generator-Maximalmomentbegrenzung" VALUE 0x000C1914 TKW_VV_VV_SW 100.0 Def_n_sw_q1p0 -32768.0000 32767.0000 /begin FUNCTION_LIST LOADRESP /end FUNCTION_LIST /end CHARACTERISTIC
/begin CHARACTERISTIC K_MGMAXAPP "Applikationswert Genratormaximalmoment" VALUE 0x000C1916 TKW_VV_VV_SW 100.0 Def_m_sw_q0p1 -3276.8000 3276.7000 /begin FUNCTION_LIST LOADRESP /end FUNCTION_LIST FORMAT "%5.2" /end CHARACTERISTIC
/begin CHARACTERISTIC K_NGENOFMN "" VALUE 0x000C1918 TKW_VV_VV_SW 100.0 Def_n_sw_q1p0 -32768.0000 32767.0000 /begin FUNCTION_LIST LOADRESP /end FUNCTION_LIST /end CHARACTERISTIC
/begin CHARACTERISTIC K_NGENOFMX "" VALUE 0x000C191A TKW_VV_VV_SW 100.0 Def_n_sw_q1p0 -32768.0000 32767.0000 /begin FUNCTION_LIST LOADRESP /end FUNCTION_LIST /end CHARACTERISTIC
/begin CHARACTERISTIC K_NMXGENOF "Motordrehzahlschwelle für Generatorzuschaltung" VALUE 0x000C191C TKW_VV_VV_SW 100.0 Def_n_sw_q1p0 -32768.0000 32767.0000 /begin FUNCTION_LIST LOADRESP /end FUNCTION_LIST /end CHARACTERISTIC
/begin CHARACTERISTIC K_RLMXGENOF "relative Luftfüllungschwelle für Generatorzuschaltung" VALUE 0x000C191E TKW_VV_VV_SW 100.0 Def_rf_sw_q0p01 -327.6800 327.6700 /begin FUNCTION_LIST LOADRESP /end FUNCTION_LIST FORMAT "%7.4" /end CHARACTERISTIC
/begin CHARACTERISTIC K_TATMGENOF "Motordrehzahlschwelle  Katalysatortemperatur" VALUE 0x000C1920 TKW_VV_VV_SW 100.0 Def_t_sw_q0p1 -3276.8000 3276.7000 /begin FUNCTION_LIST LOADRESP /end FUNCTION_LIST FORMAT "%4.1" /end CHARACTERISTIC
/begin CHARACTERISTIC K_TGENOFMN "" VALUE 0x000C1922 TKW_VV_VV_SW 100.0 Def_t_sw_q0p01 -327.6800 327.6700 /begin FUNCTION_LIST LOADRESP /end FUNCTION_LIST FORMAT "%5.2" /end CHARACTERISTIC
/begin CHARACTERISTIC K_TGENOFMX "" VALUE 0x000C1924 TKW_VV_VV_SW 100.0 Def_t_sw_q0p01 -327.6800 327.6700 /begin FUNCTION_LIST LOADRESP /end FUNCTION_LIST FORMAT "%5.2" /end CHARACTERISTIC
/begin CHARACTERISTIC K_TMOTABGNMN "minimale Motorabstelltemperatur für Generatorreduzierung" VALUE 0x000C1926 TKW_VV_VV_SW 100.0 Def_t_sw_q0p01 -327.6800 327.6700 /begin FUNCTION_LIST LOADRESP /end FUNCTION_LIST FORMAT "%5.2" /end CHARACTERISTIC
/begin CHARACTERISTIC K_TUMGGNMN "minimale Umgebungstemperatur für Generatorreduzierung" VALUE 0x000C1928 TKW_VV_VV_SW 100.0 Def_t_sw_q0p1 -3276.8000 3276.7000 /begin FUNCTION_LIST LOADRESP /end FUNCTION_LIST FORMAT "%4.1" /end CHARACTERISTIC
/begin CHARACTERISTIC K_TUMGGNMX "maximale Umgebungstemperatur für Generatorreduzierung" VALUE 0x000C192A TKW_VV_VV_SW 100.0 Def_t_sw_q0p1 -3276.8000 3276.7000 /begin FUNCTION_LIST LOADRESP /end FUNCTION_LIST FORMAT "%4.1" /end CHARACTERISTIC
/begin CHARACTERISTIC K_PUGENOFMN "" VALUE 0x000C192C TKW_VV_VV_UW 100.0 Def_p_uw_q0p039 0.0 2559.9609 /begin FUNCTION_LIST LOADRESP /end FUNCTION_LIST FORMAT "%5.2" /end CHARACTERISTIC
/begin CHARACTERISTIC K_PUGENOFMX "" VALUE 0x000C192E TKW_VV_VV_UW 100.0 Def_p_uw_q0p039 0.0 2559.9609 /begin FUNCTION_LIST LOADRESP /end FUNCTION_LIST FORMAT "%5.2" /end CHARACTERISTIC
/begin CHARACTERISTIC K_TABSTGNMN "minimale Abstellzeit für Generatorreduzierung" VALUE 0x000C1930 TKW_VV_VV_UW 100.0 Def_st_uw_q1 0.0 65535.0000 /begin FUNCTION_LIST LOADRESP /end FUNCTION_LIST /end CHARACTERISTIC
/begin CHARACTERISTIC K_TABSTGNMX "maximale Abstellzeit für Generatorreduzierung" VALUE 0x000C1932 TKW_VV_VV_UW 100.0 Def_st_uw_q1 0.0 65535.0000 /begin FUNCTION_LIST LOADRESP /end FUNCTION_LIST /end CHARACTERISTIC
/begin CHARACTERISTIC K_VGENOFMN "Geschwindigkeitgeneratorabschaltschwelle bei Vollastbeschleunigung" VALUE 0x000C1934 TKW_VV_VV_UW 100.0 Def_v_uw_q1p0 0.0 65535.0000 /begin FUNCTION_LIST LOADRESP /end FUNCTION_LIST /end CHARACTERISTIC
/begin CHARACTERISTIC K_VGENOGMX "Geschwindigkeitgeneratorzuschaltschwelle bei Vollastbeschleunigung" VALUE 0x000C1936 TKW_VV_VV_UW 100.0 Def_v_uw_q1p0 0.0 65535.0000 /begin FUNCTION_LIST LOADRESP /end FUNCTION_LIST /end CHARACTERISTIC
/begin CHARACTERISTIC K_VZLORESOFV "Geschwindigkeitsschwelle für Generatorzuschaltung" VALUE 0x000C1938 TKW_VV_VV_UW 100.0 Def_v_uw_q1p0 0.0 65535.0000 /begin FUNCTION_LIST LOADRESP /end FUNCTION_LIST /end CHARACTERISTIC
/begin CHARACTERISTIC CW_BNS_LR "" VALUE 0x000C193A TKW_VV_VV_UB 100.0 Def_st_ub_q1 0.0 1.0000 /begin FUNCTION_LIST LOADRESP /end FUNCTION_LIST /end CHARACTERISTIC
/begin CHARACTERISTIC K_BGAPP "Applikationswert Generatorbegrenzung über Maximalmoment" VALUE 0x000C193B TKW_VV_VV_UB 100.0 Identity 0.0 1.0000 /begin FUNCTION_LIST LOADRESP /end FUNCTION_LIST /end CHARACTERISTIC
/begin CHARACTERISTIC K_ENAPPLGOFF "Enable Generatorauschaltsteuerung" VALUE 0x000C193C TKW_VV_VV_UB 100.0 Def_st_ub_q1 0.0 255.0000 /begin FUNCTION_LIST LOADRESP /end FUNCTION_LIST /end CHARACTERISTIC
/begin CHARACTERISTIC K_ENAPPLRESP "Enable Handsteuerung Loadresponse" VALUE 0x000C193D TKW_VV_VV_UB 100.0 Def_st_ub_q1 0.0 255.0000 /begin FUNCTION_LIST LOADRESP /end FUNCTION_LIST /end CHARACTERISTIC
/begin CHARACTERISTIC K_FHOGNMN "minimaler Wichtungsfaktor fuer minimale HFM-Luftmassen Schwelle in Abhaengigkeit von d.Hoehe fuer Generatorreduzierung" VALUE 0x000C193E TKW_VV_VV_UB 100.0 Def_f_ub_b4 0.0 3.9843 /begin FUNCTION_LIST LOADRESP /end FUNCTION_LIST /end CHARACTERISTIC
/begin CHARACTERISTIC K_LRBNS "" VALUE 0x000C193F TKW_VV_VV_UB 100.0 Def_td_ub_q0p1 0.0 25.5000 /begin FUNCTION_LIST LOADRESP /end FUNCTION_LIST /end CHARACTERISTIC
/begin CHARACTERISTIC K_LRESPAPP "Load-Response Applikation" VALUE 0x000C1940 TKW_VV_VV_UB 100.0 Def_td_ub_q0p1 0.0 25.5000 /begin FUNCTION_LIST LOADRESP /end FUNCTION_LIST /end CHARACTERISTIC
/begin CHARACTERISTIC K_LRMAXG "" VALUE 0x000C1941 TKW_VV_VV_UB 100.0 Def_td_ub_q0p1 0.0 25.5000 /begin FUNCTION_LIST LOADRESP /end FUNCTION_LIST /end CHARACTERISTIC
/begin CHARACTERISTIC K_TGENOFFDIS "" VALUE 0x000C1942 TKW_VV_VV_UB 100.0 Def_dez_ub_q1 0.0 255.0000 /begin FUNCTION_LIST LOADRESP /end FUNCTION_LIST /end CHARACTERISTIC
/begin CHARACTERISTIC K_TGENOFVL "Generatorsabschaltzeit bei Vollastbeschleunigung" VALUE 0x000C1943 TKW_VV_VV_UB 100.0 Def_dez_ub_q1 0.0 255.0000 /begin FUNCTION_LIST LOADRESP /end FUNCTION_LIST /end CHARACTERISTIC
/begin CHARACTERISTIC K_TLORESPST "Startloadresponse" VALUE 0x000C1944 TKW_VV_VV_UB 100.0 Def_td_ub_q0p1 0.0 25.5000 /begin FUNCTION_LIST LOADRESP /end FUNCTION_LIST /end CHARACTERISTIC
/begin CHARACTERISTIC K_TVLOFHYST "Hysterese Generatorvollastabschaltung" VALUE 0x000C1945 TKW_VV_VV_UB 100.0 Def_dez_ub_q1 0.0 255.0000 /begin FUNCTION_LIST LOADRESP /end FUNCTION_LIST /end CHARACTERISTIC
/begin CHARACTERISTIC S_LORESLL "Schalter Kennlinienausschaltzeit " VALUE 0x000C1946 TKW_VV_VV_UB 100.0 Identity 0.0 1.0000 /begin FUNCTION_LIST LOADRESP /end FUNCTION_LIST /end CHARACTERISTIC
/begin CHARACTERISTIC S_MGAPP "Schalter für Applikationswert Genratormaximalmoment" VALUE 0x000C1947 TKW_VV_VV_UB 100.0 Identity 0.0 1.0000 /begin FUNCTION_LIST LOADRESP /end FUNCTION_LIST /end CHARACTERISTIC
/begin CHARACTERISTIC S_SAPP "Schalter für Applikationswert Begrenzungsstrategie" VALUE 0x000C1948 TKW_VV_VV_UB 100.0 Identity 0.0 1.0000 /begin FUNCTION_LIST LOADRESP /end FUNCTION_LIST /end CHARACTERISTIC
/begin CHARACTERISTIC S_TLACTIV "" VALUE 0x000C1949 TKW_VV_VV_UB 100.0 Identity 0.0 1.0000 /begin FUNCTION_LIST LOADRESP /end FUNCTION_LIST /end CHARACTERISTIC
/begin CHARACTERISTIC S_ULCPGOFF "" VALUE 0x000C194A TKW_VV_VV_UB 100.0 Def_dez_ub_q1 0.0 255.0000 /begin FUNCTION_LIST LOADRESP /end FUNCTION_LIST /end CHARACTERISTIC
/begin CHARACTERISTIC KL_LORESPM "Motorabhängiger Loadresponse-Faktor" CURVE 0x000C194C TKL_SW_VV_UB 100.0 Def_f_ub_b4 0.0 3.9843 /begin FUNCTION_LIST LOADRESP /end FUNCTION_LIST
 /begin AXIS_DESCR STD_AXIS Tmot Def_t_sw_q0p01 6 -327.6800 327.6700 FORMAT "%5.2" /end AXIS_DESCR
/end CHARACTERISTIC
/begin CHARACTERISTIC KF_ZLRRESOFV "Kennfeld Generatorausschaltzeit bei Fahrt" MAP 0x000C1960 TKF_UW_SW_UB 100.0 Def_td_ub_q1 0.0 255.0000 /begin FUNCTION_LIST LOADRESP /end FUNCTION_LIST
 /begin AXIS_DESCR STD_AXIS Tmot_start Def_t_sw_q0p01 4 -327.6800 327.6700 FORMAT "%5.2" /end AXIS_DESCR
 /begin AXIS_DESCR STD_AXIS Km_st Def_km_uw_q10 4 0.0 655350.0000 /end AXIS_DESCR
/end CHARACTERISTIC
/begin CHARACTERISTIC KF_ZLRESOF "Kennfeld Generatorausschaltzeit bei Stillstand" MAP 0x000C1982 TKF_UW_SW_UB 100.0 Def_td_ub_q1 0.0 255.0000 /begin FUNCTION_LIST LOADRESP /end FUNCTION_LIST
 /begin AXIS_DESCR STD_AXIS Tmot_start Def_t_sw_q0p01 4 -327.6800 327.6700 FORMAT "%5.2" /end AXIS_DESCR
 /begin AXIS_DESCR STD_AXIS Km_st Def_km_uw_q10 4 0.0 655350.0000 /end AXIS_DESCR
/end CHARACTERISTIC
/begin CHARACTERISTIC KF_LORESP "Kennfeld Loadresponse ueber Motordrehzahl und rel. Luftmasse" MAP 0x000C19A4 TKF_SW_SW_UB 100.0 Def_td_ub_q0p1 0.0 25.5000 /begin FUNCTION_LIST LOADRESP /end FUNCTION_LIST /begin AXIS_DESCR STD_AXIS Nkw Def_n_sw_q1p0 6 -32768.0000 32767.0000 /end AXIS_DESCR
 /begin AXIS_DESCR STD_AXIS Rf Def_rf_sw_q0p01 6 -327.6800 327.6700 FORMAT "%7.4" /end AXIS_DESCR
/end CHARACTERISTIC
/begin CHARACTERISTIC K_FHYDR "Konstante Fehler Hydraulikpfad" VALUE 0x000C2098 TKW_VV_VV_UL 100.0 Def_f_ul_b262144 0.0 196596.0001 /begin FUNCTION_LIST MANDETEK /end FUNCTION_LIST /end CHARACTERISTIC
/begin CHARACTERISTIC K_FHYDRMAX "Konstante max. Fehler Hydraulikpfad" VALUE 0x000C209C TKW_VV_VV_UL 100.0 Def_f_ul_b262144 0.0 196596.0001 /begin FUNCTION_LIST MANDETEK /end FUNCTION_LIST /end CHARACTERISTIC
/begin CHARACTERISTIC K_FHYDRMIN "Konstante max. Fehler Hydraulikpfad" VALUE 0x000C20A0 TKW_VV_VV_UL 100.0 Def_f_ul_b262144 0.0 196596.0001 /begin FUNCTION_LIST MANDETEK /end FUNCTION_LIST /end CHARACTERISTIC
/begin CHARACTERISTIC K_FLUFT "Konstante Fehler Luftpfad" VALUE 0x000C20A4 TKW_VV_VV_UL 100.0 Def_f_ul_b262144 0.0 262128.0002 /begin FUNCTION_LIST MANDETEK /end FUNCTION_LIST /end CHARACTERISTIC
/begin CHARACTERISTIC K_FLUFTMAX "Konstante max. Fehler lUFTpfad" VALUE 0x000C20A8 TKW_VV_VV_UL 100.0 Def_f_ul_b262144 0.0 262128.0002 /begin FUNCTION_LIST MANDETEK /end FUNCTION_LIST /end CHARACTERISTIC
/begin CHARACTERISTIC K_FLUFTMIN "Konstante mIN. Fehler lUFTpfad" VALUE 0x000C20AC TKW_VV_VV_UL 100.0 Def_f_ul_b262144 0.0 262128.0002 /begin FUNCTION_LIST MANDETEK /end FUNCTION_LIST /end CHARACTERISTIC
/begin CHARACTERISTIC K_MEMAX "Konstante maximale Einspritzmasse" VALUE 0x000C19E2 TKW_VV_VV_SW 100.0 Def_me_sw_q0p01 0.0 327.6700 /begin FUNCTION_LIST MANDETEK /end FUNCTION_LIST FORMAT "%6.3" /end CHARACTERISTIC
/begin CHARACTERISTIC K_MEMIN "Konstante minimale Einspritzmasse" VALUE 0x000C19E4 TKW_VV_VV_SW 100.0 Def_me_sw_q0p01 0.0 327.6700 /begin FUNCTION_LIST MANDETEK /end FUNCTION_LIST FORMAT "%6.3" /end CHARACTERISTIC
/begin CHARACTERISTIC K_MLMAX "Konstante maximale Luftmasse pro Zylinder" VALUE 0x000C19E6 TKW_VV_VV_SW 100.0 Def_ml_sw_q0p1 0.0 3276.7000 /begin FUNCTION_LIST MANDETEK /end FUNCTION_LIST FORMAT "%5.2" /end CHARACTERISTIC
/begin CHARACTERISTIC K_MLMIN "Konstante minimale Luftmasse pro Zylinder" VALUE 0x000C19E8 TKW_VV_VV_SW 100.0 Def_ml_sw_q0p1 0.0 3276.7000 /begin FUNCTION_LIST MANDETEK /end FUNCTION_LIST FORMAT "%5.2" /end CHARACTERISTIC
/begin CHARACTERISTIC K_NKWMIN "Konstante Motordrehzahlschwelle Manipulationserkennung" VALUE 0x000C19EA TKW_VV_VV_SW 100.0 Def_n_sw_q1p0 -32768.0000 32767.0000 /begin FUNCTION_LIST MANDETEK /end FUNCTION_LIST /end CHARACTERISTIC
/begin CHARACTERISTIC K_PLDMAX "Konstante maximalr Ladedruck" VALUE 0x000C19EC TKW_VV_VV_SW 100.0 Def_p_sw_q1 0.0 32767.0000 /begin FUNCTION_LIST MANDETEK /end FUNCTION_LIST FORMAT "%4.1" /end CHARACTERISTIC
/begin CHARACTERISTIC K_PLDMIN "Konstante minimaler Ladedruck" VALUE 0x000C19EE TKW_VV_VV_SW 100.0 Def_p_sw_q1 0.0 32767.0000 /begin FUNCTION_LIST MANDETEK /end FUNCTION_LIST FORMAT "%4.1" /end CHARACTERISTIC
/begin CHARACTERISTIC K_TLUFTMAX "Konstante max. Lufttemperatur" VALUE 0x000C19F0 TKW_VV_VV_SW 100.0 Def_t_sw_q0p01 -327.6800 327.6700 /begin FUNCTION_LIST MANDETEK /end FUNCTION_LIST FORMAT "%5.2" /end CHARACTERISTIC
/begin CHARACTERISTIC K_TLUFTMIN "Konstante min. Lufttemperatur" VALUE 0x000C19F2 TKW_VV_VV_SW 100.0 Def_t_sw_q0p01 -327.6800 327.6700 /begin FUNCTION_LIST MANDETEK /end FUNCTION_LIST FORMAT "%5.2" /end CHARACTERISTIC
/begin CHARACTERISTIC K_TVAGRMAX "Konstante maximales Tastverhältnis AGR-Steller" VALUE 0x000C19F4 TKW_VV_VV_SW 100.0 Def_tv_sw_q0p01 0.0 327.6700 /begin FUNCTION_LIST MANDETEK /end FUNCTION_LIST FORMAT "%6.3" /end CHARACTERISTIC
/begin CHARACTERISTIC K_TVAGRMIN "Konstante minimales Tastverhältnis AGR-Steller" VALUE 0x000C19F6 TKW_VV_VV_SW 100.0 Def_tv_sw_q0p01 0.0 327.6700 /begin FUNCTION_LIST MANDETEK /end FUNCTION_LIST FORMAT "%6.3" /end CHARACTERISTIC
/begin CHARACTERISTIC K_TVPLDMAX "Konstante maximales Tastverhältnis Ladedrucksteller" VALUE 0x000C19F8 TKW_VV_VV_SW 100.0 Def_tv_sw_q0p01 0.0 327.6700 /begin FUNCTION_LIST MANDETEK /end FUNCTION_LIST FORMAT "%6.3" /end CHARACTERISTIC
/begin CHARACTERISTIC K_TVPLDMIN "Konstante minimales Tastverhältnis Ladedrucksteller" VALUE 0x000C19FA TKW_VV_VV_SW 100.0 Def_tv_sw_q0p01 0.0 327.6700 /begin FUNCTION_LIST MANDETEK /end FUNCTION_LIST FORMAT "%6.3" /end CHARACTERISTIC
/begin CHARACTERISTIC K_TWASSERMAX "Konstante max. Wassertemperatur" VALUE 0x000C19FC TKW_VV_VV_SW 100.0 Def_t_sw_q0p01 -327.6800 327.6700 /begin FUNCTION_LIST MANDETEK /end FUNCTION_LIST FORMAT "%5.2" /end CHARACTERISTIC
/begin CHARACTERISTIC K_TWASSERMIN "Konstante min. Wassertemperatur" VALUE 0x000C19FE TKW_VV_VV_SW 100.0 Def_t_sw_q0p01 -327.6800 327.6700 /begin FUNCTION_LIST MANDETEK /end FUNCTION_LIST FORMAT "%5.2" /end CHARACTERISTIC
/begin CHARACTERISTIC K_WPEDMIN "Konstante Pedalwertgeber Manipulationserkennung" VALUE 0x000C1A00 TKW_VV_VV_SW 100.0 Def_tv_sw_q0p0244 -800.0000 799.9755 /begin FUNCTION_LIST MANDETEK /end FUNCTION_LIST FORMAT "%5.2" /end CHARACTERISTIC
/begin CHARACTERISTIC K_LAMAX "Konstante maximales Lambda" VALUE 0x000C1A02 TKW_VV_VV_UW 100.0 Def_f_uw_b16 0.0 15.9997 /begin FUNCTION_LIST MANDETEK /end FUNCTION_LIST FORMAT "%7.4" /end CHARACTERISTIC
/begin CHARACTERISTIC K_LAMIN "Konstante minimales Lambda" VALUE 0x000C1A04 TKW_VV_VV_UW 100.0 Def_f_uw_b16 0.0 15.9997 /begin FUNCTION_LIST MANDETEK /end FUNCTION_LIST FORMAT "%7.4" /end CHARACTERISTIC
/begin CHARACTERISTIC K_PUMIN "Konstante min. Umgebungsdruck" VALUE 0x000C1A06 TKW_VV_VV_UW 100.0 Def_p_uw_q0p039 0.0 2559.9609 /begin FUNCTION_LIST MANDETEK /end FUNCTION_LIST FORMAT "%5.2" /end CHARACTERISTIC
/begin CHARACTERISTIC K_FIDMANHYDR "Konstante Funktionsidentifier Mandetek Hydraulikpfad" VALUE 0x000C20B0 TKW_VV_VV_UB 100.0 Def_dez_ub_q1 0.0 255.0000 /begin FUNCTION_LIST MANDETEK /end FUNCTION_LIST /end CHARACTERISTIC
/begin CHARACTERISTIC K_FIDMANLUFT "Konstante Funktionsidentifier Mandetek Luftpfad" VALUE 0x000C20B1 TKW_VV_VV_UB 100.0 Def_dez_ub_q1 0.0 255.0000 /begin FUNCTION_LIST MANDETEK /end FUNCTION_LIST /end CHARACTERISTIC
/begin CHARACTERISTIC K_FLAGEW "Konstante Lambdagewichtung" VALUE 0x000C20B2 TKW_VV_VV_UB 100.0 Def_f_ub_b1 0.0 0.9960 /begin FUNCTION_LIST MANDETEK /end FUNCTION_LIST /end CHARACTERISTIC
/begin CHARACTERISTIC K_FLAISTMAX "Faktor La_ist max" VALUE 0x000C20B3 TKW_VV_VV_UB 100.0 Def_f_ub_b2 0.0 1.9921 /begin FUNCTION_LIST MANDETEK /end FUNCTION_LIST /end CHARACTERISTIC
/begin CHARACTERISTIC K_FLAISTMIN "Faktor La_ist min" VALUE 0x000C20B4 TKW_VV_VV_UB 100.0 Def_f_ub_b2 0.0 1.9921 /begin FUNCTION_LIST MANDETEK /end FUNCTION_LIST /end CHARACTERISTIC
/begin CHARACTERISTIC K_FMEISTMAX "Faktor Me_ist max" VALUE 0x000C20B5 TKW_VV_VV_UB 100.0 Def_f_ub_b2 0.0 1.9921 /begin FUNCTION_LIST MANDETEK /end FUNCTION_LIST /end CHARACTERISTIC
/begin CHARACTERISTIC K_FMEISTMIN "Faktor Me_ist min" VALUE 0x000C20B6 TKW_VV_VV_UB 100.0 Def_f_ub_b2 0.0 1.9921 /begin FUNCTION_LIST MANDETEK /end FUNCTION_LIST /end CHARACTERISTIC
/begin CHARACTERISTIC K_FMLMAX "Faktor Ml max" VALUE 0x000C20B7 TKW_VV_VV_UB 100.0 Def_f_ub_b2 0.0 1.9921 /begin FUNCTION_LIST MANDETEK /end FUNCTION_LIST /end CHARACTERISTIC
/begin CHARACTERISTIC K_FMLMIN "Faktor Ml min" VALUE 0x000C20B8 TKW_VV_VV_UB 100.0 Def_f_ub_b2 0.0 1.9921 /begin FUNCTION_LIST MANDETEK /end FUNCTION_LIST /end CHARACTERISTIC
/begin CHARACTERISTIC K_FPLDMAX "Faktor Pld max" VALUE 0x000C20B9 TKW_VV_VV_UB 100.0 Def_f_ub_b2 0.0 1.9921 /begin FUNCTION_LIST MANDETEK /end FUNCTION_LIST /end CHARACTERISTIC
/begin CHARACTERISTIC K_FPLDMIN "Faktor Pld min" VALUE 0x000C20BA TKW_VV_VV_UB 100.0 Def_f_ub_b2 0.0 1.9921 /begin FUNCTION_LIST MANDETEK /end FUNCTION_LIST /end CHARACTERISTIC
/begin CHARACTERISTIC K_FTVAGRMAX "Faktor Tvagr max" VALUE 0x000C20BB TKW_VV_VV_UB 100.0 Def_f_ub_b2 0.0 1.9921 /begin FUNCTION_LIST MANDETEK /end FUNCTION_LIST /end CHARACTERISTIC
/begin CHARACTERISTIC K_FTVAGRMIN "Faktor Tvagr min" VALUE 0x000C20BC TKW_VV_VV_UB 100.0 Def_f_ub_b2 0.0 1.9921 /begin FUNCTION_LIST MANDETEK /end FUNCTION_LIST /end CHARACTERISTIC
/begin CHARACTERISTIC K_FTVPLDMAX "Faktor Tvpldmax" VALUE 0x000C20BD TKW_VV_VV_UB 100.0 Def_f_ub_b2 0.0 1.9921 /begin FUNCTION_LIST MANDETEK /end FUNCTION_LIST /end CHARACTERISTIC
/begin CHARACTERISTIC K_FTVPLDMIN "Faktor Tvpld min" VALUE 0x000C20BE TKW_VV_VV_UB 100.0 Def_f_ub_b2 0.0 1.9921 /begin FUNCTION_LIST MANDETEK /end FUNCTION_LIST /end CHARACTERISTIC
/begin CHARACTERISTIC K_LERNRATE "s" VALUE 0x000C20BF TKW_VV_VV_UB 100.0 Def_f_ub_b1 0.0 0.9960 /begin FUNCTION_LIST MANDETEK /end FUNCTION_LIST /end CHARACTERISTIC
/begin CHARACTERISTIC K_SOM "Konstante lernen SOM aktivieren" VALUE 0x000C20C0 TKW_VV_VV_UB 100.0 Def_dez_ub_q1 0.0 255.0000 /begin FUNCTION_LIST MANDETEK /end FUNCTION_LIST /end CHARACTERISTIC
/begin CHARACTERISTIC K_GHYDRME "Kennwerteblock für Gewicht Hydraulikpfad Me_ist" VAL_BLK 0x000C1A08 TKW_VV_VV_SW 100.0 Def_me_sw_q0p01 0.0 327.6700 /begin FUNCTION_LIST MANDETEK /end FUNCTION_LIST NUMBER 120 FORMAT "%6.3" /end CHARACTERISTIC
/begin CHARACTERISTIC K_GHYDRML "Kennwerteblock für Gewicht Hydraulikpfad Ml" VAL_BLK 0x000C1AF8 TKW_VV_VV_SW 100.0 Def_ml_sw_q0p1 0.0 3276.7000 /begin FUNCTION_LIST MANDETEK /end FUNCTION_LIST NUMBER 120 FORMAT "%5.2" /end CHARACTERISTIC
/begin CHARACTERISTIC K_GLUFTML "Kennwerteblock für Gewicht Luftpfad Ml" VAL_BLK 0x000C1BE8 TKW_VV_VV_SW 100.0 Def_ml_sw_q0p1 0.0 3276.7000 /begin FUNCTION_LIST MANDETEK /end FUNCTION_LIST NUMBER 120 FORMAT "%5.2" /end CHARACTERISTIC
/begin CHARACTERISTIC K_GLUFTPLD "Kennwerteblock für Gewicht Luftpfad Pld" VAL_BLK 0x000C1CD8 TKW_VV_VV_SW 100.0 Def_p_sw_q1 0.0 32767.0000 /begin FUNCTION_LIST MANDETEK /end FUNCTION_LIST NUMBER 120 FORMAT "%4.1" /end CHARACTERISTIC
/begin CHARACTERISTIC K_GLUFTTVAGR "Kennwerteblock für Gewicht Luftpfad Tastverhältnis Agr" VAL_BLK 0x000C1DC8 TKW_VV_VV_SW 100.0 Def_tv_sw_q0p01 0.0 327.6700 /begin FUNCTION_LIST MANDETEK /end FUNCTION_LIST NUMBER 120 FORMAT "%6.3" /end CHARACTERISTIC
/begin CHARACTERISTIC K_GLUFTTVPLD "Kennwerteblock für Gewicht Luftpfad Tastverhältnis Pld" VAL_BLK 0x000C1EB8 TKW_VV_VV_SW 100.0 Def_tv_sw_q0p01 0.0 327.6700 /begin FUNCTION_LIST MANDETEK /end FUNCTION_LIST NUMBER 120 FORMAT "%6.3" /end CHARACTERISTIC
/begin CHARACTERISTIC K_GHYDRLA "Kennwerteblock für Gewicht Hydraulikpfad La_ist1" VAL_BLK 0x000C1FA8 TKW_VV_VV_UW 100.0 Def_f_uw_b16 0.0 15.9997 /begin FUNCTION_LIST MANDETEK /end FUNCTION_LIST NUMBER 120 FORMAT "%7.4" /end CHARACTERISTIC
/begin CHARACTERISTIC KL_TWLUFT "Kennlinie Tuningwahrscheinlichkeit Luft" CURVE 0x000C20C2 TKL_UW_VV_UW 100.0 Def_f_uw_b100 0.0 99.9984 /begin FUNCTION_LIST MANDETEK /end FUNCTION_LIST /begin AXIS_DESCR STD_AXIS Twluftcnt Def_dez_uw_q1 8 0.0 65535.0000 /end AXIS_DESCR FORMAT "%6.3" /end CHARACTERISTIC
/begin CHARACTERISTIC KL_TWHYDR "Kennlinie Tuningwahrscheinlichkeit Hydraulik" CURVE 0x000C20E4 TKL_UW_VV_UW 100.0 Def_f_uw_b100 0.0 99.9984 /begin FUNCTION_LIST MANDETEK /end FUNCTION_LIST /begin AXIS_DESCR STD_AXIS Twhydrcnt Def_dez_uw_q1 8 0.0 65535.0000 /end AXIS_DESCR FORMAT "%6.3" /end CHARACTERISTIC
/begin CHARACTERISTIC KF_TW "Kennfeld Tuningwahrscheinlichkeit" MAP 0x000C2106 TKF_UW_UW_UW 100.0 Def_f_uw_b100 0.0 99.9984 /begin FUNCTION_LIST MANDETEK /end FUNCTION_LIST /begin AXIS_DESCR STD_AXIS Twhydr Def_f_uw_b100 6 0.0 99.9984 FORMAT "%6.3" /end AXIS_DESCR /begin AXIS_DESCR STD_AXIS Twluft Def_f_uw_b100 6 0.0 99.9984 FORMAT "%6.3" /end AXIS_DESCR FORMAT "%6.3" /end CHARACTERISTIC
/begin CHARACTERISTIC K_OZORLIM2 "Schwelle für Orientierungswert Ölniveau (Verlustwarnung)" VALUE 0x000C2168 TKW_VV_VV_UB 100.0 Def_niv_ub_b75 0.0 74.7070 /begin FUNCTION_LIST OZBG /end FUNCTION_LIST /end CHARACTERISTIC
/begin CHARACTERISTIC K_OZLANGLIM1 "Schwelle für langen Mittelwert Ölniveau (Vebrauchswarnung)" VALUE 0x000C2169 TKW_VV_VV_UB 100.0 Def_niv_ub_b75 0.0 74.7070 /begin FUNCTION_LIST OZBG /end FUNCTION_LIST /end CHARACTERISTIC
/begin CHARACTERISTIC K_OZLANGLIM2 "Schwelle für langen Mittelwert Ölniveau (Verlustwarnung)" VALUE 0x000C216A TKW_VV_VV_UB 100.0 Def_niv_ub_b75 0.0 74.7070 /begin FUNCTION_LIST OZBG /end FUNCTION_LIST /end CHARACTERISTIC
/begin CHARACTERISTIC K_OZLIM1HEAL "Schwelle für Rücknahme der Ölniveauwarnung Verbrauch" VALUE 0x000C216B TKW_VV_VV_UB 100.0 Def_niv_ub_b75 0.0 74.7070 /begin FUNCTION_LIST OZBG /end FUNCTION_LIST /end CHARACTERISTIC
/begin CHARACTERISTIC K_OZLIM2HEAL "Schwelle für Rücknahme der Ölniveauwarnung Verlust" VALUE 0x000C216C TKW_VV_VV_UB 100.0 Def_niv_ub_b75 0.0 74.7070 /begin FUNCTION_LIST OZBG /end FUNCTION_LIST /end CHARACTERISTIC
/begin CHARACTERISTIC K_OZVORLIM1 "Schwelle für vorgezogenen Mittelwert Ölniveau (Vebrauchswarnung)" VALUE 0x000C216D TKW_VV_VV_UB 100.0 Def_niv_ub_b75 0.0 74.7070 /begin FUNCTION_LIST OZBG /end FUNCTION_LIST /end CHARACTERISTIC
/begin CHARACTERISTIC K_OZVORLIM2 "Schwelle für vorgezogenen Mittelwert Ölniveau (Verlustwarnung)" VALUE 0x000C216E TKW_VV_VV_UB 100.0 Def_niv_ub_b75 0.0 74.7070 /begin FUNCTION_LIST OZBG /end FUNCTION_LIST /end CHARACTERISTIC
/begin CHARACTERISTIC K_OZZYKCBS "Zeitabstand fürs zyklisch Senden der CBS-Nachricht" VALUE 0x000C216F TKW_VV_VV_UB 100.0 Def_dez_ub_q1 0.0 255.0000 /begin FUNCTION_LIST OZBG /end FUNCTION_LIST /end CHARACTERISTIC
/begin CHARACTERISTIC K_OZKMUPL "" VALUE 0x000C2170 TKW_VV_VV_UW 100.0 Def_km_uw_q10 0.0 655350.0000 /begin FUNCTION_LIST OZGG /end FUNCTION_LIST /end CHARACTERISTIC
/begin CHARACTERISTIC K_OZBZKMSTK1 "Bezugsintervall" VALUE 0x000C2178 TKW_VV_VV_UB 100.0 Def_km_ub_q1000 0.0 255000.0000 /begin FUNCTION_LIST OZGG /end FUNCTION_LIST /end CHARACTERISTIC
/begin CHARACTERISTIC K_OZPERMRMIN "Grenze für Niveauberechnung aus Permittivität" VALUE 0x000C2172 TKW_VV_VV_UW 100.0 Def_dez_uw_q1 0.0 65535.0000 /begin FUNCTION_LIST OZGG /end FUNCTION_LIST /end CHARACTERISTIC
/begin CHARACTERISTIC K_OZPRREFMAX "Maximum für Referenzpermittivität" VALUE 0x000C2174 TKW_VV_VV_UW 100.0 Def_dez_uw_q1 0.0 1024.0000 /begin FUNCTION_LIST OZGG /end FUNCTION_LIST /end CHARACTERISTIC
/begin CHARACTERISTIC K_OZPRREFMIN "Minimum für Referenzpermittivität" VALUE 0x000C2176 TKW_VV_VV_UW 100.0 Def_dez_uw_q1 0.0 1024.0000 /begin FUNCTION_LIST OZGG /end FUNCTION_LIST /end CHARACTERISTIC
/begin CHARACTERISTIC K_OZNIVKL "" VALUE 0x000C2179 TKW_VV_VV_UB 100.0 Def_niv_ub_b75 0.0 74.7070 /begin FUNCTION_LIST OZGG /end FUNCTION_LIST /end CHARACTERISTIC
/begin CHARACTERISTIC K_OZRESBOST "Delay für die Rücksetzung der Tester-Bos-Anforderung" VALUE 0x000C217A TKW_VV_VV_UB 100.0 Def_dez_ub_q1 0.0 255.0000 /begin FUNCTION_LIST OZGG /end FUNCTION_LIST /end CHARACTERISTIC
/begin CHARACTERISTIC K_OZSTZYK "" VALUE 0x000C217B TKW_VV_VV_UB 100.0 Def_dez_ub_q1 0.0 255.0000 /begin FUNCTION_LIST OZGG /end FUNCTION_LIST /end CHARACTERISTIC
/begin CHARACTERISTIC KL_OZPERMKL "Skalierungskennlinie Permittivität" CURVE 0x000C217C TKL_UW_VV_UW 100.0 Def_perm_uw_b6 0.0 5.9999 /begin FUNCTION_LIST OZGG /end FUNCTION_LIST /begin AXIS_DESCR STD_AXIS Oz_permt Def_dez_uw_q1 2 0.0 65535.0000 /end AXIS_DESCR /end CHARACTERISTIC
/begin CHARACTERISTIC KL_OZTEMPKL "" CURVE 0x000C2186 TKL_UW_VV_SW 100.0 Def_t_sw_q0p1 -3276.8000 3276.7000 /begin FUNCTION_LIST OZGG /end FUNCTION_LIST /begin AXIS_DESCR STD_AXIS Oz_tempt Def_dez_uw_q1 2 0.0 65535.0000 /end AXIS_DESCR FORMAT "%4.1" /end CHARACTERISTIC
/begin CHARACTERISTIC K_CW_OZ "" VALUE 0x000C2190 TKW_VV_VV_UW 100.0 Def_dez_uw_q1 0.0 65535.0000 /begin FUNCTION_LIST OZNIVDL /end FUNCTION_LIST /end CHARACTERISTIC
/begin CHARACTERISTIC K_OZNFCNT "Anzahl Werte für Nachfüllerkennung" VALUE 0x000C21C8 TKW_VV_VV_UL 100.0 Def_dez_ul_q1 0.0 4294967295.0000 /begin FUNCTION_LIST OZNIVDL /end FUNCTION_LIST /end CHARACTERISTIC
/begin CHARACTERISTIC K_OZNFTMPMAX "obere Temperaturgrenze für Nachfüllerkennung" VALUE 0x000C2192 TKW_VV_VV_SW 100.0 Def_t_sw_q0p1 -3276.8000 3276.7000 /begin FUNCTION_LIST OZNIVDL /end FUNCTION_LIST FORMAT "%4.1" /end CHARACTERISTIC
/begin CHARACTERISTIC K_OZNFTMPMIN "untere Temperaturgrenze für Nachfüllerkennung" VALUE 0x000C2194 TKW_VV_VV_SW 100.0 Def_t_sw_q0p1 -3276.8000 3276.7000 /begin FUNCTION_LIST OZNIVDL /end FUNCTION_LIST FORMAT "%4.1" /end CHARACTERISTIC
/begin CHARACTERISTIC K_OZNMOTMAX "obere Drehzahlgrenze für drehzahlkorrigierten Niveaumittelwert" VALUE 0x000C2196 TKW_VV_VV_SW 100.0 Def_n_sw_q1p0 -32768.0000 32767.0000 /begin FUNCTION_LIST OZNIVDL /end FUNCTION_LIST /end CHARACTERISTIC
/begin CHARACTERISTIC K_OZNMOTMIN "untere Drehzahlgrenze für drehzahlkorrigierten Niveaumittelwert" VALUE 0x000C2198 TKW_VV_VV_SW 100.0 Def_n_sw_q1p0 -32768.0000 32767.0000 /begin FUNCTION_LIST OZNIVDL /end FUNCTION_LIST /end CHARACTERISTIC
/begin CHARACTERISTIC K_OZTEMPBW "Temperaturschwelle Öltemperatur Motor betriebswarm" VALUE 0x000C219A TKW_VV_VV_SW 100.0 Def_t_sw_q0p1 -3276.8000 3276.7000 /begin FUNCTION_LIST OZNIVDL /end FUNCTION_LIST FORMAT "%4.1" /end CHARACTERISTIC
/begin CHARACTERISTIC K_OZTORMAX "Temperaturschwelle für Orientierungsmessung" VALUE 0x000C219C TKW_VV_VV_SW 100.0 Def_t_sw_q0p1 -3276.8000 3276.7000 /begin FUNCTION_LIST OZNIVDL /end FUNCTION_LIST FORMAT "%4.1" /end CHARACTERISTIC
/begin CHARACTERISTIC K_OZTORMIN "Mindest Temperatur für OrientierungMw QLT" VALUE 0x000C219E TKW_VV_VV_SW 100.0 Def_t_sw_q0p01 -327.6800 327.6700 /begin FUNCTION_LIST OZNIVDL /end FUNCTION_LIST FORMAT "%5.2" /end CHARACTERISTIC
/begin CHARACTERISTIC K_OZVORMV "Korrektur von Vormw für Peilstab" VALUE 0x000C21A0 TKW_VV_VV_SW 100.0 Def_f_sw_b32 -32.0000 31.9990 /begin FUNCTION_LIST OZNIVDL /end FUNCTION_LIST FORMAT "%7.4" /end CHARACTERISTIC
/begin CHARACTERISTIC K_TOGNMAX "" VALUE 0x000C21A2 TKW_VV_VV_SW 100.0 Def_n_sw_q1p0 -32768.0000 32767.0000 /begin FUNCTION_LIST OZNIVDL /end FUNCTION_LIST /end CHARACTERISTIC
/begin CHARACTERISTIC K_TOGNMIN "" VALUE 0x000C21A4 TKW_VV_VV_SW 100.0 Def_n_sw_q1p0 -32768.0000 32767.0000 /begin FUNCTION_LIST OZNIVDL /end FUNCTION_LIST /end CHARACTERISTIC
/begin CHARACTERISTIC K_TOGTMORIMAX "Tmot Schwelle Orientierungsmessung" VALUE 0x000C21A6 TKW_VV_VV_SW 100.0 Def_t_sw_q0p01 -327.6800 327.6700 /begin FUNCTION_LIST OZNIVDL /end FUNCTION_LIST FORMAT "%5.2" /end CHARACTERISTIC
/begin CHARACTERISTIC K_TOGTMORIMIN "Mindest Temperatur für OrientirungMw Töns" VALUE 0x000C21A8 TKW_VV_VV_SW 100.0 Def_t_sw_q0p01 -327.6800 327.6700 /begin FUNCTION_LIST OZNIVDL /end FUNCTION_LIST FORMAT "%5.2" /end CHARACTERISTIC
/begin CHARACTERISTIC K_TOGTMOT "" VALUE 0x000C21AA TKW_VV_VV_SW 100.0 Def_t_sw_q0p01 -327.6800 327.6700 /begin FUNCTION_LIST OZNIVDL /end FUNCTION_LIST FORMAT "%5.2" /end CHARACTERISTIC
/begin CHARACTERISTIC K_OZALTANZABZ "Abstellzeit für die Ausgabe der letzten Anzeige nach dem Ölcheck" VALUE 0x000C21AC TKW_VV_VV_UW 100.0 Def_tn_uw_q1 0.0 65535.0000 /begin FUNCTION_LIST OZNIVDL /end FUNCTION_LIST FORMAT "%5.2" /end CHARACTERISTIC
/begin CHARACTERISTIC K_OZLUFTMAX "Plausibel max luftsprung" VALUE 0x000C21AE TKW_VV_VV_UW 100.0 Def_p_uw_q039 0.0 2559.9609 /begin FUNCTION_LIST OZNIVDL /end FUNCTION_LIST FORMAT "%6.3" /end CHARACTERISTIC
/begin CHARACTERISTIC K_OZMWL "Anzahl der Messwerte für Langzeit-Mittelwert Niveau" VALUE 0x000C21B0 TKW_VV_VV_UW 100.0 Def_dez_uw_q1 0.0 65535.0000 /begin FUNCTION_LIST OZNIVDL /end FUNCTION_LIST /end CHARACTERISTIC
/begin CHARACTERISTIC K_OZMWOR "Anzahl der Messwerte für Orientierungsmessung" VALUE 0x000C21B2 TKW_VV_VV_UW 100.0 Def_dez_uw_q1 0.0 65535.0000 /begin FUNCTION_LIST OZNIVDL /end FUNCTION_LIST /end CHARACTERISTIC
/begin CHARACTERISTIC K_OZMWV "Anzahl der Messwerte für vorgezogenen Mittelwert Niveau" VALUE 0x000C21B4 TKW_VV_VV_UW 100.0 Def_dez_uw_q1 0.0 65535.0000 /begin FUNCTION_LIST OZNIVDL /end FUNCTION_LIST /end CHARACTERISTIC
/begin CHARACTERISTIC K_OZOELCABZ "Minimale Abstellzeit für den ÖlCheck" VALUE 0x000C21B6 TKW_VV_VV_UW 100.0 Def_tn_uw_q1 0.0 65535.0000 /begin FUNCTION_LIST OZNIVDL /end FUNCTION_LIST FORMAT "%5.2" /end CHARACTERISTIC
/begin CHARACTERISTIC K_OZOELVERB "Ölverbrauch" VALUE 0x000C21B8 TKW_VV_VV_UW 100.0 Def_dez_uw_q1 0.0 65535.0000 /begin FUNCTION_LIST OZNIVDL /end FUNCTION_LIST /end CHARACTERISTIC
/begin CHARACTERISTIC K_OZSTMINW "Minimale Strecke für die Steigungserkennung" VALUE 0x000C21BA TKW_VV_VV_UW 100.0 Def_f_uw_b10 0.0 9.9998 /begin FUNCTION_LIST OZNIVDL /end FUNCTION_LIST FORMAT "%7.4" /end CHARACTERISTIC
/begin CHARACTERISTIC K_OZVERBDKM "Delta km für die Ölverbrauch-Berechnung" VALUE 0x000C21BC TKW_VV_VV_UW 100.0 Def_km_uw_q10 0.0 655350.0000 /begin FUNCTION_LIST OZNIVDL /end FUNCTION_LIST /end CHARACTERISTIC
/begin CHARACTERISTIC K_PT1TOEL "Konstant für Lowpass Filter ÖltemperaturTöns" VALUE 0x000C21BE TKW_VV_VV_UW 100.0 Def_f_uw_b100 0.0 99.9984 /begin FUNCTION_LIST OZNIVDL /end FUNCTION_LIST FORMAT "%6.3" /end CHARACTERISTIC
/begin CHARACTERISTIC K_TOGANZ "" VALUE 0x000C21C0 TKW_VV_VV_UW 100.0 Def_dez_uw_q1 1.0000 3000.0000 /begin FUNCTION_LIST OZNIVDL /end FUNCTION_LIST /end CHARACTERISTIC
/begin CHARACTERISTIC K_TOGKURZANZ "" VALUE 0x000C21C2 TKW_VV_VV_UW 100.0 Def_dez_uw_q1 1.0000 1000.0000 /begin FUNCTION_LIST OZNIVDL /end FUNCTION_LIST /end CHARACTERISTIC
/begin CHARACTERISTIC K_TOGSTARTVERZ "Töns Start Verzögerung nach Drehzal" VALUE 0x000C21C4 TKW_VV_VV_UW 100.0 Def_dez_uw_q1 0.0 65535.0000 /begin FUNCTION_LIST OZNIVDL /end FUNCTION_LIST /end CHARACTERISTIC
/begin CHARACTERISTIC K_TRTYP "" VALUE 0x000C21C6 TKW_VV_VV_UW 100.0 Def_td_uw_q0p01 0.0 655.3500 /begin FUNCTION_LIST OZNIVDL /end FUNCTION_LIST FORMAT "%5.2" /end CHARACTERISTIC
/begin CHARACTERISTIC K_OZLBESCHN "Negative Längsbeschleunigung Ausblendung-Schwelle " VALUE 0x000C21CC TKW_VV_VV_SB 100.0 Def_ac_sb_q0p25 -32.0000 31.7500 /begin FUNCTION_LIST OZNIVDL /end FUNCTION_LIST /end CHARACTERISTIC
/begin CHARACTERISTIC K_OZLBESCHP "Positive Längsbeschleunigung Ausblendung-Schwelle " VALUE 0x000C21CD TKW_VV_VV_SB 100.0 Def_ac_sb_q0p25 -32.0000 31.7500 /begin FUNCTION_LIST OZNIVDL /end FUNCTION_LIST /end CHARACTERISTIC
/begin CHARACTERISTIC K_OZLBESCHS "Längsbeschleunigung Ausblendung-Schwelle im Stand" VALUE 0x000C21CE TKW_VV_VV_SB 100.0 Def_ac_sb_q0p25 -32.0000 31.7500 /begin FUNCTION_LIST OZNIVDL /end FUNCTION_LIST /end CHARACTERISTIC
/begin CHARACTERISTIC K_OZQBESCHN "Negative Querbeschleunigung Ausblendung-Schwelle " VALUE 0x000C21CF TKW_VV_VV_SB 100.0 Def_ac_sb_q0p25 -32.0000 31.7500 /begin FUNCTION_LIST OZNIVDL /end FUNCTION_LIST /end CHARACTERISTIC
/begin CHARACTERISTIC K_OZQBESCHP "Positive Querbeschleunigung Ausblendung-Schwelle " VALUE 0x000C21D0 TKW_VV_VV_SB 100.0 Def_ac_sb_q0p25 -32.0000 31.7500 /begin FUNCTION_LIST OZNIVDL /end FUNCTION_LIST /end CHARACTERISTIC
/begin CHARACTERISTIC K_OZQBESCHS "Querbeschleunigung Ausblendung-Schwelle im Stand" VALUE 0x000C21D1 TKW_VV_VV_SB 100.0 Def_ac_sb_q0p25 -32.0000 31.7500 /begin FUNCTION_LIST OZNIVDL /end FUNCTION_LIST /end CHARACTERISTIC
/begin CHARACTERISTIC K_DOLNIV "Hysteresis Töns oelverb und oelverl" VALUE 0x000C21D2 TKW_VV_VV_UB 100.0 Def_td_ub_q0p5 0.0 127.5000 /begin FUNCTION_LIST OZNIVDL /end FUNCTION_LIST /end CHARACTERISTIC
/begin CHARACTERISTIC K_NACHFUELL12 "Nachfüll Erste Balken von Peistab" VALUE 0x000C21D3 TKW_VV_VV_UB 100.0 Def_dez_ub_q1 0.0 255.0000 /begin FUNCTION_LIST OZNIVDL /end FUNCTION_LIST /end CHARACTERISTIC
/begin CHARACTERISTIC K_NACHFUELL25 "Nachfüll Zweite Balken von Peistab" VALUE 0x000C21D4 TKW_VV_VV_UB 100.0 Def_dez_ub_q1 0.0 255.0000 /begin FUNCTION_LIST OZNIVDL /end FUNCTION_LIST /end CHARACTERISTIC
/begin CHARACTERISTIC K_NACHFUELL38 "Nachfüll Dritte Balken von Peistab" VALUE 0x000C21D5 TKW_VV_VV_UB 100.0 Def_dez_ub_q1 0.0 255.0000 /begin FUNCTION_LIST OZNIVDL /end FUNCTION_LIST /end CHARACTERISTIC
/begin CHARACTERISTIC K_NACHFUELL53 "Nachfüll Vierte Balken von Peistab" VALUE 0x000C21D6 TKW_VV_VV_UB 100.0 Def_dez_ub_q1 0.0 255.0000 /begin FUNCTION_LIST OZNIVDL /end FUNCTION_LIST /end CHARACTERISTIC
/begin CHARACTERISTIC K_NACHFUELL69 "Nachfüll Fünfte Balken von Peistab" VALUE 0x000C21D7 TKW_VV_VV_UB 100.0 Def_dez_ub_q1 0.0 255.0000 /begin FUNCTION_LIST OZNIVDL /end FUNCTION_LIST /end CHARACTERISTIC
/begin CHARACTERISTIC K_NACHFUELL85 "Nachfüll Sechte Balken von Peistab" VALUE 0x000C21D8 TKW_VV_VV_UB 100.0 Def_dez_ub_q1 0.0 255.0000 /begin FUNCTION_LIST OZNIVDL /end FUNCTION_LIST /end CHARACTERISTIC
/begin CHARACTERISTIC K_NACHFUELL95 "Nachfüll Siebte Balken von Peistab" VALUE 0x000C21D9 TKW_VV_VV_UB 100.0 Def_dez_ub_q1 0.0 255.0000 /begin FUNCTION_LIST OZNIVDL /end FUNCTION_LIST /end CHARACTERISTIC
/begin CHARACTERISTIC K_OZALTLANG "Erlaubte Differenz Schwelle (letze 3 Langmw)" VALUE 0x000C21DA TKW_VV_VV_UB 100.0 Def_niv_ub_b75 0.0 74.7070 /begin FUNCTION_LIST OZNIVDL /end FUNCTION_LIST /end CHARACTERISTIC
/begin CHARACTERISTIC K_OZBESCHAUS "Zahl Ausgeblendet bei Lengsbescheunigung" VALUE 0x000C21DB TKW_VV_VV_UB 100.0 Def_dez_ub_q1 0.0 255.0000 /begin FUNCTION_LIST OZNIVDL /end FUNCTION_LIST /end CHARACTERISTIC
/begin CHARACTERISTIC K_OZKEINLUFT "1 = Luftausblendung deaktiviert" VALUE 0x000C21DC TKW_VV_VV_UB 100.0 Def_dez_ub_q1 0.0 255.0000 /begin FUNCTION_LIST OZNIVDL /end FUNCTION_LIST /end CHARACTERISTIC
/begin CHARACTERISTIC K_OZKRZORTZ "Toleranz für Orientierungsmessung " VALUE 0x000C21DD TKW_VV_VV_UB 100.0 Def_f_ub_b2 0.0 1.9921 /begin FUNCTION_LIST OZNIVDL /end FUNCTION_LIST /end CHARACTERISTIC
/begin CHARACTERISTIC K_OZMWK "Anzahl der Messwerte für Kurzzeit-Mittelwert Niveau" VALUE 0x000C21DE TKW_VV_VV_UB 100.0 Def_dez_ub_q1 0.0 255.0000 /begin FUNCTION_LIST OZNIVDL /end FUNCTION_LIST /end CHARACTERISTIC
/begin CHARACTERISTIC K_OZMXSLOPE "Maximale erlaubt Steigung" VALUE 0x000C21DF TKW_VV_VV_UB 100.0 Def_f_ub_b0p5 0.0 0.4980 /begin FUNCTION_LIST OZNIVDL /end FUNCTION_LIST /end CHARACTERISTIC
/begin CHARACTERISTIC K_OZNFDELTA "Niveaudelta für die Nachfüllerkennung Peilstab" VALUE 0x000C21E0 TKW_VV_VV_UB 100.0 Def_niv_ub_b75 0.0 74.7070 /begin FUNCTION_LIST OZNIVDL /end FUNCTION_LIST /end CHARACTERISTIC
/begin CHARACTERISTIC K_OZNFERR "Nachfüllmengenanzeige bei PreCheck OK" VALUE 0x000C21E1 TKW_VV_VV_UB 100.0 Def_dez_ub_q1 0.0 255.0000 /begin FUNCTION_LIST OZNIVDL /end FUNCTION_LIST /end CHARACTERISTIC
/begin CHARACTERISTIC K_OZNFML "Nachfüllmengenanzeige bei " VALUE 0x000C21E2 TKW_VV_VV_UB 100.0 Def_dez_ub_q1 0.0 255.0000 /begin FUNCTION_LIST OZNIVDL /end FUNCTION_LIST /end CHARACTERISTIC
/begin CHARACTERISTIC K_OZNFOELCKO "Nachfüllmengenanzeige bei PreCheck KO" VALUE 0x000C21E3 TKW_VV_VV_UB 100.0 Def_dez_ub_q1 0.0 255.0000 /begin FUNCTION_LIST OZNIVDL /end FUNCTION_LIST /end CHARACTERISTIC
/begin CHARACTERISTIC K_OZNFOELCOK "Nachfüllmengenanzeige bei PreCheck OK" VALUE 0x000C21E4 TKW_VV_VV_UB 100.0 Def_dez_ub_q1 0.0 255.0000 /begin FUNCTION_LIST OZNIVDL /end FUNCTION_LIST /end CHARACTERISTIC
/begin CHARACTERISTIC K_OZNIVMMLIT "Umrechnungsfaktor für Ölniveau von mm in Liter" VALUE 0x000C21E5 TKW_VV_VV_UB 100.0 Def_f_ub_b0p25 0.0 0.2490 /begin FUNCTION_LIST OZNIVDL /end FUNCTION_LIST /end CHARACTERISTIC
/begin CHARACTERISTIC K_OZNIVNFM05 "Niveauschwelle für Erkennung 0,5 Liter nachgefüllt" VALUE 0x000C21E6 TKW_VV_VV_UB 100.0 Def_f_ub_b8 0.0 7.9687 /begin FUNCTION_LIST OZNIVDL /end FUNCTION_LIST /end CHARACTERISTIC
/begin CHARACTERISTIC K_OZNIVNFM10 "Niveauschwelle für Erkennung 1,0 Liter nachgefüllt" VALUE 0x000C21E7 TKW_VV_VV_UB 100.0 Def_f_ub_b8 0.0 7.9687 /begin FUNCTION_LIST OZNIVDL /end FUNCTION_LIST /end CHARACTERISTIC
/begin CHARACTERISTIC K_OZOELCOK "PreDriveCheck-Schwelle" VALUE 0x000C21E8 TKW_VV_VV_UB 100.0 Def_niv_ub_b75 0.0 74.7070 /begin FUNCTION_LIST OZNIVDL /end FUNCTION_LIST /end CHARACTERISTIC
/begin CHARACTERISTIC K_OZPEIL12 "Erste Balken von Peistab" VALUE 0x000C21E9 TKW_VV_VV_UB 100.0 Def_niv_ub_b75 0.0 74.7070 /begin FUNCTION_LIST OZNIVDL /end FUNCTION_LIST /end CHARACTERISTIC
/begin CHARACTERISTIC K_OZPEIL25 "Zweite Balken von Peistab" VALUE 0x000C21EA TKW_VV_VV_UB 100.0 Def_niv_ub_b75 0.0 74.7070 /begin FUNCTION_LIST OZNIVDL /end FUNCTION_LIST /end CHARACTERISTIC
/begin CHARACTERISTIC K_OZPEIL38 "Dritte Balken von Peistab" VALUE 0x000C21EB TKW_VV_VV_UB 100.0 Def_niv_ub_b75 0.0 74.7070 /begin FUNCTION_LIST OZNIVDL /end FUNCTION_LIST /end CHARACTERISTIC
/begin CHARACTERISTIC K_OZPEIL53 "Vierte Balken von Peistab" VALUE 0x000C21EC TKW_VV_VV_UB 100.0 Def_niv_ub_b75 0.0 74.7070 /begin FUNCTION_LIST OZNIVDL /end FUNCTION_LIST /end CHARACTERISTIC
/begin CHARACTERISTIC K_OZPEIL69 "Fünfte Balken von Peistab" VALUE 0x000C21ED TKW_VV_VV_UB 100.0 Def_niv_ub_b75 0.0 74.7070 /begin FUNCTION_LIST OZNIVDL /end FUNCTION_LIST /end CHARACTERISTIC
/begin CHARACTERISTIC K_OZPEIL85 "Sechte Balken von Peistab" VALUE 0x000C21EE TKW_VV_VV_UB 100.0 Def_niv_ub_b75 0.0 74.7070 /begin FUNCTION_LIST OZNIVDL /end FUNCTION_LIST /end CHARACTERISTIC
/begin CHARACTERISTIC K_OZPEIL95 "Siebte Balken von Peistab" VALUE 0x000C21EF TKW_VV_VV_UB 100.0 Def_niv_ub_b75 0.0 74.7070 /begin FUNCTION_LIST OZNIVDL /end FUNCTION_LIST /end CHARACTERISTIC
/begin CHARACTERISTIC K_OZPEILDO "Delta + Hysteresis Langmw Peilstab" VALUE 0x000C21F0 TKW_VV_VV_UB 100.0 Def_niv_ub_b75 0.0 74.7070 /begin FUNCTION_LIST OZNIVDL /end FUNCTION_LIST /end CHARACTERISTIC
/begin CHARACTERISTIC K_OZPEILDU "Delta - Hysteresis Langmw Peilstab" VALUE 0x000C21F1 TKW_VV_VV_UB 100.0 Def_niv_ub_b75 0.0 74.7070 /begin FUNCTION_LIST OZNIVDL /end FUNCTION_LIST /end CHARACTERISTIC
/begin CHARACTERISTIC K_OZPEILERR "Balkenanzeige im Fehlerfall" VALUE 0x000C21F2 TKW_VV_VV_UB 100.0 Def_dez_ub_q1 0.0 255.0000 /begin FUNCTION_LIST OZNIVDL /end FUNCTION_LIST /end CHARACTERISTIC
/begin CHARACTERISTIC K_OZPEILLP85 "Bankenanzeige für Niveau bei 85%" VALUE 0x000C21F3 TKW_VV_VV_UB 100.0 Def_dez_ub_q1 0.0 255.0000 /begin FUNCTION_LIST OZNIVDL /end FUNCTION_LIST /end CHARACTERISTIC
/begin CHARACTERISTIC K_OZPEILML "Balkenanzeige bei Messung läuft" VALUE 0x000C21F4 TKW_VV_VV_UB 100.0 Def_dez_ub_q1 0.0 255.0000 /begin FUNCTION_LIST OZNIVDL /end FUNCTION_LIST /end CHARACTERISTIC
/begin CHARACTERISTIC K_OZPEILOELCKO "Balkenanzeige bei ÖlCheck KO" VALUE 0x000C21F5 TKW_VV_VV_UB 100.0 Def_dez_ub_q1 0.0 255.0000 /begin FUNCTION_LIST OZNIVDL /end FUNCTION_LIST /end CHARACTERISTIC
/begin CHARACTERISTIC K_OZPEILOELCOK "Balkenanzeige bei ÖlCheck OK" VALUE 0x000C21F6 TKW_VV_VV_UB 100.0 Def_dez_ub_q1 0.0 255.0000 /begin FUNCTION_LIST OZNIVDL /end FUNCTION_LIST /end CHARACTERISTIC
/begin CHARACTERISTIC K_OZSTARTVERZ "QLT Start Verzögerung nach Drehzal" VALUE 0x000C21F7 TKW_VV_VV_UB 100.0 Def_dez_ub_q1 0.0 255.0000 /begin FUNCTION_LIST OZNIVDL /end FUNCTION_LIST /end CHARACTERISTIC
/begin CHARACTERISTIC K_OZVERBFAK "Faktor für die Anpassung des Ölverbrauches" VALUE 0x000C21F8 TKW_VV_VV_UB 100.0 Def_f_ub_b8 0.0 7.9687 /begin FUNCTION_LIST OZNIVDL /end FUNCTION_LIST /end CHARACTERISTIC
/begin CHARACTERISTIC K_OZVERZERRBSD "Verzögerung für Peilstab-Fehlerfall beim BSD-Fehler" VALUE 0x000C21F9 TKW_VV_VV_UB 100.0 Def_dez_ub_q1 0.0 255.0000 /begin FUNCTION_LIST OZNIVDL /end FUNCTION_LIST /end CHARACTERISTIC
/begin CHARACTERISTIC K_OZZEITST "Delta Zeit für Luftdruck messsung" VALUE 0x000C21FA TKW_VV_VV_UB 100.0 Def_td_ub_q1 0.0 255.0000 /begin FUNCTION_LIST OZNIVDL /end FUNCTION_LIST /end CHARACTERISTIC
/begin CHARACTERISTIC K_PT1NMOT "Konstant für Lowpass Filter Drehzahl Töns" VALUE 0x000C21FB TKW_VV_VV_UB 100.0 Def_f_ub_b100 0.0 99.6093 /begin FUNCTION_LIST OZNIVDL /end FUNCTION_LIST /end CHARACTERISTIC
/begin CHARACTERISTIC K_TOGMWK "" VALUE 0x000C21FC TKW_VV_VV_UB 100.0 Def_dez_ub_q1 1.0000 100.0000 /begin FUNCTION_LIST OZNIVDL /end FUNCTION_LIST /end CHARACTERISTIC
/begin CHARACTERISTIC K_TOGORIANZ "" VALUE 0x000C21FD TKW_VV_VV_UB 100.0 Def_dez_ub_q1 1.0000 255.0000 /begin FUNCTION_LIST OZNIVDL /end FUNCTION_LIST /end CHARACTERISTIC
/begin CHARACTERISTIC K_TOGVERBKZ "" VALUE 0x000C21FE TKW_VV_VV_UB 100.0 Def_td_ub_q0p5 0.0 127.5000 /begin FUNCTION_LIST OZNIVDL /end FUNCTION_LIST /end CHARACTERISTIC
/begin CHARACTERISTIC K_TOGVERBNOR "" VALUE 0x000C21FF TKW_VV_VV_UB 100.0 Def_td_ub_q0p5 0.0 127.5000 /begin FUNCTION_LIST OZNIVDL /end FUNCTION_LIST /end CHARACTERISTIC
/begin CHARACTERISTIC K_TOGVERLKZ "" VALUE 0x000C2200 TKW_VV_VV_UB 100.0 Def_td_ub_q0p5 0.0 127.5000 /begin FUNCTION_LIST OZNIVDL /end FUNCTION_LIST /end CHARACTERISTIC
/begin CHARACTERISTIC K_TOGVERLNOR "" VALUE 0x000C2201 TKW_VV_VV_UB 100.0 Def_td_ub_q0p5 0.0 127.5000 /begin FUNCTION_LIST OZNIVDL /end FUNCTION_LIST /end CHARACTERISTIC
/begin CHARACTERISTIC K_TOGVERLORI "" VALUE 0x000C2202 TKW_VV_VV_UB 100.0 Def_td_ub_q0p5 0.0 127.5000 /begin FUNCTION_LIST OZNIVDL /end FUNCTION_LIST /end CHARACTERISTIC
/begin CHARACTERISTIC K_TOGVERZOEG "" VALUE 0x000C2203 TKW_VV_VV_UB 100.0 Def_dez_ub_q1 0.0 255.0000 /begin FUNCTION_LIST OZNIVDL /end FUNCTION_LIST /end CHARACTERISTIC
/begin CHARACTERISTIC KL_OZLN "y = ln x" CURVE 0x000C2204 TKL_UW_VV_SW 100.0 Def_f_sw_b1 -1.0000 9.99969482421875e-1 /begin FUNCTION_LIST OZNIVDL /end FUNCTION_LIST /begin AXIS_DESCR STD_AXIS Oz_pzdivp Def_f_uw_b2 6 0.0 1.9999 /end AXIS_DESCR /end CHARACTERISTIC
/begin CHARACTERISTIC KL_OZNMNIVKL "Kennlinie für Drehzahlkorrektur des Niveaus" CURVE 0x000C221E TKL_SW_VV_SB 100.0 Def_niv_sb_b37p5 -37.5000 37.2070 /begin FUNCTION_LIST OZNIVDL /end FUNCTION_LIST /begin AXIS_DESCR STD_AXIS N_ozmw Def_n_sw_q1p0 16 -32768.0000 32767.0000 /end AXIS_DESCR /end CHARACTERISTIC
/begin CHARACTERISTIC KL_TKTOENIV "Umstetzung Tk -> Oelnivau" CURVE 0x000C2250 TKL_UW_VV_UW 100.0 Def_td_uw_q0p1 0.0 6553.5000 /begin FUNCTION_LIST OZNIVDL /end FUNCTION_LIST
 /begin AXIS_DESCR STD_AXIS Td_og_tk Def_td_uw_q0p1 7 0.0 6553.5000 FORMAT "%4.1" /end AXIS_DESCR
 FORMAT "%4.1" /end CHARACTERISTIC
/begin CHARACTERISTIC KL_OZBEFKL "Befüllkennlinie" CURVE 0x000C226E TKL_UW_VV_UW 100.0 Def_niv_uw_q0p1 0.0 25.5000 /begin FUNCTION_LIST OZNIVDL /end FUNCTION_LIST
 /begin AXIS_DESCR STD_AXIS Oz_nivkrzt Def_niv_uw_b75 5 0.0 19199.7070 FORMAT "%5.2" /end AXIS_DESCR
 FORMAT "%4.1" /end CHARACTERISTIC
/begin CHARACTERISTIC KL_TVTOEL "" CURVE 0x000C2284 TKL_UW_VV_SW 100.0 Def_t_sw_q0p1 -3276.8000 3276.7000 /begin FUNCTION_LIST OZNIVDL /end FUNCTION_LIST
 /begin AXIS_DESCR STD_AXIS NO_INPUT_QUANTITY Def_td_uw_q0p1 7 0.0 6553.5000 FORMAT "%4.1" /end AXIS_DESCR
 FORMAT "%4.1" /end CHARACTERISTIC
/begin CHARACTERISTIC KL_TOGNKOR "" CURVE 0x000C22A2 TKL_SW_VV_SB 100.0 Def_niv_sb_b37p5 -37.5000 37.2070 /begin FUNCTION_LIST OZNIVDL /end FUNCTION_LIST /begin AXIS_DESCR STD_AXIS Oz_nmotfm Def_n_sw_q1p0 16 -32768.0000 32767.0000 /end AXIS_DESCR /end CHARACTERISTIC
/begin CHARACTERISTIC KF_OZKORRORI "Kennfeld für die Korrektur des OriMw mit Abstellzeit und Öltemperatur" MAP 0x000C22D4 TKF_UW_SW_SW 100.0 Def_niv_sw_b37p5 -37.5000 37.2070 /begin FUNCTION_LIST OZNIVDL /end FUNCTION_LIST
 /begin AXIS_DESCR STD_AXIS Toel Def_t_sw_q0p1 4 -3276.8000 3276.7000 FORMAT "%4.1" /end AXIS_DESCR
 /begin AXIS_DESCR STD_AXIS Tn_abstellm Def_tn_uw_q1 3 0.0 65535.0000 FORMAT "%5.2" /end AXIS_DESCR
 FORMAT "%5.2" /end CHARACTERISTIC
/begin CHARACTERISTIC K_OZPERMNK3 "Drehzahlschwelle für Er-Ausblendung" VALUE 0x000C22FC TKW_VV_VV_SW 100.0 Def_n_sw_q1p0 -32768.0000 32767.0000 /begin FUNCTION_LIST OZPERM /end FUNCTION_LIST /end CHARACTERISTIC
/begin CHARACTERISTIC K_OZPERMTK12 "Untere Temperaturgrenze Messfenster Permittivität" VALUE 0x000C22FE TKW_VV_VV_SW 100.0 Def_t_sw_q0p1 -3276.8000 3276.7000 /begin FUNCTION_LIST OZPERM /end FUNCTION_LIST FORMAT "%4.1" /end CHARACTERISTIC
/begin CHARACTERISTIC K_OZPERMTK13 "Obere Temperaturgrenze Messfenster Permittivität" VALUE 0x000C2300 TKW_VV_VV_SW 100.0 Def_t_sw_q0p1 -3276.8000 3276.7000 /begin FUNCTION_LIST OZPERM /end FUNCTION_LIST FORMAT "%4.1" /end CHARACTERISTIC
/begin CHARACTERISTIC K_OZPERMTK7 "Ausheiztemperatur" VALUE 0x000C2302 TKW_VV_VV_SW 100.0 Def_t_sw_q0p1 -3276.8000 3276.7000 /begin FUNCTION_LIST OZPERM /end FUNCTION_LIST FORMAT "%4.1" /end CHARACTERISTIC
/begin CHARACTERISTIC K_OZOELKMPL "gefahrene Strecke nach Ölwechsel, ab wo Er-Auswertung erfolgt" VALUE 0x000C2304 TKW_VV_VV_UW 100.0 Def_km_uw_q10 0.0 655350.0000 /begin FUNCTION_LIST OZPERM /end FUNCTION_LIST /end CHARACTERISTIC
/begin CHARACTERISTIC K_OZPERMCOK5 "minimale Anzahl der Messwerte für einen gültigen Permittivitätswert" VALUE 0x000C2306 TKW_VV_VV_UW 100.0 Def_dez_uw_q1 0.0 65535.0000 /begin FUNCTION_LIST OZPERM /end FUNCTION_LIST /end CHARACTERISTIC
/begin CHARACTERISTIC K_OZPERMMIN "minimaler Permittivitätswert für gültige Auswertung" VALUE 0x000C2308 TKW_VV_VV_UW 100.0 Def_perm_uw_b6 0.0 5.9999 /begin FUNCTION_LIST OZPERM /end FUNCTION_LIST /end CHARACTERISTIC
/begin CHARACTERISTIC K_OZPERMTIK6 "Mittelungszeitraum Permittivität" VALUE 0x000C230A TKW_VV_VV_UW 100.0 Def_td_uw_q1 0.0 65535.0000 /begin FUNCTION_LIST OZPERM /end FUNCTION_LIST /end CHARACTERISTIC
/begin CHARACTERISTIC K_OZPERMTIK8 "Ausheizzeit" VALUE 0x000C230C TKW_VV_VV_UW 100.0 Def_td_uw_q1 0.0 65535.0000 /begin FUNCTION_LIST OZPERM /end FUNCTION_LIST /end CHARACTERISTIC
/begin CHARACTERISTIC K_OZPERMTIK9 "maximale Zeit nach B_ozpermpl = true, Neustart und oztempf < OZPERMTI in der eine gültige Messung erfolgen kann (Kaltzeitschwelle)" VALUE 0x000C230E TKW_VV_VV_UW 100.0 Def_td_uw_q1 0.0 65535.0000 /begin FUNCTION_LIST OZPERM /end FUNCTION_LIST /end CHARACTERISTIC
/begin CHARACTERISTIC K_OZPERMTK4 "Abklingzeit Drehzahlschwelle" VALUE 0x000C2310 TKW_VV_VV_UW 100.0 Def_td_uw_q1 0.0 65535.0000 /begin FUNCTION_LIST OZPERM /end FUNCTION_LIST /end CHARACTERISTIC
/begin CHARACTERISTIC K_OZPERMMNIV "Niveauschwelle für gültige Permittivitätsauswertung" VALUE 0x000C2312 TKW_VV_VV_UB 100.0 Def_niv_ub_b75 0.0 74.7070 /begin FUNCTION_LIST OZPERM /end FUNCTION_LIST /end CHARACTERISTIC
/begin CHARACTERISTIC K_OZZEITFAKT "Bereich der gesamten Laufstrecke wo die Berechnung des Zeit-RW Beainfluss hat" VALUE 0x000C2328 TKW_VV_VV_UB 100.0 Def_f_ub_b1 0.0 0.9960 /begin FUNCTION_LIST OZRESTKM /end FUNCTION_LIST /end CHARACTERISTIC
/begin CHARACTERISTIC K_OZUEBERTEMP "Schwelle für die Ölsübertemperatur-Kontrolle" VALUE 0x000C2314 TKW_VV_VV_SW 100.0 Def_t_sw_q0p1 -3276.8000 3276.7000 /begin FUNCTION_LIST OZRESTKM /end FUNCTION_LIST FORMAT "%4.1" /end CHARACTERISTIC
/begin CHARACTERISTIC K_OZANFANZ "BOS-Startanzeigewert Restlaufstrecke" VALUE 0x000C2316 TKW_VV_VV_UW 100.0 Def_km_uw_q10 0.0 655350.0000 /begin FUNCTION_LIST OZRESTKM /end FUNCTION_LIST /end CHARACTERISTIC
/begin CHARACTERISTIC K_OZKMMAXK11 "Maximalintervall" VALUE 0x000C2318 TKW_VV_VV_UW 100.0 Def_km_uw_q10 0.0 655350.0000 /begin FUNCTION_LIST OZRESTKM /end FUNCTION_LIST /end CHARACTERISTIC
/begin CHARACTERISTIC K_OZKVBMXK18 "maximal zulässige Gesamtkraftstoffbonusmenge" VALUE 0x000C231A TKW_VV_VV_UW 100.0 Def_dez_uw_q1 0.0 65535.0000 /begin FUNCTION_LIST OZRESTKM /end FUNCTION_LIST /end CHARACTERISTIC
/begin CHARACTERISTIC K_OZKVBOK16 "Kraftstoffbonusmenge in [l] je 0,5l Ölnachfüllung" VALUE 0x000C231C TKW_VV_VV_UW 100.0 Def_dez_uw_q1 0.0 65535.0000 /begin FUNCTION_LIST OZRESTKM /end FUNCTION_LIST /end CHARACTERISTIC
/begin CHARACTERISTIC K_OZMNKMBO "Wegstrecke ab der eine Bonuszuteilung erfolgt" VALUE 0x000C231E TKW_VV_VV_UW 100.0 Def_km_uw_q10 0.0 655350.0000 /begin FUNCTION_LIST OZRESTKM /end FUNCTION_LIST /end CHARACTERISTIC
/begin CHARACTERISTIC K_OZMXOHK15 "Max Tage für den Ölservice" VALUE 0x000C2320 TKW_VV_VV_UW 100.0 Def_dez_uw_q1 0.0 65535.0000 /begin FUNCTION_LIST OZRESTKM /end FUNCTION_LIST /end CHARACTERISTIC
/begin CHARACTERISTIC K_OZPERBOK17 "Er-Bonusbetrag je 0,5l Ölnachfüllung" VALUE 0x000C2322 TKW_VV_VV_UW 100.0 Def_perm_uw_b6 0.0 5.9999 /begin FUNCTION_LIST OZRESTKM /end FUNCTION_LIST /end CHARACTERISTIC
/begin CHARACTERISTIC K_OZPERXK10 "zulässige Permittivitätsänderung im Ölwechselintervall" VALUE 0x000C2324 TKW_VV_VV_UW 100.0 Def_perm_uw_b6 0.0 5.9999 /begin FUNCTION_LIST OZRESTKM /end FUNCTION_LIST /end CHARACTERISTIC
/begin CHARACTERISTIC K_OZTAGCTERR "Wert für unplausibel Tagezähler" VALUE 0x000C2326 TKW_VV_VV_UW 100.0 Def_dez_uw_q1 0.0 65535.0000 /begin FUNCTION_LIST OZRESTKM /end FUNCTION_LIST /end CHARACTERISTIC
/begin CHARACTERISTIC K_OZDAEMPF "" VALUE 0x000C2329 TKW_VV_VV_UB 100.0 Def_f_ub_b0p25 0.0 0.2490 /begin FUNCTION_LIST OZRESTKM /end FUNCTION_LIST /end CHARACTERISTIC
/begin CHARACTERISTIC K_OZKVB96 "Typprüfkraftstoffverbrauch" VALUE 0x000C232A TKW_VV_VV_UB 100.0 Def_f_ub_b32 0.0 31.8750 /begin FUNCTION_LIST OZRESTKM /end FUNCTION_LIST /end CHARACTERISTIC
/begin CHARACTERISTIC K_OZLF1 "Länderfaktor 1 Festwert" VALUE 0x000C232B TKW_VV_VV_UB 100.0 Def_lf_ub_q0p01 0.0 2.5500 /begin FUNCTION_LIST OZRESTKM /end FUNCTION_LIST /end CHARACTERISTIC
/begin CHARACTERISTIC K_OZLF2 "Länderfaktor 2 Festwert" VALUE 0x000C232C TKW_VV_VV_UB 100.0 Def_lf_ub_q0p01 0.0 2.5500 /begin FUNCTION_LIST OZRESTKM /end FUNCTION_LIST /end CHARACTERISTIC
/begin CHARACTERISTIC K_OZPERBRK14 "Begrenzungsfaktor für Restweg aus der Permittivität" VALUE 0x000C232D TKW_VV_VV_UB 100.0 Def_kw_ub_q0p0234 0.0 5.9765 /begin FUNCTION_LIST OZRESTKM /end FUNCTION_LIST /end CHARACTERISTIC
/begin CHARACTERISTIC K_OZUTFAK "Faktor für den Kraftstoffverbrauch bei Übertemperatur" VALUE 0x000C232E TKW_VV_VV_UB 100.0 Def_dez_ub_q1 0.0 255.0000 /begin FUNCTION_LIST OZRESTKM /end FUNCTION_LIST /end CHARACTERISTIC
/begin CHARACTERISTIC K_OZZEITINT "Zeitintervall für Ölwechsel in Monate (CBS4)" VALUE 0x000C232F TKW_VV_VV_UB 100.0 Def_dez_ub_q1 0.0 255.0000 /begin FUNCTION_LIST OZRESTKM /end FUNCTION_LIST /end CHARACTERISTIC
/begin CHARACTERISTIC K_BNS_VFZG "Schwelle Geschwindigkeit fuer BNS" VALUE 0x000C2330 TKW_VV_VV_UW 100.0 Def_v_uw_q1p0 0.0 65535.0000 /begin FUNCTION_LIST PMBNSTAB /end FUNCTION_LIST /end CHARACTERISTIC
/begin CHARACTERISTIC K_BNSMAX "Bordnetz Instabil Schwelle" VALUE 0x000C2332 TKW_VV_VV_UB 100.0 Def_dez_ub_q1 0.0 255.0000 /begin FUNCTION_LIST PMBNSTAB /end FUNCTION_LIST /end CHARACTERISTIC
/begin CHARACTERISTIC K_BNS_CTRINC "bnsctr inkrement" VALUE 0x000C2333 TKW_VV_VV_UB 100.0 Def_dez_ub_q1 0.0 255.0000 /begin FUNCTION_LIST PMBNSTAB /end FUNCTION_LIST /end CHARACTERISTIC
/begin CHARACTERISTIC K_BNS_SCHW1 "BN Instabilitätsschwelle 1" VALUE 0x000C2334 TKW_VV_VV_UB 100.0 Def_dez_ub_q1 0.0 255.0000 /begin FUNCTION_LIST PMBNSTAB /end FUNCTION_LIST /end CHARACTERISTIC
/begin CHARACTERISTIC K_BNS_UBMAX "BN Spg. max. Schwelle" VALUE 0x000C2335 TKW_VV_VV_UB 100.0 Def_u_ub_q0p0942 0.0 24.0210 /begin FUNCTION_LIST PMBNSTAB /end FUNCTION_LIST /end CHARACTERISTIC
/begin CHARACTERISTIC K_BNS_UBMIN "BN Spg. untere Schwelle" VALUE 0x000C2336 TKW_VV_VV_UB 100.0 Def_u_ub_q0p0942 0.0 24.0210 /begin FUNCTION_LIST PMBNSTAB /end FUNCTION_LIST /end CHARACTERISTIC
/begin CHARACTERISTIC K_T_BNSDELAY "Delayzeit nach Motorstartende für BNS Überwachung" VALUE 0x000C2337 TKW_VV_VV_UB 100.0 Def_td_ub_q1 0.0 255.0000 /begin FUNCTION_LIST PMBNSTAB /end FUNCTION_LIST /end CHARACTERISTIC
/begin CHARACTERISTIC S_BNSCLRAPP "BNS Daten löschen" VALUE 0x000C2338 TKW_VV_VV_UB 100.0 Def_dez_ub_q1 0.0 255.0000 /begin FUNCTION_LIST PMBNSTAB /end FUNCTION_LIST /end CHARACTERISTIC
/begin MEASUREMENT St_agr.B_agrok "Bedingung Abgasrückführung ok" UBYTE Def_bit_ub_0 0 0 0.0 255.0 ECU_ADDRESS 0x007FBF7C /begin FUNCTION_LIST LAYER /end FUNCTION_LIST BIT_MASK 0x1 /end MEASUREMENT
/begin MEASUREMENT St_agr "Statuswort AGR" UBYTE Def_st_ub_q1 0 0 0.0 255.0000 ECU_ADDRESS 0x007FBF7C /begin FUNCTION_LIST LAYER /end FUNCTION_LIST /end MEASUREMENT
/begin MEASUREMENT St_lsu.B_lsuakt "Bedingung Lambdasonde aktiv" UBYTE Def_bit_ub_0 0 0 0.0 255.0 ECU_ADDRESS 0x007FBF7D /begin FUNCTION_LIST LAYER /end FUNCTION_LIST BIT_MASK 0x1 /end MEASUREMENT
/begin MEASUREMENT St_lsu "Statuswort LSU" UBYTE Def_st_ub_q1 0 0 0.0 255.0000 ECU_ADDRESS 0x007FBF7D /begin FUNCTION_LIST LAYER /end FUNCTION_LIST /end MEASUREMENT
/begin MEASUREMENT St_pld.B_pldok "Bedingung Ladedruckregelung ok" UBYTE Def_bit_ub_0 0 0 0.0 255.0 ECU_ADDRESS 0x007FBF7E /begin FUNCTION_LIST LAYER /end FUNCTION_LIST BIT_MASK 0x1 /end MEASUREMENT
/begin MEASUREMENT St_pld "Statuswort PLD" UBYTE Def_st_ub_q1 0 0 0.0 255.0000 ECU_ADDRESS 0x007FBF7E /begin FUNCTION_LIST LAYER /end FUNCTION_LIST /end MEASUREMENT
/begin MEASUREMENT St_imdgen_1s.B_genhtkrit "Diodentemparatur im kritischen Bereich" UBYTE Def_bit_ub_1 0 0 0.0 255.0 ECU_ADDRESS 0x007FBF7F /begin FUNCTION_LIST LAYER /end FUNCTION_LIST BIT_MASK 0x2 /end MEASUREMENT
/begin MEASUREMENT St_imdgen_1s.B_tdiodekrit "Generatormoment enable/disable" UBYTE Def_bit_ub_3 0 0 0.0 255.0 ECU_ADDRESS 0x007FBF7F /begin FUNCTION_LIST LAYER /end FUNCTION_LIST BIT_MASK 0x8 /end MEASUREMENT
/begin MEASUREMENT St_imdgen_1s "Statuswort" UBYTE Def_st_ub_q1 0 0 0.0 255.0000 ECU_ADDRESS 0x007FBF7F /begin FUNCTION_LIST LAYER /end FUNCTION_LIST /end MEASUREMENT
/begin MEASUREMENT Oz_lf1c "Länderfaktor 1 codiert" UBYTE Def_lf_ub_q0p01 0 0 0.0 2.5500 ECU_ADDRESS 0x007FBF80 /begin FUNCTION_LIST LAYER /end FUNCTION_LIST /end MEASUREMENT
/begin MEASUREMENT Oz_lf2c "Länderfaktor 2 codiert" UBYTE Def_lf_ub_q0p01 0 0 0.0 2.5500 ECU_ADDRESS 0x007FBF81 /begin FUNCTION_LIST LAYER /end FUNCTION_LIST /end MEASUREMENT
/begin MEASUREMENT Bosbtvfbkt "Verfügbarkeit vom Tester" UBYTE Def_dez_ub_q1 0 0 0.0 255.0000 ECU_ADDRESS 0x007FBF82 /begin FUNCTION_LIST LAYER /end FUNCTION_LIST /end MEASUREMENT
/begin MEASUREMENT Id_bosrtt "Kennung vom Tester für Ölservice" UBYTE Def_dez_ub_q1 0 0 0.0 255.0000 ECU_ADDRESS 0x007FBF83 /begin FUNCTION_LIST LAYER /end FUNCTION_LIST /end MEASUREMENT
/begin MEASUREMENT Zrbosrt "Servicezählerwert vom Tester" UBYTE Def_dez_ub_q1 0 0 0.0 255.0000 ECU_ADDRESS 0x007FBF84 /begin FUNCTION_LIST LAYER /end FUNCTION_LIST /end MEASUREMENT
/begin MEASUREMENT Acfzgl "Fahrzeuglängsbeschleunigung" SBYTE Def_ac_sb_q0p25 0 0 -32.0000 31.7500 ECU_ADDRESS 0x007FBF85 /begin FUNCTION_LIST LAYER /end FUNCTION_LIST /end MEASUREMENT
/begin MEASUREMENT Acfzgq "Fahrzeugquerbeschleunigung" SBYTE Def_ac_sb_q0p25 0 0 -32.0000 31.7500 ECU_ADDRESS 0x007FBF86 /begin FUNCTION_LIST LAYER /end FUNCTION_LIST /end MEASUREMENT
/begin MEASUREMENT Bosv "Verfügbarkeit vom Kombi" UBYTE Def_dez_ub_q1 0 0 0.0 255.0000 ECU_ADDRESS 0x007FBF87 /begin FUNCTION_LIST LAYER /end FUNCTION_LIST /end MEASUREMENT
/begin MEASUREMENT Gangi "Aktueller Gang intern" UBYTE Def_dez_ub_q1 0 0 0.0 255.0000 ECU_ADDRESS 0x007FBF88 /begin FUNCTION_LIST LAYER /end FUNCTION_LIST /end MEASUREMENT
/begin MEASUREMENT Id_bosrst "ID für BOS-Reset vom Kombi" UBYTE Def_dez_ub_q1 0 0 0.0 255.0000 ECU_ADDRESS 0x007FBF89 /begin FUNCTION_LIST LAYER /end FUNCTION_LIST /end MEASUREMENT
/begin MEASUREMENT Id_bosrtw "ID für Motoröl vom Kombi" UWORD Def_dez_uw_q1 0 0 0.0 65535.0000 ECU_ADDRESS 0x007FBF8A /begin FUNCTION_LIST LAYER /end FUNCTION_LIST /end MEASUREMENT
/begin MEASUREMENT Kvaverbr "Kraftstoffverbrauch (Einspritzmenge in Microliter)" UWORD Def_dez_uw_q1 0 0 0.0 65535.0000 ECU_ADDRESS 0x007FBF8C /begin FUNCTION_LIST LAYER /end FUNCTION_LIST /end MEASUREMENT
/begin MEASUREMENT Oz_nivr "Rohwert Ölniveau vom Sensor" UBYTE Def_dez_ub_q1 0 0 0.0 255.0000 ECU_ADDRESS 0x007FBF8E /begin FUNCTION_LIST LAYER /end FUNCTION_LIST /end MEASUREMENT
/begin MEASUREMENT Oz_permr "Rohwert Permittivität vom Sensor" UWORD Def_dez_uw_q1 0 0 0.0 65535.0000 ECU_ADDRESS 0x007FBF90 /begin FUNCTION_LIST LAYER /end FUNCTION_LIST /end MEASUREMENT
/begin MEASUREMENT Oz_status "Statusinfo vom Sensor" UBYTE Def_dez_ub_q1 0 0 0.0 255.0000 ECU_ADDRESS 0x007FBF92 /begin FUNCTION_LIST LAYER /end FUNCTION_LIST /end MEASUREMENT
/begin MEASUREMENT Oz_tempr "Rohwert Öltemperatur vom Sensor" UBYTE Def_dez_ub_q1 0 0 0.0 255.0000 ECU_ADDRESS 0x007FBF93 /begin FUNCTION_LIST LAYER /end FUNCTION_LIST /end MEASUREMENT
/begin MEASUREMENT Pu "Umgebungsdruck" UWORD Def_p_uw_q0p039 0 0 0.0 2559.9609 ECU_ADDRESS 0x007FBF94 /begin FUNCTION_LIST LAYER /end FUNCTION_LIST /end MEASUREMENT
/begin MEASUREMENT Pwg_ist "Pedalwert Fahrerwunsch in %" SWORD Def_wdk_sw_q0p0244 0 0 -800.0000 799.9755 ECU_ADDRESS 0x007FBF96 /begin FUNCTION_LIST LAYER /end FUNCTION_LIST /end MEASUREMENT
/begin MEASUREMENT Td_og_cnt "Zähler für fallende Flanken im Töns Signal" UBYTE Def_dez_ub_q1 0 0 0.0 255.0000 ECU_ADDRESS 0x007FBF98 /begin FUNCTION_LIST LAYER /end FUNCTION_LIST /end MEASUREMENT
/begin MEASUREMENT Td_og_icnt "Zeit zwischen 2 fallenden Flanken" UWORD Def_dez_uw_q1 0 0 0.0 65535.0000 ECU_ADDRESS 0x007FBF9A /begin FUNCTION_LIST LAYER /end FUNCTION_LIST /end MEASUREMENT
/begin MEASUREMENT Td_og_tk "Abkühlzeit vom TÖNS" UWORD Def_td_uw_q0p1 0 0 0.0 6553.5000 ECU_ADDRESS 0x007FBF9C /begin FUNCTION_LIST LAYER /end FUNCTION_LIST /end MEASUREMENT
/begin MEASUREMENT Td_og_tr "Referntzeit" UWORD Def_td_uw_q0p1 0 0 0.0 6553.5000 ECU_ADDRESS 0x007FBF9E /begin FUNCTION_LIST LAYER /end FUNCTION_LIST /end MEASUREMENT
/begin MEASUREMENT Td_og_tv "Abkühlzeit Vom TÖNS" UWORD Def_td_uw_q0p1 0 0 0.0 6553.5000 ECU_ADDRESS 0x007FBFA0 /begin FUNCTION_LIST LAYER /end FUNCTION_LIST /end MEASUREMENT
/begin MEASUREMENT Td_og_uplcnt "Zähler für unplausible Signale" UBYTE Def_dez_ub_q1 0 0 0.0 255.0000 ECU_ADDRESS 0x007FBFA2 /begin FUNCTION_LIST LAYER /end FUNCTION_LIST /end MEASUREMENT
/begin MEASUREMENT Toel_mdl "Modelltemperatur Motoröl" SWORD Def_t_sw_q0p1 0 0 -3276.8000 3276.7000 ECU_ADDRESS 0x007FBFA4 /begin FUNCTION_LIST LAYER /end FUNCTION_LIST /end MEASUREMENT
/begin MEASUREMENT Zrbosr "Servicezähler vom Kombi" UBYTE Def_dez_ub_q1 0 0 0.0 255.0000 ECU_ADDRESS 0x007FBFA6 /begin FUNCTION_LIST LAYER /end FUNCTION_LIST /end MEASUREMENT
/begin MEASUREMENT St_tum.B_tumers "Bedingung Umgebungstemperaturersatzwert" UBYTE Def_bit_ub_0 0 0 0.0 255.0 ECU_ADDRESS 0x007FBFA7 /begin FUNCTION_LIST LAYER /end FUNCTION_LIST BIT_MASK 0x1 /end MEASUREMENT
/begin MEASUREMENT St_tum "Statuswort tum" UBYTE Def_dez_ub_q1 0 0 0.0 255.0000 ECU_ADDRESS 0x007FBFA7 /begin FUNCTION_LIST LAYER /end FUNCTION_LIST /end MEASUREMENT
/begin MEASUREMENT St_oz_i.B_td_og "Bedingung Abkühlzeit gültig" UBYTE Def_bit_ub_0 0 0 0.0 255.0 ECU_ADDRESS 0x007FBFA8 /begin FUNCTION_LIST LAYER /end FUNCTION_LIST BIT_MASK 0x1 /end MEASUREMENT
/begin MEASUREMENT St_oz_i.B_td_ogok "Bedingung State-Machine 1x gültig gerechnet" UBYTE Def_bit_ub_4 0 0 0.0 255.0 ECU_ADDRESS 0x007FBFA8 /begin FUNCTION_LIST LAYER /end FUNCTION_LIST BIT_MASK 0x10 /end MEASUREMENT
/begin MEASUREMENT St_oz_i.B_toel "Bedingung tr und tv gültig" UBYTE Def_bit_ub_1 0 0 0.0 255.0 ECU_ADDRESS 0x007FBFA8 /begin FUNCTION_LIST LAYER /end FUNCTION_LIST BIT_MASK 0x2 /end MEASUREMENT
/begin MEASUREMENT St_oz_i "Statusbyte für Eingang OZ" UBYTE Def_dez_ub_q1 0 0 0.0 255.0000 ECU_ADDRESS 0x007FBFA8 /begin FUNCTION_LIST LAYER /end FUNCTION_LIST /end MEASUREMENT
/begin MEASUREMENT St_oz.B_anhang "Bedingung Anhänger erkannt" UBYTE Def_bit_ub_0 0 0 0.0 255.0 ECU_ADDRESS 0x007FBFA9 /begin FUNCTION_LIST LAYER /end FUNCTION_LIST BIT_MASK 0x1 /end MEASUREMENT
/begin MEASUREMENT St_oz.B_ozfbsd "Bedingung Fehler BSD-Kommunikation" UBYTE Def_bit_ub_1 0 0 0.0 255.0 ECU_ADDRESS 0x007FBFA9 /begin FUNCTION_LIST LAYER /end FUNCTION_LIST BIT_MASK 0x2 /end MEASUREMENT
/begin MEASUREMENT St_oz "Statuswort Eingangsgrößen Ölzustandssensor" UBYTE Def_dez_ub_q1 0 0 0.0 255.0000 ECU_ADDRESS 0x007FBFA9 /begin FUNCTION_LIST LAYER /end FUNCTION_LIST /end MEASUREMENT
/begin MEASUREMENT T_jahr "Borddatum" UWORD Def_dez_uw_q1 0 0 0.0 65535.0000 ECU_ADDRESS 0x007FBFAC /begin FUNCTION_LIST LAYER /end FUNCTION_LIST /end MEASUREMENT
/begin MEASUREMENT Md_mgmax "Maximalmoment Generator" SWORD Def_m_sw_q0p1 0 0 -3276.8000 3276.7000 ECU_ADDRESS 0x007FBFAE /begin FUNCTION_LIST LAYER /end FUNCTION_LIST /end MEASUREMENT
/begin MEASUREMENT T_monate "Borddatum" UBYTE Def_dez_ub_q1 0 0 0.0 255.0000 ECU_ADDRESS 0x007FBFB0 /begin FUNCTION_LIST LAYER /end FUNCTION_LIST /end MEASUREMENT
/begin MEASUREMENT T_tag "Borddatum" UBYTE Def_dez_ub_q1 0 0 0.0 255.0000 ECU_ADDRESS 0x007FBFB1 /begin FUNCTION_LIST LAYER /end FUNCTION_LIST /end MEASUREMENT
/begin MEASUREMENT P_gle "Glühleistung" UWORD Def_p_uw_q0p039 0 0 0.0 2559.9609 ECU_ADDRESS 0x007FBFB2 /begin FUNCTION_LIST LAYER /end FUNCTION_LIST /end MEASUREMENT
/begin MEASUREMENT I_zme "Strom Zumeßeinheit" SWORD Def_i_sw_q0039 0 0 -128.0000 127.9960 ECU_ADDRESS 0x007FBFB4 /begin FUNCTION_LIST LAYER /end FUNCTION_LIST /end MEASUREMENT
/begin MEASUREMENT I_pregelv "Strom Raildruckregelventil" SWORD Def_i_sw_q0039 0 0 -128.0000 127.9960 ECU_ADDRESS 0x007FBFB6 /begin FUNCTION_LIST LAYER /end FUNCTION_LIST /end MEASUREMENT
/begin MEASUREMENT Batt_coort "Codierter Batterieeinbauort" UBYTE Def_dez_ub_q1 0 0 0.0 255.0000 ECU_ADDRESS 0x007FBFB8 /begin FUNCTION_LIST LAYER /end FUNCTION_LIST /end MEASUREMENT
/begin MEASUREMENT Bordnetz "Ausgewähltes Bordnetz(0x01 => CAN11H, 0x02 => CAN12H(BN2000))" UBYTE Def_st_ub_q1 0 0 0.0 255.0000 ECU_ADDRESS 0x007FBFB9 /begin FUNCTION_LIST LAYER /end FUNCTION_LIST /end MEASUREMENT
/begin MEASUREMENT Bsdcontrol "3 Byte Schnittstelle für kt_ibs" UBYTE Def_dez_ub_q1 0 0 0.0 255.0000 ECU_ADDRESS 0x007FBFBA /begin FUNCTION_LIST LAYER /end FUNCTION_LIST /end MEASUREMENT
/begin MEASUREMENT Bsddata "3 Byte Schnittstelle kt_ibs" UBYTE Def_dez_ub_q1 0 0 0.0 255.0000 ECU_ADDRESS 0x007FBFBB /begin FUNCTION_LIST LAYER /end FUNCTION_LIST /end MEASUREMENT
/begin MEASUREMENT Bsdgencv "Chipversion Generator 1" UBYTE Def_st_ub_q1 0 0 0.0 255.0000 ECU_ADDRESS 0x007FBFBC /begin FUNCTION_LIST LAYER /end FUNCTION_LIST /end MEASUREMENT
/begin MEASUREMENT Bsdgencv2 "Chipversion Generatorregler 2" UBYTE Def_st_ub_q1 0 0 0.0 255.0000 ECU_ADDRESS 0x007FBFBD /begin FUNCTION_LIST LAYER /end FUNCTION_LIST /end MEASUREMENT
/begin MEASUREMENT Bsdgenregv "Reglerversion Generator 1" UBYTE Def_st_ub_q1 0 0 0.0 255.0000 ECU_ADDRESS 0x007FBFBE /begin FUNCTION_LIST LAYER /end FUNCTION_LIST /end MEASUREMENT
/begin MEASUREMENT Bsdgenregv2 "Reglerversion Generator 2" UBYTE Def_st_ub_q1 0 0 0.0 255.0000 ECU_ADDRESS 0x007FBFBF /begin FUNCTION_LIST LAYER /end FUNCTION_LIST /end MEASUREMENT
/begin MEASUREMENT Bsdregadr "3 Byte Schnittstelle für kt_ibs" UBYTE Def_dez_ub_q1 0 0 0.0 255.0000 ECU_ADDRESS 0x007FBFC0 /begin FUNCTION_LIST LAYER /end FUNCTION_LIST /end MEASUREMENT
/begin MEASUREMENT Dfgrob "Grobwert Auslastungsgrad Generator 1" UBYTE Def_st_ub_q1 0 0 0.0 255.0000 ECU_ADDRESS 0x007FBFC1 /begin FUNCTION_LIST LAYER /end FUNCTION_LIST /end MEASUREMENT
/begin MEASUREMENT Dfgrob2 "Grobwert Auslastungsgrad Generator 2" UBYTE Def_st_ub_q1 0 0 0.0 255.0000 ECU_ADDRESS 0x007FBFC2 /begin FUNCTION_LIST LAYER /end FUNCTION_LIST /end MEASUREMENT
/begin MEASUREMENT Dfsiggen "Auslastungsgrad Generator 1" UBYTE Def_f_ub_b100 0 0 0.0 99.6093 ECU_ADDRESS 0x007FBFC3 /begin FUNCTION_LIST LAYER /end FUNCTION_LIST /end MEASUREMENT
/begin MEASUREMENT Dfsiggen2 "Auslastungsgrad Generator 2" UBYTE Def_f_ub_b100 0 0 0.0 99.6093 ECU_ADDRESS 0x007FBFC4 /begin FUNCTION_LIST LAYER /end FUNCTION_LIST /end MEASUREMENT
/begin MEASUREMENT Dmd_gen "Maximaler Momentenanstieg Motor für Generator" SWORD Def_dm_sw_q0p1 0 0 -3276.8000 3276.7000 ECU_ADDRESS 0x007FBFC6 /begin FUNCTION_LIST LAYER /end FUNCTION_LIST /end MEASUREMENT
/begin MEASUREMENT Fahrzeug "Fahrzeugtypbezeichnung (E60 = 60, E65 = 65, E46 = 46)" UBYTE Def_dez_ub_q1 0 0 0.0 255.0000 ECU_ADDRESS 0x007FBFC8 /begin FUNCTION_LIST LAYER /end FUNCTION_LIST /end MEASUREMENT
/begin MEASUREMENT Fho "Korrekturfaktor Höhe" UWORD Def_f_uw_b2 0 0 0.0 1.9999 ECU_ADDRESS 0x007FBFCA /begin FUNCTION_LIST LAYER /end FUNCTION_LIST /end MEASUREMENT
/begin MEASUREMENT Gen_manufak "Herstellercode Generator 1" UBYTE Def_st_ub_q1 0 0 0.0 255.0000 ECU_ADDRESS 0x007FBFCC /begin FUNCTION_LIST LAYER /end FUNCTION_LIST /end MEASUREMENT
/begin MEASUREMENT Gen_manufak2 "Herstellercode Generator 2" UBYTE Def_st_ub_q1 0 0 0.0 255.0000 ECU_ADDRESS 0x007FBFCD /begin FUNCTION_LIST LAYER /end FUNCTION_LIST /end MEASUREMENT
/begin MEASUREMENT Gen_typkenn "Kennung Generatortyp Gen 1" UBYTE Def_st_ub_q1 0 0 0.0 255.0000 ECU_ADDRESS 0x007FBFCE /begin FUNCTION_LIST LAYER /end FUNCTION_LIST /end MEASUREMENT
/begin MEASUREMENT Gen_typkenn2 "Kennung Generatortyp Gen 2" UBYTE Def_st_ub_q1 0 0 0.0 255.0000 ECU_ADDRESS 0x007FBFCF /begin FUNCTION_LIST LAYER /end FUNCTION_LIST /end MEASUREMENT
/begin MEASUREMENT Ierr "Erregerstrom Generator1" UBYTE Def_i_ub_q0p125 0 0 0.0 31.8750 ECU_ADDRESS 0x007FBFD0 /begin FUNCTION_LIST LAYER /end FUNCTION_LIST /end MEASUREMENT
/begin MEASUREMENT Ierr2 "Erregerstrom Generator 2" UBYTE Def_i_ub_q0p125 0 0 0.0 31.8750 ECU_ADDRESS 0x007FBFD1 /begin FUNCTION_LIST LAYER /end FUNCTION_LIST /end MEASUREMENT
/begin MEASUREMENT Ierrfgrenz "Kopie begrenzter Erregerstrom Generator 1" UBYTE Def_i_ub_q0p125 0 0 0.0 31.8750 ECU_ADDRESS 0x007FBFD2 /begin FUNCTION_LIST LAYER /end FUNCTION_LIST /end MEASUREMENT
/begin MEASUREMENT Ierrfgrenz2 "Kopie begrenzter Erregerstrom Generator 2" UBYTE Def_i_ub_q0p125 0 0 0.0 31.8750 ECU_ADDRESS 0x007FBFD3 /begin FUNCTION_LIST LAYER /end FUNCTION_LIST /end MEASUREMENT
/begin MEASUREMENT Ierrgrenz2 "Grenzertrregerstrom" UBYTE Def_i_ub_q0p125 0 0 0.0 31.8750 ECU_ADDRESS 0x007FBFD4 /begin FUNCTION_LIST LAYER /end FUNCTION_LIST /end MEASUREMENT
/begin MEASUREMENT Ivvtmot_mw " " SWORD Def_i_sw_q0p0625 0 0 -2048.0000 2047.9375 ECU_ADDRESS 0x007FBFD6 /begin FUNCTION_LIST LAYER /end FUNCTION_LIST /end MEASUREMENT
/begin MEASUREMENT Ivvtmot_mw2 " " SWORD Def_i_sw_q0p0625 0 0 -2048.0000 2047.9375 ECU_ADDRESS 0x007FBFD8 /begin FUNCTION_LIST LAYER /end FUNCTION_LIST /end MEASUREMENT
/begin MEASUREMENT Km_st "Kilometerstand" UWORD Def_km_uw_q10 0 0 0.0 655350.0000 ECU_ADDRESS 0x007FBFDA /begin FUNCTION_LIST LAYER /end FUNCTION_LIST /end MEASUREMENT
/begin MEASUREMENT L_pwmout "Tastverhältnis E-Lüfter" UBYTE Def_tv_ub_q0p390625 0 0 0.0 99.6093 ECU_ADDRESS 0x007FBFDC /begin FUNCTION_LIST LAYER /end FUNCTION_LIST /end MEASUREMENT
/begin MEASUREMENT Mslui "Integr. Luftmasse" UWORD Def_lm_uw_q0p000444 0 0 0.0 29.1266 ECU_ADDRESS 0x007FBFDE /begin FUNCTION_LIST LAYER /end FUNCTION_LIST /end MEASUREMENT
/begin MEASUREMENT Nkw "Drehzahl" SWORD Def_n_sw_q1p0 0 0 -32768.0000 32767.0000 ECU_ADDRESS 0x007FBFE0 /begin FUNCTION_LIST LAYER /end FUNCTION_LIST /end MEASUREMENT
/begin MEASUREMENT Nsllm "Solldrehzahl im Leerlauf ohne Fahrstufe" SWORD Def_n_sw_q1p0 0 0 -32768.0000 32767.0000 ECU_ADDRESS 0x007FBFE2 /begin FUNCTION_LIST LAYER /end FUNCTION_LIST /end MEASUREMENT
/begin MEASUREMENT N_idlms "Leerlaufdrehzahlanhebung von Powermodul" UBYTE Def_st_ub_q1 0 0 0.0 255.0000 ECU_ADDRESS 0x007FBFE4 /begin FUNCTION_LIST LAYER /end FUNCTION_LIST /end MEASUREMENT
/begin MEASUREMENT Rf "Relative Luftfuellung" SWORD Def_rf_sw_q0p01 0 0 -327.6800 327.6700 ECU_ADDRESS 0x007FBFE6 /begin FUNCTION_LIST LAYER /end FUNCTION_LIST /end MEASUREMENT
/begin MEASUREMENT St_ckl15.B_ckl50 "Bedingung Klemme 50 (vom CAN)" UBYTE Def_bit_ub_0 0 0 0.0 255.0 ECU_ADDRESS 0x007FBFE8 /begin FUNCTION_LIST LAYER /end FUNCTION_LIST BIT_MASK 0x1 /end MEASUREMENT
/begin MEASUREMENT St_ckl15.B_ckl30 "Bedingung Klemme R (über CAN)" UBYTE Def_bit_ub_1 0 0 0.0 255.0 ECU_ADDRESS 0x007FBFE8 /begin FUNCTION_LIST LAYER /end FUNCTION_LIST BIT_MASK 0x2 /end MEASUREMENT
/begin MEASUREMENT St_ckl15 "Klemmensignale vom CAN" UBYTE Def_dez_ub_q1 0 0 0.0 255.0000 ECU_ADDRESS 0x007FBFE8 /begin FUNCTION_LIST LAYER /end FUNCTION_LIST /end MEASUREMENT
/begin MEASUREMENT St_egs.B_fs "Bedingung Fahrstufe" UBYTE Def_bit_ub_0 0 0 0.0 255.0 ECU_ADDRESS 0x007FBFE9 /begin FUNCTION_LIST LAYER /end FUNCTION_LIST BIT_MASK 0x1 /end MEASUREMENT
/begin MEASUREMENT St_egs "Statusbyte Automatikgetriebe" UBYTE Def_st_ub_q1 0 0 0.0 255.0000 ECU_ADDRESS 0x007FBFE9 /begin FUNCTION_LIST LAYER /end FUNCTION_LIST /end MEASUREMENT
/begin MEASUREMENT St_genallg.B_abliactiv "Bedingung Abblendlicht aktiv" UBYTE Def_bit_ub_1 0 0 0.0 255.0 ECU_ADDRESS 0x007FBFEA /begin FUNCTION_LIST LAYER /end FUNCTION_LIST BIT_MASK 0x2 /end MEASUREMENT
/begin MEASUREMENT St_genallg.B_bsdprot1 "Bedingung BSD Protokollinhalt für BSD1 Regler" UBYTE Def_bit_ub_3 0 0 0.0 255.0 ECU_ADDRESS 0x007FBFEA /begin FUNCTION_LIST LAYER /end FUNCTION_LIST BIT_MASK 0x8 /end MEASUREMENT
/begin MEASUREMENT St_genallg.B_bsdprot2 "Bedingung BSD Protokollinhalt für BSD 2 Regler" UBYTE Def_bit_ub_4 0 0 0.0 255.0 ECU_ADDRESS 0x007FBFEA /begin FUNCTION_LIST LAYER /end FUNCTION_LIST BIT_MASK 0x10 /end MEASUREMENT
/begin MEASUREMENT St_genallg.B_gen2inst "2. Generator installiert" UBYTE Def_bit_ub_2 0 0 0.0 255.0 ECU_ADDRESS 0x007FBFEA /begin FUNCTION_LIST LAYER /end FUNCTION_LIST BIT_MASK 0x4 /end MEASUREMENT
/begin MEASUREMENT St_genallg.B_iliactiv "Bedingung Innenlicht aktiv" UBYTE Def_bit_ub_0 0 0 0.0 255.0 ECU_ADDRESS 0x007FBFEA /begin FUNCTION_LIST LAYER /end FUNCTION_LIST BIT_MASK 0x1 /end MEASUREMENT
/begin MEASUREMENT St_genallg.B_rd_gentyp "Bedingung Schalter APK zum Auslesen Hersteller und Generatortyp" UBYTE Def_bit_ub_5 0 0 0.0 255.0 ECU_ADDRESS 0x007FBFEA /begin FUNCTION_LIST LAYER /end FUNCTION_LIST BIT_MASK 0x20 /end MEASUREMENT
/begin MEASUREMENT St_genallg "Allgemeine Eingangsbits" UBYTE Def_st_ub_q1 0 0 0.0 255.0000 ECU_ADDRESS 0x007FBFEA /begin FUNCTION_LIST LAYER /end FUNCTION_LIST /end MEASUREMENT
/begin MEASUREMENT St_generator.B_crashgen "Bedingung Generator abschalten bei Crash" UBYTE Def_bit_ub_6 0 0 0.0 255.0 ECU_ADDRESS 0x007FBFEB /begin FUNCTION_LIST LAYER /end FUNCTION_LIST BIT_MASK 0x40 /end MEASUREMENT
/begin MEASUREMENT St_generator.B_genactiv "Bedingung Generatorinterface aktiv" UBYTE Def_bit_ub_0 0 0 0.0 255.0 ECU_ADDRESS 0x007FBFEB /begin FUNCTION_LIST LAYER /end FUNCTION_LIST BIT_MASK 0x1 /end MEASUREMENT
/begin MEASUREMENT St_generator.B_genfbsd "Bedingung Kommunikationsverlust BSD Generator" UBYTE Def_bit_ub_2 0 0 0.0 255.0 ECU_ADDRESS 0x007FBFEB /begin FUNCTION_LIST LAYER /end FUNCTION_LIST BIT_MASK 0x4 /end MEASUREMENT
/begin MEASUREMENT St_generator.B_genfel "Bedingung Generatorfehler elektrisch" UBYTE Def_bit_ub_3 0 0 0.0 255.0 ECU_ADDRESS 0x007FBFEB /begin FUNCTION_LIST LAYER /end FUNCTION_LIST BIT_MASK 0x8 /end MEASUREMENT
/begin MEASUREMENT St_generator.B_genfht "Bedingung Generatorzustand hohe Temparatur" UBYTE Def_bit_ub_4 0 0 0.0 255.0 ECU_ADDRESS 0x007FBFEB /begin FUNCTION_LIST LAYER /end FUNCTION_LIST BIT_MASK 0x10 /end MEASUREMENT
/begin MEASUREMENT St_generator.B_genfme "Bedingung Generatorfehler mechanisch" UBYTE Def_bit_ub_5 0 0 0.0 255.0 ECU_ADDRESS 0x007FBFEB /begin FUNCTION_LIST LAYER /end FUNCTION_LIST BIT_MASK 0x20 /end MEASUREMENT
/begin MEASUREMENT St_generator "Statusbyte Generator" UBYTE Def_st_ub_q1 0 0 0.0 255.0000 ECU_ADDRESS 0x007FBFEB /begin FUNCTION_LIST LAYER /end FUNCTION_LIST /end MEASUREMENT
/begin MEASUREMENT St_generator2.B_genactiv2 "Bedingung Generatorinterface Gen 2 activ" UBYTE Def_bit_ub_0 0 0 0.0 255.0 ECU_ADDRESS 0x007FBFEC /begin FUNCTION_LIST LAYER /end FUNCTION_LIST BIT_MASK 0x1 /end MEASUREMENT
/begin MEASUREMENT St_generator2.B_genfbsd2 "Kommunikationsverlust BSD Generator 2" UBYTE Def_bit_ub_2 0 0 0.0 255.0 ECU_ADDRESS 0x007FBFEC /begin FUNCTION_LIST LAYER /end FUNCTION_LIST BIT_MASK 0x4 /end MEASUREMENT
/begin MEASUREMENT St_generator2.B_genfel2 "Generatorfehler elektrisch Generator 2" UBYTE Def_bit_ub_3 0 0 0.0 255.0 ECU_ADDRESS 0x007FBFEC /begin FUNCTION_LIST LAYER /end FUNCTION_LIST BIT_MASK 0x8 /end MEASUREMENT
/begin MEASUREMENT St_generator2.B_genfht2 "Generatorfehler Übertemperatur Gen 2" UBYTE Def_bit_ub_4 0 0 0.0 255.0 ECU_ADDRESS 0x007FBFEC /begin FUNCTION_LIST LAYER /end FUNCTION_LIST BIT_MASK 0x10 /end MEASUREMENT
/begin MEASUREMENT St_generator2.B_genfme2 "Generatorfehler Mechanisch Generator 2" UBYTE Def_bit_ub_5 0 0 0.0 255.0 ECU_ADDRESS 0x007FBFEC /begin FUNCTION_LIST LAYER /end FUNCTION_LIST BIT_MASK 0x20 /end MEASUREMENT
/begin MEASUREMENT St_generator2 "Statuswort für 2. Generator" UBYTE Def_st_ub_q1 0 0 0.0 255.0000 ECU_ADDRESS 0x007FBFEC /begin FUNCTION_LIST LAYER /end FUNCTION_LIST /end MEASUREMENT
/begin MEASUREMENT St_genll.B_lrfoff "Kopie Drehzahlschwelle für LR-Funktion Generator 1 aktiv" UBYTE Def_bit_ub_0 0 0 0.0 255.0 ECU_ADDRESS 0x007FBFED /begin FUNCTION_LIST LAYER /end FUNCTION_LIST BIT_MASK 0x1 /end MEASUREMENT
/begin MEASUREMENT St_genll.B_lrfoff2 "Kopie Drehzahlschwelle für LR-Funktion Generator 2 aktiv" UBYTE Def_bit_ub_1 0 0 0.0 255.0 ECU_ADDRESS 0x007FBFED /begin FUNCTION_LIST LAYER /end FUNCTION_LIST BIT_MASK 0x2 /end MEASUREMENT
/begin MEASUREMENT St_genll.B_lrreg1ak "LR-Register 1 aktiv Generator 1" UBYTE Def_bit_ub_2 0 0 0.0 255.0 ECU_ADDRESS 0x007FBFED /begin FUNCTION_LIST LAYER /end FUNCTION_LIST BIT_MASK 0x4 /end MEASUREMENT
/begin MEASUREMENT St_genll.B_lrreg1ak2 "LR-Register 1 aktiv Generator 2" UBYTE Def_bit_ub_3 0 0 0.0 255.0 ECU_ADDRESS 0x007FBFED /begin FUNCTION_LIST LAYER /end FUNCTION_LIST BIT_MASK 0x8 /end MEASUREMENT
/begin MEASUREMENT St_genll "LR Eingänge" UBYTE Def_st_ub_q1 0 0 0.0 255.0000 ECU_ADDRESS 0x007FBFED /begin FUNCTION_LIST LAYER /end FUNCTION_LIST /end MEASUREMENT
/begin MEASUREMENT St_instr3_1.S_tns "Bedingung aus Schalter Tag-/Nachtbeleuchtung" UBYTE Def_bit_ub_6 0 0 0.0 255.0 ECU_ADDRESS 0x007FBFEE /begin FUNCTION_LIST LAYER /end FUNCTION_LIST BIT_MASK 0x40 /end MEASUREMENT
/begin MEASUREMENT St_instr3_1 "Status Can Botschaft Instr3 (CAN11)" UBYTE Def_st_ub_q1 0 0 0.0 255.0000 ECU_ADDRESS 0x007FBFEE /begin FUNCTION_LIST LAYER /end FUNCTION_LIST /end MEASUREMENT
/begin MEASUREMENT St_kl15.B_kl15_ep "Bitgröße, Bedingung KL15 gesetzt" UBYTE Def_bit_ub_0 0 0 0.0 255.0 ECU_ADDRESS 0x007FBFEF /begin FUNCTION_LIST LAYER /end FUNCTION_LIST BIT_MASK 0x1 /end MEASUREMENT
/begin MEASUREMENT St_kl15 "Statusbyte Klemme 15" UBYTE Def_st_ub_q1 0 0 0.0 255.0000 ECU_ADDRESS 0x007FBFEF /begin FUNCTION_LIST LAYER /end FUNCTION_LIST /end MEASUREMENT
/begin MEASUREMENT St_llr.B_llrein "wird beim ersten LL-Regler ein gesetzt und nicht mehr geändert" UWORD Def_bit_uw_0 0 0 0.0 65535.0 ECU_ADDRESS 0x007FBFF0 /begin FUNCTION_LIST LAYER /end FUNCTION_LIST BIT_MASK 0x1 /end MEASUREMENT
/begin MEASUREMENT St_llr "Statusword Leerlaufregler" UWORD Def_st_uw_q1 0 0 0.0 65535.0000 ECU_ADDRESS 0x007FBFF0 /begin FUNCTION_LIST LAYER /end FUNCTION_LIST /end MEASUREMENT
/begin MEASUREMENT St_master.B_masterhw "Bedingung Master SG" UBYTE Def_bit_ub_0 0 0 0.0 255.0 ECU_ADDRESS 0x007FBFF2 /begin FUNCTION_LIST LAYER /end FUNCTION_LIST BIT_MASK 0x1 /end MEASUREMENT
/begin MEASUREMENT St_master "Statusbyte master" UBYTE Def_st_ub_q1 0 0 0.0 255.0000 ECU_ADDRESS 0x007FBFF2 /begin FUNCTION_LIST LAYER /end FUNCTION_LIST /end MEASUREMENT
/begin MEASUREMENT St_mdna.B_lastab "" UBYTE Def_bit_ub_0 0 0 0.0 255.0 ECU_ADDRESS 0x007FBFF3 /begin FUNCTION_LIST LAYER /end FUNCTION_LIST BIT_MASK 0x1 /end MEASUREMENT
/begin MEASUREMENT St_mdna "" UBYTE Def_st_ub_q1 0 0 0.0 255.0000 ECU_ADDRESS 0x007FBFF3 /begin FUNCTION_LIST LAYER /end FUNCTION_LIST /end MEASUREMENT
/begin MEASUREMENT St_mkwchn.B_kwdreht "Bedingung drehende Kurbelwelle erkannt" UBYTE Def_bit_ub_5 0 0 0.0 255.0 ECU_ADDRESS 0x007FBFF4 /begin FUNCTION_LIST LAYER /end FUNCTION_LIST BIT_MASK 0x20 /end MEASUREMENT
/begin MEASUREMENT St_mkwchn "Statuswort Masterkurbelwelle" UBYTE Def_dez_ub_q1 0 0 0.0 255.0000 ECU_ADDRESS 0x007FBFF4 /begin FUNCTION_LIST LAYER /end FUNCTION_LIST /end MEASUREMENT
/begin MEASUREMENT St_motzustd.B_ll "Bedingung Leerlauf" UWORD Def_bit_uw_3 0 0 0.0 65535.0 ECU_ADDRESS 0x007FBFF6 /begin FUNCTION_LIST LAYER /end FUNCTION_LIST BIT_MASK 0x8 /end MEASUREMENT
/begin MEASUREMENT St_motzustd.B_vl "Bedingung Vollast" UWORD Def_bit_uw_5 0 0 0.0 65535.0 ECU_ADDRESS 0x007FBFF6 /begin FUNCTION_LIST LAYER /end FUNCTION_LIST BIT_MASK 0x20 /end MEASUREMENT
/begin MEASUREMENT St_motzustd "Statusword fuer Motorzustand" UWORD Def_st_uw_q1 0 0 0.0 65535.0000 ECU_ADDRESS 0x007FBFF6 /begin FUNCTION_LIST LAYER /end FUNCTION_LIST /end MEASUREMENT
/begin MEASUREMENT St_pmi.B_fabttreg "Bedingung Batterietausch registrieren" UBYTE Def_bit_ub_1 0 0 0.0 255.0 ECU_ADDRESS 0x007FBFF8 /begin FUNCTION_LIST LAYER /end FUNCTION_LIST BIT_MASK 0x2 /end MEASUREMENT
/begin MEASUREMENT St_pmi.B_fahisrst "Bedingung Histogramm Reset" UBYTE Def_bit_ub_2 0 0 0.0 255.0 ECU_ADDRESS 0x007FBFF8 /begin FUNCTION_LIST LAYER /end FUNCTION_LIST BIT_MASK 0x4 /end MEASUREMENT
/begin MEASUREMENT St_pmi "Statuswort Eingänge LCP" UBYTE Def_dez_ub_q1 0 0 0.0 255.0000 ECU_ADDRESS 0x007FBFF8 /begin FUNCTION_LIST LAYER /end FUNCTION_LIST /end MEASUREMENT
/begin MEASUREMENT St_pwf.B_pwf "Bedingung Powerfail" UBYTE Def_bit_ub_0 0 0 0.0 255.0 ECU_ADDRESS 0x007FBFF9 /begin FUNCTION_LIST LAYER /end FUNCTION_LIST BIT_MASK 0x1 /end MEASUREMENT
/begin MEASUREMENT St_pwf "Statuswert fuer Power-fail" UBYTE Def_st_ub_q1 0 0 0.0 255.0000 ECU_ADDRESS 0x007FBFF9 /begin FUNCTION_LIST LAYER /end FUNCTION_LIST /end MEASUREMENT
/begin MEASUREMENT St_sawe.B_sa "Bedingung Schubabschaltung" UBYTE Def_bit_ub_3 0 0 0.0 255.0 ECU_ADDRESS 0x007FBFFA /begin FUNCTION_LIST LAYER /end FUNCTION_LIST BIT_MASK 0x8 /end MEASUREMENT
/begin MEASUREMENT St_sawe "Statusbyte Schubabschaltung/Wiedereinsetzen" UBYTE Def_st_ub_q1 0 0 0.0 255.0000 ECU_ADDRESS 0x007FBFFA /begin FUNCTION_LIST LAYER /end FUNCTION_LIST /end MEASUREMENT
/begin MEASUREMENT St_slp.B_fasls "Bed. Funktionsanf Sekundärluftsystem" UBYTE Def_bit_ub_0 0 0 0.0 255.0 ECU_ADDRESS 0x007FBFFB /begin FUNCTION_LIST LAYER /end FUNCTION_LIST BIT_MASK 0x1 /end MEASUREMENT
/begin MEASUREMENT St_slp.B_genslp "Bedingung Spannungsanforderung Sekundärluftpumpe" UBYTE Def_bit_ub_2 0 0 0.0 255.0 ECU_ADDRESS 0x007FBFFB /begin FUNCTION_LIST LAYER /end FUNCTION_LIST BIT_MASK 0x4 /end MEASUREMENT
/begin MEASUREMENT St_slp "Statusbyte Sekundärluftpumpe" UBYTE Def_st_ub_q1 0 0 0.0 255.0000 ECU_ADDRESS 0x007FBFFB /begin FUNCTION_LIST LAYER /end FUNCTION_LIST /end MEASUREMENT
/begin MEASUREMENT St_sls.B_sls "Bedingung Sekundärluftsystem aktiv" UBYTE Def_bit_ub_0 0 0 0.0 255.0 ECU_ADDRESS 0x007FBFFC /begin FUNCTION_LIST LAYER /end FUNCTION_LIST BIT_MASK 0x1 /end MEASUREMENT
/begin MEASUREMENT St_sls "Statuswort Sekundärluftsystem" UBYTE Def_dez_ub_q1 0 0 0.0 255.0000 ECU_ADDRESS 0x007FBFFC /begin FUNCTION_LIST LAYER /end FUNCTION_LIST /end MEASUREMENT
/begin MEASUREMENT St_zwktibs.B_ibsactiv "Bedingung Kommunikation mit IBS vorhanden" UBYTE Def_bit_ub_0 0 0 0.0 255.0 ECU_ADDRESS 0x007FBFFD /begin FUNCTION_LIST LAYER /end FUNCTION_LIST BIT_MASK 0x1 /end MEASUREMENT
/begin MEASUREMENT St_zwktibs "Statuswort zwktibs" UBYTE Def_dez_ub_q1 0 0 0.0 255.0000 ECU_ADDRESS 0x007FBFFD /begin FUNCTION_LIST LAYER /end FUNCTION_LIST /end MEASUREMENT
/begin MEASUREMENT Tans "Ansauglufttemperatur" SWORD Def_t_sw_q0p1 0 0 -3276.8000 3276.7000 ECU_ADDRESS 0x007FBFFE /begin FUNCTION_LIST LAYER /end FUNCTION_LIST /end MEASUREMENT
/begin MEASUREMENT Tchip "Chiptemperatur Generator1" SWORD Def_t_sw_q0p1 0 0 -3276.8000 3276.7000 ECU_ADDRESS 0x007FC000 /begin FUNCTION_LIST LAYER /end FUNCTION_LIST /end MEASUREMENT
/begin MEASUREMENT Tchip2 "Chiptemperatur Generator2" SWORD Def_t_sw_q0p1 0 0 -3276.8000 3276.7000 ECU_ADDRESS 0x007FC002 /begin FUNCTION_LIST LAYER /end FUNCTION_LIST /end MEASUREMENT
/begin MEASUREMENT Td_f_ierr "Filterzeit Erregerstrom aus BSD-Timingkoordinator" UBYTE Def_td_ub_q0p01 0 0 0.0 2.5500 ECU_ADDRESS 0x007FC004 /begin FUNCTION_LIST LAYER /end FUNCTION_LIST /end MEASUREMENT
/begin MEASUREMENT Td_rdgenreg2 "Auslesezeit für DF-Signal und Diagnose" UBYTE Def_td_ub_q0p1 0 0 0.0 25.5000 ECU_ADDRESS 0x007FC005 /begin FUNCTION_LIST LAYER /end FUNCTION_LIST /end MEASUREMENT
/begin MEASUREMENT Tkat_mod "Modellierte Katalysatortemperatur" SWORD Def_t_sw_q0p1 0 0 -3276.8000 3276.7000 ECU_ADDRESS 0x007FC006 /begin FUNCTION_LIST LAYER /end FUNCTION_LIST /end MEASUREMENT
/begin MEASUREMENT Tlrfgen "Kopier Generator1 LR Vorgabe auf Bus gelegt" UBYTE Def_td_ub_q0p1 0 0 0.0 25.5000 ECU_ADDRESS 0x007FC008 /begin FUNCTION_LIST LAYER /end FUNCTION_LIST /end MEASUREMENT
/begin MEASUREMENT Tlrfgen2 "Kopier Generator2 LR Vorgabe auf Bus gelegt" UBYTE Def_td_ub_q0p1 0 0 0.0 25.5000 ECU_ADDRESS 0x007FC009 /begin FUNCTION_LIST LAYER /end FUNCTION_LIST /end MEASUREMENT
/begin MEASUREMENT Tluft "Lufttemperatur" SWORD Def_t_sw_q0p01 0 0 -327.6800 327.6700 ECU_ADDRESS 0x007FC00A /begin FUNCTION_LIST LAYER /end FUNCTION_LIST /end MEASUREMENT
/begin MEASUREMENT Tmot "Kühlwassertemperatur" SWORD Def_t_sw_q0p01 0 0 -327.6800 327.6700 ECU_ADDRESS 0x007FC00C /begin FUNCTION_LIST LAYER /end FUNCTION_LIST /end MEASUREMENT
/begin MEASUREMENT Twasser "Wassertemperatur" SWORD Def_t_sw_q0p01 0 0 -327.6800 327.6700 ECU_ADDRESS 0x007FC00E /begin FUNCTION_LIST LAYER /end FUNCTION_LIST /end MEASUREMENT
/begin MEASUREMENT Tmot_start "Motorstarttemperatur" SWORD Def_t_sw_q0p01 0 0 -327.6800 327.6700 ECU_ADDRESS 0x007FC010 /begin FUNCTION_LIST LAYER /end FUNCTION_LIST /end MEASUREMENT
/begin MEASUREMENT Tn_start_10 "Zeit nach Startende in 10ms aufgelöst" UWORD Def_td_uw_q0p01 0 0 0.0 655.3500 ECU_ADDRESS 0x007FC012 /begin FUNCTION_LIST LAYER /end FUNCTION_LIST /end MEASUREMENT
/begin MEASUREMENT Tn_abstell "Abstellzeit" UWORD Def_dez_uw_q1 0 0 0.0 65535.0000 ECU_ADDRESS 0x007FC014 /begin FUNCTION_LIST LAYER /end FUNCTION_LIST /end MEASUREMENT
/begin MEASUREMENT Tumg "Umgebungstemperatur" SWORD Def_t_sw_q0p1 0 0 -3276.8000 3276.7000 ECU_ADDRESS 0x007FC016 /begin FUNCTION_LIST LAYER /end FUNCTION_LIST /end MEASUREMENT
/begin MEASUREMENT Tumg_can "Umgebungstemperatur" SWORD Def_t_sw_q0p1 0 0 -3276.8000 3276.7000 ECU_ADDRESS 0x007FC018 /begin FUNCTION_LIST LAYER /end FUNCTION_LIST /end MEASUREMENT
/begin MEASUREMENT U_fgen "Kopierter Wert von zum Generator gesendete Sollspannung Generator 1" UWORD Def_u_uw_q0p1 0 0 0.0 6553.5000 ECU_ADDRESS 0x007FC01A /begin FUNCTION_LIST LAYER /end FUNCTION_LIST /end MEASUREMENT
/begin MEASUREMENT U_fgen2 "Kopierter Wert von zum Generator gesendete Sollspannung Generator 2" UWORD Def_u_uw_q0p1 0 0 0.0 6553.5000 ECU_ADDRESS 0x007FC01C /begin FUNCTION_LIST LAYER /end FUNCTION_LIST /end MEASUREMENT
/begin MEASUREMENT U_gen_slp "Spannungsanforderung Sekundärluftpumpe" UWORD Def_u_uw_q0p1 0 0 0.0 6553.5000 ECU_ADDRESS 0x007FC01E /begin FUNCTION_LIST LAYER /end FUNCTION_LIST /end MEASUREMENT
/begin MEASUREMENT Ub "Bordnetzspannung" UWORD Def_u_uw_q0p0942 0 0 0.0 6173.3970 ECU_ADDRESS 0x007FC020 /begin FUNCTION_LIST LAYER /end FUNCTION_LIST /end MEASUREMENT
/begin MEASUREMENT U_gensollpm "Sollwert Spannung vom Powermodul" SWORD Def_u_sw_b128 0 0 -128.0000 127.9960 ECU_ADDRESS 0x007FC022 /begin FUNCTION_LIST LAYER /end FUNCTION_LIST /end MEASUREMENT
/begin MEASUREMENT Uregnom "Nominalspannung Regler Generator 1" UWORD Def_u_uw_q0p1 0 0 0.0 6553.5000 ECU_ADDRESS 0x007FC024 /begin FUNCTION_LIST LAYER /end FUNCTION_LIST /end MEASUREMENT
/begin MEASUREMENT Uregnom2 "Nominalspannung Regler Generator 2" UWORD Def_u_uw_q0p1 0 0 0.0 6553.5000 ECU_ADDRESS 0x007FC026 /begin FUNCTION_LIST LAYER /end FUNCTION_LIST /end MEASUREMENT
/begin MEASUREMENT V "Fahrzeuggeschwindigkeit" UWORD Def_v_uw_q1p0 0 0 0.0 360.0000 ECU_ADDRESS 0x007FC028 /begin FUNCTION_LIST LAYER /end FUNCTION_LIST /end MEASUREMENT
/begin MEASUREMENT W_ub "Ub von AD-Wandler" UBYTE Def_u_ub_q0p0942 0 0 0.0 24.0210 ECU_ADDRESS 0x007FC02A /begin FUNCTION_LIST LAYER /end FUNCTION_LIST /end MEASUREMENT
/begin MEASUREMENT Ztageabs "Tagezähler vom Kombi" UWORD Def_dez_uw_q1 0 0 0.0 65535.0000 ECU_ADDRESS 0x007FC02C /begin FUNCTION_LIST LAYER /end FUNCTION_LIST /end MEASUREMENT
/begin MEASUREMENT Oz_datstat "Status Anzeige Uhrzeit Datum" UBYTE Def_dez_ub_q1 0 0 0.0 255.0000 ECU_ADDRESS 0x007FC02E /begin FUNCTION_LIST LAYER /end FUNCTION_LIST /end MEASUREMENT
/begin MEASUREMENT Bosrlsmr "Restlaufstrecke Motoröl vom Kombi" SWORD Def_km_sw_q10 0 0 -327680.0000 327670.0000 ECU_ADDRESS 0x007FC030 /begin FUNCTION_LIST LAYER /end FUNCTION_LIST /end MEASUREMENT
/begin MEASUREMENT Bosrlsmt "Restlaufstrecke Motoröl vom Kombi" SWORD Def_km_sw_q10 0 0 -327680.0000 327670.0000 ECU_ADDRESS 0x007FC032 /begin FUNCTION_LIST LAYER /end FUNCTION_LIST /end MEASUREMENT
/begin MEASUREMENT Bosrw2t "Prognose_Intervall_Weg vom Tester" UBYTE Def_km_ub_q1000 0 0 0.0 255000.0000 ECU_ADDRESS 0x007FC034 /begin FUNCTION_LIST LAYER /end FUNCTION_LIST /end MEASUREMENT
/begin MEASUREMENT Bosmzielt "Zieltermin_Monat vom Tester" UBYTE Def_dez_ub_q1 0 0 0.0 255.0000 ECU_ADDRESS 0x007FC035 /begin FUNCTION_LIST LAYER /end FUNCTION_LIST /end MEASUREMENT
/begin MEASUREMENT Bosjzielt "Zieltermin_Jahr vom Tester" UBYTE Def_dez_ub_q1 0 0 0.0 255.0000 ECU_ADDRESS 0x007FC036 /begin FUNCTION_LIST LAYER /end FUNCTION_LIST /end MEASUREMENT
/begin MEASUREMENT Bosprog2t "Prognose_Intervall_Zeit vom Tester" UBYTE Def_dez_ub_q1 0 0 0.0 255.0000 ECU_ADDRESS 0x007FC037 /begin FUNCTION_LIST LAYER /end FUNCTION_LIST /end MEASUREMENT
/begin MEASUREMENT Oz_resetr "Status der Resetart vom Kombi" UBYTE Def_dez_ub_q1 0 0 0.0 255.0000 ECU_ADDRESS 0x007FC038 /begin FUNCTION_LIST LAYER /end FUNCTION_LIST /end MEASUREMENT
/begin MEASUREMENT Wped "Pedalwertgeberposition" SWORD Def_tv_sw_q0p0244 0 0 -800.0000 799.9755 ECU_ADDRESS 0x007FC03A /begin FUNCTION_LIST LAYER /end FUNCTION_LIST /end MEASUREMENT
/begin MEASUREMENT Ml "Luftmasse pro Zylinder" SWORD Def_ml_sw_q0p1 0 0 -3276.8000 3276.7000 ECU_ADDRESS 0x007FC03C /begin FUNCTION_LIST LAYER /end FUNCTION_LIST /end MEASUREMENT
/begin MEASUREMENT Me_ist "Einspritzmasse aktuell" SWORD Def_me_sw_q0p01 0 0 -327.6800 327.6700 ECU_ADDRESS 0x007FC03E /begin FUNCTION_LIST LAYER /end FUNCTION_LIST /end MEASUREMENT
/begin MEASUREMENT La_ist1 "Lambdaistwert" UWORD Def_f_uw_b16 0 0 0.0 15.9997 ECU_ADDRESS 0x007FC040 /begin FUNCTION_LIST LAYER /end FUNCTION_LIST /end MEASUREMENT
/begin MEASUREMENT Pld "Ladedruck" SWORD Def_p_sw_q1 0 0 -32768.0000 32767.0000 ECU_ADDRESS 0x007FC042 /begin FUNCTION_LIST LAYER /end FUNCTION_LIST /end MEASUREMENT
/begin MEASUREMENT Tv_pld "Tastverhältnis Ladedrucksteller" SWORD Def_tv_sw_q0p01 0 0 -327.6800 327.6700 ECU_ADDRESS 0x007FC044 /begin FUNCTION_LIST LAYER /end FUNCTION_LIST /end MEASUREMENT
/begin MEASUREMENT Tv_agr "Tastverhältnis AGR-Steller" SWORD Def_tv_sw_q0p01 0 0 -327.6800 327.6700 ECU_ADDRESS 0x007FC046 /begin FUNCTION_LIST LAYER /end FUNCTION_LIST /end MEASUREMENT
/begin MEASUREMENT Fid_manluft "Funktionsidentifier Mandetek Luftpfad" UBYTE Def_dez_ub_q1 0 0 0.0 255.0000 ECU_ADDRESS 0x007FC048 /begin FUNCTION_LIST LAYER /end FUNCTION_LIST /end MEASUREMENT
/begin MEASUREMENT Fid_manhydr "Funktionsidentifier Mandetek Hydraulikpfad" UBYTE Def_dez_ub_q1 0 0 0.0 255.0000 ECU_ADDRESS 0x007FC049 /begin FUNCTION_LIST LAYER /end FUNCTION_LIST /end MEASUREMENT
/begin MEASUREMENT Batt_class "Klassifizierung der in diesem Fzg. eingebauten Batterie" UBYTE Def_dez_ub_q1 0 0 0.0 255.0000 ECU_ADDRESS 0x007FD758 /begin FUNCTION_LIST LAYER /end FUNCTION_LIST /end MEASUREMENT
/begin MEASUREMENT Ikurz_ogr "Obere Grenze Kurzschlussstrom vom CAS" UBYTE Def_i_ub_q10 0 0 0.0 2550.0000 ECU_ADDRESS 0x007FD759 /begin FUNCTION_LIST LAYER /end FUNCTION_LIST /end MEASUREMENT
/begin MEASUREMENT Ikurz_ugr "Untere Grenze Kurzschlussstrom vom CAS" UBYTE Def_i_ub_q10 0 0 0.0 2550.0000 ECU_ADDRESS 0x007FD75A /begin FUNCTION_LIST LAYER /end FUNCTION_LIST /end MEASUREMENT
/begin MEASUREMENT Iwakeupgr "Fahrzeugspezifischer Ruhestrom" UBYTE Def_i_ub_q0p001 0 0 0.0 0.2550 ECU_ADDRESS 0x007FD75B /begin FUNCTION_LIST LAYER /end FUNCTION_LIST /end MEASUREMENT
/begin MEASUREMENT Pmsv "Angemeldete Powermanagment Standverbraucher" UBYTE Def_dez_ub_q1 0 0 0.0 255.0000 ECU_ADDRESS 0x007FD75C ARRAY_SIZE 15 /begin FUNCTION_LIST LAYER /end FUNCTION_LIST /end MEASUREMENT
/begin MEASUREMENT Tmot_abstell "Motorstarttemperatur" SWORD Def_t_sw_q0p01 0 0 -327.6800 327.6700 ECU_ADDRESS 0x007FD76C /begin FUNCTION_LIST LAYER /end FUNCTION_LIST /end MEASUREMENT
/begin MEASUREMENT Tn_abstellm "Abstellzeit in Minuten" UWORD Def_dez_uw_q1 0 0 0.0 65535.0000 ECU_ADDRESS 0x007FD76E /begin FUNCTION_LIST LAYER /end FUNCTION_LIST /end MEASUREMENT
/begin MEASUREMENT Bosid2r "ID_2_BOS_Rückstellung_2" UBYTE Def_dez_ub_q1 0 0 0.0 255.0000 ECU_ADDRESS 0x007FD770 /begin FUNCTION_LIST LAYER /end FUNCTION_LIST /end MEASUREMENT
/begin MEASUREMENT Bosfxid2r "ID_Funktion_BOS_Rückstellung_2" UWORD Def_dez_uw_q1 0 0 0.0 65535.0000 ECU_ADDRESS 0x007FD772 /begin FUNCTION_LIST LAYER /end FUNCTION_LIST /end MEASUREMENT
/begin MEASUREMENT Bosjzielr "Zieltermin_Monat_BOS_Rückstellung_2" UBYTE Def_dez_ub_q1 0 0 0.0 255.0000 ECU_ADDRESS 0x007FD774 /begin FUNCTION_LIST LAYER /end FUNCTION_LIST /end MEASUREMENT
/begin MEASUREMENT Bosmzielr "Zieltermin_Jahr_BOS_Rückstellung_2" UBYTE Def_dez_ub_q1 0 0 0.0 255.0000 ECU_ADDRESS 0x007FD775 /begin FUNCTION_LIST LAYER /end FUNCTION_LIST /end MEASUREMENT
/begin MEASUREMENT Bosprog2r "Prognose_Intervall_Zeit_BOS_Rückstellung_2" UBYTE Def_dez_ub_q1 0 0 0.0 255.0000 ECU_ADDRESS 0x007FD776 /begin FUNCTION_LIST LAYER /end FUNCTION_LIST /end MEASUREMENT
/begin MEASUREMENT Bosrw2r "Prognose_Intervall_Weg_BOS_Rückstellung_2" UBYTE Def_km_ub_q1000 0 0 0.0 255000.0000 ECU_ADDRESS 0x007FD777 /begin FUNCTION_LIST LAYER /end FUNCTION_LIST /end MEASUREMENT
/begin MEASUREMENT Km_st_1 "Wegstrecke_km auf 1km genau" ULONG Def_dez_ul_q1 0 0 0.0 2147483647.0000 ECU_ADDRESS 0x007FD778 /begin FUNCTION_LIST LAYER /end FUNCTION_LIST /end MEASUREMENT
/begin MEASUREMENT St_start.B_sta "Bedingung Automatikstart" UBYTE Def_bit_ub_7 0 0 0.0 255.0 ECU_ADDRESS 0x007FD77C /begin FUNCTION_LIST LAYER /end FUNCTION_LIST BIT_MASK 0x80 /end MEASUREMENT
/begin MEASUREMENT St_start.B_startende "Bedingung Startende" UBYTE Def_bit_ub_3 0 0 0.0 255.0 ECU_ADDRESS 0x007FD77C /begin FUNCTION_LIST LAYER /end FUNCTION_LIST BIT_MASK 0x8 /end MEASUREMENT
/begin MEASUREMENT St_start "Status Start" UBYTE Def_st_ub_q1 0 0 0.0 255.0000 ECU_ADDRESS 0x007FD77C /begin FUNCTION_LIST LAYER /end FUNCTION_LIST /end MEASUREMENT
/begin MEASUREMENT St_elu.B_elu600 "Bedingung Elüftertyp" UBYTE Def_bit_ub_0 0 0 0.0 255.0 ECU_ADDRESS 0x007FD77D /begin FUNCTION_LIST LAYER /end FUNCTION_LIST BIT_MASK 0x1 /end MEASUREMENT
/begin MEASUREMENT St_elu "Status elu" UBYTE Def_st_ub_q1 0 0 0.0 255.0000 ECU_ADDRESS 0x007FD77D /begin FUNCTION_LIST LAYER /end FUNCTION_LIST /end MEASUREMENT
/begin MEASUREMENT St_ibs.B_ibsdetec "Bedingung IBS erkannt" UBYTE Def_bit_ub_0 0 0 0.0 255.0 ECU_ADDRESS 0x007FD77E /begin FUNCTION_LIST LAYER /end FUNCTION_LIST BIT_MASK 0x1 /end MEASUREMENT
/begin MEASUREMENT St_ibs "Status ibs" UBYTE Def_st_ub_q1 0 0 0.0 255.0000 ECU_ADDRESS 0x007FD77E /begin FUNCTION_LIST LAYER /end FUNCTION_LIST /end MEASUREMENT
/begin MEASUREMENT St_pmbnstab.B_nachlend "Bedingung Nachlauf beendet" UBYTE Def_bit_ub_0 0 0 0.0 255.0 ECU_ADDRESS 0x007FD77F /begin FUNCTION_LIST LAYER /end FUNCTION_LIST BIT_MASK 0x1 /end MEASUREMENT
/begin MEASUREMENT St_pmbnstab "Status pmbnstab" UBYTE Def_st_ub_q1 0 0 0.0 255.0000 ECU_ADDRESS 0x007FD77F /begin FUNCTION_LIST LAYER /end FUNCTION_LIST /end MEASUREMENT
/begin MEASUREMENT St_pmi_nv.B_fapmmess "Bedingung Messmethode PM" UBYTE Def_bit_ub_0 0 0 0.0 255.0 ECU_ADDRESS 0x007FD780 /begin FUNCTION_LIST LAYER /end FUNCTION_LIST BIT_MASK 0x1 /end MEASUREMENT
/begin MEASUREMENT St_pmi_nv.B_ulcp "Bedingung ULCP aktiv" UBYTE Def_bit_ub_1 0 0 0.0 255.0 ECU_ADDRESS 0x007FD780 /begin FUNCTION_LIST LAYER /end FUNCTION_LIST BIT_MASK 0x2 /end MEASUREMENT
/begin MEASUREMENT St_pmi_nv "Status pmi_nv" UBYTE Def_st_ub_q1 0 0 0.0 255.0000 ECU_ADDRESS 0x007FD780 /begin FUNCTION_LIST LAYER /end FUNCTION_LIST /end MEASUREMENT
/begin MEASUREMENT St_lbattcal0.B_lbatteinih "Ende Initialisierungsphase Lbattcal Batterie hinten" UBYTE Def_bit_ub_0 0 0 0.0 255.0 ECU_ADDRESS 0x007FD7A8 /begin FUNCTION_LIST LBATTCAL /end FUNCTION_LIST BIT_MASK 0x1 /end MEASUREMENT
/begin MEASUREMENT St_lbattcal0.B_lbatteiniv "Ende Initialisierungsphase Lbattcal Batterie vorne" UBYTE Def_bit_ub_1 0 0 0.0 255.0 ECU_ADDRESS 0x007FD7A8 /begin FUNCTION_LIST LBATTCAL /end FUNCTION_LIST BIT_MASK 0x2 /end MEASUREMENT
/begin MEASUREMENT St_lbattcal0.B_lbattenh "Enable Batterie hinten" UBYTE Def_bit_ub_2 0 0 0.0 255.0 ECU_ADDRESS 0x007FD7A8 /begin FUNCTION_LIST LBATTCAL /end FUNCTION_LIST BIT_MASK 0x4 /end MEASUREMENT
/begin MEASUREMENT St_lbattcal0.B_lbattenv "Enable Batterie vorne" UBYTE Def_bit_ub_3 0 0 0.0 255.0 ECU_ADDRESS 0x007FD7A8 /begin FUNCTION_LIST LBATTCAL /end FUNCTION_LIST BIT_MASK 0x8 /end MEASUREMENT
/begin MEASUREMENT St_lbattcal0.B_lbattinit "Initialisierung LBATTCAL beendet" UBYTE Def_bit_ub_4 0 0 0.0 255.0 ECU_ADDRESS 0x007FD7A8 /begin FUNCTION_LIST LBATTCAL /end FUNCTION_LIST BIT_MASK 0x10 /end MEASUREMENT
/begin MEASUREMENT St_lbattcal0.B_dly_tbi "Bedingung für Startwertberechnung" UBYTE Def_bit_ub_5 0 0 0.0 255.0 ECU_ADDRESS 0x007FD7A8 /begin FUNCTION_LIST LBATTCAL /end FUNCTION_LIST BIT_MASK 0x20 /end MEASUREMENT
/begin MEASUREMENT St_lbattcal0 "Statuswort" UBYTE Def_st_ub_q1 0 0 0.0 255.0000 ECU_ADDRESS 0x007FD7A8 /begin FUNCTION_LIST LBATTCAL /end FUNCTION_LIST /end MEASUREMENT
/begin MEASUREMENT St_tan.B_taners "" UBYTE Def_bit_ub_0 0 0 0.0 255.0 ECU_ADDRESS 0x007FD7A9 /begin FUNCTION_LIST LBATTCAL /end FUNCTION_LIST BIT_MASK 0x1 /end MEASUREMENT
/begin MEASUREMENT St_tan "Statuswort" UBYTE Def_st_ub_q1 0 0 0.0 255.0000 ECU_ADDRESS 0x007FD7A9 /begin FUNCTION_LIST LBATTCAL /end FUNCTION_LIST /end MEASUREMENT
/begin MEASUREMENT U_kompk "Zwischengröße" SWORD Def_u_sw_b128 0 0 0.0 127.9960 ECU_ADDRESS 0x007FD788 /begin FUNCTION_LIST LBATTCAL /end FUNCTION_LIST /end MEASUREMENT
/begin MEASUREMENT U_kompm "Zwischengröße" SWORD Def_u_sw_b128 0 0 0.0 127.9960 ECU_ADDRESS 0x007FD78A /begin FUNCTION_LIST LBATTCAL /end FUNCTION_LIST /end MEASUREMENT
/begin MEASUREMENT U_lade "Zwischengröße" SWORD Def_u_sw_b128 0 0 0.0 127.9960 ECU_ADDRESS 0x007FD78C /begin FUNCTION_LIST LBATTCAL /end FUNCTION_LIST /end MEASUREMENT
/begin MEASUREMENT T_batt_lb "Batterietemperatur" SWORD Def_t_sw_q0p1 0 0 -3276.8000 3276.7000 ECU_ADDRESS 0x007FD792 /begin FUNCTION_LIST LBATTCAL /end FUNCTION_LIST /end MEASUREMENT
/begin MEASUREMENT Tumg_ers "Aussentemperatur oder Ersatzwert" SWORD Def_t_sw_q0p1 0 0 -3276.8000 3276.7000 ECU_ADDRESS 0x007FD794 /begin FUNCTION_LIST LBATTCAL /end FUNCTION_LIST /end MEASUREMENT
/begin MEASUREMENT U_gensollm "Generatorsollspannung" SWORD Def_u_sw_b128 0 0 -128.0000 127.9960 ECU_ADDRESS 0x007FD796 /begin FUNCTION_LIST LBATTCAL /end FUNCTION_LIST /end MEASUREMENT
/begin MEASUREMENT T_battabst "Batterieabstelltemperatur" SWORD Def_t_sw_q0p1 0 0 -3276.8000 3276.7000 ECU_ADDRESS 0x007FD782 /begin FUNCTION_LIST LBATTCAL /end FUNCTION_LIST /end MEASUREMENT
/begin MEASUREMENT Tumg_abst "Abstell-Aussentemperatur" SWORD Def_t_sw_q0p1 0 0 -3276.8000 3276.7000 ECU_ADDRESS 0x007FD784 /begin FUNCTION_LIST LBATTCAL /end FUNCTION_LIST /end MEASUREMENT
/begin MEASUREMENT Tumg_battab "Abstell-Umgebungstemperatur Batterie" SWORD Def_t_sw_q0p1 0 0 -3276.8000 3276.7000 ECU_ADDRESS 0x007FD786 /begin FUNCTION_LIST LBATTCAL /end FUNCTION_LIST /end MEASUREMENT
/begin MEASUREMENT T_batstiniv "Starttemperatur Batterie vorne" SWORD Def_t_sw_q0p1 0 0 -3276.8000 3276.7000 ECU_ADDRESS 0x007FD798 /begin FUNCTION_LIST LBATTCAL /end FUNCTION_LIST /end MEASUREMENT
/begin MEASUREMENT T_batt_ini "Startwert Batterietemperatur" SWORD Def_t_sw_q0p1 0 0 -3276.8000 3276.7000 ECU_ADDRESS 0x007FD79A /begin FUNCTION_LIST LBATTCAL /end FUNCTION_LIST /end MEASUREMENT
/begin MEASUREMENT T_batt_zw "Temporäre Batterietemperatur" SWORD Def_t_sw_q0p1 0 0 -3276.8000 3276.7000 ECU_ADDRESS 0x007FD79C /begin FUNCTION_LIST LBATTCAL /end FUNCTION_LIST /end MEASUREMENT
/begin MEASUREMENT T_batt_zw2 "Temporäre Zwischengroesse" SWORD Def_t_sw_q0p1 0 0 -3276.8000 3276.7000 ECU_ADDRESS 0x007FD79E /begin FUNCTION_LIST LBATTCAL /end FUNCTION_LIST /end MEASUREMENT
/begin MEASUREMENT T_batt_zw3 "" SWORD Def_t_sw_q0p1 0 0 -3276.8000 3276.7000 ECU_ADDRESS 0x007FD7A0 /begin FUNCTION_LIST LBATTCAL /end FUNCTION_LIST /end MEASUREMENT
/begin MEASUREMENT Tumg_dt "Temporäre zwischengroesse" SWORD Def_t_sw_q0p1 0 0 -3276.8000 3276.7000 ECU_ADDRESS 0x007FD7A2 /begin FUNCTION_LIST LBATTCAL /end FUNCTION_LIST /end MEASUREMENT
/begin MEASUREMENT Tumg_tp "" SWORD Def_t_sw_q0p1 0 0 -3276.8000 3276.7000 ECU_ADDRESS 0x007FD7A4 /begin FUNCTION_LIST LBATTCAL /end FUNCTION_LIST /end MEASUREMENT
/begin MEASUREMENT Batt_tfil "Zeitkonstante Batterie" UWORD Def_f_uw_b1 0 0 0.0 9.99984741210938e-1 ECU_ADDRESS 0x007FD7A6 /begin FUNCTION_LIST LBATTCAL /end FUNCTION_LIST /end MEASUREMENT
/begin MEASUREMENT Batt_ort "Batterieeinbauort" UBYTE Def_st_ub_q1 0 0 0.0 255.0000 ECU_ADDRESS 0x007FD7AA /begin FUNCTION_LIST LBATTCAL /end FUNCTION_LIST /end MEASUREMENT
/begin MEASUREMENT N_nstart "Motordrehzahl nach Motorstart" SWORD Def_n_sw_q1p0 0 0 -32768.0000 32767.0000 ECU_ADDRESS 0x007FD7B6 /begin FUNCTION_LIST LDSTGEN /end FUNCTION_LIST /end MEASUREMENT
/begin MEASUREMENT Dfpropval "" UWORD Def_f_uw_b32 0 0 0.0 31.9995 ECU_ADDRESS 0x007FD7B8 /begin FUNCTION_LIST LDSTGEN /end FUNCTION_LIST /end MEASUREMENT
/begin MEASUREMENT Dffgen "ss_msv.dat" UBYTE Def_f_ub_b100 0 0 0.0 99.6093 ECU_ADDRESS 0x007FD7BB /begin FUNCTION_LIST LDSTGEN /end FUNCTION_LIST /end MEASUREMENT
/begin MEASUREMENT St_ldstgen "Lastzustand Generator elektrisch/thermisch" UBYTE Def_st_ub_q1 0 0 0.0 255.0000 ECU_ADDRESS 0x007FD7BC /begin FUNCTION_LIST LDSTGEN /end FUNCTION_LIST /end MEASUREMENT
/begin MEASUREMENT Dfsumme "DFMonitor Summe FASTA" FLOAT32_IEEE Def_f_r32 0 0 1.0000 340282346638528860000000000000000000000.0 ECU_ADDRESS 0x007FD7AC /begin FUNCTION_LIST LDSTGEN /end FUNCTION_LIST /end MEASUREMENT
/begin MEASUREMENT Dfwanzahl "DF-Wertezähler" FLOAT32_IEEE Def_f_r32 0 0 1.0000 340282346638528860000000000000000000000.0 ECU_ADDRESS 0x007FD7B0 /begin FUNCTION_LIST LDSTGEN /end FUNCTION_LIST /end MEASUREMENT
/begin MEASUREMENT Dfmonitor "DF-Monitor für FASTA" UBYTE Def_f_ub_b100 0 0 0.0 99.6093 ECU_ADDRESS 0x007FD7B4 /begin FUNCTION_LIST LDSTGEN /end FUNCTION_LIST /end MEASUREMENT
/begin MEASUREMENT Ierr_fil "Gefilterter Erregerstrom" UBYTE Def_i_ub_q0p125 0 0 0.0 31.8750 ECU_ADDRESS 0x007FD7BA /begin FUNCTION_LIST LDSTGEN /end FUNCTION_LIST /end MEASUREMENT
/begin MEASUREMENT N_idlibs "Leerlaufdrehzahlvorgabe von LC-Powermanagement" UBYTE Def_st_ub_q1 0 0 0.0 255.0000 ECU_ADDRESS 0x007FC1CC /begin FUNCTION_LIST LLPMCTRL /end FUNCTION_LIST /end MEASUREMENT
/begin MEASUREMENT St_llranh0.B_idlgspec "" UBYTE Def_bit_ub_0 0 0 0.0 255.0 ECU_ADDRESS 0x007FD7C0 /begin FUNCTION_LIST LLRANH /end FUNCTION_LIST BIT_MASK 0x1 /end MEASUREMENT
/begin MEASUREMENT St_llranh0.B_nsub "Bedingung für Solldrehzahlanhebung bei niedriger Batteriespannung" UBYTE Def_bit_ub_1 0 0 0.0 255.0 ECU_ADDRESS 0x007FD7C0 /begin FUNCTION_LIST LLRANH /end FUNCTION_LIST BIT_MASK 0x2 /end MEASUREMENT
/begin MEASUREMENT St_llranh0.B_idl_tp "Temporäres Berechnungsbit" UBYTE Def_bit_ub_2 0 0 0.0 255.0 ECU_ADDRESS 0x007FD7C0 /begin FUNCTION_LIST LLRANH /end FUNCTION_LIST BIT_MASK 0x4 /end MEASUREMENT
/begin MEASUREMENT St_llranh0 "Statuswort" UBYTE Def_st_ub_q1 0 0 0.0 255.0000 ECU_ADDRESS 0x007FD7C0 /begin FUNCTION_LIST LLRANH /end FUNCTION_LIST /end MEASUREMENT
/begin MEASUREMENT Nslb "N_soll Korrektur von Ladebilanz Batterie" SWORD Def_n_sw_q1p0 0 0 0.0 32767.0000 ECU_ADDRESS 0x007FD7BE /begin FUNCTION_LIST LLRANH /end FUNCTION_LIST /end MEASUREMENT
/begin MEASUREMENT St_loadresp0.B_genoffst "Bedingung Generatorabschaltung im Start" UBYTE Def_bit_ub_0 0 0 0.0 255.0 ECU_ADDRESS 0x007FD7C4 /begin FUNCTION_LIST LOADRESP /end FUNCTION_LIST BIT_MASK 0x1 /end MEASUREMENT
/begin MEASUREMENT St_loadresp0.B_genoffmd "" UBYTE Def_bit_ub_1 0 0 0.0 255.0 ECU_ADDRESS 0x007FD7C4 /begin FUNCTION_LIST LOADRESP /end FUNCTION_LIST BIT_MASK 0x2 /end MEASUREMENT
/begin MEASUREMENT St_loadresp0.B_fub "" UBYTE Def_bit_ub_2 0 0 0.0 255.0 ECU_ADDRESS 0x007FD7C4 /begin FUNCTION_LIST LOADRESP /end FUNCTION_LIST BIT_MASK 0x4 /end MEASUREMENT
/begin MEASUREMENT St_loadresp0.B_lo_vlloc "" UBYTE Def_bit_ub_3 0 0 0.0 255.0 ECU_ADDRESS 0x007FD7C4 /begin FUNCTION_LIST LOADRESP /end FUNCTION_LIST BIT_MASK 0x8 /end MEASUREMENT
/begin MEASUREMENT St_loadresp0.B_lo_ffset "" UBYTE Def_bit_ub_4 0 0 0.0 255.0 ECU_ADDRESS 0x007FD7C4 /begin FUNCTION_LIST LOADRESP /end FUNCTION_LIST BIT_MASK 0x10 /end MEASUREMENT
/begin MEASUREMENT St_loadresp0.B_lo_ffrst "" UBYTE Def_bit_ub_5 0 0 0.0 255.0 ECU_ADDRESS 0x007FD7C4 /begin FUNCTION_LIST LOADRESP /end FUNCTION_LIST BIT_MASK 0x20 /end MEASUREMENT
/begin MEASUREMENT St_loadresp0.B_lo_vlmod "" UBYTE Def_bit_ub_6 0 0 0.0 255.0 ECU_ADDRESS 0x007FD7C4 /begin FUNCTION_LIST LOADRESP /end FUNCTION_LIST BIT_MASK 0x40 /end MEASUREMENT
/begin MEASUREMENT St_loadresp0.B_lo_govmod "" UBYTE Def_bit_ub_7 0 0 0.0 255.0 ECU_ADDRESS 0x007FD7C4 /begin FUNCTION_LIST LOADRESP /end FUNCTION_LIST BIT_MASK 0x80 /end MEASUREMENT
/begin MEASUREMENT St_loadresp0 "Statuswort" UBYTE Def_st_ub_q1 0 0 0.0 255.0000 ECU_ADDRESS 0x007FD7C4 /begin FUNCTION_LIST LOADRESP /end FUNCTION_LIST /end MEASUREMENT
/begin MEASUREMENT St_loadresp10ms.B_mdgrenz "Bedingung Generator im Modus Momentenbegrenzung" UBYTE Def_bit_ub_0 0 0 0.0 255.0 ECU_ADDRESS 0x007FD7C5 /begin FUNCTION_LIST LOADRESP /end FUNCTION_LIST BIT_MASK 0x1 /end MEASUREMENT
/begin MEASUREMENT St_loadresp10ms "Statuswort" UBYTE Def_st_ub_q1 0 0 0.0 255.0000 ECU_ADDRESS 0x007FD7C5 /begin FUNCTION_LIST LOADRESP /end FUNCTION_LIST /end MEASUREMENT
/begin MEASUREMENT St_loadresp_nv0.B_genoffvl "Bedingung Generatorabschaltung bei Vollast" UBYTE Def_bit_ub_0 0 0 0.0 255.0 ECU_ADDRESS 0x007FD7C1 /begin FUNCTION_LIST LOADRESP /end FUNCTION_LIST BIT_MASK 0x1 /end MEASUREMENT
/begin MEASUREMENT St_loadresp_nv0 "Statuswort" UBYTE Def_st_ub_q1 0 0 0.0 255.0000 ECU_ADDRESS 0x007FD7C1 /begin FUNCTION_LIST LOADRESP /end FUNCTION_LIST /end MEASUREMENT
/begin MEASUREMENT Md_grenz "Maximalmoment Generator an BSDII" SWORD Def_m_sw_q0p1 0 0 -3276.8000 3276.7000 ECU_ADDRESS 0x007FD7C2 /begin FUNCTION_LIST LOADRESP /end FUNCTION_LIST /end MEASUREMENT
/begin MEASUREMENT Tlrgen "Sollwert Load- Response- Zeit Generator" UBYTE Def_td_ub_q0p1 0 0 0.0 25.5000 ECU_ADDRESS 0x007FD7C6 /begin FUNCTION_LIST LOADRESP /end FUNCTION_LIST /end MEASUREMENT
/begin MEASUREMENT Tlrgen2 "Sollwert Load- Response- Zeit Generator2" UBYTE Def_td_ub_q0p1 0 0 0.0 25.5000 ECU_ADDRESS 0x007FD7C7 /begin FUNCTION_LIST LOADRESP /end FUNCTION_LIST /end MEASUREMENT
/begin MEASUREMENT Loadresp "" UBYTE Def_td_ub_q0p1 0 0 0.0 25.5000 ECU_ADDRESS 0x007FD7C8 /begin FUNCTION_LIST LOADRESP /end FUNCTION_LIST /end MEASUREMENT
/begin MEASUREMENT St_mandetek.B_mandetekml "Bedingung Freigabe Manipulationserkennung " UWORD Def_bit_uw_0 0 0 0.0 65535.0 ECU_ADDRESS 0x007FD908 /begin FUNCTION_LIST MANDETEK /end FUNCTION_LIST BIT_MASK 0x1 /end MEASUREMENT
/begin MEASUREMENT St_mandetek.B_mandetekh "Bedingung Manipulationserkenung Hydraulikpfad aktiv" UWORD Def_bit_uw_1 0 0 0.0 65535.0 ECU_ADDRESS 0x007FD908 /begin FUNCTION_LIST MANDETEK /end FUNCTION_LIST BIT_MASK 0x2 /end MEASUREMENT
/begin MEASUREMENT St_mandetek.B_mandetekl "Bedingung Manipulationserkenung Luftpfad aktiv" UWORD Def_bit_uw_2 0 0 0.0 65535.0 ECU_ADDRESS 0x007FD908 /begin FUNCTION_LIST MANDETEK /end FUNCTION_LIST BIT_MASK 0x4 /end MEASUREMENT
/begin MEASUREMENT St_mandetek.B_mandetek1 "Bedingung für Hydraulikpfadaktivierung temp 1" UWORD Def_bit_uw_3 0 0 0.0 65535.0 ECU_ADDRESS 0x007FD908 /begin FUNCTION_LIST MANDETEK /end FUNCTION_LIST BIT_MASK 0x8 /end MEASUREMENT
/begin MEASUREMENT St_mandetek.B_mandetek2 "Bedingung für Hydraulikpfadaktivierung temp. 2" UWORD Def_bit_uw_4 0 0 0.0 65535.0 ECU_ADDRESS 0x007FD908 /begin FUNCTION_LIST MANDETEK /end FUNCTION_LIST BIT_MASK 0x10 /end MEASUREMENT
/begin MEASUREMENT St_mandetek.B_mandetek3 "Bedingung für Hydraulikpfadaktivierung temp. 3" UWORD Def_bit_uw_5 0 0 0.0 65535.0 ECU_ADDRESS 0x007FD908 /begin FUNCTION_LIST MANDETEK /end FUNCTION_LIST BIT_MASK 0x20 /end MEASUREMENT
/begin MEASUREMENT St_mandetek.B_mandetek4 "Bedingung für Hydraulikpfadaktivierung temp 4" UWORD Def_bit_uw_6 0 0 0.0 65535.0 ECU_ADDRESS 0x007FD908 /begin FUNCTION_LIST MANDETEK /end FUNCTION_LIST BIT_MASK 0x40 /end MEASUREMENT
/begin MEASUREMENT St_mandetek.B_mandetek5 "Bedingung für Hydraulikpfadaktivierung temp 5" UWORD Def_bit_uw_7 0 0 0.0 65535.0 ECU_ADDRESS 0x007FD908 /begin FUNCTION_LIST MANDETEK /end FUNCTION_LIST BIT_MASK 0x80 /end MEASUREMENT
/begin MEASUREMENT St_mandetek "Statuswort" UWORD Def_st_uw_q1 0 0 0.0 65535.0000 ECU_ADDRESS 0x007FD908 /begin FUNCTION_LIST MANDETEK /end FUNCTION_LIST /end MEASUREMENT
/begin MEASUREMENT Twhydrcntg "Zähler Tuningwahrscheinlichk Hydraulikpfad gesamt" ULONG Def_dez_ul_q1 0 0 1.0000 4294967295.0000 ECU_ADDRESS 0x007FD7CC /begin FUNCTION_LIST MANDETEK /end FUNCTION_LIST /end MEASUREMENT
/begin MEASUREMENT Twluftcntg "Zähler Tuningwahrscheinlichkeit Luftpfad gesamt" ULONG Def_dez_ul_q1 0 0 1.0000 4294967264.0000 ECU_ADDRESS 0x007FD7D0 /begin FUNCTION_LIST MANDETEK /end FUNCTION_LIST /end MEASUREMENT
/begin MEASUREMENT Tw "Tuningwahrscheinlichkeit" UWORD Def_f_uw_b100 0 0 0.0 99.9984 ECU_ADDRESS 0x007FD7D4 /begin FUNCTION_LIST MANDETEK /end FUNCTION_LIST /end MEASUREMENT
/begin MEASUREMENT Twhydr "Tuningwahrscheinlichkeit Hydraulikpfad" UWORD Def_f_uw_b100 0 0 0.0 99.9984 ECU_ADDRESS 0x007FD7D6 /begin FUNCTION_LIST MANDETEK /end FUNCTION_LIST /end MEASUREMENT
/begin MEASUREMENT Twhydrcnt "Tuningwahrscheinlichkeitszähler Hydraulokpfad" UWORD Def_dez_uw_q1 0 0 0.0 65535.0000 ECU_ADDRESS 0x007FD7D8 /begin FUNCTION_LIST MANDETEK /end FUNCTION_LIST /end MEASUREMENT
/begin MEASUREMENT Twhydrmax "max. Tuningwahrscheinlichkeit Hydraulikpfad" UWORD Def_f_uw_b100 0 0 0.0 99.9984 ECU_ADDRESS 0x007FD7DA /begin FUNCTION_LIST MANDETEK /end FUNCTION_LIST /end MEASUREMENT
/begin MEASUREMENT Twluft "Tuningwahrscheinlichkeit Luftpfad" UWORD Def_f_uw_b100 0 0 0.0 99.9984 ECU_ADDRESS 0x007FD7DC /begin FUNCTION_LIST MANDETEK /end FUNCTION_LIST /end MEASUREMENT
/begin MEASUREMENT Twluftcnt "Tuningwahrscheinlichkeitszähler Luftpfad" UWORD Def_dez_uw_q1 0 0 0.0 65535.0000 ECU_ADDRESS 0x007FD7DE /begin FUNCTION_LIST MANDETEK /end FUNCTION_LIST /end MEASUREMENT
/begin MEASUREMENT Twluftmax "max. Tuningwahrscheinlichkeit Luftpfad" UWORD Def_f_uw_b100 0 0 0.0 99.9984 ECU_ADDRESS 0x007FD7E0 /begin FUNCTION_LIST MANDETEK /end FUNCTION_LIST /end MEASUREMENT
/begin MEASUREMENT Abst_hydr "Abstand Hydraulikpfadpfad" ULONG Def_f_ul_b262144 0 0 0.0 11.9998 ECU_ADDRESS 0x007FD90C /begin FUNCTION_LIST MANDETEK /end FUNCTION_LIST /end MEASUREMENT
/begin MEASUREMENT Abst_luft "Abstand Luftpfad" ULONG Def_f_ul_b262144 0 0 0.0 15.9997 ECU_ADDRESS 0x007FD910 /begin FUNCTION_LIST MANDETEK /end FUNCTION_LIST /end MEASUREMENT
/begin MEASUREMENT F_hydr "Fehler Hydraulikpfadpfad relativ" ULONG Def_f_ul_b262144 0 0 0.0 196596.0001 ECU_ADDRESS 0x007FD914 /begin FUNCTION_LIST MANDETEK /end FUNCTION_LIST /end MEASUREMENT
/begin MEASUREMENT F_hydra "Fehler Hydraulikpfadpfad absolut" ULONG Def_f_ul_b262144 0 0 0.0 11.9998 ECU_ADDRESS 0x007FD918 /begin FUNCTION_LIST MANDETEK /end FUNCTION_LIST /end MEASUREMENT
/begin MEASUREMENT F_luft "Fehler Luftpfadpfad relativ" ULONG Def_f_ul_b262144 0 0 0.0 262128.0002 ECU_ADDRESS 0x007FD91C /begin FUNCTION_LIST MANDETEK /end FUNCTION_LIST /end MEASUREMENT
/begin MEASUREMENT F_lufta "Fehler Luftpfad absolut" ULONG Def_f_ul_b262144 0 0 0.0 15.9997 ECU_ADDRESS 0x007FD920 /begin FUNCTION_LIST MANDETEK /end FUNCTION_LIST /end MEASUREMENT
/begin MEASUREMENT Fhydr_temp1 "rel. Fehler Hydraulikpfad temporär 1" ULONG Def_f_ul_b262144 0 0 0.0 65532.0000 ECU_ADDRESS 0x007FD924 /begin FUNCTION_LIST MANDETEK /end FUNCTION_LIST /end MEASUREMENT
/begin MEASUREMENT Fhydr_temp2 "rel. Fehler Hydraulikpfad temporär 2" ULONG Def_f_ul_b262144 0 0 0.0 65532.0000 ECU_ADDRESS 0x007FD928 /begin FUNCTION_LIST MANDETEK /end FUNCTION_LIST /end MEASUREMENT
/begin MEASUREMENT Fhydr_temp3 "rel. Fehler Hydraulikpfad temporär 3" ULONG Def_f_ul_b262144 0 0 0.0 65532.0000 ECU_ADDRESS 0x007FD92C /begin FUNCTION_LIST MANDETEK /end FUNCTION_LIST /end MEASUREMENT
/begin MEASUREMENT Fluft_temp1 "rel. Fehler Luftpfad temporär 1" ULONG Def_f_ul_b262144 0 0 0.0 65532.0000 ECU_ADDRESS 0x007FD930 /begin FUNCTION_LIST MANDETEK /end FUNCTION_LIST /end MEASUREMENT
/begin MEASUREMENT Fluft_temp2 "rel. Fehler Luftpfad temporär 2" ULONG Def_f_ul_b262144 0 0 0.0 65532.0000 ECU_ADDRESS 0x007FD934 /begin FUNCTION_LIST MANDETEK /end FUNCTION_LIST /end MEASUREMENT
/begin MEASUREMENT Fluft_temp3 "rel. Fehler Luftpfad temporär 3" ULONG Def_f_ul_b262144 0 0 0.0 65532.0000 ECU_ADDRESS 0x007FD938 /begin FUNCTION_LIST MANDETEK /end FUNCTION_LIST /end MEASUREMENT
/begin MEASUREMENT Fluft_temp4 "rel. Fehler Luftpfad temporär 4" ULONG Def_f_ul_b262144 0 0 0.0 65532.0000 ECU_ADDRESS 0x007FD93C /begin FUNCTION_LIST MANDETEK /end FUNCTION_LIST /end MEASUREMENT
/begin MEASUREMENT Sigmanme "Ringpuffer Einspritzmasse aktuell" SWORD Def_me_sw_q0p01 0 0 -327.6800 327.6700 ECU_ADDRESS 0x007FD7E2 ARRAY_SIZE 20 /begin FUNCTION_LIST MANDETEK /end FUNCTION_LIST /end MEASUREMENT
/begin MEASUREMENT Sigmanmlh "Ringpuffer Luftmasse pro Zylinder (Hydraulikpfad)" SWORD Def_ml_sw_q0p1 0 0 -3276.8000 3276.7000 ECU_ADDRESS 0x007FD80A ARRAY_SIZE 20 /begin FUNCTION_LIST MANDETEK /end FUNCTION_LIST /end MEASUREMENT
/begin MEASUREMENT Sigmanmll "Ringpuffer Luftmasse pro Zylinder (Luftpfad)" SWORD Def_ml_sw_q0p1 0 0 -3276.8000 3276.7000 ECU_ADDRESS 0x007FD832 ARRAY_SIZE 20 /begin FUNCTION_LIST MANDETEK /end FUNCTION_LIST /end MEASUREMENT
/begin MEASUREMENT Sigmanpld "Ringpuffer Ladedruck" SWORD Def_p_sw_q1 0 0 -32768.0000 32767.0000 ECU_ADDRESS 0x007FD85A ARRAY_SIZE 20 /begin FUNCTION_LIST MANDETEK /end FUNCTION_LIST /end MEASUREMENT
/begin MEASUREMENT Sigmantvagr "Ringpuffer Tastverhältnis AGR-Steller" SWORD Def_tv_sw_q0p01 0 0 -327.6800 327.6700 ECU_ADDRESS 0x007FD882 ARRAY_SIZE 20 /begin FUNCTION_LIST MANDETEK /end FUNCTION_LIST /end MEASUREMENT
/begin MEASUREMENT Sigmantvpld "Ringpuffer Tastverhältnis Ladedrucksteller" SWORD Def_tv_sw_q0p01 0 0 -327.6800 327.6700 ECU_ADDRESS 0x007FD8AA ARRAY_SIZE 20 /begin FUNCTION_LIST MANDETEK /end FUNCTION_LIST /end MEASUREMENT
/begin MEASUREMENT Abst_temp1 "Abstand Hydraulikpfad temporär 1" UWORD Def_f_uw_b4 0 0 0.0 3.9999 ECU_ADDRESS 0x007FD8D2 /begin FUNCTION_LIST MANDETEK /end FUNCTION_LIST /end MEASUREMENT
/begin MEASUREMENT Abst_temp2 "Abstand Hydraulikpfad temporär 2" UWORD Def_f_uw_b4 0 0 0.0 3.9999 ECU_ADDRESS 0x007FD8D4 /begin FUNCTION_LIST MANDETEK /end FUNCTION_LIST /end MEASUREMENT
/begin MEASUREMENT Abst_temp3 "Abstand Hydraulikpfad temporär 3" UWORD Def_f_uw_b4 0 0 0.0 3.9999 ECU_ADDRESS 0x007FD8D6 /begin FUNCTION_LIST MANDETEK /end FUNCTION_LIST /end MEASUREMENT
/begin MEASUREMENT Abst_temp4 "Abstand Luftpfad temporär 5" UWORD Def_f_uw_b4 0 0 0.0 3.9999 ECU_ADDRESS 0x007FD8D8 /begin FUNCTION_LIST MANDETEK /end FUNCTION_LIST /end MEASUREMENT
/begin MEASUREMENT Abst_temp5 "Abstand Luftpfad temporär 6" UWORD Def_f_uw_b4 0 0 0.0 3.9999 ECU_ADDRESS 0x007FD8DA /begin FUNCTION_LIST MANDETEK /end FUNCTION_LIST /end MEASUREMENT
/begin MEASUREMENT Abst_temp6 "Abstand Luftpfad temporär 7" UWORD Def_f_uw_b4 0 0 0.0 3.9999 ECU_ADDRESS 0x007FD8DC /begin FUNCTION_LIST MANDETEK /end FUNCTION_LIST /end MEASUREMENT
/begin MEASUREMENT Abst_temp7 "Abstand Luftpfad temporär 8" UWORD Def_f_uw_b4 0 0 0.0 3.9999 ECU_ADDRESS 0x007FD8DE /begin FUNCTION_LIST MANDETEK /end FUNCTION_LIST /end MEASUREMENT
/begin MEASUREMENT Sigmanla "Ringpuffer La_ist1" UWORD Def_f_uw_b16 0 0 0.0 15.9997 ECU_ADDRESS 0x007FD8E0 ARRAY_SIZE 20 /begin FUNCTION_LIST MANDETEK /end FUNCTION_LIST /end MEASUREMENT
/begin MEASUREMENT Gewh "Gewicht Hydraulikpfad" UBYTE Def_dez_ub_q1 0 0 0.0 255.0000 ECU_ADDRESS 0x007FD940 /begin FUNCTION_LIST MANDETEK /end FUNCTION_LIST /end MEASUREMENT
/begin MEASUREMENT Gewl "Gewicht Luftpfad" UBYTE Def_dez_ub_q1 0 0 0.0 255.0000 ECU_ADDRESS 0x007FD941 /begin FUNCTION_LIST MANDETEK /end FUNCTION_LIST /end MEASUREMENT
/begin MEASUREMENT Ghydrla "Gewicht Hydraulikpfad La_ist1" UBYTE Def_f_ub_b2 0 0 0.0079 1.9921 ECU_ADDRESS 0x007FD944 ARRAY_SIZE 120 /begin FUNCTION_LIST MANDETEK /end FUNCTION_LIST /end MEASUREMENT
/begin MEASUREMENT Ghydrme "Gewicht Hydraulikpfad Me_ist" UBYTE Def_f_ub_b2 0 0 0.0079 1.9921 ECU_ADDRESS 0x007FD9BC ARRAY_SIZE 120 /begin FUNCTION_LIST MANDETEK /end FUNCTION_LIST /end MEASUREMENT
/begin MEASUREMENT Ghydrml "Gewicht Hydraulikpfad Ml" UBYTE Def_f_ub_b2 0 0 0.0079 1.9921 ECU_ADDRESS 0x007FDA34 ARRAY_SIZE 120 /begin FUNCTION_LIST MANDETEK /end FUNCTION_LIST /end MEASUREMENT
/begin MEASUREMENT Gluftml "Gewicht Luftpfad Ml" UBYTE Def_f_ub_b2 0 0 0.0079 1.9921 ECU_ADDRESS 0x007FDAAC ARRAY_SIZE 120 /begin FUNCTION_LIST MANDETEK /end FUNCTION_LIST /end MEASUREMENT
/begin MEASUREMENT Gluftpld "Gewicht Luftpfad Pld" UBYTE Def_f_ub_b2 0 0 0.0079 1.9921 ECU_ADDRESS 0x007FDB24 ARRAY_SIZE 120 /begin FUNCTION_LIST MANDETEK /end FUNCTION_LIST /end MEASUREMENT
/begin MEASUREMENT Glufttvagr "Gewicht Luftpfad Tastverhältnis Agr" UBYTE Def_f_ub_b2 0 0 0.0079 1.9921 ECU_ADDRESS 0x007FDB9C ARRAY_SIZE 120 /begin FUNCTION_LIST MANDETEK /end FUNCTION_LIST /end MEASUREMENT
/begin MEASUREMENT Glufttvpld "Gewicht Luftpfad Tastverhältnis Pld" UBYTE Def_f_ub_b2 0 0 0.0079 1.9921 ECU_ADDRESS 0x007FDC14 ARRAY_SIZE 120 /begin FUNCTION_LIST MANDETEK /end FUNCTION_LIST /end MEASUREMENT
/begin MEASUREMENT Hydrstat "Zähler für quasistationären Zustand Hydraulikpfad" UBYTE Def_dez_ub_q1 0 0 0.0 255.0000 ECU_ADDRESS 0x007FDC8C /begin FUNCTION_LIST MANDETEK /end FUNCTION_LIST /end MEASUREMENT
/begin MEASUREMENT La_n "Lambdawert normiert" UBYTE Def_f_ub_b2 0 0 0.0 1.9921 ECU_ADDRESS 0x007FDC8D /begin FUNCTION_LIST MANDETEK /end FUNCTION_LIST /end MEASUREMENT
/begin MEASUREMENT Luftstat "Zähler für quasistationären Zustand Luftpfad" UBYTE Def_dez_ub_q1 0 0 0.0 255.0000 ECU_ADDRESS 0x007FDC8E /begin FUNCTION_LIST MANDETEK /end FUNCTION_LIST /end MEASUREMENT
/begin MEASUREMENT Me_n "Einspritzmasse normiert" UBYTE Def_f_ub_b2 0 0 0.0 1.9921 ECU_ADDRESS 0x007FDC8F /begin FUNCTION_LIST MANDETEK /end FUNCTION_LIST /end MEASUREMENT
/begin MEASUREMENT Mlh_n "Luftmasse pro Zylinder normiert Hydraulikpfad" UBYTE Def_f_ub_b2 0 0 0.0 1.9921 ECU_ADDRESS 0x007FDC90 /begin FUNCTION_LIST MANDETEK /end FUNCTION_LIST /end MEASUREMENT
/begin MEASUREMENT Mll_n "Luftmasse pro Zylinder normiert Luftpfad" UBYTE Def_f_ub_b2 0 0 0.0 1.9921 ECU_ADDRESS 0x007FDC91 /begin FUNCTION_LIST MANDETEK /end FUNCTION_LIST /end MEASUREMENT
/begin MEASUREMENT Pld_n "Ladedruck normiert" UBYTE Def_f_ub_b2 0 0 0.0 1.9921 ECU_ADDRESS 0x007FDC92 /begin FUNCTION_LIST MANDETEK /end FUNCTION_LIST /end MEASUREMENT
/begin MEASUREMENT Tv_agr_n "Tastverhältnis AGR-Steller normiert" UBYTE Def_f_ub_b2 0 0 0.0 1.9921 ECU_ADDRESS 0x007FDC93 /begin FUNCTION_LIST MANDETEK /end FUNCTION_LIST /end MEASUREMENT
/begin MEASUREMENT Tv_pld_n "Tastverhältnis Ladedrucksteller normiert" UBYTE Def_f_ub_b2 0 0 0.0 1.9921 ECU_ADDRESS 0x007FDC94 /begin FUNCTION_LIST MANDETEK /end FUNCTION_LIST /end MEASUREMENT
/begin MEASUREMENT Z_mandetek1 "Zähler Mandetek1" UBYTE Def_dez_ub_q1 0 0 0.0 255.0000 ECU_ADDRESS 0x007FDC95 /begin FUNCTION_LIST MANDETEK /end FUNCTION_LIST /end MEASUREMENT
/begin MEASUREMENT Z_mandetek2 "Zähler Mandetek2" UBYTE Def_dez_ub_q1 0 0 0.0 255.0000 ECU_ADDRESS 0x007FDC96 /begin FUNCTION_LIST MANDETEK /end FUNCTION_LIST /end MEASUREMENT
/begin MEASUREMENT St_ozbg0.B_bosmsgc "Bedingung für Absetzen einer BOS-Meldung" UBYTE Def_bit_ub_0 0 0 0.0 255.0 ECU_ADDRESS 0x007FDCB2 /begin FUNCTION_LIST OZBG /end FUNCTION_LIST BIT_MASK 0x1 /end MEASUREMENT
/begin MEASUREMENT St_ozbg0.B_mol_vb "Bedingung Ölverbrauchswarnung" UBYTE Def_bit_ub_1 0 0 0.0 255.0 ECU_ADDRESS 0x007FDCB2 /begin FUNCTION_LIST OZBG /end FUNCTION_LIST BIT_MASK 0x2 /end MEASUREMENT
/begin MEASUREMENT St_ozbg0.B_mol_vl "Bedingung Ölverlustwarnung" UBYTE Def_bit_ub_2 0 0 0.0 255.0 ECU_ADDRESS 0x007FDCB2 /begin FUNCTION_LIST OZBG /end FUNCTION_LIST BIT_MASK 0x4 /end MEASUREMENT
/begin MEASUREMENT St_ozbg0.B_oeltemp "Bedingung für CAN-Ausgabe der Öltemperatur" UBYTE Def_bit_ub_3 0 0 0.0 255.0 ECU_ADDRESS 0x007FDCB2 /begin FUNCTION_LIST OZBG /end FUNCTION_LIST BIT_MASK 0x8 /end MEASUREMENT
/begin MEASUREMENT St_ozbg0.B_oelverb "" UBYTE Def_bit_ub_4 0 0 0.0 255.0 ECU_ADDRESS 0x007FDCB2 /begin FUNCTION_LIST OZBG /end FUNCTION_LIST BIT_MASK 0x10 /end MEASUREMENT
/begin MEASUREMENT St_ozbg0.B_oelverl "" UBYTE Def_bit_ub_5 0 0 0.0 255.0 ECU_ADDRESS 0x007FDCB2 /begin FUNCTION_LIST OZBG /end FUNCTION_LIST BIT_MASK 0x20 /end MEASUREMENT
/begin MEASUREMENT St_ozbg0 "Statuswort" UBYTE Def_st_ub_q1 0 0 0.0 255.0000 ECU_ADDRESS 0x007FDCB2 /begin FUNCTION_LIST OZBG /end FUNCTION_LIST /end MEASUREMENT
/begin MEASUREMENT St_ozbg_nv0.B_ozkl15 "Merker für Einschalten Kl. 15" UBYTE Def_bit_ub_0 0 0 0.0 255.0 ECU_ADDRESS 0x007FDC98 /begin FUNCTION_LIST OZBG /end FUNCTION_LIST BIT_MASK 0x1 /end MEASUREMENT
/begin MEASUREMENT St_ozbg_nv0 "Statuswort" UBYTE Def_st_ub_q1 0 0 0.0 255.0000 ECU_ADDRESS 0x007FDC98 /begin FUNCTION_LIST OZBG /end FUNCTION_LIST /end MEASUREMENT
/begin MEASUREMENT Oz_tempakt "Ausgabe Öltemperatur für den Tester" SWORD Def_t_sw_q0p1 0 0 -3276.8000 3276.7000 ECU_ADDRESS 0x007FDCA6 /begin FUNCTION_LIST OZBG /end FUNCTION_LIST /end MEASUREMENT
/begin MEASUREMENT Toel "Ausgabewert Motoröltemperatur für LoCAN" SWORD Def_t_sw_q0p1 0 0 -3276.8000 3276.7000 ECU_ADDRESS 0x007FDCA8 /begin FUNCTION_LIST OZBG /end FUNCTION_LIST /end MEASUREMENT
/begin MEASUREMENT Toel_oz "Ausgabe Öltemperatur" SWORD Def_t_sw_q0p1 0 0 -3276.8000 3276.7000 ECU_ADDRESS 0x007FDCAA /begin FUNCTION_LIST OZBG /end FUNCTION_LIST /end MEASUREMENT
/begin MEASUREMENT Id_bosmg "Kennung für BOS-Meldung = Ölservice-Info" UWORD Def_dez_uw_q1 0 0 0.0 65535.0000 ECU_ADDRESS 0x007FDCAC /begin FUNCTION_LIST OZBG /end FUNCTION_LIST /end MEASUREMENT
/begin MEASUREMENT Bosstate "Einheit der BOS-Info (km)" UBYTE Def_dez_ub_q1 0 0 0.0 255.0000 ECU_ADDRESS 0x007FDCAE /begin FUNCTION_LIST OZBG /end FUNCTION_LIST /end MEASUREMENT
/begin MEASUREMENT Id_bosmgt "Kennung für BOS-Meldung vom Tester" UBYTE Def_dez_ub_q1 0 0 0.0 255.0000 ECU_ADDRESS 0x007FDCAF /begin FUNCTION_LIST OZBG /end FUNCTION_LIST /end MEASUREMENT
/begin MEASUREMENT Id_bosmsg "Kennung für BOS-Meldung vom Kombi" UBYTE Def_dez_ub_q1 0 0 0.0 255.0000 ECU_ADDRESS 0x007FDCB0 /begin FUNCTION_LIST OZBG /end FUNCTION_LIST /end MEASUREMENT
/begin MEASUREMENT Oz_reset "Zieltermin_Monat_BOS_Rückstellung_2" UBYTE Def_dez_ub_q1 0 0 0.0 255.0000 ECU_ADDRESS 0x007FDCB1 /begin FUNCTION_LIST OZBG /end FUNCTION_LIST /end MEASUREMENT
/begin MEASUREMENT Bosfxid2 "Zieltermin_Monat_BOS_Rückstellung_2" SWORD Def_dez_sw_q1 0 0 -32768.0000 32767.0000 ECU_ADDRESS 0x007FDC9A /begin FUNCTION_LIST OZBG /end FUNCTION_LIST /end MEASUREMENT
/begin MEASUREMENT Bosrlsm "Ausgabewert Restlaufstrecke Motoröl" SWORD Def_km_sw_q10 0 0 -327680.0000 327670.0000 ECU_ADDRESS 0x007FDC9C /begin FUNCTION_LIST OZBG /end FUNCTION_LIST /end MEASUREMENT
/begin MEASUREMENT Bosbtvfbk "Rest-Verfügbarkeit Motoröl in Prozent" UBYTE Def_dez_ub_q1 0 0 0.0 255.0000 ECU_ADDRESS 0x007FDC9E /begin FUNCTION_LIST OZBG /end FUNCTION_LIST /end MEASUREMENT
/begin MEASUREMENT Bosid2 "Zieltermin_Monat_BOS_Rückstellung_2" UBYTE Def_dez_ub_q1 0 0 0.0 255.0000 ECU_ADDRESS 0x007FDC9F /begin FUNCTION_LIST OZBG /end FUNCTION_LIST /end MEASUREMENT
/begin MEASUREMENT Bosjziel "Zieltermin_Monat_BOS_Rückstellung_2" UBYTE Def_dez_ub_q1 0 0 0.0 255.0000 ECU_ADDRESS 0x007FDCA0 /begin FUNCTION_LIST OZBG /end FUNCTION_LIST /end MEASUREMENT
/begin MEASUREMENT Bosmziel "Zieltermin_Monat_BOS_Meldung_2" UBYTE Def_dez_ub_q1 0 0 0.0 255.0000 ECU_ADDRESS 0x007FDCA1 /begin FUNCTION_LIST OZBG /end FUNCTION_LIST /end MEASUREMENT
/begin MEASUREMENT Bosprog2 "Prognose_Intervall_Zeit_BOS_Meldung_2" UBYTE Def_dez_ub_q1 0 0 0.0 255.0000 ECU_ADDRESS 0x007FDCA2 /begin FUNCTION_LIST OZBG /end FUNCTION_LIST /end MEASUREMENT
/begin MEASUREMENT Bosres "Zieltermin_Monat_BOS_Rückstellung_2" UBYTE Def_dez_ub_q1 0 0 0.0 255.0000 ECU_ADDRESS 0x007FDCA3 /begin FUNCTION_LIST OZBG /end FUNCTION_LIST /end MEASUREMENT
/begin MEASUREMENT Bosrw2 "Prognose_Intervall_Weg_BOS_Meldung_2" UBYTE Def_km_ub_q1000 0 0 0.0 255000.0000 ECU_ADDRESS 0x007FDCA4 /begin FUNCTION_LIST OZBG /end FUNCTION_LIST /end MEASUREMENT
/begin MEASUREMENT Zrbosmld "anzuzeigender Zähler für durchgeführten Ölservice" UBYTE Def_dez_ub_q1 0 0 0.0 255.0000 ECU_ADDRESS 0x007FDCA5 /begin FUNCTION_LIST OZBG /end FUNCTION_LIST /end MEASUREMENT
/begin MEASUREMENT St_ozgg0.B_oelwech "Bedingung Ölwechsel erfolgt" UBYTE Def_bit_ub_0 0 0 0.0 255.0 ECU_ADDRESS 0x007FDD03 /begin FUNCTION_LIST OZGG /end FUNCTION_LIST BIT_MASK 0x1 /end MEASUREMENT
/begin MEASUREMENT St_ozgg0.B_ozniv "Bedingung Niveausignal in Ordnung" UBYTE Def_bit_ub_1 0 0 0.0 255.0 ECU_ADDRESS 0x007FDD03 /begin FUNCTION_LIST OZGG /end FUNCTION_LIST BIT_MASK 0x2 /end MEASUREMENT
/begin MEASUREMENT St_ozgg0.B_ozperm "Bedingung Permittivitätssignal in Ordnung" UBYTE Def_bit_ub_2 0 0 0.0 255.0 ECU_ADDRESS 0x007FDD03 /begin FUNCTION_LIST OZGG /end FUNCTION_LIST BIT_MASK 0x4 /end MEASUREMENT
/begin MEASUREMENT St_ozgg0.B_oztemp "Bedingung Temperatursignal in Ordnung" UBYTE Def_bit_ub_3 0 0 0.0 255.0 ECU_ADDRESS 0x007FDD03 /begin FUNCTION_LIST OZGG /end FUNCTION_LIST BIT_MASK 0x8 /end MEASUREMENT
/begin MEASUREMENT St_ozgg0.B_ozvfchg "Bedingung für geänderte Verfügbarkeit" UBYTE Def_bit_ub_4 0 0 0.0 255.0 ECU_ADDRESS 0x007FDD03 /begin FUNCTION_LIST OZGG /end FUNCTION_LIST BIT_MASK 0x10 /end MEASUREMENT
/begin MEASUREMENT St_ozgg0.B_svcntchg "Bedingung für über Tester geänderten Servicezähler" UBYTE Def_bit_ub_5 0 0 0.0 255.0 ECU_ADDRESS 0x007FDD03 /begin FUNCTION_LIST OZGG /end FUNCTION_LIST BIT_MASK 0x20 /end MEASUREMENT
/begin MEASUREMENT St_ozgg0.B_ozvfchgt "" UBYTE Def_bit_ub_6 0 0 0.0 255.0 ECU_ADDRESS 0x007FDD03 /begin FUNCTION_LIST OZGG /end FUNCTION_LIST BIT_MASK 0x40 /end MEASUREMENT
/begin MEASUREMENT St_ozgg0.B_ozzeitdmew "" UBYTE Def_bit_ub_7 0 0 0.0 255.0 ECU_ADDRESS 0x007FDD03 /begin FUNCTION_LIST OZGG /end FUNCTION_LIST BIT_MASK 0x80 /end MEASUREMENT
/begin MEASUREMENT St_ozgg0 "Statuswort" UBYTE Def_st_ub_q1 0 0 0.0 255.0000 ECU_ADDRESS 0x007FDD03 /begin FUNCTION_LIST OZGG /end FUNCTION_LIST /end MEASUREMENT
/begin MEASUREMENT St_ozgg1.B_ozvfchgc "Bedingung für geänderte Verfügbarkeit vom Kombi über Restweg" UBYTE Def_bit_ub_0 0 0 0.0 255.0 ECU_ADDRESS 0x007FDD04 /begin FUNCTION_LIST OZGG /end FUNCTION_LIST BIT_MASK 0x1 /end MEASUREMENT
/begin MEASUREMENT St_ozgg1.B_ozvfchgcc "Bedingung für geänderte Verfügbarkeit vom Kombi" UBYTE Def_bit_ub_1 0 0 0.0 255.0 ECU_ADDRESS 0x007FDD04 /begin FUNCTION_LIST OZGG /end FUNCTION_LIST BIT_MASK 0x2 /end MEASUREMENT
/begin MEASUREMENT St_ozgg1.B_ozmanip "" UBYTE Def_bit_ub_2 0 0 0.0 255.0 ECU_ADDRESS 0x007FDD04 /begin FUNCTION_LIST OZGG /end FUNCTION_LIST BIT_MASK 0x4 /end MEASUREMENT
/begin MEASUREMENT St_ozgg1.B_ozresett "Reset vom Tester" UBYTE Def_bit_ub_3 0 0 0.0 255.0 ECU_ADDRESS 0x007FDD04 /begin FUNCTION_LIST OZGG /end FUNCTION_LIST BIT_MASK 0x8 /end MEASUREMENT
/begin MEASUREMENT St_ozgg1.B_ozresetcan "Reset BOS vom Kombi (CAN)" UBYTE Def_bit_ub_4 0 0 0.0 255.0 ECU_ADDRESS 0x007FDD04 /begin FUNCTION_LIST OZGG /end FUNCTION_LIST BIT_MASK 0x10 /end MEASUREMENT
/begin MEASUREMENT St_ozgg1.B_ozreset "BOS Reset (Ölwechsel)" UBYTE Def_bit_ub_5 0 0 0.0 255.0 ECU_ADDRESS 0x007FDD04 /begin FUNCTION_LIST OZGG /end FUNCTION_LIST BIT_MASK 0x20 /end MEASUREMENT
/begin MEASUREMENT St_ozgg1 "Statuswort" UBYTE Def_st_ub_q1 0 0 0.0 255.0000 ECU_ADDRESS 0x007FDD04 /begin FUNCTION_LIST OZGG /end FUNCTION_LIST /end MEASUREMENT
/begin MEASUREMENT St_ozgg_nv0.B_dmeini "Bedingung für neue noch nicht initialisierte DME" UBYTE Def_bit_ub_0 0 0 0.0 255.0 ECU_ADDRESS 0x007FDCB4 /begin FUNCTION_LIST OZGG /end FUNCTION_LIST BIT_MASK 0x1 /end MEASUREMENT
/begin MEASUREMENT St_ozgg_nv0.B_dmewech "Bedingung für getauschte DME zur Aktualisierung der BOS-Werte" UBYTE Def_bit_ub_1 0 0 0.0 255.0 ECU_ADDRESS 0x007FDCB4 /begin FUNCTION_LIST OZGG /end FUNCTION_LIST BIT_MASK 0x2 /end MEASUREMENT
/begin MEASUREMENT St_ozgg_nv0.B_factoryres "" UBYTE Def_bit_ub_2 0 0 0.0 255.0 ECU_ADDRESS 0x007FDCB4 /begin FUNCTION_LIST OZGG /end FUNCTION_LIST BIT_MASK 0x4 /end MEASUREMENT
/begin MEASUREMENT St_ozgg_nv0 "Statuswort" UBYTE Def_st_ub_q1 0 0 0.0 255.0000 ECU_ADDRESS 0x007FDCB4 /begin FUNCTION_LIST OZGG /end FUNCTION_LIST /end MEASUREMENT
/begin MEASUREMENT Oz_rwrueck "" SWORD Def_km_sw_q10 0 0 -327680.0000 327670.0000 ECU_ADDRESS 0x007FDCF0 /begin FUNCTION_LIST OZGG /end FUNCTION_LIST /end MEASUREMENT
/begin MEASUREMENT Oz_temp "Öltemperatur ungefiltert" SWORD Def_t_sw_q0p1 0 0 -3276.8000 3276.7000 ECU_ADDRESS 0x007FDCF2 /begin FUNCTION_LIST OZGG /end FUNCTION_LIST /end MEASUREMENT
/begin MEASUREMENT Oz_perm "Permittivität ungefiltert" UWORD Def_perm_uw_b6 0 0 0.0 5.9999 ECU_ADDRESS 0x007FDCF4 /begin FUNCTION_LIST OZGG /end FUNCTION_LIST /end MEASUREMENT
/begin MEASUREMENT Oz_permakt "Permittivität für den Tester" UWORD Def_perm_uw_b6 0 0 0.0 5.9999 ECU_ADDRESS 0x007FDCF6 /begin FUNCTION_LIST OZGG /end FUNCTION_LIST /end MEASUREMENT
/begin MEASUREMENT Oz_manip "geänderter Servicezähler" UBYTE Def_dez_ub_q1 0 0 0.0 255.0000 ECU_ADDRESS 0x007FDCFC /begin FUNCTION_LIST OZGG /end FUNCTION_LIST /end MEASUREMENT
/begin MEASUREMENT Oz_niv "Ölniveau ungefiltert" UBYTE Def_niv_ub_b75 0 0 0.0 74.7070 ECU_ADDRESS 0x007FDCFD /begin FUNCTION_LIST OZGG /end FUNCTION_LIST /end MEASUREMENT
/begin MEASUREMENT Oz_svcntchg "geänderter Servicezähler" UBYTE Def_dez_ub_q1 0 0 0.0 255.0000 ECU_ADDRESS 0x007FDCFE /begin FUNCTION_LIST OZGG /end FUNCTION_LIST /end MEASUREMENT
/begin MEASUREMENT Oz_zjbdmew "" UBYTE Def_dez_ub_q1 0 0 0.0 255.0000 ECU_ADDRESS 0x007FDCFF /begin FUNCTION_LIST OZGG /end FUNCTION_LIST /end MEASUREMENT
/begin MEASUREMENT Oz_zmbdmew "" UBYTE Def_dez_ub_q1 0 0 0.0 255.0000 ECU_ADDRESS 0x007FDD00 /begin FUNCTION_LIST OZGG /end FUNCTION_LIST /end MEASUREMENT
/begin MEASUREMENT Oz_kmlow "Kilometerstand letzter Ölwechsel" SWORD Def_km_sw_q10 0 0 -327680.0000 327670.0000 ECU_ADDRESS 0x007FDCB6 /begin FUNCTION_LIST OZGG /end FUNCTION_LIST /end MEASUREMENT
/begin MEASUREMENT Oz_lowrwanz "Register für Restweganzeige beim Ölwechsel" SWORD Def_km_sw_q10 0 0 -327680.0000 327670.0000 ECU_ADDRESS 0x007FDCB8 ARRAY_SIZE 6 /begin FUNCTION_LIST OZGG /end FUNCTION_LIST /end MEASUREMENT
/begin MEASUREMENT Oz_lowkm "Register für KM-Stand beim Ölwechsel" UWORD Def_km_uw_q10 0 0 0.0 655350.0000 ECU_ADDRESS 0x007FDCC4 ARRAY_SIZE 6 /begin FUNCTION_LIST OZGG /end FUNCTION_LIST /end MEASUREMENT
/begin MEASUREMENT Oz_lowperex "Register für extrapoliertes Er beim Ölwechsel" UWORD Def_perm_uw_b6 0 0 0.0 5.9999 ECU_ADDRESS 0x007FDCD0 ARRAY_SIZE 6 /begin FUNCTION_LIST OZGG /end FUNCTION_LIST /end MEASUREMENT
/begin MEASUREMENT Oz_lowperm0 "Register für Er nach Ölwechsel" UWORD Def_perm_uw_b6 0 0 0.0 5.9999 ECU_ADDRESS 0x007FDCDC ARRAY_SIZE 6 /begin FUNCTION_LIST OZGG /end FUNCTION_LIST /end MEASUREMENT
/begin MEASUREMENT Oz_oelkm "Ölkilometer" UWORD Def_km_uw_q10 0 0 0.0 655350.0000 ECU_ADDRESS 0x007FDCE8 /begin FUNCTION_LIST OZGG /end FUNCTION_LIST /end MEASUREMENT
/begin MEASUREMENT Oz_perref "Ersatzpermittivität" UWORD Def_dez_uw_q1 0 0 0.0 1024.0000 ECU_ADDRESS 0x007FDCEA /begin FUNCTION_LIST OZGG /end FUNCTION_LIST /end MEASUREMENT
/begin MEASUREMENT Oz_vfbdmew "Verfügbarkeit aus Kombi bei DME-Wechsel" SBYTE Def_dez_sb_q1 0 0 -128.0000 127.0000 ECU_ADDRESS 0x007FDCEC /begin FUNCTION_LIST OZGG /end FUNCTION_LIST /end MEASUREMENT
/begin MEASUREMENT Oz_lowcnt "Zähler zur Sicherung der Ölwechselinformationen" UBYTE Def_dez_ub_q1 0 0 0.0 255.0000 ECU_ADDRESS 0x007FDCED /begin FUNCTION_LIST OZGG /end FUNCTION_LIST /end MEASUREMENT
/begin MEASUREMENT Oz_manipt "Manipulation" UBYTE Def_dez_ub_q1 0 0 0.0 255.0000 ECU_ADDRESS 0x007FDCEE /begin FUNCTION_LIST OZGG /end FUNCTION_LIST /end MEASUREMENT
/begin MEASUREMENT Oz_rwprueck "" UBYTE Def_km_ub_q1000 0 0 0.0 255000.0000 ECU_ADDRESS 0x007FDCEF /begin FUNCTION_LIST OZGG /end FUNCTION_LIST /end MEASUREMENT
/begin MEASUREMENT Oz_permt "begrenzter Permittivitäts-Rohwert" UWORD Def_dez_uw_q1 0 0 0.0 1024.0000 ECU_ADDRESS 0x007FDCF8 /begin FUNCTION_LIST OZGG /end FUNCTION_LIST /end MEASUREMENT
/begin MEASUREMENT Oz_tempt "begrenzter Temperatur-Rohwert" UWORD Def_dez_uw_q1 0 0 0.0 65535.0000 ECU_ADDRESS 0x007FDCFA /begin FUNCTION_LIST OZGG /end FUNCTION_LIST /end MEASUREMENT
/begin MEASUREMENT Oz_nivrers "Ersatzniveau-Rohwert" UBYTE Def_dez_ub_q1 0 0 0.0 255.0000 ECU_ADDRESS 0x007FDD01 /begin FUNCTION_LIST OZGG /end FUNCTION_LIST /end MEASUREMENT
/begin MEASUREMENT Oz_nivt "begrenzter Niveau-Rohwert" UBYTE Def_dez_ub_q1 0 0 0.0 255.0000 ECU_ADDRESS 0x007FDD02 /begin FUNCTION_LIST OZGG /end FUNCTION_LIST /end MEASUREMENT
/begin MEASUREMENT Oz_leit_dum "" UBYTE Def_dez_ub_q1 0 0 0.0 255.0000 ECU_ADDRESS 0x007FC545 /begin FUNCTION_LIST OZLEIT /end FUNCTION_LIST /end MEASUREMENT
/begin MEASUREMENT St_oznivdl0.B_oznivb "" UBYTE Def_bit_ub_0 0 0 0.0 255.0 ECU_ADDRESS 0x007FDD43 /begin FUNCTION_LIST OZNIVDL /end FUNCTION_LIST BIT_MASK 0x1 /end MEASUREMENT
/begin MEASUREMENT St_oznivdl0.B_ozkrzkor "Bedingung drehzahlkorrigierter Kurzzeit Niveaumittelwert berechnet" UBYTE Def_bit_ub_1 0 0 0.0 255.0 ECU_ADDRESS 0x007FDD43 /begin FUNCTION_LIST OZNIVDL /end FUNCTION_LIST BIT_MASK 0x2 /end MEASUREMENT
/begin MEASUREMENT St_oznivdl0.B_ozlangmw "Bedingung Langzeit-Mittelwert berechnet" UBYTE Def_bit_ub_2 0 0 0.0 255.0 ECU_ADDRESS 0x007FDD43 /begin FUNCTION_LIST OZNIVDL /end FUNCTION_LIST BIT_MASK 0x4 /end MEASUREMENT
/begin MEASUREMENT St_oznivdl0.B_ozor "Bedingung Orientierungsmessung erfolgt" UBYTE Def_bit_ub_3 0 0 0.0 255.0 ECU_ADDRESS 0x007FDD43 /begin FUNCTION_LIST OZNIVDL /end FUNCTION_LIST BIT_MASK 0x8 /end MEASUREMENT
/begin MEASUREMENT St_oznivdl0.B_ozvormw "Bedingung vorgezogener Mittelwert berechnet" UBYTE Def_bit_ub_4 0 0 0.0 255.0 ECU_ADDRESS 0x007FDD43 /begin FUNCTION_LIST OZNIVDL /end FUNCTION_LIST BIT_MASK 0x10 /end MEASUREMENT
/begin MEASUREMENT St_oznivdl0.B_ozkrzlkor "" UBYTE Def_bit_ub_5 0 0 0.0 255.0 ECU_ADDRESS 0x007FDD43 /begin FUNCTION_LIST OZNIVDL /end FUNCTION_LIST BIT_MASK 0x20 /end MEASUREMENT
/begin MEASUREMENT St_oznivdl0.B_oelnivnorm "" UBYTE Def_bit_ub_6 0 0 0.0 255.0 ECU_ADDRESS 0x007FDD43 /begin FUNCTION_LIST OZNIVDL /end FUNCTION_LIST BIT_MASK 0x40 /end MEASUREMENT
/begin MEASUREMENT St_oznivdl0.B_ozkrzl "" UBYTE Def_bit_ub_7 0 0 0.0 255.0 ECU_ADDRESS 0x007FDD43 /begin FUNCTION_LIST OZNIVDL /end FUNCTION_LIST BIT_MASK 0x80 /end MEASUREMENT
/begin MEASUREMENT St_oznivdl0 "Statuswort" UBYTE Def_st_ub_q1 0 0 0.0 255.0000 ECU_ADDRESS 0x007FDD43 /begin FUNCTION_LIST OZNIVDL /end FUNCTION_LIST /end MEASUREMENT
/begin MEASUREMENT St_oznivdl1.B_ozkrzkor2 "Ein Mittelwert von zwei KurzMw ist da" UBYTE Def_bit_ub_0 0 0 0.0 255.0 ECU_ADDRESS 0x007FDD44 /begin FUNCTION_LIST OZNIVDL /end FUNCTION_LIST BIT_MASK 0x1 /end MEASUREMENT
/begin MEASUREMENT St_oznivdl1.B_ozkrzkornb "Bedingung drehzahlkorrigierter Kurzzeit Niveaumittelwert und nicht drehzahlbegrenzt berechnet" UBYTE Def_bit_ub_1 0 0 0.0 255.0 ECU_ADDRESS 0x007FDD44 /begin FUNCTION_LIST OZNIVDL /end FUNCTION_LIST BIT_MASK 0x2 /end MEASUREMENT
/begin MEASUREMENT St_oznivdl1 "Statuswort" UBYTE Def_st_ub_q1 0 0 0.0 255.0000 ECU_ADDRESS 0x007FDD44 /begin FUNCTION_LIST OZNIVDL /end FUNCTION_LIST /end MEASUREMENT
/begin MEASUREMENT St_oznivdl_nv0.B_ozlw1 "Bedingung mindestens 1 gültiger Langzeitmittelwert war vorhanden" UBYTE Def_bit_ub_0 0 0 0.0 255.0 ECU_ADDRESS 0x007FDD06 /begin FUNCTION_LIST OZNIVDL /end FUNCTION_LIST BIT_MASK 0x1 /end MEASUREMENT
/begin MEASUREMENT St_oznivdl_nv0.B_ozpeilerr "" UBYTE Def_bit_ub_1 0 0 0.0 255.0 ECU_ADDRESS 0x007FDD06 /begin FUNCTION_LIST OZNIVDL /end FUNCTION_LIST BIT_MASK 0x2 /end MEASUREMENT
/begin MEASUREMENT St_oznivdl_nv0 "Statuswort" UBYTE Def_st_ub_q1 0 0 0.0 255.0000 ECU_ADDRESS 0x007FDD06 /begin FUNCTION_LIST OZNIVDL /end FUNCTION_LIST /end MEASUREMENT
/begin MEASUREMENT Oz_testtoel2 "" SWORD Def_t_sw_q0p1 0 0 -3276.8000 3276.7000 ECU_ADDRESS 0x007FDD14 /begin FUNCTION_LIST OZNIVDL /end FUNCTION_LIST /end MEASUREMENT
/begin MEASUREMENT Oz_krzor "kurzzeitiger Mittelwert Orientierungsmessung Niveau" UBYTE Def_niv_ub_b75 0 0 0.0 74.7070 ECU_ADDRESS 0x007FDD28 /begin FUNCTION_LIST OZNIVDL /end FUNCTION_LIST /end MEASUREMENT
/begin MEASUREMENT Oz_lp "oz level picture" UBYTE Def_dez_ub_q1 0 0 0.0 255.0000 ECU_ADDRESS 0x007FDD29 /begin FUNCTION_LIST OZNIVDL /end FUNCTION_LIST /end MEASUREMENT
/begin MEASUREMENT Oz_lv "oz level value" UBYTE Def_dez_ub_q1 0 0 0.0 255.0000 ECU_ADDRESS 0x007FDD2A /begin FUNCTION_LIST OZNIVDL /end FUNCTION_LIST /end MEASUREMENT
/begin MEASUREMENT Oz_nivakt "Aktuelles Niveau für den Tester" UBYTE Def_niv_ub_b75 0 0 0.0 74.7070 ECU_ADDRESS 0x007FDD2B /begin FUNCTION_LIST OZNIVDL /end FUNCTION_LIST /end MEASUREMENT
/begin MEASUREMENT Oz_nivkrzt "Kurzmittelwert-Niveau für den Tester" UBYTE Def_niv_ub_b75 0 0 0.0 74.7070 ECU_ADDRESS 0x007FDD2C /begin FUNCTION_LIST OZNIVDL /end FUNCTION_LIST /end MEASUREMENT
/begin MEASUREMENT Oz_nivnfm "Nachfüllmenge" UBYTE Def_niv_ub_b8 0 0 0.0 7.9687 ECU_ADDRESS 0x007FDD2D /begin FUNCTION_LIST OZNIVDL /end FUNCTION_LIST /end MEASUREMENT
/begin MEASUREMENT Oz_orikor "OriMw korrigiert" UBYTE Def_niv_ub_b75 0 0 0.0 74.7070 ECU_ADDRESS 0x007FDD2E /begin FUNCTION_LIST OZNIVDL /end FUNCTION_LIST /end MEASUREMENT
/begin MEASUREMENT Oz_vormw "vorgezogener Mittelwert Niveau" UBYTE Def_niv_ub_b75 0 0 0.0 74.7070 ECU_ADDRESS 0x007FDD2F /begin FUNCTION_LIST OZNIVDL /end FUNCTION_LIST /end MEASUREMENT
/begin MEASUREMENT Oz_rwpeil "Restweg laut Peilstab" SWORD Def_km_sw_q10 0 0 -327680.0000 327670.0000 ECU_ADDRESS 0x007FDD08 /begin FUNCTION_LIST OZNIVDL /end FUNCTION_LIST /end MEASUREMENT
/begin MEASUREMENT Oz_oelverbr "Berechneter Ölverbrauch" UWORD Def_dez_uw_q1 0 0 0.0 65535.0000 ECU_ADDRESS 0x007FDD0A /begin FUNCTION_LIST OZNIVDL /end FUNCTION_LIST /end MEASUREMENT
/begin MEASUREMENT Oz_peilkmalt "Km Stand beim 1. Sensorfehler" UWORD Def_km_uw_q10 0 0 0.0 655350.0000 ECU_ADDRESS 0x007FDD0C /begin FUNCTION_LIST OZNIVDL /end FUNCTION_LIST /end MEASUREMENT
/begin MEASUREMENT Oz_verbkmalt "Km-Stand letzter Ölverbrauch-Berechnung" UWORD Def_km_uw_q10 0 0 0.0 655350.0000 ECU_ADDRESS 0x007FDD0E /begin FUNCTION_LIST OZNIVDL /end FUNCTION_LIST /end MEASUREMENT
/begin MEASUREMENT Oz_langmw "Langzeitmittelwert berechnet" UBYTE Def_niv_ub_b75 0 0 0.0 74.7070 ECU_ADDRESS 0x007FDD10 /begin FUNCTION_LIST OZNIVDL /end FUNCTION_LIST /end MEASUREMENT
/begin MEASUREMENT Oz_nivlangt "Langmittelwert für den Tester" UBYTE Def_niv_ub_b75 0 0 0.0 74.7070 ECU_ADDRESS 0x007FDD11 /begin FUNCTION_LIST OZNIVDL /end FUNCTION_LIST /end MEASUREMENT
/begin MEASUREMENT Oz_peilaltanz "" UBYTE Def_niv_ub_b75 0 0 0.0 74.7070 ECU_ADDRESS 0x007FDD12 /begin FUNCTION_LIST OZNIVDL /end FUNCTION_LIST /end MEASUREMENT
/begin MEASUREMENT Oz_verbnivalt "Ölniveau letzter Ölverbrauch-Berechnung" UBYTE Def_niv_ub_b75 0 0 0.0 74.7070 ECU_ADDRESS 0x007FDD13 /begin FUNCTION_LIST OZNIVDL /end FUNCTION_LIST /end MEASUREMENT
/begin MEASUREMENT N_ozmw "kurzzeitiger Mittelwert Drehzahl" SWORD Def_n_sw_q1p0 0 0 -32767.0000 32767.0000 ECU_ADDRESS 0x007FDD16 /begin FUNCTION_LIST OZNIVDL /end FUNCTION_LIST /end MEASUREMENT
/begin MEASUREMENT Oz_hoehe "" SWORD Def_f_sw_b8 0 0 -8.0000 7.9997 ECU_ADDRESS 0x007FDD18 /begin FUNCTION_LIST OZNIVDL /end FUNCTION_LIST /end MEASUREMENT
/begin MEASUREMENT Oz_nmotf "" SWORD Def_n_sw_q1p0 0 0 -32768.0000 32767.0000 ECU_ADDRESS 0x007FDD1A /begin FUNCTION_LIST OZNIVDL /end FUNCTION_LIST /end MEASUREMENT
/begin MEASUREMENT Oz_nmotfm "Drehzehlmittelwert Töns" SWORD Def_n_sw_q1p0 0 0 -32768.0000 32767.0000 ECU_ADDRESS 0x007FDD1C /begin FUNCTION_LIST OZNIVDL /end FUNCTION_LIST /end MEASUREMENT
/begin MEASUREMENT Oz_steigung "" SWORD Def_f_sw_b64 0 0 -64.0000 63.9980 ECU_ADDRESS 0x007FDD1E /begin FUNCTION_LIST OZNIVDL /end FUNCTION_LIST /end MEASUREMENT
/begin MEASUREMENT Oz_dkm "" UWORD Def_f_uw_b10 0 0 0.0 9.9998 ECU_ADDRESS 0x007FDD20 /begin FUNCTION_LIST OZNIVDL /end FUNCTION_LIST /end MEASUREMENT
/begin MEASUREMENT Oz_nivlit "Ölniveau in Liter" UWORD Def_niv_uw_q0p1 0 0 0.0 25.5000 ECU_ADDRESS 0x007FDD22 /begin FUNCTION_LIST OZNIVDL /end FUNCTION_LIST /end MEASUREMENT
/begin MEASUREMENT Oz_peilkm "Max Ziel km im Fehlerfall" UWORD Def_km_uw_q10 0 0 0.0 655350.0000 ECU_ADDRESS 0x007FDD24 /begin FUNCTION_LIST OZNIVDL /end FUNCTION_LIST /end MEASUREMENT
/begin MEASUREMENT Oz_pzdivp "Verhältnis oz_luftalt/oz_luftneu" UWORD Def_f_uw_b2 0 0 0.0 1.9999 ECU_ADDRESS 0x007FDD26 /begin FUNCTION_LIST OZNIVDL /end FUNCTION_LIST /end MEASUREMENT
/begin MEASUREMENT Oz_krzcnt "" UBYTE Def_dez_ub_q1 0 0 0.0 255.0000 ECU_ADDRESS 0x007FDD30 /begin FUNCTION_LIST OZNIVDL /end FUNCTION_LIST /end MEASUREMENT
/begin MEASUREMENT Oz_krzkor2 "Mittelwert von zwei KurzMw" UBYTE Def_niv_ub_b75 0 0 0.0 74.7070 ECU_ADDRESS 0x007FDD31 /begin FUNCTION_LIST OZNIVDL /end FUNCTION_LIST /end MEASUREMENT
/begin MEASUREMENT Oz_krzmw "" UBYTE Def_niv_ub_b75 0 0 0.0 74.7070 ECU_ADDRESS 0x007FDD32 /begin FUNCTION_LIST OZNIVDL /end FUNCTION_LIST /end MEASUREMENT
/begin MEASUREMENT Oz_krzmwkor "" UBYTE Def_niv_ub_b75 0 0 0.0 74.7070 ECU_ADDRESS 0x007FDD33 /begin FUNCTION_LIST OZNIVDL /end FUNCTION_LIST /end MEASUREMENT
/begin MEASUREMENT Oz_lgmwcnt "" UBYTE Def_dez_ub_q1 0 0 0.0 255.0000 ECU_ADDRESS 0x007FDD34 /begin FUNCTION_LIST OZNIVDL /end FUNCTION_LIST /end MEASUREMENT
/begin MEASUREMENT Oz_oelnivak "" UBYTE Def_td_ub_q0p5 0 0 0.0 127.5000 ECU_ADDRESS 0x007FDD35 /begin FUNCTION_LIST OZNIVDL /end FUNCTION_LIST /end MEASUREMENT
/begin MEASUREMENT Oz_oelnivaknk "" UBYTE Def_td_ub_q0p5 0 0 0.0 127.5000 ECU_ADDRESS 0x007FDD36 /begin FUNCTION_LIST OZNIVDL /end FUNCTION_LIST /end MEASUREMENT
/begin MEASUREMENT Oz_oelnivkurz "" UBYTE Def_td_ub_q0p5 0 0 0.0 127.5000 ECU_ADDRESS 0x007FDD37 /begin FUNCTION_LIST OZNIVDL /end FUNCTION_LIST /end MEASUREMENT
/begin MEASUREMENT Oz_oelnivm "10er Mittelwert Töns nicht korrigiet" UBYTE Def_td_ub_q0p5 0 0 0.0 127.5000 ECU_ADDRESS 0x007FDD38 /begin FUNCTION_LIST OZNIVDL /end FUNCTION_LIST /end MEASUREMENT
/begin MEASUREMENT Oz_oelnivnorm "" UBYTE Def_td_ub_q0p5 0 0 0.0 127.5000 ECU_ADDRESS 0x007FDD39 /begin FUNCTION_LIST OZNIVDL /end FUNCTION_LIST /end MEASUREMENT
/begin MEASUREMENT Oz_oelnivori "" UBYTE Def_td_ub_q0p5 0 0 0.0 127.5000 ECU_ADDRESS 0x007FDD3A /begin FUNCTION_LIST OZNIVDL /end FUNCTION_LIST /end MEASUREMENT
/begin MEASUREMENT Oz_peil "" UBYTE Def_niv_ub_b75 0 0 0.0 74.7070 ECU_ADDRESS 0x007FDD3B /begin FUNCTION_LIST OZNIVDL /end FUNCTION_LIST /end MEASUREMENT
/begin MEASUREMENT Oz_peilalt "" UBYTE Def_niv_ub_b75 0 0 0.0 74.7070 ECU_ADDRESS 0x007FDD3C /begin FUNCTION_LIST OZNIVDL /end FUNCTION_LIST /end MEASUREMENT
/begin MEASUREMENT Oz_peilalt1 "" UBYTE Def_niv_ub_b75 0 0 0.0 74.7070 ECU_ADDRESS 0x007FDD3D /begin FUNCTION_LIST OZNIVDL /end FUNCTION_LIST /end MEASUREMENT
/begin MEASUREMENT Oz_peilalt2 "" UBYTE Def_niv_ub_b75 0 0 0.0 74.7070 ECU_ADDRESS 0x007FDD3E /begin FUNCTION_LIST OZNIVDL /end FUNCTION_LIST /end MEASUREMENT
/begin MEASUREMENT Oz_tog_i "" UBYTE Def_dez_ub_q1 0 0 0.0 255.0000 ECU_ADDRESS 0x007FDD3F /begin FUNCTION_LIST OZNIVDL /end FUNCTION_LIST /end MEASUREMENT
/begin MEASUREMENT Oz_togbwi "" UBYTE Def_dez_ub_q1 0 0 0.0 255.0000 ECU_ADDRESS 0x007FDD40 /begin FUNCTION_LIST OZNIVDL /end FUNCTION_LIST /end MEASUREMENT
/begin MEASUREMENT Oz_togki "" UBYTE Def_dez_ub_q1 0 0 0.0 255.0000 ECU_ADDRESS 0x007FDD41 /begin FUNCTION_LIST OZNIVDL /end FUNCTION_LIST /end MEASUREMENT
/begin MEASUREMENT Oz_vormwcnt "" UBYTE Def_dez_ub_q1 0 0 0.0 255.0000 ECU_ADDRESS 0x007FDD42 /begin FUNCTION_LIST OZNIVDL /end FUNCTION_LIST /end MEASUREMENT
/begin MEASUREMENT St_ozperm0.B_calcdper "" UBYTE Def_bit_ub_0 0 0 0.0 255.0 ECU_ADDRESS 0x007FDD95 /begin FUNCTION_LIST OZPERM /end FUNCTION_LIST BIT_MASK 0x1 /end MEASUREMENT
/begin MEASUREMENT St_ozperm0.B_ozpermgl "" UBYTE Def_bit_ub_1 0 0 0.0 255.0 ECU_ADDRESS 0x007FDD95 /begin FUNCTION_LIST OZPERM /end FUNCTION_LIST BIT_MASK 0x2 /end MEASUREMENT
/begin MEASUREMENT St_ozperm0.B_ozpermpl "" UBYTE Def_bit_ub_2 0 0 0.0 255.0 ECU_ADDRESS 0x007FDD95 /begin FUNCTION_LIST OZPERM /end FUNCTION_LIST BIT_MASK 0x4 /end MEASUREMENT
/begin MEASUREMENT St_ozperm0.B_ozpermpld "Bedingung für Berechnung Restweg aus Er" UBYTE Def_bit_ub_3 0 0 0.0 255.0 ECU_ADDRESS 0x007FDD95 /begin FUNCTION_LIST OZPERM /end FUNCTION_LIST BIT_MASK 0x8 /end MEASUREMENT
/begin MEASUREMENT St_ozperm0 "Statuswort" UBYTE Def_st_ub_q1 0 0 0.0 255.0000 ECU_ADDRESS 0x007FDD95 /begin FUNCTION_LIST OZPERM /end FUNCTION_LIST /end MEASUREMENT
/begin MEASUREMENT St_ozperm_nv0.B_ozper0ok "Bedingung, dass gültiger Start-Permittivitätswert vorliegt" UBYTE Def_bit_ub_0 0 0 0.0 255.0 ECU_ADDRESS 0x007FDD46 /begin FUNCTION_LIST OZPERM /end FUNCTION_LIST BIT_MASK 0x1 /end MEASUREMENT
/begin MEASUREMENT St_ozperm_nv0.B_ozeranz "Bedingung für Anzeige Restweg aus Er" UBYTE Def_bit_ub_1 0 0 0.0 255.0 ECU_ADDRESS 0x007FDD46 /begin FUNCTION_LIST OZPERM /end FUNCTION_LIST BIT_MASK 0x2 /end MEASUREMENT
/begin MEASUREMENT St_ozperm_nv0.B_ozregstg "Bedingung Schieberegistersteuerung" UBYTE Def_bit_ub_2 0 0 0.0 255.0 ECU_ADDRESS 0x007FDD46 /begin FUNCTION_LIST OZPERM /end FUNCTION_LIST BIT_MASK 0x4 /end MEASUREMENT
/begin MEASUREMENT St_ozperm_nv0.B_ozer0ok "Bedingung Permittivität beim letztem Ölwechsel endgültig berechnet" UBYTE Def_bit_ub_3 0 0 0.0 255.0 ECU_ADDRESS 0x007FDD46 /begin FUNCTION_LIST OZPERM /end FUNCTION_LIST BIT_MASK 0x8 /end MEASUREMENT
/begin MEASUREMENT St_ozperm_nv0.B_ozdperm "Bedingung Delta Er-Ermittlung aktiv" UBYTE Def_bit_ub_4 0 0 0.0 255.0 ECU_ADDRESS 0x007FDD46 /begin FUNCTION_LIST OZPERM /end FUNCTION_LIST BIT_MASK 0x10 /end MEASUREMENT
/begin MEASUREMENT St_ozperm_nv0.B_ozerplt "Bedingung Ausheizzeit erfüllt" UBYTE Def_bit_ub_5 0 0 0.0 255.0 ECU_ADDRESS 0x007FDD46 /begin FUNCTION_LIST OZPERM /end FUNCTION_LIST BIT_MASK 0x20 /end MEASUREMENT
/begin MEASUREMENT St_ozperm_nv0 "Statuswort" UBYTE Def_st_ub_q1 0 0 0.0 255.0000 ECU_ADDRESS 0x007FDD46 /begin FUNCTION_LIST OZPERM /end FUNCTION_LIST /end MEASUREMENT
/begin MEASUREMENT Oz_permoff "Offset für Permittivitätskorrektur" UWORD Def_perm_uw_b6 0 0 0.0 5.9999 ECU_ADDRESS 0x007FDD92 /begin FUNCTION_LIST OZPERM /end FUNCTION_LIST /end MEASUREMENT
/begin MEASUREMENT Oz_permoff_oz "Offset für Permittivitätskorrektur" SWORD Def_perm_sw_b6 0 0 -6.0000 5.9998 ECU_ADDRESS 0x007FDD48 /begin FUNCTION_LIST OZPERM /end FUNCTION_LIST /end MEASUREMENT
/begin MEASUREMENT Oz_kmreg "Schieberegister Kilometerstand" UWORD Def_km_uw_q10 0 0 0.0 655350.0000 ECU_ADDRESS 0x007FDD4A ARRAY_SIZE 15 /begin FUNCTION_LIST OZPERM /end FUNCTION_LIST /end MEASUREMENT
/begin MEASUREMENT Oz_nivkm "letzter Kilometerstand bei dem ein neuer Langzeitmittelwert Niveau vorlag und kein Öl nachgefüllt wurde" UWORD Def_km_uw_q10 0 0 0.0 655350.0000 ECU_ADDRESS 0x007FDD68 /begin FUNCTION_LIST OZPERM /end FUNCTION_LIST /end MEASUREMENT
/begin MEASUREMENT Oz_permex "Permittivität für Bewertung aufbereitet (extrapoliert)" UWORD Def_perm_uw_b6 0 0 0.0 5.9999 ECU_ADDRESS 0x007FDD6A /begin FUNCTION_LIST OZPERM /end FUNCTION_LIST /end MEASUREMENT
/begin MEASUREMENT Oz_permlow "aufbereitete Permittivität bei letztem Ölwechsel" UWORD Def_perm_uw_b6 0 0 0.0 5.9999 ECU_ADDRESS 0x007FDD6C /begin FUNCTION_LIST OZPERM /end FUNCTION_LIST /end MEASUREMENT
/begin MEASUREMENT Oz_permreg "Schieberegister Permittivität" UWORD Def_perm_uw_b6 0 0 0.0 5.9999 ECU_ADDRESS 0x007FDD6E ARRAY_SIZE 15 /begin FUNCTION_LIST OZPERM /end FUNCTION_LIST /end MEASUREMENT
/begin MEASUREMENT Oz_prfstrg "Zähler für Delta Er-Ermittlung" UWORD Def_dez_uw_q1 0 0 0.0 65535.0000 ECU_ADDRESS 0x007FDD8C /begin FUNCTION_LIST OZPERM /end FUNCTION_LIST /end MEASUREMENT
/begin MEASUREMENT Oz_todeltime "Zähler Ausheizzeit (nichtflüchtig)" UWORD Def_td_uw_q1 0 0 0.0 65535.0000 ECU_ADDRESS 0x007FDD8E /begin FUNCTION_LIST OZPERM /end FUNCTION_LIST /end MEASUREMENT
/begin MEASUREMENT Oz_permanz "Anzahl der Messwerte im Schieberegister" SBYTE Def_dez_sb_q1 0 0 -128.0000 127.0000 ECU_ADDRESS 0x007FDD90 /begin FUNCTION_LIST OZPERM /end FUNCTION_LIST /end MEASUREMENT
/begin MEASUREMENT Oz_dpermsi "" SBYTE Def_dez_sb_q1 0 0 -128.0000 127.0000 ECU_ADDRESS 0x007FDD94 /begin FUNCTION_LIST OZPERM /end FUNCTION_LIST /end MEASUREMENT
/begin MEASUREMENT St_ozrestkm_0.B_oznoperm "Keine Berechnung von Permittivität für die Restlaufstrecke" UBYTE Def_bit_ub_0 0 0 0.0 255.0 ECU_ADDRESS 0x007FDDD9 /begin FUNCTION_LIST OZRESTKM /end FUNCTION_LIST BIT_MASK 0x1 /end MEASUREMENT
/begin MEASUREMENT St_ozrestkm_0 "Statuswort" UBYTE Def_st_ub_q1 0 0 0.0 255.0000 ECU_ADDRESS 0x007FDDD9 /begin FUNCTION_LIST OZRESTKM /end FUNCTION_LIST /end MEASUREMENT
/begin MEASUREMENT St_ozrestkm_nv0.B_rwanz0 "Bedingung für Restweganzeige = Null" UBYTE Def_bit_ub_0 0 0 0.0 255.0 ECU_ADDRESS 0x007FDD98 /begin FUNCTION_LIST OZRESTKM /end FUNCTION_LIST BIT_MASK 0x1 /end MEASUREMENT
/begin MEASUREMENT St_ozrestkm_nv0.B_ozvfk "Prognose und KVB aus der Kombi-Verfügbarkeit berechnet " UBYTE Def_bit_ub_1 0 0 0.0 255.0 ECU_ADDRESS 0x007FDD98 /begin FUNCTION_LIST OZRESTKM /end FUNCTION_LIST BIT_MASK 0x2 /end MEASUREMENT
/begin MEASUREMENT St_ozrestkm_nv0.B_ozini "" UBYTE Def_bit_ub_2 0 0 0.0 255.0 ECU_ADDRESS 0x007FDD98 /begin FUNCTION_LIST OZRESTKM /end FUNCTION_LIST BIT_MASK 0x4 /end MEASUREMENT
/begin MEASUREMENT St_ozrestkm_nv0.B_ozcntini "Tageberechnung initialisiert" UBYTE Def_bit_ub_3 0 0 0.0 255.0 ECU_ADDRESS 0x007FDD98 /begin FUNCTION_LIST OZRESTKM /end FUNCTION_LIST BIT_MASK 0x8 /end MEASUREMENT
/begin MEASUREMENT St_ozrestkm_nv0 "Statuswort" UBYTE Def_st_ub_q1 0 0 0.0 255.0000 ECU_ADDRESS 0x007FDD98 /begin FUNCTION_LIST OZRESTKM /end FUNCTION_LIST /end MEASUREMENT
/begin MEASUREMENT Oz_rwkvb "" SWORD Def_km_sw_q10 0 0 -327680.0000 327670.0000 ECU_ADDRESS 0x007FDDB4 /begin FUNCTION_LIST OZRESTKM /end FUNCTION_LIST /end MEASUREMENT
/begin MEASUREMENT Oz_rwperm "Restweg aus Permittivität abgeleitet" SWORD Def_km_sw_q10 0 0 -327680.0000 327670.0000 ECU_ADDRESS 0x007FDDB6 /begin FUNCTION_LIST OZRESTKM /end FUNCTION_LIST /end MEASUREMENT
/begin MEASUREMENT Oz_rwzeit "Restweg laut Zeitverlauf" SWORD Def_km_sw_q10 0 0 -327680.0000 327670.0000 ECU_ADDRESS 0x007FDDB8 /begin FUNCTION_LIST OZRESTKM /end FUNCTION_LIST /end MEASUREMENT
/begin MEASUREMENT Oz_oelzeit "Öl-Alter in Monate" UWORD Def_dez_uw_q1 0 0 0.0 65535.0000 ECU_ADDRESS 0x007FDDBA /begin FUNCTION_LIST OZRESTKM /end FUNCTION_LIST /end MEASUREMENT
/begin MEASUREMENT Oz_oelzeitt "Öl-Alter in Tage" UWORD Def_dez_uw_q1 0 0 0.0 65535.0000 ECU_ADDRESS 0x007FDDBC /begin FUNCTION_LIST OZRESTKM /end FUNCTION_LIST /end MEASUREMENT
/begin MEASUREMENT Oz_rwprog "Prognose_Intervall_Weg_BOS_Meldung_2" UWORD Def_km_uw_q10 0 0 0.0 655350.0000 ECU_ADDRESS 0x007FDDBE /begin FUNCTION_LIST OZRESTKM /end FUNCTION_LIST /end MEASUREMENT
/begin MEASUREMENT Oz_intprog "Prognose_Intervall_Zeit_BOS_Meldung_2" UBYTE Def_dez_ub_q1 0 0 0.0 255.0000 ECU_ADDRESS 0x007FDDD4 /begin FUNCTION_LIST OZRESTKM /end FUNCTION_LIST /end MEASUREMENT
/begin MEASUREMENT Oz_vfanz "anzuzeigende Verfügbarkeit" UBYTE Def_lf_ub_q0p01 0 0 0.0 2.5500 ECU_ADDRESS 0x007FDDD5 /begin FUNCTION_LIST OZRESTKM /end FUNCTION_LIST /end MEASUREMENT
/begin MEASUREMENT Oz_kvbmw "" ULONG Def_fuel_ul_q0p000122 0 0 0.0 100.0000 ECU_ADDRESS 0x007FDD9C /begin FUNCTION_LIST OZRESTKM /end FUNCTION_LIST /end MEASUREMENT
/begin MEASUREMENT Oz_kvbsm_ul "" ULONG Def_fuel_ul_q0p000122 0 0 0.0 524287.9998 ECU_ADDRESS 0x007FDDA0 /begin FUNCTION_LIST OZRESTKM /end FUNCTION_LIST /end MEASUREMENT
/begin MEASUREMENT Oz_cttagini "Tag beim Ölwechsel" SWORD Def_dez_sw_q1 0 0 -32768.0000 32767.0000 ECU_ADDRESS 0x007FDDA4 /begin FUNCTION_LIST OZRESTKM /end FUNCTION_LIST /end MEASUREMENT
/begin MEASUREMENT Oz_rwanz "anzuzeigender Restweg" SWORD Def_km_sw_q10 0 0 -327680.0000 327670.0000 ECU_ADDRESS 0x007FDDA6 /begin FUNCTION_LIST OZRESTKM /end FUNCTION_LIST /end MEASUREMENT
/begin MEASUREMENT Oz_kmstrw0 "Kilometerstand bei Restweg = Null" UWORD Def_km_uw_q10 0 0 0.0 655350.0000 ECU_ADDRESS 0x007FDDA8 /begin FUNCTION_LIST OZRESTKM /end FUNCTION_LIST /end MEASUREMENT
/begin MEASUREMENT Oz_kvbog "zugeteilte Bonuskraftstoffmenge" UWORD Def_dez_uw_q1 0 0 0.0 65535.0000 ECU_ADDRESS 0x007FDDAA /begin FUNCTION_LIST OZRESTKM /end FUNCTION_LIST /end MEASUREMENT
/begin MEASUREMENT Oz_permbog "zugeteilter Permittivitätsbonus" UWORD Def_perm_uw_b6 0 0 0.0 5.9999 ECU_ADDRESS 0x007FDDAC /begin FUNCTION_LIST OZRESTKM /end FUNCTION_LIST /end MEASUREMENT
/begin MEASUREMENT Oz_utzeit "Zeit Öl in Übertemperatur" UWORD Def_dez_uw_q1 0 0 0.0 65535.0000 ECU_ADDRESS 0x007FDDAE /begin FUNCTION_LIST OZRESTKM /end FUNCTION_LIST /end MEASUREMENT
/begin MEASUREMENT Oz_lf1t "Länderfaktor 1" UBYTE Def_lf_ub_q0p01 0 0 0.0 2.5500 ECU_ADDRESS 0x007FDDB0 /begin FUNCTION_LIST OZRESTKM /end FUNCTION_LIST /end MEASUREMENT
/begin MEASUREMENT Oz_lf2t "Länderfaktor 2" UBYTE Def_lf_ub_q0p01 0 0 0.0 2.5500 ECU_ADDRESS 0x007FDDB1 /begin FUNCTION_LIST OZRESTKM /end FUNCTION_LIST /end MEASUREMENT
/begin MEASUREMENT Oz_zieljahr "" UBYTE Def_dez_ub_q1 0 0 0.0 255.0000 ECU_ADDRESS 0x007FDDB2 /begin FUNCTION_LIST OZRESTKM /end FUNCTION_LIST /end MEASUREMENT
/begin MEASUREMENT Oz_zielmon "" UBYTE Def_dez_ub_q1 0 0 0.0 255.0000 ECU_ADDRESS 0x007FDDB3 /begin FUNCTION_LIST OZRESTKM /end FUNCTION_LIST /end MEASUREMENT
/begin MEASUREMENT Oz_kvbdiff "" ULONG Def_fuel_ul_q0p000122 0 0 0.0 100.0000 ECU_ADDRESS 0x007FDDCC /begin FUNCTION_LIST OZRESTKM /end FUNCTION_LIST /end MEASUREMENT
/begin MEASUREMENT Oz_kvbsm "" ULONG Def_fuel_ul_q0p000122 0 0 0.0 10000.0000 ECU_ADDRESS 0x007FDDD0 /begin FUNCTION_LIST OZRESTKM /end FUNCTION_LIST /end MEASUREMENT
/begin MEASUREMENT Oz_rwp "Zwischengröße Restwegberechnung" SWORD Def_km_sw_q10 0 0 -327680.0000 327670.0000 ECU_ADDRESS 0x007FDDC0 /begin FUNCTION_LIST OZRESTKM /end FUNCTION_LIST /end MEASUREMENT
/begin MEASUREMENT Oz_kvbmwtmp "" UWORD Def_f_uw_b64 0 0 0.0 63.9990 ECU_ADDRESS 0x007FDDC2 /begin FUNCTION_LIST OZRESTKM /end FUNCTION_LIST /end MEASUREMENT
/begin MEASUREMENT Oz_kvbmx "" UWORD Def_dez_uw_q1 0 0 0.0 65535.0000 ECU_ADDRESS 0x007FDDC4 /begin FUNCTION_LIST OZRESTKM /end FUNCTION_LIST /end MEASUREMENT
/begin MEASUREMENT Oz_kvbtmp2 "" UWORD Def_km_uw_q10 0 0 0.0 655350.0000 ECU_ADDRESS 0x007FDDC6 /begin FUNCTION_LIST OZRESTKM /end FUNCTION_LIST /end MEASUREMENT
/begin MEASUREMENT Oz_litges "Gesamtverbrauch für Ölwechsel" UWORD Def_dez_uw_q1 0 0 0.0 65535.0000 ECU_ADDRESS 0x007FDDC8 /begin FUNCTION_LIST OZRESTKM /end FUNCTION_LIST /end MEASUREMENT
/begin MEASUREMENT Oz_litgesk "Gesamtverbrauch für Ölwechsel" UWORD Def_dez_uw_q1 0 0 0.0 65535.0000 ECU_ADDRESS 0x007FDDCA /begin FUNCTION_LIST OZRESTKM /end FUNCTION_LIST /end MEASUREMENT
/begin MEASUREMENT Oz_vfkvb "Verfügbarkeit aus Kraftstoffverbrauch" UBYTE Def_lf_ub_q0p01 0 0 0.0 2.5500 ECU_ADDRESS 0x007FDDD6 /begin FUNCTION_LIST OZRESTKM /end FUNCTION_LIST /end MEASUREMENT
/begin MEASUREMENT Oz_vfperm "Verfügbarkeit aus der Permittivität" UBYTE Def_lf_ub_q0p01 0 0 0.0 2.5500 ECU_ADDRESS 0x007FDDD7 /begin FUNCTION_LIST OZRESTKM /end FUNCTION_LIST /end MEASUREMENT
/begin MEASUREMENT Oz_vfzeit "Verfügbarkeit aus Zeit" UBYTE Def_lf_ub_q0p01 0 0 0.0 2.5500 ECU_ADDRESS 0x007FDDD8 /begin FUNCTION_LIST OZRESTKM /end FUNCTION_LIST /end MEASUREMENT
/begin MEASUREMENT Oz_tempf "" SWORD Def_t_sw_q0p1 0 0 -3276.8000 3276.7000 ECU_ADDRESS 0x007FDDDA /begin FUNCTION_LIST OZTEMP /end FUNCTION_LIST /end MEASUREMENT
/begin MEASUREMENT St_bns2.B_nachlnd7 "Bordnetzstabilitätsmaßnahmen aktiv" UBYTE Def_bit_ub_0 0 0 0.0 255.0 ECU_ADDRESS 0x007FDDEB /begin FUNCTION_LIST PMBNSTAB /end FUNCTION_LIST BIT_MASK 0x1 /end MEASUREMENT
/begin MEASUREMENT St_bns2 "Statuswort" UBYTE Def_st_ub_q1 0 0 0.0 255.0000 ECU_ADDRESS 0x007FDDEB /begin FUNCTION_LIST PMBNSTAB /end FUNCTION_LIST /end MEASUREMENT
/begin MEASUREMENT St_bns.B_bns "lokales B_nachlaufende" UBYTE Def_bit_ub_0 0 0 0.0 255.0 ECU_ADDRESS 0x007FDDDC /begin FUNCTION_LIST PMBNSTAB /end FUNCTION_LIST BIT_MASK 0x1 /end MEASUREMENT
/begin MEASUREMENT St_bns "Statuswort" UBYTE Def_st_ub_q1 0 0 0.0 255.0000 ECU_ADDRESS 0x007FDDDC /begin FUNCTION_LIST PMBNSTAB /end FUNCTION_LIST /end MEASUREMENT
/begin MEASUREMENT Bnctrmx1s "" UBYTE Def_dez_ub_q1 0 0 0.0 255.0000 ECU_ADDRESS 0x007FDDEC /begin FUNCTION_LIST PMBNSTAB /end FUNCTION_LIST /end MEASUREMENT
/begin MEASUREMENT Bnsctrant0 "Counter 1 sec-Anteile ohne Grenzwertüberschreitung" ULONG Def_dez_ul_q1 0 0 0.0 4294967295.0000 ECU_ADDRESS 0x007FDDE0 /begin FUNCTION_LIST PMBNSTAB /end FUNCTION_LIST /end MEASUREMENT
/begin MEASUREMENT Bnsctrant1 "Counter 1 sec-Anteile 1. Bereich" UWORD Def_dez_uw_q1 0 0 0.0 65535.0000 ECU_ADDRESS 0x007FDDE4 /begin FUNCTION_LIST PMBNSTAB /end FUNCTION_LIST /end MEASUREMENT
/begin MEASUREMENT Bnsctrant2 "Counter 1 sec-Anteile 2. Bereich" UWORD Def_dez_uw_q1 0 0 0.0 65535.0000 ECU_ADDRESS 0x007FDDE6 /begin FUNCTION_LIST PMBNSTAB /end FUNCTION_LIST /end MEASUREMENT
/begin MEASUREMENT Bnsctrant3 "Counter 1 sec-Anteile 3. Bereich" UWORD Def_dez_uw_q1 0 0 0.0 65535.0000 ECU_ADDRESS 0x007FDDE8 /begin FUNCTION_LIST PMBNSTAB /end FUNCTION_LIST /end MEASUREMENT
/begin MEASUREMENT Bnsctr "Counter Bordnetzspannungsplausibilisierung" UBYTE Def_dez_ub_q1 0 0 0.0 255.0000 ECU_ADDRESS 0x007FDDEA /begin FUNCTION_LIST PMBNSTAB /end FUNCTION_LIST /end MEASUREMENT
/begin FUNCTION LAYER "LAYER" /end FUNCTION
/begin FUNCTION LBATTCAL "LBATTCAL" /end FUNCTION
/begin FUNCTION LDSTGEN "LDSTGEN" /end FUNCTION
/begin FUNCTION LLPMCTRL "LLPMCTRL" /end FUNCTION
/begin FUNCTION LLRANH "LLRANH" /end FUNCTION
/begin FUNCTION LOADRESP "LOADRESP" /end FUNCTION
/begin FUNCTION MANDETEK "MANDETEK" /end FUNCTION
/begin FUNCTION OZBG "OZBG" /end FUNCTION
/begin FUNCTION OZGG "OZGG" /end FUNCTION
/begin FUNCTION OZLEIT "OZLEIT" /end FUNCTION
/begin FUNCTION OZNIVDL "OZNIVDL" /end FUNCTION
/begin FUNCTION OZPERM "OZPERM" /end FUNCTION
/begin FUNCTION OZRESTKM "OZRESTKM" /end FUNCTION
/begin FUNCTION OZTEMP "OZTEMP" /end FUNCTION
/begin FUNCTION PMBNSTAB "PMBNSTAB" /end FUNCTION
/begin COMPU_METHOD Def_t_sw_q0p1 "Def_t_sw_q0p1" RAT_FUNC "%6.1" "°C" COEFFS 0 10 0 0 0 1 /end COMPU_METHOD
/begin COMPU_METHOD Def_u_uw_q0p0942 "Def_u_uw_q0p0942" RAT_FUNC "%6.1" "V" COEFFS 0 1 0 0 0 0.0942 /end COMPU_METHOD
/begin COMPU_METHOD Def_f_ub_b8 "Def_f_ub_b8" RAT_FUNC "%5.2" "-" COEFFS 0 256 0 0 0 8 /end COMPU_METHOD
/begin COMPU_METHOD Def_v_uw_q1p0 "Def_v_uw_q1p0" RAT_FUNC "%5.0" "km/h" COEFFS 0 1 0 0 0 1 /end COMPU_METHOD
/begin COMPU_METHOD Def_tv_ub_q0p390625 "Def_tv_ub_q0p390625" RAT_FUNC "%5.2" "%" COEFFS 0 256 0 0 0 100 /end COMPU_METHOD
/begin COMPU_METHOD Def_bit_ub_0 "Def_bit_ub_0" TAB_VERB "%5.2" "-" COMPU_TAB_REF Def_bit_ub_0_VTAB /end COMPU_METHOD
/begin COMPU_METHOD Def_st_ub_q1 "Def_st_ub_q1" RAT_FUNC "%3.0" "-" COEFFS 0 1 0 0 0 1 /end COMPU_METHOD
/begin COMPU_METHOD Def_n_sw_q1p0 "Def_n_sw_q1p0" RAT_FUNC "%5.0" "Upm" COEFFS 0 1 0 0 0 1 /end COMPU_METHOD
/begin COMPU_METHOD Def_f_ub_b100 "Def_f_ub_b100" RAT_FUNC "%5.2" "%" COEFFS 0 256 0 0 0 100 /end COMPU_METHOD
/begin COMPU_METHOD Def_td_ub_q0p1 "Def_td_ub_q0p1" RAT_FUNC "%4.1" "s" COEFFS 0 10 0 0 0 1 /end COMPU_METHOD
/begin COMPU_METHOD Def_bit_ub_1 "Def_bit_ub_1" TAB_VERB "%5.2" "-" COMPU_TAB_REF Def_bit_ub_1_VTAB /end COMPU_METHOD
/begin COMPU_METHOD Def_bit_ub_2 "Def_bit_ub_2" TAB_VERB "%5.2" "-" COMPU_TAB_REF Def_bit_ub_2_VTAB /end COMPU_METHOD
/begin COMPU_METHOD Def_bit_ub_3 "Def_bit_ub_3" TAB_VERB "%5.2" "-" COMPU_TAB_REF Def_bit_ub_3_VTAB /end COMPU_METHOD
/begin COMPU_METHOD Def_bit_ub_4 "Def_bit_ub_4" TAB_VERB "%5.2" "-" COMPU_TAB_REF Def_bit_ub_4_VTAB /end COMPU_METHOD
/begin COMPU_METHOD Def_bit_ub_5 "Def_bit_ub_5" TAB_VERB "%5.2" "-" COMPU_TAB_REF Def_bit_ub_5_VTAB /end COMPU_METHOD
/begin COMPU_METHOD Def_bit_ub_6 "Def_bit_ub_6" TAB_VERB "%5.2" "-" COMPU_TAB_REF Def_bit_ub_6_VTAB /end COMPU_METHOD
/begin COMPU_METHOD Def_bit_ub_7 "Def_bit_ub_7" TAB_VERB "%5.2" "-" COMPU_TAB_REF Def_bit_ub_7_VTAB /end COMPU_METHOD
/begin COMPU_METHOD Def_st_uw_q1 "Def_st_uw_q1" RAT_FUNC "%5.0" "-" COEFFS 0 1 0 0 0 1 /end COMPU_METHOD
/begin COMPU_METHOD Def_dez_uw_q1 "Def_dez_uw_q1" RAT_FUNC "%5.0" "-" COEFFS 0 1 0 0 0 1 /end COMPU_METHOD
/begin COMPU_METHOD Def_dez_ub_q1 "Def_dez_ub_q1" RAT_FUNC "%3.0" "-" COEFFS 0 1 0 0 0 1 /end COMPU_METHOD
/begin COMPU_METHOD Identity "Identity" RAT_FUNC "%4.1" "-" COEFFS 0 1 0 0 0 1 /end COMPU_METHOD
/begin COMPU_METHOD Def_dez_ul_q1 "Def_dez_ul_q1" RAT_FUNC "%7.0" "-" COEFFS 0 1 0 0 0 1 /end COMPU_METHOD
/begin COMPU_METHOD Def_m_sw_q0p1 "Def_m_sw_q0p1" RAT_FUNC "%7.2" "Nm" COEFFS 0 10 0 0 0 1 /end COMPU_METHOD
/begin COMPU_METHOD Def_f_uw_b100 "Def_f_uw_b100" RAT_FUNC "%8.3" "%" COEFFS 0 65536 0 0 0 100 /end COMPU_METHOD
/begin COMPU_METHOD Def_i_ub_q0p125 "Def_i_ub_q0p125" RAT_FUNC "%6.3" "A" COEFFS 0 8 0 0 0 1 /end COMPU_METHOD
/begin COMPU_METHOD Def_f_ub_b4 "Def_f_ub_b4" RAT_FUNC "%5.2" "-" COEFFS 0 256 0 0 0 4 /end COMPU_METHOD
/begin COMPU_METHOD Def_u_uw_q0p1 "Def_u_uw_q0p1" RAT_FUNC "%8.3" "V" COEFFS 0 10 0 0 0 1 /end COMPU_METHOD
/begin COMPU_METHOD Def_f_uw_b1 "Def_f_uw_b1" RAT_FUNC "%14.5" "-" COEFFS 0 65536 0 0 0 1 /end COMPU_METHOD
/begin COMPU_METHOD Def_f_uw_b32 "Def_f_uw_b32" RAT_FUNC "%9.4" "-" COEFFS 0 65536 0 0 0 32 /end COMPU_METHOD
/begin COMPU_METHOD Def_f_ub_b1 "Def_f_ub_b1" RAT_FUNC "%6.3" "-" COEFFS 0 256 0 0 0 1 /end COMPU_METHOD
/begin COMPU_METHOD Def_td_ub_q1 "Def_td_ub_q1" RAT_FUNC "%5.2" "s" COEFFS 0 1 0 0 0 1 /end COMPU_METHOD
/begin COMPU_METHOD Def_td_ub_q0p01 "Def_td_ub_q0p01" RAT_FUNC "%5.2" "s" COEFFS 0 100 0 0 0 1 /end COMPU_METHOD
/begin COMPU_METHOD Def_f_ub_b2 "Def_f_ub_b2" RAT_FUNC "%6.3" "-" COEFFS 0 256 0 0 0 2 /end COMPU_METHOD
/begin COMPU_METHOD Def_f_uw_b2 "Def_f_uw_b2" RAT_FUNC "%14.5" "-" COEFFS 0 65536 0 0 0 2 /end COMPU_METHOD
/begin COMPU_METHOD Def_f_uw_b64 "Def_f_uw_b64" RAT_FUNC "%9.4" "-" COEFFS 0 65536 0 0 0 64 /end COMPU_METHOD
/begin COMPU_METHOD Def_lf_ub_q0p01 "Def_lf_ub_q0p01" RAT_FUNC "%5.2" "-" COEFFS 0 100 0 0 0 1 /end COMPU_METHOD
/begin COMPU_METHOD Def_ac_sb_q0p25 "Def_ac_sb_q0p25" RAT_FUNC "%4.1" "-" COEFFS 0 4 0 0 0 1 /end COMPU_METHOD
/begin COMPU_METHOD Def_p_uw_q0p039 "Def_p_uw_q0p039" RAT_FUNC "%7.2" "hPa" COEFFS 0 256 0 0 0 10 /end COMPU_METHOD
/begin COMPU_METHOD Def_wdk_sw_q0p0244 "Def_wdk_sw_q0p0244" RAT_FUNC "%7.2" "%" COEFFS 0 4096 0 0 0 100 /end COMPU_METHOD
/begin COMPU_METHOD Def_td_uw_q0p1 "Def_td_uw_q0p1" RAT_FUNC "%6.1" "s" COEFFS 0 10 0 0 0 1 /end COMPU_METHOD
/begin COMPU_METHOD Def_i_sw_q0039 "Def_i_sw_q0039" RAT_FUNC "%8.3" "mA" COEFFS 0 256 0 0 0 1 /end COMPU_METHOD
/begin COMPU_METHOD Def_dm_sw_q0p1 "Def_dm_sw_q0p1" RAT_FUNC "%7.2" "Nm/s" COEFFS 0 10 0 0 0 1 /end COMPU_METHOD
/begin COMPU_METHOD Def_i_sw_q0p0625 "Def_i_sw_q0p0625" RAT_FUNC "%8.3" "A" COEFFS 0 1000 0 0 0 62.5 /end COMPU_METHOD
/begin COMPU_METHOD Def_km_uw_q10 "Def_km_uw_q10" RAT_FUNC "%5.0" "km" COEFFS 0 1 0 0 0 10 /end COMPU_METHOD
/begin COMPU_METHOD Def_lm_uw_q0p000444 "Def_lm_uw_q0p000444" RAT_FUNC "%9.4" "kg" COEFFS 0 2250 0 0 0 1 /end COMPU_METHOD
/begin COMPU_METHOD Def_rf_sw_q0p01 "Def_rf_sw_q0p01" RAT_FUNC "%9.4" "%" COEFFS 0 100 0 0 0 1 /end COMPU_METHOD
/begin COMPU_METHOD Def_bit_uw_0 "Def_bit_uw_0" TAB_VERB "%7.2" "-" COMPU_TAB_REF Def_bit_uw_0_VTAB /end COMPU_METHOD
/begin COMPU_METHOD Def_bit_uw_3 "Def_bit_uw_3" TAB_VERB "%7.2" "-" COMPU_TAB_REF Def_bit_uw_3_VTAB /end COMPU_METHOD
/begin COMPU_METHOD Def_bit_uw_5 "Def_bit_uw_5" TAB_VERB "%7.2" "-" COMPU_TAB_REF Def_bit_uw_5_VTAB /end COMPU_METHOD
/begin COMPU_METHOD Def_t_sw_q0p01 "Def_t_sw_q0p01" RAT_FUNC "%7.2" "°C" COEFFS 0 100 0 0 0 1 /end COMPU_METHOD
/begin COMPU_METHOD Def_td_uw_q0p01 "Def_td_uw_q0p01" RAT_FUNC "%7.2" "s" COEFFS 0 100 0 0 0 1 /end COMPU_METHOD
/begin COMPU_METHOD Def_u_sw_b128 "Def_u_sw_b128" RAT_FUNC "%8.3" "V" COEFFS 0 256 0 0 0 1 /end COMPU_METHOD
/begin COMPU_METHOD Def_u_ub_q0p0942 "Def_u_ub_q0p0942" RAT_FUNC "%7.4" "V" COEFFS 0 1 0 0 0 0.0942 /end COMPU_METHOD
/begin COMPU_METHOD Def_km_sw_q10 "Def_km_sw_q10" RAT_FUNC "%6.1" "km" COEFFS 0 1 0 0 0 10 /end COMPU_METHOD
/begin COMPU_METHOD Def_km_ub_q1000 "Def_km_ub_q1000" RAT_FUNC "%3.0" "km" COEFFS 0 1 0 0 0 1000 /end COMPU_METHOD
/begin COMPU_METHOD Def_tv_sw_q0p0244 "Def_tv_sw_q0p0244" RAT_FUNC "%7.2" "%" COEFFS 0 4096 0 0 0 100 /end COMPU_METHOD
/begin COMPU_METHOD Def_ml_sw_q0p1 "Def_ml_sw_q0p1" RAT_FUNC "%7.2" "mg/Hub" COEFFS 0 10 0 0 0 1 /end COMPU_METHOD
/begin COMPU_METHOD Def_me_sw_q0p01 "Def_me_sw_q0p01" RAT_FUNC "%8.3" "mg/cyc" COEFFS 0 100 0 0 0 1 /end COMPU_METHOD
/begin COMPU_METHOD Def_f_uw_b16 "Def_f_uw_b16" RAT_FUNC "%9.4" "-" COEFFS 0 65536 0 0 0 16 /end COMPU_METHOD
/begin COMPU_METHOD Def_p_sw_q1 "Def_p_sw_q1" RAT_FUNC "%6.1" "hPa" COEFFS 0 1 0 0 0 1 /end COMPU_METHOD
/begin COMPU_METHOD Def_tv_sw_q0p01 "Def_tv_sw_q0p01" RAT_FUNC "%8.3" "%" COEFFS 0 100 0 0 0 1 /end COMPU_METHOD
/begin COMPU_METHOD Def_i_ub_q10 "Def_i_ub_q10" RAT_FUNC "%5.2" "A" COEFFS 0 1 0 0 0 10 /end COMPU_METHOD
/begin COMPU_METHOD Def_i_ub_q0p001 "Def_i_ub_q0p001" RAT_FUNC "%6.3" "A" COEFFS 0 1000 0 0 0 1 /end COMPU_METHOD
/begin COMPU_METHOD Def_f_ub_b32 "Def_f_ub_b32" RAT_FUNC "%5.2" "-" COEFFS 0 256 0 0 0 32 /end COMPU_METHOD
/begin COMPU_METHOD Def_f_uw_b256 "Def_f_uw_b256" RAT_FUNC "%8.3" "-" COEFFS 0 65536 0 0 0 256 /end COMPU_METHOD
/begin COMPU_METHOD Def_f_r32 "Def_f_r32" RAT_FUNC "%14.7" "-" COEFFS 0 1 0 0 0 1 /end COMPU_METHOD
/begin COMPU_METHOD Def_f_sw_b100 "Def_f_sw_b100" RAT_FUNC "%8.3" "-" COEFFS 0 32768 0 0 0 100 /end COMPU_METHOD
/begin COMPU_METHOD Def_bit_uw_1 "Def_bit_uw_1" TAB_VERB "%7.2" "-" COMPU_TAB_REF Def_bit_uw_1_VTAB /end COMPU_METHOD
/begin COMPU_METHOD Def_bit_uw_2 "Def_bit_uw_2" TAB_VERB "%7.2" "-" COMPU_TAB_REF Def_bit_uw_2_VTAB /end COMPU_METHOD
/begin COMPU_METHOD Def_bit_uw_4 "Def_bit_uw_4" TAB_VERB "%7.2" "-" COMPU_TAB_REF Def_bit_uw_4_VTAB /end COMPU_METHOD
/begin COMPU_METHOD Def_bit_uw_6 "Def_bit_uw_6" TAB_VERB "%7.2" "-" COMPU_TAB_REF Def_bit_uw_6_VTAB /end COMPU_METHOD
/begin COMPU_METHOD Def_bit_uw_7 "Def_bit_uw_7" TAB_VERB "%7.2" "-" COMPU_TAB_REF Def_bit_uw_7_VTAB /end COMPU_METHOD
/begin COMPU_METHOD Def_f_ul_b262144 "Def_f_ul_b262144" RAT_FUNC "%14.5" "" COEFFS 0 16384 0 0 0 1 /end COMPU_METHOD
/begin COMPU_METHOD Def_f_uw_b4 "Def_f_uw_b4" RAT_FUNC "%14.5" "-" COEFFS 0 65536 0 0 0 4 /end COMPU_METHOD
/begin COMPU_METHOD Def_dez_sw_q1 "Def_dez_sw_q1" RAT_FUNC "%5.0" "-" COEFFS 0 1 0 0 0 1 /end COMPU_METHOD
/begin COMPU_METHOD Def_niv_ub_b75 "Def_niv_ub_b75" RAT_FUNC "%5.2" "" COEFFS 0 256 0 0 0 75 /end COMPU_METHOD
/begin COMPU_METHOD Def_perm_uw_b6 "Def_perm_uw_b6" RAT_FUNC "%14.5" "-" COEFFS 0 65536 0 0 0 6 /end COMPU_METHOD
/begin COMPU_METHOD Def_dez_sb_q1 "Def_dez_sb_q1" RAT_FUNC "%3.0" "-" COEFFS 0 1 0 0 0 1 /end COMPU_METHOD
/begin COMPU_METHOD Def_niv_ub_b8 "Def_niv_ub_b8" RAT_FUNC "%5.2" "" COEFFS 0 256 0 0 0 8 /end COMPU_METHOD
/begin COMPU_METHOD Def_f_sw_b8 "Def_f_sw_b8" RAT_FUNC "%9.4" "-" COEFFS 0 32768 0 0 0 8 /end COMPU_METHOD
/begin COMPU_METHOD Def_f_sw_b64 "Def_f_sw_b64" RAT_FUNC "%8.3" "-" COEFFS 0 65536 0 0 0 128 /end COMPU_METHOD
/begin COMPU_METHOD Def_f_uw_b10 "Def_f_uw_b10" RAT_FUNC "%9.4" "%" COEFFS 0 65536 0 0 0 10 /end COMPU_METHOD
/begin COMPU_METHOD Def_niv_uw_q0p1 "Def_niv_uw_q0p1" RAT_FUNC "%6.1" "l" COEFFS 0 10 0 0 0 1 /end COMPU_METHOD
/begin COMPU_METHOD Def_td_ub_q0p5 "Def_td_ub_q0p5" RAT_FUNC "%6.3" "s" COEFFS 0 2 0 0 0 1 /end COMPU_METHOD
/begin COMPU_METHOD Def_f_sw_b32 "Def_f_sw_b32" RAT_FUNC "%9.4" "-" COEFFS 0 32768 0 0 0 32 /end COMPU_METHOD
/begin COMPU_METHOD Def_tn_uw_q1 "Def_tn_uw_q1" RAT_FUNC "%7.2" "min" COEFFS 0 1 0 0 0 1 /end COMPU_METHOD
/begin COMPU_METHOD Def_p_uw_q039 "Def_p_uw_q039" RAT_FUNC "%8.3" "hPa" COEFFS 0 256 0 0 0 10 /end COMPU_METHOD
/begin COMPU_METHOD Def_f_ub_b0p5 "Def_f_ub_b0p5" RAT_FUNC "%6.3" "-" COEFFS 0 256 0 0 0 0.5 /end COMPU_METHOD
/begin COMPU_METHOD Def_f_ub_b0p25 "Def_f_ub_b0p25" RAT_FUNC "%7.4" "-" COEFFS 0 256 0 0 0 0.25 /end COMPU_METHOD
/begin COMPU_METHOD Def_f_sw_b1 "Def_f_sw_b1" RAT_FUNC "%14.5" "-" COEFFS 0 65536 0 0 0 2 /end COMPU_METHOD
/begin COMPU_METHOD Def_niv_sb_b37p5 "Def_niv_sb_b37p5" RAT_FUNC "%5.2" "" COEFFS 0 256 0 0 0 75 /end COMPU_METHOD
/begin COMPU_METHOD Def_niv_uw_b75 "Def_niv_uw_b75" RAT_FUNC "%7.2" "mm" COEFFS 0 256 0 0 0 75 /end COMPU_METHOD
/begin COMPU_METHOD Def_niv_sw_b37p5 "Def_niv_sw_b37p5" RAT_FUNC "%7.2" "" COEFFS 0 256 0 0 0 75 /end COMPU_METHOD
/begin COMPU_METHOD Def_perm_sw_b6 "Def_perm_sw_b6" RAT_FUNC "%9.4" "-" COEFFS 0 65536 0 0 0 12 /end COMPU_METHOD
/begin COMPU_METHOD Def_td_uw_q1 "Def_td_uw_q1" RAT_FUNC "%5.0" "s" COEFFS 0 1 0 0 0 1 /end COMPU_METHOD
/begin COMPU_METHOD Def_fuel_ul_q0p000122 "Def_fuel_ul_q0p000122" RAT_FUNC "%11.4" "" COEFFS 0 8192 0 0 0 1 /end COMPU_METHOD
/begin COMPU_METHOD Def_kw_ub_q0p0234 "Def_kw_ub_q0p0234" RAT_FUNC "%6.3" "°KW" COEFFS 0 256 0 0 0 6 /end COMPU_METHOD
/begin COMPU_VTAB Def_bit_ub_0_VTAB "Def_bit_ub_0_VTAB" TAB_VERB 2 0 "FALSE" 1 "TRUE" /end COMPU_VTAB
/begin COMPU_VTAB Def_bit_ub_1_VTAB "Def_bit_ub_1_VTAB" TAB_VERB 2 0 "FALSE" 1 "TRUE" /end COMPU_VTAB
/begin COMPU_VTAB Def_bit_ub_2_VTAB "Def_bit_ub_2_VTAB" TAB_VERB 2 0 "FALSE" 1 "TRUE" /end COMPU_VTAB
/begin COMPU_VTAB Def_bit_ub_3_VTAB "Def_bit_ub_3_VTAB" TAB_VERB 2 0 "FALSE" 1 "TRUE" /end COMPU_VTAB
/begin COMPU_VTAB Def_bit_ub_4_VTAB "Def_bit_ub_4_VTAB" TAB_VERB 2 0 "FALSE" 1 "TRUE" /end COMPU_VTAB
/begin COMPU_VTAB Def_bit_ub_5_VTAB "Def_bit_ub_5_VTAB" TAB_VERB 2 0 "FALSE" 1 "TRUE" /end COMPU_VTAB
/begin COMPU_VTAB Def_bit_ub_6_VTAB "Def_bit_ub_6_VTAB" TAB_VERB 2 0 "FALSE" 1 "TRUE" /end COMPU_VTAB
/begin COMPU_VTAB Def_bit_ub_7_VTAB "Def_bit_ub_7_VTAB" TAB_VERB 2 0 "FALSE" 1 "TRUE" /end COMPU_VTAB
/begin COMPU_VTAB Def_bit_uw_0_VTAB "Def_bit_uw_0_VTAB" TAB_VERB 2 0 "FALSE" 1 "TRUE" /end COMPU_VTAB
/begin COMPU_VTAB Def_bit_uw_3_VTAB "Def_bit_uw_3_VTAB" TAB_VERB 2 0 "FALSE" 1 "TRUE" /end COMPU_VTAB
/begin COMPU_VTAB Def_bit_uw_5_VTAB "Def_bit_uw_5_VTAB" TAB_VERB 2 0 "FALSE" 1 "TRUE" /end COMPU_VTAB
/begin COMPU_VTAB Def_bit_uw_1_VTAB "Def_bit_uw_1_VTAB" TAB_VERB 2 0 "FALSE" 1 "TRUE" /end COMPU_VTAB
/begin COMPU_VTAB Def_bit_uw_2_VTAB "Def_bit_uw_2_VTAB" TAB_VERB 2 0 "FALSE" 1 "TRUE" /end COMPU_VTAB
/begin COMPU_VTAB Def_bit_uw_4_VTAB "Def_bit_uw_4_VTAB" TAB_VERB 2 0 "FALSE" 1 "TRUE" /end COMPU_VTAB
/begin COMPU_VTAB Def_bit_uw_6_VTAB "Def_bit_uw_6_VTAB" TAB_VERB 2 0 "FALSE" 1 "TRUE" /end COMPU_VTAB
/begin COMPU_VTAB Def_bit_uw_7_VTAB "Def_bit_uw_7_VTAB" TAB_VERB 2 0 "FALSE" 1 "TRUE" /end COMPU_VTAB
/begin RECORD_LAYOUT TKW_VV_VV_UW FNC_VALUES 1 UWORD COLUMN_DIR DIRECT /end RECORD_LAYOUT
/begin RECORD_LAYOUT TKW_VV_VV_SW FNC_VALUES 1 SWORD COLUMN_DIR DIRECT /end RECORD_LAYOUT
/begin RECORD_LAYOUT TKL_UW_VV_UW NO_AXIS_PTS_X 1 UBYTE RESERVED 2 BYTE AXIS_PTS_X 3 UWORD INDEX_INCR DIRECT FNC_VALUES 4 UWORD COLUMN_DIR DIRECT /end RECORD_LAYOUT
/begin RECORD_LAYOUT TKW_VV_VV_UB FNC_VALUES 1 UBYTE COLUMN_DIR DIRECT /end RECORD_LAYOUT
/begin RECORD_LAYOUT TKW_VV_VV_UL FNC_VALUES 1 ULONG COLUMN_DIR DIRECT /end RECORD_LAYOUT
/begin RECORD_LAYOUT TKL_UW_VV_SW NO_AXIS_PTS_X 1 UBYTE RESERVED 2 BYTE AXIS_PTS_X 3 UWORD INDEX_INCR DIRECT FNC_VALUES 4 SWORD COLUMN_DIR DIRECT /end RECORD_LAYOUT
/begin RECORD_LAYOUT TKL_SW_VV_UB NO_AXIS_PTS_X 1 UBYTE RESERVED 2 BYTE AXIS_PTS_X 3 SWORD INDEX_INCR DIRECT FNC_VALUES 4 UBYTE COLUMN_DIR DIRECT /end RECORD_LAYOUT
/begin RECORD_LAYOUT TKL_SW_VV_SW NO_AXIS_PTS_X 1 UBYTE RESERVED 2 BYTE AXIS_PTS_X 3 SWORD INDEX_INCR DIRECT FNC_VALUES 4 SWORD COLUMN_DIR DIRECT /end RECORD_LAYOUT
/begin RECORD_LAYOUT TKF_UW_SW_UB NO_AXIS_PTS_X 1 UBYTE NO_AXIS_PTS_Y 2 UBYTE AXIS_PTS_X 3 SWORD INDEX_INCR DIRECT AXIS_PTS_Y 4 UWORD INDEX_INCR DIRECT FNC_VALUES 5 UBYTE COLUMN_DIR DIRECT /end RECORD_LAYOUT
/begin RECORD_LAYOUT TKF_SW_SW_UB NO_AXIS_PTS_X 1 UBYTE NO_AXIS_PTS_Y 2 UBYTE AXIS_PTS_X 3 SWORD INDEX_INCR DIRECT AXIS_PTS_Y 4 SWORD INDEX_INCR DIRECT FNC_VALUES 5 UBYTE COLUMN_DIR DIRECT /end RECORD_LAYOUT
/begin RECORD_LAYOUT TKF_UW_UW_UW NO_AXIS_PTS_X 1 UBYTE NO_AXIS_PTS_Y 2 UBYTE AXIS_PTS_X 3 UWORD INDEX_INCR DIRECT AXIS_PTS_Y 4 UWORD INDEX_INCR DIRECT FNC_VALUES 5 UWORD COLUMN_DIR DIRECT /end RECORD_LAYOUT
/begin RECORD_LAYOUT TKW_VV_VV_SB FNC_VALUES 1 SBYTE COLUMN_DIR DIRECT /end RECORD_LAYOUT
/begin RECORD_LAYOUT TKL_SW_VV_SB NO_AXIS_PTS_X 1 UBYTE RESERVED 2 BYTE AXIS_PTS_X 3 SWORD INDEX_INCR DIRECT FNC_VALUES 4 SBYTE COLUMN_DIR DIRECT /end RECORD_LAYOUT
/begin RECORD_LAYOUT TKF_UW_SW_SW NO_AXIS_PTS_X 1 UBYTE NO_AXIS_PTS_Y 2 UBYTE AXIS_PTS_X 3 SWORD INDEX_INCR DIRECT AXIS_PTS_Y 4 UWORD INDEX_INCR DIRECT FNC_VALUES 5 SWORD COLUMN_DIR DIRECT /end RECORD_LAYOUT
/end MODULE
/end PROJECT
