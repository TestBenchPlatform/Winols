ASAP2_VERSION 1 3
/begin PROJECT P389 "BMW DDE6.0 4-Zylinder V53.4 01.04.2004 CAN12H"
/begin HEADER "" VERSION "V53.4_4Z_CAN12H" PROJECT_NO P389 /end HEADER
/begin MODULE DIM ""
/begin MOD_COMMON "" BYTE_ORDER MSB_FIRST ALIGNMENT_BYTE 1 ALIGNMENT_WORD 2 ALIGNMENT_LONG 4 ALIGNMENT_FLOAT32_IEEE 4 /end MOD_COMMON
/begin CHARACTERISTIC PCV_iCnvPress_CUR "#SSD Kennlinie zur Umrechnung von Raildruck in elektrischen Strom" CURVE 0xE7F16 Kl_Xs16_Ws16 5000.000 Curr 0.00 5000.000 FORMAT "%8.3" EXTENDED_LIMITS -32768.00 32767.00
 /begin AXIS_DESCR STD_AXIS Rail_pPCVSet Pres_Rail 10 0.00 2000.000 FORMAT "%5.3" EXTENDED_LIMITS -3276.800 3276.700 DEPOSIT ABSOLUTE /end AXIS_DESCR
/end CHARACTERISTIC
/begin CHARACTERISTIC PCV_iSetMin_C "#SSD Sollstrom bei elektrischer Abschaltung des Druckregelventils" VALUE 0xE7F40 Kw_Ws16 65535.00 Curr -32768.00 32767.00 FORMAT "%8.2" /end CHARACTERISTIC
/begin CHARACTERISTIC PCV_iSet_Vector "#SSD Bypass-Label für PCV_iSet (Nicht verstellen!)" VALUE 0xC3138 Kw_Wu8 255.0 OneToOne 0.00 255.0 FORMAT "%5.1" /end CHARACTERISTIC
/begin CHARACTERISTIC PCV_iSet_Channel "#SSD Bypass-Label für PCV_iSet, nicht editieren!" VALUE 0xC3139 Kw_Wu8 255.0 OneToOne 0.00 255.0 FORMAT "%5.1" /end CHARACTERISTIC
/begin CHARACTERISTIC PFltCD_uSRCMinPPre_C "Spannungsrohwert SRC-Min des Abgasdrucks vor dem Partikelfilter" VALUE 0xE9A74 Kw_Ws16 5200.391 Volt 0.00 5200.391 FORMAT "%8.3" EXTENDED_LIMITS -160156.4 160151.5 /end CHARACTERISTIC
/begin CHARACTERISTIC PFltCD_uSRCMaxPPre_C "Spannungsrohwert SRC-Max des Abgasdrucks vor dem Partikelfilter" VALUE 0xE9A76 Kw_Ws16 5200.391 Volt 0.00 5200.391 FORMAT "%8.3" EXTENDED_LIMITS -160156.4 160151.5 /end CHARACTERISTIC
/begin CHARACTERISTIC PFltCD_pLinPre_CUR "Linearisierungskennlinie des Abgasdrucks vor dem Partikelfilter" CURVE 0xE9A78 Kl_Xs16_Ws16 50000.00 Pres 0.00 50000.00 FORMAT "%9.2" EXTENDED_LIMITS -32768.00 32767.00
 /begin AXIS_DESCR STD_AXIS PFltCD_uRawPresPre_mp Volt 8 0.00 5200.391 FORMAT "%8.3" EXTENDED_LIMITS -160156.4 160151.5 DEPOSIT ABSOLUTE /end AXIS_DESCR
/end CHARACTERISTIC
/begin CHARACTERISTIC PFltCD_uSRCMinTempPre_C "Spannungsrohwert SRC-Min der Abgastemperatur vor dem Partikelfilter" VALUE 0xE9AB8 Kw_Ws16 5200.391 Volt 0.00 5200.391 FORMAT "%8.3" EXTENDED_LIMITS -160156.4 160151.5 /end CHARACTERISTIC
/begin CHARACTERISTIC PFltCD_uSRCMaxTempPre_C "Spannungsrohwert SRC-Max der Abgastemperatur vor dem Partikelfilter" VALUE 0xE9ABA Kw_Ws16 5200.391 Volt 0.00 5200.391 FORMAT "%8.3" EXTENDED_LIMITS -160156.4 160151.5 /end CHARACTERISTIC
/begin CHARACTERISTIC PFltCD_tLinPre_CUR "Linearisierungskennlinie der Abgastemperatur vor dem Partikelfilter" CURVE 0xE9ABC Kl_Xs16_Ws16 950.0000 Temp_Cels -50.14000 899.8600 FORMAT "%8.4" EXTENDED_LIMITS -3549.940 3003.560
 /begin AXIS_DESCR STD_AXIS PFltCD_uRawTempPre Volt 16 0.00 5200.391 FORMAT "%8.3" EXTENDED_LIMITS -160156.4 160151.5 DEPOSIT ABSOLUTE /end AXIS_DESCR
/end CHARACTERISTIC
/begin CHARACTERISTIC PFltCD_DebSRCHighDefTPre_C "Fehlerentprellzeit SRC-High-Fehler für die Abgastemperatur vor dem Partikelfilter" VALUE 0xE9AFE Kw_Wu16 655350.0 Time_ms 0.00 655350.0 FORMAT "%8.1" /end CHARACTERISTIC
/begin CHARACTERISTIC PFltCD_DebSRCHighOkTPre_C "Heilungsentprellzeit SRC-High für die Abgastemperatur vor dem Partikelfilter" VALUE 0xE9B00 Kw_Wu16 655350.0 Time_ms 0.00 655350.0 FORMAT "%8.1" /end CHARACTERISTIC
/begin CHARACTERISTIC PFltCD_DebSRCHiDefPPre_C "Entprellzeit: obere SRC Grenze überschritten" VALUE 0xE9A9A Kw_Wu16 655350.0 Time_ms 0.00 655350.0 FORMAT "%8.1" /end CHARACTERISTIC
/begin CHARACTERISTIC PFltCD_DebSRCHiOkPPre_C "Entprellzeit: obere Grenzwertverletzung geheilt" VALUE 0xE9A9C Kw_Wu16 655350.0 Time_ms 0.00 655350.0 FORMAT "%8.1" /end CHARACTERISTIC
/begin CHARACTERISTIC PFltCD_DebSRCLoDefPPre_C "Entprellzeit: untere SRC Grenze überschritten" VALUE 0xE9A9E Kw_Wu16 655350.0 Time_ms 0.00 655350.0 FORMAT "%8.1" /end CHARACTERISTIC
/begin CHARACTERISTIC PFltCD_DebSRCLoOkPPre_C "Entprellzeit: untere Grenzwertverletzung geheilt" VALUE 0xE9AA0 Kw_Wu16 655350.0 Time_ms 0.00 655350.0 FORMAT "%8.1" /end CHARACTERISTIC
/begin CHARACTERISTIC PFltCD_DebSRCLowDefTPre_C "Fehlerentprellzeit SRC-Low-Fehler für die Abgastemperatur vor dem Partikelfilter" VALUE 0xE9B02 Kw_Wu16 655350.0 Time_ms 0.00 655350.0 FORMAT "%8.1" /end CHARACTERISTIC
/begin CHARACTERISTIC PFltCD_DebSRCLowOkTPre_C "Heilungsentprellzeit SRC-Low für die Abgastemperatur vor dem Partikelfilter" VALUE 0xE9B04 Kw_Wu16 655350.0 Time_ms 0.00 655350.0 FORMAT "%8.1" /end CHARACTERISTIC
/begin CHARACTERISTIC PFltCD_dtRmpSlpUpPPre_C "Rampensteigung bei Heilung/Vorgabewert für Absolutdrucksensor vor dem Partikelfilter" VALUE 0xE9AA4 Kw_Wu32 65535999.9847 RmpPres 0.00 65535999.9847 FORMAT "%14.4" /end CHARACTERISTIC
/begin CHARACTERISTIC PFltCD_dtRmpSlpDwnPPre_C "Rampensteigung bei Heilung/Vorgabewert für Abolutdrucksensor vor dem Partikelfilter" VALUE 0xE9AA8 Kw_Wu32 65535999.9847 RmpPres 0.00 65535999.9847 FORMAT "%14.4" /end CHARACTERISTIC
/begin CHARACTERISTIC PFltCD_dtRmpSlpUpPre_C "Aufw.-Schritt für Rampe der Abgastemperatur vor dem Partikelfilter" VALUE 0xE9B08 Kw_Wu32 6553599.99847 RmpTemp 0.00 6553599.99847 FORMAT "%13.5" /end CHARACTERISTIC
/begin CHARACTERISTIC PFltCD_dtRmpSlpDwnPre_C "Abw.-Schritt für Rampe der Abgastemperatur vor dem Partikelfilter" VALUE 0xE9B0C Kw_Wu32 6553599.99847 RmpTemp 0.00 6553599.99847 FORMAT "%13.5" /end CHARACTERISTIC
/begin CHARACTERISTIC PFLTCD_numAdc2_C "#SSD application parameter for Exhaust Temperature sensor 1" VALUE 0xE9AAC Kw_Wu8 24.0000000000 NumPinAdc 0.00 24.0000000000 FORMAT "%13.10" /end CHARACTERISTIC
/begin CHARACTERISTIC PFLTCD_numAdc_C "#SSD application parameter for Exhaust Temperature Sensor 1" VALUE 0xE9B10 Kw_Wu8 24.0000000000 NumPinAdc 0.00 24.0000000000 FORMAT "%13.10" /end CHARACTERISTIC
/begin CHARACTERISTIC PFltCD_tiPPrePT1_C "Zeitkonstante des PT1 Filters" VALUE 0xE9AB0 Kw_Wu32 4294.9673 TimeDelay_s 0.0000010000000 4294.9673 FORMAT "%9.4" /end CHARACTERISTIC
/begin CHARACTERISTIC PFltCD_stSensIDWordPPre_C "Geberkennwort für Abgasdruck vor dem Partikelfilter" VALUE 0xE9AB4 Kw_Wu16 65535.00 OneToOne 0.00 65535.00 FORMAT "%8.2" /end CHARACTERISTIC
/begin CHARACTERISTIC PFltCD_pDflPre_C "Vorgabewert für Absolutdruck vor dem Partikelfilter" VALUE 0xE9AB6 Kw_Ws16 50000.00 Pres 0.00 50000.00 FORMAT "%9.2" EXTENDED_LIMITS -32768.00 32767.00 /end CHARACTERISTIC
/begin CHARACTERISTIC PFltCD_stSensIDWordTPre_C "Geberkennwort für Abgastemperatur vor dem Partikelfilter" VALUE 0xE9B12 Kw_Wu16 65535.00 OneToOne 0.00 65535.00 FORMAT "%8.2" /end CHARACTERISTIC
/begin CHARACTERISTIC PFltCD_tDflPre_C "Vorgabewert für die Abgastemperatur vor dem Partikelfilter" VALUE 0xE9B14 Kw_Ws16 950.0000 Temp_Cels -50.14000 899.8600 FORMAT "%8.4" EXTENDED_LIMITS -3549.940 3003.560 /end CHARACTERISTIC
/begin CHARACTERISTIC PFlt_aVehFltAshCorMax_C "maximal zulässiger Wert Fahrzeugbeschleunigung" VALUE 0xE7FC8 Kw_Ws16 10.00000 Acc 0.00 10.00000 FORMAT "%8.5" EXTENDED_LIMITS -32.76800 32.76700 /end CHARACTERISTIC
/begin CHARACTERISTIC PFlt_aVehFltAshCorMin_C "minimal zulässiger Wert Fahrzeugbeschleunigung" VALUE 0xE7FCA Kw_Ws16 20.00000 Acc -10.00000 10.00000 FORMAT "%8.5" EXTENDED_LIMITS -32.76800 32.76700 /end CHARACTERISTIC
/begin CHARACTERISTIC PFlt_t1DT1Pres_C "Totzeit für Druckdifferenz DT1 filter" VALUE 0xE8A94 Kw_Wu32 4294.9673 TimeDelay_s 0.0000010000000 4294.9673 FORMAT "%9.4" /end CHARACTERISTIC
/begin CHARACTERISTIC PFlt_kdDT1Pres_C "kd für Druckdifferenz DT1 Filter" VALUE 0xE8A98 Kw_Ws32 32767.9999847 Kd 0.00 32767.9999847 FORMAT "%13.7" EXTENDED_LIMITS -32768.0000000 32767.9999847 /end CHARACTERISTIC
/begin CHARACTERISTIC PFlt_t1DT1Sim_C "Totzeit für q_inj DT1 Filter" VALUE 0xE8A9C Kw_Wu32 4294.9673 TimeDelay_s 0.0000010000000 4294.9673 FORMAT "%9.4" /end CHARACTERISTIC
/begin CHARACTERISTIC PFlt_kdDT1Sim_C "kd für q_inj DT1 Filter" VALUE 0xE8AA0 Kw_Ws32 32767.9999847 Kd 0.00 32767.9999847 FORMAT "%13.7" EXTENDED_LIMITS -32768.0000000 32767.9999847 /end CHARACTERISTIC
/begin CHARACTERISTIC PFlt_cpExhGs_C "Spezifische Wärmekapazität des Abgases" VALUE 0xE9754 Kw_Wu16 2000.000 Thr_Cpty_ExhGs 0.00 2000.000 FORMAT "%8.3" EXTENDED_LIMITS 0.00 655350.0 /end CHARACTERISTIC
/begin CHARACTERISTIC PFlt_CPFlt_C "Wärmekapazität des Partikelfilters" VALUE 0xE9756 Kw_Wu16 32900.00 Thr_Cpty 100.0000 33000.00 FORMAT "%8.2" EXTENDED_LIMITS 0.00 65535.00 /end CHARACTERISTIC
/begin CHARACTERISTIC PFlt_ctAshCorRgnMax_C "Counteranzahl für Maximumzähler der AshCor Regeneration" VALUE 0xE7FCC Kw_Wu16 65535.00 OneToOne 0.00 65535.00 FORMAT "%8.2" /end CHARACTERISTIC
/begin CHARACTERISTIC PFlt_ctAshCorRgn_C "Counterzahl für gültige AshCor Regeneration" VALUE 0xE7FCE Kw_Wu16 65535.00 OneToOne 0.00 65535.00 FORMAT "%8.2" /end CHARACTERISTIC
/begin CHARACTERISTIC PFlt_ctEngPrtRgn_C "Schwelle für Maschinenschutz-Regenerationszählimpuls" VALUE 0xE9594 Kw_Wu16 65535.00 OneToOne 0.00 65535.00 FORMAT "%8.2" /end CHARACTERISTIC
/begin CHARACTERISTIC PFlt_ddvolHsLnPlausNeg_C "Negativer Schwellwert Volumenstromänderung zur Dynamikplausibilisierung" VALUE 0xE94F8 Kw_Ws16 1500.000 CubMtrPerHrPerSec -1500.000 0.00 FORMAT "%8.3" EXTENDED_LIMITS -3276.800 3276.700 /end CHARACTERISTIC
/begin CHARACTERISTIC PFlt_ddvolHsLnPlausPos_C "Positiver Schwellwert Volumenstromänderung zur Dynamikplausibilisierung" VALUE 0xE94FA Kw_Ws16 1500.000 CubMtrPerHrPerSec 0.00 1500.000 FORMAT "%8.3" EXTENDED_LIMITS -3276.800 3276.700 /end CHARACTERISTIC
/begin CHARACTERISTIC PFlt_ddvolHsLnSot_C "Schwellwert Volumenstromänderung zur Schlauchleitungsüberwachung" VALUE 0xE94FC Kw_Ws16 3000.000 CubMtrPerHrPerSec -1500.000 1500.000 FORMAT "%8.3" EXTENDED_LIMITS -3276.800 3276.700 /end CHARACTERISTIC
/begin CHARACTERISTIC PFlt_DebAPSPlausDefHigh_C "Defektentprellzeit der APS-Plaus positiven Abweichung (MAX) bei projektspezifischen Druck-Plausibilitätsprüfungen" VALUE 0xE9596 Kw_Wu16 1000.000 Time_ms 0.00 1000.000 FORMAT "%8.3" EXTENDED_LIMITS 0.00 655350.0 /end CHARACTERISTIC
/begin CHARACTERISTIC PFlt_DebAPSPlausDefLow_C "Defektentprellzeit der APS-Plaus negativen Abweichung (MIN) bei projektspezifischen Druck-Plausibilitätsprüfungen" VALUE 0xE9598 Kw_Wu16 1000.000 Time_ms 0.00 1000.000 FORMAT "%8.3" EXTENDED_LIMITS 0.00 655350.0 /end CHARACTERISTIC
/begin CHARACTERISTIC PFlt_DebBPSPlausDefHigh_C "Defektentprellzeit der BPS-Plaus positiven Abweichung (MAX) bei projektspezifischen Druck-Plausibilitätsprüfungen" VALUE 0xE959A Kw_Wu16 1000.000 Time_ms 0.00 1000.000 FORMAT "%8.3" EXTENDED_LIMITS 0.00 655350.0 /end CHARACTERISTIC
/begin CHARACTERISTIC PFlt_DebBPSPlausDefLow_C "Defektentprellzeit der BPS-Plaus negativen Abweichung (MIN) bei projektspezifischen Druck-Plausibilitätsprüfungen" VALUE 0xE959C Kw_Wu16 1000.000 Time_ms 0.00 1000.000 FORMAT "%8.3" EXTENDED_LIMITS 0.00 655350.0 /end CHARACTERISTIC
/begin CHARACTERISTIC PFlt_DebPresPlausDefHigh_C "Defektentprellzeit der Pre-PFlt-Pres-Plaus positiven Abweichung (MAX) bei projektspezifischen Druck-Plausibilitätsprüfungen" VALUE 0xE959E Kw_Wu16 1000.000 Time_ms 0.00 1000.000 FORMAT "%8.3" EXTENDED_LIMITS 0.00 655350.0 /end CHARACTERISTIC
/begin CHARACTERISTIC PFlt_DebPresPlausDefLow_C "Defektentprellzeit der Pre-PFlt-Pres-Plaus negativen Abweichung (MIN) bei projektspezifischen Druck-Plausibilitätsprüfungen" VALUE 0xE95A0 Kw_Wu16 1000.000 Time_ms 0.00 1000.000 FORMAT "%8.3" EXTENDED_LIMITS 0.00 655350.0 /end CHARACTERISTIC
/begin CHARACTERISTIC PFlt_DebRstDfpEngPrtRgnMon_C "" VALUE 0xE95A2 Kw_Wu16 655.3500 Time_s 0.00 655.3500 FORMAT "%8.4" /end CHARACTERISTIC
/begin CHARACTERISTIC PFlt_dmNOxEngBas_MAP "Emissionskennfeld NOx-Massenstrom" MAP 0xE8AA4 Kf_Xs16_Ys16_Ws16 100.0000 dmSoot_mg_p_s 0.00 100.0000 FORMAT "%8.4" EXTENDED_LIMITS -327.6800 327.6700
 /begin AXIS_DESCR STD_AXIS Eng_nAvrg EngN 8 40.00000 6000.000 FORMAT "%8.3" EXTENDED_LIMITS -32768.00 32767.00 DEPOSIT ABSOLUTE /end AXIS_DESCR
 /begin AXIS_DESCR STD_AXIS InjCtl_qSetUnBal InjMassCyc 8 0.00 327.6700 FORMAT "%8.4" EXTENDED_LIMITS -327.6800 327.6700 DEPOSIT ABSOLUTE /end AXIS_DESCR
/end CHARACTERISTIC
/begin CHARACTERISTIC PFlt_dmSotSimBas_MAP "statische Partikelemission f(q,n)" MAP 0xE8B48 Kf_Xs16_Ys16_Ws16 100.0000 dmSoot_mg_p_s 0.00 100.0000 FORMAT "%8.4" EXTENDED_LIMITS -327.6800 327.6700
 /begin AXIS_DESCR STD_AXIS Eng_nAvrg EngN 9 40.00000 6000.000 FORMAT "%8.3" EXTENDED_LIMITS -32768.00 32767.00 DEPOSIT ABSOLUTE /end AXIS_DESCR
 /begin AXIS_DESCR STD_AXIS InjCtl_qSetUnBal InjMassCyc 8 0.00 327.6700 FORMAT "%8.4" EXTENDED_LIMITS -327.6800 327.6700 DEPOSIT ABSOLUTE /end AXIS_DESCR
/end CHARACTERISTIC
/begin CHARACTERISTIC PFlt_dmSotSimDyn_CUR "dynamischer Anteil der Partikelemission = f(dq/dt)" CURVE 0xE8BFE Kl_Xs16_Ws16 100.0000 dmSoot_mg_p_s 0.00 100.0000 FORMAT "%8.4" EXTENDED_LIMITS -327.6800 327.6700
 /begin AXIS_DESCR STD_AXIS PFlt_dqSetUnBal_mp InjMass 8 -327.6800 327.6700 FORMAT "%8.4" DEPOSIT ABSOLUTE /end AXIS_DESCR
/end CHARACTERISTIC
/begin CHARACTERISTIC PFlt_dmSotSimEGRoff_MAP "Emissionsgrundkennfeld Partikelmassenstrom stationär bei abgeschalteter Abgasrückführung" MAP 0xE8C20 Kf_Xs16_Ys16_Ws16 100.0000 dmSoot_mg_p_s 0.00 100.0000 FORMAT "%8.4" EXTENDED_LIMITS -327.6800 327.6700
 /begin AXIS_DESCR STD_AXIS Eng_nAvrg EngN 8 40.00000 6000.000 FORMAT "%8.3" EXTENDED_LIMITS -32768.00 32767.00 DEPOSIT ABSOLUTE /end AXIS_DESCR
 /begin AXIS_DESCR STD_AXIS InjCtl_qSetUnBal InjMassCyc 8 0.00 327.6700 FORMAT "%8.4" EXTENDED_LIMITS -327.6800 327.6700 DEPOSIT ABSOLUTE /end AXIS_DESCR
/end CHARACTERISTIC
/begin CHARACTERISTIC PFlt_dmSotSimRgnBas_CUR "Basiswert für regenerierte Partikelmasse = f(m_Soot)" CURVE 0xE8CC4 Kl_Xs16_Ws16 100.0000 dmSoot_mg_p_s 0.00 100.0000 FORMAT "%8.4" EXTENDED_LIMITS -327.6800 327.6700
 /begin AXIS_DESCR STD_AXIS PFlt_mSotSim mSoot_g 8 0.00 300.0000 FORMAT "%8.4" EXTENDED_LIMITS -327.6800 327.6700 DEPOSIT ABSOLUTE /end AXIS_DESCR
/end CHARACTERISTIC
/begin CHARACTERISTIC PFlt_dpDiffMax_C "Schwelle für Druckdifferenzänderung über der auf Simulation geschaltet wird" VALUE 0xE8CE6 Kw_Ws16 65535.00 Pres_hPa -32768.00 32767.00 FORMAT "%8.2" /end CHARACTERISTIC
/begin CHARACTERISTIC PFlt_dvolCharMonMin_C "Mindestvolumenstrom für Überwachung des Strömungswiderstandes" VALUE 0xE94FE Kw_Ws16 100.0000 CubMtrPerHr 0.00 100.0000 FORMAT "%8.4" EXTENDED_LIMITS -3276.800 3276.700 /end CHARACTERISTIC
/begin CHARACTERISTIC PFlt_dvolMeasMin_C "Schwelle für Abgasstrom unter der auf Simulation geschaltet wird" VALUE 0xE8CE8 Kw_Ws16 3000.000 CubMtrPerHr 0.00 3000.000 FORMAT "%8.3" EXTENDED_LIMITS -3276.800 3276.700 /end CHARACTERISTIC
/begin CHARACTERISTIC PFlt_dvolRstDfpEngPrtMon_C "" VALUE 0xE95A4 Kw_Ws16 3000.000 CubMtrPerHr 0.00 3000.000 FORMAT "%8.3" EXTENDED_LIMITS -3276.800 3276.700 /end CHARACTERISTIC
/begin CHARACTERISTIC PFlt_dvol_Vector "#SSD Konfigurationslabel für Bypass" VALUE 0xC313E Kw_Wu8 255.0 OneToOne 0.00 255.0 FORMAT "%5.1" /end CHARACTERISTIC
/begin CHARACTERISTIC PFlt_dvol_Channel "#SSD Konfigurationslabels für Bypass" VALUE 0xC313F Kw_Wu8 255.0 OneToOne 0.00 255.0 FORMAT "%5.1" /end CHARACTERISTIC
/begin CHARACTERISTIC PFlt_facAshCorOld_C "Faktor für den alten Aschekorrekturwert" VALUE 0xE7FD0 Kw_Ws16 65535.00 OneToOne -32768.00 32767.00 FORMAT "%8.2" /end CHARACTERISTIC
/begin CHARACTERISTIC PFlt_facAshOil_C "Faktor für Aschenöl" VALUE 0xE7FD2 Kw_Ws16 65535.00 OneToOne -32768.00 32767.00 FORMAT "%8.2" /end CHARACTERISTIC
/begin CHARACTERISTIC PFlt_facBlwBy_C "Thermischer Austauschfaktor für Abgas im Filter" VALUE 0xE9758 Kw_Ws16 1.000000 Fact 0.00 1.000000 FORMAT "%8.6" EXTENDED_LIMITS -4.000000 3.999878 /end CHARACTERISTIC
/begin CHARACTERISTIC PFlt_facCnvCat_CUR "Faktor Temperaturabhängigkeit der Konvertierung von NO zu NO2 des Oxidationskatalysators" CURVE 0xE8CEA Kl_Xs16_Ws16 1.000000 Fact 0.00 1.000000 FORMAT "%8.6" EXTENDED_LIMITS -4.000000 3.999878
 /begin AXIS_DESCR STD_AXIS PFlt_tOxiPre Temp_Cels 8 -50.1400 899.8600 FORMAT "%8.4" EXTENDED_LIMITS -3549.940 3003.560 DEPOSIT ABSOLUTE /end AXIS_DESCR
/end CHARACTERISTIC
/begin CHARACTERISTIC PFlt_facDpn_MAP "Kennfeld für Bestimmung der Wärmeverlustfaktor nach Abgastemperatursensor" MAP 0xE975A Kf_Xs16_Ys16_Ws16 1.000000 Fact 0.00 1.000000 FORMAT "%8.6" EXTENDED_LIMITS -4.000000 3.999878
 /begin AXIS_DESCR STD_AXIS IATSCD_tAir Temp_Cels 8 -50.14000 199.8600 FORMAT "%8.4" EXTENDED_LIMITS -3549.940 3003.560 DEPOSIT ABSOLUTE /end AXIS_DESCR
 /begin AXIS_DESCR STD_AXIS VSSCD_v Vel 8 0.00 300.0000 FORMAT "%8.4" EXTENDED_LIMITS -327.6800 327.6700 DEPOSIT ABSOLUTE /end AXIS_DESCR
/end CHARACTERISTIC
/begin CHARACTERISTIC PFlt_facDynVisc_CUR "Kennlinie zur Berücksichtigung der dynamischen Viskosität" CURVE 0xE8D0C Kl_Xs16_Ws16 1.000000 Fact 0.00 1.000000 FORMAT "%8.6" EXTENDED_LIMITS -4.000000 3.999878
 /begin AXIS_DESCR STD_AXIS PFlt_tSurf Temp_Cels 8 -50.1400 899.8600 FORMAT "%8.4" EXTENDED_LIMITS -3549.940 3003.560 DEPOSIT ABSOLUTE /end AXIS_DESCR
/end CHARACTERISTIC
/begin CHARACTERISTIC PFlt_facEGR_CUR "Influence of temperature on regenerated AirCtl correction mass" CURVE 0xE8D2E Kl_Xs16_Ws16 1.000000 Fact 0.00 1.000000 FORMAT "%8.6" EXTENDED_LIMITS -4.000000 3.999878
 /begin AXIS_DESCR STD_AXIS PFlt_facDesCor_mp Fact 8 0.00 10.00000 FORMAT "%8.5" EXTENDED_LIMITS -4.000000 3.999878 DEPOSIT ABSOLUTE /end AXIS_DESCR
/end CHARACTERISTIC
/begin CHARACTERISTIC PFlt_facFlTotCor_C "Gesamtmenge Kraftstoffkorrekturfaktor" VALUE 0xE7FD4 Kw_Ws16 1.000000 Fact 0.00 1.000000 FORMAT "%8.6" EXTENDED_LIMITS -4.000000 3.999878 /end CHARACTERISTIC
/begin CHARACTERISTIC PFlt_facHtTransNoLin_CUR "Nichtlinearitätsfaktor in der Wärmeübertragung im Filter" CURVE 0xE97FE Kl_Xs16_Ws16 1.000000 Fact 0.00 1.000000 FORMAT "%8.6" EXTENDED_LIMITS -4.000000 3.999878
 /begin AXIS_DESCR STD_AXIS PFlt_tDiffCorr_mp TempDiff_Cels 8 500.0000 1000.000 FORMAT "%8.3" EXTENDED_LIMITS -3276.800 3276.700 DEPOSIT ABSOLUTE /end AXIS_DESCR
/end CHARACTERISTIC
/begin CHARACTERISTIC PFlt_faclAshCor_C "Aschenkorrekturfaktor." VALUE 0xE7FD6 Kw_Wu16 65535.00 OneToOne 0.00 65535.00 FORMAT "%8.2" /end CHARACTERISTIC
/begin CHARACTERISTIC PFlt_facMflO2SimRgn_CUR "Kennlinie für den Einfluß des Oxygenmassenstromes auf Regeneration" CURVE 0xE8D50 Kl_Xs16_Ws16 1.000000 Fact 0.00 1.000000 FORMAT "%8.6" EXTENDED_LIMITS -4.000000 3.999878
 /begin AXIS_DESCR STD_AXIS PFlt_dmO2Aprx AirMassPerTime 8 0.00 3276.700 FORMAT "%8.3" EXTENDED_LIMITS -3276.800 3276.700 DEPOSIT ABSOLUTE /end AXIS_DESCR
/end CHARACTERISTIC
/begin CHARACTERISTIC PFlt_facMltCor_CUR "Kennlinie zur Berücksichtigung der Additivaschenkorrektur" CURVE 0xE8D72 Kl_Xs16_Ws16 1.000000 Fact 0.00 1.000000 FORMAT "%8.6" EXTENDED_LIMITS -4.000000 3.999878
 /begin AXIS_DESCR STD_AXIS PFlt_mAsh_mp mSoot_g 8 0.00 300.0000 FORMAT "%8.4" EXTENDED_LIMITS -327.6800 327.6700 DEPOSIT ABSOLUTE /end AXIS_DESCR
/end CHARACTERISTIC
/begin CHARACTERISTIC PFlt_facNO2dVol_CUR "Influence of temperature to regenerated PFlt_dVol" CURVE 0xE8D94 Kl_Xs16_Ws16 1.000000 Fact 0.00 1.000000 FORMAT "%8.6" EXTENDED_LIMITS -4.000000 3.999878
 /begin AXIS_DESCR STD_AXIS PFlt_dvol CubMtrPerHr 8 0.00 3000.000 FORMAT "%8.3" EXTENDED_LIMITS -3276.800 3276.700 DEPOSIT ABSOLUTE /end AXIS_DESCR
/end CHARACTERISTIC
/begin CHARACTERISTIC PFlt_facNO2Sot_C "stöchiometrisches NO2/Ruß-Verhältnis" VALUE 0xE8DB6 Kw_Ws16 20.00000 Fact1 0.00 20.00000 FORMAT "%8.5" EXTENDED_LIMITS -256.0000 255.9922 /end CHARACTERISTIC
/begin CHARACTERISTIC PFlt_facSotSimRgnCRT_CUR "Faktor für Beladungsabhängigkeit CRT-Effekt" CURVE 0xE8DB8 Kl_Xs16_Ws16 1.000000 Fact 0.00 1.000000 FORMAT "%8.6" EXTENDED_LIMITS -4.000000 3.999878
 /begin AXIS_DESCR STD_AXIS PFlt_mSotSim mSoot_g 8 0.00 300.0000 FORMAT "%8.4" EXTENDED_LIMITS -327.6800 327.6700 DEPOSIT ABSOLUTE /end AXIS_DESCR
/end CHARACTERISTIC
/begin CHARACTERISTIC PFlt_facTempCRT_CUR "Faktor für Temperaturabhängigkeit CRT-Effekt" CURVE 0xE8DDA Kl_Xs16_Ws16 1.000000 Fact 0.00 1.000000 FORMAT "%8.6" EXTENDED_LIMITS -4.000000 3.999878
 /begin AXIS_DESCR STD_AXIS PFlt_tSurf Temp_Cels 8 -50.1400 899.8600 FORMAT "%8.4" EXTENDED_LIMITS -3549.940 3003.560 DEPOSIT ABSOLUTE /end AXIS_DESCR
/end CHARACTERISTIC
/begin CHARACTERISTIC PFlt_facTempSimRgn_CUR "Einfluß der Temperatur auf regenerierte Partikelmasse" CURVE 0xE8DFC Kl_Xs16_Ws16 1.000000 Fact 0.00 1.000000 FORMAT "%8.6" EXTENDED_LIMITS -4.000000 3.999878
 /begin AXIS_DESCR STD_AXIS PFlt_tSurf Temp_Cels 8 -50.140 899.860 FORMAT "%8.3" EXTENDED_LIMITS -3549.940 3003.560 DEPOSIT ABSOLUTE /end AXIS_DESCR
/end CHARACTERISTIC
/begin CHARACTERISTIC PFlt_KdDT1TempCor_C "Sprunghöhe des DT1-Filters der Wärmeübergangssim. im Filter" VALUE 0xE9820 Kw_Ws32 100.000000000 Kd -50.0000000000 50.0000000000 FORMAT "%13.10" EXTENDED_LIMITS -32768.0000000 32767.9999847 /end CHARACTERISTIC
/begin CHARACTERISTIC PFlt_kiITempMod_C "Verstärkungsfaktor Integrator Temperaturmodell" VALUE 0xE9824 Kw_Ws32 999999.999767 Ki -500000.000000 499999.999767 FORMAT "%13.6" /end CHARACTERISTIC
/begin CHARACTERISTIC PFlt_lAshCorMax_C "Maximaler Kilometerstand" VALUE 0xE7FD8 Kw_Ws16 32767.00 LengthKm 0.00 32767.00 FORMAT "%8.2" EXTENDED_LIMITS -32768.00 32767.00 /end CHARACTERISTIC
/begin CHARACTERISTIC PFlt_lAshCorNextDef_C "Lesen des Wertes aus dem Eeprom nicht erfolgreich; diesen Wert verwenden" VALUE 0xE7FDC Kw_Wu32 4294967295.00 LengthKm 0.00 4294967295.00 FORMAT "%13.2" /end CHARACTERISTIC
/begin CHARACTERISTIC PFlt_lAshCorNplAbsRel_C "Kilometerzahl, welche bei erkanntem relativen und absoluten Fehler addiert wird" VALUE 0xE7FE0 Kw_Ws16 32767.00 LengthKm 0.00 32767.00 FORMAT "%8.2" EXTENDED_LIMITS -32768.00 32767.00 /end CHARACTERISTIC
/begin CHARACTERISTIC PFlt_lAshCorNplAbs_C "plausibler Wert für den absoluten Kilometerstand" VALUE 0xE7FE2 Kw_Ws16 32767.00 LengthKm 0.00 32767.00 FORMAT "%8.2" EXTENDED_LIMITS -32768.00 32767.00 /end CHARACTERISTIC
/begin CHARACTERISTIC PFlt_lAshCorNplRel_C "plausibler Wert für den relativen Kilometerstand" VALUE 0xE7FE4 Kw_Ws16 32767.00 LengthKm 0.00 32767.00 FORMAT "%8.2" EXTENDED_LIMITS -32768.00 32767.00 /end CHARACTERISTIC
/begin CHARACTERISTIC PFlt_lAshCorRegIntr_C "Regenerationsunterbrechung Kilometerstand" VALUE 0xE7FE6 Kw_Ws16 32767.00 LengthKm 0.00 32767.00 FORMAT "%8.2" EXTENDED_LIMITS -32768.00 32767.00 /end CHARACTERISTIC
/begin CHARACTERISTIC PFlt_lMinSnceRgn_C "Minimaler Abstand seit letzter Regeneration." VALUE 0xE7FE8 Kw_Wu32 2147483647.00 Length 0.00 2147483647.00 FORMAT "%13.2" EXTENDED_LIMITS 0.00 4294967295.00 /end CHARACTERISTIC
/begin CHARACTERISTIC PFlt_lRstDfpEngPrtMon_C "" VALUE 0xE95A8 Kw_Wu32 4294967295.00 Length 0.00 4294967295.00 FORMAT "%13.2" /end CHARACTERISTIC
/begin CHARACTERISTIC PFlt_lSumMaxDef_C "gefahrene Strecke Schwelle für Regeneration im Fehlerfall" VALUE 0xE80F0 Kw_Wu32 4294967295.00 Length 0.00 4294967295.00 FORMAT "%13.2" /end CHARACTERISTIC
/begin CHARACTERISTIC PFlt_lSumMax_C "gefahrene Strecke Schwelle für Regeneration" VALUE 0xE80F4 Kw_Wu32 4294967295.00 Length 0.00 4294967295.00 FORMAT "%13.2" /end CHARACTERISTIC
/begin CHARACTERISTIC PFlt_lSumSubs_C "Ersatzwert für gefahrene Strecke im Fall eines Eeprom lese Fehlers" VALUE 0xE80F8 Kw_Wu32 4294967295.00 Length 0.00 4294967295.00 FORMAT "%13.2" /end CHARACTERISTIC
/begin CHARACTERISTIC PFlt_mAshAdi_CUR "Kennlinie zur Umrechnung des Additivvolumens in Additivaschenmasse" CURVE 0xE8E1E Kl_Xs16_Ws16 300.0000 mSoot_g 0.00 300.0000 FORMAT "%8.4" EXTENDED_LIMITS -327.6800 327.6700
 /begin AXIS_DESCR STD_AXIS PFlt_volAddTot_mp volAdd_ml2 6 0.00 3277.000 FORMAT "%8.3" EXTENDED_LIMITS -32768.00 32767.00 DEPOSIT ABSOLUTE /end AXIS_DESCR
/end CHARACTERISTIC
/begin CHARACTERISTIC PFlt_mAshCor_MAP "Map für Ascheabweichung vom Sollwert" MAP 0xE7FEC Kf_Xs16_Ys16_Ws16 400.0000 mSoot_g -100.0000 300.0000 FORMAT "%8.4" EXTENDED_LIMITS -327.6800 327.6700
 /begin AXIS_DESCR STD_AXIS PFlt_dVolFltAshCor_mp CubMtrPerHr 8 0.00 3000.000 FORMAT "%8.3" EXTENDED_LIMITS -3276.800 3276.700 DEPOSIT ABSOLUTE /end AXIS_DESCR
 /begin AXIS_DESCR STD_AXIS PFlt_resFlowFltAshCor_mp Res_hPaHrPerCM 8 0.00 25.00000 FORMAT "%8.5" EXTENDED_LIMITS -32.76800 32.76700 DEPOSIT ABSOLUTE /end AXIS_DESCR
/end CHARACTERISTIC
/begin CHARACTERISTIC PFlt_mAshOil_CUR "Kennlinie zur Umrechnung des verbrauchten Kraftstoffes in Ölaschenmasse" CURVE 0xE8E38 Kl_Xs16_Ws16 300.0000 mSoot_g 0.00 300.0000 FORMAT "%8.4" EXTENDED_LIMITS -327.6800 327.6700
 /begin AXIS_DESCR STD_AXIS PFlt_qFlTot Fl_2 6 0.00 330.0000 FORMAT "%8.4" EXTENDED_LIMITS -327680.0 327670.0 DEPOSIT ABSOLUTE /end AXIS_DESCR
/end CHARACTERISTIC
/begin CHARACTERISTIC PFlt_mAshTolcAbs_C "" VALUE 0xE8090 Kw_Ws16 300.0000 mSoot_g 0.00 300.0000 FORMAT "%8.4" EXTENDED_LIMITS -327.6800 327.6700 /end CHARACTERISTIC
/begin CHARACTERISTIC PFlt_mAshTolcMaxAbs_C "maximal erlaubte absolute Abweichung des neu berechneten Aschewertes" VALUE 0xE8092 Kw_Ws16 300.0000 mSoot_g 0.00 300.0000 FORMAT "%8.4" EXTENDED_LIMITS -327.6800 327.6700 /end CHARACTERISTIC
/begin CHARACTERISTIC PFlt_mAshTolcMaxRel_C "maximal erlaubte relative Abweichung der neu berechneten Aschemenge" VALUE 0xE8094 Kw_Ws16 300.0000 mSoot_g 0.00 300.0000 FORMAT "%8.4" EXTENDED_LIMITS -327.6800 327.6700 /end CHARACTERISTIC
/begin CHARACTERISTIC PFlt_mDiagAFSMax_C "obere Grenze des gemittelten Wertes der Luftmasse pro Zylinder" VALUE 0xE8460 Kw_Ws16 3200.000 AirMassPerCyl 0.00 3200.000 FORMAT "%8.3" EXTENDED_LIMITS -3276.800 3276.700 /end CHARACTERISTIC
/begin CHARACTERISTIC PFlt_mDiagAFSMin_C "untere Grenze des gemittelten Wertes der Luftmasse pro Zylinder" VALUE 0xE8462 Kw_Ws16 3200.000 AirMassPerCyl 0.00 3200.000 FORMAT "%8.3" EXTENDED_LIMITS -3276.800 3276.700 /end CHARACTERISTIC
/begin CHARACTERISTIC PFlt_mDiagSotMax_C "obere Grenze der Partikelmasse im Partikelfilter" VALUE 0xE8464 Kw_Ws16 300.0000 mSoot_g 0.00 300.0000 FORMAT "%8.4" EXTENDED_LIMITS -327.6800 327.6700 /end CHARACTERISTIC
/begin CHARACTERISTIC PFlt_mDiagSotMin_C "untere Grenze der Partikelmasse im Partikelfilter" VALUE 0xE8466 Kw_Ws16 300.0000 mSoot_g 0.00 300.0000 FORMAT "%8.4" EXTENDED_LIMITS -327.6800 327.6700 /end CHARACTERISTIC
/begin CHARACTERISTIC PFlt_mLoIdlSotSimMax_C "maximaler Wert des simulierten Rußes, über den Druck-Plausibilitätsprüfungen im niedrigen Leerlaufzustand verhindert werden" VALUE 0xE95AC Kw_Ws16 300.0000 mSoot_g 0.00 300.0000 FORMAT "%8.4" EXTENDED_LIMITS -327.6800 327.6700 /end CHARACTERISTIC
/begin CHARACTERISTIC PFlt_mSotAdjMax_C "Maximum value of the particle mass which can be set via diagnosis" VALUE 0xE8E52 Kw_Ws16 300.0000 mSoot_g 0.00 300.0000 FORMAT "%8.4" EXTENDED_LIMITS -327.6800 327.6700 /end CHARACTERISTIC
/begin CHARACTERISTIC PFlt_mSotDiff_C "Threshold value for difference between simulated and measured value of soot mass" VALUE 0xE95AE Kw_Ws16 300.0000 mSoot_g 0.00 300.0000 FORMAT "%8.4" EXTENDED_LIMITS -327.6800 327.6700 /end CHARACTERISTIC
/begin CHARACTERISTIC PFlt_mSotMeas_CUR "Umrechnung Strömungswiderstand Partikelmasse" CURVE 0xE80FC Kl_Xs16_Ws16 300.0000 mSoot_g 0.00 300.0000 FORMAT "%8.4" EXTENDED_LIMITS -327.6800 327.6700
 /begin AXIS_DESCR STD_AXIS PFlt_resFlowOfs Res_hPaHrPerCM 8 0.00 25.00000 FORMAT "%8.5" EXTENDED_LIMITS -32.76800 32.76700 DEPOSIT ABSOLUTE /end AXIS_DESCR
/end CHARACTERISTIC
/begin CHARACTERISTIC PFlt_mSotMeas_MAP "Umrechnung Strömungswiderstand Partikelmasse" MAP 0xE8E54 Kf_Xs16_Ys16_Ws16 300.0000 mSoot_g 0.00 300.0000 FORMAT "%8.4" EXTENDED_LIMITS -327.6800 327.6700
 /begin AXIS_DESCR STD_AXIS PFlt_resFlowFlt Res_hPaHrPerCM 16 0.00 25.00000 FORMAT "%8.5" EXTENDED_LIMITS -32.76800 32.76700 DEPOSIT ABSOLUTE /end AXIS_DESCR
 /begin AXIS_DESCR STD_AXIS PFlt_dvolMassFlt_mp CubMtrPerHr 16 0.00 3000.000 FORMAT "%8.3" EXTENDED_LIMITS -3276.800 3276.700 DEPOSIT ABSOLUTE /end AXIS_DESCR
/end CHARACTERISTIC
/begin CHARACTERISTIC PFlt_mSotNewRng1_C "Schwelle Regeneriert -> Regenerationsstate 1" VALUE 0xE811E Kw_Ws16 300.0000 mSoot_g 0.00 300.0000 FORMAT "%8.4" EXTENDED_LIMITS -327.6800 327.6700 /end CHARACTERISTIC
/begin CHARACTERISTIC PFlt_mSotRng1New_C "Schwelle Regenerationsstate 1 -> regeneriert" VALUE 0xE8120 Kw_Ws16 300.0000 mSoot_g 0.00 300.0000 FORMAT "%8.4" EXTENDED_LIMITS -327.6800 327.6700 /end CHARACTERISTIC
/begin CHARACTERISTIC PFlt_mSotRng1Rng2_C "Schwelle Regenerationsstate 1 -> Regenerationsstate 2" VALUE 0xE8122 Kw_Ws16 300.0000 mSoot_g 0.00 300.0000 FORMAT "%8.4" EXTENDED_LIMITS -327.6800 327.6700 /end CHARACTERISTIC
/begin CHARACTERISTIC PFlt_mSotRng2Rng1_C "Schwelle Regenerationsstate 2 -> Regenerationsstate 1" VALUE 0xE8124 Kw_Ws16 300.0000 mSoot_g 0.00 300.0000 FORMAT "%8.4" EXTENDED_LIMITS -327.6800 327.6700 /end CHARACTERISTIC
/begin CHARACTERISTIC PFlt_mSotRng2Rng3_C "Schwelle Regenerationstate 2 -> 3" VALUE 0xE8126 Kw_Ws16 300.0000 mSoot_g 0.00 300.0000 FORMAT "%8.4" EXTENDED_LIMITS -327.6800 327.6700 /end CHARACTERISTIC
/begin CHARACTERISTIC PFlt_mSotRng3Rng2_C "Schwelle Regenerationsstate 3 -> 2" VALUE 0xE8128 Kw_Ws16 300.0000 mSoot_g 0.00 300.0000 FORMAT "%8.4" EXTENDED_LIMITS -327.6800 327.6700 /end CHARACTERISTIC
/begin CHARACTERISTIC PFlt_mSotRng3Rng4_C "Schwelle Regeneratiosstate 3 -> 4" VALUE 0xE812A Kw_Ws16 300.0000 mSoot_g 0.00 300.0000 FORMAT "%8.4" EXTENDED_LIMITS -327.6800 327.6700 /end CHARACTERISTIC
/begin CHARACTERISTIC PFlt_mSotRng4Rng3_C "Schwelle Regenerationsstate 4 -> 3" VALUE 0xE812C Kw_Ws16 300.0000 mSoot_g 0.00 300.0000 FORMAT "%8.4" EXTENDED_LIMITS -327.6800 327.6700 /end CHARACTERISTIC
/begin CHARACTERISTIC PFlt_mSotRng4Rng5_C "Schwelle Regenerationsstate 4 -> 5" VALUE 0xE812E Kw_Ws16 300.0000 mSoot_g 0.00 300.0000 FORMAT "%8.4" EXTENDED_LIMITS -327.6800 327.6700 /end CHARACTERISTIC
/begin CHARACTERISTIC PFlt_mSotRng5Rng4_C "Schwelle Regeneratiosstate 5 -> 4" VALUE 0xE8130 Kw_Ws16 300.0000 mSoot_g 0.00 300.0000 FORMAT "%8.4" EXTENDED_LIMITS -327.6800 327.6700 /end CHARACTERISTIC
/begin CHARACTERISTIC PFlt_mSotSimMax_C "Maximum value for a simulated particle mass" VALUE 0xE9098 Kw_Ws16 300.0000 mSoot_g 0.00 300.0000 FORMAT "%8.4" EXTENDED_LIMITS -327.6800 327.6700 /end CHARACTERISTIC
/begin CHARACTERISTIC PFlt_mSotSubs_C "Ersatzwert für Partikelmasse im Fall von Eeprom lese Fehler" VALUE 0xE909A Kw_Ws16 300.0000 mSoot_g 0.00 300.0000 FORMAT "%8.4" EXTENDED_LIMITS -327.6800 327.6700 /end CHARACTERISTIC
/begin CHARACTERISTIC PFlt_mSot_Vector "Konfigurationslabel für Bypass" VALUE 0xC3140 Kw_Wu8 255.0 OneToOne 0.00 255.0 FORMAT "%5.1" /end CHARACTERISTIC
/begin CHARACTERISTIC PFlt_mSot_Channel "Konfigurationslabels für Bypass" VALUE 0xC3141 Kw_Wu8 255.0 OneToOne 0.00 255.0 FORMAT "%5.1" /end CHARACTERISTIC
/begin CHARACTERISTIC PFlt_nAvrgFltAshCorMax_C "maximal zulässiger Wert Drehzahl" VALUE 0xE8096 Kw_Ws16 6000.000 EngN 0.00 6000.000 FORMAT "%8.3" EXTENDED_LIMITS -32768.00 32767.00 /end CHARACTERISTIC
/begin CHARACTERISTIC PFlt_nAvrgFltAshCorMin_C "minimal zulässiger Wert Drehzahl" VALUE 0xE8098 Kw_Ws16 6000.000 EngN 0.00 6000.000 FORMAT "%8.3" EXTENDED_LIMITS -32768.00 32767.00 /end CHARACTERISTIC
/begin CHARACTERISTIC PFlt_nAvrgMinMax_CA "Matrix zur Bestimmung der Bereichsgrenzen für die gefilterte mittlere Drehzahl" MAP 0xE855C Kf_Xs16_Ys16_Ws16 5960.000 EngN 40.00000 6000.000 FORMAT "%8.3" EXTENDED_LIMITS -32768.00 32767.00
 /begin AXIS_DESCR STD_AXIS PFlt_RngIdx_X_mp OneToOne 11 0.00 10.00 FORMAT "%5.2" EXTENDED_LIMITS 0.00 255.0 DEPOSIT ABSOLUTE /end AXIS_DESCR
 /begin AXIS_DESCR STD_AXIS PFlt_RngIdx_Y_mp OneToOne 2 0.00 1.000 FORMAT "%5.3" EXTENDED_LIMITS 0.00 255.0 DEPOSIT ABSOLUTE /end AXIS_DESCR
/end CHARACTERISTIC
/begin CHARACTERISTIC PFlt_nDiagLowIdle1_C "Leerlaufdrehzahl im Regenerationszustand" VALUE 0xE8468 Kw_Ws16 5000.000 EngN 0.00 5000.000 FORMAT "%8.3" EXTENDED_LIMITS -32768.00 32767.00 /end CHARACTERISTIC
/begin CHARACTERISTIC PFlt_nDiagLowIdle2_C "Leerlaufdrehzahl in der Abkühlphase" VALUE 0xE846A Kw_Ws16 5000.000 EngN 0.00 5000.000 FORMAT "%8.3" EXTENDED_LIMITS -32768.00 32767.00 /end CHARACTERISTIC
/begin CHARACTERISTIC PFlt_nDiagLowIdle_C "Leerlaufdrehzahl im Heizzustand" VALUE 0xE846C Kw_Ws16 5000.000 EngN 0.00 5000.000 FORMAT "%8.3" EXTENDED_LIMITS -32768.00 32767.00 /end CHARACTERISTIC
/begin CHARACTERISTIC PFlt_nDiagMax_C "obere Motordrehzahlgrenze" VALUE 0xE846E Kw_Ws16 5000.000 EngN 0.00 5000.000 FORMAT "%8.3" EXTENDED_LIMITS -32768.00 32767.00 /end CHARACTERISTIC
/begin CHARACTERISTIC PFlt_nDiagMin_C "untere Motordrehzahlgrenze" VALUE 0xE8470 Kw_Ws16 5000.000 EngN 0.00 5000.000 FORMAT "%8.3" EXTENDED_LIMITS -32768.00 32767.00 /end CHARACTERISTIC
/begin CHARACTERISTIC PFlt_nDiagRgnMax_C "obere Motordrehzahlgrenze" VALUE 0xE8472 Kw_Ws16 5000.000 EngN 0.00 5000.000 FORMAT "%8.3" EXTENDED_LIMITS -32768.00 32767.00 /end CHARACTERISTIC
/begin CHARACTERISTIC PFlt_nDiagRgnMin_C "untere Motordrehzahlgrenze" VALUE 0xE8474 Kw_Ws16 5000.000 EngN 0.00 5000.000 FORMAT "%8.3" EXTENDED_LIMITS -32768.00 32767.00 /end CHARACTERISTIC
/begin CHARACTERISTIC PFlt_nLoIdlMax_C "obere Grenze des Drehzahlfensters, um Druck-Plausibilitätsprüfungen im niedrigen Leerlaufzustand zu ermöglichen" VALUE 0xE95B0 Kw_Ws16 5000.000 EngN 0.00 5000.000 FORMAT "%8.3" EXTENDED_LIMITS -32768.00 32767.00 /end CHARACTERISTIC
/begin CHARACTERISTIC PFlt_nLoIdlMin_C "untere Grenze des Drehzahlfensters, um Druck-Plausibilitätsprüfungen im niedrigen Leerlaufzustand zu ermöglichen" VALUE 0xE95B2 Kw_Ws16 5000.000 EngN 0.00 5000.000 FORMAT "%8.3" EXTENDED_LIMITS -32768.00 32767.00 /end CHARACTERISTIC
/begin CHARACTERISTIC PFlt_nMin_C "minimale Drehzahl, um Druck-Plausibilitätsprüfungen bei Kl15-EIN und nach dem Aufwachungszustand zu deaktivieren" VALUE 0xE95B4 Kw_Ws16 5000.000 EngN 0.00 5000.000 FORMAT "%8.3" EXTENDED_LIMITS -32768.00 32767.00 /end CHARACTERISTIC
/begin CHARACTERISTIC PFlt_nStrtMax_C "obere Grenze des Drehzahlfensters, um Druck-Plausibilitätsprüfungen im Startzustand zu ermöglichen" VALUE 0xE95B6 Kw_Ws16 5000.000 EngN 0.00 5000.000 FORMAT "%8.3" EXTENDED_LIMITS -32768.00 32767.00 /end CHARACTERISTIC
/begin CHARACTERISTIC PFlt_nStrtMin_C "untere Grenze des Drehzahlfensters, um Druck-Plausibilitätsprüfungen im Startzustand zu ermöglichen" VALUE 0xE95B8 Kw_Ws16 5000.000 EngN 0.00 5000.000 FORMAT "%8.3" EXTENDED_LIMITS -32768.00 32767.00 /end CHARACTERISTIC
/begin CHARACTERISTIC PFlt_nTempChkTrg_C "Drehzahlschwelle zur Triggerung Zeitfenster Temperaturplausibilisierung" VALUE 0xE9500 Kw_Ws16 1500.000 EngN 500.0000 2000.000 FORMAT "%8.3" EXTENDED_LIMITS -32768.00 32767.00 /end CHARACTERISTIC
/begin CHARACTERISTIC PFlt_numAshCorMsk_C "Maske für gültige AshCor Regeneration, Eingang ist der Status PFlt_stEngPOp" VALUE 0xE809A Kw_Wu16 65535.00 OneToOne 0.00 65535.00 FORMAT "%8.2" /end CHARACTERISTIC
/begin CHARACTERISTIC PFlt_numAshCor_C "AshCor-Schalterwert" VALUE 0xE809C Kw_Wu8 11.00 OneToOne 0.00 11.00 FORMAT "%5.2" EXTENDED_LIMITS 0.00 255.0 /end CHARACTERISTIC
/begin CHARACTERISTIC PFlt_numCntBck_C "Backstep value of the counter for IATSCD minimum search" VALUE 0xE9502 Kw_Wu16 65535.00 OneToOne 0.00 65535.00 FORMAT "%8.2" /end CHARACTERISTIC
/begin CHARACTERISTIC PFlt_numCntMax_C "Maximum counter value for IATSCD minimum search" VALUE 0xE9504 Kw_Wu16 65535.00 OneToOne 0.00 65535.00 FORMAT "%8.2" /end CHARACTERISTIC
/begin CHARACTERISTIC PFlt_numEngPOpDel_CA "verzögert wirksame Matrix zur Berücksichtigung des Motorbetriebszustandes bei der Regeneration" MAP 0xE8132 Kf_Xu8_Yu8_Wu8 6.000 OneToOne 0.00 6.000 FORMAT "%5.3" EXTENDED_LIMITS 0.00 255.0
 /begin AXIS_DESCR STD_AXIS PFlt_stEngPOp OneToOne 12 0.00 11.00 FORMAT "%5.2" EXTENDED_LIMITS 0.00 255.0 DEPOSIT ABSOLUTE /end AXIS_DESCR
 /begin AXIS_DESCR STD_AXIS PFlt_numRgn_mp OneToOne 9 0.00 8.000 FORMAT "%5.3" EXTENDED_LIMITS 0.00 255.0 DEPOSIT ABSOLUTE /end AXIS_DESCR
/end CHARACTERISTIC
/begin CHARACTERISTIC PFlt_numEngPOp_CA "Partikelfilterstatus vs. Motorstatus Matrix" MAP 0xE81B5 Kf_Xu8_Yu8_Wu8 6.000 OneToOne 0.00 6.000 FORMAT "%5.3" EXTENDED_LIMITS 0.00 255.0
 /begin AXIS_DESCR STD_AXIS PFlt_stEngPOp OneToOne 12 0.00 11.00 FORMAT "%5.2" EXTENDED_LIMITS 0.00 255.0 DEPOSIT ABSOLUTE /end AXIS_DESCR
 /begin AXIS_DESCR STD_AXIS PFlt_numRgn_mp OneToOne 9 0.00 8.000 FORMAT "%5.3" EXTENDED_LIMITS 0.00 255.0 DEPOSIT ABSOLUTE /end AXIS_DESCR
/end CHARACTERISTIC
/begin CHARACTERISTIC PFlt_numEngPrtActvMsk_C "Engine protection activation mask based on regeneration action" VALUE 0xE95BA Kw_Wu8 255.0 OneToOne 0.00 255.0 FORMAT "%5.1" /end CHARACTERISTIC
/begin CHARACTERISTIC PFlt_numLst_C "Regenerationsanforderung aufgrund von gefahrener Strecke, Betriebszeit oder Verbrauch" VALUE 0xE8238 Kw_Wu8 255.0 OneToOne 0.00 255.0 FORMAT "%5.1" /end CHARACTERISTIC
/begin CHARACTERISTIC PFlt_numLSU_C "Array - Index für die Lambdasensor Konfiguration" VALUE 0xE8A8E Kw_Wu8 16.00 OneToOne 0.00 16.00 FORMAT "%5.2" EXTENDED_LIMITS 0.00 255.0 /end CHARACTERISTIC
/begin CHARACTERISTIC PFlt_numPFltErrRgnIntr_C "" VALUE 0xE809D Kw_Wu8 8.000 OneToOne 0.00 8.000 FORMAT "%5.3" EXTENDED_LIMITS 0.00 255.0 /end CHARACTERISTIC
/begin CHARACTERISTIC PFlt_numPFltErr_C "Constant for CSF Limp - Home" VALUE 0xE809E Kw_Wu8 8.000 OneToOne 0.00 8.000 FORMAT "%5.3" EXTENDED_LIMITS 0.00 255.0 /end CHARACTERISTIC
/begin CHARACTERISTIC PFlt_numPFltMon_C "Zeiger für Motortemperaturfeld" VALUE 0xE9506 Kw_Wu8 2.00000000000 EngTempFldSel 0.00 2.00000000000 FORMAT "%13.11" /end CHARACTERISTIC
/begin CHARACTERISTIC PFlt_numPOpAir_C "Zeiger auf das Motortemperaturfeld" VALUE 0xE85A6 Kw_Wu8 2.00000000000 IndSysTempFldSel 0.00 2.00000000000 FORMAT "%13.11" /end CHARACTERISTIC
/begin CHARACTERISTIC PFlt_numPOpClnt_C "Zeiger auf das Temperaturfeld des Ansaugsystems" VALUE 0xE85A7 Kw_Wu8 2.00000000000 EngTempFldSel 0.00 2.00000000000 FORMAT "%13.11" /end CHARACTERISTIC
/begin CHARACTERISTIC PFlt_numPrioRgnStg1_C "Priorität für Regenerationstate 1" VALUE 0xE823A Kw_Wu16 65535.00 OneToOne 0.00 65535.00 FORMAT "%8.2" /end CHARACTERISTIC
/begin CHARACTERISTIC PFlt_numPrioRgnStg2_C "Priorität für Regenerationstate 2" VALUE 0xE823C Kw_Wu16 65535.00 OneToOne 0.00 65535.00 FORMAT "%8.2" /end CHARACTERISTIC
/begin CHARACTERISTIC PFlt_numPrioRgnStg3_C "Priorität für Regenerationstate 3" VALUE 0xE823E Kw_Wu16 65535.00 OneToOne 0.00 65535.00 FORMAT "%8.2" /end CHARACTERISTIC
/begin CHARACTERISTIC PFlt_numPrioRgnStg4_C "Priorität für Regenerationstate 4" VALUE 0xE8240 Kw_Wu16 65535.00 OneToOne 0.00 65535.00 FORMAT "%8.2" /end CHARACTERISTIC
/begin CHARACTERISTIC PFlt_numPrioRgnStg5_C "Priorität für Regenerationstate 5" VALUE 0xE8242 Kw_Wu16 65535.00 OneToOne 0.00 65535.00 FORMAT "%8.2" /end CHARACTERISTIC
/begin CHARACTERISTIC PFlt_numPrioRgnStg6_C "Prioritätszahl für Regenerationsstufe 6" VALUE 0xE8244 Kw_Wu16 65535.00 OneToOne 0.00 65535.00 FORMAT "%8.2" /end CHARACTERISTIC
/begin CHARACTERISTIC PFlt_numPrioRgnStgDiag_C "Regeneration priority of requested state when PFlt tester demand is active" VALUE 0xE8246 Kw_Wu16 65535.00 OneToOne 0.00 65535.00 FORMAT "%8.2" /end CHARACTERISTIC
/begin CHARACTERISTIC PFlt_numPrt_C "Regenerationsanforderung aufgrund v. Motorschutz" VALUE 0xE8248 Kw_Wu8 255.0 OneToOne 0.00 255.0 FORMAT "%5.1" /end CHARACTERISTIC
/begin CHARACTERISTIC PFlt_numRgnSuc_C "größte Regenerationsanforderungszahl ab der eine erfolgreiche Regeneration detektiert wird" VALUE 0xE8249 Kw_Wu8 100.0 OneToOne 0.00 100.0 FORMAT "%5.1" EXTENDED_LIMITS 0.00 255.0 /end CHARACTERISTIC
/begin CHARACTERISTIC PFlt_numTimeStpPlausSens_C "Anzahl Zeitschritte für numerische Differentiation der Sensorsignale" VALUE 0xE9507 Kw_Wu8 9.000 OneToOne 1.000 10.00 FORMAT "%5.2" EXTENDED_LIMITS 0.00 255.0 /end CHARACTERISTIC
/begin CHARACTERISTIC PFlt_pAPSDiag_C "Atmosphärendruckgrenze" VALUE 0xE8476 Kw_Ws16 3850.000 Pres_hPa -350.0000 3500.000 FORMAT "%8.3" EXTENDED_LIMITS -32768.00 32767.00 /end CHARACTERISTIC
/begin CHARACTERISTIC PFlt_pAPSNegDvt_C "Begrenzung der APS unter welchem der MIN-Fehler bei Druck-Plausibilitätsprüfungen auf APS-Plaus gesetzt wird" VALUE 0xE95BC Kw_Ws16 5000.000 Pres_hPa 0.00 5000.000 FORMAT "%8.3" EXTENDED_LIMITS -32768.00 32767.00 /end CHARACTERISTIC
/begin CHARACTERISTIC PFlt_pAPSPosDvt_C "Begrenzung der APS über welchem der MAX-Fehler bei Druck-Plausibilitätsprüfungen auf APS-Plaus gesetzt wird" VALUE 0xE95BE Kw_Ws16 5000.000 Pres_hPa 0.00 5000.000 FORMAT "%8.3" EXTENDED_LIMITS -32768.00 32767.00 /end CHARACTERISTIC
/begin CHARACTERISTIC PFlt_pBPAndAPTolcMax_C "Toleranzband für Ladedrucksensor und Atmosphärendrucksensor" VALUE 0xE9508 Kw_Wu16 65535.00 Pres_hPa 0.00 65535.00 FORMAT "%8.2" /end CHARACTERISTIC
/begin CHARACTERISTIC PFlt_pBPSNegDvt_C "Begrenzung der BPS unter welchem der MIN-Fehler bei Druck-Plausibilitätsprüfungen auf APS Plaus gesetzt wird" VALUE 0xE95C0 Kw_Ws16 5000.000 Pres_hPa 0.00 5000.000 FORMAT "%8.3" EXTENDED_LIMITS -32768.00 32767.00 /end CHARACTERISTIC
/begin CHARACTERISTIC PFlt_pBPSPosDvt_C "Begrenzung der BPS über den maximalen Fehler auf BPS-Plaus bei Druck-Plausibilitätsprüfungen gestellt" VALUE 0xE95C2 Kw_Ws16 5000.000 Pres_hPa 0.00 5000.000 FORMAT "%8.3" EXTENDED_LIMITS -32768.00 32767.00 /end CHARACTERISTIC
/begin CHARACTERISTIC PFlt_pDfl_C "Vorgabewert Absolutdruck vor Partikelfilter" VALUE 0xE969C Kw_Ws16 65535.00 Pres_hPa -32768.00 32767.00 FORMAT "%8.2" /end CHARACTERISTIC
/begin CHARACTERISTIC PFlt_pDiagBPSMax_C "obere Grenze des linearisierten Wertes vom Ladedruck" VALUE 0xE8478 Kw_Ws16 3500.000 Pres_hPa 0.00 3500.000 FORMAT "%8.3" EXTENDED_LIMITS -32768.00 32767.00 /end CHARACTERISTIC
/begin CHARACTERISTIC PFlt_pDiagBPSMin_C "untere Grenze des linearisierten Wertes vom Ladedruck" VALUE 0xE847A Kw_Ws16 3500.000 Pres_hPa 0.00 3500.000 FORMAT "%8.3" EXTENDED_LIMITS -32768.00 32767.00 /end CHARACTERISTIC
/begin CHARACTERISTIC PFlt_pDiffCharMonMin_C "Mindestdifferenzdruck für Überwachung des Strömungswiderstandes" VALUE 0xE950A Kw_Ws16 4500.000 Pres_hPa -1000.000 3500.000 FORMAT "%8.3" EXTENDED_LIMITS -32768.00 32767.00 /end CHARACTERISTIC
/begin CHARACTERISTIC PFlt_pDiffDfl_MAP "Interpolating the value if the Pressure sensor is Defective" MAP 0xE969E Kf_Xs16_Ys16_Ws16 3500.000 Pres_hPa 0.00 3500.000 FORMAT "%8.3" EXTENDED_LIMITS -32768.00 32767.00
 /begin AXIS_DESCR STD_AXIS Eng_nAvrg EngN 8 40.00000 6000.000 FORMAT "%8.3" EXTENDED_LIMITS -32768.00 32767.00 DEPOSIT ABSOLUTE /end AXIS_DESCR
 /begin AXIS_DESCR STD_AXIS InjCtl_qSetUnBal InjMassCyc 8 0.00 327.6700 FORMAT "%8.4" EXTENDED_LIMITS -327.6800 327.6700 DEPOSIT ABSOLUTE /end AXIS_DESCR
/end CHARACTERISTIC
/begin CHARACTERISTIC PFlt_pDiffHsLnNeg_C "Untere Schwelle Differenzdruck zur Schlauchleitungsüberwachung" VALUE 0xE950C Kw_Ws16 3277.0000 Pres_hPa 223.0000 3500.0000 FORMAT "%8.4" EXTENDED_LIMITS -32768.00 32767.00 /end CHARACTERISTIC
/begin CHARACTERISTIC PFlt_pDiffMax1_C "" VALUE 0xE95C4 Kw_Ws16 3277.0000 Pres_hPa 223.0000 3500.0000 FORMAT "%8.4" EXTENDED_LIMITS -32768.00 32767.00 /end CHARACTERISTIC
/begin CHARACTERISTIC PFlt_pDiffMax_C "Obere Schwelle SRC Differenzdruck" VALUE 0xE950E Kw_Ws16 3277.0000 Pres_hPa 223.0000 3500.0000 FORMAT "%8.4" EXTENDED_LIMITS -32768.00 32767.00 /end CHARACTERISTIC
/begin CHARACTERISTIC PFlt_pDiffMin_C "Untere Schwelle SRC Differenzdruck" VALUE 0xE9510 Kw_Ws16 3277.0000 Pres_hPa 223.0000 3500.0000 FORMAT "%8.4" EXTENDED_LIMITS -32768.00 32767.00 /end CHARACTERISTIC
/begin CHARACTERISTIC PFlt_dpDiffUp_C "Rampensteigung bei Aufreten eines Systemfehlers" VALUE 0xE9744 Kw_Wu32 65535999.9847 RmpPres_hPa 0.00 65535999.9847 FORMAT "%13.4" /end CHARACTERISTIC
/begin CHARACTERISTIC PFlt_dpDiffDwn_C "Rampensteigung bei Wegfall des Systemfehlers" VALUE 0xE9748 Kw_Wu32 65535999.9847 RmpPres_hPa 0.00 65535999.9847 FORMAT "%13.4" /end CHARACTERISTIC
/begin CHARACTERISTIC PFlt_pDiffTolcMax_C "Toleranzband Differenzdrucksensor" VALUE 0xE9512 Kw_Ws16 3277.0000 Pres_hPa 223.0000 3500.0000 FORMAT "%8.4" EXTENDED_LIMITS -32768.00 32767.00 /end CHARACTERISTIC
/begin CHARACTERISTIC PFlt_pEngPrtMaxInit_C "Inititialisierungswert des PT1-Filters für den Maximalwert im Motorschutz" VALUE 0xE824A Kw_Ws16 32767.00 Pres_hPa 0.00 32767.00 FORMAT "%8.2" EXTENDED_LIMITS -32768.00 32767.00 /end CHARACTERISTIC
/begin CHARACTERISTIC PFlt_pEngPrtMax_MAP "Kennfeld obere Druckschwelle Motorschutz" MAP 0xE824C Kf_Xs16_Ys16_Ws16 3500.000 Pres_hPa 0.00 3500.000 FORMAT "%8.3" EXTENDED_LIMITS -32768.00 32767.00
 /begin AXIS_DESCR STD_AXIS Eng_nAvrg EngN 8 40.00000 6000.000 FORMAT "%8.3" EXTENDED_LIMITS -32768.00 32767.00 DEPOSIT ABSOLUTE /end AXIS_DESCR
 /begin AXIS_DESCR STD_AXIS InjCtl_qSetUnBal InjMassCyc 8 0.00 327.6700 FORMAT "%8.4" EXTENDED_LIMITS -327.6800 327.6700 DEPOSIT ABSOLUTE /end AXIS_DESCR
/end CHARACTERISTIC
/begin CHARACTERISTIC PFlt_pEngPrtMin_MAP "untere Druckschwelle Motorschutz" MAP 0xE82F0 Kf_Xs16_Ys16_Ws16 3500.000 Pres_hPa 0.00 3500.000 FORMAT "%8.3" EXTENDED_LIMITS -32768.00 32767.00
 /begin AXIS_DESCR STD_AXIS Eng_nAvrg EngN 8 40.00000 6000.000 FORMAT "%8.3" EXTENDED_LIMITS -32768.00 32767.00 DEPOSIT ABSOLUTE /end AXIS_DESCR
 /begin AXIS_DESCR STD_AXIS InjCtl_qSetUnBal InjMassCyc 8 0.00 327.6700 FORMAT "%8.4" EXTENDED_LIMITS -327.6800 327.6700 DEPOSIT ABSOLUTE /end AXIS_DESCR
/end CHARACTERISTIC
/begin CHARACTERISTIC PFlt_pMinNrmCldStrt_C "Mindestumgebungsdruck für normalen Kaltstart" VALUE 0xE9514 Kw_Ws16 2700.000 Pres_hPa 800.0000 3500.000 FORMAT "%8.3" EXTENDED_LIMITS -32768.00 32767.00 /end CHARACTERISTIC
/begin CHARACTERISTIC PFlt_pPreAndBPTolcMax_C "Toleranzband für Ladedrucksensor und absolut Drucksensor" VALUE 0xE9516 Kw_Ws16 65535.00 Pres_hPa -32768.00 32767.00 FORMAT "%8.2" /end CHARACTERISTIC
/begin CHARACTERISTIC PFlt_pPreAshOilCorr_MAP "von Auf PFlt_dvol und PFlt_mAshOil abhängiges Kennfeld zur Korrekturwertberechnung von PFlt_pPre" MAP 0xE95C6 Kf_Xs16_Ys16_Ws16 5000.000 Pres_hPa 0.00 5000.000 FORMAT "%8.3" EXTENDED_LIMITS -32768.00 32767.00
 /begin AXIS_DESCR STD_AXIS PFlt_dvol CubMtrPerHr 5 0.00 3000.000 FORMAT "%8.3" EXTENDED_LIMITS -3276.800 3276.700 DEPOSIT ABSOLUTE /end AXIS_DESCR
 /begin AXIS_DESCR STD_AXIS PFlt_mAshOil mSoot_g 5 0.00 300.0000 FORMAT "%8.4" EXTENDED_LIMITS -327.6800 327.6700 DEPOSIT ABSOLUTE /end AXIS_DESCR
/end CHARACTERISTIC
/begin CHARACTERISTIC PFlt_pPreCorrMax_C "" VALUE 0xE9610 Kw_Ws16 5000.000 Pres_hPa 0.00 5000.000 FORMAT "%8.3" EXTENDED_LIMITS -32768.00 32767.00 /end CHARACTERISTIC
/begin CHARACTERISTIC PFlt_pPresNegDvt_C "Begrenzung der pPreCorr  unter welchem der MIN-Fehler bei  Druck-Plausibilitätsprüfungen auf pPre Plaus gesetzt wird" VALUE 0xE9612 Kw_Ws16 5000.000 Pres_hPa 0.00 5000.000 FORMAT "%8.3" EXTENDED_LIMITS -32768.00 32767.00 /end CHARACTERISTIC
/begin CHARACTERISTIC PFlt_pPreSotSimCorr_MAP "von PFlt_dvol und PFlt_mSotSim abhängiges Kennfeld zur Korrekturwertberechnung von PFlt_pPre" MAP 0xE9614 Kf_Xs16_Ys16_Ws16 5000.000 Pres_hPa 0.00 5000.000 FORMAT "%8.3" EXTENDED_LIMITS -32768.00 32767.00
 /begin AXIS_DESCR STD_AXIS PFlt_dvol CubMtrPerHr 5 0.00 3000.000 FORMAT "%8.3" EXTENDED_LIMITS -3276.800 3276.700 DEPOSIT ABSOLUTE /end AXIS_DESCR
 /begin AXIS_DESCR STD_AXIS PFlt_mSotSim mSoot_g 5 0.00 300.0000 FORMAT "%8.4" EXTENDED_LIMITS -327.6800 327.6700 DEPOSIT ABSOLUTE /end AXIS_DESCR
/end CHARACTERISTIC
/begin CHARACTERISTIC PFlt_pPresPlausMaxDvt_C "Begrenzung für Druckunterschied  über den NPL-Fehler auf Doppeldefekt Plaus bei den Druck-Plausibilitätsprüfungen gestellt" VALUE 0xE965E Kw_Ws16 5000.000 Pres_hPa 0.00 5000.000 FORMAT "%8.3" EXTENDED_LIMITS -32768.00 32767.00 /end CHARACTERISTIC
/begin CHARACTERISTIC PFlt_pPresPlausMinDvt_C "Begrenzung der Druckdifferenz unter welchem alle Fehler bei  Druck-Plausibilitätsprüfungen gelöscht werden" VALUE 0xE9660 Kw_Ws16 5000.000 Pres_hPa 0.00 5000.000 FORMAT "%8.3" EXTENDED_LIMITS -32768.00 32767.00 /end CHARACTERISTIC
/begin CHARACTERISTIC PFlt_pPresPosDvt_C "Begrenzung der pPreCorr über den  maximalen Fehler auf pPre Plaus für Druck-Plausibilitätsprüfungen" VALUE 0xE9662 Kw_Ws16 5000.000 Pres_hPa 0.00 5000.000 FORMAT "%8.3" EXTENDED_LIMITS -32768.00 32767.00 /end CHARACTERISTIC
/begin CHARACTERISTIC PFlt_pPreTolcMax_C "Toleranzband Absolutdrucksensor" VALUE 0xE9518 Kw_Ws16 3277.0000 Pres_hPa 223.0000 3500.0000 FORMAT "%8.4" EXTENDED_LIMITS -32768.00 32767.00 /end CHARACTERISTIC
/begin CHARACTERISTIC PFlt_pPreVolCorr_CUR "von PFlt_dvol abhängige Kennlinie zur Korrekturwertberechnung von PFlt_pPre" CURVE 0xE9664 Kl_Xs16_Ws16 5000.000 Pres_hPa 0.00 5000.000 FORMAT "%8.3" EXTENDED_LIMITS -32768.00 32767.00
 /begin AXIS_DESCR STD_AXIS PFlt_dvol CubMtrPerHr 5 0.00 3000.000 FORMAT "%8.3" EXTENDED_LIMITS -3276.800 3276.700 DEPOSIT ABSOLUTE /end AXIS_DESCR
/end CHARACTERISTIC
/begin CHARACTERISTIC PFlt_qDiagPOpMax_CUR "Kennlinie zur Überprüfung der Maximalgrenze von InjCtl_qSetUnbal" CURVE 0xE847C Kl_Xs16_Ws16 327.6700 InjMassCyc 0.00 327.6700 FORMAT "%8.4" EXTENDED_LIMITS -327.6800 327.6700
 /begin AXIS_DESCR STD_AXIS Eng_nAvrg EngN 8 40.00000 6000.000 FORMAT "%8.3" EXTENDED_LIMITS -32768.00 32767.00 DEPOSIT ABSOLUTE /end AXIS_DESCR
/end CHARACTERISTIC
/begin CHARACTERISTIC PFlt_qDiagPOpMin_CUR "Kennlinie zur Überprüfung der Minimalgrenze von InjCtl_qSetUnbal" CURVE 0xE849E Kl_Xs16_Ws16 327.6700 InjMassCyc 0.00 327.6700 FORMAT "%8.4" EXTENDED_LIMITS -327.6800 327.6700
 /begin AXIS_DESCR STD_AXIS Eng_nAvrg EngN 8 40.00000 6000.000 FORMAT "%8.3" EXTENDED_LIMITS -32768.00 32767.00 DEPOSIT ABSOLUTE /end AXIS_DESCR
/end CHARACTERISTIC
/begin CHARACTERISTIC PFlt_qFlMaxDef_C "Regenerationsschwelle für Treibstoffverbrauch im Fehlerfall" VALUE 0xE8394 Kw_Ws16 320.0000 Fl_L 0.00 320.0000 FORMAT "%8.4" EXTENDED_LIMITS -327.6800 327.6700 /end CHARACTERISTIC
/begin CHARACTERISTIC PFlt_qFlMax_C "Regenerationsschwelle für Treibstoffverbrauch" VALUE 0xE8396 Kw_Ws16 320.0000 Fl_L 0.00 320.0000 FORMAT "%8.4" EXTENDED_LIMITS -327.6800 327.6700 /end CHARACTERISTIC
/begin CHARACTERISTIC PFlt_qFlSubs_C "Treibstoffverbrauch Ersatzwert für den Fall eines Eeprom lese Fehlers" VALUE 0xE8398 Kw_Ws16 320.0000 Fl_L 0.00 320.0000 FORMAT "%8.4" EXTENDED_LIMITS -327.6800 327.6700 /end CHARACTERISTIC
/begin CHARACTERISTIC PFlt_qFlTotAdjMax_C "Maximalwert des gesamten Kraftstoffverbrauchs" VALUE 0xE839C Kw_Ws32 42949672.9500 Fl_L -21474836.4800 21474836.4700 FORMAT "%13.4" /end CHARACTERISTIC
/begin CHARACTERISTIC PFlt_qFlTotMin_C "Unterere Grenze für Gesamtmenge Kraftstoffquantität" VALUE 0xE80A0 Kw_Ws16 320.0000 Fl_2 0.00 320.0000 FORMAT "%8.4" EXTENDED_LIMITS -327680.0 327670.0 /end CHARACTERISTIC
/begin CHARACTERISTIC PFlt_qSetUnBalFltAshCorMax_C "maximal zulässiger Wert aktuelle Einspritzmenge" VALUE 0xE80A2 Kw_Ws16 327.6700 InjMassCyc 0.00 327.6700 FORMAT "%8.4" EXTENDED_LIMITS -327.6800 327.6700 /end CHARACTERISTIC
/begin CHARACTERISTIC PFlt_qSetUnBalFltAshCorMin_C "minimal zulässiger Wert aktuelle Einspritzmenge" VALUE 0xE80A4 Kw_Ws16 327.6700 InjMassCyc 0.00 327.6700 FORMAT "%8.4" EXTENDED_LIMITS -327.6800 327.6700 /end CHARACTERISTIC
/begin CHARACTERISTIC PFlt_qSetUnBalRng10Max_GCUR "Maximalwert Einspritzmassensollwert Bereich 10" CURVE 0xE85A8 Gkl_Ws16 327.6700 InjMass 0.00 327.6700 FORMAT "%8.4" EXTENDED_LIMITS -327.6800 327.6700
 /begin AXIS_DESCR COM_AXIS PFlt_nAvrgFlt_mp EngN 8 40.00000 6000.000 FORMAT "%8.3" EXTENDED_LIMITS -32768.00 32767.00 AXIS_PTS_REF PFlt_qSetUnBal_AXIS /end AXIS_DESCR
/end CHARACTERISTIC
/begin CHARACTERISTIC PFlt_qSetUnBalRng10Min_GCUR "Minimalwert Einspritzmassensollwert Bereich 10" CURVE 0xE85B8 Gkl_Ws16 327.6700 InjMass 0.00 327.6700 FORMAT "%8.4" EXTENDED_LIMITS -327.6800 327.6700
 /begin AXIS_DESCR COM_AXIS PFlt_nAvrgFlt_mp EngN 8 40.00000 6000.000 FORMAT "%8.3" EXTENDED_LIMITS -32768.00 32767.00 AXIS_PTS_REF PFlt_qSetUnBal_AXIS /end AXIS_DESCR
/end CHARACTERISTIC
/begin CHARACTERISTIC PFlt_qSetUnBalRng1Max_GCUR "Maximalwert Einspritzmassensollwert Bereich 1" CURVE 0xE85C8 Gkl_Ws16 327.6700 InjMass 0.00 327.6700 FORMAT "%8.4" EXTENDED_LIMITS -327.6800 327.6700
 /begin AXIS_DESCR COM_AXIS PFlt_nAvrgFlt_mp EngN 8 40.00000 6000.000 FORMAT "%8.3" EXTENDED_LIMITS -32768.00 32767.00 AXIS_PTS_REF PFlt_qSetUnBal_AXIS /end AXIS_DESCR
/end CHARACTERISTIC
/begin CHARACTERISTIC PFlt_qSetUnBalRng1Min_GCUR "Minimalwert Einspritzmassensollwert Bereich 1" CURVE 0xE85D8 Gkl_Ws16 327.6700 InjMass 0.00 327.6700 FORMAT "%8.4" EXTENDED_LIMITS -327.6800 327.6700
 /begin AXIS_DESCR COM_AXIS PFlt_nAvrgFlt_mp EngN 8 40.00000 6000.000 FORMAT "%8.3" EXTENDED_LIMITS -32768.00 32767.00 AXIS_PTS_REF PFlt_qSetUnBal_AXIS /end AXIS_DESCR
/end CHARACTERISTIC
/begin CHARACTERISTIC PFlt_qSetUnBalRng2Max_GCUR "Maximalwert Einspritzmassensollwert Bereich 2" CURVE 0xE85E8 Gkl_Ws16 327.6700 InjMass 0.00 327.6700 FORMAT "%8.4" EXTENDED_LIMITS -327.6800 327.6700
 /begin AXIS_DESCR COM_AXIS PFlt_nAvrgFlt_mp EngN 8 40.00000 6000.000 FORMAT "%8.3" EXTENDED_LIMITS -32768.00 32767.00 AXIS_PTS_REF PFlt_qSetUnBal_AXIS /end AXIS_DESCR
/end CHARACTERISTIC
/begin CHARACTERISTIC PFlt_qSetUnBalRng2Min_GCUR "Minimalwert Einspritzmassensollwert Bereich 2" CURVE 0xE85F8 Gkl_Ws16 327.6700 InjMass 0.00 327.6700 FORMAT "%8.4" EXTENDED_LIMITS -327.6800 327.6700
 /begin AXIS_DESCR COM_AXIS PFlt_nAvrgFlt_mp EngN 8 40.00000 6000.000 FORMAT "%8.3" EXTENDED_LIMITS -32768.00 32767.00 AXIS_PTS_REF PFlt_qSetUnBal_AXIS /end AXIS_DESCR
/end CHARACTERISTIC
/begin CHARACTERISTIC PFlt_qSetUnBalRng3Max_GCUR "Maximalwert Einspritzmassensollwert Bereich 3" CURVE 0xE8608 Gkl_Ws16 327.6700 InjMass 0.00 327.6700 FORMAT "%8.4" EXTENDED_LIMITS -327.6800 327.6700
 /begin AXIS_DESCR COM_AXIS PFlt_nAvrgFlt_mp EngN 8 40.00000 6000.000 FORMAT "%8.3" EXTENDED_LIMITS -32768.00 32767.00 AXIS_PTS_REF PFlt_qSetUnBal_AXIS /end AXIS_DESCR
/end CHARACTERISTIC
/begin CHARACTERISTIC PFlt_qSetUnBalRng3Min_GCUR "Minimalwert Einspritzmassensollwert Bereich 3" CURVE 0xE8618 Gkl_Ws16 327.6700 InjMass 0.00 327.6700 FORMAT "%8.4" EXTENDED_LIMITS -327.6800 327.6700
 /begin AXIS_DESCR COM_AXIS PFlt_nAvrgFlt_mp EngN 8 40.00000 6000.000 FORMAT "%8.3" EXTENDED_LIMITS -32768.00 32767.00 AXIS_PTS_REF PFlt_qSetUnBal_AXIS /end AXIS_DESCR
/end CHARACTERISTIC
/begin CHARACTERISTIC PFlt_qSetUnBalRng4Max_GCUR "Maximalwert Einspritzmassensollwert Bereich 4" CURVE 0xE8628 Gkl_Ws16 327.6700 InjMass 0.00 327.6700 FORMAT "%8.4" EXTENDED_LIMITS -327.6800 327.6700
 /begin AXIS_DESCR COM_AXIS PFlt_nAvrgFlt_mp EngN 8 40.00000 6000.000 FORMAT "%8.3" EXTENDED_LIMITS -32768.00 32767.00 AXIS_PTS_REF PFlt_qSetUnBal_AXIS /end AXIS_DESCR
/end CHARACTERISTIC
/begin CHARACTERISTIC PFlt_qSetUnBalRng4Min_GCUR "Minimalwert Einspritzmassensollwert Bereich 4" CURVE 0xE8638 Gkl_Ws16 327.6700 InjMass 0.00 327.6700 FORMAT "%8.4" EXTENDED_LIMITS -327.6800 327.6700
 /begin AXIS_DESCR COM_AXIS PFlt_nAvrgFlt_mp EngN 8 40.00000 6000.000 FORMAT "%8.3" EXTENDED_LIMITS -32768.00 32767.00 AXIS_PTS_REF PFlt_qSetUnBal_AXIS /end AXIS_DESCR
/end CHARACTERISTIC
/begin CHARACTERISTIC PFlt_qSetUnBalRng5Max_GCUR "Maximalwert Einspritzmassensollwert Bereich 5" CURVE 0xE8648 Gkl_Ws16 327.6700 InjMass 0.00 327.6700 FORMAT "%8.4" EXTENDED_LIMITS -327.6800 327.6700
 /begin AXIS_DESCR COM_AXIS PFlt_nAvrgFlt_mp EngN 8 40.00000 6000.000 FORMAT "%8.3" EXTENDED_LIMITS -32768.00 32767.00 AXIS_PTS_REF PFlt_qSetUnBal_AXIS /end AXIS_DESCR
/end CHARACTERISTIC
/begin CHARACTERISTIC PFlt_qSetUnBalRng5Min_GCUR "Minimalwert Einspritzmassensollwert Bereich 5" CURVE 0xE8658 Gkl_Ws16 327.6700 InjMass 0.00 327.6700 FORMAT "%8.4" EXTENDED_LIMITS -327.6800 327.6700
 /begin AXIS_DESCR COM_AXIS PFlt_nAvrgFlt_mp EngN 8 40.00000 6000.000 FORMAT "%8.3" EXTENDED_LIMITS -32768.00 32767.00 AXIS_PTS_REF PFlt_qSetUnBal_AXIS /end AXIS_DESCR
/end CHARACTERISTIC
/begin CHARACTERISTIC PFlt_qSetUnBalRng6Max_GCUR "Maximalwert Einspritzmassensollwert Bereich 6" CURVE 0xE8668 Gkl_Ws16 327.6700 InjMass 0.00 327.6700 FORMAT "%8.4" EXTENDED_LIMITS -327.6800 327.6700
 /begin AXIS_DESCR COM_AXIS PFlt_nAvrgFlt_mp EngN 8 40.00000 6000.000 FORMAT "%8.3" EXTENDED_LIMITS -32768.00 32767.00 AXIS_PTS_REF PFlt_qSetUnBal_AXIS /end AXIS_DESCR
/end CHARACTERISTIC
/begin CHARACTERISTIC PFlt_qSetUnBalRng6Min_GCUR "Minimalwert Einspritzmassensollwert Bereich 6" CURVE 0xE8678 Gkl_Ws16 327.6700 InjMass 0.00 327.6700 FORMAT "%8.4" EXTENDED_LIMITS -327.6800 327.6700
 /begin AXIS_DESCR COM_AXIS PFlt_nAvrgFlt_mp EngN 8 40.00000 6000.000 FORMAT "%8.3" EXTENDED_LIMITS -32768.00 32767.00 AXIS_PTS_REF PFlt_qSetUnBal_AXIS /end AXIS_DESCR
/end CHARACTERISTIC
/begin CHARACTERISTIC PFlt_qSetUnBalRng7Max_GCUR "Maximalwert Einspritzmassensollwert Bereich 7" CURVE 0xE8688 Gkl_Ws16 327.6700 InjMass 0.00 327.6700 FORMAT "%8.4" EXTENDED_LIMITS -327.6800 327.6700
 /begin AXIS_DESCR COM_AXIS PFlt_nAvrgFlt_mp EngN 8 40.00000 6000.000 FORMAT "%8.3" EXTENDED_LIMITS -32768.00 32767.00 AXIS_PTS_REF PFlt_qSetUnBal_AXIS /end AXIS_DESCR
/end CHARACTERISTIC
/begin CHARACTERISTIC PFlt_qSetUnBalRng7Min_GCUR "Minimalwert Einspritzmassensollwert Bereich 7" CURVE 0xE8698 Gkl_Ws16 327.6700 InjMass 0.00 327.6700 FORMAT "%8.4" EXTENDED_LIMITS -327.6800 327.6700
 /begin AXIS_DESCR COM_AXIS PFlt_nAvrgFlt_mp EngN 8 40.00000 6000.000 FORMAT "%8.3" EXTENDED_LIMITS -32768.00 32767.00 AXIS_PTS_REF PFlt_qSetUnBal_AXIS /end AXIS_DESCR
/end CHARACTERISTIC
/begin CHARACTERISTIC PFlt_qSetUnBalRng8Max_GCUR "Maximalwert Einspritzmassensollwert Bereich 8" CURVE 0xE86A8 Gkl_Ws16 327.6700 InjMass 0.00 327.6700 FORMAT "%8.4" EXTENDED_LIMITS -327.6800 327.6700
 /begin AXIS_DESCR COM_AXIS PFlt_nAvrgFlt_mp EngN 8 40.00000 6000.000 FORMAT "%8.3" EXTENDED_LIMITS -32768.00 32767.00 AXIS_PTS_REF PFlt_qSetUnBal_AXIS /end AXIS_DESCR
/end CHARACTERISTIC
/begin CHARACTERISTIC PFlt_qSetUnBalRng8Min_GCUR "Minimalwert Einspritzmassensollwert Bereich 8" CURVE 0xE86B8 Gkl_Ws16 327.6700 InjMass 0.00 327.6700 FORMAT "%8.4" EXTENDED_LIMITS -327.6800 327.6700
 /begin AXIS_DESCR COM_AXIS PFlt_nAvrgFlt_mp EngN 8 40.00000 6000.000 FORMAT "%8.3" EXTENDED_LIMITS -32768.00 32767.00 AXIS_PTS_REF PFlt_qSetUnBal_AXIS /end AXIS_DESCR
/end CHARACTERISTIC
/begin CHARACTERISTIC PFlt_qSetUnBalRng9Max_GCUR "Maximalwert Einspritzmassensollwert Bereich 9" CURVE 0xE86C8 Gkl_Ws16 327.6700 InjMass 0.00 327.6700 FORMAT "%8.4" EXTENDED_LIMITS -327.6800 327.6700
 /begin AXIS_DESCR COM_AXIS PFlt_nAvrgFlt_mp EngN 8 40.00000 6000.000 FORMAT "%8.3" EXTENDED_LIMITS -32768.00 32767.00 AXIS_PTS_REF PFlt_qSetUnBal_AXIS /end AXIS_DESCR
/end CHARACTERISTIC
/begin CHARACTERISTIC PFlt_qSetUnBalRng9Min_GCUR "Minimalwert Einspritzmassensollwert Bereich 9" CURVE 0xE86D8 Gkl_Ws16 327.6700 InjMass 0.00 327.6700 FORMAT "%8.4" EXTENDED_LIMITS -327.6800 327.6700
 /begin AXIS_DESCR COM_AXIS PFlt_nAvrgFlt_mp EngN 8 40.00000 6000.000 FORMAT "%8.3" EXTENDED_LIMITS -32768.00 32767.00 AXIS_PTS_REF PFlt_qSetUnBal_AXIS /end AXIS_DESCR
/end CHARACTERISTIC
/begin CHARACTERISTIC PFlt_qSetUnBalRngSpoMax_GCUR "Maximalwert Einspritzmassensollwert Bereich Spontane Regeneration" CURVE 0xE86E8 Gkl_Ws16 327.6700 InjMass 0.00 327.6700 FORMAT "%8.4" EXTENDED_LIMITS -327.6800 327.6700
 /begin AXIS_DESCR COM_AXIS PFlt_nAvrgFlt_mp EngN 8 40.00000 6000.000 FORMAT "%8.3" EXTENDED_LIMITS -32768.00 32767.00 AXIS_PTS_REF PFlt_qSetUnBal_AXIS /end AXIS_DESCR
/end CHARACTERISTIC
/begin CHARACTERISTIC PFlt_qSetUnBalRngSpoMin_GCUR "Minimalwert Einspritzmassensollwert Bereich Spontane Regeneration" CURVE 0xE86F8 Gkl_Ws16 327.6700 InjMass 0.00 327.6700 FORMAT "%8.4" EXTENDED_LIMITS -327.6800 327.6700
 /begin AXIS_DESCR COM_AXIS PFlt_nAvrgFlt_mp EngN 8 40.00000 6000.000 FORMAT "%8.3" EXTENDED_LIMITS -32768.00 32767.00 AXIS_PTS_REF PFlt_qSetUnBal_AXIS /end AXIS_DESCR
/end CHARACTERISTIC
/begin AXIS_PTS PFlt_qSetUnBal_AXIS "Breakpoints for the group curves which calculate the unbalanced fuel quantity thresholds" 0xE8708 PFlt_nAvrgFlt_mp GSst_Xs16 5960.000 EngN 8 40.00000 6000.000 FORMAT "%8.3" EXTENDED_LIMITS -32768.00 32767.00 DEPOSIT ABSOLUTE /end AXIS_PTS
/begin CHARACTERISTIC PFlt_rAccPedMinMax_CA "Matrix zur Bestimmung der Bereichsgrenzen für das gefilterte Pedalwertgebersignal" MAP 0xE871A Kf_Xs16_Ys16_Ws16 100.0000 Prc 0.00 100.0000 FORMAT "%8.4" EXTENDED_LIMITS -400.0000 399.9878
 /begin AXIS_DESCR STD_AXIS PFlt_RngIdx_X_mp OneToOne 11 0.00 10.00 FORMAT "%5.2" EXTENDED_LIMITS 0.00 255.0 DEPOSIT ABSOLUTE /end AXIS_DESCR
 /begin AXIS_DESCR STD_AXIS PFlt_RngIdx_Y_mp OneToOne 2 0.00 1.000 FORMAT "%5.3" EXTENDED_LIMITS 0.00 255.0 DEPOSIT ABSOLUTE /end AXIS_DESCR
/end CHARACTERISTIC
/begin CHARACTERISTIC PFlt_rDiagAccPedMax_C "obere Grenze Fahrpedalstellung" VALUE 0xE84C0 Kw_Ws16 100.0000 Prc 0.00 100.0000 FORMAT "%8.4" EXTENDED_LIMITS -400.0000 399.9878 /end CHARACTERISTIC
/begin CHARACTERISTIC PFlt_rDiagTVAMax_C "obere Grenze des durch die Batteriespannung korrigierten Endstufenausgangs" VALUE 0xE84C2 Kw_Ws16 100.0000 DtyCyc 0.00 100.0000 FORMAT "%8.4" EXTENDED_LIMITS -327.6800 327.6700 /end CHARACTERISTIC
/begin CHARACTERISTIC PFlt_rDiagTVAMin_C "untere Grenze des durch die Batteriespannung korrigierten Endstufenausgangs" VALUE 0xE84C4 Kw_Ws16 100.0000 DtyCyc 0.00 100.0000 FORMAT "%8.4" EXTENDED_LIMITS -327.6800 327.6700 /end CHARACTERISTIC
/begin CHARACTERISTIC PFlt_rEGRSimMax_C "obere Grenze für Abschalterkennung ARF" VALUE 0xE909C Kw_Ws16 300.0000 Prc -100.0000 200.0000 FORMAT "%8.4" EXTENDED_LIMITS -400.0000 399.9878 /end CHARACTERISTIC
/begin CHARACTERISTIC PFlt_rEGRSimMin_C "untere Grenze für Abschalterkennung ARF" VALUE 0xE909E Kw_Ws16 300.0000 Prc -100.0000 200.0000 FORMAT "%8.4" EXTENDED_LIMITS -400.0000 399.9878 /end CHARACTERISTIC
/begin CHARACTERISTIC PFlt_rEngPrtRgnMax_C "Threshold value for ratio of task time and last regeneration time" VALUE 0xE967A Kw_Ws16 799.9878 Prc -400.0000 399.9878 FORMAT "%8.4" /end CHARACTERISTIC
/begin CHARACTERISTIC PFlt_resFlowAdiOfs_MAP "Kennfeld Strömungswiderstandoffset durch Additiv" MAP 0xE90A0 Kf_Xs16_Ys16_Ws16 25.00000 Res_hPaHrPerCM 0.00 25.00000 FORMAT "%8.5" EXTENDED_LIMITS -32.76800 32.76700
 /begin AXIS_DESCR STD_AXIS PFlt_dvol CubMtrPerHr 8 0.00 3000.000 FORMAT "%8.3" EXTENDED_LIMITS -3276.800 3276.700 DEPOSIT ABSOLUTE /end AXIS_DESCR
 /begin AXIS_DESCR STD_AXIS PFlt_mAshAdi_mp mSoot_g 8 0.00 300.0000 FORMAT "%8.4" EXTENDED_LIMITS -327.6800 327.6700 DEPOSIT ABSOLUTE /end AXIS_DESCR
/end CHARACTERISTIC
/begin CHARACTERISTIC PFlt_resFlowMax_C "Obere Schwelle SRC Strömungswiderstand" VALUE 0xE951A Kw_Ws16 25.00000 Res_hPaHrPerCM 0.00 25.00000 FORMAT "%8.5" EXTENDED_LIMITS -32.76800 32.76700 /end CHARACTERISTIC
/begin CHARACTERISTIC PFlt_resFlowMeasInv_MAP "Inverse Strömungswiderstandskennfeld" MAP 0xE9144 Kf_Xs16_Ys16_Ws16 25.00000 Res_hPaHrPerCM 0.00 25.00000 FORMAT "%8.5" EXTENDED_LIMITS -32.76800 32.76700
 /begin AXIS_DESCR STD_AXIS PFlt_mSotCrv_mp mSoot_g 16 0.00 300.0000 FORMAT "%8.4" EXTENDED_LIMITS -327.6800 327.6700 DEPOSIT ABSOLUTE /end AXIS_DESCR
 /begin AXIS_DESCR STD_AXIS PFlt_dvolMassFlt_mp CubMtrPerHr 16 0.00 3000.000 FORMAT "%8.3" EXTENDED_LIMITS -3276.800 3276.700 DEPOSIT ABSOLUTE /end AXIS_DESCR
/end CHARACTERISTIC
/begin CHARACTERISTIC PFlt_resFlowMin_C "Untere Schwelle SRC Strömungswiderstand" VALUE 0xE951C Kw_Ws16 25.00000 Res_hPaHrPerCM 0.00 25.00000 FORMAT "%8.5" EXTENDED_LIMITS -32.76800 32.76700 /end CHARACTERISTIC
/begin CHARACTERISTIC PFlt_resFlowOilOfs_MAP "Kennfeld Strömungswiderstandoffset durch Ölasche" MAP 0xE9388 Kf_Xs16_Ys16_Ws16 25.00000 Res_hPaHrPerCM 0.00 25.00000 FORMAT "%8.5" EXTENDED_LIMITS -32.76800 32.76700
 /begin AXIS_DESCR STD_AXIS PFlt_dvol CubMtrPerHr 8 0.00 3000.000 FORMAT "%8.3" EXTENDED_LIMITS -3276.800 3276.700 DEPOSIT ABSOLUTE /end AXIS_DESCR
 /begin AXIS_DESCR STD_AXIS PFlt_mAshOil mSoot_g 8 0.00 300.0000 FORMAT "%8.4" EXTENDED_LIMITS -327.6800 327.6700 DEPOSIT ABSOLUTE /end AXIS_DESCR
/end CHARACTERISTIC
/begin CHARACTERISTIC PFlt_resFlowPhysMax_C "" VALUE 0xE942C Kw_Ws16 25.00000 Res_hPaHrPerCM 0.00 25.00000 FORMAT "%8.5" EXTENDED_LIMITS -32.76800 32.76700 /end CHARACTERISTIC
/begin CHARACTERISTIC PFlt_resFlowTolcDynPlaus_C "Faktor für Festlegung Toleranzschwelle dynamische Drucküberwachung" VALUE 0xE951E Kw_Ws16 25.00000 Res_hPaHrPerCM 0.00 25.00000 FORMAT "%8.5" EXTENDED_LIMITS -32.76800 32.76700 /end CHARACTERISTIC
/begin CHARACTERISTIC PFlt_resFlow_MAP "Strömungswiderstand als Funktion von Abgasvolumsstrom und Differenzdruck" MAP 0xE942E Kf_Xs16_Ys16_Ws16 25.00000 Res_hPaHrPerCM 0.00 25.00000 FORMAT "%8.5" EXTENDED_LIMITS -32.76800 32.76700
 /begin AXIS_DESCR STD_AXIS PFlt_dvol CubMtrPerHr 8 0.00 3000.000 FORMAT "%8.3" EXTENDED_LIMITS -3276.800 3276.700 DEPOSIT ABSOLUTE /end AXIS_DESCR
 /begin AXIS_DESCR STD_AXIS PFlt_pDiff Pres_hPa 8 0.00 5000.000 FORMAT "%8.3" EXTENDED_LIMITS -32768.00 32767.00 DEPOSIT ABSOLUTE /end AXIS_DESCR
/end CHARACTERISTIC
/begin CHARACTERISTIC PFlt_resFlow_Vector "#SSD Konfigurationslabel für Bypass" VALUE 0xC3142 Kw_Wu8 255.0 OneToOne 0.00 255.0 FORMAT "%5.1" /end CHARACTERISTIC
/begin CHARACTERISTIC PFlt_resFlow_Channel "#SSD Konfigurationslabels für Bypass" VALUE 0xC3143 Kw_Wu8 255.0 OneToOne 0.00 255.0 FORMAT "%5.1" /end CHARACTERISTIC
/begin CHARACTERISTIC PFlt_rLoIdlTVAMax_C "maximaler Wert des TVACD-Tastverhältnisses, über welchem die Plausibilitätsprüfungen im niedrigen Leerlauf deaktiviert werden" VALUE 0xE967C Kw_Ws16 100.0000 DtyCyc 0.00 100.0000 FORMAT "%8.4" EXTENDED_LIMITS -327.6800 327.6700 /end CHARACTERISTIC
/begin CHARACTERISTIC PFlt_stCfgTempSens_C "Bitleiste zur Auswahl der Abgastemperatursensoren" VALUE 0xE9520 Kw_Wu8 255.0 OneToOne 0.00 255.0 FORMAT "%5.1" /end CHARACTERISTIC
/begin CHARACTERISTIC PFlt_stDiagAbortMsk_C "Abbruchsmaske" VALUE 0xE84C8 Kw_Wu32 4294967295.00 OneToOne 0.00 4294967295.00 FORMAT "%13.2" /end CHARACTERISTIC
/begin CHARACTERISTIC PFlt_stDiagMskRgnAbort_C "Abbruchsmaske für Freigabebedingungen" VALUE 0xE84CC Kw_Wu32 4294967295.00 OneToOne 0.00 4294967295.00 FORMAT "%13.2" /end CHARACTERISTIC
/begin CHARACTERISTIC PFlt_stDiagMskTst10_C "Abkühltrigger" VALUE 0xE84D0 Kw_Wu32 4294967295.00 OneToOne 0.00 4294967295.00 FORMAT "%13.2" /end CHARACTERISTIC
/begin CHARACTERISTIC PFlt_stDiagMskTst1_C "Maske zur Ermittlung der Zustandsinformation" VALUE 0xE84D4 Kw_Wu32 4294967295.00 OneToOne 0.00 4294967295.00 FORMAT "%13.2" /end CHARACTERISTIC
/begin CHARACTERISTIC PFlt_stDiagMskTst2_C "Maske zur Ermittlung der Zustandsinformation" VALUE 0xE84D8 Kw_Wu32 4294967295.00 OneToOne 0.00 4294967295.00 FORMAT "%13.2" /end CHARACTERISTIC
/begin CHARACTERISTIC PFlt_stDiagMskTst3_C "Maske zur Ermittlung der Zustandsinformation" VALUE 0xE84DC Kw_Wu32 4294967295.00 OneToOne 0.00 4294967295.00 FORMAT "%13.2" /end CHARACTERISTIC
/begin CHARACTERISTIC PFlt_stDiagMskTst4_C "Maske zur Ermittlung der Zustandsinformation" VALUE 0xE84E0 Kw_Wu32 4294967295.00 OneToOne 0.00 4294967295.00 FORMAT "%13.2" /end CHARACTERISTIC
/begin CHARACTERISTIC PFlt_stDiagMskTst5_C "Maske zur Ermittlung der Zustandsinformation" VALUE 0xE84E4 Kw_Wu32 4294967295.00 OneToOne 0.00 4294967295.00 FORMAT "%13.2" /end CHARACTERISTIC
/begin CHARACTERISTIC PFlt_stDiagMskTst6_C "Maske zur Ermittlung der Zustandsinformation" VALUE 0xE84E8 Kw_Wu32 4294967295.00 OneToOne 0.00 4294967295.00 FORMAT "%13.2" /end CHARACTERISTIC
/begin CHARACTERISTIC PFlt_stDiagMskTst7_C "Maske zur Ermittlung der Zustandsinformation" VALUE 0xE84EC Kw_Wu32 4294967295.00 OneToOne 0.00 4294967295.00 FORMAT "%13.2" /end CHARACTERISTIC
/begin CHARACTERISTIC PFlt_stDiagMskTst8_C "Maske zur Ermittlung der Zustandsinformation" VALUE 0xE84F0 Kw_Wu32 4294967295.00 OneToOne 0.00 4294967295.00 FORMAT "%13.2" /end CHARACTERISTIC
/begin CHARACTERISTIC PFlt_stDiagMskTst9_C "Maske zur Ermittlung der Zustandsinformation" VALUE 0xE84F4 Kw_Wu32 4294967295.00 OneToOne 0.00 4294967295.00 FORMAT "%13.2" /end CHARACTERISTIC
/begin CHARACTERISTIC PFlt_stDiagMsk_C "Maske für Freigabebedingungen" VALUE 0xE84F8 Kw_Wu32 4294967295.00 OneToOne 0.00 4294967295.00 FORMAT "%13.2" /end CHARACTERISTIC
/begin CHARACTERISTIC PFlt_stDiagOn_C "Applikation konstant Regeneration manuell beginnen" VALUE 0xE83A0 Kw_Wu8 255.0 OneToOne 0.00 255.0 FORMAT "%5.1" /end CHARACTERISTIC
/begin CHARACTERISTIC PFlt_stDiagRgnMsk_C "Regenerationsmaske zum Abschalten der Diagnose" VALUE 0xE84FC Kw_Wu32 4294967295.00 OneToOne 0.00 4294967295.00 FORMAT "%13.2" /end CHARACTERISTIC
/begin CHARACTERISTIC PFlt_stEngPOp_Vector "#SSD Konfigurationslabel für Bypass" VALUE 0xC313C Kw_Wu8 255.0 OneToOne 0.00 255.0 FORMAT "%5.1" /end CHARACTERISTIC
/begin CHARACTERISTIC PFlt_stEngPOp_Channel "#SSD Konfigurationslabel für Bypass" VALUE 0xC313D Kw_Wu8 255.0 OneToOne 0.00 255.0 FORMAT "%5.1" /end CHARACTERISTIC
/begin CHARACTERISTIC PFlt_stGearDebValMax_C "Maximaler Gang für Entprellfunktion" VALUE 0xE8764 Kw_Ws8 7.000 OneToOne -1.000 6.000 FORMAT "%5.3" EXTENDED_LIMITS -128.0 127.0 /end CHARACTERISTIC
/begin CHARACTERISTIC PFlt_stGearDebValMin_C "Minimaler Gang der Entprellfunktion" VALUE 0xE8765 Kw_Ws8 7.000 OneToOne -1.000 6.000 FORMAT "%5.3" EXTENDED_LIMITS -128.0 127.0 /end CHARACTERISTIC
/begin CHARACTERISTIC PFlt_stGearMinMax_CA "Matrix zur Bestimmung der Bereichsgrenzen für den eingelegten Gang" MAP 0xE8766 Kf_Xs16_Ys16_Ws16 7.000000 OneToOne -1.000000 6.000000 FORMAT "%8.6" EXTENDED_LIMITS -32768.00 32767.00
 /begin AXIS_DESCR STD_AXIS PFlt_RngIdx_X_mp OneToOne 11 0.00 10.00 FORMAT "%5.2" EXTENDED_LIMITS 0.00 255.0 DEPOSIT ABSOLUTE /end AXIS_DESCR
 /begin AXIS_DESCR STD_AXIS PFlt_RngIdx_Y_mp OneToOne 2 0.00 1.000 FORMAT "%5.3" EXTENDED_LIMITS 0.00 255.0 DEPOSIT ABSOLUTE /end AXIS_DESCR
/end CHARACTERISTIC
/begin CHARACTERISTIC PFlt_stLckFuelMsk_C "Maske Für EGT_st" VALUE 0xE83A2 Kw_Wu16 65535.00 OneToOne 0.00 65535.00 FORMAT "%8.2" /end CHARACTERISTIC
/begin CHARACTERISTIC PFlt_stLckRgnMsk_C "Maske für Blockierung und Freigabe der Regeneration" VALUE 0xE83A4 Kw_Wu32 4294967295.00 OneToOne 0.00 4294967295.00 FORMAT "%13.2" /end CHARACTERISTIC
/begin CHARACTERISTIC PFlt_stLoIdlEGTMsk_C "Abgasnachbehandlungsmaske für Druck-Plausibilitätsprüfungen im niedrigen Leerlaufzustand" VALUE 0xE9680 Kw_Wu32 2147483647.00 OneToOne 0.00 2147483647.00 FORMAT "%13.2" EXTENDED_LIMITS 0.00 4294967295.00 /end CHARACTERISTIC
/begin CHARACTERISTIC PFlt_stResFlowPT1RgnMsk_C "Mask für Bestimmung Regenerationsrelevante Zustand" VALUE 0xE94D4 Kw_Wu32 4294967295.00 OneToOne 0.00 4294967295.00 FORMAT "%13.2" /end CHARACTERISTIC
/begin CHARACTERISTIC PFlt_stRgnActvMsk_C "Maske für DPF-Regenerationszeit-relevante Abgasnachbehandlungszustände" VALUE 0xE83A8 Kw_Wu32 4294967295.00 OneToOne 0.00 4294967295.00 FORMAT "%13.2" /end CHARACTERISTIC
/begin CHARACTERISTIC PFlt_stRgnDiagStg1_C "Aufheizzustand" VALUE 0xE8500 Kw_Wu32 4294967295.00 OneToOne 0.00 4294967295.00 FORMAT "%13.2" /end CHARACTERISTIC
/begin CHARACTERISTIC PFlt_stRgnDiagStg2_C "Regenerationszustand" VALUE 0xE8504 Kw_Wu32 4294967295.00 OneToOne 0.00 4294967295.00 FORMAT "%13.2" /end CHARACTERISTIC
/begin CHARACTERISTIC PFlt_stRgnDiagStg3_C "Abkühlphase" VALUE 0xE8508 Kw_Wu32 4294967295.00 OneToOne 0.00 4294967295.00 FORMAT "%13.2" /end CHARACTERISTIC
/begin CHARACTERISTIC PFlt_stRgnMsk1_C "Masking for EGT_CmpSt function" VALUE 0xE9828 Kw_Wu32 2147483647.00 OneToOne 0.00 2147483647.00 FORMAT "%13.2" EXTENDED_LIMITS 0.00 4294967295.00 /end CHARACTERISTIC
/begin CHARACTERISTIC PFlt_stRgnMsk2_C "Masking for EGT_CmpSt function" VALUE 0xE982C Kw_Wu32 2147483647.00 OneToOne 0.00 2147483647.00 FORMAT "%13.2" EXTENDED_LIMITS 0.00 4294967295.00 /end CHARACTERISTIC
/begin CHARACTERISTIC PFlt_stRgnStg1_C "PFlt_st im Fall Regenerationsstate 1" VALUE 0xE83AC Kw_Wu32 4294967295.00 OneToOne 0.00 4294967295.00 FORMAT "%13.2" /end CHARACTERISTIC
/begin CHARACTERISTIC PFlt_stRgnStg2_C "PFlt_st im Fall Regenerationsstate 2" VALUE 0xE83B0 Kw_Wu32 4294967295.00 OneToOne 0.00 4294967295.00 FORMAT "%13.2" /end CHARACTERISTIC
/begin CHARACTERISTIC PFlt_stRgnStg3_C "PFlt_st im Fall Regenerationsstate 3" VALUE 0xE83B4 Kw_Wu32 4294967295.00 OneToOne 0.00 4294967295.00 FORMAT "%13.2" /end CHARACTERISTIC
/begin CHARACTERISTIC PFlt_stRgnStg4_C "PFlt_st im Fall Regenerationsstate 4" VALUE 0xE83B8 Kw_Wu32 4294967295.00 OneToOne 0.00 4294967295.00 FORMAT "%13.2" /end CHARACTERISTIC
/begin CHARACTERISTIC PFlt_stRgnStg5_C "PFlt_st im Fall Regenerationsstate 5" VALUE 0xE83BC Kw_Wu32 4294967295.00 OneToOne 0.00 4294967295.00 FORMAT "%13.2" /end CHARACTERISTIC
/begin CHARACTERISTIC PFlt_stRgnStg6_C "Maßnahmenbitwort Regenerationsstufe 6" VALUE 0xE83C0 Kw_Wu32 4294967295.00 OneToOne 0.00 4294967295.00 FORMAT "%13.2" /end CHARACTERISTIC
/begin CHARACTERISTIC PFlt_stSimRgnMsk_C "Maske zur Deaktivierung der Partikelmassen-Berechnung in definierten Regenerationszuständen" VALUE 0xE94D8 Kw_Wu32 4294967295.00 OneToOne 0.00 4294967295.00 FORMAT "%13.2" /end CHARACTERISTIC
/begin CHARACTERISTIC PFlt_st_Vector "#SSD Konfigurationslabel für Bypass" VALUE 0xC313A Kw_Wu8 255.0 OneToOne 0.00 255.0 FORMAT "%5.1" /end CHARACTERISTIC
/begin CHARACTERISTIC PFlt_st_Channel "#SSD Konfigurationslabels für Bypass" VALUE 0xC313B Kw_Wu8 255.0 OneToOne 0.00 255.0 FORMAT "%5.1" /end CHARACTERISTIC
/begin CHARACTERISTIC PFlt_swtAshCorActive_C "generelle Aktivierung der Ascheabgleich-Funktion (1=Funktion aktiv, 0=Inaktiev)" VALUE 0xE80A6 Kw_Wu8 1.000 OneToOne 0.00 1.000 FORMAT "%5.3" EXTENDED_LIMITS 0.00 255.0 /end CHARACTERISTIC
/begin CHARACTERISTIC PFlt_swtAshCorOn_C "Statusschwelle Aschekorrektur (1: Regneration erkannt, Ascheabgleichtimer gestrted; 0: keine Regeneration erkannt)" VALUE 0xE80A7 Kw_Wu8 4.000 OneToOne 0.00 4.000 FORMAT "%5.3" EXTENDED_LIMITS 0.00 255.0 /end CHARACTERISTIC
/begin CHARACTERISTIC PFlt_swtASModOn_C "Schalter für Luftmassenstromsignal (0: HFM oder 1: ASMod)" VALUE 0xE8A8F Kw_Wu8 1.000 OneToOne 0.00 1.000 FORMAT "%5.3" EXTENDED_LIMITS 0.00 255.0 /end CHARACTERISTIC
/begin CHARACTERISTIC PFlt_swtBrkRng_CA "Zur Bestimmung der Bereichswerte für das entprellte Bremssignal (0: normales, 1: invertiertes Signal, 2: Signal nicht verwendet)" VAL_BLK 0xE87B0 Kwb_Wu8 2.000 OneToOne 0.00 2.000 FORMAT "%5.3" EXTENDED_LIMITS 0.00 255.0 NUMBER 11 /end CHARACTERISTIC
/begin CHARACTERISTIC PFlt_swtClthRng_CA "Zur Bestimmung der Bereichswerte für das entprellte Kupplungssignal (0: normales, 1: invertiertes, 2: kein Signal verwendet)" VAL_BLK 0xE87BB Kwb_Wu8 2.000 OneToOne 0.00 2.000 FORMAT "%5.3" EXTENDED_LIMITS 0.00 255.0 NUMBER 11 /end CHARACTERISTIC
/begin CHARACTERISTIC PFlt_swtDiagOn_C "Schalten Regeneration manuell beginnen (1: manuell gestarted, 0: nicht manuell gestarted)" VALUE 0xE83C4 Kw_Wu8 255.0 OneToOne 0.00 255.0 FORMAT "%5.1" /end CHARACTERISTIC
/begin CHARACTERISTIC PFlt_swtDiagRlsmSotCtl_C "" VALUE 0xE9684 Kw_Wu8 1.000 OneToOne 0.00 1.000 FORMAT "%5.3" EXTENDED_LIMITS 0.00 255.0 /end CHARACTERISTIC
/begin CHARACTERISTIC PFlt_swtEngPrtWrEEPROM_C "Schalter, um Schreiben der regeneration protection counter ins EEPROM freizugeben. (1: freigegeben, 0: gesperrt)" VALUE 0xE9685 Kw_Wu8 1.000 OneToOne 0.00 1.000 FORMAT "%5.3" EXTENDED_LIMITS 0.00 255.0 /end CHARACTERISTIC
/begin CHARACTERISTIC PFlt_swtEnvTempSens_C "Schalter Umgebungstemperatursensorfühler appliziert (1: appliziert, 0: nicht appliziert)" VALUE 0xE9521 Kw_Wu8 1.000 OneToOne 0.00 1.000 FORMAT "%5.3" EXTENDED_LIMITS 0.00 255.0 /end CHARACTERISTIC
/begin CHARACTERISTIC PFlt_swtFacDpn_C "Schalter zur überlegeung der Verlustleistung (1: motornaher Kat. - Filter 0: kombinierter Kat. - Filter)" VALUE 0xE9830 Kw_Wu8 1.000 OneToOne 0.00 1.000 FORMAT "%5.3" EXTENDED_LIMITS 0.00 255.0 /end CHARACTERISTIC
/begin CHARACTERISTIC PFlt_swtLmbdAprx_C "Mess- oder Simulationssignal für Lambda-Messung (1: Simulation, 0: Messsignal)" VALUE 0xE8A90 Kw_Wu8 1.000 OneToOne 0.00 1.000 FORMAT "%5.3" EXTENDED_LIMITS 0.00 255.0 /end CHARACTERISTIC
/begin CHARACTERISTIC PFlt_swtMonCharMin_C "Schalter Auswahl Überwachung Strömungswiderstand (1: Überwachung Filterdurchbruch, 0: Grenzwert für Volumenstrom)" VALUE 0xE9522 Kw_Wu8 1.000 OneToOne 0.00 1.000 FORMAT "%5.3" EXTENDED_LIMITS 0.00 255.0 /end CHARACTERISTIC
/begin CHARACTERISTIC PFlt_swtOfsCor_C "Schalter zur Abschaltung der Offsetkorrektur im Zustandautomat (1: aus, 0: ein)" VALUE 0xE83C5 Kw_Wu8 1.000 OneToOne 0.00 1.000 FORMAT "%5.3" EXTENDED_LIMITS 0.00 255.0 /end CHARACTERISTIC
/begin CHARACTERISTIC PFlt_swtPDiffOfsOn_C "Schalter zur Berücksichtigung des Differenzdruckoffsets (1: Berücksichtigt, 0: nicht Berücksichtigt)" VALUE 0xE974C Kw_Wu8 1.000 OneToOne 0.00 1.000 FORMAT "%5.3" EXTENDED_LIMITS 0.00 255.0 /end CHARACTERISTIC
/begin CHARACTERISTIC PFlt_swtPresSensCfg_C "Auswahlwert für Sensorkonfiguration (0...nur Differenzdrucksensor verwendet, 1...nur Absolutdrucksensor verwendet)" VALUE 0xE974D Kw_Wu8 2.000 OneToOne 0.00 2.000 FORMAT "%5.3" EXTENDED_LIMITS 0.00 255.0 /end CHARACTERISTIC
/begin CHARACTERISTIC PFlt_swtSensEvalSel_C "SW-Schalter Strömungswdst aus 1: Division oder 0: Kennfeld" VALUE 0xE94DC Kw_Wu8 1.000 OneToOne 0.00 1.000 FORMAT "%5.3" EXTENDED_LIMITS 0.00 255.0 /end CHARACTERISTIC
/begin CHARACTERISTIC PFlt_swtServiceVal_C "Serviceschalter zum Zurücksetzen nach Partikelfilteraustausch (1: Reset, 0: liest Werte aus EEPROM)" VALUE 0xE83C6 Kw_Wu8 255.0 OneToOne 0.00 255.0 FORMAT "%5.1" /end CHARACTERISTIC
/begin CHARACTERISTIC Pflt_swtShOffSuc_C "" VALUE 0xE83C7 Kw_Wu8 255.0 OneToOne 0.00 255.0 FORMAT "%5.1" /end CHARACTERISTIC
/begin CHARACTERISTIC PFlt_swtSimInitOn_C "Schalter zur Initialisierung des Russpartikelmassenintegrators (1...initialisierung, 0...keine initialisierung)" VALUE 0xE94DD Kw_Wu8 1.000 OneToOne 0.00 1.000 FORMAT "%5.3" EXTENDED_LIMITS 0.00 255.0 /end CHARACTERISTIC
/begin CHARACTERISTIC PFlt_swtSvcSensChng_C "Schalter für Rücksetzen der EEPROM-Werte bei Differenzdrucksensoraustausch (1: Rücksetzen, 0: kein Rücksetzen)" VALUE 0xE9523 Kw_Wu8 255.0 OneToOne 0.00 255.0 FORMAT "%5.1" /end CHARACTERISTIC
/begin CHARACTERISTIC PFlt_swtSvcTmrRst_C "Schalter für Rücksetzen der EEPROM-Timer-Werte bei Steuergerätetausch (1: Rücksetzen, 0: kein Rücksetzen)" VALUE 0xE9524 Kw_Wu8 255.0 OneToOne 0.00 255.0 FORMAT "%5.1" /end CHARACTERISTIC
/begin CHARACTERISTIC PFlt_swtTempModOff_C "Schalter zur Abschaltung des Partikelfiltertemperaturmodells (1: aus, 0: ein)" VALUE 0xE9831 Kw_Wu8 1.000 OneToOne 0.00 1.000 FORMAT "%5.3" EXTENDED_LIMITS 0.00 255.0 /end CHARACTERISTIC
/begin CHARACTERISTIC PFlt_swtTmrLckRst_C "Schalter zum Rücksetzen des EEPROM Wertes der Sperrzeit (1: Reset, 0: kein Reset)" VALUE 0xE83C8 Kw_Wu8 255.0 OneToOne 0.00 255.0 FORMAT "%5.1" /end CHARACTERISTIC
/begin CHARACTERISTIC PFlt_tAirFltAshCorMax_C "maximal zulässiger Wert Lufttemperatur" VALUE 0xE80A8 Kw_Ws16 250.0000 Temp_Cels -50.14000 199.8600 FORMAT "%8.4" EXTENDED_LIMITS -3549.940 3003.560 /end CHARACTERISTIC
/begin CHARACTERISTIC PFlt_tAirFltAshCorMin_C "minimal zulässiger Wert Lufttemperatur" VALUE 0xE80AA Kw_Ws16 250.0000 Temp_Cels -50.14000 199.8600 FORMAT "%8.4" EXTENDED_LIMITS -3549.940 3003.560 /end CHARACTERISTIC
/begin CHARACTERISTIC PFlt_tAirMinMax_CA "Matrix zur Bestimmung der Bereichsgrenzen für die Ansauglufttemperatur" MAP 0xE87C6 Kf_Xs16_Ys16_Ws16 250.0000 Temp_Cels -50.14000 199.8600 FORMAT "%8.4" EXTENDED_LIMITS -3549.940 3003.560
 /begin AXIS_DESCR STD_AXIS PFlt_RngIdx_X_mp OneToOne 11 0.00 10.00 FORMAT "%5.2" EXTENDED_LIMITS 0.00 255.0 DEPOSIT ABSOLUTE /end AXIS_DESCR
 /begin AXIS_DESCR STD_AXIS PFlt_RngIdx_Y_mp OneToOne 2 0.00 1.000 FORMAT "%5.3" EXTENDED_LIMITS 0.00 255.0 DEPOSIT ABSOLUTE /end AXIS_DESCR
/end CHARACTERISTIC
/begin CHARACTERISTIC PFlt_tCIntAshCorMax_C "maximal zulässiger Wert Kühlmitteltemperatur" VALUE 0xE80AC Kw_Ws16 250.0000 Temp_Cels -50.14000 199.8600 FORMAT "%8.4" EXTENDED_LIMITS -3549.940 3003.560 /end CHARACTERISTIC
/begin CHARACTERISTIC PFlt_tCIntAshCorMin_C "minimal zulässiger Wert Kühlmitteltemperatur" VALUE 0xE80AE Kw_Ws16 250.0000 Temp_Cels -50.14000 199.8600 FORMAT "%8.4" EXTENDED_LIMITS -3549.940 3003.560 /end CHARACTERISTIC
/begin CHARACTERISTIC PFlt_tCldStrtDfl_C "Obere Temperaturschwelle für Kaltstarterkennung" VALUE 0xE9526 Kw_Ws16 950.0000 Temp_Cels -50.14000 899.8600 FORMAT "%8.4" EXTENDED_LIMITS -3549.940 3003.560 /end CHARACTERISTIC
/begin CHARACTERISTIC PFlt_tClntMinMax_CA "Matrix zur Bestimmung der Bereichsgrenzen für die gefilterte Temperatur der Kühlflüssigkeit" MAP 0xE8810 Kf_Xs16_Ys16_Ws16 250.0000 Temp_Cels -50.14000 199.8600 FORMAT "%8.4" EXTENDED_LIMITS -3549.940 3003.560
 /begin AXIS_DESCR STD_AXIS PFlt_RngIdx_X_mp OneToOne 11 0.00 10.00 FORMAT "%5.2" EXTENDED_LIMITS 0.00 255.0 DEPOSIT ABSOLUTE /end AXIS_DESCR
 /begin AXIS_DESCR STD_AXIS PFlt_RngIdx_Y_mp OneToOne 2 0.00 1.000 FORMAT "%5.3" EXTENDED_LIMITS 0.00 255.0 DEPOSIT ABSOLUTE /end AXIS_DESCR
/end CHARACTERISTIC
/begin CHARACTERISTIC PFlt_tDiagDpfAbrtMax_C "Grenze PFltCD_tPre" VALUE 0xE850C Kw_Ws16 950.0000 Temp_Cels -50.1400 899.8600 FORMAT "%8.4" EXTENDED_LIMITS -3549.940 3003.560 /end CHARACTERISTIC
/begin CHARACTERISTIC PFlt_tDiagDpfCoolDwn_C "Grenze PFltCD_tPre" VALUE 0xE850E Kw_Ws16 950.0000 Temp_Cels -50.1400 899.8600 FORMAT "%8.4" EXTENDED_LIMITS -3549.940 3003.560 /end CHARACTERISTIC
/begin CHARACTERISTIC PFlt_tDiagDpfHeatup_C "Grenze PFltCD_tPre" VALUE 0xE8510 Kw_Ws16 950.0000 Temp_Cels -50.1400 899.8600 FORMAT "%8.4" EXTENDED_LIMITS -3549.940 3003.560 /end CHARACTERISTIC
/begin CHARACTERISTIC PFlt_tDiagDpfMax_C "Grenze PFltCD_tPre" VALUE 0xE8512 Kw_Ws16 950.0000 Temp_Cels -50.1400 899.8600 FORMAT "%8.4" EXTENDED_LIMITS -3549.940 3003.560 /end CHARACTERISTIC
/begin CHARACTERISTIC PFlt_tDiagDpfPreRgnMin_C "Grenze PFltCD_tPre" VALUE 0xE8514 Kw_Ws16 950.0000 Temp_Cels -50.1400 899.8600 FORMAT "%8.4" EXTENDED_LIMITS -3549.940 3003.560 /end CHARACTERISTIC
/begin CHARACTERISTIC PFlt_tDiagOxiAbrtMax_C "Grenze OxiCCD_tPre" VALUE 0xE8516 Kw_Ws16 950.0000 Temp_Cels -50.1400 899.8600 FORMAT "%8.4" EXTENDED_LIMITS -3549.940 3003.560 /end CHARACTERISTIC
/begin CHARACTERISTIC PFlt_tDiagOxiCoolDwn_C "Grenze OxiCCD_tPre" VALUE 0xE8518 Kw_Ws16 950.0000 Temp_Cels -50.1400 899.8600 FORMAT "%8.4" EXTENDED_LIMITS -3549.940 3003.560 /end CHARACTERISTIC
/begin CHARACTERISTIC PFlt_tDiagOxiHeatup_C "Grenze OxiCCD_tPre" VALUE 0xE851A Kw_Ws16 950.0000 Temp_Cels -50.1400 899.8600 FORMAT "%8.4" EXTENDED_LIMITS -3549.940 3003.560 /end CHARACTERISTIC
/begin CHARACTERISTIC PFlt_tDiagOxiMax_C "obere Abgastemperaturgrenze vor dem Oxidationskatalysator) - aktueller Wert" VALUE 0xE851C Kw_Ws16 950.0000 Temp_Cels -50.1400 899.8600 FORMAT "%8.4" EXTENDED_LIMITS -3549.940 3003.560 /end CHARACTERISTIC
/begin CHARACTERISTIC PFlt_tDiagOxiMin_C "untere Abgastemperaturgrenze vor dem Oxidationskatalysator) - aktueller Wert" VALUE 0xE851E Kw_Ws16 950.0000 Temp_Cels -50.1400 899.8600 FORMAT "%8.4" EXTENDED_LIMITS -3549.940 3003.560 /end CHARACTERISTIC
/begin CHARACTERISTIC PFlt_tDiagOxiPreMax_C "Grenze OxiCCD_tPre" VALUE 0xE8520 Kw_Ws16 950.0000 Temp_Cels -50.1400 899.8600 FORMAT "%8.4" EXTENDED_LIMITS -3549.940 3003.560 /end CHARACTERISTIC
/begin CHARACTERISTIC PFlt_tDiagOxiPreRgnMin_C "Grenze OxiCCD_tPre" VALUE 0xE8522 Kw_Ws16 950.0000 Temp_Cels -50.1400 899.8600 FORMAT "%8.4" EXTENDED_LIMITS -3549.940 3003.560 /end CHARACTERISTIC
/begin CHARACTERISTIC PFlt_tDiagPFltMax_C "obere Grenze des aktuellen Wertes der Partikelfiltervortemperatur" VALUE 0xE8524 Kw_Ws16 950.0000 Temp_Cels -50.1400 899.8600 FORMAT "%8.4" EXTENDED_LIMITS -3549.940 3003.560 /end CHARACTERISTIC
/begin CHARACTERISTIC PFlt_tDiagPFltMin_C "untere Grenze des aktuellen Wertes der Partikelfiltervortemperatur" VALUE 0xE8526 Kw_Ws16 950.0000 Temp_Cels -50.1400 899.8600 FORMAT "%8.4" EXTENDED_LIMITS -3549.940 3003.560 /end CHARACTERISTIC
/begin CHARACTERISTIC PFlt_tDiffCldMax_C "Maximal erlaubte Abweichung Temperatursensoren bei Kaltstart" VALUE 0xE9528 Kw_Ws16 250.2000 TempDiff_Cels -50.10000 200.1000 FORMAT "%8.4" EXTENDED_LIMITS -3276.800 3276.700 /end CHARACTERISTIC
/begin CHARACTERISTIC PFlt_tDiffTolcMax_C "Maximal erlaubte Toleranzabweichung Temperaturplausibilisierung" VALUE 0xE952A Kw_Ws16 250.2000 TempDiff_Cels -50.10000 200.1000 FORMAT "%8.4" EXTENDED_LIMITS -3276.800 3276.700 /end CHARACTERISTIC
/begin CHARACTERISTIC PFlt_tDwnStrmTolcMax_C "Maximal zulässige Toleranz bei Plausibilisierung des zweiten Abgastemperatursensors" VALUE 0xE952C Kw_Ws16 250.2000 TempDiff_Cels -50.10000 200.1000 FORMAT "%8.4" EXTENDED_LIMITS -3276.800 3276.700 /end CHARACTERISTIC
/begin CHARACTERISTIC PFlt_tEGMax_C "Obere Schwelle SRC Temperatursensoren" VALUE 0xE952E Kw_Ws16 950.0000 Temp_Cels -50.14000 899.8600 FORMAT "%8.4" EXTENDED_LIMITS -3549.940 3003.560 /end CHARACTERISTIC
/begin CHARACTERISTIC PFlt_tEGMin_C "Untere Schwelle SRC Temperatursensoren" VALUE 0xE9530 Kw_Ws16 950.0000 Temp_Cels -50.14000 899.8600 FORMAT "%8.4" EXTENDED_LIMITS -3549.940 3003.560 /end CHARACTERISTIC
/begin CHARACTERISTIC PFlt_tEngDiagMinH_C "obere Motortemperaturgrenze" VALUE 0xE8528 Kw_Ws16 950.0000 Temp_Cels -50.1400 899.8600 FORMAT "%8.4" EXTENDED_LIMITS -3549.940 3003.560 /end CHARACTERISTIC
/begin CHARACTERISTIC PFlt_tEngDiagMinL_C "untere Motortemperaturgrenze" VALUE 0xE852A Kw_Ws16 950.0000 Temp_Cels -50.1400 899.8600 FORMAT "%8.4" EXTENDED_LIMITS -3549.940 3003.560 /end CHARACTERISTIC
/begin CHARACTERISTIC PFlt_tExhGsStyRgn1_MAP "static soot emission" MAP 0xE9832 Kf_Xs16_Ys16_Ws16 700.0000 TempDiff_Cels 100.0000 800.0000 FORMAT "%8.4" EXTENDED_LIMITS -3276.800 3276.700
 /begin AXIS_DESCR STD_AXIS Eng_nAvrg EngN 8 40.00000 6000.000 FORMAT "%8.3" EXTENDED_LIMITS -32768.00 32767.00 DEPOSIT ABSOLUTE /end AXIS_DESCR
 /begin AXIS_DESCR STD_AXIS InjCtl_qSetUnBal InjMassCyc 8 0.00 327.6700 FORMAT "%8.4" EXTENDED_LIMITS -327.6800 327.6700 DEPOSIT ABSOLUTE /end AXIS_DESCR
/end CHARACTERISTIC
/begin CHARACTERISTIC PFlt_tExhGsStyRgn2_MAP "static soot emission" MAP 0xE98D6 Kf_Xs16_Ys16_Ws16 700.0000 TempDiff_Cels 100.0000 800.0000 FORMAT "%8.4" EXTENDED_LIMITS -3276.800 3276.700
 /begin AXIS_DESCR STD_AXIS Eng_nAvrg EngN 8 40.00000 6000.000 FORMAT "%8.3" EXTENDED_LIMITS -32768.00 32767.00 DEPOSIT ABSOLUTE /end AXIS_DESCR
 /begin AXIS_DESCR STD_AXIS InjCtl_qSetUnBal InjMassCyc 8 0.00 327.6700 FORMAT "%8.4" EXTENDED_LIMITS -327.6800 327.6700 DEPOSIT ABSOLUTE /end AXIS_DESCR
/end CHARACTERISTIC
/begin CHARACTERISTIC PFlt_tExhGsSty_MAP "Kennfeld für Stationärtemperaturen" MAP 0xE997A Kf_Xs16_Ys16_Ws16 950.0000 Temp_Cels -50.1400 899.8600 FORMAT "%8.4" EXTENDED_LIMITS -3549.940 3003.560
 /begin AXIS_DESCR STD_AXIS Eng_nAvrg EngN 8 40.00000 6000.000 FORMAT "%8.3" EXTENDED_LIMITS -32768.00 32767.00 DEPOSIT ABSOLUTE /end AXIS_DESCR
 /begin AXIS_DESCR STD_AXIS InjCtl_qSetUnBal InjMassCyc 8 0.00 327.6700 FORMAT "%8.4" EXTENDED_LIMITS -327.6800 327.6700 DEPOSIT ABSOLUTE /end AXIS_DESCR
/end CHARACTERISTIC
/begin CHARACTERISTIC PFlt_tFltDiagMax_C "Grenze der Kraftstoffsystemtemperatur" VALUE 0xE852C Kw_Ws16 250.0000 Temp_Cels -50.14000 199.8600 FORMAT "%8.4" EXTENDED_LIMITS -3549.940 3003.560 /end CHARACTERISTIC
/begin CHARACTERISTIC PFlt_tFrzMin_C "Minimale Temperatur, unter der vor einem Einfrieren des Drucksensors gewarnt wird" VALUE 0xE9532 Kw_Ws16 950.0000 Temp_Cels -50.14000 899.8600 FORMAT "%8.4" EXTENDED_LIMITS -3549.940 3003.560 /end CHARACTERISTIC
/begin CHARACTERISTIC PFlt_tiAccPedPT1_C "Filterzeitkonst. für Pedalwertgeber PT1 Filter" VALUE 0xE885C Kw_Wu32 4294.9673 TimeDelay_s 0.0000010000000 4294.9673 FORMAT "%9.4" /end CHARACTERISTIC
/begin CHARACTERISTIC PFlt_tiAshCorAirTempPT1_C "Zeitkonstante Lufttemperatur" VALUE 0xE80B0 Kw_Wu32 4294.8273 TimeDelay_s 0.14000154 4294.9673 FORMAT "%9.4" EXTENDED_LIMITS 0.0000010000000 4294.9673 /end CHARACTERISTIC
/begin CHARACTERISTIC PFlt_tiAshCorCIntTempPT1_C "Zeitkonstante Kühlmitteltemperatur" VALUE 0xE80B4 Kw_Wu32 4294.8273 TimeDelay_s 0.14000154 4294.9673 FORMAT "%9.4" EXTENDED_LIMITS 0.0000010000000 4294.9673 /end CHARACTERISTIC
/begin CHARACTERISTIC PFlt_tiAshCorDVolPT1_C "Zeitkonstante Abgasvolumenstrom vor PFlt" VALUE 0xE80B8 Kw_Wu32 4294.8273 TimeDelay_s 0.14000154 4294.9673 FORMAT "%9.4" EXTENDED_LIMITS 0.0000010000000 4294.9673 /end CHARACTERISTIC
/begin CHARACTERISTIC PFlt_tiAshCorEngSpdPT1_C "Zeitkonstante Drehzahl" VALUE 0xE80BC Kw_Wu32 4294.8273 TimeDelay_s 0.14000154 4294.9673 FORMAT "%9.4" EXTENDED_LIMITS 0.0000010000000 4294.9673 /end CHARACTERISTIC
/begin CHARACTERISTIC PFlt_tiAshCorInjMsPT1_C "Zeitkonstante aktuelle Einspritzmasse" VALUE 0xE80C0 Kw_Wu32 4294.8273 TimeDelay_s 0.14000154 4294.9673 FORMAT "%9.4" EXTENDED_LIMITS 0.0000010000000 4294.9673 /end CHARACTERISTIC
/begin CHARACTERISTIC PFlt_tiAshCorOxiTempPT1_C "Zeitkonstante OxiKat-Temperatur" VALUE 0xE80C4 Kw_Wu32 4294.8273 TimeDelay_s 0.14000154 4294.9673 FORMAT "%9.4" EXTENDED_LIMITS 0.0000010000000 4294.9673 /end CHARACTERISTIC
/begin CHARACTERISTIC PFlt_tiAshCorPreTempPT1_C "Zeitkonstante Vortemperatur Partikelfilter" VALUE 0xE80C8 Kw_Wu32 4294.8273 TimeDelay_s 0.14000154 4294.9673 FORMAT "%9.4" EXTENDED_LIMITS 0.0000010000000 4294.9673 /end CHARACTERISTIC
/begin CHARACTERISTIC PFlt_tiAshCorResFlowPT1_C "Zeitkonstante gefilterter Stromwiderstand" VALUE 0xE80CC Kw_Wu32 4294.8273 TimeDelay_s 0.14000154 4294.9673 FORMAT "%9.4" EXTENDED_LIMITS 0.0000010000000 4294.9673 /end CHARACTERISTIC
/begin CHARACTERISTIC PFlt_tiAshCorRlsOn_C "Entprellzeit Simulation EIN" VALUE 0xE80D0 Kw_Wu16 655140.0 Time_ms 0.00 655140.0 FORMAT "%8.1" EXTENDED_LIMITS 0.00 655350.0 /end CHARACTERISTIC
/begin CHARACTERISTIC PFlt_tiAshCorVehAccPT1_C "Zeitkonstante Fahrzeugbeschleunigung" VALUE 0xE80D4 Kw_Wu32 4294.8273 TimeDelay_s 0.14000154 4294.9673 FORMAT "%9.4" EXTENDED_LIMITS 0.0000010000000 4294.9673 /end CHARACTERISTIC
/begin CHARACTERISTIC PFlt_tiAshCorVehSpdPT1_C "Zeitkonstante Fahrzeuggeschwindigkeit" VALUE 0xE80D8 Kw_Wu32 4294.8273 TimeDelay_s 0.14000154 4294.9673 FORMAT "%9.4" EXTENDED_LIMITS 0.0000010000000 4294.9673 /end CHARACTERISTIC
/begin CHARACTERISTIC PFlt_tiAshCorWaitMax_C "Regenerationsdauer" VALUE 0xE80DC Kw_Wu32 655140.000000 Time_s 0.00 655140.000000 FORMAT "%13.6" EXTENDED_LIMITS 0.00 42949672.9500 /end CHARACTERISTIC
/begin CHARACTERISTIC PFlt_tiBattCDPT1_C "Zeitkonstante für Batteriespannung" VALUE 0xE8860 Kw_Wu32 4294.9673 TimeDelay_s 0.0000010000000 4294.9673 FORMAT "%9.4" /end CHARACTERISTIC
/begin CHARACTERISTIC PFlt_tiChkTempPlausMax_CUR "Kennlinie zur Bestimmung des maximalen Zeitfensters zur Durchführung der Temp.-Plausibilisierung" CURVE 0xE9534 Kl_Xs16_Ws16 5.000000 Time_s 0.00 5.000000 FORMAT "%8.6" EXTENDED_LIMITS -327.6800 327.6700
 /begin AXIS_DESCR STD_AXIS BattCD_u Volt_Batt 8 0.00 5004.888 FORMAT "%8.3" EXTENDED_LIMITS -640625.6 640606.1 DEPOSIT ABSOLUTE /end AXIS_DESCR
/end CHARACTERISTIC
/begin CHARACTERISTIC PFlt_tiDebAftRunTst_C "Entprellzeit der Nachlaufbedingung zur Freigabe der Druck-Plausibilitätsprüfungen" VALUE 0xE9686 Kw_Wu16 1000.000 Time_ms 0.00 1000.000 FORMAT "%8.3" EXTENDED_LIMITS 0.00 655350.0 /end CHARACTERISTIC
/begin CHARACTERISTIC PFlt_tiDebBrkOff_C "Entprellzeit Bremse aus" VALUE 0xE8864 Kw_Wu16 3000.000 TimeDeb 0.00 3000.000 FORMAT "%8.3" EXTENDED_LIMITS 0.00 655350.0 /end CHARACTERISTIC
/begin CHARACTERISTIC PFlt_tiDebBrkOn_C "Entprellzeit Bremse an" VALUE 0xE8866 Kw_Wu16 3000.000 TimeDeb 0.00 3000.000 FORMAT "%8.3" EXTENDED_LIMITS 0.00 655350.0 /end CHARACTERISTIC
/begin CHARACTERISTIC PFlt_DebCharMaxDef_C "Entprellzeit setzen Strömungswiderstand SRC high" VALUE 0xE9556 Kw_Wu16 1000.000 Time_ms 0.00 1000.000 FORMAT "%8.3" EXTENDED_LIMITS 0.00 655350.0 /end CHARACTERISTIC
/begin CHARACTERISTIC PFlt_DebCharMaxOk_C "Entprellzeit heilen Strömungswiderstand SRC high" VALUE 0xE9558 Kw_Wu16 1000.000 Time_ms 0.00 1000.000 FORMAT "%8.3" EXTENDED_LIMITS 0.00 655350.0 /end CHARACTERISTIC
/begin CHARACTERISTIC PFlt_DebCharMinDef_C "Entprellzeit setzen Strömungswiderstand SRC low" VALUE 0xE955A Kw_Wu16 1000.000 Time_ms 0.00 1000.000 FORMAT "%8.3" EXTENDED_LIMITS 0.00 655350.0 /end CHARACTERISTIC
/begin CHARACTERISTIC PFlt_DebCharMinOk_C "Entprellzeit heilen Strömungswiderstand SRC low" VALUE 0xE955C Kw_Wu16 1000.000 Time_ms 0.00 1000.000 FORMAT "%8.3" EXTENDED_LIMITS 0.00 655350.0 /end CHARACTERISTIC
/begin CHARACTERISTIC PFlt_tiDebConvOff_C "Entprellzeit Kupplung aus" VALUE 0xE8868 Kw_Wu16 3000.000 TimeDeb 0.00 3000.000 FORMAT "%8.3" EXTENDED_LIMITS 0.00 655350.0 /end CHARACTERISTIC
/begin CHARACTERISTIC PFlt_tiDebConvOn_C "Entprellzeit Kupplung an" VALUE 0xE886A Kw_Wu16 3000.000 TimeDeb 0.00 3000.000 FORMAT "%8.3" EXTENDED_LIMITS 0.00 655350.0 /end CHARACTERISTIC
/begin CHARACTERISTIC PFlt_DebEngPrtMaxDef_C "Entprellzeit setzen Motorschutz-Fehler" VALUE 0xE955E Kw_Wu16 1000.000 Time_ms 0.00 1000.000 FORMAT "%8.3" EXTENDED_LIMITS 0.00 655350.0 /end CHARACTERISTIC
/begin CHARACTERISTIC PFlt_DebEngPrtMaxOk_C "Entprellzeit heilen Motorschutz-Fehler" VALUE 0xE9560 Kw_Wu16 1000.000 Time_ms 0.00 1000.000 FORMAT "%8.3" EXTENDED_LIMITS 0.00 655350.0 /end CHARACTERISTIC
/begin CHARACTERISTIC PFlt_tiDebGearOff_C "Entprellungszeit für die Freigabe des Gangsignales" VALUE 0xE886C Kw_Wu16 3000.000 TimeDeb 0.00 3000.000 FORMAT "%8.3" EXTENDED_LIMITS 0.00 655350.0 /end CHARACTERISTIC
/begin CHARACTERISTIC PFlt_tiDebGearOn_C "Entprellungszeit für Setzen des Gangsignals" VALUE 0xE886E Kw_Wu16 3000.000 TimeDeb 0.00 3000.000 FORMAT "%8.3" EXTENDED_LIMITS 0.00 655350.0 /end CHARACTERISTIC
/begin CHARACTERISTIC PFlt_tiDebLck_C "Entprellzeit für Timer der maximalen Regenerationszeit" VALUE 0xE83CA Kw_Wu16 120.0000 TimeDeb 0.00 120.0000 FORMAT "%8.4" EXTENDED_LIMITS 0.00 655350.0 /end CHARACTERISTIC
/begin CHARACTERISTIC PFlt_tiDebLoIdl_C "Entprellzeit der Leerlaufbedingung zur Freigabe der Druck-Plausibilitätsprüfungen" VALUE 0xE9688 Kw_Wu16 1000.000 Time_ms 0.00 1000.000 FORMAT "%8.3" EXTENDED_LIMITS 0.00 655350.0 /end CHARACTERISTIC
/begin CHARACTERISTIC PFlt_DebmSotMaxDef_C "Debouncing time for defect recognition of unsuccessful regeneration" VALUE 0xE968A Kw_Wu16 20000.00 Time_ms 0.00 20000.00 FORMAT "%8.2" EXTENDED_LIMITS 0.00 655350.0 /end CHARACTERISTIC
/begin CHARACTERISTIC PFlt_DebmSotMaxOk_C "Debouncing time for error healing of unsuccessful regeneration" VALUE 0xE968C Kw_Wu16 20000.00 Time_ms 0.00 20000.00 FORMAT "%8.2" EXTENDED_LIMITS 0.00 655350.0 /end CHARACTERISTIC
/begin CHARACTERISTIC PFlt_tiDebPresDblDef_C "Entprellzeit für APS BPS pPre Druck Plausibilitätsdoppeldefekt" VALUE 0xE968E Kw_Wu16 1000.000 Time_ms 0.00 1000.000 FORMAT "%8.3" EXTENDED_LIMITS 0.00 655350.0 /end CHARACTERISTIC
/begin CHARACTERISTIC PFlt_DebPDiffDynPlausDef_C "Entprellzeit setzen dynamischer Fehler Differenzdruck" VALUE 0xE9562 Kw_Wu16 1000.000 Time_ms 0.00 1000.000 FORMAT "%8.3" EXTENDED_LIMITS 0.00 655350.0 /end CHARACTERISTIC
/begin CHARACTERISTIC PFlt_DebPDiffDynPlausOk_C "Entprellzeit heilen dynamischer Fehler Differenzdruck" VALUE 0xE9564 Kw_Wu16 1000.000 Time_ms 0.00 1000.000 FORMAT "%8.3" EXTENDED_LIMITS 0.00 655350.0 /end CHARACTERISTIC
/begin CHARACTERISTIC PFlt_tiDebPresPlausOk_C "Entprellzeit für APS BPS pPre Druck Plausibilitätsprüfungen" VALUE 0xE9690 Kw_Wu16 1000.000 Time_ms 0.00 1000.000 FORMAT "%8.3" EXTENDED_LIMITS 0.00 655350.0 /end CHARACTERISTIC
/begin CHARACTERISTIC PFlt_DebHsLnPlausDef_C "Entprellzeit setzen Plausibilisierungsfehler Schlauchleitung" VALUE 0xE9566 Kw_Wu16 1000.000 Time_ms 0.00 1000.000 FORMAT "%8.3" EXTENDED_LIMITS 0.00 655350.0 /end CHARACTERISTIC
/begin CHARACTERISTIC PFlt_DebHsLnPlausOk_C "Entprellzeit heilen Plausibilisierungsfehler Schlauchleitung" VALUE 0xE9568 Kw_Wu16 1000.000 Time_ms 0.00 1000.000 FORMAT "%8.3" EXTENDED_LIMITS 0.00 655350.0 /end CHARACTERISTIC
/begin CHARACTERISTIC PFlt_DebPDiffMaxDef_C "Entprellzeit setzen Drucksensoren SRC high" VALUE 0xE956A Kw_Wu16 1000.000 Time_ms 0.00 1000.000 FORMAT "%8.3" EXTENDED_LIMITS 0.00 655350.0 /end CHARACTERISTIC
/begin CHARACTERISTIC PFlt_DebPDiffMaxOk_C "Entprellzeit heilen Drucksensoren SRC high" VALUE 0xE956C Kw_Wu16 1000.000 Time_ms 0.00 1000.000 FORMAT "%8.3" EXTENDED_LIMITS 0.00 655350.0 /end CHARACTERISTIC
/begin CHARACTERISTIC PFlt_DebPDiffMinDef_C "Entprellzeit setzen Drucksensoren SRC low" VALUE 0xE956E Kw_Wu16 1000.000 Time_ms 0.00 1000.000 FORMAT "%8.3" EXTENDED_LIMITS 0.00 655350.0 /end CHARACTERISTIC
/begin CHARACTERISTIC PFlt_DebPDiffMinOk_C "Entprellzeit heilen Drucksensoren SRC low" VALUE 0xE9570 Kw_Wu16 1000.000 Time_ms 0.00 1000.000 FORMAT "%8.3" EXTENDED_LIMITS 0.00 655350.0 /end CHARACTERISTIC
/begin CHARACTERISTIC PFlt_DebSotPlausDef_C "Entprellzeit setzen Plausibilisierungsfehler Versottung" VALUE 0xE9572 Kw_Wu16 1000.000 Time_ms 0.00 1000.000 FORMAT "%8.3" EXTENDED_LIMITS 0.00 655350.0 /end CHARACTERISTIC
/begin CHARACTERISTIC PFlt_DebSotPlausOk_C "Entprellzeit heilen Plausibilisierungsfehler Versottung" VALUE 0xE9574 Kw_Wu16 1000.000 Time_ms 0.00 1000.000 FORMAT "%8.3" EXTENDED_LIMITS 0.00 655350.0 /end CHARACTERISTIC
/begin CHARACTERISTIC PFlt_tiDebQLimErrIntr_C "Entprellzeit für Regenerationsunterbrechung wegen Mengenbegrenzung" VALUE 0xE83CC Kw_Wu16 655350.0 TimeDeb 0.00 655350.0 FORMAT "%8.1" /end CHARACTERISTIC
/begin CHARACTERISTIC PFlt_DebRgnPermMaxDef_C "Entprellzeit setzen permanente Regeneration" VALUE 0xE9576 Kw_Wu16 1000.000 Time_ms 0.00 1000.000 FORMAT "%8.3" EXTENDED_LIMITS 0.00 655350.0 /end CHARACTERISTIC
/begin CHARACTERISTIC PFlt_DebRgnPermMaxOk_C "Entprellzeit heilen permanente Regeneration" VALUE 0xE9578 Kw_Wu16 1000.000 Time_ms 0.00 1000.000 FORMAT "%8.3" EXTENDED_LIMITS 0.00 655350.0 /end CHARACTERISTIC
/begin CHARACTERISTIC PFlt_tiDebSimOff_C "Entprellzeit Umschaltung Simulation/Messung" VALUE 0xE94DE Kw_Wu16 20.00000 TimeDeb 0.00 20.00000 FORMAT "%8.5" EXTENDED_LIMITS 0.00 655350.0 /end CHARACTERISTIC
/begin CHARACTERISTIC PFlt_tiDebSimOn_C "Entprellzeit Umschaltung Messung/ Simulation" VALUE 0xE94E0 Kw_Wu16 20.00000 TimeDeb 0.00 20.00000 FORMAT "%8.5" EXTENDED_LIMITS 0.00 655350.0 /end CHARACTERISTIC
/begin CHARACTERISTIC PFlt_tiDebT15On_C "Entprellzeit der T15 EIN Bedingung zur Freigabe der Plausibilitätsprüfungen" VALUE 0xE9692 Kw_Wu16 1000.000 Time_ms 0.00 1000.000 FORMAT "%8.3" EXTENDED_LIMITS 0.00 655350.0 /end CHARACTERISTIC
/begin CHARACTERISTIC PFlt_DebTEGMaxDef_C "Entprellzeit setzen Temperatursensoren SRC high" VALUE 0xE957A Kw_Wu16 1000.000 Time_ms 0.00 1000.000 FORMAT "%8.3" EXTENDED_LIMITS 0.00 655350.0 /end CHARACTERISTIC
/begin CHARACTERISTIC PFlt_DebTEGMaxOk_C "Entprellzeit heilen Temperatursensoren SRC high" VALUE 0xE957C Kw_Wu16 1000.000 Time_ms 0.00 1000.000 FORMAT "%8.3" EXTENDED_LIMITS 0.00 655350.0 /end CHARACTERISTIC
/begin CHARACTERISTIC PFlt_DebTEGMinDef_C "Entprellzeit setzen Temperatursensoren SRC low" VALUE 0xE957E Kw_Wu16 1000.000 Time_ms 0.00 1000.000 FORMAT "%8.3" EXTENDED_LIMITS 0.00 655350.0 /end CHARACTERISTIC
/begin CHARACTERISTIC PFlt_DebTEGMinOk_C "Entprellzeit heilen Temperatursensoren SRC low" VALUE 0xE9580 Kw_Wu16 1000.000 Time_ms 0.00 1000.000 FORMAT "%8.3" EXTENDED_LIMITS 0.00 655350.0 /end CHARACTERISTIC
/begin CHARACTERISTIC PFlt_tiDebTrqOvhtIntr_C "Entprellzeit für Regenerationsunterbrechung wegen Überhitzungsschutz" VALUE 0xE83CE Kw_Wu16 655350.0 TimeDeb 0.00 655350.0 FORMAT "%8.1" /end CHARACTERISTIC
/begin CHARACTERISTIC PFlt_tiDelOfsCalc_C "Verzögerungszeit zur Berechnung des Differenzdrucksensoroffsets im Motornachlauf" VALUE 0xE9582 Kw_Wu16 99.30000 Time_s 0.7000000 100.0000 FORMAT "%8.4" EXTENDED_LIMITS 0.00 655.3500 /end CHARACTERISTIC
/begin CHARACTERISTIC PFlt_tiDiagCoolDwnMax_C "Abkühl-Timergrenze" VALUE 0xE8530 Kw_Wu32 655140.000000 Time_s 0.00 655140.000000 FORMAT "%13.6" EXTENDED_LIMITS 0.00 42949672.9500 /end CHARACTERISTIC
/begin CHARACTERISTIC PFlt_tiDiagDpfMax_C "Grenze PFltCD_tPre" VALUE 0xE8534 Kw_Wu32 655140.000000 Time_s 0.00 655140.000000 FORMAT "%13.6" EXTENDED_LIMITS 0.00 42949672.9500 /end CHARACTERISTIC
/begin CHARACTERISTIC PFlt_tiDiagNormal_C "Motordauer normal" VALUE 0xE8538 Kw_Wu32 655140.000000 Time_s 0.00 655140.000000 FORMAT "%13.6" EXTENDED_LIMITS 0.00 42949672.9500 /end CHARACTERISTIC
/begin CHARACTERISTIC PFlt_tiDiagOxiMax_C "Grenze OxiCCD_tPre" VALUE 0xE853C Kw_Wu32 655140.000000 Time_s 0.00 655140.000000 FORMAT "%13.6" EXTENDED_LIMITS 0.00 42949672.9500 /end CHARACTERISTIC
/begin CHARACTERISTIC PFlt_tiDiagRgnEnd_C "Regenerationsdauer" VALUE 0xE8540 Kw_Wu32 655140.000000 Time_s 0.00 655140.000000 FORMAT "%13.6" EXTENDED_LIMITS 0.00 42949672.9500 /end CHARACTERISTIC
/begin CHARACTERISTIC PFlt_tiDiagRgnHeatup_C "Grenze des Zählers für die Abbruchbedingung" VALUE 0xE8544 Kw_Wu32 655140.000000 Time_s 0.00 655140.000000 FORMAT "%13.6" EXTENDED_LIMITS 0.00 42949672.9500 /end CHARACTERISTIC
/begin CHARACTERISTIC PFlt_tiDiagRgnLidIMin_C "Dauer der Motordrehzahl innerhalb eines bestimmten Bereichs" VALUE 0xE8548 Kw_Wu32 655140.000000 Time_s 0.00 655140.000000 FORMAT "%13.6" EXTENDED_LIMITS 0.00 42949672.9500 /end CHARACTERISTIC
/begin CHARACTERISTIC PFlt_tiEngOnMaxDef_C "maximale Motorbetriebszeit für Regeneration im Fehlerfall" VALUE 0xE83D0 Kw_Wu32 4294967295.00 TimeEngOn 0.00 4294967295.00 FORMAT "%13.2" /end CHARACTERISTIC
/begin CHARACTERISTIC PFlt_tiEngOnMax_C "maximale Motorbetriebszeit für Regeneration" VALUE 0xE83D4 Kw_Wu32 4294967295.00 TimeEngOn 0.00 4294967295.00 FORMAT "%13.2" /end CHARACTERISTIC
/begin CHARACTERISTIC PFlt_tiEngPrtPT1_C "Zeitkonstante des PT1-Gliedes für den Motorschutz" VALUE 0xE83D8 Kw_Wu32 4294.9673 TimeDelay_s 0.0000010000000 4294.9673 FORMAT "%9.4" /end CHARACTERISTIC
/begin CHARACTERISTIC PFlt_tiEngPrt_C "Regenerationsdauer aufgrund von Motorschutz" VALUE 0xE83DC Kw_Wu32 21474836.4700 Time_s 0.00 21474836.4700 FORMAT "%13.4" EXTENDED_LIMITS 0.00 42949672.9500 /end CHARACTERISTIC
/begin CHARACTERISTIC PFlt_tiEngSpdPT1_C "Filterzeitkonst. für Eng_nAvrg PT1 filter" VALUE 0xE8870 Kw_Wu32 4294.9673 TimeDelay_s 0.0000010000000 4294.9673 FORMAT "%9.4" /end CHARACTERISTIC
/begin CHARACTERISTIC PFlt_tiExhGsDel_CUR "Abgasstromverzögerung" CURVE 0xE9A1E Kl_Xs16_Ws16 10.010579 TimeDelay_s 0.0010000001 10.011579 FORMAT "%9.6" EXTENDED_LIMITS 0.13107600 4294.9673
 /begin AXIS_DESCR STD_AXIS PFlt_dmEG AirMassPerTime 8 -1000.000 1000.000 FORMAT "%8.3" EXTENDED_LIMITS -3276.800 3276.700 DEPOSIT ABSOLUTE /end AXIS_DESCR
/end CHARACTERISTIC
/begin CHARACTERISTIC PFlt_tiFstEngPrtRgnMax_C "" VALUE 0xE9694 Kw_Wu32 4294967295.00 TimeEngOn 0.00 4294967295.00 FORMAT "%13.2" /end CHARACTERISTIC
/begin CHARACTERISTIC PFlt_tiGetRgnSt_C "Timergrenze zur Erfassung des Regenerationszustands" VALUE 0xE854C Kw_Wu32 655140.000000 Time_s 0.00 655140.000000 FORMAT "%13.6" EXTENDED_LIMITS 0.00 42949672.9500 /end CHARACTERISTIC
/begin CHARACTERISTIC PFlt_tiHtTransDT1_CUR "Wärmeübertragungszeit" CURVE 0xE9A40 Kl_Xs16_Ws16 2147.4826 TimeDelay_s 0.0010000001 2147.4836 FORMAT "%9.4" EXTENDED_LIMITS 0.13107600 4294.9673
 /begin AXIS_DESCR STD_AXIS PFlt_dmEG AirMassPerTime 8 -1000.000 1000.000 FORMAT "%8.3" EXTENDED_LIMITS -3276.800 3276.700 DEPOSIT ABSOLUTE /end AXIS_DESCR
/end CHARACTERISTIC
/begin CHARACTERISTIC PFlt_tiInjMsPT1_C "Filterzeitkonst. für InjCtl_qSet PT1 filter" VALUE 0xE8874 Kw_Wu32 4294.9673 TimeDelay_s 0.0000010000000 4294.9673 FORMAT "%9.4" /end CHARACTERISTIC
/begin CHARACTERISTIC PFlt_tiLckChkTempPlaus_C "Verriegelungszeit Temperatursensorplausibilisierung nach kurzem Motorlauf" VALUE 0xE9584 Kw_Wu16 50.00000 Time_s 50.00000 100.0000 FORMAT "%8.4" EXTENDED_LIMITS 0.00 655.3500 /end CHARACTERISTIC
/begin CHARACTERISTIC PFlt_tiLckRgnErr_CA "Sperrzeit  im Fehlerfall nach der maximalen Regenerationdauer erreicht wurden" VAL_BLK 0xE83E0 Kwb_Wu32 42949672.9500 Time_s 0.00 42949672.9500 FORMAT "%13.4" NUMBER 9 /end CHARACTERISTIC
/begin CHARACTERISTIC PFlt_tiLckRgn_CA "Sperrzeit  nach der maximalen Regenerationdauer erreicht wurden" VAL_BLK 0xE8404 Kwb_Wu32 42949672.9500 Time_s 0.00 42949672.9500 FORMAT "%13.4" NUMBER 9 /end CHARACTERISTIC
/begin CHARACTERISTIC PFlt_tiLckSubs_C "Ersatzwert für Sperrzeit" VALUE 0xE8428 Kw_Wu32 42949672.9500 Time_s 0.00 42949672.9500 FORMAT "%13.4" /end CHARACTERISTIC
/begin CHARACTERISTIC PFlt_tiLoIdlSnceRgnMax_C "Zeit seit letzter erfolgreicher Regeneration, nach der Plausibilitätsprüfungen freigegeben werden" VALUE 0xE9698 Kw_Wu32 4294967295.00 TimeEngOn 0.00 4294967295.00 FORMAT "%13.2" /end CHARACTERISTIC
/begin CHARACTERISTIC PFlt_tiLstRgn_C "Dauer der Regeneration aufgrund von gefahrener Strecke, Betriebszeit oder Treibstoffverbrauch" VALUE 0xE842C Kw_Wu32 21474836.4700 Time_s 0.00 21474836.4700 FORMAT "%13.4" EXTENDED_LIMITS 0.00 42949672.9500 /end CHARACTERISTIC
/begin CHARACTERISTIC PFlt_tIncrDwnStrm_C "Korrekturwert Erwärmung zweite Abgastemperatur zur Überwachung" VALUE 0xE9586 Kw_Ws16 300.0000 TempDiff_Cels 0.00 300.0000 FORMAT "%8.4" EXTENDED_LIMITS -3276.800 3276.700 /end CHARACTERISTIC
/begin CHARACTERISTIC PFlt_tIncrUpStrm_C "Korrekturwert Erwärmung erste Abgastemperatur zur Überwachung" VALUE 0xE9588 Kw_Ws16 300.0000 TempDiff_Cels 0.00 300.0000 FORMAT "%8.4" EXTENDED_LIMITS -3276.800 3276.700 /end CHARACTERISTIC
/begin CHARACTERISTIC PFlt_tiOpSubs_C "Ersatzwert für Motorbetriebszeit im Fall Eeprom lese Fehler" VALUE 0xE8430 Kw_Wu32 4294967295.00 TimeEngOn 0.00 4294967295.00 FORMAT "%13.2" /end CHARACTERISTIC
/begin CHARACTERISTIC PFlt_tiPFltErrPer_C "" VALUE 0xE80E0 Kw_Wu16 655350.0 TimePFltLimpHome 0.00 655350.0 FORMAT "%8.1" /end CHARACTERISTIC
/begin CHARACTERISTIC PFlt_tiPFltErrRgn_C "" VALUE 0xE80E2 Kw_Wu16 655350.0 TimePFltLimpHome 0.00 655350.0 FORMAT "%8.1" /end CHARACTERISTIC
/begin CHARACTERISTIC PFlt_tiPPrePT1_C "Filterzeitkonstante für gefilterten Absolutdruck vor Partikelfilter" VALUE 0xE9750 Kw_Wu32 99.582970 TimeDelay_s 0.29999073 99.882960 FORMAT "%9.5" EXTENDED_LIMITS 0.0000010000000 4294.9673 /end CHARACTERISTIC
/begin CHARACTERISTIC PFlt_tiFltHsLnPT1_C "Filterzeitkonstante Signalfilterung für Schlauchleitungsüberwachung" VALUE 0xE958C Kw_Wu32 4294.9673 TimeDelay_s 0.0000010000000 4294.9673 FORMAT "%9.4" /end CHARACTERISTIC
/begin CHARACTERISTIC PFlt_tiResFlowPT1_C "Zeitkonstante für Strömungswiderstand" VALUE 0xE94E4 Kw_Wu32 4294.9673 TimeDelay_s 0.0000010000000 4294.9673 FORMAT "%9.4" /end CHARACTERISTIC
/begin CHARACTERISTIC PFlt_tiResFlowRgnPT1_C "Zeitkonstant des PT1-Filters für den Stömungswiederstand in Regenerationsbetrieb" VALUE 0xE94E8 Kw_Wu32 4294.9673 TimeDelay_s 0.0000010000000 4294.9673 FORMAT "%9.4" /end CHARACTERISTIC
/begin CHARACTERISTIC PFlt_tiRgnMax_CA "Array für Maximalwert Regenerationsdauer" VAL_BLK 0xE8434 Kwb_Wu32 42949672.9500 Time_s 0.00 42949672.9500 FORMAT "%13.4" NUMBER 7 /end CHARACTERISTIC
/begin CHARACTERISTIC PFlt_tiRgnSpo_C "Regenerationszeit zur Detektierung einer spontanen Regeneration" VALUE 0xE8450 Kw_Wu16 655.3500 Time_s 0.00 655.3500 FORMAT "%8.4" /end CHARACTERISTIC
/begin CHARACTERISTIC PFlt_tiSpdVehPT1_C "Filterzeitkonst. für VSSCD_v PT1 filter" VALUE 0xE8878 Kw_Wu32 4294.9673 TimeDelay_s 0.0000010000000 4294.9673 FORMAT "%9.4" /end CHARACTERISTIC
/begin CHARACTERISTIC PFlt_tiStpRgn_C "Timergrenze zur Beendigung der Regeneration" VALUE 0xE8550 Kw_Wu32 655140.000000 Time_s 0.00 655140.000000 FORMAT "%13.6" EXTENDED_LIMITS 0.00 42949672.9500 /end CHARACTERISTIC
/begin CHARACTERISTIC PFlt_tiTempClntPT1_C "Filterzeitkonst. für CTSCD_tClntPT1 filter" VALUE 0xE887C Kw_Wu32 4294.9673 TimeDelay_s 0.0000010000000 4294.9673 FORMAT "%9.4" /end CHARACTERISTIC
/begin CHARACTERISTIC PFlt_tiTempOxiPrePT1_C "Filterzeitkonst. für OxiCCD_tPre  PT1 filter" VALUE 0xE8880 Kw_Wu32 4294.9673 TimeDelay_s 0.0000010000000 4294.9673 FORMAT "%9.4" /end CHARACTERISTIC
/begin CHARACTERISTIC PFlt_tiTempPrePT1_C "Filterzeitkonst. für PFlt_tPre PT1 filter" VALUE 0xE8884 Kw_Wu32 4294.9673 TimeDelay_s 0.0000010000000 4294.9673 FORMAT "%9.4" /end CHARACTERISTIC
/begin CHARACTERISTIC PFlt_tiVolFlowPT1_C "Zeitkonstant des PT1-Filers für Abgasvolumenstom" VALUE 0xE94EC Kw_Wu32 4294.9673 TimeDelay_s 0.0000010000000 4294.9673 FORMAT "%9.4" /end CHARACTERISTIC
/begin CHARACTERISTIC PFlt_tiVolFlowRgnPT1_C "Zeitkonstant des PT1-Filers für Abgasvolumenstom in Regeneration" VALUE 0xE94F0 Kw_Wu32 4294.9673 TimeDelay_s 0.0000010000000 4294.9673 FORMAT "%9.4" /end CHARACTERISTIC
/begin CHARACTERISTIC PFlt_tOilDiagMinH_C "obere Öltemperaturgrenze" VALUE 0xE8554 Kw_Ws16 950.0000 Temp_Cels -50.1400 899.8600 FORMAT "%8.4" EXTENDED_LIMITS -3549.940 3003.560 /end CHARACTERISTIC
/begin CHARACTERISTIC PFlt_tOilDiagMinL_C "untere Öltemperaturgrenze" VALUE 0xE8556 Kw_Ws16 950.0000 Temp_Cels -50.1400 899.8600 FORMAT "%8.4" EXTENDED_LIMITS -3549.940 3003.560 /end CHARACTERISTIC
/begin CHARACTERISTIC PFlt_tOxiPreFltAshCorMax_C "maximal zulässiger Wert Temperatur vor dem OxiKat" VALUE 0xE80E4 Kw_Ws16 950.000 Temp_Cels -50.140 899.860 FORMAT "%8.3" EXTENDED_LIMITS -3549.940 3003.560 /end CHARACTERISTIC
/begin CHARACTERISTIC PFlt_tOxiPreFltAshCorMin_C "minimal zulässiger Wert Temperatur vor dem OxiKat" VALUE 0xE80E6 Kw_Ws16 950.000 Temp_Cels -50.140 899.860 FORMAT "%8.3" EXTENDED_LIMITS -3549.940 3003.560 /end CHARACTERISTIC
/begin CHARACTERISTIC PFlt_tOxiPreMaxHi_C "maximal erlaubter Wert für Temperatur vor Oxidationskatalysator (oberer Schwellenwert)" VALUE 0xE8452 Kw_Ws16 950.0000 Temp_Cels -50.1400 899.8600 FORMAT "%8.4" EXTENDED_LIMITS -3549.940 3003.560 /end CHARACTERISTIC
/begin CHARACTERISTIC PFlt_tOxiPreMaxLo_C "maximal erlaubter Wert für Temperatur vor Oxidationskatalysator (unterer Schwellenwert)" VALUE 0xE8454 Kw_Ws16 950.0000 Temp_Cels -50.1400 899.8600 FORMAT "%8.4" EXTENDED_LIMITS -3549.940 3003.560 /end CHARACTERISTIC
/begin CHARACTERISTIC PFlt_tOxiPreOffMinMax_CA "Matrix zur Bestimmung der Bereichsgrenzen für die gefilterte Abgastemperatur vor Oxidationskatalysator bei inaktivem Bereich" MAP 0xE8888 Kf_Xs16_Ys16_Ws16 950.000 Temp_Cels -50.140 899.860 FORMAT "%8.3" EXTENDED_LIMITS -3549.940 3003.560
 /begin AXIS_DESCR STD_AXIS PFlt_RngIdx_X_mp OneToOne 11 0.00 10.00 FORMAT "%5.2" EXTENDED_LIMITS 0.00 255.0 DEPOSIT ABSOLUTE /end AXIS_DESCR
 /begin AXIS_DESCR STD_AXIS PFlt_RngIdx_Y_mp OneToOne 2 0.00 1.000 FORMAT "%5.3" EXTENDED_LIMITS 0.00 255.0 DEPOSIT ABSOLUTE /end AXIS_DESCR
/end CHARACTERISTIC
/begin CHARACTERISTIC PFlt_tOxiPreOnMinMax_CA "Matrix zur Bestimmung der Bereichsgrenzen für die gefilterte Abgastemperatur vor Oxidationskatalysator bei aktivem Bereich" MAP 0xE88D2 Kf_Xs16_Ys16_Ws16 950.000 Temp_Cels -50.140 899.860 FORMAT "%8.3" EXTENDED_LIMITS -3549.940 3003.560
 /begin AXIS_DESCR STD_AXIS PFlt_RngIdx_X_mp OneToOne 11 0.00 10.00 FORMAT "%5.2" EXTENDED_LIMITS 0.00 255.0 DEPOSIT ABSOLUTE /end AXIS_DESCR
 /begin AXIS_DESCR STD_AXIS PFlt_RngIdx_Y_mp OneToOne 2 0.00 1.000 FORMAT "%5.3" EXTENDED_LIMITS 0.00 255.0 DEPOSIT ABSOLUTE /end AXIS_DESCR
/end CHARACTERISTIC
/begin CHARACTERISTIC PFlt_tiOxiPreStyPT1_C " Zeitkonstant des PT1-Gliedes für stationäre Abgastemperatur vor dem Oxi-Kat" VALUE 0xE9A64 Kw_Wu32 4294.9673 TimeDelay_s 0.0000010000000 4294.9673 FORMAT "%9.4" /end CHARACTERISTIC
/begin CHARACTERISTIC PFlt_tPreFltAshCorMax_C "maximal zulässiger Wert Vortemperatur Partikelfilter" VALUE 0xE80E8 Kw_Ws16 950.000 Temp_Cels -50.140 899.860 FORMAT "%8.3" EXTENDED_LIMITS -3549.940 3003.560 /end CHARACTERISTIC
/begin CHARACTERISTIC PFlt_tPreFltAshCorMin_C "minimal zulässiger Wert Vortemperatur Partikelfilter" VALUE 0xE80EA Kw_Ws16 950.000 Temp_Cels -50.140 899.860 FORMAT "%8.3" EXTENDED_LIMITS -3549.940 3003.560 /end CHARACTERISTIC
/begin CHARACTERISTIC PFlt_tPreMaxHi_C "maximal erlaubter Wert für Temperatur vor Partikelfilter (oberer Schwellenwert)" VALUE 0xE8456 Kw_Ws16 950.0000 Temp_Cels -50.1400 899.8600 FORMAT "%8.4" EXTENDED_LIMITS -3549.940 3003.560 /end CHARACTERISTIC
/begin CHARACTERISTIC PFlt_tPreMaxLo_C "maximal erlaubter Wert für Temperatur vor Partikelfilter (unterer Schwellenwert)" VALUE 0xE8458 Kw_Ws16 950.0000 Temp_Cels -50.1400 899.8600 FORMAT "%8.4" EXTENDED_LIMITS -3549.940 3003.560 /end CHARACTERISTIC
/begin CHARACTERISTIC PFlt_tPreOffMinMax_CA "Matrix zur Bestimmung der Bereichsgrenzen für die gefilterte Abgastemperatur vor Partikelfilter bei inaktivem Bereich" MAP 0xE891C Kf_Xs16_Ys16_Ws16 950.000 Temp_Cels -50.140 899.860 FORMAT "%8.3" EXTENDED_LIMITS -3549.940 3003.560
 /begin AXIS_DESCR STD_AXIS PFlt_RngIdx_X_mp OneToOne 11 0.00 10.00 FORMAT "%5.2" EXTENDED_LIMITS 0.00 255.0 DEPOSIT ABSOLUTE /end AXIS_DESCR
 /begin AXIS_DESCR STD_AXIS PFlt_RngIdx_Y_mp OneToOne 2 0.00 1.000 FORMAT "%5.3" EXTENDED_LIMITS 0.00 255.0 DEPOSIT ABSOLUTE /end AXIS_DESCR
/end CHARACTERISTIC
/begin CHARACTERISTIC PFlt_tPreOnMinMax_CA "Matrix zur Bestimmung der Bereichsgrenzen für die gefilterte Abgastemperatur vor Partikelfilter bei aktivem Bereich" MAP 0xE8966 Kf_Xs16_Ys16_Ws16 950.000 Temp_Cels -50.140 899.860 FORMAT "%8.3" EXTENDED_LIMITS -3549.940 3003.560
 /begin AXIS_DESCR STD_AXIS PFlt_RngIdx_X_mp OneToOne 11 0.00 10.00 FORMAT "%5.2" EXTENDED_LIMITS 0.00 255.0 DEPOSIT ABSOLUTE /end AXIS_DESCR
 /begin AXIS_DESCR STD_AXIS PFlt_RngIdx_Y_mp OneToOne 2 0.00 1.000 FORMAT "%5.3" EXTENDED_LIMITS 0.00 255.0 DEPOSIT ABSOLUTE /end AXIS_DESCR
/end CHARACTERISTIC
/begin CHARACTERISTIC PFlt_tiFltTempPT1_C "Filterzeitkonstante für Oberflächentemperatursimulation" VALUE 0xE9A68 Kw_Wu32 4294.9673 TimeDelay_s 0.0000010000000 4294.9673 FORMAT "%9.4" /end CHARACTERISTIC
/begin CHARACTERISTIC PFlt_tiPreStyPT1_C "Zeitkonstant des PT1-Gliedes für stationäre Abgastemperatur vor dem Partikelfilter" VALUE 0xE9A6C Kw_Wu32 4294.9673 TimeDelay_s 0.0000010000000 4294.9673 FORMAT "%9.4" /end CHARACTERISTIC
/begin CHARACTERISTIC PFlt_tRefSty_C "Referenztemperatur für das Festlegen des Abgastemperaturenkennfeldes" VALUE 0xE9A70 Kw_Ws16 250.0000 Temp_Cels -50.1400 199.8600 FORMAT "%8.4" EXTENDED_LIMITS -3549.940 3003.560 /end CHARACTERISTIC
/begin CHARACTERISTIC PFlt_tUpStrmTolcMax_C "Maximal zulässige Toleranz bei Plausibilisierung des ersten Abgastemperatursensors" VALUE 0xE9590 Kw_Ws16 250.2000 TempDiff_Cels -50.10000 200.1000 FORMAT "%8.4" EXTENDED_LIMITS -3276.800 3276.700 /end CHARACTERISTIC
/begin CHARACTERISTIC PFlt_uBattMinMax_CA "Matrix zur Bestimmung der Bereichsgrenzen für das gefilterte Batteriespannungssignal" MAP 0xE89B0 Kf_Xs16_Ys16_Ws16 28602.15 Volt_Batt 0.00 28602.15 FORMAT "%8.2" EXTENDED_LIMITS -640625.6 640606.1
 /begin AXIS_DESCR STD_AXIS PFlt_RngIdx_X_mp OneToOne 11 0.00 10.00 FORMAT "%5.2" EXTENDED_LIMITS 0.00 255.0 DEPOSIT ABSOLUTE /end AXIS_DESCR
 /begin AXIS_DESCR STD_AXIS PFlt_RngIdx_Y_mp OneToOne 2 0.00 1.000 FORMAT "%5.3" EXTENDED_LIMITS 0.00 255.0 DEPOSIT ABSOLUTE /end AXIS_DESCR
/end CHARACTERISTIC
/begin CHARACTERISTIC PFlt_uDiagMin_C "Batteriespannungsgrenze" VALUE 0xE8558 Kw_Ws16 28602.15 Volt_Batt 0.00 28602.15 FORMAT "%8.2" EXTENDED_LIMITS -640625.6 640606.1 /end CHARACTERISTIC
/begin CHARACTERISTIC PFlt_volFlConsumSubs_C "Ersatzwert für insgesamt verbrauchten Kraftstoff" VALUE 0xE845A Kw_Wu16 65.50000 Fl_Vol 0.00 65.50000 FORMAT "%8.5" EXTENDED_LIMITS 0.00 65.53500 /end CHARACTERISTIC
/begin CHARACTERISTIC PFlt_volFuelFilMinHi_C "Obere Hystereseschwelle für Aufhebung der Sperre" VALUE 0xE845C Kw_Wu16 300.0000 Fl_Half_L 0.00 300.0000 FORMAT "%8.4" EXTENDED_LIMITS 0.00 3276.750 /end CHARACTERISTIC
/begin CHARACTERISTIC PFlt_volFuelFilMinLo_C "Untere Hystereseschwelle für Sperre der Regen." VALUE 0xE845E Kw_Wu16 300.0000 Fl_Half_L 0.00 300.0000 FORMAT "%8.4" EXTENDED_LIMITS 0.00 3276.750 /end CHARACTERISTIC
/begin CHARACTERISTIC PFlt_volPFlt_C "Volumen des Partikel Filters" VALUE 0xE94F4 Kw_Wu16 99.99000 Vol 0.01000000 100.0000 FORMAT "%8.4" EXTENDED_LIMITS 0.00 655.3500 /end CHARACTERISTIC
/begin CHARACTERISTIC PFlt_vVehFltAshCorMax_C "maximal zulässiger Wert Fahrzeuggeschwindigkeit" VALUE 0xE80EC Kw_Ws16 300.0000 Vel 0.00 300.0000 FORMAT "%8.4" EXTENDED_LIMITS -327.6800 327.6700 /end CHARACTERISTIC
/begin CHARACTERISTIC PFlt_vVehFltAshCorMin_C "minimal zulässiger Wert Fahrzeuggeschwindigkeit" VALUE 0xE80EE Kw_Ws16 300.0000 Vel 0.00 300.0000 FORMAT "%8.4" EXTENDED_LIMITS -327.6800 327.6700 /end CHARACTERISTIC
/begin CHARACTERISTIC PFlt_vVehMinMax_CA "Matrix zur Bestimmung der Bereichsgrenzen für die gefilterte Fahrgeschwindigkeit" MAP 0xE89FA Kf_Xs16_Ys16_Ws16 300.0000 Vel 0.00 300.0000 FORMAT "%8.4" EXTENDED_LIMITS -327.6800 327.6700
 /begin AXIS_DESCR STD_AXIS PFlt_RngIdx_X_mp OneToOne 11 0.00 10.00 FORMAT "%5.2" EXTENDED_LIMITS 0.00 255.0 DEPOSIT ABSOLUTE /end AXIS_DESCR
 /begin AXIS_DESCR STD_AXIS PFlt_RngIdx_Y_mp OneToOne 2 0.00 1.000 FORMAT "%5.3" EXTENDED_LIMITS 0.00 255.0 DEPOSIT ABSOLUTE /end AXIS_DESCR
/end CHARACTERISTIC
/begin CHARACTERISTIC PFlt_vVehUnFltMinMax_CA "Matrix (min/max Grenzen)für ungefilterte Fahrgeschwindigkeit" MAP 0xE8A44 Kf_Xs16_Ys16_Ws16 300.0000 Vel 0.00 300.0000 FORMAT "%8.4" EXTENDED_LIMITS -327.6800 327.6700
 /begin AXIS_DESCR STD_AXIS PFlt_RngIdxPrj_X_mp OneToOne 11 0.00 10.00 FORMAT "%5.2" EXTENDED_LIMITS 0.00 255.0 DEPOSIT ABSOLUTE /end AXIS_DESCR
 /begin AXIS_DESCR STD_AXIS PFlt_RngIdxPrj_Y_mp OneToOne 2 0.00 1.000 FORMAT "%5.3" EXTENDED_LIMITS 0.00 255.0 DEPOSIT ABSOLUTE /end AXIS_DESCR
/end CHARACTERISTIC
/begin MEASUREMENT PCV_iSet_mp "Sollstrom fuer das Druckregelventil" SWORD Curr 1 100 -32768.00 32767.00 FORMAT "%8.2" ECU_ADDRESS 0x8FF73C /end MEASUREMENT
/begin MEASUREMENT PCV_stActrCtl_mp "Zustand der Stellwertsteuerung fuer das Druckregelventil" UBYTE OneToOne 1 100 0.00 255.0 FORMAT "%5.1" ECU_ADDRESS 0x8FF73E /end MEASUREMENT
/begin MEASUREMENT PFltCD_pLinPre "linearisierter Analogwert, Absolutdrucksensor vor dem Partikelfilter" SWORD Pres 1 100 -32768.00 32767.00 FORMAT "%9.2" ECU_ADDRESS 0x7F8F76 /end MEASUREMENT
/begin MEASUREMENT PFltCD_pPre "Abgastemp. vor Partikelfilter" SWORD Pres 1 100 -32768.00 32767.00 FORMAT "%9.2" ECU_ADDRESS 0x7F8F78 /end MEASUREMENT
/begin MEASUREMENT PFltCD_tLinPre "Linearisierter Wert der Abgastemperatur vor dem Partikelfilter" SWORD Temp_Cels 1 100 -50.140 899.860 FORMAT "%8.3" ECU_ADDRESS 0x7F8F7A /end MEASUREMENT
/begin MEASUREMENT PFltCD_tPre "Abgastemp. vor Partikelfilter erster Sensor" SWORD Temp_Cels 1 100 -50.140 899.860 FORMAT "%8.3" ECU_ADDRESS 0x7F8F7C /end MEASUREMENT
/begin MEASUREMENT PFltCD_uRawPresPre_mp "Spannungsrohwert vom Absolutdrucksensor vor dem Partikelfilter" SWORD Volt 1 100 -160156.4 160151.5 FORMAT "%8.1" ECU_ADDRESS 0x6F81FE /end MEASUREMENT
/begin MEASUREMENT PFltCD_uRawTempPre "Spannungsrohwert der Abgastemperatur vor dem Partikelfilter" SWORD Volt 1 100 -160156.4 160151.5 FORMAT "%8.1" ECU_ADDRESS 0x7F8F80 /end MEASUREMENT
/begin MEASUREMENT PFlt_aVehFltAshCor_mp "gefilterter Wert Fahrzeugbeschleunigung" SWORD Acc 1 100 -32.76800 32.76700 FORMAT "%8.5" ECU_ADDRESS 0x8FF750 /end MEASUREMENT
/begin MEASUREMENT PFlt_ctEngPrtRgn_mp "engine protection regeneration counter" UWORD OneToOne 1 100 0.00 65535.00 FORMAT "%8.2" ECU_ADDRESS 0x6F81F6 /end MEASUREMENT
/begin MEASUREMENT PFlt_ctNumAshCorMax_mp "aktueller Zählerwert des Maximumzählers für AshCor Regeneration" UWORD OneToOne 1 100 0.00 65535.00 FORMAT "%8.2" ECU_ADDRESS 0x6F81C2 /end MEASUREMENT
/begin MEASUREMENT PFlt_ctNumAshCor_mp "aktueller Zählerwert für erfolgreiche Regeneration" UWORD OneToOne 1 100 0.00 65535.00 FORMAT "%8.2" ECU_ADDRESS 0x6F81C4 /end MEASUREMENT
/begin MEASUREMENT PFlt_ddvolFlt_mp "Änderung Abgasvolumenstrom" SWORD CubMtrPerHrPerSec 1 100 -3276.800 3276.700 FORMAT "%8.3" ECU_ADDRESS 0x8FF84C /end MEASUREMENT
/begin MEASUREMENT PFlt_dmEG "Abgasmassenstrom" SWORD AirMassPerTime 1 100 -3276.800 3276.700 FORMAT "%8.3" ECU_ADDRESS 0x7F8F82 /end MEASUREMENT
/begin MEASUREMENT PFlt_dmNO2Tot_mp "insgesamt zur Verfügung stehender NO2-Massenstrom" SWORD dmSoot_mg_p_s 1 100 -327.6800 327.6700 FORMAT "%8.4" ECU_ADDRESS 0x8FF7FC /end MEASUREMENT
/begin MEASUREMENT PFlt_dmNOxRaw_mp "simulierte NOx-Basisemission" SWORD dmSoot_mg_p_s 1 100 -327.6800 327.6700 FORMAT "%8.4" ECU_ADDRESS 0x8FF7FE /end MEASUREMENT
/begin MEASUREMENT PFlt_dmO2Aprx "geschätzter Sauerstoffmassenstrom vor dem Partikelfilter" SWORD AirMassPerTime 1 100 -3276.800 3276.700 FORMAT "%8.3" ECU_ADDRESS 0x7F8F84 /end MEASUREMENT
/begin MEASUREMENT PFlt_dmSotSimDyn_mp "Dynamischer Anteil für produzierte Rußmasse = f(dq)" SWORD dmSoot_mg_p_s 1 100 -327.6800 327.6700 FORMAT "%8.4" ECU_ADDRESS 0x8FF800 /end MEASUREMENT
/begin MEASUREMENT PFlt_dmSotSimEmi_mp "generierte Partikelmasse" SWORD dmSoot_mg_p_s 1 100 -327.6800 327.6700 FORMAT "%8.4" ECU_ADDRESS 0x6F81E8 /end MEASUREMENT
/begin MEASUREMENT PFlt_dmSotSimRgnCRT_mp "abgebauter Partikelmassenstrom in Simulation durch CRT" SWORD dmSoot_mg_p_s 1 100 -327.6800 327.6700 FORMAT "%8.4" ECU_ADDRESS 0x6F81EA /end MEASUREMENT
/begin MEASUREMENT PFlt_dmSotSimRgnThr_mp "abgebauter Partikelmassenstrom in Simulation durch thermische Regeneration" SWORD dmSoot_mg_p_s 1 100 -327.6800 327.6700 FORMAT "%8.4" ECU_ADDRESS 0x6F81EC /end MEASUREMENT
/begin MEASUREMENT PFlt_dmSotSimRgn_mp "regenerierte Partikelmasse" SWORD dmSoot_mg_p_s 1 100 -327.6800 327.6700 FORMAT "%8.4" ECU_ADDRESS 0x6F81EE /end MEASUREMENT
/begin MEASUREMENT PFlt_dmSotSimSty_mp "stationärer Partikelmassenstrom in Simulation" SWORD dmSoot_mg_p_s 1 100 -327.6800 327.6700 FORMAT "%8.4" ECU_ADDRESS 0x8FF802 /end MEASUREMENT
/begin MEASUREMENT PFlt_dmSotSim_mp "gesamt produzierte Partikelmasse" SWORD dmSoot_mg_p_s 1 100 -327.6800 327.6700 FORMAT "%8.4" ECU_ADDRESS 0x8FF804 /end MEASUREMENT
/begin MEASUREMENT PFlt_dpDiffFlt_mp "Änderung Druckdifferenz" SWORD hPaPerSec 1 100 -3276.800 3276.700 FORMAT "%8.3" ECU_ADDRESS 0x8FF84E /end MEASUREMENT
/begin MEASUREMENT PFlt_dpDiffNegDef_mp "Untere Schwelle Änderung Differenzdrucksignal" SWORD hPaPerSec 1 100 -3276.800 3276.700 FORMAT "%8.3" ECU_ADDRESS 0x8FF850 /end MEASUREMENT
/begin MEASUREMENT PFlt_dpDiffPosDef_mp "Obere Schwelle Änderung Differenzdrucksignal" SWORD hPaPerSec 1 100 -3276.800 3276.700 FORMAT "%8.3" ECU_ADDRESS 0x8FF852 /end MEASUREMENT
/begin MEASUREMENT PFlt_dpDiff_mp "PFlt_pDiff DT1 gefiltert" SWORD Pres_hPa 1 100 -32768.00 32767.00 FORMAT "%8.2" ECU_ADDRESS 0x8FF806 /end MEASUREMENT
/begin MEASUREMENT PFlt_dqFlTotAct_mp "" SWORD Fl_2 1 100 -327680.0 327670.0 FORMAT "%8.1" ECU_ADDRESS 0x8FF752 /end MEASUREMENT
/begin MEASUREMENT PFlt_dqFlTotEnd_mp "" SWORD Fl_2 1 100 -327680.0 327670.0 FORMAT "%8.1" ECU_ADDRESS 0x8FF754 /end MEASUREMENT
/begin MEASUREMENT PFlt_dqSetUnBal_mp "DT1-gefilterte Einspritzmasse" SWORD InjMass 1 100 -327.6800 327.6700 FORMAT "%8.4" ECU_ADDRESS 0x8FF808 /end MEASUREMENT
/begin MEASUREMENT PFlt_dvol "berechneter Abgasvolumenstrom im Partikelfilter" SWORD CubMtrPerHr 1 100 -3276.800 3276.700 FORMAT "%8.3" ECU_ADDRESS 0x7F8F86 /end MEASUREMENT
/begin MEASUREMENT PFlt_dVolFltAshCorRaw_mp "dVol-Rohwert" SWORD CubMtrPerHr 1 100 -3276.800 3276.700 FORMAT "%8.3" ECU_ADDRESS 0x8FF756 /end MEASUREMENT
/begin MEASUREMENT PFlt_dVolFltAshCor_mp "PT1-gefilterter Wert für PFlt_dvol" SWORD CubMtrPerHr 1 100 -3276.800 3276.700 FORMAT "%8.3" ECU_ADDRESS 0x8FF758 /end MEASUREMENT
/begin MEASUREMENT PFlt_dvolFlt_mp "gefilterter Abgasvolumenstrom" SWORD CubMtrPerHr 1 100 -3276.800 3276.700 FORMAT "%8.3" ECU_ADDRESS 0x8FF854 /end MEASUREMENT
/begin MEASUREMENT PFlt_dvolMassFlt_mp "gefillterter Abgasvolumenstrom" SWORD CubMtrPerHr 1 100 -3276.800 3276.700 FORMAT "%8.3" ECU_ADDRESS 0x8FF80A /end MEASUREMENT
/begin MEASUREMENT PFlt_facAshCorDiff_mp "" SWORD Fact 1 100 -4.000000 3.999878 FORMAT "%8.6" ECU_ADDRESS 0x8FF75A /end MEASUREMENT
/begin MEASUREMENT PFlt_facDesCor_mp "Mass Ratio after correction" SWORD Fact 1 100 -4.000000 3.999878 FORMAT "%8.6" ECU_ADDRESS 0x8FF80C /end MEASUREMENT
/begin MEASUREMENT PFlt_facDpn_mp "Wärmeverlustfaktor nach Temperatursensor" SWORD Fact 1 100 -4.000000 3.999878 FORMAT "%8.6" ECU_ADDRESS 0x8FF870 /end MEASUREMENT
/begin MEASUREMENT PFlt_facMltCor_mp "Korrekturfaktor Additivasche" SWORD Fact 1 100 -4.000000 3.999878 FORMAT "%8.6" ECU_ADDRESS 0x6F81F0 /end MEASUREMENT
/begin MEASUREMENT PFlt_lAshCorAct_mp "Zwischenwert Kilometerstand" UWORD LengthKm 1 100 0.00 65535.00 FORMAT "%8.2" ECU_ADDRESS 0x8FF75C /end MEASUREMENT
/begin MEASUREMENT PFlt_lAshCorNext "Kilometer für die nächste(folgende) Abgleichung" ULONG LengthKm 1 100 0.00 4294967295.00 FORMAT "%13.2" ECU_ADDRESS 0x7F91A8 /end MEASUREMENT
/begin MEASUREMENT PFlt_lAshCorNextEEProm_mp "nächster Kilometerstand für Ascheabgelichregeneration, gelesen vom EEPROM bei Motorstart" ULONG LengthKm 1 100 0.00 4294967295.00 FORMAT "%13.2" ECU_ADDRESS 0x8FF760 /end MEASUREMENT
/begin MEASUREMENT PFlt_lAshCorNextMax_mp "Messender Punkt für folgende maximale Aschenkorrektur" ULONG LengthKm 1 100 0.00 4294967295.00 FORMAT "%13.2" ECU_ADDRESS 0x8FF764 /end MEASUREMENT
/begin MEASUREMENT PFlt_lAshCorNextOilCor_mp "Messender Punkt für folgendes maximales Aschen ölen Korrektur." ULONG LengthKm 1 100 0.00 4294967295.00 FORMAT "%13.2" ECU_ADDRESS 0x8FF768 /end MEASUREMENT
/begin MEASUREMENT PFlt_lAshCorOldCalc_mp "Messender Punkt für alten Aschenkorrekturwert." ULONG LengthKm 1 100 0.00 4294967295.00 FORMAT "%13.2" ECU_ADDRESS 0x8FF76C /end MEASUREMENT
/begin MEASUREMENT PFlt_lAshCorStep_mp "Schrittgröße für Aschenkorrektur." UWORD LengthKm 1 100 0.00 65535.00 FORMAT "%8.2" ECU_ADDRESS 0x8FF770 /end MEASUREMENT
/begin MEASUREMENT PFlt_lSnceRgn "driven distance after regeneration" ULONG Length 1 100 0.00 4294967295.00 FORMAT "%13.2" ECU_ADDRESS 0x7F91AC /end MEASUREMENT
/begin MEASUREMENT PFlt_lSnceRgnu16_mp "Driven distance since last successful regeneration with reduced resolution" UWORD lSnceRgnRes 1 100 0.00 8388480. FORMAT "%8.0" ECU_ADDRESS 0x6F81CC /end MEASUREMENT
/begin MEASUREMENT PFlt_lSnceRgn_mp "gefahrene Strecke seit letzter erfolgreicher Regeneration" ULONG Length 1 100 0.00 4294967295.00 FORMAT "%13.2" ECU_ADDRESS 0x8FF794 /end MEASUREMENT
/begin MEASUREMENT PFlt_lSumu16_mp "Total driven distance with reduced resolution" UWORD lSumRes 1 100 0.00 1073725440. ECU_ADDRESS 0x6F81CE /end MEASUREMENT
/begin MEASUREMENT PFlt_lSum_mp "ges. gefahrene Strecke bei der letzten erfolgr. Regeneration" ULONG Length 1 100 0.00 4294967295.00 FORMAT "%13.2" ECU_ADDRESS 0x6F81D0 /end MEASUREMENT
/begin MEASUREMENT PFlt_mAshAdi_mp "Additivaschenmasse" SWORD mSoot_g 1 100 -327.6800 327.6700 FORMAT "%8.4" ECU_ADDRESS 0x8FF80E /end MEASUREMENT
/begin MEASUREMENT PFlt_mAshCorAct "tatsächliche Aschenmenge" SWORD mSoot_g 1 100 -327.6800 327.6700 FORMAT "%8.4" ECU_ADDRESS 0x7F8F88 /end MEASUREMENT
/begin MEASUREMENT PFlt_mAshCorActRel_mp "aktuell relative Abweichung der neu berechneten Aschemenge" SWORD mSoot_g 1 100 -327.6800 327.6700 FORMAT "%8.4" ECU_ADDRESS 0x8FF772 /end MEASUREMENT
/begin MEASUREMENT PFlt_mAshCorDiff1_mp "Absolutbetrag von PFlt_mAshCorDiff_mp, relative Aschemengeabweichung" SWORD mSoot_g 1 100 -327.6800 327.6700 FORMAT "%8.4" ECU_ADDRESS 0x8FF774 /end MEASUREMENT
/begin MEASUREMENT PFlt_mAshCorDiff2_mp "" SWORD mSoot_g 1 100 -327.6800 327.6700 FORMAT "%8.4" ECU_ADDRESS 0x8FF776 /end MEASUREMENT
/begin MEASUREMENT PFlt_mAshCorDiff_mp "output of PFlt_mAshCor_MAP, Abweichung vom Aschemengesollwert" SWORD mSoot_g 1 100 -327.6800 327.6700 FORMAT "%8.4" ECU_ADDRESS 0x6F81C6 /end MEASUREMENT
/begin MEASUREMENT PFlt_mAshCorNew "Wird nur berechnet, wenn PFlt_mAshCorAct einen plausiblen Wert besitzt" SWORD mSoot_g 1 100 -327.6800 327.6700 FORMAT "%8.4" ECU_ADDRESS 0x7F8F8A /end MEASUREMENT
/begin MEASUREMENT PFlt_mAshCorOld "Aschekorrekturwert vom vorherigen Zyklus" SWORD mSoot_g 1 100 -327.6800 327.6700 FORMAT "%8.4" ECU_ADDRESS 0x7F8F8C /end MEASUREMENT
/begin MEASUREMENT PFlt_mAshOil "particle filter Oil ash mass" SWORD mSoot_g 1 100 -327.6800 327.6700 FORMAT "%8.4" ECU_ADDRESS 0x7F8F8E /end MEASUREMENT
/begin MEASUREMENT PFlt_mAshOilNorm "" SWORD mSoot_g 1 100 -327.6800 327.6700 FORMAT "%8.4" ECU_ADDRESS 0x7F8F90 /end MEASUREMENT
/begin MEASUREMENT PFlt_mAsh_mp "Aschen-Masse" SWORD mSoot_g 1 100 -327.6800 327.6700 FORMAT "%8.4" ECU_ADDRESS 0x8FF810 /end MEASUREMENT
/begin MEASUREMENT PFlt_mSot "Rußmasse im Partikelfilter" SWORD mSoot_g 1 100 -327.6800 327.6700 FORMAT "%8.4" ECU_ADDRESS 0x7F8F92 /end MEASUREMENT
/begin MEASUREMENT PFlt_mSotCrv_mp "Partikelmasse zur Berücksichtung des Korrekturfaktors" SWORD mSoot_g 1 100 -327.6800 327.6700 FORMAT "%8.4" ECU_ADDRESS 0x8FF812 /end MEASUREMENT
/begin MEASUREMENT PFlt_mSotEEPROM_mp "EEPROM wert für in DPF gespeicherte Partikelmasse" SWORD mSoot_g 1 100 -327.6800 327.6700 FORMAT "%8.4" ECU_ADDRESS 0x8FF814 /end MEASUREMENT
/begin MEASUREMENT PFlt_mSotMeas "uncorrected soot mass of physical model" SWORD mSoot_g 1 100 -327.6800 327.6700 FORMAT "%8.4" ECU_ADDRESS 0x7F8F94 /end MEASUREMENT
/begin MEASUREMENT PFlt_mSotMeasRaw_mp "Strömungswdst. in Partikelmasse umgerechnet" SWORD mSoot_g 1 100 -327.6800 327.6700 FORMAT "%8.4" ECU_ADDRESS 0x6F81F2 /end MEASUREMENT
/begin MEASUREMENT PFlt_mSotOfs_mp "Korrekturwert äquivalenter Massenoffset" SWORD mSoot_g 1 100 -327.6800 327.6700 FORMAT "%8.4" ECU_ADDRESS 0x8FF798 /end MEASUREMENT
/begin MEASUREMENT PFlt_mSotSim "Simulierte Rußmasse im Partikel Filter" SWORD mSoot_g 1 100 -327.6800 327.6700 FORMAT "%8.4" ECU_ADDRESS 0x7F8F96 /end MEASUREMENT
/begin MEASUREMENT PFlt_nAvrgFltAshCor_mp "gefilterter Wert Drehzahl" SWORD EngN 1 100 -32768.00 32767.00 FORMAT "%8.2" ECU_ADDRESS 0x8FF778 /end MEASUREMENT
/begin MEASUREMENT PFlt_nAvrgFlt_mp "Eng_nAvrg PT1 gefiltert" SWORD EngN 1 100 -32768.00 32767.00 FORMAT "%8.2" ECU_ADDRESS 0x8FF7BE /end MEASUREMENT
/begin MEASUREMENT PFlt_nDiagLowIdle "Leerlaufdrehzahl im Regenerationszustand" SWORD EngN 1 100 -32768.00 32767.00 FORMAT "%8.2" ECU_ADDRESS 0x7F8F98 /end MEASUREMENT
/begin MEASUREMENT PFlt_numEngPOp "Regeneration number after consideration of the engine operating state" UBYTE OneToOne 1 100 0.00 255.0 FORMAT "%5.1" ECU_ADDRESS 0x7F8962 /end MEASUREMENT
/begin MEASUREMENT PFlt_numLst_mp "Regenerationsanforderung aufgrund verbr. Treibstoff, Betriebszeit oder Strecke" UBYTE OneToOne 1 100 0.00 255.0 FORMAT "%5.1" ECU_ADDRESS 0x8FF79A /end MEASUREMENT
/begin MEASUREMENT PFlt_numPrio "Priorität für angeforderten Regenerationszustand" UWORD OneToOne 1 100 0.00 65535.00 FORMAT "%8.2" ECU_ADDRESS 0x7F8F9A /end MEASUREMENT
/begin MEASUREMENT PFlt_numPrj "Regeneration demand number" UBYTE OneToOne 1 100 0.00 255.0 FORMAT "%5.1" ECU_ADDRESS 0x7F8963 /end MEASUREMENT
/begin MEASUREMENT PFlt_numPrt_mp "Regenerationsanforderung aufgrund Motorschutz" UBYTE OneToOne 1 100 0.00 255.0 FORMAT "%5.1" ECU_ADDRESS 0x8FF79B /end MEASUREMENT
/begin MEASUREMENT PFlt_numRgn_mp "gesamte Regenerationsanforderung" UBYTE OneToOne 1 100 0.00 255.0 FORMAT "%5.1" ECU_ADDRESS 0x6F81D4 /end MEASUREMENT
/begin MEASUREMENT PFlt_numSot_mp "Beladungszustand des DPF" UBYTE OneToOne 1 100 0.00 255.0 FORMAT "%5.1" ECU_ADDRESS 0x8FF79C /end MEASUREMENT
/begin MEASUREMENT PFlt_numTot_mp "Regeneationsmaßnahme nach Berücksichtigung des Motorbetriebspunktes" UBYTE OneToOne 1 100 0.00 255.0 FORMAT "%5.1" ECU_ADDRESS 0x8FF79D /end MEASUREMENT
/begin MEASUREMENT PFlt_pAPSBPSDiff_mp "absoluter Wertunterschied zwischen APSCD_pVal und BPSCD_pLin" SWORD Pres_hPa 1 100 -32768.00 32767.00 FORMAT "%8.2" ECU_ADDRESS 0x8FF820 /end MEASUREMENT
/begin MEASUREMENT PFlt_pAPSDvt_mp "Abweichung von APSCD_pVal bezüglich Mittelwert von BPSCD_pLin und korrigiertem PFlt_pPre" SWORD Pres_hPa 1 100 -32768.00 32767.00 FORMAT "%8.2" ECU_ADDRESS 0x8FF822 /end MEASUREMENT
/begin MEASUREMENT PFlt_pAPSPFltPresDiff_mp "absoluter Wertunterschied zwischen APSCD_pVal und korrigiertem PFlt_pPre" SWORD Pres_hPa 1 100 -32768.00 32767.00 FORMAT "%8.2" ECU_ADDRESS 0x8FF824 /end MEASUREMENT
/begin MEASUREMENT PFlt_pBPSDvt_mp "Abweichung von BPSCD_pLin bezüglich Mittelwert von APSCD_pVal und korrigiertem PFlt_pPre" SWORD Pres_hPa 1 100 -32768.00 32767.00 FORMAT "%8.2" ECU_ADDRESS 0x8FF826 /end MEASUREMENT
/begin MEASUREMENT PFlt_pBPSPFltPresDiff_mp "absoluter Wertunterschied zwischen BPSCD_pLin und korrigiertem PFlt_pPre" SWORD Pres_hPa 1 100 -32768.00 32767.00 FORMAT "%8.2" ECU_ADDRESS 0x8FF828 /end MEASUREMENT
/begin MEASUREMENT PFlt_pDiff "Differenzdruck über Partikelfilter" SWORD Pres_hPa 1 100 -32768.00 32767.00 FORMAT "%8.2" ECU_ADDRESS 0x7F8F9C /end MEASUREMENT
/begin MEASUREMENT PFlt_pDiffDfl_mp "Ersatzwert für PFlt_pDiff" SWORD Pres_hPa 1 100 -32768.00 32767.00 FORMAT "%8.2" ECU_ADDRESS 0x8FF86E /end MEASUREMENT
/begin MEASUREMENT PFlt_pDiffFlt_mp "gefilterte Druckdifferenz über Partikelfilter" SWORD Pres_hPa 1 100 -32768.00 32767.00 FORMAT "%8.2" ECU_ADDRESS 0x8FF856 /end MEASUREMENT
/begin MEASUREMENT PFlt_pDiffOfsValActMid_mp "Im Nachlauf gemittelter offset des Differenzdrucks[hpa]" SWORD Pres_hPa 1 100 -32768.00 32767.00 FORMAT "%8.2" ECU_ADDRESS 0x8FF858 /end MEASUREMENT
/begin MEASUREMENT PFlt_pDiffOfsValAct_mp "Aktueller Offset des Differenzdrucks über Partikelfilter" SWORD Pres_hPa 1 100 -32768.00 32767.00 FORMAT "%8.2" ECU_ADDRESS 0x8FF85A /end MEASUREMENT
/begin MEASUREMENT PFlt_pDiffOfsValOld_mp "Bisheriger Offset des Differenzdrucks über Partikelfilter" SWORD Pres_hPa 1 100 -32768.00 32767.00 FORMAT "%8.2" ECU_ADDRESS 0x8FF85C /end MEASUREMENT
/begin MEASUREMENT PFlt_pDiffRaw "Unkorrigierter Differenzdruck über Partikelfilter" SWORD Pres_hPa 1 100 -32768.00 32767.00 FORMAT "%8.2" ECU_ADDRESS 0x7F8F9E /end MEASUREMENT
/begin MEASUREMENT PFlt_pEngPrtMax_mp "Maximaldruck Motorschutz" SWORD Pres_hPa 1 100 -32768.00 32767.00 FORMAT "%8.2" ECU_ADDRESS 0x6F81D6 /end MEASUREMENT
/begin MEASUREMENT PFlt_pEngPrtMin_mp "Minimaldruck Motorschutz" SWORD Pres_hPa 1 100 -32768.00 32767.00 FORMAT "%8.2" ECU_ADDRESS 0x8FF79E /end MEASUREMENT
/begin MEASUREMENT PFlt_pMid "Absolutdruck im Partikelfilter" SWORD Pres_hPa 1 100 -32768.00 32767.00 FORMAT "%8.2" ECU_ADDRESS 0x7F8FA0 /end MEASUREMENT
/begin MEASUREMENT PFlt_pPFltPresDvt_mp "Abweichung des korrigierten PFlt_pPre bezüglich Mittelwert von APSCD_pVal und BPSCD_pLin" SWORD Pres_hPa 1 100 -32768.00 32767.00 FORMAT "%8.2" ECU_ADDRESS 0x8FF82A /end MEASUREMENT
/begin MEASUREMENT PFlt_pPre "Druck vor Partikelfilter" SWORD Pres_hPa 1 100 -32768.00 32767.00 FORMAT "%8.2" ECU_ADDRESS 0x7F8FA2 /end MEASUREMENT
/begin MEASUREMENT PFlt_pPreAshOilCorr_mp "Ausgang des PFlt_pPre-Korrekturkennfelds mit den Eingängen PFlt_dvol und PFlt_mAshOil" SWORD Pres_hPa 1 100 -32768.00 32767.00 FORMAT "%8.2" ECU_ADDRESS 0x8FF82C /end MEASUREMENT
/begin MEASUREMENT PFlt_pPreCorr_mp "korrigierter Wert von PFlt_pPre zur Nutzung durch projektspezifische Druck-Plausibilitätsprüfungen" SWORD Pres_hPa 1 100 -32768.00 32767.00 FORMAT "%8.2" ECU_ADDRESS 0x6F81F8 /end MEASUREMENT
/begin MEASUREMENT PFlt_pPreFlt "gefilterter Absolutdruck vor Partikelfilter" SWORD Pres_hPa 1 100 -32768.00 32767.00 FORMAT "%8.2" ECU_ADDRESS 0x7F8FA4 /end MEASUREMENT
/begin MEASUREMENT PFlt_pPreSotAshCorrSum_mp "Summe aus PFlt_pPreSotSimCorr_mp und  PFlt_pPreAshOilCorr_mp" SWORD Pres_hPa 1 100 -32768.00 32767.00 FORMAT "%8.2" ECU_ADDRESS 0x8FF82E /end MEASUREMENT
/begin MEASUREMENT PFlt_pPreSotSimCorr_mp "Ausgang des PFlt_pPre Korrekturkennfelds mit den Eingängen PFlt_dvol und PFlt_mSotSim" SWORD Pres_hPa 1 100 -32768.00 32767.00 FORMAT "%8.2" ECU_ADDRESS 0x8FF830 /end MEASUREMENT
/begin MEASUREMENT PFlt_pPreVolCorr_mp "Ausgang der PFlt_pPre Korrekturkennlinie mit den Eingängen PFlt_dvol und PFlt_dvol" SWORD Pres_hPa 1 100 -32768.00 32767.00 FORMAT "%8.2" ECU_ADDRESS 0x8FF832 /end MEASUREMENT
/begin MEASUREMENT PFlt_qFlTot "nach der letzten Filterreinigung verbrauchte gesamte Krafstoffmenge" SWORD Fl_2 1 100 -327680.0 327670.0 FORMAT "%8.1" ECU_ADDRESS 0x7F8FA6 /end MEASUREMENT
/begin MEASUREMENT PFlt_qFlTotCor "Gesamtmenge Kraftstoffquantitätskorrektur" SWORD Fl_2 1 100 -327680.0 327670.0 FORMAT "%8.1" ECU_ADDRESS 0x7F8FA8 /end MEASUREMENT
/begin MEASUREMENT PFlt_qFlTotEEPROM_mp "in EEPROM abgespeicherter Wert des Gesamtkraftstoffverbrauches für das DPF" SLONG Fl_L 1 100 -21474836.4800 21474836.4700 FORMAT "%13.4" ECU_ADDRESS 0x8FF7A0 /end MEASUREMENT
/begin MEASUREMENT PFlt_qFl_mp "verbrauchter Treibstoff seit der letzten erfolgreichen Regeneration" SWORD Fl_L 1 100 -327.6800 327.6700 FORMAT "%8.4" ECU_ADDRESS 0x6F81D8 /end MEASUREMENT
/begin MEASUREMENT PFlt_qPoI1Des_mp "Gewünschte Einspritzmenge für Nacheinspritzung 1" SWORD InjMassInj 1 100 -327.6800 327.6700 FORMAT "%8.4" ECU_ADDRESS 0x8FF872 /end MEASUREMENT
/begin MEASUREMENT PFlt_qPoI2NonEff "Nicht effektive PoI2-Einspritzmenge mg/zycl" SWORD InjMassCyc 1 100 -327.6800 327.6700 FORMAT "%8.4" ECU_ADDRESS 0x7F8FAA /end MEASUREMENT
/begin MEASUREMENT PFlt_qSetUnBalFltAshCor_mp "gefilterter Wert Einspritzmasse" SWORD InjMassCyc 1 100 -327.6800 327.6700 FORMAT "%8.4" ECU_ADDRESS 0x8FF77A /end MEASUREMENT
/begin MEASUREMENT PFlt_qSetUnBalFlt_mp "gefilterter Wert der Einspritzmenge" SWORD InjMass 1 100 -327.6800 327.6700 FORMAT "%8.4" ECU_ADDRESS 0x8FF7C0 /end MEASUREMENT
/begin MEASUREMENT PFlt_rAccPedFlt_mp "gefiltertes Pedalwertgebersignal" SWORD Prc 1 100 -400.0000 399.9878 FORMAT "%8.4" ECU_ADDRESS 0x8FF7C2 /end MEASUREMENT
/begin MEASUREMENT PFlt_rEngPrtRgn_mp "engine protection regeneration ratio of task time and last regeneration time" SWORD Prc 1 100 -400.0000 399.9878 FORMAT "%8.4" ECU_ADDRESS 0x6F81FA /end MEASUREMENT
/begin MEASUREMENT PFlt_resFlow "Strömungswiderstand" SWORD Res_hPaHrPerCM 1 100 -32.76800 32.76700 FORMAT "%8.5" ECU_ADDRESS 0x7F8FB0 /end MEASUREMENT
/begin MEASUREMENT PFlt_resFlowAdiOfs_mp "Strömungswiderstandoffset durch Additivasche" SWORD Res_hPaHrPerCM 1 100 -32.76800 32.76700 FORMAT "%8.5" ECU_ADDRESS 0x8FF816 /end MEASUREMENT
/begin MEASUREMENT PFlt_resFlowFlt "gefilterter Strömungswiderstand" SWORD Res_hPaHrPerCM 1 100 -32.76800 32.76700 FORMAT "%8.5" ECU_ADDRESS 0x7F8FB2 /end MEASUREMENT
/begin MEASUREMENT PFlt_resFlowFltAshCorRaw_mp "Resflow-Rohwert" SWORD Res_hPaHrPerCM 1 100 -32.76800 32.76700 FORMAT "%8.5" ECU_ADDRESS 0x8FF77C /end MEASUREMENT
/begin MEASUREMENT PFlt_resFlowFltAshCor_mp "PT1-gefilterter Wert für for PFlt_resFlow" SWORD Res_hPaHrPerCM 1 100 -32.76800 32.76700 FORMAT "%8.5" ECU_ADDRESS 0x8FF77E /end MEASUREMENT
/begin MEASUREMENT PFlt_resFlowOfs "Strömungswiderstandoffset" SWORD Res_hPaHrPerCM 1 100 -32.76800 32.76700 FORMAT "%8.5" ECU_ADDRESS 0x7F8FB4 /end MEASUREMENT
/begin MEASUREMENT PFlt_resFlowOilOfs_mp "Strömungswiderstandoffset durch Additivasche" SWORD Res_hPaHrPerCM 1 100 -32.76800 32.76700 FORMAT "%8.5" ECU_ADDRESS 0x8FF818 /end MEASUREMENT
/begin MEASUREMENT PFlt_resFlowRaw_mp "Strömungswiderstand Rohwert" SWORD Res_hPaHrPerCM 1 100 -32.76800 32.76700 FORMAT "%8.5" ECU_ADDRESS 0x6F81F4 /end MEASUREMENT
/begin MEASUREMENT PFlt_resSotMeasCrv_mp "versteckter Messpunkt, nur für aus Codierungsgründen" SWORD Res_hPaHrPerCM 1 100 -32.76800 32.76700 FORMAT "%8.5" ECU_ADDRESS 0x8FF7A4 /end MEASUREMENT
/begin MEASUREMENT PFlt_rLmbd "Lambdawert" SWORD lambda 1 100 -32.76800 32.76700 FORMAT "%8.5" ECU_ADDRESS 0x7F8FAC /end MEASUREMENT
/begin MEASUREMENT PFlt_rLmbdAprx_mp "Lambda berechnet aus q_inj und dm_air" SWORD lambda 1 100 -32.76800 32.76700 FORMAT "%8.5" ECU_ADDRESS 0x8FF7FA /end MEASUREMENT
/begin MEASUREMENT PFlt_RngIdxPrj_X_mp "Input to matrix to determine range limits for the filtered vehicle speed" UBYTE OneToOne 1 100 0.00 255.0 FORMAT "%5.1" ECU_ADDRESS 0x8FF7F4 /end MEASUREMENT
/begin MEASUREMENT PFlt_RngIdxPrj_Y_mp "Input to matrix to determine range limits for the filtered vehicle speed" UBYTE OneToOne 1 100 0.00 255.0 FORMAT "%5.1" ECU_ADDRESS 0x8FF7F5 /end MEASUREMENT
/begin MEASUREMENT PFlt_RngIdx_X_mp "Range Index for coloumn nos of matrices" UBYTE OneToOne 1 100 0.00 255.0 FORMAT "%5.1" ECU_ADDRESS 0x8FF7C4 /end MEASUREMENT
/begin MEASUREMENT PFlt_RngIdx_Y_mp "Range Index for row nos of matrices" UBYTE OneToOne 1 100 0.00 255.0 FORMAT "%5.1" ECU_ADDRESS 0x8FF7C5 /end MEASUREMENT
/begin MEASUREMENT PFlt_rSot "Asschemasse im Filter pro Filtervolumen" SWORD Soot_gPerLtr 1 100 -327.6800 327.6700 FORMAT "%8.4" ECU_ADDRESS 0x7F8FAE /end MEASUREMENT
/begin MEASUREMENT PFlt_st "von Partikelfilter angeforderter Regenerationsstatus" ULONG OneToOne 1 100 0.00 4294967295.00 FORMAT "%13.2" ECU_ADDRESS 0x7F91B0 /end MEASUREMENT
/begin MEASUREMENT PFlt_st1_mp "Status des Partikelfilters  LowByte (->Signals)" UWORD OneToOne 1 100 0.00 65535.00 FORMAT "%8.2" ECU_ADDRESS 0x6F81DA /end MEASUREMENT
/begin MEASUREMENT PFlt_st2_mp "Status des Partikelfilters  HighByte (->Signals)" UWORD OneToOne 1 100 0.00 65535.00 FORMAT "%8.2" ECU_ADDRESS 0x6F81DC /end MEASUREMENT
/begin MEASUREMENT PFlt_stAftRunDelDem "Nachlaufverzögerung für Partikelfiltermonitor" UBYTE OneToOne 1 100 0.00 255.0 FORMAT "%5.1" ECU_ADDRESS 0x7F8964 /end MEASUREMENT
/begin MEASUREMENT PFlt_stAPSPlausDefHigh_mp "APSCD_pVal Abweichung ist positiv und fehlerhaft" UBYTE OneToOne 1 100 0.00 255.0 FORMAT "%5.1" ECU_ADDRESS 0x8FF834 /end MEASUREMENT
/begin MEASUREMENT PFlt_stAPSPlausDefLow_mp "APSCD_pVal Abweichung ist negativ und fehlerhaft" UBYTE OneToOne 1 100 0.00 255.0 FORMAT "%5.1" ECU_ADDRESS 0x8FF835 /end MEASUREMENT
/begin MEASUREMENT PFlt_stAshCorCalc_mp "Berechnungsstatus Aschekorrektur" UBYTE OneToOne 1 100 0.00 255.0 FORMAT "%5.1" ECU_ADDRESS 0x8FF780 /end MEASUREMENT
/begin MEASUREMENT PFlt_stAshCorDist_mp "Status Ashekorrekturdistanz" UBYTE OneToOne 1 100 0.00 255.0 FORMAT "%5.1" ECU_ADDRESS 0x8FF781 /end MEASUREMENT
/begin MEASUREMENT PFlt_stAshCorRgnMax "Maximumzähler für AshCor Regeneration abgelaufen, keine gültige Regeneration stattgefunden" UBYTE OneToOne 1 100 0.00 255.0 FORMAT "%5.1" ECU_ADDRESS 0x7F8965 /end MEASUREMENT
/begin MEASUREMENT PFlt_stAshCorRgn_mp "bitweise Aufschlüsselung der aktuellen Regenerationsanforderung" UBYTE OneToOne 1 100 0.00 255.0 FORMAT "%5.1" ECU_ADDRESS 0x8FF782 /end MEASUREMENT
/begin MEASUREMENT PFlt_stAshCorRlsOn_mp "Status Aschekorrektur-Freigabe am" UBYTE OneToOne 1 100 0.00 255.0 FORMAT "%5.1" ECU_ADDRESS 0x8FF783 /end MEASUREMENT
/begin MEASUREMENT PFlt_stAshCorRls_mp "Status Aschekorrektur-Freigabe" UBYTE OneToOne 1 100 0.00 255.0 FORMAT "%5.1" ECU_ADDRESS 0x8FF784 /end MEASUREMENT
/begin MEASUREMENT PFlt_stAshCor_mp "Status Aschekorrektur" UBYTE OneToOne 1 100 0.00 255.0 FORMAT "%5.1" ECU_ADDRESS 0x8FF785 /end MEASUREMENT
/begin MEASUREMENT PFlt_stBPSPlausDefHigh_mp "BPSCD_pLin Abweichung ist positiv und fehlerhaft" UBYTE OneToOne 1 100 0.00 255.0 FORMAT "%5.1" ECU_ADDRESS 0x8FF836 /end MEASUREMENT
/begin MEASUREMENT PFlt_stBPSPlausDefLow_mp "BPSCD_pLin Abweichung ist negativ und fehlerhaft" UBYTE OneToOne 1 100 0.00 255.0 FORMAT "%5.1" ECU_ADDRESS 0x8FF837 /end MEASUREMENT
/begin MEASUREMENT PFlt_stBrkDeb_mp "Entprelltes Bremssignal" UBYTE OneToOne 1 100 0.00 255.0 FORMAT "%5.1" ECU_ADDRESS 0x8FF7C6 /end MEASUREMENT
/begin MEASUREMENT PFlt_stClthDeb_mp "Entprelltes Kupplungssignal" UBYTE OneToOne 1 100 0.00 255.0 FORMAT "%5.1" ECU_ADDRESS 0x8FF7C7 /end MEASUREMENT
/begin MEASUREMENT PFlt_stCnt_mp "Statuswort für  Regnerationsanf. nach Kraftstoffverbrauch, Betriebsstunden oder gefahrener Strecke" UBYTE OneToOne 1 100 0.00 255.0 FORMAT "%5.1" ECU_ADDRESS 0x8FF7A6 /end MEASUREMENT
/begin MEASUREMENT PFlt_stDiag "status of particulate filter" ULONG OneToOne 1 100 0.00 4294967295.00 FORMAT "%13.2" ECU_ADDRESS 0x7F91B4 /end MEASUREMENT
/begin MEASUREMENT PFlt_stDiagAbort "Bit-Information für Abbruchbedingungen" ULONG OneToOne 1 100 0.00 4294967295.00 FORMAT "%13.2" ECU_ADDRESS 0x7F91B8 /end MEASUREMENT
/begin MEASUREMENT PFlt_stDiagAbortMsk "gewünschte Bit-Information für Abbruchbedingungen" ULONG OneToOne 1 100 0.00 4294967295.00 FORMAT "%13.2" ECU_ADDRESS 0x7F91BC /end MEASUREMENT
/begin MEASUREMENT PFlt_stDiagAbrt1_mp "Trigger Abbruch 1" UBYTE OneToOne 1 100 0.00 255.0 FORMAT "%5.1" ECU_ADDRESS 0x8FF7B8 /end MEASUREMENT
/begin MEASUREMENT PFlt_stDiagAbrt2_mp "Trigger Abbruch 2" UBYTE OneToOne 1 100 0.00 255.0 FORMAT "%5.1" ECU_ADDRESS 0x8FF7B9 /end MEASUREMENT
/begin MEASUREMENT PFlt_stDiagCoolDwn_mp "Abkühltrigger" UBYTE OneToOne 1 100 0.00 255.0 FORMAT "%5.1" ECU_ADDRESS 0x8FF7BA /end MEASUREMENT
/begin MEASUREMENT PFlt_stDiagDemOn "Testeranforderung auf Diagnose" UBYTE OneToOne 1 100 0.00 255.0 FORMAT "%5.1" ECU_ADDRESS 0x7F8966 /end MEASUREMENT
/begin MEASUREMENT PFlt_stDiagEnd_mp "Trigger Regenerationsende" UBYTE OneToOne 1 100 0.00 255.0 FORMAT "%5.1" ECU_ADDRESS 0x8FF7BB /end MEASUREMENT
/begin MEASUREMENT PFlt_stDiagMsk "gewünschter Zustand der Freigabebedingungen" ULONG OneToOne 1 100 0.00 4294967295.00 FORMAT "%13.2" ECU_ADDRESS 0x7F91C0 /end MEASUREMENT
/begin MEASUREMENT PFlt_stDiagOn "Diagnosezustand EIN" UBYTE OneToOne 1 100 0.00 255.0 FORMAT "%5.1" ECU_ADDRESS 0x7F8967 /end MEASUREMENT
/begin MEASUREMENT PFlt_stDiagRgn "Zustand der Regenerationsbedingungen" ULONG OneToOne 1 100 0.00 4294967295.00 FORMAT "%13.2" ECU_ADDRESS 0x7F91C4 /end MEASUREMENT
/begin MEASUREMENT PFlt_stDiagRgnMsk "gewünschter Zustand der Regenerationsbedingungen" ULONG OneToOne 1 100 0.00 4294967295.00 FORMAT "%13.2" ECU_ADDRESS 0x7F91C8 /end MEASUREMENT
/begin MEASUREMENT PFlt_stDiagRgn_mp "Regenerationsstart-Trigger" UBYTE OneToOne 1 100 0.00 255.0 FORMAT "%5.1" ECU_ADDRESS 0x8FF7BC /end MEASUREMENT
/begin MEASUREMENT PFlt_stDiagRls "Zustand der Freigabebedingungen" ULONG OneToOne 1 100 0.00 4294967295.00 FORMAT "%13.2" ECU_ADDRESS 0x7F91CC /end MEASUREMENT
/begin MEASUREMENT PFlt_stDiagRls_mp "Freigabe der Diagnose" UBYTE OneToOne 1 100 0.00 255.0 FORMAT "%5.1" ECU_ADDRESS 0x8FF7BD /end MEASUREMENT
/begin MEASUREMENT PFlt_stDiagState "Diagnosezustand" UWORD OneToOne 1 100 0.00 65535.00 FORMAT "%8.2" ECU_ADDRESS 0x7F8FB6 /end MEASUREMENT
/begin MEASUREMENT PFlt_stDiagSuc "Zustand des Diagnoseerfolgs" UBYTE OneToOne 1 100 0.00 255.0 FORMAT "%5.1" ECU_ADDRESS 0x7F8968 /end MEASUREMENT
/begin MEASUREMENT PFlt_stEngPOp "Motorbetriebspunkt" UBYTE OneToOne 1 100 0.00 255.0 FORMAT "%5.1" ECU_ADDRESS 0x7F8969 /end MEASUREMENT
/begin MEASUREMENT PFlt_stEngPOp10_mp "Motorbetriebspunkt berechnet in Check Range 10" UBYTE OneToOne 1 100 0.00 255.0 FORMAT "%5.1" ECU_ADDRESS 0x8FF7C8 /end MEASUREMENT
/begin MEASUREMENT PFlt_stEngPOp1_mp "Motorbetriebspunkt berechnet in Check Range 1" UBYTE OneToOne 1 100 0.00 255.0 FORMAT "%5.1" ECU_ADDRESS 0x8FF7C9 /end MEASUREMENT
/begin MEASUREMENT PFlt_stEngPOp2_mp "Motorbetriebspunkt berechnet in Check Range 2" UBYTE OneToOne 1 100 0.00 255.0 FORMAT "%5.1" ECU_ADDRESS 0x8FF7CA /end MEASUREMENT
/begin MEASUREMENT PFlt_stEngPOp3_mp "Motorbetriebspunkt berechnet in Check Range 3" UBYTE OneToOne 1 100 0.00 255.0 FORMAT "%5.1" ECU_ADDRESS 0x8FF7CB /end MEASUREMENT
/begin MEASUREMENT PFlt_stEngPOp4_mp "Motorbetriebspunkt berechnet in Check Range 4" UBYTE OneToOne 1 100 0.00 255.0 FORMAT "%5.1" ECU_ADDRESS 0x8FF7CC /end MEASUREMENT
/begin MEASUREMENT PFlt_stEngPOp5_mp "Motorbetriebspunkt berechnet in Check Range 5" UBYTE OneToOne 1 100 0.00 255.0 FORMAT "%5.1" ECU_ADDRESS 0x8FF7CD /end MEASUREMENT
/begin MEASUREMENT PFlt_stEngPOp6_mp "Motorbetriebspunkt berechnet in Check Range 6" UBYTE OneToOne 1 100 0.00 255.0 FORMAT "%5.1" ECU_ADDRESS 0x8FF7CE /end MEASUREMENT
/begin MEASUREMENT PFlt_stEngPOp7_mp "Motorbetriebspunkt berechnet in Check Range 7" UBYTE OneToOne 1 100 0.00 255.0 FORMAT "%5.1" ECU_ADDRESS 0x8FF7CF /end MEASUREMENT
/begin MEASUREMENT PFlt_stEngPOp8_mp "Motorbetriebspunkt berechnet in Check Range 8" UBYTE OneToOne 1 100 0.00 255.0 FORMAT "%5.1" ECU_ADDRESS 0x8FF7D0 /end MEASUREMENT
/begin MEASUREMENT PFlt_stEngPOp9_mp "Motorbetriebspunkt berechnet in Check Range 9" UBYTE OneToOne 1 100 0.00 255.0 FORMAT "%5.1" ECU_ADDRESS 0x8FF7D1 /end MEASUREMENT
/begin MEASUREMENT PFlt_stEngPOpPrj "Projektspezifischer Ausgabewert für Betriebszustandsberechnung" UWORD OneToOne 1 100 0.00 65535.00 FORMAT "%8.2" ECU_ADDRESS 0x7F8FB8 /end MEASUREMENT
/begin MEASUREMENT PFlt_stEngPOpSpo_mp "Statuswert Betriebspunkt ""Spontante Regeneration""" UBYTE OneToOne 1 100 0.00 255.0 FORMAT "%5.1" ECU_ADDRESS 0x8FF7D2 /end MEASUREMENT
/begin MEASUREMENT PFlt_stEngPrtActv "Status Motorschutz aktiv" UBYTE OneToOne 1 100 0.00 255.0 FORMAT "%5.1" ECU_ADDRESS 0x7F896A /end MEASUREMENT
/begin MEASUREMENT PFlt_stEngPrtRgn_mp "Status of engine protection regeneration" UWORD OneToOne 1 100 0.00 65535.00 FORMAT "%8.2" ECU_ADDRESS 0x8FF838 /end MEASUREMENT
/begin MEASUREMENT PFlt_stFlTotCorOn_mp "Status für Gesamtmenge Kraftstoffkorrektur ON." UBYTE OneToOne 1 100 0.00 255.0 FORMAT "%5.1" ECU_ADDRESS 0x8FF786 /end MEASUREMENT
/begin MEASUREMENT PFlt_stFlTotCor_mp "Status für Gesamtmenge Kraftstoffkorrektur" UBYTE OneToOne 1 100 0.00 255.0 FORMAT "%5.1" ECU_ADDRESS 0x8FF787 /end MEASUREMENT
/begin MEASUREMENT PFlt_stGearDeb_mp "Entprelltes Gangsignal" SBYTE OneToOne 1 100 -128.0 127.0 FORMAT "%5.1" ECU_ADDRESS 0x8FF7D3 /end MEASUREMENT
/begin MEASUREMENT PFlt_stIntr_mp "Statuswort Regeneration unterbrochen" UBYTE OneToOne 1 100 0.00 255.0 FORMAT "%5.1" ECU_ADDRESS 0x6F81DE /end MEASUREMENT
/begin MEASUREMENT PFlt_stLck "Statusbit Lock Partikelfilterregeneration" UBYTE OneToOne 1 100 0.00 255.0 FORMAT "%5.1" ECU_ADDRESS 0x7F896B /end MEASUREMENT
/begin MEASUREMENT PFlt_stLckFuel_mp "Messender Punkt für Status der Kraftstoffverriegelung" UBYTE OneToOne 1 100 0.00 255.0 FORMAT "%5.1" ECU_ADDRESS 0x8FF7A7 /end MEASUREMENT
/begin MEASUREMENT PFlt_stLckTempPlaus_mp "Verriegelungsstatus Plausibilisierung Temperatursensoren" UBYTE OneToOne 1 100 0.00 255.0 FORMAT "%5.1" ECU_ADDRESS 0x8FF85E /end MEASUREMENT
/begin MEASUREMENT PFlt_stLckTmr_mp "Verriegelung Timer Temperaturplausibilisierung" UBYTE OneToOne 1 100 0.00 255.0 FORMAT "%5.1" ECU_ADDRESS 0x8FF85F /end MEASUREMENT
/begin MEASUREMENT PFlt_stLck_mp "Regeneration Blockierung und Freigabe" UBYTE OneToOne 1 100 0.00 255.0 FORMAT "%5.1" ECU_ADDRESS 0x6F81DF /end MEASUREMENT
/begin MEASUREMENT PFlt_stLstRgnEnd_mp "Status detektiert Ende des Timers für Regeneration aus Zählerblöcken" UBYTE OneToOne 1 100 0.00 255.0 FORMAT "%5.1" ECU_ADDRESS 0x8FF7A8 /end MEASUREMENT
/begin MEASUREMENT PFlt_stLstRgn_mp "Status Timer für Regeneration aus Zählerblöcken" UBYTE OneToOne 1 100 0.00 255.0 FORMAT "%5.1" ECU_ADDRESS 0x8FF7A9 /end MEASUREMENT
/begin MEASUREMENT PFlt_stNumEngPOpDelOn_mp "Statusbit verzögert wirksame Matrix zur Berücksichtigung des Motorbetriebszustandes bei der Regeneration" UBYTE OneToOne 1 100 0.00 255.0 FORMAT "%5.1" ECU_ADDRESS 0x8FF7AA /end MEASUREMENT
/begin MEASUREMENT PFlt_stPFltErr_mp "" UBYTE OneToOne 1 100 0.00 255.0 FORMAT "%5.1" ECU_ADDRESS 0x8FF788 /end MEASUREMENT
/begin MEASUREMENT PFlt_stPresDiffPlaus_mp "Zustand Plausibilisierung Differenzdrucksignal" UBYTE OneToOne 1 100 0.00 255.0 FORMAT "%5.1" ECU_ADDRESS 0x8FF860 /end MEASUREMENT
/begin MEASUREMENT PFlt_stPresPlausDefHigh_mp "PFlt_pPreCorr_mp ist positiv und fehlerhaft" UBYTE OneToOne 1 100 0.00 255.0 FORMAT "%5.1" ECU_ADDRESS 0x8FF83A /end MEASUREMENT
/begin MEASUREMENT PFlt_stPresPlausDefLow_mp "PFlt_pPreCorr_mp ist negativ und fehlerhaft" UBYTE OneToOne 1 100 0.00 255.0 FORMAT "%5.1" ECU_ADDRESS 0x8FF83B /end MEASUREMENT
/begin MEASUREMENT PFlt_stPresPlausLoIdl_mp "Bit-kodierte Informationen, um projektspezifische Druck-Plausibilitätsprüfungen im niedrigen Leerlaufzustand zu ermöglichen" UBYTE OneToOne 1 100 0.00 255.0 FORMAT "%5.1" ECU_ADDRESS 0x8FF83C /end MEASUREMENT
/begin MEASUREMENT PFlt_stPresPlausOk_mp "Zur Anzeige, ob projektspezifische Druck-Plausibilitätsprüfungen in Ordnung sind" UBYTE OneToOne 1 100 0.00 255.0 FORMAT "%5.1" ECU_ADDRESS 0x8FF83D /end MEASUREMENT
/begin MEASUREMENT PFlt_stPresPlausTst_mp "Zustandsgröße zur Anzeige, ob projektspezifische Druck-Plausibilitätsprüfungen aktiv sind oder nicht" UBYTE OneToOne 1 100 0.00 255.0 FORMAT "%5.1" ECU_ADDRESS 0x8FF83E /end MEASUREMENT
/begin MEASUREMENT PFlt_stPresPlaus_mp "Bit-kodierte Informationen, um projektspezifische Druck-Plausibilitätsprüfungen zu ermöglichen" UBYTE OneToOne 1 100 0.00 255.0 FORMAT "%5.1" ECU_ADDRESS 0x6F81FC /end MEASUREMENT
/begin MEASUREMENT PFlt_stResFlowHi_mp "Obere Schwelle Resflow-SRC überschritten" UBYTE OneToOne 1 100 0.00 255.0 FORMAT "%5.1" ECU_ADDRESS 0x8FF861 /end MEASUREMENT
/begin MEASUREMENT PFlt_stResFlowLo_mp "Untere Schwelle ResFlow-SRC unterschritten" UBYTE OneToOne 1 100 0.00 255.0 FORMAT "%5.1" ECU_ADDRESS 0x8FF862 /end MEASUREMENT
/begin MEASUREMENT PFlt_stRgnRlsOff_mp "Filter is no longer regeneratable" UBYTE OneToOne 1 100 0.00 255.0 FORMAT "%5.1" ECU_ADDRESS 0x8FF83F /end MEASUREMENT
/begin MEASUREMENT PFlt_stRlsmSotCtl_mp "Status of engine protection regeneration for release of soot control" UBYTE OneToOne 1 100 0.00 255.0 FORMAT "%5.1" ECU_ADDRESS 0x8FF840 /end MEASUREMENT
/begin MEASUREMENT PFlt_stRng10_mp "Statuswort Bereich 10" UWORD OneToOne 1 100 0.00 65535.00 FORMAT "%8.2" ECU_ADDRESS 0x8FF7D4 /end MEASUREMENT
/begin MEASUREMENT PFlt_stRng1_mp "Statuswort Bereich 1" UWORD OneToOne 1 100 0.00 65535.00 FORMAT "%8.2" ECU_ADDRESS 0x8FF7D6 /end MEASUREMENT
/begin MEASUREMENT PFlt_stRng2_mp "Statuswort Bereich 2" UWORD OneToOne 1 100 0.00 65535.00 FORMAT "%8.2" ECU_ADDRESS 0x8FF7D8 /end MEASUREMENT
/begin MEASUREMENT PFlt_stRng3_mp "Statuswort Bereich 3" UWORD OneToOne 1 100 0.00 65535.00 FORMAT "%8.2" ECU_ADDRESS 0x8FF7DA /end MEASUREMENT
/begin MEASUREMENT PFlt_stRng4_mp "Statuswort Bereich 4" UWORD OneToOne 1 100 0.00 65535.00 FORMAT "%8.2" ECU_ADDRESS 0x8FF7DC /end MEASUREMENT
/begin MEASUREMENT PFlt_stRng5_mp "Statuswort Bereich 5" UWORD OneToOne 1 100 0.00 65535.00 FORMAT "%8.2" ECU_ADDRESS 0x8FF7DE /end MEASUREMENT
/begin MEASUREMENT PFlt_stRng6_mp "Statuswort Bereich 6" UWORD OneToOne 1 100 0.00 65535.00 FORMAT "%8.2" ECU_ADDRESS 0x8FF7E0 /end MEASUREMENT
/begin MEASUREMENT PFlt_stRng7_mp "Statuswort Bereich 7" UWORD OneToOne 1 100 0.00 65535.00 FORMAT "%8.2" ECU_ADDRESS 0x8FF7E2 /end MEASUREMENT
/begin MEASUREMENT PFlt_stRng8_mp "Statuswort Bereich 8" UWORD OneToOne 1 100 0.00 65535.00 FORMAT "%8.2" ECU_ADDRESS 0x8FF7E4 /end MEASUREMENT
/begin MEASUREMENT PFlt_stRng9_mp "Statuswort Bereich 9" UWORD OneToOne 1 100 0.00 65535.00 FORMAT "%8.2" ECU_ADDRESS 0x8FF7E6 /end MEASUREMENT
/begin MEASUREMENT PFlt_stRngSpo_mp "Statuswort Bereich ""Spontane Regeneration""" UWORD OneToOne 1 100 0.00 65535.00 FORMAT "%8.2" ECU_ADDRESS 0x8FF7E8 /end MEASUREMENT
/begin MEASUREMENT PFlt_stSimOn "Statusbit Simulation aktiv" UBYTE OneToOne 1 100 0.00 255.0 FORMAT "%5.1" ECU_ADDRESS 0x7F896C /end MEASUREMENT
/begin MEASUREMENT PFlt_stSimOn_mp "Statuswort Simulation aktiv" UBYTE OneToOne 1 100 0.00 255.0 FORMAT "%5.1" ECU_ADDRESS 0x8FF81A /end MEASUREMENT
/begin MEASUREMENT PFlt_stSuc "Statuswort erfolgreiche Regeneration" UBYTE OneToOne 1 100 0.00 255.0 FORMAT "%5.1" ECU_ADDRESS 0x7F896D /end MEASUREMENT
/begin MEASUREMENT PFlt_stSuc_mp "erfolgreiche Regeneration" UBYTE OneToOne 1 100 0.00 255.0 FORMAT "%5.1" ECU_ADDRESS 0x8FF7AB /end MEASUREMENT
/begin MEASUREMENT PFlt_stTempPlausDone_mp "Statusbit Plausibilisierung Temperatursensoren durchgeführt" UBYTE OneToOne 1 100 0.00 255.0 FORMAT "%5.1" ECU_ADDRESS 0x8FF863 /end MEASUREMENT
/begin MEASUREMENT PFlt_tAirFltAshCor_mp "gefilterter Wert Ansauglufttemperatur" SWORD Temp_Cels 1 100 -50.140 899.860 FORMAT "%8.3" ECU_ADDRESS 0x8FF78A /end MEASUREMENT
/begin MEASUREMENT PFlt_tCIntFltAshCor_mp "gefilterter Wert Kühlmitteltemperatur" SWORD Temp_Cels 1 100 -50.140 899.860 FORMAT "%8.3" ECU_ADDRESS 0x8FF78C /end MEASUREMENT
/begin MEASUREMENT PFlt_tClntFlt_mp "CTSCD_tClnt PT1 gefiltert" SWORD Temp_Cels 1 100 -50.140 899.860 FORMAT "%8.3" ECU_ADDRESS 0x8FF7EA /end MEASUREMENT
/begin MEASUREMENT PFlt_tDiffCorr_mp "Temperaturabweichung durch instationären Betrieb" SWORD TempDiff_Cels 1 100 -3276.800 3276.700 FORMAT "%8.3" ECU_ADDRESS 0x8FF874 /end MEASUREMENT
/begin MEASUREMENT PFlt_tDwnStrm_mp "Zweite Abgastemperatur zur Überwachung" SWORD Temp_Cels 1 100 -50.140 899.860 FORMAT "%8.3" ECU_ADDRESS 0x8FF864 /end MEASUREMENT
/begin MEASUREMENT PFlt_tExhGsStyRgn1_mp "PFlt_tExhGsStyRgn1_MAP" SWORD TempDiff_Cels 1 100 -3276.800 3276.700 FORMAT "%8.3" ECU_ADDRESS 0x8FF876 /end MEASUREMENT
/begin MEASUREMENT PFlt_tExhGsStyRgn2_mp "Static soot emission" SWORD TempDiff_Cels 1 100 -3276.800 3276.700 FORMAT "%8.3" ECU_ADDRESS 0x8FF878 /end MEASUREMENT
/begin MEASUREMENT PFlt_tHtTransCor_mp "Temperaturkorrekturwert Wärmeübergang" SWORD TempDiff_Cels 1 100 -3276.800 3276.700 FORMAT "%8.3" ECU_ADDRESS 0x8FF87A /end MEASUREMENT
/begin MEASUREMENT PFlt_tIATLoLvl_mp "niedrigster Wert der Ansauglufttemperatur" SWORD Temp_Cels 1 100 -50.140 899.860 FORMAT "%8.3" ECU_ADDRESS 0x8FF866 /end MEASUREMENT
/begin MEASUREMENT PFlt_tiChkTmpPlaus_mp "Abgelaufene Zeit nach Motorstopp, wenn die EEPROM-Zähler noch nicht abgelaufen ist." UWORD Time_s 1 100 0.00 655.3500 FORMAT "%8.4" ECU_ADDRESS 0x8FF868 /end MEASUREMENT
/begin MEASUREMENT PFlt_tiExhGsDel_mp "Verzögerungszeit Abgas" SWORD TimeDelay_s 1 100 0.13107600 4294.9673 FORMAT "%9.4" ECU_ADDRESS 0x8FF87C /end MEASUREMENT
/begin MEASUREMENT PFlt_tiHtTransDT1_mp "Wärmeübergangszeit" SWORD TimeDelay_s 1 100 0.13107600 4294.9673 FORMAT "%9.4" ECU_ADDRESS 0x8FF87E /end MEASUREMENT
/begin MEASUREMENT PFlt_tiLckRls_mp " In EEPROM abgespeicherte Zeit für Sperren die Regeneration" ULONG Time_s 1 100 0.00 42949672.9500 FORMAT "%13.4" ECU_ADDRESS 0x8FF7AC /end MEASUREMENT
/begin MEASUREMENT PFlt_tiOpOld_mp "Time since engine on read from EEPROM since engine protection became active" ULONG TimeEngOn 1 100 0.00 4294967295.00 FORMAT "%13.2" ECU_ADDRESS 0x8FF844 /end MEASUREMENT
/begin MEASUREMENT PFlt_tiOpu16_mp "Engine operation time with reduced resolution" UWORD tiOpRes 1 100 0.00 4194240. FORMAT "%8.0" ECU_ADDRESS 0x6F81E0 /end MEASUREMENT
/begin MEASUREMENT PFlt_tiOp_mp "Motorbetriebszeit bei der letzten erfolgr. Regeneration" ULONG TimeEngOn 1 100 0.00 4294967295.00 FORMAT "%13.2" ECU_ADDRESS 0x8FF7B0 /end MEASUREMENT
/begin MEASUREMENT PFlt_tiPFltErr_mp "" UWORD TimePFltLimpHome 1 100 0.00 655350.0 FORMAT "%8.1" ECU_ADDRESS 0x6F81C8 /end MEASUREMENT
/begin MEASUREMENT PFlt_tiRgnMax_mp "Wert für die maximale Regenerierungsdauer" ULONG Time_s 1 100 0.00 42949672.9500 FORMAT "%13.4" ECU_ADDRESS 0x8FF7B4 /end MEASUREMENT
/begin MEASUREMENT PFlt_tiSnceFstEngPrtRgn_mp "" ULONG TimeEngOn 1 100 0.00 4294967295.00 FORMAT "%13.2" ECU_ADDRESS 0x8FF848 /end MEASUREMENT
/begin MEASUREMENT PFlt_tiSnceRgn "" ULONG TimeEngOn 1 100 0.00 4294967295.00 FORMAT "%13.2" ECU_ADDRESS 0x7F91D0 /end MEASUREMENT
/begin MEASUREMENT PFlt_tiSnceRgnu16_mp "Engine operation time since last successful regeneration with reduced resolution" UWORD tiSncergnRes 1 100 0.00 16776960. FORMAT "%8.0" ECU_ADDRESS 0x6F81E2 /end MEASUREMENT
/begin MEASUREMENT PFlt_tOxiPre "Temperatur vor Oxidationskatalysator" SWORD Temp_Cels 1 100 -50.140 899.860 FORMAT "%8.3" ECU_ADDRESS 0x7F8FBA /end MEASUREMENT
/begin MEASUREMENT PFlt_tOxiPreFltAshCor_mp "gefilterter Wert OxiKat-Temperatur" SWORD Temp_Cels 1 100 -50.140 899.860 FORMAT "%8.3" ECU_ADDRESS 0x8FF78E /end MEASUREMENT
/begin MEASUREMENT PFlt_tOxiPreFlt_mp "OxiCCD_tPre PT1 gefiltert" SWORD Temp_Cels 1 100 -50.140 899.860 FORMAT "%8.3" ECU_ADDRESS 0x8FF7EC /end MEASUREMENT
/begin MEASUREMENT PFlt_tOxiPreRaw_mp "Kennfeldberechnete Temperatur vor dem Oxi-Kat" SWORD Temp_Cels 1 100 -50.140 899.860 FORMAT "%8.3" ECU_ADDRESS 0x8FF880 /end MEASUREMENT
/begin MEASUREMENT PFlt_tOxiPreSty "Stationäre Temperatur vor Oxidationskatalysator" SWORD Temp_Cels 1 100 -50.140 899.860 FORMAT "%8.3" ECU_ADDRESS 0x7F8FBC /end MEASUREMENT
/begin MEASUREMENT PFlt_tPFltMon_mp "Motortemperatur aus Kennfeld" SWORD Temp_Cels 1 100 -50.140 899.860 FORMAT "%8.3" ECU_ADDRESS 0x8FF86A /end MEASUREMENT
/begin MEASUREMENT PFlt_tPOpAir_mp "Ansauglufttemperatur aus Kennfeld" SWORD Temp_Cels 1 100 -50.140 899.860 FORMAT "%8.3" ECU_ADDRESS 0x8FF7EE /end MEASUREMENT
/begin MEASUREMENT PFlt_tPOpClnt_mp "Kühlflüssigkeitstemperatur aus Kennfeld" SWORD Temp_Cels 1 100 -50.140 899.860 FORMAT "%8.3" ECU_ADDRESS 0x8FF7F0 /end MEASUREMENT
/begin MEASUREMENT PFlt_tPre "Abgastemp. vor Partikelfilter" SWORD Temp_Cels 1 100 -50.140 899.860 FORMAT "%8.3" ECU_ADDRESS 0x7F8FC0 /end MEASUREMENT
/begin MEASUREMENT PFlt_tPreCorr_mp "Korrigiertes Temperatursignal vor Partikelfilter" SWORD Temp_Cels 1 100 -50.140 899.860 FORMAT "%8.3" ECU_ADDRESS 0x8FF882 /end MEASUREMENT
/begin MEASUREMENT PFlt_tPreFltAshCor_mp "gefilterter Wert Aufwärtstemperatur Partikelfilter" SWORD Temp_Cels 1 100 -50.140 899.860 FORMAT "%8.3" ECU_ADDRESS 0x8FF790 /end MEASUREMENT
/begin MEASUREMENT PFlt_tPreFlt_mp "PFlt_tPre PT1 gefiltert" SWORD Temp_Cels 1 100 -50.140 899.860 FORMAT "%8.3" ECU_ADDRESS 0x6F81E4 /end MEASUREMENT
/begin MEASUREMENT PFlt_tPreRaw_mp "Kennfeldberechnete Temperatur vor dem Partikelfilter" SWORD Temp_Cels 1 100 -50.140 899.860 FORMAT "%8.3" ECU_ADDRESS 0x8FF884 /end MEASUREMENT
/begin MEASUREMENT PFlt_tPreSty "Stationäre Temperatur vor Partikelfilter" SWORD Temp_Cels 1 100 -50.140 899.860 FORMAT "%8.3" ECU_ADDRESS 0x7F8FC2 /end MEASUREMENT
/begin MEASUREMENT PFlt_tPstSim "Simulierte Temperatur nach Partikelfilter" SWORD Temp_Cels 1 100 -50.140 899.860 FORMAT "%8.3" ECU_ADDRESS 0x7F8FC4 /end MEASUREMENT
/begin MEASUREMENT PFlt_tSurf "Oberflächen Temperatur vom Partikel Filter" SWORD Temp_Cels 1 100 -50.140 899.860 FORMAT "%8.3" ECU_ADDRESS 0x7F8FC6 /end MEASUREMENT
/begin MEASUREMENT PFlt_tSurfSim_mp "modellierte Partikelfilteroberflächentemperatur" SWORD Temp_Cels 1 100 -50.140 899.860 FORMAT "%8.3" ECU_ADDRESS 0x8FF886 /end MEASUREMENT
/begin MEASUREMENT PFlt_tTotCor_mp "Additiver Temperaturkorrekturwert" SWORD TempDiff_Cels 1 100 -3276.800 3276.700 FORMAT "%8.3" ECU_ADDRESS 0x8FF888 /end MEASUREMENT
/begin MEASUREMENT PFlt_tUpStrm_mp "Erste Abgastemperatur zur Überwachung" SWORD Temp_Cels 1 100 -50.140 899.860 FORMAT "%8.3" ECU_ADDRESS 0x8FF86C /end MEASUREMENT
/begin MEASUREMENT PFlt_uBattCDFlt_mp "gefilterte Batteriespannung" SWORD Volt_Batt 1 100 -640625.6 640606.1 FORMAT "%8.1" ECU_ADDRESS 0x8FF7F2 /end MEASUREMENT
/begin MEASUREMENT PFlt_volAddTot_mp "Gesamt eingespritzte Additivvolumen (grob Auflösung)" SWORD volAdd_ml2 1 100 -32768.00 32767.00 FORMAT "%8.2" ECU_ADDRESS 0x8FF81C /end MEASUREMENT
/begin MEASUREMENT PFlt_vVehFltAshCor_mp "gefilterter Wert Fahrzeuggeschwindigkeit" SWORD Vel 1 100 -327.6800 327.6700 FORMAT "%8.4" ECU_ADDRESS 0x8FF792 /end MEASUREMENT
/begin MEASUREMENT PFlt_vVehFlt_mp "VSSCD_v PT1 gefiltert" SWORD Vel 1 100 -327.6800 327.6700 FORMAT "%8.4" ECU_ADDRESS 0x6F81E6 /end MEASUREMENT
/begin MEASUREMENT PFlt_vVehUnFltMax_mp "Maximum value of unfiltered vehicle speed" SWORD Vel 1 100 -327.6800 327.6700 FORMAT "%8.4" ECU_ADDRESS 0x8FF7F6 /end MEASUREMENT
/begin MEASUREMENT PFlt_vVehUnFltMin_mp "Minimum Grenzen für ungefilterte Fahrgeschwindigkeit" SWORD Vel 1 100 -327.6800 327.6700 FORMAT "%8.4" ECU_ADDRESS 0x8FF7F8 /end MEASUREMENT
/begin MEASUREMENT PrpBrk_trqDes "Vortriebsmomentwunsch der Längsbewegung" SWORD TrqPrp 1 100 -6553.600 6553.400 FORMAT "%8.3" ECU_ADDRESS 0x7F8FCC /end MEASUREMENT
/begin MEASUREMENT PrpBrk_trqLead "Vorhaltmoment der Längsbewegung" SWORD TrqPrp 1 100 -6553.600 6553.400 FORMAT "%8.3" ECU_ADDRESS 0x7F8FCE /end MEASUREMENT
/begin FUNCTION pcv_setcurr "Berechnung elektrischer Sollstrom für das Druckregelventil" /begin DEF_CHARACTERISTIC PCV_iCnvPress_CUR PCV_iSetMin_C /end DEF_CHARACTERISTIC /begin IN_MEASUREMENT Rail_pPCVSet /end IN_MEASUREMENT /end FUNCTION
/begin FUNCTION pcv_setcurr_uic "" /begin DEF_CHARACTERISTIC PCV_iSet_Vector PCV_iSet_Channel /end DEF_CHARACTERISTIC /begin OUT_MEASUREMENT PCV_iSet_mp PCV_stActrCtl_mp /end OUT_MEASUREMENT /end FUNCTION
/begin FUNCTION pfltcd_getppre "Absolutdruck vor dem Partikelfilter"
 /begin DEF_CHARACTERISTIC PFltCD_uSRCMinPPre_C PFltCD_uSRCMaxPPre_C PFltCD_pLinPre_CUR PFltCD_DebSRCHiDefPPre_C PFltCD_DebSRCHiOkPPre_C PFltCD_DebSRCLoDefPPre_C PFltCD_DebSRCLoOkPPre_C PFltCD_dtRmpSlpUpPPre_C PFltCD_dtRmpSlpDwnPPre_C PFLTCD_numAdc2_C PFltCD_tiPPrePT1_C PFltCD_stSensIDWordPPre_C PFltCD_pDflPre_C /end DEF_CHARACTERISTIC
 /begin IN_MEASUREMENT PFltCD_uRawPresPre_mp /end IN_MEASUREMENT
/end FUNCTION
/begin FUNCTION pfltcd_getppre_msg "" /begin OUT_MEASUREMENT PFltCD_pLinPre PFltCD_pPre /end OUT_MEASUREMENT /end FUNCTION
/begin FUNCTION pfltcd_getppre_uic "" /begin OUT_MEASUREMENT PFltCD_uRawPresPre_mp /end OUT_MEASUREMENT /end FUNCTION
/begin FUNCTION pfltcd_gettpre "Abgastemperatur vor dem Partikelfilter"
 /begin DEF_CHARACTERISTIC PFltCD_uSRCMinTempPre_C PFltCD_uSRCMaxTempPre_C PFltCD_tLinPre_CUR PFltCD_DebSRCHighDefTPre_C PFltCD_DebSRCHighOkTPre_C PFltCD_DebSRCLowDefTPre_C PFltCD_DebSRCLowOkTPre_C PFltCD_dtRmpSlpUpPre_C PFltCD_dtRmpSlpDwnPre_C PFLTCD_numAdc_C PFltCD_stSensIDWordTPre_C PFltCD_tDflPre_C /end DEF_CHARACTERISTIC
 /begin IN_MEASUREMENT PFltCD_uRawTempPre /end IN_MEASUREMENT
/end FUNCTION
/begin FUNCTION pfltcd_gettpre_msg "" /begin OUT_MEASUREMENT PFltCD_tLinPre PFltCD_tPre PFltCD_uRawTempPre /end OUT_MEASUREMENT /end FUNCTION
/begin FUNCTION pflt_ashcor ""
 /begin DEF_CHARACTERISTIC PFlt_aVehFltAshCorMax_C PFlt_aVehFltAshCorMin_C PFlt_ctAshCorRgnMax_C PFlt_ctAshCorRgn_C PFlt_facAshCorOld_C PFlt_facAshOil_C PFlt_facFlTotCor_C PFlt_faclAshCor_C PFlt_lAshCorMax_C PFlt_lAshCorNextDef_C PFlt_lAshCorNplAbsRel_C PFlt_lAshCorNplAbs_C PFlt_lAshCorNplRel_C PFlt_lAshCorRegIntr_C PFlt_lMinSnceRgn_C PFlt_mAshCor_MAP PFlt_mAshTolcAbs_C PFlt_mAshTolcMaxAbs_C PFlt_mAshTolcMaxRel_C PFlt_nAvrgFltAshCorMax_C PFlt_nAvrgFltAshCorMin_C PFlt_numAshCorMsk_C PFlt_numAshCor_C PFlt_numPFltErrRgnIntr_C PFlt_numPFltErr_C PFlt_qFlTotMin_C PFlt_qSetUnBalFltAshCorMax_C PFlt_qSetUnBalFltAshCorMin_C PFlt_swtAshCorActive_C PFlt_swtAshCorOn_C PFlt_tAirFltAshCorMax_C PFlt_tAirFltAshCorMin_C PFlt_tCIntAshCorMax_C PFlt_tCIntAshCorMin_C PFlt_tiAshCorAirTempPT1_C PFlt_tiAshCorCIntTempPT1_C PFlt_tiAshCorDVolPT1_C PFlt_tiAshCorEngSpdPT1_C PFlt_tiAshCorInjMsPT1_C PFlt_tiAshCorOxiTempPT1_C PFlt_tiAshCorPreTempPT1_C PFlt_tiAshCorResFlowPT1_C PFlt_tiAshCorRlsOn_C PFlt_tiAshCorVehAccPT1_C PFlt_tiAshCorVehSpdPT1_C PFlt_tiAshCorWaitMax_C PFlt_tiPFltErrPer_C PFlt_tiPFltErrRgn_C PFlt_tOxiPreFltAshCorMax_C PFlt_tOxiPreFltAshCorMin_C PFlt_tPreFltAshCorMax_C PFlt_tPreFltAshCorMin_C PFlt_vVehFltAshCorMax_C PFlt_vVehFltAshCorMin_C /end DEF_CHARACTERISTIC
 /begin IN_MEASUREMENT PFlt_dVolFltAshCor_mp PFlt_resFlowFltAshCor_mp /end IN_MEASUREMENT
/end FUNCTION
/begin FUNCTION pflt_ashcor_msg ""
 /begin OUT_MEASUREMENT PFlt_lAshCorNext PFlt_mAshCorAct PFlt_mAshCorNew PFlt_mAshCorOld PFlt_numPrj PFlt_qFlTotCor PFlt_stAshCorRgnMax /end OUT_MEASUREMENT
/end FUNCTION
/begin FUNCTION pflt_ashcor_uic ""
 /begin OUT_MEASUREMENT PFlt_aVehFltAshCor_mp PFlt_ctNumAshCorMax_mp PFlt_ctNumAshCor_mp PFlt_dqFlTotAct_mp PFlt_dqFlTotEnd_mp PFlt_dVolFltAshCorRaw_mp PFlt_dVolFltAshCor_mp PFlt_facAshCorDiff_mp PFlt_lAshCorAct_mp PFlt_lAshCorNextEEProm_mp PFlt_lAshCorNextMax_mp PFlt_lAshCorNextOilCor_mp PFlt_lAshCorOldCalc_mp PFlt_lAshCorStep_mp PFlt_mAshCorActRel_mp PFlt_mAshCorDiff1_mp PFlt_mAshCorDiff2_mp PFlt_mAshCorDiff_mp PFlt_nAvrgFltAshCor_mp PFlt_qSetUnBalFltAshCor_mp PFlt_resFlowFltAshCorRaw_mp PFlt_resFlowFltAshCor_mp PFlt_stAshCorCalc_mp PFlt_stAshCorDist_mp PFlt_stAshCorRgn_mp PFlt_stAshCorRlsOn_mp PFlt_stAshCorRls_mp PFlt_stAshCor_mp PFlt_stFlTotCorOn_mp PFlt_stFlTotCor_mp PFlt_stPFltErr_mp PFlt_tAirFltAshCor_mp PFlt_tCIntFltAshCor_mp PFlt_tiPFltErr_mp PFlt_tOxiPreFltAshCor_mp PFlt_tPreFltAshCor_mp PFlt_vVehFltAshCor_mp /end OUT_MEASUREMENT
/end FUNCTION
/begin FUNCTION pflt_corgn "Partikelfilterregenerationskoordinator"
 /begin DEF_CHARACTERISTIC PFlt_lSumMaxDef_C PFlt_lSumMax_C PFlt_lSumSubs_C PFlt_mSotMeas_CUR PFlt_mSotNewRng1_C PFlt_mSotRng1New_C PFlt_mSotRng1Rng2_C PFlt_mSotRng2Rng1_C PFlt_mSotRng2Rng3_C PFlt_mSotRng3Rng2_C PFlt_mSotRng3Rng4_C PFlt_mSotRng4Rng3_C PFlt_mSotRng4Rng5_C PFlt_mSotRng5Rng4_C PFlt_numEngPOpDel_CA PFlt_numEngPOp_CA PFlt_numLst_C PFlt_numPrioRgnStg1_C PFlt_numPrioRgnStg2_C PFlt_numPrioRgnStg3_C PFlt_numPrioRgnStg4_C PFlt_numPrioRgnStg5_C PFlt_numPrioRgnStg6_C PFlt_numPrioRgnStgDiag_C PFlt_numPrt_C PFlt_numRgnSuc_C PFlt_pEngPrtMaxInit_C PFlt_pEngPrtMax_MAP PFlt_pEngPrtMin_MAP PFlt_qFlMaxDef_C PFlt_qFlMax_C PFlt_qFlSubs_C PFlt_qFlTotAdjMax_C PFlt_stDiagOn_C PFlt_stLckFuelMsk_C PFlt_stLckRgnMsk_C PFlt_stRgnActvMsk_C PFlt_stRgnStg1_C PFlt_stRgnStg2_C PFlt_stRgnStg3_C PFlt_stRgnStg4_C PFlt_stRgnStg5_C PFlt_stRgnStg6_C PFlt_swtDiagOn_C PFlt_swtOfsCor_C PFlt_swtServiceVal_C Pflt_swtShOffSuc_C PFlt_swtTmrLckRst_C PFlt_tiDebLck_C PFlt_tiDebQLimErrIntr_C PFlt_tiDebTrqOvhtIntr_C PFlt_tiEngOnMaxDef_C PFlt_tiEngOnMax_C PFlt_tiEngPrtPT1_C PFlt_tiEngPrt_C PFlt_tiLckRgnErr_CA PFlt_tiLckRgn_CA PFlt_tiLckSubs_C PFlt_tiLstRgn_C PFlt_tiOpSubs_C PFlt_tiRgnMax_CA PFlt_tiRgnSpo_C PFlt_tOxiPreMaxHi_C PFlt_tOxiPreMaxLo_C PFlt_tPreMaxHi_C PFlt_tPreMaxLo_C PFlt_volFlConsumSubs_C PFlt_volFuelFilMinHi_C PFlt_volFuelFilMinLo_C /end DEF_CHARACTERISTIC
 /begin IN_MEASUREMENT Eng_nAvrg InjCtl_qSetUnBal PFlt_numRgn_mp PFlt_resFlowOfs PFlt_stEngPOp /end IN_MEASUREMENT
/end FUNCTION
/begin FUNCTION pflt_corgn_msg ""
 /begin OUT_MEASUREMENT PFlt_lSnceRgn PFlt_numEngPOp PFlt_numPrio PFlt_qFlTot PFlt_st PFlt_stDiagOn PFlt_stEngPrtActv PFlt_stLck PFlt_stSuc PFlt_tiSnceRgn /end OUT_MEASUREMENT
/end FUNCTION
/begin FUNCTION pflt_corgn_uic "" /begin DEF_CHARACTERISTIC PFlt_st_Vector PFlt_st_Channel /end DEF_CHARACTERISTIC
 /begin OUT_MEASUREMENT PFlt_lSnceRgnu16_mp PFlt_lSnceRgn_mp PFlt_lSumu16_mp PFlt_lSum_mp PFlt_mSotOfs_mp PFlt_numLst_mp PFlt_numPrt_mp PFlt_numRgn_mp PFlt_numSot_mp PFlt_numTot_mp PFlt_pEngPrtMax_mp PFlt_pEngPrtMin_mp PFlt_qFlTotEEPROM_mp PFlt_qFl_mp PFlt_resSotMeasCrv_mp PFlt_st1_mp PFlt_st2_mp PFlt_stCnt_mp PFlt_stIntr_mp PFlt_stLckFuel_mp PFlt_stLck_mp PFlt_stLstRgnEnd_mp PFlt_stLstRgn_mp PFlt_stNumEngPOpDelOn_mp PFlt_stSuc_mp PFlt_tiLckRls_mp PFlt_tiOpu16_mp PFlt_tiOp_mp PFlt_tiRgnMax_mp PFlt_tiSnceRgnu16_mp /end OUT_MEASUREMENT
/end FUNCTION
/begin FUNCTION pflt_diag "Diagnose für den Partikelfilter"
 /begin DEF_CHARACTERISTIC PFlt_mDiagAFSMax_C PFlt_mDiagAFSMin_C PFlt_mDiagSotMax_C PFlt_mDiagSotMin_C PFlt_nDiagLowIdle1_C PFlt_nDiagLowIdle2_C PFlt_nDiagLowIdle_C PFlt_nDiagMax_C PFlt_nDiagMin_C PFlt_nDiagRgnMax_C PFlt_nDiagRgnMin_C PFlt_pAPSDiag_C PFlt_pDiagBPSMax_C PFlt_pDiagBPSMin_C PFlt_qDiagPOpMax_CUR PFlt_qDiagPOpMin_CUR PFlt_rDiagAccPedMax_C PFlt_rDiagTVAMax_C PFlt_rDiagTVAMin_C PFlt_stDiagAbortMsk_C PFlt_stDiagMskRgnAbort_C PFlt_stDiagMskTst10_C PFlt_stDiagMskTst1_C PFlt_stDiagMskTst2_C PFlt_stDiagMskTst3_C PFlt_stDiagMskTst4_C PFlt_stDiagMskTst5_C PFlt_stDiagMskTst6_C PFlt_stDiagMskTst7_C PFlt_stDiagMskTst8_C PFlt_stDiagMskTst9_C PFlt_stDiagMsk_C PFlt_stDiagRgnMsk_C PFlt_stRgnDiagStg1_C PFlt_stRgnDiagStg2_C PFlt_stRgnDiagStg3_C PFlt_tDiagDpfAbrtMax_C PFlt_tDiagDpfCoolDwn_C PFlt_tDiagDpfHeatup_C PFlt_tDiagDpfMax_C PFlt_tDiagDpfPreRgnMin_C PFlt_tDiagOxiAbrtMax_C PFlt_tDiagOxiCoolDwn_C PFlt_tDiagOxiHeatup_C PFlt_tDiagOxiMax_C PFlt_tDiagOxiMin_C PFlt_tDiagOxiPreMax_C PFlt_tDiagOxiPreRgnMin_C PFlt_tDiagPFltMax_C PFlt_tDiagPFltMin_C PFlt_tEngDiagMinH_C PFlt_tEngDiagMinL_C PFlt_tFltDiagMax_C PFlt_tiDiagCoolDwnMax_C PFlt_tiDiagDpfMax_C PFlt_tiDiagNormal_C PFlt_tiDiagOxiMax_C PFlt_tiDiagRgnEnd_C PFlt_tiDiagRgnHeatup_C PFlt_tiDiagRgnLidIMin_C PFlt_tiGetRgnSt_C PFlt_tiStpRgn_C PFlt_tOilDiagMinH_C PFlt_tOilDiagMinL_C PFlt_uDiagMin_C /end DEF_CHARACTERISTIC
 /begin IN_MEASUREMENT Eng_nAvrg /end IN_MEASUREMENT
/end FUNCTION
/begin FUNCTION pflt_diag_msg ""
 /begin OUT_MEASUREMENT PFlt_nDiagLowIdle PFlt_stDiag PFlt_stDiagAbort PFlt_stDiagAbortMsk PFlt_stDiagDemOn PFlt_stDiagMsk PFlt_stDiagRgn PFlt_stDiagRgnMsk PFlt_stDiagRls PFlt_stDiagState PFlt_stDiagSuc /end OUT_MEASUREMENT
/end FUNCTION
/begin FUNCTION pflt_diag_uic ""
 /begin OUT_MEASUREMENT PFlt_stDiagAbrt1_mp PFlt_stDiagAbrt2_mp PFlt_stDiagCoolDwn_mp PFlt_stDiagEnd_mp PFlt_stDiagRgn_mp PFlt_stDiagRls_mp /end OUT_MEASUREMENT
/end FUNCTION
/begin FUNCTION pflt_engpopcalc "Betriebszustandsberechnung für Partikelfilter"
 /begin DEF_CHARACTERISTIC PFlt_nAvrgMinMax_CA PFlt_numPOpAir_C PFlt_numPOpClnt_C PFlt_qSetUnBalRng10Max_GCUR PFlt_qSetUnBalRng10Min_GCUR PFlt_qSetUnBalRng1Max_GCUR PFlt_qSetUnBalRng1Min_GCUR PFlt_qSetUnBalRng2Max_GCUR PFlt_qSetUnBalRng2Min_GCUR PFlt_qSetUnBalRng3Max_GCUR PFlt_qSetUnBalRng3Min_GCUR PFlt_qSetUnBalRng4Max_GCUR PFlt_qSetUnBalRng4Min_GCUR PFlt_qSetUnBalRng5Max_GCUR PFlt_qSetUnBalRng5Min_GCUR PFlt_qSetUnBalRng6Max_GCUR PFlt_qSetUnBalRng6Min_GCUR PFlt_qSetUnBalRng7Max_GCUR PFlt_qSetUnBalRng7Min_GCUR PFlt_qSetUnBalRng8Max_GCUR PFlt_qSetUnBalRng8Min_GCUR PFlt_qSetUnBalRng9Max_GCUR PFlt_qSetUnBalRng9Min_GCUR PFlt_qSetUnBalRngSpoMax_GCUR PFlt_qSetUnBalRngSpoMin_GCUR PFlt_qSetUnBal_AXIS PFlt_rAccPedMinMax_CA PFlt_stGearDebValMax_C PFlt_stGearDebValMin_C PFlt_stGearMinMax_CA PFlt_swtBrkRng_CA PFlt_swtClthRng_CA PFlt_tAirMinMax_CA PFlt_tClntMinMax_CA PFlt_tiAccPedPT1_C PFlt_tiBattCDPT1_C PFlt_tiDebBrkOff_C PFlt_tiDebBrkOn_C PFlt_tiDebConvOff_C PFlt_tiDebConvOn_C PFlt_tiDebGearOff_C PFlt_tiDebGearOn_C PFlt_tiEngSpdPT1_C PFlt_tiInjMsPT1_C PFlt_tiSpdVehPT1_C PFlt_tiTempClntPT1_C PFlt_tiTempOxiPrePT1_C PFlt_tiTempPrePT1_C PFlt_tOxiPreOffMinMax_CA PFlt_tOxiPreOnMinMax_CA PFlt_tPreOffMinMax_CA PFlt_tPreOnMinMax_CA PFlt_uBattMinMax_CA PFlt_vVehMinMax_CA /end DEF_CHARACTERISTIC
 /begin IN_MEASUREMENT PFlt_nAvrgFlt_mp PFlt_RngIdx_X_mp PFlt_RngIdx_Y_mp /end IN_MEASUREMENT
/end FUNCTION
/begin FUNCTION pflt_engpopcalc_msg "" /begin OUT_MEASUREMENT PFlt_stEngPOp /end OUT_MEASUREMENT /end FUNCTION
/begin FUNCTION pflt_engpopcalc_uic "" /begin DEF_CHARACTERISTIC PFlt_stEngPOp_Vector PFlt_stEngPOp_Channel /end DEF_CHARACTERISTIC
 /begin OUT_MEASUREMENT PFlt_nAvrgFlt_mp PFlt_qSetUnBalFlt_mp PFlt_rAccPedFlt_mp PFlt_RngIdx_X_mp PFlt_RngIdx_Y_mp PFlt_stBrkDeb_mp PFlt_stClthDeb_mp PFlt_stEngPOp10_mp PFlt_stEngPOp1_mp PFlt_stEngPOp2_mp PFlt_stEngPOp3_mp PFlt_stEngPOp4_mp PFlt_stEngPOp5_mp PFlt_stEngPOp6_mp PFlt_stEngPOp7_mp PFlt_stEngPOp8_mp PFlt_stEngPOp9_mp PFlt_stEngPOpSpo_mp PFlt_stGearDeb_mp PFlt_stRng10_mp PFlt_stRng1_mp PFlt_stRng2_mp PFlt_stRng3_mp PFlt_stRng4_mp PFlt_stRng5_mp PFlt_stRng6_mp PFlt_stRng7_mp PFlt_stRng8_mp PFlt_stRng9_mp PFlt_stRngSpo_mp PFlt_tClntFlt_mp PFlt_tOxiPreFlt_mp PFlt_tPOpAir_mp PFlt_tPOpClnt_mp PFlt_tPreFlt_mp PFlt_uBattCDFlt_mp PFlt_vVehFlt_mp /end OUT_MEASUREMENT
/end FUNCTION
/begin FUNCTION pflt_engpopprj "Erweiterung für Betriebszustandsberechnung" /begin DEF_CHARACTERISTIC PFlt_vVehUnFltMinMax_CA /end DEF_CHARACTERISTIC /begin IN_MEASUREMENT PFlt_RngIdxPrj_X_mp PFlt_RngIdxPrj_Y_mp /end IN_MEASUREMENT /end FUNCTION
/begin FUNCTION pflt_engpopprj_msg "" /begin OUT_MEASUREMENT PFlt_stEngPOpPrj /end OUT_MEASUREMENT /end FUNCTION
/begin FUNCTION pflt_engpopprj_uic ""
 /begin OUT_MEASUREMENT PFlt_RngIdxPrj_X_mp PFlt_RngIdxPrj_Y_mp PFlt_vVehUnFltMax_mp PFlt_vVehUnFltMin_mp /end OUT_MEASUREMENT
/end FUNCTION
/begin FUNCTION pflt_exhgsppty "dvol + Lambda" /begin DEF_CHARACTERISTIC PFlt_numLSU_C PFlt_swtASModOn_C PFlt_swtLmbdAprx_C /end DEF_CHARACTERISTIC /end FUNCTION
/begin FUNCTION pflt_exhgsppty_msg ""
 /begin OUT_MEASUREMENT PFlt_dmEG PFlt_dmO2Aprx PFlt_dvol PFlt_qPoI2NonEff PFlt_rLmbd /end OUT_MEASUREMENT
/end FUNCTION
/begin FUNCTION pflt_exhgsppty_uic "" /begin DEF_CHARACTERISTIC PFlt_dvol_Vector PFlt_dvol_Channel /end DEF_CHARACTERISTIC /begin OUT_MEASUREMENT PFlt_rLmbdAprx_mp /end OUT_MEASUREMENT /end FUNCTION
/begin FUNCTION pflt_masscalc "Berechnung der Rußmasse im Partikefilter"
 /begin DEF_CHARACTERISTIC PFlt_t1DT1Pres_C PFlt_kdDT1Pres_C PFlt_t1DT1Sim_C PFlt_kdDT1Sim_C PFlt_dmNOxEngBas_MAP PFlt_dmSotSimBas_MAP PFlt_dmSotSimDyn_CUR PFlt_dmSotSimEGRoff_MAP PFlt_dmSotSimRgnBas_CUR PFlt_dpDiffMax_C PFlt_dvolMeasMin_C PFlt_facCnvCat_CUR PFlt_facDynVisc_CUR PFlt_facEGR_CUR PFlt_facMflO2SimRgn_CUR PFlt_facMltCor_CUR PFlt_facNO2dVol_CUR PFlt_facNO2Sot_C PFlt_facSotSimRgnCRT_CUR PFlt_facTempCRT_CUR PFlt_facTempSimRgn_CUR PFlt_mAshAdi_CUR PFlt_mAshOil_CUR PFlt_mSotAdjMax_C PFlt_mSotMeas_MAP PFlt_mSotSimMax_C PFlt_mSotSubs_C PFlt_rEGRSimMax_C PFlt_rEGRSimMin_C PFlt_resFlowAdiOfs_MAP PFlt_resFlowMeasInv_MAP PFlt_resFlowOilOfs_MAP PFlt_resFlowPhysMax_C PFlt_resFlow_MAP PFlt_stResFlowPT1RgnMsk_C PFlt_stSimRgnMsk_C PFlt_swtSensEvalSel_C PFlt_swtSimInitOn_C PFlt_tiDebSimOff_C PFlt_tiDebSimOn_C PFlt_tiResFlowPT1_C PFlt_tiResFlowRgnPT1_C PFlt_tiVolFlowPT1_C PFlt_tiVolFlowRgnPT1_C PFlt_volPFlt_C /end DEF_CHARACTERISTIC
 /begin IN_MEASUREMENT Eng_nAvrg InjCtl_qSetUnBal PFlt_dmO2Aprx PFlt_dqSetUnBal_mp PFlt_dvol PFlt_dvolMassFlt_mp PFlt_facDesCor_mp PFlt_mAshAdi_mp PFlt_mAshOil PFlt_mAsh_mp PFlt_mSotCrv_mp PFlt_mSotSim PFlt_pDiff PFlt_qFlTot PFlt_resFlowFlt PFlt_tOxiPre PFlt_tSurf PFlt_volAddTot_mp /end IN_MEASUREMENT
/end FUNCTION
/begin FUNCTION pflt_masscalc_msg ""
 /begin OUT_MEASUREMENT PFlt_mAshOil PFlt_mAshOilNorm PFlt_mSot PFlt_mSotMeas PFlt_mSotSim PFlt_resFlow PFlt_resFlowFlt PFlt_resFlowOfs PFlt_rSot PFlt_stSimOn /end OUT_MEASUREMENT
/end FUNCTION
/begin FUNCTION pflt_masscalc_uic ""
 /begin DEF_CHARACTERISTIC PFlt_mSot_Vector PFlt_mSot_Channel PFlt_resFlow_Vector PFlt_resFlow_Channel /end DEF_CHARACTERISTIC
 /begin OUT_MEASUREMENT PFlt_dmNO2Tot_mp PFlt_dmNOxRaw_mp PFlt_dmSotSimDyn_mp PFlt_dmSotSimEmi_mp PFlt_dmSotSimRgnCRT_mp PFlt_dmSotSimRgnThr_mp PFlt_dmSotSimRgn_mp PFlt_dmSotSimSty_mp PFlt_dmSotSim_mp PFlt_dpDiff_mp PFlt_dqSetUnBal_mp PFlt_dvolMassFlt_mp PFlt_facDesCor_mp PFlt_facMltCor_mp PFlt_mAshAdi_mp PFlt_mAsh_mp PFlt_mSotCrv_mp PFlt_mSotEEPROM_mp PFlt_mSotMeasRaw_mp PFlt_resFlowAdiOfs_mp PFlt_resFlowOilOfs_mp PFlt_resFlowRaw_mp PFlt_stSimOn_mp PFlt_volAddTot_mp /end OUT_MEASUREMENT
/end FUNCTION
/begin FUNCTION pflt_monitor "Überwachung des Partikelfilters"
 /begin DEF_CHARACTERISTIC PFlt_ddvolHsLnPlausNeg_C PFlt_ddvolHsLnPlausPos_C PFlt_ddvolHsLnSot_C PFlt_dvolCharMonMin_C PFlt_nTempChkTrg_C PFlt_numCntBck_C PFlt_numCntMax_C PFlt_numPFltMon_C PFlt_numTimeStpPlausSens_C PFlt_pBPAndAPTolcMax_C PFlt_pDiffCharMonMin_C PFlt_pDiffHsLnNeg_C PFlt_pDiffMax_C PFlt_pDiffMin_C PFlt_pDiffTolcMax_C PFlt_pMinNrmCldStrt_C PFlt_pPreAndBPTolcMax_C PFlt_pPreTolcMax_C PFlt_resFlowMax_C PFlt_resFlowMin_C PFlt_resFlowTolcDynPlaus_C PFlt_stCfgTempSens_C PFlt_swtEnvTempSens_C PFlt_swtMonCharMin_C PFlt_swtSvcSensChng_C PFlt_swtSvcTmrRst_C PFlt_tCldStrtDfl_C PFlt_tDiffCldMax_C PFlt_tDiffTolcMax_C PFlt_tDwnStrmTolcMax_C PFlt_tEGMax_C PFlt_tEGMin_C PFlt_tFrzMin_C PFlt_tiChkTempPlausMax_CUR PFlt_DebCharMaxDef_C PFlt_DebCharMaxOk_C PFlt_DebCharMinDef_C PFlt_DebCharMinOk_C PFlt_DebEngPrtMaxDef_C PFlt_DebEngPrtMaxOk_C PFlt_DebPDiffDynPlausDef_C PFlt_DebPDiffDynPlausOk_C PFlt_DebHsLnPlausDef_C PFlt_DebHsLnPlausOk_C PFlt_DebPDiffMaxDef_C PFlt_DebPDiffMaxOk_C PFlt_DebPDiffMinDef_C PFlt_DebPDiffMinOk_C PFlt_DebSotPlausDef_C PFlt_DebSotPlausOk_C PFlt_DebRgnPermMaxDef_C PFlt_DebRgnPermMaxOk_C PFlt_DebTEGMaxDef_C PFlt_DebTEGMaxOk_C PFlt_DebTEGMinDef_C PFlt_DebTEGMinOk_C PFlt_tiDelOfsCalc_C PFlt_tiLckChkTempPlaus_C PFlt_tIncrDwnStrm_C PFlt_tIncrUpStrm_C PFlt_tiFltHsLnPT1_C PFlt_tUpStrmTolcMax_C /end DEF_CHARACTERISTIC
 /begin IN_MEASUREMENT BattCD_u /end IN_MEASUREMENT
/end FUNCTION
/begin FUNCTION pflt_monitor_msg "" /begin OUT_MEASUREMENT PFlt_stAftRunDelDem /end OUT_MEASUREMENT /end FUNCTION
/begin FUNCTION pflt_monitor_proj "Customer specific particulate filter monitoring functions."
 /begin DEF_CHARACTERISTIC PFlt_ctEngPrtRgn_C PFlt_DebAPSPlausDefHigh_C PFlt_DebAPSPlausDefLow_C PFlt_DebBPSPlausDefHigh_C PFlt_DebBPSPlausDefLow_C PFlt_DebPresPlausDefHigh_C PFlt_DebPresPlausDefLow_C PFlt_DebRstDfpEngPrtRgnMon_C PFlt_dvolRstDfpEngPrtMon_C PFlt_lRstDfpEngPrtMon_C PFlt_mLoIdlSotSimMax_C PFlt_mSotDiff_C PFlt_nLoIdlMax_C PFlt_nLoIdlMin_C PFlt_nMin_C PFlt_nStrtMax_C PFlt_nStrtMin_C PFlt_numEngPrtActvMsk_C PFlt_pAPSNegDvt_C PFlt_pAPSPosDvt_C PFlt_pBPSNegDvt_C PFlt_pBPSPosDvt_C PFlt_pDiffMax1_C PFlt_pPreAshOilCorr_MAP PFlt_pPreCorrMax_C PFlt_pPresNegDvt_C PFlt_pPreSotSimCorr_MAP PFlt_pPresPlausMaxDvt_C PFlt_pPresPlausMinDvt_C PFlt_pPresPosDvt_C PFlt_pPreVolCorr_CUR PFlt_rEngPrtRgnMax_C PFlt_rLoIdlTVAMax_C PFlt_stLoIdlEGTMsk_C PFlt_swtDiagRlsmSotCtl_C PFlt_swtEngPrtWrEEPROM_C PFlt_tiDebAftRunTst_C PFlt_tiDebLoIdl_C PFlt_DebmSotMaxDef_C PFlt_DebmSotMaxOk_C PFlt_tiDebPresDblDef_C PFlt_tiDebPresPlausOk_C PFlt_tiDebT15On_C PFlt_tiFstEngPrtRgnMax_C PFlt_tiLoIdlSnceRgnMax_C /end DEF_CHARACTERISTIC
 /begin IN_MEASUREMENT PFlt_dvol PFlt_mAshOil PFlt_mSotSim /end IN_MEASUREMENT
/end FUNCTION
/begin FUNCTION pflt_monitor_proj_msg "" /end FUNCTION
/begin FUNCTION pflt_monitor_proj_uic ""
 /begin OUT_MEASUREMENT PFlt_ctEngPrtRgn_mp PFlt_pAPSBPSDiff_mp PFlt_pAPSDvt_mp PFlt_pAPSPFltPresDiff_mp PFlt_pBPSDvt_mp PFlt_pBPSPFltPresDiff_mp PFlt_pPFltPresDvt_mp PFlt_pPreAshOilCorr_mp PFlt_pPreCorr_mp PFlt_pPreSotAshCorrSum_mp PFlt_pPreSotSimCorr_mp PFlt_pPreVolCorr_mp PFlt_rEngPrtRgn_mp PFlt_stAPSPlausDefHigh_mp PFlt_stAPSPlausDefLow_mp PFlt_stBPSPlausDefHigh_mp PFlt_stBPSPlausDefLow_mp PFlt_stEngPrtRgn_mp PFlt_stPresPlausDefHigh_mp PFlt_stPresPlausDefLow_mp PFlt_stPresPlausLoIdl_mp PFlt_stPresPlausOk_mp PFlt_stPresPlausTst_mp PFlt_stPresPlaus_mp PFlt_stRgnRlsOff_mp PFlt_stRlsmSotCtl_mp PFlt_tiOpOld_mp PFlt_tiSnceFstEngPrtRgn_mp /end OUT_MEASUREMENT
/end FUNCTION
/begin FUNCTION pflt_monitor_uic ""
 /begin OUT_MEASUREMENT PFlt_ddvolFlt_mp PFlt_dpDiffFlt_mp PFlt_dpDiffNegDef_mp PFlt_dpDiffPosDef_mp PFlt_dvolFlt_mp PFlt_pDiffFlt_mp PFlt_pDiffOfsValActMid_mp PFlt_pDiffOfsValAct_mp PFlt_pDiffOfsValOld_mp PFlt_stLckTempPlaus_mp PFlt_stLckTmr_mp PFlt_stPresDiffPlaus_mp PFlt_stResFlowHi_mp PFlt_stResFlowLo_mp PFlt_stTempPlausDone_mp PFlt_tDwnStrm_mp PFlt_tIATLoLvl_mp PFlt_tiChkTmpPlaus_mp PFlt_tPFltMon_mp PFlt_tUpStrm_mp /end OUT_MEASUREMENT
/end FUNCTION
/begin FUNCTION pflt_sensadapt "Sensor Adaption"
 /begin DEF_CHARACTERISTIC PFlt_pDfl_C PFlt_pDiffDfl_MAP PFlt_dpDiffUp_C PFlt_dpDiffDwn_C PFlt_swtPDiffOfsOn_C PFlt_swtPresSensCfg_C PFlt_tiPPrePT1_C /end DEF_CHARACTERISTIC
 /begin IN_MEASUREMENT Eng_nAvrg InjCtl_qSetUnBal /end IN_MEASUREMENT
/end FUNCTION
/begin FUNCTION pflt_sensadapt_msg ""
 /begin OUT_MEASUREMENT PFlt_pDiff PFlt_pDiffRaw PFlt_pMid PFlt_pPre PFlt_pPreFlt PFlt_tOxiPre PFlt_tPre /end OUT_MEASUREMENT
/end FUNCTION
/begin FUNCTION pflt_sensadapt_uic "" /begin OUT_MEASUREMENT PFlt_pDiffDfl_mp /end OUT_MEASUREMENT /end FUNCTION
/begin FUNCTION pflt_tempmod "Partikelfiltertemperaturmodell"
 /begin DEF_CHARACTERISTIC PFlt_cpExhGs_C PFlt_CPFlt_C PFlt_facBlwBy_C PFlt_facDpn_MAP PFlt_facHtTransNoLin_CUR PFlt_KdDT1TempCor_C PFlt_kiITempMod_C PFlt_stRgnMsk1_C PFlt_stRgnMsk2_C PFlt_swtFacDpn_C PFlt_swtTempModOff_C PFlt_tExhGsStyRgn1_MAP PFlt_tExhGsStyRgn2_MAP PFlt_tExhGsSty_MAP PFlt_tiExhGsDel_CUR PFlt_tiHtTransDT1_CUR PFlt_tiOxiPreStyPT1_C PFlt_tiFltTempPT1_C PFlt_tiPreStyPT1_C PFlt_tRefSty_C /end DEF_CHARACTERISTIC
 /begin IN_MEASUREMENT Eng_nAvrg IATSCD_tAir InjCtl_qSetUnBal PFlt_dmEG PFlt_tDiffCorr_mp VSSCD_v /end IN_MEASUREMENT
/end FUNCTION
/begin FUNCTION pflt_tempmod_msg "" /begin OUT_MEASUREMENT PFlt_tOxiPreSty PFlt_tPreSty PFlt_tPstSim PFlt_tSurf /end OUT_MEASUREMENT /end FUNCTION
/begin FUNCTION pflt_tempmod_uic ""
 /begin OUT_MEASUREMENT PFlt_facDpn_mp PFlt_qPoI1Des_mp PFlt_tDiffCorr_mp PFlt_tExhGsStyRgn1_mp PFlt_tExhGsStyRgn2_mp PFlt_tHtTransCor_mp PFlt_tiExhGsDel_mp PFlt_tiHtTransDT1_mp PFlt_tOxiPreRaw_mp PFlt_tPreCorr_mp PFlt_tPreRaw_mp PFlt_tSurfSim_mp PFlt_tTotCor_mp /end OUT_MEASUREMENT
/end FUNCTION
/begin FUNCTION prpbrk_msg "" /begin OUT_MEASUREMENT PrpBrk_trqDes PrpBrk_trqLead /end OUT_MEASUREMENT /end FUNCTION
/begin COMPU_METHOD Acc "Fahrzeugbeschleunigung" RAT_FUNC "%6.5" "m/s^2" COEFFS 0 1000 0 0 0 1 /end COMPU_METHOD
/begin COMPU_METHOD AirMassPerCyl "Luftmasse pro Zylinder" RAT_FUNC "%6.3" "mg/Hub" COEFFS 0 10 0 0 0 1 /end COMPU_METHOD
/begin COMPU_METHOD AirMassPerTime "Luftmasse pro Zeit" RAT_FUNC "%6.3" "Kg/h" COEFFS 0 10 0 0 0 1 /end COMPU_METHOD
/begin COMPU_METHOD CubMtrPerHr "Volumsstrom in m^3/h" RAT_FUNC "%6.3" "m^3/h" COEFFS 0 10 0 0 0 1 /end COMPU_METHOD
/begin COMPU_METHOD CubMtrPerHrPerSec "Volumenstromdifferenz pro Sekunde" RAT_FUNC "%6.3" "m^3/h/s" COEFFS 0 10 0 0 0 1 /end COMPU_METHOD
/begin COMPU_METHOD Curr "Strom" RAT_FUNC "%6.2" "mA" COEFFS 0 1 0 0 0 1 /end COMPU_METHOD
/begin COMPU_METHOD dmSoot_mg_p_s "differenzielle Rußmasse mg/s" RAT_FUNC "%6.4" "mg/s" COEFFS 0 100 0 0 0 1 /end COMPU_METHOD
/begin COMPU_METHOD DtyCyc "Tastverhaeltnis" RAT_FUNC "%6.4" "%" COEFFS 0 100 0 0 0 1 /end COMPU_METHOD
/begin COMPU_METHOD EngN "Motordrehzahl" RAT_FUNC "%6.2" "rpm" COEFFS 0 1 0 0 0 1 /end COMPU_METHOD
/begin COMPU_METHOD EngTempFldSel "Verbale Umrechnung für Auswahl aus dem Motortemperatur-Feld Eng_tFld" TAB_VERB "%6.3" "-" COMPU_TAB_REF EngTempFldSel /end COMPU_METHOD
/begin COMPU_VTAB EngTempFldSel "Verbale Umrechnung für Auswahl aus dem Motortemperatur-Feld Eng_tFld" TAB_VERB 3 0 "Coolant_Temperature" 1 "Oil_Temperature" 2 "Eng_tEng" /end COMPU_VTAB
/begin COMPU_METHOD Fact "Faktor mit Auflösung 1 / 8192, hauptsächlich für einen Faktorenbereich 0...1 verwendet" RAT_FUNC "%6.5" "-" COEFFS 0 8192 0 0 0 1 /end COMPU_METHOD
/begin COMPU_METHOD Fact1 "Faktor mit Auflösung 0,01 (100 mal höherer Bereich als Fact)" RAT_FUNC "%6.4" "-" COEFFS 0 128 0 0 0 1 /end COMPU_METHOD
/begin COMPU_METHOD Fl_2 "Umrechnung for getting 16 bit  total fuel consumption" RAT_FUNC "%6.1" "l" COEFFS 0 0.1 0 0 0 1 /end COMPU_METHOD
/begin COMPU_METHOD Fl_Half_L "Kraftstoffverbrauchsintegral" RAT_FUNC "%6.4" "l" COEFFS 0 20 0 0 0 1 /end COMPU_METHOD
/begin COMPU_METHOD Fl_L "Treibstoffmenge [l]" RAT_FUNC "%6.4" "l" COEFFS 0 100 0 0 0 1 /end COMPU_METHOD
/begin COMPU_METHOD Fl_Vol "Kraftstoffverbrauch pro 100 km" RAT_FUNC "%6.5" "l/100km" COEFFS 0 1000 0 0 0 1 /end COMPU_METHOD
/begin COMPU_METHOD hPaPerSec "Differenzdruck pro Sekunde" RAT_FUNC "%6.3" "hPa/s" COEFFS 0 10 0 0 0 1 /end COMPU_METHOD
/begin COMPU_METHOD IndSysTempFldSel "Auswahl für Lufttemperaturfeld" TAB_VERB "%6.3" "-" COMPU_TAB_REF IndSysTempFldSel /end COMPU_METHOD
/begin COMPU_VTAB IndSysTempFldSel "Auswahl für Lufttemperaturfeld" TAB_VERB 3 0 "IATSCD_tAir" 1 "AFSCD_tAir" 2 "EATSCD_tAir" /end COMPU_VTAB
/begin COMPU_METHOD InjMass "Einspritzmenge" RAT_FUNC "%6.4" "mg/hub" COEFFS 0 100 0 0 0 1 /end COMPU_METHOD
/begin COMPU_METHOD InjMassCyc "Einspritzmenge pro Zyklus (mg/Zyklus)" RAT_FUNC "%6.4" "mg/cyc" COEFFS 0 100 0 0 0 1 /end COMPU_METHOD
/begin COMPU_METHOD InjMassInj "Einspritzmenge pro Einspritzung (mg/Einspritzung)" RAT_FUNC "%6.4" "mg/inj" COEFFS 0 100 0 0 0 1 /end COMPU_METHOD
/begin COMPU_METHOD Kd "Differentialverstärkung Kd (gleiche Einheit/Umrechnungsformel an Ein- und Ausgang)" RAT_FUNC "%7.6" "1/1" COEFFS 0 65536 0 0 0 1 /end COMPU_METHOD
/begin COMPU_METHOD Ki "Integrale Verstärkung Ki (gleiche Einheit/Umrechnungsregel an Ein- und Ausgang)" RAT_FUNC "%6.5" "1/s" COEFFS 0 4294.967296 0 0 0 1 /end COMPU_METHOD
/begin COMPU_METHOD lambda "Lambda" RAT_FUNC "%6.5" "-" COEFFS 0 1000 0 0 0 1 /end COMPU_METHOD
/begin COMPU_METHOD Length "Länge in Meter" RAT_FUNC "%6.2" "m" COEFFS 0 1 0 0 0 1 /end COMPU_METHOD
/begin COMPU_METHOD LengthKm "Länge in Kilometer" RAT_FUNC "%6.2" "km" COEFFS 0 1 0 0 0 1 /end COMPU_METHOD
/begin COMPU_METHOD lSnceRgnRes "Driven distance since last successful regeneration" RAT_FUNC "%6.0" "m" COEFFS 0 0.0078125 0 0 0 1 /end COMPU_METHOD
/begin COMPU_METHOD lSumRes "Total driven distance" RAT_FUNC "%8.0" "m" COEFFS 0 6.103515625e-05 0 0 0 1 /end COMPU_METHOD
/begin COMPU_METHOD mSoot_g "Rußmasse [g]" RAT_FUNC "%6.4" "g" COEFFS 0 100 0 0 0 1 /end COMPU_METHOD
/begin COMPU_METHOD NumPinAdc "verbale Umrechnung für ADC Signale" TAB_VERB "%6.3" "-" COMPU_TAB_REF NumPinAdc /end COMPU_METHOD
/begin COMPU_VTAB NumPinAdc "verbale Umrechnung für ADC Signale" TAB_VERB 25 0 "Water_Temperature_Sensor_182" 1 "Intake_Air_Temperature_Sensor_157" 2 "Charge_Air_Temperature_Sensor_183" 3 "Exhaust_Temperature_Sensor_2_134" 4 "Exhaust_Temperature_Sensor_1_158" 5 "1st_APP_Sensor_252" 6 "2nd_APP_Sensor_239" 7 "ADC_REF" 8 "Boost_Pressure_Sensor_154" 9 "Atmospheric_Pressure_Sensor" 10 "Battery_Voltage_Sensor" 11 "Rail_Pressure_Sensor_156" 12 "Rail_Pressure_Peak_Value_156" 13 "Booster_Voltage_Sensor" 14 "Current_MeUn_Sensor" 15 "Current_PCV_Sensor" 16 "Voltage_Bank_1" 17 "Voltage_Bank_2" 18 "Pressure_Upstream_Particle_Filter_159" 19 "Engine_Oil_Pressure_110" 20 "Temperature_ECU_PCB" 21 "Voltage_Lambda_Ua" 22 "Voltage_Lambda_Ri" 23 "ADC_DUMMY_NOT_USED" 24 "ADC_DUMMY_A_NOT_USED" /end COMPU_VTAB
/begin COMPU_METHOD OneToOne "eins zu eins (physikalischer Wert ist gleich dem internen Wert)" RAT_FUNC "%6.2" "-" COEFFS 0 1 0 0 0 1 /end COMPU_METHOD
/begin COMPU_METHOD Prc "Prozent, gleiche interne Auflösung wie Fact, aber Darstellung in Prozent (0...100%)" RAT_FUNC "%6.4" "%" COEFFS 0 81.92 0 0 0 1 /end COMPU_METHOD
/begin COMPU_METHOD Pres "Druck (angezeigt in [kPa])" RAT_FUNC "%7.2" "hPa" COEFFS 0 1.000000 0 0 0 1 /end COMPU_METHOD
/begin COMPU_METHOD Pres_hPa "Druck (angezeigt in [hPa])" RAT_FUNC "%6.2" "hPa" COEFFS 0 1 0 0 0 1 /end COMPU_METHOD
/begin COMPU_METHOD Pres_Rail "Raildruck in hPa" RAT_FUNC "%4.3" "bar" COEFFS 0 10.000000 0 0 0 1 /end COMPU_METHOD
/begin COMPU_METHOD Res_hPaHrPerCM "Strömungswiderstand [hPa h/m3]" RAT_FUNC "%6.5" "hPa/(m^3/h)" COEFFS 0 1000 0 0 0 1 /end COMPU_METHOD
/begin COMPU_METHOD RmpPres "Rampengradient für Druck" RAT_FUNC "%7.3" "hPa/s" COEFFS 0 65.536000 0 0 0 1 /end COMPU_METHOD
/begin COMPU_METHOD RmpPres_hPa "Rampengradient für Druck angezeigt in [hPa/s]" RAT_FUNC "%6.4" "hPa/s" COEFFS 0 65.536 0 0 0 1 /end COMPU_METHOD
/begin COMPU_METHOD RmpTemp "Rampengradient für Temperatur" RAT_FUNC "%6.4" "deg C/s" COEFFS 0 655.36 0 0 0 1 /end COMPU_METHOD
/begin COMPU_METHOD Soot_gPerLtr "Partikelmasse pro Filtervolumen" RAT_FUNC "%6.4" "g/l" COEFFS 0 100 0 0 0 1 /end COMPU_METHOD
/begin COMPU_METHOD TempDiff_Cels "difference/offset temperature displayed in degree celcius" RAT_FUNC "%6.3" "deg C" COEFFS 0 10 0 0 0 1 /end COMPU_METHOD
/begin COMPU_METHOD Temp_Cels "Temperatur dargestellt in °C (gleiche interne Darstellung wie Temp_Kelv)" RAT_FUNC "%6.1" "deg C" COEFFS 0 10 2731.4 0 0 1 /end COMPU_METHOD
/begin COMPU_METHOD Temp_Kelv "Temperatur dargestellt in Kelvin" RAT_FUNC "%6.3" "deg C" COEFFS 0 10 0 0 0 1 /end COMPU_METHOD
/begin COMPU_METHOD Thr_Cpty "Wärmekapazität" RAT_FUNC "%6.2" "J/K" COEFFS 0 1 0 0 0 1 /end COMPU_METHOD
/begin COMPU_METHOD Thr_Cpty_ExhGs "Wärmekapazität des Abgases" RAT_FUNC "%6.2" "J/kgK" COEFFS 0 0.1 0 0 0 1 /end COMPU_METHOD
/begin COMPU_METHOD TimeDeb "Entprellzeit in Millisekunden für Libraryfunktion Debounce" RAT_FUNC "%6.1" "ms" COEFFS 0 0.1 0 0 0 1 /end COMPU_METHOD
/begin COMPU_METHOD TimeDelay_s "Zeitkonstante T1 (in s) für PT1, DT1, etc." RAT_FUNC "%9.3" "s" COEFFS 0 0 1 0 0.00023283064365387 0 /end COMPU_METHOD
/begin COMPU_METHOD TimeEngOn "Motorbetriebszeit in Sekunden" RAT_FUNC "%6.2" "s" COEFFS 0 1 0 0 0 1 /end COMPU_METHOD
/begin COMPU_METHOD TimePFltLimpHome "" RAT_FUNC "%6.1" "s" COEFFS 0 0.1 0 0 0 1 /end COMPU_METHOD
/begin COMPU_METHOD Time_ms "Zeit in ms für Fehlerentprellung (DSM) und SW-Timer" RAT_FUNC "%6.1" "ms" COEFFS 0 0.1 0 0 0 1 /end COMPU_METHOD
/begin COMPU_METHOD Time_s "Zeit in s für Fehlerentprellung (DSM) und SW-Timer" RAT_FUNC "%6.4" "s" COEFFS 0 100 0 0 0 1 /end COMPU_METHOD
/begin COMPU_METHOD tiOpRes "Engine operation time" RAT_FUNC "%6.1" "s" COEFFS 0 0.015625 0 0 0 1 /end COMPU_METHOD
/begin COMPU_METHOD tiSncergnRes "Engine operation time since last successful regeneration" RAT_FUNC "%6.0" "s" COEFFS 0 0.00390625 0 0 0 1 /end COMPU_METHOD
/begin COMPU_METHOD TrqPrp "Vortriebsmoment" RAT_FUNC "%6.3" "Nm" COEFFS 0 5 0 0 0 1 /end COMPU_METHOD
/begin COMPU_METHOD Vel "Fahrzeuggeschwindigkeit, gleiche interne Auflösung wie Vel_SI" RAT_FUNC "%6.4" "km/h" COEFFS 0 100 0 0 0 1 /end COMPU_METHOD
/begin COMPU_METHOD Vol "Volumen" RAT_FUNC "%6.4" "l" COEFFS 0 100 0 0 0 1 /end COMPU_METHOD
/begin COMPU_METHOD volAdd_ml2 "Umrechnung mit 1ml Auflösung für Additivmenge in AddPmp_AddMet" RAT_FUNC "%6.2" "ml" COEFFS 0 1 0 0 0 1 /end COMPU_METHOD
/begin COMPU_METHOD Volt "Spannung in V (von ADC)" RAT_FUNC "%6.2" "mV" COEFFS 0 0.2046 0 0 0 1 /end COMPU_METHOD
/begin COMPU_METHOD Volt_Batt "Batteriespannung" RAT_FUNC "%6.1" "mV" COEFFS 0 0.05115 0 0 0 1 /end COMPU_METHOD
/begin RECORD_LAYOUT Gkl_Ws16 FNC_VALUES 1 SWORD COLUMN_DIR DIRECT /end RECORD_LAYOUT
/begin RECORD_LAYOUT GSst_Xs16 NO_AXIS_PTS_X 1 SWORD AXIS_PTS_X 2 SWORD INDEX_INCR DIRECT /end RECORD_LAYOUT
/begin RECORD_LAYOUT Kf_Xs16_Ys16_Ws16 NO_AXIS_PTS_X 1 SWORD NO_AXIS_PTS_Y 2 SWORD AXIS_PTS_X 3 SWORD INDEX_INCR DIRECT AXIS_PTS_Y 4 SWORD INDEX_INCR DIRECT FNC_VALUES 5 SWORD COLUMN_DIR DIRECT /end RECORD_LAYOUT
/begin RECORD_LAYOUT Kf_Xu8_Yu8_Wu8 NO_AXIS_PTS_X 1 UBYTE NO_AXIS_PTS_Y 2 UBYTE AXIS_PTS_X 3 UBYTE INDEX_INCR DIRECT AXIS_PTS_Y 4 UBYTE INDEX_INCR DIRECT FNC_VALUES 5 UBYTE COLUMN_DIR DIRECT /end RECORD_LAYOUT
/begin RECORD_LAYOUT Kl_Xs16_Ws16 NO_AXIS_PTS_X 1 SWORD AXIS_PTS_X 2 SWORD INDEX_INCR DIRECT FNC_VALUES 3 SWORD COLUMN_DIR DIRECT /end RECORD_LAYOUT
/begin RECORD_LAYOUT Kwb_Wu32 FNC_VALUES 1 ULONG COLUMN_DIR DIRECT /end RECORD_LAYOUT
/begin RECORD_LAYOUT Kwb_Wu8 FNC_VALUES 1 UBYTE COLUMN_DIR DIRECT /end RECORD_LAYOUT
/begin RECORD_LAYOUT Kw_Ws16 FNC_VALUES 1 SWORD COLUMN_DIR DIRECT /end RECORD_LAYOUT
/begin RECORD_LAYOUT Kw_Ws32 FNC_VALUES 1 SLONG COLUMN_DIR DIRECT /end RECORD_LAYOUT
/begin RECORD_LAYOUT Kw_Ws8 FNC_VALUES 1 SBYTE COLUMN_DIR DIRECT /end RECORD_LAYOUT
/begin RECORD_LAYOUT Kw_Wu16 FNC_VALUES 1 UWORD COLUMN_DIR DIRECT /end RECORD_LAYOUT
/begin RECORD_LAYOUT Kw_Wu32 FNC_VALUES 1 ULONG COLUMN_DIR DIRECT /end RECORD_LAYOUT
/begin RECORD_LAYOUT Kw_Wu8 FNC_VALUES 1 UBYTE COLUMN_DIR DIRECT /end RECORD_LAYOUT
/end MODULE
/end PROJECT
