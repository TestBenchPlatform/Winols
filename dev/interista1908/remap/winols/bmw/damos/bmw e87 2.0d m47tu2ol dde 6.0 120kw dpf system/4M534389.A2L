ASAP2_VERSION 1 3
/begin PROJECT P389 "BMW DDE6.0 4-Zylinder V53.4 01.04.2004 CAN12H"
/begin HEADER "" VERSION "V53.4_4Z_CAN12H" PROJECT_NO P389 /end HEADER
/begin MODULE DIM ""
/begin MOD_COMMON "" BYTE_ORDER MSB_FIRST ALIGNMENT_BYTE 1 ALIGNMENT_WORD 2 ALIGNMENT_LONG 4 ALIGNMENT_FLOAT32_IEEE 4 /end MOD_COMMON
/begin CHARACTERISTIC ANZMRKAUS "wie oft die anzeige ausgeschalten wird" VALUE 0xC05BC KwWU8 255.0 dez 0.00 255.0 FORMAT "%5.1" /end CHARACTERISTIC
/begin CHARACTERISTIC ANZMRKMX "max. zulässige anzahl von geschwindigkeits- marken beim stufentempomat" VALUE 0xC05BD KwWU8 255.0 dez 0.00 255.0 FORMAT "%5.1" /end CHARACTERISTIC
/begin CHARACTERISTIC CrCtl_DebToVCrCtlDef_C "dfhjdghkj" VALUE 0xC90F0 Kw_Wu16 65535.00 OneToOne 0.00 65535.00 FORMAT "%8.2" /end CHARACTERISTIC
/begin CHARACTERISTIC CrCtl_DebToVCrCtlOk_C " Healing time for CrCtl_-messages Timeout" VALUE 0xC90F2 Kw_Wu16 65535.00 OneToOne 0.00 65535.00 FORMAT "%8.2" /end CHARACTERISTIC
/begin CHARACTERISTIC CrCtl_rAccPedVelMin_C "Minimum acc per ratio for cruise control" VALUE 0xC90F4 Kw_Ws16 799.9878 Prc -400.0000 399.9878 FORMAT "%8.4" /end CHARACTERISTIC
/begin CHARACTERISTIC CrCtl_swtCrCtlType_C "Schalter um Typ des Tempomats auszuwählen (1: herkömmlicher Tempomat, 2: Stufentempomat)" VALUE 0xC90F6 Kw_Wu8 255.0 OneToOne 0.00 255.0 FORMAT "%5.1" /end CHARACTERISTIC
/begin CHARACTERISTIC CrCtl_swtOffset_C "Umschaltung zwischen gesendeter und berechneter Anzeigegeschwindigkeit (1: berechnete, 0: gesendete)" VALUE 0xC90F7 Kw_Wu8 255.0 OneToOne 0.00 255.0 FORMAT "%5.1" /end CHARACTERISTIC
/begin CHARACTERISTIC CrCtl_swtVSSFil_C "Schalter zur Auswahl zwischen gefilterter und ungefilterter Fahrzeug-Ist-Geschwindigkeit (1: gefiltert 0: ungefiltert)" VALUE 0xC90F8 Kw_Wu8 255.0 OneToOne 0.00 255.0 FORMAT "%5.1" /end CHARACTERISTIC
/begin CHARACTERISTIC CrCtl_tiDisableDiagVCrCtl_C "Time to disable cruise control diagnostics" VALUE 0xC90FC Kw_Wu32 42949672950.0 Time_ms 0.00 42949672950.0 FORMAT "%13.1" /end CHARACTERISTIC
/begin CHARACTERISTIC CrCtl_tiDispOffFil_C "time delay for tracking speed set point" VALUE 0xC9100 Kw_Wu32 4294.9673 TimeDelay_s 0.0000010000000 4294.9673 FORMAT "%9.4" /end CHARACTERISTIC
/begin CHARACTERISTIC CrCtl_tiVSSFil_C "time delay for tracking speed set point" VALUE 0xC9104 Kw_Wu32 4294.9673 TimeDelay_s 0.0000010000000 4294.9673 FORMAT "%9.4" /end CHARACTERISTIC
/begin CHARACTERISTIC CrCtl_uBattMin_C "min batteriespannung" VALUE 0xC9108 Kw_Ws16 1281232. Volt_Batt -640625.6 640606.1 FORMAT "%8.1" /end CHARACTERISTIC
/begin CHARACTERISTIC CrCtl_vAlwMaxKm_C "maximal erlaubte FGR-geschw." VALUE 0xC910A Kw_Ws16 300.0000 Vel 0.00 300.0000 FORMAT "%8.4" EXTENDED_LIMITS -327.6800 327.6700 /end CHARACTERISTIC
/begin CHARACTERISTIC CrCtl_vAlwMaxM_C "max erlaubte FGR-geschwindigkeit" VALUE 0xC910C Kw_Ws16 300.0000 Vel_mph 0.00 300.0000 FORMAT "%8.4" EXTENDED_LIMITS -327.6800 327.6700 /end CHARACTERISTIC
/begin CHARACTERISTIC CrCtl_vAlwMinKm_C "min. erlaubte FGR-geschwindigkeit" VALUE 0xC910E Kw_Ws16 300.0000 Vel 0.00 300.0000 FORMAT "%8.4" EXTENDED_LIMITS -327.6800 327.6700 /end CHARACTERISTIC
/begin CHARACTERISTIC CrCtl_vAlwMinM_C "min. erlaubte FGR-geschwindigkeit" VALUE 0xC9110 Kw_Ws16 300.0000 Vel_mph 0.00 300.0000 FORMAT "%8.4" EXTENDED_LIMITS -327.6800 327.6700 /end CHARACTERISTIC
/begin CHARACTERISTIC CrCtl_vOffMax_C "Maximum velocity of cruise control" VALUE 0xC9112 Kw_Ws16 300.0000 Vel 0.00 300.0000 FORMAT "%8.4" EXTENDED_LIMITS -327.6800 327.6700 /end CHARACTERISTIC
/begin CHARACTERISTIC CrSCD_ctGapIncs_C "#SSD Kurbelwellenkonfiguration: Anzahl der fehlenden Inkremente in der Lücke (virtuelle Inkremente)" VALUE 0xC05F6 Kw_Wu8 0.00 OneToOne 2.000 2.000 FORMAT "%5.3" EXTENDED_LIMITS 0.00 255.0 /end CHARACTERISTIC
/begin CHARACTERISTIC CrSCD_ctGaps_C "#SSD Kurbelwellenkonfiguration: Anzahl der Lücken auf dem Inkrementgeberrad" VALUE 0xC05F7 Kw_Wu8 3.000 OneToOne 1.000 4.000 FORMAT "%5.3" EXTENDED_LIMITS 0.00 255.0 /end CHARACTERISTIC
/begin CHARACTERISTIC CrSCD_ctIncs_C "#SSD Kurbelwellenkonfiguration: Anzahl der Inkremente einschließlich virtueller Lückenzähne" VALUE 0xC05F8 Kw_Wu8 110.0 OneToOne 10.00 120.0 FORMAT "%5.1" EXTENDED_LIMITS 0.00 255.0 /end CHARACTERISTIC
/begin CHARACTERISTIC CrSCD_ctThresCtlMin_C "#SSD Kleinste Schwelle der dyn. Schwellennachführung des Kurbelwellensignals" VALUE 0xC05F0 Kw_Wu8 7.000 OneToOne 0.00 7.000 FORMAT "%5.3" EXTENDED_LIMITS 0.00 255.0 /end CHARACTERISTIC
/begin CHARACTERISTIC CrSCD_ctTurns_C "#SSD Anzahl der Kurbelwellenumdrehungen pro Nockenwellenumdrehung (1 = 2 Takter, 2 = 4 Takter)" VALUE 0xC05DE Kw_Wu8 1.000 OneToOne 1.000 2.000 FORMAT "%5.3" EXTENDED_LIMITS 0.00 255.0 /end CHARACTERISTIC
/begin CHARACTERISTIC CrSCD_facGapPlausHigh_CUR "#SSD Verhältnis zur Bestimmung der oberen Grenze des Fensters zur Lückenplausibilisierung des Inkrementsignals" CURVE 0xC9146 Kl_Xs16_Ws16 3.000000 Fact_Inc 3.000000 6.000000 FORMAT "%8.6" EXTENDED_LIMITS -128.0000 127.9961
 /begin AXIS_DESCR STD_AXIS CrSCD_tiIncr TimeDT 10 100.0000 32767.00 FORMAT "%8.2" EXTENDED_LIMITS 0.00 65535.00 DEPOSIT ABSOLUTE /end AXIS_DESCR
/end CHARACTERISTIC
/begin CHARACTERISTIC CrSCD_facGapPlausLow_CUR "#SSD Verhältnis zur Bestimmung der unteren Grenze des Fensters zur Lückenplausibilisierung des Inkrementsignals" CURVE 0xC9170 Kl_Xs16_Ws16 3.000000 Fact_Inc 0.00 3.000000 FORMAT "%8.6" EXTENDED_LIMITS -128.0000 127.9961
 /begin AXIS_DESCR STD_AXIS CrSCD_tiIncr TimeDT 10 100.0000 32767.00 FORMAT "%8.2" EXTENDED_LIMITS 0.00 65535.00 DEPOSIT ABSOLUTE /end AXIS_DESCR
/end CHARACTERISTIC
/begin CHARACTERISTIC CrSCD_facIncPlausHigh_CUR "#SSD Verhältnis zur Bestimmung der obere Grenze des Fensters zur Plausibilisierung des Inkrementsignals" CURVE 0xC919A Kl_Xs16_Ws16 1.000000 Fact_Inc 1.000000 2.000000 FORMAT "%8.6" EXTENDED_LIMITS -128.0000 127.9961
 /begin AXIS_DESCR STD_AXIS CrSCD_tiIncr TimeDT 10 100.0000 32767.00 FORMAT "%8.2" EXTENDED_LIMITS 0.00 65535.00 DEPOSIT ABSOLUTE /end AXIS_DESCR
/end CHARACTERISTIC
/begin CHARACTERISTIC CrSCD_facIncPlausLow_CUR "#SSD Verhältnis zur Bestimmung der unteren Grenze des Fensters zur Plausibilisierung des Inkrementsignals" CURVE 0xC91C4 Kl_Xs16_Ws16 1.000000 Fact_Inc 0.00 1.000000 FORMAT "%8.6" EXTENDED_LIMITS -128.0000 127.9961
 /begin AXIS_DESCR STD_AXIS CrSCD_tiIncr TimeDT 10 100.0000 32767.00 FORMAT "%8.2" EXTENDED_LIMITS 0.00 65535.00 DEPOSIT ABSOLUTE /end AXIS_DESCR
/end CHARACTERISTIC
/begin CHARACTERISTIC CrSCD_nFast_C "#SSD Frequenz für das winkelsynchrone Interruptsystem, wenn kein Inkrementsignal vorhanden" VALUE 0xC05E0 Kw_Ws16 8000.000 EngN 0.00 8000.000 FORMAT "%8.3" EXTENDED_LIMITS -32768.00 32767.00 /end CHARACTERISTIC
/begin CHARACTERISTIC CrSCD_nMax_C "#SSD Größte zulässige Frequenz des Inkrementsignals" VALUE 0xC05E2 Kw_Ws16 2000.000 EngN 5000.000 7000.000 FORMAT "%8.3" EXTENDED_LIMITS -32768.00 32767.00 /end CHARACTERISTIC
/begin CHARACTERISTIC CrSCD_nMin_C "#SSD Kleinste zulässige Frequenz des Inkrementsignals" VALUE 0xC05E4 Kw_Ws16 480.0000 EngN 20.00000 500.0000 FORMAT "%8.4" EXTENDED_LIMITS -32768.00 32767.00 /end CHARACTERISTIC
/begin CHARACTERISTIC CrSCD_nSlowHigh_C "#SSD Obere Drehzahlschwelle ab der das Slow-Bit für die Diahnose zurückgesetzt wird" VALUE 0xC05E6 Kw_Ws16 3000.000 EngN 0.00 3000.000 FORMAT "%8.3" EXTENDED_LIMITS -32768.00 32767.00 /end CHARACTERISTIC
/begin CHARACTERISTIC CrSCD_nSlow_C "#SSD Schwelle ab der Unterdrehzahl gemeldet wird" VALUE 0xC05E8 Kw_Ws16 1000.000 EngN 0.00 1000.000 FORMAT "%8.3" EXTENDED_LIMITS -32768.00 32767.00 /end CHARACTERISTIC
/begin CHARACTERISTIC CrSCD_nThresCtlHigh_C "#SSD Obere Schwelle zur Aktiviereung der dyn. Schwellennachführung" VALUE 0xC05F2 Kw_Ws16 65535.00 EngN -32768.00 32767.00 FORMAT "%8.2" /end CHARACTERISTIC
/begin CHARACTERISTIC CrSCD_nThresCtlLow_C "#SSD Untere Schwelle zur Aktivierung der dyn. Schwellennachführung" VALUE 0xC05F4 Kw_Ws16 65535.00 EngN -32768.00 32767.00 FORMAT "%8.2" /end CHARACTERISTIC
/begin CHARACTERISTIC CrSCD_numFBCSeg_C "#SSD Anzahl der FBC segmente" VALUE 0xC05F9 Kw_Wu8 7.000 OneToOne 1.000 8.000 FORMAT "%5.3" EXTENDED_LIMITS 0.00 255.0 /end CHARACTERISTIC
/begin CHARACTERISTIC CrSCD_numShftMisf_C "#SSD Phasenverschiebung Segmentsystem für Aussetzererkennung (in MAR-Segmenten)" VALUE 0xC05EA Kw_Wu8 1.000 OneToOne 0.00 1.000 FORMAT "%5.3" EXTENDED_LIMITS 0.00 255.0 /end CHARACTERISTIC
/begin CHARACTERISTIC CrSCD_numTDCSeg_C "#SSD Anzahl der Segment pro OT" VALUE 0xC05FA Kw_Wu8 0.00 OneToOne 2.000 2.000 FORMAT "%5.3" EXTENDED_LIMITS 0.00 255.0 READ_ONLY /end CHARACTERISTIC
/begin CHARACTERISTIC CrSCD_phiGap2Zero_C "#SSD Winkel zwischen Lücke und physikalischer Nullposition" VALUE 0xC05FC Kw_Ws16 720.0000 AngleCrS 0.00 720.0000 FORMAT "%8.4" EXTENDED_LIMITS -768.0000 767.9766 /end CHARACTERISTIC
/begin CHARACTERISTIC CrSCD_phiIncCor_CUR "#SSD Phasenkorrekturkennlinie des Inkrementsystems der Kurbelwelle" CURVE 0xC9114 Kl_Xs16_Ws16 50.01562 AngleCrS -25.00781 25.00781 FORMAT "%8.5" EXTENDED_LIMITS -768.0000 767.9766
 /begin AXIS_DESCR STD_AXIS CrSCD_nAvrg EngN 12 0.00 6000.000 FORMAT "%8.3" EXTENDED_LIMITS -32768.00 32767.00 DEPOSIT ABSOLUTE /end AXIS_DESCR
/end CHARACTERISTIC
/begin CHARACTERISTIC CrSCD_phiSegLength_C "#SSD Kurbelwellenkonfiguration: Segementlänge" VALUE 0xC05EC Kw_Ws16 90.00000 AngleCrS 30.00000 120.0000 FORMAT "%8.4" EXTENDED_LIMITS -768.0000 767.9766 /end CHARACTERISTIC
/begin CHARACTERISTIC CrSCD_phiSegPhase_C "#SSD Phasenlage der Drehzahlsegmente zum OT" VALUE 0xC05EE Kw_Ws16 720.0000 AngleCrS 0.00 720.0000 FORMAT "%8.4" EXTENDED_LIMITS -768.0000 767.9766 /end CHARACTERISTIC
/begin CHARACTERISTIC CrSCD_tiPlausCalcOff_C "#SSD Schwelle zum Abschalten der Berechnung der Plausibilitätsfenster" VALUE 0xC05FE Kw_Ws16 32767.00 TimeDT 0.00 32767.00 FORMAT "%8.2" EXTENDED_LIMITS -32768.00 32767.00 /end CHARACTERISTIC
/begin CHARACTERISTIC CrS_ctMaxInjStrt_C "#SSD Maximale Anzahl von Testeinspritzungen" VALUE 0xC05C8 Kw_Wu16 100.0000 OneToOne 0.00 100.0000 FORMAT "%8.4" EXTENDED_LIMITS 0.00 65535.00 /end CHARACTERISTIC
/begin CHARACTERISTIC CrS_facSegTimeMax_C "#SSD Maximales Verhältnis der Segmentzeiten, das eine konstante Motordrehzahl signalisiert" VALUE 0xC05CC Kw_Ws32 100.000000000 Fact1 0.00 100.000000000 FORMAT "%13.9" EXTENDED_LIMITS -16777216.0000 16777215.9922 /end CHARACTERISTIC
/begin CHARACTERISTIC CrS_facSegTimeMin_C "#SSD Minimales Verhältnis der Segmentzeiten, das eine konstante Motordrehzahl signalisiert" VALUE 0xC05D0 Kw_Ws32 100.000000000 Fact1 0.00 100.000000000 FORMAT "%13.9" EXTENDED_LIMITS -16777216.0000 16777215.9922 /end CHARACTERISTIC
/begin CHARACTERISTIC CrS_facSegTime_C "#SSD Verhältnis der Segmentzeiten" VALUE 0xC05D4 Kw_Ws32 99.0000000000 Fact1 1.00000000000 100.000000000 FORMAT "%13.9" EXTENDED_LIMITS -16777216.0000 16777215.9922 /end CHARACTERISTIC
/begin CHARACTERISTIC CrS_phiSegLengthStrtSpd_C "#SSD Segmentlänge, die berechnet werden soll" VALUE 0xC05D8 Kw_Ws16 180.0000 AngleCrS 0.00 180.0000 FORMAT "%8.4" EXTENDED_LIMITS -768.0000 767.9766 /end CHARACTERISTIC
/begin CHARACTERISTIC CrS_phiSegOfsStrtSpdOld_C "#SSD Segment Offset des alten Segmentes bezüglich TDC" VALUE 0xC05DA Kw_Ws16 1440.000 AngleCrS -720.0000 720.0000 FORMAT "%8.4" EXTENDED_LIMITS -768.0000 767.9766 /end CHARACTERISTIC
/begin CHARACTERISTIC CrS_phiSegOfsStrtSpd_C "#SSD Segment Offset des aktuellen Segmentes bezüglich TDC" VALUE 0xC05DC Kw_Ws16 1440.000 AngleCrS -720.0000 720.0000 FORMAT "%8.4" EXTENDED_LIMITS -768.0000 767.9766 /end CHARACTERISTIC
/begin CHARACTERISTIC CTSCD_uSRCMin_C "Minimalwert für SRC WTF-Sensor" VALUE 0xC91F0 Kw_Ws16 5200.391 Volt 0.00 5200.391 FORMAT "%8.3" EXTENDED_LIMITS -160156.4 160151.5 /end CHARACTERISTIC
/begin CHARACTERISTIC CTSCD_uSRCMax_C "Maximalwert für SRC WTF-Sensor" VALUE 0xC91F2 Kw_Ws16 5200.391 Volt 0.00 5200.391 FORMAT "%8.3" EXTENDED_LIMITS -160156.4 160151.5 /end CHARACTERISTIC
/begin CHARACTERISTIC CTSCD_tLin_CUR "Linearisierungskennlinie für WTF-Sensor" CURVE 0xC91F4 Kl_Xs16_Ws16 950.0000 Temp_Cels -50.1400 899.8600 FORMAT "%8.4" EXTENDED_LIMITS -3549.940 3003.560
 /begin AXIS_DESCR STD_AXIS CTSCD_uRaw Volt 20 0.00 5200.391 FORMAT "%8.3" EXTENDED_LIMITS -160156.4 160151.5 DEPOSIT ABSOLUTE /end AXIS_DESCR
/end CHARACTERISTIC
/begin CHARACTERISTIC CTSCD_DebSigDef_C "#SSD Fehlerentprellung Wassertemperatur über CAN" VALUE 0xC9246 Kw_Wu16 655350.0 Time_ms 0.00 655350.0 FORMAT "%8.1" /end CHARACTERISTIC
/begin CHARACTERISTIC CTSCD_DebSigOk_C "Heilungsentprellung Wassertemperatur über CAN" VALUE 0xC9248 Kw_Wu16 655350.0 Time_ms 0.00 655350.0 FORMAT "%8.1" /end CHARACTERISTIC
/begin CHARACTERISTIC CTSCD_DebSRCHighDef_C "#SSD WTF Fehlerentprellzeit fuer SRC-High" VALUE 0xC924A Kw_Wu16 655350.0 Time_ms 0.00 655350.0 FORMAT "%8.1" /end CHARACTERISTIC
/begin CHARACTERISTIC CTSCD_DebSRCHighOk_C "WTF Heilungsentprellzeit fuer SRC-High" VALUE 0xC924C Kw_Wu16 655350.0 Time_ms 0.00 655350.0 FORMAT "%8.1" /end CHARACTERISTIC
/begin CHARACTERISTIC CTSCD_DebSRCLowDef_C "#SSD WTF Fehlerentprellzeit fuer SRC-Low" VALUE 0xC924E Kw_Wu16 655350.0 Time_ms 0.00 655350.0 FORMAT "%8.1" /end CHARACTERISTIC
/begin CHARACTERISTIC CTSCD_DebSRCLowOk_C "WTF Heilungsentprellzeit fuer SRC-Low" VALUE 0xC9250 Kw_Wu16 655350.0 Time_ms 0.00 655350.0 FORMAT "%8.1" /end CHARACTERISTIC
/begin CHARACTERISTIC CTSCD_dtRmpSlp2UpDwn_C "Auf- und Abwärts Rampensteigung im Zustand 2 beim Übergang  zweier Ersatzwerte für den Wassertemperaturfühler" VALUE 0xC9254 Kw_Wu32 6553598.99749 RmpTemp 1.00097656250 6553599.99847 FORMAT "%13.5" EXTENDED_LIMITS 0.00 6553599.99847 /end CHARACTERISTIC
/begin CHARACTERISTIC CTSCD_dtFlTempUp_C "ramp slope up in C/ms" VALUE 0xC9258 Kw_Wu32 6553.59899750 RmpTempCels 0.00100097656250 6553.59999847 FORMAT "%13.8" EXTENDED_LIMITS 0.00 6553.59999847 /end CHARACTERISTIC
/begin CHARACTERISTIC CTSCD_dtFlTempDwn_C " ramp slope down in C/ms" VALUE 0xC925C Kw_Wu32 6553.59899750 RmpTempCels 0.00100097656250 6553.59999847 FORMAT "%13.8" EXTENDED_LIMITS 0.00 6553.59999847 /end CHARACTERISTIC
/begin CHARACTERISTIC CTSCD_numAdc_C "#SSD Applikationsparameter fuer Kuehlwassertemperatur-Fuehler" VALUE 0xC9260 Kw_Wu8 24.0000000000 NumPinAdc 0.00 24.0000000000 FORMAT "%13.10" /end CHARACTERISTIC
/begin CHARACTERISTIC CTSCD_dtRmpSlp1Up_C "Aufwärts Rampensteigung  im Zustand 1 bei  Übergang Messwert  Vorgabewert für WTF" VALUE 0xC9264 Kw_Wu32 6553598.99749 RmpTemp 1.00097656250 6553599.99847 FORMAT "%13.5" EXTENDED_LIMITS 0.00 6553599.99847 /end CHARACTERISTIC
/begin CHARACTERISTIC CTSCD_dtRmpSlp1Dwn_C "Abwärtsrampensteigung im Zustand 1 beim Übergang  Messwert Vorgabewert   für WTF" VALUE 0xC9268 Kw_Wu32 6553598.99749 RmpTemp 1.00097656250 6553599.99847 FORMAT "%13.5" EXTENDED_LIMITS 0.00 6553599.99847 /end CHARACTERISTIC
/begin CHARACTERISTIC CTSCD_stSensIDWord_C "#SSD Geberkennwort WTF-Sensor" VALUE 0xC926C Kw_Wu8 255.0 OneToOne 0.00 255.0 FORMAT "%5.1" /end CHARACTERISTIC
/begin CHARACTERISTIC CTSCD_swtPHtrIgnoreCAN_C "Schalter um Wert von CAN oder HW zu wählen (1: CAN, 0: HW)" VALUE 0xC926D Kw_Wu8 1.000 OneToOne 0.00 1.000 FORMAT "%5.3" EXTENDED_LIMITS 0.00 255.0 /end CHARACTERISTIC
/begin CHARACTERISTIC CTSCD_swtSigVal_C "Signalquelle ADC/CAN (0: ADC, 1: CAN)" VALUE 0xC926E Kw_Wu8 1.000 OneToOne 0.00 1.000 FORMAT "%5.3" EXTENDED_LIMITS 0.00 255.0 /end CHARACTERISTIC
/begin CHARACTERISTIC CTSCD_tClntPMin_C "Threshold Value of Coolant Temperature before Correction" VALUE 0xC9270 Kw_Ws16 250.0000 Temp_Cels -50.14000 199.8600 FORMAT "%8.4" EXTENDED_LIMITS -3549.940 3003.560 /end CHARACTERISTIC
/begin CHARACTERISTIC CTSCD_tDflCold_C "Wassertemperatur-Vorgabewert  im  Glüh und Startvorgang bei defektem WTS-Sensor" VALUE 0xC9272 Kw_Ws16 950.0000 Temp_Cels -50.1400 899.8600 FORMAT "%8.4" EXTENDED_LIMITS -3549.940 3003.560 /end CHARACTERISTIC
/begin CHARACTERISTIC CTSCD_tDflWarm_C "Wassertemperatur-Vorgabewert  nach Glüh und Startvorgang  bei defektem WTS-Sensor" VALUE 0xC9274 Kw_Ws16 950.0000 Temp_Cels -50.1400 899.8600 FORMAT "%8.4" EXTENDED_LIMITS -3549.940 3003.560 /end CHARACTERISTIC
/begin CHARACTERISTIC CTSCD_tDiffThres_C "Difference Threshold value of Fuel and Coolant Temperature" VALUE 0xC9276 Kw_Ws16 250.0000 Temp_Cels -50.14000 199.8600 FORMAT "%8.4" EXTENDED_LIMITS -3549.940 3003.560 /end CHARACTERISTIC
/begin CHARACTERISTIC CTSCD_tFuelMin_C "Threshold Value of Fuel Temperature" VALUE 0xC9278 Kw_Ws16 250.0000 Temp_Cels -50.14000 199.8600 FORMAT "%8.4" EXTENDED_LIMITS -3549.940 3003.560 /end CHARACTERISTIC
/begin CHARACTERISTIC CTSCD_tiWait_C "Time delay to set CTSCD_stPHtr 5th Bit" VALUE 0xC927A Kw_Wu16 655350.0 Time_ms 0.00 655350.0 FORMAT "%8.1" /end CHARACTERISTIC
/begin CHARACTERISTIC CWBGSTUT "0: Programmiermodus gesperrt, 1: Programmiermodus verfügbar" VALUE 0xC05BE KwWU8 255.0 dez 0.00 255.0 FORMAT "%5.1" /end CHARACTERISTIC
/begin CHARACTERISTIC CycSigCheck_nLimit_C "Drehzahllimit für Berechnung des zyklische Signaturchecks" VALUE 0xC927C Kw_Wu16 6000.000 EngN 0.00 6000.000 FORMAT "%8.3" EXTENDED_LIMITS 0.00 65535.00 /end CHARACTERISTIC
/begin CHARACTERISTIC CycSigCheck_swtMode_C "Cycsig Berechnung startet mit: 0 Prgramm; 1 Daten" VALUE 0xC927E Kw_Wu8 1.000 OneToOne 0.00 1.000 FORMAT "%5.3" EXTENDED_LIMITS 0.00 255.0 /end CHARACTERISTIC
/begin CHARACTERISTIC CycSigCheck_swtOff_C "Abschalten der Erkennung von fehlerhaften Signaturen in Applikations SG" VALUE 0xC927F Kw_Wu8 1.000 OneToOne 0.00 1.000 FORMAT "%5.3" EXTENDED_LIMITS 0.00 255.0 /end CHARACTERISTIC
/begin CHARACTERISTIC DrvTrn_drTransDTUp_C "Positive slope for torque changes" VALUE 0xC9280 Kw_Wu32 655359.999847 RmpTransR 0.00 655359.999847 FORMAT "%13.6" /end CHARACTERISTIC
/begin CHARACTERISTIC DrvTrn_drTransDTDwn_C "negative slope for torque changes" VALUE 0xC9284 Kw_Wu32 655359.999847 RmpTransR 0.00 655359.999847 FORMAT "%13.6" /end CHARACTERISTIC
/begin CHARACTERISTIC DrvTrn_rTransDTInit_C "Triebstrangübersetzungs-Vorgabewert (Radmoment pro Motormoment)" VALUE 0xC9288 Kw_Ws16 100.0000 TransR 0.00 100.0000 FORMAT "%8.4" EXTENDED_LIMITS -327.6800 327.6700 /end CHARACTERISTIC
/begin CHARACTERISTIC DrvTrn_swtrTransSel_C "Schalter zur aktivierung des Übersetzungsverhältniss-Momentanwertes (1: verzögert, 0: direkter Wert)" VALUE 0xC928A Kw_Wu8 1.000 OneToOne 0.00 1.000 FORMAT "%5.3" EXTENDED_LIMITS 0.00 255.0 /end CHARACTERISTIC
/begin CHARACTERISTIC DrvTrn_tiRTransDT_C "Zeitintervall für das Einfrieren des aktuellen Triebstrangübersetzungswert" VALUE 0xC928C Kw_Ws16 655140.0 Time_ms 0.00 655140.0 FORMAT "%8.1" EXTENDED_LIMITS -327680.0 327670.0 /end CHARACTERISTIC
/begin CHARACTERISTIC DSCHED_numSelFID_C "FID auswählbar zur Anzeige der defekten und nicht defekten DFPs welche den ausgewählten FID verriegeln" VALUE 0xC9290 Kw_Wu16 61703.0000000 FidName 0.00 61703.0000000 FORMAT "%13.7" /end CHARACTERISTIC
/begin CHARACTERISTIC DSMDur_DfctDur1Mode_C "Betriebsart des globalen Fehlerdauerzählers 1" VALUE 0xCCE3E Kw_Wu8 2.000 OneToOne 0.00 2.000 FORMAT "%5.3" EXTENDED_LIMITS 0.00 255.0 /end CHARACTERISTIC
/begin CHARACTERISTIC DSMDur_DfctDur2Mode_C "Betriebsart des globalen Fehlerdauerzählers 2" VALUE 0xCCE3F Kw_Wu8 2.000 OneToOne 0.00 2.000 FORMAT "%5.3" EXTENDED_LIMITS 0.00 255.0 /end CHARACTERISTIC
/begin CHARACTERISTIC DSMDur_stDfctDur1Enable_C "Aktivierungsbedingungen für den globalen Defektdauerzähler 1" VALUE 0xCCE40 Kw_Wu8 255.0 OneToOne 0.00 255.0 FORMAT "%5.1" /end CHARACTERISTIC
/begin CHARACTERISTIC DSMDur_stDfctDur2Enable_C "Aktivierungsbedingungen für den globalen Defektdauerzähler 2" VALUE 0xCCE41 Kw_Wu8 255.0 OneToOne 0.00 255.0 FORMAT "%5.1" /end CHARACTERISTIC
/begin CHARACTERISTIC DSMDur_stDfctDur1Reset_C "Rücksetzbedingungen für den globalen Defektdauerzähler 1" VALUE 0xCCE42 Kw_Wu8 255.0 OneToOne 0.00 255.0 FORMAT "%5.1" /end CHARACTERISTIC
/begin CHARACTERISTIC DSMDur_stDfctDur2Reset_C "Rücksetzbedingungen für den globalen Defektdauerzähler 2" VALUE 0xCCE43 Kw_Wu8 255.0 OneToOne 0.00 255.0 FORMAT "%5.1" /end CHARACTERISTIC
/begin CHARACTERISTIC DSM_cnvMilKmFCM_Offset_C "Offset für Umrechnung Meilen/Kilometer beim Fehlerspeicher lesen" VALUE 0xC9292 Kw_Ws16 65535.00 LengthKm -32768.00 32767.00 FORMAT "%8.2" /end CHARACTERISTIC
/begin CHARACTERISTIC DSM_cnvMilKmFCM_Slope_C "Slope für Umrechnung Meilen/Kilometer beim Fehlerspeicher lesen" VALUE 0xC9294 Kw_Ws16 65.53500 SlopeRes1000 -32.76800 32.76700 FORMAT "%8.5" /end CHARACTERISTIC
/begin CHARACTERISTIC DSM_Class1Mil_C "Art der MIL Ansteuerung" VALUE 0xC9296 Kw_Wu8 2.00000000000 Mil 0.00 2.00000000000 FORMAT "%13.11" /end CHARACTERISTIC
/begin CHARACTERISTIC DSM_Class1TFlc_C "Trigger Art für Fehlereintrags Bestätigungsentprellung (->Lampe an)" VALUE 0xC9297 Kw_Wu8 3.00000000000 ClassTrigger 0.00 3.00000000000 FORMAT "%13.11" /end CHARACTERISTIC
/begin CHARACTERISTIC DSM_Class1Flc_C "Anzahl Triggerereignisse für Fehlereintrags Bestätigungsentprellung (->Lampe an)" VALUE 0xC9298 Kw_Wu8 255.0 OneToOne 0.00 255.0 FORMAT "%5.1" /end CHARACTERISTIC
/begin CHARACTERISTIC DSM_Class1THlc_C "Trigger Art für Fehlerheilung (->Lampe aus)" VALUE 0xC9299 Kw_Wu8 3.00000000000 ClassTrigger 0.00 3.00000000000 FORMAT "%13.11" /end CHARACTERISTIC
/begin CHARACTERISTIC DSM_Class1Hlc_C "Anzahl Triggerereignisse für Fehlerheilung (->Lampe aus)" VALUE 0xC929A Kw_Wu8 255.0 OneToOne 0.00 255.0 FORMAT "%5.1" /end CHARACTERISTIC
/begin CHARACTERISTIC DSM_Class1Scatt_C "Fehler ist lesbar für OBD Scan tool tester (SCATT) wenn Wert = 1" VALUE 0xC929B Kw_Wu8 1.00000000000 Scatt 0.00 1.00000000000 FORMAT "%13.11" /end CHARACTERISTIC
/begin CHARACTERISTIC DSM_Class1TDlcPen_C "Trigger Art für Löschentprellung von nicht bestätigten Fehlern (pending)" VALUE 0xC929C Kw_Wu8 3.00000000000 ClassTriggerTDlc 0.00 3.00000000000 FORMAT "%13.11" /end CHARACTERISTIC
/begin CHARACTERISTIC DSM_Class1DlcPen_C "Anzahl Triggerereignisse für die Löschung von nicht bestätigten Fehlern (pending)" VALUE 0xC929D Kw_Wu8 255.0 OneToOne 0.00 255.0 FORMAT "%5.1" /end CHARACTERISTIC
/begin CHARACTERISTIC DSM_Class1TDlc_C "Trigger Art für Löschentprellung" VALUE 0xC929E Kw_Wu8 3.00000000000 ClassTriggerTDlc 0.00 3.00000000000 FORMAT "%13.11" /end CHARACTERISTIC
/begin CHARACTERISTIC DSM_Class1DlcKd_C "Anzahl Triggerereignisse für die Löschung von Fehlereinträgen mit Status Kundendienst" VALUE 0xC929F Kw_Wu8 255.0 OneToOne 0.00 255.0 FORMAT "%5.1" /end CHARACTERISTIC
/begin CHARACTERISTIC DSM_Class1Dlc_C "Anzahl Triggerereignisse für die Löschung von Fehlereinträgen" VALUE 0xC92A0 Kw_Wu8 255.0 OneToOne 0.00 255.0 FORMAT "%5.1" /end CHARACTERISTIC
/begin CHARACTERISTIC DSM_Class1Prio_C "Priorität des Fehlereintrages für Verdrängung und freeze frame Zuordnung" VALUE 0xC92A1 Kw_Wu8 255.0 OneToOne 0.00 255.0 FORMAT "%5.1" /end CHARACTERISTIC
/begin CHARACTERISTIC DSM_Class1SysLamp_C "Art der Systemlampenansteuerung" VALUE 0xC92A2 Kw_Wu8 2.00000000000 SysLamp 0.00 2.00000000000 FORMAT "%13.11" /end CHARACTERISTIC
/begin CHARACTERISTIC DSM_Class1ResErf_C "Verhalten Fehlerflags bei Reset und abgebrochenem Nachlauf" VALUE 0xC92A3 Kw_Wu8 3.00000000000 ResErf 0.00 3.00000000000 FORMAT "%13.11" /end CHARACTERISTIC
/begin CHARACTERISTIC DSM_Class1Readiness_C "Zuordnung Entprellklasse zu Readiness Flags" VALUE 0xC92A4 Kw_Wu8 64.0000000000 Readiness 0.00 64.0000000000 FORMAT "%13.10" /end CHARACTERISTIC
/begin CHARACTERISTIC DSM_Class2Mil_C "Art der MIL Ansteuerung" VALUE 0xC92A5 Kw_Wu8 2.00000000000 Mil 0.00 2.00000000000 FORMAT "%13.11" /end CHARACTERISTIC
/begin CHARACTERISTIC DSM_Class2TFlc_C "Trigger Art für Fehlereintrags Bestätigungsentprellung (->Lampe an)" VALUE 0xC92A6 Kw_Wu8 3.00000000000 ClassTrigger 0.00 3.00000000000 FORMAT "%13.11" /end CHARACTERISTIC
/begin CHARACTERISTIC DSM_Class2Flc_C "Anzahl Triggerereignisse für Fehlereintrags Bestätigungsentprellung (->Lampe an)" VALUE 0xC92A7 Kw_Wu8 255.0 OneToOne 0.00 255.0 FORMAT "%5.1" /end CHARACTERISTIC
/begin CHARACTERISTIC DSM_Class2THlc_C "Trigger Art für Fehlerheilung (->Lampe aus)" VALUE 0xC92A8 Kw_Wu8 3.00000000000 ClassTrigger 0.00 3.00000000000 FORMAT "%13.11" /end CHARACTERISTIC
/begin CHARACTERISTIC DSM_Class2Hlc_C "Anzahl Triggerereignisse für Fehlerheilung (->Lampe aus)" VALUE 0xC92A9 Kw_Wu8 255.0 OneToOne 0.00 255.0 FORMAT "%5.1" /end CHARACTERISTIC
/begin CHARACTERISTIC DSM_Class2Scatt_C "Fehler ist lesbar für OBD Scan tool tester (SCATT) wenn Wert = 1" VALUE 0xC92AA Kw_Wu8 1.00000000000 Scatt 0.00 1.00000000000 FORMAT "%13.11" /end CHARACTERISTIC
/begin CHARACTERISTIC DSM_Class2TDlcPen_C "Trigger Art für Löschentprellung von nicht bestätigten Fehlern (pending)" VALUE 0xC92AB Kw_Wu8 3.00000000000 ClassTriggerTDlc 0.00 3.00000000000 FORMAT "%13.11" /end CHARACTERISTIC
/begin CHARACTERISTIC DSM_Class2DlcPen_C "Anzahl Triggerereignisse für die Löschung von nicht bestätigten Fehlern (pending)" VALUE 0xC92AC Kw_Wu8 255.0 OneToOne 0.00 255.0 FORMAT "%5.1" /end CHARACTERISTIC
/begin CHARACTERISTIC DSM_Class2TDlc_C "Trigger Art für Löschentprellung" VALUE 0xC92AD Kw_Wu8 3.00000000000 ClassTriggerTDlc 0.00 3.00000000000 FORMAT "%13.11" /end CHARACTERISTIC
/begin CHARACTERISTIC DSM_Class2DlcKd_C "Anzahl Triggerereignisse für die Löschung von Fehlereinträgen mit Status Kundendienst" VALUE 0xC92AE Kw_Wu8 255.0 OneToOne 0.00 255.0 FORMAT "%5.1" /end CHARACTERISTIC
/begin CHARACTERISTIC DSM_Class2Dlc_C "Anzahl Triggerereignisse für die Löschung von Fehlereinträgen" VALUE 0xC92AF Kw_Wu8 255.0 OneToOne 0.00 255.0 FORMAT "%5.1" /end CHARACTERISTIC
/begin CHARACTERISTIC DSM_Class2Prio_C "Priorität des Fehlereintrages für Verdrängung und freeze frame Zuordnung" VALUE 0xC92B0 Kw_Wu8 255.0 OneToOne 0.00 255.0 FORMAT "%5.1" /end CHARACTERISTIC
/begin CHARACTERISTIC DSM_Class2SysLamp_C "Art der Systemlampenansteuerung" VALUE 0xC92B1 Kw_Wu8 2.00000000000 SysLamp 0.00 2.00000000000 FORMAT "%13.11" /end CHARACTERISTIC
/begin CHARACTERISTIC DSM_Class2ResErf_C "Verhalten Fehlerflags bei Reset und abgebrochenem Nachlauf" VALUE 0xC92B2 Kw_Wu8 3.00000000000 ResErf 0.00 3.00000000000 FORMAT "%13.11" /end CHARACTERISTIC
/begin CHARACTERISTIC DSM_Class2Readiness_C "Zuordnung Entprellklasse zu Readiness Flags" VALUE 0xC92B3 Kw_Wu8 64.0000000000 Readiness 0.00 64.0000000000 FORMAT "%13.10" /end CHARACTERISTIC
/begin CHARACTERISTIC DSM_Class3Mil_C "Art der MIL Ansteuerung" VALUE 0xC92B4 Kw_Wu8 2.00000000000 Mil 0.00 2.00000000000 FORMAT "%13.11" /end CHARACTERISTIC
/begin CHARACTERISTIC DSM_Class3TFlc_C "Trigger Art für Fehlereintrags Bestätigungsentprellung (->Lampe an)" VALUE 0xC92B5 Kw_Wu8 3.00000000000 ClassTrigger 0.00 3.00000000000 FORMAT "%13.11" /end CHARACTERISTIC
/begin CHARACTERISTIC DSM_Class3Flc_C "Anzahl Triggerereignisse für Fehlereintrags Bestätigungsentprellung (->Lampe an)" VALUE 0xC92B6 Kw_Wu8 255.0 OneToOne 0.00 255.0 FORMAT "%5.1" /end CHARACTERISTIC
/begin CHARACTERISTIC DSM_Class3THlc_C "Trigger Art für Fehlerheilung (->Lampe aus)" VALUE 0xC92B7 Kw_Wu8 3.00000000000 ClassTrigger 0.00 3.00000000000 FORMAT "%13.11" /end CHARACTERISTIC
/begin CHARACTERISTIC DSM_Class3Hlc_C "Anzahl Triggerereignisse für Fehlerheilung (->Lampe aus)" VALUE 0xC92B8 Kw_Wu8 255.0 OneToOne 0.00 255.0 FORMAT "%5.1" /end CHARACTERISTIC
/begin CHARACTERISTIC DSM_Class3Scatt_C "Fehler ist lesbar für OBD Scan tool tester (SCATT) wenn Wert = 1" VALUE 0xC92B9 Kw_Wu8 1.00000000000 Scatt 0.00 1.00000000000 FORMAT "%13.11" /end CHARACTERISTIC
/begin CHARACTERISTIC DSM_Class3TDlcPen_C "Trigger Art für Löschentprellung von nicht bestätigten Fehlern (pending)" VALUE 0xC92BA Kw_Wu8 3.00000000000 ClassTriggerTDlc 0.00 3.00000000000 FORMAT "%13.11" /end CHARACTERISTIC
/begin CHARACTERISTIC DSM_Class3DlcPen_C "Anzahl Triggerereignisse für die Löschung von nicht bestätigten Fehlern (pending)" VALUE 0xC92BB Kw_Wu8 255.0 OneToOne 0.00 255.0 FORMAT "%5.1" /end CHARACTERISTIC
/begin CHARACTERISTIC DSM_Class3TDlc_C "Trigger Art für Löschentprellung" VALUE 0xC92BC Kw_Wu8 3.00000000000 ClassTriggerTDlc 0.00 3.00000000000 FORMAT "%13.11" /end CHARACTERISTIC
/begin CHARACTERISTIC DSM_Class3DlcKd_C "Anzahl Triggerereignisse für die Löschung von Fehlereinträgen mit Status Kundendienst" VALUE 0xC92BD Kw_Wu8 255.0 OneToOne 0.00 255.0 FORMAT "%5.1" /end CHARACTERISTIC
/begin CHARACTERISTIC DSM_Class3Dlc_C "Anzahl Triggerereignisse für die Löschung von Fehlereinträgen" VALUE 0xC92BE Kw_Wu8 255.0 OneToOne 0.00 255.0 FORMAT "%5.1" /end CHARACTERISTIC
/begin CHARACTERISTIC DSM_Class3Prio_C "Priorität des Fehlereintrages für Verdrängung und freeze frame Zuordnung" VALUE 0xC92BF Kw_Wu8 255.0 OneToOne 0.00 255.0 FORMAT "%5.1" /end CHARACTERISTIC
/begin CHARACTERISTIC DSM_Class3SysLamp_C "Art der Systemlampenansteuerung" VALUE 0xC92C0 Kw_Wu8 2.00000000000 SysLamp 0.00 2.00000000000 FORMAT "%13.11" /end CHARACTERISTIC
/begin CHARACTERISTIC DSM_Class3ResErf_C "Verhalten Fehlerflags bei Reset und abgebrochenem Nachlauf" VALUE 0xC92C1 Kw_Wu8 3.00000000000 ResErf 0.00 3.00000000000 FORMAT "%13.11" /end CHARACTERISTIC
/begin CHARACTERISTIC DSM_Class3Readiness_C "Zuordnung Entprellklasse zu Readiness Flags" VALUE 0xC92C2 Kw_Wu8 64.0000000000 Readiness 0.00 64.0000000000 FORMAT "%13.10" /end CHARACTERISTIC
/begin CHARACTERISTIC DSM_Class4Mil_C "Art der MIL Ansteuerung" VALUE 0xC92C3 Kw_Wu8 2.00000000000 Mil 0.00 2.00000000000 FORMAT "%13.11" /end CHARACTERISTIC
/begin CHARACTERISTIC DSM_Class4TFlc_C "Trigger Art für Fehlereintrags Bestätigungsentprellung (->Lampe an)" VALUE 0xC92C4 Kw_Wu8 3.00000000000 ClassTrigger 0.00 3.00000000000 FORMAT "%13.11" /end CHARACTERISTIC
/begin CHARACTERISTIC DSM_Class4Flc_C "Anzahl Triggerereignisse für Fehlereintrags Bestätigungsentprellung (->Lampe an)" VALUE 0xC92C5 Kw_Wu8 255.0 OneToOne 0.00 255.0 FORMAT "%5.1" /end CHARACTERISTIC
/begin CHARACTERISTIC DSM_Class4THlc_C "Trigger Art für Fehlerheilung (->Lampe aus)" VALUE 0xC92C6 Kw_Wu8 3.00000000000 ClassTrigger 0.00 3.00000000000 FORMAT "%13.11" /end CHARACTERISTIC
/begin CHARACTERISTIC DSM_Class4Hlc_C "Anzahl Triggerereignisse für Fehlerheilung (->Lampe aus)" VALUE 0xC92C7 Kw_Wu8 255.0 OneToOne 0.00 255.0 FORMAT "%5.1" /end CHARACTERISTIC
/begin CHARACTERISTIC DSM_Class4Scatt_C "Fehler ist lesbar für OBD Scan tool tester (SCATT) wenn Wert = 1" VALUE 0xC92C8 Kw_Wu8 1.00000000000 Scatt 0.00 1.00000000000 FORMAT "%13.11" /end CHARACTERISTIC
/begin CHARACTERISTIC DSM_Class4TDlcPen_C "Trigger Art für Löschentprellung von nicht bestätigten Fehlern (pending)" VALUE 0xC92C9 Kw_Wu8 3.00000000000 ClassTriggerTDlc 0.00 3.00000000000 FORMAT "%13.11" /end CHARACTERISTIC
/begin CHARACTERISTIC DSM_Class4DlcPen_C "Anzahl Triggerereignisse für die Löschung von nicht bestätigten Fehlern (pending)" VALUE 0xC92CA Kw_Wu8 255.0 OneToOne 0.00 255.0 FORMAT "%5.1" /end CHARACTERISTIC
/begin CHARACTERISTIC DSM_Class4TDlc_C "Trigger Art für Löschentprellung" VALUE 0xC92CB Kw_Wu8 3.00000000000 ClassTriggerTDlc 0.00 3.00000000000 FORMAT "%13.11" /end CHARACTERISTIC
/begin CHARACTERISTIC DSM_Class4DlcKd_C "Anzahl Triggerereignisse für die Löschung von Fehlereinträgen mit Status Kundendienst" VALUE 0xC92CC Kw_Wu8 255.0 OneToOne 0.00 255.0 FORMAT "%5.1" /end CHARACTERISTIC
/begin CHARACTERISTIC DSM_Class4Dlc_C "Anzahl Triggerereignisse für die Löschung von Fehlereinträgen" VALUE 0xC92CD Kw_Wu8 255.0 OneToOne 0.00 255.0 FORMAT "%5.1" /end CHARACTERISTIC
/begin CHARACTERISTIC DSM_Class4Prio_C "Priorität des Fehlereintrages für Verdrängung und freeze frame Zuordnung" VALUE 0xC92CE Kw_Wu8 255.0 OneToOne 0.00 255.0 FORMAT "%5.1" /end CHARACTERISTIC
/begin CHARACTERISTIC DSM_Class4SysLamp_C "Art der Systemlampenansteuerung" VALUE 0xC92CF Kw_Wu8 2.00000000000 SysLamp 0.00 2.00000000000 FORMAT "%13.11" /end CHARACTERISTIC
/begin CHARACTERISTIC DSM_Class4ResErf_C "Verhalten Fehlerflags bei Reset und abgebrochenem Nachlauf" VALUE 0xC92D0 Kw_Wu8 3.00000000000 ResErf 0.00 3.00000000000 FORMAT "%13.11" /end CHARACTERISTIC
/begin CHARACTERISTIC DSM_Class4Readiness_C "Zuordnung Entprellklasse zu Readiness Flags" VALUE 0xC92D1 Kw_Wu8 64.0000000000 Readiness 0.00 64.0000000000 FORMAT "%13.10" /end CHARACTERISTIC
/begin CHARACTERISTIC DSM_Class5Mil_C "Art der MIL Ansteuerung" VALUE 0xC92D2 Kw_Wu8 2.00000000000 Mil 0.00 2.00000000000 FORMAT "%13.11" /end CHARACTERISTIC
/begin CHARACTERISTIC DSM_Class5TFlc_C "Trigger Art für Fehlereintrags Bestätigungsentprellung (->Lampe an)" VALUE 0xC92D3 Kw_Wu8 3.00000000000 ClassTrigger 0.00 3.00000000000 FORMAT "%13.11" /end CHARACTERISTIC
/begin CHARACTERISTIC DSM_Class5Flc_C "Anzahl Triggerereignisse für Fehlereintrags Bestätigungsentprellung (->Lampe an)" VALUE 0xC92D4 Kw_Wu8 255.0 OneToOne 0.00 255.0 FORMAT "%5.1" /end CHARACTERISTIC
/begin CHARACTERISTIC DSM_Class5THlc_C "Trigger Art für Fehlerheilung (->Lampe aus)" VALUE 0xC92D5 Kw_Wu8 3.00000000000 ClassTrigger 0.00 3.00000000000 FORMAT "%13.11" /end CHARACTERISTIC
/begin CHARACTERISTIC DSM_Class5Hlc_C "Anzahl Triggerereignisse für Fehlerheilung (->Lampe aus)" VALUE 0xC92D6 Kw_Wu8 255.0 OneToOne 0.00 255.0 FORMAT "%5.1" /end CHARACTERISTIC
/begin CHARACTERISTIC DSM_Class5Scatt_C "Fehler ist lesbar für OBD Scan tool tester (SCATT) wenn Wert = 1" VALUE 0xC92D7 Kw_Wu8 1.00000000000 Scatt 0.00 1.00000000000 FORMAT "%13.11" /end CHARACTERISTIC
/begin CHARACTERISTIC DSM_Class5TDlcPen_C "Trigger Art für Löschentprellung von nicht bestätigten Fehlern (pending)" VALUE 0xC92D8 Kw_Wu8 3.00000000000 ClassTriggerTDlc 0.00 3.00000000000 FORMAT "%13.11" /end CHARACTERISTIC
/begin CHARACTERISTIC DSM_Class5DlcPen_C "Anzahl Triggerereignisse für die Löschung von nicht bestätigten Fehlern (pending)" VALUE 0xC92D9 Kw_Wu8 255.0 OneToOne 0.00 255.0 FORMAT "%5.1" /end CHARACTERISTIC
/begin CHARACTERISTIC DSM_Class5TDlc_C "Trigger Art für Löschentprellung" VALUE 0xC92DA Kw_Wu8 3.00000000000 ClassTriggerTDlc 0.00 3.00000000000 FORMAT "%13.11" /end CHARACTERISTIC
/begin CHARACTERISTIC DSM_Class5DlcKd_C "Anzahl Triggerereignisse für die Löschung von Fehlereinträgen mit Status Kundendienst" VALUE 0xC92DB Kw_Wu8 255.0 OneToOne 0.00 255.0 FORMAT "%5.1" /end CHARACTERISTIC
/begin CHARACTERISTIC DSM_Class5Dlc_C "Anzahl Triggerereignisse für die Löschung von Fehlereinträgen" VALUE 0xC92DC Kw_Wu8 255.0 OneToOne 0.00 255.0 FORMAT "%5.1" /end CHARACTERISTIC
/begin CHARACTERISTIC DSM_Class5Prio_C "Priorität des Fehlereintrages für Verdrängung und freeze frame Zuordnung" VALUE 0xC92DD Kw_Wu8 255.0 OneToOne 0.00 255.0 FORMAT "%5.1" /end CHARACTERISTIC
/begin CHARACTERISTIC DSM_Class5SysLamp_C "Art der Systemlampenansteuerung" VALUE 0xC92DE Kw_Wu8 2.00000000000 SysLamp 0.00 2.00000000000 FORMAT "%13.11" /end CHARACTERISTIC
/begin CHARACTERISTIC DSM_Class5ResErf_C "Verhalten Fehlerflags bei Reset und abgebrochenem Nachlauf" VALUE 0xC92DF Kw_Wu8 3.00000000000 ResErf 0.00 3.00000000000 FORMAT "%13.11" /end CHARACTERISTIC
/begin CHARACTERISTIC DSM_Class5Readiness_C "Zuordnung Entprellklasse zu Readiness Flags" VALUE 0xC92E0 Kw_Wu8 64.0000000000 Readiness 0.00 64.0000000000 FORMAT "%13.10" /end CHARACTERISTIC
/begin CHARACTERISTIC DSM_Class6Mil_C "Art der MIL Ansteuerung" VALUE 0xC92E1 Kw_Wu8 2.00000000000 Mil 0.00 2.00000000000 FORMAT "%13.11" /end CHARACTERISTIC
/begin CHARACTERISTIC DSM_Class6TFlc_C "Trigger Art für Fehlereintrags Bestätigungsentprellung (->Lampe an)" VALUE 0xC92E2 Kw_Wu8 3.00000000000 ClassTrigger 0.00 3.00000000000 FORMAT "%13.11" /end CHARACTERISTIC
/begin CHARACTERISTIC DSM_Class6Flc_C "Anzahl Triggerereignisse für Fehlereintrags Bestätigungsentprellung (->Lampe an)" VALUE 0xC92E3 Kw_Wu8 255.0 OneToOne 0.00 255.0 FORMAT "%5.1" /end CHARACTERISTIC
/begin CHARACTERISTIC DSM_Class6THlc_C "Trigger Art für Fehlerheilung (->Lampe aus)" VALUE 0xC92E4 Kw_Wu8 3.00000000000 ClassTrigger 0.00 3.00000000000 FORMAT "%13.11" /end CHARACTERISTIC
/begin CHARACTERISTIC DSM_Class6Hlc_C "Anzahl Triggerereignisse für Fehlerheilung (->Lampe aus)" VALUE 0xC92E5 Kw_Wu8 255.0 OneToOne 0.00 255.0 FORMAT "%5.1" /end CHARACTERISTIC
/begin CHARACTERISTIC DSM_Class6Scatt_C "Fehler ist lesbar für OBD Scan tool tester (SCATT) wenn Wert = 1" VALUE 0xC92E6 Kw_Wu8 1.00000000000 Scatt 0.00 1.00000000000 FORMAT "%13.11" /end CHARACTERISTIC
/begin CHARACTERISTIC DSM_Class6TDlcPen_C "Trigger Art für Löschentprellung von nicht bestätigten Fehlern (pending)" VALUE 0xC92E7 Kw_Wu8 3.00000000000 ClassTriggerTDlc 0.00 3.00000000000 FORMAT "%13.11" /end CHARACTERISTIC
/begin CHARACTERISTIC DSM_Class6DlcPen_C "Anzahl Triggerereignisse für die Löschung von nicht bestätigten Fehlern (pending)" VALUE 0xC92E8 Kw_Wu8 255.0 OneToOne 0.00 255.0 FORMAT "%5.1" /end CHARACTERISTIC
/begin CHARACTERISTIC DSM_Class6TDlc_C "Trigger Art für Löschentprellung" VALUE 0xC92E9 Kw_Wu8 3.00000000000 ClassTriggerTDlc 0.00 3.00000000000 FORMAT "%13.11" /end CHARACTERISTIC
/begin CHARACTERISTIC DSM_Class6DlcKd_C "Anzahl Triggerereignisse für die Löschung von Fehlereinträgen mit Status Kundendienst" VALUE 0xC92EA Kw_Wu8 255.0 OneToOne 0.00 255.0 FORMAT "%5.1" /end CHARACTERISTIC
/begin CHARACTERISTIC DSM_Class6Dlc_C "Anzahl Triggerereignisse für die Löschung von Fehlereinträgen" VALUE 0xC92EB Kw_Wu8 255.0 OneToOne 0.00 255.0 FORMAT "%5.1" /end CHARACTERISTIC
/begin CHARACTERISTIC DSM_Class6Prio_C "Priorität des Fehlereintrages für Verdrängung und freeze frame Zuordnung" VALUE 0xC92EC Kw_Wu8 255.0 OneToOne 0.00 255.0 FORMAT "%5.1" /end CHARACTERISTIC
/begin CHARACTERISTIC DSM_Class6SysLamp_C "Art der Systemlampenansteuerung" VALUE 0xC92ED Kw_Wu8 2.00000000000 SysLamp 0.00 2.00000000000 FORMAT "%13.11" /end CHARACTERISTIC
/begin CHARACTERISTIC DSM_Class6ResErf_C "Verhalten Fehlerflags bei Reset und abgebrochenem Nachlauf" VALUE 0xC92EE Kw_Wu8 3.00000000000 ResErf 0.00 3.00000000000 FORMAT "%13.11" /end CHARACTERISTIC
/begin CHARACTERISTIC DSM_Class6Readiness_C "Zuordnung Entprellklasse zu Readiness Flags" VALUE 0xC92EF Kw_Wu8 64.0000000000 Readiness 0.00 64.0000000000 FORMAT "%13.10" /end CHARACTERISTIC
/begin CHARACTERISTIC DSM_Class7Mil_C "Art der MIL Ansteuerung" VALUE 0xC92F0 Kw_Wu8 2.00000000000 Mil 0.00 2.00000000000 FORMAT "%13.11" /end CHARACTERISTIC
/begin CHARACTERISTIC DSM_Class7TFlc_C "Trigger Art für Fehlereintrags Bestätigungsentprellung (->Lampe an)" VALUE 0xC92F1 Kw_Wu8 3.00000000000 ClassTrigger 0.00 3.00000000000 FORMAT "%13.11" /end CHARACTERISTIC
/begin CHARACTERISTIC DSM_Class7Flc_C "Anzahl Triggerereignisse für Fehlereintrags Bestätigungsentprellung (->Lampe an)" VALUE 0xC92F2 Kw_Wu8 255.0 OneToOne 0.00 255.0 FORMAT "%5.1" /end CHARACTERISTIC
/begin CHARACTERISTIC DSM_Class7THlc_C "Trigger Art für Fehlerheilung (->Lampe aus)" VALUE 0xC92F3 Kw_Wu8 3.00000000000 ClassTrigger 0.00 3.00000000000 FORMAT "%13.11" /end CHARACTERISTIC
/begin CHARACTERISTIC DSM_Class7Hlc_C "Anzahl Triggerereignisse für Fehlerheilung (->Lampe aus)" VALUE 0xC92F4 Kw_Wu8 255.0 OneToOne 0.00 255.0 FORMAT "%5.1" /end CHARACTERISTIC
/begin CHARACTERISTIC DSM_Class7Scatt_C "Fehler ist lesbar für OBD Scan tool tester (SCATT) wenn Wert = 1" VALUE 0xC92F5 Kw_Wu8 1.00000000000 Scatt 0.00 1.00000000000 FORMAT "%13.11" /end CHARACTERISTIC
/begin CHARACTERISTIC DSM_Class7TDlcPen_C "Trigger Art für Löschentprellung von nicht bestätigten Fehlern (pending)" VALUE 0xC92F6 Kw_Wu8 3.00000000000 ClassTriggerTDlc 0.00 3.00000000000 FORMAT "%13.11" /end CHARACTERISTIC
/begin CHARACTERISTIC DSM_Class7DlcPen_C "Anzahl Triggerereignisse für die Löschung von nicht bestätigten Fehlern (pending)" VALUE 0xC92F7 Kw_Wu8 255.0 OneToOne 0.00 255.0 FORMAT "%5.1" /end CHARACTERISTIC
/begin CHARACTERISTIC DSM_Class7TDlc_C "Trigger Art für Löschentprellung" VALUE 0xC92F8 Kw_Wu8 3.00000000000 ClassTriggerTDlc 0.00 3.00000000000 FORMAT "%13.11" /end CHARACTERISTIC
/begin CHARACTERISTIC DSM_Class7DlcKd_C "Anzahl Triggerereignisse für die Löschung von Fehlereinträgen mit Status Kundendienst" VALUE 0xC92F9 Kw_Wu8 255.0 OneToOne 0.00 255.0 FORMAT "%5.1" /end CHARACTERISTIC
/begin CHARACTERISTIC DSM_Class7Dlc_C "Anzahl Triggerereignisse für die Löschung von Fehlereinträgen" VALUE 0xC92FA Kw_Wu8 255.0 OneToOne 0.00 255.0 FORMAT "%5.1" /end CHARACTERISTIC
/begin CHARACTERISTIC DSM_Class7Prio_C "Priorität des Fehlereintrages für Verdrängung und freeze frame Zuordnung" VALUE 0xC92FB Kw_Wu8 255.0 OneToOne 0.00 255.0 FORMAT "%5.1" /end CHARACTERISTIC
/begin CHARACTERISTIC DSM_Class7SysLamp_C "Art der Systemlampenansteuerung" VALUE 0xC92FC Kw_Wu8 2.00000000000 SysLamp 0.00 2.00000000000 FORMAT "%13.11" /end CHARACTERISTIC
/begin CHARACTERISTIC DSM_Class7ResErf_C "Verhalten Fehlerflags bei Reset und abgebrochenem Nachlauf" VALUE 0xC92FD Kw_Wu8 3.00000000000 ResErf 0.00 3.00000000000 FORMAT "%13.11" /end CHARACTERISTIC
/begin CHARACTERISTIC DSM_Class7Readiness_C "Zuordnung Entprellklasse zu Readiness Flags" VALUE 0xC92FE Kw_Wu8 64.0000000000 Readiness 0.00 64.0000000000 FORMAT "%13.10" /end CHARACTERISTIC
/begin CHARACTERISTIC DSM_Class8Mil_C "Art der MIL Ansteuerung" VALUE 0xC92FF Kw_Wu8 2.00000000000 Mil 0.00 2.00000000000 FORMAT "%13.11" /end CHARACTERISTIC
/begin CHARACTERISTIC DSM_Class8TFlc_C "Trigger Art für Fehlereintrags Bestätigungsentprellung (->Lampe an)" VALUE 0xC9300 Kw_Wu8 3.00000000000 ClassTrigger 0.00 3.00000000000 FORMAT "%13.11" /end CHARACTERISTIC
/begin CHARACTERISTIC DSM_Class8Flc_C "Anzahl Triggerereignisse für Fehlereintrags Bestätigungsentprellung (->Lampe an)" VALUE 0xC9301 Kw_Wu8 255.0 OneToOne 0.00 255.0 FORMAT "%5.1" /end CHARACTERISTIC
/begin CHARACTERISTIC DSM_Class8THlc_C "Trigger Art für Fehlerheilung (->Lampe aus)" VALUE 0xC9302 Kw_Wu8 3.00000000000 ClassTrigger 0.00 3.00000000000 FORMAT "%13.11" /end CHARACTERISTIC
/begin CHARACTERISTIC DSM_Class8Hlc_C "Anzahl Triggerereignisse für Fehlerheilung (->Lampe aus)" VALUE 0xC9303 Kw_Wu8 255.0 OneToOne 0.00 255.0 FORMAT "%5.1" /end CHARACTERISTIC
/begin CHARACTERISTIC DSM_Class8Scatt_C "Fehler ist lesbar für OBD Scan tool tester (SCATT) wenn Wert = 1" VALUE 0xC9304 Kw_Wu8 1.00000000000 Scatt 0.00 1.00000000000 FORMAT "%13.11" /end CHARACTERISTIC
/begin CHARACTERISTIC DSM_Class8TDlcPen_C "Trigger Art für Löschentprellung von nicht bestätigten Fehlern (pending)" VALUE 0xC9305 Kw_Wu8 3.00000000000 ClassTriggerTDlc 0.00 3.00000000000 FORMAT "%13.11" /end CHARACTERISTIC
/begin CHARACTERISTIC DSM_Class8DlcPen_C "Anzahl Triggerereignisse für die Löschung von nicht bestätigten Fehlern (pending)" VALUE 0xC9306 Kw_Wu8 255.0 OneToOne 0.00 255.0 FORMAT "%5.1" /end CHARACTERISTIC
/begin CHARACTERISTIC DSM_Class8TDlc_C "Trigger Art für Löschentprellung" VALUE 0xC9307 Kw_Wu8 3.00000000000 ClassTriggerTDlc 0.00 3.00000000000 FORMAT "%13.11" /end CHARACTERISTIC
/begin CHARACTERISTIC DSM_Class8DlcKd_C "Anzahl Triggerereignisse für die Löschung von Fehlereinträgen mit Status Kundendienst" VALUE 0xC9308 Kw_Wu8 255.0 OneToOne 0.00 255.0 FORMAT "%5.1" /end CHARACTERISTIC
/begin CHARACTERISTIC DSM_Class8Dlc_C "Anzahl Triggerereignisse für die Löschung von Fehlereinträgen" VALUE 0xC9309 Kw_Wu8 255.0 OneToOne 0.00 255.0 FORMAT "%5.1" /end CHARACTERISTIC
/begin CHARACTERISTIC DSM_Class8Prio_C "Priorität des Fehlereintrages für Verdrängung und freeze frame Zuordnung" VALUE 0xC930A Kw_Wu8 255.0 OneToOne 0.00 255.0 FORMAT "%5.1" /end CHARACTERISTIC
/begin CHARACTERISTIC DSM_Class8SysLamp_C "Art der Systemlampenansteuerung" VALUE 0xC930B Kw_Wu8 2.00000000000 SysLamp 0.00 2.00000000000 FORMAT "%13.11" /end CHARACTERISTIC
/begin CHARACTERISTIC DSM_Class8ResErf_C "Verhalten Fehlerflags bei Reset und abgebrochenem Nachlauf" VALUE 0xC930C Kw_Wu8 3.00000000000 ResErf 0.00 3.00000000000 FORMAT "%13.11" /end CHARACTERISTIC
/begin CHARACTERISTIC DSM_Class8Readiness_C "Zuordnung Entprellklasse zu Readiness Flags" VALUE 0xC930D Kw_Wu8 64.0000000000 Readiness 0.00 64.0000000000 FORMAT "%13.10" /end CHARACTERISTIC
/begin CHARACTERISTIC DSM_Class9Mil_C "Art der MIL Ansteuerung" VALUE 0xC930E Kw_Wu8 2.00000000000 Mil 0.00 2.00000000000 FORMAT "%13.11" /end CHARACTERISTIC
/begin CHARACTERISTIC DSM_Class9TFlc_C "Trigger Art für Fehlereintrags Bestätigungsentprellung (->Lampe an)" VALUE 0xC930F Kw_Wu8 3.00000000000 ClassTrigger 0.00 3.00000000000 FORMAT "%13.11" /end CHARACTERISTIC
/begin CHARACTERISTIC DSM_Class9Flc_C "Anzahl Triggerereignisse für Fehlereintrags Bestätigungsentprellung (->Lampe an)" VALUE 0xC9310 Kw_Wu8 255.0 OneToOne 0.00 255.0 FORMAT "%5.1" /end CHARACTERISTIC
/begin CHARACTERISTIC DSM_Class9THlc_C "Trigger Art für Fehlerheilung (->Lampe aus)" VALUE 0xC9311 Kw_Wu8 3.00000000000 ClassTrigger 0.00 3.00000000000 FORMAT "%13.11" /end CHARACTERISTIC
/begin CHARACTERISTIC DSM_Class9Hlc_C "Anzahl Triggerereignisse für Fehlerheilung (->Lampe aus)" VALUE 0xC9312 Kw_Wu8 255.0 OneToOne 0.00 255.0 FORMAT "%5.1" /end CHARACTERISTIC
/begin CHARACTERISTIC DSM_Class9Scatt_C "Fehler ist lesbar für OBD Scan tool tester (SCATT) wenn Wert = 1" VALUE 0xC9313 Kw_Wu8 1.00000000000 Scatt 0.00 1.00000000000 FORMAT "%13.11" /end CHARACTERISTIC
/begin CHARACTERISTIC DSM_Class9TDlcPen_C "Trigger Art für Löschentprellung von nicht bestätigten Fehlern (pending)" VALUE 0xC9314 Kw_Wu8 3.00000000000 ClassTriggerTDlc 0.00 3.00000000000 FORMAT "%13.11" /end CHARACTERISTIC
/begin CHARACTERISTIC DSM_Class9DlcPen_C "Anzahl Triggerereignisse für die Löschung von nicht bestätigten Fehlern (pending)" VALUE 0xC9315 Kw_Wu8 255.0 OneToOne 0.00 255.0 FORMAT "%5.1" /end CHARACTERISTIC
/begin CHARACTERISTIC DSM_Class9TDlc_C "Trigger Art für Löschentprellung" VALUE 0xC9316 Kw_Wu8 3.00000000000 ClassTriggerTDlc 0.00 3.00000000000 FORMAT "%13.11" /end CHARACTERISTIC
/begin CHARACTERISTIC DSM_Class9DlcKd_C "Anzahl Triggerereignisse für die Löschung von Fehlereinträgen mit Status Kundendienst" VALUE 0xC9317 Kw_Wu8 255.0 OneToOne 0.00 255.0 FORMAT "%5.1" /end CHARACTERISTIC
/begin CHARACTERISTIC DSM_Class9Dlc_C "Anzahl Triggerereignisse für die Löschung von Fehlereinträgen" VALUE 0xC9318 Kw_Wu8 255.0 OneToOne 0.00 255.0 FORMAT "%5.1" /end CHARACTERISTIC
/begin CHARACTERISTIC DSM_Class9Prio_C "Priorität des Fehlereintrages für Verdrängung und freeze frame Zuordnung" VALUE 0xC9319 Kw_Wu8 255.0 OneToOne 0.00 255.0 FORMAT "%5.1" /end CHARACTERISTIC
/begin CHARACTERISTIC DSM_Class9SysLamp_C "Art der Systemlampenansteuerung" VALUE 0xC931A Kw_Wu8 2.00000000000 SysLamp 0.00 2.00000000000 FORMAT "%13.11" /end CHARACTERISTIC
/begin CHARACTERISTIC DSM_Class9ResErf_C "Verhalten Fehlerflags bei Reset und abgebrochenem Nachlauf" VALUE 0xC931B Kw_Wu8 3.00000000000 ResErf 0.00 3.00000000000 FORMAT "%13.11" /end CHARACTERISTIC
/begin CHARACTERISTIC DSM_Class9Readiness_C "Zuordnung Entprellklasse zu Readiness Flags" VALUE 0xC931C Kw_Wu8 64.0000000000 Readiness 0.00 64.0000000000 FORMAT "%13.10" /end CHARACTERISTIC
/begin CHARACTERISTIC DSM_Class10Mil_C "Art der MIL Ansteuerung" VALUE 0xC931D Kw_Wu8 2.00000000000 Mil 0.00 2.00000000000 FORMAT "%13.11" /end CHARACTERISTIC
/begin CHARACTERISTIC DSM_Class10TFlc_C "Trigger Art für Fehlereintrags Bestätigungsentprellung (->Lampe an)" VALUE 0xC931E Kw_Wu8 3.00000000000 ClassTrigger 0.00 3.00000000000 FORMAT "%13.11" /end CHARACTERISTIC
/begin CHARACTERISTIC DSM_Class10Flc_C "Anzahl Triggerereignisse für Fehlereintrags Bestätigungsentprellung (->Lampe an)" VALUE 0xC931F Kw_Wu8 255.0 OneToOne 0.00 255.0 FORMAT "%5.1" /end CHARACTERISTIC
/begin CHARACTERISTIC DSM_Class10THlc_C "Trigger Art für Fehlerheilung (->Lampe aus)" VALUE 0xC9320 Kw_Wu8 3.00000000000 ClassTrigger 0.00 3.00000000000 FORMAT "%13.11" /end CHARACTERISTIC
/begin CHARACTERISTIC DSM_Class10Hlc_C "Anzahl Triggerereignisse für Fehlerheilung (->Lampe aus)" VALUE 0xC9321 Kw_Wu8 255.0 OneToOne 0.00 255.0 FORMAT "%5.1" /end CHARACTERISTIC
/begin CHARACTERISTIC DSM_Class10Scatt_C "Fehler ist lesbar für OBD Scan tool tester (SCATT) wenn Wert = 1" VALUE 0xC9322 Kw_Wu8 1.00000000000 Scatt 0.00 1.00000000000 FORMAT "%13.11" /end CHARACTERISTIC
/begin CHARACTERISTIC DSM_Class10TDlcPen_C "Trigger Art für Löschentprellung von nicht bestätigten Fehlern (pending)" VALUE 0xC9323 Kw_Wu8 3.00000000000 ClassTriggerTDlc 0.00 3.00000000000 FORMAT "%13.11" /end CHARACTERISTIC
/begin CHARACTERISTIC DSM_Class10DlcPen_C "Anzahl Triggerereignisse für die Löschung von nicht bestätigten Fehlern (pending)" VALUE 0xC9324 Kw_Wu8 255.0 OneToOne 0.00 255.0 FORMAT "%5.1" /end CHARACTERISTIC
/begin CHARACTERISTIC DSM_Class10TDlc_C "Trigger Art für Löschentprellung" VALUE 0xC9325 Kw_Wu8 3.00000000000 ClassTriggerTDlc 0.00 3.00000000000 FORMAT "%13.11" /end CHARACTERISTIC
/begin CHARACTERISTIC DSM_Class10DlcKd_C "Anzahl Triggerereignisse für die Löschung von Fehlereinträgen mit Status Kundendienst" VALUE 0xC9326 Kw_Wu8 255.0 OneToOne 0.00 255.0 FORMAT "%5.1" /end CHARACTERISTIC
/begin CHARACTERISTIC DSM_Class10Dlc_C "Anzahl Triggerereignisse für die Löschung von Fehlereinträgen" VALUE 0xC9327 Kw_Wu8 255.0 OneToOne 0.00 255.0 FORMAT "%5.1" /end CHARACTERISTIC
/begin CHARACTERISTIC DSM_Class10Prio_C "Priorität des Fehlereintrages für Verdrängung und freeze frame Zuordnung" VALUE 0xC9328 Kw_Wu8 255.0 OneToOne 0.00 255.0 FORMAT "%5.1" /end CHARACTERISTIC
/begin CHARACTERISTIC DSM_Class10SysLamp_C "Art der Systemlampenansteuerung" VALUE 0xC9329 Kw_Wu8 2.00000000000 SysLamp 0.00 2.00000000000 FORMAT "%13.11" /end CHARACTERISTIC
/begin CHARACTERISTIC DSM_Class10ResErf_C "Verhalten Fehlerflags bei Reset und abgebrochenem Nachlauf" VALUE 0xC932A Kw_Wu8 3.00000000000 ResErf 0.00 3.00000000000 FORMAT "%13.11" /end CHARACTERISTIC
/begin CHARACTERISTIC DSM_Class10Readiness_C "Zuordnung Entprellklasse zu Readiness Flags" VALUE 0xC932B Kw_Wu8 64.0000000000 Readiness 0.00 64.0000000000 FORMAT "%13.10" /end CHARACTERISTIC
/begin CHARACTERISTIC DSM_Class11Mil_C "Art der MIL Ansteuerung" VALUE 0xC932C Kw_Wu8 2.00000000000 Mil 0.00 2.00000000000 FORMAT "%13.11" /end CHARACTERISTIC
/begin CHARACTERISTIC DSM_Class11TFlc_C "Trigger Art für Fehlereintrags Bestätigungsentprellung (->Lampe an)" VALUE 0xC932D Kw_Wu8 3.00000000000 ClassTrigger 0.00 3.00000000000 FORMAT "%13.11" /end CHARACTERISTIC
/begin CHARACTERISTIC DSM_Class11Flc_C "Anzahl Triggerereignisse für Fehlereintrags Bestätigungsentprellung (->Lampe an)" VALUE 0xC932E Kw_Wu8 255.0 OneToOne 0.00 255.0 FORMAT "%5.1" /end CHARACTERISTIC
/begin CHARACTERISTIC DSM_Class11THlc_C "Trigger Art für Fehlerheilung (->Lampe aus)" VALUE 0xC932F Kw_Wu8 3.00000000000 ClassTrigger 0.00 3.00000000000 FORMAT "%13.11" /end CHARACTERISTIC
/begin CHARACTERISTIC DSM_Class11Hlc_C "Anzahl Triggerereignisse für Fehlerheilung (->Lampe aus)" VALUE 0xC9330 Kw_Wu8 255.0 OneToOne 0.00 255.0 FORMAT "%5.1" /end CHARACTERISTIC
/begin CHARACTERISTIC DSM_Class11Scatt_C "Fehler ist lesbar für OBD Scan tool tester (SCATT) wenn Wert = 1" VALUE 0xC9331 Kw_Wu8 1.00000000000 Scatt 0.00 1.00000000000 FORMAT "%13.11" /end CHARACTERISTIC
/begin CHARACTERISTIC DSM_Class11TDlcPen_C "Trigger Art für Löschentprellung von nicht bestätigten Fehlern (pending)" VALUE 0xC9332 Kw_Wu8 3.00000000000 ClassTriggerTDlc 0.00 3.00000000000 FORMAT "%13.11" /end CHARACTERISTIC
/begin CHARACTERISTIC DSM_Class11DlcPen_C "Anzahl Triggerereignisse für die Löschung von nicht bestätigten Fehlern (pending)" VALUE 0xC9333 Kw_Wu8 255.0 OneToOne 0.00 255.0 FORMAT "%5.1" /end CHARACTERISTIC
/begin CHARACTERISTIC DSM_Class11TDlc_C "Trigger Art für Löschentprellung" VALUE 0xC9334 Kw_Wu8 3.00000000000 ClassTriggerTDlc 0.00 3.00000000000 FORMAT "%13.11" /end CHARACTERISTIC
/begin CHARACTERISTIC DSM_Class11DlcKd_C "Anzahl Triggerereignisse für die Löschung von Fehlereinträgen mit Status Kundendienst" VALUE 0xC9335 Kw_Wu8 255.0 OneToOne 0.00 255.0 FORMAT "%5.1" /end CHARACTERISTIC
/begin CHARACTERISTIC DSM_Class11Dlc_C "Anzahl Triggerereignisse für die Löschung von Fehlereinträgen" VALUE 0xC9336 Kw_Wu8 255.0 OneToOne 0.00 255.0 FORMAT "%5.1" /end CHARACTERISTIC
/begin CHARACTERISTIC DSM_Class11Prio_C "Priorität des Fehlereintrages für Verdrängung und freeze frame Zuordnung" VALUE 0xC9337 Kw_Wu8 255.0 OneToOne 0.00 255.0 FORMAT "%5.1" /end CHARACTERISTIC
/begin CHARACTERISTIC DSM_Class11SysLamp_C "Art der Systemlampenansteuerung" VALUE 0xC9338 Kw_Wu8 2.00000000000 SysLamp 0.00 2.00000000000 FORMAT "%13.11" /end CHARACTERISTIC
/begin CHARACTERISTIC DSM_Class11ResErf_C "Verhalten Fehlerflags bei Reset und abgebrochenem Nachlauf" VALUE 0xC9339 Kw_Wu8 3.00000000000 ResErf 0.00 3.00000000000 FORMAT "%13.11" /end CHARACTERISTIC
/begin CHARACTERISTIC DSM_Class11Readiness_C "Zuordnung Entprellklasse zu Readiness Flags" VALUE 0xC933A Kw_Wu8 64.0000000000 Readiness 0.00 64.0000000000 FORMAT "%13.10" /end CHARACTERISTIC
/begin CHARACTERISTIC DSM_Class12Mil_C "Art der MIL Ansteuerung" VALUE 0xC933B Kw_Wu8 2.00000000000 Mil 0.00 2.00000000000 FORMAT "%13.11" /end CHARACTERISTIC
/begin CHARACTERISTIC DSM_Class12TFlc_C "Trigger Art für Fehlereintrags Bestätigungsentprellung (->Lampe an)" VALUE 0xC933C Kw_Wu8 3.00000000000 ClassTrigger 0.00 3.00000000000 FORMAT "%13.11" /end CHARACTERISTIC
/begin CHARACTERISTIC DSM_Class12Flc_C "Anzahl Triggerereignisse für Fehlereintrags Bestätigungsentprellung (->Lampe an)" VALUE 0xC933D Kw_Wu8 255.0 OneToOne 0.00 255.0 FORMAT "%5.1" /end CHARACTERISTIC
/begin CHARACTERISTIC DSM_Class12THlc_C "Trigger Art für Fehlerheilung (->Lampe aus)" VALUE 0xC933E Kw_Wu8 3.00000000000 ClassTrigger 0.00 3.00000000000 FORMAT "%13.11" /end CHARACTERISTIC
/begin CHARACTERISTIC DSM_Class12Hlc_C "Anzahl Triggerereignisse für Fehlerheilung (->Lampe aus)" VALUE 0xC933F Kw_Wu8 255.0 OneToOne 0.00 255.0 FORMAT "%5.1" /end CHARACTERISTIC
/begin CHARACTERISTIC DSM_Class12Scatt_C "Fehler ist lesbar für OBD Scan tool tester (SCATT) wenn Wert = 1" VALUE 0xC9340 Kw_Wu8 1.00000000000 Scatt 0.00 1.00000000000 FORMAT "%13.11" /end CHARACTERISTIC
/begin CHARACTERISTIC DSM_Class12TDlcPen_C "Trigger Art für Löschentprellung von nicht bestätigten Fehlern (pending)" VALUE 0xC9341 Kw_Wu8 3.00000000000 ClassTriggerTDlc 0.00 3.00000000000 FORMAT "%13.11" /end CHARACTERISTIC
/begin CHARACTERISTIC DSM_Class12DlcPen_C "Anzahl Triggerereignisse für die Löschung von nicht bestätigten Fehlern (pending)" VALUE 0xC9342 Kw_Wu8 255.0 OneToOne 0.00 255.0 FORMAT "%5.1" /end CHARACTERISTIC
/begin CHARACTERISTIC DSM_Class12TDlc_C "Trigger Art für Löschentprellung" VALUE 0xC9343 Kw_Wu8 3.00000000000 ClassTriggerTDlc 0.00 3.00000000000 FORMAT "%13.11" /end CHARACTERISTIC
/begin CHARACTERISTIC DSM_Class12DlcKd_C "Anzahl Triggerereignisse für die Löschung von Fehlereinträgen mit Status Kundendienst" VALUE 0xC9344 Kw_Wu8 255.0 OneToOne 0.00 255.0 FORMAT "%5.1" /end CHARACTERISTIC
/begin CHARACTERISTIC DSM_Class12Dlc_C "Anzahl Triggerereignisse für die Löschung von Fehlereinträgen" VALUE 0xC9345 Kw_Wu8 255.0 OneToOne 0.00 255.0 FORMAT "%5.1" /end CHARACTERISTIC
/begin CHARACTERISTIC DSM_Class12Prio_C "Priorität des Fehlereintrages für Verdrängung und freeze frame Zuordnung" VALUE 0xC9346 Kw_Wu8 255.0 OneToOne 0.00 255.0 FORMAT "%5.1" /end CHARACTERISTIC
/begin CHARACTERISTIC DSM_Class12SysLamp_C "Art der Systemlampenansteuerung" VALUE 0xC9347 Kw_Wu8 2.00000000000 SysLamp 0.00 2.00000000000 FORMAT "%13.11" /end CHARACTERISTIC
/begin CHARACTERISTIC DSM_Class12ResErf_C "Verhalten Fehlerflags bei Reset und abgebrochenem Nachlauf" VALUE 0xC9348 Kw_Wu8 3.00000000000 ResErf 0.00 3.00000000000 FORMAT "%13.11" /end CHARACTERISTIC
/begin CHARACTERISTIC DSM_Class12Readiness_C "Zuordnung Entprellklasse zu Readiness Flags" VALUE 0xC9349 Kw_Wu8 64.0000000000 Readiness 0.00 64.0000000000 FORMAT "%13.10" /end CHARACTERISTIC
/begin CHARACTERISTIC DSM_Class13Mil_C "Art der MIL Ansteuerung" VALUE 0xC934A Kw_Wu8 2.00000000000 Mil 0.00 2.00000000000 FORMAT "%13.11" /end CHARACTERISTIC
/begin CHARACTERISTIC DSM_Class13TFlc_C "Trigger Art für Fehlereintrags Bestätigungsentprellung (->Lampe an)" VALUE 0xC934B Kw_Wu8 3.00000000000 ClassTrigger 0.00 3.00000000000 FORMAT "%13.11" /end CHARACTERISTIC
/begin CHARACTERISTIC DSM_Class13Flc_C "Anzahl Triggerereignisse für Fehlereintrags Bestätigungsentprellung (->Lampe an)" VALUE 0xC934C Kw_Wu8 255.0 OneToOne 0.00 255.0 FORMAT "%5.1" /end CHARACTERISTIC
/begin CHARACTERISTIC DSM_Class13THlc_C "Trigger Art für Fehlerheilung (->Lampe aus)" VALUE 0xC934D Kw_Wu8 3.00000000000 ClassTrigger 0.00 3.00000000000 FORMAT "%13.11" /end CHARACTERISTIC
/begin CHARACTERISTIC DSM_Class13Hlc_C "Anzahl Triggerereignisse für Fehlerheilung (->Lampe aus)" VALUE 0xC934E Kw_Wu8 255.0 OneToOne 0.00 255.0 FORMAT "%5.1" /end CHARACTERISTIC
/begin CHARACTERISTIC DSM_Class13Scatt_C "Fehler ist lesbar für OBD Scan tool tester (SCATT) wenn Wert = 1" VALUE 0xC934F Kw_Wu8 1.00000000000 Scatt 0.00 1.00000000000 FORMAT "%13.11" /end CHARACTERISTIC
/begin CHARACTERISTIC DSM_Class13TDlcPen_C "Trigger Art für Löschentprellung von nicht bestätigten Fehlern (pending)" VALUE 0xC9350 Kw_Wu8 3.00000000000 ClassTriggerTDlc 0.00 3.00000000000 FORMAT "%13.11" /end CHARACTERISTIC
/begin CHARACTERISTIC DSM_Class13DlcPen_C "Anzahl Triggerereignisse für die Löschung von nicht bestätigten Fehlern (pending)" VALUE 0xC9351 Kw_Wu8 255.0 OneToOne 0.00 255.0 FORMAT "%5.1" /end CHARACTERISTIC
/begin CHARACTERISTIC DSM_Class13TDlc_C "Trigger Art für Löschentprellung" VALUE 0xC9352 Kw_Wu8 3.00000000000 ClassTriggerTDlc 0.00 3.00000000000 FORMAT "%13.11" /end CHARACTERISTIC
/begin CHARACTERISTIC DSM_Class13DlcKd_C "Anzahl Triggerereignisse für die Löschung von Fehlereinträgen mit Status Kundendienst" VALUE 0xC9353 Kw_Wu8 255.0 OneToOne 0.00 255.0 FORMAT "%5.1" /end CHARACTERISTIC
/begin CHARACTERISTIC DSM_Class13Dlc_C "Anzahl Triggerereignisse für die Löschung von Fehlereinträgen" VALUE 0xC9354 Kw_Wu8 255.0 OneToOne 0.00 255.0 FORMAT "%5.1" /end CHARACTERISTIC
/begin CHARACTERISTIC DSM_Class13Prio_C "Priorität des Fehlereintrages für Verdrängung und freeze frame Zuordnung" VALUE 0xC9355 Kw_Wu8 255.0 OneToOne 0.00 255.0 FORMAT "%5.1" /end CHARACTERISTIC
/begin CHARACTERISTIC DSM_Class13SysLamp_C "Art der Systemlampenansteuerung" VALUE 0xC9356 Kw_Wu8 2.00000000000 SysLamp 0.00 2.00000000000 FORMAT "%13.11" /end CHARACTERISTIC
/begin CHARACTERISTIC DSM_Class13ResErf_C "Verhalten Fehlerflags bei Reset und abgebrochenem Nachlauf" VALUE 0xC9357 Kw_Wu8 3.00000000000 ResErf 0.00 3.00000000000 FORMAT "%13.11" /end CHARACTERISTIC
/begin CHARACTERISTIC DSM_Class13Readiness_C "Zuordnung Entprellklasse zu Readiness Flags" VALUE 0xC9358 Kw_Wu8 64.0000000000 Readiness 0.00 64.0000000000 FORMAT "%13.10" /end CHARACTERISTIC
/begin CHARACTERISTIC DSM_Class14Mil_C "Art der MIL Ansteuerung" VALUE 0xC9359 Kw_Wu8 2.00000000000 Mil 0.00 2.00000000000 FORMAT "%13.11" /end CHARACTERISTIC
/begin CHARACTERISTIC DSM_Class14TFlc_C "Trigger Art für Fehlereintrags Bestätigungsentprellung (->Lampe an)" VALUE 0xC935A Kw_Wu8 3.00000000000 ClassTrigger 0.00 3.00000000000 FORMAT "%13.11" /end CHARACTERISTIC
/begin CHARACTERISTIC DSM_Class14Flc_C "Anzahl Triggerereignisse für Fehlereintrags Bestätigungsentprellung (->Lampe an)" VALUE 0xC935B Kw_Wu8 255.0 OneToOne 0.00 255.0 FORMAT "%5.1" /end CHARACTERISTIC
/begin CHARACTERISTIC DSM_Class14THlc_C "Trigger Art für Fehlerheilung (->Lampe aus)" VALUE 0xC935C Kw_Wu8 3.00000000000 ClassTrigger 0.00 3.00000000000 FORMAT "%13.11" /end CHARACTERISTIC
/begin CHARACTERISTIC DSM_Class14Hlc_C "Anzahl Triggerereignisse für Fehlerheilung (->Lampe aus)" VALUE 0xC935D Kw_Wu8 255.0 OneToOne 0.00 255.0 FORMAT "%5.1" /end CHARACTERISTIC
/begin CHARACTERISTIC DSM_Class14Scatt_C "Fehler ist lesbar für OBD Scan tool tester (SCATT) wenn Wert = 1" VALUE 0xC935E Kw_Wu8 1.00000000000 Scatt 0.00 1.00000000000 FORMAT "%13.11" /end CHARACTERISTIC
/begin CHARACTERISTIC DSM_Class14TDlcPen_C "Trigger Art für Löschentprellung von nicht bestätigten Fehlern (pending)" VALUE 0xC935F Kw_Wu8 3.00000000000 ClassTriggerTDlc 0.00 3.00000000000 FORMAT "%13.11" /end CHARACTERISTIC
/begin CHARACTERISTIC DSM_Class14DlcPen_C "Anzahl Triggerereignisse für die Löschung von nicht bestätigten Fehlern (pending)" VALUE 0xC9360 Kw_Wu8 255.0 OneToOne 0.00 255.0 FORMAT "%5.1" /end CHARACTERISTIC
/begin CHARACTERISTIC DSM_Class14TDlc_C "Trigger Art für Löschentprellung" VALUE 0xC9361 Kw_Wu8 3.00000000000 ClassTriggerTDlc 0.00 3.00000000000 FORMAT "%13.11" /end CHARACTERISTIC
/begin CHARACTERISTIC DSM_Class14DlcKd_C "Anzahl Triggerereignisse für die Löschung von Fehlereinträgen mit Status Kundendienst" VALUE 0xC9362 Kw_Wu8 255.0 OneToOne 0.00 255.0 FORMAT "%5.1" /end CHARACTERISTIC
/begin CHARACTERISTIC DSM_Class14Dlc_C "Anzahl Triggerereignisse für die Löschung von Fehlereinträgen" VALUE 0xC9363 Kw_Wu8 255.0 OneToOne 0.00 255.0 FORMAT "%5.1" /end CHARACTERISTIC
/begin CHARACTERISTIC DSM_Class14Prio_C "Priorität des Fehlereintrages für Verdrängung und freeze frame Zuordnung" VALUE 0xC9364 Kw_Wu8 255.0 OneToOne 0.00 255.0 FORMAT "%5.1" /end CHARACTERISTIC
/begin CHARACTERISTIC DSM_Class14SysLamp_C "Art der Systemlampenansteuerung" VALUE 0xC9365 Kw_Wu8 2.00000000000 SysLamp 0.00 2.00000000000 FORMAT "%13.11" /end CHARACTERISTIC
/begin CHARACTERISTIC DSM_Class14ResErf_C "Verhalten Fehlerflags bei Reset und abgebrochenem Nachlauf" VALUE 0xC9366 Kw_Wu8 3.00000000000 ResErf 0.00 3.00000000000 FORMAT "%13.11" /end CHARACTERISTIC
/begin CHARACTERISTIC DSM_Class14Readiness_C "Zuordnung Entprellklasse zu Readiness Flags" VALUE 0xC9367 Kw_Wu8 64.0000000000 Readiness 0.00 64.0000000000 FORMAT "%13.10" /end CHARACTERISTIC
/begin CHARACTERISTIC DSM_Class15Mil_C "Art der MIL Ansteuerung" VALUE 0xC9368 Kw_Wu8 2.00000000000 Mil 0.00 2.00000000000 FORMAT "%13.11" /end CHARACTERISTIC
/begin CHARACTERISTIC DSM_Class15TFlc_C "Trigger Art für Fehlereintrags Bestätigungsentprellung (->Lampe an)" VALUE 0xC9369 Kw_Wu8 3.00000000000 ClassTrigger 0.00 3.00000000000 FORMAT "%13.11" /end CHARACTERISTIC
/begin CHARACTERISTIC DSM_Class15Flc_C "Anzahl Triggerereignisse für Fehlereintrags Bestätigungsentprellung (->Lampe an)" VALUE 0xC936A Kw_Wu8 255.0 OneToOne 0.00 255.0 FORMAT "%5.1" /end CHARACTERISTIC
/begin CHARACTERISTIC DSM_Class15THlc_C "Trigger Art für Fehlerheilung (->Lampe aus)" VALUE 0xC936B Kw_Wu8 3.00000000000 ClassTrigger 0.00 3.00000000000 FORMAT "%13.11" /end CHARACTERISTIC
/begin CHARACTERISTIC DSM_Class15Hlc_C "Anzahl Triggerereignisse für Fehlerheilung (->Lampe aus)" VALUE 0xC936C Kw_Wu8 255.0 OneToOne 0.00 255.0 FORMAT "%5.1" /end CHARACTERISTIC
/begin CHARACTERISTIC DSM_Class15Scatt_C "Fehler ist lesbar für OBD Scan tool tester (SCATT) wenn Wert = 1" VALUE 0xC936D Kw_Wu8 1.00000000000 Scatt 0.00 1.00000000000 FORMAT "%13.11" /end CHARACTERISTIC
/begin CHARACTERISTIC DSM_Class15TDlcPen_C "Trigger Art für Löschentprellung von nicht bestätigten Fehlern (pending)" VALUE 0xC936E Kw_Wu8 3.00000000000 ClassTriggerTDlc 0.00 3.00000000000 FORMAT "%13.11" /end CHARACTERISTIC
/begin CHARACTERISTIC DSM_Class15DlcPen_C "Anzahl Triggerereignisse für die Löschung von nicht bestätigten Fehlern (pending)" VALUE 0xC936F Kw_Wu8 255.0 OneToOne 0.00 255.0 FORMAT "%5.1" /end CHARACTERISTIC
/begin CHARACTERISTIC DSM_Class15TDlc_C "Trigger Art für Löschentprellung" VALUE 0xC9370 Kw_Wu8 3.00000000000 ClassTriggerTDlc 0.00 3.00000000000 FORMAT "%13.11" /end CHARACTERISTIC
/begin CHARACTERISTIC DSM_Class15DlcKd_C "Anzahl Triggerereignisse für die Löschung von Fehlereinträgen mit Status Kundendienst" VALUE 0xC9371 Kw_Wu8 255.0 OneToOne 0.00 255.0 FORMAT "%5.1" /end CHARACTERISTIC
/begin CHARACTERISTIC DSM_Class15Dlc_C "Anzahl Triggerereignisse für die Löschung von Fehlereinträgen" VALUE 0xC9372 Kw_Wu8 255.0 OneToOne 0.00 255.0 FORMAT "%5.1" /end CHARACTERISTIC
/begin CHARACTERISTIC DSM_Class15Prio_C "Priorität des Fehlereintrages für Verdrängung und freeze frame Zuordnung" VALUE 0xC9373 Kw_Wu8 255.0 OneToOne 0.00 255.0 FORMAT "%5.1" /end CHARACTERISTIC
/begin CHARACTERISTIC DSM_Class15SysLamp_C "Art der Systemlampenansteuerung" VALUE 0xC9374 Kw_Wu8 2.00000000000 SysLamp 0.00 2.00000000000 FORMAT "%13.11" /end CHARACTERISTIC
/begin CHARACTERISTIC DSM_Class15ResErf_C "Verhalten Fehlerflags bei Reset und abgebrochenem Nachlauf" VALUE 0xC9375 Kw_Wu8 3.00000000000 ResErf 0.00 3.00000000000 FORMAT "%13.11" /end CHARACTERISTIC
/begin CHARACTERISTIC DSM_Class15Readiness_C "Zuordnung Entprellklasse zu Readiness Flags" VALUE 0xC9376 Kw_Wu8 64.0000000000 Readiness 0.00 64.0000000000 FORMAT "%13.10" /end CHARACTERISTIC
/begin CHARACTERISTIC DSM_Class16Mil_C "Art der MIL Ansteuerung" VALUE 0xC9377 Kw_Wu8 2.00000000000 Mil 0.00 2.00000000000 FORMAT "%13.11" /end CHARACTERISTIC
/begin CHARACTERISTIC DSM_Class16TFlc_C "Trigger Art für Fehlereintrags Bestätigungsentprellung (->Lampe an)" VALUE 0xC9378 Kw_Wu8 3.00000000000 ClassTrigger 0.00 3.00000000000 FORMAT "%13.11" /end CHARACTERISTIC
/begin CHARACTERISTIC DSM_Class16Flc_C "Anzahl Triggerereignisse für Fehlereintrags Bestätigungsentprellung (->Lampe an)" VALUE 0xC9379 Kw_Wu8 255.0 OneToOne 0.00 255.0 FORMAT "%5.1" /end CHARACTERISTIC
/begin CHARACTERISTIC DSM_Class16THlc_C "Trigger Art für Fehlerheilung (->Lampe aus)" VALUE 0xC937A Kw_Wu8 3.00000000000 ClassTrigger 0.00 3.00000000000 FORMAT "%13.11" /end CHARACTERISTIC
/begin CHARACTERISTIC DSM_Class16Hlc_C "Anzahl Triggerereignisse für Fehlerheilung (->Lampe aus)" VALUE 0xC937B Kw_Wu8 255.0 OneToOne 0.00 255.0 FORMAT "%5.1" /end CHARACTERISTIC
/begin CHARACTERISTIC DSM_Class16Scatt_C "Fehler ist lesbar für OBD Scan tool tester (SCATT) wenn Wert = 1" VALUE 0xC937C Kw_Wu8 1.00000000000 Scatt 0.00 1.00000000000 FORMAT "%13.11" /end CHARACTERISTIC
/begin CHARACTERISTIC DSM_Class16TDlcPen_C "Trigger Art für Löschentprellung von nicht bestätigten Fehlern (pending)" VALUE 0xC937D Kw_Wu8 3.00000000000 ClassTriggerTDlc 0.00 3.00000000000 FORMAT "%13.11" /end CHARACTERISTIC
/begin CHARACTERISTIC DSM_Class16DlcPen_C "Anzahl Triggerereignisse für die Löschung von nicht bestätigten Fehlern (pending)" VALUE 0xC937E Kw_Wu8 255.0 OneToOne 0.00 255.0 FORMAT "%5.1" /end CHARACTERISTIC
/begin CHARACTERISTIC DSM_Class16TDlc_C "Trigger Art für Löschentprellung" VALUE 0xC937F Kw_Wu8 3.00000000000 ClassTriggerTDlc 0.00 3.00000000000 FORMAT "%13.11" /end CHARACTERISTIC
/begin CHARACTERISTIC DSM_Class16DlcKd_C "Anzahl Triggerereignisse für die Löschung von Fehlereinträgen mit Status Kundendienst" VALUE 0xC9380 Kw_Wu8 255.0 OneToOne 0.00 255.0 FORMAT "%5.1" /end CHARACTERISTIC
/begin CHARACTERISTIC DSM_Class16Dlc_C "Anzahl Triggerereignisse für die Löschung von Fehlereinträgen" VALUE 0xC9381 Kw_Wu8 255.0 OneToOne 0.00 255.0 FORMAT "%5.1" /end CHARACTERISTIC
/begin CHARACTERISTIC DSM_Class16Prio_C "Priorität des Fehlereintrages für Verdrängung und freeze frame Zuordnung" VALUE 0xC9382 Kw_Wu8 255.0 OneToOne 0.00 255.0 FORMAT "%5.1" /end CHARACTERISTIC
/begin CHARACTERISTIC DSM_Class16SysLamp_C "Art der Systemlampenansteuerung" VALUE 0xC9383 Kw_Wu8 2.00000000000 SysLamp 0.00 2.00000000000 FORMAT "%13.11" /end CHARACTERISTIC
/begin CHARACTERISTIC DSM_Class16ResErf_C "Verhalten Fehlerflags bei Reset und abgebrochenem Nachlauf" VALUE 0xC9384 Kw_Wu8 3.00000000000 ResErf 0.00 3.00000000000 FORMAT "%13.11" /end CHARACTERISTIC
/begin CHARACTERISTIC DSM_Class16Readiness_C "Zuordnung Entprellklasse zu Readiness Flags" VALUE 0xC9385 Kw_Wu8 64.0000000000 Readiness 0.00 64.0000000000 FORMAT "%13.10" /end CHARACTERISTIC
/begin CHARACTERISTIC DSM_Class17Mil_C "Art der MIL Ansteuerung" VALUE 0xC9386 Kw_Wu8 2.00000000000 Mil 0.00 2.00000000000 FORMAT "%13.11" /end CHARACTERISTIC
/begin CHARACTERISTIC DSM_Class17TFlc_C "Trigger Art für Fehlereintrags Bestätigungsentprellung (->Lampe an)" VALUE 0xC9387 Kw_Wu8 3.00000000000 ClassTrigger 0.00 3.00000000000 FORMAT "%13.11" /end CHARACTERISTIC
/begin CHARACTERISTIC DSM_Class17Flc_C "Anzahl Triggerereignisse für Fehlereintrags Bestätigungsentprellung (->Lampe an)" VALUE 0xC9388 Kw_Wu8 255.0 OneToOne 0.00 255.0 FORMAT "%5.1" /end CHARACTERISTIC
/begin CHARACTERISTIC DSM_Class17THlc_C "Trigger Art für Fehlerheilung (->Lampe aus)" VALUE 0xC9389 Kw_Wu8 3.00000000000 ClassTrigger 0.00 3.00000000000 FORMAT "%13.11" /end CHARACTERISTIC
/begin CHARACTERISTIC DSM_Class17Hlc_C "Anzahl Triggerereignisse für Fehlerheilung (->Lampe aus)" VALUE 0xC938A Kw_Wu8 255.0 OneToOne 0.00 255.0 FORMAT "%5.1" /end CHARACTERISTIC
/begin CHARACTERISTIC DSM_Class17Scatt_C "Fehler ist lesbar für OBD Scan tool tester (SCATT) wenn Wert = 1" VALUE 0xC938B Kw_Wu8 1.00000000000 Scatt 0.00 1.00000000000 FORMAT "%13.11" /end CHARACTERISTIC
/begin CHARACTERISTIC DSM_Class17TDlcPen_C "Trigger Art für Löschentprellung von nicht bestätigten Fehlern (pending)" VALUE 0xC938C Kw_Wu8 3.00000000000 ClassTriggerTDlc 0.00 3.00000000000 FORMAT "%13.11" /end CHARACTERISTIC
/begin CHARACTERISTIC DSM_Class17DlcPen_C "Anzahl Triggerereignisse für die Löschung von nicht bestätigten Fehlern (pending)" VALUE 0xC938D Kw_Wu8 255.0 OneToOne 0.00 255.0 FORMAT "%5.1" /end CHARACTERISTIC
/begin CHARACTERISTIC DSM_Class17TDlc_C "Trigger Art für Löschentprellung" VALUE 0xC938E Kw_Wu8 3.00000000000 ClassTriggerTDlc 0.00 3.00000000000 FORMAT "%13.11" /end CHARACTERISTIC
/begin CHARACTERISTIC DSM_Class17DlcKd_C "Anzahl Triggerereignisse für die Löschung von Fehlereinträgen mit Status Kundendienst" VALUE 0xC938F Kw_Wu8 255.0 OneToOne 0.00 255.0 FORMAT "%5.1" /end CHARACTERISTIC
/begin CHARACTERISTIC DSM_Class17Dlc_C "Anzahl Triggerereignisse für die Löschung von Fehlereinträgen" VALUE 0xC9390 Kw_Wu8 255.0 OneToOne 0.00 255.0 FORMAT "%5.1" /end CHARACTERISTIC
/begin CHARACTERISTIC DSM_Class17Prio_C "Priorität des Fehlereintrages für Verdrängung und freeze frame Zuordnung" VALUE 0xC9391 Kw_Wu8 255.0 OneToOne 0.00 255.0 FORMAT "%5.1" /end CHARACTERISTIC
/begin CHARACTERISTIC DSM_Class17SysLamp_C "Art der Systemlampenansteuerung" VALUE 0xC9392 Kw_Wu8 2.00000000000 SysLamp 0.00 2.00000000000 FORMAT "%13.11" /end CHARACTERISTIC
/begin CHARACTERISTIC DSM_Class17ResErf_C "Verhalten Fehlerflags bei Reset und abgebrochenem Nachlauf" VALUE 0xC9393 Kw_Wu8 3.00000000000 ResErf 0.00 3.00000000000 FORMAT "%13.11" /end CHARACTERISTIC
/begin CHARACTERISTIC DSM_Class17Readiness_C "Zuordnung Entprellklasse zu Readiness Flags" VALUE 0xC9394 Kw_Wu8 64.0000000000 Readiness 0.00 64.0000000000 FORMAT "%13.10" /end CHARACTERISTIC
/begin CHARACTERISTIC DSM_Class18Mil_C "Art der MIL Ansteuerung" VALUE 0xC9395 Kw_Wu8 2.00000000000 Mil 0.00 2.00000000000 FORMAT "%13.11" /end CHARACTERISTIC
/begin CHARACTERISTIC DSM_Class18TFlc_C "Trigger Art für Fehlereintrags Bestätigungsentprellung (->Lampe an)" VALUE 0xC9396 Kw_Wu8 3.00000000000 ClassTrigger 0.00 3.00000000000 FORMAT "%13.11" /end CHARACTERISTIC
/begin CHARACTERISTIC DSM_Class18Flc_C "Anzahl Triggerereignisse für Fehlereintrags Bestätigungsentprellung (->Lampe an)" VALUE 0xC9397 Kw_Wu8 255.0 OneToOne 0.00 255.0 FORMAT "%5.1" /end CHARACTERISTIC
/begin CHARACTERISTIC DSM_Class18THlc_C "Trigger Art für Fehlerheilung (->Lampe aus)" VALUE 0xC9398 Kw_Wu8 3.00000000000 ClassTrigger 0.00 3.00000000000 FORMAT "%13.11" /end CHARACTERISTIC
/begin CHARACTERISTIC DSM_Class18Hlc_C "Anzahl Triggerereignisse für Fehlerheilung (->Lampe aus)" VALUE 0xC9399 Kw_Wu8 255.0 OneToOne 0.00 255.0 FORMAT "%5.1" /end CHARACTERISTIC
/begin CHARACTERISTIC DSM_Class18Scatt_C "Fehler ist lesbar für OBD Scan tool tester (SCATT) wenn Wert = 1" VALUE 0xC939A Kw_Wu8 1.00000000000 Scatt 0.00 1.00000000000 FORMAT "%13.11" /end CHARACTERISTIC
/begin CHARACTERISTIC DSM_Class18TDlcPen_C "Trigger Art für Löschentprellung von nicht bestätigten Fehlern (pending)" VALUE 0xC939B Kw_Wu8 3.00000000000 ClassTriggerTDlc 0.00 3.00000000000 FORMAT "%13.11" /end CHARACTERISTIC
/begin CHARACTERISTIC DSM_Class18DlcPen_C "Anzahl Triggerereignisse für die Löschung von nicht bestätigten Fehlern (pending)" VALUE 0xC939C Kw_Wu8 255.0 OneToOne 0.00 255.0 FORMAT "%5.1" /end CHARACTERISTIC
/begin CHARACTERISTIC DSM_Class18TDlc_C "Trigger Art für Löschentprellung" VALUE 0xC939D Kw_Wu8 3.00000000000 ClassTriggerTDlc 0.00 3.00000000000 FORMAT "%13.11" /end CHARACTERISTIC
/begin CHARACTERISTIC DSM_Class18DlcKd_C "Anzahl Triggerereignisse für die Löschung von Fehlereinträgen mit Status Kundendienst" VALUE 0xC939E Kw_Wu8 255.0 OneToOne 0.00 255.0 FORMAT "%5.1" /end CHARACTERISTIC
/begin CHARACTERISTIC DSM_Class18Dlc_C "Anzahl Triggerereignisse für die Löschung von Fehlereinträgen" VALUE 0xC939F Kw_Wu8 255.0 OneToOne 0.00 255.0 FORMAT "%5.1" /end CHARACTERISTIC
/begin CHARACTERISTIC DSM_Class18Prio_C "Priorität des Fehlereintrages für Verdrängung und freeze frame Zuordnung" VALUE 0xC93A0 Kw_Wu8 255.0 OneToOne 0.00 255.0 FORMAT "%5.1" /end CHARACTERISTIC
/begin CHARACTERISTIC DSM_Class18SysLamp_C "Art der Systemlampenansteuerung" VALUE 0xC93A1 Kw_Wu8 2.00000000000 SysLamp 0.00 2.00000000000 FORMAT "%13.11" /end CHARACTERISTIC
/begin CHARACTERISTIC DSM_Class18ResErf_C "Verhalten Fehlerflags bei Reset und abgebrochenem Nachlauf" VALUE 0xC93A2 Kw_Wu8 3.00000000000 ResErf 0.00 3.00000000000 FORMAT "%13.11" /end CHARACTERISTIC
/begin CHARACTERISTIC DSM_Class18Readiness_C "Zuordnung Entprellklasse zu Readiness Flags" VALUE 0xC93A3 Kw_Wu8 64.0000000000 Readiness 0.00 64.0000000000 FORMAT "%13.10" /end CHARACTERISTIC
/begin CHARACTERISTIC DSM_Class19Mil_C "Art der MIL Ansteuerung" VALUE 0xC93A4 Kw_Wu8 2.00000000000 Mil 0.00 2.00000000000 FORMAT "%13.11" /end CHARACTERISTIC
/begin CHARACTERISTIC DSM_Class19TFlc_C "Trigger Art für Fehlereintrags Bestätigungsentprellung (->Lampe an)" VALUE 0xC93A5 Kw_Wu8 3.00000000000 ClassTrigger 0.00 3.00000000000 FORMAT "%13.11" /end CHARACTERISTIC
/begin CHARACTERISTIC DSM_Class19Flc_C "Anzahl Triggerereignisse für Fehlereintrags Bestätigungsentprellung (->Lampe an)" VALUE 0xC93A6 Kw_Wu8 255.0 OneToOne 0.00 255.0 FORMAT "%5.1" /end CHARACTERISTIC
/begin CHARACTERISTIC DSM_Class19THlc_C "Trigger Art für Fehlerheilung (->Lampe aus)" VALUE 0xC93A7 Kw_Wu8 3.00000000000 ClassTrigger 0.00 3.00000000000 FORMAT "%13.11" /end CHARACTERISTIC
/begin CHARACTERISTIC DSM_Class19Hlc_C "Anzahl Triggerereignisse für Fehlerheilung (->Lampe aus)" VALUE 0xC93A8 Kw_Wu8 255.0 OneToOne 0.00 255.0 FORMAT "%5.1" /end CHARACTERISTIC
/begin CHARACTERISTIC DSM_Class19Scatt_C "Fehler ist lesbar für OBD Scan tool tester (SCATT) wenn Wert = 1" VALUE 0xC93A9 Kw_Wu8 1.00000000000 Scatt 0.00 1.00000000000 FORMAT "%13.11" /end CHARACTERISTIC
/begin CHARACTERISTIC DSM_Class19TDlcPen_C "Trigger Art für Löschentprellung von nicht bestätigten Fehlern (pending)" VALUE 0xC93AA Kw_Wu8 3.00000000000 ClassTriggerTDlc 0.00 3.00000000000 FORMAT "%13.11" /end CHARACTERISTIC
/begin CHARACTERISTIC DSM_Class19DlcPen_C "Anzahl Triggerereignisse für die Löschung von nicht bestätigten Fehlern (pending)" VALUE 0xC93AB Kw_Wu8 255.0 OneToOne 0.00 255.0 FORMAT "%5.1" /end CHARACTERISTIC
/begin CHARACTERISTIC DSM_Class19TDlc_C "Trigger Art für Löschentprellung" VALUE 0xC93AC Kw_Wu8 3.00000000000 ClassTriggerTDlc 0.00 3.00000000000 FORMAT "%13.11" /end CHARACTERISTIC
/begin CHARACTERISTIC DSM_Class19DlcKd_C "Anzahl Triggerereignisse für die Löschung von Fehlereinträgen mit Status Kundendienst" VALUE 0xC93AD Kw_Wu8 255.0 OneToOne 0.00 255.0 FORMAT "%5.1" /end CHARACTERISTIC
/begin CHARACTERISTIC DSM_Class19Dlc_C "Anzahl Triggerereignisse für die Löschung von Fehlereinträgen" VALUE 0xC93AE Kw_Wu8 255.0 OneToOne 0.00 255.0 FORMAT "%5.1" /end CHARACTERISTIC
/begin CHARACTERISTIC DSM_Class19Prio_C "Priorität des Fehlereintrages für Verdrängung und freeze frame Zuordnung" VALUE 0xC93AF Kw_Wu8 255.0 OneToOne 0.00 255.0 FORMAT "%5.1" /end CHARACTERISTIC
/begin CHARACTERISTIC DSM_Class19SysLamp_C "Art der Systemlampenansteuerung" VALUE 0xC93B0 Kw_Wu8 2.00000000000 SysLamp 0.00 2.00000000000 FORMAT "%13.11" /end CHARACTERISTIC
/begin CHARACTERISTIC DSM_Class19ResErf_C "Verhalten Fehlerflags bei Reset und abgebrochenem Nachlauf" VALUE 0xC93B1 Kw_Wu8 3.00000000000 ResErf 0.00 3.00000000000 FORMAT "%13.11" /end CHARACTERISTIC
/begin CHARACTERISTIC DSM_Class19Readiness_C "Zuordnung Entprellklasse zu Readiness Flags" VALUE 0xC93B2 Kw_Wu8 64.0000000000 Readiness 0.00 64.0000000000 FORMAT "%13.10" /end CHARACTERISTIC
/begin CHARACTERISTIC DSM_Class20Mil_C "Art der MIL Ansteuerung" VALUE 0xC93B3 Kw_Wu8 2.00000000000 Mil 0.00 2.00000000000 FORMAT "%13.11" /end CHARACTERISTIC
/begin CHARACTERISTIC DSM_Class20TFlc_C "Trigger Art für Fehlereintrags Bestätigungsentprellung (->Lampe an)" VALUE 0xC93B4 Kw_Wu8 3.00000000000 ClassTrigger 0.00 3.00000000000 FORMAT "%13.11" /end CHARACTERISTIC
/begin CHARACTERISTIC DSM_Class20Flc_C "Anzahl Triggerereignisse für Fehlereintrags Bestätigungsentprellung (->Lampe an)" VALUE 0xC93B5 Kw_Wu8 255.0 OneToOne 0.00 255.0 FORMAT "%5.1" /end CHARACTERISTIC
/begin CHARACTERISTIC DSM_Class20THlc_C "Trigger Art für Fehlerheilung (->Lampe aus)" VALUE 0xC93B6 Kw_Wu8 3.00000000000 ClassTrigger 0.00 3.00000000000 FORMAT "%13.11" /end CHARACTERISTIC
/begin CHARACTERISTIC DSM_Class20Hlc_C "Anzahl Triggerereignisse für Fehlerheilung (->Lampe aus)" VALUE 0xC93B7 Kw_Wu8 255.0 OneToOne 0.00 255.0 FORMAT "%5.1" /end CHARACTERISTIC
/begin CHARACTERISTIC DSM_Class20Scatt_C "Fehler ist lesbar für OBD Scan tool tester (SCATT) wenn Wert = 1" VALUE 0xC93B8 Kw_Wu8 1.00000000000 Scatt 0.00 1.00000000000 FORMAT "%13.11" /end CHARACTERISTIC
/begin CHARACTERISTIC DSM_Class20TDlcPen_C "Trigger Art für Löschentprellung von nicht bestätigten Fehlern (pending)" VALUE 0xC93B9 Kw_Wu8 3.00000000000 ClassTriggerTDlc 0.00 3.00000000000 FORMAT "%13.11" /end CHARACTERISTIC
/begin CHARACTERISTIC DSM_Class20DlcPen_C "Anzahl Triggerereignisse für die Löschung von nicht bestätigten Fehlern (pending)" VALUE 0xC93BA Kw_Wu8 255.0 OneToOne 0.00 255.0 FORMAT "%5.1" /end CHARACTERISTIC
/begin CHARACTERISTIC DSM_Class20TDlc_C "Trigger Art für Löschentprellung" VALUE 0xC93BB Kw_Wu8 3.00000000000 ClassTriggerTDlc 0.00 3.00000000000 FORMAT "%13.11" /end CHARACTERISTIC
/begin CHARACTERISTIC DSM_Class20DlcKd_C "Anzahl Triggerereignisse für die Löschung von Fehlereinträgen mit Status Kundendienst" VALUE 0xC93BC Kw_Wu8 255.0 OneToOne 0.00 255.0 FORMAT "%5.1" /end CHARACTERISTIC
/begin CHARACTERISTIC DSM_Class20Dlc_C "Anzahl Triggerereignisse für die Löschung von Fehlereinträgen" VALUE 0xC93BD Kw_Wu8 255.0 OneToOne 0.00 255.0 FORMAT "%5.1" /end CHARACTERISTIC
/begin CHARACTERISTIC DSM_Class20Prio_C "Priorität des Fehlereintrages für Verdrängung und freeze frame Zuordnung" VALUE 0xC93BE Kw_Wu8 255.0 OneToOne 0.00 255.0 FORMAT "%5.1" /end CHARACTERISTIC
/begin CHARACTERISTIC DSM_Class20SysLamp_C "Art der Systemlampenansteuerung" VALUE 0xC93BF Kw_Wu8 2.00000000000 SysLamp 0.00 2.00000000000 FORMAT "%13.11" /end CHARACTERISTIC
/begin CHARACTERISTIC DSM_Class20ResErf_C "Verhalten Fehlerflags bei Reset und abgebrochenem Nachlauf" VALUE 0xC93C0 Kw_Wu8 3.00000000000 ResErf 0.00 3.00000000000 FORMAT "%13.11" /end CHARACTERISTIC
/begin CHARACTERISTIC DSM_Class20Readiness_C "Zuordnung Entprellklasse zu Readiness Flags" VALUE 0xC93C1 Kw_Wu8 64.0000000000 Readiness 0.00 64.0000000000 FORMAT "%13.10" /end CHARACTERISTIC
/begin CHARACTERISTIC DSM_FCMClear_C "Fehlerspeicher löschen über Label" VALUE 0xC93C2 Kw_Wu8 1.000 OneToOne 0.00 1.000 FORMAT "%5.3" EXTENDED_LIMITS 0.00 255.0 /end CHARACTERISTIC
/begin CHARACTERISTIC DSM_FrzFrEnvironment_C "Freeze frame, Auswahl der Umweltbedingungen" VAL_BLK 0xC93C4 Kwb_Wu16 255.000000000 SigName 0.00 255.000000000 FORMAT "%13.9" NUMBER 11 /end CHARACTERISTIC
/begin CHARACTERISTIC DSM_stStepWidth_CA "Schrittweite der Ereignisentprellung der up/down counter" VAL_BLK 0xC93DA Kwb_Wu8 255.0 OneToOne 0.00 255.0 FORMAT "%5.1" NUMBER 4 /end CHARACTERISTIC
/begin CHARACTERISTIC DSM_SysLampMode_C "Aktivierungsbedingung der System Lampe (1= aktuelle Fehler, 0 = bestätigte Fehlerspeichereinträge)" VALUE 0xC93DE Kw_Wu8 2.00000000000 SysLampMode 0.00 2.00000000000 FORMAT "%13.11" /end CHARACTERISTIC
/begin CHARACTERISTIC DSM_tiDCMin_C "Mindestzeit für driving cycle Erkennung (Maximalwert = Nachlauf)" VALUE 0xC93E0 Kw_Wu16 65535.00 TimeDsmDC 0.00 65535.00 FORMAT "%8.2" /end CHARACTERISTIC
/begin CHARACTERISTIC DSM_tiWucDelay_C "Zeitverzögerung für die Abtasung der Kühlwassertemperatur bei Start zur Warm Up Cycle Ermittlung" VALUE 0xC93E2 Kw_Wu16 655350.0 Time_ms 0.00 655350.0 FORMAT "%8.1" /end CHARACTERISTIC
/begin CHARACTERISTIC DSM_WucMinDiff_C "Minimale Differenztemperatur für warm up cycle" VALUE 0xC93E4 Kw_Ws16 6553.500 TempDiff_Cels -3276.800 3276.700 FORMAT "%8.3" /end CHARACTERISTIC
/begin CHARACTERISTIC DSM_WucMinTemp_C "Minimaltemperatur für warm up cycle" VALUE 0xC93E6 Kw_Ws16 950.000 Temp_Cels -50.140 899.860 FORMAT "%8.3" EXTENDED_LIMITS -3549.940 3003.560 /end CHARACTERISTIC
/begin CHARACTERISTIC DVMARK "Mindestabstand von Geschwindigkeits-Marken beim Stufentempomat" VALUE 0xC05AC KwWU16 655.3500 Vel 0.00 655.3500 FORMAT "%8.4" /end CHARACTERISTIC
/begin CHARACTERISTIC DVMARKMI "dvmark_w für mph-Tachometer" VALUE 0xC05AE KwWU16 655.3500 Vel 0.00 655.3500 FORMAT "%8.4" /end CHARACTERISTIC
/begin CHARACTERISTIC DVPRG "Schrittweite bei Anzeige der Regelgeschwindigkeit im Programmiermodus" VALUE 0xC05B0 KwWU16 655.3500 Vel 0.00 655.3500 FORMAT "%8.4" /end CHARACTERISTIC
/begin CHARACTERISTIC DVPRGMI "dvprg_w für mph-Tachometer" VALUE 0xC05B2 KwWU16 655.3500 Vel 0.00 655.3500 FORMAT "%8.4" /end CHARACTERISTIC
/begin CHARACTERISTIC DVSTUTOM "Schrittweite f ür Verstellung der Zielgeschwindigkeit ohne programmierte Marken" VALUE 0xC05B4 KwWU16 655.3500 Vel 0.00 655.3500 FORMAT "%8.4" /end CHARACTERISTIC
/begin CHARACTERISTIC DVSTUTOMMI "dvstutom_w für mph - tacho" VALUE 0xC05B6 KwWU16 655.3500 Vel 0.00 655.3500 FORMAT "%8.4" /end CHARACTERISTIC
/begin CHARACTERISTIC TFGRTP "Zeit für Tip-Erkennung bei FGR-Bedientasten" VALUE 0xC05BF KwWU8 5.100 t20msxs_ub_b5p1 0.00 5.100 FORMAT "%5.3" /end CHARACTERISTIC
/begin CHARACTERISTIC TMARK "Verzögerungszeit f ür Ein- und Ausblenden der Marken mit Tipschalter Aus" VALUE 0xC05C0 KwWU8 5.100 t20msxs_ub_b5p1 0.00 5.100 FORMAT "%5.3" /end CHARACTERISTIC
/begin CHARACTERISTIC TMRKBLI "Zeit für Ein- und Ausschaltung beim Blinken der Markenanzeige" VALUE 0xC05C1 KwWU8 5.100 t20msxs_ub_b5p1 0.00 5.100 FORMAT "%5.3" /end CHARACTERISTIC
/begin CHARACTERISTIC TSELO "Verzögerungszeit für das Setzen und Löschen von Marken" VALUE 0xC05C2 KwWU8 5.100 t20msxs_ub_b5p1 0.00 5.100 FORMAT "%5.3" /end CHARACTERISTIC
/begin CHARACTERISTIC TVSTUTK "Verzögerungszeit kurz für Verstellung bei gehaltener Taste" VALUE 0xC05C3 KwWU8 5.100 t20msxs_ub_b5p1 0.00 5.100 FORMAT "%5.3" /end CHARACTERISTIC
/begin CHARACTERISTIC TVSTUTL "Verzögerungszeit lang für Verstellung bei gehaltener Taste" VALUE 0xC05C4 KwWU8 5.100 t20msxs_ub_b5p1 0.00 5.100 FORMAT "%5.3" /end CHARACTERISTIC
/begin CHARACTERISTIC VFGRPRG "Geschindigkeitsschwelle zum Abschalten des FGR Programmiermodus" VALUE 0xC05B8 KwWU16 655.3500 Vel 0.00 655.3500 FORMAT "%8.4" /end CHARACTERISTIC
/begin CHARACTERISTIC VVEMOFS "Offset zur eingefrorenen vIst bei verzögern, ab der die v-Marke wieder zum Schleppzeiger wird" VALUE 0xC05BA KwWU16 655.3500 Vel 0.00 655.3500 FORMAT "%8.4" /end CHARACTERISTIC
/begin MEASUREMENT anzmark "Anzahl Geschwindigkeits-Marken Stufentempomat" UBYTE dez 1 100 0.00 255.0 FORMAT "%5.1" ECU_ADDRESS 0x7F89AB /end MEASUREMENT
/begin MEASUREMENT BGSTUTlokbits0 "keine Funktion" UWORD dez 1 100 0.00 65535.00 FORMAT "%8.2" ECU_ADDRESS 0x7F8A8A /end MEASUREMENT
/begin MEASUREMENT B_acc "Bedingung ACC-Steuergerät vorhanden" UBYTE B_TRUE 1 100 0.00 1.00000000000 BIT_MASK 0x1 FORMAT "%13.11" ECU_ADDRESS 0x7F87CA /end MEASUREMENT
/begin MEASUREMENT B_besch "Bedingung FGR im Zustand Beschleunigen" UBYTE B_TRUE 1 100 0.00 1.00000000000 BIT_MASK 0x1 FORMAT "%13.11" ECU_ADDRESS 0x7F87CC /end MEASUREMENT
/begin MEASUREMENT B_beveh "Bedingung Halten der Beschleunigen- oder Verzögerungs-Taste" UBYTE B_TRUE 1 100 0.00 1.00000000000 FORMAT "%13.11" ECU_ADDRESS 0x7F87CD /end MEASUREMENT
/begin MEASUREMENT B_bv1 "Bedingung Bediensignal Stufentempomat Beschleunigen oder Verzögern 1. Stufe" UBYTE B_TRUE 1 100 0.00 1.00000000000 FORMAT "%13.11" ECU_ADDRESS 0x7F87CE /end MEASUREMENT
/begin MEASUREMENT B_bv2 "Bedingung Bediensignal Stufentempomat Beschleunigen oder Verzögern 2. Stufe" UBYTE B_TRUE 1 100 0.00 1.00000000000 FORMAT "%13.11" ECU_ADDRESS 0x7F87CF /end MEASUREMENT
/begin MEASUREMENT B_envtwa "Bedingung FGR aktiv vor Betätigung der Wiederaufnahme-Taste" UBYTE B_TRUE 1 100 0.00 1.00000000000 FORMAT "%13.11" ECU_ADDRESS 0x7F87D1 /end MEASUREMENT
/begin MEASUREMENT B_fgrat "Bedingung: Tip-Schalter Aus am FGR-Bedienteil betätigt" UBYTE B_TRUE 1 100 0.00 1.00000000000 BIT_MASK 0x1 FORMAT "%13.11" ECU_ADDRESS 0x7F87D3 /end MEASUREMENT
/begin MEASUREMENT B_fgren "Bedingung Fahrgeschwindigkeitsregelung aktiv (Enable)" UBYTE B_TRUE 1 100 0.00 1.00000000000 BIT_MASK 0x1 FORMAT "%13.11" ECU_ADDRESS 0x7F87D4 /end MEASUREMENT
/begin MEASUREMENT B_fgrepa "Status in Cruise control" UBYTE B_TRUE 1 100 0.00 1.00000000000 FORMAT "%13.11" ECU_ADDRESS 0x7F87D5 /end MEASUREMENT
/begin MEASUREMENT B_fgresv "" UBYTE B_TRUE 1 100 0.00 1.00000000000 BIT_MASK 0x1 FORMAT "%13.11" ECU_ADDRESS 0x7F87D6 /end MEASUREMENT
/begin MEASUREMENT B_fgrtb2 "Bedingung FGR-Taste Auswahl der nächsthöheren Zielgeschwindigkeit" UBYTE B_TRUE 1 100 0.00 1.00000000000 BIT_MASK 0x1 FORMAT "%13.11" ECU_ADDRESS 0x7F87D7 /end MEASUREMENT
/begin MEASUREMENT B_fgrtbe "Bedingung FGR-Taste Beschleunigen" UBYTE B_TRUE 1 100 0.00 1.00000000000 BIT_MASK 0x1 FORMAT "%13.11" ECU_ADDRESS 0x7F87D8 /end MEASUREMENT
/begin MEASUREMENT B_fgrtv2 "Bedingung FGR-Taste Auswahl der nächstniederen Zielgeschwindigkeit" UBYTE B_TRUE 1 100 0.00 1.00000000000 BIT_MASK 0x1 FORMAT "%13.11" ECU_ADDRESS 0x7F87D9 /end MEASUREMENT
/begin MEASUREMENT B_fgrtve "Bedingung FGR-Taste Verzöägern" UBYTE B_TRUE 1 100 0.00 1.00000000000 BIT_MASK 0x1 FORMAT "%13.11" ECU_ADDRESS 0x7F87DA /end MEASUREMENT
/begin MEASUREMENT B_fgrtwa "Bedingung FGR-Taste Wiederaufnahme" UBYTE B_TRUE 1 100 0.00 1.00000000000 BIT_MASK 0x1 FORMAT "%13.11" ECU_ADDRESS 0x7F87DB /end MEASUREMENT
/begin MEASUREMENT B_fgrvem "Bedingung: FGR im Zustand Verzögern (aus ME)" UBYTE B_TRUE 1 100 0.00 1.00000000000 BIT_MASK 0x1 FORMAT "%13.11" ECU_ADDRESS 0x7F87DC /end MEASUREMENT
/begin MEASUREMENT B_insfgre "Bedingung Fehler im INST-Kombi, FGR muss abgeschaltet werden" UBYTE B_TRUE 1 100 0.00 1.00000000000 BIT_MASK 0x1 FORMAT "%13.11" ECU_ADDRESS 0x7F87DD /end MEASUREMENT
/begin MEASUREMENT B_kl15 "Bedingung Klemme 15" UBYTE B_TRUE 1 100 0.00 1.00000000000 BIT_MASK 0x1 FORMAT "%13.11" ECU_ADDRESS 0x7F87DE /end MEASUREMENT
/begin MEASUREMENT B_km "Bedingung CAN-Kombi-Kodierung in km/h" UBYTE B_TRUE 1 100 0.00 1.00000000000 BIT_MASK 0x1 FORMAT "%13.11" ECU_ADDRESS 0x7F87DF /end MEASUREMENT
/begin MEASUREMENT B_mmiena "Status bit" UBYTE B_TRUE 1 100 0.00 1.00000000000 BIT_MASK 0x1 FORMAT "%13.11" ECU_ADDRESS 0x7F87E0 /end MEASUREMENT
/begin MEASUREMENT B_mrkbli "Bedingung Blinken der Markenanzeige" UBYTE B_TRUE 1 100 0.00 1.00000000000 FORMAT "%13.11" ECU_ADDRESS 0x7F87E1 /end MEASUREMENT
/begin MEASUREMENT B_mrkein "Bedingung Anzeige Geschwindigkeits-Marken im Kombi ein" UBYTE B_TRUE 1 100 0.00 1.00000000000 BIT_MASK 0x1 FORMAT "%13.11" ECU_ADDRESS 0x7F87E2 /end MEASUREMENT
/begin MEASUREMENT B_mrkv "Bedingung Veränderung der Geschwindigkeits-Marken Stufentempomat" UBYTE B_TRUE 1 100 0.00 1.00000000000 BIT_MASK 0x1 FORMAT "%13.11" ECU_ADDRESS 0x7F87E3 /end MEASUREMENT
/begin MEASUREMENT B_prgmod "Bedingung Programmiermodus Stufentempomat" UBYTE B_TRUE 1 100 0.00 1.00000000000 FORMAT "%13.11" ECU_ADDRESS 0x7F87E5 /end MEASUREMENT
/begin MEASUREMENT B_tmark "Bedingung Taste Aus für die Zeit TMARK betätigt" UBYTE B_TRUE 1 100 0.00 1.00000000000 FORMAT "%13.11" ECU_ADDRESS 0x7F87E6 /end MEASUREMENT
/begin MEASUREMENT B_tmrkbli "Bedingung"" Blinken der Markenanzeige""" UBYTE B_TRUE 1 100 0.00 1.00000000000 FORMAT "%13.11" ECU_ADDRESS 0x7F87E7 /end MEASUREMENT
/begin MEASUREMENT B_vziels "Bedingung Übernahme berechnete Zielgeschwindigkeit" UBYTE B_TRUE 1 100 0.00 1.00000000000 BIT_MASK 0x1 FORMAT "%13.11" ECU_ADDRESS 0x7F87E8 /end MEASUREMENT
/begin MEASUREMENT canzbl "Zähler für Aus-/Ein-Schaltungen beim Blinken der Markenanzeige" UBYTE dez 1 100 0.00 255.0 FORMAT "%5.1" ECU_ADDRESS 0x7F89AC /end MEASUREMENT
/begin MEASUREMENT CrCtl_BGSTUTbits2_mp "" UWORD OneToOne 1 100 0.00 65535.00 FORMAT "%8.2" ECU_ADDRESS 0x8FE580 /end MEASUREMENT
/begin MEASUREMENT CrCtl_mrkeinvp_mp "" UBYTE OneToOne 1 100 0.00 255.0 FORMAT "%5.1" ECU_ADDRESS 0x8FE582 /end MEASUREMENT
/begin MEASUREMENT CrCtl_numVMrk "1 Index für vmrki..." UBYTE OneToOne 1 100 0.00 255.0 FORMAT "%5.1" ECU_ADDRESS 0x7F882F /end MEASUREMENT
/begin MEASUREMENT CrCtl_stCC "Status FGR" UBYTE OneToOne 1 100 0.00 255.0 FORMAT "%5.1" ECU_ADDRESS 0x7F8833 /end MEASUREMENT
/begin MEASUREMENT CrCtl_stUpdateVMrk "Trigger zum senden der Botschaft" UBYTE OneToOne 1 100 0.00 255.0 FORMAT "%5.1" ECU_ADDRESS 0x7F8836 /end MEASUREMENT
/begin MEASUREMENT CrCtl_stVCrCtl "Diagnosefreigabestatus für Anzeigegeschwindigkeit" UBYTE OneToOne 1 100 0.00 255.0 FORMAT "%5.1" ECU_ADDRESS 0x7F8837 /end MEASUREMENT
/begin MEASUREMENT CrCtl_stVDisp "Marke aus/ein" UBYTE OneToOne 1 100 0.00 255.0 FORMAT "%5.1" ECU_ADDRESS 0x7F8838 /end MEASUREMENT
/begin MEASUREMENT CrCtl_stVSetNew "neue Sollgeschwindigkeit aus Stufentempomat übernehmen" UBYTE OneToOne 1 100 0.00 255.0 FORMAT "%5.1" ECU_ADDRESS 0x7F8839 /end MEASUREMENT
/begin MEASUREMENT CrCtl_vAlwMax "Obere Grenze für FGR-Sollgeschwindigkeit" SWORD Vel 1 100 0.00 300.0000 FORMAT "%8.4" ECU_ADDRESS 0x7F8B7C /end MEASUREMENT
/begin MEASUREMENT CrCtl_vAlwMin "min. mögliche Setzgeschwindigkeit" SWORD Vel 1 100 0.00 300.0000 FORMAT "%8.4" ECU_ADDRESS 0x7F8B7E /end MEASUREMENT
/begin MEASUREMENT CrCtl_vCurr "Fahrzeuggeschwindigkeit für FGR" SWORD Vel 1 100 0.00 300.0000 FORMAT "%8.4" ECU_ADDRESS 0x7F8B82 /end MEASUREMENT
/begin MEASUREMENT CrCtl_vDesDisp "aktuelle Zielgeschwindigkeit STUT" SWORD Vel 1 100 0.00 300.0000 FORMAT "%8.4" ECU_ADDRESS 0x7F8B86 /end MEASUREMENT
/begin MEASUREMENT CrCtl_vDispOffset "Abweichung Anzeigegeschwindigkeit - gef. Messgeschwindigkeit" SWORD Vel 1 100 0.00 300.0000 FORMAT "%8.4" ECU_ADDRESS 0x7F8B88 /end MEASUREMENT
/begin MEASUREMENT CrCtl_vMrk1 "v-Marke 1 für Botschaft" SWORD Vel 1 100 0.00 300.0000 FORMAT "%8.4" ECU_ADDRESS 0x7F8B8A /end MEASUREMENT
/begin MEASUREMENT CrCtl_vMrk2 "v-Marke für 2 Botschaft" SWORD Vel 1 100 0.00 300.0000 FORMAT "%8.4" ECU_ADDRESS 0x7F8B8C /end MEASUREMENT
/begin MEASUREMENT CrCtl_vMrk3 "v-Marke 3 für Botschaft" SWORD Vel 1 100 0.00 300.0000 FORMAT "%8.4" ECU_ADDRESS 0x7F8B8E /end MEASUREMENT
/begin MEASUREMENT CrCtl_vSetNew "neue Sollgeschwindigkeit aus Stufentempomat" SWORD Vel 1 100 0.00 300.0000 FORMAT "%8.4" ECU_ADDRESS 0x7F8B92 /end MEASUREMENT
/begin MEASUREMENT CrSCD_dSegMisf "Verschiebung Segmentsystem für Aussetzererkennung" SBYTE OneToOne 1 100 -128.0 127.0 FORMAT "%5.1" ECU_ADDRESS 0x7F883A /end MEASUREMENT
/begin MEASUREMENT CrSCD_incNextIntDelta_mp "Anzahl der Inkrements bis zum nächsten statischen  Interrupt" SWORD OneToOne 1 100 -32768.00 32767.00 FORMAT "%8.2" ECU_ADDRESS 0x8FE59C /end MEASUREMENT
/begin MEASUREMENT CrSCD_incNextInt_mp "Anzahl der Inkrements bis zum nächsten statischen  Interrupt" SBYTE OneToOne 1 100 -128.0 127.0 FORMAT "%5.1" ECU_ADDRESS 0x8FE59E /end MEASUREMENT
/begin MEASUREMENT CrSCD_nAvrg "gemittelte Kurbelwellendrehzahl des letzten und vorletzten segmentes" SWORD EngN 1 100 -32768.00 32767.00 FORMAT "%8.2" ECU_ADDRESS 0x7F8B94 /end MEASUREMENT
/begin MEASUREMENT CrSCD_nAvrgHiRes "Gemittelte hochauflösende Drehzahl" SLONG EngN_HiRes 1 100 -268435456.000 268435455.875 FORMAT "%13.3" ECU_ADDRESS 0x7F90F0 /end MEASUREMENT
/begin MEASUREMENT CrSCD_nCurr "aktuelle Motordrehzahl aus der letzten Segmentperiode" SWORD EngN 1 100 -32768.00 32767.00 FORMAT "%8.2" ECU_ADDRESS 0x7F8B96 /end MEASUREMENT
/begin MEASUREMENT CrSCD_nCurrHiRes "Aktuelle hochauflösende Drehzahl" SLONG EngN_HiRes 1 100 -268435456.000 268435455.875 FORMAT "%13.3" ECU_ADDRESS 0x7F90F4 /end MEASUREMENT
/begin MEASUREMENT CrSCD_nDyn "aktuelle Motordrehzahl mit Filter für Segment der Dekompressionsphase" SWORD EngN 1 100 -32768.00 32767.00 FORMAT "%8.2" ECU_ADDRESS 0x7F8B98 /end MEASUREMENT
/begin MEASUREMENT CrSCD_nHold "aktuelle Motordrehzahl des vorletzten Segmentes" SWORD EngN 1 100 -32768.00 32767.00 FORMAT "%8.2" ECU_ADDRESS 0x7F8B9A /end MEASUREMENT
/begin MEASUREMENT CrSCD_nIncr "Motordrehzahl aus Inkrementperiode" SWORD EngN 1 100 -32768.00 32767.00 FORMAT "%8.2" ECU_ADDRESS 0x7F8B9C /end MEASUREMENT
/begin MEASUREMENT CrSCD_nMisf "Drehzahlsignal für ODB-Zündaussetzererkennung" SWORD EngN 1 100 -32768.00 32767.00 FORMAT "%8.2" ECU_ADDRESS 0x7F8B9E /end MEASUREMENT
/begin MEASUREMENT CrSCD_numSeg "aktuelle Segmentnummer  (Segment 0 ist bei OT 1)" UBYTE OneToOne 1 100 0.00 255.0 FORMAT "%5.1" ECU_ADDRESS 0x7F883B /end MEASUREMENT
/begin MEASUREMENT CrSCD_phiCurr_mp "Aktueller Winkel basierent auf dem Inkrementsystem" SWORD AngleCrS 1 100 -768.0000 767.9766 FORMAT "%8.4" ECU_ADDRESS 0x8FE5A0 /end MEASUREMENT
/begin MEASUREMENT CrSCD_phiIncCor "aktuelle Phasenkorrektur des Inkrementsystems der Kurbelwelle" SWORD AngleCrS 1 100 -768.0000 767.9766 FORMAT "%8.4" ECU_ADDRESS 0x7F8BA0 /end MEASUREMENT
/begin MEASUREMENT CrSCD_phiIncr "Winkel eines Inkrements in Grad Kurbelwelle" SWORD AngleCrS 1 100 -768.0000 767.9766 FORMAT "%8.4" ECU_ADDRESS 0x7F8BA2 /end MEASUREMENT
/begin MEASUREMENT CrSCD_phiSegGrid_mp "Berechnete Drehzahlsegmentlänge" SWORD AngleCrS 1 100 -768.0000 767.9766 FORMAT "%8.4" ECU_ADDRESS 0x8FE5A2 /end MEASUREMENT
/begin MEASUREMENT CrSCD_stIncErr_mp "Fehlerstatus des Inkrementgebersignals (Signalstöhrungen, Frequenzstatus, Inkrementpufferstatus)" UBYTE OneToOne 1 100 0.00 255.0 FORMAT "%5.1" ECU_ADDRESS 0x8FE5A4 /end MEASUREMENT
/begin MEASUREMENT CrSCD_stIncSig_mp "Status des Inkrementgeber Signalauswertung (Plausibilisierung der Zahnflankenzeiten und -anzahl)" UBYTE OneToOne 1 100 0.00 255.0 FORMAT "%5.1" ECU_ADDRESS 0x8FE5A5 /end MEASUREMENT
/begin MEASUREMENT CrSCD_stIncSyncInc_mp "Synchronisationsstatus des Inkrementgebersignals nach Aufruf von CrSCD_UpdPos (Intern, Debugging)" UBYTE OneToOne 1 100 0.00 255.0 FORMAT "%5.1" ECU_ADDRESS 0x8FE5A6 /end MEASUREMENT
/begin MEASUREMENT CrSCD_stIncSyncPhase_mp "Synchronisationsstatus des Inkrementgebersignals nach Aufruf von CaSCD_GetPos (Intern, Debugging)" UBYTE OneToOne 1 100 0.00 255.0 FORMAT "%5.1" ECU_ADDRESS 0x8FE5A7 /end MEASUREMENT
/begin MEASUREMENT CrSCD_tiIncr "aktuelle Inkrementperiode (1 Inkrement = Winkelbereich aus 360°KW/CrSCD_ctIncs_C, Abtastung = 2ms)" UWORD TimeDT 1 100 0.00 65535.00 FORMAT "%8.2" ECU_ADDRESS 0x7F8BA4 /end MEASUREMENT
/begin MEASUREMENT CrSCD_tiSeg "aktuelle Segmentperiode (1 Segment = Winkelbereich der über CrSCD_phiSeg_C appliziert ist, Abtastung = n-sync.)" ULONG Per_Dur 1 100 0.00 4294967295.00 FORMAT "%13.2" ECU_ADDRESS 0x7F90F8 /end MEASUREMENT
/begin MEASUREMENT CrS_ctInjStrt_mp "Anzahl der durchgeführten Testeinspritzungen" UWORD OneToOne 1 100 0.00 65535.00 FORMAT "%8.2" ECU_ADDRESS 0x8FE584 /end MEASUREMENT
/begin MEASUREMENT CrS_facSegTime_mp "Verhältnis der Segmentzeiten" SLONG Fact1 1 100 -16777216.0000 16777215.9922 FORMAT "%13.4" ECU_ADDRESS 0x8FE588 /end MEASUREMENT
/begin MEASUREMENT CrS_numTDCStrtLst_mp "Zeigt den Zylinder an, in den als letztes eingespritzt wurde" UWORD OneToOne 1 100 0.00 65535.00 FORMAT "%8.2" ECU_ADDRESS 0x8FE58C /end MEASUREMENT
/begin MEASUREMENT CrS_numTDCStrt_mp "Zeigt die Zylinder an, in die bereits eingespritzt wurde" UWORD OneToOne 1 100 0.00 65535.00 FORMAT "%8.2" ECU_ADDRESS 0x8FE58E /end MEASUREMENT
/begin MEASUREMENT CrS_stStrt_mp "Messpunkt für Zustandsautomat" UBYTE OneToOne 1 100 0.00 255.0 FORMAT "%5.1" ECU_ADDRESS 0x8FE590 /end MEASUREMENT
/begin MEASUREMENT CrS_tiSegOld_mp "Segmentzeit vor einer Testeinspritzung" SLONG Per_Dur 1 100 -2147483648.00 2147483647.00 FORMAT "%13.2" ECU_ADDRESS 0x8FE594 /end MEASUREMENT
/begin MEASUREMENT CrS_tiSeg_mp "Segmentzeit nach einer Testeinspritzung" SLONG Per_Dur 1 100 -2147483648.00 2147483647.00 FORMAT "%13.2" ECU_ADDRESS 0x8FE598 /end MEASUREMENT
/begin MEASUREMENT ctblink "Zeitzähler für Blinken der Markenanzeige" UBYTE t20msxs_ub_b5p1 1 100 0.00 5.100 FORMAT "%5.3" ECU_ADDRESS 0x7F89AD /end MEASUREMENT
/begin MEASUREMENT CTSCD_dtClnt "Wechselrate der Kuehlwassertemperatur" SWORD TempCels_100ms 1 100 -32768.00 32767.00 FORMAT "%8.2" ECU_ADDRESS 0x7F8AB4 /end MEASUREMENT
/begin MEASUREMENT CTSCD_stErrIni "Fehlerstatus ADC Kanal Kühlwassertemperatur während SG-Hochlauf" UBYTE OneToOne 1 100 0.00 255.0 FORMAT "%5.1" ECU_ADDRESS 0x7F87F2 /end MEASUREMENT
/begin MEASUREMENT CTSCD_stPHtr "Heater Temperature status" UBYTE OneToOne 1 100 0.00 255.0 FORMAT "%5.1" ECU_ADDRESS 0x7F87F3 /end MEASUREMENT
/begin MEASUREMENT CTSCD_stRmp_mp "Zustandsinformation aktiver Rampensteigungsparametersatz" UBYTE OneToOne 1 100 0.00 255.0 FORMAT "%5.1" ECU_ADDRESS 0x8FE5A8 /end MEASUREMENT
/begin MEASUREMENT CTSCD_swtSig "Wassertemperatur über CAN oder ADC" UBYTE OneToOne 1 100 0.00 255.0 FORMAT "%5.1" ECU_ADDRESS 0x7F87F4 /end MEASUREMENT
/begin MEASUREMENT CTSCD_tClnt "Kühlmitteltemperatur" SWORD Temp_Cels 1 100 -50.140 899.860 FORMAT "%8.3" ECU_ADDRESS 0x7F8AB6 /end MEASUREMENT
/begin MEASUREMENT CTSCD_tClntLin "linearisierter Wert aus HWK vorm Aufruf der Übergangsfunktion" SWORD Temp_Cels 1 100 -50.140 899.860 FORMAT "%8.3" ECU_ADDRESS 0x7F8AB8 /end MEASUREMENT
/begin MEASUREMENT CTSCD_tClntP "Coolant Temperature Before correction" SWORD Temp_Cels 1 100 -50.140 899.860 FORMAT "%8.3" ECU_ADDRESS 0x7F8ABA /end MEASUREMENT
/begin MEASUREMENT CTSCD_uRaw "Wassertemperatur Spannungsrohwert" SWORD Volt 1 100 -160156.4 160151.5 FORMAT "%8.1" ECU_ADDRESS 0x7F8ABC /end MEASUREMENT
/begin MEASUREMENT CycSigCheck_stTest "cycsigcheck Status Bit0: 0/1 Prog/Data; Bit1: falsche Sig erkennen; Bit2: Zyklus kompl.; Bit3: shoff requ.; Bit4/5: Prog/Data OK" UBYTE OneToOne 1 100 0.00 255.0 FORMAT "%5.1" ECU_ADDRESS 0x7F883C /end MEASUREMENT
/begin MEASUREMENT DrvTrn_rTransDT "Triebstrang-Übersetzung (Radmoment pro Motormoment)" SWORD TransR 1 100 -327.6800 327.6700 FORMAT "%8.4" ECU_ADDRESS 0x7F8BB2 /end MEASUREMENT
/begin MEASUREMENT DrvTrn_rTransDTact_mp "aktueller Wert der Triebstrangübersetzung" SWORD TransR 1 100 -327.6800 327.6700 FORMAT "%8.4" ECU_ADDRESS 0x8FE5AA /end MEASUREMENT
/begin MEASUREMENT DrvTrn_rTransDTRmpIn_mp "Input to the ramp for delaying torque requests" SWORD TransR 1 100 -327.6800 327.6700 FORMAT "%8.4" ECU_ADDRESS 0x8FE5AC /end MEASUREMENT
/begin MEASUREMENT DSC_stTstTrigger_mp "Zustand Testeranforderung an DSM Scheduler" UBYTE OneToOne 1 100 0.00 255.0 FORMAT "%5.1" ECU_ADDRESS 0x8FE5AE /end MEASUREMENT
/begin MEASUREMENT DSMDur_ctDfctDur1 "Wert Fehlerdauerzähler" UWORD OneToOne 1 100 0.00 65535.00 FORMAT "%8.2" ECU_ADDRESS 0x7F8BA6 /end MEASUREMENT
/begin MEASUREMENT DSMDur_ctDfctDur2 "Wert Fehlerdauerzähler 2" UWORD OneToOne 1 100 0.00 65535.00 FORMAT "%8.2" ECU_ADDRESS 0x7F8BA8 /end MEASUREMENT
/begin MEASUREMENT DSMDur_stGlobalDefCnt_mp "Aktivierungs und Resetzustand der beiden globalen Fehlerdauerzähler" UBYTE OneToOne 1 100 0.00 255.0 FORMAT "%5.1" ECU_ADDRESS 0x6F807C /end MEASUREMENT
/begin MEASUREMENT dvmark_w "Mindestabstand von Geschwindigkeitsmarken beim Stufentempomat" UWORD Vel 1 100 0.00 655.3500 FORMAT "%8.4" ECU_ADDRESS 0x7F9078 /end MEASUREMENT
/begin MEASUREMENT dvprg_w "Schrittweite bei Anzeige der Regelgeschwindigkeit im Programmiermodus" UWORD Vel 1 100 0.00 655.3500 FORMAT "%8.4" ECU_ADDRESS 0x7F907A /end MEASUREMENT
/begin MEASUREMENT dvstutom_w "Schrittweite für Verstellung der Zielgeschwindigkeit ohne programmierte Marken" UWORD Vel 1 100 0.00 655.3500 FORMAT "%8.4" ECU_ADDRESS 0x7F907C /end MEASUREMENT
/begin MEASUREMENT mmimrk_w "ported from ME9" UWORD Vel 1 100 0.00 655.3500 FORMAT "%8.4" ARRAY_SIZE 15 ECU_ADDRESS 0x7F92CE /end MEASUREMENT
/begin MEASUREMENT mrknrc "Nummer veränderte Geschwindigkeits-Marke für schnelle CAN- Übertragung" UBYTE dez 1 100 0.00 255.0 FORMAT "%5.1" ECU_ADDRESS 0x7F89AF /end MEASUREMENT
/begin MEASUREMENT mrknrcan "Nummer Geschwindigkeits-Marken Stufentempomat f ür CAN- Übertragung" UBYTE dez 1 100 0.00 255.0 FORMAT "%5.1" ARRAY_SIZE 15 ECU_ADDRESS 0x7F92A0 /end MEASUREMENT
/begin MEASUREMENT mrknrint "Nummer Geschwindigkeits-Marken Stufentempomat intern" UBYTE dez 1 100 0.00 255.0 FORMAT "%5.1" ARRAY_SIZE 15 ECU_ADDRESS 0x7F92AF /end MEASUREMENT
/begin MEASUREMENT mrkstut_w "Geschwindigkeits-Marken Stufentempomat" UWORD Vel 1 100 0.00 655.3500 FORMAT "%8.4" ARRAY_SIZE 15 ECU_ADDRESS 0x7F92EC /end MEASUREMENT
/begin MEASUREMENT statvza "Status Zielgeschwindigkeit für Kombi-Anzeige Stufentempomat" UBYTE dez 1 100 0.00 255.0 FORMAT "%5.1" ECU_ADDRESS 0x7F89B4 /end MEASUREMENT
/begin MEASUREMENT vfgr_w "Fahrzeug-Ist-Geschwindigkeit für FGR" UWORD Vel 1 100 0.00 655.3500 FORMAT "%8.4" ECU_ADDRESS 0x7F9080 /end MEASUREMENT
/begin MEASUREMENT vreglmax_w "Maximal zulässige Sollgeschwindigkeit für FGR" UWORD Vel 1 100 0.00 655.3500 FORMAT "%8.4" ECU_ADDRESS 0x7F9088 /end MEASUREMENT
/begin MEASUREMENT vreglmin_w "minimal zulässige Sollgeschwindigkeit für FGR" UWORD Vel 1 100 0.00 655.3500 FORMAT "%8.4" ECU_ADDRESS 0x7F908A /end MEASUREMENT
/begin MEASUREMENT vzielakvp_w "Variable für Zielgeschwindigkeit im Kombi" UWORD Vel 1 100 0.00 655.3500 FORMAT "%8.4" ECU_ADDRESS 0x7F9090 /end MEASUREMENT
/begin MEASUREMENT vzielak_w "Zielgeschwindigkeit für Kombi-Anzeige Stufentempomat" UWORD Vel 1 100 0.00 655.3500 FORMAT "%8.4" ECU_ADDRESS 0x7F908E /end MEASUREMENT
/begin MEASUREMENT vziels_w "Berechnete Soll-Zielgeschwindigkeit für FGR" UWORD Vel 1 100 0.00 655.3500 FORMAT "%8.4" ECU_ADDRESS 0x7F9092 /end MEASUREMENT
/begin MEASUREMENT vziel_w "Zielgeschwindigkeit für FGR" UWORD Vel 1 100 0.00 655.3500 FORMAT "%8.4" ECU_ADDRESS 0x7F908C /end MEASUREMENT
/begin FUNCTION crctl_vcrctl ""
 /begin DEF_CHARACTERISTIC CrCtl_DebToVCrCtlDef_C CrCtl_DebToVCrCtlOk_C CrCtl_rAccPedVelMin_C CrCtl_swtCrCtlType_C CrCtl_swtOffset_C CrCtl_swtVSSFil_C CrCtl_tiDisableDiagVCrCtl_C CrCtl_tiDispOffFil_C CrCtl_tiVSSFil_C CrCtl_uBattMin_C CrCtl_vAlwMaxKm_C CrCtl_vAlwMaxM_C CrCtl_vAlwMinKm_C CrCtl_vAlwMinM_C CrCtl_vOffMax_C /end DEF_CHARACTERISTIC
/end FUNCTION
/begin FUNCTION crctl_vcrctl_msg ""
 /begin OUT_MEASUREMENT CrCtl_stVCrCtl CrCtl_vAlwMax CrCtl_vAlwMin CrCtl_vCurr CrCtl_vDispOffset /end OUT_MEASUREMENT
/end FUNCTION
/begin FUNCTION crctl_vcrctl_uic "" /end FUNCTION
/begin FUNCTION crctl_vsetstep "Stufentempomat"
 /begin DEF_CHARACTERISTIC ANZMRKAUS ANZMRKMX CWBGSTUT DVMARK DVMARKMI DVPRG DVPRGMI DVSTUTOM DVSTUTOMMI TFGRTP TMARK TMRKBLI TSELO TVSTUTK TVSTUTL VFGRPRG VVEMOFS /end DEF_CHARACTERISTIC
/end FUNCTION
/begin FUNCTION crctl_vsetstep_msg ""
 /begin OUT_MEASUREMENT anzmark BGSTUTlokbits0 B_beveh B_bv1 B_bv2 B_envtwa B_fgrepa B_mrkbli B_mrkein B_mrkv B_prgmod B_tmark B_tmrkbli B_vziels canzbl ctblink dvmark_w dvprg_w dvstutom_w mrknrc mrknrcan mrknrint mrkstut_w statvza vzielakvp_w vzielak_w vziels_w /end OUT_MEASUREMENT
/end FUNCTION
/begin FUNCTION crctl_vsetstep_uic "" /begin OUT_MEASUREMENT CrCtl_BGSTUTbits2_mp CrCtl_mrkeinvp_mp /end OUT_MEASUREMENT /end FUNCTION
/begin FUNCTION crctl_vstepadapt "Aufbereitung der Größen für den Stufentempomaten" /end FUNCTION
/begin FUNCTION crctl_vstepadapt_msg ""
 /begin OUT_MEASUREMENT B_acc B_besch B_fgrat B_fgren B_fgresv B_fgrtb2 B_fgrtbe B_fgrtv2 B_fgrtve B_fgrtwa B_fgrvem B_insfgre B_kl15 B_km B_mmiena CrCtl_numVMrk CrCtl_stCC CrCtl_stUpdateVMrk CrCtl_stVDisp CrCtl_stVSetNew CrCtl_vDesDisp CrCtl_vMrk1 CrCtl_vMrk2 CrCtl_vMrk3 CrCtl_vSetNew mmimrk_w vfgr_w vreglmax_w vreglmin_w vziel_w /end OUT_MEASUREMENT
/end FUNCTION
/begin FUNCTION crctl_vstepadapt_uic "" /end FUNCTION
/begin FUNCTION crscd "Komponententreiber Kurbelwelle"
 /begin DEF_CHARACTERISTIC CrSCD_ctTurns_C CrSCD_nFast_C CrSCD_nMax_C CrSCD_nMin_C CrSCD_nSlowHigh_C CrSCD_nSlow_C CrSCD_numShftMisf_C CrSCD_phiIncCor_CUR CrSCD_phiSegLength_C CrSCD_phiSegPhase_C /end DEF_CHARACTERISTIC
 /begin IN_MEASUREMENT CrSCD_nAvrg /end IN_MEASUREMENT
/end FUNCTION
/begin FUNCTION crscd_msg ""
 /begin OUT_MEASUREMENT CrSCD_dSegMisf CrSCD_nAvrg CrSCD_nAvrgHiRes CrSCD_nCurr CrSCD_nCurrHiRes CrSCD_nDyn CrSCD_nHold CrSCD_nMisf CrSCD_numSeg CrSCD_phiIncCor CrSCD_phiIncr CrSCD_tiSeg /end OUT_MEASUREMENT
/end FUNCTION
/begin FUNCTION crscd_thresctl ""
 /begin DEF_CHARACTERISTIC CrSCD_ctThresCtlMin_C CrSCD_nThresCtlHigh_C CrSCD_nThresCtlLow_C /end DEF_CHARACTERISTIC
/end FUNCTION
/begin FUNCTION crscd_uic ""
 /begin OUT_MEASUREMENT CrSCD_incNextIntDelta_mp CrSCD_incNextInt_mp CrSCD_phiCurr_mp CrSCD_phiSegGrid_mp CrSCD_stIncErr_mp CrSCD_stIncSig_mp CrSCD_stIncSyncInc_mp CrSCD_stIncSyncPhase_mp /end OUT_MEASUREMENT
/end FUNCTION
/begin FUNCTION crscd_var ""
 /begin DEF_CHARACTERISTIC CrSCD_ctGapIncs_C CrSCD_ctGaps_C CrSCD_ctIncs_C CrSCD_facGapPlausHigh_CUR CrSCD_facGapPlausLow_CUR CrSCD_facIncPlausHigh_CUR CrSCD_facIncPlausLow_CUR CrSCD_numFBCSeg_C CrSCD_numTDCSeg_C CrSCD_phiGap2Zero_C CrSCD_tiPlausCalcOff_C /end DEF_CHARACTERISTIC
 /begin IN_MEASUREMENT CrSCD_tiIncr /end IN_MEASUREMENT
/end FUNCTION
/begin FUNCTION crscd_var_msg "" /begin OUT_MEASUREMENT CrSCD_nIncr CrSCD_tiIncr /end OUT_MEASUREMENT /end FUNCTION
/begin FUNCTION crs_chkstrtspd "Redundanter Start nur mit Kurbelwelle"
 /begin DEF_CHARACTERISTIC CrS_ctMaxInjStrt_C CrS_facSegTimeMax_C CrS_facSegTimeMin_C CrS_facSegTime_C CrS_phiSegLengthStrtSpd_C CrS_phiSegOfsStrtSpdOld_C CrS_phiSegOfsStrtSpd_C /end DEF_CHARACTERISTIC
/end FUNCTION
/begin FUNCTION crs_chkstrtspd_uic ""
 /begin OUT_MEASUREMENT CrS_ctInjStrt_mp CrS_facSegTime_mp CrS_numTDCStrtLst_mp CrS_numTDCStrt_mp CrS_stStrt_mp CrS_tiSegOld_mp CrS_tiSeg_mp /end OUT_MEASUREMENT
/end FUNCTION
/begin FUNCTION ctscd "Wassertemperaturfühler Komponententreiber"
 /begin DEF_CHARACTERISTIC CTSCD_uSRCMin_C CTSCD_uSRCMax_C CTSCD_tLin_CUR CTSCD_DebSigDef_C CTSCD_DebSigOk_C CTSCD_DebSRCHighDef_C CTSCD_DebSRCHighOk_C CTSCD_DebSRCLowDef_C CTSCD_DebSRCLowOk_C CTSCD_dtRmpSlp2UpDwn_C CTSCD_dtFlTempUp_C CTSCD_dtFlTempDwn_C CTSCD_numAdc_C CTSCD_dtRmpSlp1Up_C CTSCD_dtRmpSlp1Dwn_C CTSCD_stSensIDWord_C CTSCD_swtPHtrIgnoreCAN_C CTSCD_swtSigVal_C CTSCD_tClntPMin_C CTSCD_tDflCold_C CTSCD_tDflWarm_C CTSCD_tDiffThres_C CTSCD_tFuelMin_C CTSCD_tiWait_C /end DEF_CHARACTERISTIC
 /begin IN_MEASUREMENT CTSCD_uRaw /end IN_MEASUREMENT
/end FUNCTION
/begin FUNCTION ctscd_msg ""
 /begin OUT_MEASUREMENT CTSCD_dtClnt CTSCD_stErrIni CTSCD_stPHtr CTSCD_swtSig CTSCD_tClnt CTSCD_tClntLin CTSCD_tClntP CTSCD_uRaw /end OUT_MEASUREMENT
/end FUNCTION
/begin FUNCTION ctscd_uic "" /begin OUT_MEASUREMENT CTSCD_stRmp_mp /end OUT_MEASUREMENT /end FUNCTION
/begin FUNCTION ctscd_var "" /end FUNCTION
/begin FUNCTION ctscd_var_msg "" /end FUNCTION
/begin FUNCTION curmap_size_base "" /end FUNCTION
/begin FUNCTION curmap_size_proj "" /end FUNCTION
/begin FUNCTION curmap_size_sys "" /end FUNCTION
/begin FUNCTION cycsigcheck ""
 /begin DEF_CHARACTERISTIC CycSigCheck_nLimit_C CycSigCheck_swtMode_C CycSigCheck_swtOff_C /end DEF_CHARACTERISTIC
/end FUNCTION
/begin FUNCTION cycsigcheck_msg "" /begin OUT_MEASUREMENT CycSigCheck_stTest /end OUT_MEASUREMENT /end FUNCTION
/begin FUNCTION drvtrn "Antriebsstrang"
 /begin DEF_CHARACTERISTIC DrvTrn_drTransDTUp_C DrvTrn_drTransDTDwn_C DrvTrn_rTransDTInit_C DrvTrn_swtrTransSel_C DrvTrn_tiRTransDT_C /end DEF_CHARACTERISTIC
/end FUNCTION
/begin FUNCTION drvtrn_msg "" /begin OUT_MEASUREMENT DrvTrn_rTransDT /end OUT_MEASUREMENT /end FUNCTION
/begin FUNCTION drvtrn_uic "" /begin OUT_MEASUREMENT DrvTrn_rTransDTact_mp DrvTrn_rTransDTRmpIn_mp /end OUT_MEASUREMENT /end FUNCTION
/begin FUNCTION dsched "" /begin DEF_CHARACTERISTIC DSCHED_numSelFID_C /end DEF_CHARACTERISTIC /end FUNCTION
/begin FUNCTION dsched_msg "" /end FUNCTION
/begin FUNCTION dsched_uic "" /begin OUT_MEASUREMENT DSC_stTstTrigger_mp /end OUT_MEASUREMENT /end FUNCTION
/begin FUNCTION dsm ""
 /begin DEF_CHARACTERISTIC DSM_cnvMilKmFCM_Offset_C DSM_cnvMilKmFCM_Slope_C DSM_Class1Mil_C DSM_Class1TFlc_C DSM_Class1Flc_C DSM_Class1THlc_C DSM_Class1Hlc_C DSM_Class1Scatt_C DSM_Class1TDlcPen_C DSM_Class1DlcPen_C DSM_Class1TDlc_C DSM_Class1DlcKd_C DSM_Class1Dlc_C DSM_Class1Prio_C DSM_Class1SysLamp_C DSM_Class1ResErf_C DSM_Class1Readiness_C DSM_Class2Mil_C DSM_Class2TFlc_C DSM_Class2Flc_C DSM_Class2THlc_C DSM_Class2Hlc_C DSM_Class2Scatt_C DSM_Class2TDlcPen_C DSM_Class2DlcPen_C DSM_Class2TDlc_C DSM_Class2DlcKd_C DSM_Class2Dlc_C DSM_Class2Prio_C DSM_Class2SysLamp_C DSM_Class2ResErf_C DSM_Class2Readiness_C DSM_Class3Mil_C DSM_Class3TFlc_C DSM_Class3Flc_C DSM_Class3THlc_C DSM_Class3Hlc_C DSM_Class3Scatt_C DSM_Class3TDlcPen_C DSM_Class3DlcPen_C DSM_Class3TDlc_C DSM_Class3DlcKd_C DSM_Class3Dlc_C DSM_Class3Prio_C DSM_Class3SysLamp_C DSM_Class3ResErf_C DSM_Class3Readiness_C DSM_Class4Mil_C DSM_Class4TFlc_C DSM_Class4Flc_C DSM_Class4THlc_C DSM_Class4Hlc_C DSM_Class4Scatt_C DSM_Class4TDlcPen_C DSM_Class4DlcPen_C DSM_Class4TDlc_C DSM_Class4DlcKd_C DSM_Class4Dlc_C DSM_Class4Prio_C DSM_Class4SysLamp_C DSM_Class4ResErf_C DSM_Class4Readiness_C DSM_Class5Mil_C DSM_Class5TFlc_C DSM_Class5Flc_C DSM_Class5THlc_C DSM_Class5Hlc_C DSM_Class5Scatt_C DSM_Class5TDlcPen_C DSM_Class5DlcPen_C DSM_Class5TDlc_C DSM_Class5DlcKd_C DSM_Class5Dlc_C DSM_Class5Prio_C DSM_Class5SysLamp_C DSM_Class5ResErf_C DSM_Class5Readiness_C DSM_Class6Mil_C DSM_Class6TFlc_C DSM_Class6Flc_C DSM_Class6THlc_C DSM_Class6Hlc_C DSM_Class6Scatt_C DSM_Class6TDlcPen_C DSM_Class6DlcPen_C DSM_Class6TDlc_C DSM_Class6DlcKd_C DSM_Class6Dlc_C DSM_Class6Prio_C DSM_Class6SysLamp_C DSM_Class6ResErf_C DSM_Class6Readiness_C DSM_Class7Mil_C DSM_Class7TFlc_C DSM_Class7Flc_C DSM_Class7THlc_C DSM_Class7Hlc_C DSM_Class7Scatt_C DSM_Class7TDlcPen_C DSM_Class7DlcPen_C DSM_Class7TDlc_C DSM_Class7DlcKd_C DSM_Class7Dlc_C DSM_Class7Prio_C DSM_Class7SysLamp_C DSM_Class7ResErf_C DSM_Class7Readiness_C DSM_Class8Mil_C DSM_Class8TFlc_C DSM_Class8Flc_C DSM_Class8THlc_C DSM_Class8Hlc_C DSM_Class8Scatt_C DSM_Class8TDlcPen_C DSM_Class8DlcPen_C DSM_Class8TDlc_C DSM_Class8DlcKd_C DSM_Class8Dlc_C DSM_Class8Prio_C DSM_Class8SysLamp_C DSM_Class8ResErf_C DSM_Class8Readiness_C DSM_Class9Mil_C DSM_Class9TFlc_C DSM_Class9Flc_C DSM_Class9THlc_C DSM_Class9Hlc_C DSM_Class9Scatt_C DSM_Class9TDlcPen_C DSM_Class9DlcPen_C DSM_Class9TDlc_C DSM_Class9DlcKd_C DSM_Class9Dlc_C DSM_Class9Prio_C DSM_Class9SysLamp_C DSM_Class9ResErf_C DSM_Class9Readiness_C DSM_Class10Mil_C DSM_Class10TFlc_C DSM_Class10Flc_C DSM_Class10THlc_C DSM_Class10Hlc_C DSM_Class10Scatt_C DSM_Class10TDlcPen_C DSM_Class10DlcPen_C DSM_Class10TDlc_C DSM_Class10DlcKd_C DSM_Class10Dlc_C DSM_Class10Prio_C DSM_Class10SysLamp_C DSM_Class10ResErf_C DSM_Class10Readiness_C DSM_Class11Mil_C DSM_Class11TFlc_C DSM_Class11Flc_C DSM_Class11THlc_C DSM_Class11Hlc_C DSM_Class11Scatt_C DSM_Class11TDlcPen_C DSM_Class11DlcPen_C DSM_Class11TDlc_C DSM_Class11DlcKd_C DSM_Class11Dlc_C DSM_Class11Prio_C DSM_Class11SysLamp_C DSM_Class11ResErf_C DSM_Class11Readiness_C DSM_Class12Mil_C DSM_Class12TFlc_C DSM_Class12Flc_C DSM_Class12THlc_C DSM_Class12Hlc_C DSM_Class12Scatt_C DSM_Class12TDlcPen_C DSM_Class12DlcPen_C DSM_Class12TDlc_C DSM_Class12DlcKd_C DSM_Class12Dlc_C DSM_Class12Prio_C DSM_Class12SysLamp_C DSM_Class12ResErf_C DSM_Class12Readiness_C DSM_Class13Mil_C DSM_Class13TFlc_C DSM_Class13Flc_C DSM_Class13THlc_C DSM_Class13Hlc_C DSM_Class13Scatt_C DSM_Class13TDlcPen_C DSM_Class13DlcPen_C DSM_Class13TDlc_C DSM_Class13DlcKd_C DSM_Class13Dlc_C DSM_Class13Prio_C DSM_Class13SysLamp_C DSM_Class13ResErf_C DSM_Class13Readiness_C DSM_Class14Mil_C DSM_Class14TFlc_C DSM_Class14Flc_C DSM_Class14THlc_C DSM_Class14Hlc_C DSM_Class14Scatt_C DSM_Class14TDlcPen_C DSM_Class14DlcPen_C DSM_Class14TDlc_C DSM_Class14DlcKd_C DSM_Class14Dlc_C DSM_Class14Prio_C DSM_Class14SysLamp_C DSM_Class14ResErf_C DSM_Class14Readiness_C DSM_Class15Mil_C DSM_Class15TFlc_C DSM_Class15Flc_C DSM_Class15THlc_C DSM_Class15Hlc_C DSM_Class15Scatt_C DSM_Class15TDlcPen_C DSM_Class15DlcPen_C DSM_Class15TDlc_C DSM_Class15DlcKd_C DSM_Class15Dlc_C DSM_Class15Prio_C DSM_Class15SysLamp_C DSM_Class15ResErf_C DSM_Class15Readiness_C DSM_Class16Mil_C DSM_Class16TFlc_C DSM_Class16Flc_C DSM_Class16THlc_C DSM_Class16Hlc_C DSM_Class16Scatt_C DSM_Class16TDlcPen_C DSM_Class16DlcPen_C DSM_Class16TDlc_C DSM_Class16DlcKd_C DSM_Class16Dlc_C DSM_Class16Prio_C DSM_Class16SysLamp_C DSM_Class16ResErf_C DSM_Class16Readiness_C DSM_Class17Mil_C DSM_Class17TFlc_C DSM_Class17Flc_C DSM_Class17THlc_C DSM_Class17Hlc_C DSM_Class17Scatt_C DSM_Class17TDlcPen_C DSM_Class17DlcPen_C DSM_Class17TDlc_C DSM_Class17DlcKd_C DSM_Class17Dlc_C DSM_Class17Prio_C DSM_Class17SysLamp_C DSM_Class17ResErf_C DSM_Class17Readiness_C DSM_Class18Mil_C DSM_Class18TFlc_C DSM_Class18Flc_C DSM_Class18THlc_C DSM_Class18Hlc_C DSM_Class18Scatt_C DSM_Class18TDlcPen_C DSM_Class18DlcPen_C DSM_Class18TDlc_C DSM_Class18DlcKd_C DSM_Class18Dlc_C DSM_Class18Prio_C DSM_Class18SysLamp_C DSM_Class18ResErf_C DSM_Class18Readiness_C DSM_Class19Mil_C DSM_Class19TFlc_C DSM_Class19Flc_C DSM_Class19THlc_C DSM_Class19Hlc_C DSM_Class19Scatt_C DSM_Class19TDlcPen_C DSM_Class19DlcPen_C DSM_Class19TDlc_C DSM_Class19DlcKd_C DSM_Class19Dlc_C DSM_Class19Prio_C DSM_Class19SysLamp_C DSM_Class19ResErf_C DSM_Class19Readiness_C DSM_Class20Mil_C DSM_Class20TFlc_C DSM_Class20Flc_C DSM_Class20THlc_C DSM_Class20Hlc_C DSM_Class20Scatt_C DSM_Class20TDlcPen_C DSM_Class20DlcPen_C DSM_Class20TDlc_C DSM_Class20DlcKd_C DSM_Class20Dlc_C DSM_Class20Prio_C DSM_Class20SysLamp_C DSM_Class20ResErf_C DSM_Class20Readiness_C DSM_FCMClear_C DSM_FrzFrEnvironment_C DSM_stStepWidth_CA DSM_SysLampMode_C DSM_tiDCMin_C DSM_tiWucDelay_C DSM_WucMinDiff_C DSM_WucMinTemp_C /end DEF_CHARACTERISTIC
/end FUNCTION
/begin FUNCTION dsmdur ""
 /begin DEF_CHARACTERISTIC DSMDur_DfctDur1Mode_C DSMDur_DfctDur2Mode_C DSMDur_stDfctDur1Enable_C DSMDur_stDfctDur2Enable_C DSMDur_stDfctDur1Reset_C DSMDur_stDfctDur2Reset_C /end DEF_CHARACTERISTIC
/end FUNCTION
/begin FUNCTION dsmdur_msg "" /begin OUT_MEASUREMENT DSMDur_ctDfctDur1 DSMDur_ctDfctDur2 /end OUT_MEASUREMENT /end FUNCTION
/begin FUNCTION dsmdur_uic "" /begin OUT_MEASUREMENT DSMDur_stGlobalDefCnt_mp /end OUT_MEASUREMENT /end FUNCTION
/begin COMPU_METHOD AngleCrS "Winkel Kurbelwelle" RAT_FUNC "%6.4" "deg CrS" COEFFS 0 42.6666666666667 0 0 0 1 /end COMPU_METHOD
/begin COMPU_METHOD B_TRUE "Umrechnung   ----> FALSE;    TRUE = TRUE" TAB_VERB "%6.3" "-" COMPU_TAB_REF B_TRUE /end COMPU_METHOD
/begin COMPU_VTAB B_TRUE "Umrechnung   ----> FALSE;    TRUE = TRUE" TAB_VERB 2 0 "FALSE" 1 "TRUE" /end COMPU_VTAB
/begin COMPU_METHOD ClassTrigger "Verbale Umrechnung für DSM_Class%TFlc_C und DSM_Class%THlc_C" TAB_VERB "%6.3" "-" COMPU_TAB_REF ClassTrigger /end COMPU_METHOD
/begin COMPU_VTAB ClassTrigger "Verbale Umrechnung für DSM_Class%TFlc_C und DSM_Class%THlc_C" TAB_VERB 4 0 "no handling" 1 "time quantum" 2 "driving cycle" 3 "warm up cycle" /end COMPU_VTAB
/begin COMPU_METHOD ClassTriggerTDlc "Verbale Umrechnung für DSM_Class%TDlc_C und DSM_Class%TDlcPen_C" TAB_VERB "%6.3" "-" COMPU_TAB_REF ClassTriggerTDlc /end COMPU_METHOD
/begin COMPU_VTAB ClassTriggerTDlc "Verbale Umrechnung für DSM_Class%TDlc_C und DSM_Class%TDlcPen_C" TAB_VERB 4 0 "no handling" 1 "each afterrun_1" 2 "each afterrun_2" 3 "warm up cycle" /end COMPU_VTAB
/begin COMPU_METHOD dez "K3 Umwandlungen" RAT_FUNC "%6.2" "-" COEFFS 0 1 0 0 0 1 /end COMPU_METHOD
/begin COMPU_METHOD EngN "Motordrehzahl" RAT_FUNC "%6.2" "rpm" COEFFS 0 1 0 0 0 1 /end COMPU_METHOD
/begin COMPU_METHOD EngN_HiRes "Motordrehzahl, höhere Auflösung als EngM" RAT_FUNC "%6.3" "rpm" COEFFS 0 8 0 0 0 1 /end COMPU_METHOD
/begin COMPU_METHOD Fact1 "Faktor mit Auflösung 0,01 (100 mal höherer Bereich als Fact)" RAT_FUNC "%6.4" "-" COEFFS 0 128 0 0 0 1 /end COMPU_METHOD
/begin COMPU_METHOD FactHigh "Faktor mit Auflösung 1/4096, hauptsächlich für einen Faktorenbereich 0.1...10 verwendet" RAT_FUNC "%6.5" "-" COEFFS 0 8192 0 0 0 1 /end COMPU_METHOD
/begin COMPU_METHOD Fact_Inc "Faktor für Inkrement/Gap Plausibilitäts-Fenster" RAT_FUNC "%6.4" "-" COEFFS 0 256 0 0 0 1 /end COMPU_METHOD
/begin COMPU_METHOD FidName "Verbale Umrechnung für Fid-Namen" TAB_VERB "%6.3" "-" COMPU_TAB_REF FidName /end COMPU_METHOD
/begin COMPU_VTAB FidName "Verbale Umrechnung für Fid-Namen" TAB_VERB 1316 0 "Fid_unused" 4097 "Fid_ACCIRevErr_MAX" 4098 "Fid_ACCRevErr_MAX" 4099 "Fid_ACC_AliveErr_MAX" 4100 "Fid_ACC_CsErr_MAX" 4101 "Fid_ACC_TiOutErr_MAX" 4102 "Fid_ACCtl_ACTrqErr_MAX" 4103 "Fid_ACCtl_CTSErr_MAX" 4104 "Fid_ACCtl_FanErr_MAX" 4105 "Fid_ACCtl_TGearbxErr_MAX" 4106 "Fid_ACCtl_VSSErr_MAX" 4107 "Fid_AFSCD_MAX" 4108 "Fid_AFSCD_AirPerTime_MAX" 4109 "Fid_AFSCD_PlOffsDrft_MAX" 4110 "Fid_AFSCD_PlSetyDrft_MAX" 4111 "Fid_AFSCD_SRCCorrAirm_MAX" 4112 "Fid_AFSCD_SRCDcyc_MAX" 4113 "Fid_AFSCD_SRCRawAirm_MAX" 4114 "Fid_AFSCD_SRCRefSig_MAX" 4115 "Fid_AFS_CanMon_MAX" 4116 "Fid_AFS_GenDisableCond_MAX" 4117 "Fid_AOHt_ShutOffErr_MAX" 4118 "Fid_APP1_MAX" 4119 "Fid_APP2_MAX" 4120 "Fid_APSCD_MAX" 4121 "Fid_ARSOff_MAX" 4122 "Fid_ASDdc_MAX" 4123 "Fid_ASModSwtOffEng_MAX" 4124 "Fid_ASModSwtOffIndVol_MAX" 4125 "Fid_AccPed_MAX" 4126 "Fid_AccPed_Brk_MAX" 4127 "Fid_AirCtl_MAX" 4128 "Fid_AirCtlNeg_MAX" 4129 "Fid_AirCtlNeg2_MAX" 4130 "Fid_AirCtlPFltEGRRed_MAX" 4131 "Fid_AirCtlPlateBreak_MAX" 4132 "Fid_AirCtlPlateBreakActv_MAX" 4133 "Fid_AirCtlPos_MAX" 4134 "Fid_AirCtlPos2_MAX" 4135 "Fid_AirCtl_Brk_MAX" 4136 "Fid_BPSCDMon_MAX" 4137 "Fid_CTSCDFlTemp_MAX" 4138 "Fid_CTSCD_Plaus_MAX" 4139 "Fid_ClgDynTst_MAX" 4140 "Fid_CmbChb_MAX" 4141 "Fid_CoDT_GripDeb_MAX" 4142 "Fid_CoEngIRevSys1_MAX" 4143 "Fid_CoEngIRevSys2_MAX" 4144 "Fid_CoEngIRevVeh_MAX" 4145 "Fid_CoEngPFltErr_MAX" 4146 "Fid_CoEngRevSys1_MAX" 4147 "Fid_CoEngRevSys2_MAX" 4148 "Fid_CoEngRevVeh_MAX" 4149 "Fid_CoEngShOffTst_MAX" 4150 "Fid_CoEngSoftShOffTV_MAX" 4151 "Fid_CoEng_ActrPrt_MAX" 4152 "Fid_CoEng_Nrml2Strt_MAX" 4153 "Fid_CoEng_PwrStgEnable_MAX" 4154 "Fid_CoEng_trqLimErr_MAX" 4155 "Fid_CoEng_trqLimErr1_MAX" 4156 "Fid_CoEng_trqLimErr2_MAX" 4157 "Fid_CoEng_trqLimErr3_MAX" 4158 "Fid_CoEng_trqLimErr4_MAX" 4159 "Fid_CoVM_StabDem_Err_MAX" 4160 "Fid_CoVehtrqLimErr_MAX" 4161 "Fid_CrCtlShutOffIr_MAX" 4162 "Fid_CrCtl_ASCTimeout_MAX" 4163 "Fid_CrCtl_CanDef_MAX" 4164 "Fid_CrCtl_KombiTimeout_MAX" 4165 "Fid_CrCtl_vCrCtl_MAX" 4166 "Fid_DSM_Wuc_MAX" 4167 "Fid_EATSCDTSubs_MAX" 4168 "Fid_EBAFCD_MAX" 4169 "Fid_EBFCD_MAX" 4170 "Fid_ECU_MAX" 4171 "Fid_EGSysCoLSU0_MAX" 4172 "Fid_EGSysCoNSC_MAX" 4173 "Fid_EGSysCoOxi_MAX" 4174 "Fid_EGSysCoTrbn_MAX" 4175 "Fid_EGSysCoTube0_MAX" 4176 "Fid_EGSysCoTube1_MAX" 4177 "Fid_EGSysHtgDel_MAX" 4178 "Fid_EGSysNSC_MAX" 4179 "Fid_EGSysOxiCat_MAX" 4180 "Fid_EGSysPresEnv_MAX" 4181 "Fid_EGSysStrt_MAX" 4182 "Fid_EGSysTemp_MAX" 4183 "Fid_EGSysTrbn_MAX" 4184 "Fid_EGSysTube_MAX" 4185 "Fid_EGSys_AP_MAX" 4186 "Fid_EGTRgnLck_MAX" 4187 "Fid_EGTTempGvnrAirCtl_MAX" 4188 "Fid_EGTTempGvnrInr_MAX" 4189 "Fid_EGTTempGvnrOutr_MAX" 4190 "Fid_ETClbCorActv_MAX" 4191 "Fid_EngCTSCD_MAX" 4192 "Fid_EngMCaSBackUp_MAX" 4193 "Fid_EngMCrSBackUp_MAX" 4194 "Fid_EngMTEng_MAX" 4195 "Fid_EngMTrqFrcPDiff_MAX" 4196 "Fid_EngMVVeh_MAX" 4197 "Fid_EngM_ChkStrtSpd_MAX" 4198 "Fid_EngPrt_nLimErr_MAX" 4199 "Fid_FBC_MAX" 4200 "Fid_FBCMonI_MAX" 4201 "Fid_FMASwtOff1_MAX" 4202 "Fid_FMASwtOff3_MAX" 4203 "Fid_FMTC_AirCorr_MAX" 4204 "Fid_FMTC_SOECorr_MAX" 4205 "Fid_FTSCDErr_MAX" 4206 "Fid_FWOscDet_MAX" 4207 "Fid_FanCtl_MAX" 4208 "Fid_FanGbxOil_MAX" 4209 "Fid_FlMngFullLdRglOff_MAX" 4210 "Fid_FlMngSmkDefect_MAX" 4211 "Fid_FlSysCTSSens_MAX" 4212 "Fid_FlSysDens_MAX" 4213 "Fid_FlSysFTSSens_MAX" 4214 "Fid_FrmMngAPP_MAX" 4215 "Fid_FrmMngARS_MAX" 4216 "Fid_FrmMngAddLevl_MAX" 4217 "Fid_FrmMngBrk_MAX" 4218 "Fid_FrmMngBrkDef_MAX" 4219 "Fid_FrmMngCoEng_MAX" 4220 "Fid_FrmMngCoEng_St2_MAX" 4221 "Fid_FrmMngConvDef_MAX" 4222 "Fid_FrmMngEngRpmTemp_MAX" 4223 "Fid_FrmMngEngSpd_MAX" 4224 "Fid_FrmMngInjDU1_MAX" 4225 "Fid_FrmMngInjDU2_MAX" 4226 "Fid_FrmMngInjVlv_MAX" 4227 "Fid_FrmMngOBDCtl_MAX" 4228 "Fid_FrmMngPFltDef_MAX" 4229 "Fid_FrmMngParkConsumer_MAX" 4230 "Fid_FrmMngPla_DSC_MAX" 4231 "Fid_FrmMngPla_EGS_MAX" 4232 "Fid_FrmMngPowerTrainCAN_MAX" 4233 "Fid_FrmMngPwrMngLIGovSt_MAX" 4234 "Fid_FrmMngSIG_ARS_MAX" 4235 "Fid_FrmMngSIG_DSC_MAX" 4236 "Fid_FrmMngSig_EGS_MAX" 4237 "Fid_FrmMngTO_ARS_MAX" 4238 "Fid_FrmMngTO_DSC_MAX" 4239 "Fid_FrmMngTo_EGS_MAX" 4240 "Fid_FrmMngWaterVlv_MAX" 4241 "Fid_FrmMng_ST_TORQ_MAX" 4242 "Fid_FrmMngnSetpoint_MAX" 4243 "Fid_FrmMngpVal_MAX" 4244 "Fid_FrmMngtEng_MAX" 4245 "Fid_GearbxDrvAway_MAX" 4246 "Fid_GearbxDrvAwayInactiv_MAX" 4247 "Fid_GearbxPtCANErr_MAX" 4248 "Fid_GearbxTrqLimErr_MAX" 4249 "Fid_Gearbx_GearDet_MAX" 4250 "Fid_Gearbx_TrqIntv_Err_MAX" 4251 "Fid_GlwCtl1_MAX" 4252 "Fid_HDC_MAX" 4253 "Fid_IndSys1_MAX" 4254 "Fid_IndSys2_MAX" 4255 "Fid_InjCrvCoErr_MAX" 4256 "Fid_InjCtl_qLimErr_MAX" 4257 "Fid_InjVlvWvCorOff_MAX" 4258 "Fid_LIGovSetpDrvAway_MAX" 4259 "Fid_LIGovSetpointDrvAwy_MAX" 4260 "Fid_LIGovUbr_MAX" 4261 "Fid_LSUCDMon0_MAX" 4262 "Fid_LSUCDO20_MAX" 4263 "Fid_LSUCDRi0_MAX" 4264 "Fid_LSUCDactiv0_MAX" 4265 "Fid_LSUCDlsu0_MAX" 4266 "Fid_LSUClbSched_MAX" 4267 "Fid_LSUCtl0_MAX" 4268 "Fid_LSUMonAllChecks_MAX" 4269 "Fid_LSUMonPlausChk_MAX" 4270 "Fid_Layer_FI_TANS_MAX" 4271 "Fid_Layer_FI_TUMG_MAX" 4272 "Fid_Layer_MANHYDR_MAX" 4273 "Fid_Layer_MANLUFT_MAX" 4274 "Fid_MSidCD_ECU_MAX" 4275 "Fid_MSidCD_Pin_MAX" 4276 "Fid_MeUnCDCalcI_MAX" 4277 "Fid_OTSCD_MAX" 4278 "Fid_PCR_MAX" 4279 "Fid_PCRBalGvnr_MAX" 4280 "Fid_PCRExtnLimActr_MAX" 4281 "Fid_PCRGvnrDvtNeg_MAX" 4282 "Fid_PCRGvnrDvtPos_MAX" 4283 "Fid_PCRSurgeLIGov_MAX" 4284 "Fid_PCR_MS_MAX" 4285 "Fid_PCR_SurgeDet_MAX" 4286 "Fid_PCVCDCalcI_MAX" 4287 "Fid_PFltAshCor_MAX" 4288 "Fid_PFltAshCorRgn_MAX" 4289 "Fid_PFltBrk_MAX" 4290 "Fid_PFltChar_MAX" 4291 "Fid_PFltChngPar_MAX" 4292 "Fid_PFltClth_MAX" 4293 "Fid_PFltDiagRls1_MAX" 4294 "Fid_PFltDiagRls2_MAX" 4295 "Fid_PFltDynChk_MAX" 4296 "Fid_PFltEngPrtRgnMon_MAX" 4297 "Fid_PFltGearDet_MAX" 4298 "Fid_PFltHsLnChk_MAX" 4299 "Fid_PFltLckRgnErr_MAX" 4300 "Fid_PFltLckRgnFuel_MAX" 4301 "Fid_PFltNumPFltErr_MAX" 4302 "Fid_PFltNumPFltErrLck_MAX" 4303 "Fid_PFltPPreErr_MAX" 4304 "Fid_PFltPlausPres_MAX" 4305 "Fid_PFltPlausTemp_MAX" 4306 "Fid_PFltPresPlausProj_MAX" 4307 "Fid_PFltPresSensFrz_MAX" 4308 "Fid_PFltPresSensHsLn_MAX" 4309 "Fid_PFltSRCPres_MAX" 4310 "Fid_PFltSRCTemp_MAX" 4311 "Fid_PFltSimOn_MAX" 4312 "Fid_PFltSpdVeh_MAX" 4313 "Fid_PFltTempAir_MAX" 4314 "Fid_PFltTempClnt_MAX" 4315 "Fid_PFltTempOxiPre_MAX" 4316 "Fid_PFltTempPre_MAX" 4317 "Fid_PFltTempSensFrz_MAX" 4318 "Fid_PFltVltgBatt_MAX" 4319 "Fid_RailCDRPSErrChk_MAX" 4320 "Fid_RailCDSubstVal_MAX" 4321 "Fid_RailCD_PMonStrt_MAX" 4322 "Fid_RailCtlMode_MAX" 4323 "Fid_RailMeUn0Blk_MAX" 4324 "Fid_RailMeUn0Rls_MAX" 4325 "Fid_RailMeUn1Blk_MAX" 4326 "Fid_RailMeUn1Rls_MAX" 4327 "Fid_RailMeUn2Blk_MAX" 4328 "Fid_RailMeUn2Rls_MAX" 4329 "Fid_RailMeUn3Blk_MAX" 4330 "Fid_RailMeUn3Rls_MAX" 4331 "Fid_RailMeUn4Blk_MAX" 4332 "Fid_RailMeUn4Rls_MAX" 4333 "Fid_RailMeUnCtlMode_MAX" 4334 "Fid_RailPCV0Blk_MAX" 4335 "Fid_RailPCV0Rls_MAX" 4336 "Fid_RailPCV1Blk_MAX" 4337 "Fid_RailPCV1Rls_MAX" 4338 "Fid_RailPCV2Blk_MAX" 4339 "Fid_RailPCV2Rls_MAX" 4340 "Fid_RailPCV3Blk_MAX" 4341 "Fid_RailPCV3Rls_MAX" 4342 "Fid_RailPCV4Blk_MAX" 4343 "Fid_RailPCV4Rls_MAX" 4344 "Fid_RailPCV5Blk_MAX" 4345 "Fid_RailPCV5Rls_MAX" 4346 "Fid_RailPCVCtlMode_MAX" 4347 "Fid_RailSetPointLim_MAX" 4348 "Fid_RailSetPointRed_MAX" 4349 "Fid_ShuttrCTS_MAX" 4350 "Fid_ShuttrEGS_MAX" 4351 "Fid_SignalsTstNLim_MAX" 4352 "Fid_StSysImmo_MAX" 4353 "Fid_StSysStrtTipGbxDat_MAX" 4354 "Fid_T15CDCanError_MAX" 4355 "Fid_T50CDSig_MAX" 4356 "Fid_UsrDa_FDCOff_MAX" 4357 "Fid_VehDaDist_MAX" 4358 "Fid_ZFCClbActv_MAX" 4359 "Fid_ZFCCldCmbCham_MAX" 8193 "Fid_ACCIRevErr_MIN" 8194 "Fid_ACCRevErr_MIN" 8195 "Fid_ACC_AliveErr_MIN" 8196 "Fid_ACC_CsErr_MIN" 8197 "Fid_ACC_TiOutErr_MIN" 8198 "Fid_ACCtl_ACTrqErr_MIN" 8199 "Fid_ACCtl_CTSErr_MIN" 8200 "Fid_ACCtl_FanErr_MIN" 8201 "Fid_ACCtl_TGearbxErr_MIN" 8202 "Fid_ACCtl_VSSErr_MIN" 8203 "Fid_AFSCD_MIN" 8204 "Fid_AFSCD_AirPerTime_MIN" 8205 "Fid_AFSCD_PlOffsDrft_MIN" 8206 "Fid_AFSCD_PlSetyDrft_MIN" 8207 "Fid_AFSCD_SRCCorrAirm_MIN" 8208 "Fid_AFSCD_SRCDcyc_MIN" 8209 "Fid_AFSCD_SRCRawAirm_MIN" 8210 "Fid_AFSCD_SRCRefSig_MIN" 8211 "Fid_AFS_CanMon_MIN" 8212 "Fid_AFS_GenDisableCond_MIN" 8213 "Fid_AOHt_ShutOffErr_MIN" 8214 "Fid_APP1_MIN" 8215 "Fid_APP2_MIN" 8216 "Fid_APSCD_MIN" 8217 "Fid_ARSOff_MIN" 8218 "Fid_ASDdc_MIN" 8219 "Fid_ASModSwtOffEng_MIN" 8220 "Fid_ASModSwtOffIndVol_MIN" 8221 "Fid_AccPed_MIN" 8222 "Fid_AccPed_Brk_MIN" 8223 "Fid_AirCtl_MIN" 8224 "Fid_AirCtlNeg_MIN" 8225 "Fid_AirCtlNeg2_MIN" 8226 "Fid_AirCtlPFltEGRRed_MIN" 8227 "Fid_AirCtlPlateBreak_MIN" 8228 "Fid_AirCtlPlateBreakActv_MIN" 8229 "Fid_AirCtlPos_MIN" 8230 "Fid_AirCtlPos2_MIN" 8231 "Fid_AirCtl_Brk_MIN" 8232 "Fid_BPSCDMon_MIN" 8233 "Fid_CTSCDFlTemp_MIN" 8234 "Fid_CTSCD_Plaus_MIN" 8235 "Fid_ClgDynTst_MIN" 8236 "Fid_CmbChb_MIN" 8237 "Fid_CoDT_GripDeb_MIN" 8238 "Fid_CoEngIRevSys1_MIN" 8239 "Fid_CoEngIRevSys2_MIN" 8240 "Fid_CoEngIRevVeh_MIN" 8241 "Fid_CoEngPFltErr_MIN" 8242 "Fid_CoEngRevSys1_MIN" 8243 "Fid_CoEngRevSys2_MIN" 8244 "Fid_CoEngRevVeh_MIN" 8245 "Fid_CoEngShOffTst_MIN" 8246 "Fid_CoEngSoftShOffTV_MIN" 8247 "Fid_CoEng_ActrPrt_MIN" 8248 "Fid_CoEng_Nrml2Strt_MIN" 8249 "Fid_CoEng_PwrStgEnable_MIN" 8250 "Fid_CoEng_trqLimErr_MIN" 8251 "Fid_CoEng_trqLimErr1_MIN" 8252 "Fid_CoEng_trqLimErr2_MIN" 8253 "Fid_CoEng_trqLimErr3_MIN" 8254 "Fid_CoEng_trqLimErr4_MIN" 8255 "Fid_CoVM_StabDem_Err_MIN" 8256 "Fid_CoVehtrqLimErr_MIN" 8257 "Fid_CrCtlShutOffIr_MIN" 8258 "Fid_CrCtl_ASCTimeout_MIN" 8259 "Fid_CrCtl_CanDef_MIN" 8260 "Fid_CrCtl_KombiTimeout_MIN" 8261 "Fid_CrCtl_vCrCtl_MIN" 8262 "Fid_DSM_Wuc_MIN" 8263 "Fid_EATSCDTSubs_MIN" 8264 "Fid_EBAFCD_MIN" 8265 "Fid_EBFCD_MIN" 8266 "Fid_ECU_MIN" 8267 "Fid_EGSysCoLSU0_MIN" 8268 "Fid_EGSysCoNSC_MIN" 8269 "Fid_EGSysCoOxi_MIN" 8270 "Fid_EGSysCoTrbn_MIN" 8271 "Fid_EGSysCoTube0_MIN" 8272 "Fid_EGSysCoTube1_MIN" 8273 "Fid_EGSysHtgDel_MIN" 8274 "Fid_EGSysNSC_MIN" 8275 "Fid_EGSysOxiCat_MIN" 8276 "Fid_EGSysPresEnv_MIN" 8277 "Fid_EGSysStrt_MIN" 8278 "Fid_EGSysTemp_MIN" 8279 "Fid_EGSysTrbn_MIN" 8280 "Fid_EGSysTube_MIN" 8281 "Fid_EGSys_AP_MIN" 8282 "Fid_EGTRgnLck_MIN" 8283 "Fid_EGTTempGvnrAirCtl_MIN" 8284 "Fid_EGTTempGvnrInr_MIN" 8285 "Fid_EGTTempGvnrOutr_MIN" 8286 "Fid_ETClbCorActv_MIN" 8287 "Fid_EngCTSCD_MIN" 8288 "Fid_EngMCaSBackUp_MIN" 8289 "Fid_EngMCrSBackUp_MIN" 8290 "Fid_EngMTEng_MIN" 8291 "Fid_EngMTrqFrcPDiff_MIN" 8292 "Fid_EngMVVeh_MIN" 8293 "Fid_EngM_ChkStrtSpd_MIN" 8294 "Fid_EngPrt_nLimErr_MIN" 8295 "Fid_FBC_MIN" 8296 "Fid_FBCMonI_MIN" 8297 "Fid_FMASwtOff1_MIN" 8298 "Fid_FMASwtOff3_MIN" 8299 "Fid_FMTC_AirCorr_MIN" 8300 "Fid_FMTC_SOECorr_MIN" 8301 "Fid_FTSCDErr_MIN" 8302 "Fid_FWOscDet_MIN" 8303 "Fid_FanCtl_MIN" 8304 "Fid_FanGbxOil_MIN" 8305 "Fid_FlMngFullLdRglOff_MIN" 8306 "Fid_FlMngSmkDefect_MIN" 8307 "Fid_FlSysCTSSens_MIN" 8308 "Fid_FlSysDens_MIN" 8309 "Fid_FlSysFTSSens_MIN" 8310 "Fid_FrmMngAPP_MIN" 8311 "Fid_FrmMngARS_MIN" 8312 "Fid_FrmMngAddLevl_MIN" 8313 "Fid_FrmMngBrk_MIN" 8314 "Fid_FrmMngBrkDef_MIN" 8315 "Fid_FrmMngCoEng_MIN" 8316 "Fid_FrmMngCoEng_St2_MIN" 8317 "Fid_FrmMngConvDef_MIN" 8318 "Fid_FrmMngEngRpmTemp_MIN" 8319 "Fid_FrmMngEngSpd_MIN" 8320 "Fid_FrmMngInjDU1_MIN" 8321 "Fid_FrmMngInjDU2_MIN" 8322 "Fid_FrmMngInjVlv_MIN" 8323 "Fid_FrmMngOBDCtl_MIN" 8324 "Fid_FrmMngPFltDef_MIN" 8325 "Fid_FrmMngParkConsumer_MIN" 8326 "Fid_FrmMngPla_DSC_MIN" 8327 "Fid_FrmMngPla_EGS_MIN" 8328 "Fid_FrmMngPowerTrainCAN_MIN" 8329 "Fid_FrmMngPwrMngLIGovSt_MIN" 8330 "Fid_FrmMngSIG_ARS_MIN" 8331 "Fid_FrmMngSIG_DSC_MIN" 8332 "Fid_FrmMngSig_EGS_MIN" 8333 "Fid_FrmMngTO_ARS_MIN" 8334 "Fid_FrmMngTO_DSC_MIN" 8335 "Fid_FrmMngTo_EGS_MIN" 8336 "Fid_FrmMngWaterVlv_MIN" 8337 "Fid_FrmMng_ST_TORQ_MIN" 8338 "Fid_FrmMngnSetpoint_MIN" 8339 "Fid_FrmMngpVal_MIN" 8340 "Fid_FrmMngtEng_MIN" 8341 "Fid_GearbxDrvAway_MIN" 8342 "Fid_GearbxDrvAwayInactiv_MIN" 8343 "Fid_GearbxPtCANErr_MIN" 8344 "Fid_GearbxTrqLimErr_MIN" 8345 "Fid_Gearbx_GearDet_MIN" 8346 "Fid_Gearbx_TrqIntv_Err_MIN" 8347 "Fid_GlwCtl1_MIN" 8348 "Fid_HDC_MIN" 8349 "Fid_IndSys1_MIN" 8350 "Fid_IndSys2_MIN" 8351 "Fid_InjCrvCoErr_MIN" 8352 "Fid_InjCtl_qLimErr_MIN" 8353 "Fid_InjVlvWvCorOff_MIN" 8354 "Fid_LIGovSetpDrvAway_MIN" 8355 "Fid_LIGovSetpointDrvAwy_MIN" 8356 "Fid_LIGovUbr_MIN" 8357 "Fid_LSUCDMon0_MIN" 8358 "Fid_LSUCDO20_MIN" 8359 "Fid_LSUCDRi0_MIN" 8360 "Fid_LSUCDactiv0_MIN" 8361 "Fid_LSUCDlsu0_MIN" 8362 "Fid_LSUClbSched_MIN" 8363 "Fid_LSUCtl0_MIN" 8364 "Fid_LSUMonAllChecks_MIN" 8365 "Fid_LSUMonPlausChk_MIN" 8366 "Fid_Layer_FI_TANS_MIN" 8367 "Fid_Layer_FI_TUMG_MIN" 8368 "Fid_Layer_MANHYDR_MIN" 8369 "Fid_Layer_MANLUFT_MIN" 8370 "Fid_MSidCD_ECU_MIN" 8371 "Fid_MSidCD_Pin_MIN" 8372 "Fid_MeUnCDCalcI_MIN" 8373 "Fid_OTSCD_MIN" 8374 "Fid_PCR_MIN" 8375 "Fid_PCRBalGvnr_MIN" 8376 "Fid_PCRExtnLimActr_MIN" 8377 "Fid_PCRGvnrDvtNeg_MIN" 8378 "Fid_PCRGvnrDvtPos_MIN" 8379 "Fid_PCRSurgeLIGov_MIN" 8380 "Fid_PCR_MS_MIN" 8381 "Fid_PCR_SurgeDet_MIN" 8382 "Fid_PCVCDCalcI_MIN" 8383 "Fid_PFltAshCor_MIN" 8384 "Fid_PFltAshCorRgn_MIN" 8385 "Fid_PFltBrk_MIN" 8386 "Fid_PFltChar_MIN" 8387 "Fid_PFltChngPar_MIN" 8388 "Fid_PFltClth_MIN" 8389 "Fid_PFltDiagRls1_MIN" 8390 "Fid_PFltDiagRls2_MIN" 8391 "Fid_PFltDynChk_MIN" 8392 "Fid_PFltEngPrtRgnMon_MIN" 8393 "Fid_PFltGearDet_MIN" 8394 "Fid_PFltHsLnChk_MIN" 8395 "Fid_PFltLckRgnErr_MIN" 8396 "Fid_PFltLckRgnFuel_MIN" 8397 "Fid_PFltNumPFltErr_MIN" 8398 "Fid_PFltNumPFltErrLck_MIN" 8399 "Fid_PFltPPreErr_MIN" 8400 "Fid_PFltPlausPres_MIN" 8401 "Fid_PFltPlausTemp_MIN" 8402 "Fid_PFltPresPlausProj_MIN" 8403 "Fid_PFltPresSensFrz_MIN" 8404 "Fid_PFltPresSensHsLn_MIN" 8405 "Fid_PFltSRCPres_MIN" 8406 "Fid_PFltSRCTemp_MIN" 8407 "Fid_PFltSimOn_MIN" 8408 "Fid_PFltSpdVeh_MIN" 8409 "Fid_PFltTempAir_MIN" 8410 "Fid_PFltTempClnt_MIN" 8411 "Fid_PFltTempOxiPre_MIN" 8412 "Fid_PFltTempPre_MIN" 8413 "Fid_PFltTempSensFrz_MIN" 8414 "Fid_PFltVltgBatt_MIN" 8415 "Fid_RailCDRPSErrChk_MIN" 8416 "Fid_RailCDSubstVal_MIN" 8417 "Fid_RailCD_PMonStrt_MIN" 8418 "Fid_RailCtlMode_MIN" 8419 "Fid_RailMeUn0Blk_MIN" 8420 "Fid_RailMeUn0Rls_MIN" 8421 "Fid_RailMeUn1Blk_MIN" 8422 "Fid_RailMeUn1Rls_MIN" 8423 "Fid_RailMeUn2Blk_MIN" 8424 "Fid_RailMeUn2Rls_MIN" 8425 "Fid_RailMeUn3Blk_MIN" 8426 "Fid_RailMeUn3Rls_MIN" 8427 "Fid_RailMeUn4Blk_MIN" 8428 "Fid_RailMeUn4Rls_MIN" 8429 "Fid_RailMeUnCtlMode_MIN" 8430 "Fid_RailPCV0Blk_MIN" 8431 "Fid_RailPCV0Rls_MIN" 8432 "Fid_RailPCV1Blk_MIN" 8433 "Fid_RailPCV1Rls_MIN" 8434 "Fid_RailPCV2Blk_MIN" 8435 "Fid_RailPCV2Rls_MIN" 8436 "Fid_RailPCV3Blk_MIN" 8437 "Fid_RailPCV3Rls_MIN" 8438 "Fid_RailPCV4Blk_MIN" 8439 "Fid_RailPCV4Rls_MIN" 8440 "Fid_RailPCV5Blk_MIN" 8441 "Fid_RailPCV5Rls_MIN" 8442 "Fid_RailPCVCtlMode_MIN" 8443 "Fid_RailSetPointLim_MIN" 8444 "Fid_RailSetPointRed_MIN" 8445 "Fid_ShuttrCTS_MIN" 8446 "Fid_ShuttrEGS_MIN" 8447 "Fid_SignalsTstNLim_MIN" 8448 "Fid_StSysImmo_MIN" 8449 "Fid_StSysStrtTipGbxDat_MIN" 8450 "Fid_T15CDCanError_MIN" 8451 "Fid_T50CDSig_MIN" 8452 "Fid_UsrDa_FDCOff_MIN" 8453 "Fid_VehDaDist_MIN" 8454 "Fid_ZFCClbActv_MIN" 8455 "Fid_ZFCCldCmbCham_MIN" 16385 "Fid_ACCIRevErr_SIG" 16386 "Fid_ACCRevErr_SIG" 16387 "Fid_ACC_AliveErr_SIG" 16388 "Fid_ACC_CsErr_SIG" 16389 "Fid_ACC_TiOutErr_SIG" 16390 "Fid_ACCtl_ACTrqErr_SIG" 16391 "Fid_ACCtl_CTSErr_SIG" 16392 "Fid_ACCtl_FanErr_SIG" 16393 "Fid_ACCtl_TGearbxErr_SIG" 16394 "Fid_ACCtl_VSSErr_SIG" 16395 "Fid_AFSCD_SIG" 16396 "Fid_AFSCD_AirPerTime_SIG" 16397 "Fid_AFSCD_PlOffsDrft_SIG" 16398 "Fid_AFSCD_PlSetyDrft_SIG" 16399 "Fid_AFSCD_SRCCorrAirm_SIG" 16400 "Fid_AFSCD_SRCDcyc_SIG" 16401 "Fid_AFSCD_SRCRawAirm_SIG" 16402 "Fid_AFSCD_SRCRefSig_SIG" 16403 "Fid_AFS_CanMon_SIG" 16404 "Fid_AFS_GenDisableCond_SIG" 16405 "Fid_AOHt_ShutOffErr_SIG" 16406 "Fid_APP1_SIG" 16407 "Fid_APP2_SIG" 16408 "Fid_APSCD_SIG" 16409 "Fid_ARSOff_SIG" 16410 "Fid_ASDdc_SIG" 16411 "Fid_ASModSwtOffEng_SIG" 16412 "Fid_ASModSwtOffIndVol_SIG" 16413 "Fid_AccPed_SIG" 16414 "Fid_AccPed_Brk_SIG" 16415 "Fid_AirCtl_SIG" 16416 "Fid_AirCtlNeg_SIG" 16417 "Fid_AirCtlNeg2_SIG" 16418 "Fid_AirCtlPFltEGRRed_SIG" 16419 "Fid_AirCtlPlateBreak_SIG" 16420 "Fid_AirCtlPlateBreakActv_SIG" 16421 "Fid_AirCtlPos_SIG" 16422 "Fid_AirCtlPos2_SIG" 16423 "Fid_AirCtl_Brk_SIG" 16424 "Fid_BPSCDMon_SIG" 16425 "Fid_CTSCDFlTemp_SIG" 16426 "Fid_CTSCD_Plaus_SIG" 16427 "Fid_ClgDynTst_SIG" 16428 "Fid_CmbChb_SIG" 16429 "Fid_CoDT_GripDeb_SIG" 16430 "Fid_CoEngIRevSys1_SIG" 16431 "Fid_CoEngIRevSys2_SIG" 16432 "Fid_CoEngIRevVeh_SIG" 16433 "Fid_CoEngPFltErr_SIG" 16434 "Fid_CoEngRevSys1_SIG" 16435 "Fid_CoEngRevSys2_SIG" 16436 "Fid_CoEngRevVeh_SIG" 16437 "Fid_CoEngShOffTst_SIG" 16438 "Fid_CoEngSoftShOffTV_SIG" 16439 "Fid_CoEng_ActrPrt_SIG" 16440 "Fid_CoEng_Nrml2Strt_SIG" 16441 "Fid_CoEng_PwrStgEnable_SIG" 16442 "Fid_CoEng_trqLimErr_SIG" 16443 "Fid_CoEng_trqLimErr1_SIG" 16444 "Fid_CoEng_trqLimErr2_SIG" 16445 "Fid_CoEng_trqLimErr3_SIG" 16446 "Fid_CoEng_trqLimErr4_SIG" 16447 "Fid_CoVM_StabDem_Err_SIG" 16448 "Fid_CoVehtrqLimErr_SIG" 16449 "Fid_CrCtlShutOffIr_SIG" 16450 "Fid_CrCtl_ASCTimeout_SIG" 16451 "Fid_CrCtl_CanDef_SIG" 16452 "Fid_CrCtl_KombiTimeout_SIG" 16453 "Fid_CrCtl_vCrCtl_SIG" 16454 "Fid_DSM_Wuc_SIG" 16455 "Fid_EATSCDTSubs_SIG" 16456 "Fid_EBAFCD_SIG" 16457 "Fid_EBFCD_SIG" 16458 "Fid_ECU_SIG" 16459 "Fid_EGSysCoLSU0_SIG" 16460 "Fid_EGSysCoNSC_SIG" 16461 "Fid_EGSysCoOxi_SIG" 16462 "Fid_EGSysCoTrbn_SIG" 16463 "Fid_EGSysCoTube0_SIG" 16464 "Fid_EGSysCoTube1_SIG" 16465 "Fid_EGSysHtgDel_SIG" 16466 "Fid_EGSysNSC_SIG" 16467 "Fid_EGSysOxiCat_SIG" 16468 "Fid_EGSysPresEnv_SIG" 16469 "Fid_EGSysStrt_SIG" 16470 "Fid_EGSysTemp_SIG" 16471 "Fid_EGSysTrbn_SIG" 16472 "Fid_EGSysTube_SIG" 16473 "Fid_EGSys_AP_SIG" 16474 "Fid_EGTRgnLck_SIG" 16475 "Fid_EGTTempGvnrAirCtl_SIG" 16476 "Fid_EGTTempGvnrInr_SIG" 16477 "Fid_EGTTempGvnrOutr_SIG" 16478 "Fid_ETClbCorActv_SIG" 16479 "Fid_EngCTSCD_SIG" 16480 "Fid_EngMCaSBackUp_SIG" 16481 "Fid_EngMCrSBackUp_SIG" 16482 "Fid_EngMTEng_SIG" 16483 "Fid_EngMTrqFrcPDiff_SIG" 16484 "Fid_EngMVVeh_SIG" 16485 "Fid_EngM_ChkStrtSpd_SIG" 16486 "Fid_EngPrt_nLimErr_SIG" 16487 "Fid_FBC_SIG" 16488 "Fid_FBCMonI_SIG" 16489 "Fid_FMASwtOff1_SIG" 16490 "Fid_FMASwtOff3_SIG" 16491 "Fid_FMTC_AirCorr_SIG" 16492 "Fid_FMTC_SOECorr_SIG" 16493 "Fid_FTSCDErr_SIG" 16494 "Fid_FWOscDet_SIG" 16495 "Fid_FanCtl_SIG" 16496 "Fid_FanGbxOil_SIG" 16497 "Fid_FlMngFullLdRglOff_SIG" 16498 "Fid_FlMngSmkDefect_SIG" 16499 "Fid_FlSysCTSSens_SIG" 16500 "Fid_FlSysDens_SIG" 16501 "Fid_FlSysFTSSens_SIG" 16502 "Fid_FrmMngAPP_SIG" 16503 "Fid_FrmMngARS_SIG" 16504 "Fid_FrmMngAddLevl_SIG" 16505 "Fid_FrmMngBrk_SIG" 16506 "Fid_FrmMngBrkDef_SIG" 16507 "Fid_FrmMngCoEng_SIG" 16508 "Fid_FrmMngCoEng_St2_SIG" 16509 "Fid_FrmMngConvDef_SIG" 16510 "Fid_FrmMngEngRpmTemp_SIG" 16511 "Fid_FrmMngEngSpd_SIG" 16512 "Fid_FrmMngInjDU1_SIG" 16513 "Fid_FrmMngInjDU2_SIG" 16514 "Fid_FrmMngInjVlv_SIG" 16515 "Fid_FrmMngOBDCtl_SIG" 16516 "Fid_FrmMngPFltDef_SIG" 16517 "Fid_FrmMngParkConsumer_SIG" 16518 "Fid_FrmMngPla_DSC_SIG" 16519 "Fid_FrmMngPla_EGS_SIG" 16520 "Fid_FrmMngPowerTrainCAN_SIG" 16521 "Fid_FrmMngPwrMngLIGovSt_SIG" 16522 "Fid_FrmMngSIG_ARS_SIG" 16523 "Fid_FrmMngSIG_DSC_SIG" 16524 "Fid_FrmMngSig_EGS_SIG" 16525 "Fid_FrmMngTO_ARS_SIG" 16526 "Fid_FrmMngTO_DSC_SIG" 16527 "Fid_FrmMngTo_EGS_SIG" 16528 "Fid_FrmMngWaterVlv_SIG" 16529 "Fid_FrmMng_ST_TORQ_SIG" 16530 "Fid_FrmMngnSetpoint_SIG" 16531 "Fid_FrmMngpVal_SIG" 16532 "Fid_FrmMngtEng_SIG" 16533 "Fid_GearbxDrvAway_SIG" 16534 "Fid_GearbxDrvAwayInactiv_SIG" 16535 "Fid_GearbxPtCANErr_SIG" 16536 "Fid_GearbxTrqLimErr_SIG" 16537 "Fid_Gearbx_GearDet_SIG" 16538 "Fid_Gearbx_TrqIntv_Err_SIG" 16539 "Fid_GlwCtl1_SIG" 16540 "Fid_HDC_SIG" 16541 "Fid_IndSys1_SIG" 16542 "Fid_IndSys2_SIG" 16543 "Fid_InjCrvCoErr_SIG" 16544 "Fid_InjCtl_qLimErr_SIG" 16545 "Fid_InjVlvWvCorOff_SIG" 16546 "Fid_LIGovSetpDrvAway_SIG" 16547 "Fid_LIGovSetpointDrvAwy_SIG" 16548 "Fid_LIGovUbr_SIG" 16549 "Fid_LSUCDMon0_SIG" 16550 "Fid_LSUCDO20_SIG" 16551 "Fid_LSUCDRi0_SIG" 16552 "Fid_LSUCDactiv0_SIG" 16553 "Fid_LSUCDlsu0_SIG" 16554 "Fid_LSUClbSched_SIG" 16555 "Fid_LSUCtl0_SIG" 16556 "Fid_LSUMonAllChecks_SIG" 16557 "Fid_LSUMonPlausChk_SIG" 16558 "Fid_Layer_FI_TANS_SIG" 16559 "Fid_Layer_FI_TUMG_SIG" 16560 "Fid_Layer_MANHYDR_SIG" 16561 "Fid_Layer_MANLUFT_SIG" 16562 "Fid_MSidCD_ECU_SIG" 16563 "Fid_MSidCD_Pin_SIG" 16564 "Fid_MeUnCDCalcI_SIG" 16565 "Fid_OTSCD_SIG" 16566 "Fid_PCR_SIG" 16567 "Fid_PCRBalGvnr_SIG" 16568 "Fid_PCRExtnLimActr_SIG" 16569 "Fid_PCRGvnrDvtNeg_SIG" 16570 "Fid_PCRGvnrDvtPos_SIG" 16571 "Fid_PCRSurgeLIGov_SIG" 16572 "Fid_PCR_MS_SIG" 16573 "Fid_PCR_SurgeDet_SIG" 16574 "Fid_PCVCDCalcI_SIG" 16575 "Fid_PFltAshCor_SIG" 16576 "Fid_PFltAshCorRgn_SIG" 16577 "Fid_PFltBrk_SIG" 16578 "Fid_PFltChar_SIG" 16579 "Fid_PFltChngPar_SIG" 16580 "Fid_PFltClth_SIG" 16581 "Fid_PFltDiagRls1_SIG" 16582 "Fid_PFltDiagRls2_SIG" 16583 "Fid_PFltDynChk_SIG" 16584 "Fid_PFltEngPrtRgnMon_SIG" 16585 "Fid_PFltGearDet_SIG" 16586 "Fid_PFltHsLnChk_SIG" 16587 "Fid_PFltLckRgnErr_SIG" 16588 "Fid_PFltLckRgnFuel_SIG" 16589 "Fid_PFltNumPFltErr_SIG" 16590 "Fid_PFltNumPFltErrLck_SIG" 16591 "Fid_PFltPPreErr_SIG" 16592 "Fid_PFltPlausPres_SIG" 16593 "Fid_PFltPlausTemp_SIG" 16594 "Fid_PFltPresPlausProj_SIG" 16595 "Fid_PFltPresSensFrz_SIG" 16596 "Fid_PFltPresSensHsLn_SIG" 16597 "Fid_PFltSRCPres_SIG" 16598 "Fid_PFltSRCTemp_SIG" 16599 "Fid_PFltSimOn_SIG" 16600 "Fid_PFltSpdVeh_SIG" 16601 "Fid_PFltTempAir_SIG" 16602 "Fid_PFltTempClnt_SIG" 16603 "Fid_PFltTempOxiPre_SIG" 16604 "Fid_PFltTempPre_SIG" 16605 "Fid_PFltTempSensFrz_SIG" 16606 "Fid_PFltVltgBatt_SIG" 16607 "Fid_RailCDRPSErrChk_SIG" 16608 "Fid_RailCDSubstVal_SIG" 16609 "Fid_RailCD_PMonStrt_SIG" 16610 "Fid_RailCtlMode_SIG" 16611 "Fid_RailMeUn0Blk_SIG" 16612 "Fid_RailMeUn0Rls_SIG" 16613 "Fid_RailMeUn1Blk_SIG" 16614 "Fid_RailMeUn1Rls_SIG" 16615 "Fid_RailMeUn2Blk_SIG" 16616 "Fid_RailMeUn2Rls_SIG" 16617 "Fid_RailMeUn3Blk_SIG" 16618 "Fid_RailMeUn3Rls_SIG" 16619 "Fid_RailMeUn4Blk_SIG" 16620 "Fid_RailMeUn4Rls_SIG" 16621 "Fid_RailMeUnCtlMode_SIG" 16622 "Fid_RailPCV0Blk_SIG" 16623 "Fid_RailPCV0Rls_SIG" 16624 "Fid_RailPCV1Blk_SIG" 16625 "Fid_RailPCV1Rls_SIG" 16626 "Fid_RailPCV2Blk_SIG" 16627 "Fid_RailPCV2Rls_SIG" 16628 "Fid_RailPCV3Blk_SIG" 16629 "Fid_RailPCV3Rls_SIG" 16630 "Fid_RailPCV4Blk_SIG" 16631 "Fid_RailPCV4Rls_SIG" 16632 "Fid_RailPCV5Blk_SIG" 16633 "Fid_RailPCV5Rls_SIG" 16634 "Fid_RailPCVCtlMode_SIG" 16635 "Fid_RailSetPointLim_SIG" 16636 "Fid_RailSetPointRed_SIG" 16637 "Fid_ShuttrCTS_SIG" 16638 "Fid_ShuttrEGS_SIG" 16639 "Fid_SignalsTstNLim_SIG" 16640 "Fid_StSysImmo_SIG" 16641 "Fid_StSysStrtTipGbxDat_SIG" 16642 "Fid_T15CDCanError_SIG" 16643 "Fid_T50CDSig_SIG" 16644 "Fid_UsrDa_FDCOff_SIG" 16645 "Fid_VehDaDist_SIG" 16646 "Fid_ZFCClbActv_SIG" 16647 "Fid_ZFCCldCmbCham_SIG" 32769 "Fid_ACCIRevErr_NPL" 32770 "Fid_ACCRevErr_NPL" 32771 "Fid_ACC_AliveErr_NPL" 32772 "Fid_ACC_CsErr_NPL" 32773 "Fid_ACC_TiOutErr_NPL" 32774 "Fid_ACCtl_ACTrqErr_NPL" 32775 "Fid_ACCtl_CTSErr_NPL" 32776 "Fid_ACCtl_FanErr_NPL" 32777 "Fid_ACCtl_TGearbxErr_NPL" 32778 "Fid_ACCtl_VSSErr_NPL" 32779 "Fid_AFSCD_NPL" 32780 "Fid_AFSCD_AirPerTime_NPL" 32781 "Fid_AFSCD_PlOffsDrft_NPL" 32782 "Fid_AFSCD_PlSetyDrft_NPL" 32783 "Fid_AFSCD_SRCCorrAirm_NPL" 32784 "Fid_AFSCD_SRCDcyc_NPL" 32785 "Fid_AFSCD_SRCRawAirm_NPL" 32786 "Fid_AFSCD_SRCRefSig_NPL" 32787 "Fid_AFS_CanMon_NPL" 32788 "Fid_AFS_GenDisableCond_NPL" 32789 "Fid_AOHt_ShutOffErr_NPL" 32790 "Fid_APP1_NPL" 32791 "Fid_APP2_NPL" 32792 "Fid_APSCD_NPL" 32793 "Fid_ARSOff_NPL" 32794 "Fid_ASDdc_NPL" 32795 "Fid_ASModSwtOffEng_NPL" 32796 "Fid_ASModSwtOffIndVol_NPL" 32797 "Fid_AccPed_NPL" 32798 "Fid_AccPed_Brk_NPL" 32799 "Fid_AirCtl_NPL" 32800 "Fid_AirCtlNeg_NPL" 32801 "Fid_AirCtlNeg2_NPL" 32802 "Fid_AirCtlPFltEGRRed_NPL" 32803 "Fid_AirCtlPlateBreak_NPL" 32804 "Fid_AirCtlPlateBreakActv_NPL" 32805 "Fid_AirCtlPos_NPL" 32806 "Fid_AirCtlPos2_NPL" 32807 "Fid_AirCtl_Brk_NPL" 32808 "Fid_BPSCDMon_NPL" 32809 "Fid_CTSCDFlTemp_NPL" 32810 "Fid_CTSCD_Plaus_NPL" 32811 "Fid_ClgDynTst_NPL" 32812 "Fid_CmbChb_NPL" 32813 "Fid_CoDT_GripDeb_NPL" 32814 "Fid_CoEngIRevSys1_NPL" 32815 "Fid_CoEngIRevSys2_NPL" 32816 "Fid_CoEngIRevVeh_NPL" 32817 "Fid_CoEngPFltErr_NPL" 32818 "Fid_CoEngRevSys1_NPL" 32819 "Fid_CoEngRevSys2_NPL" 32820 "Fid_CoEngRevVeh_NPL" 32821 "Fid_CoEngShOffTst_NPL" 32822 "Fid_CoEngSoftShOffTV_NPL" 32823 "Fid_CoEng_ActrPrt_NPL" 32824 "Fid_CoEng_Nrml2Strt_NPL" 32825 "Fid_CoEng_PwrStgEnable_NPL" 32826 "Fid_CoEng_trqLimErr_NPL" 32827 "Fid_CoEng_trqLimErr1_NPL" 32828 "Fid_CoEng_trqLimErr2_NPL" 32829 "Fid_CoEng_trqLimErr3_NPL" 32830 "Fid_CoEng_trqLimErr4_NPL" 32831 "Fid_CoVM_StabDem_Err_NPL" 32832 "Fid_CoVehtrqLimErr_NPL" 32833 "Fid_CrCtlShutOffIr_NPL" 32834 "Fid_CrCtl_ASCTimeout_NPL" 32835 "Fid_CrCtl_CanDef_NPL" 32836 "Fid_CrCtl_KombiTimeout_NPL" 32837 "Fid_CrCtl_vCrCtl_NPL" 32838 "Fid_DSM_Wuc_NPL" 32839 "Fid_EATSCDTSubs_NPL" 32840 "Fid_EBAFCD_NPL" 32841 "Fid_EBFCD_NPL" 32842 "Fid_ECU_NPL" 32843 "Fid_EGSysCoLSU0_NPL" 32844 "Fid_EGSysCoNSC_NPL" 32845 "Fid_EGSysCoOxi_NPL" 32846 "Fid_EGSysCoTrbn_NPL" 32847 "Fid_EGSysCoTube0_NPL" 32848 "Fid_EGSysCoTube1_NPL" 32849 "Fid_EGSysHtgDel_NPL" 32850 "Fid_EGSysNSC_NPL" 32851 "Fid_EGSysOxiCat_NPL" 32852 "Fid_EGSysPresEnv_NPL" 32853 "Fid_EGSysStrt_NPL" 32854 "Fid_EGSysTemp_NPL" 32855 "Fid_EGSysTrbn_NPL" 32856 "Fid_EGSysTube_NPL" 32857 "Fid_EGSys_AP_NPL" 32858 "Fid_EGTRgnLck_NPL" 32859 "Fid_EGTTempGvnrAirCtl_NPL" 32860 "Fid_EGTTempGvnrInr_NPL" 32861 "Fid_EGTTempGvnrOutr_NPL" 32862 "Fid_ETClbCorActv_NPL" 32863 "Fid_EngCTSCD_NPL" 32864 "Fid_EngMCaSBackUp_NPL" 32865 "Fid_EngMCrSBackUp_NPL" 32866 "Fid_EngMTEng_NPL" 32867 "Fid_EngMTrqFrcPDiff_NPL" 32868 "Fid_EngMVVeh_NPL" 32869 "Fid_EngM_ChkStrtSpd_NPL" 32870 "Fid_EngPrt_nLimErr_NPL" 32871 "Fid_FBC_NPL" 32872 "Fid_FBCMonI_NPL" 32873 "Fid_FMASwtOff1_NPL" 32874 "Fid_FMASwtOff3_NPL" 32875 "Fid_FMTC_AirCorr_NPL" 32876 "Fid_FMTC_SOECorr_NPL" 32877 "Fid_FTSCDErr_NPL" 32878 "Fid_FWOscDet_NPL" 32879 "Fid_FanCtl_NPL" 32880 "Fid_FanGbxOil_NPL" 32881 "Fid_FlMngFullLdRglOff_NPL" 32882 "Fid_FlMngSmkDefect_NPL" 32883 "Fid_FlSysCTSSens_NPL" 32884 "Fid_FlSysDens_NPL" 32885 "Fid_FlSysFTSSens_NPL" 32886 "Fid_FrmMngAPP_NPL" 32887 "Fid_FrmMngARS_NPL" 32888 "Fid_FrmMngAddLevl_NPL" 32889 "Fid_FrmMngBrk_NPL" 32890 "Fid_FrmMngBrkDef_NPL" 32891 "Fid_FrmMngCoEng_NPL" 32892 "Fid_FrmMngCoEng_St2_NPL" 32893 "Fid_FrmMngConvDef_NPL" 32894 "Fid_FrmMngEngRpmTemp_NPL" 32895 "Fid_FrmMngEngSpd_NPL" 32896 "Fid_FrmMngInjDU1_NPL" 32897 "Fid_FrmMngInjDU2_NPL" 32898 "Fid_FrmMngInjVlv_NPL" 32899 "Fid_FrmMngOBDCtl_NPL" 32900 "Fid_FrmMngPFltDef_NPL" 32901 "Fid_FrmMngParkConsumer_NPL" 32902 "Fid_FrmMngPla_DSC_NPL" 32903 "Fid_FrmMngPla_EGS_NPL" 32904 "Fid_FrmMngPowerTrainCAN_NPL" 32905 "Fid_FrmMngPwrMngLIGovSt_NPL" 32906 "Fid_FrmMngSIG_ARS_NPL" 32907 "Fid_FrmMngSIG_DSC_NPL" 32908 "Fid_FrmMngSig_EGS_NPL" 32909 "Fid_FrmMngTO_ARS_NPL" 32910 "Fid_FrmMngTO_DSC_NPL" 32911 "Fid_FrmMngTo_EGS_NPL" 32912 "Fid_FrmMngWaterVlv_NPL" 32913 "Fid_FrmMng_ST_TORQ_NPL" 32914 "Fid_FrmMngnSetpoint_NPL" 32915 "Fid_FrmMngpVal_NPL" 32916 "Fid_FrmMngtEng_NPL" 32917 "Fid_GearbxDrvAway_NPL" 32918 "Fid_GearbxDrvAwayInactiv_NPL" 32919 "Fid_GearbxPtCANErr_NPL" 32920 "Fid_GearbxTrqLimErr_NPL" 32921 "Fid_Gearbx_GearDet_NPL" 32922 "Fid_Gearbx_TrqIntv_Err_NPL" 32923 "Fid_GlwCtl1_NPL" 32924 "Fid_HDC_NPL" 32925 "Fid_IndSys1_NPL" 32926 "Fid_IndSys2_NPL" 32927 "Fid_InjCrvCoErr_NPL" 32928 "Fid_InjCtl_qLimErr_NPL" 32929 "Fid_InjVlvWvCorOff_NPL" 32930 "Fid_LIGovSetpDrvAway_NPL" 32931 "Fid_LIGovSetpointDrvAwy_NPL" 32932 "Fid_LIGovUbr_NPL" 32933 "Fid_LSUCDMon0_NPL" 32934 "Fid_LSUCDO20_NPL" 32935 "Fid_LSUCDRi0_NPL" 32936 "Fid_LSUCDactiv0_NPL" 32937 "Fid_LSUCDlsu0_NPL" 32938 "Fid_LSUClbSched_NPL" 32939 "Fid_LSUCtl0_NPL" 32940 "Fid_LSUMonAllChecks_NPL" 32941 "Fid_LSUMonPlausChk_NPL" 32942 "Fid_Layer_FI_TANS_NPL" 32943 "Fid_Layer_FI_TUMG_NPL" 32944 "Fid_Layer_MANHYDR_NPL" 32945 "Fid_Layer_MANLUFT_NPL" 32946 "Fid_MSidCD_ECU_NPL" 32947 "Fid_MSidCD_Pin_NPL" 32948 "Fid_MeUnCDCalcI_NPL" 32949 "Fid_OTSCD_NPL" 32950 "Fid_PCR_NPL" 32951 "Fid_PCRBalGvnr_NPL" 32952 "Fid_PCRExtnLimActr_NPL" 32953 "Fid_PCRGvnrDvtNeg_NPL" 32954 "Fid_PCRGvnrDvtPos_NPL" 32955 "Fid_PCRSurgeLIGov_NPL" 32956 "Fid_PCR_MS_NPL" 32957 "Fid_PCR_SurgeDet_NPL" 32958 "Fid_PCVCDCalcI_NPL" 32959 "Fid_PFltAshCor_NPL" 32960 "Fid_PFltAshCorRgn_NPL" 32961 "Fid_PFltBrk_NPL" 32962 "Fid_PFltChar_NPL" 32963 "Fid_PFltChngPar_NPL" 32964 "Fid_PFltClth_NPL" 32965 "Fid_PFltDiagRls1_NPL" 32966 "Fid_PFltDiagRls2_NPL" 32967 "Fid_PFltDynChk_NPL" 32968 "Fid_PFltEngPrtRgnMon_NPL" 32969 "Fid_PFltGearDet_NPL" 32970 "Fid_PFltHsLnChk_NPL" 32971 "Fid_PFltLckRgnErr_NPL" 32972 "Fid_PFltLckRgnFuel_NPL" 32973 "Fid_PFltNumPFltErr_NPL" 32974 "Fid_PFltNumPFltErrLck_NPL" 32975 "Fid_PFltPPreErr_NPL" 32976 "Fid_PFltPlausPres_NPL" 32977 "Fid_PFltPlausTemp_NPL" 32978 "Fid_PFltPresPlausProj_NPL" 32979 "Fid_PFltPresSensFrz_NPL" 32980 "Fid_PFltPresSensHsLn_NPL" 32981 "Fid_PFltSRCPres_NPL" 32982 "Fid_PFltSRCTemp_NPL" 32983 "Fid_PFltSimOn_NPL" 32984 "Fid_PFltSpdVeh_NPL" 32985 "Fid_PFltTempAir_NPL" 32986 "Fid_PFltTempClnt_NPL" 32987 "Fid_PFltTempOxiPre_NPL" 32988 "Fid_PFltTempPre_NPL" 32989 "Fid_PFltTempSensFrz_NPL" 32990 "Fid_PFltVltgBatt_NPL" 32991 "Fid_RailCDRPSErrChk_NPL" 32992 "Fid_RailCDSubstVal_NPL" 32993 "Fid_RailCD_PMonStrt_NPL" 32994 "Fid_RailCtlMode_NPL" 32995 "Fid_RailMeUn0Blk_NPL" 32996 "Fid_RailMeUn0Rls_NPL" 32997 "Fid_RailMeUn1Blk_NPL" 32998 "Fid_RailMeUn1Rls_NPL" 32999 "Fid_RailMeUn2Blk_NPL" 33000 "Fid_RailMeUn2Rls_NPL" 33001 "Fid_RailMeUn3Blk_NPL" 33002 "Fid_RailMeUn3Rls_NPL" 33003 "Fid_RailMeUn4Blk_NPL" 33004 "Fid_RailMeUn4Rls_NPL" 33005 "Fid_RailMeUnCtlMode_NPL" 33006 "Fid_RailPCV0Blk_NPL" 33007 "Fid_RailPCV0Rls_NPL" 33008 "Fid_RailPCV1Blk_NPL" 33009 "Fid_RailPCV1Rls_NPL" 33010 "Fid_RailPCV2Blk_NPL" 33011 "Fid_RailPCV2Rls_NPL" 33012 "Fid_RailPCV3Blk_NPL" 33013 "Fid_RailPCV3Rls_NPL" 33014 "Fid_RailPCV4Blk_NPL" 33015 "Fid_RailPCV4Rls_NPL" 33016 "Fid_RailPCV5Blk_NPL" 33017 "Fid_RailPCV5Rls_NPL" 33018 "Fid_RailPCVCtlMode_NPL" 33019 "Fid_RailSetPointLim_NPL" 33020 "Fid_RailSetPointRed_NPL" 33021 "Fid_ShuttrCTS_NPL" 33022 "Fid_ShuttrEGS_NPL" 33023 "Fid_SignalsTstNLim_NPL" 33024 "Fid_StSysImmo_NPL" 33025 "Fid_StSysStrtTipGbxDat_NPL" 33026 "Fid_T15CDCanError_NPL" 33027 "Fid_T50CDSig_NPL" 33028 "Fid_UsrDa_FDCOff_NPL" 33029 "Fid_VehDaDist_NPL" 33030 "Fid_ZFCClbActv_NPL" 33031 "Fid_ZFCCldCmbCham_NPL" 61441 "Fid_ACCIRevErr" 61442 "Fid_ACCRevErr" 61443 "Fid_ACC_AliveErr" 61444 "Fid_ACC_CsErr" 61445 "Fid_ACC_TiOutErr" 61446 "Fid_ACCtl_ACTrqErr" 61447 "Fid_ACCtl_CTSErr" 61448 "Fid_ACCtl_FanErr" 61449 "Fid_ACCtl_TGearbxErr" 61450 "Fid_ACCtl_VSSErr" 61451 "Fid_AFSCD" 61452 "Fid_AFSCD_AirPerTime" 61453 "Fid_AFSCD_PlOffsDrft" 61454 "Fid_AFSCD_PlSetyDrft" 61455 "Fid_AFSCD_SRCCorrAirm" 61456 "Fid_AFSCD_SRCDcyc" 61457 "Fid_AFSCD_SRCRawAirm" 61458 "Fid_AFSCD_SRCRefSig" 61459 "Fid_AFS_CanMon" 61460 "Fid_AFS_GenDisableCond" 61461 "Fid_AOHt_ShutOffErr" 61462 "Fid_APP1" 61463 "Fid_APP2" 61464 "Fid_APSCD" 61465 "Fid_ARSOff" 61466 "Fid_ASDdc" 61467 "Fid_ASModSwtOffEng" 61468 "Fid_ASModSwtOffIndVol" 61469 "Fid_AccPed" 61470 "Fid_AccPed_Brk" 61471 "Fid_AirCtl" 61472 "Fid_AirCtlNeg" 61473 "Fid_AirCtlNeg2" 61474 "Fid_AirCtlPFltEGRRed" 61475 "Fid_AirCtlPlateBreak" 61476 "Fid_AirCtlPlateBreakActv" 61477 "Fid_AirCtlPos" 61478 "Fid_AirCtlPos2" 61479 "Fid_AirCtl_Brk" 61480 "Fid_BPSCDMon" 61481 "Fid_CTSCDFlTemp" 61482 "Fid_CTSCD_Plaus" 61483 "Fid_ClgDynTst" 61484 "Fid_CmbChb" 61485 "Fid_CoDT_GripDeb" 61486 "Fid_CoEngIRevSys1" 61487 "Fid_CoEngIRevSys2" 61488 "Fid_CoEngIRevVeh" 61489 "Fid_CoEngPFltErr" 61490 "Fid_CoEngRevSys1" 61491 "Fid_CoEngRevSys2" 61492 "Fid_CoEngRevVeh" 61493 "Fid_CoEngShOffTst" 61494 "Fid_CoEngSoftShOffTV" 61495 "Fid_CoEng_ActrPrt" 61496 "Fid_CoEng_Nrml2Strt" 61497 "Fid_CoEng_PwrStgEnable" 61498 "Fid_CoEng_trqLimErr" 61499 "Fid_CoEng_trqLimErr1" 61500 "Fid_CoEng_trqLimErr2" 61501 "Fid_CoEng_trqLimErr3" 61502 "Fid_CoEng_trqLimErr4" 61503 "Fid_CoVM_StabDem_Err" 61504 "Fid_CoVehtrqLimErr" 61505 "Fid_CrCtlShutOffIr" 61506 "Fid_CrCtl_ASCTimeout" 61507 "Fid_CrCtl_CanDef" 61508 "Fid_CrCtl_KombiTimeout" 61509 "Fid_CrCtl_vCrCtl" 61510 "Fid_DSM_Wuc" 61511 "Fid_EATSCDTSubs" 61512 "Fid_EBAFCD" 61513 "Fid_EBFCD" 61514 "Fid_ECU" 61515 "Fid_EGSysCoLSU0" 61516 "Fid_EGSysCoNSC" 61517 "Fid_EGSysCoOxi" 61518 "Fid_EGSysCoTrbn" 61519 "Fid_EGSysCoTube0" 61520 "Fid_EGSysCoTube1" 61521 "Fid_EGSysHtgDel" 61522 "Fid_EGSysNSC" 61523 "Fid_EGSysOxiCat" 61524 "Fid_EGSysPresEnv" 61525 "Fid_EGSysStrt" 61526 "Fid_EGSysTemp" 61527 "Fid_EGSysTrbn" 61528 "Fid_EGSysTube" 61529 "Fid_EGSys_AP" 61530 "Fid_EGTRgnLck" 61531 "Fid_EGTTempGvnrAirCtl" 61532 "Fid_EGTTempGvnrInr" 61533 "Fid_EGTTempGvnrOutr" 61534 "Fid_ETClbCorActv" 61535 "Fid_EngCTSCD" 61536 "Fid_EngMCaSBackUp" 61537 "Fid_EngMCrSBackUp" 61538 "Fid_EngMTEng" 61539 "Fid_EngMTrqFrcPDiff" 61540 "Fid_EngMVVeh" 61541 "Fid_EngM_ChkStrtSpd" 61542 "Fid_EngPrt_nLimErr" 61543 "Fid_FBC" 61544 "Fid_FBCMonI" 61545 "Fid_FMASwtOff1" 61546 "Fid_FMASwtOff3" 61547 "Fid_FMTC_AirCorr" 61548 "Fid_FMTC_SOECorr" 61549 "Fid_FTSCDErr" 61550 "Fid_FWOscDet" 61551 "Fid_FanCtl" 61552 "Fid_FanGbxOil" 61553 "Fid_FlMngFullLdRglOff" 61554 "Fid_FlMngSmkDefect" 61555 "Fid_FlSysCTSSens" 61556 "Fid_FlSysDens" 61557 "Fid_FlSysFTSSens" 61558 "Fid_FrmMngAPP" 61559 "Fid_FrmMngARS" 61560 "Fid_FrmMngAddLevl" 61561 "Fid_FrmMngBrk" 61562 "Fid_FrmMngBrkDef" 61563 "Fid_FrmMngCoEng" 61564 "Fid_FrmMngCoEng_St2" 61565 "Fid_FrmMngConvDef" 61566 "Fid_FrmMngEngRpmTemp" 61567 "Fid_FrmMngEngSpd" 61568 "Fid_FrmMngInjDU1" 61569 "Fid_FrmMngInjDU2" 61570 "Fid_FrmMngInjVlv" 61571 "Fid_FrmMngOBDCtl" 61572 "Fid_FrmMngPFltDef" 61573 "Fid_FrmMngParkConsumer" 61574 "Fid_FrmMngPla_DSC" 61575 "Fid_FrmMngPla_EGS" 61576 "Fid_FrmMngPowerTrainCAN" 61577 "Fid_FrmMngPwrMngLIGovSt" 61578 "Fid_FrmMngSIG_ARS" 61579 "Fid_FrmMngSIG_DSC" 61580 "Fid_FrmMngSig_EGS" 61581 "Fid_FrmMngTO_ARS" 61582 "Fid_FrmMngTO_DSC" 61583 "Fid_FrmMngTo_EGS" 61584 "Fid_FrmMngWaterVlv" 61585 "Fid_FrmMng_ST_TORQ" 61586 "Fid_FrmMngnSetpoint" 61587 "Fid_FrmMngpVal" 61588 "Fid_FrmMngtEng" 61589 "Fid_GearbxDrvAway" 61590 "Fid_GearbxDrvAwayInactiv" 61591 "Fid_GearbxPtCANErr" 61592 "Fid_GearbxTrqLimErr" 61593 "Fid_Gearbx_GearDet" 61594 "Fid_Gearbx_TrqIntv_Err" 61595 "Fid_GlwCtl1" 61596 "Fid_HDC" 61597 "Fid_IndSys1" 61598 "Fid_IndSys2" 61599 "Fid_InjCrvCoErr" 61600 "Fid_InjCtl_qLimErr" 61601 "Fid_InjVlvWvCorOff" 61602 "Fid_LIGovSetpDrvAway" 61603 "Fid_LIGovSetpointDrvAwy" 61604 "Fid_LIGovUbr" 61605 "Fid_LSUCDMon0" 61606 "Fid_LSUCDO20" 61607 "Fid_LSUCDRi0" 61608 "Fid_LSUCDactiv0" 61609 "Fid_LSUCDlsu0" 61610 "Fid_LSUClbSched" 61611 "Fid_LSUCtl0" 61612 "Fid_LSUMonAllChecks" 61613 "Fid_LSUMonPlausChk" 61614 "Fid_Layer_FI_TANS" 61615 "Fid_Layer_FI_TUMG" 61616 "Fid_Layer_MANHYDR" 61617 "Fid_Layer_MANLUFT" 61618 "Fid_MSidCD_ECU" 61619 "Fid_MSidCD_Pin" 61620 "Fid_MeUnCDCalcI" 61621 "Fid_OTSCD" 61622 "Fid_PCR" 61623 "Fid_PCRBalGvnr" 61624 "Fid_PCRExtnLimActr" 61625 "Fid_PCRGvnrDvtNeg" 61626 "Fid_PCRGvnrDvtPos" 61627 "Fid_PCRSurgeLIGov" 61628 "Fid_PCR_MS" 61629 "Fid_PCR_SurgeDet" 61630 "Fid_PCVCDCalcI" 61631 "Fid_PFltAshCor" 61632 "Fid_PFltAshCorRgn" 61633 "Fid_PFltBrk" 61634 "Fid_PFltChar" 61635 "Fid_PFltChngPar" 61636 "Fid_PFltClth" 61637 "Fid_PFltDiagRls1" 61638 "Fid_PFltDiagRls2" 61639 "Fid_PFltDynChk" 61640 "Fid_PFltEngPrtRgnMon" 61641 "Fid_PFltGearDet" 61642 "Fid_PFltHsLnChk" 61643 "Fid_PFltLckRgnErr" 61644 "Fid_PFltLckRgnFuel" 61645 "Fid_PFltNumPFltErr" 61646 "Fid_PFltNumPFltErrLck" 61647 "Fid_PFltPPreErr" 61648 "Fid_PFltPlausPres" 61649 "Fid_PFltPlausTemp" 61650 "Fid_PFltPresPlausProj" 61651 "Fid_PFltPresSensFrz" 61652 "Fid_PFltPresSensHsLn" 61653 "Fid_PFltSRCPres" 61654 "Fid_PFltSRCTemp" 61655 "Fid_PFltSimOn" 61656 "Fid_PFltSpdVeh" 61657 "Fid_PFltTempAir" 61658 "Fid_PFltTempClnt" 61659 "Fid_PFltTempOxiPre" 61660 "Fid_PFltTempPre" 61661 "Fid_PFltTempSensFrz" 61662 "Fid_PFltVltgBatt" 61663 "Fid_RailCDRPSErrChk" 61664 "Fid_RailCDSubstVal" 61665 "Fid_RailCD_PMonStrt" 61666 "Fid_RailCtlMode" 61667 "Fid_RailMeUn0Blk" 61668 "Fid_RailMeUn0Rls" 61669 "Fid_RailMeUn1Blk" 61670 "Fid_RailMeUn1Rls" 61671 "Fid_RailMeUn2Blk" 61672 "Fid_RailMeUn2Rls" 61673 "Fid_RailMeUn3Blk" 61674 "Fid_RailMeUn3Rls" 61675 "Fid_RailMeUn4Blk" 61676 "Fid_RailMeUn4Rls" 61677 "Fid_RailMeUnCtlMode" 61678 "Fid_RailPCV0Blk" 61679 "Fid_RailPCV0Rls" 61680 "Fid_RailPCV1Blk" 61681 "Fid_RailPCV1Rls" 61682 "Fid_RailPCV2Blk" 61683 "Fid_RailPCV2Rls" 61684 "Fid_RailPCV3Blk" 61685 "Fid_RailPCV3Rls" 61686 "Fid_RailPCV4Blk" 61687 "Fid_RailPCV4Rls" 61688 "Fid_RailPCV5Blk" 61689 "Fid_RailPCV5Rls" 61690 "Fid_RailPCVCtlMode" 61691 "Fid_RailSetPointLim" 61692 "Fid_RailSetPointRed" 61693 "Fid_ShuttrCTS" 61694 "Fid_ShuttrEGS" 61695 "Fid_SignalsTstNLim" 61696 "Fid_StSysImmo" 61697 "Fid_StSysStrtTipGbxDat" 61698 "Fid_T15CDCanError" 61699 "Fid_T50CDSig" 61700 "Fid_UsrDa_FDCOff" 61701 "Fid_VehDaDist" 61702 "Fid_ZFCClbActv" 61703 "Fid_ZFCCldCmbCham" /end COMPU_VTAB
/begin COMPU_METHOD LengthKm "Länge in Kilometer" RAT_FUNC "%6.2" "km" COEFFS 0 1 0 0 0 1 /end COMPU_METHOD
/begin COMPU_METHOD Mil "Verbale Umrechnung für DSM_Class%Mil_C" TAB_VERB "%6.3" "-" COMPU_TAB_REF Mil /end COMPU_METHOD
/begin COMPU_VTAB Mil "Verbale Umrechnung für DSM_Class%Mil_C" TAB_VERB 3 0 "Mil OFF" 1 "Mil ON" 2 "Mil BLINK" /end COMPU_VTAB
/begin COMPU_METHOD NumPinAdc "verbale Umrechnung für ADC Signale" TAB_VERB "%6.3" "-" COMPU_TAB_REF NumPinAdc /end COMPU_METHOD
/begin COMPU_VTAB NumPinAdc "verbale Umrechnung für ADC Signale" TAB_VERB 25 0 "Water_Temperature_Sensor_182" 1 "Intake_Air_Temperature_Sensor_157" 2 "Charge_Air_Temperature_Sensor_183" 3 "Exhaust_Temperature_Sensor_2_134" 4 "Exhaust_Temperature_Sensor_1_158" 5 "1st_APP_Sensor_252" 6 "2nd_APP_Sensor_239" 7 "ADC_REF" 8 "Boost_Pressure_Sensor_154" 9 "Atmospheric_Pressure_Sensor" 10 "Battery_Voltage_Sensor" 11 "Rail_Pressure_Sensor_156" 12 "Rail_Pressure_Peak_Value_156" 13 "Booster_Voltage_Sensor" 14 "Current_MeUn_Sensor" 15 "Current_PCV_Sensor" 16 "Voltage_Bank_1" 17 "Voltage_Bank_2" 18 "Pressure_Upstream_Particle_Filter_159" 19 "Engine_Oil_Pressure_110" 20 "Temperature_ECU_PCB" 21 "Voltage_Lambda_Ua" 22 "Voltage_Lambda_Ri" 23 "ADC_DUMMY_NOT_USED" 24 "ADC_DUMMY_A_NOT_USED" /end COMPU_VTAB
/begin COMPU_METHOD OneToOne "eins zu eins (physikalischer Wert ist gleich dem internen Wert)" RAT_FUNC "%6.2" "-" COEFFS 0 1 0 0 0 1 /end COMPU_METHOD
/begin COMPU_METHOD Per_Dur "Periodendauer Segmentzeit" RAT_FUNC "%6.2" "usec" COEFFS 0 1 0 0 0 1 /end COMPU_METHOD
/begin COMPU_METHOD Prc "Prozent, gleiche interne Auflösung wie Fact, aber Darstellung in Prozent (0...100%)" RAT_FUNC "%6.4" "%" COEFFS 0 81.92 0 0 0 1 /end COMPU_METHOD
/begin COMPU_METHOD Readiness "Verbale Umrechnung für DSM_Class%Readiness_C" TAB_VERB "%6.3" "-" COMPU_TAB_REF Readiness /end COMPU_METHOD
/begin COMPU_VTAB Readiness "Verbale Umrechnung für DSM_Class%Readiness_C" TAB_VERB 8 0 "non" 1 "EGR system monitoring" 2 "catalyst monitoring" 4 "misfire monitoring" 8 "fuel system" 16 "comprehensive components" 32 "oxygen sensor" 64 "oxygen sensor heater" /end COMPU_VTAB
/begin COMPU_METHOD ResErf "Verbale Umrechnung für DSM_Class%ResErf_C" TAB_VERB "%6.3" "-" COMPU_TAB_REF ResErf /end COMPU_METHOD
/begin COMPU_VTAB ResErf "Verbale Umrechnung für DSM_Class%ResErf_C" TAB_VERB 4 0 "no Reset" 1 "Reset on Init" 2 "Reset on Restart" 3 "Reset on Init or Restart" /end COMPU_VTAB
/begin COMPU_METHOD RmpTemp "Rampengradient für Temperatur" RAT_FUNC "%6.4" "deg C/s" COEFFS 0 655.36 0 0 0 1 /end COMPU_METHOD
/begin COMPU_METHOD RmpTempCels "temperature ramp gradient in Centigrade" RAT_FUNC "%8.7" "C/ms" COEFFS 0 655360 0 0 0 1 /end COMPU_METHOD
/begin COMPU_METHOD RmpTransR "Umrechnung für die Rampensteigung des Triebstrangübersetzungverhältnisses" RAT_FUNC "%6.5" "1/s" COEFFS 0 6553.6 0 0 0 1 /end COMPU_METHOD
/begin COMPU_METHOD Scatt "Verbale Umrechnugn für DSM_Class%Scatt_C" TAB_VERB "%6.3" "-" COMPU_TAB_REF Scatt /end COMPU_METHOD
/begin COMPU_VTAB Scatt "Verbale Umrechnugn für DSM_Class%Scatt_C" TAB_VERB 2 0 "not visible for OBD-Tester" 1 "visible for OBD-Tester" /end COMPU_VTAB
/begin COMPU_METHOD SigName "Verbale Umrechnung für Signal Referenz Nummern" TAB_VERB "%6.3" "-" COMPU_TAB_REF SigName /end COMPU_METHOD
/begin COMPU_VTAB SigName "Verbale Umrechnung für Signal Referenz Nummern" TAB_VERB 118 0 "Sig_unused" 4 "CoEng_rTrq__Carb_r_DLen1" 5 "CTSCD_tClntLin__Carb_t_DLen1" 11 "BPSCD_pLin__Carb_p_DLen1" 12 "Eng_nAvrg__Carb_n_DLen2" 13 "VSSCD_vSensVal__Carb_v_DLen1" 15 "AFSCD_tAir_mp__Carb_t_DLen1" 16 "AFSCD_dmAirRawPerTime__Carb_mAirTim_DLen2" 28 "Signals_PID0x1C_C__OneToOne_DLen1" 33 "DSMDur_ctDfctDur1__Carb_l_DLen2" 128 "AFSCD_dmAirPerTime__mAirTim_DLen2" 129 "AFSCD_mAirPerCyl__mAirCyl_DLen2" 131 "AFSCD_rAir__dcyc_DLen2" 133 "AOHtCD_rOut_mp__dcyc_DLen2" 134 "APPCD_rFlt__r_DLen2" 137 "APPCD_uRawAPP1__u_DLen2" 138 "APPCD_uRawAPP2__u_DLen2" 139 "APSCD_pVal__p_DLen2" 140 "APSCD_uRaw__u_DLen2" 141 "AirCtl_mDesVal__mAirCyl_DLen2" 142 "AltCD_rAltLoad__r_DLen2" 143 "BPACD_rOut__dcyc_DLen2" 145 "BPSCD_pOutVal__p_DLen2" 146 "BPSCD_uRawVal__u_DLen2" 147 "BattCD_u__uBatt_DLen2" 148 "CBACD_stLogicOut_mp__OneToOne_DLen1" 149 "CTSCD_tClnt__t_DLen2" 150 "CTSCD_uRaw__u_DLen2" 151 "CoEng_trq__trq_DLen2" 152 "EBAFCD_stSigOut__OneToOne_DLen1" 153 "EGRCD_rOut__dcyc_DLen2" 155 "EGT_st__ShftRght0Byte_DLen2" 156 "EngM_stOut__OneToOne_DLen1" 157 "EngM_stSync__OneToOne_DLen1" 158 "Eng_nAvrg__n_DLen2" 159 "FMTC_trqInr__trq_DLen2" 160 "FTSCD_tFuel__t_DLen2" 161 "FTSCD_uRaw__u_DLen2" 162 "FanCD_dcycRaw_mp__dcyc_DLen2" 163 "FlFCD_stFlFltRawVal__OneToOne_DLen1" 164 "FrmMng_nPSP__nPSPSpd_DLen2" 165 "FrmMng_rPSPSetPoint__r_DLen2" 166 "GlwCtl_rPwrOut__OneToOne_DLen1" 167 "GlwCtl_stLampOut__OneToOne_DLen1" 168 "HWEMon_numRecovery__ShftRght0Byte_DLen2" 169 "HWEMon_numRecovery__ShftRght1Byte_DLen2" 170 "HWEMon_recLocLow_mp__ShftRght0Byte_DLen2" 171 "HWEMon_recLocLow_mp__ShftRght1Byte_DLen2" 172 "HWEMon_recLocHigh_mp__ShftRght0Byte_DLen2" 173 "IATSCD_tAir__t_DLen2" 174 "IATSCD_tAirCats__t_DLen2" 176 "IATSCD_uRawCats__u_DLen2" 178 "Tn_abstell__DezUwQ1_DLen2" 179 "U_gen__UUwQ0p1_DLen2" 181 "InjCtl_qCurr__qInjMassCyc_DLen2" 182 "InjCtl_qSetUnBal__qInjMassCyc_DLen2" 183 "LIGov_nSetpoint__n_DLen2" 184 "LIGov_trq__trq_DLen2" 185 "LPACD_rOut__dcyc_DLen2" 186 "LSUCD_rO2Raw[0]__O2_DLen2" 187 "LSUCD_uO2Raw[0]__u_DLen2" 188 "LSU_rLmbd[0]__Lambda_DLen2" 189 "LSU_rO2Adpt[0]__O2_DLen2" 190 "MeUnCD_dcycOut_mp__dcyc_DLen2" 191 "OPSCD_stSigOut__OneToOne_DLen1" 192 "OPSCD_stpOEL__OneToOne_DLen1" 193 "OTSCD_tEngOil__t_DLen2" 194 "OxiCCD_tPre__tExhaustgas_DLen2" 196 "OxiCCD_uRawTempPre__u_DLen2" 198 "PCR_pDesVal__p_DLen2" 199 "PCVCD_dcycOut_mp__dcyc_DLen2" 200 "PFltCD_pPre__p_DLen2" 202 "PFltCD_tPre__tExhaustgas_DLen2" 204 "PFltCD_uRawPresPre_mp__u_DLen2" 206 "PFltCD_uRawTempPre__u_DLen2" 208 "PFlt_dvol__volph_DLen2" 209 "PFlt_lSnceRgnu16_mp__lenrgnu16PFlt_DLen2" 211 "PFlt_mAshOil__mSoot_DLen2" 212 "PFlt_mSot__mSoot_DLen2" 213 "PFlt_mSotSim__mSoot_DLen2" 214 "PFlt_numEngPOp__OneToOne_DLen1" 215 "PFlt_numRgn_mp__OneToOne_DLen1" 216 "PFlt_pDiff__p_DLen2" 217 "PFlt_qFl_mp__FlConPFlt_DLen2" 219 "PFlt_stEngPOp__OneToOne_DLen1" 220 "PFlt_stIntr_mp__OneToOne_DLen1" 221 "PFlt_stLck_mp__OneToOne_DLen1" 222 "PSPCD_dvolOut__FlCon_DLen2" 223 "RailCD_pPeak__pRail_DLen2" 224 "RailCD_uPeakRaw__u_DLen2" 225 "Rail_pSetPoint__pRail_DLen2" 226 "TVACD_rOut__dcyc_DLen2" 228 "VSACD_rOut__dcyc_DLen2" 229 "VSSCD_v__v_DLen2" 230 "VehDa_tiEngOn__timEng_DLen2" 231 "PFlt_pPreCorr_mp__p_DLen2" 232 "PFlt_stPresPlaus_mp__OneToOne_DLen1" 234 "EGPpCD_stActrOut__OneToOne_DLen1" 236 "OvRMon_tiTDCAvrg__InjTim_DLen2" 237 "OvRMon_tiOvRMonActive_mp__tims_DLen2" 238 "CoEng_trqInrSet__trq_DLen2" 239 "InjCtl_qSet__qInjMassCyc_DLen2" 240 "Absch_korr__FSwQ0p00153_DLen2" 241 "D_soc__FSwB100_DLen2" 242 "I_batt__IUwQ0p08O200_DLen2" 243 "Oz_oelkm__KmUwQ10_DLen2" 244 "Oz_oelnivkurz__TdUbQ0p5_DLen1" 245 "Oz_oelnivnorm__TdUbQ0p5_DLen1" 246 "Oz_oelnivori__TdUbQ0p5_DLen1" 247 "Pm_klemmstat__DezUbQ1_DLen1" 248 "Stat_sv_reg1__DezUbQ1_DLen1" 249 "Stat_sv_reg2__DezUbQ1_DLen1" 250 "T2histshort__TdUbQ14p9333_DLen1" 251 "T3histshort__TdUbQ14p9333_DLen1" 252 "T4histshort__TdUbQ14p9333_DLen1" 253 "Toel__TSwQ0p1_DLen2" 254 "T_batt__TSwQ0p1_DLen2" 255 "U_batt__UUwQ0p25em3_DLen2" /end COMPU_VTAB
/begin COMPU_METHOD SlopeRes1000 "Umrechnung für Slope: Slopewert mit Verhältnis 0,001" RAT_FUNC "%6.5" "-" COEFFS 0 1000 0 0 0 1 /end COMPU_METHOD
/begin COMPU_METHOD SysLamp "Verbale Umrechnung für DSM_Class%SysLamp_C" TAB_VERB "%6.3" "-" COMPU_TAB_REF SysLamp /end COMPU_METHOD
/begin COMPU_VTAB SysLamp "Verbale Umrechnung für DSM_Class%SysLamp_C" TAB_VERB 3 0 "SysLamp OFF" 1 "SysLamp ON" 2 "SysLamp BLINK" /end COMPU_VTAB
/begin COMPU_METHOD SysLampMode "Verbale Umrechnung für DSM_SysLampMode_C" TAB_VERB "%6.3" "-" COMPU_TAB_REF SysLampMode /end COMPU_METHOD
/begin COMPU_VTAB SysLampMode "Verbale Umrechnung für DSM_SysLampMode_C" TAB_VERB 3 0 "controlled by FCM Statemachine" 1 "controlled by entry defect Status" 2 "controlled by dfp Status" /end COMPU_VTAB
/begin COMPU_METHOD t20msxs_ub_b5p1 "K3 Umwandlungen" RAT_FUNC "%6.4" "s" COEFFS 0 1 0 0 0 0.02 /end COMPU_METHOD
/begin COMPU_METHOD TempCels_100ms "Temperatur Differenz in Grad C/sec (bezgl. 100ms task)" RAT_FUNC "%6.2" "deg C/s" COEFFS 0 1 0 0 0 1 /end COMPU_METHOD
/begin COMPU_METHOD TempDiff_Cels "difference/offset temperature displayed in degree celcius" RAT_FUNC "%6.3" "deg C" COEFFS 0 10 0 0 0 1 /end COMPU_METHOD
/begin COMPU_METHOD Temp_Cels "Temperatur dargestellt in °C (gleiche interne Darstellung wie Temp_Kelv)" RAT_FUNC "%6.1" "deg C" COEFFS 0 10 2731.4 0 0 1 /end COMPU_METHOD
/begin COMPU_METHOD TimeDelay_s "Zeitkonstante T1 (in s) für PT1, DT1, etc." RAT_FUNC "%9.3" "s" COEFFS 0 0 1 0 0.00023283064365387 0 /end COMPU_METHOD
/begin COMPU_METHOD TimeDsmDC "Skalierung Zeit DSM Driving cycle Verzögerung" RAT_FUNC "%6.2" "s" COEFFS 0 1 0 0 0 1 /end COMPU_METHOD
/begin COMPU_METHOD TimeDT "Abtastzeit (in us) für Library Regler, Filter, etc." RAT_FUNC "%6.2" "us" COEFFS 0 1 0 0 0 1 /end COMPU_METHOD
/begin COMPU_METHOD Time_ms "Zeit in ms für Fehlerentprellung (DSM) und SW-Timer" RAT_FUNC "%6.1" "ms" COEFFS 0 0.1 0 0 0 1 /end COMPU_METHOD
/begin COMPU_METHOD TransR "Übersetzungsverhältnis (Getriebe etc.)" RAT_FUNC "%6.4" "-" COEFFS 0 100 0 0 0 1 /end COMPU_METHOD
/begin COMPU_METHOD Vel "Fahrzeuggeschwindigkeit, gleiche interne Auflösung wie Vel_SI" RAT_FUNC "%6.4" "km/h" COEFFS 0 100 0 0 0 1 /end COMPU_METHOD
/begin COMPU_METHOD Vel_mph "vehicle speed in mph" RAT_FUNC "%6.4" "mph" COEFFS 0 100 0 0 0 1 /end COMPU_METHOD
/begin COMPU_METHOD Volt "Spannung in V (von ADC)" RAT_FUNC "%6.2" "mV" COEFFS 0 0.2046 0 0 0 1 /end COMPU_METHOD
/begin COMPU_METHOD Volt_Batt "Batteriespannung" RAT_FUNC "%6.1" "mV" COEFFS 0 0.05115 0 0 0 1 /end COMPU_METHOD
/begin RECORD_LAYOUT Kl_Xs16_Ws16 NO_AXIS_PTS_X 1 SWORD AXIS_PTS_X 2 SWORD INDEX_INCR DIRECT FNC_VALUES 3 SWORD COLUMN_DIR DIRECT /end RECORD_LAYOUT
/begin RECORD_LAYOUT Kwb_Wu16 FNC_VALUES 1 UWORD COLUMN_DIR DIRECT /end RECORD_LAYOUT
/begin RECORD_LAYOUT Kwb_Wu8 FNC_VALUES 1 UBYTE COLUMN_DIR DIRECT /end RECORD_LAYOUT
/begin RECORD_LAYOUT KwWU16 FNC_VALUES 1 UWORD COLUMN_DIR DIRECT /end RECORD_LAYOUT
/begin RECORD_LAYOUT KwWU8 FNC_VALUES 1 UBYTE COLUMN_DIR DIRECT /end RECORD_LAYOUT
/begin RECORD_LAYOUT Kw_Ws16 FNC_VALUES 1 SWORD COLUMN_DIR DIRECT /end RECORD_LAYOUT
/begin RECORD_LAYOUT Kw_Ws32 FNC_VALUES 1 SLONG COLUMN_DIR DIRECT /end RECORD_LAYOUT
/begin RECORD_LAYOUT Kw_Wu16 FNC_VALUES 1 UWORD COLUMN_DIR DIRECT /end RECORD_LAYOUT
/begin RECORD_LAYOUT Kw_Wu32 FNC_VALUES 1 ULONG COLUMN_DIR DIRECT /end RECORD_LAYOUT
/begin RECORD_LAYOUT Kw_Wu8 FNC_VALUES 1 UBYTE COLUMN_DIR DIRECT /end RECORD_LAYOUT
/end MODULE
/end PROJECT
