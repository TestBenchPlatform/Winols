ASAP2_VERSION 1 3
/begin PROJECT P389 "BMW DDE6.0 4-Zylinder V53.4 01.04.2004 CAN12H"
/begin HEADER "" VERSION "V53.4_4Z_CAN12H" PROJECT_NO P389 /end HEADER
/begin MODULE DIM ""
/begin MOD_COMMON "" BYTE_ORDER MSB_FIRST ALIGNMENT_BYTE 1 ALIGNMENT_WORD 2 ALIGNMENT_LONG 4 ALIGNMENT_FLOAT32_IEEE 4 /end MOD_COMMON
/begin CHARACTERISTIC K_ABKORROVER "schlechter absch_korr Schwelle ueberschritten" VALUE 0x000C233A TKW_VV_VV_SW 100.0 Def_f_sw_q0p00153 -50.0000 49.9984 /begin FUNCTION_LIST PMDIAG /end FUNCTION_LIST FORMAT "%6.3" /end CHARACTERISTIC
/begin CHARACTERISTIC K_DSOCHYSTCC "DSOC Hyst. fuer B_ccbtnach reset " VALUE 0x000C233C TKW_VV_VV_SW 100.0 Def_f_sw_b100 -100.0000 99.9969 /begin FUNCTION_LIST PMDIAG /end FUNCTION_LIST FORMAT "%6.3" /end CHARACTERISTIC
/begin CHARACTERISTIC K_DSOCLOW "DSOC Grenze f. CCmeld Batt Nachladen" VALUE 0x000C233E TKW_VV_VV_SW 100.0 Def_f_sw_b100 -100.0000 99.9969 /begin FUNCTION_LIST PMDIAG /end FUNCTION_LIST FORMAT "%6.3" /end CHARACTERISTIC
/begin CHARACTERISTIC K_OSPGHYST "Unterspannungshysterese" VALUE 0x000C2340 TKW_VV_VV_SW 100.0 Def_u_sw_q0p00025 -8.1920 8.1917 /begin FUNCTION_LIST PMDIAG /end FUNCTION_LIST FORMAT "%7.4" /end CHARACTERISTIC
/begin CHARACTERISTIC K_USPGHYST "Unterspannungshysterese" VALUE 0x000C2342 TKW_VV_VV_SW 100.0 Def_u_sw_q0p00025 -8.1920 8.1917 /begin FUNCTION_LIST PMDIAG /end FUNCTION_LIST FORMAT "%7.4" /end CHARACTERISTIC
/begin CHARACTERISTIC K_CCPWRSET "ctrpwrcos Schwelle ab dem CC Meldung aktiviert wird. " VALUE 0x000C2344 TKW_VV_VV_UW 100.0 Def_dez_uw_q1 0.0 65535.0000 /begin FUNCTION_LIST PMDIAG /end FUNCTION_LIST /end CHARACTERISTIC
/begin CHARACTERISTIC K_OSPGAPP "Oberspannungsschwelle" VALUE 0x000C2346 TKW_VV_VV_UW 100.0 Def_u_uw_q0p25em3_o6 6.0000 22.3837 /begin FUNCTION_LIST PMDIAG /end FUNCTION_LIST FORMAT "%7.4" /end CHARACTERISTIC
/begin CHARACTERISTIC K_T2PMINFO "T2 Zykluszeit fuer PM Fehlerinfo" VALUE 0x000C2348 TKW_VV_VV_UW 100.0 Def_td_uw_q0p1 0.0 6553.5000 /begin FUNCTION_LIST PMDIAG /end FUNCTION_LIST FORMAT "%4.1" /end CHARACTERISTIC
/begin CHARACTERISTIC K_T3PMINFO "T3 Zykluszeit fuer PM Fehlerinfo" VALUE 0x000C234A TKW_VV_VV_UW 100.0 Def_td_uw_q0p1 0.0 6553.5000 /begin FUNCTION_LIST PMDIAG /end FUNCTION_LIST FORMAT "%4.1" /end CHARACTERISTIC
/begin CHARACTERISTIC K_TBATNACHL "B_ccbtnach wird nach dieser Zeit aktiviert" VALUE 0x000C234C TKW_VV_VV_UW 100.0 Def_td_uw_q0p1 0.0 6553.5000 /begin FUNCTION_LIST PMDIAG /end FUNCTION_LIST FORMAT "%4.1" /end CHARACTERISTIC
/begin CHARACTERISTIC K_T_CCRUHVER "Dauer fuer CC-Meld. erhoehter Ruhestrom" VALUE 0x000C234E TKW_VV_VV_UW 100.0 Def_td_uw_q0p1 0.0 6553.5000 /begin FUNCTION_LIST PMDIAG /end FUNCTION_LIST FORMAT "%4.1" /end CHARACTERISTIC
/begin CHARACTERISTIC K_T_KMSHIFT "Delayzeit für Km_st Info-shift" VALUE 0x000C2350 TKW_VV_VV_UW 100.0 Def_td_uw_q0p1 0.0 6553.5000 /begin FUNCTION_LIST PMDIAG /end FUNCTION_LIST FORMAT "%4.1" /end CHARACTERISTIC
/begin CHARACTERISTIC K_USPGAPP "Unterspannungschwelle" VALUE 0x000C2352 TKW_VV_VV_UW 100.0 Def_u_uw_q0p25em3_o6 6.0000 22.3837 /begin FUNCTION_LIST PMDIAG /end FUNCTION_LIST FORMAT "%7.4" /end CHARACTERISTIC
/begin CHARACTERISTIC CW_CCMASK "CC-Meldung Maske" VALUE 0x000C2354 TKW_VV_VV_UB 100.0 Def_dez_ub_q1 0.0 255.0000 /begin FUNCTION_LIST PMDIAG /end FUNCTION_LIST /end CHARACTERISTIC
/begin CHARACTERISTIC CW_PMDEFMASK "Bitcodierte Maske zum Setzen von PM Defekt" VALUE 0x000C2355 TKW_VV_VV_UB 100.0 Def_dez_ub_q1 0.0 255.0000 /begin FUNCTION_LIST PMDIAG /end FUNCTION_LIST /end CHARACTERISTIC
/begin CHARACTERISTIC K_BATTINDAPP "batt_index appl." VALUE 0x000C2356 TKW_VV_VV_UB 100.0 Def_dez_ub_q1 0.0 255.0000 /begin FUNCTION_LIST PMDIAG /end FUNCTION_LIST /end CHARACTERISTIC
/begin CHARACTERISTIC K_BATTREGAPP "Batterietauschregristrieren App" VALUE 0x000C2357 TKW_VV_VV_UB 100.0 Def_dez_ub_q1 0.0 255.0000 /begin FUNCTION_LIST PMDIAG /end FUNCTION_LIST /end CHARACTERISTIC
/begin CHARACTERISTIC K_CBATTAPP "Cbattnenn appl." VALUE 0x000C2358 TKW_VV_VV_UB 100.0 Def_ql_ub_q1 0.0 255.0000 /begin FUNCTION_LIST PMDIAG /end FUNCTION_LIST /end CHARACTERISTIC
/begin CHARACTERISTIC K_CCPRIOSET "Schwelle von E65Prios ab dem ccmeldung aktiv ist." VALUE 0x000C2359 TKW_VV_VV_UB 100.0 Def_dez_ub_q1 0.0 7.0000 /begin FUNCTION_LIST PMDIAG /end FUNCTION_LIST /end CHARACTERISTIC
/begin CHARACTERISTIC K_CCPRIOTIME "Zeitverschiebung bis ccmeldung gesetzt wird." VALUE 0x000C235A TKW_VV_VV_UB 100.0 Def_td_ub_q0p1 0.0 25.5000 /begin FUNCTION_LIST PMDIAG /end FUNCTION_LIST /end CHARACTERISTIC
/begin CHARACTERISTIC K_HISTDMERST "Manueller Reset d. Histogramm in der DME" VALUE 0x000C235B TKW_VV_VV_UB 100.0 Def_dez_ub_q1 0.0 255.0000 /begin FUNCTION_LIST PMDIAG /end FUNCTION_LIST /end CHARACTERISTIC
/begin CHARACTERISTIC K_HISTIBSRST "Manueller Histogramm Reset in IBS" VALUE 0x000C235C TKW_VV_VV_UB 100.0 Def_dez_ub_q1 0.0 255.0000 /begin FUNCTION_LIST PMDIAG /end FUNCTION_LIST /end CHARACTERISTIC
/begin CHARACTERISTIC K_IWAKEAPP "Wakeupgrenze Appl." VALUE 0x000C235D TKW_VV_VV_UB 100.0 Def_i_ub_q0p00125 0.0 0.2550 /begin FUNCTION_LIST PMDIAG /end FUNCTION_LIST /end CHARACTERISTIC
/begin CHARACTERISTIC K_KSOGRZAPP "Ikurz_ogrz appl." VALUE 0x000C235E TKW_VV_VV_UB 100.0 Def_i_ub_q5p12 0.0 998.4000 /begin FUNCTION_LIST PMDIAG /end FUNCTION_LIST /end CHARACTERISTIC
/begin CHARACTERISTIC K_KSUGRZAPP "Ikurz_ugrz Appl." VALUE 0x000C235F TKW_VV_VV_UB 100.0 Def_i_ub_q5p12 0.0 1000.0000 /begin FUNCTION_LIST PMDIAG /end FUNCTION_LIST /end CHARACTERISTIC
/begin CHARACTERISTIC K_OSPGPRELLZ "Anzahl der Entprellungen für Oberspannungsfehlereintrag" VALUE 0x000C2360 TKW_VV_VV_UB 100.0 Def_dez_ub_q1 0.0 255.0000 /begin FUNCTION_LIST PMDIAG /end FUNCTION_LIST /end CHARACTERISTIC
/begin CHARACTERISTIC K_OSPRELLDEC "Dekrement auf Entprellcounter Oberspannung" VALUE 0x000C2361 TKW_VV_VV_UB 100.0 Def_dez_ub_q1 0.0 255.0000 /begin FUNCTION_LIST PMDIAG /end FUNCTION_LIST /end CHARACTERISTIC
/begin CHARACTERISTIC K_OSPRELLINC "Inkrement auf Entprellcounter Oberspannung" VALUE 0x000C2362 TKW_VV_VV_UB 100.0 Def_dez_ub_q1 0.0 255.0000 /begin FUNCTION_LIST PMDIAG /end FUNCTION_LIST /end CHARACTERISTIC
/begin CHARACTERISTIC K_RUHVERMODE "Ruhestromverletzungserkennungsmode" VALUE 0x000C2363 TKW_VV_VV_UB 100.0 Def_dez_ub_q1 0.0 255.0000 /begin FUNCTION_LIST PMDIAG /end FUNCTION_LIST /end CHARACTERISTIC
/begin CHARACTERISTIC K_T1PMINFO "T1 Zykluszeit fuer PM Fehlerinfo" VALUE 0x000C2364 TKW_VV_VV_UB 100.0 Def_td_ub_q0p1 0.0 25.5000 /begin FUNCTION_LIST PMDIAG /end FUNCTION_LIST /end CHARACTERISTIC
/begin CHARACTERISTIC K_TCODIERPM "T1 Zyklus fuer Fehlerinfo" VALUE 0x000C2365 TKW_VV_VV_UB 100.0 Def_td_ub_q0p1 0.0 25.5000 /begin FUNCTION_LIST PMDIAG /end FUNCTION_LIST /end CHARACTERISTIC
/begin CHARACTERISTIC K_TRINGSHIFT "Ruhezeit nachdem der Ruhestrom-Ringspeicher eingetragen wird." VALUE 0x000C2366 TKW_VV_VV_UB 100.0 Def_td_ub_q0p9333 0.0 238.0000 /begin FUNCTION_LIST PMDIAG /end FUNCTION_LIST /end CHARACTERISTIC
/begin CHARACTERISTIC K_T_OSPGRSET "Zeit für 1x Oberspannungsentprellungrücknahme" VALUE 0x000C2367 TKW_VV_VV_UB 100.0 Def_td_ub_q0p1 0.0 25.5000 /begin FUNCTION_LIST PMDIAG /end FUNCTION_LIST /end CHARACTERISTIC
/begin CHARACTERISTIC K_T_OSPGSET "Entrpellzeit FS_oberspannungserkennung" VALUE 0x000C2368 TKW_VV_VV_UB 100.0 Def_td_ub_q0p1 0.0 25.5000 /begin FUNCTION_LIST PMDIAG /end FUNCTION_LIST /end CHARACTERISTIC
/begin CHARACTERISTIC K_T_RUHAUSW "Minimal verstrichene Zeit für Ruheverl. Auswertung" VALUE 0x000C2369 TKW_VV_VV_UB 100.0 Def_td_ub_q0p9333 0.0 238.0000 /begin FUNCTION_LIST PMDIAG /end FUNCTION_LIST /end CHARACTERISTIC
/begin CHARACTERISTIC K_T_SQSHIFT "Delayzeit für Soc_quali Info-shift" VALUE 0x000C236A TKW_VV_VV_UB 100.0 Def_td_ub_q0p1 0.0 25.5000 /begin FUNCTION_LIST PMDIAG /end FUNCTION_LIST /end CHARACTERISTIC
/begin CHARACTERISTIC K_T_USPGRSET "Uterspannung Resetzeit" VALUE 0x000C236B TKW_VV_VV_UB 100.0 Def_td_ub_q0p1 0.0 25.5000 /begin FUNCTION_LIST PMDIAG /end FUNCTION_LIST /end CHARACTERISTIC
/begin CHARACTERISTIC K_T_USPGSET "Zeit für 1x Unterspannungsentprellung" VALUE 0x000C236C TKW_VV_VV_UB 100.0 Def_td_ub_q0p1 0.0 25.5000 /begin FUNCTION_LIST PMDIAG /end FUNCTION_LIST /end CHARACTERISTIC
/begin CHARACTERISTIC K_USPGPRELLZ "Anzahl der FS_uspg Entprellungen für Fehlereintrag" VALUE 0x000C236D TKW_VV_VV_UB 100.0 Def_dez_ub_q1 0.0 255.0000 /begin FUNCTION_LIST PMDIAG /end FUNCTION_LIST /end CHARACTERISTIC
/begin CHARACTERISTIC K_USPRELLDEC "Dekrement auf Entprellcounter Unterspannung" VALUE 0x000C236E TKW_VV_VV_UB 100.0 Def_dez_ub_q1 0.0 255.0000 /begin FUNCTION_LIST PMDIAG /end FUNCTION_LIST /end CHARACTERISTIC
/begin CHARACTERISTIC K_USPRELLINC "Inkrement auf Entprellcounter Unterspannung" VALUE 0x000C236F TKW_VV_VV_UB 100.0 Def_dez_ub_q1 0.0 255.0000 /begin FUNCTION_LIST PMDIAG /end FUNCTION_LIST /end CHARACTERISTIC
/begin CHARACTERISTIC S_PMSV_HEIZ "Standheizen wird für Nibble-historie ausgewertet" VALUE 0x000C2370 TKW_VV_VV_UB 100.0 Identity 0.0 1.0000 /begin FUNCTION_LIST PMDIAG /end FUNCTION_LIST /end CHARACTERISTIC
/begin CHARACTERISTIC S_PMSV_KLIMA "Standklimatisierung wird für Nibble-historie ausgewertet" VALUE 0x000C2371 TKW_VV_VV_UB 100.0 Identity 0.0 1.0000 /begin FUNCTION_LIST PMDIAG /end FUNCTION_LIST /end CHARACTERISTIC
/begin CHARACTERISTIC S_PMSV_LUFT "Standlueften wird für Nibble-historie ausgewertet" VALUE 0x000C2372 TKW_VV_VV_UB 100.0 Identity 0.0 1.0000 /begin FUNCTION_LIST PMDIAG /end FUNCTION_LIST /end CHARACTERISTIC
/begin CHARACTERISTIC KL_T4RELMXRG "Max Toleranzzeit von T4 Ringshift" CURVE 0x000C2374 TKL_UW_VV_UW 100.0 Def_td_uw_q14 0.0 917490.0000 /begin FUNCTION_LIST PMDIAG /end FUNCTION_LIST
 /begin AXIS_DESCR STD_AXIS T_histsum Def_td_uw_q56 6 0.0 3669960.0000 FORMAT "%5.2" /end AXIS_DESCR
 FORMAT "%5.2" /end CHARACTERISTIC
/begin CHARACTERISTIC KL_CLASS2NENN "Batterieklasse -> Batteriegroesse" CURVE 0x000C238E TKL_UB_VV_UB 100.0 Def_ql_ub_q1 0.0 255.0000 /begin FUNCTION_LIST PMDIAG /end FUNCTION_LIST /begin AXIS_DESCR STD_AXIS Batt_class Def_dez_ub_q1 8 0.0 255.0000 /end AXIS_DESCR /end CHARACTERISTIC
/begin CHARACTERISTIC KL_T2RELMXRG "Max Toleranzzeit von T2 Ringshift" CURVE 0x000C23A0 TKL_UW_VV_UW 100.0 Def_td_uw_q14 0.0 917490.0000 /begin FUNCTION_LIST PMDIAG /end FUNCTION_LIST
 /begin AXIS_DESCR STD_AXIS T_histsum Def_td_uw_q56 6 0.0 3669960.0000 FORMAT "%5.2" /end AXIS_DESCR
 FORMAT "%5.2" /end CHARACTERISTIC
/begin CHARACTERISTIC KL_T2RELMAX "Max Toleranzzeit von T2" CURVE 0x000C23BA TKL_UW_VV_UW 100.0 Def_td_uw_q14 0.0 917490.0000 /begin FUNCTION_LIST PMDIAG /end FUNCTION_LIST
 /begin AXIS_DESCR STD_AXIS T_histsum Def_td_uw_q56 6 0.0 3669960.0000 FORMAT "%5.2" /end AXIS_DESCR
 FORMAT "%5.2" /end CHARACTERISTIC
/begin CHARACTERISTIC KL_T3RELMAX "Max Toleranzzeit von T3" CURVE 0x000C23D4 TKL_UW_VV_UW 100.0 Def_td_uw_q14 0.0 917490.0000 /begin FUNCTION_LIST PMDIAG /end FUNCTION_LIST
 /begin AXIS_DESCR STD_AXIS T_histsum Def_td_uw_q56 6 0.0 3669960.0000 FORMAT "%5.2" /end AXIS_DESCR
 FORMAT "%5.2" /end CHARACTERISTIC
/begin CHARACTERISTIC KL_CLASS2IND "Batterieklasse -> Batterieindex" CURVE 0x000C23EE TKL_UB_VV_UB 100.0 Def_dez_ub_q1 0.0 255.0000 /begin FUNCTION_LIST PMDIAG /end FUNCTION_LIST /begin AXIS_DESCR STD_AXIS Batt_class Def_dez_ub_q1 8 0.0 255.0000 /end AXIS_DESCR /end CHARACTERISTIC
/begin CHARACTERISTIC KL_T3RELMXRG "Max Toleranzzeit von T3 Ringshift" CURVE 0x000C2400 TKL_UW_VV_UW 100.0 Def_td_uw_q14 0.0 917490.0000 /begin FUNCTION_LIST PMDIAG /end FUNCTION_LIST
 /begin AXIS_DESCR STD_AXIS T_histsum Def_td_uw_q56 6 0.0 3669960.0000 FORMAT "%5.2" /end AXIS_DESCR
 FORMAT "%5.2" /end CHARACTERISTIC
/begin CHARACTERISTIC KL_T4RELMAX "Max Toleranzzeit von T4" CURVE 0x000C241A TKL_UW_VV_UW 100.0 Def_td_uw_q14 0.0 917490.0000 /begin FUNCTION_LIST PMDIAG /end FUNCTION_LIST
 /begin AXIS_DESCR STD_AXIS T_histsum Def_td_uw_q56 6 0.0 3669960.0000 FORMAT "%5.2" /end AXIS_DESCR
 FORMAT "%5.2" /end CHARACTERISTIC
/begin CHARACTERISTIC CW_PMMASKDFP "Powermanagement Fehlerpseicher Maske" VALUE 0x000C2373 TKW_VV_VV_UB 100.0 Def_dez_ub_q1 0.0 255.0000 /begin FUNCTION_LIST PMDIAG /end FUNCTION_LIST /end CHARACTERISTIC
/begin CHARACTERISTIC K_DSOCPCOS "dsoc, unterhalb derer die Standverbraucher deaktiviert werden." VALUE 0x000C2434 TKW_VV_VV_SW 100.0 Def_f_sw_b100 -100.0000 99.9969 /begin FUNCTION_LIST PMPRSVCALC /end FUNCTION_LIST FORMAT "%6.3" /end CHARACTERISTIC
/begin CHARACTERISTIC K_NKW2HIPTC "Nkw i.O. PTC darf zugeschaltet werden." VALUE 0x000C2436 TKW_VV_VV_SW 100.0 Def_n_sw_q1p0 -32768.0000 32767.0000 /begin FUNCTION_LIST PMPRSVCALC /end FUNCTION_LIST /end CHARACTERISTIC
/begin CHARACTERISTIC K_NKW2LOWPTC "Nkw zu niedrig, PTC wird abgeschaltet" VALUE 0x000C2438 TKW_VV_VV_SW 100.0 Def_n_sw_q1p0 -32768.0000 32767.0000 /begin FUNCTION_LIST PMPRSVCALC /end FUNCTION_LIST /end CHARACTERISTIC
/begin CHARACTERISTIC K_DUDTPTCAUS "K-Faktor für dudt-PTC Abschaltung" VALUE 0x000C243A TKW_VV_VV_UW 100.0 Def_f_uw_b1 0.0 9.99984741210938e-1 /begin FUNCTION_LIST PMPRSVCALC /end FUNCTION_LIST /end CHARACTERISTIC
/begin CHARACTERISTIC K_IPMPMDEC "Prio-dekrementfaktor aufgrund IPM" VALUE 0x000C243C TKW_VV_VV_UW 100.0 Def_f_uw_q0p25 0.0 450.0000 /begin FUNCTION_LIST PMPRSVCALC /end FUNCTION_LIST FORMAT "%6.3" /end CHARACTERISTIC
/begin CHARACTERISTIC K_IPMPMINC "Prio-Inkrementfaktor aufgrund IPM" VALUE 0x000C243E TKW_VV_VV_UW 100.0 Def_f_uw_q0p25 0.0 450.0000 /begin FUNCTION_LIST PMPRSVCALC /end FUNCTION_LIST FORMAT "%6.3" /end CHARACTERISTIC
/begin CHARACTERISTIC K_MN_PTCPI "Minimalwert des PI-Reglers PTC Ansteuerung" VALUE 0x000C2440 TKW_VV_VV_UW 100.0 Def_f_uw_b512 0.0 511.9921 /begin FUNCTION_LIST PMPRSVCALC /end FUNCTION_LIST FORMAT "%6.3" /end CHARACTERISTIC
/begin CHARACTERISTIC K_MN_PWRDFPI "Minimaler Wert PI-Regler df Prio" VALUE 0x000C2442 TKW_VV_VV_UW 100.0 Def_f_uw_b512 0.0 511.9921 /begin FUNCTION_LIST PMPRSVCALC /end FUNCTION_LIST FORMAT "%6.3" /end CHARACTERISTIC
/begin CHARACTERISTIC K_MX_PTCPI "Maximalwert des PI-Reglers PTC Ansteuerung" VALUE 0x000C2444 TKW_VV_VV_UW 100.0 Def_f_uw_b512 0.0 511.9921 /begin FUNCTION_LIST PMPRSVCALC /end FUNCTION_LIST FORMAT "%6.3" /end CHARACTERISTIC
/begin CHARACTERISTIC K_PWRCOS15 "PWRCOS bei Kl.15, Motor aus" VALUE 0x000C2446 TKW_VV_VV_UW 100.0 Def_dez_uw_q1 0.0 65535.0000 /begin FUNCTION_LIST PMPRSVCALC /end FUNCTION_LIST /end CHARACTERISTIC
/begin CHARACTERISTIC K_PWRCOSAPP "Steuerung Leistung Verbraucher bitcodiert Applikationsgroesse" VALUE 0x000C2448 TKW_VV_VV_UW 100.0 Def_dez_uw_q1 0.0 65535.0000 /begin FUNCTION_LIST PMPRSVCALC /end FUNCTION_LIST /end CHARACTERISTIC
/begin CHARACTERISTIC K_PWRCOSHT "ctrpwrcos-Wert bei Generator Hochtemperatur" VALUE 0x000C244A TKW_VV_VV_UW 100.0 Def_dez_uw_q1 0.0 65535.0000 /begin FUNCTION_LIST PMPRSVCALC /end FUNCTION_LIST /end CHARACTERISTIC
/begin CHARACTERISTIC K_PWRCOSULEV "Bitcodierte ctrpwrcos Zuschaltung bei Sulev" VALUE 0x000C244C TKW_VV_VV_UW 100.0 Def_dez_uw_q1 0.0 65535.0000 /begin FUNCTION_LIST PMPRSVCALC /end FUNCTION_LIST /end CHARACTERISTIC
/begin CHARACTERISTIC K_PWRCOS_R "PowerCos Bitcodiert bei Kl.R" VALUE 0x000C244E TKW_VV_VV_UW 100.0 Def_dez_uw_q1 0.0 65535.0000 /begin FUNCTION_LIST PMPRSVCALC /end FUNCTION_LIST /end CHARACTERISTIC
/begin CHARACTERISTIC K_PWRCSGNDEF "ctrpwrcos-Wert bei Gen. mechn. el. Fehler" VALUE 0x000C2450 TKW_VV_VV_UW 100.0 Def_dez_uw_q1 0.0 65535.0000 /begin FUNCTION_LIST PMPRSVCALC /end FUNCTION_LIST /end CHARACTERISTIC
/begin CHARACTERISTIC K_PWRCSKOMM "ctrpwrcos Wert bei Gen. Komm. Fehler" VALUE 0x000C2452 TKW_VV_VV_UW 100.0 Def_dez_uw_q1 0.0 65535.0000 /begin FUNCTION_LIST PMPRSVCALC /end FUNCTION_LIST /end CHARACTERISTIC
/begin CHARACTERISTIC K_TD_PWRDFPI "K-Faktor des PI Reglers zur Berechnung von ctrpwrdf" VALUE 0x000C2454 TKW_VV_VV_UW 100.0 Def_td_uw_q0p1 0.1000 6553.5000 /begin FUNCTION_LIST PMPRSVCALC /end FUNCTION_LIST FORMAT "%4.1" /end CHARACTERISTIC
/begin CHARACTERISTIC K_T_PTCPI "T-Faktor des PI-Reglers für PTC-Ansteuerung" VALUE 0x000C2456 TKW_VV_VV_UW 100.0 Def_td_uw_q0p1 0.1000 6553.5000 /begin FUNCTION_LIST PMPRSVCALC /end FUNCTION_LIST FORMAT "%4.1" /end CHARACTERISTIC
/begin CHARACTERISTIC K_T_SULEVON "Zeit für SULEV-ctrpwrcos-prios nach Motorstart" VALUE 0x000C2458 TKW_VV_VV_UW 100.0 Def_td_uw_q0p1 0.0 6553.5000 /begin FUNCTION_LIST PMPRSVCALC /end FUNCTION_LIST FORMAT "%4.1" /end CHARACTERISTIC
/begin CHARACTERISTIC K_UBAT_LP "K-Faktor des ubatt-tiefpass Filters zur Berechnung von ctrpwrdf" VALUE 0x000C245A TKW_VV_VV_UW 100.0 Def_f_uw_b1 0.0 9.99984741210938e-1 /begin FUNCTION_LIST PMPRSVCALC /end FUNCTION_LIST /end CHARACTERISTIC
/begin CHARACTERISTIC K_UBPTC_LP "K-Faktor des ubatt-Tiefpass Filters zur Berechnung von PTC" VALUE 0x000C245C TKW_VV_VV_UW 100.0 Def_f_uw_b1 0.0 9.99984741210938e-1 /begin FUNCTION_LIST PMPRSVCALC /end FUNCTION_LIST /end CHARACTERISTIC
/begin CHARACTERISTIC K_UBTAPP "Batteriespannung Applikationsgroesse" VALUE 0x000C245E TKW_VV_VV_UW 100.0 Def_u_uw_q0p015 0.0 61.4250 /begin FUNCTION_LIST PMPRSVCALC /end FUNCTION_LIST FORMAT "%6.3" /end CHARACTERISTIC
/begin CHARACTERISTIC K_UBTLOWMAX "Obere Unterspannungsgrenze" VALUE 0x000C2460 TKW_VV_VV_UW 100.0 Def_u_uw_q0p25em3_o6 6.0000 16.0000 /begin FUNCTION_LIST PMPRSVCALC /end FUNCTION_LIST FORMAT "%7.4" /end CHARACTERISTIC
/begin CHARACTERISTIC K_UBTLOWMIN "Untere Unterspannungsgrenze" VALUE 0x000C2462 TKW_VV_VV_UW 100.0 Def_u_uw_q0p25em3_o6 6.0000 16.0000 /begin FUNCTION_LIST PMPRSVCALC /end FUNCTION_LIST FORMAT "%7.4" /end CHARACTERISTIC
/begin CHARACTERISTIC K_CTRCBRA "" VALUE 0x000C2490 TKW_VV_VV_UB 100.0 Def_dez_ub_q1 0.0 255.0000 /begin FUNCTION_LIST PMPRSVCALC /end FUNCTION_LIST /end CHARACTERISTIC
/begin CHARACTERISTIC K_CTRCBRAPP "Steuerung Stromzweige Applikationsgroesse" VALUE 0x000C2491 TKW_VV_VV_UB 100.0 Def_dez_ub_q1 0.0 255.0000 /begin FUNCTION_LIST PMPRSVCALC /end FUNCTION_LIST /end CHARACTERISTIC
/begin CHARACTERISTIC K_CTRCBRKBM "CTRCBR APP bei B_startfgk" VALUE 0x000C2492 TKW_VV_VV_UB 100.0 Def_dez_ub_q1 0.0 255.0000 /begin FUNCTION_LIST PMPRSVCALC /end FUNCTION_LIST /end CHARACTERISTIC
/begin CHARACTERISTIC K_CTRPCOSAPP "Steuerung Standverbraucher Applikationsgroesse" VALUE 0x000C2493 TKW_VV_VV_UB 100.0 Def_dez_ub_q1 0.0 3.0000 /begin FUNCTION_LIST PMPRSVCALC /end FUNCTION_LIST /end CHARACTERISTIC
/begin CHARACTERISTIC K_CTRPRIOAPP "Steuerung Spitzenreduzierung Prioritaet Applikationsgroesse" VALUE 0x000C2494 TKW_VV_VV_UB 100.0 Def_dez_ub_q1 0.0 7.0000 /begin FUNCTION_LIST PMPRSVCALC /end FUNCTION_LIST /end CHARACTERISTIC
/begin CHARACTERISTIC K_DFFILTAPP "Schalter, um dffgenfilt auf DFFILT_APP umzustellen" VALUE 0x000C2495 TKW_VV_VV_UB 100.0 Def_f_ub_b100 0.0 99.6093 /begin FUNCTION_LIST PMPRSVCALC /end FUNCTION_LIST /end CHARACTERISTIC
/begin CHARACTERISTIC K_DFKOMMERR "Ersatzwert Dffgen bei Gen. Komm. Fehler" VALUE 0x000C2496 TKW_VV_VV_UB 100.0 Def_f_ub_b100 0.0 99.6093 /begin FUNCTION_LIST PMPRSVCALC /end FUNCTION_LIST /end CHARACTERISTIC
/begin CHARACTERISTIC K_DFPTC_LP "K-Faktor des df-Tiefpass Filters zur Berechnung von PTC" VALUE 0x000C2497 TKW_VV_VV_UB 100.0 Def_f_ub_b1 0.0 0.9960 /begin FUNCTION_LIST PMPRSVCALC /end FUNCTION_LIST /end CHARACTERISTIC
/begin CHARACTERISTIC K_DF_LP "K-Faktor des df-Tiefpass Filters zur Berechnung von ctrpwrdf" VALUE 0x000C2498 TKW_VV_VV_UB 100.0 Def_f_ub_b1 0.0 0.9960 /begin FUNCTION_LIST PMPRSVCALC /end FUNCTION_LIST /end CHARACTERISTIC
/begin CHARACTERISTIC K_IBSWAKEAPP "Bit, ob IBS Bus wecken darf oder nicht. Applikationsgroesse." VALUE 0x000C2499 TKW_VV_VV_UB 100.0 Def_dez_ub_q1 0.0 255.0000 /begin FUNCTION_LIST PMPRSVCALC /end FUNCTION_LIST /end CHARACTERISTIC
/begin CHARACTERISTIC K_KBMCNT_APP "Zeit, indem KBM alle Straenge einschalten soll." VALUE 0x000C249A TKW_VV_VV_UB 100.0 Def_td_ub_q0p1 0.0 25.5000 /begin FUNCTION_LIST PMPRSVCALC /end FUNCTION_LIST /end CHARACTERISTIC
/begin CHARACTERISTIC K_LLPMFILTK "Filterkonstante : Tiefpassfilter DF-Signal" VALUE 0x000C249B TKW_VV_VV_UB 100.0 Def_f_ub_b1 0.0 0.9960 /begin FUNCTION_LIST PMPRSVCALC /end FUNCTION_LIST /end CHARACTERISTIC
/begin CHARACTERISTIC K_PM_IPMON "IPM Massnahmen bzgl. PM aktiviert" VALUE 0x000C249C TKW_VV_VV_UB 100.0 Def_dez_ub_q1 0.0 3.0000 /begin FUNCTION_LIST PMPRSVCALC /end FUNCTION_LIST /end CHARACTERISTIC
/begin CHARACTERISTIC K_PRIO15 "Prios bei Kl.15, Motor aus" VALUE 0x000C249D TKW_VV_VV_UB 100.0 Def_dez_ub_q1 0.0 7.0000 /begin FUNCTION_LIST PMPRSVCALC /end FUNCTION_LIST /end CHARACTERISTIC
/begin CHARACTERISTIC K_PRIOCF15 "PrioCF bei kl.15, Motor aus" VALUE 0x000C249E TKW_VV_VV_UB 100.0 Def_dez_ub_q1 0.0 7.0000 /begin FUNCTION_LIST PMPRSVCALC /end FUNCTION_LIST /end CHARACTERISTIC
/begin CHARACTERISTIC K_PRIOCFAPP "Steuerung Spitzenreduzierung Prioritaet Komfort App" VALUE 0x000C249F TKW_VV_VV_UB 100.0 Def_dez_ub_q1 0.0 7.0000 /begin FUNCTION_LIST PMPRSVCALC /end FUNCTION_LIST /end CHARACTERISTIC
/begin CHARACTERISTIC K_PRIOCF_R "Prio Comfort Bei Kl.R" VALUE 0x000C24A0 TKW_VV_VV_UB 100.0 Def_dez_ub_q1 0.0 7.0000 /begin FUNCTION_LIST PMPRSVCALC /end FUNCTION_LIST /end CHARACTERISTIC
/begin CHARACTERISTIC K_PRIO_R "Prio Bei Kl.R" VALUE 0x000C24A1 TKW_VV_VV_UB 100.0 Def_dez_ub_q1 0.0 7.0000 /begin FUNCTION_LIST PMPRSVCALC /end FUNCTION_LIST /end CHARACTERISTIC
/begin CHARACTERISTIC K_PTCPWRAPP "Ansteuerung PWM-Ausgang für PTC-Zuheizer. Applikationsgroesse." VALUE 0x000C24A2 TKW_VV_VV_UB 100.0 Def_f_ub_b127p5 0.0 127.5000 /begin FUNCTION_LIST PMPRSVCALC /end FUNCTION_LIST /end CHARACTERISTIC
/begin CHARACTERISTIC K_PTC_PI "K-Faktor des PI-Reglers PTC-Ansteuerung" VALUE 0x000C24A3 TKW_VV_VV_UB 100.0 Def_f_ub_b1 0.0 0.9960 /begin FUNCTION_LIST PMPRSVCALC /end FUNCTION_LIST /end CHARACTERISTIC
/begin CHARACTERISTIC K_PWRDF_PI "K-Faktor des PI Reglers zur Berechnung von ctrpwrdf" VALUE 0x000C24A4 TKW_VV_VV_UB 100.0 Def_f_ub_b1 0.0 0.9960 /begin FUNCTION_LIST PMPRSVCALC /end FUNCTION_LIST /end CHARACTERISTIC
/begin CHARACTERISTIC K_RESET_PI "PI-Reset-Zeit bei steigender Kl.15" VALUE 0x000C24A5 TKW_VV_VV_UB 100.0 Def_td_ub_q0p1 0.0 25.5000 /begin FUNCTION_LIST PMPRSVCALC /end FUNCTION_LIST /end CHARACTERISTIC
/begin CHARACTERISTIC K_RQPCOSA "Parameter für SV-Anmeldung" VALUE 0x000C24A6 TKW_VV_VV_UB 100.0 Def_dez_ub_q1 0.0 3.0000 /begin FUNCTION_LIST PMPRSVCALC /end FUNCTION_LIST /end CHARACTERISTIC
/begin CHARACTERISTIC K_RQPCOSAPP "Anforderung Standverbraucher Applikationsgroesse" VALUE 0x000C24A7 TKW_VV_VV_UB 100.0 Def_dez_ub_q1 0.0 255.0000 /begin FUNCTION_LIST PMPRSVCALC /end FUNCTION_LIST /end CHARACTERISTIC
/begin CHARACTERISTIC K_RQULCP "RQPCOS Master umschalter" VALUE 0x000C24A8 TKW_VV_VV_UB 100.0 Def_dez_ub_q1 0.0 4.0000 /begin FUNCTION_LIST PMPRSVCALC /end FUNCTION_LIST /end CHARACTERISTIC
/begin CHARACTERISTIC K_SELSPCOSA "Spezialverbraucher" VALUE 0x000C24A9 TKW_VV_VV_UB 100.0 Def_dez_ub_q1 0.0 15.0000 /begin FUNCTION_LIST PMPRSVCALC /end FUNCTION_LIST /end CHARACTERISTIC
/begin CHARACTERISTIC K_SELSPCSAPP "Auswahl Sonderverbraucher Applikationsgroesse" VALUE 0x000C24AA TKW_VV_VV_UB 100.0 Def_dez_ub_q1 0.0 15.0000 /begin FUNCTION_LIST PMPRSVCALC /end FUNCTION_LIST /end CHARACTERISTIC
/begin CHARACTERISTIC K_STPCOSAPP "Status Standverbraucher Applikationsgroesse" VALUE 0x000C24AB TKW_VV_VV_UB 100.0 Def_dez_ub_q1 0.0 3.0000 /begin FUNCTION_LIST PMPRSVCALC /end FUNCTION_LIST /end CHARACTERISTIC
/begin CHARACTERISTIC K_T_IPMPRIO "max. Zeit, indem Prio aufgrund IPM gesteuert wird" VALUE 0x000C24AC TKW_VV_VV_UB 100.0 Def_td_ub_q0p1 0.0 25.5000 /begin FUNCTION_LIST PMPRSVCALC /end FUNCTION_LIST /end CHARACTERISTIC
/begin CHARACTERISTIC K_T_NKPTCAUS "Zeit PTC aus aufgrund NKW zu niedrig." VALUE 0x000C24AD TKW_VV_VV_UB 100.0 Def_td_ub_q0p1 0.0 25.5000 /begin FUNCTION_LIST PMPRSVCALC /end FUNCTION_LIST /end CHARACTERISTIC
/begin CHARACTERISTIC K_T_PMBS "Zeit bis zum nächsten zyklischen senden" VALUE 0x000C24AE TKW_VV_VV_UB 100.0 Def_td_ub_q1 0.0 255.0000 /begin FUNCTION_LIST PMPRSVCALC /end FUNCTION_LIST /end CHARACTERISTIC
/begin CHARACTERISTIC K_T_PMVS "Zeit zwischen zwei zyklischen Sendungen von 3b3 " VALUE 0x000C24AF TKW_VV_VV_UB 100.0 Def_td_ub_q1 0.0 255.0000 /begin FUNCTION_LIST PMPRSVCALC /end FUNCTION_LIST /end CHARACTERISTIC
/begin CHARACTERISTIC K_T_PTCKWAN "PTC-Ein Wartezeit nach Motor an." VALUE 0x000C24B0 TKW_VV_VV_UB 100.0 Def_td_ub_q0p1 0.0 25.5000 /begin FUNCTION_LIST PMPRSVCALC /end FUNCTION_LIST /end CHARACTERISTIC
/begin CHARACTERISTIC K_ULEVA "Spannungslevel" VALUE 0x000C24B1 TKW_VV_VV_UB 100.0 Def_dez_ub_q1 0.0 255.0000 /begin FUNCTION_LIST PMPRSVCALC /end FUNCTION_LIST /end CHARACTERISTIC
/begin CHARACTERISTIC K_ULEVAPP "Spannungsebene Applikationsgroesse" VALUE 0x000C24B2 TKW_VV_VV_UB 100.0 Def_dez_ub_q1 0.0 15.0000 /begin FUNCTION_LIST PMPRSVCALC /end FUNCTION_LIST /end CHARACTERISTIC
/begin CHARACTERISTIC K_ULOWSETAPP "Entrpellzeit zentrale Unterspannung" VALUE 0x000C24B3 TKW_VV_VV_UB 100.0 Def_td_ub_q0p1 0.0 25.5000 /begin FUNCTION_LIST PMPRSVCALC /end FUNCTION_LIST /end CHARACTERISTIC
/begin CHARACTERISTIC S_DFKOMMERR "Maßnahmen bei Gen. Komm. Fehler aktiv" VALUE 0x000C24B4 TKW_VV_VV_UB 100.0 Identity 0.0 1.0000 /begin FUNCTION_LIST PMPRSVCALC /end FUNCTION_LIST /end CHARACTERISTIC
/begin CHARACTERISTIC S_IPMPTC "PTC Einschränkung aufgrund IPM" VALUE 0x000C24B5 TKW_VV_VV_UB 100.0 Identity 0.0 1.0000 /begin FUNCTION_LIST PMPRSVCALC /end FUNCTION_LIST /end CHARACTERISTIC
/begin CHARACTERISTIC S_PMMESS "Schalter Messemode aktiv" VALUE 0x000C24B6 TKW_VV_VV_UB 100.0 Identity 0.0 1.0000 /begin FUNCTION_LIST PMPRSVCALC /end FUNCTION_LIST /end CHARACTERISTIC
/begin CHARACTERISTIC S_PRIOCFENA "" VALUE 0x000C24B7 TKW_VV_VV_UB 100.0 Identity 0.0 1.0000 /begin FUNCTION_LIST PMPRSVCALC /end FUNCTION_LIST /end CHARACTERISTIC
/begin CHARACTERISTIC S_PRIOMANUAL "Manueller Schalter fuer E60/E65-Can Botschaften" VALUE 0x000C24B8 TKW_VV_VV_UB 100.0 Def_dez_ub_q1 0.0 255.0000 /begin FUNCTION_LIST PMPRSVCALC /end FUNCTION_LIST /end CHARACTERISTIC
/begin CHARACTERISTIC S_PTCKOOR "Schalter Aktivierung PTC Koordinator im PMPRSVCALC" VALUE 0x000C24B9 TKW_VV_VV_UB 100.0 Identity 0.0 1.0000 /begin FUNCTION_LIST PMPRSVCALC /end FUNCTION_LIST /end CHARACTERISTIC
/begin CHARACTERISTIC S_PTCMANUAL "Schalter manueller PTC Wert aktivieren." VALUE 0x000C24BA TKW_VV_VV_UB 100.0 Identity 0.0 1.0000 /begin FUNCTION_LIST PMPRSVCALC /end FUNCTION_LIST /end CHARACTERISTIC
/begin CHARACTERISTIC S_PWRCFENA "" VALUE 0x000C24BB TKW_VV_VV_UB 100.0 Identity 0.0 1.0000 /begin FUNCTION_LIST PMPRSVCALC /end FUNCTION_LIST /end CHARACTERISTIC
/begin CHARACTERISTIC K_CTRPWRCF "" VAL_BLK 0x000C2464 TKW_VV_VV_UW 100.0 Def_dez_uw_q1 0.0 65535.0000 /begin FUNCTION_LIST PMPRSVCALC /end FUNCTION_LIST NUMBER 7 /end CHARACTERISTIC
/begin CHARACTERISTIC K_CTRPWRDF "" VAL_BLK 0x000C2472 TKW_VV_VV_UW 100.0 Def_dez_uw_q1 0.0 65535.0000 /begin FUNCTION_LIST PMPRSVCALC /end FUNCTION_LIST NUMBER 14 /end CHARACTERISTIC
/begin CHARACTERISTIC K_CTRPRIOCF "" VAL_BLK 0x000C24BC TKW_VV_VV_UB 100.0 Def_dez_ub_q1 0.0 255.0000 /begin FUNCTION_LIST PMPRSVCALC /end FUNCTION_LIST NUMBER 7 /end CHARACTERISTIC
/begin CHARACTERISTIC K_PRIODF "" VAL_BLK 0x000C24C4 TKW_VV_VV_UB 100.0 Def_dez_ub_q1 0.0 255.0000 /begin FUNCTION_LIST PMPRSVCALC /end FUNCTION_LIST NUMBER 7 /end CHARACTERISTIC
/begin CHARACTERISTIC KL_UB_PTC "UBatt-Kennlinie für Ansteuerung PTC" CURVE 0x000C24CC TKL_SW_VV_SW 100.0 Def_f_sw_p0q25 -100.0000 100.0000 /begin FUNCTION_LIST PMPRSVCALC /end FUNCTION_LIST
 /begin AXIS_DESCR STD_AXIS Ubtpt1ptc Def_f_sw_b32 6 -32.0000 31.9990 FORMAT "%7.4" /end AXIS_DESCR
 FORMAT "%5.2" /end CHARACTERISTIC
/begin CHARACTERISTIC KL_PTC "PWM-Übersetzer für PTC-Ansteuerung" CURVE 0x000C24E6 TKL_UW_VV_UB 100.0 Def_f_ub_b127p5 0.0 127.5000 /begin FUNCTION_LIST PMPRSVCALC /end FUNCTION_LIST
 /begin AXIS_DESCR STD_AXIS Allptcfilt Def_f_uw_q0p25 5 0.0 16383.7500 FORMAT "%6.3" /end AXIS_DESCR
/end CHARACTERISTIC
/begin CHARACTERISTIC KL_I2PTC "I-Delta Übersetzer zu PTC Ansteuerung" CURVE 0x000C24F8 TKL_UW_VV_SW 100.0 Def_f_sw_p0q25 -100.0000 100.0000 /begin FUNCTION_LIST PMPRSVCALC /end FUNCTION_LIST
 /begin AXIS_DESCR STD_AXIS Isolldiff Def_i_uw_q0p08_o200 6 -200.0000 5042.8000 FORMAT "%6.3" /end AXIS_DESCR
 FORMAT "%5.2" /end CHARACTERISTIC
/begin CHARACTERISTIC KL_PRIOCF "" CURVE 0x000C2512 TKL_SW_VV_UB 100.0 Def_dez_ub_q1 0.0 6.0000 /begin FUNCTION_LIST PMPRSVCALC /end FUNCTION_LIST
 /begin AXIS_DESCR STD_AXIS Dsoc2pi Def_f_sw_p0q25 7 -8192.0000 8191.7500 FORMAT "%5.2" /end AXIS_DESCR
/end CHARACTERISTIC
/begin CHARACTERISTIC KL_PWRCF "" CURVE 0x000C252A TKL_SW_VV_UB 100.0 Def_dez_ub_q1 0.0 6.0000 /begin FUNCTION_LIST PMPRSVCALC /end FUNCTION_LIST
 /begin AXIS_DESCR STD_AXIS Dsoc2pi Def_f_sw_p0q25 7 -8192.0000 8191.7500 FORMAT "%5.2" /end AXIS_DESCR
/end CHARACTERISTIC
/begin CHARACTERISTIC KL_WUBPTC "KL Multiplikationsfaktor W_ub bei SpgEinbruch" CURVE 0x000C2542 TKL_UW_VV_UB 100.0 Def_f_ub_b4 0.0 3.9843 /begin FUNCTION_LIST PMPRSVCALC /end FUNCTION_LIST /begin AXIS_DESCR STD_AXIS Ub Def_u_uw_q0p0942 5 0.0 6173.3970 FORMAT "%4.1" /end AXIS_DESCR /end CHARACTERISTIC
/begin CHARACTERISTIC KL_DFPTC "Gefiltertes dffgen -> Prio_Gewichtung -Übersetzer" CURVE 0x000C2554 TKL_UB_VV_SW 100.0 Def_f_sw_p0q25 -100.0000 100.0000 /begin FUNCTION_LIST PMPRSVCALC /end FUNCTION_LIST /begin AXIS_DESCR STD_AXIS Dfpt1ptc Def_f_ub_b100 6 0.0 99.6093 /end AXIS_DESCR FORMAT "%5.2" /end CHARACTERISTIC
/begin CHARACTERISTIC KL_PWRDF "" CURVE 0x000C2568 TKL_UW_VV_UB 100.0 Def_dez_ub_q1 0.0 13.0000 /begin FUNCTION_LIST PMPRSVCALC /end FUNCTION_LIST
 /begin AXIS_DESCR STD_AXIS Dfprio Def_f_uw_q0p25 14 0.0 16383.7500 FORMAT "%6.3" /end AXIS_DESCR
/end CHARACTERISTIC
/begin CHARACTERISTIC KL_PRIO2PTC "Gewichtung der Prios auf Gewichtung fuer PTC Ansteuerung" CURVE 0x000C2594 TKL_UW_VV_SW 100.0 Def_f_sw_p0q25 -100.0000 100.0000 /begin FUNCTION_LIST PMPRSVCALC /end FUNCTION_LIST
 /begin AXIS_DESCR STD_AXIS Dfprio Def_f_uw_q0p25 5 0.0 16383.7500 FORMAT "%6.3" /end AXIS_DESCR
 FORMAT "%5.2" /end CHARACTERISTIC
/begin CHARACTERISTIC KL_SOCPRIO "dsoc -> Prio Übersetzer" CURVE 0x000C25AA TKL_SW_VV_SW 100.0 Def_f_sw_p0q25 -150.0000 150.0000 /begin FUNCTION_LIST PMPRSVCALC /end FUNCTION_LIST
 /begin AXIS_DESCR STD_AXIS D_soc Def_f_sw_b100 4 -100.0000 99.9969 FORMAT "%6.3" /end AXIS_DESCR
 FORMAT "%5.2" /end CHARACTERISTIC
/begin CHARACTERISTIC KL_DFPRIO "Dffgen Prio Übersetzer" CURVE 0x000C25BC TKL_UB_VV_SW 100.0 Def_f_sw_p0q25 -100.0000 100.0000 /begin FUNCTION_LIST PMPRSVCALC /end FUNCTION_LIST /begin AXIS_DESCR STD_AXIS Dfpt1filt Def_f_ub_b100 6 0.0 99.6093 /end AXIS_DESCR FORMAT "%5.2" /end CHARACTERISTIC
/begin CHARACTERISTIC KL_UBTPRIO "Delta-Spannung -> Prio Übersetzer" CURVE 0x000C25D0 TKL_SW_VV_SW 100.0 Def_f_sw_p0q25 -100.0000 100.0000 /begin FUNCTION_LIST PMPRSVCALC /end FUNCTION_LIST
 /begin AXIS_DESCR STD_AXIS Ubdiffilt Def_f_sw_b32 6 -32.0000 31.9990 FORMAT "%7.4" /end AXIS_DESCR
 FORMAT "%5.2" /end CHARACTERISTIC
/begin CHARACTERISTIC KL_IREST "Noch verfuegbare Restleistung vom Generator." CURVE 0x000C25EA TKL_UW_VV_SW 100.0 Def_f_sw_p0q25 -100.0000 100.0000 /begin FUNCTION_LIST PMPRSVCALC /end FUNCTION_LIST
 /begin AXIS_DESCR STD_AXIS Pgenrest Def_f_uw_q0p25 10 0.0 16383.7500 FORMAT "%6.3" /end AXIS_DESCR
 FORMAT "%5.2" /end CHARACTERISTIC
/begin CHARACTERISTIC KL_DUDTPTC "Übersetzer dudtmul -> PTC Add. Gewichtung" CURVE 0x000C2614 TKL_SW_VV_UW 100.0 Def_f_uw_q0p25 0.0 550.0000 /begin FUNCTION_LIST PMPRSVCALC /end FUNCTION_LIST
 /begin AXIS_DESCR STD_AXIS Dudtmul Def_f_sw_q0p000147 5 -48.2304 48.2289 FORMAT "%7.4" /end AXIS_DESCR
 FORMAT "%6.3" /end CHARACTERISTIC
/begin CHARACTERISTIC KL_DSOCPTC "Kennlinie dsoc auf PTC-Ansteuerung Übersetzer" CURVE 0x000C262A TKL_SW_VV_SW 100.0 Def_f_sw_p0q25 -150.0000 150.0000 /begin FUNCTION_LIST PMPRSVCALC /end FUNCTION_LIST
 /begin AXIS_DESCR STD_AXIS D_soc Def_f_sw_b100 4 -100.0000 99.9969 FORMAT "%6.3" /end AXIS_DESCR
 FORMAT "%5.2" /end CHARACTERISTIC
/begin CHARACTERISTIC KL_ISOLLPR "Delta-I -> Prio Übersetzer" CURVE 0x000C263C TKL_UW_VV_SW 100.0 Def_f_sw_p0q25 -100.0000 100.0000 /begin FUNCTION_LIST PMPRSVCALC /end FUNCTION_LIST
 /begin AXIS_DESCR STD_AXIS Ibtdiff Def_i_uw_q0p08_o200 6 -200.0000 5042.8000 FORMAT "%6.3" /end AXIS_DESCR
 FORMAT "%5.2" /end CHARACTERISTIC
/begin CHARACTERISTIC KL_DSOCPRIO "" CURVE 0x000C2656 TKL_SW_VV_UW 100.0 Def_f_uw_b512 0.0 511.9921 /begin FUNCTION_LIST PMPRSVCALC /end FUNCTION_LIST
 /begin AXIS_DESCR STD_AXIS D_soc Def_f_sw_b100 5 -100.0000 99.9969 FORMAT "%6.3" /end AXIS_DESCR
 FORMAT "%6.3" /end CHARACTERISTIC
/begin CHARACTERISTIC KL_PRIODF "" CURVE 0x000C266C TKL_UW_VV_UB 100.0 Def_dez_ub_q1 0.0 6.0000 /begin FUNCTION_LIST PMPRSVCALC /end FUNCTION_LIST
 /begin AXIS_DESCR STD_AXIS Dfprio Def_f_uw_q0p25 7 0.0 16383.7500 FORMAT "%6.3" /end AXIS_DESCR
/end CHARACTERISTIC
/begin CHARACTERISTIC KF_IBTSOLL "KFSollstrom aufgrund von Batterietemperatur und Ladezustand." MAP 0x000C2684 TKF_SW_SW_UW 100.0 Def_i_uw_q0p08_o200 -200.0000 5042.8000 /begin FUNCTION_LIST PMPRSVCALC /end FUNCTION_LIST
 /begin AXIS_DESCR STD_AXIS T_batt Def_t_sw_q0p1 5 -3276.8000 3276.7000 FORMAT "%4.1" /end AXIS_DESCR
 /begin AXIS_DESCR STD_AXIS D_soc Def_f_sw_b100 6 -100.0000 99.9969 FORMAT "%6.3" /end AXIS_DESCR
 FORMAT "%6.3" /end CHARACTERISTIC
/begin CHARACTERISTIC K_Q_BILAPWF "Defaultwert für q_bila nach Powerfail" VALUE 0x000C26D8 TKW_VV_VV_UW 100.0 Def_ql_uw_q0p0182 0.0 1193.0282 /begin FUNCTION_LIST PMSOCCALC /end FUNCTION_LIST FORMAT "%6.3" /end CHARACTERISTIC
/begin CHARACTERISTIC K_SOC_BILAWA "Applikationswert soc_bila" VALUE 0x000C26DA TKW_VV_VV_UW 100.0 Def_f_uw_b100 0.0 99.9984 /begin FUNCTION_LIST PMSOCCALC /end FUNCTION_LIST FORMAT "%6.3" /end CHARACTERISTIC
/begin CHARACTERISTIC K_SOC_QPWF "Ladezustandsqualität nach Powerfail" VALUE 0x000C26DC TKW_VV_VV_UW 100.0 Def_ql_uw_q0p0182 0.0 1193.0282 /begin FUNCTION_LIST PMSOCCALC /end FUNCTION_LIST FORMAT "%6.3" /end CHARACTERISTIC
/begin CHARACTERISTIC K_SOC_QUALIA "Applikationswert soc_quali" VALUE 0x000C26DE TKW_VV_VV_UW 100.0 Def_ql_uw_q0p0182 0.0 1193.0282 /begin FUNCTION_LIST PMSOCCALC /end FUNCTION_LIST FORMAT "%6.3" /end CHARACTERISTIC
/begin CHARACTERISTIC CBATT_DEF "Ersatzwert Batteriekapazität" VALUE 0x000C26E0 TKW_VV_VV_UB 100.0 Def_ql_ub_q1 1.0000 255.0000 /begin FUNCTION_LIST PMSOCCALC /end FUNCTION_LIST /end CHARACTERISTIC
/begin CHARACTERISTIC K_IB_COMMVAL "Anzahl Taskaufrufe zwischen periodischer Abfrage qlad und qelad" VALUE 0x000C26E1 TKW_VV_VV_UB 100.0 Def_dez_ub_q1 0.0 255.0000 /begin FUNCTION_LIST PMSOCCALC /end FUNCTION_LIST /end CHARACTERISTIC
/begin CHARACTERISTIC K_PMQ_UX "Ruhespannung Extrapolationsteiler" VALUE 0x000C26E2 TKW_VV_VV_UB 100.0 Def_f_ub_b8 0.0313 7.9687 /begin FUNCTION_LIST PMSOCCALC /end FUNCTION_LIST /end CHARACTERISTIC
/begin CHARACTERISTIC S_BSOCCALC "Enable Rücksetzten Ruhespannungen IBS" VALUE 0x000C26E3 TKW_VV_VV_UB 100.0 Def_dez_ub_q1 0.0 255.0000 /begin FUNCTION_LIST PMSOCCALC /end FUNCTION_LIST /end CHARACTERISTIC
/begin CHARACTERISTIC S_SOC_BILA "Schalter für Applik. soc_bila" VALUE 0x000C26E4 TKW_VV_VV_UB 100.0 Def_dez_ub_q1 0.0 255.0000 /begin FUNCTION_LIST PMSOCCALC /end FUNCTION_LIST /end CHARACTERISTIC
/begin CHARACTERISTIC S_SOC_QUAL "Schalter für Applik. soc_quali" VALUE 0x000C26E5 TKW_VV_VV_UB 100.0 Def_dez_ub_q1 0.0 255.0000 /begin FUNCTION_LIST PMSOCCALC /end FUNCTION_LIST /end CHARACTERISTIC
/begin CHARACTERISTIC KL_SOC0TEMP "Temperaturabhängige Stromkorrektur für Ruhespannungsmessung" CURVE 0x000C26E6 TKL_SW_VV_UB 100.0 Def_f_ub_b2 0.0 1.9921 /begin FUNCTION_LIST PMSOCCALC /end FUNCTION_LIST
 /begin AXIS_DESCR STD_AXIS Tsocloc Def_t_sw_q0p1 5 -3276.8000 3276.7000 FORMAT "%4.1" /end AXIS_DESCR
/end CHARACTERISTIC
/begin CHARACTERISTIC KF_SOCLF "Ladefaktor in Abhängigkeit von Temperatur und Ladezustand" MAP 0x000C26F8 TKF_UW_SW_UB 100.0 Def_f_ub_b4 0.0157 3.9843 /begin FUNCTION_LIST PMSOCCALC /end FUNCTION_LIST
 /begin AXIS_DESCR STD_AXIS T_batt Def_t_sw_q0p1 3 -3276.8000 3276.7000 FORMAT "%4.1" /end AXIS_DESCR
 /begin AXIS_DESCR STD_AXIS Soc_b_loc Def_ql_uw_q0p0182 3 0.0 1192.7502 FORMAT "%6.3" /end AXIS_DESCR
/end CHARACTERISTIC
/begin CHARACTERISTIC KF_SOC0UBIB "" MAP 0x000C2710 TKF_SW_UW_UW 100.0 Def_ql_uw_q0p0182 0.0 1193.0282 /begin FUNCTION_LIST PMSOCCALC /end FUNCTION_LIST
 /begin AXIS_DESCR STD_AXIS Ubatt0 Def_u_uw_q0p25em3_o6 3 6.0000 22.3837 FORMAT "%7.4" /end AXIS_DESCR
 /begin AXIS_DESCR STD_AXIS Isoc0loc Def_i_sw_q0p02 5 -655.3600 655.3400 FORMAT "%6.3" /end AXIS_DESCR
 FORMAT "%6.3" /end CHARACTERISTIC
/begin CHARACTERISTIC K_I_FITAUSW "Grenzwert Fitstrom" VALUE 0x000C2740 TKW_VV_VV_UW 100.0 Def_i_uw_q0p08_o200 -200.0000 5042.8000 /begin FUNCTION_LIST PMSOCFIT /end FUNCTION_LIST FORMAT "%6.3" /end CHARACTERISTIC
/begin CHARACTERISTIC K_SOCFITAPP "Applikationwert Soc aus der Fitberechnung" VALUE 0x000C2742 TKW_VV_VV_UW 100.0 Def_f_uw_b100 0.0 99.9984 /begin FUNCTION_LIST PMSOCFIT /end FUNCTION_LIST FORMAT "%6.3" /end CHARACTERISTIC
/begin CHARACTERISTIC ZK_PMSOC "Zeitfaktor" VALUE 0x000C2744 TKW_VV_VV_UW 100.0 Def_f_uw_b1 0.0 9.99984741210938e-1 /begin FUNCTION_LIST PMSOCFIT /end FUNCTION_LIST /end CHARACTERISTIC
/begin CHARACTERISTIC S_PMSOCFIT "Schalter zur Applikation SoC aus der Fitberechnung" VALUE 0x000C2746 TKW_VV_VV_UB 100.0 Def_dez_ub_q1 0.0 255.0000 /begin FUNCTION_LIST PMSOCFIT /end FUNCTION_LIST /end CHARACTERISTIC
/begin CHARACTERISTIC KL_PMSOCVU "SoC-Wert aus der Fitberechnung" CURVE 0x000C2748 TKL_UW_VV_UW 100.0 Def_f_uw_b100 0.0 99.9984 /begin FUNCTION_LIST PMSOCFIT /end FUNCTION_LIST
 /begin AXIS_DESCR STD_AXIS Ubatts2 Def_u_uw_q0p25em3_o6 3 6.0000 22.3837 FORMAT "%7.4" /end AXIS_DESCR
 FORMAT "%6.3" /end CHARACTERISTIC
/begin CHARACTERISTIC KF_PMRIBAT8 "Kennfeld Innenwiderstand Batterie8" MAP 0x000C2756 TKF_UW_SW_UB 100.0 Def_f_ub_q0p001 0.0 0.2550 /begin FUNCTION_LIST PMSOCFIT /end FUNCTION_LIST
 /begin AXIS_DESCR STD_AXIS T_batt Def_t_sw_q0p1 4 -3276.8000 3276.7000 FORMAT "%4.1" /end AXIS_DESCR
 /begin AXIS_DESCR STD_AXIS I_batt Def_i_uw_q0p08_o200 6 -200.0000 5042.8000 FORMAT "%6.3" /end AXIS_DESCR
/end CHARACTERISTIC
/begin CHARACTERISTIC KF_PMRIBAT6 "Kennfeld Innenwiderstand Batterie6" MAP 0x000C2784 TKF_UW_SW_UB 100.0 Def_f_ub_q0p001 0.0 0.2550 /begin FUNCTION_LIST PMSOCFIT /end FUNCTION_LIST
 /begin AXIS_DESCR STD_AXIS T_batt Def_t_sw_q0p1 4 -3276.8000 3276.7000 FORMAT "%4.1" /end AXIS_DESCR
 /begin AXIS_DESCR STD_AXIS I_batt Def_i_uw_q0p08_o200 6 -200.0000 5042.8000 FORMAT "%6.3" /end AXIS_DESCR
/end CHARACTERISTIC
/begin CHARACTERISTIC KF_PMRIBAT5 "Kennfeld Innenwiderstand Batterie5" MAP 0x000C27B2 TKF_UW_SW_UB 100.0 Def_f_ub_q0p001 0.0 0.2550 /begin FUNCTION_LIST PMSOCFIT /end FUNCTION_LIST
 /begin AXIS_DESCR STD_AXIS T_batt Def_t_sw_q0p1 4 -3276.8000 3276.7000 FORMAT "%4.1" /end AXIS_DESCR
 /begin AXIS_DESCR STD_AXIS I_batt Def_i_uw_q0p08_o200 6 -200.0000 5042.8000 FORMAT "%6.3" /end AXIS_DESCR
/end CHARACTERISTIC
/begin CHARACTERISTIC KF_PMRIBAT3 "Kennfeld Innenwiderstand Batterie3" MAP 0x000C27E0 TKF_UW_SW_UB 100.0 Def_f_ub_q0p001 0.0 0.2550 /begin FUNCTION_LIST PMSOCFIT /end FUNCTION_LIST
 /begin AXIS_DESCR STD_AXIS T_batt Def_t_sw_q0p1 4 -3276.8000 3276.7000 FORMAT "%4.1" /end AXIS_DESCR
 /begin AXIS_DESCR STD_AXIS I_batt Def_i_uw_q0p08_o200 6 -200.0000 5042.8000 FORMAT "%6.3" /end AXIS_DESCR
/end CHARACTERISTIC
/begin CHARACTERISTIC KF_PMRIBAT4 "Kennfeld Innenwiderstand Batterie4" MAP 0x000C280E TKF_UW_SW_UB 100.0 Def_f_ub_q0p001 0.0 0.2550 /begin FUNCTION_LIST PMSOCFIT /end FUNCTION_LIST
 /begin AXIS_DESCR STD_AXIS T_batt Def_t_sw_q0p1 4 -3276.8000 3276.7000 FORMAT "%4.1" /end AXIS_DESCR
 /begin AXIS_DESCR STD_AXIS I_batt Def_i_uw_q0p08_o200 6 -200.0000 5042.8000 FORMAT "%6.3" /end AXIS_DESCR
/end CHARACTERISTIC
/begin CHARACTERISTIC KF_PMRIBAT2 "Kennfeld Innenwiderstand Batterie2" MAP 0x000C283C TKF_UW_SW_UB 100.0 Def_f_ub_q0p001 0.0 0.2550 /begin FUNCTION_LIST PMSOCFIT /end FUNCTION_LIST
 /begin AXIS_DESCR STD_AXIS T_batt Def_t_sw_q0p1 4 -3276.8000 3276.7000 FORMAT "%4.1" /end AXIS_DESCR
 /begin AXIS_DESCR STD_AXIS I_batt Def_i_uw_q0p08_o200 6 -200.0000 5042.8000 FORMAT "%6.3" /end AXIS_DESCR
/end CHARACTERISTIC
/begin CHARACTERISTIC KF_PMRIBAT1 "Kennfeld Innenwiderstand Batterie" MAP 0x000C286A TKF_UW_SW_UB 100.0 Def_f_ub_q0p001 0.0 0.2550 /begin FUNCTION_LIST PMSOCFIT /end FUNCTION_LIST
 /begin AXIS_DESCR STD_AXIS T_batt Def_t_sw_q0p1 4 -3276.8000 3276.7000 FORMAT "%4.1" /end AXIS_DESCR
 /begin AXIS_DESCR STD_AXIS I_batt Def_i_uw_q0p08_o200 6 -200.0000 5042.8000 FORMAT "%6.3" /end AXIS_DESCR
/end CHARACTERISTIC
/begin CHARACTERISTIC KF_PMRIBAT7 "Kennfeld Innenwiderstand Batterie7" MAP 0x000C2898 TKF_UW_SW_UB 100.0 Def_f_ub_q0p001 0.0 0.2550 /begin FUNCTION_LIST PMSOCFIT /end FUNCTION_LIST
 /begin AXIS_DESCR STD_AXIS T_batt Def_t_sw_q0p1 4 -3276.8000 3276.7000 FORMAT "%4.1" /end AXIS_DESCR
 /begin AXIS_DESCR STD_AXIS I_batt Def_i_uw_q0p08_o200 6 -200.0000 5042.8000 FORMAT "%6.3" /end AXIS_DESCR
/end CHARACTERISTIC
/begin CHARACTERISTIC K_ABSCHKORA "Applikationswert für Korrektur Abschaltung" VALUE 0x000C28C6 TKW_VV_VV_SW 100.0 Def_f_sw_q0p00153 -50.0000 49.9984 /begin FUNCTION_LIST PMSOCKOR /end FUNCTION_LIST FORMAT "%6.3" /end CHARACTERISTIC
/begin CHARACTERISTIC K_DAB_KORR1 "Korrekturkonstante 1 für Abschaltung" VALUE 0x000C28C8 TKW_VV_VV_SW 100.0 Def_f_sw_q0p00153 -50.0000 49.9984 /begin FUNCTION_LIST PMSOCKOR /end FUNCTION_LIST FORMAT "%6.3" /end CHARACTERISTIC
/begin CHARACTERISTIC K_DAB_KORR2 "Korrekturkonstante 2 für Abschaltung" VALUE 0x000C28CA TKW_VV_VV_SW 100.0 Def_f_sw_q0p00153 -50.0000 49.9984 /begin FUNCTION_LIST PMSOCKOR /end FUNCTION_LIST FORMAT "%6.3" /end CHARACTERISTIC
/begin CHARACTERISTIC K_DAB_KORR3 "Korrekturkonstante 3 für Abschaltung" VALUE 0x000C28CC TKW_VV_VV_SW 100.0 Def_f_sw_q0p00153 -50.0000 49.9984 /begin FUNCTION_LIST PMSOCKOR /end FUNCTION_LIST FORMAT "%6.3" /end CHARACTERISTIC
/begin CHARACTERISTIC K_DSOCA "Applikationsgrösse für d_soc" VALUE 0x000C28CE TKW_VV_VV_SW 100.0 Def_f_sw_b100 -100.0000 99.9969 /begin FUNCTION_LIST PMSOCKOR /end FUNCTION_LIST FORMAT "%6.3" /end CHARACTERISTIC
/begin CHARACTERISTIC K_DSOCABSCH "Applikationsgrösse für d_soc" VALUE 0x000C28D0 TKW_VV_VV_SW 100.0 Def_f_sw_b100 -100.0000 99.9969 /begin FUNCTION_LIST PMSOCKOR /end FUNCTION_LIST FORMAT "%6.3" /end CHARACTERISTIC
/begin CHARACTERISTIC K_TSAISPWF "Defaultwert Saison Temp bei DME Powerfail" VALUE 0x000C28D2 TKW_VV_VV_SW 100.0 Def_t_sw_q0p1 -3276.8000 3276.7000 /begin FUNCTION_LIST PMSOCKOR /end FUNCTION_LIST FORMAT "%4.1" /end CHARACTERISTIC
/begin CHARACTERISTIC K_BILA_OGRZ "Grenzwert oberhalb dessen eine Apassung durch soc_kor nicht zulässig ist" VALUE 0x000C28D4 TKW_VV_VV_UW 100.0 Def_f_uw_b100 0.0 99.9984 /begin FUNCTION_LIST PMSOCKOR /end FUNCTION_LIST FORMAT "%6.3" /end CHARACTERISTIC
/begin CHARACTERISTIC K_BILA_UGRZ "" VALUE 0x000C28D6 TKW_VV_VV_UW 100.0 Def_f_uw_b100 0.0 99.9984 /begin FUNCTION_LIST PMSOCKOR /end FUNCTION_LIST FORMAT "%6.3" /end CHARACTERISTIC
/begin CHARACTERISTIC K_PMTIMERSQ1 "Startwert Timer für soc_quali" VALUE 0x000C28D8 TKW_VV_VV_UW 100.0 Def_st_uw_q1 0.0 65535.0000 /begin FUNCTION_LIST PMSOCKOR /end FUNCTION_LIST /end CHARACTERISTIC
/begin CHARACTERISTIC K_PM_TABSMN "Applikationsgrösse für Abstellzeit tabsmn_w" VALUE 0x000C28DA TKW_VV_VV_UW 100.0 Def_td_uw_q1 0.0 65535.0000 /begin FUNCTION_LIST PMSOCKOR /end FUNCTION_LIST /end CHARACTERISTIC
/begin CHARACTERISTIC K_QSOCCL1 "Grenze zur Ladezustandsqualitätsklasse1" VALUE 0x000C28DC TKW_VV_VV_UW 100.0 Def_ql_uw_q0p0182 0.0 1193.0282 /begin FUNCTION_LIST PMSOCKOR /end FUNCTION_LIST FORMAT "%6.3" /end CHARACTERISTIC
/begin CHARACTERISTIC K_QSOCCL2 "Grenze zur Ladezustandsqualitätsklasse2" VALUE 0x000C28DE TKW_VV_VV_UW 100.0 Def_ql_uw_q0p0182 0.0 1193.0282 /begin FUNCTION_LIST PMSOCKOR /end FUNCTION_LIST FORMAT "%6.3" /end CHARACTERISTIC
/begin CHARACTERISTIC K_QSOCCL3 "Grenze zur Ladezustandsqualitätsklasse3" VALUE 0x000C28E0 TKW_VV_VV_UW 100.0 Def_ql_uw_q0p0182 0.0 1193.0282 /begin FUNCTION_LIST PMSOCKOR /end FUNCTION_LIST FORMAT "%6.3" /end CHARACTERISTIC
/begin CHARACTERISTIC K_QSTARTFGA "Applikationswert für q_startfgk" VALUE 0x000C28E2 TKW_VV_VV_UW 100.0 Def_ql_uw_q0p0182 0.0 1193.0282 /begin FUNCTION_LIST PMSOCKOR /end FUNCTION_LIST FORMAT "%6.3" /end CHARACTERISTIC
/begin CHARACTERISTIC K_SOCFITGRZ "Grenzwert für soc_fit" VALUE 0x000C28E4 TKW_VV_VV_UW 100.0 Def_f_uw_b100 0.0 99.9984 /begin FUNCTION_LIST PMSOCKOR /end FUNCTION_LIST FORMAT "%6.3" /end CHARACTERISTIC
/begin CHARACTERISTIC K_SOCFITLIMH "Applikationskonstante zur Verbesserung SoC aus der Fitberechnung" VALUE 0x000C28E6 TKW_VV_VV_UW 100.0 Def_f_uw_b100 0.0 99.9984 /begin FUNCTION_LIST PMSOCKOR /end FUNCTION_LIST FORMAT "%6.3" /end CHARACTERISTIC
/begin CHARACTERISTIC K_SOCFITLIML "Applikationskonstante zur Abwertung SoC aus der Fitberechnung" VALUE 0x000C28E8 TKW_VV_VV_UW 100.0 Def_f_uw_b100 0.0 99.9984 /begin FUNCTION_LIST PMSOCKOR /end FUNCTION_LIST FORMAT "%6.3" /end CHARACTERISTIC
/begin CHARACTERISTIC K_SOC_STAFGA "Applikationswert für SoC aus der Startfähigkeit" VALUE 0x000C28EA TKW_VV_VV_UW 100.0 Def_f_uw_b100 0.0 99.9984 /begin FUNCTION_LIST PMSOCKOR /end FUNCTION_LIST FORMAT "%6.3" /end CHARACTERISTIC
/begin CHARACTERISTIC K_TSAISONFIL "Filterkonstante für t_saison" VALUE 0x000C28EC TKW_VV_VV_UW 100.0 Def_dez_uw_q1 1.0000 65535.0000 /begin FUNCTION_LIST PMSOCKOR /end FUNCTION_LIST /end CHARACTERISTIC
/begin CHARACTERISTIC S_ABSCHK "Schalter für Applikationswert absch_korr" VALUE 0x000C28EE TKW_VV_VV_UB 100.0 Def_dez_ub_q1 0.0 255.0000 /begin FUNCTION_LIST PMSOCKOR /end FUNCTION_LIST /end CHARACTERISTIC
/begin CHARACTERISTIC S_DSOCS "Schalter für Applikationswert Delta SoC" VALUE 0x000C28EF TKW_VV_VV_UB 100.0 Def_dez_ub_q1 0.0 255.0000 /begin FUNCTION_LIST PMSOCKOR /end FUNCTION_LIST /end CHARACTERISTIC
/begin CHARACTERISTIC S_PMTABSMN "Schalter für Applikation der Abstellzeit tabsmn_w" VALUE 0x000C28F0 TKW_VV_VV_UB 100.0 Def_dez_ub_q1 0.0 255.0000 /begin FUNCTION_LIST PMSOCKOR /end FUNCTION_LIST /end CHARACTERISTIC
/begin CHARACTERISTIC S_QSTARTFK "Schalter für Applikation q_startfgk" VALUE 0x000C28F1 TKW_VV_VV_UB 100.0 Def_dez_ub_q1 0.0 255.0000 /begin FUNCTION_LIST PMSOCKOR /end FUNCTION_LIST /end CHARACTERISTIC
/begin CHARACTERISTIC S_SOCSTAFK "Schalter für Applikation SoC aus der Startfähigkeit" VALUE 0x000C28F2 TKW_VV_VV_UB 100.0 Def_dez_ub_q1 0.0 255.0000 /begin FUNCTION_LIST PMSOCKOR /end FUNCTION_LIST /end CHARACTERISTIC
/begin CHARACTERISTIC KL_FITGRZ "Grenzwert für soc_fit" CURVE 0x000C28F4 TKL_SW_VV_UW 100.0 Def_f_uw_b100 0.0 99.9984 /begin FUNCTION_LIST PMSOCKOR /end FUNCTION_LIST
 /begin AXIS_DESCR STD_AXIS T_saison Def_t_sw_q0p1 4 -3276.8000 3276.7000 FORMAT "%4.1" /end AXIS_DESCR
 FORMAT "%6.3" /end CHARACTERISTIC
/begin CHARACTERISTIC KL_SSOC "soc_s in Abh. von tsaison" CURVE 0x000C2906 TKL_SW_VV_UW 100.0 Def_f_uw_b100 0.0 99.9984 /begin FUNCTION_LIST PMSOCKOR /end FUNCTION_LIST
 /begin AXIS_DESCR STD_AXIS T_saison Def_t_sw_q0p1 4 -3276.8000 3276.7000 FORMAT "%4.1" /end AXIS_DESCR
 FORMAT "%6.3" /end CHARACTERISTIC
/begin CHARACTERISTIC K_TIME_START "Zeittriggerschwelle nach Motorstart" VALUE 0x000C2918 TKW_VV_VV_UW 100.0 Def_td_uw_q0p01 0.0 655.3500 /begin FUNCTION_LIST PMSOCSTART /end FUNCTION_LIST FORMAT "%5.2" /end CHARACTERISTIC
/begin CHARACTERISTIC K_UB_GRENZ "Grenzwert Gradient d. Bordnetzspannung" VALUE 0x000C291A TKW_VV_VV_UW 100.0 Def_u_uw_q0p0942 0.0 6173.3970 /begin FUNCTION_LIST PMSOCSTART /end FUNCTION_LIST FORMAT "%4.1" /end CHARACTERISTIC
/begin CHARACTERISTIC K_USTARTGRZ "Spannungsgrenzwert für Startauswertung " VALUE 0x000C291C TKW_VV_VV_UW 100.0 Def_u_uw_q0p25em3_o6 6.0000 22.3837 /begin FUNCTION_LIST PMSOCSTART /end FUNCTION_LIST FORMAT "%7.4" /end CHARACTERISTIC
/begin CHARACTERISTIC K_RIN_GRENZ1 "Grenzwert Innenwiderstand Batterie1" VALUE 0x000C291E TKW_VV_VV_UB 100.0 Def_f_ub_b32 0.0 31.8750 /begin FUNCTION_LIST PMSOCSTART /end FUNCTION_LIST /end CHARACTERISTIC
/begin CHARACTERISTIC K_RIN_GRENZ2 "Grenzwert Innenwiderstand Batterie2" VALUE 0x000C291F TKW_VV_VV_UB 100.0 Def_f_ub_b32 0.0 31.8750 /begin FUNCTION_LIST PMSOCSTART /end FUNCTION_LIST /end CHARACTERISTIC
/begin CHARACTERISTIC K_RIN_GRENZ3 "Grenzwert Innenwiderstand Batterie3" VALUE 0x000C2920 TKW_VV_VV_UB 100.0 Def_f_ub_b32 0.0 31.8750 /begin FUNCTION_LIST PMSOCSTART /end FUNCTION_LIST /end CHARACTERISTIC
/begin CHARACTERISTIC K_RIN_GRENZ4 "Grenzwert Innenwiderstand Batterie4" VALUE 0x000C2921 TKW_VV_VV_UB 100.0 Def_f_ub_b32 0.0 31.8750 /begin FUNCTION_LIST PMSOCSTART /end FUNCTION_LIST /end CHARACTERISTIC
/begin CHARACTERISTIC K_RIN_GRENZ5 "Grenzwert Innenwiderstand Batterie5" VALUE 0x000C2922 TKW_VV_VV_UB 100.0 Def_f_ub_b32 0.0 31.8750 /begin FUNCTION_LIST PMSOCSTART /end FUNCTION_LIST /end CHARACTERISTIC
/begin CHARACTERISTIC K_RIN_GRENZ6 "Grenzwert Innenwiderstand Batterie6" VALUE 0x000C2923 TKW_VV_VV_UB 100.0 Def_f_ub_b32 0.0 31.8750 /begin FUNCTION_LIST PMSOCSTART /end FUNCTION_LIST /end CHARACTERISTIC
/begin CHARACTERISTIC K_RIN_GRENZ7 "Grenzwert Innenwiderstand Batterie7" VALUE 0x000C2924 TKW_VV_VV_UB 100.0 Def_f_ub_b32 0.0 31.8750 /begin FUNCTION_LIST PMSOCSTART /end FUNCTION_LIST /end CHARACTERISTIC
/begin CHARACTERISTIC K_RIN_GRENZ8 "Grenzwert Innenwiderstand Batterie8" VALUE 0x000C2925 TKW_VV_VV_UB 100.0 Def_f_ub_b32 0.0 31.8750 /begin FUNCTION_LIST PMSOCSTART /end FUNCTION_LIST /end CHARACTERISTIC
/begin CHARACTERISTIC S_NKWITNSTRT "0 = Nkw-Auswertung, 1=Itnstart Auswertung" VALUE 0x000C2926 TKW_VV_VV_UB 100.0 Identity 0.0 1.0000 /begin FUNCTION_LIST PMSOCSTART /end FUNCTION_LIST /end CHARACTERISTIC
/begin CHARACTERISTIC S_PMSTARTQ "Applikationsschalter f. B_pmstartq" VALUE 0x000C2927 TKW_VV_VV_UB 100.0 Def_dez_ub_q1 0.0 255.0000 /begin FUNCTION_LIST PMSOCSTART /end FUNCTION_LIST /end CHARACTERISTIC
/begin CHARACTERISTIC S_PM_TEST1 "Applikationsschalter um die Startberechnung zu erzwingen" VALUE 0x000C2928 TKW_VV_VV_UB 100.0 Def_dez_ub_q1 0.0 255.0000 /begin FUNCTION_LIST PMSOCSTART /end FUNCTION_LIST /end CHARACTERISTIC
/begin CHARACTERISTIC S_RIN "Schalter Applikation Innenwiderstandsprüfung" VALUE 0x000C2929 TKW_VV_VV_UB 100.0 Def_dez_ub_q1 0.0 255.0000 /begin FUNCTION_LIST PMSOCSTART /end FUNCTION_LIST /end CHARACTERISTIC
/begin CHARACTERISTIC S_STARTAW "Startauswertung fertig" VALUE 0x000C292A TKW_VV_VV_UB 100.0 Def_dez_ub_q1 0.0 255.0000 /begin FUNCTION_LIST PMSOCSTART /end FUNCTION_LIST /end CHARACTERISTIC
/begin CHARACTERISTIC KL_UNSTART "Startspannung abhängig v.Motordrehzahl" CURVE 0x000C292C TKL_SW_VV_UW 100.0 Def_u_uw_q0p25em3_o6 6.0000 22.3837 /begin FUNCTION_LIST PMSOCSTART /end FUNCTION_LIST /begin AXIS_DESCR STD_AXIS Nnmstart Def_n_sw_q1p0 2 -32768.0000 32767.0000 /end AXIS_DESCR FORMAT "%7.4" /end CHARACTERISTIC
/begin CHARACTERISTIC KL_ITNSTART "Startspannung abh. vom Itnstart" CURVE 0x000C2936 TKL_UB_VV_UW 100.0 Def_u_uw_q0p25em3_o6 6.0000 22.3837 /begin FUNCTION_LIST PMSOCSTART /end FUNCTION_LIST /begin AXIS_DESCR STD_AXIS NO_INPUT_QUANTITY Def_i_ub_b1000 4 0.0 996.0937 /end AXIS_DESCR FORMAT "%7.4" /end CHARACTERISTIC
/begin CHARACTERISTIC KL_UTSTART "Startspannung in Abhängigkeit von Temperatur Batterie" CURVE 0x000C2944 TKL_SW_VV_SW 100.0 Def_u_sw_q0p00025 -8.1920 8.1917 /begin FUNCTION_LIST PMSOCSTART /end FUNCTION_LIST
 /begin AXIS_DESCR STD_AXIS T_batt Def_t_sw_q0p1 3 -3276.8000 3276.7000 FORMAT "%4.1" /end AXIS_DESCR
 FORMAT "%7.4" /end CHARACTERISTIC
/begin CHARACTERISTIC K_IGRDETEC "U_gsoll - U_ibs Max für Freeze" VALUE 0x000C2952 TKW_VV_VV_SW 100.0 Def_u_sw_b128 -128.0000 127.9960 /begin FUNCTION_LIST PMUGENCALC /end FUNCTION_LIST FORMAT "%6.3" /end CHARACTERISTIC
/begin CHARACTERISTIC K_PMUGEN_MAX "Max zugelassene Generatorspg" VALUE 0x000C2954 TKW_VV_VV_SW 100.0 Def_u_sw_b128 -128.0000 127.9960 /begin FUNCTION_LIST PMUGENCALC /end FUNCTION_LIST FORMAT "%6.3" /end CHARACTERISTIC
/begin CHARACTERISTIC K_PMUGEN_MIN "Min zugelassene Generatorspg" VALUE 0x000C2956 TKW_VV_VV_SW 100.0 Def_u_sw_b128 -128.0000 127.9960 /begin FUNCTION_LIST PMUGENCALC /end FUNCTION_LIST FORMAT "%6.3" /end CHARACTERISTIC
/begin CHARACTERISTIC K_UGENNORM "Generator Normspannung" VALUE 0x000C2958 TKW_VV_VV_SW 100.0 Def_u_sw_b128 -128.0000 127.9960 /begin FUNCTION_LIST PMUGENCALC /end FUNCTION_LIST FORMAT "%6.3" /end CHARACTERISTIC
/begin CHARACTERISTIC K_UIBSAPP "Manueller Applikationswert von Uibs an UGENKOR" VALUE 0x000C295A TKW_VV_VV_SW 100.0 Def_u_sw_b128 -128.0000 127.9960 /begin FUNCTION_LIST PMUGENCALC /end FUNCTION_LIST FORMAT "%6.3" /end CHARACTERISTIC
/begin CHARACTERISTIC K_USTEPMIN "Min. Delta zw. Battsollspg und Battspg damit uibs veraendert wird." VALUE 0x000C295C TKW_VV_VV_SW 100.0 Def_u_sw_b128 -128.0000 127.9960 /begin FUNCTION_LIST PMUGENCALC /end FUNCTION_LIST FORMAT "%6.3" /end CHARACTERISTIC
/begin CHARACTERISTIC K_PMUBAT_MAX "Max. zugelassene Batteriespg " VALUE 0x000C295E TKW_VV_VV_UW 100.0 Def_u_uw_q0p25em3_o6 6.0000 22.3837 /begin FUNCTION_LIST PMUGENCALC /end FUNCTION_LIST FORMAT "%7.4" /end CHARACTERISTIC
/begin CHARACTERISTIC K_PMUBAT_MIN "Min. zugelassene Batteriespg" VALUE 0x000C2960 TKW_VV_VV_UW 100.0 Def_u_uw_q0p25em3_o6 6.0000 22.3837 /begin FUNCTION_LIST PMUGENCALC /end FUNCTION_LIST FORMAT "%7.4" /end CHARACTERISTIC
/begin CHARACTERISTIC K_DFOVERRIDE "Schwellwert wann Generator als ueberlastet erkannt wird" VALUE 0x000C2962 TKW_VV_VV_UB 100.0 Def_f_ub_b100 0.0 99.6093 /begin FUNCTION_LIST PMUGENCALC /end FUNCTION_LIST /end CHARACTERISTIC
/begin CHARACTERISTIC K_TD_BNMOT "Zeit nach Motorlauf, wo die stufenweise (USTEPMIN) Berechnung von uibs aktiviert wird." VALUE 0x000C2963 TKW_VV_VV_UB 100.0 Def_td_ub_q1 0.0 255.0000 /begin FUNCTION_LIST PMUGENCALC /end FUNCTION_LIST /end CHARACTERISTIC
/begin CHARACTERISTIC K_TD_PMUGEN "Taskzeit von PMUGENCALC, = Zeit wo die stufenweise Setzung von uibs berechnet wird." VALUE 0x000C2964 TKW_VV_VV_UB 100.0 Def_td_ub_q1 0.0 255.0000 /begin FUNCTION_LIST PMUGENCALC /end FUNCTION_LIST /end CHARACTERISTIC
/begin CHARACTERISTIC S_UIBS "Schalter für UIBS, wenn True dann uibs=UIBSAPP" VALUE 0x000C2965 TKW_VV_VV_UB 100.0 Identity 0.0 1.0000 /begin FUNCTION_LIST PMUGENCALC /end FUNCTION_LIST /end CHARACTERISTIC
/begin CHARACTERISTIC KL_USOLL "Batteriesollspannung aufgrund von tbatt" CURVE 0x000C2966 TKL_SW_VV_UW 100.0 Def_u_uw_q0p25em3_o6 6.0000 22.3837 /begin FUNCTION_LIST PMUGENCALC /end FUNCTION_LIST
 /begin AXIS_DESCR STD_AXIS T_batt Def_t_sw_q0p1 3 -3276.8000 3276.7000 FORMAT "%4.1" /end AXIS_DESCR
 FORMAT "%7.4" /end CHARACTERISTIC
/begin CHARACTERISTIC KF_USOLL "Batteriesollspannung aufgrund der Temperatur und soc." MAP 0x000C2974 TKF_UW_SW_UW 100.0 Def_u_uw_q0p25em3_o6 6.0000 22.3837 /begin FUNCTION_LIST PMUGENCALC /end FUNCTION_LIST
 /begin AXIS_DESCR STD_AXIS T_batt Def_t_sw_q0p1 3 -3276.8000 3276.7000 FORMAT "%4.1" /end AXIS_DESCR
 /begin AXIS_DESCR STD_AXIS Soc_rel Def_f_uw_b100 3 0.0 99.9984 FORMAT "%6.3" /end AXIS_DESCR
 FORMAT "%7.4" /end CHARACTERISTIC
/begin CHARACTERISTIC K_GENOFFTIME "maximale Generatorauszeit" VALUE 0x000C299A TKW_VV_VV_UW 100.0 Def_td_uw_q0p1 0.0 6553.5000 /begin FUNCTION_LIST UGENKOR /end FUNCTION_LIST FORMAT "%4.1" /end CHARACTERISTIC
/begin CHARACTERISTIC K_GENUMAX "maximale Generatorspannung" VALUE 0x000C299C TKW_VV_VV_UW 100.0 Def_u_uw_q0p1 0.0 6553.5000 /begin FUNCTION_LIST UGENKOR /end FUNCTION_LIST FORMAT "%6.3" /end CHARACTERISTIC
/begin CHARACTERISTIC K_GENURAMP "Spannungsinkrement fuer Rampe" VALUE 0x000C299E TKW_VV_VV_UW 100.0 Def_u_uw_q0p1 0.0 6553.5000 /begin FUNCTION_LIST UGENKOR /end FUNCTION_LIST FORMAT "%6.3" /end CHARACTERISTIC
/begin CHARACTERISTIC K_GENURAMPOF "Spannungsinkrement fuer Rampe, Generator ausschalten" VALUE 0x000C29A0 TKW_VV_VV_UW 100.0 Def_u_uw_q0p1 0.0 6553.5000 /begin FUNCTION_LIST UGENKOR /end FUNCTION_LIST FORMAT "%6.3" /end CHARACTERISTIC
/begin CHARACTERISTIC K_GEN_APPUG "Manuelle Generatorspannungsvorgabe" VALUE 0x000C29A2 TKW_VV_VV_UW 100.0 Def_u_uw_q0p1 0.0 6553.5000 /begin FUNCTION_LIST UGENKOR /end FUNCTION_LIST FORMAT "%6.3" /end CHARACTERISTIC
/begin CHARACTERISTIC K_PMSA_RST "" VALUE 0x000C29A4 TKW_VV_VV_UW 100.0 Def_dez_uw_q1 0.0 65535.0000 /begin FUNCTION_LIST UGENKOR /end FUNCTION_LIST /end CHARACTERISTIC
/begin CHARACTERISTIC K_PMSA_SET "" VALUE 0x000C29A6 TKW_VV_VV_UW 100.0 Def_dez_uw_q1 0.0 65535.0000 /begin FUNCTION_LIST UGENKOR /end FUNCTION_LIST /end CHARACTERISTIC
/begin CHARACTERISTIC K_T_IGRNACHL "" VALUE 0x000C29A8 TKW_VV_VV_UW 100.0 Def_td_uw_q0p1 0.0 6553.5000 /begin FUNCTION_LIST UGENKOR /end FUNCTION_LIST FORMAT "%4.1" /end CHARACTERISTIC
/begin CHARACTERISTIC K_UBNS "" VALUE 0x000C29AA TKW_VV_VV_UW 100.0 Def_u_uw_q0p1 0.0 6553.5000 /begin FUNCTION_LIST UGENKOR /end FUNCTION_LIST FORMAT "%6.3" /end CHARACTERISTIC
/begin CHARACTERISTIC K_UGENDELTA "" VALUE 0x000C29AC TKW_VV_VV_UW 100.0 Def_u_uw_q0p1 0.0 6553.5000 /begin FUNCTION_LIST UGENKOR /end FUNCTION_LIST FORMAT "%6.3" /end CHARACTERISTIC
/begin CHARACTERISTIC K_UGENMAXE65 "" VALUE 0x000C29AE TKW_VV_VV_UW 100.0 Def_u_uw_q0p1 0.0 6553.5000 /begin FUNCTION_LIST UGENKOR /end FUNCTION_LIST FORMAT "%6.3" /end CHARACTERISTIC
/begin CHARACTERISTIC K_UGENOFF "Generatorauschaltspannung bei vfzg = 0" VALUE 0x000C29B0 TKW_VV_VV_UW 100.0 Def_u_uw_q0p1 0.0 6553.5000 /begin FUNCTION_LIST UGENKOR /end FUNCTION_LIST FORMAT "%6.3" /end CHARACTERISTIC
/begin CHARACTERISTIC K_UGENOFFSTA "Generatorauschaltspannung während Start" VALUE 0x000C29B2 TKW_VV_VV_UW 100.0 Def_u_uw_q0p1 0.0 6553.5000 /begin FUNCTION_LIST UGENKOR /end FUNCTION_LIST FORMAT "%6.3" /end CHARACTERISTIC
/begin CHARACTERISTIC K_UGENOFFV0 "Generatorauschaltspannung bei vfzg != 0" VALUE 0x000C29B4 TKW_VV_VV_UW 100.0 Def_u_uw_q0p1 0.0 6553.5000 /begin FUNCTION_LIST UGENKOR /end FUNCTION_LIST FORMAT "%6.3" /end CHARACTERISTIC
/begin CHARACTERISTIC K_U_BNMAX "" VALUE 0x000C29B6 TKW_VV_VV_UW 100.0 Def_u_uw_q0p1 0.0 6553.5000 /begin FUNCTION_LIST UGENKOR /end FUNCTION_LIST FORMAT "%6.3" /end CHARACTERISTIC
/begin CHARACTERISTIC K_U_IGRRAMP "" VALUE 0x000C29B8 TKW_VV_VV_UW 100.0 Def_u_uw_q0p1 0.0 6553.5000 /begin FUNCTION_LIST UGENKOR /end FUNCTION_LIST FORMAT "%6.3" /end CHARACTERISTIC
/begin CHARACTERISTIC CW_BNSUMAX "" VALUE 0x000C29BA TKW_VV_VV_UB 100.0 Def_st_ub_q1 0.0 255.0000 /begin FUNCTION_LIST UGENKOR /end FUNCTION_LIST /end CHARACTERISTIC
/begin CHARACTERISTIC K_APP_UGEN "Umschaltung auf manuelle Generatorspannungsvorgabe" VALUE 0x000C29BB TKW_VV_VV_UB 100.0 Def_st_ub_q1 0.0 255.0000 /begin FUNCTION_LIST UGENKOR /end FUNCTION_LIST /end CHARACTERISTIC
/begin CHARACTERISTIC K_ENGENTOGGL "Freigabe Generatortoggeln" VALUE 0x000C29BC TKW_VV_VV_UB 100.0 Identity 0.0 1.0000 /begin FUNCTION_LIST UGENKOR /end FUNCTION_LIST /end CHARACTERISTIC
/begin CHARACTERISTIC K_PMSA_DEC "" VALUE 0x000C29BD TKW_VV_VV_UB 100.0 Def_dez_ub_q1 0.0 255.0000 /begin FUNCTION_LIST UGENKOR /end FUNCTION_LIST /end CHARACTERISTIC
/begin CHARACTERISTIC K_PMSA_INC "" VALUE 0x000C29BE TKW_VV_VV_UB 100.0 Def_dez_ub_q1 0.0 255.0000 /begin FUNCTION_LIST UGENKOR /end FUNCTION_LIST /end CHARACTERISTIC
/begin CHARACTERISTIC K_T_VERBON "Verzugszeit Verbraucherzuschaltung nach Aufhebung Genertorreduzierung" VALUE 0x000C29BF TKW_VV_VV_UB 100.0 Def_td_ub_q0p1 0.0 25.5000 /begin FUNCTION_LIST UGENKOR /end FUNCTION_LIST /end CHARACTERISTIC
/begin CHARACTERISTIC S_GOFFRAMP "Schalter Sprung auf 10,6V unverzoegert" VALUE 0x000C29C0 TKW_VV_VV_UB 100.0 Def_st_ub_q1 0.0 255.0000 /begin FUNCTION_LIST UGENKOR /end FUNCTION_LIST /end CHARACTERISTIC
/begin CHARACTERISTIC S_IGRLOW "" VALUE 0x000C29C1 TKW_VV_VV_UB 100.0 Identity 0.0 1.0000 /begin FUNCTION_LIST UGENKOR /end FUNCTION_LIST /end CHARACTERISTIC
/begin CHARACTERISTIC S_UGENOFST "" VALUE 0x000C29C2 TKW_VV_VV_UB 100.0 Def_st_ub_q1 0.0 255.0000 /begin FUNCTION_LIST UGENKOR /end FUNCTION_LIST /end CHARACTERISTIC
/begin MEASUREMENT St_pmdiag0.B_codierpm "Q_elad 1. Takt vorbei " UBYTE Def_bit_ub_0 0 0 0.0 255.0 ECU_ADDRESS 0x007FDE78 /begin FUNCTION_LIST PMDIAG /end FUNCTION_LIST BIT_MASK 0x1 /end MEASUREMENT
/begin MEASUREMENT St_pmdiag0.B_ccprio "Anfrage an CAS die Codierdaten erneut fuer PM zu senden." UBYTE Def_bit_ub_1 0 0 0.0 255.0 ECU_ADDRESS 0x007FDE78 /begin FUNCTION_LIST PMDIAG /end FUNCTION_LIST BIT_MASK 0x2 /end MEASUREMENT
/begin MEASUREMENT St_pmdiag0.B_ccbttdfk "CC Meldung : Komfortverbraucher eingeschraenkt" UBYTE Def_bit_ub_2 0 0 0.0 255.0 ECU_ADDRESS 0x007FDE78 /begin FUNCTION_LIST PMDIAG /end FUNCTION_LIST BIT_MASK 0x4 /end MEASUREMENT
/begin MEASUREMENT St_pmdiag0.B_ccpmerr "CC Meldung : Batterie Nachladen" UBYTE Def_bit_ub_3 0 0 0.0 255.0 ECU_ADDRESS 0x007FDE78 /begin FUNCTION_LIST PMDIAG /end FUNCTION_LIST BIT_MASK 0x8 /end MEASUREMENT
/begin MEASUREMENT St_pmdiag0.B_ccbttknt "Ruhestromverletzung derzeit vorhanden." UBYTE Def_bit_ub_4 0 0 0.0 255.0 ECU_ADDRESS 0x007FDE78 /begin FUNCTION_LIST PMDIAG /end FUNCTION_LIST BIT_MASK 0x10 /end MEASUREMENT
/begin MEASUREMENT St_pmdiag0.B_pcoschg "IBS Histrogramm darf gelöscht werden." UBYTE Def_bit_ub_5 0 0 0.0 255.0 ECU_ADDRESS 0x007FDE78 /begin FUNCTION_LIST PMDIAG /end FUNCTION_LIST BIT_MASK 0x20 /end MEASUREMENT
/begin MEASUREMENT St_pmdiag0.B_ccbtnach "IHKA Standverbraucher aktiv" UBYTE Def_bit_ub_6 0 0 0.0 255.0 ECU_ADDRESS 0x007FDE78 /begin FUNCTION_LIST PMDIAG /end FUNCTION_LIST BIT_MASK 0x40 /end MEASUREMENT
/begin MEASUREMENT St_pmdiag0.B_tiefrset "CC Meldung : Batterie verschlissen" UBYTE Def_bit_ub_7 0 0 0.0 255.0 ECU_ADDRESS 0x007FDE78 /begin FUNCTION_LIST PMDIAG /end FUNCTION_LIST BIT_MASK 0x80 /end MEASUREMENT
/begin MEASUREMENT St_pmdiag0 "Statuswort" UBYTE Def_st_ub_q1 0 0 0.0 255.0000 ECU_ADDRESS 0x007FDE78 /begin FUNCTION_LIST PMDIAG /end FUNCTION_LIST /end MEASUREMENT
/begin MEASUREMENT St_pmdiag1.B_ccruhver "CC Meldung : Powermgm ausser Betrieb" UBYTE Def_bit_ub_0 0 0 0.0 255.0 ECU_ADDRESS 0x007FDE79 /begin FUNCTION_LIST PMDIAG /end FUNCTION_LIST BIT_MASK 0x1 /end MEASUREMENT
/begin MEASUREMENT St_pmdiag1.B_histrset "CC Meldung : Batteriekontakt pruefen" UBYTE Def_bit_ub_1 0 0 0.0 255.0 ECU_ADDRESS 0x007FDE79 /begin FUNCTION_LIST PMDIAG /end FUNCTION_LIST BIT_MASK 0x2 /end MEASUREMENT
/begin MEASUREMENT St_pmdiag1.B_timer_rst "Bed. SVstatus darf geändert werden." UBYTE Def_bit_ub_2 0 0 0.0 255.0 ECU_ADDRESS 0x007FDE79 /begin FUNCTION_LIST PMDIAG /end FUNCTION_LIST BIT_MASK 0x4 /end MEASUREMENT
/begin MEASUREMENT St_pmdiag1.B_sv_ihka "Dient zum Aufziehen des internen Delay Timers" UBYTE Def_bit_ub_3 0 0 0.0 255.0 ECU_ADDRESS 0x007FDE79 /begin FUNCTION_LIST PMDIAG /end FUNCTION_LIST BIT_MASK 0x8 /end MEASUREMENT
/begin MEASUREMENT St_pmdiag1.B_ruhverl7 "Tiefentladungsbit, B_tiefset, im IBS löschen." UBYTE Def_bit_ub_4 0 0 0.0 255.0 ECU_ADDRESS 0x007FDE79 /begin FUNCTION_LIST PMDIAG /end FUNCTION_LIST BIT_MASK 0x10 /end MEASUREMENT
/begin MEASUREMENT St_pmdiag1.B_qelad1step "CC Meldung : erhoehter Ruhestrom" UBYTE Def_bit_ub_5 0 0 0.0 255.0 ECU_ADDRESS 0x007FDE79 /begin FUNCTION_LIST PMDIAG /end FUNCTION_LIST BIT_MASK 0x20 /end MEASUREMENT
/begin MEASUREMENT St_pmdiag1 "Statuswort" UBYTE Def_st_ub_q1 0 0 0.0 255.0000 ECU_ADDRESS 0x007FDE79 /begin FUNCTION_LIST PMDIAG /end FUNCTION_LIST /end MEASUREMENT
/begin MEASUREMENT St_pmdiagnv.B_ruhverl "ruhestromverletzung vorhanden" UBYTE Def_bit_ub_0 0 0 0.0 255.0 ECU_ADDRESS 0x007FDDF0 /begin FUNCTION_LIST PMDIAG /end FUNCTION_LIST BIT_MASK 0x1 /end MEASUREMENT
/begin MEASUREMENT St_pmdiagnv "Statuswort" UBYTE Def_st_ub_q1 0 0 0.0 255.0000 ECU_ADDRESS 0x007FDDF0 /begin FUNCTION_LIST PMDIAG /end FUNCTION_LIST /end MEASUREMENT
/begin MEASUREMENT Dqelad7 "diff = qelad-qeladold7" UWORD Def_ql_uw_q0p29127 0 0 0.0 19088.4522 ECU_ADDRESS 0x007FDE62 /begin FUNCTION_LIST PMDIAG /end FUNCTION_LIST /end MEASUREMENT
/begin MEASUREMENT Dqlad7 "diff = qlad-qladold7" UWORD Def_ql_uw_q0p29127 0 0 0.0 19088.4522 ECU_ADDRESS 0x007FDE64 /begin FUNCTION_LIST PMDIAG /end FUNCTION_LIST /end MEASUREMENT
/begin MEASUREMENT Qladzwsp7 "qlad uebertragspeicher" UWORD Def_dez_uw_q1 0 0 0.0 65535.0000 ECU_ADDRESS 0x007FDE66 /begin FUNCTION_LIST PMDIAG /end FUNCTION_LIST /end MEASUREMENT
/begin MEASUREMENT Stat_sv_reg "Status Standverbraucher registriert" UWORD Def_dez_uw_q1 0 0 0.0 65535.0000 ECU_ADDRESS 0x007FDE68 /begin FUNCTION_LIST PMDIAG /end FUNCTION_LIST /end MEASUREMENT
/begin MEASUREMENT T2hist "T2histitruh in sek." UWORD Def_td_uw_q14 0 0 0.0 917490.0000 ECU_ADDRESS 0x007FDE6A /begin FUNCTION_LIST PMDIAG /end FUNCTION_LIST /end MEASUREMENT
/begin MEASUREMENT T2pmcntr "T2PMINFO countdowncounter" UWORD Def_td_uw_q0p1 0 0 0.0 6553.5000 ECU_ADDRESS 0x007FDE6C /begin FUNCTION_LIST PMDIAG /end FUNCTION_LIST /end MEASUREMENT
/begin MEASUREMENT T3hist "T3histiruh in Sek" UWORD Def_td_uw_q14 0 0 0.0 917490.0000 ECU_ADDRESS 0x007FDE6E /begin FUNCTION_LIST PMDIAG /end FUNCTION_LIST /end MEASUREMENT
/begin MEASUREMENT T3pmcntr "T3PMINFO countdowncounter" UWORD Def_td_uw_q0p1 0 0 0.0 6553.5000 ECU_ADDRESS 0x007FDE70 /begin FUNCTION_LIST PMDIAG /end FUNCTION_LIST /end MEASUREMENT
/begin MEASUREMENT T4hist "T4histiruh in Sek" UWORD Def_td_uw_q14 0 0 0.0 917490.0000 ECU_ADDRESS 0x007FDE72 /begin FUNCTION_LIST PMDIAG /end FUNCTION_LIST /end MEASUREMENT
/begin MEASUREMENT T_histsum "Txhistiruh Summe" UWORD Def_td_uw_q56 0 0 0.0 3669960.0000 ECU_ADDRESS 0x007FDE74 /begin FUNCTION_LIST PMDIAG /end FUNCTION_LIST /end MEASUREMENT
/begin MEASUREMENT T_histsummin "Summe der Txhistiruh in Minuten" UWORD Def_td_uw_q0p933 0 0 0.0 61166.0000 ECU_ADDRESS 0x007FDE76 /begin FUNCTION_LIST PMDIAG /end FUNCTION_LIST /end MEASUREMENT
/begin MEASUREMENT Batt_index "Batterie Index" UBYTE Def_dez_ub_q1 0 0 0.0 255.0000 ECU_ADDRESS 0x007FDE7A /begin FUNCTION_LIST PMDIAG /end FUNCTION_LIST /end MEASUREMENT
/begin MEASUREMENT C_battnenn "Batteriekapazitaet" UBYTE Def_ql_ub_q1 0 0 0.0 255.0000 ECU_ADDRESS 0x007FDE7B /begin FUNCTION_LIST PMDIAG /end FUNCTION_LIST /end MEASUREMENT
/begin MEASUREMENT Codiercnt "Internet Zaehler fuer Anfrage Codierung" UBYTE Def_td_ub_q0p1 0 0 0.0 25.5000 ECU_ADDRESS 0x007FDE7C /begin FUNCTION_LIST PMDIAG /end FUNCTION_LIST /end MEASUREMENT
/begin MEASUREMENT Ibsbor_hb "highbyte ibsborctr" UBYTE Def_dez_ub_q1 0 0 0.0 255.0000 ECU_ADDRESS 0x007FDE7D /begin FUNCTION_LIST PMDIAG /end FUNCTION_LIST /end MEASUREMENT
/begin MEASUREMENT Ikurz_ogrz "Obere Grenze Kurzschlußstrom" UBYTE Def_i_ub_q10 0 0 0.0 2550.0000 ECU_ADDRESS 0x007FDE7E /begin FUNCTION_LIST PMDIAG /end FUNCTION_LIST /end MEASUREMENT
/begin MEASUREMENT Ikurz_ugrz "Untere Grenze Kurzschlußstrom" UBYTE Def_i_ub_q10 0 0 0.0 2550.0000 ECU_ADDRESS 0x007FDE7F /begin FUNCTION_LIST PMDIAG /end FUNCTION_LIST /end MEASUREMENT
/begin MEASUREMENT Iwakeupgrz "Ruhestromverletzungsgrenze, ab hier weckt u.U. das IBS." UBYTE Def_i_ub_q0p00125 0 0 0.0 0.2550 ECU_ADDRESS 0x007FDE80 /begin FUNCTION_LIST PMDIAG /end FUNCTION_LIST /end MEASUREMENT
/begin MEASUREMENT Ospgcnt "fs_Oberspannungscounter" UBYTE Def_td_ub_q0p1 0 0 0.0 25.5000 ECU_ADDRESS 0x007FDE81 /begin FUNCTION_LIST PMDIAG /end FUNCTION_LIST /end MEASUREMENT
/begin MEASUREMENT Ospgprell "Anzahl der entprellten FS_Oberspannungserkennung" UBYTE Def_dez_ub_q1 0 0 0.0 255.0000 ECU_ADDRESS 0x007FDE82 /begin FUNCTION_LIST PMDIAG /end FUNCTION_LIST /end MEASUREMENT
/begin MEASUREMENT Ospgstat "Status Oberspannungserkennung" UBYTE Def_dez_ub_q1 0 0 0.0 255.0000 ECU_ADDRESS 0x007FDE83 /begin FUNCTION_LIST PMDIAG /end FUNCTION_LIST /end MEASUREMENT
/begin MEASUREMENT Pm_klemmstat "Umweltbed. Klemmenstatus" UBYTE Def_dez_ub_q1 0 0 0.0 255.0000 ECU_ADDRESS 0x007FDE84 /begin FUNCTION_LIST PMDIAG /end FUNCTION_LIST /end MEASUREMENT
/begin MEASUREMENT Stat_sv_reg1 "LoByte Stat_sv_reg für Umweltbedingungen" UBYTE Def_dez_ub_q1 0 0 0.0 255.0000 ECU_ADDRESS 0x007FDE85 /begin FUNCTION_LIST PMDIAG /end FUNCTION_LIST /end MEASUREMENT
/begin MEASUREMENT Stat_sv_reg2 "HiByte Stat_sv_reg für Umweltbedinung" UBYTE Def_dez_ub_q1 0 0 0.0 255.0000 ECU_ADDRESS 0x007FDE86 /begin FUNCTION_LIST PMDIAG /end FUNCTION_LIST /end MEASUREMENT
/begin MEASUREMENT Svaus "Status Standverbraucher sind aus " UBYTE Identity 0 0 0.0 1.0000 ECU_ADDRESS 0x007FDE87 /begin FUNCTION_LIST PMDIAG /end FUNCTION_LIST /end MEASUREMENT
/begin MEASUREMENT T1histshort "T1 Histogramm in 14.9333 MIn. Quantisiert" UBYTE Def_td_ub_q14p9333 0 0 0.0 3808.0000 ECU_ADDRESS 0x007FDE88 /begin FUNCTION_LIST PMDIAG /end FUNCTION_LIST /end MEASUREMENT
/begin MEASUREMENT T1pmcntr "T1PMINFO countdowncounter" UBYTE Def_td_ub_q0p1 0 0 0.0 25.5000 ECU_ADDRESS 0x007FDE89 /begin FUNCTION_LIST PMDIAG /end FUNCTION_LIST /end MEASUREMENT
/begin MEASUREMENT T2histshort "T2 Histogramm als Umweltbed. bei Ruhestromverletzung" UBYTE Def_td_ub_q14p9333 0 0 0.0 3808.0000 ECU_ADDRESS 0x007FDE8A /begin FUNCTION_LIST PMDIAG /end FUNCTION_LIST /end MEASUREMENT
/begin MEASUREMENT T3histshort "T3 Histogramm als Umweltbed. bei Ruhestromverletzung" UBYTE Def_td_ub_q14p9333 0 0 0.0 3808.0000 ECU_ADDRESS 0x007FDE8B /begin FUNCTION_LIST PMDIAG /end FUNCTION_LIST /end MEASUREMENT
/begin MEASUREMENT T4histshort "T4 Histogramm als Umweltbed. bei Ruhestromverletzung" UBYTE Def_td_ub_q14p9333 0 0 0.0 3808.0000 ECU_ADDRESS 0x007FDE8C /begin FUNCTION_LIST PMDIAG /end FUNCTION_LIST /end MEASUREMENT
/begin MEASUREMENT T_saismem "T Saison zw. speicher" UBYTE Def_dez_ub_q1 0 0 0.0 255.0000 ECU_ADDRESS 0x007FDE8D /begin FUNCTION_LIST PMDIAG /end FUNCTION_LIST /end MEASUREMENT
/begin MEASUREMENT Uspgcnt "FS_Unterspannungscounter" UBYTE Def_td_ub_q0p1 0 0 0.0 25.5000 ECU_ADDRESS 0x007FDE8E /begin FUNCTION_LIST PMDIAG /end FUNCTION_LIST /end MEASUREMENT
/begin MEASUREMENT Uspgprell "Anzahl der entprellten FS_Unterspannungserkennung." UBYTE Def_dez_ub_q1 0 0 0.0 255.0000 ECU_ADDRESS 0x007FDE8F /begin FUNCTION_LIST PMDIAG /end FUNCTION_LIST /end MEASUREMENT
/begin MEASUREMENT Uspgstat "FS_Unterspannungsstatus" UBYTE Def_dez_ub_q1 0 0 0.0 255.0000 ECU_ADDRESS 0x007FDE90 /begin FUNCTION_LIST PMDIAG /end FUNCTION_LIST /end MEASUREMENT
/begin MEASUREMENT Ztagedelta "verstrichene Tage" UBYTE Def_dez_ub_q1 0 0 0.0 10.0000 ECU_ADDRESS 0x007FDE91 /begin FUNCTION_LIST PMDIAG /end FUNCTION_LIST /end MEASUREMENT
/begin MEASUREMENT Ztagestate "Tageswechsel Statemachine Ctr" UBYTE Def_dez_ub_q1 0 0 0.0 255.0000 ECU_ADDRESS 0x007FDE92 /begin FUNCTION_LIST PMDIAG /end FUNCTION_LIST /end MEASUREMENT
/begin MEASUREMENT Pminfo1 "Infospeicher 1 vom Powermanagement" UWORD Def_dez_uw_q1 0 0 0.0 65535.0000 ECU_ADDRESS 0x007FDDF2 ARRAY_SIZE 37 /begin FUNCTION_LIST PMDIAG /end FUNCTION_LIST /end MEASUREMENT
/begin MEASUREMENT Qeladold7 "zuletzt gesp. qelad" UWORD Def_ql_uw_q0p0182 0 0 0.0 1193.0282 ECU_ADDRESS 0x007FDE3C /begin FUNCTION_LIST PMDIAG /end FUNCTION_LIST /end MEASUREMENT
/begin MEASUREMENT Qladold7 "zuletzt gesp. qlad" UWORD Def_ql_uw_q0p0182 0 0 0.0 1193.0282 ECU_ADDRESS 0x007FDE3E /begin FUNCTION_LIST PMDIAG /end FUNCTION_LIST /end MEASUREMENT
/begin MEASUREMENT Ztageold "letzter Wert von ztageabs_w" UWORD Def_dez_uw_q1 0 0 0.0 65535.0000 ECU_ADDRESS 0x007FDE40 /begin FUNCTION_LIST PMDIAG /end FUNCTION_LIST /end MEASUREMENT
/begin MEASUREMENT Fs_pm "Fehlerspeicher Powermanagement, Bitcodiert" UBYTE Def_dez_ub_q1 0 0 0.0 255.0000 ECU_ADDRESS 0x007FDE42 /begin FUNCTION_LIST PMDIAG /end FUNCTION_LIST /end MEASUREMENT
/begin MEASUREMENT Pminfo2 "Fehlerinfo2 vom Powermanagement" UBYTE Def_dez_ub_q1 0 0 0.0 255.0000 ECU_ADDRESS 0x007FDE44 ARRAY_SIZE 29 /begin FUNCTION_LIST PMDIAG /end FUNCTION_LIST /end MEASUREMENT
/begin MEASUREMENT St_pmprsvcalc.B_ubtlow "Bedingung Batterie in Unterspannungszustand" UBYTE Def_bit_ub_0 0 0 0.0 255.0 ECU_ADDRESS 0x007FDF20 /begin FUNCTION_LIST PMPRSVCALC /end FUNCTION_LIST BIT_MASK 0x1 /end MEASUREMENT
/begin MEASUREMENT St_pmprsvcalc.B_uloreset "Bedingung Batterie nicht mehr in Unterspannungszustand" UBYTE Def_bit_ub_1 0 0 0.0 255.0 ECU_ADDRESS 0x007FDF20 /begin FUNCTION_LIST PMPRSVCALC /end FUNCTION_LIST BIT_MASK 0x2 /end MEASUREMENT
/begin MEASUREMENT St_pmprsvcalc.B_ipmtimer "IPM Timer für Prios aktiv" UBYTE Def_bit_ub_2 0 0 0.0 255.0 ECU_ADDRESS 0x007FDF20 /begin FUNCTION_LIST PMPRSVCALC /end FUNCTION_LIST BIT_MASK 0x4 /end MEASUREMENT
/begin MEASUREMENT St_pmprsvcalc.B_ipmaktiv "IPM Massnahmen bzgl. Prios aktiviert" UBYTE Def_bit_ub_3 0 0 0.0 255.0 ECU_ADDRESS 0x007FDF20 /begin FUNCTION_LIST PMPRSVCALC /end FUNCTION_LIST BIT_MASK 0x8 /end MEASUREMENT
/begin MEASUREMENT St_pmprsvcalc.B_kwdr_old "Dient zur Erkennung einer steigender Flanke B_kl15" UBYTE Def_bit_ub_4 0 0 0.0 255.0 ECU_ADDRESS 0x007FDF20 /begin FUNCTION_LIST PMPRSVCALC /end FUNCTION_LIST BIT_MASK 0x10 /end MEASUREMENT
/begin MEASUREMENT St_pmprsvcalc.B_gendef "Bedingung Generator defekt während Motorbetrieb" UBYTE Def_bit_ub_5 0 0 0.0 255.0 ECU_ADDRESS 0x007FDF20 /begin FUNCTION_LIST PMPRSVCALC /end FUNCTION_LIST BIT_MASK 0x20 /end MEASUREMENT
/begin MEASUREMENT St_pmprsvcalc.B_nkwptcio "NKW status für PTC i.o." UBYTE Def_bit_ub_6 0 0 0.0 255.0 ECU_ADDRESS 0x007FDF20 /begin FUNCTION_LIST PMPRSVCALC /end FUNCTION_LIST BIT_MASK 0x40 /end MEASUREMENT
/begin MEASUREMENT St_pmprsvcalc.B_ptckoor "PTC Koordinator Maßnahmen Aktiv" UBYTE Def_bit_ub_7 0 0 0.0 255.0 ECU_ADDRESS 0x007FDF20 /begin FUNCTION_LIST PMPRSVCALC /end FUNCTION_LIST BIT_MASK 0x80 /end MEASUREMENT
/begin MEASUREMENT St_pmprsvcalc "Statuswort" UBYTE Def_st_ub_q1 0 0 0.0 255.0000 ECU_ADDRESS 0x007FDF20 /begin FUNCTION_LIST PMPRSVCALC /end FUNCTION_LIST /end MEASUREMENT
/begin MEASUREMENT St_pmprsvcalc1.B_enwakeup "Bit, ob IBS Bus wecken darf oder nicht." UBYTE Def_bit_ub_0 0 0 0.0 255.0 ECU_ADDRESS 0x007FDF21 /begin FUNCTION_LIST PMPRSVCALC /end FUNCTION_LIST BIT_MASK 0x1 /end MEASUREMENT
/begin MEASUREMENT St_pmprsvcalc1.B_dubt "Bedg., ob dubt > 100mV" UBYTE Def_bit_ub_1 0 0 0.0 255.0 ECU_ADDRESS 0x007FDF21 /begin FUNCTION_LIST PMPRSVCALC /end FUNCTION_LIST BIT_MASK 0x2 /end MEASUREMENT
/begin MEASUREMENT St_pmprsvcalc1.B_pmvsdanf "Bedg., ob 3b3 versendet wird" UBYTE Def_bit_ub_2 0 0 0.0 255.0 ECU_ADDRESS 0x007FDF21 /begin FUNCTION_LIST PMPRSVCALC /end FUNCTION_LIST BIT_MASK 0x4 /end MEASUREMENT
/begin MEASUREMENT St_pmprsvcalc1.B_pmbsdanf "Bedg. ob 3b4 versendet wird" UBYTE Def_bit_ub_4 0 0 0.0 255.0 ECU_ADDRESS 0x007FDF21 /begin FUNCTION_LIST PMPRSVCALC /end FUNCTION_LIST BIT_MASK 0x10 /end MEASUREMENT
/begin MEASUREMENT St_pmprsvcalc1.B_limcalc "Bedg. begrenzte Berechnung" UBYTE Def_bit_ub_5 0 0 0.0 255.0 ECU_ADDRESS 0x007FDF21 /begin FUNCTION_LIST PMPRSVCALC /end FUNCTION_LIST BIT_MASK 0x20 /end MEASUREMENT
/begin MEASUREMENT St_pmprsvcalc1.B_notprsv "Bed.Notlauf aufg.Batt-Unterspg, Generatorstat und B_kl15 in PMPRSVCALC" UBYTE Def_bit_ub_6 0 0 0.0 255.0 ECU_ADDRESS 0x007FDF21 /begin FUNCTION_LIST PMPRSVCALC /end FUNCTION_LIST BIT_MASK 0x40 /end MEASUREMENT
/begin MEASUREMENT St_pmprsvcalc1.B_pireset "Bedingung für PI-Reset" UBYTE Def_bit_ub_7 0 0 0.0 255.0 ECU_ADDRESS 0x007FDF21 /begin FUNCTION_LIST PMPRSVCALC /end FUNCTION_LIST BIT_MASK 0x80 /end MEASUREMENT
/begin MEASUREMENT St_pmprsvcalc1 "Statuswort" UBYTE Def_st_ub_q1 0 0 0.0 255.0000 ECU_ADDRESS 0x007FDF21 /begin FUNCTION_LIST PMPRSVCALC /end FUNCTION_LIST /end MEASUREMENT
/begin MEASUREMENT St_pmprsvcalc2.B_kwdrise "Motorstart Rising" UBYTE Def_bit_ub_0 0 0 0.0 255.0 ECU_ADDRESS 0x007FDF22 /begin FUNCTION_LIST PMPRSVCALC /end FUNCTION_LIST BIT_MASK 0x1 /end MEASUREMENT
/begin MEASUREMENT St_pmprsvcalc2.B_pmsulevon "PM Sulev Maßnahmen aktiv" UBYTE Def_bit_ub_1 0 0 0.0 255.0 ECU_ADDRESS 0x007FDF22 /begin FUNCTION_LIST PMPRSVCALC /end FUNCTION_LIST BIT_MASK 0x2 /end MEASUREMENT
/begin MEASUREMENT St_pmprsvcalc2.B_genkommerr "Nur Gen. Komm. Fehler vorhanden" UBYTE Def_bit_ub_2 0 0 0.0 255.0 ECU_ADDRESS 0x007FDF22 /begin FUNCTION_LIST PMPRSVCALC /end FUNCTION_LIST BIT_MASK 0x4 /end MEASUREMENT
/begin MEASUREMENT St_pmprsvcalc2 "Statuswort" UBYTE Def_st_ub_q1 0 0 0.0 255.0000 ECU_ADDRESS 0x007FDF22 /begin FUNCTION_LIST PMPRSVCALC /end FUNCTION_LIST /end MEASUREMENT
/begin MEASUREMENT St_pmprsv_nv.B_enwake7 "lokales B_enwake" UBYTE Def_bit_ub_0 0 0 0.0 255.0 ECU_ADDRESS 0x007FDE93 /begin FUNCTION_LIST PMPRSVCALC /end FUNCTION_LIST BIT_MASK 0x1 /end MEASUREMENT
/begin MEASUREMENT St_pmprsv_nv "Statuswort" UBYTE Def_st_ub_q1 0 0 0.0 255.0000 ECU_ADDRESS 0x007FDE93 /begin FUNCTION_LIST PMPRSVCALC /end FUNCTION_LIST /end MEASUREMENT
/begin MEASUREMENT Priopizw1 "Pi-Regler zw1" SLONG Def_f_sl_q0p007 0 0 -512.0000 512.0000 ECU_ADDRESS 0x007FDEEC /begin FUNCTION_LIST PMPRSVCALC /end FUNCTION_LIST /end MEASUREMENT
/begin MEASUREMENT Priopizw2 "Pi-Regler zw2" SLONG Def_f_sl_q0p007 0 0 -512.0000 512.0000 ECU_ADDRESS 0x007FDEF0 /begin FUNCTION_LIST PMPRSVCALC /end FUNCTION_LIST /end MEASUREMENT
/begin MEASUREMENT Ptcpizw1 "PTC PI Regler zw1" SLONG Def_f_sl_q0p007 0 0 -512.0000 512.0000 ECU_ADDRESS 0x007FDEF4 /begin FUNCTION_LIST PMPRSVCALC /end FUNCTION_LIST /end MEASUREMENT
/begin MEASUREMENT Ptcpizw2 "PTC PI zw2" SLONG Def_f_sl_q0p007 0 0 -512.0000 512.0000 ECU_ADDRESS 0x007FDEF8 /begin FUNCTION_LIST PMPRSVCALC /end FUNCTION_LIST /end MEASUREMENT
/begin MEASUREMENT All2ptc "Gesamtgewichtung für PTC-Ansteuerung" SWORD Def_f_sw_p0q25 0 0 -500.0000 550.0000 ECU_ADDRESS 0x007FDE96 /begin FUNCTION_LIST PMPRSVCALC /end FUNCTION_LIST /end MEASUREMENT
/begin MEASUREMENT Df2pi "DF-Gewichtung auf Prios" SWORD Def_f_sw_p0q25 0 0 -100.0000 100.0000 ECU_ADDRESS 0x007FDE98 /begin FUNCTION_LIST PMPRSVCALC /end FUNCTION_LIST /end MEASUREMENT
/begin MEASUREMENT Dfall2pi "Gesamtgewichtung auf Prios" SWORD Def_f_sw_p0q25 0 0 -500.0000 500.0000 ECU_ADDRESS 0x007FDE9A /begin FUNCTION_LIST PMPRSVCALC /end FUNCTION_LIST /end MEASUREMENT
/begin MEASUREMENT Dfpi2ptc "Gewichtung der Prios -> Gewichtung für PTC Ansteuerung" SWORD Def_f_sw_p0q25 0 0 -100.0000 100.0000 ECU_ADDRESS 0x007FDE9C /begin FUNCTION_LIST PMPRSVCALC /end FUNCTION_LIST /end MEASUREMENT
/begin MEASUREMENT Dfpt1_2ptc "gefiltertes dffgen Gewichtung auf PTC-Ansteuerung" SWORD Def_f_sw_p0q25 0 0 -100.0000 100.0000 ECU_ADDRESS 0x007FDE9E /begin FUNCTION_LIST PMPRSVCALC /end FUNCTION_LIST /end MEASUREMENT
/begin MEASUREMENT Dsoc2pi "Batterieladezustand-Gewichtung auf Prios" SWORD Def_f_sw_p0q25 0 0 -150.0000 150.0000 ECU_ADDRESS 0x007FDEA0 /begin FUNCTION_LIST PMPRSVCALC /end FUNCTION_LIST /end MEASUREMENT
/begin MEASUREMENT Dsoc2ptc "dsoc Gewichtung auf PTC-Ansteuerung" SWORD Def_f_sw_p0q25 0 0 -150.0000 150.0000 ECU_ADDRESS 0x007FDEA2 /begin FUNCTION_LIST PMPRSVCALC /end FUNCTION_LIST /end MEASUREMENT
/begin MEASUREMENT Dudtmul "PTC dudt : gewichtetes Dudt" SWORD Def_f_sw_q0p000147 0 0 -48.2304 48.2289 ECU_ADDRESS 0x007FDEA4 /begin FUNCTION_LIST PMPRSVCALC /end FUNCTION_LIST /end MEASUREMENT
/begin MEASUREMENT Ibtdiff2pi "Batterie-soll-strom Gewichtung auf Prios" SWORD Def_f_sw_p0q25 0 0 -100.0000 100.0000 ECU_ADDRESS 0x007FDEA6 /begin FUNCTION_LIST PMPRSVCALC /end FUNCTION_LIST /end MEASUREMENT
/begin MEASUREMENT Idiff2ptc "idiff Gewichtung auf die PTC-Ansteuerung" SWORD Def_f_sw_p0q25 0 0 -100.0000 100.0000 ECU_ADDRESS 0x007FDEA8 /begin FUNCTION_LIST PMPRSVCALC /end FUNCTION_LIST /end MEASUREMENT
/begin MEASUREMENT Pgen2ptc "Gewichtung der Generatorrestleistung für PTC-Ansteuerung" SWORD Def_f_sw_p0q25 0 0 -100.0000 100.0000 ECU_ADDRESS 0x007FDEAA /begin FUNCTION_LIST PMPRSVCALC /end FUNCTION_LIST /end MEASUREMENT
/begin MEASUREMENT Ubdiff "ubattsoll - ubatt_w" SWORD Def_f_sw_b32 0 0 -32.0000 31.9990 ECU_ADDRESS 0x007FDEAC /begin FUNCTION_LIST PMPRSVCALC /end FUNCTION_LIST /end MEASUREMENT
/begin MEASUREMENT Ubdiff2pi "Ubatt-Differenz-Gewichtung auf Prios" SWORD Def_f_sw_p0q25 0 0 -100.0000 100.0000 ECU_ADDRESS 0x007FDEAE /begin FUNCTION_LIST PMPRSVCALC /end FUNCTION_LIST /end MEASUREMENT
/begin MEASUREMENT Ubt7mem "resultierendes ubt" SWORD Def_u_sw_b128 0 0 -128.0000 127.9960 ECU_ADDRESS 0x007FDEB0 /begin FUNCTION_LIST PMPRSVCALC /end FUNCTION_LIST /end MEASUREMENT
/begin MEASUREMENT Ubtpt12ptc "Ubatt Gewichtung für PTC Ansteuerung" SWORD Def_f_sw_p0q25 0 0 -100.0000 100.0000 ECU_ADDRESS 0x007FDEB2 /begin FUNCTION_LIST PMPRSVCALC /end FUNCTION_LIST /end MEASUREMENT
/begin MEASUREMENT Udeltac "inkrementierte Differenz zwischen altem und neuem ubt" SWORD Def_u_sw_b128 0 0 -128.0000 127.9960 ECU_ADDRESS 0x007FDEB4 /begin FUNCTION_LIST PMPRSVCALC /end FUNCTION_LIST /end MEASUREMENT
/begin MEASUREMENT Ubdiffilt "Wert nach Ubdiff-Tiefpass Prio" SWORD Def_f_sw_b32 0 0 -32.0000 31.9990 ECU_ADDRESS 0x007FDEE6 /begin FUNCTION_LIST PMPRSVCALC /end FUNCTION_LIST /end MEASUREMENT
/begin MEASUREMENT Ubdiffptc "Delta Usoll-Ubatt PTC" SWORD Def_f_sw_b32 0 0 -32.0000 31.9990 ECU_ADDRESS 0x007FDEE8 /begin FUNCTION_LIST PMPRSVCALC /end FUNCTION_LIST /end MEASUREMENT
/begin MEASUREMENT Ubtpt1ptc "Ubdiffptc gefiltert" SWORD Def_f_sw_b32 0 0 -32.0000 31.9990 ECU_ADDRESS 0x007FDEEA /begin FUNCTION_LIST PMPRSVCALC /end FUNCTION_LIST /end MEASUREMENT
/begin MEASUREMENT Allptcfilt "pi-geregelte Gewichtung für PTC-Ansteuerung" UWORD Def_f_uw_q0p25 0 0 0.0 550.0000 ECU_ADDRESS 0x007FDEB6 /begin FUNCTION_LIST PMPRSVCALC /end FUNCTION_LIST /end MEASUREMENT
/begin MEASUREMENT Ctrpwrcf "Komfort-Teil von ctrpwrcos" UWORD Def_dez_uw_q1 0 0 0.0 65535.0000 ECU_ADDRESS 0x007FDEB8 /begin FUNCTION_LIST PMPRSVCALC /end FUNCTION_LIST /end MEASUREMENT
/begin MEASUREMENT Ctrpwrcos "Steuerung_Leistung_Verbraucher" UWORD Def_dez_uw_q1 0 0 0.0 65535.0000 ECU_ADDRESS 0x007FDEBA /begin FUNCTION_LIST PMPRSVCALC /end FUNCTION_LIST /end MEASUREMENT
/begin MEASUREMENT Ctrpwrcos7 "lokales ctrpwrcos" UWORD Def_dez_uw_q1 0 0 0.0 65535.0000 ECU_ADDRESS 0x007FDEBC /begin FUNCTION_LIST PMPRSVCALC /end FUNCTION_LIST /end MEASUREMENT
/begin MEASUREMENT Ctrpwrdf "df-Teil von ctrpwrcos" UWORD Def_dez_uw_q1 0 0 0.0 65535.0000 ECU_ADDRESS 0x007FDEBE /begin FUNCTION_LIST PMPRSVCALC /end FUNCTION_LIST /end MEASUREMENT
/begin MEASUREMENT Ctrpwrmem "altes ctrpwrcos" UWORD Def_dez_uw_q1 0 0 0.0 65535.0000 ECU_ADDRESS 0x007FDEC0 /begin FUNCTION_LIST PMPRSVCALC /end FUNCTION_LIST /end MEASUREMENT
/begin MEASUREMENT Dfallpi "PI-Geregelte Gesamtgewichtung auf Prios" UWORD Def_f_uw_q0p25 0 0 0.0 450.0000 ECU_ADDRESS 0x007FDEC2 /begin FUNCTION_LIST PMPRSVCALC /end FUNCTION_LIST /end MEASUREMENT
/begin MEASUREMENT Dfprio "" UWORD Def_f_uw_q0p25 0 0 0.0 450.0000 ECU_ADDRESS 0x007FDEC4 /begin FUNCTION_LIST PMPRSVCALC /end FUNCTION_LIST /end MEASUREMENT
/begin MEASUREMENT F_dudtptc "Inkrement auf Ptc_pwr aufgrund du/dt" UWORD Def_f_uw_q0p25 0 0 0.0 550.0000 ECU_ADDRESS 0x007FDEC6 /begin FUNCTION_LIST PMPRSVCALC /end FUNCTION_LIST /end MEASUREMENT
/begin MEASUREMENT Ibtdiff "Delta Ibtsoll-Ibatt" UWORD Def_i_uw_q0p08_o200 0 0 -200.0000 5042.8000 ECU_ADDRESS 0x007FDEC8 /begin FUNCTION_LIST PMPRSVCALC /end FUNCTION_LIST /end MEASUREMENT
/begin MEASUREMENT Ibtsoll "Sollstrom aufgrund von tbatt und dsoc" UWORD Def_i_uw_q0p08_o200 0 0 -200.0000 5042.8000 ECU_ADDRESS 0x007FDECA /begin FUNCTION_LIST PMPRSVCALC /end FUNCTION_LIST /end MEASUREMENT
/begin MEASUREMENT Ipmdfprio "lokale Prioberechnungsvariable bei IPM aktiv" UWORD Def_f_uw_q0p25 0 0 0.0 450.0000 ECU_ADDRESS 0x007FDECC /begin FUNCTION_LIST PMPRSVCALC /end FUNCTION_LIST /end MEASUREMENT
/begin MEASUREMENT Isolldiff "Differenz isoll - ibatt_w für PTC Ansteuerung" UWORD Def_i_uw_q0p08_o200 0 0 -200.0000 5042.8000 ECU_ADDRESS 0x007FDECE /begin FUNCTION_LIST PMPRSVCALC /end FUNCTION_LIST /end MEASUREMENT
/begin MEASUREMENT Memprio1 "memory 1 PI-Regler dfall2pi E60Prio" UWORD Def_f_uw_b512 0 0 0.0 511.9921 ECU_ADDRESS 0x007FDED0 /begin FUNCTION_LIST PMPRSVCALC /end FUNCTION_LIST /end MEASUREMENT
/begin MEASUREMENT Memprio2 "memory 2 PI-Regler dfall2pi E60Prio" UWORD Def_f_uw_b512 0 0 0.0 511.9921 ECU_ADDRESS 0x007FDED2 /begin FUNCTION_LIST PMPRSVCALC /end FUNCTION_LIST /end MEASUREMENT
/begin MEASUREMENT Memptc1 "memory 1 PI-Regler all2ptc PTC" UWORD Def_f_uw_b512 0 0 0.0 511.9921 ECU_ADDRESS 0x007FDED4 /begin FUNCTION_LIST PMPRSVCALC /end FUNCTION_LIST /end MEASUREMENT
/begin MEASUREMENT Memptc2 "memory 2 PI-Regler all2ptc PTC" UWORD Def_f_uw_b512 0 0 0.0 511.9921 ECU_ADDRESS 0x007FDED6 /begin FUNCTION_LIST PMPRSVCALC /end FUNCTION_LIST /end MEASUREMENT
/begin MEASUREMENT Pgenrest "Generatorrestleistung (igenrest*ubatt_w)" UWORD Def_f_uw_q0p25 0 0 0.0 6400.0000 ECU_ADDRESS 0x007FDED8 /begin FUNCTION_LIST PMPRSVCALC /end FUNCTION_LIST /end MEASUREMENT
/begin MEASUREMENT Ptcadd "Wg. Spgeinbruch zu addierender PTC Faktor" UWORD Def_f_uw_q0p25 0 0 0.0 550.0000 ECU_ADDRESS 0x007FDEDA /begin FUNCTION_LIST PMPRSVCALC /end FUNCTION_LIST /end MEASUREMENT
/begin MEASUREMENT Ubold7 "PTC dudt : alter Ub Wert zur Differenzbildung" UWORD Def_u_uw_q0p0942 0 0 0.0 6173.3970 ECU_ADDRESS 0x007FDEDC /begin FUNCTION_LIST PMPRSVCALC /end FUNCTION_LIST /end MEASUREMENT
/begin MEASUREMENT Ubt "Batteriespannung" UWORD Def_u_uw_q0p015 0 0 0.0 983.0250 ECU_ADDRESS 0x007FDEDE /begin FUNCTION_LIST PMPRSVCALC /end FUNCTION_LIST /end MEASUREMENT
/begin MEASUREMENT Ubt7 "Lokale Batteriespannung" UWORD Def_u_uw_q0p015 0 0 0.0 61.4250 ECU_ADDRESS 0x007FDEE0 /begin FUNCTION_LIST PMPRSVCALC /end FUNCTION_LIST /end MEASUREMENT
/begin MEASUREMENT Ubt7old "altes ubt" UWORD Def_u_uw_q0p015 0 0 0.0 61.4250 ECU_ADDRESS 0x007FDEE2 /begin FUNCTION_LIST PMPRSVCALC /end FUNCTION_LIST /end MEASUREMENT
/begin MEASUREMENT Udeltaabsc "absoluter Wert von udelta" UWORD Def_u_uw_q0p015 0 0 0.0 61.4250 ECU_ADDRESS 0x007FDEE4 /begin FUNCTION_LIST PMPRSVCALC /end FUNCTION_LIST /end MEASUREMENT
/begin MEASUREMENT D_udtptc "Spannungsdifferenz in 10ms" SBYTE Def_u_sb_q0p0942 0 0 -12.0576 11.9634 ECU_ADDRESS 0x007FDEFC /begin FUNCTION_LIST PMPRSVCALC /end FUNCTION_LIST /end MEASUREMENT
/begin MEASUREMENT Ctrcbr "Steuerung_Stromzweige" UBYTE Def_dez_ub_q1 0 0 0.0 255.0000 ECU_ADDRESS 0x007FDEFD /begin FUNCTION_LIST PMPRSVCALC /end FUNCTION_LIST /end MEASUREMENT
/begin MEASUREMENT Ctrcbr7 "lokales ctrcbr" UBYTE Def_dez_ub_q1 0 0 0.0 255.0000 ECU_ADDRESS 0x007FDEFE /begin FUNCTION_LIST PMPRSVCALC /end FUNCTION_LIST /end MEASUREMENT
/begin MEASUREMENT Ctrcbrmem "altes ctrbr" UBYTE Def_dez_ub_q1 0 0 0.0 255.0000 ECU_ADDRESS 0x007FDEFF /begin FUNCTION_LIST PMPRSVCALC /end FUNCTION_LIST /end MEASUREMENT
/begin MEASUREMENT Ctrpcos "Steuerung_Standverbraucher" UBYTE Def_dez_ub_q1 0 0 0.0 3.0000 ECU_ADDRESS 0x007FDF00 /begin FUNCTION_LIST PMPRSVCALC /end FUNCTION_LIST /end MEASUREMENT
/begin MEASUREMENT Ctrpcosmem "altes ctrpcos" UBYTE Def_dez_ub_q1 0 0 0.0 3.0000 ECU_ADDRESS 0x007FDF01 /begin FUNCTION_LIST PMPRSVCALC /end FUNCTION_LIST /end MEASUREMENT
/begin MEASUREMENT Ctrprio "Steuerung_Spitzenreduzierung_Priorität" UBYTE Def_dez_ub_q1 0 0 0.0 7.0000 ECU_ADDRESS 0x007FDF02 /begin FUNCTION_LIST PMPRSVCALC /end FUNCTION_LIST /end MEASUREMENT
/begin MEASUREMENT Ctrprio7 "lokales ctrprio" UBYTE Def_dez_ub_q1 0 0 0.0 7.0000 ECU_ADDRESS 0x007FDF03 /begin FUNCTION_LIST PMPRSVCALC /end FUNCTION_LIST /end MEASUREMENT
/begin MEASUREMENT Ctrpriocf "Steuerung_Spitzenreduzierung_Priorität_Komfort" UBYTE Def_dez_ub_q1 0 0 0.0 7.0000 ECU_ADDRESS 0x007FDF04 /begin FUNCTION_LIST PMPRSVCALC /end FUNCTION_LIST /end MEASUREMENT
/begin MEASUREMENT Ctrpriocf7 "lokales ctrpriocf" UBYTE Def_dez_ub_q1 0 0 0.0 7.0000 ECU_ADDRESS 0x007FDF05 /begin FUNCTION_LIST PMPRSVCALC /end FUNCTION_LIST /end MEASUREMENT
/begin MEASUREMENT Ctrpriocfm "altes ctrpriocf" UBYTE Def_dez_ub_q1 0 0 0.0 7.0000 ECU_ADDRESS 0x007FDF06 /begin FUNCTION_LIST PMPRSVCALC /end FUNCTION_LIST /end MEASUREMENT
/begin MEASUREMENT Ctrpriomem "altes ctrprio" UBYTE Def_dez_ub_q1 0 0 0.0 7.0000 ECU_ADDRESS 0x007FDF07 /begin FUNCTION_LIST PMPRSVCALC /end FUNCTION_LIST /end MEASUREMENT
/begin MEASUREMENT Ctrpwspcos "Steuerung_Leistung_Sonderverbraucher" UBYTE Def_f_ub_b127p5 0 0 0.0 127.5000 ECU_ADDRESS 0x007FDF08 /begin FUNCTION_LIST PMPRSVCALC /end FUNCTION_LIST /end MEASUREMENT
/begin MEASUREMENT Dff_filt7 "lokales dffgenflit" UBYTE Def_f_ub_b100 0 0 0.0 99.6093 ECU_ADDRESS 0x007FDF09 /begin FUNCTION_LIST PMPRSVCALC /end FUNCTION_LIST /end MEASUREMENT
/begin MEASUREMENT Dfgenfilt "Über PT-1 gefiltertes dffgen-Signal" UBYTE Def_f_ub_b100 0 0 0.0 99.6093 ECU_ADDRESS 0x007FDF0A /begin FUNCTION_LIST PMPRSVCALC /end FUNCTION_LIST /end MEASUREMENT
/begin MEASUREMENT Picntr "Counter fuer PI-Reset" UBYTE Def_td_ub_q0p1 0 0 0.0 25.5000 ECU_ADDRESS 0x007FDF0B /begin FUNCTION_LIST PMPRSVCALC /end FUNCTION_LIST /end MEASUREMENT
/begin MEASUREMENT Pmbscount "zyklisches Senden entspricht 5 sek" UBYTE Def_dez_ub_q1 0 0 0.0 255.0000 ECU_ADDRESS 0x007FDF0C /begin FUNCTION_LIST PMPRSVCALC /end FUNCTION_LIST /end MEASUREMENT
/begin MEASUREMENT Pmvscount "Zähler bis zum nächsten zyklischen Senden von 3b3" UBYTE Def_dez_ub_q1 0 0 0.0 255.0000 ECU_ADDRESS 0x007FDF0D /begin FUNCTION_LIST PMPRSVCALC /end FUNCTION_LIST /end MEASUREMENT
/begin MEASUREMENT Ptc_pwr "Maximale Leistung, die der PTC einstellen darf." UBYTE Def_f_ub_b127p5 0 0 0.0 127.5000 ECU_ADDRESS 0x007FDF0E /begin FUNCTION_LIST PMPRSVCALC /end FUNCTION_LIST /end MEASUREMENT
/begin MEASUREMENT Ptc_pwr7 "lokales ptc_pwr" UBYTE Def_f_ub_b127p5 0 0 0.0 127.5000 ECU_ADDRESS 0x007FDF0F /begin FUNCTION_LIST PMPRSVCALC /end FUNCTION_LIST /end MEASUREMENT
/begin MEASUREMENT Pwrspmem "altes ctrpwspcos" UBYTE Def_f_ub_b127p5 0 0 0.0 127.5000 ECU_ADDRESS 0x007FDF10 /begin FUNCTION_LIST PMPRSVCALC /end FUNCTION_LIST /end MEASUREMENT
/begin MEASUREMENT Rqpcos "Anforderung_Standverbraucher" UBYTE Def_dez_ub_q1 0 0 0.0 3.0000 ECU_ADDRESS 0x007FDF11 /begin FUNCTION_LIST PMPRSVCALC /end FUNCTION_LIST /end MEASUREMENT
/begin MEASUREMENT Rqpcos7 "lokales rqpcos" UBYTE Def_dez_ub_q1 0 0 0.0 3.0000 ECU_ADDRESS 0x007FDF12 /begin FUNCTION_LIST PMPRSVCALC /end FUNCTION_LIST /end MEASUREMENT
/begin MEASUREMENT Rqpcosmem "altes rqpcos" UBYTE Def_dez_ub_q1 0 0 0.0 3.0000 ECU_ADDRESS 0x007FDF13 /begin FUNCTION_LIST PMPRSVCALC /end FUNCTION_LIST /end MEASUREMENT
/begin MEASUREMENT Selspcos "Auswahl_Sonderverbraucher" UBYTE Def_dez_ub_q1 0 0 0.0 15.0000 ECU_ADDRESS 0x007FDF14 /begin FUNCTION_LIST PMPRSVCALC /end FUNCTION_LIST /end MEASUREMENT
/begin MEASUREMENT Selspcosme "altes selspcos" UBYTE Def_dez_ub_q1 0 0 0.0 15.0000 ECU_ADDRESS 0x007FDF15 /begin FUNCTION_LIST PMPRSVCALC /end FUNCTION_LIST /end MEASUREMENT
/begin MEASUREMENT Stpcos "Status_Standverbraucher" UBYTE Def_dez_ub_q1 0 0 0.0 3.0000 ECU_ADDRESS 0x007FDF16 /begin FUNCTION_LIST PMPRSVCALC /end FUNCTION_LIST /end MEASUREMENT
/begin MEASUREMENT Stpcosmem "altes stpcos" UBYTE Def_dez_ub_q1 0 0 0.0 3.0000 ECU_ADDRESS 0x007FDF17 /begin FUNCTION_LIST PMPRSVCALC /end FUNCTION_LIST /end MEASUREMENT
/begin MEASUREMENT Ulev "Spannungsebene" UBYTE Def_dez_ub_q1 0 0 0.0 15.0000 ECU_ADDRESS 0x007FDF18 /begin FUNCTION_LIST PMPRSVCALC /end FUNCTION_LIST /end MEASUREMENT
/begin MEASUREMENT Ulevmem "altes ulev" UBYTE Def_dez_ub_q1 0 0 0.0 15.0000 ECU_ADDRESS 0x007FDF19 /begin FUNCTION_LIST PMPRSVCALC /end FUNCTION_LIST /end MEASUREMENT
/begin MEASUREMENT Ulow "Unterspannungsstatus : 0=i.O, 1=in between, 2=unterspannung" UBYTE Def_dez_ub_q1 0 0 0.0 255.0000 ECU_ADDRESS 0x007FDF1A /begin FUNCTION_LIST PMPRSVCALC /end FUNCTION_LIST /end MEASUREMENT
/begin MEASUREMENT Ulowtimer "Zeit zur Unterspannungserkennung * Taskzeit (50*100ms = 5sec)" UBYTE Def_td_ub_q0p1 0 0 0.0 25.5000 ECU_ADDRESS 0x007FDF1B /begin FUNCTION_LIST PMPRSVCALC /end FUNCTION_LIST /end MEASUREMENT
/begin MEASUREMENT kbmcount "Counter, gesetzt von KBMCNT_APP" UBYTE Def_td_ub_q0p1 0 0 0.0 25.5000 ECU_ADDRESS 0x007FDF1C /begin FUNCTION_LIST PMPRSVCALC /end FUNCTION_LIST /end MEASUREMENT
/begin MEASUREMENT Dfpt1filt "Wert nach DF-Tiefpass Prio" UBYTE Def_f_ub_b100 0 0 0.0 99.6093 ECU_ADDRESS 0x007FDF1D /begin FUNCTION_LIST PMPRSVCALC /end FUNCTION_LIST /end MEASUREMENT
/begin MEASUREMENT Dfpt1ptc "Wert nach DFFGEN-Filter PTC" UBYTE Def_f_ub_b100 0 0 0.0 99.6093 ECU_ADDRESS 0x007FDF1E /begin FUNCTION_LIST PMPRSVCALC /end FUNCTION_LIST /end MEASUREMENT
/begin MEASUREMENT Igenrest "Generatorreststrom modelliert" UBYTE Def_i_ub_q1 0 0 0.0 255.0000 ECU_ADDRESS 0x007FDF1F /begin FUNCTION_LIST PMPRSVCALC /end FUNCTION_LIST /end MEASUREMENT
/begin MEASUREMENT Ctrpcos7 "lokales ctrpcos" UBYTE Def_dez_ub_q1 0 0 0.0 3.0000 ECU_ADDRESS 0x007FDE94 /begin FUNCTION_LIST PMPRSVCALC /end FUNCTION_LIST /end MEASUREMENT
/begin MEASUREMENT Stpcos7 "lokales stpcos" UBYTE Def_dez_ub_q1 0 0 0.0 3.0000 ECU_ADDRESS 0x007FDE95 /begin FUNCTION_LIST PMPRSVCALC /end FUNCTION_LIST /end MEASUREMENT
/begin MEASUREMENT St_pmsoccalc.B_soc_pwf "Uo Kalibrierung durchgeführt" UBYTE Def_bit_ub_1 0 0 0.0 255.0 ECU_ADDRESS 0x007FDF46 /begin FUNCTION_LIST PMSOCCALC /end FUNCTION_LIST BIT_MASK 0x2 /end MEASUREMENT
/begin MEASUREMENT St_pmsoccalc.B_soccalc "Bedingung Powerfail IBS erkannt" UBYTE Def_bit_ub_2 0 0 0.0 255.0 ECU_ADDRESS 0x007FDF46 /begin FUNCTION_LIST PMSOCCALC /end FUNCTION_LIST BIT_MASK 0x4 /end MEASUREMENT
/begin MEASUREMENT St_pmsoccalc "Statuswort" UBYTE Def_st_ub_q1 0 0 0.0 255.0000 ECU_ADDRESS 0x007FDF46 /begin FUNCTION_LIST PMSOCCALC /end FUNCTION_LIST /end MEASUREMENT
/begin MEASUREMENT St_pmsocalc1.B_ibspwf_e "Uo Kalibrierung durchgeführt" UBYTE Def_bit_ub_0 0 0 0.0 255.0 ECU_ADDRESS 0x007FDF24 /begin FUNCTION_LIST PMSOCCALC /end FUNCTION_LIST BIT_MASK 0x1 /end MEASUREMENT
/begin MEASUREMENT St_pmsocalc1 "Statuswort" UBYTE Def_st_ub_q1 0 0 0.0 255.0000 ECU_ADDRESS 0x007FDF24 /begin FUNCTION_LIST PMSOCCALC /end FUNCTION_LIST /end MEASUREMENT
/begin MEASUREMENT D_qelad "Delta Kapazität entladen" UWORD Def_ql_uw_q0p0182 0 0 0.0 1193.0282 ECU_ADDRESS 0x007FDF34 /begin FUNCTION_LIST PMSOCCALC /end FUNCTION_LIST /end MEASUREMENT
/begin MEASUREMENT D_qlad "Delta Kapazität geladen" UWORD Def_ql_uw_q0p0182 0 0 0.0 1193.0282 ECU_ADDRESS 0x007FDF36 /begin FUNCTION_LIST PMSOCCALC /end FUNCTION_LIST /end MEASUREMENT
/begin MEASUREMENT Soc_bila "Ladezustand durch Bilanzierung und Ruhespannungsmessung ermittelt" UWORD Def_f_uw_b100 0 0 0.0 99.9984 ECU_ADDRESS 0x007FDF38 /begin FUNCTION_LIST PMSOCCALC /end FUNCTION_LIST /end MEASUREMENT
/begin MEASUREMENT Soc_quali "Zähler Genauigkeit Ladeztustandsbestimmung" UWORD Def_ql_uw_q0p0182 0 0 0.0 1193.0282 ECU_ADDRESS 0x007FDF3A /begin FUNCTION_LIST PMSOCCALC /end FUNCTION_LIST /end MEASUREMENT
/begin MEASUREMENT Ubatt0 "Aus Wertetripel ausgewählter Ruhespannungswert" UWORD Def_u_uw_q0p25em3_o6 0 0 6.0000 22.3837 ECU_ADDRESS 0x007FDF3C /begin FUNCTION_LIST PMSOCCALC /end FUNCTION_LIST /end MEASUREMENT
/begin MEASUREMENT Cbatt_lo "Nennkapazität Batterie, lokal" UBYTE Def_ql_ub_q1 0 0 1.0000 255.0000 ECU_ADDRESS 0x007FDF42 /begin FUNCTION_LIST PMSOCCALC /end FUNCTION_LIST /end MEASUREMENT
/begin MEASUREMENT Ib_commcnt "Zähler Taskaufrufe zwischen periodischer Abfrage qlad und qelad" UBYTE Def_dez_ub_q1 0 0 0.0 255.0000 ECU_ADDRESS 0x007FDF43 /begin FUNCTION_LIST PMSOCCALC /end FUNCTION_LIST /end MEASUREMENT
/begin MEASUREMENT Ib_commsta "Statemaschine zeiger zur Abfrage qlad und qelad" UBYTE Def_dez_ub_q1 0 0 0.0 255.0000 ECU_ADDRESS 0x007FDF44 /begin FUNCTION_LIST PMSOCCALC /end FUNCTION_LIST /end MEASUREMENT
/begin MEASUREMENT Kalevcnt "Anzahl der Ruhespannungsmessungen" UBYTE Def_dez_ub_q1 0 0 0.0 255.0000 ECU_ADDRESS 0x007FDF45 /begin FUNCTION_LIST PMSOCCALC /end FUNCTION_LIST /end MEASUREMENT
/begin MEASUREMENT Q_bila "Kapazität Batterie (long)" ULONG Def_ql_ul_q2p7Em7 0 0 0.0 1193.0464 ECU_ADDRESS 0x007FDF28 /begin FUNCTION_LIST PMSOCCALC /end FUNCTION_LIST /end MEASUREMENT
/begin MEASUREMENT Qeladold "Kapazität Entladen vor Abstellen" UWORD Def_ql_uw_q0p0182 0 0 0.0 1193.0282 ECU_ADDRESS 0x007FDF2C /begin FUNCTION_LIST PMSOCCALC /end FUNCTION_LIST /end MEASUREMENT
/begin MEASUREMENT Qladold "Kapazität Getladen vor Abstellen" UWORD Def_ql_uw_q0p0182 0 0 0.0 1193.0282 ECU_ADDRESS 0x007FDF2E /begin FUNCTION_LIST PMSOCCALC /end FUNCTION_LIST /end MEASUREMENT
/begin MEASUREMENT Soc_b_loc "lokal soc_bila f. KFSOCLF" UWORD Def_f_uw_b100 0 0 0.0 99.9984 ECU_ADDRESS 0x007FDF30 /begin FUNCTION_LIST PMSOCCALC /end FUNCTION_LIST /end MEASUREMENT
/begin MEASUREMENT Soc_q_loc "lokaler Zähler Genauigkeit Ladeztustandsbestimmung" UWORD Def_ql_uw_q0p0182 0 0 0.0 1193.0282 ECU_ADDRESS 0x007FDF32 /begin FUNCTION_LIST PMSOCCALC /end FUNCTION_LIST /end MEASUREMENT
/begin MEASUREMENT Isoc0loc "Batteriestrom zum Zeitpunkt der Ruhespannungsmessung (lokal)" SWORD Def_i_sw_q0p02 0 0 -655.3600 655.3400 ECU_ADDRESS 0x007FDF3E /begin FUNCTION_LIST PMSOCCALC /end FUNCTION_LIST /end MEASUREMENT
/begin MEASUREMENT Tsocloc "Batterietemperatur zum Zeitpunkt der Ruhespannungsmessung (lokal)" SWORD Def_t_sw_q0p1 0 0 -3276.8000 3276.7000 ECU_ADDRESS 0x007FDF40 /begin FUNCTION_LIST PMSOCCALC /end FUNCTION_LIST /end MEASUREMENT
/begin MEASUREMENT Soc_fit_temp "" UWORD Def_f_uw_b100 0 0 0.0 99.9984 ECU_ADDRESS 0x007FCA90 /begin FUNCTION_LIST PMSOCFIT /end FUNCTION_LIST /end MEASUREMENT
/begin MEASUREMENT Ubatts2 "Hilfswert2 Spannung aus Fitberechnung" UWORD Def_u_uw_q0p25em3_o6 0 0 6.0000 16.0000 ECU_ADDRESS 0x007FCA92 /begin FUNCTION_LIST PMSOCFIT /end FUNCTION_LIST /end MEASUREMENT
/begin MEASUREMENT Soc_fit "SoC aus der Fitformel" UWORD Def_f_uw_b100 0 0 0.0 99.9984 ECU_ADDRESS 0x007FDF48 /begin FUNCTION_LIST PMSOCFIT /end FUNCTION_LIST /end MEASUREMENT
/begin MEASUREMENT St_pmsockor0.B_soc_npl "Bedingung Hilfsvariable Fit 3" UBYTE Def_bit_ub_0 0 0 0.0 255.0 ECU_ADDRESS 0x007FDF68 /begin FUNCTION_LIST PMSOCKOR /end FUNCTION_LIST BIT_MASK 0x1 /end MEASUREMENT
/begin MEASUREMENT St_pmsockor0.B_pm_fit2 "Bedingung SoC-Wert nicht plausibel" UBYTE Def_bit_ub_1 0 0 0.0 255.0 ECU_ADDRESS 0x007FDF68 /begin FUNCTION_LIST PMSOCKOR /end FUNCTION_LIST BIT_MASK 0x2 /end MEASUREMENT
/begin MEASUREMENT St_pmsockor0.B_pm_fit3 "Bedingung Hilfsvariable Fit 2" UBYTE Def_bit_ub_2 0 0 0.0 255.0 ECU_ADDRESS 0x007FDF68 /begin FUNCTION_LIST PMSOCKOR /end FUNCTION_LIST BIT_MASK 0x4 /end MEASUREMENT
/begin MEASUREMENT St_pmsockor0.B_pmsocini "Bedingung Startqualität vollständig berechnet" UBYTE Def_bit_ub_3 0 0 0.0 255.0 ECU_ADDRESS 0x007FDF68 /begin FUNCTION_LIST PMSOCKOR /end FUNCTION_LIST BIT_MASK 0x8 /end MEASUREMENT
/begin MEASUREMENT St_pmsockor0.B_q_start "wird beim INIT wahr um den Timer zurückzusetzen" UBYTE Def_bit_ub_4 0 0 0.0 255.0 ECU_ADDRESS 0x007FDF68 /begin FUNCTION_LIST PMSOCKOR /end FUNCTION_LIST BIT_MASK 0x10 /end MEASUREMENT
/begin MEASUREMENT St_pmsockor0.B_abschfit "Bedingung Korrektur Startfähigkeitsgrenze durchgeführt" UBYTE Def_bit_ub_5 0 0 0.0 255.0 ECU_ADDRESS 0x007FDF68 /begin FUNCTION_LIST PMSOCKOR /end FUNCTION_LIST BIT_MASK 0x20 /end MEASUREMENT
/begin MEASUREMENT St_pmsockor0 "Statuswort" UBYTE Def_st_ub_q1 0 0 0.0 255.0000 ECU_ADDRESS 0x007FDF68 /begin FUNCTION_LIST PMSOCKOR /end FUNCTION_LIST /end MEASUREMENT
/begin MEASUREMENT D_socw "Delta SoC" SWORD Def_f_sw_b100 0 0 -100.0000 99.9969 ECU_ADDRESS 0x007FDF5C /begin FUNCTION_LIST PMSOCKOR /end FUNCTION_LIST /end MEASUREMENT
/begin MEASUREMENT T_saisonalt "letzter Wert Saisontemperatur" SWORD Def_t_sw_q0p1 0 0 -3276.8000 3276.7000 ECU_ADDRESS 0x007FDF5E /begin FUNCTION_LIST PMSOCKOR /end FUNCTION_LIST /end MEASUREMENT
/begin MEASUREMENT Soc_stfgkw "SoC Startfähigkeit" UWORD Def_f_uw_b100 0 0 0.0 99.9984 ECU_ADDRESS 0x007FDF60 /begin FUNCTION_LIST PMSOCKOR /end FUNCTION_LIST /end MEASUREMENT
/begin MEASUREMENT Absch_korr "Korrekturwert Abschaltung" SWORD Def_f_sw_q0p00153 0 0 -40.0000 40.0000 ECU_ADDRESS 0x007FDF4A /begin FUNCTION_LIST PMSOCKOR /end FUNCTION_LIST /end MEASUREMENT
/begin MEASUREMENT D_soc "Abstand zur Startfähigkeitsgrenze" SWORD Def_f_sw_b100 0 0 -100.0000 99.9969 ECU_ADDRESS 0x007FDF4C /begin FUNCTION_LIST PMSOCKOR /end FUNCTION_LIST /end MEASUREMENT
/begin MEASUREMENT Soc_korr "Korrekturwert soc_bila" SWORD Def_f_sw_b100 0 0 -100.0000 99.9969 ECU_ADDRESS 0x007FDF4E /begin FUNCTION_LIST PMSOCKOR /end FUNCTION_LIST /end MEASUREMENT
/begin MEASUREMENT T_saison "Saison -Temperatur" SWORD Def_t_sw_q0p1 0 0 -3276.8000 3276.7000 ECU_ADDRESS 0x007FDF50 /begin FUNCTION_LIST PMSOCKOR /end FUNCTION_LIST /end MEASUREMENT
/begin MEASUREMENT Q_startfgk "Abstand zur Startfähigkeitsgrenze" UWORD Def_ql_uw_q0p0182 0 0 0.0 1193.0282 ECU_ADDRESS 0x007FDF52 /begin FUNCTION_LIST PMSOCKOR /end FUNCTION_LIST /end MEASUREMENT
/begin MEASUREMENT Soc_q_kor "Korrekturwert Genauigkeit Ladezustandsbestimmung" UWORD Def_ql_uw_q0p0182 0 0 0.0 1193.0282 ECU_ADDRESS 0x007FDF54 /begin FUNCTION_LIST PMSOCKOR /end FUNCTION_LIST /end MEASUREMENT
/begin MEASUREMENT Soc_rel "Relativzähler für Ladezustand SoC" UWORD Def_f_uw_b100 0 0 0.0 99.9984 ECU_ADDRESS 0x007FDF56 /begin FUNCTION_LIST PMSOCKOR /end FUNCTION_LIST /end MEASUREMENT
/begin MEASUREMENT Soc_stfgk "Startfähigkeitsgrenze" UWORD Def_f_uw_b100 0 0 0.0 99.9984 ECU_ADDRESS 0x007FDF58 /begin FUNCTION_LIST PMSOCKOR /end FUNCTION_LIST /end MEASUREMENT
/begin MEASUREMENT Pm_tsrdy "Status Berechnung Tsaison" UBYTE Identity 0 0 0.0 1.0000 ECU_ADDRESS 0x007FDF5A /begin FUNCTION_LIST PMSOCKOR /end FUNCTION_LIST /end MEASUREMENT
/begin MEASUREMENT St_pmsocstart0.B_pmstart7 "Bed. Motorstart für Startauswertung PM" UBYTE Def_bit_ub_0 0 0 0.0 255.0 ECU_ADDRESS 0x007FDF77 /begin FUNCTION_LIST PMSOCSTART /end FUNCTION_LIST BIT_MASK 0x1 /end MEASUREMENT
/begin MEASUREMENT St_pmsocstart0.B_resetsta "Motor aus erkannt, Startwerte im IBS bereit zum löschen." UBYTE Def_bit_ub_1 0 0 0.0 255.0 ECU_ADDRESS 0x007FDF77 /begin FUNCTION_LIST PMSOCSTART /end FUNCTION_LIST BIT_MASK 0x2 /end MEASUREMENT
/begin MEASUREMENT St_pmsocstart0.B_rstdatardy "Bedingung Reset Startauswertung" UBYTE Def_bit_ub_2 0 0 0.0 255.0 ECU_ADDRESS 0x007FDF77 /begin FUNCTION_LIST PMSOCSTART /end FUNCTION_LIST BIT_MASK 0x4 /end MEASUREMENT
/begin MEASUREMENT St_pmsocstart0 "Statuswort" UBYTE Def_st_ub_q1 0 0 0.0 255.0000 ECU_ADDRESS 0x007FDF77 /begin FUNCTION_LIST PMSOCSTART /end FUNCTION_LIST /end MEASUREMENT
/begin MEASUREMENT St_pmsocstart_nv0.B_pmstartq "Bedingung Startqualität" UBYTE Def_bit_ub_0 0 0 0.0 255.0 ECU_ADDRESS 0x007FDF69 /begin FUNCTION_LIST PMSOCSTART /end FUNCTION_LIST BIT_MASK 0x1 /end MEASUREMENT
/begin MEASUREMENT St_pmsocstart_nv0.B_pmsqrdy "kt_ibs.dat" UBYTE Def_bit_ub_1 0 0 0.0 255.0 ECU_ADDRESS 0x007FDF69 /begin FUNCTION_LIST PMSOCSTART /end FUNCTION_LIST BIT_MASK 0x2 /end MEASUREMENT
/begin MEASUREMENT St_pmsocstart_nv0 "Statuswort" UBYTE Def_st_ub_q1 0 0 0.0 255.0000 ECU_ADDRESS 0x007FDF69 /begin FUNCTION_LIST PMSOCSTART /end FUNCTION_LIST /end MEASUREMENT
/begin MEASUREMENT Nnmstart "Motordrehzahl nach Motorstart" SWORD Def_n_sw_q1p0 0 0 -32768.0000 32767.0000 ECU_ADDRESS 0x007FDF6A /begin FUNCTION_LIST PMSOCSTART /end FUNCTION_LIST /end MEASUREMENT
/begin MEASUREMENT U_startausw "U_tnstart - ugrenz" SWORD Def_u_sw_q0p00025 0 0 -8.1920 8.1917 ECU_ADDRESS 0x007FDF6C /begin FUNCTION_LIST PMSOCSTART /end FUNCTION_LIST /end MEASUREMENT
/begin MEASUREMENT Ideltaabs "Differenz der Startströme" UWORD Def_i_uw_q0p02 0 0 0.0200 1310.7000 ECU_ADDRESS 0x007FDF6E /begin FUNCTION_LIST PMSOCSTART /end FUNCTION_LIST /end MEASUREMENT
/begin MEASUREMENT U_grenz "Grenzwert Spannung" UWORD Def_u_uw_q0p25em3_o6 0 0 6.0000 22.3837 ECU_ADDRESS 0x007FDF70 /begin FUNCTION_LIST PMSOCSTART /end FUNCTION_LIST /end MEASUREMENT
/begin MEASUREMENT Ub_old "letzter Wert Batteriespannung" UWORD Def_u_uw_q0p0942 0 0 0.0 6173.3970 ECU_ADDRESS 0x007FDF72 /begin FUNCTION_LIST PMSOCSTART /end FUNCTION_LIST /end MEASUREMENT
/begin MEASUREMENT Pmstartsta "Schalter für Ablaufsteuerung" UBYTE Def_dez_ub_q1 0 0 0.0 255.0000 ECU_ADDRESS 0x007FDF74 /begin FUNCTION_LIST PMSOCSTART /end FUNCTION_LIST /end MEASUREMENT
/begin MEASUREMENT Rin_grenzh "Batt.Innenwiderstand Grenze" UBYTE Def_f_ub_b32 0 0 0.0 31.8750 ECU_ADDRESS 0x007FDF75 /begin FUNCTION_LIST PMSOCSTART /end FUNCTION_LIST /end MEASUREMENT
/begin MEASUREMENT Rin_start "Innenwiderstand Batterie beim Start" UBYTE Def_f_ub_b32 0 0 0.0 31.8750 ECU_ADDRESS 0x007FDF76 /begin FUNCTION_LIST PMSOCSTART /end FUNCTION_LIST /end MEASUREMENT
/begin MEASUREMENT St_pmugencalc.B_genclcon "Wird auf true gesetzt wenn Motor und Generator bereits T_B_NMOT-Sekunden laufen." UBYTE Def_bit_ub_0 0 0 0.0 255.0 ECU_ADDRESS 0x007FDF86 /begin FUNCTION_LIST PMUGENCALC /end FUNCTION_LIST BIT_MASK 0x1 /end MEASUREMENT
/begin MEASUREMENT St_pmugencalc "Statuswort" UBYTE Def_st_ub_q1 0 0 0.0 255.0000 ECU_ADDRESS 0x007FDF86 /begin FUNCTION_LIST PMUGENCALC /end FUNCTION_LIST /end MEASUREMENT
/begin MEASUREMENT U_ibs "Generatorspannungsvorgabe von IBS" SWORD Def_u_sw_b128 0 0 -128.0000 127.9960 ECU_ADDRESS 0x007FDF7A /begin FUNCTION_LIST PMUGENCALC /end FUNCTION_LIST /end MEASUREMENT
/begin MEASUREMENT U_igrdetec "U_gsoll - U_ibs für IGRLOW Detektierung" SWORD Def_u_sw_b128 0 0 -128.0000 127.9960 ECU_ADDRESS 0x007FDF7C /begin FUNCTION_LIST PMUGENCALC /end FUNCTION_LIST /end MEASUREMENT
/begin MEASUREMENT Udelta "Delta zw. Battsollspg und Battspg" SWORD Def_u_sw_q0p00025 0 0 -8.1920 8.1917 ECU_ADDRESS 0x007FDF7E /begin FUNCTION_LIST PMUGENCALC /end FUNCTION_LIST /end MEASUREMENT
/begin MEASUREMENT Udeltaabs "Absolutwert von udelta" SWORD Def_u_sw_q0p00025 0 0 0.0 8.1917 ECU_ADDRESS 0x007FDF80 /begin FUNCTION_LIST PMUGENCALC /end FUNCTION_LIST /end MEASUREMENT
/begin MEASUREMENT Ubattsoll "Batteriesollspannung aufgrund Batterietemperatur und Batt.-ladezustand. Weitere Nutzung in PMPRSVCALC." UWORD Def_u_uw_q0p25em3_o6 0 0 6.0000 22.3837 ECU_ADDRESS 0x007FDF82 /begin FUNCTION_LIST PMUGENCALC /end FUNCTION_LIST /end MEASUREMENT
/begin MEASUREMENT Ubattsoll7 "lokales ubattsoll" UWORD Def_u_uw_q0p25em3_o6 0 0 6.0000 22.3837 ECU_ADDRESS 0x007FDF84 /begin FUNCTION_LIST PMUGENCALC /end FUNCTION_LIST /end MEASUREMENT
/begin MEASUREMENT T_bnmotakt "Zeit nachdem der Motor laeuft, hoert nach T_B_NMOT Sekunden auf." UBYTE Def_td_ub_q1 0 0 0.0 255.0000 ECU_ADDRESS 0x007FDF87 /begin FUNCTION_LIST PMUGENCALC /end FUNCTION_LIST /end MEASUREMENT
/begin MEASUREMENT T_delta "Zeit, die seit letzem Prozessaufruf verstrichen ist. Dient zur Taskkompatibilitaet." UBYTE Def_td_ub_q1 0 0 0.0 255.0000 ECU_ADDRESS 0x007FDF88 /begin FUNCTION_LIST PMUGENCALC /end FUNCTION_LIST /end MEASUREMENT
/begin MEASUREMENT Uibs7 "lokales uibs" SWORD Def_u_sw_b128 0 0 -128.0000 127.9960 ECU_ADDRESS 0x007FDF78 /begin FUNCTION_LIST PMUGENCALC /end FUNCTION_LIST /end MEASUREMENT
/begin MEASUREMENT St_ugenkor0.B_1stugen "" UBYTE Def_bit_ub_0 0 0 0.0 255.0 ECU_ADDRESS 0x007FDFA9 /begin FUNCTION_LIST UGENKOR /end FUNCTION_LIST BIT_MASK 0x1 /end MEASUREMENT
/begin MEASUREMENT St_ugenkor0.B_genoffout "" UBYTE Def_bit_ub_1 0 0 0.0 255.0 ECU_ADDRESS 0x007FDFA9 /begin FUNCTION_LIST UGENKOR /end FUNCTION_LIST BIT_MASK 0x2 /end MEASUREMENT
/begin MEASUREMENT St_ugenkor0.B_ugenini "Bedingung ctrgenutar noch nicht gueltig" UBYTE Def_bit_ub_2 0 0 0.0 255.0 ECU_ADDRESS 0x007FDFA9 /begin FUNCTION_LIST UGENKOR /end FUNCTION_LIST BIT_MASK 0x4 /end MEASUREMENT
/begin MEASUREMENT St_ugenkor0.B_genoff "" UBYTE Def_bit_ub_3 0 0 0.0 255.0 ECU_ADDRESS 0x007FDFA9 /begin FUNCTION_LIST UGENKOR /end FUNCTION_LIST BIT_MASK 0x8 /end MEASUREMENT
/begin MEASUREMENT St_ugenkor0.B_genoff2 "" UBYTE Def_bit_ub_4 0 0 0.0 255.0 ECU_ADDRESS 0x007FDFA9 /begin FUNCTION_LIST UGENKOR /end FUNCTION_LIST BIT_MASK 0x10 /end MEASUREMENT
/begin MEASUREMENT St_ugenkor0.B_genoffok "Bedingung Generator ausgeschaltet" UBYTE Def_bit_ub_5 0 0 0.0 255.0 ECU_ADDRESS 0x007FDFA9 /begin FUNCTION_LIST UGENKOR /end FUNCTION_LIST BIT_MASK 0x20 /end MEASUREMENT
/begin MEASUREMENT St_ugenkor0.B_noctrgen "Bedingung Generator2 ausgeschaltet" UBYTE Def_bit_ub_6 0 0 0.0 255.0 ECU_ADDRESS 0x007FDFA9 /begin FUNCTION_LIST UGENKOR /end FUNCTION_LIST BIT_MASK 0x40 /end MEASUREMENT
/begin MEASUREMENT St_ugenkor0.B_verb_off "Bedingung Generatorabschaltfreigabe Sicherheitstimer" UBYTE Def_bit_ub_7 0 0 0.0 255.0 ECU_ADDRESS 0x007FDFA9 /begin FUNCTION_LIST UGENKOR /end FUNCTION_LIST BIT_MASK 0x80 /end MEASUREMENT
/begin MEASUREMENT St_ugenkor0 "Statuswort" UBYTE Def_st_ub_q1 0 0 0.0 255.0000 ECU_ADDRESS 0x007FDFA9 /begin FUNCTION_LIST UGENKOR /end FUNCTION_LIST /end MEASUREMENT
/begin MEASUREMENT St_ugenkor2.B_saaktiv "Bedingung elektr. Verbraucher AUS" UBYTE Def_bit_ub_0 0 0 0.0 255.0 ECU_ADDRESS 0x007FDFA8 /begin FUNCTION_LIST UGENKOR /end FUNCTION_LIST BIT_MASK 0x1 /end MEASUREMENT
/begin MEASUREMENT St_ugenkor2.B_saset "Bedindung Toggel Generatorauswahl" UBYTE Def_bit_ub_1 0 0 0.0 255.0 ECU_ADDRESS 0x007FDFA8 /begin FUNCTION_LIST UGENKOR /end FUNCTION_LIST BIT_MASK 0x2 /end MEASUREMENT
/begin MEASUREMENT St_ugenkor2 "Statuswort" UBYTE Def_st_ub_q1 0 0 0.0 255.0000 ECU_ADDRESS 0x007FDFA8 /begin FUNCTION_LIST UGENKOR /end FUNCTION_LIST /end MEASUREMENT
/begin MEASUREMENT St_ugenkor1.B_gentoggl "Bedingung Ladespannungvorgabe ignoriert" UBYTE Def_bit_ub_0 0 0 0.0 255.0 ECU_ADDRESS 0x007FDF90 /begin FUNCTION_LIST UGENKOR /end FUNCTION_LIST BIT_MASK 0x1 /end MEASUREMENT
/begin MEASUREMENT St_ugenkor1 "Statuswort" UBYTE Def_st_ub_q1 0 0 0.0 255.0000 ECU_ADDRESS 0x007FDF90 /begin FUNCTION_LIST UGENKOR /end FUNCTION_LIST /end MEASUREMENT
/begin MEASUREMENT T_batt "Batterietemperatur" SWORD Def_t_sw_q0p1 0 0 -3276.8000 3276.7000 ECU_ADDRESS 0x007FDFA4 /begin FUNCTION_LIST UGENKOR /end FUNCTION_LIST /end MEASUREMENT
/begin MEASUREMENT U_gen "Sollwert Generatorspannung" UWORD Def_u_uw_q0p1 0 0 0.0 6553.5000 ECU_ADDRESS 0x007FDF92 /begin FUNCTION_LIST UGENKOR /end FUNCTION_LIST /end MEASUREMENT
/begin MEASUREMENT U_gen2 "Generatosspannungssollwert für Generator2" UWORD Def_u_uw_q0p1 0 0 0.0 16.0000 ECU_ADDRESS 0x007FDF94 /begin FUNCTION_LIST UGENKOR /end FUNCTION_LIST /end MEASUREMENT
/begin MEASUREMENT U_gsoll "Generatorsollspannung Basis" UWORD Def_u_uw_q0p1 0 0 0.0 6553.5000 ECU_ADDRESS 0x007FDF96 /begin FUNCTION_LIST UGENKOR /end FUNCTION_LIST /end MEASUREMENT
/begin MEASUREMENT Pmigrlowctr "" UWORD Def_dez_uw_q1 0 0 0.0 65535.0000 ECU_ADDRESS 0x007FDF98 /begin FUNCTION_LIST UGENKOR /end FUNCTION_LIST /end MEASUREMENT
/begin MEASUREMENT U_gen_igr "" UWORD Def_u_uw_q0p1 0 0 0.0 6553.5000 ECU_ADDRESS 0x007FDF9A /begin FUNCTION_LIST UGENKOR /end FUNCTION_LIST /end MEASUREMENT
/begin MEASUREMENT U_gsoll_tp "Generatorsollspannung Basis" UWORD Def_u_uw_q0p1 0 0 0.0 6553.5000 ECU_ADDRESS 0x007FDF9C /begin FUNCTION_LIST UGENKOR /end FUNCTION_LIST /end MEASUREMENT
/begin MEASUREMENT U_gsoll_tp2 "Generatorsollspannung Basis" UWORD Def_u_uw_q0p1 0 0 0.0 6553.5000 ECU_ADDRESS 0x007FDF9E /begin FUNCTION_LIST UGENKOR /end FUNCTION_LIST /end MEASUREMENT
/begin MEASUREMENT U_gsollred "reduzierte Generatorsollspannung" UWORD Def_u_uw_q0p1 0 0 0.0 6553.5000 ECU_ADDRESS 0x007FDFA0 /begin FUNCTION_LIST UGENKOR /end FUNCTION_LIST /end MEASUREMENT
/begin MEASUREMENT U_gsolltmp "reduzierte Zwischengeneratorsollspannung" UWORD Def_u_uw_q0p1 0 0 0.0 6553.5000 ECU_ADDRESS 0x007FDFA6 /begin FUNCTION_LIST UGENKOR /end FUNCTION_LIST /end MEASUREMENT
/begin FUNCTION PMDIAG "PMDIAG" /end FUNCTION
/begin FUNCTION PMPRSVCALC "PMPRSVCALC" /end FUNCTION
/begin FUNCTION PMSOCCALC "PMSOCCALC" /end FUNCTION
/begin FUNCTION PMSOCFIT "PMSOCFIT" /end FUNCTION
/begin FUNCTION PMSOCKOR "PMSOCKOR" /end FUNCTION
/begin FUNCTION PMSOCSTART "PMSOCSTART" /end FUNCTION
/begin FUNCTION PMUGENCALC "PMUGENCALC" /end FUNCTION
/begin FUNCTION UGENKOR "UGENKOR" /end FUNCTION
/begin FUNCTION _bmw_CrSys "Einspritzsystem"
 /begin SUB_FUNCTION etclb_calibration etclb_eval etclb_lib flsys_calccnvfac flsys_calccnvfac_msg flsys_calccnvfac_uic flsys_deflate flsys_deflate_uic flsys_shofftst_uic flsys_temp flsys_temp_msg flsys_temp_uic fma_adapt fma_ctlcalc fma_errmod fma_monitor hpun_co hpun_co_msg hpun_co_uic hpun_qntbalinjlim hpun_qntbalinjlim_uic injctl_msg injctl_qco injctl_qco_msg injctl_qco_uic injctl_qlim injctl_qlim_msg injctl_qlim_uic injctl_uic injun injun_masscnv injun_masscnv_uic injun_mi1dynqntcor_uic injun_mi2dynqntcor_uic injun_pii1dynqntcor_uic injun_pii2dynqntcor_uic injun_pii3dynqntcor_uic injun_poi1dynqntcor_uic injun_poi2dynqntcor_uic injun_sched injun_sched_msg injun_sched_uic injun_soptst injvcd injvcd_calcmi1et injvcd_calcmi1et_uic injvcd_calcpii1et_uic injvcd_calcpii2et_uic injvcd_calcpoi1et_uic injvcd_calcpoi2et_uic injvcd_estet injvcd_estet_uic injvcd_getet injvcd_getet_uic injvcd_mirmtctl_uic injvcd_pickupcurrdur injvcd_pickupcurrdur_uic injvcd_pii1rmtctl_uic injvcd_pii2rmtctl_uic injvcd_pii3rmtctl_uic injvcd_poi1rmtctl_uic injvcd_poi2rmtctl_uic injvcd_progdyn injvcd_progdyn_uic injvcd_progetlib injvcd_progetlib_uic injvcd_progetzfc injvcd_progetzfc_uic injvcd_progmi injvcd_progmi_uic injvcd_progpii injvcd_progpii_uic injvcd_progpii2 injvcd_progpii2_uic injvcd_progpii3 injvcd_progpii3_uic injvcd_progpoi1 injvcd_progpoi1_uic injvcd_progpoi2 injvcd_progpoi2_uic injvcd_progzfc injvcd_progzfc_uic injvcd_zfcetcor injvcd_zfcetcor_uic injvlv_addbal injvlv_addbal_uic injvlv_addballib injvlv_addbalzfc injvlv_addbalzfc_uic injvlv_chrgbalinjlim injvlv_chrgbalinjlim_uic injvlv_errdet injvlv_errdet_msg injvlv_errdet_uic injvlv_mon injvlv_mon_msg injvlv_mon_uic injvlv_presmin injvlv_qntadj injvlv_qntadj_uic injvlv_qntadjrepl injvlv_tdiffhyd injvlv_wvcor injvlv_wvcor_msg injvlv_wvcorlib injvlv_wvcorlib_uic mcy315_conf mcy33x_conf meun_setcurr meun_setcurr_uic ovrmon_accped ovrmon_brksens ovrmon_co ovrmon_convsens ovrmon_engspdsens ovrmon_getsuminj ovrmon_t15sens ovrmon_trqdsc ovrmon_trqegs ovrmon_trqssg pcv_leak pcv_leak_uic pcv_msg pcv_setcurr pcv_setcurr_uic rail_adcget_uic rail_ctlloop rail_ctlloop_msg rail_ctlloop_uic rail_ctllooplib rail_ctllooplib_uic rail_ctllooplimmeun rail_ctllooplimmeun_uic rail_ctllooplimpcv rail_ctllooplimpcv_uic rail_ctlloopmeun_msg rail_ctlloopparameun rail_ctlloopparameun_uic rail_ctlloopparapcv rail_ctlloopparapcv_uic rail_ctllooppcv_msg rail_ctlmeun rail_ctlmeun_uic rail_ctlpcv rail_ctlpcv_uic rail_ctltypeswt rail_ctltypeswt_uic rail_igovcalc rail_igovcalc_uic rail_monmeun rail_monmeun_msg rail_monmeun_uic rail_monpcv rail_monpcv_msg rail_monpcv_uic rail_msg rail_pgovsetup rail_pgovsetup_msg rail_pgovsetup_uic rail_prectlmeun rail_prectlmeun_uic rail_prectlmeunrmtctl_uic rail_prectlpcv rail_prectlpcv_uic rail_prectlpcvrmtctl_uic rail_rgn rail_rgn_msg rail_rgn_uic rail_rgnlib rail_setpoint rail_setpoint_msg rail_setpoint_uic rail_setpointaddcor rail_setpointaddcor_msg rail_setpointaddcor_uic rail_setpointaddcorrgn rail_setpointaddcorrgn_msg rail_setpointaddcorrgn_uic rail_setpointenvcor rail_setpointenvcor_msg rail_setpointenvcor_uic rail_setpointenvcorrgn rail_setpointenvcorrgn_msg rail_setpointenvcorrgn_uic rail_setpointenvcorslow rail_setpointenvcorslow_msg rail_setpointenvcorslow_uic rail_setpointenvcorslowrgn rail_setpointenvcorslowrgn_msg rail_setpointenvcorslowrgn_uic rail_setpointrmtctl_uic rail_setsubst /end SUB_FUNCTION
/end FUNCTION
/begin FUNCTION _bmw_CSF "Dieselpartikelfilter"
 /begin SUB_FUNCTION egt_corgntsync egt_corgntsync_uic egt_tempgvnr egt_tempgvnrdesval egt_tempgvnrmonitor egt_tempgvnroutval egpp_logic egpp_logic_msg egpp_logic_uic egpp_prescalc egpp_prescalc_msg nsc_corgn nsc_corgn_msg nsc_corgn_uic oxiccd_gettemppre oxiccd_gettemppre_msg oxiccd_gettemppre_uic pflt_ashcor pflt_corgn pflt_corgn_msg pflt_corgn_uic pflt_diag pflt_engpopcalc pflt_engpopcalc_msg pflt_engpopcalc_uic pflt_engpopprj pflt_exhgsppty pflt_exhgsppty_uic pflt_masscalc pflt_masscalc_uic pflt_monitor pflt_monitor_msg pflt_monitor_uic pflt_monitor_proj pflt_sensadapt pflt_sensadapt_msg pflt_tempmod pfltcd_getppre pfltcd_getppre_msg pfltcd_getppre_uic pfltcd_gettpre pfltcd_gettpre_msg /end SUB_FUNCTION
/end FUNCTION
/begin FUNCTION _bmw_Diagnostic "Diagnose- Überwachungsfunktionen"
 /begin SUB_FUNCTION carb cycsigcheck dsched dsched_msg dsm dsm_auto_blk dsm_auto_cdc dsm_auto_cdk dsm_auto_debclass dsm_auto_dfpmp dsm_auto_env16 dsm_auto_env8 dsm_auto_fid_scd dsm_auto_fid_scd_msg dsm_auto_inh dsm_auto_inhdel dsm_auto_oldas dsm_auto_sdw dsm_auto_trans dsm_auto_tsf dsm_msg dsm_rdy dsm_sy_conf dsm_uic dsmdur dsmdur_msg dsmdur_uic ecu eepinit eepinit_develop erlpcd erlpcd_msg erlpcd_uic hwemon hwemon_msg hwemon_uic k2rdli _k2rei memmon memmon_msg rtmo rtmo_msg sched sched_msg signals signals_base signals_limits signals_model signals_mon signals_project signals_uic sigtst_auto soptst soptst_msg tpumon tpumon_uic uaddr usap wdcom wdcom_msg /end SUB_FUNCTION
/end FUNCTION
/begin FUNCTION _bmw_FZGFunktionen "Fahrzeug Funktionen"
 /begin SUB_FUNCTION ac ac_msg ac_uic accd accd_actrout accd_actrout_msg accd_actrout_uic accd_swtin accd_swtin_msg accd_uic accd_var accd_var_msg acctl_logic acctl_logic_msg acctl_logic_uic acctl_logic_var acctl_logic_var_uic acctl_msg airbcd airbcd_msg airbcd_uic altcd altcd_msg altcd_uic aoht aoht_msg aoht_uic clg clg_msg clg_uic coeng_actrprt coeng_actrprt_uic coeng_aftrun coeng_aftrun_msg coeng_aftrun_uic coeng_aftrunextwait coeng_aftrunextwait_msg coeng_aftrunextwait_uic coeng_flconsum coeng_flconsum_uic coeng_flconsum_var coeng_flconsum_var_msg coeng_mon coeng_mon_uic coeng_monaddreq coeng_monaddreq_msg coeng_monaddreq_uic coeng_msg coeng_ovrruncoord_uic coeng_shoff coeng_shoff_msg coeng_shoff_uic coeng_shofflib coeng_shofflib_uic coeng_steng coeng_steng_msg coeng_steng_uic crccd_keydet crccd_keydet_msg crccd_keydet_uic crctl_detcrctl crctl_detcrctl_msg crctl_detcrctl_uic crctl_msg crctl_sendvmrk crctl_sendvmrk_msg crctl_sendvmrk_uic crctl_shutoff crctl_shutoff_msg crctl_shutoff_uic crctl_vcrctl crctl_vcrctl_msg crctl_vcrctl_uic crctl_vsetstep crctl_vsetstep_msg crctl_vsetstep_uic crctl_vstepadapt crctl_vstepadapt_msg crctl_vstepadapt_uic fanctl fanctl_msg fanctl_uic frmmng frmmng_conv frmmng_rx100ms_msg frmmng_uic frmmng_var_msg layer layer_fltmng msid msid_msg msid_uic netmng netmng_errhndl netmng_msg netmng_uic pcbs_calccbs prp_cocrctlprpctl prp_cocrctlprpctl_msg prp_cocrctlprpctl_uic prp_demsel prp_demsel_msg prp_demsel_uic usrda vehda vehda_lsum vehda_lsum_msg vehda_lsum_uic vehda_msg vehda_tiengon vehda_tiengon_msg vehda_tiengon_uic vehda_uic vehmot /end SUB_FUNCTION
/end FUNCTION
/begin FUNCTION _bmw_LuftsystemZumessung "Luftsystem und Zumessung"
 /begin SUB_FUNCTION airctl_ctlvalcalc airctl_ctlvalcalc_msg airctl_ctlvalcalc_uic airctl_desvalcalc airctl_desvalcalc_msg airctl_desvalcalc_uic airctl_governor airctl_governor_msg airctl_governor_uic airctl_governor_var airctl_governor_var_msg airctl_governor_var_uic airctl_monitor airctl_monitor_msg airctl_monitor_uic airctl_monitor_var airctl_monitor_var_msg airctl_monitor_var_uic airsys_cotstdem_msg asmod_co_msg asmod_co_uic asmod_eng asmod_indvol asmod_voleff asmod_voleff_msg asmod_voleff_uic cmbchb_misfire cmbchb_misfire_msg cmbchb_misfire_uic egrvlv_co egrvlv_co_msg egrvlv_co_uic egsys_dewdet egsys_dewdet_msg egsys_dewdet_uic egsys_mdlbackpres egsys_mdlbackpres_msg egsys_mdlbackpres_uic egsys_tegco egsys_tegco_msg egsys_tegco_uic egsys_tegco_var egsys_tegmod egsys_tegmod_msg egsys_tegmod_uic egsys_tnscmod egsys_tnscmod_msg egsys_tnscmod_uic egsys_toxicatmod egsys_toxicatmod_msg egsys_toxicatmod_uic egsys_tstrtcalc egsys_tstrtcalc_msg egsys_tstrtcalc_uic egsys_ttrbmod egsys_ttrbmod_msg egsys_ttrbmod_uic egsys_ttubemod egsys_ttubemod_msg egsys_ttubemod_uic engmon_irrcmb engmon_irrcmb_msg engmon_irrcmb_uic flmng flmng_fullldrgl flmng_fullldrgl_var flmng_fullldrgl_var_uic flmng_msg flmng_uic flmng_var flmng_var_uic fmtc fmtc_calccorr fmtc_calccorr_msg fmtc_calccorr_uic fmtc_msg fmtc_uic indsys_bpatdefdet indsys_bpatdefdet_uic indsys_calcswirl indsys_calcswirl_uic indsys_msg indsys_uic injcrv injcrv_co injcrv_co_msg injcrv_co_uic injcrv_copiirlsaddcor injcrv_copiirlscor injcrv_copiirlsoprng injcrv_ctlqnt injcrv_ctlqnt_msg injcrv_ctlqnt_uic injcrv_mi injcrv_mi_msg injcrv_mi_uic injcrv_mi1phiaddcorslow injcrv_mi1phiaddcorslow_uic injcrv_miaddcor injcrv_miaddcor_msg injcrv_miaddcor_uic injcrv_mienvcor injcrv_mienvcor_msg injcrv_mienvcor_uic injcrv_mienvcorrgn injcrv_mienvcorrgn_msg injcrv_mienvcorrgn_uic injcrv_mienvcorslow injcrv_mienvcorslow_msg injcrv_mienvcorslow_uic injcrv_mienvcorslowrgn injcrv_mienvcorslowrgn_msg injcrv_mienvcorslowrgn_uic injcrv_mirgn injcrv_mirgn_msg injcrv_mirgn_uic injcrv_mirgnlib injcrv_mirmtctl_uic injcrv_misoergn_msg injcrv_misoergn_uic injcrv_mistrt injcrv_pii injcrv_pii_msg injcrv_pii_uic injcrv_pii1soephibas injcrv_pii1soephibas_uic injcrv_pii1soetibas injcrv_pii1soetibas_uic injcrv_pii1strt injcrv_pii2 injcrv_pii2_uic injcrv_pii2addcor injcrv_pii2addcor_msg injcrv_pii2addcor_uic injcrv_pii2addcorphi injcrv_pii2addcorphi_uic injcrv_pii2addcorslow injcrv_pii2addcorslow_msg injcrv_pii2addcorslow_uic injcrv_pii2envcor injcrv_pii2envcor_msg injcrv_pii2envcor_uic injcrv_pii2envcorphi injcrv_pii2envcorphi_uic injcrv_pii2envcorslow injcrv_pii2envcorslow_msg injcrv_pii2envcorslow_uic injcrv_pii2envcorti injcrv_pii2envcorti_uic injcrv_pii2rgn injcrv_pii2rgn_msg injcrv_pii2rgn_uic injcrv_pii2rgnlib injcrv_pii2rmtctl_uic injcrv_pii2soephibas injcrv_pii2soephibas_uic injcrv_pii2soetibas injcrv_pii2soetibas_uic injcrv_pii2strt injcrv_pii3 injcrv_pii3_uic injcrv_pii3addcor injcrv_pii3addcor_msg injcrv_pii3addcor_uic injcrv_pii3envcor injcrv_pii3envcor_msg injcrv_pii3envcor_uic injcrv_pii3envcorslow injcrv_pii3envcorslow_msg injcrv_pii3envcorslow_uic injcrv_pii3rgn_msg injcrv_pii3rgn_uic injcrv_pii3rgnlib injcrv_pii3rmtctl_uic injcrv_piiaddcor injcrv_piiaddcor_msg injcrv_piiaddcor_uic injcrv_piiaddcorphi injcrv_piiaddcorphi_uic injcrv_piiaddcorslow injcrv_piiaddcorslow_msg injcrv_piiaddcorslow_uic injcrv_piiaddcorti injcrv_piiaddcorti_uic injcrv_piienvcor injcrv_piienvcor_msg injcrv_piienvcor_uic injcrv_piienvcorrgn injcrv_piienvcorrgn_msg injcrv_piienvcorrgn_uic injcrv_piienvcorslow injcrv_piienvcorslow_msg injcrv_piienvcorslow_uic injcrv_piienvcorslowrgn injcrv_piienvcorslowrgn_msg injcrv_piienvcorslowrgn_uic injcrv_piienvcorti injcrv_piienvcorti_uic injcrv_piirgn injcrv_piirgn_msg injcrv_piirgn_uic injcrv_piirgnlib injcrv_piirmtctl_uic injcrv_poi1 injcrv_poi1_msg injcrv_poi1_uic injcrv_poi1addcor injcrv_poi1addcor_msg injcrv_poi1addcor_uic injcrv_poi1envcor injcrv_poi1envcor_msg injcrv_poi1envcor_uic injcrv_poi1envcorslow injcrv_poi1envcorslow_msg injcrv_poi1envcorslow_uic injcrv_poi1rgn injcrv_poi1rgn_msg injcrv_poi1rgn_uic injcrv_poi1rgnlib injcrv_poi1rls injcrv_poi1rls_uic injcrv_poi1rmtctl_uic injcrv_poi2addcor injcrv_poi2addcor_msg injcrv_poi2addcor_uic injcrv_poi2agabstdc injcrv_poi2agabstdc_uic injcrv_poi2envcor injcrv_poi2envcor_msg injcrv_poi2envcor_uic injcrv_poi2envcorphi injcrv_poi2envcorphi_uic injcrv_poi2envcorrgn injcrv_poi2envcorrgn_msg injcrv_poi2envcorrgn_uic injcrv_poi2envcorslow injcrv_poi2envcorslow_msg injcrv_poi2envcorslow_uic injcrv_poi2envcorslowrgn injcrv_poi2envcorslowrgn_msg injcrv_poi2envcorslowrgn_uic injcrv_poi2envcorti injcrv_poi2envcorti_uic injcrv_poi2q injcrv_poi2q_msg injcrv_poi2q_uic injcrv_poi2qrmtctl_uic injcrv_poi2rgn injcrv_poi2rgn_msg injcrv_poi2rgn_uic injcrv_poi2rgnlib injcrv_poi2rls injcrv_poi2rls_uic injcrv_poi2soe injcrv_poi2soe_msg injcrv_poi2soe_uic injcrv_poi2soephibas injcrv_poi2soephibas_uic injcrv_poi2soermtctl_uic injcrv_poi2soetibas injcrv_poi2soetibas_uic injcrv_qntminlib injcrv_qntminlib_uic injcrv_rmtctl_uic injcrv_settipse injcrv_settipse_msg injcrv_settipse_uic lsu_clbsched lsu_clbsched_msg lsu_conf lsu_lmbdcalc lsu_lmbdcalc_msg lsu_lmbdcalc_uic lsu_mon lsu_mon_msg lsu_mon_uic lsuctl lsuctl_msg pcr_balgvnr pcr_balgvnr_msg pcr_balgvnr_uic pcr_ctlvalcalc pcr_ctlvalcalc_msg pcr_ctlvalcalc_uic pcr_ctlvalcalc_var pcr_desvalcalc pcr_desvalcalc_msg pcr_desvalcalc_uic pcr_governor pcr_governor_msg pcr_governor_uic pcr_governor_var pcr_governor_var_msg pcr_governor_var_uic pcr_lpgovernor pcr_monitor pcr_monitor_msg pcr_monitor_uic pcr_monitor_var pcr_monitor_var_msg pcr_monitor_var_uic pcr_surgectl pcr_surgedet thrvlv_co thrvlv_co_msg thrvlv_co_uic /end SUB_FUNCTION
/end FUNCTION
/begin FUNCTION _bmw_NRegler "Drehzahlregler"
 /begin SUB_FUNCTION asddc asddc_msg asddc_uic asddc_var asddc_var_uic asdrf_governor asdrf_governor_msg asdrf_governor_uic asdrf_selectparameter asdrf_selectparameter_msg asdrf_selectparameter_uic asdrf_selectparameter_var engprt_fwoscdet engprt_fwoscdet_msg engprt_fwoscdet_uic fbc_equal fbc_equal_uic fbc_msg fbc_wheellrn fbc_wheellrn_uic ligov ligov_ms_msg ligov_msg ligov_setpoint ligov_setpoint_msg ligov_setpoint_uic ligov_tsync_ps_conv ligov_uic vesgov_governor vesgov_governor_msg vesgov_governor_uic zfc_cldcmbcham zfc_cldcmbcham_uic zfc_inj zfc_inj_uic zfc_msg /end SUB_FUNCTION
/end FUNCTION
/begin FUNCTION _bmw_SignalIO "Steller und Sensoren"
 /begin SUB_FUNCTION adcmon adcmon_msg adcmon_uic afscd afscd_co_t1 afscd_co_t1_msg afscd_co_t1_uic afscd_coord afscd_corvalcalc afscd_corvalcalc_msg afscd_corvalcalc_uic afscd_drftcomp afscd_drftcomp_msg afscd_drftcomp_uic afscd_flt afscd_flt_msg afscd_flt_uic afscd_mon afscd_mon_msg afscd_mon_uic afscd_msg afscd_uic aohtcd aohtcd_msg aohtcd_uic appcd appcd_msg appcd_uic apscd apscd_msg apscd_uic apscd_variant batt_corfac batt_corfac_msg battcd battcd_msg battcd_uic bss bpa_co_uic bpa_lpco_uic bpacd bpacd_msg bpacd_uic bpscd bpscd_msg bpscd_uic brkcd brkcd_msg brkcd_uic bypetk bypetk_msg bypint bypint_msg cascd cascd_backup cascd_msg cascd_uic cbacd coeng_pwrstgstatecalc coeng_pwrstgstatecalc_uic coeng_tstco coeng_tstco_msg conv_grip conv_grip_msg convcd_co convcd_co_uic convcd_msg cpbvlv_logic crs_chkstrtspd crs_chkstrtspd_uic crscd crscd_msg crscd_thresctl crscd_uic crscd_var crscd_var_msg ctscd ctscd_msg ctscd_uic ctscd_var ctscd_var_msg eatscd eatscd_msg eatscd_uic ebafcd ebafcd_msg ebafcd_uic ebfcd_actoutebox ebfcd_actoutebox_msg ebfcd_actoutebox_uic ebtscd_gettempebox ebtscd_gettempebox_msg ebtscd_gettempebox_uic eepcd egppcd_actrout egppcd_actrout_uic egrcd egrcd_msg egrcd_uic eng eng_teng eng_teng_msg eng_teng_uic engm engm_ang engm_ang_msg engm_ang_uic engm_angdiag engm_angdiag_uic engm_backup engm_backup_uic engm_engmntctl engm_engmntctl_msg engm_engmntctl_uic engm_msg engm_tdsig engm_soptst engm_uic fancd_co fancd_co_uic fancd_msg flfcd flfcd_msg flfcd_uic ftscd ftscd_msg gearcd_pn gearcd_pn_msg gearcd_pn_uic glwcd glwcd_msg glwcd_uic iatscd iatscd_cats iatscd_cats_msg iatscd_cats_uic iatscd_cats_var_msg iatscd_msg iatscd_uic iatscd_var_msg ibscd ibscd_ht ibscd_ht_uic ibscd_msg ibscd_uic lpacd lsucd_adaption lsucd_adaption_msg lsucd_adaption_uic lsucd_heater lsucd_heater_msg lsucd_iprefctl lsucd_iprefctl_msg lsucd_iprefctl_uic lsucd_o2raw lsucd_o2raw_msg lsucd_prescomp lsucd_prescomp_msg lsucd_prescomp_uic lsucd_pumpctl lsucd_pumpctl_msg lsucd_pumpctl_uic lsucd_ri lsucd_ri_msg lsucd_spictl lsucd_spictl_msg lsucd_spictl_uic lsucd_wiredia lsucd_wiredia_msg lsucd_wiredia_uic lsucd_wiredia_100ms lubcd_co lubcd_co_msg lubcd_co_uic meuncd_co meuncd_co_uic mrlycd mrlycd_msg mrlycd_uic opscd opscd_anain opscd_anain_msg opscd_anain_uic opscd_msg opscd_uic otscd_co otscd_co_msg otscd_co_uic pcvcd_co pcvcd_co_msg pcvcd_co_uic pspcd pspcd_msg pspcd_uic qltcd railcd_co railcd_co_msg railcd_co_uic railcd_offstst railcd_offstst_msg railcd_offstst_uic railcd_pmonstrt railcd_pmonstrt_uic shutcd_actrout shutcd_actrout_uic shuttr_logic shuttr_logic_msg shuttr_logic_uic spmon sspmon sspmon_msg sspmon_uic stdpwm_pwrstg strtcd_actrout strtcd_actrout_uic t15cd t15cd_msg t15cd_uic t50cd t50cd_msg t50cd_uic tvacd tvacd_msg tvacd_uic vsa_co vsa_co_msg vsa_co_uic vsacd vsacd_msg vsacd_uic vsacd_var vsacd_var_uic vsscd_co vsscd_co_distfac vsscd_co_distfac_uic vsscd_co_uic vsscd_co_var vsscd_co_var_msg vsscd_co_var_uic vsscd_msg /end SUB_FUNCTION
/end FUNCTION
/begin FUNCTION _bmw_StSys "Startsystem"
 /begin SUB_FUNCTION glwctl_glwun glwctl_glwun_msg glwctl_glwun_uic glwctl_logic glwctl_logic_msg glwctl_logic_uic glwctl_rly glwctl_rly_msg glwctl_rly_uic ignlck ignlck_msg ignlck_uic immcd immcd_msg immcd_uic immctl immctl_msg immctl_uic immeep_eval immeep_eval_msg immeep_eval_uic stsys stsys_addcor stsys_addcor_msg stsys_addcor_uic stsys_strt stsys_strt_msg stsys_strt_uic stsys_strtbas stsys_strtbas_msg stsys_strtbas_uic stsys_strtctl stsys_strtctl_msg stsys_strtctl_uic stsys_strtrmp stsys_strtrmp_msg stsys_strtrmp_uic stsys_strttip stsys_strttip_msg stsys_strttip_uic stsys_t50shutoff stsys_t50shutoff_uic /end SUB_FUNCTION
/end FUNCTION
/begin FUNCTION _bmw_Torque "Momentenpfad"
 /begin SUB_FUNCTION acc_updatedem acc_updatedem_msg acc_updatedem_uic accped accped_drvdem_uic accped_drvdemlead_uic accped_msg accped_uic acctl_limtrq acctl_limtrq_uic afs_detafspwr afs_detafspwr_msg afs_detafspwr_uic alt alt_msg alt_uic alt_var alt_var_uic ars_detarspwr ars_detarspwr_msg ars_detarspwr_uic codt_drvtrncord codt_drvtrncord_msg codt_drvtrncord_uic codt_drvtrncordlead_uic codt_grip codt_grip_msg codt_grip_uic codt_prptrqcurrcalc codt_prptrqcurrcalc_msg codt_prptrqcurrcalc_uic codt_prptrqrngcalc codt_prptrqrngcalc_msg codt_prptrqrngcalc_uic coeng_ovrruncoord coeng_sttrqlimcalc coeng_sttrqlimcalc_msg coeng_sttrqlimcalc_uic coeng_trqcalc coeng_trqcalc_msg coeng_trqcalc_uic coeng_trqcalc_var coeng_trqcalc_var_uic coeng_trqcalclead coeng_trqcalclead_uic coeng_trqlim coeng_trqlim_uic coeng_trqslplim coeng_trqslplim_uic coveh_acsmng coveh_acsmng_msg coveh_acsmng_uic coveh_drvtrnord coveh_drvtrnord_msg coveh_drvtrnord_uic coveh_drvtrnordlead_uic covm_demcheck covm_demcheck_msg covm_demcheck_uic covm_demcord covm_demcord_msg covm_demcord_uic covm_demcordlead_uic covm_stabdem covm_stabdem_msg covm_stabdem_uic crctl_updatedem crctl_updatedem_msg crctl_updatedem_uic drvtrn drvtrn_msg drvtrn_uic engm_trqfrc engm_trqfrc_msg engm_trqfrc_uic engm_trqfrcadpt engm_trqfrcadpt_msg engm_trqfrcadpt_uic engprt engprt_msg engprt_prtlim_var_uic engprt_qprtlim engprt_qprtlim_uic engprt_uic engprt_var_msg ess_getnmin ess_getnmin_uic ess_getnmin_var ess_getnmin_var_uic ess_msg ess_updatedem ess_updatedem_uic gearbx_data gearbx_data_msg gearbx_data_uic gearbx_geardet gearbx_geardet_uic gearbx_getnmin gearbx_getnmin_uic gearbx_intvplauschk gearbx_intvplauschk_msg gearbx_intvplauschk_uic gearbx_msg gearbx_strtmotrls gearbx_strtmotrls_msg gearbx_strtmotrls_uic gearbx_trqfrc gearbx_trqfrc_uic gearbx_trqintv gearbx_trqintv_uic gearbx_trqlim gearbx_trqlim_uic prp_virtapp prp_virtapp_msg prp_virtapp_uic prpbrk_msg prpctl prpctl_msg prpctl_uic srvpmp /end SUB_FUNCTION
/end FUNCTION
/begin FUNCTION _bmw_Nicht_Zugeordnet "Nicht zugeordnete Funktionen, die Labels enthalten" /begin SUB_FUNCTION /end SUB_FUNCTION /end FUNCTION
/begin COMPU_METHOD Def_f_uw_b512 "Def_f_uw_b512" RAT_FUNC "%8.3" "-" COEFFS 0 65536 0 0 0 512 /end COMPU_METHOD
/begin COMPU_METHOD Def_t_sw_q0p1 "Def_t_sw_q0p1" RAT_FUNC "%6.1" "°C" COEFFS 0 10 0 0 0 1 /end COMPU_METHOD
/begin COMPU_METHOD Def_u_uw_q0p0942 "Def_u_uw_q0p0942" RAT_FUNC "%6.1" "V" COEFFS 0 1 0 0 0 0.0942 /end COMPU_METHOD
/begin COMPU_METHOD Def_f_ub_b8 "Def_f_ub_b8" RAT_FUNC "%5.2" "-" COEFFS 0 256 0 0 0 8 /end COMPU_METHOD
/begin COMPU_METHOD Def_bit_ub_0 "Def_bit_ub_0" TAB_VERB "%5.2" "-" COMPU_TAB_REF Def_bit_ub_0_VTAB /end COMPU_METHOD
/begin COMPU_METHOD Def_st_ub_q1 "Def_st_ub_q1" RAT_FUNC "%3.0" "-" COEFFS 0 1 0 0 0 1 /end COMPU_METHOD
/begin COMPU_METHOD Def_n_sw_q1p0 "Def_n_sw_q1p0" RAT_FUNC "%5.0" "Upm" COEFFS 0 1 0 0 0 1 /end COMPU_METHOD
/begin COMPU_METHOD Def_f_ub_b100 "Def_f_ub_b100" RAT_FUNC "%5.2" "%" COEFFS 0 256 0 0 0 100 /end COMPU_METHOD
/begin COMPU_METHOD Def_i_ub_q1 "Def_i_ub_q1" RAT_FUNC "%6.3" "" COEFFS 0 1 0 0 0 1 /end COMPU_METHOD
/begin COMPU_METHOD Def_td_ub_q0p1 "Def_td_ub_q0p1" RAT_FUNC "%4.1" "s" COEFFS 0 10 0 0 0 1 /end COMPU_METHOD
/begin COMPU_METHOD Def_bit_ub_1 "Def_bit_ub_1" TAB_VERB "%5.2" "-" COMPU_TAB_REF Def_bit_ub_1_VTAB /end COMPU_METHOD
/begin COMPU_METHOD Def_bit_ub_2 "Def_bit_ub_2" TAB_VERB "%5.2" "-" COMPU_TAB_REF Def_bit_ub_2_VTAB /end COMPU_METHOD
/begin COMPU_METHOD Def_bit_ub_3 "Def_bit_ub_3" TAB_VERB "%5.2" "-" COMPU_TAB_REF Def_bit_ub_3_VTAB /end COMPU_METHOD
/begin COMPU_METHOD Def_bit_ub_4 "Def_bit_ub_4" TAB_VERB "%5.2" "-" COMPU_TAB_REF Def_bit_ub_4_VTAB /end COMPU_METHOD
/begin COMPU_METHOD Def_bit_ub_5 "Def_bit_ub_5" TAB_VERB "%5.2" "-" COMPU_TAB_REF Def_bit_ub_5_VTAB /end COMPU_METHOD
/begin COMPU_METHOD Def_bit_ub_6 "Def_bit_ub_6" TAB_VERB "%5.2" "-" COMPU_TAB_REF Def_bit_ub_6_VTAB /end COMPU_METHOD
/begin COMPU_METHOD Def_bit_ub_7 "Def_bit_ub_7" TAB_VERB "%5.2" "-" COMPU_TAB_REF Def_bit_ub_7_VTAB /end COMPU_METHOD
/begin COMPU_METHOD Def_st_uw_q1 "Def_st_uw_q1" RAT_FUNC "%5.0" "-" COEFFS 0 1 0 0 0 1 /end COMPU_METHOD
/begin COMPU_METHOD Def_dez_uw_q1 "Def_dez_uw_q1" RAT_FUNC "%5.0" "-" COEFFS 0 1 0 0 0 1 /end COMPU_METHOD
/begin COMPU_METHOD Def_dez_ub_q1 "Def_dez_ub_q1" RAT_FUNC "%3.0" "-" COEFFS 0 1 0 0 0 1 /end COMPU_METHOD
/begin COMPU_METHOD Identity "Identity" RAT_FUNC "%4.1" "-" COEFFS 0 1 0 0 0 1 /end COMPU_METHOD
/begin COMPU_METHOD Def_f_uw_b100 "Def_f_uw_b100" RAT_FUNC "%8.3" "%" COEFFS 0 65536 0 0 0 100 /end COMPU_METHOD
/begin COMPU_METHOD Def_f_ub_b4 "Def_f_ub_b4" RAT_FUNC "%5.2" "-" COEFFS 0 256 0 0 0 4 /end COMPU_METHOD
/begin COMPU_METHOD Def_u_uw_q0p1 "Def_u_uw_q0p1" RAT_FUNC "%8.3" "V" COEFFS 0 10 0 0 0 1 /end COMPU_METHOD
/begin COMPU_METHOD Def_f_uw_b1 "Def_f_uw_b1" RAT_FUNC "%14.5" "-" COEFFS 0 65536 0 0 0 1 /end COMPU_METHOD
/begin COMPU_METHOD Def_f_ub_b1 "Def_f_ub_b1" RAT_FUNC "%6.3" "-" COEFFS 0 256 0 0 0 1 /end COMPU_METHOD
/begin COMPU_METHOD Def_td_ub_q1 "Def_td_ub_q1" RAT_FUNC "%5.2" "s" COEFFS 0 1 0 0 0 1 /end COMPU_METHOD
/begin COMPU_METHOD Def_f_ub_b2 "Def_f_ub_b2" RAT_FUNC "%6.3" "-" COEFFS 0 256 0 0 0 2 /end COMPU_METHOD
/begin COMPU_METHOD Def_i_uw_q0p08_o200 "Def_i_uw_q0p08_o200" RAT_FUNC "%8.3" "" COEFFS 0 25 5000 0 0 2 /end COMPU_METHOD
/begin COMPU_METHOD Def_u_uw_q0p25em3_o6 "Def_u_uw_q0p25em3_o6" RAT_FUNC "%9.4" "" COEFFS 0 -4000 24000 0 0 -1 /end COMPU_METHOD
/begin COMPU_METHOD Def_ql_uw_q0p0182 "Def_ql_uw_q0p0182" RAT_FUNC "%8.3" "Ah" COEFFS 0 989 0 0 0 18 /end COMPU_METHOD
/begin COMPU_METHOD Def_i_sw_q0p02 "Def_i_sw_q0p02" RAT_FUNC "%8.3" "A" COEFFS 0 50 0 0 0 1 /end COMPU_METHOD
/begin COMPU_METHOD Def_i_uw_q0p02 "Def_i_uw_q0p02" RAT_FUNC "%8.3" "A" COEFFS 0 1 0 0 0 0.02 /end COMPU_METHOD
/begin COMPU_METHOD Def_i_ub_q5p12 "Def_i_ub_q5p12" RAT_FUNC "%5.2" "" COEFFS 0 25 0 0 0 128 /end COMPU_METHOD
/begin COMPU_METHOD Def_td_uw_q0p1 "Def_td_uw_q0p1" RAT_FUNC "%6.1" "s" COEFFS 0 10 0 0 0 1 /end COMPU_METHOD
/begin COMPU_METHOD Def_td_uw_q0p01 "Def_td_uw_q0p01" RAT_FUNC "%7.2" "s" COEFFS 0 100 0 0 0 1 /end COMPU_METHOD
/begin COMPU_METHOD Def_u_sw_b128 "Def_u_sw_b128" RAT_FUNC "%8.3" "V" COEFFS 0 256 0 0 0 1 /end COMPU_METHOD
/begin COMPU_METHOD Def_i_ub_q10 "Def_i_ub_q10" RAT_FUNC "%5.2" "A" COEFFS 0 1 0 0 0 10 /end COMPU_METHOD
/begin COMPU_METHOD Def_f_ub_b32 "Def_f_ub_b32" RAT_FUNC "%5.2" "-" COEFFS 0 256 0 0 0 32 /end COMPU_METHOD
/begin COMPU_METHOD Def_f_sw_b100 "Def_f_sw_b100" RAT_FUNC "%8.3" "-" COEFFS 0 32768 0 0 0 100 /end COMPU_METHOD
/begin COMPU_METHOD Def_f_sw_b32 "Def_f_sw_b32" RAT_FUNC "%9.4" "-" COEFFS 0 32768 0 0 0 32 /end COMPU_METHOD
/begin COMPU_METHOD Def_td_uw_q1 "Def_td_uw_q1" RAT_FUNC "%5.0" "s" COEFFS 0 1 0 0 0 1 /end COMPU_METHOD
/begin COMPU_METHOD Def_ql_uw_q0p29127 "Def_ql_uw_q0p29127" RAT_FUNC "%7.2" "" COEFFS 0 103 0 0 0 30 /end COMPU_METHOD
/begin COMPU_METHOD Def_td_uw_q14 "Def_td_uw_q14" RAT_FUNC "%7.2" "s" COEFFS 0 1 0 0 0 14 /end COMPU_METHOD
/begin COMPU_METHOD Def_td_uw_q56 "Def_td_uw_q56" RAT_FUNC "%7.2" "s" COEFFS 0 1 0 0 0 56 /end COMPU_METHOD
/begin COMPU_METHOD Def_td_uw_q0p933 "Def_td_uw_q0p933" RAT_FUNC "%7.2" "min" COEFFS 0 15 0 0 0 14 /end COMPU_METHOD
/begin COMPU_METHOD Def_ql_ub_q1 "Def_ql_ub_q1" RAT_FUNC "%4.1" "" COEFFS 0 1 0 0 0 1 /end COMPU_METHOD
/begin COMPU_METHOD Def_i_ub_q0p00125 "Def_i_ub_q0p00125" RAT_FUNC "%6.3" "" COEFFS 0 800 0 0 0 1 /end COMPU_METHOD
/begin COMPU_METHOD Def_td_ub_q14p9333 "Def_td_ub_q14p9333" RAT_FUNC "%5.2" "min" COEFFS 0 15 0 0 0 224 /end COMPU_METHOD
/begin COMPU_METHOD Def_f_sw_q0p00153 "Def_f_sw_q0p00153" RAT_FUNC "%8.3" "-" COEFFS 0 32768 0 0 0 50 /end COMPU_METHOD
/begin COMPU_METHOD Def_u_sw_q0p00025 "Def_u_sw_q0p00025" RAT_FUNC "%9.4" "" COEFFS 0 4000 0 0 0 1 /end COMPU_METHOD
/begin COMPU_METHOD Def_td_ub_q0p9333 "Def_td_ub_q0p9333" RAT_FUNC "%7.4" "min" COEFFS 0 15 0 0 0 14 /end COMPU_METHOD
/begin COMPU_METHOD Def_f_sl_q0p007 "Def_f_sl_q0p007" RAT_FUNC "%10.3" "" COEFFS 0 65536 0 0 0 512 /end COMPU_METHOD
/begin COMPU_METHOD Def_f_sw_p0q25 "Def_f_sw_p0q25" RAT_FUNC "%7.2" "" COEFFS 0 4 0 0 0 1 /end COMPU_METHOD
/begin COMPU_METHOD Def_f_sw_q0p000147 "Def_f_sw_q0p000147" RAT_FUNC "%9.4" "-" COEFFS 0 64 0 0 0 0.0942 /end COMPU_METHOD
/begin COMPU_METHOD Def_f_uw_q0p25 "Def_f_uw_q0p25" RAT_FUNC "%8.3" "" COEFFS 0 4 0 0 0 1 /end COMPU_METHOD
/begin COMPU_METHOD Def_u_uw_q0p015 "Def_u_uw_q0p015" RAT_FUNC "%8.3" "V" COEFFS 0 200 0 0 0 3 /end COMPU_METHOD
/begin COMPU_METHOD Def_u_sb_q0p0942 "Def_u_sb_q0p0942" RAT_FUNC "%7.4" "V" COEFFS 0 1 0 0 0 0.0942 /end COMPU_METHOD
/begin COMPU_METHOD Def_f_ub_b127p5 "Def_f_ub_b127p5" RAT_FUNC "%5.2" "%" COEFFS 0 2 0 0 0 1 /end COMPU_METHOD
/begin COMPU_METHOD Def_ql_ul_q2p7Em7 "Def_ql_ul_q2p7Em7" RAT_FUNC "%11.4" "Ah" COEFFS 0 3600000 0 0 0 1 /end COMPU_METHOD
/begin COMPU_METHOD Def_f_ub_q0p001 "Def_f_ub_q0p001" RAT_FUNC "%6.3" "" COEFFS 0 1000 0 0 0 1 /end COMPU_METHOD
/begin COMPU_METHOD Def_i_ub_b1000 "Def_i_ub_b1000" RAT_FUNC "%6.3" "A" COEFFS 0 256 0 0 0 1000 /end COMPU_METHOD
/begin COMPU_VTAB Def_bit_ub_0_VTAB "Def_bit_ub_0_VTAB" TAB_VERB 2 0 "FALSE" 1 "TRUE" /end COMPU_VTAB
/begin COMPU_VTAB Def_bit_ub_1_VTAB "Def_bit_ub_1_VTAB" TAB_VERB 2 0 "FALSE" 1 "TRUE" /end COMPU_VTAB
/begin COMPU_VTAB Def_bit_ub_2_VTAB "Def_bit_ub_2_VTAB" TAB_VERB 2 0 "FALSE" 1 "TRUE" /end COMPU_VTAB
/begin COMPU_VTAB Def_bit_ub_3_VTAB "Def_bit_ub_3_VTAB" TAB_VERB 2 0 "FALSE" 1 "TRUE" /end COMPU_VTAB
/begin COMPU_VTAB Def_bit_ub_4_VTAB "Def_bit_ub_4_VTAB" TAB_VERB 2 0 "FALSE" 1 "TRUE" /end COMPU_VTAB
/begin COMPU_VTAB Def_bit_ub_5_VTAB "Def_bit_ub_5_VTAB" TAB_VERB 2 0 "FALSE" 1 "TRUE" /end COMPU_VTAB
/begin COMPU_VTAB Def_bit_ub_6_VTAB "Def_bit_ub_6_VTAB" TAB_VERB 2 0 "FALSE" 1 "TRUE" /end COMPU_VTAB
/begin COMPU_VTAB Def_bit_ub_7_VTAB "Def_bit_ub_7_VTAB" TAB_VERB 2 0 "FALSE" 1 "TRUE" /end COMPU_VTAB
/begin COMPU_METHOD volAdd_ml_fine "feinere Auflösung des Additivvolumen [ml]" RAT_FUNC "%6.5" "ml" COEFFS 0 1000 0 0 0 1 /end COMPU_METHOD
/begin RECORD_LAYOUT TKW_VV_VV_UW FNC_VALUES 1 UWORD COLUMN_DIR DIRECT /end RECORD_LAYOUT
/begin RECORD_LAYOUT TKW_VV_VV_SW FNC_VALUES 1 SWORD COLUMN_DIR DIRECT /end RECORD_LAYOUT
/begin RECORD_LAYOUT TKL_UW_VV_UB NO_AXIS_PTS_X 1 UBYTE RESERVED 2 BYTE AXIS_PTS_X 3 UWORD INDEX_INCR DIRECT FNC_VALUES 4 UBYTE COLUMN_DIR DIRECT /end RECORD_LAYOUT
/begin RECORD_LAYOUT TKL_UW_VV_UW NO_AXIS_PTS_X 1 UBYTE RESERVED 2 BYTE AXIS_PTS_X 3 UWORD INDEX_INCR DIRECT FNC_VALUES 4 UWORD COLUMN_DIR DIRECT /end RECORD_LAYOUT
/begin RECORD_LAYOUT TKL_SW_VV_UW NO_AXIS_PTS_X 1 UBYTE RESERVED 2 BYTE AXIS_PTS_X 3 SWORD INDEX_INCR DIRECT FNC_VALUES 4 UWORD COLUMN_DIR DIRECT /end RECORD_LAYOUT
/begin RECORD_LAYOUT TKW_VV_VV_UB FNC_VALUES 1 UBYTE COLUMN_DIR DIRECT /end RECORD_LAYOUT
/begin RECORD_LAYOUT TKL_UB_VV_UB NO_AXIS_PTS_X 1 UBYTE RESERVED 2 BYTE AXIS_PTS_X 3 UBYTE INDEX_INCR DIRECT FNC_VALUES 4 UBYTE COLUMN_DIR DIRECT /end RECORD_LAYOUT
/begin RECORD_LAYOUT TKL_UW_VV_SW NO_AXIS_PTS_X 1 UBYTE RESERVED 2 BYTE AXIS_PTS_X 3 UWORD INDEX_INCR DIRECT FNC_VALUES 4 SWORD COLUMN_DIR DIRECT /end RECORD_LAYOUT
/begin RECORD_LAYOUT TKL_SW_VV_UB NO_AXIS_PTS_X 1 UBYTE RESERVED 2 BYTE AXIS_PTS_X 3 SWORD INDEX_INCR DIRECT FNC_VALUES 4 UBYTE COLUMN_DIR DIRECT /end RECORD_LAYOUT
/begin RECORD_LAYOUT TKF_SW_SW_UW NO_AXIS_PTS_X 1 UBYTE NO_AXIS_PTS_Y 2 UBYTE AXIS_PTS_X 3 SWORD INDEX_INCR DIRECT AXIS_PTS_Y 4 SWORD INDEX_INCR DIRECT FNC_VALUES 5 UWORD COLUMN_DIR DIRECT /end RECORD_LAYOUT
/begin RECORD_LAYOUT TKL_SW_VV_SW NO_AXIS_PTS_X 1 UBYTE RESERVED 2 BYTE AXIS_PTS_X 3 SWORD INDEX_INCR DIRECT FNC_VALUES 4 SWORD COLUMN_DIR DIRECT /end RECORD_LAYOUT
/begin RECORD_LAYOUT TKF_UW_SW_UB NO_AXIS_PTS_X 1 UBYTE NO_AXIS_PTS_Y 2 UBYTE AXIS_PTS_X 3 SWORD INDEX_INCR DIRECT AXIS_PTS_Y 4 UWORD INDEX_INCR DIRECT FNC_VALUES 5 UBYTE COLUMN_DIR DIRECT /end RECORD_LAYOUT
/begin RECORD_LAYOUT TKL_UB_VV_SW NO_AXIS_PTS_X 1 UBYTE RESERVED 2 BYTE AXIS_PTS_X 3 UBYTE INDEX_INCR DIRECT FNC_VALUES 4 SWORD COLUMN_DIR DIRECT /end RECORD_LAYOUT
/begin RECORD_LAYOUT TKF_SW_UW_UW NO_AXIS_PTS_X 1 UBYTE NO_AXIS_PTS_Y 2 UBYTE AXIS_PTS_X 3 UWORD INDEX_INCR DIRECT AXIS_PTS_Y 4 SWORD INDEX_INCR DIRECT FNC_VALUES 5 UWORD COLUMN_DIR DIRECT /end RECORD_LAYOUT
/begin RECORD_LAYOUT TKL_UB_VV_UW NO_AXIS_PTS_X 1 UBYTE RESERVED 2 BYTE AXIS_PTS_X 3 UBYTE INDEX_INCR DIRECT FNC_VALUES 4 UWORD COLUMN_DIR DIRECT /end RECORD_LAYOUT
/begin RECORD_LAYOUT TKF_UW_SW_UW NO_AXIS_PTS_X 1 UBYTE NO_AXIS_PTS_Y 2 UBYTE AXIS_PTS_X 3 SWORD INDEX_INCR DIRECT AXIS_PTS_Y 4 UWORD INDEX_INCR DIRECT FNC_VALUES 5 UWORD COLUMN_DIR DIRECT /end RECORD_LAYOUT
/end MODULE
/end PROJECT
