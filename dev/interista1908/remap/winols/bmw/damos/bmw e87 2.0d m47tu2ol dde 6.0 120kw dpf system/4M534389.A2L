ASAP2_VERSION 1 3
/begin PROJECT P389 "BMW DDE6.0 4-Zylinder V53.4 01.04.2004 CAN12H"
/begin HEADER "" VERSION "V53.4_4Z_CAN12H" PROJECT_NO P389 /end HEADER
/begin MODULE DIM ""
/begin MOD_COMMON "" BYTE_ORDER MSB_FIRST ALIGNMENT_BYTE 1 ALIGNMENT_WORD 2 ALIGNMENT_LONG 4 ALIGNMENT_FLOAT32_IEEE 4 /end MOD_COMMON
/begin CHARACTERISTIC FTSCD_uSRCMin_C "SRC Minimum (Kraftstoffstemperatur)" VALUE 0xD4728 Kw_Ws16 5200.391 Volt 0.00 5200.391 FORMAT "%8.3" EXTENDED_LIMITS -160156.4 160151.5 /end CHARACTERISTIC
/begin CHARACTERISTIC FTSCD_uSRCMax_C "SRC Maximum (Kraftstoffstemperatur)" VALUE 0xD472A Kw_Ws16 5200.391 Volt 0.00 5200.391 FORMAT "%8.3" EXTENDED_LIMITS -160156.4 160151.5 /end CHARACTERISTIC
/begin CHARACTERISTIC FTSCD_tLin_CUR "Linearisierungskennlinie der Kraftstoffstemperatur" CURVE 0xD472C Kl_Xs16_Ws16 950.0000 Temp_Cels -50.1400 899.8600 FORMAT "%8.4" EXTENDED_LIMITS -3549.940 3003.560
 /begin AXIS_DESCR STD_AXIS FTSCD_uRaw Volt 20 0.00 5200.391 FORMAT "%8.3" EXTENDED_LIMITS -160156.4 160151.5 DEPOSIT ABSOLUTE /end AXIS_DESCR
/end CHARACTERISTIC
/begin CHARACTERISTIC FTSCD_DebSRCHighDef_C "FTS Fehlerentprellungszeit fuer SRC-High" VALUE 0xD477E Kw_Wu16 655350.0 Time_ms 0.00 655350.0 FORMAT "%8.1" /end CHARACTERISTIC
/begin CHARACTERISTIC FTSCD_DebSRCHighOk_C "FTS Heilungsentprellzeit fuer SRC-High" VALUE 0xD4780 Kw_Wu16 655350.0 Time_ms 0.00 655350.0 FORMAT "%8.1" /end CHARACTERISTIC
/begin CHARACTERISTIC FTSCD_DebSRCLowDef_C "FTS Fehlerentprellungszeit fuer SRC-Low" VALUE 0xD4782 Kw_Wu16 655350.0 Time_ms 0.00 655350.0 FORMAT "%8.1" /end CHARACTERISTIC
/begin CHARACTERISTIC FTSCD_DebSRCLowOk_C "FTS Heilungsentprellzeit fuer SRC-Low" VALUE 0xD4784 Kw_Wu16 655350.0 Time_ms 0.00 655350.0 FORMAT "%8.1" /end CHARACTERISTIC
/begin CHARACTERISTIC FTSCD_numAdc_C "#SSD Applikationsparameter fuer zweite Kraftstofftemperaturfuehler" VALUE 0xD4786 Kw_Wu8 24.0000000000 NumPinAdc 0.00 24.0000000000 FORMAT "%13.10" /end CHARACTERISTIC
/begin CHARACTERISTIC FTSCD_dtRmpSlpUp_C "Aufwärts-Schritt für Rampe" VALUE 0xD4788 Kw_Wu32 6553598.99749 RmpTemp 1.00097656250 6553599.99847 FORMAT "%13.5" EXTENDED_LIMITS 0.00 6553599.99847 /end CHARACTERISTIC
/begin CHARACTERISTIC FTSCD_dtRmpSlpDwn_C "Abwärts-Schritt für Rampe" VALUE 0xD478C Kw_Wu32 6553598.99749 RmpTemp 1.00097656250 6553599.99847 FORMAT "%13.5" EXTENDED_LIMITS 0.00 6553599.99847 /end CHARACTERISTIC
/begin CHARACTERISTIC FTSCD_stSensIDWord_C "Geberkennwort Kraftstoffstemperatur" VALUE 0xD4790 Kw_Wu16 65535.00 OneToOne 0.00 65535.00 FORMAT "%8.2" /end CHARACTERISTIC
/begin CHARACTERISTIC FTSCD_tDfl_C "Vorgabewert Kraftstoffstemperatur" VALUE 0xD4792 Kw_Ws16 950.0000 Temp_Cels -50.1400 899.8600 FORMAT "%8.4" EXTENDED_LIMITS -3549.940 3003.560 /end CHARACTERISTIC
/begin CHARACTERISTIC Gearbx_amMax_C "#SSD Maximaler Drehimpuls" VALUE 0xD48A0 Kw_Wu16 32767.00 TrqDT 0.00 32767.00 FORMAT "%8.2" EXTENDED_LIMITS 0.00 65535.00 /end CHARACTERISTIC
/begin CHARACTERISTIC Gearbx_dnNMinRmpUp_C "Low Idel speed up ramping  value" VALUE 0xD47E0 Kw_Wu32 65535999.9847 RmpEngN 0.00 65535999.9847 FORMAT "%13.4" /end CHARACTERISTIC
/begin CHARACTERISTIC Gearbx_dnNMinRmpDwn_C "Low Idel speed down ramping value" VALUE 0xD47E4 Kw_Wu32 65535999.9847 RmpEngN 0.00 65535999.9847 FORMAT "%13.4" /end CHARACTERISTIC
/begin CHARACTERISTIC Gearbx_dtrqLimUp_C "Rampensteigung fuer Anfahrmomentbegrenzung" VALUE 0xD4904 Kw_Wu32 6553599.99847 RmpTrq 0.00 6553599.99847 FORMAT "%13.5" /end CHARACTERISTIC
/begin CHARACTERISTIC Gearbx_dtrqRmpUp_C "Rampensteigung für Getriebemomentbegrenzung bei Gangwechsel" VALUE 0xD4908 Kw_Wu32 6553599.99847 RmpTrq 0.00 6553599.99847 FORMAT "%13.5" /end CHARACTERISTIC
/begin CHARACTERISTIC Gearbx_dtrqRmpDwn_C "Abwärts Steigung der Rampe für Getriebemomentbegrenzung mit Kurs" VALUE 0xD490C Kw_Wu32 6553599.99847 RmpTrq 0.00 6553599.99847 FORMAT "%13.5" /end CHARACTERISTIC
/begin CHARACTERISTIC Gearbx_facLimUp_CUR "Faktor fuer die Berechnung der Rampensteigung" CURVE 0xD4910 Kl_Xs16_Ws16 7.999878 Fact -4.000000 3.999878 FORMAT "%8.6"
 /begin AXIS_DESCR STD_AXIS VSSCD_v Vel 8 0.00 300.0000 FORMAT "%8.4" EXTENDED_LIMITS -327.6800 327.6700 DEPOSIT ABSOLUTE /end AXIS_DESCR
/end CHARACTERISTIC
/begin CHARACTERISTIC Gearbx_nMinFDC_MAP "Anpassung der niedrig-untätigen setpointgeschwindigkeitsnachfrage" MAP 0xD47E8 Kf_Xs16_Ys16_Ws16 3000.000 EngN 0.00 3000.000 FORMAT "%8.3" EXTENDED_LIMITS -32768.00 32767.00
 /begin AXIS_DESCR STD_AXIS FrmMng_nTSC EngN 4 0.00 10000.00 FORMAT "%8.2" EXTENDED_LIMITS -32768.00 32767.00 DEPOSIT ABSOLUTE /end AXIS_DESCR
 /begin AXIS_DESCR STD_AXIS Gearbx_stGear OneToOne 8 -1.000 6.000 FORMAT "%5.3" EXTENDED_LIMITS -128.0 127.0 DEPOSIT ABSOLUTE /end AXIS_DESCR
/end CHARACTERISTIC
/begin CHARACTERISTIC Gearbx_nMin_MAP "#SSD Leerlaufanhebung bei Automatikgetriebe, abhängig von Abtriebsdrehzahl des Getriebes und Gang." MAP 0xD4844 Kf_Xs16_Ys16_Ws16 3000.000 EngN 0.00 3000.000 FORMAT "%8.3" EXTENDED_LIMITS -32768.00 32767.00
 /begin AXIS_DESCR STD_AXIS FrmMng_nTSC EngN 4 0.00 10000.00 FORMAT "%8.2" EXTENDED_LIMITS -32768.00 32767.00 DEPOSIT ABSOLUTE /end AXIS_DESCR
 /begin AXIS_DESCR STD_AXIS Gearbx_stGear OneToOne 8 -1.000 6.000 FORMAT "%5.3" EXTENDED_LIMITS -128.0 127.0 DEPOSIT ABSOLUTE /end AXIS_DESCR
/end CHARACTERISTIC
/begin CHARACTERISTIC Gearbx_numGearDfl_C "Ersatzwert der Ganginformation" VALUE 0xD4796 Kw_Ws16 7.000000 OneToOne -1.000000 6.000000 FORMAT "%8.6" EXTENDED_LIMITS -32768.00 32767.00 /end CHARACTERISTIC
/begin CHARACTERISTIC Gearbx_numWinG0_C "Gang unterhalb des untersten v/n-Schnellgangbandes" VALUE 0xD4798 Kw_Ws8 7.000 OneToOne -1.000 6.000 FORMAT "%5.3" EXTENDED_LIMITS -128.0 127.0 /end CHARACTERISTIC
/begin CHARACTERISTIC Gearbx_numWinG1_C "Gang im 1. v/n-Schnellgangbandes" VALUE 0xD4799 Kw_Ws8 7.000 OneToOne -1.000 6.000 FORMAT "%5.3" EXTENDED_LIMITS -128.0 127.0 /end CHARACTERISTIC
/begin CHARACTERISTIC Gearbx_numWinG2_C "Gang im 2. v/n-Schnellgangbandes" VALUE 0xD479A Kw_Ws8 7.000 OneToOne -1.000 6.000 FORMAT "%5.3" EXTENDED_LIMITS -128.0 127.0 /end CHARACTERISTIC
/begin CHARACTERISTIC Gearbx_numWinG3_C "Gang im 3. v/n-Schnellgangbandes" VALUE 0xD479B Kw_Ws8 7.000 OneToOne -1.000 6.000 FORMAT "%5.3" EXTENDED_LIMITS -128.0 127.0 /end CHARACTERISTIC
/begin CHARACTERISTIC Gearbx_numWinG4_C "Gang im 4. v/n-Schnellgangbandes" VALUE 0xD479C Kw_Ws8 7.000 OneToOne -1.000 6.000 FORMAT "%5.3" EXTENDED_LIMITS -128.0 127.0 /end CHARACTERISTIC
/begin CHARACTERISTIC Gearbx_numWinG5_C "Gang im 5. v/n-Schnellgangbandes" VALUE 0xD479D Kw_Ws8 7.000 OneToOne -1.000 6.000 FORMAT "%5.3" EXTENDED_LIMITS -128.0 127.0 /end CHARACTERISTIC
/begin CHARACTERISTIC Gearbx_numWinG6_C "Gang im 6. v/n-Schnellgangbandes" VALUE 0xD479E Kw_Ws8 7.000 OneToOne -1.000 6.000 FORMAT "%5.3" EXTENDED_LIMITS -128.0 127.0 /end CHARACTERISTIC
/begin CHARACTERISTIC Gearbx_numWinG7_C "Gang oberhalb des 6. v/n-Schnellgangbandes" VALUE 0xD479F Kw_Ws8 7.000 OneToOne -1.000 6.000 FORMAT "%5.3" EXTENDED_LIMITS -128.0 127.0 /end CHARACTERISTIC
/begin CHARACTERISTIC Gearbx_numWinGR_C "Gang im Rückwärts v/n-Schnellgangbandes" VALUE 0xD47A0 Kw_Ws8 7.000 OneToOne -1.000 6.000 FORMAT "%5.3" EXTENDED_LIMITS -128.0 127.0 /end CHARACTERISTIC
/begin CHARACTERISTIC Gearbx_rTrans1_C "#SSD Getriebeübersetzung 1. Gang" VALUE 0xD47A2 Kw_Ws16 327.6700 TransR 0.00 327.6700 FORMAT "%8.4" EXTENDED_LIMITS -327.6800 327.6700 /end CHARACTERISTIC
/begin CHARACTERISTIC Gearbx_rTrans2_C "#SSD Getriebeübersetzung 2. Gang" VALUE 0xD47A4 Kw_Ws16 327.6700 TransR 0.00 327.6700 FORMAT "%8.4" EXTENDED_LIMITS -327.6800 327.6700 /end CHARACTERISTIC
/begin CHARACTERISTIC Gearbx_rTrans3_C "#SSD Getriebeübersetzung 3. Gang" VALUE 0xD47A6 Kw_Ws16 327.6700 TransR 0.00 327.6700 FORMAT "%8.4" EXTENDED_LIMITS -327.6800 327.6700 /end CHARACTERISTIC
/begin CHARACTERISTIC Gearbx_rTrans4_C "#SSD Getriebeübersetzung 4. Gang" VALUE 0xD47A8 Kw_Ws16 327.6700 TransR 0.00 327.6700 FORMAT "%8.4" EXTENDED_LIMITS -327.6800 327.6700 /end CHARACTERISTIC
/begin CHARACTERISTIC Gearbx_rTrans5_C "#SSD Getriebeübersetzung 5. Gang" VALUE 0xD47AA Kw_Ws16 327.6700 TransR 0.00 327.6700 FORMAT "%8.4" EXTENDED_LIMITS -327.6800 327.6700 /end CHARACTERISTIC
/begin CHARACTERISTIC Gearbx_rTrans6_C "#SSD Getriebeübersetzung 6. Gang" VALUE 0xD47AC Kw_Ws16 327.6700 TransR 0.00 327.6700 FORMAT "%8.4" EXTENDED_LIMITS -327.6800 327.6700 /end CHARACTERISTIC
/begin CHARACTERISTIC Gearbx_rTransR_C "#SSD Getriebeübersetzung Rückwärtsgang" VALUE 0xD47AE Kw_Ws16 327.6700 TransR 0.00 327.6700 FORMAT "%8.4" EXTENDED_LIMITS -327.6800 327.6700 /end CHARACTERISTIC
/begin CHARACTERISTIC Gearbx_rVn0ToR_C "v/n-Toleranzbandegrenze für Schnellgang N und R" VALUE 0xD47B0 Kw_Ws16 0.3276700 VelToN 0.00 0.3276700 FORMAT "%9.7" EXTENDED_LIMITS -0.3276800 0.3276700 /end CHARACTERISTIC
/begin CHARACTERISTIC Gearbx_rVn1H_C "obere Grenze des v/n-Toleranzbandes 1. Gang" VALUE 0xD47B2 Kw_Ws16 0.3276700 VelToN 0.00 0.3276700 FORMAT "%9.7" EXTENDED_LIMITS -0.3276800 0.3276700 /end CHARACTERISTIC
/begin CHARACTERISTIC Gearbx_rVn1L_C "untere Grenze des v/n-Toleranzbandes 1. Gang" VALUE 0xD47B4 Kw_Ws16 0.3276700 VelToN 0.00 0.3276700 FORMAT "%9.7" EXTENDED_LIMITS -0.3276800 0.3276700 /end CHARACTERISTIC
/begin CHARACTERISTIC Gearbx_rVn1To2_C "v/n-Toleranzbandegrenze für Schnellgang 1. und 2. Gang" VALUE 0xD47B6 Kw_Ws16 0.3276700 VelToN 0.00 0.3276700 FORMAT "%9.7" EXTENDED_LIMITS -0.3276800 0.3276700 /end CHARACTERISTIC
/begin CHARACTERISTIC Gearbx_rVn2H_C "obere Grenze des v/n-Toleranzbandes 2. Gang" VALUE 0xD47B8 Kw_Ws16 0.3276700 VelToN 0.00 0.3276700 FORMAT "%9.7" EXTENDED_LIMITS -0.3276800 0.3276700 /end CHARACTERISTIC
/begin CHARACTERISTIC Gearbx_rVn2L_C "untere Grenze des v/n-Toleranzbandes 2. Gang" VALUE 0xD47BA Kw_Ws16 0.3276700 VelToN 0.00 0.3276700 FORMAT "%9.7" EXTENDED_LIMITS -0.3276800 0.3276700 /end CHARACTERISTIC
/begin CHARACTERISTIC Gearbx_rVn2To3_C "v/n-Toleranzbandegrenze für Schnellgang 2. und 3. Gang" VALUE 0xD47BC Kw_Ws16 0.3276700 VelToN 0.00 0.3276700 FORMAT "%9.7" EXTENDED_LIMITS -0.3276800 0.3276700 /end CHARACTERISTIC
/begin CHARACTERISTIC Gearbx_rVn3H_C "obere Grenze des v/n-Toleranzbandes 3. Gang" VALUE 0xD47BE Kw_Ws16 0.3276700 VelToN 0.00 0.3276700 FORMAT "%9.7" EXTENDED_LIMITS -0.3276800 0.3276700 /end CHARACTERISTIC
/begin CHARACTERISTIC Gearbx_rVn3L_C "untere Grenze des v/n-Toleranzbandes 3. Gang" VALUE 0xD47C0 Kw_Ws16 0.3276700 VelToN 0.00 0.3276700 FORMAT "%9.7" EXTENDED_LIMITS -0.3276800 0.3276700 /end CHARACTERISTIC
/begin CHARACTERISTIC Gearbx_rVn3To4_C "v/n-Toleranzbandegrenze für Schnellgang 3. und 4. Gang" VALUE 0xD47C2 Kw_Ws16 0.3276700 VelToN 0.00 0.3276700 FORMAT "%9.7" EXTENDED_LIMITS -0.3276800 0.3276700 /end CHARACTERISTIC
/begin CHARACTERISTIC Gearbx_rVn4H_C "obere Grenze des v/n-Toleranzbandes 4. Gang" VALUE 0xD47C4 Kw_Ws16 0.3276700 VelToN 0.00 0.3276700 FORMAT "%9.7" EXTENDED_LIMITS -0.3276800 0.3276700 /end CHARACTERISTIC
/begin CHARACTERISTIC Gearbx_rVn4L_C "untere Grenze des v/n-Toleranzbandes 4. Gang" VALUE 0xD47C6 Kw_Ws16 0.3276700 VelToN 0.00 0.3276700 FORMAT "%9.7" EXTENDED_LIMITS -0.3276800 0.3276700 /end CHARACTERISTIC
/begin CHARACTERISTIC Gearbx_rVn4To5_C "v/n-Toleranzbandegrenze für Schnellgang 4. und 5. Gang" VALUE 0xD47C8 Kw_Ws16 0.3276700 VelToN 0.00 0.3276700 FORMAT "%9.7" EXTENDED_LIMITS -0.3276800 0.3276700 /end CHARACTERISTIC
/begin CHARACTERISTIC Gearbx_rVn5H_C "obere Grenze des v/n-Toleranzbandes 5. Gang" VALUE 0xD47CA Kw_Ws16 0.3276700 VelToN 0.00 0.3276700 FORMAT "%9.7" EXTENDED_LIMITS -0.3276800 0.3276700 /end CHARACTERISTIC
/begin CHARACTERISTIC Gearbx_rVn5L_C "untere Grenze des v/n-Toleranzbandes 5. Gang" VALUE 0xD47CC Kw_Ws16 0.3276700 VelToN 0.00 0.3276700 FORMAT "%9.7" EXTENDED_LIMITS -0.3276800 0.3276700 /end CHARACTERISTIC
/begin CHARACTERISTIC Gearbx_rVn5To6_C "v/n-Toleranzbandegrenze für Schnellgang 5. und 6. Gang" VALUE 0xD47CE Kw_Ws16 0.3276700 VelToN 0.00 0.3276700 FORMAT "%9.7" EXTENDED_LIMITS -0.3276800 0.3276700 /end CHARACTERISTIC
/begin CHARACTERISTIC Gearbx_rVn6H_C "obere Grenze des v/n-Toleranzbandes 6. Gang" VALUE 0xD47D0 Kw_Ws16 0.3276700 VelToN 0.00 0.3276700 FORMAT "%9.7" EXTENDED_LIMITS -0.3276800 0.3276700 /end CHARACTERISTIC
/begin CHARACTERISTIC Gearbx_rVn6L_C "untere Grenze des v/n-Toleranzbandes 6. Gang" VALUE 0xD47D2 Kw_Ws16 0.3276700 VelToN 0.00 0.3276700 FORMAT "%9.7" EXTENDED_LIMITS -0.3276800 0.3276700 /end CHARACTERISTIC
/begin CHARACTERISTIC Gearbx_rVn6To7_C "v/n-Toleranzbandegrenze für Schnellgang größer 6. Gang" VALUE 0xD47D4 Kw_Ws16 0.3276700 VelToN 0.00 0.3276700 FORMAT "%9.7" EXTENDED_LIMITS -0.3276800 0.3276700 /end CHARACTERISTIC
/begin CHARACTERISTIC Gearbx_rVnRH_C "obere Grenze des v/n-Toleranzbandes Rückwärtsgang" VALUE 0xD47D6 Kw_Ws16 0.3276700 VelToN 0.00 0.3276700 FORMAT "%9.7" EXTENDED_LIMITS -0.3276800 0.3276700 /end CHARACTERISTIC
/begin CHARACTERISTIC Gearbx_rVnRL_C "untere Grenze des v/n-Toleranzbandes Rückwärtsgang" VALUE 0xD47D8 Kw_Ws16 0.3276700 VelToN 0.00 0.3276700 FORMAT "%9.7" EXTENDED_LIMITS -0.3276800 0.3276700 /end CHARACTERISTIC
/begin CHARACTERISTIC Gearbx_rVnRTo1_C "v/n-Toleranzbandegrenze für Schnellgang R und 1. Gang" VALUE 0xD47DA Kw_Ws16 0.3276700 VelToN 0.00 0.3276700 FORMAT "%9.7" EXTENDED_LIMITS -0.3276800 0.3276700 /end CHARACTERISTIC
/begin CHARACTERISTIC Gearbx_stTypeSelCAN_C "Zuordnung Getriebetyp und Ganginformation über CAN" VALUE 0xD47DC Kw_Ws16 8.000000 OneToOne 0.00 8.000000 FORMAT "%8.6" EXTENDED_LIMITS -32768.00 32767.00 /end CHARACTERISTIC
/begin CHARACTERISTIC Gearbx_swtDrvAway_C "Abschaltbedingung für Anfahrmomentbegrenzung (1: Begrenzung möglich, 0 keine Begrenzung)" VALUE 0xD4932 Kw_Wu8 1.000 OneToOne 0.00 1.000 FORMAT "%5.3" EXTENDED_LIMITS 0.00 255.0 /end CHARACTERISTIC
/begin CHARACTERISTIC Gearbx_swtErrRea_C "Ersatzreaktion bei fehlerhafter CAN-Übertragung (1: v/n ratio, 0: default value)" VALUE 0xD47DE Kw_Ws16 1.000000 OneToOne 0.00 1.000000 FORMAT "%8.6" EXTENDED_LIMITS -32768.00 32767.00 /end CHARACTERISTIC
/begin CHARACTERISTIC Gearbx_swtTypeVal_C "Getriebetyp (0:manual; 1:automatisch; 2: automatisch shift; 3: continous variable; 4:automatisch manual/nur Z-Car)" VALUE 0xD4794 Kw_Wu8 3.000 OneToOne 0.00 3.000 FORMAT "%5.3" EXTENDED_LIMITS 0.00 255.0 /end CHARACTERISTIC
/begin CHARACTERISTIC Gearbx_swtTypeType_C "Getriebetyp-Ablageart" VALUE 0xD4795 Kw_Wu8 1.000 OneToOne 1.000 2.000 FORMAT "%5.3" EXTENDED_LIMITS 0.00 255.0 /end CHARACTERISTIC
/begin CHARACTERISTIC Gearbx_swtUnplausChk_C "#SSD Schalter für Momentenüberschussintegral (1...ein, 0...aus)." VALUE 0xD48A2 Kw_Wu8 1.000 OneToOne 0.00 1.000 FORMAT "%5.3" EXTENDED_LIMITS 0.00 255.0 /end CHARACTERISTIC
/begin CHARACTERISTIC Gearbx_tiDebMaxOk_C "Heilungsentprellzeit der physikalischen Unplausibilität" VALUE 0xD48A4 Kw_Wu16 655350.0 TimeDeb 0.00 655350.0 FORMAT "%8.1" /end CHARACTERISTIC
/begin CHARACTERISTIC Gearbx_tiDebMaxDef_C "Fehlerentprellzeit der physikalischen Unplausibilität" VALUE 0xD48A6 Kw_Wu16 655350.0 TimeDeb 0.00 655350.0 FORMAT "%8.1" /end CHARACTERISTIC
/begin CHARACTERISTIC Gearbx_trqDecMax_C "#SSD Decreasing torque intervention" VALUE 0xD48A8 Kw_Ws16 1500.000 Trq -500.0000 1000.000 FORMAT "%8.3" EXTENDED_LIMITS -3276.800 3276.700 /end CHARACTERISTIC
/begin CHARACTERISTIC Gearbx_trqDecMax_CUR "#SSD Calculates the maximum torque that can be decremented depending on the engine speed" CURVE 0xD48AA Kl_Xs16_Ws16 1500.000 Trq -500.0000 1000.000 FORMAT "%8.3" EXTENDED_LIMITS -3276.800 3276.700
 /begin AXIS_DESCR STD_AXIS Eng_nAvrg EngN 16 0.00 6000.000 FORMAT "%8.3" EXTENDED_LIMITS -32768.00 32767.00 DEPOSIT ABSOLUTE /end AXIS_DESCR
/end CHARACTERISTIC
/begin CHARACTERISTIC Gearbx_dtrqLimUptrqDec_C "Ramp up slope for decrease in torque" VALUE 0xD48EC Kw_Wu32 6553599.99847 RmpTrq 0.00 6553599.99847 FORMAT "%13.5" /end CHARACTERISTIC
/begin CHARACTERISTIC Gearbx_dtrqLimDwntrqDec_C "Ramp down slope for decrease in torque" VALUE 0xD48F0 Kw_Wu32 6553599.99847 RmpTrq 0.00 6553599.99847 FORMAT "%13.5" /end CHARACTERISTIC
/begin CHARACTERISTIC Gearbx_trqIncMax_C "Maximum Gearbox Increasing torque" VALUE 0xD48F4 Kw_Ws16 1500.000 Trq -500.0000 1000.000 FORMAT "%8.3" EXTENDED_LIMITS -3276.800 3276.700 /end CHARACTERISTIC
/begin CHARACTERISTIC Gearbx_trqIncMin_C "Increasing torque intervention" VALUE 0xD48F6 Kw_Ws16 1500.000 Trq -500.0000 1000.000 FORMAT "%8.3" EXTENDED_LIMITS -3276.800 3276.700 /end CHARACTERISTIC
/begin CHARACTERISTIC Gearbx_dtrqLimUptrqInc_C "Torque ramp up slope for increase in torque" VALUE 0xD48F8 Kw_Wu32 6553599.99847 RmpTrq 0.00 6553599.99847 FORMAT "%13.5" /end CHARACTERISTIC
/begin CHARACTERISTIC Gearbx_dtrqLimDwntrqInc_C "Torque ramp down slope for increase in torque" VALUE 0xD48FC Kw_Wu32 6553599.99847 RmpTrq 0.00 6553599.99847 FORMAT "%13.5" /end CHARACTERISTIC
/begin CHARACTERISTIC Gearbx_trqInMax_CUR "Kurve für maximales Getriebeeingangsmoment bei Leerlauf" CURVE 0xD4934 Kl_Xs16_Ws16 1000.000 Trq 0.00 1000.000 FORMAT "%8.3" EXTENDED_LIMITS -3276.800 3276.700
 /begin AXIS_DESCR STD_AXIS Eng_nAvrg EngN 10 0.00 6000.000 FORMAT "%8.3" EXTENDED_LIMITS -32768.00 32767.00 DEPOSIT ABSOLUTE /end AXIS_DESCR
/end CHARACTERISTIC
/begin CHARACTERISTIC Gearbx_trqInMax_Vector "#SSD Bypass Label, nicht ändern!" VALUE 0xC3094 Kw_Wu8 255.0 OneToOne 0.00 255.0 FORMAT "%5.1" /end CHARACTERISTIC
/begin CHARACTERISTIC Gearbx_trqInMax_Channel "#SSD Bypass Label, nicht ändern!" VALUE 0xC3095 Kw_Wu8 255.0 OneToOne 0.00 255.0 FORMAT "%5.1" /end CHARACTERISTIC
/begin CHARACTERISTIC Gearbx_trqMaxErr2_CUR "Curve for calculation of maximum input torque of gearbox (error2 value)" CURVE 0xD495E Kl_Xs16_Ws16 1000.000 Trq 0.00 1000.000 FORMAT "%8.3" EXTENDED_LIMITS -3276.800 3276.700
 /begin AXIS_DESCR STD_AXIS Eng_nAvrg EngN 25 0.00 6000.000 FORMAT "%8.3" EXTENDED_LIMITS -32768.00 32767.00 DEPOSIT ABSOLUTE /end AXIS_DESCR
/end CHARACTERISTIC
/begin CHARACTERISTIC Gearbx_trqMaxErr_CUR "Curve for calculation of maximum input torque of gearbox (error value)" CURVE 0xD49C4 Kl_Xs16_Ws16 1000.000 Trq 0.00 1000.000 FORMAT "%8.3" EXTENDED_LIMITS -3276.800 3276.700
 /begin AXIS_DESCR STD_AXIS Eng_nAvrg EngN 10 0.00 6000.000 FORMAT "%8.3" EXTENDED_LIMITS -32768.00 32767.00 DEPOSIT ABSOLUTE /end AXIS_DESCR
/end CHARACTERISTIC
/begin CHARACTERISTIC Gearbx_trqMaxGear1_CUR "Begrenzungsmoment für ersten Gang" CURVE 0xD49EE Kl_Xs16_Ws16 1000.000 Trq 0.00 1000.000 FORMAT "%8.3" EXTENDED_LIMITS -3276.800 3276.700
 /begin AXIS_DESCR STD_AXIS Eng_nAvrg EngN 10 0.00 6000.000 FORMAT "%8.3" EXTENDED_LIMITS -32768.00 32767.00 DEPOSIT ABSOLUTE /end AXIS_DESCR
/end CHARACTERISTIC
/begin CHARACTERISTIC Gearbx_trqMaxGear2_CUR "Begrenzungsmoment für zweiten Gang" CURVE 0xD4A18 Kl_Xs16_Ws16 1000.000 Trq 0.00 1000.000 FORMAT "%8.3" EXTENDED_LIMITS -3276.800 3276.700
 /begin AXIS_DESCR STD_AXIS Eng_nAvrg EngN 10 0.00 6000.000 FORMAT "%8.3" EXTENDED_LIMITS -32768.00 32767.00 DEPOSIT ABSOLUTE /end AXIS_DESCR
/end CHARACTERISTIC
/begin CHARACTERISTIC Gearbx_trqMaxGear3_CUR "Begrenzungsmoment für dritten Gang" CURVE 0xD4A42 Kl_Xs16_Ws16 1000.000 Trq 0.00 1000.000 FORMAT "%8.3" EXTENDED_LIMITS -3276.800 3276.700
 /begin AXIS_DESCR STD_AXIS Eng_nAvrg EngN 10 0.00 6000.000 FORMAT "%8.3" EXTENDED_LIMITS -32768.00 32767.00 DEPOSIT ABSOLUTE /end AXIS_DESCR
/end CHARACTERISTIC
/begin CHARACTERISTIC Gearbx_trqMaxGear4_CUR "Begrenzungsmoment für vierten Gang" CURVE 0xD4A6C Kl_Xs16_Ws16 1000.000 Trq 0.00 1000.000 FORMAT "%8.3" EXTENDED_LIMITS -3276.800 3276.700
 /begin AXIS_DESCR STD_AXIS Eng_nAvrg EngN 10 0.00 6000.000 FORMAT "%8.3" EXTENDED_LIMITS -32768.00 32767.00 DEPOSIT ABSOLUTE /end AXIS_DESCR
/end CHARACTERISTIC
/begin CHARACTERISTIC Gearbx_trqMaxGear5_CUR "Begrenzungsmoment für fünften Gang" CURVE 0xD4A96 Kl_Xs16_Ws16 1000.000 Trq 0.00 1000.000 FORMAT "%8.3" EXTENDED_LIMITS -3276.800 3276.700
 /begin AXIS_DESCR STD_AXIS Eng_nAvrg EngN 10 0.00 6000.000 FORMAT "%8.3" EXTENDED_LIMITS -32768.00 32767.00 DEPOSIT ABSOLUTE /end AXIS_DESCR
/end CHARACTERISTIC
/begin CHARACTERISTIC Gearbx_trqMaxGear6_CUR "Begrenzungsmoment für sechsten Gang" CURVE 0xD4AC0 Kl_Xs16_Ws16 1000.000 Trq 0.00 1000.000 FORMAT "%8.3" EXTENDED_LIMITS -3276.800 3276.700
 /begin AXIS_DESCR STD_AXIS Eng_nAvrg EngN 10 0.00 6000.000 FORMAT "%8.3" EXTENDED_LIMITS -32768.00 32767.00 DEPOSIT ABSOLUTE /end AXIS_DESCR
/end CHARACTERISTIC
/begin CHARACTERISTIC Gearbx_trqMaxGearR_CUR "Begrenzungsmoment für Rückwärtsgang" CURVE 0xD4AEA Kl_Xs16_Ws16 1000.000 Trq 0.00 1000.000 FORMAT "%8.3" EXTENDED_LIMITS -3276.800 3276.700
 /begin AXIS_DESCR STD_AXIS Eng_nAvrg EngN 10 0.00 6000.000 FORMAT "%8.3" EXTENDED_LIMITS -32768.00 32767.00 DEPOSIT ABSOLUTE /end AXIS_DESCR
/end CHARACTERISTIC
/begin CHARACTERISTIC Gearbx_vTrqIntvVSSCDlim_C "VSSCD  torque intervention limit" VALUE 0xD4900 Kw_Wu16 655.3500 Vel 0.00 655.3500 FORMAT "%8.4" /end CHARACTERISTIC
/begin CHARACTERISTIC Gearbx_vTrqLim_C "Vehicle speed limit for gearbox torque limitation" VALUE 0xD4B14 Kw_Ws16 300.0000 Vel 0.00 300.0000 FORMAT "%8.4" EXTENDED_LIMITS -327.6800 327.6700 /end CHARACTERISTIC
/begin CHARACTERISTIC GearCD_tiDebNeg_C "Entprellzeit fallende Flanke" VALUE 0xD4B18 Kw_Wu16 655350.0 TimeDeb 0.00 655350.0 FORMAT "%8.1" /end CHARACTERISTIC
/begin CHARACTERISTIC GearCD_tiDebPos_C "Entprellzeit steigende Flanke" VALUE 0xD4B1A Kw_Wu16 655350.0 TimeDeb 0.00 655350.0 FORMAT "%8.1" /end CHARACTERISTIC
/begin CHARACTERISTIC GearCD_numDioIn_C "#SSD Applikationsparameter für HW-Pin der PN-Stellungserkennung bei Automatgetriebe" VALUE 0xD4B1C Kw_Wu8 14.0000000000 NumPinDioIn 0.00 14.0000000000 FORMAT "%13.10" /end CHARACTERISTIC
/begin CHARACTERISTIC GearCD_stPNDflVal_C "Vorgabewert PN-Stellung" VALUE 0xD4B1D Kw_Wu8 1.000 OneToOne 0.00 1.000 FORMAT "%5.3" EXTENDED_LIMITS 0.00 255.0 /end CHARACTERISTIC
/begin CHARACTERISTIC GearCD_stPNInv_C "Invertierung Eingangssignal PNRawVal" VALUE 0xD4B1E Kw_Wu8 1.000 OneToOne 0.00 1.000 FORMAT "%5.3" EXTENDED_LIMITS 0.00 255.0 /end CHARACTERISTIC
/begin CHARACTERISTIC GearCD_swtPNSigVal_C "Schalter für PN-Signalquelleauswahl (0 = HW-Eingang, 1= CAN)" VALUE 0xD4B1F Kw_Wu8 1.000 OneToOne 0.00 1.000 FORMAT "%5.3" EXTENDED_LIMITS 0.00 255.0 /end CHARACTERISTIC
/begin CHARACTERISTIC GlwCD_rBoostMax_C "Maximale Glühanforderung für Startglühen-Anhebung" VALUE 0xD4B20 Kw_Wu8 62.00 OneToOne 65.00 127.0 FORMAT "%5.1" EXTENDED_LIMITS 0.00 255.0 /end CHARACTERISTIC
/begin CHARACTERISTIC GlwCD_rInterMax_C "Maximale Glühanforderung bei Zwischenglühen" VALUE 0xD4B21 Kw_Wu8 61.00 OneToOne 2.000 63.00 FORMAT "%5.2" EXTENDED_LIMITS 0.00 255.0 /end CHARACTERISTIC
/begin CHARACTERISTIC GlwCD_tiDebCircExTDefect_C "Fehlerentprellzeit für Übertemperaturfehler der Glueh-Endstufe" VALUE 0xD4B22 Kw_Wu16 655350.0 Time_ms 0.00 655350.0 FORMAT "%8.1" /end CHARACTERISTIC
/begin CHARACTERISTIC GlwCD_tiDebCircExTOk_C "Fehlerentprellzeit für Übertemperatur der Glüh-Endstufe" VALUE 0xD4B24 Kw_Wu16 655350.0 Time_ms 0.00 655350.0 FORMAT "%8.1" /end CHARACTERISTIC
/begin CHARACTERISTIC GlwCD_tiDebCircGndDefect_C "Fehlerentprellzeit für Kurzschluß nach Masse der Glüh-Endstufe" VALUE 0xD4B26 Kw_Wu16 655350.0 Time_ms 0.00 655350.0 FORMAT "%8.1" /end CHARACTERISTIC
/begin CHARACTERISTIC GlwCD_tiDebCircGndOk_C "Heilungsentprellzeit für Kurzschluß nach Masse der Glüh-Endstufe" VALUE 0xD4B28 Kw_Wu16 655350.0 Time_ms 0.00 655350.0 FORMAT "%8.1" /end CHARACTERISTIC
/begin CHARACTERISTIC GlwCD_tiDebCircNLDefect_C "Fehlerentprellzeit für einen Lastabfallsfehler an der Glüh-Endstufe" VALUE 0xD4B2A Kw_Wu16 655350.0 Time_ms 0.00 655350.0 FORMAT "%8.1" /end CHARACTERISTIC
/begin CHARACTERISTIC GlwCD_tiDebCircNLOk_C "Heilungsentprellzeit für einen Lastabfallsfehler an der Glühendstufe" VALUE 0xD4B2C Kw_Wu16 655350.0 Time_ms 0.00 655350.0 FORMAT "%8.1" /end CHARACTERISTIC
/begin CHARACTERISTIC GlwCD_tiDebCommDefect_C "Defektentprellzeit fürr Kommunikationsfehler mit dem BSD-Glühsteuergerät" VALUE 0xD4B2E Kw_Wu16 655350.0 Time_ms 0.00 655350.0 FORMAT "%8.1" /end CHARACTERISTIC
/begin CHARACTERISTIC GlwCD_tiDebCommOk_C "Heilungsentprellzeit für Kommunikationsfehler mit dem BSD Glühsteuergerät" VALUE 0xD4B30 Kw_Wu16 655350.0 Time_ms 0.00 655350.0 FORMAT "%8.1" /end CHARACTERISTIC
/begin CHARACTERISTIC GlwCD_tiReset_C "Regenerierzeit der BSD Schnittstelle nach einem Kommunikationsfehler mit dem Gluehsteuergeraet" VALUE 0xD4B32 Kw_Wu16 1980.000 Time_ms 20.00000 2000.000 FORMAT "%8.3" EXTENDED_LIMITS 0.00 655350.0 /end CHARACTERISTIC
/begin CHARACTERISTIC GlwCtl_ctPreGlwErr_C "Counter for pre-glow without engine start" VALUE 0xD4C9A Kw_Wu8 99.00 OneToOne 1.000 100.0 FORMAT "%5.1" EXTENDED_LIMITS 0.00 255.0 /end CHARACTERISTIC
/begin CHARACTERISTIC GlwCtl_ctPreGlw_C "Counter for pre-glow without engine start" VALUE 0xD4C9B Kw_Wu8 255.0 OneToOne 0.00 255.0 FORMAT "%5.1" /end CHARACTERISTIC
/begin CHARACTERISTIC GlwCtl_nLamp_C "Drehzahlgrenze für Glühanzeigelampe AUS" VALUE 0xD4CD8 Kw_Ws16 5000.000 EngN 0.00 5000.000 FORMAT "%8.3" EXTENDED_LIMITS -32768.00 32767.00 /end CHARACTERISTIC
/begin CHARACTERISTIC GlwCtl_nPre_C "oberer Schwellwert Drehzahl für Ende Vorglühen" VALUE 0xD4C9C Kw_Wu16 6000.000 EngN 0.00 6000.000 FORMAT "%8.3" EXTENDED_LIMITS 0.00 65535.00 /end CHARACTERISTIC
/begin CHARACTERISTIC GlwCtl_rLimitClnt_CUR "Glühanforderungsschwelle als Funktion der Kühlmitteltemperatur" CURVE 0xD4B34 Kl_Xs16_Ws16 400.0000 OneToOne -200.0000 200.0000 FORMAT "%8.4" EXTENDED_LIMITS -32768.00 32767.00
 /begin AXIS_DESCR STD_AXIS GlwCtl_tClnt Temp_Cels 8 -50.1400 199.8600 FORMAT "%8.4" EXTENDED_LIMITS -3549.940 3003.560 DEPOSIT ABSOLUTE /end AXIS_DESCR
/end CHARACTERISTIC
/begin CHARACTERISTIC GlwCtl_rLimitNM_MAP "Glühanforderunsschwelle als Funktion von Drehzahl und Innerem Moment" MAP 0xD4B56 Kf_Xs16_Ys16_Ws16 400.0000 OneToOne -200.0000 200.0000 FORMAT "%8.4" EXTENDED_LIMITS -32768.00 32767.00
 /begin AXIS_DESCR STD_AXIS Eng_nAvrg EngN 6 0.00 6000.000 FORMAT "%8.3" EXTENDED_LIMITS -32768.00 32767.00 DEPOSIT ABSOLUTE /end AXIS_DESCR
 /begin AXIS_DESCR STD_AXIS CoEng_trqInrCurr Trq 6 0.00 999.0000 FORMAT "%8.4" EXTENDED_LIMITS -3276.800 3276.700 DEPOSIT ABSOLUTE /end AXIS_DESCR
/end CHARACTERISTIC
/begin CHARACTERISTIC GlwCtl_rMaxOff_C "Maximum value für Glühanforderung AUS" VALUE 0xD4BBA Kw_Wu8 100.0 OneToOne 0.00 100.0 FORMAT "%5.1" EXTENDED_LIMITS 0.00 255.0 /end CHARACTERISTIC
/begin CHARACTERISTIC GlwCtl_rMaxStdby_C "Maximalwert für Glühanforderung Standby" VALUE 0xD4BBB Kw_Wu8 100.0 OneToOne 0.00 100.0 FORMAT "%5.1" EXTENDED_LIMITS 0.00 255.0 /end CHARACTERISTIC
/begin CHARACTERISTIC GlwCtl_rMax_C "Maximalwert bei Glühanforderung EIN" VALUE 0xD4BBC Kw_Wu8 200.0 OneToOne 0.00 200.0 FORMAT "%5.1" EXTENDED_LIMITS 0.00 255.0 /end CHARACTERISTIC
/begin CHARACTERISTIC GlwCtl_rPwrClnt_CUR "Glühanforderung als Funktion der Kühlmitteltemperatur" CURVE 0xD4BBE Kl_Xs16_Ws16 400.0000 OneToOne -200.0000 200.0000 FORMAT "%8.4" EXTENDED_LIMITS -32768.00 32767.00
 /begin AXIS_DESCR STD_AXIS GlwCtl_tClnt Temp_Cels 8 -50.1400 199.8600 FORMAT "%8.4" EXTENDED_LIMITS -3549.940 3003.560 DEPOSIT ABSOLUTE /end AXIS_DESCR
/end CHARACTERISTIC
/begin CHARACTERISTIC GlwCtl_rPwrNM_MAP "Glühanforderung als Funktion von Drehzahl und Innerem Moment" MAP 0xD4BE0 Kf_Xs16_Ys16_Ws16 400.0000 OneToOne -200.0000 200.0000 FORMAT "%8.4" EXTENDED_LIMITS -32768.00 32767.00
 /begin AXIS_DESCR STD_AXIS Eng_nAvrg EngN 6 0.00 6000.000 FORMAT "%8.3" EXTENDED_LIMITS -32768.00 32767.00 DEPOSIT ABSOLUTE /end AXIS_DESCR
 /begin AXIS_DESCR STD_AXIS CoEng_trqInrCurr Trq 6 0.00 999.0000 FORMAT "%8.4" EXTENDED_LIMITS -3276.800 3276.700 DEPOSIT ABSOLUTE /end AXIS_DESCR
/end CHARACTERISTIC
/begin CHARACTERISTIC GlwCtl_rPwrPAir_CUR "Glühanforderung als Funktion des Luftdrucks" CURVE 0xD4C44 Kl_Xs16_Ws16 400.0000 OneToOne -200.0000 200.0000 FORMAT "%8.4" EXTENDED_LIMITS -32768.00 32767.00
 /begin AXIS_DESCR STD_AXIS APSCD_pVal Pres_hPa 8 -50.00000 3500.0000 FORMAT "%8.4" EXTENDED_LIMITS -32768.00 32767.00 DEPOSIT ABSOLUTE /end AXIS_DESCR
/end CHARACTERISTIC
/begin CHARACTERISTIC GlwCtl_rPwrTAir_CUR "Glühanforderung als Funktion der Lufttemperatur" CURVE 0xD4C66 Kl_Xs16_Ws16 400.0000 OneToOne -200.0000 200.0000 FORMAT "%8.4" EXTENDED_LIMITS -32768.00 32767.00
 /begin AXIS_DESCR STD_AXIS IATSCD_tAir Temp_Cels 8 -50.1400 199.8600 FORMAT "%8.4" EXTENDED_LIMITS -3549.940 3003.560 DEPOSIT ABSOLUTE /end AXIS_DESCR
/end CHARACTERISTIC
/begin CHARACTERISTIC GlwCtl_rStart_CUR "" CURVE 0xD4C88 Kl_Xs16_Ws16 99.00000 OneToOne 101.0000 200.0000 FORMAT "%8.4" EXTENDED_LIMITS -32768.00 32767.00
 /begin AXIS_DESCR STD_AXIS GlwCtl_tClnt Temp_Cels 2 -50.1400 199.8600 FORMAT "%8.4" EXTENDED_LIMITS -3549.940 3003.560 DEPOSIT ABSOLUTE /end AXIS_DESCR
/end CHARACTERISTIC
/begin CHARACTERISTIC GlwCtl_rThresOff_C "Untere Schwelle für Glühanforderung EIN" VALUE 0xD4C92 Kw_Ws16 65535.00 OneToOne -32768.00 32767.00 FORMAT "%8.2" /end CHARACTERISTIC
/begin CHARACTERISTIC GlwCtl_rThresOn_C "Obere Schwelle für Glühanforderung EIN" VALUE 0xD4C94 Kw_Ws16 65535.00 OneToOne -32768.00 32767.00 FORMAT "%8.2" /end CHARACTERISTIC
/begin CHARACTERISTIC GlwCtl_stHdnPreGlwMsk1_C "Triggermaske, durch GlwCtl_ctPreGlw begrenzte Triggerbedingungen" VALUE 0xD4C9E Kw_Wu16 255.0000 OneToOne 0.00 255.0000 FORMAT "%8.4" EXTENDED_LIMITS 0.00 65535.00 /end CHARACTERISTIC
/begin CHARACTERISTIC GlwCtl_stHdnPreGlwMsk2_C "Triggermaske, unbegrenzt" VALUE 0xD4CA0 Kw_Wu16 255.0000 OneToOne 0.00 255.0000 FORMAT "%8.4" EXTENDED_LIMITS 0.00 65535.00 /end CHARACTERISTIC
/begin CHARACTERISTIC GlwCtl_stHdnPreGlwMskT1_C "Triggermaske, durch GlwCtl_ctPreGlw begrenzte Triggerbedingungen" VALUE 0xD4CA2 Kw_Wu16 255.0000 OneToOne 0.00 255.0000 FORMAT "%8.4" EXTENDED_LIMITS 0.00 65535.00 /end CHARACTERISTIC
/begin CHARACTERISTIC GlwCtl_stLampEnaMsk_C "Triggermaske für die Lampenfreigabe" VALUE 0xD4CA4 Kw_Wu16 255.0000 OneToOne 0.00 255.0000 FORMAT "%8.4" EXTENDED_LIMITS 0.00 65535.00 /end CHARACTERISTIC
/begin CHARACTERISTIC GlwCtl_tDflClnt_C "Vorgabewert falls Wassertemperaturfühler defekt" VALUE 0xD4CA6 Kw_Ws16 250.00000 Temp_Cels -50.14000 199.86000 FORMAT "%8.5" EXTENDED_LIMITS -3549.940 3003.560 /end CHARACTERISTIC
/begin CHARACTERISTIC GlwCtl_tLimLow_C "Untere Temperaturschwelle für die Hysterese - Umschaltung zwischen den Triggermasken" VALUE 0xD4CA8 Kw_Ws16 950.000 Temp_Cels -50.140 899.860 FORMAT "%8.3" EXTENDED_LIMITS -3549.940 3003.560 /end CHARACTERISTIC
/begin CHARACTERISTIC GlwCtl_tLimHigh_C "Oberer Temperaturgrenzwert für die Hysterese - Umschaltung zwischen den Triggermasken" VALUE 0xD4CAA Kw_Ws16 950.000 Temp_Cels -50.140 899.860 FORMAT "%8.3" EXTENDED_LIMITS -3549.940 3003.560 /end CHARACTERISTIC
/begin CHARACTERISTIC GlwCtl_stLimLow_C "Applikationskonstante für den GlwCtl Zustand ""nicht steil"" - Teil der Hysterese zur Umschaltung zwischen den Trigger Masken" VALUE 0xD4CAC Kw_Ws16 65535.00 OneToOne -32768.00 32767.00 FORMAT "%8.2" /end CHARACTERISTIC
/begin CHARACTERISTIC GlwCtl_stLimHigh_C "Konstante für den GlwCtl Zustand Steil - Teil der Hystereseparameter für das Umschalten zwischen den Triggermasken" VALUE 0xD4CAE Kw_Ws16 65535.00 OneToOne -32768.00 32767.00 FORMAT "%8.2" /end CHARACTERISTIC
/begin CHARACTERISTIC GlwCtl_tiDebConvSig_C "Entprellung, Kupplungssignal für Trigger" VALUE 0xD4CB0 Kw_Wu16 655350.0 Time_ms 0.00 655350.0 FORMAT "%8.1" /end CHARACTERISTIC
/begin CHARACTERISTIC GlwCtl_tiDebPre_C "Entprellzeit für Ende Vorglühen falls Schwellwert Drehzahl erreicht ist" VALUE 0xD4CB2 Kw_Wu16 655350.0 Time_ms 0.00 655350.0 FORMAT "%8.1" /end CHARACTERISTIC
/begin CHARACTERISTIC GlwCtl_tiLampBase_CUR "Basiswert der Lampenansteuerdauer" CURVE 0xD4CDA Kl_Xs16_Ws16 655140.0 Time_ms 0.00 655140.0 FORMAT "%8.1" EXTENDED_LIMITS -327680.0 327670.0
 /begin AXIS_DESCR STD_AXIS GlwCtl_tClnt Temp_Cels 6 -50.14000 199.8600 FORMAT "%8.4" EXTENDED_LIMITS -3549.940 3003.560 DEPOSIT ABSOLUTE /end AXIS_DESCR
/end CHARACTERISTIC
/begin CHARACTERISTIC GlwCtl_tiLampEng_C "Entprellzeit für Glühanzeige AUS bei überschrittener Drehzahlschwelle" VALUE 0xD4CF4 Kw_Wu16 65000.00 Time_ms 0.00 65000.00 FORMAT "%8.2" EXTENDED_LIMITS 0.00 655350.0 /end CHARACTERISTIC
/begin CHARACTERISTIC GlwCtl_tiLampPAir_CUR "athmosphärendruckspez. Wert der Lampenansteuerdauer" CURVE 0xD4CF6 Kl_Xs16_Ws16 655140.0 Time_ms 0.00 655140.0 FORMAT "%8.1" EXTENDED_LIMITS -327680.0 327670.0
 /begin AXIS_DESCR STD_AXIS GlwCtl_tClnt Temp_Cels 2 -50.140 899.860 FORMAT "%8.3" EXTENDED_LIMITS -3549.940 3003.560 DEPOSIT ABSOLUTE /end AXIS_DESCR
/end CHARACTERISTIC
/begin CHARACTERISTIC GlwCtl_tiLampUBatt_CUR "batteriespannungsspez. Wert der Lampenansteuerdauer" CURVE 0xD4D00 Kl_Xs16_Ws16 655140.0 Time_ms 0.00 655140.0 FORMAT "%8.1" EXTENDED_LIMITS -327680.0 327670.0
 /begin AXIS_DESCR STD_AXIS BattCD_u Volt_Batt 2 0.00 28602.15 FORMAT "%8.2" EXTENDED_LIMITS -640625.6 640606.1 DEPOSIT ABSOLUTE /end AXIS_DESCR
/end CHARACTERISTIC
/begin CHARACTERISTIC GlwCtl_tiMaxOn_C "Maximale Dauer für Glühanforderung EIN" VALUE 0xD4C96 Kw_Wu16 180000.0 Time_ms 0.00 180000.0 FORMAT "%8.1" EXTENDED_LIMITS 0.00 655350.0 /end CHARACTERISTIC
/begin CHARACTERISTIC GlwCtl_tiNoEngSpd_C "Entprellzeit, Abwürgerkennung" VALUE 0xD4CB4 Kw_Wu16 655350.0 Time_ms 0.00 655350.0 FORMAT "%8.1" /end CHARACTERISTIC
/begin CHARACTERISTIC GlwCtl_tiPre_CUR "Vorglühzeit als f(WT)" CURVE 0xD4CB6 Kl_Xs16_Ws16 655140.0 Time_ms 0.00 655140.0 FORMAT "%8.1" EXTENDED_LIMITS -327680.0 327670.0
 /begin AXIS_DESCR STD_AXIS GlwCtl_tClnt Temp_Cels 6 -50.14000 199.8600 FORMAT "%8.4" EXTENDED_LIMITS -3549.940 3003.560 DEPOSIT ABSOLUTE /end AXIS_DESCR
/end CHARACTERISTIC
/begin CHARACTERISTIC GlwCtl_tiPSync_C "time for syncronisation and railpressure" VALUE 0xD4D0A Kw_Wu16 10000.00 Time_ms 0.00 10000.00 FORMAT "%8.2" EXTENDED_LIMITS 0.00 655350.0 /end CHARACTERISTIC
/begin CHARACTERISTIC GlwCtl_tiReady_C "Dauer Status Startbereitschaftsglühen" VALUE 0xD4CD0 Kw_Wu16 655350.0 Time_ms 0.00 655350.0 FORMAT "%8.1" /end CHARACTERISTIC
/begin CHARACTERISTIC GlwCtl_tiStdby_C "Standbyzeit bei Glühanforderung EIN" VALUE 0xD4C98 Kw_Wu16 180000.0 Time_ms 0.00 180000.0 FORMAT "%8.1" EXTENDED_LIMITS 0.00 655350.0 /end CHARACTERISTIC
/begin CHARACTERISTIC GlwCtl_tiStrt_C "Dauer Status Startglühen" VALUE 0xD4CD2 Kw_Wu16 655350.0 Time_ms 0.00 655350.0 FORMAT "%8.1" /end CHARACTERISTIC
/begin CHARACTERISTIC GlwCtl_tiWaitforTemp_C "Time duration to wait for Value" VALUE 0xD4CD4 Kw_Wu16 655350.0 Time_ms 0.00 655350.0 FORMAT "%8.1" /end CHARACTERISTIC
/begin CHARACTERISTIC GlwCtl_tStrt_C "Oberer Schwellwert der Wassertemperatur für Startglühen" VALUE 0xD4CD6 Kw_Ws16 250.00000 Temp_Cels -50.14000 199.86000 FORMAT "%8.5" EXTENDED_LIMITS -3549.940 3003.560 /end CHARACTERISTIC
/begin CHARACTERISTIC HPUn_dvolMeUnMax_C "maximales Fördervolumen durch die Zumesseinheit" VALUE 0xD4D0C Kw_Ws16 50000.00 Qp_mm3_sec 0.00 50000.00 FORMAT "%8.2" EXTENDED_LIMITS -327680.0 327670.0 /end CHARACTERISTIC
/begin CHARACTERISTIC HPUn_etaPmpFlTemp_CUR "Kraftstofftemperaturabhängiger Wirkungsgrad der Hochdruckpumpe" CURVE 0xD4D0E Kl_Xs16_Ws16 0.9921875 Eta 0.007812500 1.000000 FORMAT "%8.6" EXTENDED_LIMITS -256.0000 255.9922
 /begin AXIS_DESCR STD_AXIS FlSys_t Temp_Cels 6 -50.14000 199.8600 FORMAT "%8.4" EXTENDED_LIMITS -3549.940 3003.560 DEPOSIT ABSOLUTE /end AXIS_DESCR
/end CHARACTERISTIC
/begin CHARACTERISTIC HPUn_etaPmpMaxAged_CUR "Maximaler Wirkungsgrad einer gealterten Hochdruckpumpe" CURVE 0xD4D28 Kl_Xs16_Ws16 0.9921875 Eta 0.007812500 1.000000 FORMAT "%8.6" EXTENDED_LIMITS -256.0000 255.9922
 /begin AXIS_DESCR STD_AXIS Eng_nAvrg EngN 6 0.00 6000.000 FORMAT "%8.3" EXTENDED_LIMITS -32768.00 32767.00 DEPOSIT ABSOLUTE /end AXIS_DESCR
/end CHARACTERISTIC
/begin CHARACTERISTIC HPUn_etaPmpMech_C "mechanischer Wirkungsgrad der Hochdruckpumpe" VALUE 0xD4D42 Kw_Ws16 0.9921875 Eta 0.007812500 1.000000 FORMAT "%8.6" EXTENDED_LIMITS -256.0000 255.9922 /end CHARACTERISTIC
/begin CHARACTERISTIC HPUn_nMin_C "#SSD Drehzahlschwelle zur Abschaltung der Lastmomentberechnung der Hochdruckpumpe" VALUE 0xD4D44 Kw_Ws16 6000.000 EngN 0.00 6000.000 FORMAT "%8.3" EXTENDED_LIMITS -32768.00 32767.00 /end CHARACTERISTIC
/begin CHARACTERISTIC HPUn_numInjMin_C "Minimal von der Hochdruckpumpe erlaubte  Anzahl an Einspritzungen" VALUE 0xD4FB0 Kw_Wu8 6.000 OneToOne 0.00 6.000 FORMAT "%5.3" EXTENDED_LIMITS 0.00 255.0 /end CHARACTERISTIC
/begin CHARACTERISTIC HPUn_pRailDvtOk_C "#SSD Maximale Raildruck Regelabweichung für die Mengenbilanzprüfung" VALUE 0xD4FB2 Kw_Wu16 2000.000 Pres_Rail 0.00 2000.000 FORMAT "%5.3" EXTENDED_LIMITS 0.00 6553.500 /end CHARACTERISTIC
/begin CHARACTERISTIC HPUn_tiPresDvtFlt_C "PT1 Zeitkonstante zur Filterung der Raildruck Regelabweichung" VALUE 0xD4FB4 Kw_Wu32 4294.9673 TimeDelay_s 0.0000010000000 4294.9673 FORMAT "%9.4" /end CHARACTERISTIC
/begin CHARACTERISTIC HPUn_qBalLim_CUR "#SSD Begrenzungsmenge auf Grund der Mengenbilanz der Hochdruckpumpe" CURVE 0xD4D46 Kl_Xs16_Ws16 327.6700 InjMassCyc 0.00 327.6700 FORMAT "%8.4" EXTENDED_LIMITS -327.6800 327.6700
 /begin AXIS_DESCR STD_AXIS Eng_nAvrg EngN 8 0.00 6000.000 FORMAT "%8.3" EXTENDED_LIMITS -32768.00 32767.00 DEPOSIT ABSOLUTE /end AXIS_DESCR
/end CHARACTERISTIC
/begin CHARACTERISTIC HPUn_qFlTempLim_MAP "#SSD Kennfeld für Begrenzungsmenge abhängig der Kraftstofftemperatur" MAP 0xD4D68 Kf_Xs16_Ys16_Ws16 327.6700 InjMassCyc 0.00 327.6700 FORMAT "%8.4" EXTENDED_LIMITS -327.6800 327.6700
 /begin AXIS_DESCR STD_AXIS Eng_nAvrg EngN 16 0.00 6000.000 FORMAT "%8.3" EXTENDED_LIMITS -32768.00 32767.00 DEPOSIT ABSOLUTE /end AXIS_DESCR
 /begin AXIS_DESCR STD_AXIS FTSCD_tFuel Temp_Cels 16 -50.14000 199.8600 FORMAT "%8.4" EXTENDED_LIMITS -3549.940 3003.560 DEPOSIT ABSOLUTE /end AXIS_DESCR
/end CHARACTERISTIC
/begin CHARACTERISTIC HPUn_rTransCrS_C "Übersetzung Hochdruckpumpe zu Kurbelwelle" VALUE 0xD4FAC Kw_Ws16 10.00000 TransR 0.00 10.00000 FORMAT "%8.5" EXTENDED_LIMITS -327.6800 327.6700 /end CHARACTERISTIC
/begin CHARACTERISTIC HPUn_tiQntBalDel_C "Verzögerungszeit zur Berechnung der Mengenbilanz der Hochdruckpumpe" VALUE 0xD4FB8 Kw_Wu16 655140.0 Time_ms 0.00 655140.0 FORMAT "%8.1" EXTENDED_LIMITS 0.00 655350.0 /end CHARACTERISTIC
/begin CHARACTERISTIC HPUn_volPmp_C "geometrisches Fördervolumen der Hochdruckpumpe pro Pumpenumdrehung" VALUE 0xD4FAE Kw_Ws16 1500.000 PmpQnt 0.00 1500.000 FORMAT "%8.3" EXTENDED_LIMITS -3276.800 3276.700 /end CHARACTERISTIC
/begin CHARACTERISTIC HWEMon_DebComStepDown_C "#SSD Abwärts Schrittweite für Entprellung SPI Kommunikation" VALUE 0xD4FBC Kw_Wu8 3.000 OneToOne 0.00 3.000 FORMAT "%5.3" EXTENDED_LIMITS 0.00 255.0 /end CHARACTERISTIC
/begin CHARACTERISTIC HWEMon_DebComStepUp_C "#SSD Aufwärts Schrittweite für Entprellung SPI Kommunikation" VALUE 0xD4FBD Kw_Wu8 3.000 OneToOne 0.00 3.000 FORMAT "%5.3" EXTENDED_LIMITS 0.00 255.0 /end CHARACTERISTIC
/begin CHARACTERISTIC HWEMon_DebComDef_C "#SSD Entprellung für defekt Erkennung der SPI Kommunikation" VALUE 0xD4FBE Kw_Wu16 65535.00 OneToOne 0.00 65535.00 FORMAT "%8.2" /end CHARACTERISTIC
/begin CHARACTERISTIC HWEMon_DebComOk_C "#SSD Entprellung für intakt Erkennung der SPI Kommunikation" VALUE 0xD4FC0 Kw_Wu16 65535.00 OneToOne 0.00 65535.00 FORMAT "%8.2" /end CHARACTERISTIC
/begin CHARACTERISTIC HWEMon_nThres_C "Drehzahlschwelle für Latchbetrieb der Überspannungsüberwachung (nur für CJ945)" VALUE 0xD4FC2 Kw_Ws16 300.0000 EngN 300.0000 600.0000 FORMAT "%8.4" EXTENDED_LIMITS -32768.00 32767.00 /end CHARACTERISTIC
/begin CHARACTERISTIC HWEMon_numTrigRecovery_C "#SSD Nummer der durch Änderung dieses Labels auszulösenden Recovery" VALUE 0xD4FC4 Kw_Wu16 65535.00 OneToOne 0.00 65535.00 FORMAT "%8.2" /end CHARACTERISTIC
/begin CHARACTERISTIC IATSCD_uSRCMinCats_C "Minimalwert für SRC Ladelufttemperaturfühler" VALUE 0xD5050 Kw_Ws16 5200.391 Volt 0.00 5200.391 FORMAT "%8.3" EXTENDED_LIMITS -160156.4 160151.5 /end CHARACTERISTIC
/begin CHARACTERISTIC IATSCD_uSRCMaxCats_C "Maximalwert für SRC Ladelufttemperaturfühler" VALUE 0xD5052 Kw_Ws16 5200.391 Volt 0.00 5200.391 FORMAT "%8.3" EXTENDED_LIMITS -160156.4 160151.5 /end CHARACTERISTIC
/begin CHARACTERISTIC IATSCD_tLinCats_CUR "Linearisierungskennlinie für Ladelufttemperaturfühler" CURVE 0xD5054 Kl_Xs16_Ws16 250.0000 Temp_Cels -50.14000 199.8600 FORMAT "%8.4" EXTENDED_LIMITS -3549.940 3003.560
 /begin AXIS_DESCR STD_AXIS IATSCD_uRawCats Volt 16 0.00 5200.391 FORMAT "%8.3" EXTENDED_LIMITS -160156.4 160151.5 DEPOSIT ABSOLUTE /end AXIS_DESCR
/end CHARACTERISTIC
/begin CHARACTERISTIC IATSCD_uSRCMin_C "Minimalwert für SRC LTF-Sensor" VALUE 0xD4FC8 Kw_Ws16 5200.391 Volt 0.00 5200.391 FORMAT "%8.3" EXTENDED_LIMITS -160156.4 160151.5 /end CHARACTERISTIC
/begin CHARACTERISTIC IATSCD_uSRCMax_C "Maximalwert für SRC LTF-Sensor" VALUE 0xD4FCA Kw_Ws16 5200.391 Volt 0.00 5200.391 FORMAT "%8.3" EXTENDED_LIMITS -160156.4 160151.5 /end CHARACTERISTIC
/begin CHARACTERISTIC IATSCD_tLin_CUR "Linearisierungskennlinie für LTF-Sensor" CURVE 0xD4FCC Kl_Xs16_Ws16 950.0000 Temp_Cels -50.1400 899.8600 FORMAT "%8.4" EXTENDED_LIMITS -3549.940 3003.560
 /begin AXIS_DESCR STD_AXIS IATSCD_uRaw Volt 25 0.00 5200.391 FORMAT "%8.3" EXTENDED_LIMITS -160156.4 160151.5 DEPOSIT ABSOLUTE /end AXIS_DESCR
/end CHARACTERISTIC
/begin CHARACTERISTIC IATSCD_DebSigDefCats_C "Ladelufttemperatur - Entprellzeit bis Signal defekt" VALUE 0xD5096 Kw_Wu16 655350.0 Time_ms 0.00 655350.0 FORMAT "%8.1" /end CHARACTERISTIC
/begin CHARACTERISTIC IATSCD_DebSigOkCats_C "Ladelufttemperatur - Entprellzeit bis Signal geheilt" VALUE 0xD5098 Kw_Wu16 655350.0 Time_ms 0.00 655350.0 FORMAT "%8.1" /end CHARACTERISTIC
/begin CHARACTERISTIC IATSCD_DebSigDef_C "#SSD Ladelufttemperatur - Entprellzeit bis Signal defekt" VALUE 0xD5032 Kw_Wu16 655350.0 Time_ms 0.00 655350.0 FORMAT "%8.1" /end CHARACTERISTIC
/begin CHARACTERISTIC IATSCD_DebSigOk_C "Ladelufttemperatur - Entprellzeit bis Signal geheilt" VALUE 0xD5034 Kw_Wu16 655350.0 Time_ms 0.00 655350.0 FORMAT "%8.1" /end CHARACTERISTIC
/begin CHARACTERISTIC IATSCD_DebSRCHighDefCats_C "Ladelufttemperaturfühler Fehlerentprellzeit fuer SRC-High" VALUE 0xD509A Kw_Wu16 655350.0 Time_ms 0.00 655350.0 FORMAT "%8.1" /end CHARACTERISTIC
/begin CHARACTERISTIC IATSCD_DebSRCHighOkCats_C "Ladelufttemperaturfühler Heilungsentprellzeit fuer SRC-High" VALUE 0xD509C Kw_Wu16 655350.0 Time_ms 0.00 655350.0 FORMAT "%8.1" /end CHARACTERISTIC
/begin CHARACTERISTIC IATSCD_DebSRCHighDef_C "#SSD LTF Fehlerentprellzeit fuer SRC-High" VALUE 0xD5036 Kw_Wu16 655350.0 Time_ms 0.00 655350.0 FORMAT "%8.1" /end CHARACTERISTIC
/begin CHARACTERISTIC IATSCD_DebSRCHighOk_C "LTF Heilungsentprellzeit fuer SRC-High" VALUE 0xD5038 Kw_Wu16 655350.0 Time_ms 0.00 655350.0 FORMAT "%8.1" /end CHARACTERISTIC
/begin CHARACTERISTIC IATSCD_DebSRCLowDefCats_C "Ladelufttemperaturfühler Fehlerentprellzeit fuer SRC-Low" VALUE 0xD509E Kw_Wu16 655350.0 Time_ms 0.00 655350.0 FORMAT "%8.1" /end CHARACTERISTIC
/begin CHARACTERISTIC IATSCD_DebSRCLowOkCats_C "Ladelufttemperaturfühler Heilungsentprellzeit fuer SRC-Low" VALUE 0xD50A0 Kw_Wu16 655350.0 Time_ms 0.00 655350.0 FORMAT "%8.1" /end CHARACTERISTIC
/begin CHARACTERISTIC IATSCD_DebSRCLowDef_C "#SSD LTF Fehlerentprellzeit fuer SRC-Low" VALUE 0xD503A Kw_Wu16 655350.0 Time_ms 0.00 655350.0 FORMAT "%8.1" /end CHARACTERISTIC
/begin CHARACTERISTIC IATSCD_DebSRCLowOk_C "LTF Heilungsentprellzeit fuer SRC-Low" VALUE 0xD503C Kw_Wu16 655350.0 Time_ms 0.00 655350.0 FORMAT "%8.1" /end CHARACTERISTIC
/begin CHARACTERISTIC IATSCD_numAdcCats_C "#SSD Applikationsparameter fuer Ladelufttemperatur-Fuehler" VALUE 0xD50A2 Kw_Wu8 24.0000000000 NumPinAdc 0.00 24.0000000000 FORMAT "%13.10" /end CHARACTERISTIC
/begin CHARACTERISTIC IATSCD_numAdc_C "#SSD Applikationsparameter fuer Ansauglufttemperatur-Fuehler" VALUE 0xD503E Kw_Wu8 24.0000000000 NumPinAdc 0.00 24.0000000000 FORMAT "%13.10" /end CHARACTERISTIC
/begin CHARACTERISTIC IATSCD_dtRmpSlpUpCats_C "Rampensteigung bei Heilung/Vorgabewert für Ladelufttemperaturfühler" VALUE 0xD50A4 Kw_Wu32 6553598.99749 RmpTemp 1.00097656250 6553599.99847 FORMAT "%13.5" EXTENDED_LIMITS 0.00 6553599.99847 /end CHARACTERISTIC
/begin CHARACTERISTIC IATSCD_dtRmpSlpDwnCats_C "Rampensteigung bei Heilung/Vorgabewert für Ladelufttemperaturfühler" VALUE 0xD50A8 Kw_Wu32 6553598.99749 RmpTemp 1.00097656250 6553599.99847 FORMAT "%13.5" EXTENDED_LIMITS 0.00 6553599.99847 /end CHARACTERISTIC
/begin CHARACTERISTIC IATSCD_dtRmpSlpUp_C "Rampensteigung bei Heilung/Vorgabewert für LTF" VALUE 0xD5040 Kw_Wu32 6553598.99749 RmpTemp 1.00097656250 6553599.99847 FORMAT "%13.5" EXTENDED_LIMITS 0.00 6553599.99847 /end CHARACTERISTIC
/begin CHARACTERISTIC IATSCD_dtRmpSlpDwn_C "Rampensteigung bei Heilung/Vorgabewert für LTF" VALUE 0xD5044 Kw_Wu32 6553598.99749 RmpTemp 1.00097656250 6553599.99847 FORMAT "%13.5" EXTENDED_LIMITS 0.00 6553599.99847 /end CHARACTERISTIC
/begin CHARACTERISTIC IATSCD_swtSigValCats_C "Ladelufttemperatur - Funktionsschalter Signalquelle ADC oder CAN (0 = ADC, 1 = CAN)" VALUE 0xD50AC Kw_Wu8 1.000 OneToOne 0.00 1.000 FORMAT "%5.3" EXTENDED_LIMITS 0.00 255.0 /end CHARACTERISTIC
/begin CHARACTERISTIC IATSCD_swtSigVal_C "Lufttemperatur - Funktionsschalter Signalquelle ADC oder CAN (0=ADC, 1= CAN)" VALUE 0xD5048 Kw_Wu8 1.000 OneToOne 0.00 1.000 FORMAT "%5.3" EXTENDED_LIMITS 0.00 255.0 /end CHARACTERISTIC
/begin CHARACTERISTIC IATSCD_swtT10Src_C "Temperatur von ADC/CAN oder von Message AFSCD_tAir (0...ADC, 1...CAN)" VALUE 0xD5049 Kw_Wu8 1.000 OneToOne 0.00 1.000 FORMAT "%5.3" EXTENDED_LIMITS 0.00 255.0 /end CHARACTERISTIC
/begin CHARACTERISTIC IATSCD_stSensIDWordCats_C "Geberkennwort Ladelufttemperaturfühler" VALUE 0xD50AE Kw_Wu16 65535.00 OneToOne 0.00 65535.00 FORMAT "%8.2" /end CHARACTERISTIC
/begin CHARACTERISTIC IATSCD_tDflCats_C "Vorgabewert bei defektem Ladelufttemperaturfühler" VALUE 0xD50B0 Kw_Ws16 250.0000 Temp_Cels -50.14000 199.8600 FORMAT "%8.4" EXTENDED_LIMITS -3549.940 3003.560 /end CHARACTERISTIC
/begin CHARACTERISTIC IATSCD_stSensIDWord_C "Geberkennwort LTF-Sensor" VALUE 0xD504A Kw_Wu16 65535.00 OneToOne 0.00 65535.00 FORMAT "%8.2" /end CHARACTERISTIC
/begin CHARACTERISTIC IATSCD_tDfl_C "Vorgabewert bei defektem LTF-Sensor" VALUE 0xD504C Kw_Ws16 950.0000 Temp_Cels -50.1400 899.8600 FORMAT "%8.4" EXTENDED_LIMITS -3549.940 3003.560 /end CHARACTERISTIC
/begin CHARACTERISTIC IBSCD_tiReset_C "Applikationslabel fuer Powermanagement" VALUE 0xD50B6 Kw_Wu16 1980.000 Time_ms 20.00000 2000.000 FORMAT "%8.3" EXTENDED_LIMITS 0.00 655350.0 /end CHARACTERISTIC
/begin CHARACTERISTIC IBSCD_tiWaitDetection_C "Applikationslabel fuer Powermanagement" VALUE 0xD50B4 Kw_Wu16 655350.0 Time_ms 0.00 655350.0 FORMAT "%8.1" /end CHARACTERISTIC
/begin CHARACTERISTIC IndSys_facDiffCorr_CUR "Curve to determine the correction value" CURVE 0xD50D2 Kl_Xs16_Ws16 5.000000 Fact 0.00 5.000000 FORMAT "%8.6" EXTENDED_LIMITS -4.000000 3.999878
 /begin AXIS_DESCR STD_AXIS Eng_tEng Temp_Cels 5 -50.14000 199.8600 FORMAT "%8.4" EXTENDED_LIMITS -3549.940 3003.560 DEPOSIT ABSOLUTE /end AXIS_DESCR
/end CHARACTERISTIC
/begin CHARACTERISTIC IndSys_facVSACTCor_CUR "Korrektur des Drallniveau-Grundwertes  über Wassertemperatur" CURVE 0xD5290 Kl_Xs16_Ws16 100.0000 Fact 0.00 100.0000 FORMAT "%8.4" EXTENDED_LIMITS -4.000000 3.999878
 /begin AXIS_DESCR STD_AXIS CTSCD_tClnt Temp_Cels 8 -50.1400 899.8600 FORMAT "%8.4" EXTENDED_LIMITS -3549.940 3003.560 DEPOSIT ABSOLUTE /end AXIS_DESCR
/end CHARACTERISTIC
/begin CHARACTERISTIC IndSys_mAirPerCylLim_MAP "map to determine the Airmass value" MAP 0xD50E8 Kf_Xs16_Ys16_Ws16 1500.000 AirMassPerCyl 0.00 1500.000 FORMAT "%8.3" EXTENDED_LIMITS -3276.800 3276.700
 /begin AXIS_DESCR STD_AXIS Eng_nAvrg EngN 4 0.00 6000.000 FORMAT "%8.3" EXTENDED_LIMITS -32768.00 32767.00 DEPOSIT ABSOLUTE /end AXIS_DESCR
 /begin AXIS_DESCR STD_AXIS InjCtl_qSetUnBal InjMassCyc 4 0.00 327.6700 FORMAT "%8.4" EXTENDED_LIMITS -327.6800 327.6700 DEPOSIT ABSOLUTE /end AXIS_DESCR
/end CHARACTERISTIC
/begin CHARACTERISTIC IndSys_nAvrgMax_C "Maximum Engine speed threshold value" VALUE 0xD511C Kw_Ws16 6000.000 EngN 0.00 6000.000 FORMAT "%8.3" EXTENDED_LIMITS -32768.00 32767.00 /end CHARACTERISTIC
/begin CHARACTERISTIC IndSys_nAvrgMin_C "Minimum Engine speed threshold value" VALUE 0xD511E Kw_Ws16 6000.000 EngN 0.00 6000.000 FORMAT "%8.3" EXTENDED_LIMITS -32768.00 32767.00 /end CHARACTERISTIC
/begin CHARACTERISTIC IndSys_pAPDynCorr_CUR "Dynamic air pressure correction" CURVE 0xD5120 Kl_Xs16_Ws16 3500.000 Pres_hPa 0.00 3500.000 FORMAT "%8.3" EXTENDED_LIMITS -32768.00 32767.00
 /begin AXIS_DESCR STD_AXIS APSCD_pVal Pres_hPa 5 0.00 4000.000 FORMAT "%8.3" EXTENDED_LIMITS -32768.00 32767.00 DEPOSIT ABSOLUTE /end AXIS_DESCR
/end CHARACTERISTIC
/begin CHARACTERISTIC IndSys_pAPStatCorr_CUR "Static air pressure correction" CURVE 0xD5136 Kl_Xs16_Ws16 3500.000 Pres_hPa 0.00 3500.000 FORMAT "%8.3" EXTENDED_LIMITS -32768.00 32767.00
 /begin AXIS_DESCR STD_AXIS APSCD_pVal Pres_hPa 5 0.00 4000.000 FORMAT "%8.3" EXTENDED_LIMITS -32768.00 32767.00 DEPOSIT ABSOLUTE /end AXIS_DESCR
/end CHARACTERISTIC
/begin CHARACTERISTIC IndSys_pDiffCorr_MAP "map to determine the correction Pressure value" MAP 0xD514C Kf_Xs16_Ys16_Ws16 3500.000 Pres_hPa 0.00 3500.000 FORMAT "%8.3" EXTENDED_LIMITS -32768.00 32767.00
 /begin AXIS_DESCR STD_AXIS Eng_nAvrg EngN 6 0.00 6000.000 FORMAT "%8.3" EXTENDED_LIMITS -32768.00 32767.00 DEPOSIT ABSOLUTE /end AXIS_DESCR
 /begin AXIS_DESCR STD_AXIS InjCtl_qSetUnBal InjMassCyc 6 0.00 327.6700 FORMAT "%8.4" EXTENDED_LIMITS -327.6800 327.6700 DEPOSIT ABSOLUTE /end AXIS_DESCR
/end CHARACTERISTIC
/begin CHARACTERISTIC IndSys_pDiffStat_MAP "map to determine the Static Pressure value" MAP 0xD51B0 Kf_Xs16_Ys16_Ws16 3500.000 Pres_hPa 0.00 3500.000 FORMAT "%8.3" EXTENDED_LIMITS -32768.00 32767.00
 /begin AXIS_DESCR STD_AXIS Eng_nAvrg EngN 6 0.00 6000.000 FORMAT "%8.3" EXTENDED_LIMITS -32768.00 32767.00 DEPOSIT ABSOLUTE /end AXIS_DESCR
 /begin AXIS_DESCR STD_AXIS InjCtl_qSetUnBal InjMassCyc 6 0.00 327.6700 FORMAT "%8.4" EXTENDED_LIMITS -327.6800 327.6700 DEPOSIT ABSOLUTE /end AXIS_DESCR
/end CHARACTERISTIC
/begin CHARACTERISTIC IndSys_pDynMin_CUR "Curve to determine the Dynamic Pressure value" CURVE 0xD5214 Kl_Xs16_Ws16 3500.000 Pres_hPa 0.00 3500.000 FORMAT "%8.3" EXTENDED_LIMITS -32768.00 32767.00
 /begin AXIS_DESCR STD_AXIS Eng_nAvrg EngN 5 0.00 6000.000 FORMAT "%8.3" EXTENDED_LIMITS -32768.00 32767.00 DEPOSIT ABSOLUTE /end AXIS_DESCR
/end CHARACTERISTIC
/begin CHARACTERISTIC IndSys_qDiffStatMax_CUR "Curve to determine the Maximum static diff Quantity value" CURVE 0xD522A Kl_Xs16_Ws16 327.6700 InjMassCyc 0.00 327.6700 FORMAT "%8.4" EXTENDED_LIMITS -327.6800 327.6700
 /begin AXIS_DESCR STD_AXIS Eng_nAvrg EngN 5 0.00 6000.000 FORMAT "%8.3" EXTENDED_LIMITS -32768.00 32767.00 DEPOSIT ABSOLUTE /end AXIS_DESCR
/end CHARACTERISTIC
/begin CHARACTERISTIC IndSys_qDiffStatMin_CUR "Curve to determine the Minimum static diff Quantity value" CURVE 0xD5240 Kl_Xs16_Ws16 327.6700 InjMassCyc 0.00 327.6700 FORMAT "%8.4" EXTENDED_LIMITS -327.6800 327.6700
 /begin AXIS_DESCR STD_AXIS Eng_nAvrg EngN 5 0.00 6000.000 FORMAT "%8.3" EXTENDED_LIMITS -32768.00 32767.00 DEPOSIT ABSOLUTE /end AXIS_DESCR
/end CHARACTERISTIC
/begin CHARACTERISTIC IndSys_qSetDynMax_CUR "Curve to determine the Maximum Dynamic Quantity value" CURVE 0xD5256 Kl_Xs16_Ws16 327.6700 InjMassCyc 0.00 327.6700 FORMAT "%8.4" EXTENDED_LIMITS -327.6800 327.6700
 /begin AXIS_DESCR STD_AXIS Eng_nAvrg EngN 5 0.00 6000.000 FORMAT "%8.3" EXTENDED_LIMITS -32768.00 32767.00 DEPOSIT ABSOLUTE /end AXIS_DESCR
/end CHARACTERISTIC
/begin CHARACTERISTIC IndSys_qSetDynMin_CUR "Curve to determine the Minimum Dynamic Quantity value" CURVE 0xD526C Kl_Xs16_Ws16 327.6700 InjMassCyc 0.00 327.6700 FORMAT "%8.4" EXTENDED_LIMITS -327.6800 327.6700
 /begin AXIS_DESCR STD_AXIS Eng_nAvrg EngN 5 0.00 6000.000 FORMAT "%8.3" EXTENDED_LIMITS -32768.00 32767.00 DEPOSIT ABSOLUTE /end AXIS_DESCR
/end CHARACTERISTIC
/begin CHARACTERISTIC IndSys_qSetUnBalMax_C "Maximum Quantity  threshold value" VALUE 0xD5282 Kw_Ws16 327.6700 InjMassCyc 0.00 327.6700 FORMAT "%8.4" EXTENDED_LIMITS -327.6800 327.6700 /end CHARACTERISTIC
/begin CHARACTERISTIC IndSys_qSetUnBalMin_C "Minimum Quantity  threshold value" VALUE 0xD5284 Kw_Ws16 327.6700 InjMassCyc 0.00 327.6700 FORMAT "%8.4" EXTENDED_LIMITS -327.6800 327.6700 /end CHARACTERISTIC
/begin CHARACTERISTIC IndSys_rClsEGR_C "Ersatzwert für Output von IndSys_rVSARgn_MAP bei geschlossener EGR" VALUE 0xD52B2 Kw_Ws16 327.6700 DtyCyc 0.00 327.6700 FORMAT "%8.4" EXTENDED_LIMITS -327.6800 327.6700 /end CHARACTERISTIC
/begin CHARACTERISTIC IndSys_rVSAAdd_Vector "#SSD Bypass-Label für additiven Bypass von IndSys_rVSA (Nicht verstellen!)" VALUE 0xC3096 Kw_Wu8 255.0 OneToOne 0.00 255.0 FORMAT "%5.1" /end CHARACTERISTIC
/begin CHARACTERISTIC IndSys_rVSAAdd_Channel "#SSD Bypass-Label für additiven Bypass von IndSys_rVSA (Nicht verstellen!)" VALUE 0xC3097 Kw_Wu8 255.0 OneToOne 0.00 255.0 FORMAT "%5.1" /end CHARACTERISTIC
/begin CHARACTERISTIC IndSys_rVSAATCorr_CUR "Lufttemperatur Korrekturkennlinie" CURVE 0xD52B4 Kl_Xs16_Ws16 100.0000 DtyCyc 0.00 100.0000 FORMAT "%8.4" EXTENDED_LIMITS -327.6800 327.6700
 /begin AXIS_DESCR STD_AXIS IATSCD_tAir Temp_Cels 2 -50.1400 899.8600 FORMAT "%8.4" EXTENDED_LIMITS -3549.940 3003.560 DEPOSIT ABSOLUTE /end AXIS_DESCR
/end CHARACTERISTIC
/begin CHARACTERISTIC IndSys_rVSACTCor_MAP "Korrektur des Drallniveau-Grundwertes über Wassertemperatur" MAP 0xD52BE Kf_Xs16_Ys16_Ws16 100.0000 DtyCyc 0.00 100.0000 FORMAT "%8.4" EXTENDED_LIMITS -327.6800 327.6700
 /begin AXIS_DESCR STD_AXIS Eng_nAvrg EngN 10 -32768.00 32767.00 FORMAT "%8.2" DEPOSIT ABSOLUTE /end AXIS_DESCR
 /begin AXIS_DESCR STD_AXIS InjCtl_qRaw InjMassCyc 12 -327.6800 327.6700 FORMAT "%8.4" DEPOSIT ABSOLUTE /end AXIS_DESCR
/end CHARACTERISTIC
/begin CHARACTERISTIC IndSys_rVSAMAX_C "maximales Tasterverhältnis für Drallniveausteller (Maximalwertbegrenzung)" VALUE 0xD53DE Kw_Ws16 655.3500 DtyCyc -327.6800 327.6700 FORMAT "%8.4" /end CHARACTERISTIC
/begin CHARACTERISTIC IndSys_rVSARgn_MAP "Drallklappensteuerkennfeld für Regeneration" MAP 0xD53E0 Kf_Xs16_Ys16_Ws16 100.0000 DtyCyc 0.00 100.0000 FORMAT "%8.4" EXTENDED_LIMITS -327.6800 327.6700
 /begin AXIS_DESCR STD_AXIS Eng_nAvrg EngN 12 40.00000 6000.000 FORMAT "%8.3" EXTENDED_LIMITS -32768.00 32767.00 DEPOSIT ABSOLUTE /end AXIS_DESCR
 /begin AXIS_DESCR STD_AXIS InjCtl_qCurr InjMassCyc 16 0.00 327.6700 FORMAT "%8.4" EXTENDED_LIMITS -327.6800 327.6700 DEPOSIT ABSOLUTE /end AXIS_DESCR
/end CHARACTERISTIC
/begin CHARACTERISTIC IndSys_rVSA_MAP "Kennfeld für Drallniveausteuerung" MAP 0xD559C Kf_Xs16_Ys16_Ws16 100.0000 DtyCyc 0.00 100.0000 FORMAT "%8.4" EXTENDED_LIMITS -327.6800 327.6700
 /begin AXIS_DESCR STD_AXIS Eng_nAvrg EngN 12 -32768.00 32767.00 FORMAT "%8.2" DEPOSIT ABSOLUTE /end AXIS_DESCR
 /begin AXIS_DESCR STD_AXIS InjCtl_qCurr InjMassCyc 16 -327.6800 327.6700 FORMAT "%8.4" DEPOSIT ABSOLUTE /end AXIS_DESCR
/end CHARACTERISTIC
/begin CHARACTERISTIC IndSys_rVSA_Vector "#SSD Bypass-Label für IndSys_rVSA (Nicht verstellen!)" VALUE 0xC3098 Kw_Wu8 255.0 OneToOne 0.00 255.0 FORMAT "%5.1" /end CHARACTERISTIC
/begin CHARACTERISTIC IndSys_rVSA_Channel "#SSD Bypass-Label für IndSys_rVSA (Nicht verstellen!)" VALUE 0xC3099 Kw_Wu8 255.0 OneToOne 0.00 255.0 FORMAT "%5.1" /end CHARACTERISTIC
/begin CHARACTERISTIC IndSys_stMskVSARgn_C "Bitmaske für Codierung der Umschaltung bei Regeneration" VALUE 0xD5758 Kw_Wu32 4294967295.00 OneToOne 0.00 4294967295.00 FORMAT "%13.2" /end CHARACTERISTIC
/begin CHARACTERISTIC IndSys_tiDelayDef1_C "Time delay for Defect1" VALUE 0xD5286 Kw_Wu16 10000.00 Time_ms 0.00 10000.00 FORMAT "%8.2" EXTENDED_LIMITS 0.00 655350.0 /end CHARACTERISTIC
/begin CHARACTERISTIC IndSys_tiDelayDef2_C "Time delay for Defect2" VALUE 0xD5288 Kw_Wu16 10000.00 Time_ms 0.00 10000.00 FORMAT "%8.2" EXTENDED_LIMITS 0.00 655350.0 /end CHARACTERISTIC
/begin CHARACTERISTIC IndSys_tiDelayDef3_C "IndSys_nAvrgMin_C" VALUE 0xD528A Kw_Wu16 10000.00 Time_ms 0.00 10000.00 FORMAT "%8.2" EXTENDED_LIMITS 0.00 655350.0 /end CHARACTERISTIC
/begin CHARACTERISTIC IndSys_tiDelayOK1_C "Time delay for O.K1" VALUE 0xD528C Kw_Wu16 10000.00 Time_ms 0.00 10000.00 FORMAT "%8.2" EXTENDED_LIMITS 0.00 655350.0 /end CHARACTERISTIC
/begin CHARACTERISTIC IndSys_tiRmpSlpVSA_C "Rampenlaufzeit für Regenerationsschalter" VALUE 0xD575C Kw_Wu32 31.775030303030302 TimeEGTRmp 0.99296969696969695 32.768000000000001 FORMAT "%19.16" EXTENDED_LIMITS 0.000000015258789066052715 65.536000000000001 /end CHARACTERISTIC
/begin CHARACTERISTIC IndSys_tiStartDelay_C "Verzögerungszeit zum Umschalten auf einen anderen Vorgabewert im Startfall" VALUE 0xD5760 Kw_Ws16 655.3500 Time_s -327.6800 327.6700 FORMAT "%8.4" /end CHARACTERISTIC
/begin CHARACTERISTIC InjCrv_ctTempSel_C "Auszulesende Motortemperatur aus dem Motortemperaturenfeld" VALUE 0xD5768 Kw_Wu8 2.00000000000 EngTempFldSel 0.00 2.00000000000 FORMAT "%13.11" /end CHARACTERISTIC
/begin CHARACTERISTIC InjCrv_DebLimDef_C "#SSD Fehlerentprellzeit für Begrenzung der Anzahl der Einspritzungen" VALUE 0xD576A Kw_Wu16 65535.00 OneToOne 0.00 65535.00 FORMAT "%8.2" /end CHARACTERISTIC
/begin CHARACTERISTIC InjCrv_DebLimOk_C "#SSD Heilungsentprellzeit für Begrenzung der Anzahl der Einspritzungen" VALUE 0xD576C Kw_Wu16 65535.00 OneToOne 0.00 65535.00 FORMAT "%8.2" /end CHARACTERISTIC
/begin CHARACTERISTIC InjCrv_dphiMIDynUp_C "Rampensteigung für Korrekturwertsteigung auf 0 Grad KW" VALUE 0xD86E4 Kw_Wu32 1535999.99964 RmpCrsAg_InjCrv 0.00 1535999.99964 FORMAT "%13.5" /end CHARACTERISTIC
/begin CHARACTERISTIC InjCrv_dphiMIDynDown_C "Rampensteigung für Korrekturwertabsenkung auf 0 Grad KW" VALUE 0xD86E8 Kw_Wu32 1535999.99964 RmpCrsAg_InjCrv 0.00 1535999.99964 FORMAT "%13.5" /end CHARACTERISTIC
/begin CHARACTERISTIC InjCrv_dqFltLowNeg_C "Schwellwert für pos. dq für Filter Parameter Auswahl" VALUE 0xD86EC Kw_Ws16 32767.50 InjMassPerSec_20ms -16384.00 16383.50 FORMAT "%8.2" /end CHARACTERISTIC
/begin CHARACTERISTIC InjCrv_dqFltLowPos_C "pos. dq Schwellwert für Filter Parameter Selektion" VALUE 0xD86EE Kw_Ws16 32767.50 InjMassPerSec_20ms -16384.00 16383.50 FORMAT "%8.2" /end CHARACTERISTIC
/begin CHARACTERISTIC InjCrv_dqFltMidNeg_C "pos dq threshold for PT1 filter parameter selection" VALUE 0xD86F0 Kw_Ws16 32767.50 InjMassPerSec_20ms -16384.00 16383.50 FORMAT "%8.2" /end CHARACTERISTIC
/begin CHARACTERISTIC InjCrv_dqFltMidPos_C "pos dq threshold for PT1 filter parameter selection" VALUE 0xD86F2 Kw_Ws16 32767.50 InjMassPerSec_20ms -16384.00 16383.50 FORMAT "%8.2" /end CHARACTERISTIC
/begin CHARACTERISTIC InjCrv_dqSetUnBalMax_C "pos dq threshold for PT1 filter parameter selection" VALUE 0xD86F4 Kw_Ws16 32767.50 InjMassPerSec_20ms -16384.00 16383.50 FORMAT "%8.2" /end CHARACTERISTIC
/begin CHARACTERISTIC InjCrv_dqSetUnBalMin_C "pos dq threshold for PT1 filter parameter selection" VALUE 0xD86F6 Kw_Ws16 32767.50 InjMassPerSec_20ms -16384.00 16383.50 FORMAT "%8.2" /end CHARACTERISTIC
/begin CHARACTERISTIC InjCrv_facAPMIDynCor2_CUR "weighting factor by engine temperature for SOE correction" CURVE 0xD8658 Kl_Xs16_Ws16 2.000000 Fact 0.00 2.000000 FORMAT "%8.6" EXTENDED_LIMITS -4.000000 3.999878
 /begin AXIS_DESCR STD_AXIS APSCD_pVal Pres_hPa 6 0.00 3500.000 FORMAT "%8.3" EXTENDED_LIMITS -32768.00 32767.00 DEPOSIT ABSOLUTE /end AXIS_DESCR
/end CHARACTERISTIC
/begin CHARACTERISTIC InjCrv_facDQMI1DynCor2_CUR "Gewichtungsfaktor der abgeleiteten Einspritzmenge for S0E Korrektur" CURVE 0xD86F8 Kl_Xs16_Ws16 4.000000 Fact -2.000000 2.000000 FORMAT "%8.6" EXTENDED_LIMITS -4.000000 3.999878
 /begin AXIS_DESCR STD_AXIS InjCrv_dqSetUnBalFltLim InjMassPerSec_20ms 6 -16384.00 16383.50 FORMAT "%8.2" DEPOSIT ABSOLUTE /end AXIS_DESCR
/end CHARACTERISTIC
/begin CHARACTERISTIC InjCrv_facETMIDynCor2_CUR "weighting factor by engine temperature for SOE correction" CURVE 0xD8672 Kl_Xs16_Ws16 2.000000 Fact 0.00 2.000000 FORMAT "%8.6" EXTENDED_LIMITS -4.000000 3.999878
 /begin AXIS_DESCR STD_AXIS InjCrv_tEng Temp_Cels 6 -50.14000 199.8600 FORMAT "%8.4" EXTENDED_LIMITS -3549.940 3003.560 DEPOSIT ABSOLUTE /end AXIS_DESCR
/end CHARACTERISTIC
/begin CHARACTERISTIC InjCrv_facIATMIDynCor2_CUR "weigthing factor by engine temperature for SOE correction" CURVE 0xD868C Kl_Xs16_Ws16 2.000000 Fact 0.00 2.000000 FORMAT "%8.6" EXTENDED_LIMITS -4.000000 3.999878
 /begin AXIS_DESCR STD_AXIS IATSCD_tAir Temp_Cels 6 -50.14000 199.8600 FORMAT "%8.4" EXTENDED_LIMITS -3549.940 3003.560 DEPOSIT ABSOLUTE /end AXIS_DESCR
/end CHARACTERISTIC
/begin CHARACTERISTIC InjCrv_facMIAPSPhiCor2_CUR "atmosphärendruckabhängige Korrekturkennlinie -2 für Ansteuerbeginn MI1" CURVE 0xDA3B4 Gkl_Ws16 1.000000 Fact 0.00 1.000000 FORMAT "%8.6" EXTENDED_LIMITS -4.000000 3.999878
 /begin AXIS_DESCR COM_AXIS APSCD_pVal Pres_hPa 8 0.00 4000.000 FORMAT "%8.3" EXTENDED_LIMITS -32768.00 32767.00 AXIS_PTS_REF InjCrv_facMIAPSPhiCor_AXIS /end AXIS_DESCR
/end CHARACTERISTIC
/begin CHARACTERISTIC InjCrv_facMIAPSPhiCorStrt_CUR "weighting factor by air pressure for SOE correction" CURVE 0xDA3C4 Kl_Xs16_Ws16 1.000000 Fact 0.00 1.000000 FORMAT "%8.6" EXTENDED_LIMITS -4.000000 3.999878
 /begin AXIS_DESCR STD_AXIS APSCD_pVal Pres_hPa 8 0.00 4000.000 FORMAT "%8.3" EXTENDED_LIMITS -32768.00 32767.00 DEPOSIT ABSOLUTE /end AXIS_DESCR
/end CHARACTERISTIC
/begin AXIS_PTS InjCrv_facMIAPSPhiCor_AXIS "gemeinsame Stützstellen für atmosphärendruckabhängige Ansteuerbeginnkorrekturkennlinien für MI1" 0xDA3E6 APSCD_pVal GSst_Xs16 4000.000 Pres_hPa 8 0.00 4000.000 FORMAT "%8.3" EXTENDED_LIMITS -32768.00 32767.00 DEPOSIT ABSOLUTE /end AXIS_PTS
/begin CHARACTERISTIC InjCrv_facMIAPSPhiCor_CUR "atmosphärendruckabhängige Ansteuerbeginnkorrekturkennlinie für MI1" CURVE 0xDA3F8 Gkl_Ws16 1.000000 Fact 0.00 1.000000 FORMAT "%8.6" EXTENDED_LIMITS -4.000000 3.999878
 /begin AXIS_DESCR COM_AXIS APSCD_pVal Pres_hPa 8 0.00 4000.000 FORMAT "%8.3" EXTENDED_LIMITS -32768.00 32767.00 AXIS_PTS_REF InjCrv_facMIAPSPhiCor_AXIS /end AXIS_DESCR
/end CHARACTERISTIC
/begin CHARACTERISTIC InjCrv_facMIATSDynCor_CUR "Korrekturkennline für Lufttemperaturkorrektur" CURVE 0xD86A6 Kl_Xs16_Ws16 2.000000 Fact 0.00 2.000000 FORMAT "%8.6" EXTENDED_LIMITS -4.000000 3.999878
 /begin AXIS_DESCR STD_AXIS IATSCD_tAir Temp_Cels 6 -50.14000 199.8600 FORMAT "%8.4" EXTENDED_LIMITS -3549.940 3003.560 DEPOSIT ABSOLUTE /end AXIS_DESCR
/end CHARACTERISTIC
/begin CHARACTERISTIC InjCrv_facMIATSPhiCor2_CUR "ansauglufttemperaturabhängige Korrekturkennlinie -2 für Ansteuerbeginn MI1" CURVE 0xDA408 Gkl_Ws16 1.000000 Fact 0.00 1.000000 FORMAT "%8.6" EXTENDED_LIMITS -4.000000 3.999878
 /begin AXIS_DESCR COM_AXIS IATSCD_tAir Temp_Cels 8 -50.14000 199.8600 FORMAT "%8.4" EXTENDED_LIMITS -3549.940 3003.560 AXIS_PTS_REF InjCrv_facMIATSPhiCor_AXIS /end AXIS_DESCR
/end CHARACTERISTIC
/begin CHARACTERISTIC InjCrv_facMIATSPhiCorStrt_CUR "weighting factor by intake air temperature for SOE correction" CURVE 0xDA418 Kl_Xs16_Ws16 1.000000 Fact 0.00 1.000000 FORMAT "%8.6" EXTENDED_LIMITS -4.000000 3.999878
 /begin AXIS_DESCR STD_AXIS IATSCD_tAir Temp_Cels 8 -50.14000 199.8600 FORMAT "%8.4" EXTENDED_LIMITS -3549.940 3003.560 DEPOSIT ABSOLUTE /end AXIS_DESCR
/end CHARACTERISTIC
/begin AXIS_PTS InjCrv_facMIATSPhiCor_AXIS "gemeinsame Stützstellen für ansauglufttemperaturabhängige Ansteuerbeginnkorrekturkennlinien für MI1" 0xDA43A IATSCD_tAir GSst_Xs16 250.0000 Temp_Cels 8 -50.14000 199.8600 FORMAT "%8.4" EXTENDED_LIMITS -3549.940 3003.560 DEPOSIT ABSOLUTE /end AXIS_PTS
/begin CHARACTERISTIC InjCrv_facMIATSPhiCor_CUR "ansauglufttemperaturabhängige Ansteuerbeginnkorrekturkennlinie für MI1" CURVE 0xDA44C Gkl_Ws16 1.000000 Fact 0.00 1.000000 FORMAT "%8.6" EXTENDED_LIMITS -4.000000 3.999878
 /begin AXIS_DESCR COM_AXIS IATSCD_tAir Temp_Cels 8 -50.14000 199.8600 FORMAT "%8.4" EXTENDED_LIMITS -3549.940 3003.560 AXIS_PTS_REF InjCrv_facMIATSPhiCor_AXIS /end AXIS_DESCR
/end CHARACTERISTIC
/begin CHARACTERISTIC InjCrv_facMICTSDynCor_CUR "Korrekturkennlinie für Wassertemperaturkorrektur" CURVE 0xD86C0 Kl_Xs16_Ws16 2.000000 Fact 0.00 2.000000 FORMAT "%8.6" EXTENDED_LIMITS -4.000000 3.999878
 /begin AXIS_DESCR STD_AXIS CTSCD_tClnt Temp_Cels 6 -50.14000 199.8600 FORMAT "%8.4" EXTENDED_LIMITS -3549.940 3003.560 DEPOSIT ABSOLUTE /end AXIS_DESCR
/end CHARACTERISTIC
/begin CHARACTERISTIC InjCrv_facMIETSPhiCor12_CUR "motortemperaturabhängige Ansteuerbeginnkorrekturkennlinie" CURVE 0xDA45C Gkl_Ws16 1.000000 Fact 0.00 1.000000 FORMAT "%8.6" EXTENDED_LIMITS -4.000000 3.999878
 /begin AXIS_DESCR COM_AXIS InjCrv_tEng Temp_Cels 8 -50.14000 199.8600 FORMAT "%8.4" EXTENDED_LIMITS -3549.940 3003.560 AXIS_PTS_REF InjCrv_facMIETSPhiCor1_AXIS /end AXIS_DESCR
/end CHARACTERISTIC
/begin AXIS_PTS InjCrv_facMIETSPhiCor1_AXIS "Achsenpunkte der Motortemperatur" 0xDA46C InjCrv_tEng GSst_Xs16 250.0000 Temp_Cels 8 -50.14000 199.8600 FORMAT "%8.4" EXTENDED_LIMITS -3549.940 3003.560 DEPOSIT ABSOLUTE /end AXIS_PTS
/begin CHARACTERISTIC InjCrv_facMIETSPhiCor1_CUR "motortemperaturabhängige Korrekturkennlinie -1 für Ansteuerbeginn MI1" CURVE 0xDA47E Gkl_Ws16 1.000000 Fact 0.00 1.000000 FORMAT "%8.6" EXTENDED_LIMITS -4.000000 3.999878
 /begin AXIS_DESCR COM_AXIS InjCrv_tEng Temp_Cels 8 -50.14000 199.8600 FORMAT "%8.4" EXTENDED_LIMITS -3549.940 3003.560 AXIS_PTS_REF InjCrv_facMIETSPhiCor1_AXIS /end AXIS_DESCR
/end CHARACTERISTIC
/begin CHARACTERISTIC InjCrv_facMIETSPhiCor2_CUR "motortemperaturabhängige Korrekturkennlinie -2 für Ansteuerbeginn MI1" CURVE 0xDA48E Gkl_Ws16 1.000000 Fact 0.00 1.000000 FORMAT "%8.6" EXTENDED_LIMITS -4.000000 3.999878
 /begin AXIS_DESCR COM_AXIS InjCrv_tEng Temp_Cels 8 -50.14000 199.8600 FORMAT "%8.4" EXTENDED_LIMITS -3549.940 3003.560 AXIS_PTS_REF InjCrv_facMIETSPhiCor_AXIS /end AXIS_DESCR
/end CHARACTERISTIC
/begin CHARACTERISTIC InjCrv_facMIETSPhiCorStrt_CUR "weighting factor by engine temperature for SOE correction" CURVE 0xDA49E Kl_Xs16_Ws16 1.000000 Fact 0.00 1.000000 FORMAT "%8.6" EXTENDED_LIMITS -4.000000 3.999878
 /begin AXIS_DESCR STD_AXIS InjCrv_tEng Temp_Cels 8 -50.14000 199.8600 FORMAT "%8.4" EXTENDED_LIMITS -3549.940 3003.560 DEPOSIT ABSOLUTE /end AXIS_DESCR
/end CHARACTERISTIC
/begin AXIS_PTS InjCrv_facMIETSPhiCor_AXIS "gemeinsame Stützstellen für motortemperaturabhängige Ansteuerbeginnkorrekturkennlinien für MI1" 0xDA4C0 InjCrv_tEng GSst_Xs16 250.0000 Temp_Cels 8 -50.14000 199.8600 FORMAT "%8.4" EXTENDED_LIMITS -3549.940 3003.560 DEPOSIT ABSOLUTE /end AXIS_PTS
/begin CHARACTERISTIC InjCrv_facMIETSPhiCor_CUR "motortemperaturabhängige Ansteuerbeginnkorrekturkennlinie für MI1" CURVE 0xDA4D2 Gkl_Ws16 1.000000 Fact 0.00 1.000000 FORMAT "%8.6" EXTENDED_LIMITS -4.000000 3.999878
 /begin AXIS_DESCR COM_AXIS InjCrv_tEng Temp_Cels 8 -50.14000 199.8600 FORMAT "%8.4" EXTENDED_LIMITS -3549.940 3003.560 AXIS_PTS_REF InjCrv_facMIETSPhiCor_AXIS /end AXIS_DESCR
/end CHARACTERISTIC
/begin CHARACTERISTIC InjCrv_facMIFTSRailCorStrt_CUR "correction factor curve for the MI1, based on rail pressure" CURVE 0xDA4E2 Kl_Xs16_Ws16 1.000000 Fact 0.00 1.000000 FORMAT "%8.6" EXTENDED_LIMITS -4.000000 3.999878
 /begin AXIS_DESCR STD_AXIS Rail_pSetPointFlTempCor Pres_Rail 8 -1800.000 2000.000 FORMAT "%5.3" EXTENDED_LIMITS -3276.800 3276.700 DEPOSIT ABSOLUTE /end AXIS_DESCR
/end CHARACTERISTIC
/begin CHARACTERISTIC InjCrv_facMIFTSRailCor_CUR "Korrekturfaktorkennlinie für die MI1, abhängig von der kraftstofftemperaturabhängigen Raildruckkorrektur" CURVE 0xDA504 Kl_Xs16_Ws16 1.000000 Fact 0.00 1.000000 FORMAT "%8.6" EXTENDED_LIMITS -4.000000 3.999878
 /begin AXIS_DESCR STD_AXIS Rail_pSetPointFlTempCor Pres_Rail 8 -1800.000 2000.000 FORMAT "%5.3" EXTENDED_LIMITS -3276.800 3276.700 DEPOSIT ABSOLUTE /end AXIS_DESCR
/end CHARACTERISTIC
/begin CHARACTERISTIC InjCrv_facMIPDynCor_CUR "Korrekturkennlinie für Faktor abhängig vom Raildruck" CURVE 0xD8712 Kl_Xs16_Ws16 2.000000 Fact 0.00 2.000000 FORMAT "%8.6" EXTENDED_LIMITS -4.000000 3.999878
 /begin AXIS_DESCR STD_AXIS InjCrv_pMIDynCor_mp Pres_Rail 8 -3276.800 3276.700 FORMAT "%5.3" DEPOSIT ABSOLUTE /end AXIS_DESCR
/end CHARACTERISTIC
/begin CHARACTERISTIC InjCrv_tiLowNegPT1_C "dq filter time constant neg. slope low range" VALUE 0xD8734 Kw_Wu32 4294.9673 TimeDelay_s 0.0000010000000 4294.9673 FORMAT "%9.4" /end CHARACTERISTIC
/begin CHARACTERISTIC InjCrv_tiLowPosPT1_C "dq filter time constant pos. slope low range" VALUE 0xD8738 Kw_Wu32 4294.9673 TimeDelay_s 0.0000010000000 4294.9673 FORMAT "%9.4" /end CHARACTERISTIC
/begin CHARACTERISTIC InjCrv_tiMidNegPT1_C "dq filter time constant neg. slope middle range" VALUE 0xD873C Kw_Wu32 4294.9673 TimeDelay_s 0.0000010000000 4294.9673 FORMAT "%9.4" /end CHARACTERISTIC
/begin CHARACTERISTIC InjCrv_tiMidPosPT1_C "dq filter time constant pos. slope middle range" VALUE 0xD8740 Kw_Wu32 4294.9673 TimeDelay_s 0.0000010000000 4294.9673 FORMAT "%9.4" /end CHARACTERISTIC
/begin CHARACTERISTIC InjCrv_tiUppNegPT1_C "dq filter time constant neg. slope upper range" VALUE 0xD8744 Kw_Wu32 4294.9673 TimeDelay_s 0.0000010000000 4294.9673 FORMAT "%9.4" /end CHARACTERISTIC
/begin CHARACTERISTIC InjCrv_tiUppPosPT1_C "dq filter time constant pos. slope upper range" VALUE 0xD8748 Kw_Wu32 4294.9673 TimeDelay_s 0.0000010000000 4294.9673 FORMAT "%9.4" /end CHARACTERISTIC
/begin CHARACTERISTIC InjCrv_tiDT1DQMISOECor2_C "reciprocal of time delay DT1" VALUE 0xD874C Kw_Wu32 4294.9673 TimeDelay_s 0.0000010000000 4294.9673 FORMAT "%9.4" /end CHARACTERISTIC
/begin CHARACTERISTIC InjCrv_KdDT1DQMISOECor2_C "Diffenrential factor Kd q DT1 filter" VALUE 0xD8750 Kw_Ws32 3276799.99924 Kd_PerSec_20ms -1638400.00000 1638399.99924 FORMAT "%13.5" /end CHARACTERISTIC
/begin CHARACTERISTIC InjCrv_tiDpCorrDT1_C "DT1-Paramter für Atmosphärendruckfilterung" VALUE 0xD86DC Kw_Wu32 4294.9673 TimeDelay_s 0.0000010000000 4294.9673 FORMAT "%9.4" /end CHARACTERISTIC
/begin CHARACTERISTIC InjCrv_dpCorrDKd_C "DT1-Paramter Atmosphärendruckfilterung" VALUE 0xD86E0 Kw_Ws32 32767.9999924 Kd_Pres2dpdt -16384.0000000 16383.9999924 FORMAT "%13.7" /end CHARACTERISTIC
/begin CHARACTERISTIC InjCrv_nMIDynMax_C "Drehzahlschwelle unter der die Korrektur erfolgt" VALUE 0xD8754 Kw_Ws16 6000.000 EngN 0.00 6000.000 FORMAT "%8.3" EXTENDED_LIMITS -32768.00 32767.00 /end CHARACTERISTIC
/begin CHARACTERISTIC InjCrv_numInjMaxSys_C "#SSD Systembedingte maximal erlaubte Anzahl an Einspritzungen" VALUE 0xD576E Kw_Wu8 6.000 OneToOne 0.00 6.000 FORMAT "%5.3" EXTENDED_LIMITS 0.00 255.0 /end CHARACTERISTIC
/begin CHARACTERISTIC InjCrv_phiMI1Bas1CBFDC_MAP "1st base map of MI1 SOE for compressor bypass open, for Sport mode" MAP 0xD69DC Kf_Xs16_Ys16_Ws16 50.01562 AngleCrS -10.00781 40.00781 FORMAT "%8.5" EXTENDED_LIMITS -768.0000 767.9766
 /begin AXIS_DESCR STD_AXIS Eng_nAvrg EngN 16 0.00 6000.000 FORMAT "%8.3" EXTENDED_LIMITS -32768.00 32767.00 DEPOSIT ABSOLUTE /end AXIS_DESCR
 /begin AXIS_DESCR STD_AXIS InjCtl_qSetUnBal InjMassCyc 16 0.00 327.6700 FORMAT "%8.4" EXTENDED_LIMITS -327.6800 327.6700 DEPOSIT ABSOLUTE /end AXIS_DESCR
/end CHARACTERISTIC
/begin CHARACTERISTIC InjCrv_phiMI1Bas1CB_MAP "Grundwert Ansteuerbeginn, wenn keine PiI aktiv ist bei geoeffnetem Verdichterbypass" MAP 0xD6C20 Kf_Xs16_Ys16_Ws16 50.01562 AngleCrS -10.00781 40.00781 FORMAT "%8.5" EXTENDED_LIMITS -768.0000 767.9766
 /begin AXIS_DESCR STD_AXIS Eng_nAvrg EngN 16 0.00 6000.000 FORMAT "%8.3" EXTENDED_LIMITS -32768.00 32767.00 DEPOSIT ABSOLUTE /end AXIS_DESCR
 /begin AXIS_DESCR STD_AXIS InjCtl_qSetUnBal InjMassCyc 16 0.00 327.6700 FORMAT "%8.4" EXTENDED_LIMITS -327.6800 327.6700 DEPOSIT ABSOLUTE /end AXIS_DESCR
/end CHARACTERISTIC
/begin CHARACTERISTIC InjCrv_phiMI1Bas1FDC_MAP "1st base map of MI1 SOE for sport mode" MAP 0xD6E64 Kf_Xs16_Ys16_Ws16 50.01562 AngleCrS -10.00781 40.00781 FORMAT "%8.5" EXTENDED_LIMITS -768.0000 767.9766
 /begin AXIS_DESCR STD_AXIS Eng_nAvrg EngN 16 0.00 6000.000 FORMAT "%8.3" EXTENDED_LIMITS -32768.00 32767.00 DEPOSIT ABSOLUTE /end AXIS_DESCR
 /begin AXIS_DESCR STD_AXIS InjCtl_qSetUnBal InjMassCyc 16 0.00 327.6700 FORMAT "%8.4" EXTENDED_LIMITS -327.6800 327.6700 DEPOSIT ABSOLUTE /end AXIS_DESCR
/end CHARACTERISTIC
/begin CHARACTERISTIC InjCrv_phiMI1Bas1_MAP "1. Grundwertekennfeld,  Ansteuerbeginn MI1" MAP 0xD70A8 Kf_Xs16_Ys16_Ws16 1535.977 AngleCrS -768.0000 767.9766 FORMAT "%8.4"
 /begin AXIS_DESCR STD_AXIS Eng_nAvrg EngN 16 0.00 6000.000 FORMAT "%8.3" EXTENDED_LIMITS -32768.00 32767.00 DEPOSIT ABSOLUTE /end AXIS_DESCR
 /begin AXIS_DESCR STD_AXIS InjCtl_qSetUnBal InjMassCyc 16 0.00 327.6700 FORMAT "%8.4" EXTENDED_LIMITS -327.6800 327.6700 DEPOSIT ABSOLUTE /end AXIS_DESCR
/end CHARACTERISTIC
/begin CHARACTERISTIC InjCrv_phiMI1Bas2CBFDC_MAP "2nd base map of MI1 SOE for compressor bypass open, in sport mode" MAP 0xD72EC Kf_Xs16_Ys16_Ws16 50.01562 AngleCrS -10.00781 40.00781 FORMAT "%8.5" EXTENDED_LIMITS -768.0000 767.9766
 /begin AXIS_DESCR STD_AXIS Eng_nAvrg EngN 16 0.00 6000.000 FORMAT "%8.3" EXTENDED_LIMITS -32768.00 32767.00 DEPOSIT ABSOLUTE /end AXIS_DESCR
 /begin AXIS_DESCR STD_AXIS InjCtl_qSetUnBal InjMassCyc 16 0.00 327.6700 FORMAT "%8.4" EXTENDED_LIMITS -327.6800 327.6700 DEPOSIT ABSOLUTE /end AXIS_DESCR
/end CHARACTERISTIC
/begin CHARACTERISTIC InjCrv_phiMI1Bas2CB_MAP "Grundwert Ansteuerbeginn, wenn nur PiI1 aktiv ist bei geoeffnetem Verdichterbypass" MAP 0xD7530 Kf_Xs16_Ys16_Ws16 50.01562 AngleCrS -10.00781 40.00781 FORMAT "%8.5" EXTENDED_LIMITS -768.0000 767.9766
 /begin AXIS_DESCR STD_AXIS Eng_nAvrg EngN 16 0.00 6000.000 FORMAT "%8.3" EXTENDED_LIMITS -32768.00 32767.00 DEPOSIT ABSOLUTE /end AXIS_DESCR
 /begin AXIS_DESCR STD_AXIS InjCtl_qSetUnBal InjMassCyc 16 0.00 327.6700 FORMAT "%8.4" EXTENDED_LIMITS -327.6800 327.6700 DEPOSIT ABSOLUTE /end AXIS_DESCR
/end CHARACTERISTIC
/begin CHARACTERISTIC InjCrv_phiMI1Bas2FDC_MAP "2nd base map of MI1 SOE for sport mode" MAP 0xD7774 Kf_Xs16_Ys16_Ws16 50.01562 AngleCrS -10.00781 40.00781 FORMAT "%8.5" EXTENDED_LIMITS -768.0000 767.9766
 /begin AXIS_DESCR STD_AXIS Eng_nAvrg EngN 16 0.00 6000.000 FORMAT "%8.3" EXTENDED_LIMITS -32768.00 32767.00 DEPOSIT ABSOLUTE /end AXIS_DESCR
 /begin AXIS_DESCR STD_AXIS InjCtl_qSetUnBal InjMassCyc 16 0.00 327.6700 FORMAT "%8.4" EXTENDED_LIMITS -327.6800 327.6700 DEPOSIT ABSOLUTE /end AXIS_DESCR
/end CHARACTERISTIC
/begin CHARACTERISTIC InjCrv_phiMI1Bas2_MAP "2. Grundwertekennfeld,  Ansteuerbeginn MI1" MAP 0xD79B8 Kf_Xs16_Ys16_Ws16 50.01562 AngleCrS -10.00781 40.00781 FORMAT "%8.5" EXTENDED_LIMITS -768.0000 767.9766
 /begin AXIS_DESCR STD_AXIS Eng_nAvrg EngN 16 0.00 6000.000 FORMAT "%8.3" EXTENDED_LIMITS -32768.00 32767.00 DEPOSIT ABSOLUTE /end AXIS_DESCR
 /begin AXIS_DESCR STD_AXIS InjCtl_qSetUnBal InjMassCyc 16 0.00 327.6700 FORMAT "%8.4" EXTENDED_LIMITS -327.6800 327.6700 DEPOSIT ABSOLUTE /end AXIS_DESCR
/end CHARACTERISTIC
/begin CHARACTERISTIC InjCrv_phiMI1Bas3_MAP "3. Grundwertekennfeld, Ansteuerbeginn MI1" MAP 0xD7BFC Kf_Xs16_Ys16_Ws16 50.01562 AngleCrS -10.00781 40.00781 FORMAT "%8.5" EXTENDED_LIMITS -768.0000 767.9766
 /begin AXIS_DESCR STD_AXIS Eng_nAvrg EngN 16 0.00 6000.000 FORMAT "%8.3" EXTENDED_LIMITS -32768.00 32767.00 DEPOSIT ABSOLUTE /end AXIS_DESCR
 /begin AXIS_DESCR STD_AXIS InjCtl_qSetUnBal InjMassCyc 16 0.00 327.6700 FORMAT "%8.4" EXTENDED_LIMITS -327.6800 327.6700 DEPOSIT ABSOLUTE /end AXIS_DESCR
/end CHARACTERISTIC
/begin CHARACTERISTIC InjCrv_phiMI1Bas4_MAP "4. Grundwertekennfeld, Ansteuerbeginn MI1" MAP 0xD7E40 Kf_Xs16_Ys16_Ws16 50.01562 AngleCrS -10.00781 40.00781 FORMAT "%8.5" EXTENDED_LIMITS -768.0000 767.9766
 /begin AXIS_DESCR STD_AXIS Eng_nAvrg EngN 16 0.00 6000.000 FORMAT "%8.3" EXTENDED_LIMITS -32768.00 32767.00 DEPOSIT ABSOLUTE /end AXIS_DESCR
 /begin AXIS_DESCR STD_AXIS InjCtl_qSetUnBal InjMassCyc 16 0.00 327.6700 FORMAT "%8.4" EXTENDED_LIMITS -327.6800 327.6700 DEPOSIT ABSOLUTE /end AXIS_DESCR
/end CHARACTERISTIC
/begin CHARACTERISTIC InjCrv_phiMI1Bas5_MAP "5. Grundwertekennfeld, Ansteuerbeginn MI1" MAP 0xD8084 Kf_Xs16_Ys16_Ws16 50.01562 AngleCrS -10.00781 40.00781 FORMAT "%8.5" EXTENDED_LIMITS -768.0000 767.9766
 /begin AXIS_DESCR STD_AXIS Eng_nAvrg EngN 16 0.00 6000.000 FORMAT "%8.3" EXTENDED_LIMITS -32768.00 32767.00 DEPOSIT ABSOLUTE /end AXIS_DESCR
 /begin AXIS_DESCR STD_AXIS InjCtl_qSetUnBal InjMassCyc 16 0.00 327.6700 FORMAT "%8.4" EXTENDED_LIMITS -327.6800 327.6700 DEPOSIT ABSOLUTE /end AXIS_DESCR
/end CHARACTERISTIC
/begin CHARACTERISTIC InjCrv_phiMI1DynCor2_MAP "Basiskorrekturkennfeld für MI bei SOE Korrektur 2" MAP 0xD8756 Kf_Xs16_Ys16_Ws16 50.01562 AngleCrS -25.00781 25.00781 FORMAT "%8.5" EXTENDED_LIMITS -768.0000 767.9766
 /begin AXIS_DESCR STD_AXIS Eng_nAvrg EngN 16 0.00 6000.000 FORMAT "%8.3" EXTENDED_LIMITS -32768.00 32767.00 DEPOSIT ABSOLUTE /end AXIS_DESCR
 /begin AXIS_DESCR STD_AXIS InjCtl_qSetUnBal InjMassCyc 8 0.00 327.6700 FORMAT "%8.4" EXTENDED_LIMITS -327.6800 327.6700 DEPOSIT ABSOLUTE /end AXIS_DESCR
/end CHARACTERISTIC
/begin CHARACTERISTIC InjCrv_phiMI1Max2_MAP "Kennfeld -2 für frühesten Ansteuerbeginn MI1" MAP 0xD82C8 Gkf_Ws16 50.01562 AngleCrS -10.00781 40.00781 FORMAT "%8.5" EXTENDED_LIMITS -768.0000 767.9766
 /begin AXIS_DESCR COM_AXIS Eng_nAvrg EngN 8 0.00 6000.000 FORMAT "%8.3" EXTENDED_LIMITS -32768.00 32767.00 AXIS_PTS_REF InjCrv_phiMI1Max_X_AXIS /end AXIS_DESCR
 /begin AXIS_DESCR COM_AXIS InjCtl_qSetUnBal InjMassCyc 8 0.00 327.6700 FORMAT "%8.4" EXTENDED_LIMITS -327.6800 327.6700 AXIS_PTS_REF InjCrv_phiMI1Max_Y_AXIS /end AXIS_DESCR
/end CHARACTERISTIC
/begin CHARACTERISTIC InjCrv_phiMI1Max_MAP "#SSD frühester Ansteuerbeginn der MI1" MAP 0xD8348 Gkf_Ws16 50.01562 AngleCrS -10.00781 40.00781 FORMAT "%8.5" EXTENDED_LIMITS -768.0000 767.9766
 /begin AXIS_DESCR COM_AXIS Eng_nAvrg EngN 8 0.00 6000.000 FORMAT "%8.3" EXTENDED_LIMITS -32768.00 32767.00 AXIS_PTS_REF InjCrv_phiMI1Max_X_AXIS /end AXIS_DESCR
 /begin AXIS_DESCR COM_AXIS InjCtl_qSetUnBal InjMassCyc 8 0.00 327.6700 FORMAT "%8.4" EXTENDED_LIMITS -327.6800 327.6700 AXIS_PTS_REF InjCrv_phiMI1Max_Y_AXIS /end AXIS_DESCR
/end CHARACTERISTIC
/begin AXIS_PTS InjCrv_phiMI1Max_X_AXIS "gemeinsame X-Achse der Kennfelder für frühesten Ansteuerbeginn für MI" 0xD83C8 Eng_nAvrg GSst_Xs16 6000.000 EngN 8 0.00 6000.000 FORMAT "%8.3" EXTENDED_LIMITS -32768.00 32767.00 DEPOSIT ABSOLUTE /end AXIS_PTS
/begin AXIS_PTS InjCrv_phiMI1Max_Y_AXIS "gemeinsame Y-Achse der Kennfelder für frühesten Ansteuerbeginn für MI" 0xD83DA InjCtl_qSetUnBal GSst_Xs16 327.6700 InjMassCyc 8 0.00 327.6700 FORMAT "%8.4" EXTENDED_LIMITS -327.6800 327.6700 DEPOSIT ABSOLUTE /end AXIS_PTS
/begin CHARACTERISTIC InjCrv_phiMI1Min_CUR "Curve for limiting the latest SOE of MI1" CURVE 0xD83EC Kl_Xs16_Ws16 1535.977 AngleCrS -768.0000 767.9766 FORMAT "%8.4"
 /begin AXIS_DESCR STD_AXIS InjCrv_tEng Temp_Cels 8 -50.14000 199.8600 FORMAT "%8.4" EXTENDED_LIMITS -3549.940 3003.560 DEPOSIT ABSOLUTE /end AXIS_DESCR
/end CHARACTERISTIC
/begin CHARACTERISTIC InjCrv_phiMIAPSCor2_MAP "atmosphärentemperaturabhängiger Korrekturkennfeld -2 für Ansteuerbeginn MI1" MAP 0xD89FC Gkf_Ws16 20.01562 AngleCrS -10.00781 10.00781 FORMAT "%8.5" EXTENDED_LIMITS -768.0000 767.9766
 /begin AXIS_DESCR COM_AXIS Eng_nAvrg EngN 16 0.00 6000.000 FORMAT "%8.3" EXTENDED_LIMITS -32768.00 32767.00 AXIS_PTS_REF InjCrv_phiMIAPSCor_X_AXIS /end AXIS_DESCR
 /begin AXIS_DESCR COM_AXIS InjCtl_qSetUnBal InjMassCyc 16 0.00 327.6700 FORMAT "%8.4" EXTENDED_LIMITS -327.6800 327.6700 AXIS_PTS_REF InjCrv_phiMIAPSCor_Y_AXIS /end AXIS_DESCR
/end CHARACTERISTIC
/begin CHARACTERISTIC InjCrv_phiMIAPSCorStrt_MAP "base value for SOE correction to be weighted by air pressure" MAP 0xD8BFC Kf_Xs16_Ys16_Ws16 20.01562 AngleCrS -10.00781 10.00781 FORMAT "%8.5" EXTENDED_LIMITS -768.0000 767.9766
 /begin AXIS_DESCR STD_AXIS Eng_nAvrg EngN 16 0.00 6000.000 FORMAT "%8.3" EXTENDED_LIMITS -32768.00 32767.00 DEPOSIT ABSOLUTE /end AXIS_DESCR
 /begin AXIS_DESCR STD_AXIS InjCtl_qSetUnBal InjMassCyc 16 0.00 327.6700 FORMAT "%8.4" EXTENDED_LIMITS -327.6800 327.6700 DEPOSIT ABSOLUTE /end AXIS_DESCR
/end CHARACTERISTIC
/begin CHARACTERISTIC InjCrv_phiMIAPSCor_MAP "atmosphärendruckabhängiges Ansteuerbeginnkorrekturkennfeld für MI1" MAP 0xD8E40 Gkf_Ws16 20.01562 AngleCrS -10.00781 10.00781 FORMAT "%8.5" EXTENDED_LIMITS -768.0000 767.9766
 /begin AXIS_DESCR COM_AXIS Eng_nAvrg EngN 16 0.00 6000.000 FORMAT "%8.3" EXTENDED_LIMITS -32768.00 32767.00 AXIS_PTS_REF InjCrv_phiMIAPSCor_X_AXIS /end AXIS_DESCR
 /begin AXIS_DESCR COM_AXIS InjCtl_qSetUnBal InjMassCyc 16 0.00 327.6700 FORMAT "%8.4" EXTENDED_LIMITS -327.6800 327.6700 AXIS_PTS_REF InjCrv_phiMIAPSCor_Y_AXIS /end AXIS_DESCR
/end CHARACTERISTIC
/begin AXIS_PTS InjCrv_phiMIAPSCor_X_AXIS "gemeinsame X-Achse für atmosphärendruckabhängige Ansteuerbeginnkorrekturkennfelder für MI" 0xD9040 Eng_nAvrg GSst_Xs16 6000.000 EngN 16 0.00 6000.000 FORMAT "%8.3" EXTENDED_LIMITS -32768.00 32767.00 DEPOSIT ABSOLUTE /end AXIS_PTS
/begin AXIS_PTS InjCrv_phiMIAPSCor_Y_AXIS "gemeinsame Y-Achse für atmosphärendruckabhängige Ansteuerbeginnkorrekturkennfelder für MI" 0xD9062 InjCtl_qSetUnBal GSst_Xs16 327.6700 InjMassCyc 16 0.00 327.6700 FORMAT "%8.4" EXTENDED_LIMITS -327.6800 327.6700 DEPOSIT ABSOLUTE /end AXIS_PTS
/begin CHARACTERISTIC InjCrv_phiMIAPSDynCor_MAP "Korrekturkennfeld für Ansteuerbeginn der Haupteinspritzung" MAP 0xD888A Kf_Xs16_Ys16_Ws16 50.01562 AngleCrS -25.00781 25.00781 FORMAT "%8.5" EXTENDED_LIMITS -768.0000 767.9766
 /begin AXIS_DESCR STD_AXIS Eng_nAvrg EngN 4 0.00 6000.000 FORMAT "%8.3" EXTENDED_LIMITS -32768.00 32767.00 DEPOSIT ABSOLUTE /end AXIS_DESCR
 /begin AXIS_DESCR STD_AXIS InjCrv_dpMIDynCor dp_dZ20 4 -1000.000 1000.000 FORMAT "%8.3" EXTENDED_LIMITS -327680.0 327670.0 DEPOSIT ABSOLUTE /end AXIS_DESCR
/end CHARACTERISTIC
/begin CHARACTERISTIC InjCrv_phiMIATSCor2_MAP "ansauglufttemperaturabhängiger Korrekturkennfeld -2 für Ansteuerbeginn MI1" MAP 0xD9084 Gkf_Ws16 20.01562 AngleCrS -10.00781 10.00781 FORMAT "%8.5" EXTENDED_LIMITS -768.0000 767.9766
 /begin AXIS_DESCR COM_AXIS Eng_nAvrg EngN 16 0.00 6000.000 FORMAT "%8.3" EXTENDED_LIMITS -32768.00 32767.00 AXIS_PTS_REF InjCrv_phiMIATSCor_X_AXIS /end AXIS_DESCR
 /begin AXIS_DESCR COM_AXIS InjCtl_qSetUnBal InjMassCyc 16 0.00 327.6700 FORMAT "%8.4" EXTENDED_LIMITS -327.6800 327.6700 AXIS_PTS_REF InjCrv_phiMIATSCor_Y_AXIS /end AXIS_DESCR
/end CHARACTERISTIC
/begin CHARACTERISTIC InjCrv_phiMIATSCorStrt_MAP "base value for SOE correction to be weighted by intake air temperature" MAP 0xD9284 Kf_Xs16_Ys16_Ws16 20.01562 AngleCrS -10.00781 10.00781 FORMAT "%8.5" EXTENDED_LIMITS -768.0000 767.9766
 /begin AXIS_DESCR STD_AXIS Eng_nAvrg EngN 16 0.00 6000.000 FORMAT "%8.3" EXTENDED_LIMITS -32768.00 32767.00 DEPOSIT ABSOLUTE /end AXIS_DESCR
 /begin AXIS_DESCR STD_AXIS InjCtl_qSetUnBal InjMassCyc 16 0.00 327.6700 FORMAT "%8.4" EXTENDED_LIMITS -327.6800 327.6700 DEPOSIT ABSOLUTE /end AXIS_DESCR
/end CHARACTERISTIC
/begin CHARACTERISTIC InjCrv_phiMIATSCor_MAP "ansauglufttemperaturabhängiges Ansteuerbeginnkorrekturkennfeld für MI1" MAP 0xD94C8 Gkf_Ws16 20.01562 AngleCrS -10.00781 10.00781 FORMAT "%8.5" EXTENDED_LIMITS -768.0000 767.9766
 /begin AXIS_DESCR COM_AXIS Eng_nAvrg EngN 16 0.00 6000.000 FORMAT "%8.3" EXTENDED_LIMITS -32768.00 32767.00 AXIS_PTS_REF InjCrv_phiMIATSCor_X_AXIS /end AXIS_DESCR
 /begin AXIS_DESCR COM_AXIS InjCtl_qSetUnBal InjMassCyc 16 0.00 327.6700 FORMAT "%8.4" EXTENDED_LIMITS -327.6800 327.6700 AXIS_PTS_REF InjCrv_phiMIATSCor_Y_AXIS /end AXIS_DESCR
/end CHARACTERISTIC
/begin AXIS_PTS InjCrv_phiMIATSCor_X_AXIS "gemeinsame X-Achse für ansuglufttemperaturabhängige Ansteuerbeginnkorrekturkennfelder für MI" 0xD96C8 Eng_nAvrg GSst_Xs16 6000.000 EngN 16 0.00 6000.000 FORMAT "%8.3" EXTENDED_LIMITS -32768.00 32767.00 DEPOSIT ABSOLUTE /end AXIS_PTS
/begin AXIS_PTS InjCrv_phiMIATSCor_Y_AXIS "gemeinsame Y-Achse für ansuglufttemperaturabhängige Ansteuerbeginnkorrekturkennfelder für MI" 0xD96EA InjCtl_qSetUnBal GSst_Xs16 327.6700 InjMassCyc 16 0.00 327.6700 FORMAT "%8.4" EXTENDED_LIMITS -327.6800 327.6700 DEPOSIT ABSOLUTE /end AXIS_PTS
/begin CHARACTERISTIC InjCrv_phiMIDynCor_MAP "Korrekturkennfeld für Ansteuerbeginn Haupteinspritzung" MAP 0xD88BE Kf_Xs16_Ys16_Ws16 50.01562 AngleCrS -25.00781 25.00781 FORMAT "%8.5" EXTENDED_LIMITS -768.0000 767.9766
 /begin AXIS_DESCR STD_AXIS Eng_nAvrg EngN 16 0.00 6000.000 FORMAT "%8.3" EXTENDED_LIMITS -32768.00 32767.00 DEPOSIT ABSOLUTE /end AXIS_DESCR
 /begin AXIS_DESCR STD_AXIS InjCtl_qSetUnBal InjMassCyc 8 0.00 327.6700 FORMAT "%8.4" EXTENDED_LIMITS -327.6800 327.6700 DEPOSIT ABSOLUTE /end AXIS_DESCR
/end CHARACTERISTIC
/begin CHARACTERISTIC InjCrv_phiMIDynMax_C "Max. Grenze für Korrekturwert des Ansteuerbeginns der MI1" VALUE 0xD89F2 Kw_Ws16 50.01562 AngleCrS -25.00781 25.00781 FORMAT "%8.5" EXTENDED_LIMITS -768.0000 767.9766 /end CHARACTERISTIC
/begin CHARACTERISTIC InjCrv_phiMIDynMin_C "Min. Grenze für Korrekturwert des Ansteuerbeginns der MI1" VALUE 0xD89F4 Kw_Ws16 50.01562 AngleCrS -25.00781 25.00781 FORMAT "%8.5" EXTENDED_LIMITS -768.0000 767.9766 /end CHARACTERISTIC
/begin CHARACTERISTIC InjCrv_phiMIETSCor12_MAP "kühlmitteltemperaturabhängiges Ansteuerbeginnkorrekturkennfeld für MI1" MAP 0xD970C Gkf_Ws16 20.01562 AngleCrS -10.00781 10.00781 FORMAT "%8.5" EXTENDED_LIMITS -768.0000 767.9766
 /begin AXIS_DESCR COM_AXIS Eng_nAvrg EngN 16 0.00 6000.000 FORMAT "%8.3" EXTENDED_LIMITS -32768.00 32767.00 AXIS_PTS_REF InjCrv_phiMIETSCor1_X_AXIS /end AXIS_DESCR
 /begin AXIS_DESCR COM_AXIS InjCtl_qSetUnBal InjMassCyc 16 0.00 327.6700 FORMAT "%8.4" EXTENDED_LIMITS -327.6800 327.6700 AXIS_PTS_REF InjCrv_phiMIETSCor1_Y_AXIS /end AXIS_DESCR
/end CHARACTERISTIC
/begin CHARACTERISTIC InjCrv_phiMIETSCor1_MAP "motortemperaturabhängiger Korrekturkennfeld-1 für Ansteuerbeginn MI1" MAP 0xD990C Gkf_Ws16 20.01562 AngleCrS -10.00781 10.00781 FORMAT "%8.5" EXTENDED_LIMITS -768.0000 767.9766
 /begin AXIS_DESCR COM_AXIS Eng_nAvrg EngN 16 0.00 6000.000 FORMAT "%8.3" EXTENDED_LIMITS -32768.00 32767.00 AXIS_PTS_REF InjCrv_phiMIETSCor1_X_AXIS /end AXIS_DESCR
 /begin AXIS_DESCR COM_AXIS InjCtl_qSetUnBal InjMassCyc 16 0.00 327.6700 FORMAT "%8.4" EXTENDED_LIMITS -327.6800 327.6700 AXIS_PTS_REF InjCrv_phiMIETSCor1_Y_AXIS /end AXIS_DESCR
/end CHARACTERISTIC
/begin AXIS_PTS InjCrv_phiMIETSCor1_X_AXIS "Achsenpunkte der mittleren Drehzahl" 0xD9B0C Eng_nAvrg GSst_Xs16 6000.000 EngN 16 0.00 6000.000 FORMAT "%8.3" EXTENDED_LIMITS -32768.00 32767.00 DEPOSIT ABSOLUTE /end AXIS_PTS
/begin AXIS_PTS InjCrv_phiMIETSCor1_Y_AXIS "Achsenpunkte der aktuellen Einspritzmenge" 0xD9B2E InjCtl_qSetUnBal GSst_Xs16 327.6700 InjMassCyc 16 0.00 327.6700 FORMAT "%8.4" EXTENDED_LIMITS -327.6800 327.6700 DEPOSIT ABSOLUTE /end AXIS_PTS
/begin CHARACTERISTIC InjCrv_phiMIETSCor2_MAP "motortemperaturabhängiger Korrekturkennfeld-2 für Ansteuerbeginn MI1" MAP 0xD9B50 Gkf_Ws16 20.01562 AngleCrS -10.00781 10.00781 FORMAT "%8.5" EXTENDED_LIMITS -768.0000 767.9766
 /begin AXIS_DESCR COM_AXIS Eng_nAvrg EngN 16 0.00 6000.000 FORMAT "%8.3" EXTENDED_LIMITS -32768.00 32767.00 AXIS_PTS_REF InjCrv_phiMIETSCor_X_AXIS /end AXIS_DESCR
 /begin AXIS_DESCR COM_AXIS InjCtl_qSetUnBal InjMassCyc 16 0.00 327.6700 FORMAT "%8.4" EXTENDED_LIMITS -327.6800 327.6700 AXIS_PTS_REF InjCrv_phiMIETSCor_Y_AXIS /end AXIS_DESCR
/end CHARACTERISTIC
/begin CHARACTERISTIC InjCrv_phiMIETSCorStrt_MAP "base value for SOE correction to be weighted by engine temperature" MAP 0xD9D50 Kf_Xs16_Ys16_Ws16 20.01562 AngleCrS -10.00781 10.00781 FORMAT "%8.5" EXTENDED_LIMITS -768.0000 767.9766
 /begin AXIS_DESCR STD_AXIS Eng_nAvrg EngN 16 0.00 6000.000 FORMAT "%8.3" EXTENDED_LIMITS -32768.00 32767.00 DEPOSIT ABSOLUTE /end AXIS_DESCR
 /begin AXIS_DESCR STD_AXIS InjCtl_qSetUnBal InjMassCyc 16 0.00 327.6700 FORMAT "%8.4" EXTENDED_LIMITS -327.6800 327.6700 DEPOSIT ABSOLUTE /end AXIS_DESCR
/end CHARACTERISTIC
/begin CHARACTERISTIC InjCrv_phiMIETSCor_MAP "motortemperaturabhängiges Ansteuerbeginnkorrekturkennfeld für MI1" MAP 0xD9F94 Gkf_Ws16 20.01562 AngleCrS -10.00781 10.00781 FORMAT "%8.5" EXTENDED_LIMITS -768.0000 767.9766
 /begin AXIS_DESCR COM_AXIS Eng_nAvrg EngN 16 0.00 6000.000 FORMAT "%8.3" EXTENDED_LIMITS -32768.00 32767.00 AXIS_PTS_REF InjCrv_phiMIETSCor_X_AXIS /end AXIS_DESCR
 /begin AXIS_DESCR COM_AXIS InjCtl_qSetUnBal InjMassCyc 16 0.00 327.6700 FORMAT "%8.4" EXTENDED_LIMITS -327.6800 327.6700 AXIS_PTS_REF InjCrv_phiMIETSCor_Y_AXIS /end AXIS_DESCR
/end CHARACTERISTIC
/begin AXIS_PTS InjCrv_phiMIETSCor_X_AXIS "gemeinsame X-Achse für motortemperaturabhängige Ansteuerbeginnkorrekturkennfelder für MI" 0xDA194 Eng_nAvrg GSst_Xs16 6000.000 EngN 16 0.00 6000.000 FORMAT "%8.3" EXTENDED_LIMITS -32768.00 32767.00 DEPOSIT ABSOLUTE /end AXIS_PTS
/begin AXIS_PTS InjCrv_phiMIETSCor_Y_AXIS "gemeinsame Y-Achse für motortemperaturabhängige Ansteuerbeginnkorrekturkennfelder für MI" 0xDA1B6 InjCtl_qSetUnBal GSst_Xs16 327.6700 InjMassCyc 16 0.00 327.6700 FORMAT "%8.4" EXTENDED_LIMITS -327.6800 327.6700 DEPOSIT ABSOLUTE /end AXIS_PTS
/begin CHARACTERISTIC InjCrv_phiMIFTSRailCorMax_C "Maximaler Ansteuerbeginnkorrekturfaktor für MI1, abhängig von der kraftstofftemperaturabhängigen Raildruckkorrektur" VALUE 0xDA1D8 Kw_Ws16 1535.977 AngleCrS -768.0000 767.9766 FORMAT "%8.4" /end CHARACTERISTIC
/begin CHARACTERISTIC InjCrv_phiMIFTSRailCorMin_C "Minimaler Ansteuerbeginnkorrekturfaktor für MI1, abhängig von der kraftstofftemperaturabhängigen Raildruckkorrektur" VALUE 0xDA1DA Kw_Ws16 1535.977 AngleCrS -768.0000 767.9766 FORMAT "%8.4" /end CHARACTERISTIC
/begin CHARACTERISTIC InjCrv_phiMIFTSRailCorStrt_MAP "map for correction factor of SOE for the MI1, based on rail pressure" MAP 0xDA1DC Kf_Xs16_Ys16_Ws16 20.01562 AngleCrS -10.00781 10.00781 FORMAT "%8.5" EXTENDED_LIMITS -768.0000 767.9766
 /begin AXIS_DESCR STD_AXIS Eng_nAvrg EngN 12 0.00 6000.000 FORMAT "%8.3" EXTENDED_LIMITS -32768.00 32767.00 DEPOSIT ABSOLUTE /end AXIS_DESCR
 /begin AXIS_DESCR STD_AXIS InjCtl_qSetUnBal InjMassCyc 8 0.00 327.6700 FORMAT "%8.4" EXTENDED_LIMITS -327.6800 327.6700 DEPOSIT ABSOLUTE /end AXIS_DESCR
/end CHARACTERISTIC
/begin CHARACTERISTIC InjCrv_phiMIFTSRailCor_MAP "Korrekturfaktorkennfeld für die MI1, abhängig von der kraftstofftemperaturabhängigen Raildruckkorrektur" MAP 0xDA2C8 Kf_Xs16_Ys16_Ws16 20.01562 AngleCrS -10.00781 10.00781 FORMAT "%8.5" EXTENDED_LIMITS -768.0000 767.9766
 /begin AXIS_DESCR STD_AXIS Eng_nAvrg EngN 12 0.00 6000.000 FORMAT "%8.3" EXTENDED_LIMITS -32768.00 32767.00 DEPOSIT ABSOLUTE /end AXIS_DESCR
 /begin AXIS_DESCR STD_AXIS InjCtl_qSetUnBal InjMassCyc 8 0.00 327.6700 FORMAT "%8.4" EXTENDED_LIMITS -327.6800 327.6700 DEPOSIT ABSOLUTE /end AXIS_DESCR
/end CHARACTERISTIC
/begin CHARACTERISTIC InjCrv_pMIDynMax_C "Max. Grenze Raildruckdifferenz" VALUE 0xD89F6 Kw_Ws16 2000.000 Pres_Rail 0.00 2000.000 FORMAT "%5.3" EXTENDED_LIMITS -3276.800 3276.700 /end CHARACTERISTIC
/begin CHARACTERISTIC InjCrv_pMIDynMin_C "Min. Grenze Raildruckdifferenz" VALUE 0xD89F8 Kw_Ws16 2000.000 Pres_Rail 0.00 2000.000 FORMAT "%5.3" EXTENDED_LIMITS -3276.800 3276.700 /end CHARACTERISTIC
/begin CHARACTERISTIC InjCrv_pPiI2RlsAirPXDelta_C "Hysteresis for atmospheric pressure" VALUE 0xD62DC Kw_Ws16 65535.00 Pres_hPa -32768.00 32767.00 FORMAT "%8.2" /end CHARACTERISTIC
/begin CHARACTERISTIC InjCrv_pPiI2RlsAirXLo_C "Lower threshold for atmospheric pressure" VALUE 0xD62DE Kw_Ws16 65535.00 Pres_hPa -32768.00 32767.00 FORMAT "%8.2" /end CHARACTERISTIC
/begin CHARACTERISTIC InjCrv_qMI1Cor_MAP "Mengenkorrekturkennfeld der MI1" MAP 0xD840E Kf_Xs16_Ys16_Ws16 10.00000 InjMassInj 0.00 10.00000 FORMAT "%8.5" EXTENDED_LIMITS -327.6800 327.6700
 /begin AXIS_DESCR STD_AXIS Eng_nAvrg EngN 16 0.00 6000.000 FORMAT "%8.3" EXTENDED_LIMITS -32768.00 32767.00 DEPOSIT ABSOLUTE /end AXIS_DESCR
 /begin AXIS_DESCR STD_AXIS InjCtl_qSetUnBal InjMassCyc 16 0.00 327.6700 FORMAT "%8.4" EXTENDED_LIMITS -327.6800 327.6700 DEPOSIT ABSOLUTE /end AXIS_DESCR
/end CHARACTERISTIC
/begin CHARACTERISTIC InjCrv_qRawDelta_C "Hystersis for Injection quantity" VALUE 0xD62E0 Kw_Ws16 327.6700 InjMassCyc 0.00 327.6700 FORMAT "%8.4" EXTENDED_LIMITS -327.6800 327.6700 /end CHARACTERISTIC
/begin CHARACTERISTIC InjCrv_qRawLo_C "Injection Quantity lower threshold value" VALUE 0xD62E2 Kw_Ws16 327.6700 InjMassCyc 0.00 327.6700 FORMAT "%8.4" EXTENDED_LIMITS -327.6800 327.6700 /end CHARACTERISTIC
/begin CHARACTERISTIC InjCrv_rOpRngATSHys_C "Ansauglufttemperatur-Hystereseschwelle zur Bestimmung des Betriebsbereichs" VALUE 0xD654E Kw_Wu16 100.0000 Prc 0.00 100.0000 FORMAT "%8.4" EXTENDED_LIMITS 0.00 799.9878 /end CHARACTERISTIC
/begin CHARACTERISTIC InjCrv_rOpRngETSHys_C "Motortemperatur-Hystereseschwelle zur Bestimmung des Betriebsbereichs" VALUE 0xD6550 Kw_Wu16 100.0000 Prc 0.00 100.0000 FORMAT "%8.4" EXTENDED_LIMITS 0.00 799.9878 /end CHARACTERISTIC
/begin CHARACTERISTIC InjCrv_rPiIRlsEngSpdHys_C "Drehzahl Hystereseschwelle für die Auswahl der Freigabestruktur der Voreinspritzungen" VALUE 0xD5770 Kw_Wu16 100.0000 Prc 0.00 100.0000 FORMAT "%8.4" EXTENDED_LIMITS 0.00 799.9878 /end CHARACTERISTIC
/begin CHARACTERISTIC InjCrv_rPiIRlsQntHys_C "Mengen-Hystereseschwelle  zur Auswahl der Freigabestruktur der Voreinspritzungen" VALUE 0xD5772 Kw_Wu16 100.0000 Prc 0.00 100.0000 FORMAT "%8.4" EXTENDED_LIMITS 0.00 799.9878 /end CHARACTERISTIC
/begin CHARACTERISTIC InjCrv_stInjCharPrioRgn_C "Prioritätsstatus für die Abschaltung der Voreinspritzungen im Regenerationsbetrieb" VALUE 0xD5774 Kw_Wu32 4294967295.00 OneToOne 0.00 4294967295.00 FORMAT "%13.2" /end CHARACTERISTIC
/begin CHARACTERISTIC InjCrv_stInjCharPrio_C "Prioritätsstatus für die Abschaltung der Voreinspritzungen" VALUE 0xD5778 Kw_Wu32 4294967295.00 OneToOne 0.00 4294967295.00 FORMAT "%13.2" /end CHARACTERISTIC
/begin CHARACTERISTIC InjCrv_stInjCharSetVal_Vector "#SSD Konfigurationslabel für Bypass" VALUE 0xC309A Kw_Wu8 255.0 OneToOne 0.00 255.0 FORMAT "%5.1" /end CHARACTERISTIC
/begin CHARACTERISTIC InjCrv_stInjCharSetVal_Channel "#SSD Konfigurationslabels für Bypass" VALUE 0xC309B Kw_Wu8 255.0 OneToOne 0.00 255.0 FORMAT "%5.1" /end CHARACTERISTIC
/begin CHARACTERISTIC InjCrv_stInjDstSel_C "Status der Darstellung relativer Zeitabstände der Einspritzungen" VALUE 0xD5764 Kw_Wu8 255.0 OneToOne 0.00 255.0 FORMAT "%5.1" /end CHARACTERISTIC
/begin CHARACTERISTIC InjCrv_stMI1RgnDelMsk_C "Maske für die Deaktivierung der MI1 Grundwerteberechnung im Regenerationsbetrieb" VALUE 0xD8654 Kw_Wu32 4294967295.00 OneToOne 0.00 4294967295.00 FORMAT "%13.2" /end CHARACTERISTIC
/begin CHARACTERISTIC InjCrv_stPiI2RlsGearMax_C "Gear upper threshold" VALUE 0xD62F2 Kw_Ws8 255.0 OneToOne -128.0 127.0 FORMAT "%5.1" /end CHARACTERISTIC
/begin CHARACTERISTIC InjCrv_stPiI2RlsGearMin_C " Gear lower threshold" VALUE 0xD62F3 Kw_Ws8 255.0 OneToOne -128.0 127.0 FORMAT "%5.1" /end CHARACTERISTIC
/begin CHARACTERISTIC InjCrv_stPiIRlsBypass_Vector "#SSD Bypass Label, NICHT AENDERN" VALUE 0xC309C Kw_Wu8 255.0 OneToOne 0.00 255.0 FORMAT "%5.1" /end CHARACTERISTIC
/begin CHARACTERISTIC InjCrv_stPiIRlsBypass_Channel "#SSD Bypass Label, NICHT AENDERN" VALUE 0xC309D Kw_Wu8 255.0 OneToOne 0.00 255.0 FORMAT "%5.1" /end CHARACTERISTIC
/begin CHARACTERISTIC InjCrv_stPiIRlsOpRng1_MAP "Freigabekennfeld im Betriebsbereich 1" MAP 0xD577C Kf_Xs16_Ys16_Ws16 4.000000 OneToOne 1.000000 5.000000 FORMAT "%8.6" EXTENDED_LIMITS -32768.00 32767.00
 /begin AXIS_DESCR STD_AXIS Eng_nAvrg EngN 16 0.00 6000.000 FORMAT "%8.3" EXTENDED_LIMITS -32768.00 32767.00 DEPOSIT ABSOLUTE /end AXIS_DESCR
 /begin AXIS_DESCR STD_AXIS InjCtl_qSetUnBal InjMassCyc 16 0.00 327.6700 FORMAT "%8.4" EXTENDED_LIMITS -327.6800 327.6700 DEPOSIT ABSOLUTE /end AXIS_DESCR
/end CHARACTERISTIC
/begin CHARACTERISTIC InjCrv_stPiIRlsOpRng2_MAP "Freigabekennfeld im Betriebsbereich 2" MAP 0xD59C0 Kf_Xs16_Ys16_Ws16 4.000000 OneToOne 1.000000 5.000000 FORMAT "%8.6" EXTENDED_LIMITS -32768.00 32767.00
 /begin AXIS_DESCR STD_AXIS Eng_nAvrg EngN 16 0.00 6000.000 FORMAT "%8.3" EXTENDED_LIMITS -32768.00 32767.00 DEPOSIT ABSOLUTE /end AXIS_DESCR
 /begin AXIS_DESCR STD_AXIS InjCtl_qSetUnBal InjMassCyc 16 0.00 327.6700 FORMAT "%8.4" EXTENDED_LIMITS -327.6800 327.6700 DEPOSIT ABSOLUTE /end AXIS_DESCR
/end CHARACTERISTIC
/begin CHARACTERISTIC InjCrv_stPiIRlsOpRng3_MAP "Freigabekennfeld im Betriebsbereich 3" MAP 0xD5C04 Kf_Xs16_Ys16_Ws16 4.000000 OneToOne 1.000000 5.000000 FORMAT "%8.6" EXTENDED_LIMITS -32768.00 32767.00
 /begin AXIS_DESCR STD_AXIS Eng_nAvrg EngN 16 0.00 6000.000 FORMAT "%8.3" EXTENDED_LIMITS -32768.00 32767.00 DEPOSIT ABSOLUTE /end AXIS_DESCR
 /begin AXIS_DESCR STD_AXIS InjCtl_qSetUnBal InjMassCyc 16 0.00 327.6700 FORMAT "%8.4" EXTENDED_LIMITS -327.6800 327.6700 DEPOSIT ABSOLUTE /end AXIS_DESCR
/end CHARACTERISTIC
/begin CHARACTERISTIC InjCrv_stPiIRlsOpRng4_MAP "Freigabekennfeld im Betriebsbereich 4" MAP 0xD5E48 Kf_Xs16_Ys16_Ws16 4.000000 OneToOne 1.000000 5.000000 FORMAT "%8.6" EXTENDED_LIMITS -32768.00 32767.00
 /begin AXIS_DESCR STD_AXIS Eng_nAvrg EngN 16 0.00 6000.000 FORMAT "%8.3" EXTENDED_LIMITS -32768.00 32767.00 DEPOSIT ABSOLUTE /end AXIS_DESCR
 /begin AXIS_DESCR STD_AXIS InjCtl_qSetUnBal InjMassCyc 16 0.00 327.6700 FORMAT "%8.4" EXTENDED_LIMITS -327.6800 327.6700 DEPOSIT ABSOLUTE /end AXIS_DESCR
/end CHARACTERISTIC
/begin CHARACTERISTIC InjCrv_stPiIRlsOpRng5_MAP "Freigabekennfeld im Betriebsbereich 5" MAP 0xD608C Kf_Xs16_Ys16_Ws16 4.000000 OneToOne 1.000000 5.000000 FORMAT "%8.6" EXTENDED_LIMITS -32768.00 32767.00
 /begin AXIS_DESCR STD_AXIS Eng_nAvrg EngN 16 0.00 6000.000 FORMAT "%8.3" EXTENDED_LIMITS -32768.00 32767.00 DEPOSIT ABSOLUTE /end AXIS_DESCR
 /begin AXIS_DESCR STD_AXIS InjCtl_qSetUnBal InjMassCyc 16 0.00 327.6700 FORMAT "%8.4" EXTENDED_LIMITS -327.6800 327.6700 DEPOSIT ABSOLUTE /end AXIS_DESCR
/end CHARACTERISTIC
/begin CHARACTERISTIC InjCrv_stPiIRlsOpRng6_MAP "PiI release map for operation range 6" MAP 0xD62F4 Kf_Xs16_Ys16_Ws16 4.000000 OneToOne 1.000000 5.000000 FORMAT "%8.6" EXTENDED_LIMITS -32768.00 32767.00
 /begin AXIS_DESCR STD_AXIS Eng_nAvrg EngN 16 0.00 6000.000 FORMAT "%8.3" EXTENDED_LIMITS -32768.00 32767.00 DEPOSIT ABSOLUTE /end AXIS_DESCR
 /begin AXIS_DESCR STD_AXIS InjCtl_qSetUnBal InjMassCyc 16 0.00 327.6700 FORMAT "%8.4" EXTENDED_LIMITS -327.6800 327.6700 DEPOSIT ABSOLUTE /end AXIS_DESCR
/end CHARACTERISTIC
/begin CHARACTERISTIC InjCrv_stPrioRgnMsk_C "Bitmaske für Aktivierung  des Prioritätsstaus im Regenerationsbetrieb" VALUE 0xD62D0 Kw_Wu32 4294967295.00 OneToOne 0.00 4294967295.00 FORMAT "%13.2" /end CHARACTERISTIC
/begin CHARACTERISTIC InjCrv_stRlsOpRngThresRgn_MAP "Betriebsbereichsschwellen für die Freigabe der Voreinspritzungen im Regenerationsbetrieb" MAP 0xD6552 Kf_Xs16_Ys16_Ws16 4.000000 OneToOne 1.000000 5.000000 FORMAT "%8.6" EXTENDED_LIMITS -32768.00 32767.00
 /begin AXIS_DESCR STD_AXIS InjCrv_tEng Temp_Cels 16 -50.14000 199.8600 FORMAT "%8.4" EXTENDED_LIMITS -3549.940 3003.560 DEPOSIT ABSOLUTE /end AXIS_DESCR
 /begin AXIS_DESCR STD_AXIS IATSCD_tAir Temp_Cels 16 -50.14000 199.8600 FORMAT "%8.4" EXTENDED_LIMITS -3549.940 3003.560 DEPOSIT ABSOLUTE /end AXIS_DESCR
/end CHARACTERISTIC
/begin CHARACTERISTIC InjCrv_stRlsOpRngThres_MAP "Betriebsbereichsschwellen für die Freigabe der Voreinspritzungen" MAP 0xD6796 Kf_Xs16_Ys16_Ws16 4.000000 OneToOne 1.000000 5.000000 FORMAT "%8.6" EXTENDED_LIMITS -32768.00 32767.00
 /begin AXIS_DESCR STD_AXIS InjCrv_tEng Temp_Cels 16 -50.14000 199.8600 FORMAT "%8.4" EXTENDED_LIMITS -3549.940 3003.560 DEPOSIT ABSOLUTE /end AXIS_DESCR
 /begin AXIS_DESCR STD_AXIS IATSCD_tAir Temp_Cels 16 -50.14000 199.8600 FORMAT "%8.4" EXTENDED_LIMITS -3549.940 3003.560 DEPOSIT ABSOLUTE /end AXIS_DESCR
/end CHARACTERISTIC
/begin CHARACTERISTIC InjCrv_stRlsRgnMsk_C "Bitmaske für Aktivierung des Freigabekennfelds im Regenerationsbetrieb" VALUE 0xD62D4 Kw_Wu32 4294967295.00 OneToOne 0.00 4294967295.00 FORMAT "%13.2" /end CHARACTERISTIC
/begin CHARACTERISTIC InjCrv_swtPiIDblCorMapVal_C "Schalter für die PiI1- und MI- Korrekturwertberechnung mit verdoppeltem Kennfeldsatz (1: doppeltes, 0: einfaches Kennfeld)" VALUE 0xD62D8 Kw_Wu8 1.000 OneToOne 0.00 1.000 FORMAT "%5.3" EXTENDED_LIMITS 0.00 255.0 /end CHARACTERISTIC
/begin CHARACTERISTIC InjCrv_swtPiIDblCorMapType_C "Schaltertyp für die PiI1- und MI- Korrekturwertberechnung mit verdoppeltem Kennfeldsatz" VALUE 0xD62D9 Kw_Wu8 0.00 OneToOne 2.000 2.000 FORMAT "%5.3" EXTENDED_LIMITS 0.00 255.0 /end CHARACTERISTIC
/begin CHARACTERISTIC InjCrv_tiPause_C "#SSD physikalische bedingte Mindestzeit zwischen 2 Einspritzungen" VALUE 0xC061E Kw_Ws16 65535.00 InjTime_us -32768.00 32767.00 FORMAT "%8.2" /end CHARACTERISTIC
/begin CHARACTERISTIC InjCrv_tPiI2RlsAirTXDelta_C "Hysteresis for intake air temperature" VALUE 0xD62E4 Kw_Ws16 6553.500 TempDiff_Cels -3276.800 3276.700 FORMAT "%8.3" /end CHARACTERISTIC
/begin CHARACTERISTIC InjCrv_tPiI2RlsAirTXLo1_C "Threshold 1 for intake air temperature" VALUE 0xD62E6 Kw_Ws16 950.000 Temp_Cels -50.140 899.860 FORMAT "%8.3" EXTENDED_LIMITS -3549.940 3003.560 /end CHARACTERISTIC
/begin CHARACTERISTIC InjCrv_tPiI2RlsAirTXLo2_C "Threshold 2 for intake air temperature" VALUE 0xD62E8 Kw_Ws16 950.000 Temp_Cels -50.140 899.860 FORMAT "%8.3" EXTENDED_LIMITS -3549.940 3003.560 /end CHARACTERISTIC
/begin CHARACTERISTIC InjCrv_tPiI2RlsAirTXLo3_C "Threshold 3 for intake air temperature" VALUE 0xD62EA Kw_Ws16 950.000 Temp_Cels -50.140 899.860 FORMAT "%8.3" EXTENDED_LIMITS -3549.940 3003.560 /end CHARACTERISTIC
/begin CHARACTERISTIC InjCrv_tPiI2RlsAirTXLo4_C "Threshold 4 for intake air temperature" VALUE 0xD62EC Kw_Ws16 950.000 Temp_Cels -50.140 899.860 FORMAT "%8.3" EXTENDED_LIMITS -3549.940 3003.560 /end CHARACTERISTIC
/begin CHARACTERISTIC InjCrv_tPiI2RlsAirTXLo5_C "Threshold 5 for intake air temperature" VALUE 0xD62EE Kw_Ws16 950.000 Temp_Cels -50.140 899.860 FORMAT "%8.3" EXTENDED_LIMITS -3549.940 3003.560 /end CHARACTERISTIC
/begin CHARACTERISTIC InjCrv_tPiI2RlsAirTXLo6_C "Threshold 6 for intake air temperature" VALUE 0xD62F0 Kw_Ws16 950.000 Temp_Cels -50.140 899.860 FORMAT "%8.3" EXTENDED_LIMITS -3549.940 3003.560 /end CHARACTERISTIC
/begin CHARACTERISTIC InjCrv_tPiI2RlsTAirXDelta_C " Hysteresis for Air temperature" VALUE 0xD6538 Kw_Ws16 6553.500 TempDiff_Cels -3276.800 3276.700 FORMAT "%8.3" /end CHARACTERISTIC
/begin CHARACTERISTIC InjCrv_tPiI2RlsTAirXLo1_C "Air temperature lower threshold" VALUE 0xD653A Kw_Ws16 950.000 Temp_Cels -50.140 899.860 FORMAT "%8.3" EXTENDED_LIMITS -3549.940 3003.560 /end CHARACTERISTIC
/begin CHARACTERISTIC InjCrv_tPiI2RlsTAirXLo2_C "Air temperature upper threshold" VALUE 0xD653C Kw_Ws16 950.000 Temp_Cels -50.140 899.860 FORMAT "%8.3" EXTENDED_LIMITS -3549.940 3003.560 /end CHARACTERISTIC
/begin CHARACTERISTIC InjCrv_tPiI2RlsTEngXDelta_C "Hysteresis for engine temperature" VALUE 0xD653E Kw_Ws16 6553.500 TempDiff_Cels -3276.800 3276.700 FORMAT "%8.3" /end CHARACTERISTIC
/begin CHARACTERISTIC InjCrv_tPiI2RlsTEngXLo1_C "Lower threshold for engine temperature" VALUE 0xD6540 Kw_Ws16 950.000 Temp_Cels -50.140 899.860 FORMAT "%8.3" EXTENDED_LIMITS -3549.940 3003.560 /end CHARACTERISTIC
/begin CHARACTERISTIC InjCrv_tPiI2RlsTEngXLo2_C " Upper threshold for engine temperature" VALUE 0xD6542 Kw_Ws16 950.000 Temp_Cels -50.140 899.860 FORMAT "%8.3" EXTENDED_LIMITS -3549.940 3003.560 /end CHARACTERISTIC
/begin CHARACTERISTIC InjCrv_vPiI2RlsXDelta_C "Hysteresis for vehicle speed" VALUE 0xD6544 Kw_Ws16 655.3500 Vel -327.6800 327.6700 FORMAT "%8.4" /end CHARACTERISTIC
/begin CHARACTERISTIC InjCrv_vPiI2RlsXLo123_C "Threshold for vehicle speed in 1,2 or 3rd gear" VALUE 0xD6546 Kw_Ws16 655.3500 Vel -327.6800 327.6700 FORMAT "%8.4" /end CHARACTERISTIC
/begin CHARACTERISTIC InjCrv_vPiI2RlsXLo4_C "Threshold for vehicle speed in 4th gear" VALUE 0xD6548 Kw_Ws16 655.3500 Vel -327.6800 327.6700 FORMAT "%8.4" /end CHARACTERISTIC
/begin CHARACTERISTIC InjCrv_vPiI2RlsXLo5_C "Threshold for vehicle speed in 5th gear" VALUE 0xD654A Kw_Ws16 655.3500 Vel -327.6800 327.6700 FORMAT "%8.4" /end CHARACTERISTIC
/begin CHARACTERISTIC InjCrv_vPiI2RlsXLo6_C "Threshold for vehicle speed in 6th gear" VALUE 0xD654C Kw_Ws16 655.3500 Vel -327.6800 327.6700 FORMAT "%8.4" /end CHARACTERISTIC
/begin MEASUREMENT FrmMng_aDirect "" SWORD Acc 1 100 -32.76800 32.76700 FORMAT "%8.5" ECU_ADDRESS 0x7F8C90 /end MEASUREMENT
/begin MEASUREMENT FrmMng_aSide "acceleration vehicle across DSC" SWORD Acc 1 100 -32.76800 32.76700 FORMAT "%8.5" ECU_ADDRESS 0x7F8C92 /end MEASUREMENT
/begin MEASUREMENT FrmMng_ctACC_TrqAlv "Alive Counter-message DREHMOMENT_ANF_ACC" UBYTE OneToOne 1 100 0.00 255.0 FORMAT "%5.1" ECU_ADDRESS 0x7F887D /end MEASUREMENT
/begin MEASUREMENT FrmMng_ctrRel "relativ counter" ULONG OneToOne 1 100 0.00 4294967295.00 FORMAT "%13.2" ECU_ADDRESS 0x7F9130 /end MEASUREMENT
/begin MEASUREMENT FrmMng_ctSTAT_KOMBIalv "Alive Zähler Kombi" UBYTE OneToOne 1 100 0.00 255.0 FORMAT "%5.1" ECU_ADDRESS 0x7F887E /end MEASUREMENT
/begin MEASUREMENT FrmMng_dACC_CkSTrq "Checksumm-message DREHMOMENT_ANF_ACC" UBYTE OneToOne 1 100 0.00 255.0 FORMAT "%5.1" ECU_ADDRESS 0x7F8880 /end MEASUREMENT
/begin MEASUREMENT FrmMng_dphiStrg "Rate of change of steering angle recieved over CAN" SWORD AngleGradPerSec 1 100 -1440.154 1440.110 FORMAT "%8.3" ECU_ADDRESS 0x7F8C96 /end MEASUREMENT
/begin MEASUREMENT FrmMng_dSlopeACP "slope of frmmng accelerator pedal value" SWORD SlopeRes1000 1 100 -32.76800 32.76700 FORMAT "%8.5" ECU_ADDRESS 0x7F8C94 /end MEASUREMENT
/begin MEASUREMENT FrmMng_iHiLimCurr "Botschaft für I_SC_MAX_VEH CAN signal" UBYTE i_ub_q10p0 1 100 0.00 2550. FORMAT "%5.0" ECU_ADDRESS 0x7F8881 /end MEASUREMENT
/begin MEASUREMENT FrmMng_iLoLimCurr "Botschaft für I_SC_MIN_VEH CAN signal" UBYTE i_ub_q10p0 1 100 0.00 2550. FORMAT "%5.0" ECU_ADDRESS 0x7F8882 /end MEASUREMENT
/begin MEASUREMENT FrmMng_iZrCurrLim "Botschaft für QC_VEH CAN signal" UBYTE i_ub_q0p001 1 100 0.00 0.2550 FORMAT "%6.4" ECU_ADDRESS 0x7F8883 /end MEASUREMENT
/begin MEASUREMENT FrmMng_lSum "Kilometerstand des Fahrzeugs" ULONG LengthKm 1 100 0.00 4294967295.00 FORMAT "%13.2" ECU_ADDRESS 0x7F9134 /end MEASUREMENT
/begin MEASUREMENT FrmMng_nBattCls "Botschaft für MAG_BT CAN signal" UBYTE DEZ 1 100 0.00 255.0 FORMAT "%5.1" ECU_ADDRESS 0x7F8884 /end MEASUREMENT
/begin MEASUREMENT FrmMng_nEngRpm1 "Engine rpm threshold 1 to be given to the drag indicator on kombi" UWORD EngN 1 100 0.00 65535.00 FORMAT "%8.2" ECU_ADDRESS 0x7F8C98 /end MEASUREMENT
/begin MEASUREMENT FrmMng_nEngRpm2 "Engine rpm threshold 2 to be given to the drag indicator on kombi" UWORD EngN 1 100 0.00 65535.00 FORMAT "%8.2" ECU_ADDRESS 0x7F8C9A /end MEASUREMENT
/begin MEASUREMENT FrmMng_nFan "Lüfterdrehzahl" SWORD FanSpd 1 100 -3000.092 3000.000 FORMAT "%8.3" ECU_ADDRESS 0x7F8C9C /end MEASUREMENT
/begin MEASUREMENT FrmMng_nLimSSG "Maximum engine speed in phase 2 of the switching process" SWORD EngN 1 100 -32768.00 32767.00 FORMAT "%8.2" ECU_ADDRESS 0x7F8C9E /end MEASUREMENT
/begin MEASUREMENT FrmMng_nRqStgEFan "Anforderung LüfterDrehzahl" UWORD FanSpd 1 100 0.00 6000.092 FORMAT "%8.3" ECU_ADDRESS 0x7F8CA2 /end MEASUREMENT
/begin MEASUREMENT FrmMng_nTSC "take off engine speed" SWORD EngN 1 100 -32768.00 32767.00 FORMAT "%8.2" ECU_ADDRESS 0x7F8CA6 /end MEASUREMENT
/begin MEASUREMENT FrmMng_numACFanDes "fanspeed desired by AC" UBYTE OneToOne 1 100 0.00 255.0 FORMAT "%5.1" ECU_ADDRESS 0x7F8885 /end MEASUREMENT
/begin MEASUREMENT FrmMng_numRqStgEFan "Mit Diesem Signal können Steuergeräte eine E-Lüfterstufe anfordern" UBYTE OneToOne 1 100 0.00 255.0 FORMAT "%5.1" ECU_ADDRESS 0x7F8886 /end MEASUREMENT
/begin MEASUREMENT FrmMng_parkConsumerFunctionID "ID function park consumer" UWORD OneToOne 1 100 0.00 65535.00 FORMAT "%8.2" ECU_ADDRESS 0x7F8CAE /end MEASUREMENT
/begin MEASUREMENT FrmMng_parkConsumerID2 "ID function park consumer" UBYTE OneToOne 1 100 0.00 255.0 FORMAT "%5.1" ECU_ADDRESS 0x7F8887 /end MEASUREMENT
/begin MEASUREMENT FrmMng_phiStrg "Steering angle recieved over CAN" SWORD AngleGrad 1 100 -1440.154 1440.110 FORMAT "%8.3" ECU_ADDRESS 0x7F8CB0 /end MEASUREMENT
/begin MEASUREMENT FrmMng_rHtFlowReq "heat flow request" UWORD Prc 1 100 0.00 799.9878 FORMAT "%8.4" ECU_ADDRESS 0x7F8CB2 /end MEASUREMENT
/begin MEASUREMENT FrmMng_stACCTrqCtl "Message to indicate the torque reduction for ACC" UBYTE OneToOne 1 100 0.00 255.0 FORMAT "%5.1" ECU_ADDRESS 0x7F8888 /end MEASUREMENT
/begin MEASUREMENT FrmMng_stACC_ModDME "Status ACC mode DME-message" UBYTE OneToOne 1 100 0.00 255.0 FORMAT "%5.1" ECU_ADDRESS 0x7F8889 /end MEASUREMENT
/begin MEASUREMENT FrmMng_stACC_PrevOvrRunSwtDem "request prevention over run fuel shutoff-message" UBYTE OneToOne 1 100 0.00 255.0 FORMAT "%5.1" ECU_ADDRESS 0x7F888A /end MEASUREMENT
/begin MEASUREMENT FrmMng_stACC_ShtDwnDME "Status ACC Switch-off system-message" UBYTE OneToOne 1 100 0.00 255.0 FORMAT "%5.1" ECU_ADDRESS 0x7F888B /end MEASUREMENT
/begin MEASUREMENT FrmMng_stACC_TrqDes "Torque target status-message DREHMOMENT_ANF_ACC" UBYTE OneToOne 1 100 0.00 255.0 FORMAT "%5.1" ECU_ADDRESS 0x7F888C /end MEASUREMENT
/begin MEASUREMENT FrmMng_stACmainSwt "Hauptschalter Klimakompressor" UBYTE OneToOne 1 100 0.00 255.0 FORMAT "%5.1" ECU_ADDRESS 0x7F888E /end MEASUREMENT
/begin MEASUREMENT FrmMng_stACnMin "Drehzahlanhebungsanforderung vom Klimakompressor" UBYTE OneToOne 1 100 0.00 255.0 FORMAT "%5.1" ECU_ADDRESS 0x7F888F /end MEASUREMENT
/begin MEASUREMENT FrmMng_stARS "type of ARS torque-intervention" UBYTE OneToOne 1 100 0.00 255.0 FORMAT "%5.1" ECU_ADDRESS 0x7F8890 /end MEASUREMENT
/begin MEASUREMENT FrmMng_stAVAI_BOS_RSTG "unit for availability of removing parts" UBYTE OneToOne 1 100 0.00 255.0 FORMAT "%5.1" ECU_ADDRESS 0x7F8892 /end MEASUREMENT
/begin MEASUREMENT FrmMng_stBltbDr "Status Gurtschloßkontakt" UBYTE OneToOne 1 100 0.00 255.0 FORMAT "%5.1" ECU_ADDRESS 0x7F8893 /end MEASUREMENT
/begin MEASUREMENT FrmMng_stBOS_RESETSig "signalerrorstatus-message BOS_RESET" UWORD OneToOne 1 100 0.00 65535.00 FORMAT "%8.2" ECU_ADDRESS 0x7F8CBA /end MEASUREMENT
/begin MEASUREMENT FrmMng_stBOS_RESET_2Sig "" UWORD OneToOne 1 100 0.00 65535.00 FORMAT "%8.2" ECU_ADDRESS 0x7F8CBC /end MEASUREMENT
/begin MEASUREMENT FrmMng_stClCtr "control-status" UBYTE OneToOne 1 100 0.00 255.0 FORMAT "%5.1" ECU_ADDRESS 0x7F8897 /end MEASUREMENT
/begin MEASUREMENT FrmMng_stCltSSG "Status of Clutch" UBYTE OneToOne 1 100 0.00 255.0 FORMAT "%5.1" ECU_ADDRESS 0x7F8898 /end MEASUREMENT
/begin MEASUREMENT FrmMng_stConv "Kupplungszustand über CAN" UBYTE OneToOne 1 100 0.00 255.0 FORMAT "%5.1" ECU_ADDRESS 0x7F8899 /end MEASUREMENT
/begin MEASUREMENT FrmMng_stCOU_RSTG_BOS_RSTG "counter for removing parts" UBYTE OneToOne 1 100 0.00 255.0 FORMAT "%5.1" ECU_ADDRESS 0x7F8896 /end MEASUREMENT
/begin MEASUREMENT FrmMng_stCrCtlRaw "state CrCtlRaw" UBYTE OneToOne 1 100 0.00 255.0 FORMAT "%5.1" ECU_ADDRESS 0x7F889A /end MEASUREMENT
/begin MEASUREMENT FrmMng_stDateDay "" UBYTE OneToOne 1 100 0.00 255.0 FORMAT "%5.1" ECU_ADDRESS 0x7F889D /end MEASUREMENT
/begin MEASUREMENT FrmMng_stDateMon "" UBYTE OneToOne 1 100 0.00 255.0 FORMAT "%5.1" ECU_ADDRESS 0x7F889E /end MEASUREMENT
/begin MEASUREMENT FrmMng_stDateSeason "" UBYTE OneToOne 1 100 0.00 255.0 FORMAT "%5.1" ECU_ADDRESS 0x7F889F /end MEASUREMENT
/begin MEASUREMENT FrmMng_stDateYr "" UWORD OneToOne 1 100 0.00 65535.00 FORMAT "%8.2" ECU_ADDRESS 0x7F8CC4 /end MEASUREMENT
/begin MEASUREMENT FrmMng_stDecellDSC "state delay DSC" UBYTE OneToOne 1 100 0.00 255.0 FORMAT "%5.1" ECU_ADDRESS 0x7F88A0 /end MEASUREMENT
/begin MEASUREMENT FrmMng_stDM_ANF_AFSSig "signal error status for DREHMOMENT_ANF_AFS" UWORD OneToOne 1 100 0.00 65535.00 FORMAT "%8.2" ECU_ADDRESS 0x7F8CBE /end MEASUREMENT
/begin MEASUREMENT FrmMng_stDREHMOMENT_ANF_ACCSig "signalerrorstatus-message" UWORD OneToOne 1 100 0.00 65535.00 FORMAT "%8.2" ECU_ADDRESS 0x7F8CC0 /end MEASUREMENT
/begin MEASUREMENT FrmMng_stDRMANFSSGSig "Status of error signal DREHMOMENT_ANF_SSG" UWORD OneToOne 1 100 0.00 65535.00 FORMAT "%8.2" ECU_ADDRESS 0x7F8CC2 /end MEASUREMENT
/begin MEASUREMENT FrmMng_stDSCDef "Status DSC" UBYTE OneToOne 1 100 0.00 255.0 FORMAT "%5.1" ECU_ADDRESS 0x7F889C /end MEASUREMENT
/begin MEASUREMENT FrmMng_stErrAFS "Error status of AFS received over CAN" UBYTE OneToOne 1 100 0.00 255.0 FORMAT "%5.1" ECU_ADDRESS 0x7F88A1 /end MEASUREMENT
/begin MEASUREMENT FrmMng_stErrStrg "Error status of Steering received over CAN" UBYTE OneToOne 1 100 0.00 255.0 FORMAT "%5.1" ECU_ADDRESS 0x7F88A2 /end MEASUREMENT
/begin MEASUREMENT FrmMng_stFDC "status of VEH_MOD" UBYTE OneToOne 1 100 0.00 255.0 FORMAT "%5.1" ECU_ADDRESS 0x7F88A3 /end MEASUREMENT
/begin MEASUREMENT FrmMng_stGbx "Getriebezustand (Schaltung aktiv/inaktiv) über CAN" UBYTE OneToOne 1 100 0.00 255.0 FORMAT "%5.1" ECU_ADDRESS 0x7F88A4 /end MEASUREMENT
/begin MEASUREMENT FrmMng_stGear "Istganginformation vom CAN" UBYTE OneToOne 1 100 0.00 255.0 FORMAT "%5.1" ECU_ADDRESS 0x7F88A5 /end MEASUREMENT
/begin MEASUREMENT FrmMng_stGEARBX_DATA2Sig "signalerrorstatus-message GEARBX_DATA2" UWORD OneToOne 1 100 0.00 65535.00 FORMAT "%8.2" ECU_ADDRESS 0x7F8CC6 /end MEASUREMENT
/begin MEASUREMENT FrmMng_stGEARBX_DATASig "state of single signals in CAN-message" UWORD OneToOne 1 100 0.00 65535.00 FORMAT "%8.2" ECU_ADDRESS 0x7F8CC8 /end MEASUREMENT
/begin MEASUREMENT FrmMng_stHEAT_ACSig "state of single signals in CAN-message" UWORD OneToOne 1 100 0.00 65535.00 FORMAT "%8.2" ECU_ADDRESS 0x7F8CCA /end MEASUREMENT
/begin MEASUREMENT FrmMng_stId2BosRst "" UBYTE OneToOne 1 100 0.00 255.0 FORMAT "%5.1" ECU_ADDRESS 0x7F88A8 /end MEASUREMENT
/begin MEASUREMENT FrmMng_stId2RqStgEFan "dienstenachricht um die Anforderung einer elektrolüfterstufe handelt" UBYTE OneToOne 1 100 0.00 255.0 FORMAT "%5.1" ECU_ADDRESS 0x7F88A9 /end MEASUREMENT
/begin MEASUREMENT FrmMng_stID2_BOS_RSTG "unit BOS_RESET" UBYTE OneToOne 1 100 0.00 255.0 FORMAT "%5.1" ECU_ADDRESS 0x7F88A7 /end MEASUREMENT
/begin MEASUREMENT FrmMng_stIdFktBosRst "" UWORD OneToOne 1 100 0.00 65535.00 FORMAT "%8.2" ECU_ADDRESS 0x7F8CD0 /end MEASUREMENT
/begin MEASUREMENT FrmMng_stIdFnRqStgEFan "Das signal gibt den Anforderer der gewünschten Elektrolüfterstufe an" UBYTE OneToOne 1 100 0.00 255.0 FORMAT "%5.1" ECU_ADDRESS 0x7F88AA /end MEASUREMENT
/begin MEASUREMENT FrmMng_stIdlingSpec "increase idling speed" UBYTE OneToOne 1 100 0.00 255.0 FORMAT "%5.1" ECU_ADDRESS 0x7F88AB /end MEASUREMENT
/begin MEASUREMENT FrmMng_stID_FN_BOS_RSTG "unit for witch part is removed" UWORD OneToOne 1 100 0.00 65535.00 FORMAT "%8.2" ECU_ADDRESS 0x7F8CCE /end MEASUREMENT
/begin MEASUREMENT FrmMng_stInjDu "Status of Drehungleichförmigkeit" UBYTE OneToOne 1 100 0.00 255.0 FORMAT "%5.1" ECU_ADDRESS 0x7F88AC /end MEASUREMENT
/begin MEASUREMENT FrmMng_stKeyVld "Status Schlüssel gültig" UBYTE OneToOne 1 100 0.00 255.0 FORMAT "%5.1" ECU_ADDRESS 0x7F88AD /end MEASUREMENT
/begin MEASUREMENT FrmMng_stLENKRADWINKELSig "signal error status for LENKRADWINKEL" UWORD OneToOne 1 100 0.00 65535.00 FORMAT "%8.2" ECU_ADDRESS 0x7F8CD2 /end MEASUREMENT
/begin MEASUREMENT FrmMng_stMILEAGE_RANGESig "signalerrorstatus-message MILEAGE_RANGE" UWORD OneToOne 1 100 0.00 65535.00 FORMAT "%8.2" ECU_ADDRESS 0x7F8CD4 /end MEASUREMENT
/begin MEASUREMENT FrmMng_stOPCRCTLACCSig "signalerrorstatus-message OP_CRCTLACC" UWORD OneToOne 1 100 0.00 65535.00 FORMAT "%8.2" ECU_ADDRESS 0x7F8CD6 /end MEASUREMENT
/begin MEASUREMENT FrmMng_stParkConsumer "status park consumer power managment" UBYTE OneToOne 1 100 0.00 255.0 FORMAT "%5.1" ECU_ADDRESS 0x7F88B1 /end MEASUREMENT
/begin MEASUREMENT FrmMng_stParkConsumerSig "signalerrorstatus-message Park Consumer" UWORD OneToOne 1 100 0.00 65535.00 FORMAT "%8.2" ECU_ADDRESS 0x7F8CDC /end MEASUREMENT
/begin MEASUREMENT FrmMng_stPHtr "status of Heater Temperature" UBYTE OneToOne 1 100 0.00 255.0 FORMAT "%5.1" ECU_ADDRESS 0x7F88AF /end MEASUREMENT
/begin MEASUREMENT FrmMng_stPrgIntTimeBosRst "" UBYTE OneToOne 1 100 0.00 255.0 FORMAT "%5.1" ECU_ADDRESS 0x7F88B2 /end MEASUREMENT
/begin MEASUREMENT FrmMng_stPrgIntWayBosRst "" UBYTE OneToOne 1 100 0.00 255.0 FORMAT "%5.1" ECU_ADDRESS 0x7F88B3 /end MEASUREMENT
/begin MEASUREMENT FrmMng_stPWRMNG_LOADVSig "signalerrorstatus-message PWRMNG_LOADV" UWORD OneToOne 1 100 0.00 65535.00 FORMAT "%8.2" ECU_ADDRESS 0x7F8CDA /end MEASUREMENT
/begin MEASUREMENT FrmMng_stRecACC "Status ACC Reconigtion" UBYTE OneToOne 1 100 0.00 255.0 FORMAT "%5.1" ECU_ADDRESS 0x7F88B4 /end MEASUREMENT
/begin MEASUREMENT FrmMng_stRecAFS "message on CAN used for self recognition of AFS" UBYTE OneToOne 1 100 0.00 255.0 FORMAT "%5.1" ECU_ADDRESS 0x7F88B5 /end MEASUREMENT
/begin MEASUREMENT FrmMng_stRecARS "Status of ARS Recognition received over CAN" UBYTE OneToOne 1 100 0.00 255.0 FORMAT "%5.1" ECU_ADDRESS 0x7F88B6 /end MEASUREMENT
/begin MEASUREMENT FrmMng_stRecFDC "automatische Erkennung des CAN-Frame VEH_MOD" UBYTE OneToOne 1 100 0.00 255.0 FORMAT "%5.1" ECU_ADDRESS 0x7F88B7 /end MEASUREMENT
/begin MEASUREMENT FrmMng_stRecFGR "Status FGR Reconigtion" UBYTE OneToOne 1 100 0.00 255.0 FORMAT "%5.1" ECU_ADDRESS 0x7F88B8 /end MEASUREMENT
/begin MEASUREMENT FrmMng_stRMMI_BOS_RSTG "" SWORD OneToOne 1 100 -32768.00 32767.00 FORMAT "%8.2" ECU_ADDRESS 0x7F8CE0 /end MEASUREMENT
/begin MEASUREMENT FrmMng_stRQ_STG_EFANSig "signalerrorstatus-message RQ_STG_EFAN" UWORD OneToOne 1 100 0.00 65535.00 FORMAT "%8.2" ECU_ADDRESS 0x7F8CE2 /end MEASUREMENT
/begin MEASUREMENT FrmMng_stShpsSSG "Status of SSG selection" UBYTE OneToOne 1 100 0.00 255.0 FORMAT "%5.1" ECU_ADDRESS 0x7F88BB /end MEASUREMENT
/begin MEASUREMENT FrmMng_stShpsSSGOld "Last value of Status of SSG selection" UBYTE OneToOne 1 100 0.00 255.0 FORMAT "%5.1" ECU_ADDRESS 0x7F88BC /end MEASUREMENT
/begin MEASUREMENT FrmMng_stShutOffSSG "Demand for engine stop in case of error" UBYTE OneToOne 1 100 0.00 255.0 FORMAT "%5.1" ECU_ADDRESS 0x7F88BD /end MEASUREMENT
/begin MEASUREMENT FrmMng_stSITZGURTSig "Signalstatus der STAT_SITZBELEGUNG_GURT-Botschaft" UWORD OneToOne 1 100 0.00 65535.00 FORMAT "%8.2" ECU_ADDRESS 0x7F8CE4 /end MEASUREMENT
/begin MEASUREMENT FrmMng_stSTAT_ANHSig "" UWORD OneToOne 1 100 0.00 65535.00 FORMAT "%8.2" ECU_ADDRESS 0x7F8CE6 /end MEASUREMENT
/begin MEASUREMENT FrmMng_stSTAT_ARSSig "state of single signals in CAN-message" UWORD OneToOne 1 100 0.00 65535.00 FORMAT "%8.2" ECU_ADDRESS 0x7F8CE8 /end MEASUREMENT
/begin MEASUREMENT FrmMng_stSTAT_DSCSig "state of single signals in CAN-message" UWORD OneToOne 1 100 0.00 65535.00 FORMAT "%8.2" ECU_ADDRESS 0x7F8CEA /end MEASUREMENT
/begin MEASUREMENT FrmMng_stSTAT_EKPSig "signalerrorstatus-message STAT_EKP" UWORD OneToOne 1 100 0.00 65535.00 FORMAT "%8.2" ECU_ADDRESS 0x7F8CEC /end MEASUREMENT
/begin MEASUREMENT FrmMng_stSTAT_KOMBISig "signalerrorstatus-message STAT_KOMBI" UWORD OneToOne 1 100 0.00 65535.00 FORMAT "%8.2" ECU_ADDRESS 0x7F8CEE /end MEASUREMENT
/begin MEASUREMENT FrmMng_stT15 "Zustand der Klemme 15 über CAN" UBYTE OneToOne 1 100 0.00 255.0 FORMAT "%5.1" ECU_ADDRESS 0x7F88BE /end MEASUREMENT
/begin MEASUREMENT FrmMng_stT50 "Zustand Klemme 50 vom CAN" UBYTE OneToOne 1 100 0.00 255.0 FORMAT "%5.1" ECU_ADDRESS 0x7F88BF /end MEASUREMENT
/begin MEASUREMENT FrmMng_stTEMPRELTIMESig "signalerrorstatus-message TEMPRELTIME" UWORD OneToOne 1 100 0.00 65535.00 FORMAT "%8.2" ECU_ADDRESS 0x7F8CF0 /end MEASUREMENT
/begin MEASUREMENT FrmMng_stTERMINALSig "state of single signals in CAN-message" UWORD OneToOne 1 100 0.00 65535.00 FORMAT "%8.2" ECU_ADDRESS 0x7F8CF2 /end MEASUREMENT
/begin MEASUREMENT FrmMng_stTgMonthBosRst "" UBYTE OneToOne 1 100 0.00 255.0 FORMAT "%5.1" ECU_ADDRESS 0x7F88C2 /end MEASUREMENT
/begin MEASUREMENT FrmMng_stTgYearBosRst "" UBYTE OneToOne 1 100 0.00 255.0 FORMAT "%5.1" ECU_ADDRESS 0x7F88C3 /end MEASUREMENT
/begin MEASUREMENT FrmMng_stTIME_DATESig "" UWORD OneToOne 1 100 0.00 65535.00 FORMAT "%8.2" ECU_ADDRESS 0x7F8CF4 /end MEASUREMENT
/begin MEASUREMENT FrmMng_stTorqTarAFS "status of required torque from AFS" UBYTE OneToOne 1 100 0.00 255.0 FORMAT "%5.1" ECU_ADDRESS 0x7F88C4 /end MEASUREMENT
/begin MEASUREMENT FrmMng_stTORQUE_DSCSig "state of single signals in CAN-message" UWORD OneToOne 1 100 0.00 65535.00 FORMAT "%8.2" ECU_ADDRESS 0x7F8CF6 /end MEASUREMENT
/begin MEASUREMENT FrmMng_stTORQUE_GEARBXSig "state of single signals in CAN-message" UWORD OneToOne 1 100 0.00 65535.00 FORMAT "%8.2" ECU_ADDRESS 0x7F8CF8 /end MEASUREMENT
/begin MEASUREMENT FrmMng_stTRadio "state TRadio" UBYTE OneToOne 1 100 0.00 255.0 FORMAT "%5.1" ECU_ADDRESS 0x7F88C1 /end MEASUREMENT
/begin MEASUREMENT FrmMng_stTrailer "Anhänger Status" UBYTE OneToOne 1 100 0.00 255.0 FORMAT "%5.1" ECU_ADDRESS 0x7F88C5 /end MEASUREMENT
/begin MEASUREMENT FrmMng_stTrqDesDSC "type of DSC torque-intervention" UBYTE OneToOne 1 100 0.00 255.0 FORMAT "%5.1" ECU_ADDRESS 0x7F88C6 /end MEASUREMENT
/begin MEASUREMENT FrmMng_stTrqDesGearbx "type of gearbox torque-intervention" UBYTE OneToOne 1 100 0.00 255.0 FORMAT "%5.1" ECU_ADDRESS 0x7F88C7 /end MEASUREMENT
/begin MEASUREMENT FrmMng_stTrqLimGearbx "state of torquelimitation for acceleration from standstill" UBYTE OneToOne 1 100 0.00 255.0 FORMAT "%5.1" ECU_ADDRESS 0x7F88C9 /end MEASUREMENT
/begin MEASUREMENT FrmMng_stUnitV "Einheit der angez. Geschwindigkeit" UBYTE OneToOne 1 100 0.00 255.0 FORMAT "%5.1" ECU_ADDRESS 0x7F88CA /end MEASUREMENT
/begin MEASUREMENT FrmMng_stVCom "status der geschwindigkeitsanzeige combi" UBYTE OneToOne 1 100 0.00 255.0 FORMAT "%5.1" ECU_ADDRESS 0x7F88CB /end MEASUREMENT
/begin MEASUREMENT FrmMng_stVEH_MODSig "signalerrorstatus-message VEH_MOD" UWORD OneToOne 1 100 0.00 65535.00 FORMAT "%8.2" ECU_ADDRESS 0x7F8CFE /end MEASUREMENT
/begin MEASUREMENT FrmMng_stVELOCITYSig "state of single signals in CAN-message" UWORD OneToOne 1 100 0.00 65535.00 FORMAT "%8.2" ECU_ADDRESS 0x7F8D00 /end MEASUREMENT
/begin MEASUREMENT FrmMng_stWghSeatDr "Klasse Gewicht Sitz Fahrer" UBYTE OneToOne 1 100 0.00 255.0 FORMAT "%5.1" ECU_ADDRESS 0x7F88CC /end MEASUREMENT
/begin MEASUREMENT FrmMng_swtPSPOff "Botschaft für CTR_CRASH_SWO_EKP CAN signal" UBYTE OneToOne 1 100 0.00 255.0 FORMAT "%5.1" ECU_ADDRESS 0x7F88CE /end MEASUREMENT
/begin MEASUREMENT FrmMng_tOil "Öltemperatur" SWORD Temp_Cels 1 100 -50.140 899.860 FORMAT "%8.3" ECU_ADDRESS 0x7F8D0A /end MEASUREMENT
/begin MEASUREMENT FrmMng_trqAC "Aktuelles Klimakompressormoment" SWORD Trq 1 100 -3276.800 3276.700 FORMAT "%8.3" ECU_ADDRESS 0x7F8D0E /end MEASUREMENT
/begin MEASUREMENT FrmMng_trqACC_TrqDes "Torque request-message DREHMOMENT_ANF_ACC" SWORD Trq 1 100 -3276.800 3276.700 FORMAT "%8.3" ECU_ADDRESS 0x7F8D10 /end MEASUREMENT
/begin MEASUREMENT FrmMng_trqARSCur "current torque ARS" SWORD TrqPrp 1 100 -6553.600 6553.400 FORMAT "%8.3" ECU_ADDRESS 0x7F8D12 /end MEASUREMENT
/begin MEASUREMENT FrmMng_trqARSDes "desired torque ARS" SWORD TrqPrp 1 100 -6553.600 6553.400 FORMAT "%8.3" ECU_ADDRESS 0x7F8D14 /end MEASUREMENT
/begin MEASUREMENT FrmMng_trqARSInc "Momentenerhöhender Eingriff, Schaltung" SWORD TrqPrp 1 100 -6553.600 6553.400 FORMAT "%8.3" ECU_ADDRESS 0x7F8D16 /end MEASUREMENT
/begin MEASUREMENT FrmMng_trqAvlAFS "Required torque from AFS" SWORD Trq 1 100 -3276.800 3276.700 FORMAT "%8.3" ECU_ADDRESS 0x7F8D18 /end MEASUREMENT
/begin MEASUREMENT FrmMng_trqDSCDec "verringernder Momenteneingriff, DSC" SWORD Trq 1 100 -3276.800 3276.700 FORMAT "%8.3" ECU_ADDRESS 0x7F8D1C /end MEASUREMENT
/begin MEASUREMENT FrmMng_trqDSCDes "desired torque DSC" SWORD Trq 1 100 -3276.800 3276.700 FORMAT "%8.3" ECU_ADDRESS 0x7F8D1E /end MEASUREMENT
/begin MEASUREMENT FrmMng_trqDSCInc "erhöhender Momenteneingriff, DSC" SWORD Trq 1 100 -3276.800 3276.700 FORMAT "%8.3" ECU_ADDRESS 0x7F8D20 /end MEASUREMENT
/begin MEASUREMENT FrmMng_trqGearbxDec "reduzierender Momenteneingriff des Getriebes aus Can" SWORD Trq 1 100 -3276.800 3276.700 FORMAT "%8.3" ECU_ADDRESS 0x7F8D24 /end MEASUREMENT
/begin MEASUREMENT FrmMng_trqGearbxDes "desired torque by gearbox" SWORD Trq 1 100 -3276.800 3276.700 FORMAT "%8.3" ECU_ADDRESS 0x7F8D26 /end MEASUREMENT
/begin MEASUREMENT FrmMng_trqGearbxFrc "Momentenaufnahme des Getriebe" SWORD Trq 1 100 -3276.800 3276.700 FORMAT "%8.3" ECU_ADDRESS 0x7F8D28 /end MEASUREMENT
/begin MEASUREMENT FrmMng_trqGearbxInc "erhöhender Momenteneingriff des Getriebes aus CAN" SWORD Trq 1 100 -3276.800 3276.700 FORMAT "%8.3" ECU_ADDRESS 0x7F8D2A /end MEASUREMENT
/begin MEASUREMENT FrmMng_trqGearbxMax "maximum torque Gearbox" SWORD Trq 1 100 -3276.800 3276.700 FORMAT "%8.3" ECU_ADDRESS 0x7F8D2C /end MEASUREMENT
/begin MEASUREMENT FrmMng_trqInr "Increased torque demand though Frame Manager" SWORD Trq 1 100 -3276.800 3276.700 FORMAT "%8.3" ECU_ADDRESS 0x7F8D2E /end MEASUREMENT
/begin MEASUREMENT FrmMng_trqTarAFS "Requested torque from AFS" SWORD Trq 1 100 -3276.800 3276.700 FORMAT "%8.3" ECU_ADDRESS 0x7F8D34 /end MEASUREMENT
/begin MEASUREMENT FrmMng_uAltTarget "target voltage alternator" UWORD UC_Volt 1 100 0.00 6553.500 FORMAT "%8.3" ECU_ADDRESS 0x7F8D36 /end MEASUREMENT
/begin MEASUREMENT FrmMng_v "Fahrzeuggeschwindigkeit über CAN" SWORD Vel 1 100 -327.6800 327.6700 FORMAT "%8.4" ECU_ADDRESS 0x7F8D38 /end MEASUREMENT
/begin MEASUREMENT FrmMng_vDirection "" SWORD Vel 1 100 -327.6800 327.6700 FORMAT "%8.4" ECU_ADDRESS 0x7F8D3A /end MEASUREMENT
/begin MEASUREMENT FrmMng_vDisp "angez. Geschwindigkeit" SWORD Vel 1 100 -327.6800 327.6700 FORMAT "%8.4" ECU_ADDRESS 0x7F8D3C /end MEASUREMENT
/begin MEASUREMENT FrmMng_volFuelFil "Tankfüllstand" UWORD Fl_Half_L 1 100 0.00 3276.750 FORMAT "%8.3" ECU_ADDRESS 0x7F8D4C /end MEASUREMENT
/begin MEASUREMENT FrmMng_vWheelLB "Geschwindigkeit des linken hinteren Rades" SWORD Vel 1 100 -327.6800 327.6700 FORMAT "%8.4" ECU_ADDRESS 0x7F8D44 /end MEASUREMENT
/begin MEASUREMENT FrmMng_vWheelLF "Meßpunkt Radgeschwindigkeit links vorne" SWORD Vel 1 100 -327.6800 327.6700 FORMAT "%8.4" ECU_ADDRESS 0x7F8D46 /end MEASUREMENT
/begin MEASUREMENT FrmMng_vWheelRB "Geschwindigkeit des rechten hintern Rades" SWORD Vel 1 100 -327.6800 327.6700 FORMAT "%8.4" ECU_ADDRESS 0x7F8D48 /end MEASUREMENT
/begin MEASUREMENT FrmMng_vWheelRF "Meßpunkt Radgeschwindigkeit rechts vorne" SWORD Vel 1 100 -327.6800 327.6700 FORMAT "%8.4" ECU_ADDRESS 0x7F8D4A /end MEASUREMENT
/begin MEASUREMENT FTSCD_tFuel "Kraftstofftemperatur" SWORD Temp_Cels 1 100 -50.140 899.860 FORMAT "%8.3" ECU_ADDRESS 0x7F8C78 /end MEASUREMENT
/begin MEASUREMENT FTSCD_tFuelLin "linearisierter Wert der Kraftstoffstemperatur" SWORD Temp_Cels 1 100 -50.140 899.860 FORMAT "%8.3" ECU_ADDRESS 0x7F8C7A /end MEASUREMENT
/begin MEASUREMENT FTSCD_uRaw "Spannungsrohwert der Kraftstoffstemperatur" SWORD Volt 1 100 -160156.4 160151.5 FORMAT "%8.1" ECU_ADDRESS 0x7F8C7C /end MEASUREMENT
/begin MEASUREMENT Gearbx_amAct_mp "Aktueller Integrationswert des Momentenüberschußintegrals" SWORD TrqDT 1 100 -32768.00 32767.00 FORMAT "%8.2" ECU_ADDRESS 0x8FF120 /end MEASUREMENT
/begin MEASUREMENT Gearbx_dtrqLimUp_mp "DrehkraftRampe Herauf Steigung" ULONG RmpTrq 1 100 0.00 6553599.99847 FORMAT "%13.5" ECU_ADDRESS 0x8FF12C /end MEASUREMENT
/begin MEASUREMENT Gearbx_nMin "LL_Solldrehzahlanforderung durch Getriebe2 Botschaft" SWORD EngN 1 100 -32768.00 32767.00 FORMAT "%8.2" ECU_ADDRESS 0x7F8D4E /end MEASUREMENT
/begin MEASUREMENT Gearbx_nMinRaw_mp "Low Idel speed Raw value depending on Gear state and FrmMng_nTSC" SWORD EngN 1 100 -32768.00 32767.00 FORMAT "%8.2" ECU_ADDRESS 0x8FF11E /end MEASUREMENT
/begin MEASUREMENT Gearbx_numGearDes "erkannter Zielgang" SBYTE OneToOne 1 100 -128.0 127.0 FORMAT "%5.1" ECU_ADDRESS 0x7F88D2 /end MEASUREMENT
/begin MEASUREMENT Gearbx_numGearFast "erkannter schneller Getriebegang" SBYTE OneToOne 1 100 -128.0 127.0 FORMAT "%5.1" ECU_ADDRESS 0x7F88D3 /end MEASUREMENT
/begin MEASUREMENT Gearbx_rTrans "Getriebeübersetzung" SWORD TransR 1 100 -327.6800 327.6700 FORMAT "%8.4" ECU_ADDRESS 0x7F8D50 /end MEASUREMENT
/begin MEASUREMENT Gearbx_stDemUnplaus "Entprellter Status des Momentenüberschußintegrals" UBYTE OneToOne 1 100 0.00 255.0 FORMAT "%5.1" ECU_ADDRESS 0x7F88D4 /end MEASUREMENT
/begin MEASUREMENT Gearbx_stDrvAway_mp "Status der Anfahrmomentbegrenzung" UBYTE OneToOne 1 100 0.00 255.0 FORMAT "%5.1" ECU_ADDRESS 0x8FF130 /end MEASUREMENT
/begin MEASUREMENT Gearbx_stGbxIncMax_mp "Status des Momentenüberschußintegrals" UBYTE OneToOne 1 100 0.00 255.0 FORMAT "%5.1" ECU_ADDRESS 0x8FF122 /end MEASUREMENT
/begin MEASUREMENT Gearbx_stGear "Ganginformation" SBYTE OneToOne 1 100 -128.0 127.0 FORMAT "%5.1" ECU_ADDRESS 0x7F88D5 /end MEASUREMENT
/begin MEASUREMENT Gearbx_stGearBit "" UBYTE OneToOne 1 100 0.00 255.0 FORMAT "%5.1" ECU_ADDRESS 0x7F88D6 /end MEASUREMENT
/begin MEASUREMENT Gearbx_stIntv_mp "Status der Defekt- und Heilungsrampe vom Getriebewunschmoment" UBYTE OneToOne 1 100 0.00 255.0 FORMAT "%5.1" ECU_ADDRESS 0x8FF126 /end MEASUREMENT
/begin MEASUREMENT Gearbx_stStrtMotRls "Anlasserfreigabezustand vom Getriebe" UBYTE OneToOne 1 100 0.00 255.0 FORMAT "%5.1" ECU_ADDRESS 0x7F88D7 /end MEASUREMENT
/begin MEASUREMENT Gearbx_swtType "Getriebetyp (0: manuell(MT); 1: automatisch(AT); 2: Schaltautomatisch(AST); 3: StufenlosesGetriebe (CVT); 4:automatic Z-Car)" UBYTE OneToOne 1 100 0.00 3.000 FORMAT "%5.3" ECU_ADDRESS 0x7F88D8 /end MEASUREMENT
/begin MEASUREMENT Gearbx_tOil "Gearbox oil temperature" SWORD Temp_Cels 1 100 -50.140 899.860 FORMAT "%8.3" ECU_ADDRESS 0x7F8D52 /end MEASUREMENT
/begin MEASUREMENT Gearbx_trqDec "erniedrigender Momenteneingriff vom Getriebe" SWORD Trq 1 100 -500.0000 1000.000 FORMAT "%8.3" ECU_ADDRESS 0x7F8D54 /end MEASUREMENT
/begin MEASUREMENT Gearbx_trqDecRaw_mp "Ersatzwert für das reduzierende Getriebemoment" SWORD Trq 1 100 -3276.800 3276.700 FORMAT "%8.3" ECU_ADDRESS 0x8FF128 /end MEASUREMENT
/begin MEASUREMENT Gearbx_trqFrc "aktuelles Verlustmoment Getriebe" SWORD Trq 1 100 -500.0000 1000.000 FORMAT "%8.3" ECU_ADDRESS 0x7F8D56 /end MEASUREMENT
/begin MEASUREMENT Gearbx_trqInc "erhöhender Momenteneingriff vom Getriebe" SWORD Trq 1 100 -500.0000 1000.000 FORMAT "%8.3" ECU_ADDRESS 0x7F8D5A /end MEASUREMENT
/begin MEASUREMENT Gearbx_trqIncRaw_mp "Ersatzwert für das erhöhende Getriebemoment" SWORD Trq 1 100 -3276.800 3276.700 FORMAT "%8.3" ECU_ADDRESS 0x8FF12A /end MEASUREMENT
/begin MEASUREMENT Gearbx_trqInMax "maximales Getriebeeingangsmoment" SWORD Trq 1 100 -500.0000 1000.000 FORMAT "%8.3" ECU_ADDRESS 0x7F8D58 /end MEASUREMENT
/begin MEASUREMENT Gearbx_trqInt_mp "Aktuelles  Integrationsmoment des Momentenüberschußintegrals" SWORD Trq 1 100 -3276.800 3276.700 FORMAT "%8.3" ECU_ADDRESS 0x8FF124 /end MEASUREMENT
/begin MEASUREMENT Gearbx_trqLimDrvAway_mp "Begrenztes Anfahrmoment" SWORD Trq 1 100 -3276.800 3276.700 FORMAT "%8.3" ECU_ADDRESS 0x8FF132 /end MEASUREMENT
/begin MEASUREMENT Gearbx_trqMaxCur_mp "maximales Getriebeeingangsmoment aus Kennlinie" SWORD Trq 1 100 -3276.800 3276.700 FORMAT "%8.3" ECU_ADDRESS 0x8FF134 /end MEASUREMENT
/begin MEASUREMENT GearCD_stPN "Status Getriebe in PN-Stellung" UBYTE OneToOne 1 100 0.00 255.0 FORMAT "%5.1" ECU_ADDRESS 0x7F88CF /end MEASUREMENT
/begin MEASUREMENT GearCD_stPNCon_mp "Zustand Bedingungen PN-Erkennung" UBYTE OneToOne 1 100 0.00 255.0 FORMAT "%5.1" ECU_ADDRESS 0x8FF136 /end MEASUREMENT
/begin MEASUREMENT GearCD_stPNRawVal "Rohwert PN_Signal" UBYTE OneToOne 1 100 0.00 255.0 FORMAT "%5.1" ECU_ADDRESS 0x7F88D0 /end MEASUREMENT
/begin MEASUREMENT GearCD_swtPNSig "Schalterstellung PN_signal v. CAN od. HW" UBYTE OneToOne 1 100 0.00 255.0 FORMAT "%5.1" ECU_ADDRESS 0x7F88D1 /end MEASUREMENT
/begin MEASUREMENT GlwCD_BufLev_mp "buffer status" SWORD OneToOne 1 100 -32768.00 32767.00 FORMAT "%8.2" ECU_ADDRESS 0x8FF138 /end MEASUREMENT
/begin MEASUREMENT GlwCD_CtlState_mp "Wert auf Identifier 1 des Glühsteuergerätes" UBYTE OneToOne 1 100 0.00 255.0 FORMAT "%5.1" ECU_ADDRESS 0x8FF13A /end MEASUREMENT
/begin MEASUREMENT GlwCD_ErrBank1_mp "Wert auf Identifier 3 des Glühsteuergeräts" UBYTE OneToOne 1 100 0.00 255.0 FORMAT "%5.1" ECU_ADDRESS 0x8FF13B /end MEASUREMENT
/begin MEASUREMENT GlwCD_ErrPwr_mp "Wert auf Identifier 2 des Glühsteuergeräts" UBYTE OneToOne 1 100 0.00 255.0 FORMAT "%5.1" ECU_ADDRESS 0x8FF13C /end MEASUREMENT
/begin MEASUREMENT GlwCD_OtherReg_mp "Glow controller value" UWORD OneToOne 1 100 0.00 65535.00 FORMAT "%8.2" ECU_ADDRESS 0x8FF13E /end MEASUREMENT
/begin MEASUREMENT GlwCD_Parity_mp "error status" UWORD OneToOne 1 100 0.00 65535.00 FORMAT "%8.2" ECU_ADDRESS 0x8FF140 /end MEASUREMENT
/begin MEASUREMENT GlwCD_pwrGlw "power consumption of the glow-plugs (readback value from glow control unit)" UWORD Pwr_HiRes 1 100 0.00 32767.50 FORMAT "%8.2" ECU_ADDRESS 0x7F8D5C /end MEASUREMENT
/begin MEASUREMENT GlwCD_RawVal_mp "Rohwert für das Glühanforderungsregister des Glühcontrollers" UBYTE OneToOne 1 100 0.00 255.0 FORMAT "%5.1" ECU_ADDRESS 0x6F815D /end MEASUREMENT
/begin MEASUREMENT GlwCD_Reset_mp "communication error" UWORD OneToOne 1 100 0.00 65535.00 FORMAT "%8.2" ECU_ADDRESS 0x8FF142 /end MEASUREMENT
/begin MEASUREMENT GlwCD_stCtl_mp "Steuerstatus des Glühsteuergeraet - Zustandsautomaten (aktueller Gluehzustand bei Gluehen ueber BSD)" UWORD OneToOne 1 100 0.00 65535.00 FORMAT "%8.2" ECU_ADDRESS 0x8FF144 /end MEASUREMENT
/begin MEASUREMENT GlwCD_stState_mp "Status des BSD Gluehschnittstelle - Zustandsautomaten (Verbindungsstatus)" UWORD OneToOne 1 100 0.00 65535.00 FORMAT "%8.2" ECU_ADDRESS 0x8FF146 /end MEASUREMENT
/begin MEASUREMENT GlwCtl_ctPreGlw_mp "Counter for pre-glow without engine start" UBYTE OneToOne 1 100 0.00 255.0 FORMAT "%5.1" ECU_ADDRESS 0x8FF14E /end MEASUREMENT
/begin MEASUREMENT GlwCtl_rLimitRaw_mp "Messpunkt für Rohwert-Limit für Glühanforderung" SWORD OneToOne 1 100 -32768.00 32767.00 FORMAT "%8.2" ECU_ADDRESS 0x8FF148 /end MEASUREMENT
/begin MEASUREMENT GlwCtl_rLimit_mp "Messpunkt für oberes Limit der Glühanforderun" SWORD OneToOne 1 100 -32768.00 32767.00 FORMAT "%8.2" ECU_ADDRESS 0x8FF14A /end MEASUREMENT
/begin MEASUREMENT GlwCtl_rPwrOut "Glühanforderung" UBYTE OneToOne 1 100 0.00 255.0 FORMAT "%5.1" ECU_ADDRESS 0x7F88D9 /end MEASUREMENT
/begin MEASUREMENT GlwCtl_rRaw_mp "Messpunkt für Glühanforderung Rohwert" SWORD OneToOne 1 100 -32768.00 32767.00 FORMAT "%8.2" ECU_ADDRESS 0x8FF14C /end MEASUREMENT
/begin MEASUREMENT GlwCtl_stHdnPreGlwOld_mp "Zustandsbits der Triggerbedingungen vorher" UBYTE OneToOne 1 100 0.00 255.0 FORMAT "%5.1" ECU_ADDRESS 0x8FF14F /end MEASUREMENT
/begin MEASUREMENT GlwCtl_stHdnPreGlwTrg_mp "positive Flankenerkennung der Triggerbedingungen" UBYTE OneToOne 1 100 0.00 255.0 FORMAT "%5.1" ECU_ADDRESS 0x8FF150 /end MEASUREMENT
/begin MEASUREMENT GlwCtl_stHdnPreGlw_mp "Zustandsbits der Triggerbedingungen" UBYTE OneToOne 1 100 0.00 255.0 FORMAT "%5.1" ECU_ADDRESS 0x8FF151 /end MEASUREMENT
/begin MEASUREMENT GlwCtl_stLampCond_mp "Bedingungen für Ansteuerung Glühanzeige" UBYTE OneToOne 1 100 0.00 255.0 FORMAT "%5.1" ECU_ADDRESS 0x8FF156 /end MEASUREMENT
/begin MEASUREMENT GlwCtl_stLampEna "Aktivierungsbedingung Glühanzeige" UBYTE OneToOne 1 100 0.00 255.0 FORMAT "%5.1" ECU_ADDRESS 0x7F88DA /end MEASUREMENT
/begin MEASUREMENT GlwCtl_stLampOut "Zustand der Glühanzeige" UBYTE OneToOne 1 100 0.00 255.0 FORMAT "%5.1" ECU_ADDRESS 0x7F88DB /end MEASUREMENT
/begin MEASUREMENT GlwCtl_stLogic "aktueller Zustand der Glühzeitsteuerung" UWORD OneToOne 1 100 0.00 65535.00 FORMAT "%8.2" ECU_ADDRESS 0x7F8D5E /end MEASUREMENT
/begin MEASUREMENT GlwCtl_stLogicCond_mp "Zustandsbits der Triggerbedingungen" UBYTE OneToOne 1 100 0.00 255.0 FORMAT "%5.1" ECU_ADDRESS 0x8FF152 /end MEASUREMENT
/begin MEASUREMENT GlwCtl_stStrtMFlag_mp "Zustandsflag, altes BN-Glühen aktiv" UBYTE OneToOne 1 100 0.00 255.0 FORMAT "%5.1" ECU_ADDRESS 0x8FF153 /end MEASUREMENT
/begin MEASUREMENT GlwCtl_tClnt "Kühlmitteltemperatur für interne Verwendung der Glühzeitsteuerung" SWORD Temp_Cels 1 100 -50.140 899.860 FORMAT "%8.3" ECU_ADDRESS 0x7F8D60 /end MEASUREMENT
/begin MEASUREMENT GlwCtl_tiLamp_mp "Einschaltdauer Glühanzeige" SWORD Time_ms 1 100 -327680.0 327670.0 FORMAT "%8.1" ECU_ADDRESS 0x8FF158 /end MEASUREMENT
/begin MEASUREMENT GlwCtl_tiPre_mp "Nachglühzeit" UWORD Time_ms 1 100 0.00 655350.0 FORMAT "%8.1" ECU_ADDRESS 0x8FF154 /end MEASUREMENT
/begin MEASUREMENT HPUn_dvolPmpMaxCor_mp "Wirkungsgrad korrigiertes physikalisches Maximum des Volumenstroms einer Hochdruckpumpe" SWORD Qp_mm3_sec 1 100 -327680.0 327670.0 FORMAT "%8.1" ECU_ADDRESS 0x8FF15A /end MEASUREMENT
/begin MEASUREMENT HPUn_dvolPmpMax_mp "Physikalisches Maximum des Volumenstroms einer Hochdruckpumpe" SWORD Qp_mm3_sec 1 100 -327680.0 327670.0 FORMAT "%8.1" ECU_ADDRESS 0x8FF15C /end MEASUREMENT
/begin MEASUREMENT HPUn_etaPmpFlTemp_mp "Kraftstofftemperaturabhängiger Wirkungsgrad der Hochdruckpumpe" SWORD Eta 1 100 -256.0000 255.9922 FORMAT "%8.4" ECU_ADDRESS 0x8FF15E /end MEASUREMENT
/begin MEASUREMENT HPUn_etaPmpMaxAged_mp "maximaler Wirkungsgrad einer gealterten Hochdruckpumpe" SWORD Eta 1 100 -256.0000 255.9922 FORMAT "%8.4" ECU_ADDRESS 0x8FF160 /end MEASUREMENT
/begin MEASUREMENT HPUn_numInjQntBal "Maximale Anzahl an Einspritzungen aufgrund der Mengenbilanz der Hochdruckpumpe" UBYTE OneToOne 1 100 0.00 255.0 FORMAT "%5.1" ECU_ADDRESS 0x7F88DC /end MEASUREMENT
/begin MEASUREMENT HPUn_pRailDvtFlt_mp "Gefilterte Raildruck Regelabweichung" SWORD Pres_Rail 1 100 -3276.800 3276.700 FORMAT "%5.3" ECU_ADDRESS 0x8FF168 /end MEASUREMENT
/begin MEASUREMENT HPUn_qBalLim_mp "Begrenzungsmenge auf Grund der Mengenbilanz der Hochdruckpumpe" SWORD InjMassCyc 1 100 -327.6800 327.6700 FORMAT "%8.4" ECU_ADDRESS 0x8FF162 /end MEASUREMENT
/begin MEASUREMENT HPUn_qFlTempLim_mp "Begrenzungsmenge abhängig der Kraftstofftemperatur" SWORD InjMassCyc 1 100 -327.6800 327.6700 FORMAT "%8.4" ECU_ADDRESS 0x8FF164 /end MEASUREMENT
/begin MEASUREMENT HPUn_qLim "Begrenzungsmenge der Hochdruckpumpe" SWORD InjMassCyc 1 100 -327.6800 327.6700 FORMAT "%8.4" ECU_ADDRESS 0x7F8D62 /end MEASUREMENT
/begin MEASUREMENT HPUn_stNumInjMax_mp "Statusvariable, Mengebilanz der Hochruckpumpe" UBYTE OneToOne 1 100 0.00 255.0 FORMAT "%5.1" ECU_ADDRESS 0x8FF16A /end MEASUREMENT
/begin MEASUREMENT HPUn_stQntBal_mp "Status der Mengenbilanz der Hochdruckpumpe" UBYTE OneToOne 1 100 0.00 255.0 FORMAT "%5.1" ECU_ADDRESS 0x8FF166 /end MEASUREMENT
/begin MEASUREMENT HPUn_trqDes "Momentenanforderung der Hochdruckpumpe" SWORD Trq 1 100 -3276.800 3276.700 FORMAT "%8.3" ECU_ADDRESS 0x7F8D64 /end MEASUREMENT
/begin MEASUREMENT HWEMon_ctRecovery "Anzahl der während 2 Sekunden aufgetretenen Recoverys" UBYTE OneToOne 1 100 0.00 255.0 FORMAT "%5.1" ECU_ADDRESS 0x7F88DD /end MEASUREMENT
/begin MEASUREMENT HWEMon_numRecovery "Herkunft des letzten Reset ( >0 = Recovery )" UWORD OneToOne 1 100 0.00 65535.00 FORMAT "%8.2" ECU_ADDRESS 0x7F8D66 /end MEASUREMENT
/begin MEASUREMENT HWEMon_recLocHigh_mp "HighAdresse recovery location" UWORD OneToOne 1 100 0.00 65535.00 FORMAT "%8.2" ECU_ADDRESS 0x6F815E /end MEASUREMENT
/begin MEASUREMENT HWEMon_recLocLow_mp "LowAdresse recovery location" UWORD OneToOne 1 100 0.00 65535.00 FORMAT "%8.2" ECU_ADDRESS 0x6F8160 /end MEASUREMENT
/begin MEASUREMENT HWEMon_stVoltMon_mp "Latchbetrieb der Überspannungsüberwachung (1 = Latch aktiv)" UBYTE OneToOne 1 100 0.00 255.0 FORMAT "%5.1" ECU_ADDRESS 0x8FF16B /end MEASUREMENT
/begin MEASUREMENT IATSCD_dtAir "Änderungsrate der angesaugten Lufttemperatur" SWORD TempCels_100ms 1 100 -32768.00 32767.00 FORMAT "%8.2" ECU_ADDRESS 0x7F8D68 /end MEASUREMENT
/begin MEASUREMENT IATSCD_dtAirCats "Anderung von IATSCD_tAirCats zwischen den Abtastschritten n und n-1" SWORD TempCels_100ms 1 100 -32768.00 32767.00 FORMAT "%8.2" ECU_ADDRESS 0x7F8D6A /end MEASUREMENT
/begin MEASUREMENT IATSCD_swtSig "Signalquelle Schalter ADC/CAN" UBYTE OneToOne 1 100 0.00 255.0 FORMAT "%5.1" ECU_ADDRESS 0x7F88DE /end MEASUREMENT
/begin MEASUREMENT IATSCD_swtSigCats "Signalquelle Schalter Ladelufttemperatur über ADC oder CAN" UBYTE OneToOne 1 100 0.00 255.0 FORMAT "%5.1" ECU_ADDRESS 0x7F88DF /end MEASUREMENT
/begin MEASUREMENT IATSCD_tAir "Ansauglufttemperatur" SWORD Temp_Cels 1 100 -50.140 899.860 FORMAT "%8.3" ECU_ADDRESS 0x7F8D6C /end MEASUREMENT
/begin MEASUREMENT IATSCD_tAirCats "Ladelufttemperatur nach Ladeluftkühler" SWORD Temp_Cels 1 100 -50.140 899.860 FORMAT "%8.3" ECU_ADDRESS 0x7F8D6E /end MEASUREMENT
/begin MEASUREMENT IATSCD_tAirLin "linearisierter Wert aus HWK vorm Aufruf der Übergangsfunktion" SWORD Temp_Cels 1 100 -50.140 899.860 FORMAT "%8.3" ECU_ADDRESS 0x7F8D70 /end MEASUREMENT
/begin MEASUREMENT IATSCD_tAirLinCats "Ladelufttemperatur - Linearisierter Wert aus HWK vor Aufruf der Übergangsfunktion" SWORD Temp_Cels 1 100 -50.140 899.860 FORMAT "%8.3" ECU_ADDRESS 0x7F8D72 /end MEASUREMENT
/begin MEASUREMENT IATSCD_uRaw "Lufttemperatur Spannungsrohwert" SWORD Volt 1 100 -160156.4 160151.5 FORMAT "%8.1" ECU_ADDRESS 0x7F8D74 /end MEASUREMENT
/begin MEASUREMENT IATSCD_uRawCats "Ladelufttemperatur Spannungsrohwert" SWORD Volt 1 100 -160156.4 160151.5 FORMAT "%8.1" ECU_ADDRESS 0x7F8D76 /end MEASUREMENT
/begin MEASUREMENT IBSCD_BsdControl_mp "flags to koordinate communication between HT and KT" UBYTE OneToOne 1 100 0.00 255.0 FORMAT "%5.1" ECU_ADDRESS 0x8FF16C /end MEASUREMENT
/begin MEASUREMENT IBSCD_BsdData_mp "data from IBS and to IBS" UBYTE OneToOne 1 100 0.00 255.0 FORMAT "%5.1" ECU_ADDRESS 0x8FF16E /end MEASUREMENT
/begin MEASUREMENT IBSCD_BsdRegAdr_mp "adress of BSD register in IBS" UBYTE OneToOne 1 100 0.00 255.0 FORMAT "%5.1" ECU_ADDRESS 0x8FF16F /end MEASUREMENT
/begin MEASUREMENT IBSCD_stB_ibsactiv_mp "status IBS" UBYTE B_TRUE 1 100 0.00 1.00000000000 FORMAT "%13.11" ECU_ADDRESS 0x8FF16D /end MEASUREMENT
/begin MEASUREMENT IBSCD_stB_ibsdetec_mp "IBS detection status" UBYTE B_TRUE 1 100 0.00 1.00000000000 FORMAT "%13.11" ECU_ADDRESS 0x8FF170 /end MEASUREMENT
/begin MEASUREMENT IgnLck_st "Abschaltanforderungen für Immobilizer/Wegfahrsperre" UBYTE OneToOne 1 100 0.00 255.0 FORMAT "%5.1" ECU_ADDRESS 0x7F88E0 /end MEASUREMENT
/begin MEASUREMENT ImmCtl_stIniSeq "status initialisation" UBYTE OneToOne 1 100 0.00 255.0 FORMAT "%5.1" ECU_ADDRESS 0x7F88E3 /end MEASUREMENT
/begin MEASUREMENT IndSys_mAirPerCylLim_mp "Air mass Per Cylinder value" SWORD AirMassPerCyl 1 100 -3276.800 3276.700 FORMAT "%8.3" ECU_ADDRESS 0x8FF1A2 /end MEASUREMENT
/begin MEASUREMENT IndSys_rVSA "Sollposition für Einlaßkanalabschaltung" SWORD DtyCyc 1 100 -327.6800 327.6700 FORMAT "%8.4" ECU_ADDRESS 0x7F8D7E /end MEASUREMENT
/begin MEASUREMENT IndSys_rVSAATCorr_mp "Lufttemperatur Korrekturwert" SWORD DtyCyc 1 100 -327.6800 327.6700 FORMAT "%8.4" ECU_ADDRESS 0x8FF1A6 /end MEASUREMENT
/begin MEASUREMENT IndSys_rVSABase_mp "Drallniveausteuerung - Grundwert" SWORD DtyCyc 1 100 -327.6800 327.6700 FORMAT "%8.4" ECU_ADDRESS 0x8FF1A8 /end MEASUREMENT
/begin MEASUREMENT IndSys_rVSAByp_mp "Bypass-Label, Kopie von IndSys_rVSA" SWORD DtyCyc 1 100 -327.6800 327.6700 FORMAT "%8.4" ECU_ADDRESS 0x8FF1AA /end MEASUREMENT
/begin MEASUREMENT IndSys_rVSACorr_mp "korrigierter Wert (vor der Maximalwert-Begrenzung)" SWORD DtyCyc 1 100 -327.6800 327.6700 FORMAT "%8.4" ECU_ADDRESS 0x8FF1AC /end MEASUREMENT
/begin MEASUREMENT IndSys_rVSACTCorr_mp "Külmitteltemperatur Korrekturwert" SWORD DtyCyc 1 100 -327.6800 327.6700 FORMAT "%8.4" ECU_ADDRESS 0x8FF1AE /end MEASUREMENT
/begin MEASUREMENT IndSys_stPart1_mp "Status Induction system" UBYTE OneToOne 1 100 0.00 255.0 FORMAT "%5.1" ECU_ADDRESS 0x8FF1A4 /end MEASUREMENT
/begin MEASUREMENT IndSys_stPart2_mp "Status Induction system" UBYTE OneToOne 1 100 0.00 255.0 FORMAT "%5.1" ECU_ADDRESS 0x8FF1A5 /end MEASUREMENT
/begin MEASUREMENT IndSys_tFld "Temperaturfeld Ansaugtrakt" SWORD Temp_Cels 1 100 -50.140 899.860 FORMAT "%8.3" ARRAY_SIZE 3 ECU_ADDRESS 0x7F91F8 /end MEASUREMENT
/begin MEASUREMENT InjCrv_dpMIDynCor "DT1 gefilterter Atmosphärendruck" SWORD dp_dZ20 1 100 -327680.0 327670.0 FORMAT "%8.1" ECU_ADDRESS 0x7F8D88 /end MEASUREMENT
/begin MEASUREMENT InjCrv_dqSetUnBalFltLim "gefilterter, limitierter Einspritzmengengradient" SWORD InjMassPerSec_20ms 1 100 -16384.00 16383.50 FORMAT "%8.2" ECU_ADDRESS 0x7F8D8A /end MEASUREMENT
/begin MEASUREMENT InjCrv_dqSetUnBal_mp "InjCrv_qSetUnBal DT1 filtered" SWORD InjMassPerSec_20ms 1 100 -16384.00 16383.50 FORMAT "%8.2" ECU_ADDRESS 0x8FF1DC /end MEASUREMENT
/begin MEASUREMENT InjCrv_facMI1DynCor2_mp "dq correction factor MI SOE customer correction II" SWORD Fact 1 100 -4.000000 3.999878 FORMAT "%8.6" ECU_ADDRESS 0x8FF1DE /end MEASUREMENT
/begin MEASUREMENT InjCrv_facMI1DynCorSlow2 "factor depending on atmospheric pressure" SWORD Fact 1 100 -4.000000 3.999878 FORMAT "%8.6" ECU_ADDRESS 0x7F8D8C /end MEASUREMENT
/begin MEASUREMENT InjCrv_facMIAPSPhiCor "atmosphärendruckabhängiger Korrekturfaktor für die MI1" SWORD Fact 1 100 -4.000000 3.999878 FORMAT "%8.6" ECU_ADDRESS 0x7F8D8E /end MEASUREMENT
/begin MEASUREMENT InjCrv_facMIAPSPhiCor2 "atmosphärendruckabhängiger Korrekturfaktor -2 für MI1" SWORD Fact 1 100 -4.000000 3.999878 FORMAT "%8.6" ECU_ADDRESS 0x7F8D90 /end MEASUREMENT
/begin MEASUREMENT InjCrv_facMIAPSPhiCorStrt "Korrekturfaktur für Atmosphärendruck im Start" SWORD Fact 1 100 -4.000000 3.999878 FORMAT "%8.6" ECU_ADDRESS 0x7F8D92 /end MEASUREMENT
/begin MEASUREMENT InjCrv_facMIATSPhiCor "ansauglufttemperaturabhängiger Korrekturfaktor für die MI1" SWORD Fact 1 100 -4.000000 3.999878 FORMAT "%8.6" ECU_ADDRESS 0x7F8D94 /end MEASUREMENT
/begin MEASUREMENT InjCrv_facMIATSPhiCor2 "ansauglufttemperaturabhängiger Korrekturfaktor -2 für MI1" SWORD Fact 1 100 -4.000000 3.999878 FORMAT "%8.6" ECU_ADDRESS 0x7F8D96 /end MEASUREMENT
/begin MEASUREMENT InjCrv_facMIATSPhiCorStrt "Korrekturfaktur für Umgebungstemperatur im Start" SWORD Fact 1 100 -4.000000 3.999878 FORMAT "%8.6" ECU_ADDRESS 0x7F8D98 /end MEASUREMENT
/begin MEASUREMENT InjCrv_facMIDynCor "resultierneder Faktor abhängig von Lufttemperatur und Wassertemperatur" SWORD Fact 1 100 -4.000000 3.999878 FORMAT "%8.6" ECU_ADDRESS 0x7F8D9A /end MEASUREMENT
/begin MEASUREMENT InjCrv_facMIETSPhiCor "Gewichtsfaktor für Ansteuerbeginnkorrektur Haupteinspritzung in Abhängigkeit der Motortemperatur" SWORD Fact 1 100 -4.000000 3.999878 FORMAT "%8.6" ECU_ADDRESS 0x7F8D9C /end MEASUREMENT
/begin MEASUREMENT InjCrv_facMIETSPhiCor1 "motortemperaturabhängiger Korrekturfaktor -1 für MI1" SWORD Fact 1 100 -4.000000 3.999878 FORMAT "%8.6" ECU_ADDRESS 0x7F8D9E /end MEASUREMENT
/begin MEASUREMENT InjCrv_facMIETSPhiCor12 """motortemperaturabhängiger Korrekturfaktor für MI1 bei inaktiver PiI2""" SWORD Fact 1 100 -4.000000 3.999878 FORMAT "%8.6" ECU_ADDRESS 0x7F8DA0 /end MEASUREMENT
/begin MEASUREMENT InjCrv_facMIETSPhiCor2 "motortemperaturabhängiger Korrekturfaktor -2 für MI1" SWORD Fact 1 100 -4.000000 3.999878 FORMAT "%8.6" ECU_ADDRESS 0x7F8DA2 /end MEASUREMENT
/begin MEASUREMENT InjCrv_facMIETSPhiCorStrt "Korrekturfaktur für Motortemperatur im Start" SWORD Fact 1 100 -4.000000 3.999878 FORMAT "%8.6" ECU_ADDRESS 0x7F8DA4 /end MEASUREMENT
/begin MEASUREMENT InjCrv_facMIFTSRailCor "Korrekturfaktor für die MI1, abhängig von der kraftstofftemperaturabhängigen Raildruckkorrektur" SWORD Fact 1 100 -4.000000 3.999878 FORMAT "%8.6" ECU_ADDRESS 0x7F8DA6 /end MEASUREMENT
/begin MEASUREMENT InjCrv_facMIFTSRailCorStrt "Korrekturfaktor für Kraftstofftemperatur im Start" SWORD Fact 1 100 -4.000000 3.999878 FORMAT "%8.6" ECU_ADDRESS 0x7F8DA8 /end MEASUREMENT
/begin MEASUREMENT InjCrv_facMIPDynCor_mp "Korrekturfaktor abhängig vom Raildruck" SWORD Fact 1 100 -4.000000 3.999878 FORMAT "%8.6" ECU_ADDRESS 0x8FF1E0 /end MEASUREMENT
/begin MEASUREMENT InjCrv_numInjDes_mp "gewünschte Anzahl an Einspritzungen pro Arbeitsspiel" UBYTE OneToOne 1 100 0.00 255.0 FORMAT "%5.1" ECU_ADDRESS 0x8FF1B0 /end MEASUREMENT
/begin MEASUREMENT InjCrv_numInjLim_mp "Erlaubte Anzahl an Einspritzungen" UBYTE OneToOne 1 100 0.00 255.0 FORMAT "%5.1" ECU_ADDRESS 0x8FF1B1 /end MEASUREMENT
/begin MEASUREMENT InjCrv_numInjMaxSys "Systembedingte maximal erlaubte Anzahl an Einspritzungen" UBYTE OneToOne 1 100 0.00 255.0 FORMAT "%5.1" ECU_ADDRESS 0x7F88ED /end MEASUREMENT
/begin MEASUREMENT InjCrv_phiMI1AddCor "Korrekturwinkel für Ansteuerbeginn MI1 in Abhängigkeit kundenspezifischer Funktionen" SWORD AngleCrS 1 100 -768.0000 767.9766 FORMAT "%8.4" ECU_ADDRESS 0x7F8DF2 /end MEASUREMENT
/begin MEASUREMENT InjCrv_phiMI1AddCor2 "kundenspezifischer Korrekturwinkel für die MI bei aktiver PiI2" SWORD AngleCrS 1 100 -768.0000 767.9766 FORMAT "%8.4" ECU_ADDRESS 0x7F8DF4 /end MEASUREMENT
/begin MEASUREMENT InjCrv_phiMI1DynCor1_mp "MI SOE customer correction 1" SWORD AngleCrS 1 100 -768.0000 767.9766 FORMAT "%8.4" ECU_ADDRESS 0x8FF1E2 /end MEASUREMENT
/begin MEASUREMENT InjCrv_phiMI1DynCor2Bas_mp "MI SOE customer correction II, base value" SWORD AngleCrS 1 100 -768.0000 767.9766 FORMAT "%8.4" ECU_ADDRESS 0x8FF1E4 /end MEASUREMENT
/begin MEASUREMENT InjCrv_phiMI1DynCor2_mp "MI SOE customer correction II" SWORD AngleCrS 1 100 -768.0000 767.9766 FORMAT "%8.4" ECU_ADDRESS 0x8FF1E6 /end MEASUREMENT
/begin MEASUREMENT InjCrv_phiMIAPSDynCor_mp "Korrekturwert für Ansteuerbeginn der Haupteinspritzung" SWORD AngleCrS 1 100 -768.0000 767.9766 FORMAT "%8.4" ECU_ADDRESS 0x8FF1E8 /end MEASUREMENT
/begin MEASUREMENT InjCrv_phiMIDynCor_mp "Korrekturwert für Ansteuerbeginn der Haupteinspritzung" SWORD AngleCrS 1 100 -768.0000 767.9766 FORMAT "%8.4" ECU_ADDRESS 0x8FF1EA /end MEASUREMENT
/begin MEASUREMENT InjCrv_phiMIPDynCor_mp "Korrekturwert für Ansteuerbeginn der Haupteinspritzung" SWORD AngleCrS 1 100 -768.0000 767.9766 FORMAT "%8.4" ECU_ADDRESS 0x8FF1EC /end MEASUREMENT
/begin MEASUREMENT InjCrv_pMIDynCor_mp "begrenzte Raildruckdifferenz" SWORD Pres_Rail 1 100 -3276.800 3276.700 FORMAT "%5.3" ECU_ADDRESS 0x8FF1EE /end MEASUREMENT
/begin MEASUREMENT InjCrv_PoI2RgnVal "Aktivierungswert für die Freigabe der PoI2 über das Abgasnachbehandlungssystem" ULONG EGTSwt 1 100 0.00 262.143999939 FORMAT "%13.9" ECU_ADDRESS 0x7F915C /end MEASUREMENT
/begin MEASUREMENT InjCrv_PoI2RgnValTSync "Aktivierungswert für die Freigabe der PoI2 über das Abgasnachbehandlungssystem (t sync)" ULONG EGTSwt 1 100 0.00 262.143999939 FORMAT "%13.9" ECU_ADDRESS 0x7F9160 /end MEASUREMENT
/begin MEASUREMENT InjCrv_qLmbdCtl "Lambdakontrollmenge" SWORD InjMassCyc 1 100 -327.6800 327.6700 FORMAT "%8.4" ECU_ADDRESS 0x7F8E2A /end MEASUREMENT
/begin MEASUREMENT InjCrv_qTot "Gesamteinspritzmenge" SWORD InjMassCyc 1 100 -327.6800 327.6700 FORMAT "%8.4" ECU_ADDRESS 0x7F8E5A /end MEASUREMENT
/begin MEASUREMENT InjCrv_stInjCharActVal "Einspritzverlauf aktueller Wert" UBYTE OneToOne 1 100 0.00 255.0 FORMAT "%5.1" ECU_ADDRESS 0x7F88EE /end MEASUREMENT
/begin MEASUREMENT InjCrv_stInjCharDes_mp "Wunscheinspritzverlauf" UBYTE OneToOne 1 100 0.00 255.0 FORMAT "%5.1" ECU_ADDRESS 0x8FF1B2 /end MEASUREMENT
/begin MEASUREMENT InjCrv_stInjCharPrio "Prioritätenstatus zur Abschaltung der Einspritzung" ULONG OneToOne 1 100 0.00 4294967295.00 FORMAT "%13.2" ECU_ADDRESS 0x7F9164 /end MEASUREMENT
/begin MEASUREMENT InjCrv_stInjCharPrioTSync "Prioritätenstatus zur Abschaltung von Einspritzungen (t sync)" ULONG OneToOne 1 100 0.00 4294967295.00 FORMAT "%13.2" ECU_ADDRESS 0x7F9168 /end MEASUREMENT
/begin MEASUREMENT InjCrv_stInjCharSetVal "Einspritzverlauf Sollwert (drehzahlsynchron)" UBYTE OneToOne 1 100 0.00 255.0 FORMAT "%5.1" ECU_ADDRESS 0x7F88EF /end MEASUREMENT
/begin MEASUREMENT InjCrv_stInjCharSetValTSync "Einspritzverlauf Sollwert (zeitsynchron)" UBYTE OneToOne 1 100 0.00 255.0 FORMAT "%5.1" ECU_ADDRESS 0x7F88F0 /end MEASUREMENT
/begin MEASUREMENT InjCrv_stInjCharSetVal_mp "Messpunkt vor dem Ascet Freischnitt" UBYTE OneToOne 1 100 0.00 255.0 FORMAT "%5.1" ECU_ADDRESS 0x8FF1B3 /end MEASUREMENT
/begin MEASUREMENT InjCrv_stLmbdCtl "Freigabestatus Lambdakontrollmenge" UBYTE OneToOne 1 100 0.00 255.0 FORMAT "%5.1" ECU_ADDRESS 0x7F88F1 /end MEASUREMENT
/begin MEASUREMENT InjCrv_stPiI2RlsAirP_mp "Freigabezustand der ansaugluftdruckabhängigen Voreinspritzung 2" UBYTE OneToOne 1 100 0.00 255.0 FORMAT "%5.1" ECU_ADDRESS 0x8FF1B8 /end MEASUREMENT
/begin MEASUREMENT InjCrv_stPiI2RlsAirTBit_mp "Freigabezustand der ansauglufttemperaturabhängigen Voreinspritzung 2" UBYTE OneToOne 1 100 0.00 255.0 FORMAT "%5.1" ECU_ADDRESS 0x8FF1B9 /end MEASUREMENT
/begin MEASUREMENT InjCrv_stPiI2RlsAirT_mp "status of Piot injection 2 release based on Intake air temperature" UBYTE OneToOne 1 100 0.00 255.0 FORMAT "%5.1" ECU_ADDRESS 0x8FF1BA /end MEASUREMENT
/begin MEASUREMENT InjCrv_stPiI2RlsOpRng6Bit_mp "aktueller Betriebspunkt zur Freigabe von Voreinspritzungszuständen" UBYTE OneToOne 1 100 0.00 255.0 FORMAT "%5.1" ECU_ADDRESS 0x8FF1BE /end MEASUREMENT
/begin MEASUREMENT InjCrv_stPiI2RlsQRaw_mp "Freigabezustand der rohmengenabhängigen Voreinspritzung 2" UBYTE OneToOne 1 100 0.00 255.0 FORMAT "%5.1" ECU_ADDRESS 0x8FF1BB /end MEASUREMENT
/begin MEASUREMENT InjCrv_stPiIRlsCor_mp "Freigabestruktur der Voreinspritzung nach Korrekturen" SWORD OneToOne 1 100 -32768.00 32767.00 FORMAT "%8.2" ECU_ADDRESS 0x8FF1C0 /end MEASUREMENT
/begin MEASUREMENT InjCrv_stPiIRlsOpRng6_mp "Current operation point for release of pilot injections" UBYTE OneToOne 1 100 0.00 255.0 FORMAT "%5.1" ECU_ADDRESS 0x8FF1C2 /end MEASUREMENT
/begin MEASUREMENT InjCrv_stPiIRlsOpRng_mp "aktueller Betriebsbereich für die Freigabe der Voreinspritzungen" UBYTE OneToOne 1 100 0.00 255.0 FORMAT "%5.1" ECU_ADDRESS 0x8FF1C3 /end MEASUREMENT
/begin MEASUREMENT InjCrv_stPiIRlsRaw_mp "Freigabestruktur der Voreinspritzung vor zusätzlichen Korrekturen" SWORD OneToOne 1 100 -32768.00 32767.00 FORMAT "%8.2" ECU_ADDRESS 0x8FF1B4 /end MEASUREMENT
/begin MEASUREMENT InjCrv_stPiIRlsStructRaw_mp "gewünschte Freigabekombination der Voreinspritzungen" SWORD OneToOne 1 100 -32768.00 32767.00 FORMAT "%8.2" ECU_ADDRESS 0x8FF1BC /end MEASUREMENT
/begin MEASUREMENT InjCrv_stPiIRlsStruct_mp "Freigabestruktur der Voreinspritzungen" UBYTE OneToOne 1 100 0.00 255.0 FORMAT "%5.1" ECU_ADDRESS 0x8FF1B6 /end MEASUREMENT
/begin MEASUREMENT InjCrv_swtPiIDblCorMap "Berechnung der kundenspezifischen und der Umgebungskorrekturen für PiI und MI auf der Basis eines doppelten Kennfeldsatzes" UBYTE OneToOne 1 100 0.00 255.0 FORMAT "%5.1" ECU_ADDRESS 0x7F88F3 /end MEASUREMENT
/begin MEASUREMENT InjCrv_tEng "selektierte Motortemperatur für das Einspritzsystem" SWORD Temp_Cels 1 100 -50.140 899.860 FORMAT "%8.3" ECU_ADDRESS 0x7F8E5C /end MEASUREMENT
/begin MEASUREMENT InjCrv_tiDQPT1AddCor2_mp "dq PT1 filter const. in MI SOE correction II" ULONG TimeDelay_s 1 100 0.0000010000000 4294.9673 FORMAT "%9.4" ECU_ADDRESS 0x8FF1F0 /end MEASUREMENT
/begin FUNCTION frmmng_var_msg ""
 /begin OUT_MEASUREMENT FrmMng_aDirect FrmMng_aSide FrmMng_ctACC_TrqAlv FrmMng_ctrRel FrmMng_ctSTAT_KOMBIalv FrmMng_dACC_CkSTrq FrmMng_dphiStrg FrmMng_dSlopeACP FrmMng_iHiLimCurr FrmMng_iLoLimCurr FrmMng_iZrCurrLim FrmMng_lSum FrmMng_nBattCls FrmMng_nEngRpm1 FrmMng_nEngRpm2 FrmMng_nFan FrmMng_nLimSSG FrmMng_nRqStgEFan FrmMng_nTSC FrmMng_numACFanDes FrmMng_numRqStgEFan FrmMng_parkConsumerFunctionID FrmMng_parkConsumerID2 FrmMng_phiStrg FrmMng_rHtFlowReq FrmMng_stACCTrqCtl FrmMng_stACC_ModDME FrmMng_stACC_PrevOvrRunSwtDem FrmMng_stACC_ShtDwnDME FrmMng_stACC_TrqDes FrmMng_stACmainSwt FrmMng_stACnMin FrmMng_stARS FrmMng_stAVAI_BOS_RSTG FrmMng_stBltbDr FrmMng_stBOS_RESETSig FrmMng_stBOS_RESET_2Sig FrmMng_stClCtr FrmMng_stCltSSG FrmMng_stConv FrmMng_stCOU_RSTG_BOS_RSTG FrmMng_stCrCtlRaw FrmMng_stDateDay FrmMng_stDateMon FrmMng_stDateSeason FrmMng_stDateYr FrmMng_stDecellDSC FrmMng_stDM_ANF_AFSSig FrmMng_stDREHMOMENT_ANF_ACCSig FrmMng_stDRMANFSSGSig FrmMng_stDSCDef FrmMng_stErrAFS FrmMng_stErrStrg FrmMng_stFDC FrmMng_stGbx FrmMng_stGear FrmMng_stGEARBX_DATA2Sig FrmMng_stGEARBX_DATASig FrmMng_stHEAT_ACSig FrmMng_stId2BosRst FrmMng_stId2RqStgEFan FrmMng_stID2_BOS_RSTG FrmMng_stIdFktBosRst FrmMng_stIdFnRqStgEFan FrmMng_stIdlingSpec FrmMng_stID_FN_BOS_RSTG FrmMng_stInjDu FrmMng_stKeyVld FrmMng_stLENKRADWINKELSig FrmMng_stMILEAGE_RANGESig FrmMng_stOPCRCTLACCSig FrmMng_stParkConsumer FrmMng_stParkConsumerSig FrmMng_stPHtr FrmMng_stPrgIntTimeBosRst FrmMng_stPrgIntWayBosRst FrmMng_stPWRMNG_LOADVSig FrmMng_stRecACC FrmMng_stRecAFS FrmMng_stRecARS FrmMng_stRecFDC FrmMng_stRecFGR FrmMng_stRMMI_BOS_RSTG FrmMng_stRQ_STG_EFANSig FrmMng_stShpsSSG FrmMng_stShpsSSGOld FrmMng_stShutOffSSG FrmMng_stSITZGURTSig FrmMng_stSTAT_ANHSig FrmMng_stSTAT_ARSSig FrmMng_stSTAT_DSCSig FrmMng_stSTAT_EKPSig FrmMng_stSTAT_KOMBISig FrmMng_stT15 FrmMng_stT50 FrmMng_stTEMPRELTIMESig FrmMng_stTERMINALSig FrmMng_stTgMonthBosRst FrmMng_stTgYearBosRst FrmMng_stTIME_DATESig FrmMng_stTorqTarAFS FrmMng_stTORQUE_DSCSig FrmMng_stTORQUE_GEARBXSig FrmMng_stTRadio FrmMng_stTrailer FrmMng_stTrqDesDSC FrmMng_stTrqDesGearbx FrmMng_stTrqLimGearbx FrmMng_stUnitV FrmMng_stVCom FrmMng_stVEH_MODSig FrmMng_stVELOCITYSig FrmMng_stWghSeatDr FrmMng_swtPSPOff FrmMng_tOil FrmMng_trqAC FrmMng_trqACC_TrqDes FrmMng_trqARSCur FrmMng_trqARSDes FrmMng_trqARSInc FrmMng_trqAvlAFS FrmMng_trqDSCDec FrmMng_trqDSCDes FrmMng_trqDSCInc FrmMng_trqGearbxDec FrmMng_trqGearbxDes FrmMng_trqGearbxFrc FrmMng_trqGearbxInc FrmMng_trqGearbxMax FrmMng_trqInr FrmMng_trqTarAFS FrmMng_uAltTarget FrmMng_v FrmMng_vDirection FrmMng_vDisp FrmMng_volFuelFil FrmMng_vWheelLB FrmMng_vWheelLF FrmMng_vWheelRB FrmMng_vWheelRF /end OUT_MEASUREMENT
/end FUNCTION
/begin FUNCTION ftscd "Kraftstofftemperatur Komponententreiber"
 /begin DEF_CHARACTERISTIC FTSCD_uSRCMin_C FTSCD_uSRCMax_C FTSCD_tLin_CUR FTSCD_DebSRCHighDef_C FTSCD_DebSRCHighOk_C FTSCD_DebSRCLowDef_C FTSCD_DebSRCLowOk_C FTSCD_numAdc_C FTSCD_dtRmpSlpUp_C FTSCD_dtRmpSlpDwn_C FTSCD_stSensIDWord_C FTSCD_tDfl_C /end DEF_CHARACTERISTIC
 /begin IN_MEASUREMENT FTSCD_uRaw /end IN_MEASUREMENT
/end FUNCTION
/begin FUNCTION ftscd_msg "" /begin OUT_MEASUREMENT FTSCD_tFuel FTSCD_tFuelLin FTSCD_uRaw /end OUT_MEASUREMENT /end FUNCTION
/begin FUNCTION gearbx_data "Getriebeinformation" /begin DEF_CHARACTERISTIC Gearbx_swtTypeVal_C Gearbx_swtTypeType_C /end DEF_CHARACTERISTIC /end FUNCTION
/begin FUNCTION gearbx_data_msg "" /begin OUT_MEASUREMENT Gearbx_tOil /end OUT_MEASUREMENT /end FUNCTION
/begin FUNCTION gearbx_data_uic "" /end FUNCTION
/begin FUNCTION gearbx_geardet "Gangerkennung"
 /begin DEF_CHARACTERISTIC Gearbx_numGearDfl_C Gearbx_numWinG0_C Gearbx_numWinG1_C Gearbx_numWinG2_C Gearbx_numWinG3_C Gearbx_numWinG4_C Gearbx_numWinG5_C Gearbx_numWinG6_C Gearbx_numWinG7_C Gearbx_numWinGR_C Gearbx_rTrans1_C Gearbx_rTrans2_C Gearbx_rTrans3_C Gearbx_rTrans4_C Gearbx_rTrans5_C Gearbx_rTrans6_C Gearbx_rTransR_C Gearbx_rVn0ToR_C Gearbx_rVn1H_C Gearbx_rVn1L_C Gearbx_rVn1To2_C Gearbx_rVn2H_C Gearbx_rVn2L_C Gearbx_rVn2To3_C Gearbx_rVn3H_C Gearbx_rVn3L_C Gearbx_rVn3To4_C Gearbx_rVn4H_C Gearbx_rVn4L_C Gearbx_rVn4To5_C Gearbx_rVn5H_C Gearbx_rVn5L_C Gearbx_rVn5To6_C Gearbx_rVn6H_C Gearbx_rVn6L_C Gearbx_rVn6To7_C Gearbx_rVnRH_C Gearbx_rVnRL_C Gearbx_rVnRTo1_C Gearbx_stTypeSelCAN_C Gearbx_swtErrRea_C /end DEF_CHARACTERISTIC
/end FUNCTION
/begin FUNCTION gearbx_geardet_uic "" /end FUNCTION
/begin FUNCTION gearbx_getnmin "Berechnung der Leerlaufsolldrehzahlanforderung vom Getriebe"
 /begin DEF_CHARACTERISTIC Gearbx_dnNMinRmpUp_C Gearbx_dnNMinRmpDwn_C Gearbx_nMinFDC_MAP Gearbx_nMin_MAP /end DEF_CHARACTERISTIC
 /begin IN_MEASUREMENT FrmMng_nTSC Gearbx_stGear /end IN_MEASUREMENT
/end FUNCTION
/begin FUNCTION gearbx_getnmin_uic "" /begin OUT_MEASUREMENT Gearbx_nMinRaw_mp /end OUT_MEASUREMENT /end FUNCTION
/begin FUNCTION gearbx_intvplauschk "Momentenüberschussintegral"
 /begin DEF_CHARACTERISTIC Gearbx_amMax_C Gearbx_swtUnplausChk_C Gearbx_tiDebMaxOk_C Gearbx_tiDebMaxDef_C /end DEF_CHARACTERISTIC
/end FUNCTION
/begin FUNCTION gearbx_intvplauschk_msg "" /begin OUT_MEASUREMENT Gearbx_stDemUnplaus /end OUT_MEASUREMENT /end FUNCTION
/begin FUNCTION gearbx_intvplauschk_uic "" /begin OUT_MEASUREMENT Gearbx_amAct_mp Gearbx_stGbxIncMax_mp Gearbx_trqInt_mp /end OUT_MEASUREMENT /end FUNCTION
/begin FUNCTION gearbx_msg ""
 /begin OUT_MEASUREMENT Gearbx_nMin Gearbx_numGearDes Gearbx_numGearFast Gearbx_rTrans Gearbx_stGear Gearbx_stGearBit Gearbx_swtType Gearbx_trqDec Gearbx_trqFrc Gearbx_trqInc Gearbx_trqInMax /end OUT_MEASUREMENT
/end FUNCTION
/begin FUNCTION gearbx_strtmotrls "" /end FUNCTION
/begin FUNCTION gearbx_strtmotrls_msg "" /begin OUT_MEASUREMENT Gearbx_stStrtMotRls /end OUT_MEASUREMENT /end FUNCTION
/begin FUNCTION gearbx_strtmotrls_uic "" /end FUNCTION
/begin FUNCTION gearbx_trqfrc "aktuelles Verlustmoment Getriebe" /end FUNCTION
/begin FUNCTION gearbx_trqfrc_uic "" /end FUNCTION
/begin FUNCTION gearbx_trqintv "Getriebeeingriff auf Motormoment"
 /begin DEF_CHARACTERISTIC Gearbx_trqDecMax_C Gearbx_trqDecMax_CUR Gearbx_dtrqLimUptrqDec_C Gearbx_dtrqLimDwntrqDec_C Gearbx_trqIncMax_C Gearbx_trqIncMin_C Gearbx_dtrqLimUptrqInc_C Gearbx_dtrqLimDwntrqInc_C Gearbx_vTrqIntvVSSCDlim_C /end DEF_CHARACTERISTIC
 /begin IN_MEASUREMENT Eng_nAvrg /end IN_MEASUREMENT
/end FUNCTION
/begin FUNCTION gearbx_trqintv_uic "" /begin OUT_MEASUREMENT Gearbx_stIntv_mp Gearbx_trqDecRaw_mp Gearbx_trqIncRaw_mp /end OUT_MEASUREMENT /end FUNCTION
/begin FUNCTION gearbx_trqlim "Getriebeschutz"
 /begin DEF_CHARACTERISTIC Gearbx_dtrqLimUp_C Gearbx_dtrqRmpUp_C Gearbx_dtrqRmpDwn_C Gearbx_facLimUp_CUR Gearbx_swtDrvAway_C Gearbx_trqInMax_CUR Gearbx_trqMaxErr2_CUR Gearbx_trqMaxErr_CUR Gearbx_trqMaxGear1_CUR Gearbx_trqMaxGear2_CUR Gearbx_trqMaxGear3_CUR Gearbx_trqMaxGear4_CUR Gearbx_trqMaxGear5_CUR Gearbx_trqMaxGear6_CUR Gearbx_trqMaxGearR_CUR Gearbx_vTrqLim_C /end DEF_CHARACTERISTIC
 /begin IN_MEASUREMENT Eng_nAvrg VSSCD_v /end IN_MEASUREMENT
/end FUNCTION
/begin FUNCTION gearbx_trqlim_uic "" /begin DEF_CHARACTERISTIC Gearbx_trqInMax_Vector Gearbx_trqInMax_Channel /end DEF_CHARACTERISTIC
 /begin OUT_MEASUREMENT Gearbx_dtrqLimUp_mp Gearbx_stDrvAway_mp Gearbx_trqLimDrvAway_mp Gearbx_trqMaxCur_mp /end OUT_MEASUREMENT
/end FUNCTION
/begin FUNCTION gearcd_pn "Getriebe PN-Stellungserkennung"
 /begin DEF_CHARACTERISTIC GearCD_tiDebNeg_C GearCD_tiDebPos_C GearCD_numDioIn_C GearCD_stPNDflVal_C GearCD_stPNInv_C GearCD_swtPNSigVal_C /end DEF_CHARACTERISTIC
/end FUNCTION
/begin FUNCTION gearcd_pn_msg "" /begin OUT_MEASUREMENT GearCD_stPN GearCD_stPNRawVal GearCD_swtPNSig /end OUT_MEASUREMENT /end FUNCTION
/begin FUNCTION gearcd_pn_uic "" /begin OUT_MEASUREMENT GearCD_stPNCon_mp /end OUT_MEASUREMENT /end FUNCTION
/begin FUNCTION glwcd "Komponententreiber Glühanlage"
 /begin DEF_CHARACTERISTIC GlwCD_rBoostMax_C GlwCD_rInterMax_C GlwCD_tiDebCircExTDefect_C GlwCD_tiDebCircExTOk_C GlwCD_tiDebCircGndDefect_C GlwCD_tiDebCircGndOk_C GlwCD_tiDebCircNLDefect_C GlwCD_tiDebCircNLOk_C GlwCD_tiDebCommDefect_C GlwCD_tiDebCommOk_C GlwCD_tiReset_C /end DEF_CHARACTERISTIC
/end FUNCTION
/begin FUNCTION glwcd_msg "" /begin OUT_MEASUREMENT GlwCD_pwrGlw /end OUT_MEASUREMENT /end FUNCTION
/begin FUNCTION glwcd_uic ""
 /begin OUT_MEASUREMENT GlwCD_BufLev_mp GlwCD_CtlState_mp GlwCD_ErrBank1_mp GlwCD_ErrPwr_mp GlwCD_OtherReg_mp GlwCD_Parity_mp GlwCD_RawVal_mp GlwCD_Reset_mp GlwCD_stCtl_mp GlwCD_stState_mp /end OUT_MEASUREMENT
/end FUNCTION
/begin FUNCTION glwctl_glwun "Steuerung für Glühsteuergerät"
 /begin DEF_CHARACTERISTIC GlwCtl_rLimitClnt_CUR GlwCtl_rLimitNM_MAP GlwCtl_rMaxOff_C GlwCtl_rMaxStdby_C GlwCtl_rMax_C GlwCtl_rPwrClnt_CUR GlwCtl_rPwrNM_MAP GlwCtl_rPwrPAir_CUR GlwCtl_rPwrTAir_CUR GlwCtl_rStart_CUR GlwCtl_rThresOff_C GlwCtl_rThresOn_C GlwCtl_tiMaxOn_C GlwCtl_tiStdby_C /end DEF_CHARACTERISTIC
 /begin IN_MEASUREMENT APSCD_pVal CoEng_trqInrCurr Eng_nAvrg GlwCtl_tClnt IATSCD_tAir /end IN_MEASUREMENT
/end FUNCTION
/begin FUNCTION glwctl_glwun_msg "" /begin OUT_MEASUREMENT GlwCtl_rPwrOut /end OUT_MEASUREMENT /end FUNCTION
/begin FUNCTION glwctl_glwun_uic "" /begin OUT_MEASUREMENT GlwCtl_rLimitRaw_mp GlwCtl_rLimit_mp GlwCtl_rRaw_mp /end OUT_MEASUREMENT /end FUNCTION
/begin FUNCTION glwctl_logic "Glühzeitkontrolle"
 /begin DEF_CHARACTERISTIC GlwCtl_ctPreGlwErr_C GlwCtl_ctPreGlw_C GlwCtl_nPre_C GlwCtl_stHdnPreGlwMsk1_C GlwCtl_stHdnPreGlwMsk2_C GlwCtl_stHdnPreGlwMskT1_C GlwCtl_stLampEnaMsk_C GlwCtl_tDflClnt_C GlwCtl_tLimLow_C GlwCtl_tLimHigh_C GlwCtl_stLimLow_C GlwCtl_stLimHigh_C GlwCtl_tiDebConvSig_C GlwCtl_tiDebPre_C GlwCtl_tiNoEngSpd_C GlwCtl_tiPre_CUR GlwCtl_tiReady_C GlwCtl_tiStrt_C GlwCtl_tiWaitforTemp_C GlwCtl_tStrt_C /end DEF_CHARACTERISTIC
 /begin IN_MEASUREMENT GlwCtl_tClnt /end IN_MEASUREMENT
/end FUNCTION
/begin FUNCTION glwctl_logic_msg "" /begin OUT_MEASUREMENT GlwCtl_stLampEna GlwCtl_stLogic GlwCtl_tClnt /end OUT_MEASUREMENT /end FUNCTION
/begin FUNCTION glwctl_logic_uic ""
 /begin OUT_MEASUREMENT GlwCtl_ctPreGlw_mp GlwCtl_stHdnPreGlwOld_mp GlwCtl_stHdnPreGlwTrg_mp GlwCtl_stHdnPreGlw_mp GlwCtl_stLogicCond_mp GlwCtl_stStrtMFlag_mp GlwCtl_tiPre_mp /end OUT_MEASUREMENT
/end FUNCTION
/begin FUNCTION glwctl_rly "Steuerung für Glührelais"
 /begin DEF_CHARACTERISTIC GlwCtl_nLamp_C GlwCtl_tiLampBase_CUR GlwCtl_tiLampEng_C GlwCtl_tiLampPAir_CUR GlwCtl_tiLampUBatt_CUR GlwCtl_tiPSync_C /end DEF_CHARACTERISTIC
 /begin IN_MEASUREMENT BattCD_u GlwCtl_tClnt /end IN_MEASUREMENT
/end FUNCTION
/begin FUNCTION glwctl_rly_msg "" /begin OUT_MEASUREMENT GlwCtl_stLampOut /end OUT_MEASUREMENT /end FUNCTION
/begin FUNCTION glwctl_rly_uic "" /begin OUT_MEASUREMENT GlwCtl_stLampCond_mp GlwCtl_tiLamp_mp /end OUT_MEASUREMENT /end FUNCTION
/begin FUNCTION hpun_co "Hochdruckpumpe"
 /begin DEF_CHARACTERISTIC HPUn_dvolMeUnMax_C HPUn_etaPmpFlTemp_CUR HPUn_etaPmpMaxAged_CUR HPUn_etaPmpMech_C HPUn_nMin_C HPUn_qBalLim_CUR HPUn_qFlTempLim_MAP HPUn_rTransCrS_C HPUn_volPmp_C /end DEF_CHARACTERISTIC
 /begin IN_MEASUREMENT Eng_nAvrg FlSys_t FTSCD_tFuel /end IN_MEASUREMENT
/end FUNCTION
/begin FUNCTION hpun_co_msg "" /begin OUT_MEASUREMENT HPUn_numInjQntBal HPUn_qLim HPUn_trqDes /end OUT_MEASUREMENT /end FUNCTION
/begin FUNCTION hpun_co_uic ""
 /begin OUT_MEASUREMENT HPUn_dvolPmpMaxCor_mp HPUn_dvolPmpMax_mp HPUn_etaPmpFlTemp_mp HPUn_etaPmpMaxAged_mp HPUn_qBalLim_mp HPUn_qFlTempLim_mp HPUn_stQntBal_mp /end OUT_MEASUREMENT
/end FUNCTION
/begin FUNCTION hpun_qntbalinjlim "maximale Anzahl an Einspritzungen aufgrund der Mengenbilanz der Hochdruckpumpe"
 /begin DEF_CHARACTERISTIC HPUn_numInjMin_C HPUn_pRailDvtOk_C HPUn_tiPresDvtFlt_C HPUn_tiQntBalDel_C /end DEF_CHARACTERISTIC
/end FUNCTION
/begin FUNCTION hpun_qntbalinjlim_uic "" /begin OUT_MEASUREMENT HPUn_pRailDvtFlt_mp HPUn_stNumInjMax_mp /end OUT_MEASUREMENT /end FUNCTION
/begin FUNCTION hwemon "Monitoring of Hardware Encapsulation Functions"
 /begin DEF_CHARACTERISTIC HWEMon_DebComStepDown_C HWEMon_DebComStepUp_C HWEMon_DebComDef_C HWEMon_DebComOk_C HWEMon_nThres_C HWEMon_numTrigRecovery_C /end DEF_CHARACTERISTIC
/end FUNCTION
/begin FUNCTION hwemon_msg "" /begin OUT_MEASUREMENT HWEMon_ctRecovery HWEMon_numRecovery /end OUT_MEASUREMENT /end FUNCTION
/begin FUNCTION hwemon_uic ""
 /begin OUT_MEASUREMENT HWEMon_recLocHigh_mp HWEMon_recLocLow_mp HWEMon_stVoltMon_mp /end OUT_MEASUREMENT
/end FUNCTION
/begin FUNCTION iatscd "Lufttemperaturfühler Komponententreiber"
 /begin DEF_CHARACTERISTIC IATSCD_uSRCMin_C IATSCD_uSRCMax_C IATSCD_tLin_CUR IATSCD_DebSigDef_C IATSCD_DebSigOk_C IATSCD_DebSRCHighDef_C IATSCD_DebSRCHighOk_C IATSCD_DebSRCLowDef_C IATSCD_DebSRCLowOk_C IATSCD_numAdc_C IATSCD_dtRmpSlpUp_C IATSCD_dtRmpSlpDwn_C IATSCD_swtSigVal_C IATSCD_swtT10Src_C IATSCD_stSensIDWord_C IATSCD_tDfl_C /end DEF_CHARACTERISTIC
 /begin IN_MEASUREMENT IATSCD_uRaw /end IN_MEASUREMENT
/end FUNCTION
/begin FUNCTION iatscd_cats ""
 /begin DEF_CHARACTERISTIC IATSCD_uSRCMinCats_C IATSCD_uSRCMaxCats_C IATSCD_tLinCats_CUR IATSCD_DebSigDefCats_C IATSCD_DebSigOkCats_C IATSCD_DebSRCHighDefCats_C IATSCD_DebSRCHighOkCats_C IATSCD_DebSRCLowDefCats_C IATSCD_DebSRCLowOkCats_C IATSCD_numAdcCats_C IATSCD_dtRmpSlpUpCats_C IATSCD_dtRmpSlpDwnCats_C IATSCD_swtSigValCats_C IATSCD_stSensIDWordCats_C IATSCD_tDflCats_C /end DEF_CHARACTERISTIC
 /begin IN_MEASUREMENT IATSCD_uRawCats /end IN_MEASUREMENT
/end FUNCTION
/begin FUNCTION iatscd_cats_msg ""
 /begin OUT_MEASUREMENT IATSCD_dtAirCats IATSCD_swtSigCats IATSCD_tAirCats IATSCD_tAirLinCats IATSCD_uRawCats /end OUT_MEASUREMENT
/end FUNCTION
/begin FUNCTION iatscd_cats_uic "" /end FUNCTION
/begin FUNCTION iatscd_cats_var_msg "" /end FUNCTION
/begin FUNCTION iatscd_msg ""
 /begin OUT_MEASUREMENT IATSCD_dtAir IATSCD_swtSig IATSCD_tAir IATSCD_tAirLin IATSCD_uRaw /end OUT_MEASUREMENT
/end FUNCTION
/begin FUNCTION iatscd_uic "" /end FUNCTION
/begin FUNCTION iatscd_var_msg "" /end FUNCTION
/begin FUNCTION ibscd "" /begin DEF_CHARACTERISTIC IBSCD_tiWaitDetection_C /end DEF_CHARACTERISTIC /end FUNCTION
/begin FUNCTION ibscd_ht "" /begin DEF_CHARACTERISTIC IBSCD_tiReset_C /end DEF_CHARACTERISTIC /end FUNCTION
/begin FUNCTION ibscd_ht_uic "" /begin OUT_MEASUREMENT IBSCD_BsdControl_mp IBSCD_stB_ibsactiv_mp /end OUT_MEASUREMENT /end FUNCTION
/begin FUNCTION ibscd_msg "" /end FUNCTION
/begin FUNCTION ibscd_uic "" /begin OUT_MEASUREMENT IBSCD_BsdData_mp IBSCD_BsdRegAdr_mp IBSCD_stB_ibsdetec_mp /end OUT_MEASUREMENT /end FUNCTION
/begin FUNCTION ignlck "Zündschloss" /end FUNCTION
/begin FUNCTION ignlck_msg "" /begin OUT_MEASUREMENT IgnLck_st /end OUT_MEASUREMENT /end FUNCTION
/begin FUNCTION ignlck_uic "" /end FUNCTION
/begin FUNCTION immcd "Immobilizer component driver" /begin DEF_CHARACTERISTIC /end DEF_CHARACTERISTIC /end FUNCTION
/begin FUNCTION immcd_msg "" /begin OUT_MEASUREMENT /end OUT_MEASUREMENT /end FUNCTION
/begin FUNCTION immcd_uic "" /end FUNCTION
/begin FUNCTION immctl "Steuerung Wegfahrsperre" /begin DEF_CHARACTERISTIC /end DEF_CHARACTERISTIC /end FUNCTION
/begin FUNCTION immctl_msg "" /begin OUT_MEASUREMENT ImmCtl_stIniSeq /end OUT_MEASUREMENT /end FUNCTION
/begin FUNCTION immctl_uic "" /end FUNCTION
/begin FUNCTION immeep_eval "" /end FUNCTION
/begin FUNCTION immeep_eval_msg "" /begin OUT_MEASUREMENT /end OUT_MEASUREMENT /end FUNCTION
/begin FUNCTION immeep_eval_uic "" /begin OUT_MEASUREMENT /end OUT_MEASUREMENT /end FUNCTION
/begin FUNCTION indsys_bpatdefdet ""
 /begin DEF_CHARACTERISTIC IndSys_facDiffCorr_CUR IndSys_mAirPerCylLim_MAP IndSys_nAvrgMax_C IndSys_nAvrgMin_C IndSys_pAPDynCorr_CUR IndSys_pAPStatCorr_CUR IndSys_pDiffCorr_MAP IndSys_pDiffStat_MAP IndSys_pDynMin_CUR IndSys_qDiffStatMax_CUR IndSys_qDiffStatMin_CUR IndSys_qSetDynMax_CUR IndSys_qSetDynMin_CUR IndSys_qSetUnBalMax_C IndSys_qSetUnBalMin_C IndSys_tiDelayDef1_C IndSys_tiDelayDef2_C IndSys_tiDelayDef3_C IndSys_tiDelayOK1_C /end DEF_CHARACTERISTIC
 /begin IN_MEASUREMENT APSCD_pVal Eng_nAvrg Eng_tEng InjCtl_qSetUnBal /end IN_MEASUREMENT
/end FUNCTION
/begin FUNCTION indsys_bpatdefdet_uic ""
 /begin OUT_MEASUREMENT IndSys_mAirPerCylLim_mp IndSys_stPart1_mp IndSys_stPart2_mp /end OUT_MEASUREMENT
/end FUNCTION
/begin FUNCTION indsys_calcswirl "Drallniveausteuerung"
 /begin DEF_CHARACTERISTIC IndSys_facVSACTCor_CUR IndSys_rClsEGR_C IndSys_rVSAATCorr_CUR IndSys_rVSACTCor_MAP IndSys_rVSAMAX_C IndSys_rVSARgn_MAP IndSys_rVSA_MAP IndSys_stMskVSARgn_C IndSys_tiRmpSlpVSA_C IndSys_tiStartDelay_C /end DEF_CHARACTERISTIC
 /begin IN_MEASUREMENT CTSCD_tClnt Eng_nAvrg IATSCD_tAir InjCtl_qCurr InjCtl_qRaw /end IN_MEASUREMENT
/end FUNCTION
/begin FUNCTION indsys_calcswirl_uic ""
 /begin DEF_CHARACTERISTIC IndSys_rVSAAdd_Vector IndSys_rVSAAdd_Channel IndSys_rVSA_Vector IndSys_rVSA_Channel /end DEF_CHARACTERISTIC
 /begin OUT_MEASUREMENT IndSys_rVSAATCorr_mp IndSys_rVSABase_mp IndSys_rVSAByp_mp IndSys_rVSACorr_mp IndSys_rVSACTCorr_mp /end OUT_MEASUREMENT
/end FUNCTION
/begin FUNCTION indsys_msg "" /begin OUT_MEASUREMENT IndSys_rVSA /end OUT_MEASUREMENT /end FUNCTION
/begin FUNCTION indsys_tair_msg "" /begin OUT_MEASUREMENT IndSys_tFld /end OUT_MEASUREMENT /end FUNCTION
/begin FUNCTION indsys_tair_uic "" /end FUNCTION
/begin FUNCTION indsys_uic "" /end FUNCTION
/begin FUNCTION injcrv "Einspritzverlauf" /begin DEF_CHARACTERISTIC InjCrv_stInjDstSel_C InjCrv_tiPause_C /end DEF_CHARACTERISTIC /end FUNCTION
/begin FUNCTION injcrv_co "Spritzbeginn Sollwertbildung"
 /begin DEF_CHARACTERISTIC InjCrv_ctTempSel_C InjCrv_DebLimDef_C InjCrv_DebLimOk_C InjCrv_numInjMaxSys_C InjCrv_rPiIRlsEngSpdHys_C InjCrv_rPiIRlsQntHys_C InjCrv_stInjCharPrioRgn_C InjCrv_stInjCharPrio_C InjCrv_stPiIRlsOpRng1_MAP InjCrv_stPiIRlsOpRng2_MAP InjCrv_stPiIRlsOpRng3_MAP InjCrv_stPiIRlsOpRng4_MAP InjCrv_stPiIRlsOpRng5_MAP InjCrv_stPrioRgnMsk_C InjCrv_stRlsRgnMsk_C InjCrv_swtPiIDblCorMapVal_C InjCrv_swtPiIDblCorMapType_C /end DEF_CHARACTERISTIC
 /begin IN_MEASUREMENT Eng_nAvrg InjCtl_qSetUnBal /end IN_MEASUREMENT
/end FUNCTION
/begin FUNCTION injcrv_copiirlsaddcor ""
 /begin DEF_CHARACTERISTIC InjCrv_pPiI2RlsAirPXDelta_C InjCrv_pPiI2RlsAirXLo_C InjCrv_qRawDelta_C InjCrv_qRawLo_C InjCrv_tPiI2RlsAirTXDelta_C InjCrv_tPiI2RlsAirTXLo1_C InjCrv_tPiI2RlsAirTXLo2_C InjCrv_tPiI2RlsAirTXLo3_C InjCrv_tPiI2RlsAirTXLo4_C InjCrv_tPiI2RlsAirTXLo5_C InjCrv_tPiI2RlsAirTXLo6_C /end DEF_CHARACTERISTIC
/end FUNCTION
/begin FUNCTION injcrv_copiirlsaddcor_uic ""
 /begin OUT_MEASUREMENT InjCrv_stPiI2RlsAirP_mp InjCrv_stPiI2RlsAirTBit_mp InjCrv_stPiI2RlsAirT_mp InjCrv_stPiI2RlsQRaw_mp InjCrv_stPiIRlsStructRaw_mp /end OUT_MEASUREMENT
/end FUNCTION
/begin FUNCTION injcrv_copiirlscor ""
 /begin DEF_CHARACTERISTIC InjCrv_stPiI2RlsGearMax_C InjCrv_stPiI2RlsGearMin_C InjCrv_stPiIRlsOpRng6_MAP InjCrv_tPiI2RlsTAirXDelta_C InjCrv_tPiI2RlsTAirXLo1_C InjCrv_tPiI2RlsTAirXLo2_C InjCrv_tPiI2RlsTEngXDelta_C InjCrv_tPiI2RlsTEngXLo1_C InjCrv_tPiI2RlsTEngXLo2_C InjCrv_vPiI2RlsXDelta_C InjCrv_vPiI2RlsXLo123_C InjCrv_vPiI2RlsXLo4_C InjCrv_vPiI2RlsXLo5_C InjCrv_vPiI2RlsXLo6_C /end DEF_CHARACTERISTIC
 /begin IN_MEASUREMENT Eng_nAvrg InjCtl_qSetUnBal /end IN_MEASUREMENT
/end FUNCTION
/begin FUNCTION injcrv_copiirlscor_uic ""
 /begin OUT_MEASUREMENT InjCrv_stPiI2RlsOpRng6Bit_mp InjCrv_stPiIRlsCor_mp InjCrv_stPiIRlsOpRng6_mp /end OUT_MEASUREMENT
/end FUNCTION
/begin FUNCTION injcrv_copiirlsoprng ""
 /begin DEF_CHARACTERISTIC InjCrv_rOpRngATSHys_C InjCrv_rOpRngETSHys_C InjCrv_stRlsOpRngThresRgn_MAP InjCrv_stRlsOpRngThres_MAP /end DEF_CHARACTERISTIC
 /begin IN_MEASUREMENT IATSCD_tAir InjCrv_tEng /end IN_MEASUREMENT
/end FUNCTION
/begin FUNCTION injcrv_copiirlsoprng_uic "" /begin OUT_MEASUREMENT InjCrv_stPiIRlsOpRng_mp /end OUT_MEASUREMENT /end FUNCTION
/begin FUNCTION injcrv_co_msg ""
 /begin OUT_MEASUREMENT InjCrv_numInjMaxSys InjCrv_PoI2RgnVal InjCrv_PoI2RgnValTSync InjCrv_stInjCharActVal InjCrv_stInjCharPrio InjCrv_stInjCharPrioTSync InjCrv_stInjCharSetVal InjCrv_stInjCharSetValTSync InjCrv_swtPiIDblCorMap InjCrv_tEng /end OUT_MEASUREMENT
/end FUNCTION
/begin FUNCTION injcrv_co_uic ""
 /begin DEF_CHARACTERISTIC InjCrv_stInjCharSetVal_Vector InjCrv_stInjCharSetVal_Channel InjCrv_stPiIRlsBypass_Vector InjCrv_stPiIRlsBypass_Channel /end DEF_CHARACTERISTIC
 /begin OUT_MEASUREMENT InjCrv_numInjDes_mp InjCrv_numInjLim_mp InjCrv_stInjCharDes_mp InjCrv_stInjCharSetVal_mp InjCrv_stPiIRlsRaw_mp InjCrv_stPiIRlsStruct_mp /end OUT_MEASUREMENT
/end FUNCTION
/begin FUNCTION injcrv_ctlqnt "" /end FUNCTION
/begin FUNCTION injcrv_ctlqnt_msg "" /begin OUT_MEASUREMENT InjCrv_qLmbdCtl InjCrv_qTot InjCrv_stLmbdCtl /end OUT_MEASUREMENT /end FUNCTION
/begin FUNCTION injcrv_ctlqnt_uic "" /end FUNCTION
/begin FUNCTION injcrv_mi "Einspritzverlauf - Haupteinspritzung"
 /begin DEF_CHARACTERISTIC InjCrv_phiMI1Bas1CBFDC_MAP InjCrv_phiMI1Bas1CB_MAP InjCrv_phiMI1Bas1FDC_MAP InjCrv_phiMI1Bas1_MAP InjCrv_phiMI1Bas2CBFDC_MAP InjCrv_phiMI1Bas2CB_MAP InjCrv_phiMI1Bas2FDC_MAP InjCrv_phiMI1Bas2_MAP InjCrv_phiMI1Bas3_MAP InjCrv_phiMI1Bas4_MAP InjCrv_phiMI1Bas5_MAP InjCrv_phiMI1Max2_MAP InjCrv_phiMI1Max_MAP InjCrv_phiMI1Max_X_AXIS InjCrv_phiMI1Max_Y_AXIS InjCrv_phiMI1Min_CUR InjCrv_qMI1Cor_MAP InjCrv_stMI1RgnDelMsk_C /end DEF_CHARACTERISTIC
 /begin IN_MEASUREMENT Eng_nAvrg InjCrv_tEng InjCtl_qSetUnBal /end IN_MEASUREMENT
/end FUNCTION
/begin FUNCTION injcrv_mi1phiaddcorslow "Haupteinspritzung - projektspezifische Korrekturen zeitsynchron"
 /begin DEF_CHARACTERISTIC InjCrv_facAPMIDynCor2_CUR InjCrv_facETMIDynCor2_CUR InjCrv_facIATMIDynCor2_CUR InjCrv_facMIATSDynCor_CUR InjCrv_facMICTSDynCor_CUR InjCrv_tiDpCorrDT1_C InjCrv_dpCorrDKd_C /end DEF_CHARACTERISTIC
 /begin IN_MEASUREMENT APSCD_pVal CTSCD_tClnt IATSCD_tAir InjCrv_tEng /end IN_MEASUREMENT
/end FUNCTION
/begin FUNCTION injcrv_mi1phiaddcorslow_uic "" /end FUNCTION
/begin FUNCTION injcrv_miaddcor "Haupteinspritzung - projektspezifische Korrekturen"
 /begin DEF_CHARACTERISTIC InjCrv_dphiMIDynUp_C InjCrv_dphiMIDynDown_C InjCrv_dqFltLowNeg_C InjCrv_dqFltLowPos_C InjCrv_dqFltMidNeg_C InjCrv_dqFltMidPos_C InjCrv_dqSetUnBalMax_C InjCrv_dqSetUnBalMin_C InjCrv_facDQMI1DynCor2_CUR InjCrv_facMIPDynCor_CUR InjCrv_tiLowNegPT1_C InjCrv_tiLowPosPT1_C InjCrv_tiMidNegPT1_C InjCrv_tiMidPosPT1_C InjCrv_tiUppNegPT1_C InjCrv_tiUppPosPT1_C InjCrv_tiDT1DQMISOECor2_C InjCrv_KdDT1DQMISOECor2_C InjCrv_nMIDynMax_C InjCrv_phiMI1DynCor2_MAP InjCrv_phiMIAPSDynCor_MAP InjCrv_phiMIDynCor_MAP InjCrv_phiMIDynMax_C InjCrv_phiMIDynMin_C InjCrv_pMIDynMax_C InjCrv_pMIDynMin_C /end DEF_CHARACTERISTIC
 /begin IN_MEASUREMENT Eng_nAvrg InjCrv_dpMIDynCor InjCrv_dqSetUnBalFltLim InjCrv_pMIDynCor_mp InjCtl_qSetUnBal /end IN_MEASUREMENT
/end FUNCTION
/begin FUNCTION injcrv_miaddcor_msg ""
 /begin OUT_MEASUREMENT InjCrv_dpMIDynCor InjCrv_dqSetUnBalFltLim InjCrv_facMI1DynCorSlow2 InjCrv_facMIDynCor InjCrv_phiMI1AddCor InjCrv_phiMI1AddCor2 /end OUT_MEASUREMENT
/end FUNCTION
/begin FUNCTION injcrv_miaddcor_uic ""
 /begin OUT_MEASUREMENT InjCrv_dqSetUnBal_mp InjCrv_facMI1DynCor2_mp InjCrv_facMIPDynCor_mp InjCrv_phiMI1DynCor1_mp InjCrv_phiMI1DynCor2Bas_mp InjCrv_phiMI1DynCor2_mp InjCrv_phiMIAPSDynCor_mp InjCrv_phiMIDynCor_mp InjCrv_phiMIPDynCor_mp InjCrv_pMIDynCor_mp InjCrv_tiDQPT1AddCor2_mp /end OUT_MEASUREMENT
/end FUNCTION
/begin FUNCTION injcrv_mienvcor "Haupteinspritzung - Umwelt - Korrekturen"
 /begin DEF_CHARACTERISTIC InjCrv_phiMIAPSCor2_MAP InjCrv_phiMIAPSCorStrt_MAP InjCrv_phiMIAPSCor_MAP InjCrv_phiMIAPSCor_X_AXIS InjCrv_phiMIAPSCor_Y_AXIS InjCrv_phiMIATSCor2_MAP InjCrv_phiMIATSCorStrt_MAP InjCrv_phiMIATSCor_MAP InjCrv_phiMIATSCor_X_AXIS InjCrv_phiMIATSCor_Y_AXIS InjCrv_phiMIETSCor12_MAP InjCrv_phiMIETSCor1_MAP InjCrv_phiMIETSCor1_X_AXIS InjCrv_phiMIETSCor1_Y_AXIS InjCrv_phiMIETSCor2_MAP InjCrv_phiMIETSCorStrt_MAP InjCrv_phiMIETSCor_MAP InjCrv_phiMIETSCor_X_AXIS InjCrv_phiMIETSCor_Y_AXIS InjCrv_phiMIFTSRailCorMax_C InjCrv_phiMIFTSRailCorMin_C InjCrv_phiMIFTSRailCorStrt_MAP InjCrv_phiMIFTSRailCor_MAP /end DEF_CHARACTERISTIC
 /begin IN_MEASUREMENT Eng_nAvrg InjCtl_qSetUnBal /end IN_MEASUREMENT
/end FUNCTION
/begin FUNCTION injcrv_mienvcorrgn "Haupteinspritzung - Umwelt - Korrekturen für den Regenerationsbetrieb" /end FUNCTION
/begin FUNCTION injcrv_mienvcorrgn_msg "" /end FUNCTION
/begin FUNCTION injcrv_mienvcorrgn_uic "" /end FUNCTION
/begin FUNCTION injcrv_mienvcorslow "Korrekturen für die Haupteinspritzung (langsamer Prozess)"
 /begin DEF_CHARACTERISTIC InjCrv_facMIAPSPhiCor2_CUR InjCrv_facMIAPSPhiCorStrt_CUR InjCrv_facMIAPSPhiCor_AXIS InjCrv_facMIAPSPhiCor_CUR InjCrv_facMIATSPhiCor2_CUR InjCrv_facMIATSPhiCorStrt_CUR InjCrv_facMIATSPhiCor_AXIS InjCrv_facMIATSPhiCor_CUR InjCrv_facMIETSPhiCor12_CUR InjCrv_facMIETSPhiCor1_AXIS InjCrv_facMIETSPhiCor1_CUR InjCrv_facMIETSPhiCor2_CUR InjCrv_facMIETSPhiCorStrt_CUR InjCrv_facMIETSPhiCor_AXIS InjCrv_facMIETSPhiCor_CUR InjCrv_facMIFTSRailCorStrt_CUR InjCrv_facMIFTSRailCor_CUR /end DEF_CHARACTERISTIC
 /begin IN_MEASUREMENT APSCD_pVal IATSCD_tAir InjCrv_tEng Rail_pSetPointFlTempCor /end IN_MEASUREMENT
/end FUNCTION
/begin FUNCTION injcrv_mienvcorslowrgn "Haupteinspritzung - Umwelt - Gewichtungsfaktoren für den Regenerationsbetrieb" /end FUNCTION
/begin FUNCTION injcrv_mienvcorslowrgn_msg "" /end FUNCTION
/begin FUNCTION injcrv_mienvcorslowrgn_uic "" /end FUNCTION
/begin FUNCTION injcrv_mienvcorslow_msg ""
 /begin OUT_MEASUREMENT InjCrv_facMIAPSPhiCor InjCrv_facMIAPSPhiCor2 InjCrv_facMIAPSPhiCorStrt InjCrv_facMIATSPhiCor InjCrv_facMIATSPhiCor2 InjCrv_facMIATSPhiCorStrt InjCrv_facMIETSPhiCor InjCrv_facMIETSPhiCor1 InjCrv_facMIETSPhiCor12 InjCrv_facMIETSPhiCor2 InjCrv_facMIETSPhiCorStrt InjCrv_facMIFTSRailCor InjCrv_facMIFTSRailCorStrt /end OUT_MEASUREMENT
/end FUNCTION
/begin FUNCTION injcrv_mienvcorslow_uic "" /end FUNCTION
/begin COMPU_METHOD Acc "Fahrzeugbeschleunigung" RAT_FUNC "%6.5" "m/s^2" COEFFS 0 1000 0 0 0 1 /end COMPU_METHOD
/begin COMPU_METHOD AirMassPerCyl "Luftmasse pro Zylinder" RAT_FUNC "%6.3" "mg/Hub" COEFFS 0 10 0 0 0 1 /end COMPU_METHOD
/begin COMPU_METHOD AngleCrS "Winkel Kurbelwelle" RAT_FUNC "%6.4" "deg CrS" COEFFS 0 42.6666666666667 0 0 0 1 /end COMPU_METHOD
/begin COMPU_METHOD AngleGrad "Winkelanzeige in Grad" RAT_FUNC "%6.4" "Grad" COEFFS 0 22.7531285551763 0 0 0 1 /end COMPU_METHOD
/begin COMPU_METHOD AngleGradPerSec "Winkelanzeige in Grad pro Sekunde" RAT_FUNC "%6.4" "Grad/s" COEFFS 0 22.7531285551763 0 0 0 1 /end COMPU_METHOD
/begin COMPU_METHOD B_TRUE "Umrechnung   ----> FALSE;    TRUE = TRUE" TAB_VERB "%6.3" "-" COMPU_TAB_REF B_TRUE /end COMPU_METHOD
/begin COMPU_VTAB B_TRUE "Umrechnung   ----> FALSE;    TRUE = TRUE" TAB_VERB 2 0 "FALSE" 1 "TRUE" /end COMPU_VTAB
/begin COMPU_METHOD DEZ "K3 Umwandlungen" RAT_FUNC "%6.2" "-" COEFFS 0 1 0 0 0 1 /end COMPU_METHOD
/begin COMPU_METHOD dp_dZ20 " boost pressure per time (dp/dt) every 20ms" RAT_FUNC "%6.1" "hPa/s" COEFFS 0 0.1 0 0 0 1 /end COMPU_METHOD
/begin COMPU_METHOD DtyCyc "Tastverhaeltnis" RAT_FUNC "%6.4" "%" COEFFS 0 100 0 0 0 1 /end COMPU_METHOD
/begin COMPU_METHOD EGTSwt "Umrechnung für EGT Rampenschalter (1 / 1000*2^14 )" RAT_FUNC "%10.9" "-" COEFFS 0 16384000 0 0 0 1 /end COMPU_METHOD
/begin COMPU_METHOD EngN "Motordrehzahl" RAT_FUNC "%6.2" "rpm" COEFFS 0 1 0 0 0 1 /end COMPU_METHOD
/begin COMPU_METHOD EngTempFldSel "Verbale Umrechnung für Auswahl aus dem Motortemperatur-Feld Eng_tFld" TAB_VERB "%6.3" "-" COMPU_TAB_REF EngTempFldSel /end COMPU_METHOD
/begin COMPU_VTAB EngTempFldSel "Verbale Umrechnung für Auswahl aus dem Motortemperatur-Feld Eng_tFld" TAB_VERB 3 0 "Coolant_Temperature" 1 "Oil_Temperature" 2 "Eng_tEng" /end COMPU_VTAB
/begin COMPU_METHOD Eta "Umrechnugsformel für Wirkungsgradfaktor eta" RAT_FUNC "%6.4" "Nm/(mg/cyc)" COEFFS 0 128 0 0 0 1 /end COMPU_METHOD
/begin COMPU_METHOD Fact "Faktor mit Auflösung 1 / 8192, hauptsächlich für einen Faktorenbereich 0...1 verwendet" RAT_FUNC "%6.5" "-" COEFFS 0 8192 0 0 0 1 /end COMPU_METHOD
/begin COMPU_METHOD FanSpd "(MAXSINT16 / FANSPD_MAX) * phys" RAT_FUNC "%6.3" "1/min" COEFFS 0 10.9223333333333 0 0 0 1 /end COMPU_METHOD
/begin COMPU_METHOD Fl_Half_L "Kraftstoffverbrauchsintegral" RAT_FUNC "%6.4" "l" COEFFS 0 20 0 0 0 1 /end COMPU_METHOD
/begin COMPU_METHOD InjMassCyc "Einspritzmenge pro Zyklus (mg/Zyklus)" RAT_FUNC "%6.4" "mg/cyc" COEFFS 0 100 0 0 0 1 /end COMPU_METHOD
/begin COMPU_METHOD InjMassInj "Einspritzmenge pro Einspritzung (mg/Einspritzung)" RAT_FUNC "%6.4" "mg/inj" COEFFS 0 100 0 0 0 1 /end COMPU_METHOD
/begin COMPU_METHOD InjMassPerSec_20ms "Einspritzmengenänderung pro Sekunde für 20ms-Tasks" RAT_FUNC "%6.3" "mg/hub/s" COEFFS 0 2 0 0 0 1 /end COMPU_METHOD
/begin COMPU_METHOD InjTime_us "Zeit in Microsekunden für das Einspritztiming" RAT_FUNC "%6.2" "us" COEFFS 0 1 0 0 0 1 /end COMPU_METHOD
/begin COMPU_METHOD i_ub_q0p001 "K3 Umwandlungen" RAT_FUNC "%5.4" "A" COEFFS 0 1 0 0 0 0.001 /end COMPU_METHOD
/begin COMPU_METHOD i_ub_q10p0 "K3 Umwandlungen" RAT_FUNC "%5.1" "A" COEFFS 0 1 0 0 0 10 /end COMPU_METHOD
/begin COMPU_METHOD Kd_PerSec_20ms "differential gain (same unit as input and output) per time" RAT_FUNC "%6.5" "1/s" COEFFS 0 1310.72 0 0 0 1 /end COMPU_METHOD
/begin COMPU_METHOD Kd_Pres2dpdt "differential gain(boost pressure to rate of change of boost pressure)" RAT_FUNC "%8.7" "hPa/sec/hPa" COEFFS 0 131072 0 0 0 1 /end COMPU_METHOD
/begin COMPU_METHOD Ki_PrcEGRRmp_2_Prc "Integral Faktor (Prozent für EGR-Rampe zu Prozent)" RAT_FUNC "%7.6" "1/s" COEFFS 0 53687.0912 0 0 0 1 /end COMPU_METHOD
/begin COMPU_METHOD Ki_rpm2Nm_1 "Integrator Verstärkung (Umdrehungen nach Drehmoment), Umrechnung für sint16 Werte." RAT_FUNC "%6.4" "Nm/(rpm*s)" COEFFS 0 167.77216 0 0 0 1 /end COMPU_METHOD
/begin COMPU_METHOD Ki_Trq2TrqT "Integrale Verstärkung Ki (Getriebeausgangsmoment über die Zeit aufintegriert)" RAT_FUNC "%6.4" "Nms" COEFFS 0 171.79869184 0 0 0 1 /end COMPU_METHOD
/begin COMPU_METHOD LengthKm "Länge in Kilometer" RAT_FUNC "%6.2" "km" COEFFS 0 1 0 0 0 1 /end COMPU_METHOD
/begin COMPU_METHOD NumPinAdc "verbale Umrechnung für ADC Signale" TAB_VERB "%6.3" "-" COMPU_TAB_REF NumPinAdc /end COMPU_METHOD
/begin COMPU_VTAB NumPinAdc "verbale Umrechnung für ADC Signale" TAB_VERB 25 0 "Water_Temperature_Sensor_182" 1 "Intake_Air_Temperature_Sensor_157" 2 "Charge_Air_Temperature_Sensor_183" 3 "Exhaust_Temperature_Sensor_2_134" 4 "Exhaust_Temperature_Sensor_1_158" 5 "1st_APP_Sensor_252" 6 "2nd_APP_Sensor_239" 7 "ADC_REF" 8 "Boost_Pressure_Sensor_154" 9 "Atmospheric_Pressure_Sensor" 10 "Battery_Voltage_Sensor" 11 "Rail_Pressure_Sensor_156" 12 "Rail_Pressure_Peak_Value_156" 13 "Booster_Voltage_Sensor" 14 "Current_MeUn_Sensor" 15 "Current_PCV_Sensor" 16 "Voltage_Bank_1" 17 "Voltage_Bank_2" 18 "Pressure_Upstream_Particle_Filter_159" 19 "Engine_Oil_Pressure_110" 20 "Temperature_ECU_PCB" 21 "Voltage_Lambda_Ua" 22 "Voltage_Lambda_Ri" 23 "ADC_DUMMY_NOT_USED" 24 "ADC_DUMMY_A_NOT_USED" /end COMPU_VTAB
/begin COMPU_METHOD NumPinDioIn "Verbale Umrechnung für Digitaleingang Signale" TAB_VERB "%6.3" "-" COMPU_TAB_REF NumPinDioIn /end COMPU_METHOD
/begin COMPU_VTAB NumPinDioIn "Verbale Umrechnung für Digitaleingang Signale" TAB_VERB 15 0 "Terminal_15_207" 1 "Main_Brake_Switch_236" 2 "Redundant_Brake_Switch_223" 3 "Clutch_Switch" 4 "Terminal_50_224" 5 "ECU_selection_Switch_251" 6 "FlFlt_Switch_211" 7 "Coolant-heater_212" 8 "Redundant_Terminal_15_209(118)" 9 "AC-compressor_overboost_213" 10 "Additive_tank_level_switch_235" 11 "Terminal_61_113" 12 "Lambda_Regeneration" 13 "Oil_Level_sensor_138" 14 "DIO_IN_DUMMY_NOT_USED" /end COMPU_VTAB
/begin COMPU_METHOD OneToOne "eins zu eins (physikalischer Wert ist gleich dem internen Wert)" RAT_FUNC "%6.2" "-" COEFFS 0 1 0 0 0 1 /end COMPU_METHOD
/begin COMPU_METHOD PmpQnt "Fördermenge der Pumpe / Umdrehung" RAT_FUNC "%6.3" "mm^3/rev" COEFFS 0 10 0 0 0 1 /end COMPU_METHOD
/begin COMPU_METHOD Prc "Prozent, gleiche interne Auflösung wie Fact, aber Darstellung in Prozent (0...100%)" RAT_FUNC "%6.4" "%" COEFFS 0 81.92 0 0 0 1 /end COMPU_METHOD
/begin COMPU_METHOD Pres_hPa "Druck (angezeigt in [hPa])" RAT_FUNC "%6.2" "hPa" COEFFS 0 1 0 0 0 1 /end COMPU_METHOD
/begin COMPU_METHOD Pres_Rail "Raildruck in hPa" RAT_FUNC "%4.3" "bar" COEFFS 0 10.000000 0 0 0 1 /end COMPU_METHOD
/begin COMPU_METHOD Pwr_HiRes "Hochaufloesung der Leistung" RAT_FUNC "%6.3" "W" COEFFS 0 2 0 0 0 1 /end COMPU_METHOD
/begin COMPU_METHOD Qp_mm3_sec "Umrechnung für Volumenstrom" RAT_FUNC "%6.1" "mm3/s" COEFFS 0 0.1 0 0 0 1 /end COMPU_METHOD
/begin COMPU_METHOD RmpCrsAg_InjCrv "Kurbelwellenwinkel Rampengradient" RAT_FUNC "%6.5" "deg Crs/s" COEFFS 0 2796.20266666667 0 0 0 1 /end COMPU_METHOD
/begin COMPU_METHOD RmpEngN "Rampengradient für Motordrehzahl" RAT_FUNC "%6.4" "rpm/s" COEFFS 0 65.536 0 0 0 1 /end COMPU_METHOD
/begin COMPU_METHOD RmpTemp "Rampengradient für Temperatur" RAT_FUNC "%6.4" "deg C/s" COEFFS 0 655.36 0 0 0 1 /end COMPU_METHOD
/begin COMPU_METHOD RmpTrq "Rampengradient für Motormoment" RAT_FUNC "%6.4" "Nm/s" COEFFS 0 655.36 0 0 0 1 /end COMPU_METHOD
/begin COMPU_METHOD SlopeRes1000 "Umrechnung für Slope: Slopewert mit Verhältnis 0,001" RAT_FUNC "%6.5" "-" COEFFS 0 1000 0 0 0 1 /end COMPU_METHOD
/begin COMPU_METHOD TempCels_100ms "Temperatur Differenz in Grad C/sec (bezgl. 100ms task)" RAT_FUNC "%6.2" "deg C/s" COEFFS 0 1 0 0 0 1 /end COMPU_METHOD
/begin COMPU_METHOD TempDiff_Cels "difference/offset temperature displayed in degree celcius" RAT_FUNC "%6.3" "deg C" COEFFS 0 10 0 0 0 1 /end COMPU_METHOD
/begin COMPU_METHOD Temp_Cels "Temperatur dargestellt in °C (gleiche interne Darstellung wie Temp_Kelv)" RAT_FUNC "%6.1" "deg C" COEFFS 0 10 2731.4 0 0 1 /end COMPU_METHOD
/begin COMPU_METHOD TimeDeb "Entprellzeit in Millisekunden für Libraryfunktion Debounce" RAT_FUNC "%6.1" "ms" COEFFS 0 0.1 0 0 0 1 /end COMPU_METHOD
/begin COMPU_METHOD TimeDelay_s "Zeitkonstante T1 (in s) für PT1, DT1, etc." RAT_FUNC "%9.3" "s" COEFFS 0 0 1 0 0.00023283064365387 0 /end COMPU_METHOD
/begin COMPU_METHOD TimeEGTRmp "Umrechnung  Zeit in Rampensteigung,  Verwendet in EGT-Bibliothek" RAT_FUNC "%6.3" "s" COEFFS 0 0 1 0 0.0152587890625 0 /end COMPU_METHOD
/begin COMPU_METHOD Time_ms "Zeit in ms für Fehlerentprellung (DSM) und SW-Timer" RAT_FUNC "%6.1" "ms" COEFFS 0 0.1 0 0 0 1 /end COMPU_METHOD
/begin COMPU_METHOD Time_s "Zeit in s für Fehlerentprellung (DSM) und SW-Timer" RAT_FUNC "%6.4" "s" COEFFS 0 100 0 0 0 1 /end COMPU_METHOD
/begin COMPU_METHOD TransR "Übersetzungsverhältnis (Getriebe etc.)" RAT_FUNC "%6.4" "-" COEFFS 0 100 0 0 0 1 /end COMPU_METHOD
/begin COMPU_METHOD Trq "Motormoment" RAT_FUNC "%6.3" "Nm" COEFFS 0 10 0 0 0 1 /end COMPU_METHOD
/begin COMPU_METHOD TrqDT "zeitlich aufintegriertes Kupplungsmoment" RAT_FUNC "%6.2" "Nm*s" COEFFS 0 1 0 0 0 1 /end COMPU_METHOD
/begin COMPU_METHOD TrqPrp "Vortriebsmoment" RAT_FUNC "%6.3" "Nm" COEFFS 0 5 0 0 0 1 /end COMPU_METHOD
/begin COMPU_METHOD UC_Volt "Hardwarekapselung: Kondensatorspannung fuer MCy330" RAT_FUNC "%6.3" "V" COEFFS 0 10 0 0 0 1 /end COMPU_METHOD
/begin COMPU_METHOD Vel "Fahrzeuggeschwindigkeit, gleiche interne Auflösung wie Vel_SI" RAT_FUNC "%6.4" "km/h" COEFFS 0 100 0 0 0 1 /end COMPU_METHOD
/begin COMPU_METHOD VelToN "Verhältnis Fahrzeuggeschwindigkeit zu Motordrehzahl v/n" RAT_FUNC "%8.7" "(km/h)/rpm" COEFFS 0 100000 0 0 0 1 /end COMPU_METHOD
/begin COMPU_METHOD Volt "Spannung in V (von ADC)" RAT_FUNC "%6.2" "mV" COEFFS 0 0.2046 0 0 0 1 /end COMPU_METHOD
/begin COMPU_METHOD Volt_Batt "Batteriespannung" RAT_FUNC "%6.1" "mV" COEFFS 0 0.05115 0 0 0 1 /end COMPU_METHOD
/begin RECORD_LAYOUT Gkf_Ws16 FNC_VALUES 1 SWORD COLUMN_DIR DIRECT /end RECORD_LAYOUT
/begin RECORD_LAYOUT Gkl_Ws16 FNC_VALUES 1 SWORD COLUMN_DIR DIRECT /end RECORD_LAYOUT
/begin RECORD_LAYOUT GSst_Xs16 NO_AXIS_PTS_X 1 SWORD AXIS_PTS_X 2 SWORD INDEX_INCR DIRECT /end RECORD_LAYOUT
/begin RECORD_LAYOUT Kf_Xs16_Ys16_Ws16 NO_AXIS_PTS_X 1 SWORD NO_AXIS_PTS_Y 2 SWORD AXIS_PTS_X 3 SWORD INDEX_INCR DIRECT AXIS_PTS_Y 4 SWORD INDEX_INCR DIRECT FNC_VALUES 5 SWORD COLUMN_DIR DIRECT /end RECORD_LAYOUT
/begin RECORD_LAYOUT Kl_Xs16_Ws16 NO_AXIS_PTS_X 1 SWORD AXIS_PTS_X 2 SWORD INDEX_INCR DIRECT FNC_VALUES 3 SWORD COLUMN_DIR DIRECT /end RECORD_LAYOUT
/begin RECORD_LAYOUT Kw_Ws16 FNC_VALUES 1 SWORD COLUMN_DIR DIRECT /end RECORD_LAYOUT
/begin RECORD_LAYOUT Kw_Ws32 FNC_VALUES 1 SLONG COLUMN_DIR DIRECT /end RECORD_LAYOUT
/begin RECORD_LAYOUT Kw_Ws8 FNC_VALUES 1 SBYTE COLUMN_DIR DIRECT /end RECORD_LAYOUT
/begin RECORD_LAYOUT Kw_Wu16 FNC_VALUES 1 UWORD COLUMN_DIR DIRECT /end RECORD_LAYOUT
/begin RECORD_LAYOUT Kw_Wu32 FNC_VALUES 1 ULONG COLUMN_DIR DIRECT /end RECORD_LAYOUT
/begin RECORD_LAYOUT Kw_Wu8 FNC_VALUES 1 UBYTE COLUMN_DIR DIRECT /end RECORD_LAYOUT
/end MODULE
/end PROJECT
