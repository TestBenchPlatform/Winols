ASAP2_VERSION 1 3
/begin PROJECT P389 "BMW DDE6.0 4-Zylinder V53.4 01.04.2004 CAN12H"
/begin HEADER "" VERSION "V53.4_4Z_CAN12H" PROJECT_NO P389 /end HEADER
/begin MODULE DIM ""
/begin MOD_COMMON "" BYTE_ORDER MSB_FIRST ALIGNMENT_BYTE 1 ALIGNMENT_WORD 2 ALIGNMENT_LONG 4 ALIGNMENT_FLOAT32_IEEE 4 /end MOD_COMMON
/begin CHARACTERISTIC Dmd_gen_C "" VALUE 0xE381C Kw_Ws16 65535.00 OneToOne -32768.00 32767.00 FORMAT "%8.2" /end CHARACTERISTIC
/begin CHARACTERISTIC InjCrv_dtiPoI2RgnEffRmpUp_C "positive gradient of regeneration ramp" VALUE 0xE15FC Kw_Wu32 65535999.9847 Rmp 0.00 65535999.9847 FORMAT "%13.4" /end CHARACTERISTIC
/begin CHARACTERISTIC InjCrv_dtiPoI2RgnEffRmpDwn_C "negative gradient of regeneration ramp" VALUE 0xE1600 Kw_Wu32 65535999.9847 Rmp 0.00 65535999.9847 FORMAT "%13.4" /end CHARACTERISTIC
/begin CHARACTERISTIC InjCrv_dtiPoI2RgnRmpUp_C "positive Rampensteigung bei Umschaltung auf Regenerationswerte PoI2" VALUE 0xE1604 Kw_Wu32 65535999.9847 Rmp 0.00 65535999.9847 FORMAT "%13.4" /end CHARACTERISTIC
/begin CHARACTERISTIC InjCrv_dtiPoI2RgnRmpDwn_C "negative Rampensteigung bei Umschaltung auf Regenerationswerte PoI2" VALUE 0xE1608 Kw_Wu32 65535999.9847 Rmp 0.00 65535999.9847 FORMAT "%13.4" /end CHARACTERISTIC
/begin CHARACTERISTIC InjCrv_dtiPoI2RgnTypeRmpUp_C "positive gradient of regeneration ramp" VALUE 0xE160C Kw_Wu32 65535999.9847 Rmp 0.00 65535999.9847 FORMAT "%13.4" /end CHARACTERISTIC
/begin CHARACTERISTIC InjCrv_dtiPoI2RgnTypeRmpDwn_C "negative gradient of regeneration ramp" VALUE 0xE1610 Kw_Wu32 65535999.9847 Rmp 0.00 65535999.9847 FORMAT "%13.4" /end CHARACTERISTIC
/begin CHARACTERISTIC InjCrv_facPoI2EffRgnAdd_Vector "Konfigurationslabel für Bypass Freischnitt" VALUE 0xC30FA Kw_Wu8 255.0 OneToOne 0.00 255.0 FORMAT "%5.1" /end CHARACTERISTIC
/begin CHARACTERISTIC InjCrv_facPoI2EffRgnAdd_Channel "Konfigurationslabel für Bypass Freischnitt" VALUE 0xC30FB Kw_Wu8 255.0 OneToOne 0.00 255.0 FORMAT "%5.1" /end CHARACTERISTIC
/begin CHARACTERISTIC InjCrv_facPoI2EffRgn_Vector "Konfigurationslabel für Bypass Freischnitt" VALUE 0xC30FC Kw_Wu8 255.0 OneToOne 0.00 255.0 FORMAT "%5.1" /end CHARACTERISTIC
/begin CHARACTERISTIC InjCrv_facPoI2EffRgn_Channel "Konfigurationslabel für Bypass Freischnitt" VALUE 0xC30FD Kw_Wu8 255.0 OneToOne 0.00 255.0 FORMAT "%5.1" /end CHARACTERISTIC
/begin CHARACTERISTIC InjCrv_phiPoI2Add_Vector "Bypass-label für additiven Bypass von InjCrv_phiPoI2 ( Nicht verstellen !)" VALUE 0xC310A Kw_Wu8 255.0 OneToOne 0.00 255.0 FORMAT "%5.1" /end CHARACTERISTIC
/begin CHARACTERISTIC InjCrv_phiPoI2Add_Channel "Label für additvien Bypass von InjCrv_phiPoI2 (Nicht verstellen!)" VALUE 0xC310B Kw_Wu8 255.0 OneToOne 0.00 255.0 FORMAT "%5.1" /end CHARACTERISTIC
/begin CHARACTERISTIC InjCrv_phiPoI2Bas_MAP "Winkelkomponente Ansteuerbeginn Grundwert PoI2" MAP 0xE17C0 Kf_Xs16_Ys16_Ws16 40.00781 AngleCrS -40.00781 0.00 FORMAT "%8.5" EXTENDED_LIMITS -768.0000 767.9766
 /begin AXIS_DESCR STD_AXIS Eng_nAvrg EngN 2 0.00 6000.000 FORMAT "%8.3" EXTENDED_LIMITS -32768.00 32767.00 DEPOSIT ABSOLUTE /end AXIS_DESCR
 /begin AXIS_DESCR STD_AXIS InjCtl_qSetUnBal InjMassCyc 2 0.00 327.6700 FORMAT "%8.4" EXTENDED_LIMITS -327.6800 327.6700 DEPOSIT ABSOLUTE /end AXIS_DESCR
/end CHARACTERISTIC
/begin CHARACTERISTIC InjCrv_phiPoI2Min_C "#SSD minimaler Ansteuerbeginn PoI2 relativ zum oberen Totpunkt" VALUE 0xE1688 Kw_Ws16 40.00781 AngleCrS -40.00781 0.00 FORMAT "%8.5" EXTENDED_LIMITS -768.0000 767.9766 /end CHARACTERISTIC
/begin CHARACTERISTIC InjCrv_phiPoI2RgnAdd_Vector "Bypass-Label für InjCrv_phiPoI2RgnAdd_Vector (Nicht verstellen!)" VALUE 0xC30FE Kw_Wu8 255.0 OneToOne 0.00 255.0 FORMAT "%5.1" /end CHARACTERISTIC
/begin CHARACTERISTIC InjCrv_phiPoI2RgnAdd_Channel "Bypass-Label für InjCrv_phiPoI2RgnAdd_Channel (Nicht verstellen!)" VALUE 0xC30FF Kw_Wu8 255.0 OneToOne 0.00 255.0 FORMAT "%5.1" /end CHARACTERISTIC
/begin CHARACTERISTIC InjCrv_phiPoI2Rgn_Vector "#SSD Bypass-Label, nicht editieren !" VALUE 0xC3100 Kw_Wu8 255.0 OneToOne 0.00 255.0 FORMAT "%5.1" /end CHARACTERISTIC
/begin CHARACTERISTIC InjCrv_phiPoI2Rgn_Channel "#SSD Bypass-Label, nicht editieren !" VALUE 0xC3101 Kw_Wu8 255.0 OneToOne 0.00 255.0 FORMAT "%5.1" /end CHARACTERISTIC
/begin CHARACTERISTIC InjCrv_phiPoI2_Vector "#SSD Bypass-Label, nicht editieren !" VALUE 0xC310C Kw_Wu8 255.0 OneToOne 0.00 255.0 FORMAT "%5.1" /end CHARACTERISTIC
/begin CHARACTERISTIC InjCrv_phiPoI2_Channel "#SSD Bypass-Label, nicht editieren !" VALUE 0xC310D Kw_Wu8 255.0 OneToOne 0.00 255.0 FORMAT "%5.1" /end CHARACTERISTIC
/begin CHARACTERISTIC InjCrv_POpPoI2Bas_MAP "grundwert Freigabe PoI2" MAP 0xE1620 Kf_Xs16_Ys16_Ws16 100.0000 OneToOne 0.00 100.0000 FORMAT "%8.4" EXTENDED_LIMITS -32768.00 32767.00
 /begin AXIS_DESCR STD_AXIS Eng_nAvrg EngN 6 0.00 6000.000 FORMAT "%8.3" EXTENDED_LIMITS -32768.00 32767.00 DEPOSIT ABSOLUTE /end AXIS_DESCR
 /begin AXIS_DESCR STD_AXIS InjCtl_qSetUnBal InjMassCyc 6 0.00 327.6700 FORMAT "%8.4" EXTENDED_LIMITS -327.6800 327.6700 DEPOSIT ABSOLUTE /end AXIS_DESCR
/end CHARACTERISTIC
/begin CHARACTERISTIC InjCrv_POpPoI2High_C "Feigabe PoI2 über Betriebspunkt, obere Hystereseschwelle" VALUE 0xE1684 Kw_Ws16 100.0000 OneToOne 0.00 100.0000 FORMAT "%8.4" EXTENDED_LIMITS -32768.00 32767.00 /end CHARACTERISTIC
/begin CHARACTERISTIC InjCrv_POpPoI2Low_C "Freigabe PoI2 über Betriebspunkt, untere Hystereseschwelle" VALUE 0xE1686 Kw_Ws16 100.0000 OneToOne 0.00 100.0000 FORMAT "%8.4" EXTENDED_LIMITS -32768.00 32767.00 /end CHARACTERISTIC
/begin CHARACTERISTIC InjCrv_qMin_CUR "Kennlinie für die Berechnung der Minimalmenge einer Einspritzung" CURVE 0xE1A18 Kl_Xs16_Ws16 327.6700 InjMassInj 0.00 327.6700 FORMAT "%8.4" EXTENDED_LIMITS -327.6800 327.6700
 /begin AXIS_DESCR STD_AXIS RailCD_pPeak Pres_Rail 16 0.00 2000.000 FORMAT "%5.3" EXTENDED_LIMITS -3276.800 3276.700 DEPOSIT ABSOLUTE /end AXIS_DESCR
/end CHARACTERISTIC
/begin CHARACTERISTIC InjCrv_qPoI2DesAdd_Vector "Bypass-Label für additiven Bypass von InjCrv_qPoI2Des (Nicht verstellen!)" VALUE 0xC310E Kw_Wu8 255.0 OneToOne 0.00 255.0 FORMAT "%5.1" /end CHARACTERISTIC
/begin CHARACTERISTIC InjCrv_qPoI2DesAdd_Channel "Konfigurationslabel für additive Bypass message" VALUE 0xC310F Kw_Wu8 255.0 OneToOne 0.00 255.0 FORMAT "%5.1" /end CHARACTERISTIC
/begin CHARACTERISTIC InjCrv_qPoI2EffAdd_Vector "Bypass-label für additiven Bypass InjCrv_qPoI2Eff (nicht verstellen!)" VALUE 0xC3110 Kw_Wu8 255.0 OneToOne 0.00 255.0 FORMAT "%5.1" /end CHARACTERISTIC
/begin CHARACTERISTIC InjCrv_qPoI2EffAdd_Channel "Bypass-label für additiven Bypass  InjCrv_qPoI2Eff (nicht verstellen!)" VALUE 0xC3111 Kw_Wu8 255.0 OneToOne 0.00 255.0 FORMAT "%5.1" /end CHARACTERISTIC
/begin CHARACTERISTIC InjCrv_qPoI2Eff_Vector "#SSD Bypass-Label, nicht editieren !" VALUE 0xC3112 Kw_Wu8 255.0 OneToOne 0.00 255.0 FORMAT "%5.1" /end CHARACTERISTIC
/begin CHARACTERISTIC InjCrv_qPoI2Eff_Channel "#SSD Bypass-Label, nicht editieren !" VALUE 0xC3113 Kw_Wu8 255.0 OneToOne 0.00 255.0 FORMAT "%5.1" /end CHARACTERISTIC
/begin CHARACTERISTIC InjCrv_qPoI2RgnAdd_Vector "Konfigurationslabel für Bypass Freischnitt" VALUE 0xC3102 Kw_Wu8 255.0 OneToOne 0.00 255.0 FORMAT "%5.1" /end CHARACTERISTIC
/begin CHARACTERISTIC InjCrv_qPoI2RgnAdd_Channel "Konfigurationslabel für Bypass Freischnitt" VALUE 0xC3103 Kw_Wu8 255.0 OneToOne 0.00 255.0 FORMAT "%5.1" /end CHARACTERISTIC
/begin CHARACTERISTIC InjCrv_qPoI2Rgn_Vector "#SSD Bypass-Label, nicht editieren !" VALUE 0xC3104 Kw_Wu8 255.0 OneToOne 0.00 255.0 FORMAT "%5.1" /end CHARACTERISTIC
/begin CHARACTERISTIC InjCrv_qPoI2Rgn_Channel "#SSD Bypass-Label, nicht editieren !" VALUE 0xC3105 Kw_Wu8 255.0 OneToOne 0.00 255.0 FORMAT "%5.1" /end CHARACTERISTIC
/begin CHARACTERISTIC InjCrv_qPoI2Des_Vector "#SSD Bypass-Label für InjCrv_qPoI2Des (Nicht verstellen!)" VALUE 0xC3114 Kw_Wu8 255.0 OneToOne 0.00 255.0 FORMAT "%5.1" /end CHARACTERISTIC
/begin CHARACTERISTIC InjCrv_qPoI2Des_Channel "#SSD Bypass-Label für InjCrv_qPoI2Des (Nicht verstellen!)" VALUE 0xC3115 Kw_Wu8 255.0 OneToOne 0.00 255.0 FORMAT "%5.1" /end CHARACTERISTIC
/begin CHARACTERISTIC InjCrv_stPoI2RgnEffMsk_C "Bitmask for activate PoI2 in regeneration mode" VALUE 0xE1614 Kw_Wu32 4294967295.00 OneToOne 0.00 4294967295.00 FORMAT "%13.2" /end CHARACTERISTIC
/begin CHARACTERISTIC InjCrv_stPoI2RgnMsk_C "Maske zur Aktivierung der Regeneration über PoI2" VALUE 0xE1618 Kw_Wu32 4294967295.00 OneToOne 0.00 4294967295.00 FORMAT "%13.2" /end CHARACTERISTIC
/begin CHARACTERISTIC InjCrv_stPoI2RgnTypeMsk_C "Bitmask for activate PoI2 in regeneration mode" VALUE 0xE161C Kw_Wu32 4294967295.00 OneToOne 0.00 4294967295.00 FORMAT "%13.2" /end CHARACTERISTIC
/begin CHARACTERISTIC InjCrv_swtTiPseVal_C "Schalter zur Auswahl von fester oder gemessener Mindestzeit zwischen 2 Einspritzungen" VALUE 0xE1A5C Kw_Wu8 1.000 OneToOne 0.00 1.000 FORMAT "%5.3" EXTENDED_LIMITS 0.00 255.0 /end CHARACTERISTIC
/begin CHARACTERISTIC InjCrv_swtTiPseType_C "Auswahl Datensatz oder EEPROM Wert" VALUE 0xE1A5D Kw_Wu8 0.00 OneToOne 2.000 2.000 FORMAT "%5.3" EXTENDED_LIMITS 0.00 255.0 /end CHARACTERISTIC
/begin CHARACTERISTIC InjCrv_tiFltFstDcyDecPT1_C "PT1 Zeitkonstante zur Filterung der Mindestzeit zwischen 2 Einspritzungen bei fallender Schnelloeschdauer" VALUE 0xE1A60 Kw_Wu32 4294.9673 TimeDelay_s 0.0000010000000 4294.9673 FORMAT "%9.4" /end CHARACTERISTIC
/begin CHARACTERISTIC InjCrv_tiFltFstDcyIncPT1_C "PT1 Zeitkonstante zur Filterung der Mindestzeit zwischen 2 Einspritzungen bei steigender Schnelloeschdauer" VALUE 0xE1A64 Kw_Wu32 4294.9673 TimeDelay_s 0.0000010000000 4294.9673 FORMAT "%9.4" /end CHARACTERISTIC
/begin CHARACTERISTIC InjCrv_tiPoI2Add_Vector "Bypass-label für additiven Bypass InjCrv_tiPoI2 (nicht verstellen !)" VALUE 0xC3116 Kw_Wu8 255.0 OneToOne 0.00 255.0 FORMAT "%5.1" /end CHARACTERISTIC
/begin CHARACTERISTIC InjCrv_tiPoI2Add_Channel "Bypass-label für additiven Bypass InjCrv_tiPoI2 (nicht verstellen !)" VALUE 0xC3117 Kw_Wu8 255.0 OneToOne 0.00 255.0 FORMAT "%5.1" /end CHARACTERISTIC
/begin CHARACTERISTIC InjCrv_tiPoI2Bas_MAP "Zeitkomponente Ansteuerbeginn Grundwert PoI2" MAP 0xE17D4 Kf_Xs16_Ys16_Ws16 18000.00 InjTime_us -13000.00 5000.00 FORMAT "%8.2" EXTENDED_LIMITS -32768.00 32767.00
 /begin AXIS_DESCR STD_AXIS Eng_nAvrg EngN 16 0.00 6000.000 FORMAT "%8.3" EXTENDED_LIMITS -32768.00 32767.00 DEPOSIT ABSOLUTE /end AXIS_DESCR
 /begin AXIS_DESCR STD_AXIS InjCtl_qSetUnBal InjMassCyc 16 0.00 327.6700 FORMAT "%8.4" EXTENDED_LIMITS -327.6800 327.6700 DEPOSIT ABSOLUTE /end AXIS_DESCR
/end CHARACTERISTIC
/begin CHARACTERISTIC InjCrv_tiPoI2Max_MAP "#SSD maximaler Ansteuerbeginn PoI2 relativ zur Haupteinspritzung" MAP 0xE168A Kf_Xs16_Ys16_Ws16 18000.00 InjTime_us -13000.00 5000.00 FORMAT "%8.2" EXTENDED_LIMITS -32768.00 32767.00
 /begin AXIS_DESCR STD_AXIS RailCD_pPeak Pres_Rail 8 0.00 2000.000 FORMAT "%5.3" EXTENDED_LIMITS -3276.800 3276.700 DEPOSIT ABSOLUTE /end AXIS_DESCR
 /begin AXIS_DESCR STD_AXIS InjCrv_qMI1Des InjMassInj 16 0.00 327.6700 FORMAT "%8.4" EXTENDED_LIMITS -327.6800 327.6700 DEPOSIT ABSOLUTE /end AXIS_DESCR
/end CHARACTERISTIC
/begin CHARACTERISTIC InjCrv_tiPoI2Min_C "#SSD physikalisch bedingter minimaler Ansteuerbeginn PoI2" VALUE 0xE17BE Kw_Ws16 18000.00 InjTime_us -13000.00 5000.00 FORMAT "%8.2" EXTENDED_LIMITS -32768.00 32767.00 /end CHARACTERISTIC
/begin CHARACTERISTIC InjCrv_tiPoI2RgnAdd_Vector "Bypass-Label für  (Nicht verstellen!)" VALUE 0xC3106 Kw_Wu8 255.0 OneToOne 0.00 255.0 FORMAT "%5.1" /end CHARACTERISTIC
/begin CHARACTERISTIC InjCrv_tiPoI2RgnAdd_Channel "Bypass-Label für InjCrv_tiPoI2RgnAdd_Channel (Nicht verstellen!)" VALUE 0xC3107 Kw_Wu8 255.0 OneToOne 0.00 255.0 FORMAT "%5.1" /end CHARACTERISTIC
/begin CHARACTERISTIC InjCrv_tiPoI2Rgn_Vector "#SSD Bypass-Label, nicht editieren !" VALUE 0xC3108 Kw_Wu8 255.0 OneToOne 0.00 255.0 FORMAT "%5.1" /end CHARACTERISTIC
/begin CHARACTERISTIC InjCrv_tiPoI2Rgn_Channel "#SSD Bypass-Label, nicht editieren !" VALUE 0xC3109 Kw_Wu8 255.0 OneToOne 0.00 255.0 FORMAT "%5.1" /end CHARACTERISTIC
/begin CHARACTERISTIC InjCrv_tiPoI2_Vector "#SSD Bypass-Label, nicht editieren !" VALUE 0xC3118 Kw_Wu8 255.0 OneToOne 0.00 255.0 FORMAT "%5.1" /end CHARACTERISTIC
/begin CHARACTERISTIC InjCrv_tiPoI2_Channel "#SSD Bypass-Label, nicht editieren !" VALUE 0xC3119 Kw_Wu8 255.0 OneToOne 0.00 255.0 FORMAT "%5.1" /end CHARACTERISTIC
/begin CHARACTERISTIC InjCrv_tiSafDst_C "Sicherheitszeitabstand zwischen 2 Einspritzungen" VALUE 0xE1A68 Kw_Wu16 65535.00 InjTime_us 0.00 65535.00 FORMAT "%8.2" /end CHARACTERISTIC
/begin CHARACTERISTIC InjCtl_dqLimUp_C "Rampensteigung bei Wegfall des Systemfehlers" VALUE 0xE1B64 Kw_Wu32 655359.999847 RmpInjMass 0.00 655359.999847 FORMAT "%13.6" /end CHARACTERISTIC
/begin CHARACTERISTIC InjCtl_dqLimDwn_C "Rampensteigung bei Auftreten eines Systemfehlers" VALUE 0xE1B68 Kw_Wu32 655359.999847 RmpInjMass 0.00 655359.999847 FORMAT "%13.6" /end CHARACTERISTIC
/begin CHARACTERISTIC InjCtl_facAdjSrvMax_C "Maximalwert für Serviceabgleichfaktor" VALUE 0xE1A6C Kw_Ws16 3.000000 Fact 0.00 3.000000 FORMAT "%8.6" EXTENDED_LIMITS -4.000000 3.999878 /end CHARACTERISTIC
/begin CHARACTERISTIC InjCtl_facAdjSrvMin_C "Minimalwert für Serviceabgleichfaktor" VALUE 0xE1A6E Kw_Ws16 3.000000 Fact 0.00 3.000000 FORMAT "%8.6" EXTENDED_LIMITS -4.000000 3.999878 /end CHARACTERISTIC
/begin CHARACTERISTIC InjCtl_facAdjSrvUnlimDfl_C "Vorgabewert für Serviceabgleichfaktor" VALUE 0xE1A70 Kw_Ws16 3.000000 Fact 0.00 3.000000 FORMAT "%8.6" EXTENDED_LIMITS -4.000000 3.999878 /end CHARACTERISTIC
/begin CHARACTERISTIC InjCtl_qAdjQntMax_C "Maximalwert für Mengenabgleich" VALUE 0xE1A72 Kw_Ws16 327.6700 InjMassCyc 0.00 327.6700 FORMAT "%8.4" EXTENDED_LIMITS -327.6800 327.6700 /end CHARACTERISTIC
/begin CHARACTERISTIC InjCtl_qAdjQntMin_C "Minimalwert für Mengenabgleich" VALUE 0xE1A74 Kw_Ws16 327.6700 InjMassCyc 0.00 327.6700 FORMAT "%8.4" EXTENDED_LIMITS -327.6800 327.6700 /end CHARACTERISTIC
/begin CHARACTERISTIC InjCtl_qAdjQnt_MAP "Neutralkennfeld für Mengenabgleich" MAP 0xE1A76 Kf_Xs16_Ys16_Ws16 327.6700 InjMassCyc 0.00 327.6700 FORMAT "%8.4" EXTENDED_LIMITS -327.6800 327.6700
 /begin AXIS_DESCR STD_AXIS Eng_nAvrg EngN 8 0.00 6000.000 FORMAT "%8.3" EXTENDED_LIMITS -32768.00 32767.00 DEPOSIT ABSOLUTE /end AXIS_DESCR
 /begin AXIS_DESCR STD_AXIS InjCtl_qSetUnCor_mp InjMassCyc 6 0.00 327.6700 FORMAT "%8.4" EXTENDED_LIMITS -327.6800 327.6700 DEPOSIT ABSOLUTE /end AXIS_DESCR
/end CHARACTERISTIC
/begin CHARACTERISTIC InjCtl_t1DT1SetUnBal_C "Totzeit für Kraftstoffmasse DT1 filter" VALUE 0xE1AF8 Kw_Wu32 4294.9673 TimeDelay_s 0.0000010000000 4294.9673 FORMAT "%9.4" /end CHARACTERISTIC
/begin CHARACTERISTIC InjCtl_kdDT1SetUnBal_C "Verstärkungskonstante des DT1 filters für Kraftstoffmasse ohne FBC" VALUE 0xE1AFC Kw_Ws32 32767.9999847 Kd 0.00 32767.9999847 FORMAT "%13.7" EXTENDED_LIMITS -32768.0000000 32767.9999847 /end CHARACTERISTIC
/begin CHARACTERISTIC InjCtl_qCurr_Vector "#SSD Bypass-Label für InjCtl_qCurr (Nicht verstellen!)" VALUE 0xC311A Kw_Wu8 255.0 OneToOne 0.00 255.0 FORMAT "%5.1" /end CHARACTERISTIC
/begin CHARACTERISTIC InjCtl_qCurr_Channel "#SSD Bypass Label, nicht ändern!" VALUE 0xC311B Kw_Wu8 255.0 OneToOne 0.00 255.0 FORMAT "%5.1" /end CHARACTERISTIC
/begin CHARACTERISTIC InjCtl_qDriftComp_MAP "Kennfeld für Mengendriftkompensation" MAP 0xE1B00 Kf_Xs16_Ys16_Ws16 327.6700 InjMassCyc 0.00 327.6700 FORMAT "%8.4" EXTENDED_LIMITS -327.6800 327.6700
 /begin AXIS_DESCR STD_AXIS InjCtl_qSetUnBal InjMassCyc 8 0.00 327.6700 FORMAT "%8.4" EXTENDED_LIMITS -327.6800 327.6700 DEPOSIT ABSOLUTE /end AXIS_DESCR
 /begin AXIS_DESCR STD_AXIS InjCtl_tiEngOn_mp TimeEngOnHrs 4 0.00 596497.0 FORMAT "%8.1" EXTENDED_LIMITS -596515.2 596497.0 DEPOSIT ABSOLUTE /end AXIS_DESCR
/end CHARACTERISTIC
/begin CHARACTERISTIC InjCtl_qDriftMax2_C "Mengendriftkompensationsbegrenzung (Datensatz)" VALUE 0xE1B5C Kw_Ws16 327.6700 InjMassCyc 0.00 327.6700 FORMAT "%8.4" EXTENDED_LIMITS -327.6800 327.6700 /end CHARACTERISTIC
/begin CHARACTERISTIC InjCtl_qDriftMin2_C "Mengendriftkompensationsbegrenzung (Datensatz)" VALUE 0xE1B5E Kw_Ws16 327.6700 InjMassCyc 0.00 327.6700 FORMAT "%8.4" EXTENDED_LIMITS -327.6800 327.6700 /end CHARACTERISTIC
/begin CHARACTERISTIC InjCtl_qLimErr_CUR "#SSD Begrenzungsmeneg bei Systemfehler" CURVE 0xE1B6C Kl_Xs16_Ws16 327.6700 InjMass 0.00 327.6700 FORMAT "%8.4" EXTENDED_LIMITS -327.6800 327.6700
 /begin AXIS_DESCR STD_AXIS Eng_nAvrg EngN 21 0.00 6000.000 FORMAT "%8.3" EXTENDED_LIMITS -32768.00 32767.00 DEPOSIT ABSOLUTE /end AXIS_DESCR
/end CHARACTERISTIC
/begin CHARACTERISTIC InjCtl_qLimErr_MAP "#SSD Limitierungsmoment bei Systemfehler" MAP 0xE1BC2 Kf_Xs16_Ys16_Ws16 327.6700 InjMass 0.00 327.6700 FORMAT "%8.4" EXTENDED_LIMITS -327.6800 327.6700
 /begin AXIS_DESCR STD_AXIS Eng_nAvrg EngN 12 0.00 6000.000 FORMAT "%8.3" EXTENDED_LIMITS -32768.00 32767.00 DEPOSIT ABSOLUTE /end AXIS_DESCR
 /begin AXIS_DESCR STD_AXIS FTSCD_tFuel Temp_Cels 5 -50.14000 199.8600 FORMAT "%8.4" EXTENDED_LIMITS -3549.940 3003.560 DEPOSIT ABSOLUTE /end AXIS_DESCR
/end CHARACTERISTIC
/begin CHARACTERISTIC InjCtl_qLimSoftShOff_CUR "limitation value in case of soft shutoff" CURVE 0xE1C60 Kl_Xs16_Ws16 327.6700 InjMass 0.00 327.6700 FORMAT "%8.4" EXTENDED_LIMITS -327.6800 327.6700
 /begin AXIS_DESCR STD_AXIS Eng_nAvrg EngN 16 0.00 6000.000 FORMAT "%8.3" EXTENDED_LIMITS -32768.00 32767.00 DEPOSIT ABSOLUTE /end AXIS_DESCR
/end CHARACTERISTIC
/begin CHARACTERISTIC InjCtl_qRaw_Vector "#SSD Bypass-Label für InjCtl_qRaw (Nicht verstellen!)" VALUE 0xC311C Kw_Wu8 255.0 OneToOne 0.00 255.0 FORMAT "%5.1" /end CHARACTERISTIC
/begin CHARACTERISTIC InjCtl_qRaw_Channel "#SSD Bypass-Label für InjCtl_qRaw, nicht editieren!" VALUE 0xC311D Kw_Wu8 255.0 OneToOne 0.00 255.0 FORMAT "%5.1" /end CHARACTERISTIC
/begin CHARACTERISTIC InjCtl_qSet_Vector "#SSD Bypass-Label für InjCtl_qSet (Nicht verstellen!)" VALUE 0xC311E Kw_Wu8 255.0 OneToOne 0.00 255.0 FORMAT "%5.1" /end CHARACTERISTIC
/begin CHARACTERISTIC InjCtl_qSet_Channel "#SSD Bypass-Label für InjCtl_qSet, nicht editieren !" VALUE 0xC311F Kw_Wu8 255.0 OneToOne 0.00 255.0 FORMAT "%5.1" /end CHARACTERISTIC
/begin CHARACTERISTIC InjCtl_swtFMACor_C "Schalter für FMA Korrektur (1: indirekte Korrektion ist aktiev, 0: inaktiev)" VALUE 0xE1B60 Kw_Wu8 1.000 OneToOne 0.00 1.000 FORMAT "%5.3" EXTENDED_LIMITS 0.00 255.0 /end CHARACTERISTIC
/begin CHARACTERISTIC InjUn_nInjLock_C "#SSD Kein Berechnung der Einspritzungen solange Überprüfung der Synchronisation nicht abgeschlossen" VALUE 0xC0620 Kw_Ws16 8000.000 EngN 0.00 8000.000 FORMAT "%8.3" EXTENDED_LIMITS -32768.00 32767.00 /end CHARACTERISTIC
/begin CHARACTERISTIC InjUn_phiTstShOffPathSet_C "#SSD Winkel zwischen Programmierung und Beginn der Einspritzung bei Abschaltpfadtest" VALUE 0xE1CA4 Kw_Wu16 100.0078 AngleCrS 0.00 100.0078 FORMAT "%8.4" EXTENDED_LIMITS 0.00 1535.977 /end CHARACTERISTIC
/begin CHARACTERISTIC InjUn_tiTstShOffPathET_C "#SSD Ansteuerdauer bei Abschaltpfadtest" VALUE 0xE1CA6 Kw_Wu16 65415.00 InjTime_us 120.0000 65535.00 FORMAT "%8.2" EXTENDED_LIMITS 0.00 65535.00 /end CHARACTERISTIC
/begin CHARACTERISTIC InjVCD_nETMaxLim_C "#SSD Schwelle für max. Drehzahl Begrenzung Ansteuerdauer" VALUE 0xE1CAC Kw_Ws16 65535.00 EngN -32768.00 32767.00 FORMAT "%8.2" /end CHARACTERISTIC
/begin AXIS_PTS InjVCD_pRailZFCETCor_AXIS "gemeinsame Raildruck-Achse fuer ZFC Ansteuerdauerkorrektur-Kennfelder" 0xE2234 RailCD_pAct_mp GSst_Xs16 600000.0 Pres_Rail 6 200000.0 800000.0 FORMAT "%8.1" EXTENDED_LIMITS -3276800. 3276700. DEPOSIT ABSOLUTE /end AXIS_PTS
/begin AXIS_PTS InjVCD_qZFCETCor_AXIS "Stuetzstellen der Menge fuer Korrekturfaktor-Gruppenkennfelder der Ansteuerdauerkorrektur der Nullmengenkalibrierung" 0xE2242 InjVCD_qInZFCETGMap_mp GSst_Xs16 3.000000 InjMassInj 6 0.00 3.000000 FORMAT "%8.6" EXTENDED_LIMITS -327.6800 327.6700 DEPOSIT ABSOLUTE /end AXIS_PTS
/begin CHARACTERISTIC InjVCD_rZFCETDif0_GMAP "Gruppenkennfeld Bewertungsfaktor fuer Ansteuerdauerkorrektur durch Nullmengenkalibrierung am Raildruck-Kalibrierpunkt 0" MAP 0xE2250 Gkf_Ws16 100.0000 Prc 0.00 100.0000 FORMAT "%8.4" EXTENDED_LIMITS -400.0000 399.9878
 /begin AXIS_DESCR COM_AXIS RailCD_pAct_mp Pres_Rail 6 200.0000 2000.0000 FORMAT "%5.4" EXTENDED_LIMITS -3276.8000 3276.7000 AXIS_PTS_REF InjVCD_pRailZFCETCor_AXIS /end AXIS_DESCR
 /begin AXIS_DESCR COM_AXIS InjVCD_qInZFCETGMap_mp InjMassInj 6 0.00 3.000000 FORMAT "%8.6" EXTENDED_LIMITS -327.6800 327.6700 AXIS_PTS_REF InjVCD_qZFCETCor_AXIS /end AXIS_DESCR
/end CHARACTERISTIC
/begin CHARACTERISTIC InjVCD_rZFCETDif1_GMAP "Gruppenkennfeld Bewertungsfaktor fuer Ansteuerdauerkorrektur durch Nullmengenkalibrierung am Raildruck-Kalibrierpunkt 1" MAP 0xE2298 Gkf_Ws16 100.0000 Prc 0.00 100.0000 FORMAT "%8.4" EXTENDED_LIMITS -400.0000 399.9878
 /begin AXIS_DESCR COM_AXIS RailCD_pAct_mp Pres_Rail 6 200.0000 2000.0000 FORMAT "%5.4" EXTENDED_LIMITS -3276.8000 3276.7000 AXIS_PTS_REF InjVCD_pRailZFCETCor_AXIS /end AXIS_DESCR
 /begin AXIS_DESCR COM_AXIS InjVCD_qInZFCETGMap_mp InjMassInj 6 0.00 3.000000 FORMAT "%8.6" EXTENDED_LIMITS -327.6800 327.6700 AXIS_PTS_REF InjVCD_qZFCETCor_AXIS /end AXIS_DESCR
/end CHARACTERISTIC
/begin CHARACTERISTIC InjVCD_rZFCETDif2_GMAP "#SSD Gruppenkennfeld Bewertungsfaktor fuer Ansteuerdauerkorrektur durch Nullmengenkalibrierung am Raildruck-Kalibrierpunkt 2" MAP 0xE22E0 Gkf_Ws16 100.0000 Prc 0.00 100.0000 FORMAT "%8.4" EXTENDED_LIMITS -400.0000 399.9878
 /begin AXIS_DESCR COM_AXIS RailCD_pAct_mp Pres_Rail 6 200.0000 2000.0000 FORMAT "%5.4" EXTENDED_LIMITS -3276.8000 3276.7000 AXIS_PTS_REF InjVCD_pRailZFCETCor_AXIS /end AXIS_DESCR
 /begin AXIS_DESCR COM_AXIS InjVCD_qInZFCETGMap_mp InjMassInj 6 0.00 3.000000 FORMAT "%8.6" EXTENDED_LIMITS -327.6800 327.6700 AXIS_PTS_REF InjVCD_qZFCETCor_AXIS /end AXIS_DESCR
/end CHARACTERISTIC
/begin CHARACTERISTIC InjVCD_rZFCETMsk_GMAP "Gruppenkennfeld Gesamtbewertungsfaktor der Ansteuerdauerkorrektur durch Nullmengenkalibrierung" MAP 0xE2328 Gkf_Ws16 100.0000 Prc 0.00 100.0000 FORMAT "%8.4" EXTENDED_LIMITS -400.0000 399.9878
 /begin AXIS_DESCR COM_AXIS RailCD_pAct_mp Pres_Rail 6 200.0000 2000.0000 FORMAT "%5.4" EXTENDED_LIMITS -3276.8000 3276.7000 AXIS_PTS_REF InjVCD_pRailZFCETCor_AXIS /end AXIS_DESCR
 /begin AXIS_DESCR COM_AXIS InjVCD_qInZFCETGMap_mp InjMassInj 6 0.00 3.000000 FORMAT "%8.6" EXTENDED_LIMITS -327.6800 327.6700 AXIS_PTS_REF InjVCD_qZFCETCor_AXIS /end AXIS_DESCR
/end CHARACTERISTIC
/begin CHARACTERISTIC InjVCD_stInjMode_C "#SSD Verhalten der Umschaltung von Anzugsphase auf Haltephase" VALUE 0xC0624 Kw_Wu8 3.000 OneToOne 0.00 3.000 FORMAT "%5.3" EXTENDED_LIMITS 0.00 255.0 /end CHARACTERISTIC
/begin CHARACTERISTIC InjVCD_stInputZFCETGMap_C "Auswahl der Menge fuer Anzeige der Gruppenkennfelder InjVCD_rZFCETDif0_GMAP, ...Dif1_GMAP, ...Msk_GMAP" VALUE 0xE2370 Kw_Wu8 255.0 OneToOne 0.00 255.0 FORMAT "%5.1" /end CHARACTERISTIC
/begin CHARACTERISTIC InjVCD_stZFCETCorActv_C "Aktivierungsstatus der ZFC Ansteuerdauerkorrektur (0 = keine Korrektur)" VALUE 0xE2371 Kw_Wu8 0.00 OneToOne 0.00 0.00 FORMAT "%5.2" EXTENDED_LIMITS 0.00 255.0 /end CHARACTERISTIC
/begin CHARACTERISTIC InjVCD_swtEnaAgDiff_C "#SSD Ein-/Ausschalter zur Berechnung des Differenzwinkels (1: ein, 0: aus)" VALUE 0xE1CA8 Kw_Wu8 1.000 OneToOne 0.00 1.000 FORMAT "%5.3" EXTENDED_LIMITS 0.00 255.0 /end CHARACTERISTIC
/begin CHARACTERISTIC InjVCD_swtInputETMAP_C "Auswahl der Eingangsgrössen zur Darstellung von InjVCD_tiET_MAP auf dem Applikationstool." VALUE 0xE1CAE Kw_Wu8 15.00 OneToOne 0.00 15.00 FORMAT "%5.2" EXTENDED_LIMITS 0.00 255.0 /end CHARACTERISTIC
/begin CHARACTERISTIC InjVCD_swtZFCCorOvrRunOn_C "Schalter zum Einschalten der ZFC-Korrektur bei aktiver Schubüberwachung (1= Korrektur auch bei aktiver Schubüberwachung)" VALUE 0xE2372 Kw_Wu8 0.00 OneToOne 0.00 0.00 FORMAT "%5.2" EXTENDED_LIMITS 0.00 255.0 /end CHARACTERISTIC
/begin CHARACTERISTIC InjVCD_tiETMax_C "#SSD Schwelle für maximal zulässige Ansteuerdauer bei Drehzahl >  InjVCD_nETMaxLim_C" VALUE 0xC0622 Kw_Ws16 65535.00 InjTime_us -32768.00 32767.00 FORMAT "%8.2" /end CHARACTERISTIC
/begin CHARACTERISTIC InjVCD_tiETMinHigh_C "#SSD Obere Schwelle: minimale AD" VALUE 0xE1CAA Kw_Ws16 65535.00 InjTime_us -32768.00 32767.00 FORMAT "%8.2" /end CHARACTERISTIC
/begin CHARACTERISTIC InjVCD_tiETMinLow_C "Minimale Ansteuerdauer" VALUE 0xC0626 Kw_Ws16 65535.00 InjTime_us -32768.00 32767.00 FORMAT "%8.2" /end CHARACTERISTIC
/begin CHARACTERISTIC InjVCD_tiET_MAP "#SSD Kennfeld zur Umrechnung von Einspritzmengen in Ansteuerdauer. Gilt für alle Einspritzungen." MAP 0xE1CB0 Kf_Xs16_Ys16_Ws16 5000.000 InjTime_us 0.00 5000.000 FORMAT "%8.3" EXTENDED_LIMITS -32768.00 32767.00
 /begin AXIS_DESCR STD_AXIS InjVCD_pInET_mp Pres_Rail 16 0.00 2000.000 FORMAT "%5.3" EXTENDED_LIMITS -3276.800 3276.700 DEPOSIT ABSOLUTE /end AXIS_DESCR
 /begin AXIS_DESCR STD_AXIS InjVCD_volInET_mp InjQntInj 40 0.00 327.6700 FORMAT "%8.4" EXTENDED_LIMITS -327.6800 327.6700 DEPOSIT ABSOLUTE /end AXIS_DESCR
/end CHARACTERISTIC
/begin CHARACTERISTIC InjVCD_tiHoldMin_C "kleinste Dauer der Haltestromphase bei einer Einspritzung" VALUE 0xC0628 Kw_Ws16 5000.000 InjTime_us 0.00 5000.000 FORMAT "%8.3" EXTENDED_LIMITS -32768.00 32767.00 /end CHARACTERISTIC
/begin CHARACTERISTIC InjVCD_tiMI1ET_Vector "#SSD Bypass-Label, nicht editieren !" VALUE 0xC3120 Kw_Wu8 255.0 OneToOne 0.00 255.0 FORMAT "%5.1" /end CHARACTERISTIC
/begin CHARACTERISTIC InjVCD_tiMI1ET_Channel "#SSD Bypass-Label, nicht editieren !" VALUE 0xC3121 Kw_Wu8 255.0 OneToOne 0.00 255.0 FORMAT "%5.1" /end CHARACTERISTIC
/begin CHARACTERISTIC InjVCD_tiPickUpCurrBattLo_C "#SSD Anzugsstromdauer im Falle zu niederer Batteriespannung" VALUE 0xE2224 Kw_Ws16 5000.000 InjTime_us 0.00 5000.000 FORMAT "%8.3" EXTENDED_LIMITS -32768.00 32767.00 /end CHARACTERISTIC
/begin CHARACTERISTIC InjVCD_tiPickUpCurr_CUR "#SSD motortemperaturabhängige Anzugsstromdauerkennlinie" CURVE 0xE2226 Kl_Xs16_Ws16 4940.000 InjTime_us 60.00000 5000.000 FORMAT "%8.3" EXTENDED_LIMITS -32768.00 32767.00
 /begin AXIS_DESCR STD_AXIS Eng_tEng Temp_Cels 2 -50.14000 199.8600 FORMAT "%8.4" EXTENDED_LIMITS -3549.940 3003.560 DEPOSIT ABSOLUTE /end AXIS_DESCR
/end CHARACTERISTIC
/begin CHARACTERISTIC InjVCD_tiPiI1ET_Vector "#SSD Bypass-Label, nicht editieren !" VALUE 0xC3122 Kw_Wu8 255.0 OneToOne 0.00 255.0 FORMAT "%5.1" /end CHARACTERISTIC
/begin CHARACTERISTIC InjVCD_tiPiI1ET_Channel "#SSD Bypass-Label, nicht editieren !" VALUE 0xC3123 Kw_Wu8 255.0 OneToOne 0.00 255.0 FORMAT "%5.1" /end CHARACTERISTIC
/begin CHARACTERISTIC InjVCD_tiPiI2ET_Vector "#SSD Bypass-Label, nicht editieren !" VALUE 0xC3124 Kw_Wu8 255.0 OneToOne 0.00 255.0 FORMAT "%5.1" /end CHARACTERISTIC
/begin CHARACTERISTIC InjVCD_tiPiI2ET_Channel "#SSD Bypass-Label, nicht editieren !" VALUE 0xC3125 Kw_Wu8 255.0 OneToOne 0.00 255.0 FORMAT "%5.1" /end CHARACTERISTIC
/begin CHARACTERISTIC InjVCD_tiPoI1ET_Vector "#SSD Bypass-Label, nicht editieren !" VALUE 0xC3126 Kw_Wu8 255.0 OneToOne 0.00 255.0 FORMAT "%5.1" /end CHARACTERISTIC
/begin CHARACTERISTIC InjVCD_tiPoI1ET_Channel "#SSD Bypass-Label, nicht editieren !" VALUE 0xC3127 Kw_Wu8 255.0 OneToOne 0.00 255.0 FORMAT "%5.1" /end CHARACTERISTIC
/begin CHARACTERISTIC InjVCD_tiPoI2ET_Vector "#SSD Bypass-Label, nicht editieren !" VALUE 0xC3128 Kw_Wu8 255.0 OneToOne 0.00 255.0 FORMAT "%5.1" /end CHARACTERISTIC
/begin CHARACTERISTIC InjVCD_tiPoI2ET_Channel "#SSD Bypass-Label, nicht editieren !" VALUE 0xC3129 Kw_Wu8 255.0 OneToOne 0.00 255.0 FORMAT "%5.1" /end CHARACTERISTIC
/begin CHARACTERISTIC InjVCD_tiZFCETCorMax_C "maximale ZFC Ansteuerdauerkorrektur" VALUE 0xE2374 Kw_Ws16 5300.0000 InjTime_us -300.0000 5000.0000 FORMAT "%8.4" EXTENDED_LIMITS -32768.00 32767.00 /end CHARACTERISTIC
/begin CHARACTERISTIC InjVCD_tiZFCETCorMin_C "minimale ZFC Ansteuerdauerkorrektur" VALUE 0xE2376 Kw_Ws16 5300.0000 InjTime_us -300.0000 5000.0000 FORMAT "%8.4" EXTENDED_LIMITS -32768.00 32767.00 /end CHARACTERISTIC
/begin CHARACTERISTIC InjVCD_uThresDeltaHi_C "#SSD Delta zur unteren Batteriespannungsschwelle, bei der die Anzugsstromdauer durch eine Kennline bestimmt wird" VALUE 0xE2230 Kw_Ws16 14897.36 Volt_Batt 97.75171 14995.11 FORMAT "%8.2" EXTENDED_LIMITS -640625.6 640606.1 /end CHARACTERISTIC
/begin CHARACTERISTIC InjVCD_uThresLo_C "#SSD untere Batteriespannungsschwelle, bei der die Anzugsstromdauer durch einen vorgegeben Wert bestimmt wird" VALUE 0xE2232 Kw_Ws16 14995.11 Volt_Batt 0.00 14995.11 FORMAT "%8.2" EXTENDED_LIMITS -640625.6 640606.1 /end CHARACTERISTIC
/begin CHARACTERISTIC InjVlv_DebBnkA0Def_C "#SSD Defektentprellung für A Bankfehlerpfade Bit 0" VALUE 0xE23B0 Kw_Wu16 65534.00 OneToOne 1.000000 65535.00 FORMAT "%8.2" EXTENDED_LIMITS 0.00 65535.00 /end CHARACTERISTIC
/begin CHARACTERISTIC InjVlv_DebBnkA0Ok_C "#SSD Heilungsentprellung für A Bankfehlerpfade Bit 0" VALUE 0xE23B2 Kw_Wu16 65535.00 OneToOne 0.00 65535.00 FORMAT "%8.2" /end CHARACTERISTIC
/begin CHARACTERISTIC InjVlv_DebBnkA1Def_C "#SSD Defektentprellung für A Bankfehlerpfade Bit 1" VALUE 0xE23B4 Kw_Wu16 65534.00 OneToOne 1.000000 65535.00 FORMAT "%8.2" EXTENDED_LIMITS 0.00 65535.00 /end CHARACTERISTIC
/begin CHARACTERISTIC InjVlv_DebBnkA1Ok_C "#SSD Heilungsentprellung für A Bankfehlerpfade Bit 1" VALUE 0xE23B6 Kw_Wu16 65535.00 OneToOne 0.00 65535.00 FORMAT "%8.2" /end CHARACTERISTIC
/begin CHARACTERISTIC InjVlv_DebBnkA2Def_C "#SSD Defektentprellung für A Bankfehlerpfade Bit 2" VALUE 0xE23B8 Kw_Wu16 65534.00 OneToOne 1.000000 65535.00 FORMAT "%8.2" EXTENDED_LIMITS 0.00 65535.00 /end CHARACTERISTIC
/begin CHARACTERISTIC InjVlv_DebBnkA2Ok_C "#SSD Heilungsentprellung für A Bankfehlerpfade Bit 2" VALUE 0xE23BA Kw_Wu16 65535.00 OneToOne 0.00 65535.00 FORMAT "%8.2" /end CHARACTERISTIC
/begin CHARACTERISTIC InjVlv_DebBnkA3Def_C "#SSD Defektentprellung für A Bankfehlerpfade Bit 3" VALUE 0xE23BC Kw_Wu16 65534.00 OneToOne 1.000000 65535.00 FORMAT "%8.2" EXTENDED_LIMITS 0.00 65535.00 /end CHARACTERISTIC
/begin CHARACTERISTIC InjVlv_DebBnkA3Ok_C "#SSD Heilungsentprellung für A Bankfehlerpfade Bit 3" VALUE 0xE23BE Kw_Wu16 65535.00 OneToOne 0.00 65535.00 FORMAT "%8.2" /end CHARACTERISTIC
/begin CHARACTERISTIC InjVlv_DebBnkB0Def_C "#SSD Defektentprellung für B Bankfehlerpfade Bit 0" VALUE 0xE23C0 Kw_Wu16 65534.00 OneToOne 1.000000 65535.00 FORMAT "%8.2" EXTENDED_LIMITS 0.00 65535.00 /end CHARACTERISTIC
/begin CHARACTERISTIC InjVlv_DebBnkB0Ok_C "#SSD Heilungsentprellung für B Bankfehlerpfade Bit 0" VALUE 0xE23C2 Kw_Wu16 65535.00 OneToOne 0.00 65535.00 FORMAT "%8.2" /end CHARACTERISTIC
/begin CHARACTERISTIC InjVlv_DebBnkB1Def_C "#SSD Defektentprellung für B Bankfehlerpfade Bit 1" VALUE 0xE23C4 Kw_Wu16 65534.00 OneToOne 1.000000 65535.00 FORMAT "%8.2" EXTENDED_LIMITS 0.00 65535.00 /end CHARACTERISTIC
/begin CHARACTERISTIC InjVlv_DebBnkB1Ok_C "#SSD Heilungsentprellung für B Bankfehlerpfade Bit 1" VALUE 0xE23C6 Kw_Wu16 65535.00 OneToOne 0.00 65535.00 FORMAT "%8.2" /end CHARACTERISTIC
/begin CHARACTERISTIC InjVlv_DebBnkB2Def_C "#SSD Defektentprellung für B Bankfehlerpfade Bit 2" VALUE 0xE23C8 Kw_Wu16 65534.00 OneToOne 1.000000 65535.00 FORMAT "%8.2" EXTENDED_LIMITS 0.00 65535.00 /end CHARACTERISTIC
/begin CHARACTERISTIC InjVlv_DebBnkB2Ok_C "#SSD Heilungsentprellung für B Bankfehlerpfade Bit 2" VALUE 0xE23CA Kw_Wu16 65535.00 OneToOne 0.00 65535.00 FORMAT "%8.2" /end CHARACTERISTIC
/begin CHARACTERISTIC InjVlv_DebBnkB3Def_C "#SSD Defektentprellung für B Bankfehlerpfade Bit 3" VALUE 0xE23CC Kw_Wu16 65534.00 OneToOne 1.000000 65535.00 FORMAT "%8.2" EXTENDED_LIMITS 0.00 65535.00 /end CHARACTERISTIC
/begin CHARACTERISTIC InjVlv_DebBnkB3Ok_C "#SSD Heilungsentprellung für B Bankfehlerpfade Bit 3" VALUE 0xE23CE Kw_Wu16 65535.00 OneToOne 0.00 65535.00 FORMAT "%8.2" /end CHARACTERISTIC
/begin CHARACTERISTIC InjVlv_DebChipA0Def_C "#SSD Defektentprellung für  A Bausteinfehlerpfade Bit 0" VALUE 0xE23D0 Kw_Wu16 65534.00 OneToOne 1.000000 65535.00 FORMAT "%8.2" EXTENDED_LIMITS 0.00 65535.00 /end CHARACTERISTIC
/begin CHARACTERISTIC InjVlv_DebChipA0Ok_C "#SSD Heilungsentprellung für  A Bausteinfehlerpfade Bit 0" VALUE 0xE23D2 Kw_Wu16 65535.00 OneToOne 0.00 65535.00 FORMAT "%8.2" /end CHARACTERISTIC
/begin CHARACTERISTIC InjVlv_DebChipA1Def_C "#SSD Defektentprellung für  A Bausteinfehlerpfade Bit 1" VALUE 0xE23D4 Kw_Wu16 65534.00 OneToOne 1.000000 65535.00 FORMAT "%8.2" EXTENDED_LIMITS 0.00 65535.00 /end CHARACTERISTIC
/begin CHARACTERISTIC InjVlv_DebChipA1Ok_C "#SSD Heilungsentprellung für  A Bausteinfehlerpfade Bit 1" VALUE 0xE23D6 Kw_Wu16 65535.00 OneToOne 0.00 65535.00 FORMAT "%8.2" /end CHARACTERISTIC
/begin CHARACTERISTIC InjVlv_DebChipA2Def_C "#SSD Defektentprellung für  A Bausteinfehlerpfade Bit 2" VALUE 0xE23D8 Kw_Wu16 65534.00 OneToOne 1.000000 65535.00 FORMAT "%8.2" EXTENDED_LIMITS 0.00 65535.00 /end CHARACTERISTIC
/begin CHARACTERISTIC InjVlv_DebChipA2Ok_C "#SSD Heilungsentprellung für  A Bausteinfehlerpfade Bit 2" VALUE 0xE23DA Kw_Wu16 65535.00 OneToOne 0.00 65535.00 FORMAT "%8.2" /end CHARACTERISTIC
/begin CHARACTERISTIC InjVlv_DebChipA3Def_C "#SSD Defektentprellung für  A Bausteinfehlerpfade Bit 3" VALUE 0xE23DC Kw_Wu16 65534.00 OneToOne 1.000000 65535.00 FORMAT "%8.2" EXTENDED_LIMITS 0.00 65535.00 /end CHARACTERISTIC
/begin CHARACTERISTIC InjVlv_DebChipA3Ok_C "#SSD Heilungsentprellung für  A Bausteinfehlerpfade Bit 3" VALUE 0xE23DE Kw_Wu16 65535.00 OneToOne 0.00 65535.00 FORMAT "%8.2" /end CHARACTERISTIC
/begin CHARACTERISTIC InjVlv_DebChipB0Def_C "#SSD Defektentprellung für  B Bausteinfehlerpfade Bit 0" VALUE 0xE23E0 Kw_Wu16 65534.00 OneToOne 1.000000 65535.00 FORMAT "%8.2" EXTENDED_LIMITS 0.00 65535.00 /end CHARACTERISTIC
/begin CHARACTERISTIC InjVlv_DebChipB0Ok_C "#SSD Heilungsentprellung für  B Bausteinfehlerpfade Bit 0" VALUE 0xE23E2 Kw_Wu16 65535.00 OneToOne 0.00 65535.00 FORMAT "%8.2" /end CHARACTERISTIC
/begin CHARACTERISTIC InjVlv_DebChipB1Def_C "#SSD Defektentprellung für  B Bausteinfehlerpfade Bit 1" VALUE 0xE23E4 Kw_Wu16 65534.00 OneToOne 1.000000 65535.00 FORMAT "%8.2" EXTENDED_LIMITS 0.00 65535.00 /end CHARACTERISTIC
/begin CHARACTERISTIC InjVlv_DebChipB1Ok_C "#SSD Heilungsentprellung für  B Bausteinfehlerpfade Bit 1" VALUE 0xE23E6 Kw_Wu16 65535.00 OneToOne 0.00 65535.00 FORMAT "%8.2" /end CHARACTERISTIC
/begin CHARACTERISTIC InjVlv_DebChipB2Def_C "#SSD Defektentprellung für  B Bausteinfehlerpfade Bit 2" VALUE 0xE23E8 Kw_Wu16 65534.00 OneToOne 1.000000 65535.00 FORMAT "%8.2" EXTENDED_LIMITS 0.00 65535.00 /end CHARACTERISTIC
/begin CHARACTERISTIC InjVlv_DebChipB2Ok_C "#SSD Heilungsentprellung für  B Bausteinfehlerpfade Bit 2" VALUE 0xE23EA Kw_Wu16 65535.00 OneToOne 0.00 65535.00 FORMAT "%8.2" /end CHARACTERISTIC
/begin CHARACTERISTIC InjVlv_DebChipB3Def_C "#SSD Defektentprellung für  B Bausteinfehlerpfade Bit 3" VALUE 0xE23EC Kw_Wu16 65534.00 OneToOne 1.000000 65535.00 FORMAT "%8.2" EXTENDED_LIMITS 0.00 65535.00 /end CHARACTERISTIC
/begin CHARACTERISTIC InjVlv_DebChipB3Ok_C "#SSD Heilungsentprellung für  B Bausteinfehlerpfade Bit 3" VALUE 0xE23EE Kw_Wu16 65535.00 OneToOne 0.00 65535.00 FORMAT "%8.2" /end CHARACTERISTIC
/begin CHARACTERISTIC InjVlv_DebCylA0Def_C "#SSD Defektentprellung für A Zylinderfehlerpfade Bit 0" VALUE 0xE23F0 Kw_Wu16 65534.00 OneToOne 1.000000 65535.00 FORMAT "%8.2" EXTENDED_LIMITS 0.00 65535.00 /end CHARACTERISTIC
/begin CHARACTERISTIC InjVlv_DebCylA0Ok_C "#SSD Heilungsentprellung für A Zylinderfehlerpfade Bit 0" VALUE 0xE23F2 Kw_Wu16 65535.00 OneToOne 0.00 65535.00 FORMAT "%8.2" /end CHARACTERISTIC
/begin CHARACTERISTIC InjVlv_DebCylA1Def_C "#SSD Defektentprellung für A Zylinderfehlerpfade Bit 1" VALUE 0xE23F4 Kw_Wu16 65534.00 OneToOne 1.000000 65535.00 FORMAT "%8.2" EXTENDED_LIMITS 0.00 65535.00 /end CHARACTERISTIC
/begin CHARACTERISTIC InjVlv_DebCylA1Ok_C "#SSD Heilungsentprellung für A Zylinderfehlerpfade Bit 1" VALUE 0xE23F6 Kw_Wu16 65535.00 OneToOne 0.00 65535.00 FORMAT "%8.2" /end CHARACTERISTIC
/begin CHARACTERISTIC InjVlv_DebCylA2Def_C "#SSD Defektentprellung für A Zylinderfehlerpfade Bit 2" VALUE 0xE23F8 Kw_Wu16 65534.00 OneToOne 1.000000 65535.00 FORMAT "%8.2" EXTENDED_LIMITS 0.00 65535.00 /end CHARACTERISTIC
/begin CHARACTERISTIC InjVlv_DebCylA2Ok_C "#SSD Heilungsentprellung für A Zylinderfehlerpfade Bit 2" VALUE 0xE23FA Kw_Wu16 65535.00 OneToOne 0.00 65535.00 FORMAT "%8.2" /end CHARACTERISTIC
/begin CHARACTERISTIC InjVlv_DebCylA3Def_C "#SSD Defektentprellung für A Zylinderfehlerpfade Bit 3" VALUE 0xE23FC Kw_Wu16 65534.00 OneToOne 1.000000 65535.00 FORMAT "%8.2" EXTENDED_LIMITS 0.00 65535.00 /end CHARACTERISTIC
/begin CHARACTERISTIC InjVlv_DebCylA3Ok_C "#SSD Heilungsentprellung für A Zylinderfehlerpfade Bit 3" VALUE 0xE23FE Kw_Wu16 65535.00 OneToOne 0.00 65535.00 FORMAT "%8.2" /end CHARACTERISTIC
/begin CHARACTERISTIC InjVlv_DebCylB0Def_C "#SSD Defektentprellung für B Zylinderfehlerpfade Bit 0" VALUE 0xE2400 Kw_Wu16 65534.00 OneToOne 1.000000 65535.00 FORMAT "%8.2" EXTENDED_LIMITS 0.00 65535.00 /end CHARACTERISTIC
/begin CHARACTERISTIC InjVlv_DebCylB0Ok_C "#SSD Heilungsentprellung für B Zylinderfehlerpfade Bit 0" VALUE 0xE2402 Kw_Wu16 65535.00 OneToOne 0.00 65535.00 FORMAT "%8.2" /end CHARACTERISTIC
/begin CHARACTERISTIC InjVlv_DebCylB1Def_C "#SSD Defektentprellung für B Zylinderfehlerpfade Bit 1" VALUE 0xE2404 Kw_Wu16 65534.00 OneToOne 1.000000 65535.00 FORMAT "%8.2" EXTENDED_LIMITS 0.00 65535.00 /end CHARACTERISTIC
/begin CHARACTERISTIC InjVlv_DebCylB1Ok_C "#SSD Heilungsentprellung für B Zylinderfehlerpfade Bit 1" VALUE 0xE2406 Kw_Wu16 65535.00 OneToOne 0.00 65535.00 FORMAT "%8.2" /end CHARACTERISTIC
/begin CHARACTERISTIC InjVlv_DebCylB2Def_C "#SSD Defektentprellung für B Zylinderfehlerpfade Bit 2" VALUE 0xE2408 Kw_Wu16 65534.00 OneToOne 1.000000 65535.00 FORMAT "%8.2" EXTENDED_LIMITS 0.00 65535.00 /end CHARACTERISTIC
/begin CHARACTERISTIC InjVlv_DebCylB2Ok_C "#SSD Heilungsentprellung für B Zylinderfehlerpfade Bit 2" VALUE 0xE240A Kw_Wu16 65535.00 OneToOne 0.00 65535.00 FORMAT "%8.2" /end CHARACTERISTIC
/begin CHARACTERISTIC InjVlv_DebCylB3Def_C "#SSD Defektentprellung für B Zylinderfehlerpfade Bit 3" VALUE 0xE240C Kw_Wu16 65534.00 OneToOne 1.000000 65535.00 FORMAT "%8.2" EXTENDED_LIMITS 0.00 65535.00 /end CHARACTERISTIC
/begin CHARACTERISTIC InjVlv_DebCylB3Ok_C "#SSD Heilungsentprellung für B Zylinderfehlerpfade Bit 3" VALUE 0xE240E Kw_Wu16 65535.00 OneToOne 0.00 65535.00 FORMAT "%8.2" /end CHARACTERISTIC
/begin CHARACTERISTIC InjVlv_facAddBalRls_MAP "Freigabekennfeld zur Aufrechnung der Mengenkorrektur" MAP 0xE2378 Kf_Xs16_Ys16_Ws16 1.000000 Fact 0.00 1.000000 FORMAT "%8.6" EXTENDED_LIMITS -4.000000 3.999878
 /begin AXIS_DESCR STD_AXIS RailCD_pPeak Pres_Rail 3 0.00 2000.000 FORMAT "%5.3" EXTENDED_LIMITS -3276.800 3276.700 DEPOSIT ABSOLUTE /end AXIS_DESCR
 /begin AXIS_DESCR STD_AXIS InjCtl_qSetUnBal InjMassCyc 2 0.00 327.6700 FORMAT "%8.4" EXTENDED_LIMITS -327.6800 327.6700 DEPOSIT ABSOLUTE /end AXIS_DESCR
/end CHARACTERISTIC
/begin CHARACTERISTIC InjVlv_facFTSWvCor_MAP "KF für die Berechnung des kraftstofftemperaturabhängigen Druckwellenkorrekturfaktors" MAP 0xE291A Kf_Xs16_Ys16_Ws16 2.000000 Fact 0.00 2.000000 FORMAT "%8.6" EXTENDED_LIMITS -4.000000 3.999878
 /begin AXIS_DESCR STD_AXIS RailCD_pPeak Pres_Rail 16 0.00 2000.000 FORMAT "%5.3" EXTENDED_LIMITS -3276.800 3276.700 DEPOSIT ABSOLUTE /end AXIS_DESCR
 /begin AXIS_DESCR STD_AXIS InjVlv_tWvCor_mp Temp_Cels 8 -50.1400 199.8600 FORMAT "%8.4" EXTENDED_LIMITS -3549.940 3003.560 DEPOSIT ABSOLUTE /end AXIS_DESCR
/end CHARACTERISTIC
/begin CHARACTERISTIC InjVlv_facPiI2WvCor_C "Gewichtungsfaktor der Druckwellenkorrekturmenge der MI1 abhängig von PiI2" VALUE 0xE2CE6 Kw_Ws16 1.000000 Fact 0.00 1.000000 FORMAT "%8.6" EXTENDED_LIMITS -4.000000 3.999878 /end CHARACTERISTIC
/begin CHARACTERISTIC InjVlv_facWvCor1_MAP "KF 1 für Gewichtungsfaktor der Druckwellenkorrektur" MAP 0xE2CE8 Kf_Xs16_Ys16_Ws16 10.00000 Fact1 0.00 10.00000 FORMAT "%8.5" EXTENDED_LIMITS -256.0000 255.9922
 /begin AXIS_DESCR STD_AXIS InjCrv_qMI1Des InjMassInj 8 0.00 327.6700 FORMAT "%8.4" EXTENDED_LIMITS -327.6800 327.6700 DEPOSIT ABSOLUTE /end AXIS_DESCR
 /begin AXIS_DESCR STD_AXIS RailCD_pAct_mp Pres_Rail 16 0.00 2000.000 FORMAT "%5.3" EXTENDED_LIMITS -3276.800 3276.700 DEPOSIT ABSOLUTE /end AXIS_DESCR
/end CHARACTERISTIC
/begin CHARACTERISTIC InjVlv_facWvCor2_MAP "KF 2 für Gewichtungsfaktor der Druckwellenkorrektur" MAP 0xE2E1C Kf_Xs16_Ys16_Ws16 10.00000 Fact1 0.00 10.00000 FORMAT "%8.5" EXTENDED_LIMITS -256.0000 255.9922
 /begin AXIS_DESCR STD_AXIS InjCrv_qPoI2Des_mp InjMassInj 8 0.00 327.6700 FORMAT "%8.4" EXTENDED_LIMITS -327.6800 327.6700 DEPOSIT ABSOLUTE /end AXIS_DESCR
 /begin AXIS_DESCR STD_AXIS RailCD_pAct_mp Pres_Rail 16 0.00 2000.000 FORMAT "%5.3" EXTENDED_LIMITS -3276.800 3276.700 DEPOSIT ABSOLUTE /end AXIS_DESCR
/end CHARACTERISTIC
/begin CHARACTERISTIC InjVlv_numInjChrgBal_MAP "#SSD max. Anzahl an Einspritzungen aufgrund Ladungsbilanz Boosterkondensators" MAP 0xE2394 Kf_Xs16_Ys16_Ws16 6.000000 OneToOne 0.00 6.000000 FORMAT "%8.6" EXTENDED_LIMITS -32768.00 32767.00
 /begin AXIS_DESCR STD_AXIS Eng_nAvrg EngN 2 0.00 6000.000 FORMAT "%8.3" EXTENDED_LIMITS -32768.00 32767.00 DEPOSIT ABSOLUTE /end AXIS_DESCR
 /begin AXIS_DESCR STD_AXIS BattCD_u Volt_Batt 2 -640625.6 640606.1 FORMAT "%8.1" DEPOSIT ABSOLUTE /end AXIS_DESCR
/end CHARACTERISTIC
/begin CHARACTERISTIC InjVlv_numNoLoadCylMax_C "#SSD maximale zulässige Anzahl von Zylindern mit Lastabfall" VALUE 0xE2410 Kw_Wu8 8.000 OneToOne 0.00 8.000 FORMAT "%5.3" EXTENDED_LIMITS 0.00 255.0 /end CHARACTERISTIC
/begin CHARACTERISTIC InjVlv_numSegOfs1_C "Semgentoffset für die Bestimmung der zylinderselektiven Drehzahlen für Testmodus a" VALUE 0xE23AC Kw_Wu8 11.00 OneToOne 0.00 11.00 FORMAT "%5.2" EXTENDED_LIMITS 0.00 255.0 /end CHARACTERISTIC
/begin CHARACTERISTIC InjVlv_numSegOfs2_C "Semgentoffset für die Bestimmung der zylinderselektiven Drehzahlen für Testmodus b und c" VALUE 0xE23AD Kw_Wu8 11.00 OneToOne 0.00 11.00 FORMAT "%5.2" EXTENDED_LIMITS 0.00 255.0 /end CHARACTERISTIC
/begin CHARACTERISTIC InjVlv_pMin_C "#SSD Injektorabhängige Druckschwelle zur Freigabe/Sperrung der Einspritzung" VALUE 0xE2514 Kw_Ws16 2000.000 Pres_Rail 0.00 2000.000 FORMAT "%5.3" EXTENDED_LIMITS -3276.800 3276.700 /end CHARACTERISTIC
/begin CHARACTERISTIC InjVlv_pMin_CUR "#SSD Kühlmitteltemperaturabhängige Druckschwelle zur Freigabe der Einspritzungen" CURVE 0xE2516 Kl_Xs16_Ws16 2000.000 Pres_Rail 0.00 2000.000 FORMAT "%5.3" EXTENDED_LIMITS -3276.800 3276.700
 /begin AXIS_DESCR STD_AXIS Eng_tEng Temp_Cels 8 -50.14000 199.8600 FORMAT "%8.4" EXTENDED_LIMITS -3549.940 3003.560 DEPOSIT ABSOLUTE /end AXIS_DESCR
/end CHARACTERISTIC
/begin CHARACTERISTIC InjVlv_qWvCor1_MAP "Grundwerte-KF 1 der Druckwellenkorrekturmenge" MAP 0xE2F50 Kf_Xs16_Ys16_Ws16 655.3400 InjMassInj -327.6700 327.6700 FORMAT "%8.4" EXTENDED_LIMITS -327.6800 327.6700
 /begin AXIS_DESCR STD_AXIS InjVlv_tiPiI1MI1Cor_mp InjTime_us 32 0.00 13000.00 FORMAT "%8.2" EXTENDED_LIMITS -32768.00 32767.00 DEPOSIT ABSOLUTE /end AXIS_DESCR
 /begin AXIS_DESCR STD_AXIS InjCrv_qPiI1Des InjMassInj 16 0.00 327.6700 FORMAT "%8.4" EXTENDED_LIMITS -327.6800 327.6700 DEPOSIT ABSOLUTE /end AXIS_DESCR
/end CHARACTERISTIC
/begin CHARACTERISTIC InjVlv_qWvCor2_MAP "Grundwerte-KF 2 der Druckwellenkorrekturmenge" MAP 0xE33B4 Kf_Xs16_Ys16_Ws16 655.3400 InjMassInj -327.6700 327.6700 FORMAT "%8.4" EXTENDED_LIMITS -327.6800 327.6700
 /begin AXIS_DESCR STD_AXIS InjVlv_tiMI1PoI2Cor_mp InjTime_us 32 0.00 13000.00 FORMAT "%8.2" EXTENDED_LIMITS -32768.00 32767.00 DEPOSIT ABSOLUTE /end AXIS_DESCR
 /begin AXIS_DESCR STD_AXIS InjVlv_rMI1WvCorNorm_mp QntR 16 0.0009765625 24.00000 FORMAT "%8.5" EXTENDED_LIMITS -32.00000 31.99902 DEPOSIT ABSOLUTE /end AXIS_DESCR
/end CHARACTERISTIC
/begin CHARACTERISTIC InjVlv_qWvCorMax_C "#SSD maximale Begrenzungsmenge der Druckwellenkorrektur" VALUE 0xE3818 Kw_Ws16 20.00000 InjMassInj -10.00000 10.00000 FORMAT "%8.5" EXTENDED_LIMITS -327.6800 327.6700 /end CHARACTERISTIC
/begin CHARACTERISTIC InjVlv_qWvCorMin_C "#SSD minimale Begrenzungsmenge der Druckwellenkorrektur" VALUE 0xE381A Kw_Ws16 20.00000 InjMassInj -10.00000 10.00000 FORMAT "%8.5" EXTENDED_LIMITS -327.6800 327.6700 /end CHARACTERISTIC
/begin CHARACTERISTIC InjVlv_qWvCorNorm_CUR "Kennlinie für die raildruckabhängige Einspritznormierungsmenge" CURVE 0xE2A4E Kl_Xs16_Ws16 327.6600 InjMassInj 0.01000000 327.6700 FORMAT "%8.4" EXTENDED_LIMITS -327.6800 327.6700
 /begin AXIS_DESCR STD_AXIS RailCD_pPeak Pres_Rail 20 0.00 2000.000 FORMAT "%5.3" EXTENDED_LIMITS -3276.800 3276.700 DEPOSIT ABSOLUTE /end AXIS_DESCR
/end CHARACTERISTIC
/begin CHARACTERISTIC InjVlv_rChrgBalEngSpdHys_C "#SSD Drehzahl Hystereseschwelle für die Auswahl der max. Anzahl an Einspritzungen aufgrund der Ladungsbilanz des Boosterkondensators" VALUE 0xE23A8 Kw_Wu16 100.0000 Prc 0.00 100.0000 FORMAT "%8.4" EXTENDED_LIMITS 0.00 799.9878 /end CHARACTERISTIC
/begin CHARACTERISTIC InjVlv_rChrgBalVltgHys_C "#SSD Batteriespannungs Hystereseschwelle für Auswahl der max. Anzahl an Einspritzungen aufgrund Ladungsbilanz Boosterkondensators" VALUE 0xE23AA Kw_Wu16 100.0000 Prc 0.00 100.0000 FORMAT "%8.4" EXTENDED_LIMITS 0.00 799.9878 /end CHARACTERISTIC
/begin CHARACTERISTIC InjVlv_stErrDet_C "Status der Injektorfehlererkennung" VALUE 0xE23AE Kw_Wu8 1.000 OneToOne 0.00 1.000 FORMAT "%5.3" EXTENDED_LIMITS 0.00 255.0 /end CHARACTERISTIC
/begin CHARACTERISTIC InjVlv_stErrMskPattern_C "#SSD Pattern-Matrix zur Mustererkennung" VAL_BLK 0xE2414 Kwb_Wu32 4294967295.00 OneToOne 0.00 4294967295.00 FORMAT "%13.2" NUMBER 32 /end CHARACTERISTIC
/begin CHARACTERISTIC InjVlv_stErrMskSelect_C "#SSD Select-Matrix zur Mustererkennung" VAL_BLK 0xE2494 Kwb_Wu32 4294967295.00 OneToOne 0.00 4294967295.00 FORMAT "%13.2" NUMBER 32 /end CHARACTERISTIC
/begin CHARACTERISTIC InjVlv_stInputAddBalMap_C "y-Eingang des Kennfelds InjVCD_facAddBalRls_MAP auf dem Applikationswerkzeug" VALUE 0xE2392 Kw_Wu8 255.0 OneToOne 0.00 255.0 FORMAT "%5.1" /end CHARACTERISTIC
/begin CHARACTERISTIC InjVlv_stQntAdjRepl_C "Ersatzwerte für Injektormengenabgleich" VAL_BLK 0xE26A0 Kwb_Wu32 4294967295.00 OneToOne 0.00 4294967295.00 FORMAT "%13.2" NUMBER 12 /end CHARACTERISTIC
/begin CHARACTERISTIC InjVlv_stQntAdj_MAP "Statuskennfeld (Index und Gewichtungsfaktor) für den Injektor-Mengenabgleich" MAP 0xE2538 Kf_Xs16_Ys16_Ws16 32767.00 OneToOne 0.00 32767.00 FORMAT "%8.2" EXTENDED_LIMITS -32768.00 32767.00
 /begin AXIS_DESCR STD_AXIS RailCD_pPeak Pres_Rail 10 0.00 2000.000 FORMAT "%5.3" EXTENDED_LIMITS -3276.800 3276.700 DEPOSIT ABSOLUTE /end AXIS_DESCR
 /begin AXIS_DESCR STD_AXIS InjUn_volMI1Cor_mp InjQntInj 10 0.00 100.0000 FORMAT "%8.4" EXTENDED_LIMITS -327.6800 327.6700 DEPOSIT ABSOLUTE /end AXIS_DESCR
/end CHARACTERISTIC
/begin CHARACTERISTIC InjVlv_stWvCorActv_C "Freigabe der Druckwellenkorrektur" VALUE 0xE2AA0 Kw_Wu8 1.000 OneToOne 0.00 1.000 FORMAT "%5.3" EXTENDED_LIMITS 0.00 255.0 /end CHARACTERISTIC
/begin CHARACTERISTIC InjVlv_swtDiffHydInSel_C "Auswahl für Darstellung des Betriebspunktes im Kennfeld InjVlv_tiDiffHyd_MAP (1,2,3: Darstellung, sonst: keine Darstellung)" VALUE 0xE26D4 Kw_Wu8 2.000 OneToOne 0.00 2.000 FORMAT "%5.3" EXTENDED_LIMITS 0.00 255.0 /end CHARACTERISTIC
/begin CHARACTERISTIC InjVlv_swtQntAdj_C "Schalter zum Ersetzen der Mengenabgleichwerte (0...EEPROM, 1...Ersatzwerte)" VALUE 0xE26D0 Kw_Wu8 1.000 OneToOne 0.00 1.000 FORMAT "%5.3" EXTENDED_LIMITS 0.00 255.0 /end CHARACTERISTIC
/begin CHARACTERISTIC InjVlv_tiDiffHyd_MAP "Kennfeld mit Differenzzeiten zwischen hydraulischem Nadelschliessende und elektrischem Ansteuerende" MAP 0xE26D6 Kf_Xs16_Ys16_Ws16 10000.00 InjTime_us -5000.000 5000.000 FORMAT "%8.3" EXTENDED_LIMITS -32768.00 32767.00
 /begin AXIS_DESCR STD_AXIS InjVlv_pActInDiffHyd_mp Pres_Rail 16 0.00 2000.000 FORMAT "%5.3" EXTENDED_LIMITS -3276.800 3276.700 DEPOSIT ABSOLUTE /end AXIS_DESCR
 /begin AXIS_DESCR STD_AXIS InjVlv_qDesInDiffHyd_mp InjMassInj 16 0.00 327.6700 FORMAT "%8.4" EXTENDED_LIMITS -327.6800 327.6700 DEPOSIT ABSOLUTE /end AXIS_DESCR
/end CHARACTERISTIC
/begin CHARACTERISTIC InjVlv_tWvCor_MAP "KF fuer die Eingangstemperatur der Druckwellenkorrektur" MAP 0xE2AA2 Kf_Xs16_Ys16_Ws16 250.0000 Temp_Cels -50.1400 199.8600 FORMAT "%8.4" EXTENDED_LIMITS -3549.940 3003.560
 /begin AXIS_DESCR STD_AXIS FTSCD_tFuel Temp_Cels 16 -50.14000 199.8600 FORMAT "%8.4" EXTENDED_LIMITS -3549.940 3003.560 DEPOSIT ABSOLUTE /end AXIS_DESCR
 /begin AXIS_DESCR STD_AXIS CTSCD_tClnt Temp_Cels 16 -50.14000 199.8600 FORMAT "%8.4" EXTENDED_LIMITS -3549.940 3003.560 DEPOSIT ABSOLUTE /end AXIS_DESCR
/end CHARACTERISTIC
/begin CHARACTERISTIC InjVlv_volQntAdjLim_C "#SSD symmetrische Begrenzung des Mengen-Abgleichwertes" VALUE 0xE262C Kw_Ws16 128.0000 InjQntInj 0.00 128.0000 FORMAT "%8.4" EXTENDED_LIMITS -327.6800 327.6700 /end CHARACTERISTIC
/begin CHARACTERISTIC InjVlv_volQntAdjMax0_C "obere Grenzwerte der Mengen-Abgleichwerte für die ""0""-Quantisierungsschrittweite (0d=00b)" VAL_BLK 0xE262E Kwb_Ws16 6.300000 InjQntInj 0.00 6.300000 FORMAT "%8.6" EXTENDED_LIMITS -327.6800 327.6700 NUMBER 7 /end CHARACTERISTIC
/begin CHARACTERISTIC InjVlv_volQntAdjMax1_C "obere Grenzwerte der Mengen-Abgleichwerte für die ""1""-Quantisierungsschrittweite (1d=01b)" VAL_BLK 0xE263C Kwb_Ws16 9.450000 InjQntInj 0.00 9.450000 FORMAT "%8.6" EXTENDED_LIMITS -327.6800 327.6700 NUMBER 7 /end CHARACTERISTIC
/begin CHARACTERISTIC InjVlv_volQntAdjMax2_C "obere Grenzwerte der Mengen-Abgleichwerte für die ""2""-Quantisierungsschrittweite (2d=10b)" VAL_BLK 0xE264A Kwb_Ws16 15.75000 InjQntInj 0.00 15.75000 FORMAT "%8.5" EXTENDED_LIMITS -327.6800 327.6700 NUMBER 7 /end CHARACTERISTIC
/begin CHARACTERISTIC InjVlv_volQntAdjMax3_C "obere Grenzwerte der Mengen-Abgleichwerte für die ""3""-Quantisierungsschrittweite (3d=11b)" VAL_BLK 0xE2658 Kwb_Ws16 31.50000 InjQntInj 0.00 31.50000 FORMAT "%8.5" EXTENDED_LIMITS -327.6800 327.6700 NUMBER 7 /end CHARACTERISTIC
/begin CHARACTERISTIC InjVlv_volQntAdjMin0_C "untere Grenzwerte der Mengen-Abgleichwerte für die ""0""-Quantisierungsschrittweite (0d=00b)" VAL_BLK 0xE2666 Kwb_Ws16 6.400000 InjQntInj -6.400000 0.00 FORMAT "%8.6" EXTENDED_LIMITS -327.6800 327.6700 NUMBER 7 /end CHARACTERISTIC
/begin CHARACTERISTIC InjVlv_volQntAdjMin1_C "untere Grenzwerte der Mengen-Abgleichwerte für die ""1""-Quantisierungsschrittweite (1d=01b)" VAL_BLK 0xE2674 Kwb_Ws16 9.600000 InjQntInj -9.600000 0.00 FORMAT "%8.6" EXTENDED_LIMITS -327.6800 327.6700 NUMBER 7 /end CHARACTERISTIC
/begin CHARACTERISTIC InjVlv_volQntAdjMin2_C "untere Grenzwerte der Mengen-Abgleichwerte für die ""2""-Quantisierungsschrittweite (2d=10b)" VAL_BLK 0xE2682 Kwb_Ws16 16.00000 InjQntInj -16.00000 0.00 FORMAT "%8.5" EXTENDED_LIMITS -327.6800 327.6700 NUMBER 7 /end CHARACTERISTIC
/begin CHARACTERISTIC InjVlv_volQntAdjMin3_C "untere Grenzwerte der Mengen-Abgleichwerte für die ""3""-Quantisierungsschrittweite (3d=11b)" VAL_BLK 0xE2690 Kwb_Ws16 32.00000 InjQntInj -32.00000 0.00 FORMAT "%8.5" EXTENDED_LIMITS -327.6800 327.6700 NUMBER 7 /end CHARACTERISTIC
/begin CHARACTERISTIC K2RDLI_dDataSetVer_C "Array für Datensatzversion" ASCII 0xC062A Kwb_Wu8 255.0 defaultAscii 0.00 255.0 NUMBER 10 /end CHARACTERISTIC
/begin CHARACTERISTIC Layer_APPVARBN_C "" VALUE 0xE381E Kw_Wu8 255.0 OneToOne 0.00 255.0 FORMAT "%5.1" /end CHARACTERISTIC
/begin CHARACTERISTIC Layer_APPVARVEH_C "" VALUE 0xE381F Kw_Wu8 255.0 OneToOne 0.00 255.0 FORMAT "%5.1" /end CHARACTERISTIC
/begin CHARACTERISTIC Layer_ctDebBSDStep_C "" VALUE 0xE3858 Kw_Wu8 255.0 OneToOne 0.00 255.0 FORMAT "%5.1" /end CHARACTERISTIC
/begin CHARACTERISTIC Layer_ctDebGENStep_C "" VALUE 0xE3859 Kw_Wu8 255.0 OneToOne 0.00 255.0 FORMAT "%5.1" /end CHARACTERISTIC
/begin CHARACTERISTIC Layer_ctDebIBS1Step_C "" VALUE 0xE385A Kw_Wu8 255.0 OneToOne 0.00 255.0 FORMAT "%5.1" /end CHARACTERISTIC
/begin CHARACTERISTIC Layer_ctDebIBS2Step_C "" VALUE 0xE385B Kw_Wu8 255.0 OneToOne 0.00 255.0 FORMAT "%5.1" /end CHARACTERISTIC
/begin CHARACTERISTIC Layer_ctDebIBS3Step_C "" VALUE 0xE385C Kw_Wu8 255.0 OneToOne 0.00 255.0 FORMAT "%5.1" /end CHARACTERISTIC
/begin CHARACTERISTIC Layer_ctDebMANHYDRStep_C "" VALUE 0xE385D Kw_Wu8 255.0 OneToOne 0.00 255.0 FORMAT "%5.1" /end CHARACTERISTIC
/begin CHARACTERISTIC Layer_ctDebMANLUFTStep_C "" VALUE 0xE385E Kw_Wu8 255.0 OneToOne 0.00 255.0 FORMAT "%5.1" /end CHARACTERISTIC
/begin CHARACTERISTIC Layer_ctDebPMBATTStep_C "" VALUE 0xE385F Kw_Wu8 255.0 OneToOne 0.00 255.0 FORMAT "%5.1" /end CHARACTERISTIC
/begin CHARACTERISTIC Layer_ctDebPMBNStep_C "" VALUE 0xE3860 Kw_Wu8 255.0 OneToOne 0.00 255.0 FORMAT "%5.1" /end CHARACTERISTIC
/begin CHARACTERISTIC Layer_ctDebPMRUHVERLStep_C "" VALUE 0xE3861 Kw_Wu8 255.0 OneToOne 0.00 255.0 FORMAT "%5.1" /end CHARACTERISTIC
/begin CHARACTERISTIC Layer_ctDebQLTStep_C "" VALUE 0xE3862 Kw_Wu8 255.0 OneToOne 0.00 255.0 FORMAT "%5.1" /end CHARACTERISTIC
/begin CHARACTERISTIC Layer_ctDebTANSStep_C "" VALUE 0xE3863 Kw_Wu8 255.0 OneToOne 0.00 255.0 FORMAT "%5.1" /end CHARACTERISTIC
/begin CHARACTERISTIC Layer_ctDebTOENSStep_C "" VALUE 0xE3864 Kw_Wu8 255.0 OneToOne 0.00 255.0 FORMAT "%5.1" /end CHARACTERISTIC
/begin CHARACTERISTIC Layer_ctDebTUMGStep_C "" VALUE 0xE3865 Kw_Wu8 255.0 OneToOne 0.00 255.0 FORMAT "%5.1" /end CHARACTERISTIC
/begin CHARACTERISTIC Layer_ctDebBSDDef_C "" VALUE 0xE3866 Kw_Wu16 65535.00 OneToOne 0.00 65535.00 FORMAT "%8.2" /end CHARACTERISTIC
/begin CHARACTERISTIC Layer_ctDebBSDOk_C "" VALUE 0xE3868 Kw_Wu16 65535.00 OneToOne 0.00 65535.00 FORMAT "%8.2" /end CHARACTERISTIC
/begin CHARACTERISTIC Layer_ctDebGENDef_C "" VALUE 0xE386A Kw_Wu16 65535.00 OneToOne 0.00 65535.00 FORMAT "%8.2" /end CHARACTERISTIC
/begin CHARACTERISTIC Layer_ctDebGENOk_C "" VALUE 0xE386C Kw_Wu16 65535.00 OneToOne 0.00 65535.00 FORMAT "%8.2" /end CHARACTERISTIC
/begin CHARACTERISTIC Layer_ctDebIBS1Def_C "" VALUE 0xE386E Kw_Wu16 65535.00 OneToOne 0.00 65535.00 FORMAT "%8.2" /end CHARACTERISTIC
/begin CHARACTERISTIC Layer_ctDebIBS1Ok_C "" VALUE 0xE3870 Kw_Wu16 65535.00 OneToOne 0.00 65535.00 FORMAT "%8.2" /end CHARACTERISTIC
/begin CHARACTERISTIC Layer_ctDebIBS2Def_C "" VALUE 0xE3872 Kw_Wu16 65535.00 OneToOne 0.00 65535.00 FORMAT "%8.2" /end CHARACTERISTIC
/begin CHARACTERISTIC Layer_ctDebIBS2Ok_C "" VALUE 0xE3874 Kw_Wu16 65535.00 OneToOne 0.00 65535.00 FORMAT "%8.2" /end CHARACTERISTIC
/begin CHARACTERISTIC Layer_ctDebIBS3Def_C "" VALUE 0xE3876 Kw_Wu16 65535.00 OneToOne 0.00 65535.00 FORMAT "%8.2" /end CHARACTERISTIC
/begin CHARACTERISTIC Layer_ctDebIBS3Ok_C "" VALUE 0xE3878 Kw_Wu16 65535.00 OneToOne 0.00 65535.00 FORMAT "%8.2" /end CHARACTERISTIC
/begin CHARACTERISTIC Layer_ctDebMANHYDRDef_C "" VALUE 0xE387A Kw_Wu16 65535.00 OneToOne 0.00 65535.00 FORMAT "%8.2" /end CHARACTERISTIC
/begin CHARACTERISTIC Layer_ctDebMANHYDROk_C "" VALUE 0xE387C Kw_Wu16 65535.00 OneToOne 0.00 65535.00 FORMAT "%8.2" /end CHARACTERISTIC
/begin CHARACTERISTIC Layer_ctDebMANLUFTDef_C "" VALUE 0xE387E Kw_Wu16 65535.00 OneToOne 0.00 65535.00 FORMAT "%8.2" /end CHARACTERISTIC
/begin CHARACTERISTIC Layer_ctDebMANLUFTOk_C "" VALUE 0xE3880 Kw_Wu16 65535.00 OneToOne 0.00 65535.00 FORMAT "%8.2" /end CHARACTERISTIC
/begin CHARACTERISTIC Layer_ctDebPMBATTDef_C "" VALUE 0xE3882 Kw_Wu16 65535.00 OneToOne 0.00 65535.00 FORMAT "%8.2" /end CHARACTERISTIC
/begin CHARACTERISTIC Layer_ctDebPMBATTOk_C "" VALUE 0xE3884 Kw_Wu16 65535.00 OneToOne 0.00 65535.00 FORMAT "%8.2" /end CHARACTERISTIC
/begin CHARACTERISTIC Layer_ctDebPMBNDef_C "" VALUE 0xE3886 Kw_Wu16 65535.00 OneToOne 0.00 65535.00 FORMAT "%8.2" /end CHARACTERISTIC
/begin CHARACTERISTIC Layer_ctDebPMBNOk_C "" VALUE 0xE3888 Kw_Wu16 65535.00 OneToOne 0.00 65535.00 FORMAT "%8.2" /end CHARACTERISTIC
/begin CHARACTERISTIC Layer_ctDebPMRUHVERLDef_C "" VALUE 0xE388A Kw_Wu16 65535.00 OneToOne 0.00 65535.00 FORMAT "%8.2" /end CHARACTERISTIC
/begin CHARACTERISTIC Layer_ctDebPMRUHVERLOk_C "" VALUE 0xE388C Kw_Wu16 65535.00 OneToOne 0.00 65535.00 FORMAT "%8.2" /end CHARACTERISTIC
/begin CHARACTERISTIC Layer_ctDebQLTDef_C "" VALUE 0xE388E Kw_Wu16 65535.00 OneToOne 0.00 65535.00 FORMAT "%8.2" /end CHARACTERISTIC
/begin CHARACTERISTIC Layer_ctDebQLTOk_C "" VALUE 0xE3890 Kw_Wu16 65535.00 OneToOne 0.00 65535.00 FORMAT "%8.2" /end CHARACTERISTIC
/begin CHARACTERISTIC Layer_ctDebTANSDef_C "" VALUE 0xE3892 Kw_Wu16 65535.00 OneToOne 0.00 65535.00 FORMAT "%8.2" /end CHARACTERISTIC
/begin CHARACTERISTIC Layer_ctDebTANSOk_C "" VALUE 0xE3894 Kw_Wu16 65535.00 OneToOne 0.00 65535.00 FORMAT "%8.2" /end CHARACTERISTIC
/begin CHARACTERISTIC Layer_ctDebTOENSDef_C "" VALUE 0xE3896 Kw_Wu16 65535.00 OneToOne 0.00 65535.00 FORMAT "%8.2" /end CHARACTERISTIC
/begin CHARACTERISTIC Layer_ctDebTOENSOk_C "" VALUE 0xE3898 Kw_Wu16 65535.00 OneToOne 0.00 65535.00 FORMAT "%8.2" /end CHARACTERISTIC
/begin CHARACTERISTIC Layer_ctDebTUMGDef_C "" VALUE 0xE389A Kw_Wu16 65535.00 OneToOne 0.00 65535.00 FORMAT "%8.2" /end CHARACTERISTIC
/begin CHARACTERISTIC Layer_ctDebTUMGOk_C "" VALUE 0xE389C Kw_Wu16 65535.00 OneToOne 0.00 65535.00 FORMAT "%8.2" /end CHARACTERISTIC
/begin CHARACTERISTIC Layer_stAirCtlBits_C "" VALUE 0xE3820 Kw_Wu32 4294967295.00 OneToOne 0.00 4294967295.00 FORMAT "%13.2" /end CHARACTERISTIC
/begin CHARACTERISTIC Layer_stPCR_C "" VALUE 0xE3824 Kw_Wu16 65535.00 OneToOne 0.00 65535.00 FORMAT "%8.2" /end CHARACTERISTIC
/begin CHARACTERISTIC Layer_swtB_bsdprot "" VALUE 0xE3826 Kw_Wu8 255.0 OneToOne 0.00 255.0 FORMAT "%5.1" /end CHARACTERISTIC
/begin CHARACTERISTIC Layer_swtTunProt_C "" VALUE 0xE3827 Kw_Wu8 1.000 OneToOne 0.00 1.000 FORMAT "%5.3" EXTENDED_LIMITS 0.00 255.0 /end CHARACTERISTIC
/begin CHARACTERISTIC Layer_tiDefWrEep_C "" VALUE 0xE3828 Kw_Wu16 10000.00 Time_ms 0.00 10000.00 FORMAT "%8.2" EXTENDED_LIMITS 0.00 655350.0 /end CHARACTERISTIC
/begin CHARACTERISTIC LIGov_CldCltchFlt1T1_C "T1 Komponente für erstes PDT1-Glied wenn ausgekuppelt und Motor kalt" VALUE 0xE38A0 Kw_Wu32 4294.9673 TimeDelay_s 0.0000010000000 4294.9673 FORMAT "%9.4" /end CHARACTERISTIC
/begin CHARACTERISTIC LIGov_CldCltchFlt2T1_C "T1 Komponente für zweites PDT1-Glied wenn ausgekuppelt und Motor kalt" VALUE 0xE38A4 Kw_Wu32 4294.9673 TimeDelay_s 0.0000010000000 4294.9673 FORMAT "%9.4" /end CHARACTERISTIC
/begin CHARACTERISTIC LIGov_CldCltchIKi_C "Kleinsignalverstärkung" VALUE 0xE38A8 Kw_Wu32 799999.999814 Ki_rpm2Nm 0.00 799999.999814 FORMAT "%13.6" /end CHARACTERISTIC
/begin CHARACTERISTIC LIGov_CldCltchIKiPos_C "Verstärkung für positive Großsignale" VALUE 0xE38AC Kw_Wu32 799999.999814 Ki_rpm2Nm 0.00 799999.999814 FORMAT "%13.6" /end CHARACTERISTIC
/begin CHARACTERISTIC LIGov_CldCltchIKiNeg_C "Verstärkung für negative Großsignale" VALUE 0xE38B0 Kw_Wu32 799999.999814 Ki_rpm2Nm 0.00 799999.999814 FORMAT "%13.6" /end CHARACTERISTIC
/begin CHARACTERISTIC LIGov_CldCltchIWinPos_C "Kleinsignalfenster positiv" VALUE 0xE38B4 Kw_Ws16 8191.875 EngN_HiRes -4096.000 4095.875 FORMAT "%8.3" /end CHARACTERISTIC
/begin CHARACTERISTIC LIGov_CldCltchIWinNeg_C "Kleinsignalfenster negativ" VALUE 0xE38B6 Kw_Ws16 8191.875 EngN_HiRes -4096.000 4095.875 FORMAT "%8.3" /end CHARACTERISTIC
/begin CHARACTERISTIC LIGov_CldCltchPredef_C "Einschrittmoment Vorsteuerung" VALUE 0xE38B8 Kw_Ws16 6553.500 Trq -3276.800 3276.700 FORMAT "%8.3" /end CHARACTERISTIC
/begin CHARACTERISTIC LIGov_CldCltchPKp_C "Kleinsignalverstärkung" VALUE 0xE38BC Kw_Wu32 52428.7999878 Kp_rpm2Nm 0.00 52428.7999878 FORMAT "%13.7" /end CHARACTERISTIC
/begin CHARACTERISTIC LIGov_CldCltchPKpPos_C "Verstärkung für positive Großsignale" VALUE 0xE38C0 Kw_Wu32 52428.7999878 Kp_rpm2Nm 0.00 52428.7999878 FORMAT "%13.7" /end CHARACTERISTIC
/begin CHARACTERISTIC LIGov_CldCltchPKpNeg_C "Verstärkung für negative Großsignale" VALUE 0xE38C4 Kw_Wu32 52428.7999878 Kp_rpm2Nm 0.00 52428.7999878 FORMAT "%13.7" /end CHARACTERISTIC
/begin CHARACTERISTIC LIGov_CldCltchPWinPos_C "Kleinsignalfenster positiv" VALUE 0xE38C8 Kw_Ws16 8191.875 EngN_HiRes -4096.000 4095.875 FORMAT "%8.3" /end CHARACTERISTIC
/begin CHARACTERISTIC LIGov_CldCltchPWinNeg_C "Kleinsignalfenster negativ" VALUE 0xE38CA Kw_Ws16 8191.875 EngN_HiRes -4096.000 4095.875 FORMAT "%8.3" /end CHARACTERISTIC
/begin CHARACTERISTIC LIGov_tiCldGearDT1_C "Koeffizient D-Glied (T)" VALUE 0xE38CC Kw_Wu32 4294.9673 TimeDelay_s 0.0000010000000 4294.9673 FORMAT "%9.4" /end CHARACTERISTIC
/begin CHARACTERISTIC LIGov_CldGearDKd_C "Koeffizient D-Glied (K)" VALUE 0xE38D0 Kw_Ws32 6553.59999847 Kd_rpm2Nm -3276.80000000 3276.79999847 FORMAT "%13.8" /end CHARACTERISTIC
/begin CHARACTERISTIC LIGov_CldGearIKi_C "Kleinsignalverstärkung" VALUE 0xE38D4 Kw_Wu32 799999.999814 Ki_rpm2Nm 0.00 799999.999814 FORMAT "%13.6" /end CHARACTERISTIC
/begin CHARACTERISTIC LIGov_CldGearIKiPos_C "Verstärkung für positive Großsignale" VALUE 0xE38D8 Kw_Wu32 799999.999814 Ki_rpm2Nm 0.00 799999.999814 FORMAT "%13.6" /end CHARACTERISTIC
/begin CHARACTERISTIC LIGov_CldGearIKiNeg_C "Verstärkung für negative Großsignale" VALUE 0xE38DC Kw_Wu32 799999.999814 Ki_rpm2Nm 0.00 799999.999814 FORMAT "%13.6" /end CHARACTERISTIC
/begin CHARACTERISTIC LIGov_CldGearIWinPos_C "Kleinsignalfenster positiv" VALUE 0xE38E0 Kw_Ws16 8191.875 EngN_HiRes -4096.000 4095.875 FORMAT "%8.3" /end CHARACTERISTIC
/begin CHARACTERISTIC LIGov_CldGearIWinNeg_C "Kleinsignalfenster negativ" VALUE 0xE38E2 Kw_Ws16 8191.875 EngN_HiRes -4096.000 4095.875 FORMAT "%8.3" /end CHARACTERISTIC
/begin CHARACTERISTIC LIGov_CldGearPredef_C "Einschrittmoment Vorsteuerung" VALUE 0xE38E4 Kw_Ws16 6553.500 Trq -3276.800 3276.700 FORMAT "%8.3" /end CHARACTERISTIC
/begin CHARACTERISTIC LIGov_CldGearPKp_C "Kleinsignalverstärkung" VALUE 0xE38E8 Kw_Wu32 52428.7999878 Kp_rpm2Nm 0.00 52428.7999878 FORMAT "%13.7" /end CHARACTERISTIC
/begin CHARACTERISTIC LIGov_CldGearPKpPos_C "Verstärkung für positive Großsignale" VALUE 0xE38EC Kw_Wu32 52428.7999878 Kp_rpm2Nm 0.00 52428.7999878 FORMAT "%13.7" /end CHARACTERISTIC
/begin CHARACTERISTIC LIGov_CldGearPKpNeg_C "Verstärkung für negative Großsignale" VALUE 0xE38F0 Kw_Wu32 52428.7999878 Kp_rpm2Nm 0.00 52428.7999878 FORMAT "%13.7" /end CHARACTERISTIC
/begin CHARACTERISTIC LIGov_CldGearPWinPos_C "Kleinsignalfenster positiv" VALUE 0xE38F4 Kw_Ws16 8191.875 EngN_HiRes -4096.000 4095.875 FORMAT "%8.3" /end CHARACTERISTIC
/begin CHARACTERISTIC LIGov_CldGearPWinNeg_C "Kleinsignalfenster negativ" VALUE 0xE38F6 Kw_Ws16 8191.875 EngN_HiRes -4096.000 4095.875 FORMAT "%8.3" /end CHARACTERISTIC
/begin CHARACTERISTIC LIGov_tiGear1DT1_C "Koeffizient D-Glied (T)" VALUE 0xE38F8 Kw_Wu32 4294.9673 TimeDelay_s 0.0000010000000 4294.9673 FORMAT "%9.4" /end CHARACTERISTIC
/begin CHARACTERISTIC LIGov_Gear1DKd_C "Koeffizient D-Glied (K)" VALUE 0xE38FC Kw_Ws32 6553.59999847 Kd_rpm2Nm -3276.80000000 3276.79999847 FORMAT "%13.8" /end CHARACTERISTIC
/begin CHARACTERISTIC LIGov_Gear1Flt1T1_C "T1 Komponente für erstes PDT1-Glied bei Verwendung des ersten Ganges" VALUE 0xE3900 Kw_Wu32 4294.9673 TimeDelay_s 0.0000010000000 4294.9673 FORMAT "%9.4" /end CHARACTERISTIC
/begin CHARACTERISTIC LIGov_Gear1Flt2T1_C "T1 Komponente für zweites PDT1-Glied bei Verwendung des ersten Ganges" VALUE 0xE3904 Kw_Wu32 4294.9673 TimeDelay_s 0.0000010000000 4294.9673 FORMAT "%9.4" /end CHARACTERISTIC
/begin CHARACTERISTIC LIGov_Gear1IKi_C "Kleinsignalverstärkung" VALUE 0xE3908 Kw_Wu32 799999.999814 Ki_rpm2Nm 0.00 799999.999814 FORMAT "%13.6" /end CHARACTERISTIC
/begin CHARACTERISTIC LIGov_Gear1IKiPos_C "Verstärkung für positive Großsignale" VALUE 0xE390C Kw_Wu32 799999.999814 Ki_rpm2Nm 0.00 799999.999814 FORMAT "%13.6" /end CHARACTERISTIC
/begin CHARACTERISTIC LIGov_Gear1IKiNeg_C "Verstärkung für negative Großsignale" VALUE 0xE3910 Kw_Wu32 799999.999814 Ki_rpm2Nm 0.00 799999.999814 FORMAT "%13.6" /end CHARACTERISTIC
/begin CHARACTERISTIC LIGov_Gear1IWinPos_C "Kleinsignalfenster positiv" VALUE 0xE3914 Kw_Ws16 8191.875 EngN_HiRes -4096.000 4095.875 FORMAT "%8.3" /end CHARACTERISTIC
/begin CHARACTERISTIC LIGov_Gear1IWinNeg_C "Kleinsignalfenster negativ" VALUE 0xE3916 Kw_Ws16 8191.875 EngN_HiRes -4096.000 4095.875 FORMAT "%8.3" /end CHARACTERISTIC
/begin CHARACTERISTIC LIGov_Gear1Predef_C "Einschrittmoment Vorsteuerung" VALUE 0xE3918 Kw_Ws16 6553.500 Trq -3276.800 3276.700 FORMAT "%8.3" /end CHARACTERISTIC
/begin CHARACTERISTIC LIGov_Gear1PKp_C "Kleinsignalverstärkung" VALUE 0xE391C Kw_Wu32 52428.7999878 Kp_rpm2Nm 0.00 52428.7999878 FORMAT "%13.7" /end CHARACTERISTIC
/begin CHARACTERISTIC LIGov_Gear1PKpPos_C "Verstärkung für positive Großsignale" VALUE 0xE3920 Kw_Wu32 52428.7999878 Kp_rpm2Nm 0.00 52428.7999878 FORMAT "%13.7" /end CHARACTERISTIC
/begin CHARACTERISTIC LIGov_Gear1PKpNeg_C "Verstärkung für negative Großsignale" VALUE 0xE3924 Kw_Wu32 52428.7999878 Kp_rpm2Nm 0.00 52428.7999878 FORMAT "%13.7" /end CHARACTERISTIC
/begin CHARACTERISTIC LIGov_Gear1PWinPos_C "Kleinsignalfenster positiv" VALUE 0xE3928 Kw_Ws16 8191.875 EngN_HiRes -4096.000 4095.875 FORMAT "%8.3" /end CHARACTERISTIC
/begin CHARACTERISTIC LIGov_Gear1PWinNeg_C "Kleinsignalfenster negativ" VALUE 0xE392A Kw_Ws16 8191.875 EngN_HiRes -4096.000 4095.875 FORMAT "%8.3" /end CHARACTERISTIC
/begin CHARACTERISTIC LIGov_tiGear2DT1_C "Koeffizient D-Glied (T)" VALUE 0xE392C Kw_Wu32 4294.9673 TimeDelay_s 0.0000010000000 4294.9673 FORMAT "%9.4" /end CHARACTERISTIC
/begin CHARACTERISTIC LIGov_Gear2DKd_C "Koeffizient D-Glied (K)" VALUE 0xE3930 Kw_Ws32 6553.59999847 Kd_rpm2Nm -3276.80000000 3276.79999847 FORMAT "%13.8" /end CHARACTERISTIC
/begin CHARACTERISTIC LIGov_Gear2Flt1T1_C "T1 Komponente für erstes PDT1-Glied bei Verwendung des zweiten Ganges" VALUE 0xE3934 Kw_Wu32 4294.9673 TimeDelay_s 0.0000010000000 4294.9673 FORMAT "%9.4" /end CHARACTERISTIC
/begin CHARACTERISTIC LIGov_Gear2Flt2T1_C "T1 Komponente für zweites PDT1-Glied bei Verwendung des zweiten Ganges" VALUE 0xE3938 Kw_Wu32 4294.9673 TimeDelay_s 0.0000010000000 4294.9673 FORMAT "%9.4" /end CHARACTERISTIC
/begin CHARACTERISTIC LIGov_Gear2IKi_C "Kleinsignalverstärkung" VALUE 0xE393C Kw_Wu32 799999.999814 Ki_rpm2Nm 0.00 799999.999814 FORMAT "%13.6" /end CHARACTERISTIC
/begin CHARACTERISTIC LIGov_Gear2IKiPos_C "Verstärkung für positive Großsignale" VALUE 0xE3940 Kw_Wu32 799999.999814 Ki_rpm2Nm 0.00 799999.999814 FORMAT "%13.6" /end CHARACTERISTIC
/begin CHARACTERISTIC LIGov_Gear2IKiNeg_C "Verstärkung für negative Großsignale" VALUE 0xE3944 Kw_Wu32 799999.999814 Ki_rpm2Nm 0.00 799999.999814 FORMAT "%13.6" /end CHARACTERISTIC
/begin CHARACTERISTIC LIGov_Gear2IWinPos_C "Kleinsignalfenster positiv" VALUE 0xE3948 Kw_Ws16 8191.875 EngN_HiRes -4096.000 4095.875 FORMAT "%8.3" /end CHARACTERISTIC
/begin CHARACTERISTIC LIGov_Gear2IWinNeg_C "Kleinsignalfenster negativ" VALUE 0xE394A Kw_Ws16 8191.875 EngN_HiRes -4096.000 4095.875 FORMAT "%8.3" /end CHARACTERISTIC
/begin CHARACTERISTIC LIGov_Gear2Predef_C "Einschrittmoment Vorsteuerung" VALUE 0xE394C Kw_Ws16 6553.500 Trq -3276.800 3276.700 FORMAT "%8.3" /end CHARACTERISTIC
/begin CHARACTERISTIC LIGov_Gear2PKp_C "Kleinsignalverstärkung" VALUE 0xE3950 Kw_Wu32 52428.7999878 Kp_rpm2Nm 0.00 52428.7999878 FORMAT "%13.7" /end CHARACTERISTIC
/begin CHARACTERISTIC LIGov_Gear2PKpPos_C "Verstärkung für positive Großsignale" VALUE 0xE3954 Kw_Wu32 52428.7999878 Kp_rpm2Nm 0.00 52428.7999878 FORMAT "%13.7" /end CHARACTERISTIC
/begin CHARACTERISTIC LIGov_Gear2PKpNeg_C "Verstärkung für negative Großsignale" VALUE 0xE3958 Kw_Wu32 52428.7999878 Kp_rpm2Nm 0.00 52428.7999878 FORMAT "%13.7" /end CHARACTERISTIC
/begin CHARACTERISTIC LIGov_Gear2PWinPos_C "Kleinsignalfenster positiv" VALUE 0xE395C Kw_Ws16 8191.875 EngN_HiRes -4096.000 4095.875 FORMAT "%8.3" /end CHARACTERISTIC
/begin CHARACTERISTIC LIGov_Gear2PWinNeg_C "Kleinsignalfenster negativ" VALUE 0xE395E Kw_Ws16 8191.875 EngN_HiRes -4096.000 4095.875 FORMAT "%8.3" /end CHARACTERISTIC
/begin CHARACTERISTIC LIGov_tiGear3DT1_C "Koeffizient D-Glied (T)" VALUE 0xE3960 Kw_Wu32 4294.9673 TimeDelay_s 0.0000010000000 4294.9673 FORMAT "%9.4" /end CHARACTERISTIC
/begin CHARACTERISTIC LIGov_Gear3DKd_C "Koeffizient D-Glied (K)" VALUE 0xE3964 Kw_Ws32 6553.59999847 Kd_rpm2Nm -3276.80000000 3276.79999847 FORMAT "%13.8" /end CHARACTERISTIC
/begin CHARACTERISTIC LIGov_Gear3Flt1T1_C "T1 Komponente für erstes PDT1-Glied bei Verwendung des dritten Ganges" VALUE 0xE3968 Kw_Wu32 4294.9673 TimeDelay_s 0.0000010000000 4294.9673 FORMAT "%9.4" /end CHARACTERISTIC
/begin CHARACTERISTIC LIGov_Gear3Flt2T1_C "T1 Komponente für zweites PDT1-Glied bei Verwendung des dritten Ganges" VALUE 0xE396C Kw_Wu32 4294.9673 TimeDelay_s 0.0000010000000 4294.9673 FORMAT "%9.4" /end CHARACTERISTIC
/begin CHARACTERISTIC LIGov_Gear3IKi_C "Kleinsignalverstärkung" VALUE 0xE3970 Kw_Wu32 799999.999814 Ki_rpm2Nm 0.00 799999.999814 FORMAT "%13.6" /end CHARACTERISTIC
/begin CHARACTERISTIC LIGov_Gear3IKiPos_C "Verstärkung für positive Großsignale" VALUE 0xE3974 Kw_Wu32 799999.999814 Ki_rpm2Nm 0.00 799999.999814 FORMAT "%13.6" /end CHARACTERISTIC
/begin CHARACTERISTIC LIGov_Gear3IKiNeg_C "Verstärkung für negative Großsignale" VALUE 0xE3978 Kw_Wu32 799999.999814 Ki_rpm2Nm 0.00 799999.999814 FORMAT "%13.6" /end CHARACTERISTIC
/begin CHARACTERISTIC LIGov_Gear3IWinPos_C "Kleinsignalfenster positiv" VALUE 0xE397C Kw_Ws16 8191.875 EngN_HiRes -4096.000 4095.875 FORMAT "%8.3" /end CHARACTERISTIC
/begin CHARACTERISTIC LIGov_Gear3IWinNeg_C "Kleinsignalfenster negativ" VALUE 0xE397E Kw_Ws16 8191.875 EngN_HiRes -4096.000 4095.875 FORMAT "%8.3" /end CHARACTERISTIC
/begin CHARACTERISTIC LIGov_Gear3Predef_C "Einschrittmoment Vorsteuerung" VALUE 0xE3980 Kw_Ws16 6553.500 Trq -3276.800 3276.700 FORMAT "%8.3" /end CHARACTERISTIC
/begin CHARACTERISTIC LIGov_Gear3PKp_C "Kleinsignalverstärkung" VALUE 0xE3984 Kw_Wu32 52428.7999878 Kp_rpm2Nm 0.00 52428.7999878 FORMAT "%13.7" /end CHARACTERISTIC
/begin CHARACTERISTIC LIGov_Gear3PKpPos_C "Verstärkung für positive Großsignale" VALUE 0xE3988 Kw_Wu32 52428.7999878 Kp_rpm2Nm 0.00 52428.7999878 FORMAT "%13.7" /end CHARACTERISTIC
/begin CHARACTERISTIC LIGov_Gear3PKpNeg_C "Verstärkung für negative Großsignale" VALUE 0xE398C Kw_Wu32 52428.7999878 Kp_rpm2Nm 0.00 52428.7999878 FORMAT "%13.7" /end CHARACTERISTIC
/begin CHARACTERISTIC LIGov_Gear3PWinPos_C "Kleinsignalfenster positiv" VALUE 0xE3990 Kw_Ws16 8191.875 EngN_HiRes -4096.000 4095.875 FORMAT "%8.3" /end CHARACTERISTIC
/begin CHARACTERISTIC LIGov_Gear3PWinNeg_C "Kleinsignalfenster negativ" VALUE 0xE3992 Kw_Ws16 8191.875 EngN_HiRes -4096.000 4095.875 FORMAT "%8.3" /end CHARACTERISTIC
/begin CHARACTERISTIC LIGov_tiGear4DT1_C "Koeffizient D-Glied (T)" VALUE 0xE3994 Kw_Wu32 4294.9673 TimeDelay_s 0.0000010000000 4294.9673 FORMAT "%9.4" /end CHARACTERISTIC
/begin CHARACTERISTIC LIGov_Gear4DKd_C "Koeffizient D-Glied (K)" VALUE 0xE3998 Kw_Ws32 6553.59999847 Kd_rpm2Nm -3276.80000000 3276.79999847 FORMAT "%13.8" /end CHARACTERISTIC
/begin CHARACTERISTIC LIGov_Gear4Flt1T1_C "T1 Komponente für erstes PDT1-Glied bei Verwendung des vierte Ganges" VALUE 0xE399C Kw_Wu32 4294.9673 TimeDelay_s 0.0000010000000 4294.9673 FORMAT "%9.4" /end CHARACTERISTIC
/begin CHARACTERISTIC LIGov_Gear4Flt2T1_C "T1 Komponente für zweites PDT1-Glied bei Verwendung des vierte Ganges" VALUE 0xE39A0 Kw_Wu32 4294.9673 TimeDelay_s 0.0000010000000 4294.9673 FORMAT "%9.4" /end CHARACTERISTIC
/begin CHARACTERISTIC LIGov_Gear4IKi_C "Kleinsignalverstärkung" VALUE 0xE39A4 Kw_Wu32 799999.999814 Ki_rpm2Nm 0.00 799999.999814 FORMAT "%13.6" /end CHARACTERISTIC
/begin CHARACTERISTIC LIGov_Gear4IKiPos_C "Verstärkung für positive Großsignale" VALUE 0xE39A8 Kw_Wu32 799999.999814 Ki_rpm2Nm 0.00 799999.999814 FORMAT "%13.6" /end CHARACTERISTIC
/begin CHARACTERISTIC LIGov_Gear4IKiNeg_C "Verstärkung für negative Großsignale" VALUE 0xE39AC Kw_Wu32 799999.999814 Ki_rpm2Nm 0.00 799999.999814 FORMAT "%13.6" /end CHARACTERISTIC
/begin CHARACTERISTIC LIGov_Gear4IWinPos_C "Kleinsignalfenster positiv" VALUE 0xE39B0 Kw_Ws16 8191.875 EngN_HiRes -4096.000 4095.875 FORMAT "%8.3" /end CHARACTERISTIC
/begin CHARACTERISTIC LIGov_Gear4IWinNeg_C "Kleinsignalfenster negativ" VALUE 0xE39B2 Kw_Ws16 8191.875 EngN_HiRes -4096.000 4095.875 FORMAT "%8.3" /end CHARACTERISTIC
/begin CHARACTERISTIC LIGov_Gear4Predef_C "Einschrittmoment Vorsteuerung" VALUE 0xE39B4 Kw_Ws16 6553.500 Trq -3276.800 3276.700 FORMAT "%8.3" /end CHARACTERISTIC
/begin CHARACTERISTIC LIGov_Gear4PKp_C "Kleinsignalverstärkung" VALUE 0xE39B8 Kw_Wu32 52428.7999878 Kp_rpm2Nm 0.00 52428.7999878 FORMAT "%13.7" /end CHARACTERISTIC
/begin CHARACTERISTIC LIGov_Gear4PKpPos_C "Verstärkung für positive Großsignale" VALUE 0xE39BC Kw_Wu32 52428.7999878 Kp_rpm2Nm 0.00 52428.7999878 FORMAT "%13.7" /end CHARACTERISTIC
/begin CHARACTERISTIC LIGov_Gear4PKpNeg_C "Verstärkung für negative Großsignale" VALUE 0xE39C0 Kw_Wu32 52428.7999878 Kp_rpm2Nm 0.00 52428.7999878 FORMAT "%13.7" /end CHARACTERISTIC
/begin CHARACTERISTIC LIGov_Gear4PWinPos_C "Kleinsignalfenster positiv" VALUE 0xE39C4 Kw_Ws16 8191.875 EngN_HiRes -4096.000 4095.875 FORMAT "%8.3" /end CHARACTERISTIC
/begin CHARACTERISTIC LIGov_Gear4PWinNeg_C "Kleinsignalfenster negativ" VALUE 0xE39C6 Kw_Ws16 8191.875 EngN_HiRes -4096.000 4095.875 FORMAT "%8.3" /end CHARACTERISTIC
/begin CHARACTERISTIC LIGov_tiGear5DT1_C "Koeffizient D-Glied (T)" VALUE 0xE39C8 Kw_Wu32 4294.9673 TimeDelay_s 0.0000010000000 4294.9673 FORMAT "%9.4" /end CHARACTERISTIC
/begin CHARACTERISTIC LIGov_Gear5DKd_C "Koeffizient D-Glied (K)" VALUE 0xE39CC Kw_Ws32 6553.59999847 Kd_rpm2Nm -3276.80000000 3276.79999847 FORMAT "%13.8" /end CHARACTERISTIC
/begin CHARACTERISTIC LIGov_Gear5Flt1T1_C "T1 Komponente für erstes PDT1-Glied bei Verwendung des fünften Ganges" VALUE 0xE39D0 Kw_Wu32 4294.9673 TimeDelay_s 0.0000010000000 4294.9673 FORMAT "%9.4" /end CHARACTERISTIC
/begin CHARACTERISTIC LIGov_Gear5Flt2T1_C "T1 Komponente für zweites PDT1-Glied bei Verwendung des fünften Ganges" VALUE 0xE39D4 Kw_Wu32 4294.9673 TimeDelay_s 0.0000010000000 4294.9673 FORMAT "%9.4" /end CHARACTERISTIC
/begin CHARACTERISTIC LIGov_Gear5IKi_C "Kleinsignalverstärkung" VALUE 0xE39D8 Kw_Wu32 799999.999814 Ki_rpm2Nm 0.00 799999.999814 FORMAT "%13.6" /end CHARACTERISTIC
/begin CHARACTERISTIC LIGov_Gear5IKiPos_C "Verstärkung für positive Großsignale" VALUE 0xE39DC Kw_Wu32 799999.999814 Ki_rpm2Nm 0.00 799999.999814 FORMAT "%13.6" /end CHARACTERISTIC
/begin CHARACTERISTIC LIGov_Gear5IKiNeg_C "Verstärkung für negative Großsignale" VALUE 0xE39E0 Kw_Wu32 799999.999814 Ki_rpm2Nm 0.00 799999.999814 FORMAT "%13.6" /end CHARACTERISTIC
/begin CHARACTERISTIC LIGov_Gear5IWinPos_C "Kleinsignalfenster positiv" VALUE 0xE39E4 Kw_Ws16 8191.875 EngN_HiRes -4096.000 4095.875 FORMAT "%8.3" /end CHARACTERISTIC
/begin CHARACTERISTIC LIGov_Gear5IWinNeg_C "Kleinsignalfenster negativ" VALUE 0xE39E6 Kw_Ws16 8191.875 EngN_HiRes -4096.000 4095.875 FORMAT "%8.3" /end CHARACTERISTIC
/begin CHARACTERISTIC LIGov_Gear5Predef_C "Einschrittmoment Vorsteuerung" VALUE 0xE39E8 Kw_Ws16 6553.500 Trq -3276.800 3276.700 FORMAT "%8.3" /end CHARACTERISTIC
/begin CHARACTERISTIC LIGov_Gear5PKp_C "Kleinsignalverstärkung" VALUE 0xE39EC Kw_Wu32 52428.7999878 Kp_rpm2Nm 0.00 52428.7999878 FORMAT "%13.7" /end CHARACTERISTIC
/begin CHARACTERISTIC LIGov_Gear5PKpPos_C "Verstärkung für positive Großsignale" VALUE 0xE39F0 Kw_Wu32 52428.7999878 Kp_rpm2Nm 0.00 52428.7999878 FORMAT "%13.7" /end CHARACTERISTIC
/begin CHARACTERISTIC LIGov_Gear5PKpNeg_C "Verstärkung für negative Großsignale" VALUE 0xE39F4 Kw_Wu32 52428.7999878 Kp_rpm2Nm 0.00 52428.7999878 FORMAT "%13.7" /end CHARACTERISTIC
/begin CHARACTERISTIC LIGov_Gear5PWinPos_C "Kleinsignalfenster positiv" VALUE 0xE39F8 Kw_Ws16 8191.875 EngN_HiRes -4096.000 4095.875 FORMAT "%8.3" /end CHARACTERISTIC
/begin CHARACTERISTIC LIGov_Gear5PWinNeg_C "Kleinsignalfenster negativ" VALUE 0xE39FA Kw_Ws16 8191.875 EngN_HiRes -4096.000 4095.875 FORMAT "%8.3" /end CHARACTERISTIC
/begin CHARACTERISTIC LIGov_tiGear6DT1_C "Koeffizient D-Glied (T)" VALUE 0xE39FC Kw_Wu32 4294.9673 TimeDelay_s 0.0000010000000 4294.9673 FORMAT "%9.4" /end CHARACTERISTIC
/begin CHARACTERISTIC LIGov_Gear6DKd_C "Koeffizient D-Glied (K)" VALUE 0xE3A00 Kw_Ws32 6553.59999847 Kd_rpm2Nm -3276.80000000 3276.79999847 FORMAT "%13.8" /end CHARACTERISTIC
/begin CHARACTERISTIC LIGov_Gear6Flt1T1_C "T1 Komponente für erstes PDT1-Glied bei Verwendung des sechsten Ganges" VALUE 0xE3A04 Kw_Wu32 4294.9673 TimeDelay_s 0.0000010000000 4294.9673 FORMAT "%9.4" /end CHARACTERISTIC
/begin CHARACTERISTIC LIGov_Gear6Flt2T1_C "T1 Komponente für zweites PDT1-Glied bei Verwendung des sechsten Ganges" VALUE 0xE3A08 Kw_Wu32 4294.9673 TimeDelay_s 0.0000010000000 4294.9673 FORMAT "%9.4" /end CHARACTERISTIC
/begin CHARACTERISTIC LIGov_Gear6IKi_C "Kleinsignalverstärkung" VALUE 0xE3A0C Kw_Wu32 799999.999814 Ki_rpm2Nm 0.00 799999.999814 FORMAT "%13.6" /end CHARACTERISTIC
/begin CHARACTERISTIC LIGov_Gear6IKiPos_C "Verstärkung für positie Großsingnale" VALUE 0xE3A10 Kw_Wu32 799999.999814 Ki_rpm2Nm 0.00 799999.999814 FORMAT "%13.6" /end CHARACTERISTIC
/begin CHARACTERISTIC LIGov_Gear6IKiNeg_C "Verstärkung für negative Großsignale" VALUE 0xE3A14 Kw_Wu32 799999.999814 Ki_rpm2Nm 0.00 799999.999814 FORMAT "%13.6" /end CHARACTERISTIC
/begin CHARACTERISTIC LIGov_Gear6IWinPos_C "Kleinsignalfenster positiv" VALUE 0xE3A18 Kw_Ws16 8191.875 EngN_HiRes -4096.000 4095.875 FORMAT "%8.3" /end CHARACTERISTIC
/begin CHARACTERISTIC LIGov_Gear6IWinNeg_C "Kleinsignalfenster negativ" VALUE 0xE3A1A Kw_Ws16 8191.875 EngN_HiRes -4096.000 4095.875 FORMAT "%8.3" /end CHARACTERISTIC
/begin CHARACTERISTIC LIGov_Gear6Predef_C "Einschrittmoment Vorsteuerung" VALUE 0xE3A1C Kw_Ws16 6553.500 Trq -3276.800 3276.700 FORMAT "%8.3" /end CHARACTERISTIC
/begin CHARACTERISTIC LIGov_Gear6PKp_C "Kleinsignalverstärkung" VALUE 0xE3A20 Kw_Wu32 52428.7999878 Kp_rpm2Nm 0.00 52428.7999878 FORMAT "%13.7" /end CHARACTERISTIC
/begin CHARACTERISTIC LIGov_Gear6PKpPos_C "Verstärkung für positive Großsignale" VALUE 0xE3A24 Kw_Wu32 52428.7999878 Kp_rpm2Nm 0.00 52428.7999878 FORMAT "%13.7" /end CHARACTERISTIC
/begin CHARACTERISTIC LIGov_Gear6PKpNeg_C "Verstärkung für negative Großsignale" VALUE 0xE3A28 Kw_Wu32 52428.7999878 Kp_rpm2Nm 0.00 52428.7999878 FORMAT "%13.7" /end CHARACTERISTIC
/begin CHARACTERISTIC LIGov_Gear6PWinPos_C "Kleinsignalfenster positiv" VALUE 0xE3A2C Kw_Ws16 8191.875 EngN_HiRes -4096.000 4095.875 FORMAT "%8.3" /end CHARACTERISTIC
/begin CHARACTERISTIC LIGov_Gear6PWinNeg_C "Kleinsignalfenster negativ" VALUE 0xE3A2E Kw_Ws16 8191.875 EngN_HiRes -4096.000 4095.875 FORMAT "%8.3" /end CHARACTERISTIC
/begin CHARACTERISTIC LIGov_nDflTrmVal_C "Datensatz-Abgleichwert" VALUE 0xE3A30 Kw_Ws16 65535.00 EngN -32768.00 32767.00 FORMAT "%8.2" /end CHARACTERISTIC
/begin CHARACTERISTIC LIGov_nDHypDenom_C "Nennerparameter für Hyperbel zur Aufschaltung LLR D-Anteil" VALUE 0xE3A32 Kw_Ws16 32766.00 EngN 1.000000 32767.00 FORMAT "%8.2" EXTENDED_LIMITS -32768.00 32767.00 /end CHARACTERISTIC
/begin CHARACTERISTIC LIGov_nDHypNum_C "Zählerparameter für Hyperbel zur Aufschaltung LLR D-Anteil" VALUE 0xE3A34 Kw_Ws16 65535.00 EngN -32768.00 32767.00 FORMAT "%8.2" /end CHARACTERISTIC
/begin CHARACTERISTIC LIGov_nLimHigh_C "#SSD obere Drehzahlgrenze für LLR" VALUE 0xE3A36 Kw_Ws16 65535.00 EngN -32768.00 32767.00 FORMAT "%8.2" /end CHARACTERISTIC
/begin CHARACTERISTIC LIGov_nLimLow_C "untere Drehzahlgrenze für LLR" VALUE 0xE3A38 Kw_Ws16 65535.00 EngN -32768.00 32767.00 FORMAT "%8.2" /end CHARACTERISTIC
/begin CHARACTERISTIC LIGov_nMSDiffMax_C "#SSD Max zulässige Differenz zwischen Master Solldrehzahl und der vom Slave berechneten Solldrehzahl" VALUE 0xE3A3A Kw_Ws16 5960.000 EngN 40.00000 6000.000 FORMAT "%8.3" EXTENDED_LIMITS -32768.00 32767.00 /end CHARACTERISTIC
/begin CHARACTERISTIC LIGov_nOffsetPreCtrltrqDem_C "Vorsteuerung aktiv n-Offset auf Basisdrehzahl und Momentenwunsch" VALUE 0xE3A3C Kw_Ws16 65535.00 EngN -32768.00 32767.00 FORMAT "%8.2" /end CHARACTERISTIC
/begin CHARACTERISTIC LIGov_nOffsetPreCtrl_C "Vorsteuerung aktiv n-Offset auf Basisdrehzahl" VALUE 0xE3A3E Kw_Ws16 65535.00 EngN -32768.00 32767.00 FORMAT "%8.2" /end CHARACTERISTIC
/begin CHARACTERISTIC LIGov_nOffsetPredef_C "Einschrittmoment aktiv n-Offset auf Basisdrehzahl" VALUE 0xE3A40 Kw_Ws16 65535.00 EngN -32768.00 32767.00 FORMAT "%8.2" /end CHARACTERISTIC
/begin CHARACTERISTIC LIGov_nOffsetUbr_C "Drehzahlschwelle für Erkennung für Leerlaufregler-Zustand Unterbremsen" VALUE 0xE3A42 Kw_Ws16 65535.00 EngN -32768.00 32767.00 FORMAT "%8.2" /end CHARACTERISTIC
/begin CHARACTERISTIC LIGov_rAPPThresFreezeI_C "Schwelle für PWG-Wert zum Rücksetzen des LLR Status ""freezeI""" VALUE 0xE3A44 Kw_Ws16 100.0000 Prc 0.00 100.0000 FORMAT "%8.4" EXTENDED_LIMITS -400.0000 399.9878 /end CHARACTERISTIC
/begin CHARACTERISTIC LIGov_rAPPThresTrqDem_C "Schwelle für PWG-Wert zum Rücksetzen des LLR Status ""torque demand""" VALUE 0xE3A46 Kw_Ws16 100.0000 Prc 0.00 100.0000 FORMAT "%8.4" EXTENDED_LIMITS -400.0000 399.9878 /end CHARACTERISTIC
/begin CHARACTERISTIC LIGov_stPsRev_C "Wählt Paramtersatz für Rückwärtsgang (1 entspricht PS 1.Gang, 2 entspricht PS 2.Gang)" VALUE 0xE3A48 Kw_Ws8 1.000 OneToOne 1.000 2.000 FORMAT "%5.3" EXTENDED_LIMITS -128.0 127.0 /end CHARACTERISTIC
/begin CHARACTERISTIC LIGov_swtAPPFreezeI_C "Schalter für die Auswahl gefilterter (0) oder ungefilterter (1) PWG-Wert für die Entscheidung des LLR-Status ""freezeI""" VALUE 0xE3A49 Kw_Wu8 1.000 OneToOne 0.00 1.000 FORMAT "%5.3" EXTENDED_LIMITS 0.00 255.0 /end CHARACTERISTIC
/begin CHARACTERISTIC LIGov_swtAPPTrqDem_C "Schalter für die Auswahl gefilterter (0) oder ungefilterter (1) PWG-Wert für die Entscheidung des LLR-Status ""torque demanded""" VALUE 0xE3A4A Kw_Wu8 1.000 OneToOne 0.00 1.000 FORMAT "%5.3" EXTENDED_LIMITS 0.00 255.0 /end CHARACTERISTIC
/begin CHARACTERISTIC LIGov_swtInitPreCtrlNotLck_C "Startzustand des LLR Zustands ""Vorsteuerung nicht gesperrt"" (0: nicht gesperrt, 1: gesperrt)" VALUE 0xE3A4B Kw_Wu8 1.000 OneToOne 0.00 1.000 FORMAT "%5.3" EXTENDED_LIMITS 0.00 255.0 /end CHARACTERISTIC
/begin CHARACTERISTIC LIGov_tClntXLow_C "Schwelle 1 für Wassertemperaturhysterese" VALUE 0xE3A4C Kw_Ws16 250.0000 Temp_Cels -50.14000 199.8600 FORMAT "%8.4" EXTENDED_LIMITS -3549.940 3003.560 /end CHARACTERISTIC
/begin CHARACTERISTIC LIGov_tClntXHigh_C "Schwelle 2 für Wassertemperaturhysterese" VALUE 0xE3A4E Kw_Ws16 250.0000 Temp_Cels -50.14000 199.8600 FORMAT "%8.4" EXTENDED_LIMITS -3549.940 3003.560 /end CHARACTERISTIC
/begin CHARACTERISTIC LIGov_stCold_C "Konstante für LiGov Status kalt" VALUE 0xE3A50 Kw_Ws16 65535.00 OneToOne -32768.00 32767.00 FORMAT "%8.2" READ_ONLY /end CHARACTERISTIC
/begin CHARACTERISTIC LIGov_stWarm_C "Konstante für LIGov Status warm" VALUE 0xE3A52 Kw_Ws16 65535.00 OneToOne -32768.00 32767.00 FORMAT "%8.2" READ_ONLY /end CHARACTERISTIC
/begin CHARACTERISTIC LIGov_tiDelCutOut_C "delay time after CoEng_stEng moves from status COENG_STSTART to COENG_STNORMAL" VALUE 0xE3A54 Kw_Wu16 2000.000 Time_ms 0.00 2000.000 FORMAT "%8.3" EXTENDED_LIMITS 0.00 655350.0 /end CHARACTERISTIC
/begin CHARACTERISTIC LIGov_tiPT1_CUR "Kennlinie der Zeitkonstanten für die PT1 Flterung über der Drehzahl" CURVE 0xE3A56 Kl_Xs16_Ws16 5.000000 TimeDelay_s_Lin_16 0.00 5.000000 FORMAT "%8.6" EXTENDED_LIMITS -5.000153 5.000000
 /begin AXIS_DESCR STD_AXIS LIGov_nDiff_mp EngN 8 -5000.000 1000.000 FORMAT "%8.3" EXTENDED_LIMITS -32768.00 32767.00 DEPOSIT ABSOLUTE /end AXIS_DESCR
/end CHARACTERISTIC
/begin CHARACTERISTIC LIGov_trqMax_CUR "Wassertemperaturabhängiges Begrenzungsmoment für den LLR" CURVE 0xE3A78 Kl_Xs16_Ws16 400.0000 Trq 0.00 400.0000 FORMAT "%8.4" EXTENDED_LIMITS -3276.800 3276.700
 /begin AXIS_DESCR STD_AXIS Eng_nAvrg EngN 8 -32768.00 32767.00 FORMAT "%8.2" DEPOSIT ABSOLUTE /end AXIS_DESCR
/end CHARACTERISTIC
/begin CHARACTERISTIC LIGov_trqSetMax_C "Maximale begrenze fuer Moment anforderung über Diagnose für NMK Schnellernen" VALUE 0xE3A9A Kw_Ws16 70.00000 Trq 0.00 70.00000 FORMAT "%8.5" EXTENDED_LIMITS -3276.800 3276.700 /end CHARACTERISTIC
/begin CHARACTERISTIC LIGov_trqThresDefrostI_C "Mengenschwelle Integrator einfrieren/auftauen" VALUE 0xE3A9C Kw_Ws16 6553.500 Trq -3276.800 3276.700 FORMAT "%8.3" /end CHARACTERISTIC
/begin CHARACTERISTIC LIGov_UbrPKp_C "Kleinsignalverstärkung" VALUE 0xE3AA0 Kw_Wu32 52428.7999878 Kp_rpm2Nm 0.00 52428.7999878 FORMAT "%13.7" /end CHARACTERISTIC
/begin CHARACTERISTIC LIGov_UbrPKpPos_C "Verstärkung für positive Großsignale" VALUE 0xE3AA4 Kw_Wu32 52428.7999878 Kp_rpm2Nm 0.00 52428.7999878 FORMAT "%13.7" /end CHARACTERISTIC
/begin CHARACTERISTIC LIGov_UbrPKpNeg_C "Verstärkung für negative Großsignale" VALUE 0xE3AA8 Kw_Wu32 52428.7999878 Kp_rpm2Nm 0.00 52428.7999878 FORMAT "%13.7" /end CHARACTERISTIC
/begin CHARACTERISTIC LIGov_UbrPWinPos_C "Kleinsignalfenster positiv" VALUE 0xE3AAC Kw_Ws16 8191.875 EngN_HiRes -4096.000 4095.875 FORMAT "%8.3" /end CHARACTERISTIC
/begin CHARACTERISTIC LIGov_UbrPWinNeg_C "Kleinsignalfenster negativ" VALUE 0xE3AAE Kw_Ws16 8191.875 EngN_HiRes -4096.000 4095.875 FORMAT "%8.3" /end CHARACTERISTIC
/begin CHARACTERISTIC LIGov_vThresUbr_C "Schwellgeschwindigkeit bei Unterbremsen" VALUE 0xE3AB0 Kw_Ws16 655.3500 Vel -327.6800 327.6700 FORMAT "%8.4" /end CHARACTERISTIC
/begin CHARACTERISTIC LIGov_WrmCltchFlt1T1_C "T1 Komponente für erstes PDT1-Glied wenn ausgekuppelt und Motor warm" VALUE 0xE3AB4 Kw_Wu32 4294.9673 TimeDelay_s 0.0000010000000 4294.9673 FORMAT "%9.4" /end CHARACTERISTIC
/begin CHARACTERISTIC LIGov_WrmCltchFlt2T1_C "T1 Komponente für zweites PDT1-Glied wenn ausgekuppelt und Motor warm" VALUE 0xE3AB8 Kw_Wu32 4294.9673 TimeDelay_s 0.0000010000000 4294.9673 FORMAT "%9.4" /end CHARACTERISTIC
/begin CHARACTERISTIC LIGov_WrmCltchIKi_C "Kleinsignalverstärkung" VALUE 0xE3ABC Kw_Wu32 799999.999814 Ki_rpm2Nm 0.00 799999.999814 FORMAT "%13.6" /end CHARACTERISTIC
/begin CHARACTERISTIC LIGov_WrmCltchIKiPos_C "Verstärkung für positive Großsignale" VALUE 0xE3AC0 Kw_Wu32 799999.999814 Ki_rpm2Nm 0.00 799999.999814 FORMAT "%13.6" /end CHARACTERISTIC
/begin CHARACTERISTIC LIGov_WrmCltchIKiNeg_C "Verstärkung für negative Großsignale" VALUE 0xE3AC4 Kw_Wu32 799999.999814 Ki_rpm2Nm 0.00 799999.999814 FORMAT "%13.6" /end CHARACTERISTIC
/begin CHARACTERISTIC LIGov_WrmCltchIWinPos_C "Kleinsignalfenster positiv" VALUE 0xE3AC8 Kw_Ws16 8191.875 EngN_HiRes -4096.000 4095.875 FORMAT "%8.3" /end CHARACTERISTIC
/begin CHARACTERISTIC LIGov_WrmCltchIWinNeg_C "Kleinsignalfenster negativ" VALUE 0xE3ACA Kw_Ws16 8191.875 EngN_HiRes -4096.000 4095.875 FORMAT "%8.3" /end CHARACTERISTIC
/begin CHARACTERISTIC LIGov_WrmCltchPredef_C "Einschrittmoment Vorsteuerung" VALUE 0xE3ACC Kw_Ws16 6553.500 Trq -3276.800 3276.700 FORMAT "%8.3" /end CHARACTERISTIC
/begin CHARACTERISTIC LIGov_WrmCltchPKp_C "Kleinsignalverstärkung" VALUE 0xE3AD0 Kw_Wu32 52428.7999878 Kp_rpm2Nm 0.00 52428.7999878 FORMAT "%13.7" /end CHARACTERISTIC
/begin CHARACTERISTIC LIGov_WrmCltchPKpPos_C "Verstärkung für positive Großsignale" VALUE 0xE3AD4 Kw_Wu32 52428.7999878 Kp_rpm2Nm 0.00 52428.7999878 FORMAT "%13.7" /end CHARACTERISTIC
/begin CHARACTERISTIC LIGov_WrmCltchPKpNeg_C "Verstärkung für negative Großsignale" VALUE 0xE3AD8 Kw_Wu32 52428.7999878 Kp_rpm2Nm 0.00 52428.7999878 FORMAT "%13.7" /end CHARACTERISTIC
/begin CHARACTERISTIC LIGov_WrmCltchPWinPos_C "Kleinsignalfenster positiv" VALUE 0xE3ADC Kw_Ws16 8191.875 EngN_HiRes -4096.000 4095.875 FORMAT "%8.3" /end CHARACTERISTIC
/begin CHARACTERISTIC LIGov_WrmCltchPWinNeg_C "Kleinsignalfenster negativ" VALUE 0xE3ADE Kw_Ws16 8191.875 EngN_HiRes -4096.000 4095.875 FORMAT "%8.3" /end CHARACTERISTIC
/begin CHARACTERISTIC PwrMng_B_ulcp_C "Applikationslabel fuer Powermanagement" VALUE 0xE382A Kw_Wu8 255.0 OneToOne 0.00 255.0 FORMAT "%5.1" /end CHARACTERISTIC
/begin CHARACTERISTIC PwrMng_dmAirPerTimeCor_C "correction factor for air mass per time" VALUE 0xE382C Kw_Ws16 1500.000 SlopeRes10000 0.00 1500.000 FORMAT "%8.3" EXTENDED_LIMITS -3.276800 3.276700 /end CHARACTERISTIC
/begin CHARACTERISTIC PwrMng_dmAirPerTimeIMax_C "Maximum integrated air mass" VALUE 0xE382E Kw_Wu8 1500. AirMassPerTime 0.00 1500. FORMAT "%5.0" EXTENDED_LIMITS 0.00 25.50 /end CHARACTERISTIC
/begin CHARACTERISTIC PwrMng_dmAirPerTimeIMin_C "Integrated air mass minimum value" VALUE 0xE382F Kw_Wu8 1500. AirMassPerTime 0.00 1500. FORMAT "%5.0" EXTENDED_LIMITS 0.00 25.50 /end CHARACTERISTIC
/begin CHARACTERISTIC PwrMng_dmAirPerTimeIKi_C "I-governor gain, deviation is within small signal bounds" VALUE 0xE3830 Kw_Wu32 5.00003807247 Ki 0.00 5.00003807247 FORMAT "%13.11" EXTENDED_LIMITS 0.00 999999.999767 /end CHARACTERISTIC
/begin CHARACTERISTIC PwrMng_dmAirPerTimeIKiPos_C "I-governor gain, deviation is greater than small signal bound" VALUE 0xE3834 Kw_Wu32 5.00003807247 Ki 0.00 5.00003807247 FORMAT "%13.11" EXTENDED_LIMITS 0.00 999999.999767 /end CHARACTERISTIC
/begin CHARACTERISTIC PwrMng_dmAirPerTimeIKiNeg_C "I-governor gain, deviation is less than small signal bound" VALUE 0xE3838 Kw_Wu32 5.00003807247 Ki 0.00 5.00003807247 FORMAT "%13.11" EXTENDED_LIMITS 0.00 999999.999767 /end CHARACTERISTIC
/begin CHARACTERISTIC PwrMng_dmAirPerTimeIWinPos_C "I-governor positive window border" VALUE 0xE383C Kw_Ws16 1500.000 AirMassPerTime 0.00 1500.000 FORMAT "%8.3" EXTENDED_LIMITS -3276.800 3276.700 /end CHARACTERISTIC
/begin CHARACTERISTIC PwrMng_dmAirPerTimeIWinNeg_C "I-governor negative window border" VALUE 0xE383E Kw_Ws16 1500.000 AirMassPerTime 0.00 1500.000 FORMAT "%8.3" EXTENDED_LIMITS -3276.800 3276.700 /end CHARACTERISTIC
/begin CHARACTERISTIC PwrMng_nB_kwdrehtHi_C "" VALUE 0xE3840 Kw_Ws16 6000.000 EngN 0.00 6000.000 FORMAT "%8.3" EXTENDED_LIMITS -32768.00 32767.00 /end CHARACTERISTIC
/begin CHARACTERISTIC PwrMng_nB_kwdrehtLo_C "" VALUE 0xE3842 Kw_Ws16 6000.000 EngN 0.00 6000.000 FORMAT "%8.3" EXTENDED_LIMITS -32768.00 32767.00 /end CHARACTERISTIC
/begin CHARACTERISTIC PwrMng_nB_llHigh_C "High threshold for condition low idle" VALUE 0xE3844 Kw_Ws16 6000.000 EngN 0.00 6000.000 FORMAT "%8.3" EXTENDED_LIMITS -32768.00 32767.00 /end CHARACTERISTIC
/begin CHARACTERISTIC PwrMng_nB_llLow_C "Low threshold for condition low idle" VALUE 0xE3846 Kw_Ws16 6000.000 EngN 0.00 6000.000 FORMAT "%8.3" EXTENDED_LIMITS -32768.00 32767.00 /end CHARACTERISTIC
/begin CHARACTERISTIC PwrMng_rLoadMax_C "Threshold for condition maximum load" VALUE 0xE3848 Kw_Ws16 100.0000 Prc 0.00 100.0000 FORMAT "%8.4" EXTENDED_LIMITS -400.0000 399.9878 /end CHARACTERISTIC
/begin CHARACTERISTIC PwrMng_rLoadMin_C "" VALUE 0xE384A Kw_Ws16 100.0000 Prc 0.00 100.0000 FORMAT "%8.4" EXTENDED_LIMITS -400.0000 399.9878 /end CHARACTERISTIC
/begin CHARACTERISTIC PwrMng_stIdlingDefVal_C "defect value for n_idlms" VALUE 0xE384C Kw_Wu8 255.0 OneToOne 0.00 255.0 FORMAT "%5.1" /end CHARACTERISTIC
/begin CHARACTERISTIC PwrMng_swtnmot_w_C "switch for nmot_w (Eng_nAvrg/CrSCD_nCurr)" VALUE 0xE384D Kw_Wu8 1.000 OneToOne 0.00 1.000 FORMAT "%5.3" EXTENDED_LIMITS 0.00 255.0 /end CHARACTERISTIC
/begin CHARACTERISTIC PwrMng_swtPmsvActiv_C "Applikationslabel fuer Powermanagement" VALUE 0xE384E Kw_Wu8 1.000 OneToOne 0.00 1.000 FORMAT "%5.3" EXTENDED_LIMITS 0.00 255.0 /end CHARACTERISTIC
/begin CHARACTERISTIC PwrMng_swttumg_C "switch for tumg (IATSCD_tAir/EATSCD_tAir)" VALUE 0xE384F Kw_Wu8 1.000 OneToOne 0.00 1.000 FORMAT "%5.3" EXTENDED_LIMITS 0.00 255.0 /end CHARACTERISTIC
/begin CHARACTERISTIC PwrMng_tiChgBatt_C "Applikationslabel fuer Powermanagement" VALUE 0xE3850 Kw_Wu16 10000.00 Time_ms 0.00 10000.00 FORMAT "%8.2" EXTENDED_LIMITS 0.00 655350.0 /end CHARACTERISTIC
/begin CHARACTERISTIC PwrMng_tiHisRst_C "Applikationslabel fuer Powermanagement" VALUE 0xE3852 Kw_Wu16 10000.00 Time_ms 0.00 10000.00 FORMAT "%8.2" EXTENDED_LIMITS 0.00 655350.0 /end CHARACTERISTIC
/begin CHARACTERISTIC PwrMng_Tkat_mod_C "" VALUE 0xE3854 Kw_Ws16 327675.0 temp_ub_q5_o50 -163890.0 163785.0 FORMAT "%8.1" /end CHARACTERISTIC
/begin CHARACTERISTIC PwrMng_uAltTargetDefVal_C "defect value for ctrgnms" VALUE 0xE3856 Kw_Ws16 65535.00 OneToOne -32768.00 32767.00 FORMAT "%8.2" /end CHARACTERISTIC
/begin MEASUREMENT BD_BSD "" UBYTE OneToOne 1 100 0.00 255.0 FORMAT "%5.1" ECU_ADDRESS 0x8FF470 /end MEASUREMENT
/begin MEASUREMENT BD_GEN "" UBYTE OneToOne 1 100 0.00 255.0 FORMAT "%5.1" ECU_ADDRESS 0x8FF471 /end MEASUREMENT
/begin MEASUREMENT BD_IBS1 "" UBYTE OneToOne 1 100 0.00 255.0 FORMAT "%5.1" ECU_ADDRESS 0x8FF472 /end MEASUREMENT
/begin MEASUREMENT BD_IBS2 "" UBYTE OneToOne 1 100 0.00 255.0 FORMAT "%5.1" ECU_ADDRESS 0x8FF473 /end MEASUREMENT
/begin MEASUREMENT BD_IBS3 "" UBYTE OneToOne 1 100 0.00 255.0 FORMAT "%5.1" ECU_ADDRESS 0x8FF474 /end MEASUREMENT
/begin MEASUREMENT BD_MANHYDR "" UBYTE OneToOne 1 100 0.00 255.0 FORMAT "%5.1" ECU_ADDRESS 0x8FF475 /end MEASUREMENT
/begin MEASUREMENT BD_MANLUFT "" UBYTE OneToOne 1 100 0.00 255.0 FORMAT "%5.1" ECU_ADDRESS 0x8FF476 /end MEASUREMENT
/begin MEASUREMENT BD_PMBATT "" UBYTE OneToOne 1 100 0.00 255.0 FORMAT "%5.1" ECU_ADDRESS 0x8FF477 /end MEASUREMENT
/begin MEASUREMENT BD_PMBN "" UBYTE OneToOne 1 100 0.00 255.0 FORMAT "%5.1" ECU_ADDRESS 0x8FF478 /end MEASUREMENT
/begin MEASUREMENT BD_PMRUHVERL "" UBYTE OneToOne 1 100 0.00 255.0 FORMAT "%5.1" ECU_ADDRESS 0x8FF479 /end MEASUREMENT
/begin MEASUREMENT BD_QLT "" UBYTE OneToOne 1 100 0.00 255.0 FORMAT "%5.1" ECU_ADDRESS 0x8FF47A /end MEASUREMENT
/begin MEASUREMENT BD_TANS "" UBYTE OneToOne 1 100 0.00 255.0 FORMAT "%5.1" ECU_ADDRESS 0x8FF47B /end MEASUREMENT
/begin MEASUREMENT BD_TOENS "" UBYTE OneToOne 1 100 0.00 255.0 FORMAT "%5.1" ECU_ADDRESS 0x8FF47C /end MEASUREMENT
/begin MEASUREMENT BD_TUMG "" UBYTE OneToOne 1 100 0.00 255.0 FORMAT "%5.1" ECU_ADDRESS 0x8FF47D /end MEASUREMENT
/begin MEASUREMENT Counter_Layer_fp1000_mp "" UBYTE OneToOne 1 100 0.00 255.0 FORMAT "%5.1" ECU_ADDRESS 0x8FF4A8 /end MEASUREMENT
/begin MEASUREMENT Counter_Layer_fp100_mp "" UBYTE OneToOne 1 100 0.00 255.0 FORMAT "%5.1" ECU_ADDRESS 0x8FF4A9 /end MEASUREMENT
/begin MEASUREMENT Counter_Layer_fp10_mp "" UBYTE OneToOne 1 100 0.00 255.0 FORMAT "%5.1" ECU_ADDRESS 0x8FF4AA /end MEASUREMENT
/begin MEASUREMENT Counter_Layer_fp200_mp "" UBYTE OneToOne 1 100 0.00 255.0 FORMAT "%5.1" ECU_ADDRESS 0x8FF4AB /end MEASUREMENT
/begin MEASUREMENT Counter_Layer_ini_mp "" UBYTE OneToOne 1 100 0.00 255.0 FORMAT "%5.1" ECU_ADDRESS 0x8FF4AC /end MEASUREMENT
/begin MEASUREMENT Counter_Layer_nl1000_mp "" UBYTE OneToOne 1 100 0.00 255.0 FORMAT "%5.1" ECU_ADDRESS 0x8FF4AD /end MEASUREMENT
/begin MEASUREMENT Counter_Layer_nl100_mp "" UBYTE OneToOne 1 100 0.00 255.0 FORMAT "%5.1" ECU_ADDRESS 0x8FF4AE /end MEASUREMENT
/begin MEASUREMENT Counter_Layer_nl10_mp "" UBYTE OneToOne 1 100 0.00 255.0 FORMAT "%5.1" ECU_ADDRESS 0x8FF4AF /end MEASUREMENT
/begin MEASUREMENT Counter_Layer_nl200_mp "" UBYTE OneToOne 1 100 0.00 255.0 FORMAT "%5.1" ECU_ADDRESS 0x8FF4B0 /end MEASUREMENT
/begin MEASUREMENT Counter_Layer_wakeup1000_mp "" UBYTE OneToOne 1 100 0.00 255.0 FORMAT "%5.1" ECU_ADDRESS 0x8FF4B1 /end MEASUREMENT
/begin MEASUREMENT Counter_Layer_wakeup100_mp "" UBYTE OneToOne 1 100 0.00 255.0 FORMAT "%5.1" ECU_ADDRESS 0x8FF4B2 /end MEASUREMENT
/begin MEASUREMENT Counter_Layer_wakeup10_mp "" UBYTE OneToOne 1 100 0.00 255.0 FORMAT "%5.1" ECU_ADDRESS 0x8FF4B3 /end MEASUREMENT
/begin MEASUREMENT Counter_Layer_wakeup200_mp "" UBYTE OneToOne 1 100 0.00 255.0 FORMAT "%5.1" ECU_ADDRESS 0x8FF4B4 /end MEASUREMENT
/begin MEASUREMENT E_BSD "" UBYTE OneToOne 1 100 0.00 255.0 FORMAT "%5.1" ECU_ADDRESS 0x8FF47E /end MEASUREMENT
/begin MEASUREMENT E_GEN "" UBYTE OneToOne 1 100 0.00 255.0 FORMAT "%5.1" ECU_ADDRESS 0x8FF47F /end MEASUREMENT
/begin MEASUREMENT E_IBS1 "" UBYTE OneToOne 1 100 0.00 255.0 FORMAT "%5.1" ECU_ADDRESS 0x8FF480 /end MEASUREMENT
/begin MEASUREMENT E_IBS2 "" UBYTE OneToOne 1 100 0.00 255.0 FORMAT "%5.1" ECU_ADDRESS 0x8FF481 /end MEASUREMENT
/begin MEASUREMENT E_IBS3 "" UBYTE OneToOne 1 100 0.00 255.0 FORMAT "%5.1" ECU_ADDRESS 0x8FF482 /end MEASUREMENT
/begin MEASUREMENT E_MANHYDR "" UBYTE OneToOne 1 100 0.00 255.0 FORMAT "%5.1" ECU_ADDRESS 0x8FF483 /end MEASUREMENT
/begin MEASUREMENT E_MANLUFT "" UBYTE OneToOne 1 100 0.00 255.0 FORMAT "%5.1" ECU_ADDRESS 0x8FF484 /end MEASUREMENT
/begin MEASUREMENT E_PMBATT "" UBYTE OneToOne 1 100 0.00 255.0 FORMAT "%5.1" ECU_ADDRESS 0x8FF485 /end MEASUREMENT
/begin MEASUREMENT E_PMBN "" UBYTE OneToOne 1 100 0.00 255.0 FORMAT "%5.1" ECU_ADDRESS 0x8FF486 /end MEASUREMENT
/begin MEASUREMENT E_PMRUHVERL "" UBYTE OneToOne 1 100 0.00 255.0 FORMAT "%5.1" ECU_ADDRESS 0x8FF487 /end MEASUREMENT
/begin MEASUREMENT E_QLT "" UBYTE OneToOne 1 100 0.00 255.0 FORMAT "%5.1" ECU_ADDRESS 0x8FF488 /end MEASUREMENT
/begin MEASUREMENT E_TANS "" UBYTE OneToOne 1 100 0.00 255.0 FORMAT "%5.1" ECU_ADDRESS 0x8FF489 /end MEASUREMENT
/begin MEASUREMENT E_TOENS "" UBYTE OneToOne 1 100 0.00 255.0 FORMAT "%5.1" ECU_ADDRESS 0x8FF48A /end MEASUREMENT
/begin MEASUREMENT E_TUMG "" UBYTE OneToOne 1 100 0.00 255.0 FORMAT "%5.1" ECU_ADDRESS 0x8FF48B /end MEASUREMENT
/begin MEASUREMENT InjCrv_facPoI2EffRgn "Faktor für den drehmomentbildenden Anteil der Einspritzmenge PoI2 im Regenerationsmodus" SWORD Fact 1 100 -4.000000 3.999878 FORMAT "%8.6" ECU_ADDRESS 0x7F8DF0 /end MEASUREMENT
/begin MEASUREMENT InjCrv_facPoI2EffRgn1_mp "corrected factor component for PoI2" SWORD Fact 1 100 -4.000000 3.999878 FORMAT "%8.6" ECU_ADDRESS 0x8FF35A /end MEASUREMENT
/begin MEASUREMENT InjCrv_facPoI2EffRgn2_mp "corrected factor component for PoI2" SWORD Fact 1 100 -4.000000 3.999878 FORMAT "%8.6" ECU_ADDRESS 0x8FF35C /end MEASUREMENT
/begin MEASUREMENT InjCrv_facPoI2EffRgnByp_mp "Effektivwert Nacheinspritzung Regeneration" SWORD Fact 1 100 -4.000000 3.999878 FORMAT "%8.6" ECU_ADDRESS 0x8FF35E /end MEASUREMENT
/begin MEASUREMENT InjCrv_phiPoI2AbsTot_mp "absoluter Ansteuerbeginn PoI2 aus Winkel- und Zeitkomponente" SWORD AngleCrS 1 100 -768.0000 767.9766 FORMAT "%8.4" ECU_ADDRESS 0x8FF376 /end MEASUREMENT
/begin MEASUREMENT InjCrv_phiPoI2Abs_mp "Sollwert, Winkelkomponente Ansteuerbeginn PoI2 relativ zum oberen Totpunkt" SWORD AngleCrS 1 100 -768.0000 767.9766 FORMAT "%8.4" ECU_ADDRESS 0x8FF378 /end MEASUREMENT
/begin MEASUREMENT InjCrv_phiPoI2Bas_mp "Winkelkomponente Ansteuerbeginn PoI2 Grundwert" SWORD AngleCrS 1 100 -768.0000 767.9766 FORMAT "%8.4" ECU_ADDRESS 0x8FF390 /end MEASUREMENT
/begin MEASUREMENT InjCrv_phiPoI2Byp_mp "Messpunkt für Bypass" SWORD AngleCrS 1 100 -768.0000 767.9766 FORMAT "%8.4" ECU_ADDRESS 0x8FF37A /end MEASUREMENT
/begin MEASUREMENT InjCrv_phiPoI2Cor_mp "korrigierter Grundwert der Winkelkomponente Ansteuerbeginn PoI2" SWORD AngleCrS 1 100 -768.0000 767.9766 FORMAT "%8.4" ECU_ADDRESS 0x8FF37C /end MEASUREMENT
/begin MEASUREMENT InjCrv_phiPoI2Des "gewünschter Bezugswinkel für Beginn der PoI2" SWORD AngleCrS 1 100 -768.0000 767.9766 FORMAT "%8.4" ECU_ADDRESS 0x7F8E20 /end MEASUREMENT
/begin MEASUREMENT InjCrv_phiPoI2Rel_mp "Winkelkomponente Ansteuerbeginn PoI2 relativ zur Haupteinspritzung" SWORD AngleCrS 1 100 -768.0000 767.9766 FORMAT "%8.4" ECU_ADDRESS 0x8FF37E /end MEASUREMENT
/begin MEASUREMENT InjCrv_phiPoI2Rgn "Grundwert der Winkelkomponente Ansteuerbeginn PoI2 im Regenerationsbetrieb" SWORD AngleCrS 1 100 -768.0000 767.9766 FORMAT "%8.4" ECU_ADDRESS 0x7F8E24 /end MEASUREMENT
/begin MEASUREMENT InjCrv_phiPoI2Rgn1_mp "Regenerationswert 1 für Förderbeginn Nacheinspritzung" SWORD AngleCrS 1 100 -768.0000 767.9766 FORMAT "%8.4" ECU_ADDRESS 0x8FF360 /end MEASUREMENT
/begin MEASUREMENT InjCrv_phiPoI2Rgn2_mp "Regenerationswert 2 für Förderbeginn Nacheinspritzung" SWORD AngleCrS 1 100 -768.0000 767.9766 FORMAT "%8.4" ECU_ADDRESS 0x8FF362 /end MEASUREMENT
/begin MEASUREMENT InjCrv_phiPoI2RgnByp_mp "Measure point for Bypass" SWORD AngleCrS 1 100 -768.0000 767.9766 FORMAT "%8.4" ECU_ADDRESS 0x8FF364 /end MEASUREMENT
/begin MEASUREMENT InjCrv_PoI2RgnTypeVal "activation value for PoI2 demanded by EGT-System" ULONG EGTSwt 1 100 0.00 262.143999939 FORMAT "%13.9" ECU_ADDRESS 0x7F9158 /end MEASUREMENT
/begin MEASUREMENT InjCrv_POpPoI2Bas_mp "grundwert Freigabe PoI2" SWORD OneToOne 1 100 -32768.00 32767.00 FORMAT "%8.2" ECU_ADDRESS 0x8FF372 /end MEASUREMENT
/begin MEASUREMENT InjCrv_POpPoI2_mp "reigabe PoI2, korrigierter Grundwert" SWORD OneToOne 1 100 -32768.00 32767.00 FORMAT "%8.2" ECU_ADDRESS 0x8FF374 /end MEASUREMENT
/begin MEASUREMENT InjCrv_qPiI1MinWv_mp "Minimalmenge der PiI1 mit Wellenlorrektur" SWORD InjMassInj 1 100 -327.6800 327.6700 FORMAT "%8.4" ECU_ADDRESS 0x8FF394 /end MEASUREMENT
/begin MEASUREMENT InjCrv_qPoI2DesByp_mp "Messpunkt für den Bypass" SWORD InjMassInj 1 100 -327.6800 327.6700 FORMAT "%8.4" ECU_ADDRESS 0x8FF380 /end MEASUREMENT
/begin MEASUREMENT InjCrv_qPoI2EffByp_mp "Messpunkt für den Bypass" SWORD InjMassInj 1 100 -327.6800 327.6700 FORMAT "%8.4" ECU_ADDRESS 0x8FF382 /end MEASUREMENT
/begin MEASUREMENT InjCrv_qPoI2Rgn "Grundwert Einspritzmenge PoI2 im Regenerationsbetrieb" SWORD InjMassInj 1 100 -327.6800 327.6700 FORMAT "%8.4" ECU_ADDRESS 0x7F8E56 /end MEASUREMENT
/begin MEASUREMENT InjCrv_qPoI2Rgn1_mp "Grundwert 1 für Regenerationsmenge Nacheinspritzung" SWORD InjMassInj 1 100 -327.6800 327.6700 FORMAT "%8.4" ECU_ADDRESS 0x8FF366 /end MEASUREMENT
/begin MEASUREMENT InjCrv_qPoI2Rgn2_mp "Regenerationswert 2  für Menge Nacheinspritzung" SWORD InjMassInj 1 100 -327.6800 327.6700 FORMAT "%8.4" ECU_ADDRESS 0x8FF368 /end MEASUREMENT
/begin MEASUREMENT InjCrv_qPoI2RgnByp_mp "Measure point for Bypass" SWORD InjMassInj 1 100 -327.6800 327.6700 FORMAT "%8.4" ECU_ADDRESS 0x8FF36A /end MEASUREMENT
/begin MEASUREMENT InjCrv_swtPoI2AgAbsTDC_mp "Status des Betriebsmodus Ansteuerbeginn PoI2 (entweder Winkel absolut zum TDC oder Winkel bzw. Zeit relativ zur MI)" UBYTE OneToOne 1 100 0.00 255.0 FORMAT "%5.1" ECU_ADDRESS 0x8FF384 /end MEASUREMENT
/begin MEASUREMENT InjCrv_tiFstDcy_mp "Schnellloeschdauer" SLONG InjTime_us 1 100 -2147483648.00 2147483647.00 FORMAT "%13.2" ECU_ADDRESS 0x8FF398 /end MEASUREMENT
/begin MEASUREMENT InjCrv_tiPoI2Bas_mp "Zeitkomponente Ansteuerbeginn PoI2 Grundwert" SWORD InjTime_us 1 100 -32768.00 32767.00 FORMAT "%8.2" ECU_ADDRESS 0x8FF392 /end MEASUREMENT
/begin MEASUREMENT InjCrv_tiPoI2Byp_mp "Messpunkt für den Bypass" SWORD InjTime_us 1 100 -32768.00 32767.00 FORMAT "%8.2" ECU_ADDRESS 0x8FF386 /end MEASUREMENT
/begin MEASUREMENT InjCrv_tiPoI2Cor_mp "korrigierter Grundwert der Zeitkomponente Ansteuerbeginn PoI2" SWORD InjTime_us 1 100 -32768.00 32767.00 FORMAT "%8.2" ECU_ADDRESS 0x8FF388 /end MEASUREMENT
/begin MEASUREMENT InjCrv_tiPoI2Des "gewünschte Bezugszeitkomponente für Beginn PoI2" SWORD InjTime_us 1 100 -32768.00 32767.00 FORMAT "%8.2" ECU_ADDRESS 0x7F8E7C /end MEASUREMENT
/begin MEASUREMENT InjCrv_tiPoI2Max_mp "maximaler Ansteuerbeginn PoI2 relativ zur Haupteinspritzung" SWORD InjTime_us 1 100 -32768.00 32767.00 FORMAT "%8.2" ECU_ADDRESS 0x8FF38A /end MEASUREMENT
/begin MEASUREMENT InjCrv_tiPoI2RelTot_mp "Ansteuerbeginnabstand PoI2 aus Winkel- und Zeitkomponente" SWORD InjTime_us 1 100 -32768.00 32767.00 FORMAT "%8.2" ECU_ADDRESS 0x8FF38C /end MEASUREMENT
/begin MEASUREMENT InjCrv_tiPoI2Rel_mp "Zeitkomponente Ansteuerbeginn PoI2 relativ zur Haupteinspritzung" SWORD InjTime_us 1 100 -32768.00 32767.00 FORMAT "%8.2" ECU_ADDRESS 0x8FF38E /end MEASUREMENT
/begin MEASUREMENT InjCrv_tiPoI2Rgn "Grundwert der Zeitkomponente Ansteuerbeginn PoI2 im Regenerationsbetrieb" SWORD InjTime_us 1 100 -32768.00 32767.00 FORMAT "%8.2" ECU_ADDRESS 0x7F8E80 /end MEASUREMENT
/begin MEASUREMENT InjCrv_tiPoI2Rgn1_mp "corrected time component for PoI2 Regeneration 1" SWORD InjTime_us 1 100 -32768.00 32767.00 FORMAT "%8.2" ECU_ADDRESS 0x8FF36C /end MEASUREMENT
/begin MEASUREMENT InjCrv_tiPoI2Rgn2_mp "Corrected time component for PoI2 Regeneration 2" SWORD InjTime_us 1 100 -32768.00 32767.00 FORMAT "%8.2" ECU_ADDRESS 0x8FF36E /end MEASUREMENT
/begin MEASUREMENT InjCrv_tiPoI2RgnByp_mp "Measure point for Bypass" SWORD InjTime_us 1 100 -32768.00 32767.00 FORMAT "%8.2" ECU_ADDRESS 0x8FF370 /end MEASUREMENT
/begin MEASUREMENT InjCrv_tiPse "feste oder gemessene Mindestzeit zwischen 2 Einspritzungen" SWORD InjTime_us 1 100 -32768.00 32767.00 FORMAT "%8.2" ECU_ADDRESS 0x7F8E84 /end MEASUREMENT
/begin MEASUREMENT InjCtl_dAdjQntCS_mp "Checksumme der Mengenabgleichkennfeldwerte (im EEPROM abgelegt)" UBYTE OneToOne 1 100 0.00 255.0 FORMAT "%5.1" ECU_ADDRESS 0x8FF39C /end MEASUREMENT
/begin MEASUREMENT InjCtl_dDriftCS_mp "Checksumme der Mengendriftkompensationswerte (im EEPROM abgelegt)" UBYTE OneToOne 1 100 0.00 255.0 FORMAT "%5.1" ECU_ADDRESS 0x8FF39D /end MEASUREMENT
/begin MEASUREMENT InjCtl_dqSetUnBal "Kraftstoffmassengradient ohne FBC" SWORD InjMassPerSec_20ms 1 100 -16384.00 16383.50 FORMAT "%8.2" ECU_ADDRESS 0x7F8E86 /end MEASUREMENT
/begin MEASUREMENT InjCtl_facAdjSrvUnlim_mp "Serviceabgleich Faktor (im EEPROM abgelegt)" SWORD Fact 1 100 -4.000000 3.999878 FORMAT "%8.6" ECU_ADDRESS 0x8FF39E /end MEASUREMENT
/begin MEASUREMENT InjCtl_facAdjSrv_mp "Serviceabgleichfaktor (nach Limitierung)" SWORD Fact 1 100 -4.000000 3.999878 FORMAT "%8.6" ECU_ADDRESS 0x8FF3A0 /end MEASUREMENT
/begin MEASUREMENT InjCtl_qAdjQntUnlim_mp "Mengenabgleichwert vor Begrenzung" SWORD InjMassCyc 1 100 -327.6800 327.6700 FORMAT "%8.4" ECU_ADDRESS 0x8FF3A2 /end MEASUREMENT
/begin MEASUREMENT InjCtl_qAdjQnt_mp "Mengenabgleichwert" SWORD InjMassCyc 1 100 -327.6800 327.6700 FORMAT "%8.4" ECU_ADDRESS 0x8FF3A4 /end MEASUREMENT
/begin MEASUREMENT InjCtl_qCurr "Einspritzmenge aktueller Wert" SWORD InjMassCyc 1 100 -327.6800 327.6700 FORMAT "%8.4" ECU_ADDRESS 0x7F8E88 /end MEASUREMENT
/begin MEASUREMENT InjCtl_qCurrCor "fuel mass current value with FMA correction" SWORD InjMassCyc 1 100 -327.6800 327.6700 FORMAT "%8.4" ECU_ADDRESS 0x7F8E8A /end MEASUREMENT
/begin MEASUREMENT InjCtl_qCurrUnCor "aktuelle Menge ohne Korrektur durch Mengenmittelwertadaption (FMA)" SWORD InjMassCyc 1 100 -327.6800 327.6700 FORMAT "%8.4" ECU_ADDRESS 0x7F8E8C /end MEASUREMENT
/begin MEASUREMENT InjCtl_qDes "Einspritzmenge Wunschwert" SWORD InjMassCyc 1 100 -327.6800 327.6700 FORMAT "%8.4" ECU_ADDRESS 0x7F8E8E /end MEASUREMENT
/begin MEASUREMENT InjCtl_qDesCor " fuel mass desired value with FMA correction" SWORD InjMassCyc 1 100 -327.6800 327.6700 FORMAT "%8.4" ECU_ADDRESS 0x7F8E90 /end MEASUREMENT
/begin MEASUREMENT InjCtl_qDriftComp_mp "Mengendriftkompensationswert" SWORD InjMassCyc 1 100 -327.6800 327.6700 FORMAT "%8.4" ECU_ADDRESS 0x8FF3A6 /end MEASUREMENT
/begin MEASUREMENT InjCtl_qDriftLim1_mp "Mengendriftkompensationwert nach Begrenzung durch EEPROM-Werte" SWORD InjMassCyc 1 100 -327.6800 327.6700 FORMAT "%8.4" ECU_ADDRESS 0x8FF3A8 /end MEASUREMENT
/begin MEASUREMENT InjCtl_qDriftLim2_mp "Mengendriftkompensationswert nach Begrenzung durch Datensatz" SWORD InjMassCyc 1 100 -327.6800 327.6700 FORMAT "%8.4" ECU_ADDRESS 0x8FF3AA /end MEASUREMENT
/begin MEASUREMENT InjCtl_qDriftMax1_mp "Mengendriftkompensationsbegrenzung (im EEPROM abgelegt)" SWORD InjMassCyc 1 100 -327.6800 327.6700 FORMAT "%8.4" ECU_ADDRESS 0x8FF3AC /end MEASUREMENT
/begin MEASUREMENT InjCtl_qDriftMin1_mp "Mengendriftkompensationsbegrenzung (im EEPROM abgelegt)" SWORD InjMassCyc 1 100 -327.6800 327.6700 FORMAT "%8.4" ECU_ADDRESS 0x8FF3AE /end MEASUREMENT
/begin MEASUREMENT InjCtl_qDriftUnlim_mp "Mengendriftkompensation unbegrenzt" SWORD InjMassCyc 1 100 -327.6800 327.6700 FORMAT "%8.4" ECU_ADDRESS 0x8FF3B0 /end MEASUREMENT
/begin MEASUREMENT InjCtl_qLim "Begrenzungsmenge" SWORD InjMassCyc 1 100 -327.6800 327.6700 FORMAT "%8.4" ECU_ADDRESS 0x7F8E92 /end MEASUREMENT
/begin MEASUREMENT InjCtl_qLimErr "Begrenzungsmenge im Falle eines Systemfehlers" SWORD InjMass 1 100 -327.6800 327.6700 FORMAT "%8.4" ECU_ADDRESS 0x7F8E94 /end MEASUREMENT
/begin MEASUREMENT InjCtl_qLimSoftShOff_mp "soft shutoff limit" SWORD InjMassCyc 1 100 -327.6800 327.6700 FORMAT "%8.4" ECU_ADDRESS 0x8FF3B8 /end MEASUREMENT
/begin MEASUREMENT InjCtl_qLimSwt "Ausgang RampSwitch-Block für Begrenzungsmenge im Systemfehlerfall" SWORD InjMassCyc 1 100 -327.6800 327.6700 FORMAT "%8.4" ECU_ADDRESS 0x7F8E96 /end MEASUREMENT
/begin MEASUREMENT InjCtl_qLim_mp "fuel mass limitation in normal case" SWORD InjMassCyc 1 100 -327.6800 327.6700 FORMAT "%8.4" ECU_ADDRESS 0x8FF3BA /end MEASUREMENT
/begin MEASUREMENT InjCtl_qRaw "Einspritzmenge Rohwert" SWORD InjMassCyc 1 100 -327.6800 327.6700 FORMAT "%8.4" ECU_ADDRESS 0x7F8E98 /end MEASUREMENT
/begin MEASUREMENT InjCtl_qRawCor " fuel mass raw value with FMA correction" SWORD InjMassCyc 1 100 -327.6800 327.6700 FORMAT "%8.4" ECU_ADDRESS 0x7F8E9A /end MEASUREMENT
/begin MEASUREMENT InjCtl_qSet "Einspritzmenge Sollwert" SWORD InjMassCyc 1 100 -327.6800 327.6700 FORMAT "%8.4" ECU_ADDRESS 0x7F8E9C /end MEASUREMENT
/begin MEASUREMENT InjCtl_qSetUnBal "Einspritzmenge Sollwert ohne Mengenausgleichsregelung" SWORD InjMassCyc 1 100 -327.6800 327.6700 FORMAT "%8.4" ECU_ADDRESS 0x7F8E9E /end MEASUREMENT
/begin MEASUREMENT InjCtl_qSetUnCor_mp "Menge vor Eingriff von Mengenabgleich, Serviceabgleich, Mengendriftkompensation" SWORD InjMassCyc 1 100 -327.6800 327.6700 FORMAT "%8.4" ECU_ADDRESS 0x8FF3B2 /end MEASUREMENT
/begin MEASUREMENT InjCtl_stAdjQnt_mp "Status vom Mengenabgleich" UBYTE OneToOne 1 100 0.00 255.0 FORMAT "%5.1" ECU_ADDRESS 0x8FF3B4 /end MEASUREMENT
/begin MEASUREMENT InjCtl_stNoInj "Status für keine Einspritzung (0 -> Einspritzung, 1 -> InjCtl_qSetUnBal == 0)" UBYTE OneToOne 1 100 0.00 255.0 FORMAT "%5.1" ECU_ADDRESS 0x7F88F5 /end MEASUREMENT
/begin MEASUREMENT InjCtl_stQLimErr "Status Begrenzungsmenge im Falle eines Systemfehlers (soll verwendet werden)" UBYTE OneToOne 1 100 0.00 255.0 FORMAT "%5.1" ECU_ADDRESS 0x7F88F6 /end MEASUREMENT
/begin MEASUREMENT InjCtl_tiEngOn_mp "Betriebsstundenzähler" SWORD TimeEngOnHrs 1 100 -596515.2 596497.0 FORMAT "%8.1" ECU_ADDRESS 0x8FF3B6 /end MEASUREMENT
/begin MEASUREMENT InjCtl_trqInrLim "Begrenzungsmoment (als inneres Moment) resultierend aus der Begrenzungsmenge InjCtl_qLim" SWORD Trq 1 100 -3276.800 3276.700 FORMAT "%8.3" ECU_ADDRESS 0x7F8EA0 /end MEASUREMENT
/begin MEASUREMENT InjUn_numCylMI1_mp "Zylinder aktuell benutzt für 1. Haupteinspritzung" UBYTE OneToOne 1 100 0.00 255.0 FORMAT "%5.1" ECU_ADDRESS 0x6F816B /end MEASUREMENT
/begin MEASUREMENT InjUn_numCylMI2_mp "Zylinder aktuell benutzt für 2. Haupteinspritzung" UBYTE OneToOne 1 100 0.00 255.0 FORMAT "%5.1" ECU_ADDRESS 0x6F816C /end MEASUREMENT
/begin MEASUREMENT InjUn_numCylPiI1_mp "Zylindernummer zugehörend zur  Voreinspritzung 1" UBYTE OneToOne 1 100 0.00 255.0 FORMAT "%5.1" ECU_ADDRESS 0x6F816D /end MEASUREMENT
/begin MEASUREMENT InjUn_numCylPiI2_mp "Zylindernummer zugehörend zur Voreinspritzung 2" UBYTE OneToOne 1 100 0.00 255.0 FORMAT "%5.1" ECU_ADDRESS 0x6F816E /end MEASUREMENT
/begin MEASUREMENT InjUn_numCylPoI1_mp "Zylindernummer zugehörend zur Nacheinspritzung 1" UBYTE OneToOne 1 100 0.00 255.0 FORMAT "%5.1" ECU_ADDRESS 0x6F816F /end MEASUREMENT
/begin MEASUREMENT InjUn_numCylPoI2_mp "Zylindernummer zugehörend zur Nacheinspritzung 2" UBYTE OneToOne 1 100 0.00 255.0 FORMAT "%5.1" ECU_ADDRESS 0x6F8170 /end MEASUREMENT
/begin MEASUREMENT InjUn_qMI1Cor_mp "Korrigierte Menge der Haupteinspritzung 1" SWORD InjMassInj 1 100 -327.6800 327.6700 FORMAT "%8.4" ECU_ADDRESS 0x8FF3BC /end MEASUREMENT
/begin MEASUREMENT InjUn_qPiI1Cor_mp "Korrigierte Menge der Voreinspritzung 1" SWORD InjMassInj 1 100 -327.6800 327.6700 FORMAT "%8.4" ECU_ADDRESS 0x8FF3C2 /end MEASUREMENT
/begin MEASUREMENT InjUn_qPiI2Cor_mp "Korrigierte Menge der Voreinspritzung 2" SWORD InjMassInj 1 100 -327.6800 327.6700 FORMAT "%8.4" ECU_ADDRESS 0x8FF3C8 /end MEASUREMENT
/begin MEASUREMENT InjUn_qPoI1Cor_mp "Korrigierte Menge der Nacheinspritzung 1" SWORD InjMassInj 1 100 -327.6800 327.6700 FORMAT "%8.4" ECU_ADDRESS 0x8FF3CE /end MEASUREMENT
/begin MEASUREMENT InjUn_qPoI2Cor_mp "Korrigierte Menge der Nacheinspritzung 2" SWORD InjMassInj 1 100 -327.6800 327.6700 FORMAT "%8.4" ECU_ADDRESS 0x8FF3D4 /end MEASUREMENT
/begin MEASUREMENT InjUn_stInjValve "Abschaltanforderungen für Injektor" UBYTE OneToOne 1 100 0.00 255.0 FORMAT "%5.1" ECU_ADDRESS 0x7F88F7 /end MEASUREMENT
/begin MEASUREMENT InjUn_stShutOffReq "Abschaltanforderungen aus dem Einspritzsystem" UBYTE OneToOne 1 100 0.00 255.0 FORMAT "%5.1" ECU_ADDRESS 0x7F88F8 /end MEASUREMENT
/begin MEASUREMENT InjUn_stTst "allgemeiner Status der Tests, die im Einspritzsystem durchgeführt werden" UWORD OneToOne 1 100 0.00 65535.00 FORMAT "%8.2" ECU_ADDRESS 0x7F8EA2 /end MEASUREMENT
/begin MEASUREMENT InjUn_volMI1CorCyc "zylinderspezifisches Korrekturvolumen aus Mengenausgleichsregelung und Injektor-Abgleichmenge für MI1" SWORD InjQntInj 1 100 -327.6800 327.6700 FORMAT "%8.4" ARRAY_SIZE 6 ECU_ADDRESS 0x7F9258 /end MEASUREMENT
/begin MEASUREMENT InjUn_volMI1Cor_mp "Korrigiertes Volumen der Haupteinspritzung 1" SWORD InjQntInj 1 100 -327.6800 327.6700 FORMAT "%8.4" ECU_ADDRESS 0x8FF3BE /end MEASUREMENT
/begin MEASUREMENT InjUn_volMI1_mp "Einspritzvolumen der Haupteinspritzung 1 nach Mengenabgleich" SWORD InjQntInj 1 100 -327.6800 327.6700 FORMAT "%8.4" ECU_ADDRESS 0x8FF3C0 /end MEASUREMENT
/begin MEASUREMENT InjUn_volPiI1CorCyc "zylinderspezifisches Korrekturvolumen aus Mengenausgleichsregelung und Injektor-Abgleichmenge für PiI1" SWORD InjQntInj 1 100 -327.6800 327.6700 FORMAT "%8.4" ARRAY_SIZE 6 ECU_ADDRESS 0x7F9264 /end MEASUREMENT
/begin MEASUREMENT InjUn_volPiI1Cor_mp "Korrigiertes Volumen der Voreinspritzung 1" SWORD InjQntInj 1 100 -327.6800 327.6700 FORMAT "%8.4" ECU_ADDRESS 0x8FF3C4 /end MEASUREMENT
/begin MEASUREMENT InjUn_volPiI1_mp "Einspritzvolumen der Voreinspritzung 1 nach Mengenabgleich" SWORD InjQntInj 1 100 -327.6800 327.6700 FORMAT "%8.4" ECU_ADDRESS 0x8FF3C6 /end MEASUREMENT
/begin MEASUREMENT InjUn_volPiI2CorCyc "zylinderspezifisches Korrekturvolumen aus Mengenausgleichsregelung und Injektor-Abgleichmenge für PiI2" SWORD InjQntInj 1 100 -327.6800 327.6700 FORMAT "%8.4" ARRAY_SIZE 6 ECU_ADDRESS 0x7F9270 /end MEASUREMENT
/begin MEASUREMENT InjUn_volPiI2Cor_mp "Korrigiertes Volumen der Voreinspritzung 2" SWORD InjQntInj 1 100 -327.6800 327.6700 FORMAT "%8.4" ECU_ADDRESS 0x8FF3CA /end MEASUREMENT
/begin MEASUREMENT InjUn_volPiI2_mp "Einspritzvolumen der Voreinspritzung 2 nach Mengenabgleich" SWORD InjQntInj 1 100 -327.6800 327.6700 FORMAT "%8.4" ECU_ADDRESS 0x8FF3CC /end MEASUREMENT
/begin MEASUREMENT InjUn_volPoI1Cor_mp "Korrigiertes Volumen der Nacheinspritzung 1" SWORD InjQntInj 1 100 -327.6800 327.6700 FORMAT "%8.4" ECU_ADDRESS 0x8FF3D0 /end MEASUREMENT
/begin MEASUREMENT InjUn_volPoI1_mp "Einspritzvolumen der Nacheinspritzung 1 nach Mengenabgleich" SWORD InjQntInj 1 100 -327.6800 327.6700 FORMAT "%8.4" ECU_ADDRESS 0x8FF3D2 /end MEASUREMENT
/begin MEASUREMENT InjUn_volPoI2Cor_mp "Korrigiertes Volumen der Nacheinspritzung 2" SWORD InjQntInj 1 100 -327.6800 327.6700 FORMAT "%8.4" ECU_ADDRESS 0x8FF3D6 /end MEASUREMENT
/begin MEASUREMENT InjUn_volPoI2_mp "Einspritzvolumen der Nacheinspritzung 2 nach Mengenabgleich" SWORD InjQntInj 1 100 -327.6800 327.6700 FORMAT "%8.4" ECU_ADDRESS 0x8FF3D8 /end MEASUREMENT
/begin MEASUREMENT InjVCD_ctMI1AgDiff_mp "Zähler für Winkelverletzungen bei Programmierung des Ansteuerbeginns der MI1" UWORD OneToOne 1 100 0.00 65535.00 FORMAT "%8.2" ECU_ADDRESS 0x8FF3E8 /end MEASUREMENT
/begin MEASUREMENT InjVCD_ctPiI1AgDiff_mp "Zähler für Winkelverletzungen bei Programmierung des Ansteuerbeginns der PiI1" UWORD OneToOne 1 100 0.00 65535.00 FORMAT "%8.2" ECU_ADDRESS 0x8FF3F0 /end MEASUREMENT
/begin MEASUREMENT InjVCD_ctPiI2AgDiff_mp "Zähler für Winkelverletzungen bei Programmierung des Ansteuerbeginns der PiI2" UWORD OneToOne 1 100 0.00 65535.00 FORMAT "%8.2" ECU_ADDRESS 0x8FF3EC /end MEASUREMENT
/begin MEASUREMENT InjVCD_phiMI1Diff_mp "Winkeldifferenz zwischen dem gewünschten Ansteuerbeginn und dem systembed. frühesten Ansteuerbeginn der MI1" SWORD AngleCrS 1 100 -768.0000 767.9766 FORMAT "%8.4" ECU_ADDRESS 0x8FF3EA /end MEASUREMENT
/begin MEASUREMENT InjVCD_phiPiI1Diff_mp "Winkeldifferenz zwischen dem gewünschten Ansteuerbeginn und dem systembed. frühesten Ansteuerbeginn der PiI1" SWORD AngleCrS 1 100 -768.0000 767.9766 FORMAT "%8.4" ECU_ADDRESS 0x8FF3F2 /end MEASUREMENT
/begin MEASUREMENT InjVCD_phiPiI2Diff_mp "Winkeldifferenz zwischen dem gewünschten Ansteuerbeginn und dem systembed. frühesten Ansteuerbeginn der PiI2" SWORD AngleCrS 1 100 -768.0000 767.9766 FORMAT "%8.4" ECU_ADDRESS 0x8FF3EE /end MEASUREMENT
/begin MEASUREMENT InjVCD_pInET_mp "X-Eingang des Kennfeldes InjVCD_tiET_MAP auf dem Appplikationswerkzeug" SWORD Pres_Rail 1 100 -3276.800 3276.700 FORMAT "%5.3" ECU_ADDRESS 0x8FF3DA /end MEASUREMENT
/begin MEASUREMENT InjVCD_qInZFCETGMap_mp "Menge fuer Eingangsanzeige der Gruppenkennfelder InjVCD_rZFCETMsk_GMAP, ...Dif0_GMAP, ...Dif1_GMAP" SWORD InjMassInj 1 100 -327.6800 327.6700 FORMAT "%8.4" ECU_ADDRESS 0x8FF3FC /end MEASUREMENT
/begin MEASUREMENT InjVCD_rZFCETCoeffDif_mp "Bewertungsfaktoren fuer Ansteuerdauerkorrektur durch Nullmengenkalibrierung" SWORD Prc 1 100 -400.0000 399.9878 FORMAT "%8.4" ARRAY_SIZE 3 ECU_ADDRESS 0x8FF3F4 /end MEASUREMENT
/begin MEASUREMENT InjVCD_rZFCETCoeffMsk_mp "Gesamtbewertungsfaktor der Ansteuerdauerkorrektur durch Nullmengenkalibrierung" SWORD Prc 1 100 -400.0000 399.9878 FORMAT "%8.4" ECU_ADDRESS 0x8FF3FA /end MEASUREMENT
/begin MEASUREMENT InjVCD_stInjMI1_mp "Status der Haupteinspritzung-1-Programmierung" UBYTE OneToOne 1 100 0.00 255.0 FORMAT "%5.1" ECU_ADDRESS 0x8FF3E0 /end MEASUREMENT
/begin MEASUREMENT InjVCD_stInjMI2_mp "Status der Haupteinspritzung-2-Programmierung" UBYTE OneToOne 1 100 0.00 255.0 FORMAT "%5.1" ECU_ADDRESS 0x8FF3E1 /end MEASUREMENT
/begin MEASUREMENT InjVCD_stInjPiI1_mp "Status der Voreinspritzung-1-Programmierung" UBYTE OneToOne 1 100 0.00 255.0 FORMAT "%5.1" ECU_ADDRESS 0x8FF3E2 /end MEASUREMENT
/begin MEASUREMENT InjVCD_stInjPiI2_mp "Status der Voreinspritzung-2-Programmierung" UBYTE OneToOne 1 100 0.00 255.0 FORMAT "%5.1" ECU_ADDRESS 0x8FF3E3 /end MEASUREMENT
/begin MEASUREMENT InjVCD_stInjPiI3_mp "Status der Voreinspritzung-3-Programmierung" UBYTE OneToOne 1 100 0.00 255.0 FORMAT "%5.1" ECU_ADDRESS 0x8FF3E4 /end MEASUREMENT
/begin MEASUREMENT InjVCD_stInjPoI1_mp "Status der Nacheinspritzung-1-Programmierung" UBYTE OneToOne 1 100 0.00 255.0 FORMAT "%5.1" ECU_ADDRESS 0x8FF3E5 /end MEASUREMENT
/begin MEASUREMENT InjVCD_stInjPoI2_mp "Status der Nacheinspritzung-2-Programmierung" UBYTE OneToOne 1 100 0.00 255.0 FORMAT "%5.1" ECU_ADDRESS 0x8FF3E6 /end MEASUREMENT
/begin MEASUREMENT InjVCD_stInjZFC_mp "Status der ZFC Programmierung" UBYTE OneToOne 1 100 0.00 255.0 FORMAT "%5.1" ECU_ADDRESS 0x8FF3E7 /end MEASUREMENT
/begin MEASUREMENT InjVCD_tiMI1ETUnLim_mp "energising time of Main Injection1" SWORD InjTime_us 1 100 -32768.00 32767.00 FORMAT "%8.2" ECU_ADDRESS 0x6F8172 /end MEASUREMENT
/begin MEASUREMENT InjVCD_tiMI1ET_mp "Ansteuerdauer der Haupteinspritzung 1" SWORD InjTime_us 1 100 -32768.00 32767.00 FORMAT "%8.2" ECU_ADDRESS 0x6F8174 /end MEASUREMENT
/begin MEASUREMENT InjVCD_tiPickUpCurr_mp "Anzugsstromdauer" SWORD InjTime_us 1 100 -32768.00 32767.00 FORMAT "%8.2" ECU_ADDRESS 0x8FF3DE /end MEASUREMENT
/begin MEASUREMENT InjVCD_tiPiI1ET_mp "Ansteuerdauer der Voreinspritzung 1" SWORD InjTime_us 1 100 -32768.00 32767.00 FORMAT "%8.2" ECU_ADDRESS 0x6F8176 /end MEASUREMENT
/begin MEASUREMENT InjVCD_tiPiI1ZFCETCor_mp "Ansteuerdauerkorrektur der ZFC für Voreinspritzung 1 und jeden Zylinder" SWORD InjTime_us 1 100 -32768.00 32767.00 FORMAT "%8.2" ARRAY_SIZE 6 ECU_ADDRESS 0x6F8182 /end MEASUREMENT
/begin MEASUREMENT InjVCD_tiPiI2ET_mp "Ansteuerdauer der Voreinspritzung 2" SWORD InjTime_us 1 100 -32768.00 32767.00 FORMAT "%8.2" ECU_ADDRESS 0x6F817A /end MEASUREMENT
/begin MEASUREMENT InjVCD_tiPiI2ZFCETCor_mp "Ansteuerdauerkorrektur der ZFC für Voreinspritzung 2 und jeden Zylinder" SWORD InjTime_us 1 100 -32768.00 32767.00 FORMAT "%8.2" ARRAY_SIZE 6 ECU_ADDRESS 0x6F818E /end MEASUREMENT
/begin MEASUREMENT InjVCD_tiPiI3ZFCETCor_mp "Ansteuerdauerkorrektur der ZFC für Voreinspritzung 3 und jeden Zylinder" SWORD InjTime_us 1 100 -32768.00 32767.00 FORMAT "%8.2" ARRAY_SIZE 6 ECU_ADDRESS 0x6F819A /end MEASUREMENT
/begin MEASUREMENT InjVCD_tiPoI1ET_mp "Ansteuerdauer Nacheinspritzung 1" SWORD InjTime_us 1 100 -32768.00 32767.00 FORMAT "%8.2" ECU_ADDRESS 0x6F817E /end MEASUREMENT
/begin MEASUREMENT InjVCD_tiPoI2ET_mp "Ansteuerdauer der Nacheinspritzung 2" SWORD InjTime_us 1 100 -32768.00 32767.00 FORMAT "%8.2" ECU_ADDRESS 0x6F8180 /end MEASUREMENT
/begin MEASUREMENT InjVCD_tiZFCPiI1ETCor_mp "ZFC Ansteuerdauerkorrektur fuer Voreinspritzung 1" SWORD InjTime_us 1 100 -32768.00 32767.00 FORMAT "%8.2" ECU_ADDRESS 0x6F8178 /end MEASUREMENT
/begin MEASUREMENT InjVCD_tiZFCPiI2ETCor_mp "ZFC Ansteuerdauerkorrektur fuer Voreinspritzung 2" SWORD InjTime_us 1 100 -32768.00 32767.00 FORMAT "%8.2" ECU_ADDRESS 0x6F817C /end MEASUREMENT
/begin MEASUREMENT InjVCD_volInET_mp "Y-Eingang des Kennfeldes InjVCD_tiET_MAP auf dem Applikationswerkzeug" SWORD InjQntInj 1 100 -327.6800 327.6700 FORMAT "%8.4" ECU_ADDRESS 0x8FF3DC /end MEASUREMENT
/begin MEASUREMENT InjVlv_facAddBalRls "Ergebniss aus Freigabekennfeld zur Aufrechnung der Mengenkorrektur als Array (zylinderspezifisch)" SWORD Fact 1 100 -4.000000 3.999878 FORMAT "%8.6" ARRAY_SIZE 6 ECU_ADDRESS 0x7F927C /end MEASUREMENT
/begin MEASUREMENT InjVlv_facFTSWvCor "Faktor der Druckwellenkorrektur abhängig von der Kraftstofftemperatur" SWORD Fact 1 100 -4.000000 3.999878 FORMAT "%8.6" ECU_ADDRESS 0x7F8EA4 /end MEASUREMENT
/begin MEASUREMENT InjVlv_facMI1PoI2WvCor_mp "Druckwellenkorrekturfaktor für PoI2" SWORD Fact1 1 100 -256.0000 255.9922 FORMAT "%8.4" ECU_ADDRESS 0x8FF44A /end MEASUREMENT
/begin MEASUREMENT InjVlv_facPiI2PiI1WvCor_mp "Druckwellenkorrekturfaktor der PiI1" SWORD Fact1 1 100 -256.0000 255.9922 FORMAT "%8.4" ECU_ADDRESS 0x8FF44C /end MEASUREMENT
/begin MEASUREMENT InjVlv_facPiIMI1WvCor_mp "Druckwellenkorrekturfaktor der MI1" SWORD Fact1 1 100 -256.0000 255.9922 FORMAT "%8.4" ECU_ADDRESS 0x8FF44E /end MEASUREMENT
/begin MEASUREMENT InjVlv_nCyl "Zylinderspezifische Drehzahl für alle Zylinder" SWORD EngN 1 100 -32768.00 32767.00 FORMAT "%8.2" ARRAY_SIZE 6 ECU_ADDRESS 0x7F9288 /end MEASUREMENT
/begin MEASUREMENT InjVlv_numIdxErrCyl1_mp "Indizes erkannter Muster für Zylinder 1" ULONG OneToOne 1 100 0.00 4294967295.00 FORMAT "%13.2" ECU_ADDRESS 0x8FF410 /end MEASUREMENT
/begin MEASUREMENT InjVlv_numIdxErrCyl2_mp "Indizes erkannter Muster für Zylinder 2" ULONG OneToOne 1 100 0.00 4294967295.00 FORMAT "%13.2" ECU_ADDRESS 0x8FF414 /end MEASUREMENT
/begin MEASUREMENT InjVlv_numIdxErrCyl3_mp "Indizes erkannter Muster für Zylinder 3" ULONG OneToOne 1 100 0.00 4294967295.00 FORMAT "%13.2" ECU_ADDRESS 0x8FF418 /end MEASUREMENT
/begin MEASUREMENT InjVlv_numIdxErrCyl4_mp "Indizes erkannter Muster für Zylinder 4" ULONG OneToOne 1 100 0.00 4294967295.00 FORMAT "%13.2" ECU_ADDRESS 0x8FF41C /end MEASUREMENT
/begin MEASUREMENT InjVlv_numIdxErrCyl5_mp "Indizes erkannter Muster für Zylinder 5" ULONG OneToOne 1 100 0.00 4294967295.00 FORMAT "%13.2" ECU_ADDRESS 0x8FF420 /end MEASUREMENT
/begin MEASUREMENT InjVlv_numIdxErrCyl6_mp "Indizes erkannter Muster für Zylinder 6" ULONG OneToOne 1 100 0.00 4294967295.00 FORMAT "%13.2" ECU_ADDRESS 0x8FF424 /end MEASUREMENT
/begin MEASUREMENT InjVlv_numInjChrgBal_mp "Maximale Anzahl an Einspritzungen aufgrund der Ladungsbilanz des Boosterkondensators" UBYTE OneToOne 1 100 0.00 255.0 FORMAT "%5.1" ECU_ADDRESS 0x8FF40C /end MEASUREMENT
/begin MEASUREMENT InjVlv_pActInDiffHyd_mp "Aktueller Raildruck als Eingangswert für das Kennfeld InjVlv_tiDiffHydMAP" SWORD Pres_Rail 1 100 -3276.800 3276.700 FORMAT "%5.3" ECU_ADDRESS 0x8FF43E /end MEASUREMENT
/begin MEASUREMENT InjVlv_qDesInDiffHyd_mp "Gewünschte Einspritzmenge als Eingangswert für das Kennfeld InjVlv_tiDiffHydMAP" SWORD InjMassInj 1 100 -327.6800 327.6700 FORMAT "%8.4" ECU_ADDRESS 0x8FF440 /end MEASUREMENT
/begin MEASUREMENT InjVlv_qFBCCyl "Zylinderselektive FBC-Mengenkorrektur für alle Zylinder" SWORD InjMass 1 100 -327.6800 327.6700 FORMAT "%8.4" ARRAY_SIZE 6 ECU_ADDRESS 0x7F9294 /end MEASUREMENT
/begin MEASUREMENT InjVlv_qMI1Bal_mp "Korrekturmenge Haupteinspritzung 1" SWORD InjMassInj 1 100 -327.6800 327.6700 FORMAT "%8.4" ECU_ADDRESS 0x8FF3FE /end MEASUREMENT
/begin MEASUREMENT InjVlv_qMI1PoI2WvCor_mp "Grundwert der Druckwellenkorrekturmenge der PoI2" SWORD InjMassInj 1 100 -327.6800 327.6700 FORMAT "%8.4" ECU_ADDRESS 0x8FF450 /end MEASUREMENT
/begin MEASUREMENT InjVlv_qMI1WvCor_mp "Druckwellenkorrekturmenge der MI1" SWORD InjMassInj 1 100 -327.6800 327.6700 FORMAT "%8.4" ECU_ADDRESS 0x8FF452 /end MEASUREMENT
/begin MEASUREMENT InjVlv_qPiI1Bal_mp "Korrekturmenge Voreinspritzung 1" SWORD InjMassInj 1 100 -327.6800 327.6700 FORMAT "%8.4" ECU_ADDRESS 0x8FF400 /end MEASUREMENT
/begin MEASUREMENT InjVlv_qPiI1MI1WvCor_mp "Grundwert der Druckwellenkorrekturmenge der MI1 abhängig von PiI1" SWORD InjMassInj 1 100 -327.6800 327.6700 FORMAT "%8.4" ECU_ADDRESS 0x8FF454 /end MEASUREMENT
/begin MEASUREMENT InjVlv_qPiI1WvCor_mp "Druckwellenkorrekturmenge der PiI1" SWORD InjMassInj 1 100 -327.6800 327.6700 FORMAT "%8.4" ECU_ADDRESS 0x8FF456 /end MEASUREMENT
/begin MEASUREMENT InjVlv_qPiI2Bal_mp "Korrekturmenge Voreinspritzung 2" SWORD InjMassInj 1 100 -327.6800 327.6700 FORMAT "%8.4" ECU_ADDRESS 0x8FF402 /end MEASUREMENT
/begin MEASUREMENT InjVlv_qPiI2MI1WvCor_mp "Grundwert der Druckwellenkorrekturmenge der MI1 abhängig von PiI2" SWORD InjMassInj 1 100 -327.6800 327.6700 FORMAT "%8.4" ECU_ADDRESS 0x8FF458 /end MEASUREMENT
/begin MEASUREMENT InjVlv_qPiI2PiI1WvCor_mp "Grundwert der Druckwellenkorrekturmenge der PiI1" SWORD InjMassInj 1 100 -327.6800 327.6700 FORMAT "%8.4" ECU_ADDRESS 0x8FF45A /end MEASUREMENT
/begin MEASUREMENT InjVlv_qPiI3Bal_mp "Korrekturmenge Voreinspritzung 3" SWORD InjMassInj 1 100 -327.6800 327.6700 FORMAT "%8.4" ECU_ADDRESS 0x8FF404 /end MEASUREMENT
/begin MEASUREMENT InjVlv_qPoI1Bal_mp "Korrekturmenge Nacheinspritzung 1" SWORD InjMassInj 1 100 -327.6800 327.6700 FORMAT "%8.4" ECU_ADDRESS 0x8FF406 /end MEASUREMENT
/begin MEASUREMENT InjVlv_qPoI2BalEff_mp "Korrekturmenge für Nacheinspritzung 2, Moment bildender Teil" SWORD InjMassInj 1 100 -327.6800 327.6700 FORMAT "%8.4" ECU_ADDRESS 0x8FF408 /end MEASUREMENT
/begin MEASUREMENT InjVlv_qPoI2Bal_mp "Korrekturmenge Nacheinspritzung 2" SWORD InjMassInj 1 100 -327.6800 327.6700 FORMAT "%8.4" ECU_ADDRESS 0x8FF40A /end MEASUREMENT
/begin MEASUREMENT InjVlv_qPoI2WvCor_mp "Druckwellenkorrekturmenge der PoI2" SWORD InjMassInj 1 100 -327.6800 327.6700 FORMAT "%8.4" ECU_ADDRESS 0x8FF45C /end MEASUREMENT
/begin MEASUREMENT InjVlv_qWvCorNorm "Einspritznormierungsmenge" SWORD InjMassInj 1 100 -327.6800 327.6700 FORMAT "%8.4" ECU_ADDRESS 0x7F8EA6 /end MEASUREMENT
/begin MEASUREMENT InjVlv_rMI1WvCorNorm_mp "Raildruckabhängiges normiertes MI1 Einspritzverhältnis für Druckwellenkorrektur" SWORD QntR 1 100 -32.00000 31.99902 FORMAT "%8.5" ECU_ADDRESS 0x8FF45E /end MEASUREMENT
/begin MEASUREMENT InjVlv_stChipVerCy33x_mp "Versionsnummer des Bausteins CY33x" UBYTE OneToOne 1 100 0.00 255.0 FORMAT "%5.1" ECU_ADDRESS 0x8FF428 /end MEASUREMENT
/begin MEASUREMENT InjVlv_stErrBnk1 "lowlevel Fehlermeldung für Bank1" UBYTE OneToOne 1 100 0.00 255.0 FORMAT "%5.1" ECU_ADDRESS 0x7F88F9 /end MEASUREMENT
/begin MEASUREMENT InjVlv_stErrBnk2 "lowlevel Fehlermeldung für  Bank2" UBYTE OneToOne 1 100 0.00 255.0 FORMAT "%5.1" ECU_ADDRESS 0x7F88FA /end MEASUREMENT
/begin MEASUREMENT InjVlv_stErrChip "lowlevel Fehlermeldung für CY33x" UBYTE OneToOne 1 100 0.00 255.0 FORMAT "%5.1" ECU_ADDRESS 0x7F88FB /end MEASUREMENT
/begin MEASUREMENT InjVlv_stErrChipPrep "lowlevel Fehlermeldung für CY33x vorverarbeitet" UBYTE OneToOne 1 100 0.00 255.0 FORMAT "%5.1" ECU_ADDRESS 0x7F88FC /end MEASUREMENT
/begin MEASUREMENT InjVlv_stErrClctCyl1 "gesammelte Fehlermeldungen für Zylinder 1" ULONG OneToOne 1 100 0.00 4294967295.00 FORMAT "%13.2" ECU_ADDRESS 0x7F916C /end MEASUREMENT
/begin MEASUREMENT InjVlv_stErrClctCyl2 "gesammelte Fehlermeldungen für Zylinder 2" ULONG OneToOne 1 100 0.00 4294967295.00 FORMAT "%13.2" ECU_ADDRESS 0x7F9170 /end MEASUREMENT
/begin MEASUREMENT InjVlv_stErrClctCyl3 "gesammelte Fehlermeldungen für Zylinder 3" ULONG OneToOne 1 100 0.00 4294967295.00 FORMAT "%13.2" ECU_ADDRESS 0x7F9174 /end MEASUREMENT
/begin MEASUREMENT InjVlv_stErrClctCyl4 "gesammelte Fehlermeldungen für Zylinder 4" ULONG OneToOne 1 100 0.00 4294967295.00 FORMAT "%13.2" ECU_ADDRESS 0x7F9178 /end MEASUREMENT
/begin MEASUREMENT InjVlv_stErrClctCyl5 "gesammelte Fehlermeldungen für Zylinder 5" ULONG OneToOne 1 100 0.00 4294967295.00 FORMAT "%13.2" ECU_ADDRESS 0x7F917C /end MEASUREMENT
/begin MEASUREMENT InjVlv_stErrClctCyl6 "gesammelte Fehlermeldungen für Zylinder 6" ULONG OneToOne 1 100 0.00 4294967295.00 FORMAT "%13.2" ECU_ADDRESS 0x7F9180 /end MEASUREMENT
/begin MEASUREMENT InjVlv_stErrCyl1_mp "lowlevel Fehlermeldung für Zylinder1" UBYTE OneToOne 1 100 0.00 255.0 FORMAT "%5.1" ECU_ADDRESS 0x8FF429 /end MEASUREMENT
/begin MEASUREMENT InjVlv_stErrCyl2_mp "lowlevel Fehlermeldung für Zylinder 2" UBYTE OneToOne 1 100 0.00 255.0 FORMAT "%5.1" ECU_ADDRESS 0x8FF42A /end MEASUREMENT
/begin MEASUREMENT InjVlv_stErrCyl3_mp "lowlevel Fehlermeldung für Zylinder 3" UBYTE OneToOne 1 100 0.00 255.0 FORMAT "%5.1" ECU_ADDRESS 0x8FF42B /end MEASUREMENT
/begin MEASUREMENT InjVlv_stErrCyl4_mp "lowlevel Fehlermeldung für Zylinder 4" UBYTE OneToOne 1 100 0.00 255.0 FORMAT "%5.1" ECU_ADDRESS 0x8FF42C /end MEASUREMENT
/begin MEASUREMENT InjVlv_stErrCyl5_mp "lowlevel Fehlermeldung für Zylinder 5" UBYTE OneToOne 1 100 0.00 255.0 FORMAT "%5.1" ECU_ADDRESS 0x8FF42D /end MEASUREMENT
/begin MEASUREMENT InjVlv_stErrCyl6_mp "lowlevel Fehlermeldung für Zylinder 6" UBYTE OneToOne 1 100 0.00 255.0 FORMAT "%5.1" ECU_ADDRESS 0x8FF42E /end MEASUREMENT
/begin MEASUREMENT InjVlv_stErrUnknown "Fehlermuster des letzten nicht klassifizierbaren Fehlers" ULONG OneToOne 1 100 0.00 4294967295.00 FORMAT "%13.2" ECU_ADDRESS 0x7F9184 /end MEASUREMENT
/begin MEASUREMENT InjVlv_stIniCy331_mp "Status der Initialisierung des CY331" UWORD OneToOne 1 100 0.00 65535.00 FORMAT "%8.2" ECU_ADDRESS 0x8FF430 /end MEASUREMENT
/begin MEASUREMENT InjVlv_stInjValve "Zustand des Einspritzventils" UBYTE OneToOne 1 100 0.00 255.0 FORMAT "%5.1" ECU_ADDRESS 0x7F88FD /end MEASUREMENT
/begin MEASUREMENT InjVlv_stWvCor "Status der Druckwellenkorrektur" UBYTE OneToOne 1 100 0.00 255.0 FORMAT "%5.1" ECU_ADDRESS 0x7F88FE /end MEASUREMENT
/begin MEASUREMENT InjVlv_tiMI1DiffHydCor_mp "Differenz zwischen hydraulischem Nadelschliessende und elektrischem Ansteuerende des Injektors für die MI1" SWORD InjTime_us 1 100 -32768.00 32767.00 FORMAT "%8.2" ECU_ADDRESS 0x8FF442 /end MEASUREMENT
/begin MEASUREMENT InjVlv_tiMI1PoI2Cor_mp "korrigierter Zeitabstand Ende MI1 bis Beginn PoI2" SWORD InjTime_us 1 100 -32768.00 32767.00 FORMAT "%8.2" ECU_ADDRESS 0x8FF460 /end MEASUREMENT
/begin MEASUREMENT InjVlv_tiMI1PoI2_mp "Zeitabstand ende MI1 bis Beginn PoI2" UWORD InjTime_us 1 100 0.00 65535.00 FORMAT "%8.2" ECU_ADDRESS 0x8FF462 /end MEASUREMENT
/begin MEASUREMENT InjVlv_tiPiI1DiffHydCor_mp "Differenz zwischen hydraulischem Nadelschliessende und elektrischem Ansteuerende des Injektors für die PiI1" SWORD InjTime_us 1 100 -32768.00 32767.00 FORMAT "%8.2" ECU_ADDRESS 0x8FF444 /end MEASUREMENT
/begin MEASUREMENT InjVlv_tiPiI1MI1Cor_mp "korrigierter Zeitabstand Ende PiI1 bis Beginn MI1" SWORD InjTime_us 1 100 -32768.00 32767.00 FORMAT "%8.2" ECU_ADDRESS 0x8FF464 /end MEASUREMENT
/begin MEASUREMENT InjVlv_tiPiI1MI1_mp "korrigierter Zeitabstand Ende PiI1 bis Beginn MI1" UWORD InjTime_us 1 100 0.00 65535.00 FORMAT "%8.2" ECU_ADDRESS 0x8FF466 /end MEASUREMENT
/begin MEASUREMENT InjVlv_tiPiI2DiffHydCor_mp "Differenz zwischen hydraulischem Nadelschliessende und elektrischem Ansteuerende des Injektors für die PiI2" SWORD InjTime_us 1 100 -32768.00 32767.00 FORMAT "%8.2" ECU_ADDRESS 0x8FF446 /end MEASUREMENT
/begin MEASUREMENT InjVlv_tiPiI2MI1Cor_mp "korrigierter Zeitabstand Ende PiI2 bis Beginn MI1" SWORD InjTime_us 1 100 -32768.00 32767.00 FORMAT "%8.2" ECU_ADDRESS 0x8FF468 /end MEASUREMENT
/begin MEASUREMENT InjVlv_tiPiI2MI1_mp "Zeitabstand Ende PiI2 bis Beginn MI1" UWORD InjTime_us 1 100 0.00 65535.00 FORMAT "%8.2" ECU_ADDRESS 0x8FF46A /end MEASUREMENT
/begin MEASUREMENT InjVlv_tiPiI2PiI1Cor_mp "korrigierter Zeitabstand Ende PiI2 bis Beginn PiI1" SWORD InjTime_us 1 100 -32768.00 32767.00 FORMAT "%8.2" ECU_ADDRESS 0x8FF46C /end MEASUREMENT
/begin MEASUREMENT InjVlv_tiPiI2PiI1_mp "Zeitabstand Ende PiI2 bis Beginn PiI1" UWORD InjTime_us 1 100 0.00 65535.00 FORMAT "%8.2" ECU_ADDRESS 0x8FF46E /end MEASUREMENT
/begin MEASUREMENT InjVlv_tWvCor_mp "Eingangstemperatur fuer die Druckwellenkorrektur" SWORD Temp_Cels 1 100 -50.140 899.860 FORMAT "%8.3" ECU_ADDRESS 0x8FF448 /end MEASUREMENT
/begin MEASUREMENT InjVlv_volMI1QntAdj_mp "Injektor-Abgleichmenge der Haupteinspritzung 1" SWORD InjQntInj 1 100 -327.6800 327.6700 FORMAT "%8.4" ECU_ADDRESS 0x8FF432 /end MEASUREMENT
/begin MEASUREMENT InjVlv_volPiI1QntAdj_mp "Injektor-Abgleichmenge der Voreinspritzung 1" SWORD InjQntInj 1 100 -327.6800 327.6700 FORMAT "%8.4" ECU_ADDRESS 0x8FF434 /end MEASUREMENT
/begin MEASUREMENT InjVlv_volPiI2QntAdj_mp "Injektor-Abgleichmenge der Voreinspritzung 2" SWORD InjQntInj 1 100 -327.6800 327.6700 FORMAT "%8.4" ECU_ADDRESS 0x8FF436 /end MEASUREMENT
/begin MEASUREMENT InjVlv_volPiI3QntAdj_mp "Injektor-Abgleichmenge der Voreinspritzung 3" SWORD InjQntInj 1 100 -327.6800 327.6700 FORMAT "%8.4" ECU_ADDRESS 0x8FF438 /end MEASUREMENT
/begin MEASUREMENT InjVlv_volPoI1QntAdj_mp "Injektor-Abgleichmenge der Nacheinspritzung 1" SWORD InjQntInj 1 100 -327.6800 327.6700 FORMAT "%8.4" ECU_ADDRESS 0x8FF43A /end MEASUREMENT
/begin MEASUREMENT InjVlv_volPoI2QntAdj_mp "Injektor-Abgleichmenge der Nacheinspritzung 2" SWORD InjQntInj 1 100 -327.6800 327.6700 FORMAT "%8.4" ECU_ADDRESS 0x8FF43C /end MEASUREMENT
/begin MEASUREMENT Layer_bos01_w "" SWORD km_sw_q10 1 100 -327680.0 327670.0 FORMAT "%8.1" ECU_ADDRESS 0x7F8F1E /end MEASUREMENT
/begin MEASUREMENT Layer_bosbtvfbk "" UBYTE rel_ub_q1 1 100 0.00 255.0 FORMAT "%5.1" ECU_ADDRESS 0x7F892D /end MEASUREMENT
/begin MEASUREMENT Layer_bosstate "" UBYTE DEZ 1 100 0.00 255.0 FORMAT "%5.1" ECU_ADDRESS 0x7F892E /end MEASUREMENT
/begin MEASUREMENT Layer_bosvalue_DIAG "" UBYTE OneToOne 1 100 0.00 255.0 FORMAT "%5.1" ARRAY_SIZE 6 ECU_ADDRESS 0x7F91FE /end MEASUREMENT
/begin MEASUREMENT Layer_FRC_INTM_T_BOS2 "" UBYTE DEZ 1 100 0.00 255.0 FORMAT "%5.1" ECU_ADDRESS 0x7F8928 /end MEASUREMENT
/begin MEASUREMENT Layer_FRC_INTM_WAY_BOS2 "" UBYTE DEZ 1 100 0.00 255.0 FORMAT "%5.1" ECU_ADDRESS 0x7F8929 /end MEASUREMENT
/begin MEASUREMENT Layer_ID2_BOS2 "" UBYTE DEZ 1 100 0.00 255.0 FORMAT "%5.1" ECU_ADDRESS 0x7F892A /end MEASUREMENT
/begin MEASUREMENT Layer_idbosmsg "" UBYTE DEZ 1 100 0.00 255.0 FORMAT "%5.1" ECU_ADDRESS 0x7F892F /end MEASUREMENT
/begin MEASUREMENT Layer_idfbosmg_w "" UWORD DEZ 1 100 0.00 65535.00 FORMAT "%8.2" ECU_ADDRESS 0x7F8F20 /end MEASUREMENT
/begin MEASUREMENT Layer_ID_FN_BOS2 "" SWORD DEZ 1 100 -32768.00 32767.00 FORMAT "%8.2" ECU_ADDRESS 0x7F8F1C /end MEASUREMENT
/begin MEASUREMENT Layer_stExtWaitRdy "" UBYTE DEZ 1 100 0.00 255.0 FORMAT "%5.1" ECU_ADDRESS 0x7F8930 /end MEASUREMENT
/begin MEASUREMENT Layer_stLayer "" UWORD OneToOne 1 100 0.00 65535.00 FORMAT "%8.2" ECU_ADDRESS 0x7F8F22 /end MEASUREMENT
/begin MEASUREMENT Layer_stOelTog "" UBYTE DEZ 1 100 0.00 255.0 FORMAT "%5.1" ECU_ADDRESS 0x7F8931 /end MEASUREMENT
/begin MEASUREMENT Layer_stOelVerb "" UBYTE DEZ 1 100 0.00 255.0 FORMAT "%5.1" ECU_ADDRESS 0x7F8932 /end MEASUREMENT
/begin MEASUREMENT Layer_stOelVerl "" UBYTE DEZ 1 100 0.00 255.0 FORMAT "%5.1" ECU_ADDRESS 0x7F8933 /end MEASUREMENT
/begin MEASUREMENT Layer_TARD_MON_BOS2 "" UBYTE DEZ 1 100 0.00 255.0 FORMAT "%5.1" ECU_ADDRESS 0x7F892B /end MEASUREMENT
/begin MEASUREMENT Layer_TARD_YR_BOS2 "" UBYTE DEZ 1 100 0.00 255.0 FORMAT "%5.1" ECU_ADDRESS 0x7F892C /end MEASUREMENT
/begin MEASUREMENT Layer_volOil "" UBYTE DEZ 1 100 0.00 255.0 FORMAT "%5.1" ECU_ADDRESS 0x7F8935 /end MEASUREMENT
/begin MEASUREMENT Layer_volOilRefill "" UBYTE DEZ 1 100 0.00 255.0 FORMAT "%5.1" ECU_ADDRESS 0x7F8936 /end MEASUREMENT
/begin MEASUREMENT Layer_zrbosmld "" UBYTE DEZ 1 100 0.00 255.0 FORMAT "%5.1" ECU_ADDRESS 0x7F8937 /end MEASUREMENT
/begin MEASUREMENT LIGov_st "Zustand des Leerlaufreglers" UWORD OneToOne 1 100 0.00 65535.00 FORMAT "%8.2" ECU_ADDRESS 0x7F8EB2 /end MEASUREMENT
/begin MEASUREMENT LIGov_stSetTrqActive "Status zum Moment anforderung über Diagnose für NMK Schnellernen" UBYTE OneToOne 1 100 0.00 255.0 FORMAT "%5.1" ECU_ADDRESS 0x7F8900 /end MEASUREMENT
/begin MEASUREMENT LIGov_trq "Leerlaufreglermoment" SWORD Trq 1 100 -3276.800 3276.700 FORMAT "%8.3" ECU_ADDRESS 0x7F8EB6 /end MEASUREMENT
/begin MEASUREMENT LIGov_trqCurrPredef "aktuell verwendetes Einsschrittmoment" SWORD Trq 1 100 -3276.800 3276.700 FORMAT "%8.3" ECU_ADDRESS 0x7F8EB8 /end MEASUREMENT
/begin MEASUREMENT LIGov_trqFlt "Leerlaufreglermoment PT1 gefiltert" SWORD Trq 1 100 -3276.800 3276.700 FORMAT "%8.3" ECU_ADDRESS 0x7F8EBA /end MEASUREMENT
/begin MEASUREMENT LIGov_trqI "Wert des I-Anteils des LLR" SWORD Trq 1 100 -3276.800 3276.700 FORMAT "%8.3" ECU_ADDRESS 0x7F8EBC /end MEASUREMENT
/begin MEASUREMENT LIGov_trqP "Wert des P-Anteils des LLR" SWORD Trq 1 100 -3276.800 3276.700 FORMAT "%8.3" ECU_ADDRESS 0x7F8EC0 /end MEASUREMENT
/begin MEASUREMENT LIGov_trqSetDIAG "Moment anforderung über Diagnose für NMK Schnellernen" SWORD Trq 1 100 -3276.800 3276.700 FORMAT "%8.3" ECU_ADDRESS 0x7F8EC2 /end MEASUREMENT
/begin MEASUREMENT PwrMng_absch_korr "correction value shut off" UWORD OneToOne 1 100 0.00 65535.00 FORMAT "%8.2" ECU_ADDRESS 0x7F8FE2 /end MEASUREMENT
/begin MEASUREMENT PwrMng_dmAirPerTimeI_mp "integrated air mass" SWORD AirMassPerTime 1 100 -3276.800 3276.700 FORMAT "%8.3" ECU_ADDRESS 0x8FF4B6 /end MEASUREMENT
/begin MEASUREMENT PwrMng_d_soc "battery load state" UWORD OneToOne 1 100 0.00 65535.00 FORMAT "%8.2" ECU_ADDRESS 0x7F8FE4 /end MEASUREMENT
/begin MEASUREMENT PwrMng_iEngine "engine current" SWORD igen_ub_q1 1 100 -32768.00 32767.00 FORMAT "%8.2" ECU_ADDRESS 0x7F8FE6 /end MEASUREMENT
/begin MEASUREMENT PwrMng_iGen "Alternator current" UBYTE igen_ub_q1 1 100 0.00 255.0 FORMAT "%5.1" ECU_ADDRESS 0x7F8973 /end MEASUREMENT
/begin MEASUREMENT PwrMng_Nkw_mp "" UWORD nmot_uw_q0p25 1 100 0.00 16383.75 FORMAT "%8.2" ECU_ADDRESS 0x8FF4B8 /end MEASUREMENT
/begin MEASUREMENT PwrMng_nMin "low idle demand from PwrMng" SWORD EngN 1 100 -32768.00 32767.00 FORMAT "%8.2" ECU_ADDRESS 0x7F8FE8 /end MEASUREMENT
/begin MEASUREMENT PwrMng_nnnstart "start rpm engine" SWORD OneToOne 1 100 -32768.00 32767.00 FORMAT "%8.2" ECU_ADDRESS 0x7F8FEA /end MEASUREMENT
/begin MEASUREMENT PwrMng_pwrDes "alternator power" SWORD Pwr 1 100 -308831.1 308821.7 FORMAT "%8.1" ECU_ADDRESS 0x7F8FEC /end MEASUREMENT
/begin MEASUREMENT PwrMng_pwrPTC "dummy power management message" SWORD DtyCyc 1 100 -327.6800 327.6700 FORMAT "%8.4" ECU_ADDRESS 0x7F8FEE /end MEASUREMENT
/begin MEASUREMENT PwrMng_rCtrPwrSpCos "controlling power extra-consumers" UBYTE fak_q0p5 1 100 0.00 127.5 FORMAT "%5.1" ECU_ADDRESS 0x7F8974 /end MEASUREMENT
/begin MEASUREMENT PwrMng_rdffgen "DF-signal in GS-resolution for CAN" UBYTE PCENT 1 100 0.00 99.61 FORMAT "%5.2" ECU_ADDRESS 0x7F8975 /end MEASUREMENT
/begin MEASUREMENT PwrMng_stB_ccbtnach "Powermanagement value" UBYTE OneToOne 1 100 0.00 255.0 FORMAT "%5.1" ECU_ADDRESS 0x7F8976 /end MEASUREMENT
/begin MEASUREMENT PwrMng_stB_ccbttdfk "Powermanagement value" UBYTE OneToOne 1 100 0.00 255.0 FORMAT "%5.1" ECU_ADDRESS 0x7F8977 /end MEASUREMENT
/begin MEASUREMENT PwrMng_stB_ccbttknt "Powermanagement value" UBYTE OneToOne 1 100 0.00 255.0 FORMAT "%5.1" ECU_ADDRESS 0x7F8978 /end MEASUREMENT
/begin MEASUREMENT PwrMng_stB_ccpmerr "Powermanagement value" UBYTE OneToOne 1 100 0.00 255.0 FORMAT "%5.1" ECU_ADDRESS 0x7F8979 /end MEASUREMENT
/begin MEASUREMENT PwrMng_stB_ccprio "Powermanagement value" UBYTE OneToOne 1 100 0.00 255.0 FORMAT "%5.1" ECU_ADDRESS 0x7F897A /end MEASUREMENT
/begin MEASUREMENT PwrMng_stB_ccruhver "Powermanagement value" UBYTE OneToOne 1 100 0.00 255.0 FORMAT "%5.1" ECU_ADDRESS 0x7F897B /end MEASUREMENT
/begin MEASUREMENT PwrMng_stB_codierpm "Powermanagement value" UBYTE OneToOne 1 100 0.00 255.0 FORMAT "%5.1" ECU_ADDRESS 0x7F897C /end MEASUREMENT
/begin MEASUREMENT PwrMng_stCtrCbr "controlling current branch" UBYTE DEZ 1 100 0.00 255.0 FORMAT "%5.1" ECU_ADDRESS 0x7F897D /end MEASUREMENT
/begin MEASUREMENT PwrMng_stCtrPCos "controlling stand-consumers" UBYTE DEZ 1 100 0.00 255.0 FORMAT "%5.1" ECU_ADDRESS 0x7F897E /end MEASUREMENT
/begin MEASUREMENT PwrMng_stCtrPrio "controlling priority peak decreasing" UBYTE DEZ 1 100 0.00 255.0 FORMAT "%5.1" ECU_ADDRESS 0x7F897F /end MEASUREMENT
/begin MEASUREMENT PwrMng_stCtrPrioCf "controlling priority peak decreasing" UBYTE DEZ 1 100 0.00 255.0 FORMAT "%5.1" ECU_ADDRESS 0x7F8980 /end MEASUREMENT
/begin MEASUREMENT PwrMng_stCtrPwrCos "controlling power consumers bit-coded" UWORD DEZ 1 100 0.00 65535.00 FORMAT "%8.2" ECU_ADDRESS 0x7F8FF0 /end MEASUREMENT
/begin MEASUREMENT PwrMng_stGen "State alternator" UBYTE OneToOne 1 100 0.00 255.0 FORMAT "%5.1" ECU_ADDRESS 0x7F8981 /end MEASUREMENT
/begin MEASUREMENT PwrMng_stLdstGen "alternator load state" UBYTE OneToOne 1 100 0.00 255.0 FORMAT "%5.1" ECU_ADDRESS 0x7F8983 /end MEASUREMENT
/begin MEASUREMENT PwrMng_stLIGov "State of low idle governor" UWORD OneToOne 1 100 0.00 65535.00 FORMAT "%8.2" ECU_ADDRESS 0x7F8982 /end MEASUREMENT
/begin MEASUREMENT PwrMng_stPCos "state stand-consumers" UBYTE DEZ 1 100 0.00 255.0 FORMAT "%5.1" ECU_ADDRESS 0x7F8984 /end MEASUREMENT
/begin MEASUREMENT PwrMng_stRqPCos "Demand stand-consumers" UBYTE DEZ 1 100 0.00 255.0 FORMAT "%5.1" ECU_ADDRESS 0x7F8985 /end MEASUREMENT
/begin MEASUREMENT PwrMng_stSelSpCos "status extra-consumers detection" UBYTE DEZ 1 100 0.00 255.0 FORMAT "%5.1" ECU_ADDRESS 0x7F8986 /end MEASUREMENT
/begin MEASUREMENT PwrMng_stTerminal61 "Status Klemme 61" UBYTE OneToOne 1 100 0.00 255.0 FORMAT "%5.1" ECU_ADDRESS 0x7F8987 /end MEASUREMENT
/begin MEASUREMENT PwrMng_stULev "voltage level" UBYTE DEZ 1 100 0.00 255.0 FORMAT "%5.1" ECU_ADDRESS 0x7F8988 /end MEASUREMENT
/begin MEASUREMENT PwrMng_tiLRGen "Load-Response Zeit" UWORD Time_s 1 100 0.00 655.3500 FORMAT "%8.4" ECU_ADDRESS 0x7F8FF2 /end MEASUREMENT
/begin MEASUREMENT PwrMng_trqmd_gennm_mp "Alternator torque" SWORD Trq 1 100 -3276.800 3276.700 FORMAT "%8.3" ECU_ADDRESS 0x8FF4BA /end MEASUREMENT
/begin MEASUREMENT PwrMng_tumgcan_mp "temperature from CAN" SWORD temp_q1 1 100 -32768.00 32767.00 FORMAT "%8.2" ECU_ADDRESS 0x8FF4BC /end MEASUREMENT
/begin MEASUREMENT PwrMng_ubt "Battery voltage" UWORD spg_uw_q0p015 1 100 0.00 983.02500 ECU_ADDRESS 0x7F8FF8 /end MEASUREMENT
/begin MEASUREMENT PwrMng_uGen "Sollwert Generatorspannung" UWORD Volt_Batt 1 100 0.00 1281232. FORMAT "%8.0" ECU_ADDRESS 0x7F8FF4 /end MEASUREMENT
/begin MEASUREMENT PwrMng_uGen2 "" UWORD Volt_Batt 1 100 0.00 1281232. FORMAT "%8.0" ECU_ADDRESS 0x7F8FF6 /end MEASUREMENT
/begin MEASUREMENT PwrMng_V_mp "" UWORD vfzg_ub_q1p25 1 100 0.00 81918.75 FORMAT "%8.2" ECU_ADDRESS 0x8FF4BE /end MEASUREMENT
/begin MEASUREMENT RF_BSD "" UBYTE OneToOne 1 100 0.00 255.0 FORMAT "%5.1" ECU_ADDRESS 0x8FF48C /end MEASUREMENT
/begin MEASUREMENT RF_GEN "" UBYTE OneToOne 1 100 0.00 255.0 FORMAT "%5.1" ECU_ADDRESS 0x8FF48D /end MEASUREMENT
/begin MEASUREMENT RF_IBS1 "" UBYTE OneToOne 1 100 0.00 255.0 FORMAT "%5.1" ECU_ADDRESS 0x8FF48E /end MEASUREMENT
/begin MEASUREMENT RF_IBS2 "" UBYTE OneToOne 1 100 0.00 255.0 FORMAT "%5.1" ECU_ADDRESS 0x8FF48F /end MEASUREMENT
/begin MEASUREMENT RF_IBS3 "" UBYTE OneToOne 1 100 0.00 255.0 FORMAT "%5.1" ECU_ADDRESS 0x8FF490 /end MEASUREMENT
/begin MEASUREMENT RF_MANHYDR "" UBYTE OneToOne 1 100 0.00 255.0 FORMAT "%5.1" ECU_ADDRESS 0x8FF491 /end MEASUREMENT
/begin MEASUREMENT RF_MANLUFT "" UBYTE OneToOne 1 100 0.00 255.0 FORMAT "%5.1" ECU_ADDRESS 0x8FF492 /end MEASUREMENT
/begin MEASUREMENT RF_PMBATT "" UBYTE OneToOne 1 100 0.00 255.0 FORMAT "%5.1" ECU_ADDRESS 0x8FF493 /end MEASUREMENT
/begin MEASUREMENT RF_PMBN "" UBYTE OneToOne 1 100 0.00 255.0 FORMAT "%5.1" ECU_ADDRESS 0x8FF494 /end MEASUREMENT
/begin MEASUREMENT RF_PMRUHVERL "" UBYTE OneToOne 1 100 0.00 255.0 FORMAT "%5.1" ECU_ADDRESS 0x8FF495 /end MEASUREMENT
/begin MEASUREMENT RF_QLT "" UBYTE OneToOne 1 100 0.00 255.0 FORMAT "%5.1" ECU_ADDRESS 0x8FF496 /end MEASUREMENT
/begin MEASUREMENT RF_TANS "" UBYTE OneToOne 1 100 0.00 255.0 FORMAT "%5.1" ECU_ADDRESS 0x8FF497 /end MEASUREMENT
/begin MEASUREMENT RF_TOENS "" UBYTE OneToOne 1 100 0.00 255.0 FORMAT "%5.1" ECU_ADDRESS 0x8FF498 /end MEASUREMENT
/begin MEASUREMENT RF_TUMG "" UBYTE OneToOne 1 100 0.00 255.0 FORMAT "%5.1" ECU_ADDRESS 0x8FF499 /end MEASUREMENT
/begin MEASUREMENT ZF_BSD "" UBYTE OneToOne 1 100 0.00 255.0 FORMAT "%5.1" ECU_ADDRESS 0x8FF49A /end MEASUREMENT
/begin MEASUREMENT ZF_GEN "" UBYTE OneToOne 1 100 0.00 255.0 FORMAT "%5.1" ECU_ADDRESS 0x8FF49B /end MEASUREMENT
/begin MEASUREMENT ZF_IBS1 "" UBYTE OneToOne 1 100 0.00 255.0 FORMAT "%5.1" ECU_ADDRESS 0x8FF49C /end MEASUREMENT
/begin MEASUREMENT ZF_IBS2 "" UBYTE OneToOne 1 100 0.00 255.0 FORMAT "%5.1" ECU_ADDRESS 0x8FF49D /end MEASUREMENT
/begin MEASUREMENT ZF_IBS3 "" UBYTE OneToOne 1 100 0.00 255.0 FORMAT "%5.1" ECU_ADDRESS 0x8FF49E /end MEASUREMENT
/begin MEASUREMENT ZF_MANHYDR "" UBYTE OneToOne 1 100 0.00 255.0 FORMAT "%5.1" ECU_ADDRESS 0x8FF49F /end MEASUREMENT
/begin MEASUREMENT ZF_MANLUFT "" UBYTE OneToOne 1 100 0.00 255.0 FORMAT "%5.1" ECU_ADDRESS 0x8FF4A0 /end MEASUREMENT
/begin MEASUREMENT ZF_PMBATT "" UBYTE OneToOne 1 100 0.00 255.0 FORMAT "%5.1" ECU_ADDRESS 0x8FF4A1 /end MEASUREMENT
/begin MEASUREMENT ZF_PMBN "" UBYTE OneToOne 1 100 0.00 255.0 FORMAT "%5.1" ECU_ADDRESS 0x8FF4A2 /end MEASUREMENT
/begin MEASUREMENT ZF_PMRUHVERL "" UBYTE OneToOne 1 100 0.00 255.0 FORMAT "%5.1" ECU_ADDRESS 0x8FF4A3 /end MEASUREMENT
/begin MEASUREMENT ZF_QLT "" UBYTE OneToOne 1 100 0.00 255.0 FORMAT "%5.1" ECU_ADDRESS 0x8FF4A4 /end MEASUREMENT
/begin MEASUREMENT ZF_TANS "" UBYTE OneToOne 1 100 0.00 255.0 FORMAT "%5.1" ECU_ADDRESS 0x8FF4A5 /end MEASUREMENT
/begin MEASUREMENT ZF_TOENS "" UBYTE OneToOne 1 100 0.00 255.0 FORMAT "%5.1" ECU_ADDRESS 0x8FF4A6 /end MEASUREMENT
/begin MEASUREMENT ZF_TUMG "" UBYTE OneToOne 1 100 0.00 255.0 FORMAT "%5.1" ECU_ADDRESS 0x8FF4A7 /end MEASUREMENT
/begin FUNCTION injcrv_poi2rgnlib "Library function  of exhaust gas regeneration for Post Injection 2"
 /begin DEF_CHARACTERISTIC InjCrv_dtiPoI2RgnEffRmpUp_C InjCrv_dtiPoI2RgnEffRmpDwn_C InjCrv_dtiPoI2RgnRmpUp_C InjCrv_dtiPoI2RgnRmpDwn_C InjCrv_dtiPoI2RgnTypeRmpUp_C InjCrv_dtiPoI2RgnTypeRmpDwn_C InjCrv_stPoI2RgnEffMsk_C InjCrv_stPoI2RgnMsk_C InjCrv_stPoI2RgnTypeMsk_C /end DEF_CHARACTERISTIC
/end FUNCTION
/begin FUNCTION injcrv_poi2rgn_msg ""
 /begin OUT_MEASUREMENT InjCrv_facPoI2EffRgn InjCrv_phiPoI2Rgn InjCrv_PoI2RgnTypeVal InjCrv_qPoI2Rgn InjCrv_tiPoI2Rgn /end OUT_MEASUREMENT
/end FUNCTION
/begin FUNCTION injcrv_poi2rgn_uic ""
 /begin DEF_CHARACTERISTIC InjCrv_facPoI2EffRgnAdd_Vector InjCrv_facPoI2EffRgnAdd_Channel InjCrv_facPoI2EffRgn_Vector InjCrv_facPoI2EffRgn_Channel InjCrv_phiPoI2RgnAdd_Vector InjCrv_phiPoI2RgnAdd_Channel InjCrv_phiPoI2Rgn_Vector InjCrv_phiPoI2Rgn_Channel InjCrv_qPoI2RgnAdd_Vector InjCrv_qPoI2RgnAdd_Channel InjCrv_qPoI2Rgn_Vector InjCrv_qPoI2Rgn_Channel InjCrv_tiPoI2RgnAdd_Vector InjCrv_tiPoI2RgnAdd_Channel InjCrv_tiPoI2Rgn_Vector InjCrv_tiPoI2Rgn_Channel /end DEF_CHARACTERISTIC
 /begin OUT_MEASUREMENT InjCrv_facPoI2EffRgn1_mp InjCrv_facPoI2EffRgn2_mp InjCrv_facPoI2EffRgnByp_mp InjCrv_phiPoI2Rgn1_mp InjCrv_phiPoI2Rgn2_mp InjCrv_phiPoI2RgnByp_mp InjCrv_qPoI2Rgn1_mp InjCrv_qPoI2Rgn2_mp InjCrv_qPoI2RgnByp_mp InjCrv_tiPoI2Rgn1_mp InjCrv_tiPoI2Rgn2_mp InjCrv_tiPoI2RgnByp_mp /end OUT_MEASUREMENT
/end FUNCTION
/begin FUNCTION injcrv_poi2rls ""
 /begin DEF_CHARACTERISTIC InjCrv_POpPoI2Bas_MAP InjCrv_POpPoI2High_C InjCrv_POpPoI2Low_C /end DEF_CHARACTERISTIC
 /begin IN_MEASUREMENT Eng_nAvrg InjCtl_qSetUnBal /end IN_MEASUREMENT
/end FUNCTION
/begin FUNCTION injcrv_poi2rls_uic "" /begin OUT_MEASUREMENT InjCrv_POpPoI2Bas_mp InjCrv_POpPoI2_mp /end OUT_MEASUREMENT /end FUNCTION
/begin FUNCTION injcrv_poi2soe "Nacheinspritzung 2, Ansteuerdauerberechnung"
 /begin DEF_CHARACTERISTIC InjCrv_phiPoI2Min_C InjCrv_tiPoI2Max_MAP InjCrv_tiPoI2Min_C /end DEF_CHARACTERISTIC
 /begin IN_MEASUREMENT InjCrv_qMI1Des RailCD_pPeak /end IN_MEASUREMENT
/end FUNCTION
/begin FUNCTION injcrv_poi2soephibas "" /begin DEF_CHARACTERISTIC InjCrv_phiPoI2Bas_MAP /end DEF_CHARACTERISTIC /begin IN_MEASUREMENT Eng_nAvrg InjCtl_qSetUnBal /end IN_MEASUREMENT /end FUNCTION
/begin FUNCTION injcrv_poi2soephibas_uic "" /begin OUT_MEASUREMENT InjCrv_phiPoI2Bas_mp /end OUT_MEASUREMENT /end FUNCTION
/begin FUNCTION injcrv_poi2soermtctl_uic "" /end FUNCTION
/begin FUNCTION injcrv_poi2soetibas "" /begin DEF_CHARACTERISTIC InjCrv_tiPoI2Bas_MAP /end DEF_CHARACTERISTIC /begin IN_MEASUREMENT Eng_nAvrg InjCtl_qSetUnBal /end IN_MEASUREMENT /end FUNCTION
/begin FUNCTION injcrv_poi2soetibas_uic "" /begin OUT_MEASUREMENT InjCrv_tiPoI2Bas_mp /end OUT_MEASUREMENT /end FUNCTION
/begin FUNCTION injcrv_poi2soe_msg "" /begin OUT_MEASUREMENT InjCrv_phiPoI2Des InjCrv_tiPoI2Des /end OUT_MEASUREMENT /end FUNCTION
/begin FUNCTION injcrv_poi2soe_uic ""
 /begin DEF_CHARACTERISTIC InjCrv_phiPoI2Add_Vector InjCrv_phiPoI2Add_Channel InjCrv_phiPoI2_Vector InjCrv_phiPoI2_Channel InjCrv_qPoI2DesAdd_Vector InjCrv_qPoI2DesAdd_Channel InjCrv_qPoI2EffAdd_Vector InjCrv_qPoI2EffAdd_Channel InjCrv_qPoI2Eff_Vector InjCrv_qPoI2Eff_Channel InjCrv_qPoI2Des_Vector InjCrv_qPoI2Des_Channel InjCrv_tiPoI2Add_Vector InjCrv_tiPoI2Add_Channel InjCrv_tiPoI2_Vector InjCrv_tiPoI2_Channel /end DEF_CHARACTERISTIC
 /begin OUT_MEASUREMENT InjCrv_phiPoI2AbsTot_mp InjCrv_phiPoI2Abs_mp InjCrv_phiPoI2Byp_mp InjCrv_phiPoI2Cor_mp InjCrv_phiPoI2Rel_mp InjCrv_qPoI2DesByp_mp InjCrv_qPoI2EffByp_mp InjCrv_swtPoI2AgAbsTDC_mp InjCrv_tiPoI2Byp_mp InjCrv_tiPoI2Cor_mp InjCrv_tiPoI2Max_mp InjCrv_tiPoI2RelTot_mp InjCrv_tiPoI2Rel_mp /end OUT_MEASUREMENT
/end FUNCTION
/begin FUNCTION injcrv_qntminlib "Berechnung minimale Einspritzmenge" /begin DEF_CHARACTERISTIC InjCrv_qMin_CUR /end DEF_CHARACTERISTIC /begin IN_MEASUREMENT RailCD_pPeak /end IN_MEASUREMENT /end FUNCTION
/begin FUNCTION injcrv_qntminlib_uic "" /begin OUT_MEASUREMENT InjCrv_qPiI1MinWv_mp /end OUT_MEASUREMENT /end FUNCTION
/begin FUNCTION injcrv_rmtctl_uic "" /end FUNCTION
/begin FUNCTION injcrv_settipse "Minimumzeitberechnung  zwischen 2 Einspritzungen"
 /begin DEF_CHARACTERISTIC InjCrv_swtTiPseVal_C InjCrv_swtTiPseType_C InjCrv_tiFltFstDcyDecPT1_C InjCrv_tiFltFstDcyIncPT1_C InjCrv_tiSafDst_C /end DEF_CHARACTERISTIC
/end FUNCTION
/begin FUNCTION injcrv_settipse_msg "" /begin OUT_MEASUREMENT InjCrv_tiPse /end OUT_MEASUREMENT /end FUNCTION
/begin FUNCTION injcrv_settipse_uic "" /begin OUT_MEASUREMENT InjCrv_tiFstDcy_mp /end OUT_MEASUREMENT /end FUNCTION
/begin FUNCTION injctl_msg ""
 /begin OUT_MEASUREMENT InjCtl_dqSetUnBal InjCtl_qCurr InjCtl_qCurrCor InjCtl_qCurrUnCor InjCtl_qDes InjCtl_qDesCor InjCtl_qRaw InjCtl_qRawCor InjCtl_qSet InjCtl_qSetUnBal InjCtl_stNoInj /end OUT_MEASUREMENT
/end FUNCTION
/begin FUNCTION injctl_qco "Mengenkoordination"
 /begin DEF_CHARACTERISTIC InjCtl_facAdjSrvMax_C InjCtl_facAdjSrvMin_C InjCtl_facAdjSrvUnlimDfl_C InjCtl_qAdjQntMax_C InjCtl_qAdjQntMin_C InjCtl_qAdjQnt_MAP InjCtl_t1DT1SetUnBal_C InjCtl_kdDT1SetUnBal_C InjCtl_qDriftComp_MAP InjCtl_qDriftMax2_C InjCtl_qDriftMin2_C InjCtl_swtFMACor_C /end DEF_CHARACTERISTIC
 /begin IN_MEASUREMENT Eng_nAvrg InjCtl_qSetUnBal InjCtl_qSetUnCor_mp InjCtl_tiEngOn_mp /end IN_MEASUREMENT
/end FUNCTION
/begin FUNCTION injctl_qco_msg "" /begin OUT_MEASUREMENT InjCtl_trqInrLim /end OUT_MEASUREMENT /end FUNCTION
/begin FUNCTION injctl_qco_uic ""
 /begin DEF_CHARACTERISTIC InjCtl_qCurr_Vector InjCtl_qCurr_Channel InjCtl_qRaw_Vector InjCtl_qRaw_Channel InjCtl_qSet_Vector InjCtl_qSet_Channel /end DEF_CHARACTERISTIC
 /begin OUT_MEASUREMENT InjCtl_dAdjQntCS_mp InjCtl_dDriftCS_mp InjCtl_facAdjSrvUnlim_mp InjCtl_facAdjSrv_mp InjCtl_qAdjQntUnlim_mp InjCtl_qAdjQnt_mp InjCtl_qDriftComp_mp InjCtl_qDriftLim1_mp InjCtl_qDriftLim2_mp InjCtl_qDriftMax1_mp InjCtl_qDriftMin1_mp InjCtl_qDriftUnlim_mp InjCtl_qSetUnCor_mp InjCtl_stAdjQnt_mp InjCtl_tiEngOn_mp /end OUT_MEASUREMENT
/end FUNCTION
/begin FUNCTION injctl_qlim "Begrenzungsmenge"
 /begin DEF_CHARACTERISTIC InjCtl_dqLimUp_C InjCtl_dqLimDwn_C InjCtl_qLimErr_CUR InjCtl_qLimErr_MAP InjCtl_qLimSoftShOff_CUR /end DEF_CHARACTERISTIC
 /begin IN_MEASUREMENT Eng_nAvrg FTSCD_tFuel /end IN_MEASUREMENT
/end FUNCTION
/begin FUNCTION injctl_qlim_msg "" /begin OUT_MEASUREMENT InjCtl_qLim InjCtl_qLimErr InjCtl_qLimSwt InjCtl_stQLimErr /end OUT_MEASUREMENT /end FUNCTION
/begin FUNCTION injctl_qlim_uic "" /begin OUT_MEASUREMENT InjCtl_qLimSoftShOff_mp InjCtl_qLim_mp /end OUT_MEASUREMENT /end FUNCTION
/begin FUNCTION injctl_uic "" /end FUNCTION
/begin FUNCTION injun "Einspritzsystem" /end FUNCTION
/begin FUNCTION injun_co "Koordinator für das Einspritzsystem" /end FUNCTION
/begin FUNCTION injun_co_msg "" /begin OUT_MEASUREMENT InjUn_stInjValve /end OUT_MEASUREMENT /end FUNCTION
/begin FUNCTION injun_co_uic "" /end FUNCTION
/begin FUNCTION injun_masscnv "Umrechnung von Kraftstoffmenge nach Kraftstoffvolumen" /end FUNCTION
/begin FUNCTION injun_masscnv_uic "" /end FUNCTION
/begin FUNCTION injun_mi1dynqntcor_uic ""
 /begin OUT_MEASUREMENT InjUn_numCylMI1_mp InjUn_qMI1Cor_mp InjUn_volMI1Cor_mp InjUn_volMI1_mp /end OUT_MEASUREMENT
/end FUNCTION
/begin FUNCTION injun_mi2dynqntcor_uic "" /begin OUT_MEASUREMENT InjUn_numCylMI2_mp /end OUT_MEASUREMENT /end FUNCTION
/begin FUNCTION injun_pii1dynqntcor_uic ""
 /begin OUT_MEASUREMENT InjUn_numCylPiI1_mp InjUn_qPiI1Cor_mp InjUn_volPiI1Cor_mp InjUn_volPiI1_mp /end OUT_MEASUREMENT
/end FUNCTION
/begin FUNCTION injun_pii2dynqntcor_uic ""
 /begin OUT_MEASUREMENT InjUn_numCylPiI2_mp InjUn_qPiI2Cor_mp InjUn_volPiI2Cor_mp InjUn_volPiI2_mp /end OUT_MEASUREMENT
/end FUNCTION
/begin FUNCTION injun_pii3dynqntcor_uic "" /end FUNCTION
/begin FUNCTION injun_poi1dynqntcor_uic ""
 /begin OUT_MEASUREMENT InjUn_numCylPoI1_mp InjUn_qPoI1Cor_mp InjUn_volPoI1Cor_mp InjUn_volPoI1_mp /end OUT_MEASUREMENT
/end FUNCTION
/begin FUNCTION injun_poi2dynqntcor_uic ""
 /begin OUT_MEASUREMENT InjUn_numCylPoI2_mp InjUn_qPoI2Cor_mp InjUn_volPoI2Cor_mp InjUn_volPoI2_mp /end OUT_MEASUREMENT
/end FUNCTION
/begin FUNCTION injun_sched "" /begin DEF_CHARACTERISTIC InjUn_nInjLock_C /end DEF_CHARACTERISTIC /end FUNCTION
/begin FUNCTION injun_sched_msg "" /begin OUT_MEASUREMENT InjUn_volMI1CorCyc InjUn_volPiI1CorCyc InjUn_volPiI2CorCyc /end OUT_MEASUREMENT /end FUNCTION
/begin FUNCTION injun_sched_uic "" /end FUNCTION
/begin FUNCTION injun_soptst "" /begin DEF_CHARACTERISTIC InjUn_phiTstShOffPathSet_C InjUn_tiTstShOffPathET_C /end DEF_CHARACTERISTIC /end FUNCTION
/begin FUNCTION injun_soptst_msg "" /begin OUT_MEASUREMENT InjUn_stShutOffReq /end OUT_MEASUREMENT /end FUNCTION
/begin FUNCTION injun_soptst_uic "" /end FUNCTION
/begin FUNCTION injun_tst "" /end FUNCTION
/begin FUNCTION injun_tst_msg "" /begin OUT_MEASUREMENT InjUn_stTst /end OUT_MEASUREMENT /end FUNCTION
/begin FUNCTION injun_tst_uic "" /end FUNCTION
/begin FUNCTION injvcd "injection valve component driver"
 /begin DEF_CHARACTERISTIC InjVCD_stInjMode_C InjVCD_swtEnaAgDiff_C InjVCD_tiETMinHigh_C InjVCD_tiETMinLow_C InjVCD_tiHoldMin_C /end DEF_CHARACTERISTIC
/end FUNCTION
/begin FUNCTION injvcd_calcmi1et "Einspritzsspezifische Berechnung der Injektoransteuerdauer der ersten Haupteinspritzung" /begin DEF_CHARACTERISTIC InjVCD_nETMaxLim_C InjVCD_tiETMax_C /end DEF_CHARACTERISTIC /end FUNCTION
/begin FUNCTION injvcd_calcmi1et_uic "" /begin DEF_CHARACTERISTIC InjVCD_tiMI1ET_Vector InjVCD_tiMI1ET_Channel /end DEF_CHARACTERISTIC /begin OUT_MEASUREMENT InjVCD_tiMI1ETUnLim_mp InjVCD_tiMI1ET_mp /end OUT_MEASUREMENT /end FUNCTION
/begin FUNCTION injvcd_calcpii1et "" /end FUNCTION
/begin FUNCTION injvcd_calcpii1et_uic "" /begin DEF_CHARACTERISTIC InjVCD_tiPiI1ET_Vector InjVCD_tiPiI1ET_Channel /end DEF_CHARACTERISTIC /begin OUT_MEASUREMENT InjVCD_tiPiI1ET_mp InjVCD_tiZFCPiI1ETCor_mp /end OUT_MEASUREMENT /end FUNCTION
/begin FUNCTION injvcd_calcpii2et "" /end FUNCTION
/begin FUNCTION injvcd_calcpii2et_uic "" /begin DEF_CHARACTERISTIC InjVCD_tiPiI2ET_Vector InjVCD_tiPiI2ET_Channel /end DEF_CHARACTERISTIC /begin OUT_MEASUREMENT InjVCD_tiPiI2ET_mp InjVCD_tiZFCPiI2ETCor_mp /end OUT_MEASUREMENT /end FUNCTION
/begin FUNCTION injvcd_calcpii3et "" /end FUNCTION
/begin FUNCTION injvcd_calcpii3et_uic "" /end FUNCTION
/begin FUNCTION injvcd_calcpoi1et "" /end FUNCTION
/begin FUNCTION injvcd_calcpoi1et_uic "" /begin DEF_CHARACTERISTIC InjVCD_tiPoI1ET_Vector InjVCD_tiPoI1ET_Channel /end DEF_CHARACTERISTIC /begin OUT_MEASUREMENT InjVCD_tiPoI1ET_mp /end OUT_MEASUREMENT /end FUNCTION
/begin FUNCTION injvcd_calcpoi2et "" /end FUNCTION
/begin FUNCTION injvcd_calcpoi2et_uic "" /begin DEF_CHARACTERISTIC InjVCD_tiPoI2ET_Vector InjVCD_tiPoI2ET_Channel /end DEF_CHARACTERISTIC /begin OUT_MEASUREMENT InjVCD_tiPoI2ET_mp /end OUT_MEASUREMENT /end FUNCTION
/begin FUNCTION injvcd_estet "" /end FUNCTION
/begin FUNCTION injvcd_estet_uic "" /end FUNCTION
/begin FUNCTION injvcd_getet "Ansteuerdauerberechnung" /begin DEF_CHARACTERISTIC InjVCD_swtInputETMAP_C InjVCD_tiET_MAP /end DEF_CHARACTERISTIC /begin IN_MEASUREMENT InjVCD_pInET_mp InjVCD_volInET_mp /end IN_MEASUREMENT /end FUNCTION
/begin FUNCTION injvcd_getet_uic "" /begin OUT_MEASUREMENT InjVCD_pInET_mp InjVCD_volInET_mp /end OUT_MEASUREMENT /end FUNCTION
/begin FUNCTION injvcd_mirmtctl_uic "" /end FUNCTION
/begin FUNCTION injvcd_pickupcurrdur ""
 /begin DEF_CHARACTERISTIC InjVCD_tiPickUpCurrBattLo_C InjVCD_tiPickUpCurr_CUR InjVCD_uThresDeltaHi_C InjVCD_uThresLo_C /end DEF_CHARACTERISTIC
 /begin IN_MEASUREMENT Eng_tEng /end IN_MEASUREMENT
/end FUNCTION
/begin FUNCTION injvcd_pickupcurrdur_uic "" /begin OUT_MEASUREMENT InjVCD_tiPickUpCurr_mp /end OUT_MEASUREMENT /end FUNCTION
/begin FUNCTION injvcd_pii1rmtctl_uic "" /end FUNCTION
/begin FUNCTION injvcd_pii2rmtctl_uic "" /end FUNCTION
/begin FUNCTION injvcd_pii3rmtctl_uic "" /end FUNCTION
/begin FUNCTION injvcd_poi1rmtctl_uic "" /end FUNCTION
/begin FUNCTION injvcd_poi2rmtctl_uic "" /end FUNCTION
/begin FUNCTION injvcd_progdyn "" /end FUNCTION
/begin FUNCTION injvcd_progdyn_uic "" /end FUNCTION
/begin FUNCTION injvcd_progetlib "" /end FUNCTION
/begin FUNCTION injvcd_progetlib_uic ""
 /begin OUT_MEASUREMENT InjVCD_stInjMI1_mp InjVCD_stInjMI2_mp InjVCD_stInjPiI1_mp InjVCD_stInjPiI2_mp InjVCD_stInjPiI3_mp InjVCD_stInjPoI1_mp InjVCD_stInjPoI2_mp /end OUT_MEASUREMENT
/end FUNCTION
/begin FUNCTION injvcd_progetzfc "" /end FUNCTION
/begin FUNCTION injvcd_progetzfc_uic "" /begin OUT_MEASUREMENT InjVCD_stInjZFC_mp /end OUT_MEASUREMENT /end FUNCTION
/begin FUNCTION injvcd_progmi "Programmierung der MI1, Initialisierung von Schnelllöschung und Haltestrom" /end FUNCTION
/begin FUNCTION injvcd_progmi_uic "" /begin OUT_MEASUREMENT InjVCD_ctMI1AgDiff_mp InjVCD_phiMI1Diff_mp /end OUT_MEASUREMENT /end FUNCTION
/begin FUNCTION injvcd_progpii "Programmierung der Voreinspritzung" /end FUNCTION
/begin FUNCTION injvcd_progpii2 "" /end FUNCTION
/begin FUNCTION injvcd_progpii2_uic "" /begin OUT_MEASUREMENT InjVCD_ctPiI2AgDiff_mp InjVCD_phiPiI2Diff_mp /end OUT_MEASUREMENT /end FUNCTION
/begin FUNCTION injvcd_progpii3 "" /end FUNCTION
/begin FUNCTION injvcd_progpii3_uic "" /end FUNCTION
/begin FUNCTION injvcd_progpii_uic "" /begin OUT_MEASUREMENT InjVCD_ctPiI1AgDiff_mp InjVCD_phiPiI1Diff_mp /end OUT_MEASUREMENT /end FUNCTION
/begin FUNCTION injvcd_progpoi1 "" /end FUNCTION
/begin FUNCTION injvcd_progpoi1_uic "" /end FUNCTION
/begin FUNCTION injvcd_progpoi2 "" /end FUNCTION
/begin FUNCTION injvcd_progpoi2_uic "" /end FUNCTION
/begin FUNCTION injvcd_progzfc "" /end FUNCTION
/begin FUNCTION injvcd_progzfc_uic "" /end FUNCTION
/begin FUNCTION injvcd_zfcetcor "Ansteuerdauerkorrektur durch Nullmengenkalibrierung"
 /begin DEF_CHARACTERISTIC InjVCD_pRailZFCETCor_AXIS InjVCD_qZFCETCor_AXIS InjVCD_rZFCETDif0_GMAP InjVCD_rZFCETDif1_GMAP InjVCD_rZFCETDif2_GMAP InjVCD_rZFCETMsk_GMAP InjVCD_stInputZFCETGMap_C InjVCD_stZFCETCorActv_C InjVCD_swtZFCCorOvrRunOn_C InjVCD_tiZFCETCorMax_C InjVCD_tiZFCETCorMin_C /end DEF_CHARACTERISTIC
 /begin IN_MEASUREMENT InjVCD_qInZFCETGMap_mp RailCD_pAct_mp /end IN_MEASUREMENT
 /begin OUT_MEASUREMENT InjVCD_rZFCETCoeffDif_mp InjVCD_rZFCETCoeffMsk_mp InjVCD_tiPiI1ZFCETCor_mp InjVCD_tiPiI2ZFCETCor_mp InjVCD_tiPiI3ZFCETCor_mp /end OUT_MEASUREMENT
/end FUNCTION
/begin FUNCTION injvcd_zfcetcor_uic "" /begin OUT_MEASUREMENT InjVCD_qInZFCETGMap_mp /end OUT_MEASUREMENT /end FUNCTION
/begin FUNCTION injvlv_addbal "Korrektur Einspritzmenge aus Laufruheregler" /begin DEF_CHARACTERISTIC InjVlv_facAddBalRls_MAP /end DEF_CHARACTERISTIC /begin IN_MEASUREMENT InjCtl_qSetUnBal RailCD_pPeak /end IN_MEASUREMENT /end FUNCTION
/begin FUNCTION injvlv_addballib "" /begin DEF_CHARACTERISTIC InjVlv_stInputAddBalMap_C /end DEF_CHARACTERISTIC /end FUNCTION
/begin FUNCTION injvlv_addballib_uic ""
 /begin OUT_MEASUREMENT InjVlv_qMI1Bal_mp InjVlv_qPiI1Bal_mp InjVlv_qPiI2Bal_mp InjVlv_qPiI3Bal_mp InjVlv_qPoI1Bal_mp InjVlv_qPoI2BalEff_mp InjVlv_qPoI2Bal_mp /end OUT_MEASUREMENT
/end FUNCTION
/begin FUNCTION injvlv_addbalzfc "" /end FUNCTION
/begin FUNCTION injvlv_addbalzfc_uic "" /end FUNCTION
/begin FUNCTION injvlv_addbal_msg "" /begin OUT_MEASUREMENT InjVlv_facAddBalRls /end OUT_MEASUREMENT /end FUNCTION
/begin FUNCTION injvlv_addbal_uic "" /end FUNCTION
/begin FUNCTION injvlv_chrgbalinjlim "maximale Anzahl an Einspritzungen aufgrund der Ladungsbilanz des Boosterkondensators"
 /begin DEF_CHARACTERISTIC InjVlv_numInjChrgBal_MAP InjVlv_rChrgBalEngSpdHys_C InjVlv_rChrgBalVltgHys_C /end DEF_CHARACTERISTIC
 /begin IN_MEASUREMENT BattCD_u Eng_nAvrg /end IN_MEASUREMENT
/end FUNCTION
/begin FUNCTION injvlv_chrgbalinjlim_uic "" /begin OUT_MEASUREMENT InjVlv_numInjChrgBal_mp /end OUT_MEASUREMENT /end FUNCTION
/begin FUNCTION injvlv_errdet "Injektorfehlererkennung" /begin DEF_CHARACTERISTIC InjVlv_numSegOfs1_C InjVlv_numSegOfs2_C InjVlv_stErrDet_C /end DEF_CHARACTERISTIC /end FUNCTION
/begin FUNCTION injvlv_errdet_msg "" /begin OUT_MEASUREMENT InjVlv_nCyl InjVlv_qFBCCyl /end OUT_MEASUREMENT /end FUNCTION
/begin FUNCTION injvlv_errdet_uic "" /end FUNCTION
/begin FUNCTION injvlv_mon "Injektordiagnose"
 /begin DEF_CHARACTERISTIC InjVlv_DebBnkA0Def_C InjVlv_DebBnkA0Ok_C InjVlv_DebBnkA1Def_C InjVlv_DebBnkA1Ok_C InjVlv_DebBnkA2Def_C InjVlv_DebBnkA2Ok_C InjVlv_DebBnkA3Def_C InjVlv_DebBnkA3Ok_C InjVlv_DebBnkB0Def_C InjVlv_DebBnkB0Ok_C InjVlv_DebBnkB1Def_C InjVlv_DebBnkB1Ok_C InjVlv_DebBnkB2Def_C InjVlv_DebBnkB2Ok_C InjVlv_DebBnkB3Def_C InjVlv_DebBnkB3Ok_C InjVlv_DebChipA0Def_C InjVlv_DebChipA0Ok_C InjVlv_DebChipA1Def_C InjVlv_DebChipA1Ok_C InjVlv_DebChipA2Def_C InjVlv_DebChipA2Ok_C InjVlv_DebChipA3Def_C InjVlv_DebChipA3Ok_C InjVlv_DebChipB0Def_C InjVlv_DebChipB0Ok_C InjVlv_DebChipB1Def_C InjVlv_DebChipB1Ok_C InjVlv_DebChipB2Def_C InjVlv_DebChipB2Ok_C InjVlv_DebChipB3Def_C InjVlv_DebChipB3Ok_C InjVlv_DebCylA0Def_C InjVlv_DebCylA0Ok_C InjVlv_DebCylA1Def_C InjVlv_DebCylA1Ok_C InjVlv_DebCylA2Def_C InjVlv_DebCylA2Ok_C InjVlv_DebCylA3Def_C InjVlv_DebCylA3Ok_C InjVlv_DebCylB0Def_C InjVlv_DebCylB0Ok_C InjVlv_DebCylB1Def_C InjVlv_DebCylB1Ok_C InjVlv_DebCylB2Def_C InjVlv_DebCylB2Ok_C InjVlv_DebCylB3Def_C InjVlv_DebCylB3Ok_C InjVlv_numNoLoadCylMax_C InjVlv_stErrMskPattern_C InjVlv_stErrMskSelect_C /end DEF_CHARACTERISTIC
 /begin OUT_MEASUREMENT InjVlv_numIdxErrCyl1_mp InjVlv_numIdxErrCyl2_mp InjVlv_numIdxErrCyl3_mp InjVlv_numIdxErrCyl4_mp InjVlv_numIdxErrCyl5_mp InjVlv_numIdxErrCyl6_mp InjVlv_stChipVerCy33x_mp InjVlv_stErrCyl1_mp InjVlv_stErrCyl2_mp InjVlv_stErrCyl3_mp InjVlv_stErrCyl4_mp InjVlv_stErrCyl5_mp InjVlv_stErrCyl6_mp InjVlv_stIniCy331_mp /end OUT_MEASUREMENT
/end FUNCTION
/begin FUNCTION injvlv_mon_msg ""
 /begin OUT_MEASUREMENT InjVlv_stErrBnk1 InjVlv_stErrBnk2 InjVlv_stErrChip InjVlv_stErrChipPrep InjVlv_stErrClctCyl1 InjVlv_stErrClctCyl2 InjVlv_stErrClctCyl3 InjVlv_stErrClctCyl4 InjVlv_stErrClctCyl5 InjVlv_stErrClctCyl6 InjVlv_stErrUnknown InjVlv_stInjValve /end OUT_MEASUREMENT
/end FUNCTION
/begin FUNCTION injvlv_mon_uic "" /end FUNCTION
/begin FUNCTION injvlv_presmin "Abschaltanforderung aufgrund Mindestdruck" /begin DEF_CHARACTERISTIC InjVlv_pMin_C InjVlv_pMin_CUR /end DEF_CHARACTERISTIC /begin IN_MEASUREMENT Eng_tEng /end IN_MEASUREMENT /end FUNCTION
/begin FUNCTION injvlv_qntadj "Injektor-Mengenabgleich"
 /begin DEF_CHARACTERISTIC InjVlv_stQntAdj_MAP InjVlv_volQntAdjLim_C InjVlv_volQntAdjMax0_C InjVlv_volQntAdjMax1_C InjVlv_volQntAdjMax2_C InjVlv_volQntAdjMax3_C InjVlv_volQntAdjMin0_C InjVlv_volQntAdjMin1_C InjVlv_volQntAdjMin2_C InjVlv_volQntAdjMin3_C /end DEF_CHARACTERISTIC
 /begin IN_MEASUREMENT InjUn_volMI1Cor_mp RailCD_pPeak /end IN_MEASUREMENT
/end FUNCTION
/begin FUNCTION injvlv_qntadjrepl "" /begin DEF_CHARACTERISTIC InjVlv_stQntAdjRepl_C InjVlv_swtQntAdj_C /end DEF_CHARACTERISTIC /end FUNCTION
/begin FUNCTION injvlv_qntadj_uic ""
 /begin OUT_MEASUREMENT InjVlv_volMI1QntAdj_mp InjVlv_volPiI1QntAdj_mp InjVlv_volPiI2QntAdj_mp InjVlv_volPiI3QntAdj_mp InjVlv_volPoI1QntAdj_mp InjVlv_volPoI2QntAdj_mp /end OUT_MEASUREMENT
/end FUNCTION
/begin FUNCTION injvlv_tdiffhyd "" /begin DEF_CHARACTERISTIC InjVlv_swtDiffHydInSel_C InjVlv_tiDiffHyd_MAP /end DEF_CHARACTERISTIC /begin IN_MEASUREMENT InjVlv_pActInDiffHyd_mp InjVlv_qDesInDiffHyd_mp /end IN_MEASUREMENT /end FUNCTION
/begin FUNCTION injvlv_tdiffhyd_uic ""
 /begin OUT_MEASUREMENT InjVlv_pActInDiffHyd_mp InjVlv_qDesInDiffHyd_mp InjVlv_tiMI1DiffHydCor_mp InjVlv_tiPiI1DiffHydCor_mp InjVlv_tiPiI2DiffHydCor_mp /end OUT_MEASUREMENT
/end FUNCTION
/begin FUNCTION injvlv_wvcor "Druckwellenkorrektur"
 /begin DEF_CHARACTERISTIC InjVlv_facFTSWvCor_MAP InjVlv_qWvCorNorm_CUR InjVlv_stWvCorActv_C InjVlv_tWvCor_MAP /end DEF_CHARACTERISTIC
 /begin IN_MEASUREMENT CTSCD_tClnt FTSCD_tFuel InjVlv_tWvCor_mp RailCD_pPeak /end IN_MEASUREMENT
/end FUNCTION
/begin FUNCTION injvlv_wvcorlib "Druckwellenkorrektur Funktionsbibliothek"
 /begin DEF_CHARACTERISTIC InjVlv_facPiI2WvCor_C InjVlv_facWvCor1_MAP InjVlv_facWvCor2_MAP InjVlv_qWvCor1_MAP InjVlv_qWvCor2_MAP InjVlv_qWvCorMax_C InjVlv_qWvCorMin_C /end DEF_CHARACTERISTIC
 /begin IN_MEASUREMENT InjCrv_qMI1Des InjCrv_qPiI1Des InjCrv_qPoI2Des_mp InjVlv_rMI1WvCorNorm_mp InjVlv_tiMI1PoI2Cor_mp InjVlv_tiPiI1MI1Cor_mp RailCD_pAct_mp /end IN_MEASUREMENT
/end FUNCTION
/begin FUNCTION injvlv_wvcorlib_uic ""
 /begin OUT_MEASUREMENT InjVlv_facMI1PoI2WvCor_mp InjVlv_facPiI2PiI1WvCor_mp InjVlv_facPiIMI1WvCor_mp InjVlv_qMI1PoI2WvCor_mp InjVlv_qMI1WvCor_mp InjVlv_qPiI1MI1WvCor_mp InjVlv_qPiI1WvCor_mp InjVlv_qPiI2MI1WvCor_mp InjVlv_qPiI2PiI1WvCor_mp InjVlv_qPoI2WvCor_mp InjVlv_rMI1WvCorNorm_mp InjVlv_tiMI1PoI2Cor_mp InjVlv_tiMI1PoI2_mp InjVlv_tiPiI1MI1Cor_mp InjVlv_tiPiI1MI1_mp InjVlv_tiPiI2MI1Cor_mp InjVlv_tiPiI2MI1_mp InjVlv_tiPiI2PiI1Cor_mp InjVlv_tiPiI2PiI1_mp /end OUT_MEASUREMENT
/end FUNCTION
/begin FUNCTION injvlv_wvcor_msg "" /begin OUT_MEASUREMENT InjVlv_facFTSWvCor InjVlv_qWvCorNorm InjVlv_stWvCor /end OUT_MEASUREMENT /end FUNCTION
/begin FUNCTION injvlv_wvcor_uic "" /begin OUT_MEASUREMENT InjVlv_tWvCor_mp /end OUT_MEASUREMENT /end FUNCTION
/begin FUNCTION k2rdli "" /begin DEF_CHARACTERISTIC K2RDLI_dDataSetVer_C /end DEF_CHARACTERISTIC /end FUNCTION
/begin FUNCTION layer "Interface function to customer code"
 /begin DEF_CHARACTERISTIC Dmd_gen_C Layer_APPVARBN_C Layer_APPVARVEH_C Layer_stAirCtlBits_C Layer_stPCR_C Layer_swtB_bsdprot Layer_swtTunProt_C Layer_tiDefWrEep_C PwrMng_B_ulcp_C PwrMng_dmAirPerTimeCor_C PwrMng_dmAirPerTimeIMax_C PwrMng_dmAirPerTimeIMin_C PwrMng_dmAirPerTimeIKi_C PwrMng_dmAirPerTimeIKiPos_C PwrMng_dmAirPerTimeIKiNeg_C PwrMng_dmAirPerTimeIWinPos_C PwrMng_dmAirPerTimeIWinNeg_C PwrMng_nB_kwdrehtHi_C PwrMng_nB_kwdrehtLo_C PwrMng_nB_llHigh_C PwrMng_nB_llLow_C PwrMng_rLoadMax_C PwrMng_rLoadMin_C PwrMng_stIdlingDefVal_C PwrMng_swtnmot_w_C PwrMng_swtPmsvActiv_C PwrMng_swttumg_C PwrMng_tiChgBatt_C PwrMng_tiHisRst_C PwrMng_Tkat_mod_C PwrMng_uAltTargetDefVal_C /end DEF_CHARACTERISTIC
/end FUNCTION
/begin FUNCTION layer_fltmng ""
 /begin DEF_CHARACTERISTIC Layer_ctDebBSDStep_C Layer_ctDebGENStep_C Layer_ctDebIBS1Step_C Layer_ctDebIBS2Step_C Layer_ctDebIBS3Step_C Layer_ctDebMANHYDRStep_C Layer_ctDebMANLUFTStep_C Layer_ctDebPMBATTStep_C Layer_ctDebPMBNStep_C Layer_ctDebPMRUHVERLStep_C Layer_ctDebQLTStep_C Layer_ctDebTANSStep_C Layer_ctDebTOENSStep_C Layer_ctDebTUMGStep_C Layer_ctDebBSDDef_C Layer_ctDebBSDOk_C Layer_ctDebGENDef_C Layer_ctDebGENOk_C Layer_ctDebIBS1Def_C Layer_ctDebIBS1Ok_C Layer_ctDebIBS2Def_C Layer_ctDebIBS2Ok_C Layer_ctDebIBS3Def_C Layer_ctDebIBS3Ok_C Layer_ctDebMANHYDRDef_C Layer_ctDebMANHYDROk_C Layer_ctDebMANLUFTDef_C Layer_ctDebMANLUFTOk_C Layer_ctDebPMBATTDef_C Layer_ctDebPMBATTOk_C Layer_ctDebPMBNDef_C Layer_ctDebPMBNOk_C Layer_ctDebPMRUHVERLDef_C Layer_ctDebPMRUHVERLOk_C Layer_ctDebQLTDef_C Layer_ctDebQLTOk_C Layer_ctDebTANSDef_C Layer_ctDebTANSOk_C Layer_ctDebTOENSDef_C Layer_ctDebTOENSOk_C Layer_ctDebTUMGDef_C Layer_ctDebTUMGOk_C /end DEF_CHARACTERISTIC
/end FUNCTION
/begin FUNCTION layer_fltmng_uic ""
 /begin OUT_MEASUREMENT BD_BSD BD_GEN BD_IBS1 BD_IBS2 BD_IBS3 BD_MANHYDR BD_MANLUFT BD_PMBATT BD_PMBN BD_PMRUHVERL BD_QLT BD_TANS BD_TOENS BD_TUMG E_BSD E_GEN E_IBS1 E_IBS2 E_IBS3 E_MANHYDR E_MANLUFT E_PMBATT E_PMBN E_PMRUHVERL E_QLT E_TANS E_TOENS E_TUMG RF_BSD RF_GEN RF_IBS1 RF_IBS2 RF_IBS3 RF_MANHYDR RF_MANLUFT RF_PMBATT RF_PMBN RF_PMRUHVERL RF_QLT RF_TANS RF_TOENS RF_TUMG ZF_BSD ZF_GEN ZF_IBS1 ZF_IBS2 ZF_IBS3 ZF_MANHYDR ZF_MANLUFT ZF_PMBATT ZF_PMBN ZF_PMRUHVERL ZF_QLT ZF_TANS ZF_TOENS ZF_TUMG /end OUT_MEASUREMENT
/end FUNCTION
/begin FUNCTION layer_msg ""
 /begin OUT_MEASUREMENT Layer_bos01_w Layer_bosbtvfbk Layer_bosstate Layer_bosvalue_DIAG Layer_FRC_INTM_T_BOS2 Layer_FRC_INTM_WAY_BOS2 Layer_ID2_BOS2 Layer_idbosmsg Layer_idfbosmg_w Layer_ID_FN_BOS2 Layer_stExtWaitRdy Layer_stLayer Layer_stOelTog Layer_stOelVerb Layer_stOelVerl Layer_TARD_MON_BOS2 Layer_TARD_YR_BOS2 Layer_volOil Layer_volOilRefill Layer_zrbosmld PwrMng_absch_korr PwrMng_d_soc PwrMng_iEngine PwrMng_iGen PwrMng_nMin PwrMng_nnnstart PwrMng_pwrDes PwrMng_pwrPTC PwrMng_rCtrPwrSpCos PwrMng_rdffgen PwrMng_stB_ccbtnach PwrMng_stB_ccbttdfk PwrMng_stB_ccbttknt PwrMng_stB_ccpmerr PwrMng_stB_ccprio PwrMng_stB_ccruhver PwrMng_stB_codierpm PwrMng_stCtrCbr PwrMng_stCtrPCos PwrMng_stCtrPrio PwrMng_stCtrPrioCf PwrMng_stCtrPwrCos PwrMng_stGen PwrMng_stLdstGen PwrMng_stLIGov PwrMng_stPCos PwrMng_stRqPCos PwrMng_stSelSpCos PwrMng_stTerminal61 PwrMng_stULev PwrMng_tiLRGen PwrMng_ubt PwrMng_uGen PwrMng_uGen2 /end OUT_MEASUREMENT
/end FUNCTION
/begin FUNCTION layer_uic ""
 /begin OUT_MEASUREMENT Counter_Layer_fp1000_mp Counter_Layer_fp100_mp Counter_Layer_fp10_mp Counter_Layer_fp200_mp Counter_Layer_ini_mp Counter_Layer_nl1000_mp Counter_Layer_nl100_mp Counter_Layer_nl10_mp Counter_Layer_nl200_mp Counter_Layer_wakeup1000_mp Counter_Layer_wakeup100_mp Counter_Layer_wakeup10_mp Counter_Layer_wakeup200_mp PwrMng_dmAirPerTimeI_mp PwrMng_Nkw_mp PwrMng_trqmd_gennm_mp PwrMng_tumgcan_mp PwrMng_V_mp /end OUT_MEASUREMENT
/end FUNCTION
/begin FUNCTION ligov "Leerlaufregler"
 /begin DEF_CHARACTERISTIC LIGov_CldCltchFlt1T1_C LIGov_CldCltchFlt2T1_C LIGov_CldCltchIKi_C LIGov_CldCltchIKiPos_C LIGov_CldCltchIKiNeg_C LIGov_CldCltchIWinPos_C LIGov_CldCltchIWinNeg_C LIGov_CldCltchPredef_C LIGov_CldCltchPKp_C LIGov_CldCltchPKpPos_C LIGov_CldCltchPKpNeg_C LIGov_CldCltchPWinPos_C LIGov_CldCltchPWinNeg_C LIGov_tiCldGearDT1_C LIGov_CldGearDKd_C LIGov_CldGearIKi_C LIGov_CldGearIKiPos_C LIGov_CldGearIKiNeg_C LIGov_CldGearIWinPos_C LIGov_CldGearIWinNeg_C LIGov_CldGearPredef_C LIGov_CldGearPKp_C LIGov_CldGearPKpPos_C LIGov_CldGearPKpNeg_C LIGov_CldGearPWinPos_C LIGov_CldGearPWinNeg_C LIGov_tiGear1DT1_C LIGov_Gear1DKd_C LIGov_Gear1Flt1T1_C LIGov_Gear1Flt2T1_C LIGov_Gear1IKi_C LIGov_Gear1IKiPos_C LIGov_Gear1IKiNeg_C LIGov_Gear1IWinPos_C LIGov_Gear1IWinNeg_C LIGov_Gear1Predef_C LIGov_Gear1PKp_C LIGov_Gear1PKpPos_C LIGov_Gear1PKpNeg_C LIGov_Gear1PWinPos_C LIGov_Gear1PWinNeg_C LIGov_tiGear2DT1_C LIGov_Gear2DKd_C LIGov_Gear2Flt1T1_C LIGov_Gear2Flt2T1_C LIGov_Gear2IKi_C LIGov_Gear2IKiPos_C LIGov_Gear2IKiNeg_C LIGov_Gear2IWinPos_C LIGov_Gear2IWinNeg_C LIGov_Gear2Predef_C LIGov_Gear2PKp_C LIGov_Gear2PKpPos_C LIGov_Gear2PKpNeg_C LIGov_Gear2PWinPos_C LIGov_Gear2PWinNeg_C LIGov_tiGear3DT1_C LIGov_Gear3DKd_C LIGov_Gear3Flt1T1_C LIGov_Gear3Flt2T1_C LIGov_Gear3IKi_C LIGov_Gear3IKiPos_C LIGov_Gear3IKiNeg_C LIGov_Gear3IWinPos_C LIGov_Gear3IWinNeg_C LIGov_Gear3Predef_C LIGov_Gear3PKp_C LIGov_Gear3PKpPos_C LIGov_Gear3PKpNeg_C LIGov_Gear3PWinPos_C LIGov_Gear3PWinNeg_C LIGov_tiGear4DT1_C LIGov_Gear4DKd_C LIGov_Gear4Flt1T1_C LIGov_Gear4Flt2T1_C LIGov_Gear4IKi_C LIGov_Gear4IKiPos_C LIGov_Gear4IKiNeg_C LIGov_Gear4IWinPos_C LIGov_Gear4IWinNeg_C LIGov_Gear4Predef_C LIGov_Gear4PKp_C LIGov_Gear4PKpPos_C LIGov_Gear4PKpNeg_C LIGov_Gear4PWinPos_C LIGov_Gear4PWinNeg_C LIGov_tiGear5DT1_C LIGov_Gear5DKd_C LIGov_Gear5Flt1T1_C LIGov_Gear5Flt2T1_C LIGov_Gear5IKi_C LIGov_Gear5IKiPos_C LIGov_Gear5IKiNeg_C LIGov_Gear5IWinPos_C LIGov_Gear5IWinNeg_C LIGov_Gear5Predef_C LIGov_Gear5PKp_C LIGov_Gear5PKpPos_C LIGov_Gear5PKpNeg_C LIGov_Gear5PWinPos_C LIGov_Gear5PWinNeg_C LIGov_tiGear6DT1_C LIGov_Gear6DKd_C LIGov_Gear6Flt1T1_C LIGov_Gear6Flt2T1_C LIGov_Gear6IKi_C LIGov_Gear6IKiPos_C LIGov_Gear6IKiNeg_C LIGov_Gear6IWinPos_C LIGov_Gear6IWinNeg_C LIGov_Gear6Predef_C LIGov_Gear6PKp_C LIGov_Gear6PKpPos_C LIGov_Gear6PKpNeg_C LIGov_Gear6PWinPos_C LIGov_Gear6PWinNeg_C LIGov_nDflTrmVal_C LIGov_nDHypDenom_C LIGov_nDHypNum_C LIGov_nLimHigh_C LIGov_nLimLow_C LIGov_nMSDiffMax_C LIGov_nOffsetPreCtrltrqDem_C LIGov_nOffsetPreCtrl_C LIGov_nOffsetPredef_C LIGov_nOffsetUbr_C LIGov_rAPPThresFreezeI_C LIGov_rAPPThresTrqDem_C LIGov_stPsRev_C LIGov_swtAPPFreezeI_C LIGov_swtAPPTrqDem_C LIGov_swtInitPreCtrlNotLck_C LIGov_tClntXLow_C LIGov_tClntXHigh_C LIGov_stCold_C LIGov_stWarm_C LIGov_tiDelCutOut_C LIGov_tiPT1_CUR LIGov_trqMax_CUR LIGov_trqSetMax_C LIGov_trqThresDefrostI_C LIGov_UbrPKp_C LIGov_UbrPKpPos_C LIGov_UbrPKpNeg_C LIGov_UbrPWinPos_C LIGov_UbrPWinNeg_C LIGov_vThresUbr_C LIGov_WrmCltchFlt1T1_C LIGov_WrmCltchFlt2T1_C LIGov_WrmCltchIKi_C LIGov_WrmCltchIKiPos_C LIGov_WrmCltchIKiNeg_C LIGov_WrmCltchIWinPos_C LIGov_WrmCltchIWinNeg_C LIGov_WrmCltchPredef_C LIGov_WrmCltchPKp_C LIGov_WrmCltchPKpPos_C LIGov_WrmCltchPKpNeg_C LIGov_WrmCltchPWinPos_C LIGov_WrmCltchPWinNeg_C /end DEF_CHARACTERISTIC
 /begin IN_MEASUREMENT Eng_nAvrg LIGov_nDiff_mp /end IN_MEASUREMENT
/end FUNCTION
/begin FUNCTION ligov_msg ""
 /begin OUT_MEASUREMENT LIGov_st LIGov_stSetTrqActive LIGov_trq LIGov_trqCurrPredef LIGov_trqFlt LIGov_trqI LIGov_trqP LIGov_trqSetDIAG /end OUT_MEASUREMENT
/end FUNCTION
/begin FUNCTION ligov_ms_msg "" /end FUNCTION
/begin COMPU_METHOD AirMassPerTime "Luftmasse pro Zeit" RAT_FUNC "%6.3" "Kg/h" COEFFS 0 10 0 0 0 1 /end COMPU_METHOD
/begin COMPU_METHOD AngleCrS "Winkel Kurbelwelle" RAT_FUNC "%6.4" "deg CrS" COEFFS 0 42.6666666666667 0 0 0 1 /end COMPU_METHOD
/begin COMPU_METHOD DEZ "K3 Umwandlungen" RAT_FUNC "%6.2" "-" COEFFS 0 1 0 0 0 1 /end COMPU_METHOD
/begin COMPU_METHOD DtyCyc "Tastverhaeltnis" RAT_FUNC "%6.4" "%" COEFFS 0 100 0 0 0 1 /end COMPU_METHOD
/begin COMPU_METHOD EGTSwt "Umrechnung für EGT Rampenschalter (1 / 1000*2^14 )" RAT_FUNC "%10.9" "-" COEFFS 0 16384000 0 0 0 1 /end COMPU_METHOD
/begin COMPU_METHOD EngN "Motordrehzahl" RAT_FUNC "%6.2" "rpm" COEFFS 0 1 0 0 0 1 /end COMPU_METHOD
/begin COMPU_METHOD EngN_HiRes "Motordrehzahl, höhere Auflösung als EngM" RAT_FUNC "%6.3" "rpm" COEFFS 0 8 0 0 0 1 /end COMPU_METHOD
/begin COMPU_METHOD Fact "Faktor mit Auflösung 1 / 8192, hauptsächlich für einen Faktorenbereich 0...1 verwendet" RAT_FUNC "%6.5" "-" COEFFS 0 8192 0 0 0 1 /end COMPU_METHOD
/begin COMPU_METHOD Fact1 "Faktor mit Auflösung 0,01 (100 mal höherer Bereich als Fact)" RAT_FUNC "%6.4" "-" COEFFS 0 128 0 0 0 1 /end COMPU_METHOD
/begin COMPU_METHOD fak_q0p5 "K3 Umwandlungen" RAT_FUNC "%6.3" "-" COEFFS 0 1 0 0 0 0.5 /end COMPU_METHOD
/begin COMPU_METHOD igen_ub_q1 "K3 Umwandlungen" RAT_FUNC "%6.2" "-" COEFFS 0 1 0 0 0 1 /end COMPU_METHOD
/begin COMPU_METHOD InjMass "Einspritzmenge" RAT_FUNC "%6.4" "mg/hub" COEFFS 0 100 0 0 0 1 /end COMPU_METHOD
/begin COMPU_METHOD InjMassCyc "Einspritzmenge pro Zyklus (mg/Zyklus)" RAT_FUNC "%6.4" "mg/cyc" COEFFS 0 100 0 0 0 1 /end COMPU_METHOD
/begin COMPU_METHOD InjMassInj "Einspritzmenge pro Einspritzung (mg/Einspritzung)" RAT_FUNC "%6.4" "mg/inj" COEFFS 0 100 0 0 0 1 /end COMPU_METHOD
/begin COMPU_METHOD InjMassPerSec_20ms "Einspritzmengenänderung pro Sekunde für 20ms-Tasks" RAT_FUNC "%6.3" "mg/hub/s" COEFFS 0 2 0 0 0 1 /end COMPU_METHOD
/begin COMPU_METHOD InjQntInj "Einspritzmenge der einzelnen Einspritzung" RAT_FUNC "%6.4" "mm^3/inj" COEFFS 0 100 0 0 0 1 /end COMPU_METHOD
/begin COMPU_METHOD InjTime_us "Zeit in Microsekunden für das Einspritztiming" RAT_FUNC "%6.2" "us" COEFFS 0 1 0 0 0 1 /end COMPU_METHOD
/begin COMPU_METHOD Kd "Differentialverstärkung Kd (gleiche Einheit/Umrechnungsformel an Ein- und Ausgang)" RAT_FUNC "%7.6" "1/1" COEFFS 0 65536 0 0 0 1 /end COMPU_METHOD
/begin COMPU_METHOD Kd_rpm2Nm "Differentialverstärkung Kd (Motordrehzahl EngN zu Motormoment Trq)" RAT_FUNC "%8.7" "Nm/rpm" COEFFS 0 655360 0 0 0 1 /end COMPU_METHOD
/begin COMPU_METHOD Ki "Integrale Verstärkung Ki (gleiche Einheit/Umrechnungsregel an Ein- und Ausgang)" RAT_FUNC "%6.5" "1/s" COEFFS 0 4294.967296 0 0 0 1 /end COMPU_METHOD
/begin COMPU_METHOD Ki_rpm2Nm "Integralverstärkung Ki (Motordrehzahl EngN zu Motormoment Trq)" RAT_FUNC "%6.5" "Nm/(rpm*s)" COEFFS 0 5368.70912 0 0 0 1 /end COMPU_METHOD
/begin COMPU_METHOD km_sw_q10 "K3 Umwandlungen" RAT_FUNC "%6.1" "-" COEFFS 0 0.1 0 0 0 1 /end COMPU_METHOD
/begin COMPU_METHOD Kp_rpm2Nm "Proportionale Verstärkung Kp (Motordrehzahl EngN zu Moment Trq)" RAT_FUNC "%7.6" "Nm/rpm" COEFFS 0 81920 0 0 0 1 /end COMPU_METHOD
/begin COMPU_METHOD nmot_uw_q0p25 "K3 Umwandlungen" RAT_FUNC "%6.3" "1/min" COEFFS 0 1 0 0 0 0.25 /end COMPU_METHOD
/begin COMPU_METHOD OneToOne "eins zu eins (physikalischer Wert ist gleich dem internen Wert)" RAT_FUNC "%6.2" "-" COEFFS 0 1 0 0 0 1 /end COMPU_METHOD
/begin COMPU_METHOD PCENT "K3 Umwandlungen" RAT_FUNC "%6.3" "%" COEFFS 0 256 0 0 0 100 /end COMPU_METHOD
/begin COMPU_METHOD Prc "Prozent, gleiche interne Auflösung wie Fact, aber Darstellung in Prozent (0...100%)" RAT_FUNC "%6.4" "%" COEFFS 0 81.92 0 0 0 1 /end COMPU_METHOD
/begin COMPU_METHOD PresAC_hPa "Druck (Klimatisierung) angezeigt in [hPa]" RAT_FUNC "%6.2" "hPa" COEFFS 0 0.5 0 0 0 1 /end COMPU_METHOD
/begin COMPU_METHOD Pres_AC "Druck (Klimatisierung)" RAT_FUNC "%7.2" "hPa" COEFFS 0 0.500000 0 0 0 1 /end COMPU_METHOD
/begin COMPU_METHOD Pres_Rail "Raildruck in hPa" RAT_FUNC "%4.3" "bar" COEFFS 0 10.000000 0 0 0 1 /end COMPU_METHOD
/begin COMPU_METHOD Pres_SI "Druck (angezeigt in [Pa])" RAT_FUNC "%6.0" "Pa" COEFFS 0 0.01 0 0 0 1 /end COMPU_METHOD
/begin COMPU_METHOD Pwr "Leistung" RAT_FUNC "%6.2" "W" COEFFS 0 0.10610329539459 0 0 0 1 /end COMPU_METHOD
/begin COMPU_METHOD QntR "Normierungsverhältnis Einspritzmenge / Normierungsmenge" RAT_FUNC "%6.5" "-" COEFFS 0 1024 0 0 0 1 /end COMPU_METHOD
/begin COMPU_METHOD rel_ub_q1 "K3 Umwandlungen" RAT_FUNC "%6.2" "%" COEFFS 0 1 0 0 0 1 /end COMPU_METHOD
/begin COMPU_METHOD Rmp "einheitenloser Rampengradient (für Library Ramp, etc.)" RAT_FUNC "%6.4" "1/s" COEFFS 0 65.536 0 0 0 1 /end COMPU_METHOD
/begin COMPU_METHOD RmpInjMass "Rampengradient für Einspritzmenge" RAT_FUNC "%6.5" "(mg/stroke)/s" COEFFS 0 6553.6 0 0 0 1 /end COMPU_METHOD
/begin COMPU_METHOD SlopeRes10000 "Umrechnung für Slope: Slopewert mit Verhältnis 0,0001" RAT_FUNC "%7.6" "-" COEFFS 0 10000 0 0 0 1 /end COMPU_METHOD
/begin COMPU_METHOD spg_uw_q0p015 "K3 Umwandlungen" RAT_FUNC "%9.5" "V" COEFFS 0 1 0 0 0 0.015 /end COMPU_METHOD
/begin COMPU_METHOD Temp_Cels "Temperatur dargestellt in °C (gleiche interne Darstellung wie Temp_Kelv)" RAT_FUNC "%6.1" "deg C" COEFFS 0 10 2731.4 0 0 1 /end COMPU_METHOD
/begin COMPU_METHOD temp_q1 "K3 Umwandlungen" RAT_FUNC "%6.2" "Grad C" COEFFS 0 1 0 0 0 1 /end COMPU_METHOD
/begin COMPU_METHOD temp_ub_q5_o50 "K3 Umwandlungen" RAT_FUNC "%6.2" "Grad C" COEFFS 0 1 50 0 0 5 /end COMPU_METHOD
/begin COMPU_METHOD TimeDelay_s "Zeitkonstante T1 (in s) für PT1, DT1, etc." RAT_FUNC "%9.3" "s" COEFFS 0 0 1 0 0.00023283064365387 0 /end COMPU_METHOD
/begin COMPU_METHOD TimeDelay_s_Lin_16 "Zeitkonstante T1 (in s) für PT1, DT1, etc. für SINT16, kein Kehrwert" RAT_FUNC "%6.5" "s" COEFFS 0 6553.4 0 0 0 1 /end COMPU_METHOD
/begin COMPU_METHOD TimeEngOnHrs "Umrechnung für Betriebsstundenzähler" RAT_FUNC "%6.1" "h" COEFFS 0 0.0549323782423836 0 0 0 1 /end COMPU_METHOD
/begin COMPU_METHOD Time_ms "Zeit in ms für Fehlerentprellung (DSM) und SW-Timer" RAT_FUNC "%6.1" "ms" COEFFS 0 0.1 0 0 0 1 /end COMPU_METHOD
/begin COMPU_METHOD Time_s "Zeit in s für Fehlerentprellung (DSM) und SW-Timer" RAT_FUNC "%6.4" "s" COEFFS 0 100 0 0 0 1 /end COMPU_METHOD
/begin COMPU_METHOD Trq "Motormoment" RAT_FUNC "%6.3" "Nm" COEFFS 0 10 0 0 0 1 /end COMPU_METHOD
/begin COMPU_METHOD Vel "Fahrzeuggeschwindigkeit, gleiche interne Auflösung wie Vel_SI" RAT_FUNC "%6.4" "km/h" COEFFS 0 100 0 0 0 1 /end COMPU_METHOD
/begin COMPU_METHOD vfzg_ub_q1p25 "K3 Umwandlungen" RAT_FUNC "%6.2" "km/h" COEFFS 0 1 0 0 0 1.25 /end COMPU_METHOD
/begin COMPU_METHOD Volt_Batt "Batteriespannung" RAT_FUNC "%6.1" "mV" COEFFS 0 0.05115 0 0 0 1 /end COMPU_METHOD
/begin COMPU_METHOD defaultAscii "" RAT_FUNC "%6.2" "-" COEFFS 0 1 0 0 0 1 /end COMPU_METHOD
/begin RECORD_LAYOUT Gkf_Ws16 FNC_VALUES 1 SWORD COLUMN_DIR DIRECT /end RECORD_LAYOUT
/begin RECORD_LAYOUT GSst_Xs16 NO_AXIS_PTS_X 1 SWORD AXIS_PTS_X 2 SWORD INDEX_INCR DIRECT /end RECORD_LAYOUT
/begin RECORD_LAYOUT Kf_Xs16_Ys16_Ws16 NO_AXIS_PTS_X 1 SWORD NO_AXIS_PTS_Y 2 SWORD AXIS_PTS_X 3 SWORD INDEX_INCR DIRECT AXIS_PTS_Y 4 SWORD INDEX_INCR DIRECT FNC_VALUES 5 SWORD COLUMN_DIR DIRECT /end RECORD_LAYOUT
/begin RECORD_LAYOUT Kl_Xs16_Ws16 NO_AXIS_PTS_X 1 SWORD AXIS_PTS_X 2 SWORD INDEX_INCR DIRECT FNC_VALUES 3 SWORD COLUMN_DIR DIRECT /end RECORD_LAYOUT
/begin RECORD_LAYOUT Kwb_Ws16 FNC_VALUES 1 SWORD COLUMN_DIR DIRECT /end RECORD_LAYOUT
/begin RECORD_LAYOUT Kwb_Wu32 FNC_VALUES 1 ULONG COLUMN_DIR DIRECT /end RECORD_LAYOUT
/begin RECORD_LAYOUT Kwb_Wu8 FNC_VALUES 1 UBYTE COLUMN_DIR DIRECT /end RECORD_LAYOUT
/begin RECORD_LAYOUT Kw_Ws16 FNC_VALUES 1 SWORD COLUMN_DIR DIRECT /end RECORD_LAYOUT
/begin RECORD_LAYOUT Kw_Ws32 FNC_VALUES 1 SLONG COLUMN_DIR DIRECT /end RECORD_LAYOUT
/begin RECORD_LAYOUT Kw_Ws8 FNC_VALUES 1 SBYTE COLUMN_DIR DIRECT /end RECORD_LAYOUT
/begin RECORD_LAYOUT Kw_Wu16 FNC_VALUES 1 UWORD COLUMN_DIR DIRECT /end RECORD_LAYOUT
/begin RECORD_LAYOUT Kw_Wu32 FNC_VALUES 1 ULONG COLUMN_DIR DIRECT /end RECORD_LAYOUT
/begin RECORD_LAYOUT Kw_Wu8 FNC_VALUES 1 UBYTE COLUMN_DIR DIRECT /end RECORD_LAYOUT
/end MODULE
/end PROJECT
