ASAP2_VERSION 1 3
/begin PROJECT P389 "BMW DDE6.0 4-Zylinder V53.4 01.04.2004 CAN12H"
/begin HEADER "" VERSION "V53.4_4Z_CAN12H" PROJECT_NO P389 /end HEADER
/begin MODULE DIM ""
/begin MOD_COMMON "" BYTE_ORDER MSB_FIRST ALIGNMENT_BYTE 1 ALIGNMENT_WORD 2 ALIGNMENT_LONG 4 ALIGNMENT_FLOAT32_IEEE 4 /end MOD_COMMON
/begin CHARACTERISTIC CoEng_dnOvrFulMin_C "untere Hysteresegrenze für Overfueling Drehzahlgradienten" VALUE 0xC862C Kw_Ws16 655350.0 dn_dZ20 -327680.0 327670.0 FORMAT "%8.1" /end CHARACTERISTIC
/begin CHARACTERISTIC CoEng_dnOvrFulMax_C "obere Hysteresegrenze für Overfueling Drehzahlgradienten" VALUE 0xC862E Kw_Ws16 655350.0 dn_dZ20 -327680.0 327670.0 FORMAT "%8.1" /end CHARACTERISTIC
/begin CHARACTERISTIC CoEng_stdnOvrFulLow_C "Status für Overfueling Drehzahlgradienten Hysterese aus" VALUE 0xC8630 Kw_Ws16 65535.00 OneToOne -32768.00 32767.00 FORMAT "%8.2" READ_ONLY /end CHARACTERISTIC
/begin CHARACTERISTIC CoEng_stdnOvrFulHigh_C "Status für Overfueling Drehzahlgradienten Hysterese ein" VALUE 0xC8632 Kw_Ws16 65535.00 OneToOne -32768.00 32767.00 FORMAT "%8.2" READ_ONLY /end CHARACTERISTIC
/begin CHARACTERISTIC CoEng_dqSubsRgnRmpUp_C "Rampensteigung zur Umschaltung" VALUE 0xC8278 Kw_Wu32 655359.999847 RmpInjMassCyc 0.00 655359.999847 FORMAT "%13.6" /end CHARACTERISTIC
/begin CHARACTERISTIC CoEng_dqSubsRgnRmpDwn_C "Rampensteigung zur Umschaltung" VALUE 0xC827C Kw_Wu32 655359.999847 RmpInjMassCyc 0.00 655359.999847 FORMAT "%13.6" /end CHARACTERISTIC
/begin CHARACTERISTIC CoEng_dtrqEngPrtRgnMonUp_C "" VALUE 0xC8634 Kw_Wu32 6553599.99847 RmpTrq 0.00 6553599.99847 FORMAT "%13.5" /end CHARACTERISTIC
/begin CHARACTERISTIC CoEng_dtrqEngPrtRgnMonDwn_C "" VALUE 0xC8638 Kw_Wu32 6553599.99847 RmpTrq 0.00 6553599.99847 FORMAT "%13.5" /end CHARACTERISTIC
/begin CHARACTERISTIC CoEng_dtrqLimUp_C "#SSD pos. Rampenanstieg bei Umschaltung auf Begrenzungsmoment bei Systemfehler" VALUE 0xC863C Kw_Wu32 6553599.99847 RmpTrq 0.00 6553599.99847 FORMAT "%13.5" /end CHARACTERISTIC
/begin CHARACTERISTIC CoEng_dtrqLimDwn_C "neg. Rampenanstieg bei Rückkehr von dem Begrenzungsmoment bei Systemfehler" VALUE 0xC8640 Kw_Wu32 6553599.99847 RmpTrq 0.00 6553599.99847 FORMAT "%13.5" /end CHARACTERISTIC
/begin CHARACTERISTIC CoEng_dtrqLimUp1_C "#SSD positive Rampensteigung für Rampenschalter" VALUE 0xC8644 Kw_Wu32 6553599.99847 RmpTrq 0.00 6553599.99847 FORMAT "%13.5" /end CHARACTERISTIC
/begin CHARACTERISTIC CoEng_dtrqLimDwn1_C "negative Steigung für einen Rampenschalter" VALUE 0xC8648 Kw_Wu32 6553599.99847 RmpTrq 0.00 6553599.99847 FORMAT "%13.5" /end CHARACTERISTIC
/begin CHARACTERISTIC CoEng_dtrqLimUp2_C "positive Steigung für Rampenschalter 2" VALUE 0xC864C Kw_Wu32 6553599.99847 RmpTrq 0.00 6553599.99847 FORMAT "%13.5" /end CHARACTERISTIC
/begin CHARACTERISTIC CoEng_dtrqLimDwn2_C "negative Steigung für Rampenschalter 2" VALUE 0xC8650 Kw_Wu32 6553599.99847 RmpTrq 0.00 6553599.99847 FORMAT "%13.5" /end CHARACTERISTIC
/begin CHARACTERISTIC CoEng_dtrqLimUp3_C "positive Rampensteigung für Rampenschalter" VALUE 0xC8654 Kw_Wu32 6553599.99847 RmpTrq 0.00 6553599.99847 FORMAT "%13.5" /end CHARACTERISTIC
/begin CHARACTERISTIC CoEng_dtrqLimDwn3_C "negative Rampensteigung für Rampenschalter" VALUE 0xC8658 Kw_Wu32 6553599.99847 RmpTrq 0.00 6553599.99847 FORMAT "%13.5" /end CHARACTERISTIC
/begin CHARACTERISTIC CoEng_dtrqLimUp4_C "positive Rampensteigung für Rampenschalter" VALUE 0xC865C Kw_Wu32 6553599.99847 RmpTrq 0.00 6553599.99847 FORMAT "%13.5" /end CHARACTERISTIC
/begin CHARACTERISTIC CoEng_dtrqLimDwn4_C "negative Rampensteigung für Rampenschalter" VALUE 0xC8660 Kw_Wu32 6553599.99847 RmpTrq 0.00 6553599.99847 FORMAT "%13.5" /end CHARACTERISTIC
/begin CHARACTERISTIC CoEng_tiOvrFulDT1_C "Zeit für Overfueling DT1" VALUE 0xC8664 Kw_Wu32 4294.9673 TimeDelay_s 0.0000010000000 4294.9673 FORMAT "%9.4" /end CHARACTERISTIC
/begin CHARACTERISTIC CoEng_facOvrFulDKd_C "Kd für overfueling DT1" VALUE 0xC8668 Kw_Ws32 32767.9999924 Kd_rpm2dndt -16384.0000000 16383.9999924 FORMAT "%13.7" /end CHARACTERISTIC
/begin CHARACTERISTIC CoEng_ExtWaitMsk2_C "#SSD Bitmaske für externe Ereignisse vor Öffnen des Hauptrelais" VALUE 0xC8268 Kw_Wu8 255.0 OneToOne 0.00 255.0 FORMAT "%5.1" /end CHARACTERISTIC
/begin CHARACTERISTIC CoEng_ExtWaitMsk_C "#SSD Bitmaske für externe Ereignisse for Schreiben des EEPROM" VALUE 0xC8269 Kw_Wu8 255.0 OneToOne 0.00 255.0 FORMAT "%5.1" /end CHARACTERISTIC
/begin CHARACTERISTIC CoEng_facAdjDfl_C "Defaultwert für Abgleich Momentenbegrenzung" VALUE 0xC866C Kw_Ws16 2.000000 Fact 0.00 2.000000 FORMAT "%8.6" EXTENDED_LIMITS -4.000000 3.999878 /end CHARACTERISTIC
/begin CHARACTERISTIC CoEng_facAdjMax_C "#SSD Maximaler Abgleichwert für Abgleich Momentenbegrenzung" VALUE 0xC866E Kw_Ws16 7.999878 Fact -4.000000 3.999878 FORMAT "%8.6" /end CHARACTERISTIC
/begin CHARACTERISTIC CoEng_facAdjMin_C "Minimaler Abgleichwert für Abgleich Momentenbegrenzung" VALUE 0xC8670 Kw_Ws16 7.999878 Fact -4.000000 3.999878 FORMAT "%8.6" /end CHARACTERISTIC
/begin CHARACTERISTIC CoEng_facFlConsumAdjDfl_C "Ersatzwert für den Kraftstoffverbrauchsabgleich" VALUE 0xC8280 Kw_Ws16 2.000000 Fact 0.00 2.000000 FORMAT "%8.6" EXTENDED_LIMITS -4.000000 3.999878 /end CHARACTERISTIC
/begin CHARACTERISTIC CoEng_facFlConsumAdjMax_C "Maximalwert des Kraftstoffverbrauch-Abgleichwerts" VALUE 0xC8282 Kw_Ws16 2.000000 Fact 0.00 2.000000 FORMAT "%8.6" EXTENDED_LIMITS -4.000000 3.999878 /end CHARACTERISTIC
/begin CHARACTERISTIC CoEng_facFlConsumAdjMin_C "Minumumwert des Kraftstoffverbrauch-Abgleichwerts" VALUE 0xC8284 Kw_Ws16 2.000000 Fact 0.00 2.000000 FORMAT "%8.6" EXTENDED_LIMITS -4.000000 3.999878 /end CHARACTERISTIC
/begin CHARACTERISTIC CoEng_lSumFuncPref_C "Schwelle für gefahrene Strecke" VALUE 0xC8534 Kw_Wu32 1000000.00000 Length 0.00 1000000.00000 FORMAT "%13.5" EXTENDED_LIMITS 0.00 4294967295.00 /end CHARACTERISTIC
/begin CHARACTERISTIC CoEng_nOvrFulMin_C "untere Hysteresegrenze für Overfueling Motordrehzahl" VALUE 0xC8672 Kw_Ws16 5960.000 EngN 40.00000 6000.000 FORMAT "%8.3" EXTENDED_LIMITS -32768.00 32767.00 /end CHARACTERISTIC
/begin CHARACTERISTIC CoEng_nOvrFulMax_C "obere Hysteresegrenze für Overfueling Motordrehzahl" VALUE 0xC8674 Kw_Ws16 5960.000 EngN 40.00000 6000.000 FORMAT "%8.3" EXTENDED_LIMITS -32768.00 32767.00 /end CHARACTERISTIC
/begin CHARACTERISTIC CoEng_stnOvrFulLow_C "Status für Overfueling Motordrehzahl Hysterese aus" VALUE 0xC8676 Kw_Ws16 65535.00 OneToOne -32768.00 32767.00 FORMAT "%8.2" READ_ONLY /end CHARACTERISTIC
/begin CHARACTERISTIC CoEng_stnOvrFulHigh_C "Status für Overfueling Motordrehzahl Hysterese ein" VALUE 0xC8678 Kw_Ws16 65535.00 OneToOne -32768.00 32767.00 FORMAT "%8.2" READ_ONLY /end CHARACTERISTIC
/begin CHARACTERISTIC CoEng_nShOffTstMax_C "#SSD maximale Drehzahlschwelle für Abstelltest" VALUE 0xC85C4 Kw_Ws16 32767.00 EngN 0.00 32767.00 FORMAT "%8.2" EXTENDED_LIMITS -32768.00 32767.00 /end CHARACTERISTIC
/begin CHARACTERISTIC CoEng_nShOffTstMin_C "#SSD minimale Drehzahlschwelle für Abstelltest" VALUE 0xC85C6 Kw_Ws16 32767.00 EngN 0.00 32767.00 FORMAT "%8.2" EXTENDED_LIMITS -32768.00 32767.00 /end CHARACTERISTIC
/begin CHARACTERISTIC CoEng_nSlpLimMin_C "Drehzahlschwelle f. Aktivierung Tuboschubbegrenzung" VALUE 0xC8910 Kw_Ws16 32767.00 EngN 0.00 32767.00 FORMAT "%8.2" EXTENDED_LIMITS -32768.00 32767.00 /end CHARACTERISTIC
/begin CHARACTERISTIC CoEng_nSoftShOffMax_C "engine speed limit for soft shutoff" VALUE 0xC8564 Kw_Ws16 32727.00 EngN 40.00000 32767.00 FORMAT "%8.2" EXTENDED_LIMITS -32768.00 32767.00 /end CHARACTERISTIC
/begin CHARACTERISTIC CoEng_nSoftShOffMin_C "minimale Drehzahlschwelle für Komfortabstellung" VALUE 0xC8566 Kw_Ws16 32727.00 EngN 40.00000 32767.00 FORMAT "%8.2" EXTENDED_LIMITS -32768.00 32767.00 /end CHARACTERISTIC
/begin CHARACTERISTIC CoEng_nThresNrml2Strt_C "Motordrehzahlschwelle für Zustandsübergang von NORMAL nach START" VALUE 0xC85CC Kw_Ws16 8000.000 EngN 0.00 8000.000 FORMAT "%8.3" EXTENDED_LIMITS -32768.00 32767.00 /end CHARACTERISTIC
/begin CHARACTERISTIC CoEng_numSelFuncPref_C "Auswahl Funktion mit uneingeschränkter Priorität" VALUE 0xC8538 Kw_Wu8 7.000 OneToOne 0.00 7.000 FORMAT "%5.3" EXTENDED_LIMITS 0.00 255.0 /end CHARACTERISTIC
/begin CHARACTERISTIC CoEng_facActvFunc2_1_C "Gewichtungsfaktor für Schubphasenzähler für Funktion1" VALUE 0xC8539 Kw_Wu8 10.00 OneToOne 0.00 10.00 FORMAT "%5.2" EXTENDED_LIMITS 0.00 255.0 /end CHARACTERISTIC
/begin CHARACTERISTIC CoEng_facActvFunc2_2_C "Gewichtungsfaktor für Schubphasenzähler für Funktion 2" VALUE 0xC853A Kw_Wu8 10.00 OneToOne 0.00 10.00 FORMAT "%5.2" EXTENDED_LIMITS 0.00 255.0 /end CHARACTERISTIC
/begin CHARACTERISTIC CoEng_facActvFunc2_3_C "Gewichtungsfaktor für Schubphasenzähler für Funktion 3" VALUE 0xC853B Kw_Wu8 10.00 OneToOne 0.00 10.00 FORMAT "%5.2" EXTENDED_LIMITS 0.00 255.0 /end CHARACTERISTIC
/begin CHARACTERISTIC CoEng_facActvFunc2_4_C "Gewichtungsfaktor für Schubphasenzähler für Funktion 4" VALUE 0xC853C Kw_Wu8 10.00 OneToOne 0.00 10.00 FORMAT "%5.2" EXTENDED_LIMITS 0.00 255.0 /end CHARACTERISTIC
/begin CHARACTERISTIC CoEng_facActvFunc2_5_C "Gewichtungsfaktor für Schubphasenzähler für Funktion 5" VALUE 0xC853D Kw_Wu8 10.00 OneToOne 0.00 10.00 FORMAT "%5.2" EXTENDED_LIMITS 0.00 255.0 /end CHARACTERISTIC
/begin CHARACTERISTIC CoEng_facActvFunc2_6_C "Gewichtungsfaktor für Schubphasenzähler für Funktion 6" VALUE 0xC853E Kw_Wu8 10.00 OneToOne 0.00 10.00 FORMAT "%5.2" EXTENDED_LIMITS 0.00 255.0 /end CHARACTERISTIC
/begin CHARACTERISTIC CoEng_facActvFunc2_7_C "Gewichtungsfaktor für Schubphasenzähler für Funktion 7" VALUE 0xC853F Kw_Wu8 10.00 OneToOne 0.00 10.00 FORMAT "%5.2" EXTENDED_LIMITS 0.00 255.0 /end CHARACTERISTIC
/begin CHARACTERISTIC CoEng_facActvFunc2_8_C "Gewichtungsfaktor für Schubphasenzähler für reservierte Funktion 8" VALUE 0xC8540 Kw_Wu8 0.00 OneToOne 0.00 0.00 FORMAT "%5.2" EXTENDED_LIMITS 0.00 255.0 /end CHARACTERISTIC
/begin CHARACTERISTIC CoEng_facActvFunc1_C "Gewichtungsfaktor für Schubphasenzähler für Funktion 1" VALUE 0xC8541 Kw_Wu8 10.00 OneToOne 0.00 10.00 FORMAT "%5.2" EXTENDED_LIMITS 0.00 255.0 /end CHARACTERISTIC
/begin CHARACTERISTIC CoEng_facActvFunc2_C "Gewichtungsfaktor für Schubphasenzähler für Funktion 2" VALUE 0xC8542 Kw_Wu8 10.00 OneToOne 0.00 10.00 FORMAT "%5.2" EXTENDED_LIMITS 0.00 255.0 /end CHARACTERISTIC
/begin CHARACTERISTIC CoEng_facActvFunc3_C "Gewichtungsfaktor für Schubphasenzähler für Funktion 3" VALUE 0xC8543 Kw_Wu8 10.00 OneToOne 0.00 10.00 FORMAT "%5.2" EXTENDED_LIMITS 0.00 255.0 /end CHARACTERISTIC
/begin CHARACTERISTIC CoEng_facActvFunc4_C "Gewichtungsfaktor für Schubphasenzähler für Funktion 4" VALUE 0xC8544 Kw_Wu8 10.00 OneToOne 0.00 10.00 FORMAT "%5.2" EXTENDED_LIMITS 0.00 255.0 /end CHARACTERISTIC
/begin CHARACTERISTIC CoEng_facActvFunc5_C "Gewichtungsfaktor für Schubphasenzähler für Funktion 5" VALUE 0xC8545 Kw_Wu8 10.00 OneToOne 0.00 10.00 FORMAT "%5.2" EXTENDED_LIMITS 0.00 255.0 /end CHARACTERISTIC
/begin CHARACTERISTIC CoEng_facActvFunc6_C "Gewichtungsfaktor für Schubphasenzähler für Funktion 6" VALUE 0xC8546 Kw_Wu8 10.00 OneToOne 0.00 10.00 FORMAT "%5.2" EXTENDED_LIMITS 0.00 255.0 /end CHARACTERISTIC
/begin CHARACTERISTIC CoEng_facActvFunc7_C "Gewichtungsfaktor für Schubphasenzähler für Funktion 7" VALUE 0xC8547 Kw_Wu8 10.00 OneToOne 0.00 10.00 FORMAT "%5.2" EXTENDED_LIMITS 0.00 255.0 /end CHARACTERISTIC
/begin CHARACTERISTIC CoEng_facActvFunc8_C "Gewichtungsfaktor für Schubphasenzähler für Funktion 8" VALUE 0xC8548 Kw_Wu8 0.00 OneToOne 0.00 0.00 FORMAT "%5.2" EXTENDED_LIMITS 0.00 255.0 /end CHARACTERISTIC
/begin CHARACTERISTIC CoEng_dtrqRmpUp_C "Rampensteigung aufwärts für Schubabschaltung( nicht applizierbar da nie in Gebrauch)" VALUE 0xC85D0 Kw_Wu32 6553584.99908 RmpTrq 14.9993896484 6553599.99847 FORMAT "%13.5" EXTENDED_LIMITS 0.00 6553599.99847 READ_ONLY /end CHARACTERISTIC
/begin CHARACTERISTIC CoEng_dtrqRmpDwn_C "Rampensteigung bei Schubabschaltung" VALUE 0xC85D4 Kw_Wu32 6553584.99908 RmpTrq 14.9993896484 6553599.99847 FORMAT "%13.5" EXTENDED_LIMITS 0.00 6553599.99847 /end CHARACTERISTIC
/begin CHARACTERISTIC CoEng_tiPFltdVolPT1_C "Filterzeitkonstante für Volumenstrom" VALUE 0xC867C Kw_Wu32 4294.9673 TimeDelay_s 0.0000010000000 4294.9673 FORMAT "%9.4" /end CHARACTERISTIC
/begin CHARACTERISTIC CoEng_tiPFltResFlowPT1_C "Filterzeitkonstante für Strömungswiderstand" VALUE 0xC8680 Kw_Wu32 4294.9673 TimeDelay_s 0.0000010000000 4294.9673 FORMAT "%9.4" /end CHARACTERISTIC
/begin CHARACTERISTIC CoEng_qSoftShOffMax_C "injection quantity limit for soft shutoff" VALUE 0xC8568 Kw_Ws16 327.6700 InjMassCyc 0.00 327.6700 FORMAT "%8.4" EXTENDED_LIMITS -327.6800 327.6700 /end CHARACTERISTIC
/begin CHARACTERISTIC CoEng_qSubs_MAP "Kennfeld für Ersatzmenge im Regenerationsfall" MAP 0xC8286 Kf_Xs16_Ys16_Ws16 80.00000 InjMassCyc 0.00 80.00000 FORMAT "%8.5" EXTENDED_LIMITS -327.6800 327.6700
 /begin AXIS_DESCR STD_AXIS Eng_nAvrg EngN 16 0.00 8000.000 FORMAT "%8.3" EXTENDED_LIMITS -32768.00 32767.00 DEPOSIT ABSOLUTE /end AXIS_DESCR
 /begin AXIS_DESCR STD_AXIS CoEng_trq Trq 16 0.00 200.0000 FORMAT "%8.4" EXTENDED_LIMITS -3276.800 3276.700 DEPOSIT ABSOLUTE /end AXIS_DESCR
/end CHARACTERISTIC
/begin CHARACTERISTIC CoEng_rhoFuel_C "#SSD Kraftstoffdichte" VALUE 0xC84CA Kw_Ws16 1500.000 RhoFuel 0.00 1500.000 FORMAT "%8.3" EXTENDED_LIMITS -3276.800 3276.700 /end CHARACTERISTIC
/begin CHARACTERISTIC CoEng_dtrqOvrFulUp_C "Steigung des Drehmoments (Nm/s) für Overfueling ramp switch" VALUE 0xC8684 Kw_Wu32 6553594.99817 RmpTrq 5.00030517578 6553599.99847 FORMAT "%13.5" EXTENDED_LIMITS 0.00 6553599.99847 /end CHARACTERISTIC
/begin CHARACTERISTIC CoEng_dtrqOvrFulDown_C "Steigung des Drehmoments (Nm/s) für Overfueling ramp switch" VALUE 0xC8688 Kw_Wu32 6553594.99817 RmpTrq 5.00030517578 6553599.99847 FORMAT "%13.5" EXTENDED_LIMITS 0.00 6553599.99847 /end CHARACTERISTIC
/begin CHARACTERISTIC CoEng_rOvrFulMin_C "untere Hysteresegrenze für Overfueling Gaspedalposition" VALUE 0xC868C Kw_Ws16 100.0000 Prc 0.00 100.0000 FORMAT "%8.4" EXTENDED_LIMITS -400.0000 399.9878 /end CHARACTERISTIC
/begin CHARACTERISTIC CoEng_rOvrFulMax_C "obere Hysteresegrenze für Overfueling Gaspedalposition" VALUE 0xC868E Kw_Ws16 100.0000 Prc 0.00 100.0000 FORMAT "%8.4" EXTENDED_LIMITS -400.0000 399.9878 /end CHARACTERISTIC
/begin CHARACTERISTIC CoEng_strOvrFulLow_C "status for overfueling acceleration pedale position hysteresis off" VALUE 0xC8690 Kw_Ws16 65535.00 OneToOne -32768.00 32767.00 FORMAT "%8.2" READ_ONLY /end CHARACTERISTIC
/begin CHARACTERISTIC CoEng_strOvrFulHigh_C "status for overfueling acceleration pedale position hysteresis on" VALUE 0xC8692 Kw_Ws16 65535.00 OneToOne -32768.00 32767.00 FORMAT "%8.2" READ_ONLY /end CHARACTERISTIC
/begin CHARACTERISTIC CoEng_dtrqSlpLimUpdef_C "Anstiegsbegrenzung f. Rauchgrenze ""Turboschubbegrenzung"" bei unbekannter Ganginformation" VALUE 0xC8914 Kw_Wu32 6553599.99847 RmpTrq 0.00 6553599.99847 FORMAT "%13.5" /end CHARACTERISTIC
/begin CHARACTERISTIC CoEng_dtrqSlpLimDwndef_C "Abwärts-Momentenbegrenzung für Rauchbegrenzung/Turboschubbegrenzung (fest auf maximalem Abstieg) bei unbekannter Ganginformation" VALUE 0xC8918 Kw_Wu32 6553599.99847 RmpTrq 0.00 6553599.99847 FORMAT "%13.5" READ_ONLY /end CHARACTERISTIC
/begin CHARACTERISTIC CoEng_dtrqSlpLimUp1_C "Anstiegsbegrenzung f. Rauchgrenze ""Turboschubbegrenzung"" bei Gang 1" VALUE 0xC891C Kw_Wu32 6553599.99847 RmpTrq 0.00 6553599.99847 FORMAT "%13.5" /end CHARACTERISTIC
/begin CHARACTERISTIC CoEng_dtrqSlpLimDwn1_C "Abwärts-Momentenbegrenzung für Rauchbegrenzung/Turboschubbegrenzung (fest auf maximalem Abstieg) bei Gang 1" VALUE 0xC8920 Kw_Wu32 6553599.99847 RmpTrq 0.00 6553599.99847 FORMAT "%13.5" READ_ONLY /end CHARACTERISTIC
/begin CHARACTERISTIC CoEng_dtrqSlpLimUp2_C "Anstiegsbegrenzung f. Rauchgrenze ""Turboschubbegrenzung"" bei Gang 2" VALUE 0xC8924 Kw_Wu32 6553599.99847 RmpTrq 0.00 6553599.99847 FORMAT "%13.5" /end CHARACTERISTIC
/begin CHARACTERISTIC CoEng_dtrqSlpLimDwn2_C "Abwärts-Momentenbegrenzung für Rauchbegrenzung/Turboschubbegrenzung (fest auf maximalem Abstieg) bei Gang 2" VALUE 0xC8928 Kw_Wu32 6553599.99847 RmpTrq 0.00 6553599.99847 FORMAT "%13.5" READ_ONLY /end CHARACTERISTIC
/begin CHARACTERISTIC CoEng_dtrqSlpLimUp3_C "Anstiegsbegrenzung f. Rauchgrenze ""Turboschubbegrenzung"" bei Gang 3" VALUE 0xC892C Kw_Wu32 6553599.99847 RmpTrq 0.00 6553599.99847 FORMAT "%13.5" /end CHARACTERISTIC
/begin CHARACTERISTIC CoEng_dtrqSlpLimDwn3_C "Abwärts-Momentenbegrenzung für Rauchbegrenzung/Turboschubbegrenzung (fest auf maximalem Abstieg) bei Gang 3" VALUE 0xC8930 Kw_Wu32 6553599.99847 RmpTrq 0.00 6553599.99847 FORMAT "%13.5" READ_ONLY /end CHARACTERISTIC
/begin CHARACTERISTIC CoEng_dtrqSlpLimUp4_C "Anstiegsbegrenzung f. Rauchgrenze ""Turboschubbegrenzung"" bei Gang 4" VALUE 0xC8934 Kw_Wu32 6553599.99847 RmpTrq 0.00 6553599.99847 FORMAT "%13.5" /end CHARACTERISTIC
/begin CHARACTERISTIC CoEng_dtrqSlpLimDwn4_C "Abwärts-Momentenbegrenzung für Rauchbegrenzung/Turboschubbegrenzung (fest auf maximalem Abstieg) bei Gang 4" VALUE 0xC8938 Kw_Wu32 6553599.99847 RmpTrq 0.00 6553599.99847 FORMAT "%13.5" READ_ONLY /end CHARACTERISTIC
/begin CHARACTERISTIC CoEng_dtrqSlpLimUp5_C "Anstiegsbegrenzung f. Rauchgrenze ""Turboschubbegrenzung"" bei Gang 5" VALUE 0xC893C Kw_Wu32 6553599.99847 RmpTrq 0.00 6553599.99847 FORMAT "%13.5" /end CHARACTERISTIC
/begin CHARACTERISTIC CoEng_dtrqSlpLimDwn5_C "Abwärts-Momentenbegrenzung für Rauchbegrenzung/Turboschubbegrenzung (fest auf maximalem Abstieg) bei Gang 5" VALUE 0xC8940 Kw_Wu32 6553599.99847 RmpTrq 0.00 6553599.99847 FORMAT "%13.5" READ_ONLY /end CHARACTERISTIC
/begin CHARACTERISTIC CoEng_dtrqSlpLimUp6_C "Anstiegsbegrenzung f. Rauchgrenze ""Turboschubbegrenzung"" bei Gang 6" VALUE 0xC8944 Kw_Wu32 6553599.99847 RmpTrq 0.00 6553599.99847 FORMAT "%13.5" /end CHARACTERISTIC
/begin CHARACTERISTIC CoEng_dtrqSlpLimDwn6_C "Abwärts-Momentenbegrenzung für Rauchbegrenzung/Turboschubbegrenzung (fest auf maximalem Abstieg) bei Gang 6" VALUE 0xC8948 Kw_Wu32 6553599.99847 RmpTrq 0.00 6553599.99847 FORMAT "%13.5" READ_ONLY /end CHARACTERISTIC
/begin CHARACTERISTIC CoEng_dtrqSlpLimUpREV_C "Anstiegsbegrenzung f. Rauchgrenze ""Turboschubbegrenzung"" bei Rückwärtsgang" VALUE 0xC894C Kw_Wu32 6553599.99847 RmpTrq 0.00 6553599.99847 FORMAT "%13.5" /end CHARACTERISTIC
/begin CHARACTERISTIC CoEng_dtrqSlpLimDwnREV_C "Abwärts-Momentenbegrenzung für Rauchbegrenzung/Turboschubbegrenzung (fest auf maximalem Abstieg) bei Rückwärtsgang" VALUE 0xC8950 Kw_Wu32 6553599.99847 RmpTrq 0.00 6553599.99847 FORMAT "%13.5" READ_ONLY /end CHARACTERISTIC
/begin CHARACTERISTIC CoEng_stCoopCapbl_C "Kooperationsattribute zu koordinierender Funktionen im Schubkoordinator (bitcodiert)" VALUE 0xC8549 Kw_Wu8 127.0 OneToOne 0.00 127.0 FORMAT "%5.1" EXTENDED_LIMITS 0.00 255.0 /end CHARACTERISTIC
/begin CHARACTERISTIC CoEng_stIRevShutOff_C "#SSD Maske für irreversible Abschaltursachen" VALUE 0xC84D0 Kw_Wu32 4294967295.00 OneToOne 0.00 4294967295.00 FORMAT "%13.2" /end CHARACTERISTIC
/begin CHARACTERISTIC CoEng_stOvrRunRgnMsk_C "Maske zur Erkennung der Regenerationsart" VALUE 0xC854C Kw_Wu32 4294967295.00 OneToOne 0.00 4294967295.00 FORMAT "%13.2" /end CHARACTERISTIC
/begin CHARACTERISTIC CoEng_stRevShutOff_C "#SSD Maske für reversible Abschaltursachen" VALUE 0xC84D4 Kw_Wu32 4294967295.00 OneToOne 0.00 4294967295.00 FORMAT "%13.2" /end CHARACTERISTIC
/begin CHARACTERISTIC CoEng_stShOffAddReqIRev_C "#SSD Abstellpfade für kundenspezifische irreversible Abschaltanforderung" VALUE 0xC84D8 Kw_Wu32 4294967295.00 OneToOne 0.00 4294967295.00 FORMAT "%13.2" /end CHARACTERISTIC
/begin CHARACTERISTIC CoEng_stShOffAddReqRev_C "#SSD Abstellpfade für kundenspezifische reversible Abschaltanforderung" VALUE 0xC84DC Kw_Wu32 4294967295.00 OneToOne 0.00 4294967295.00 FORMAT "%13.2" /end CHARACTERISTIC
/begin CHARACTERISTIC CoEng_stShOffAftRun_C "#SSD Abschaltanforderungen im Nachlauf" VALUE 0xC856C Kw_Wu32 4294967295.00 OneToOne 0.00 4294967295.00 FORMAT "%13.2" /end CHARACTERISTIC
/begin CHARACTERISTIC CoEng_stShOffAirbFrnt_C "#SSD Abstellpfade für Airbag Frontalaufprall aktiv" VALUE 0xC84E0 Kw_Wu32 4294967295.00 OneToOne 0.00 4294967295.00 FORMAT "%13.2" /end CHARACTERISTIC
/begin CHARACTERISTIC CoEng_stShOffAirbRear_C "#SSD Abstellpfade für Airbag Heckaufprall aktiv" VALUE 0xC84E4 Kw_Wu32 4294967295.00 OneToOne 0.00 4294967295.00 FORMAT "%13.2" /end CHARACTERISTIC
/begin CHARACTERISTIC CoEng_stShOffAirbSide_C "#SSD Abstellpfade für Airbag Seitenaufprall aktiv" VALUE 0xC84E8 Kw_Wu32 4294967295.00 OneToOne 0.00 4294967295.00 FORMAT "%13.2" /end CHARACTERISTIC
/begin CHARACTERISTIC CoEng_stShOffCycSigChk_C "Abstellpfad für Fehler bei zyklischem Signaturcheck" VALUE 0xC84EC Kw_Wu32 4294967295.00 OneToOne 0.00 4294967295.00 FORMAT "%13.2" /end CHARACTERISTIC
/begin CHARACTERISTIC CoEng_stShOffDblCtl_C "#SSD Abstellpfade für unzulässigen Hochdruck-Reglerbetrieb (nur 2-Reglerkonzept)" VALUE 0xC84F0 Kw_Wu32 4294967295.00 OneToOne 0.00 4294967295.00 FORMAT "%13.2" /end CHARACTERISTIC
/begin CHARACTERISTIC CoEng_stShOffDiaReqFI_C "#SSD Abstellantwort von Diagnose-Schnittstelle fuer Kraftstoffzusatz" VALUE 0xC84F4 Kw_Wu32 4294967295.00 OneToOne 0.00 4294967295.00 FORMAT "%13.2" /end CHARACTERISTIC
/begin CHARACTERISTIC CoEng_stShOffExtReq_C "#SSD Abstellpfade bei externer Anforderung" VALUE 0xC8570 Kw_Wu32 4294967295.00 OneToOne 0.00 4294967295.00 FORMAT "%13.2" /end CHARACTERISTIC
/begin CHARACTERISTIC CoEng_stShOffFWOscDet_C "#SSD Abschaltpfad für Schwungscheibenschwingung (-Schwungradschwingung)" VALUE 0xC84F8 Kw_Wu32 4294967295.00 OneToOne 0.00 4294967295.00 FORMAT "%13.2" /end CHARACTERISTIC
/begin CHARACTERISTIC CoEng_stShOffInit_C "#SSD Abstellpfade, die nach der Initialisierung im Eingriff sind" VALUE 0xC84FC Kw_Wu32 4294967295.00 OneToOne 0.00 4294967295.00 FORMAT "%13.2" /end CHARACTERISTIC
/begin CHARACTERISTIC CoEng_stShOffInjMon_C "#SSD Abstellpfade für mehrfache Injektorlastabfälle" VALUE 0xC8500 Kw_Wu32 4294967295.00 OneToOne 0.00 4294967295.00 FORMAT "%13.2" /end CHARACTERISTIC
/begin CHARACTERISTIC CoEng_stShOffInjShCir_C "#SSD Abstellpfade bei Injektorkurzschluss" VALUE 0xC8504 Kw_Wu32 4294967295.00 OneToOne 0.00 4294967295.00 FORMAT "%13.2" /end CHARACTERISTIC
/begin CHARACTERISTIC CoEng_stShOffIRevSys1_C "#SSD Abstellpfade für irreversible Systemfehler 1" VALUE 0xC8508 Kw_Wu32 4294967295.00 OneToOne 0.00 4294967295.00 FORMAT "%13.2" /end CHARACTERISTIC
/begin CHARACTERISTIC CoEng_stShOffIRevSys2_C "#SSD Abstellpfade für irreversible Systemfehler 2" VALUE 0xC850C Kw_Wu32 4294967295.00 OneToOne 0.00 4294967295.00 FORMAT "%13.2" /end CHARACTERISTIC
/begin CHARACTERISTIC CoEng_stShOffIRevVeh_C "#SSD Abstellpfade für irreversible Fahrzeugfehler" VALUE 0xC8510 Kw_Wu32 4294967295.00 OneToOne 0.00 4294967295.00 FORMAT "%13.2" /end CHARACTERISTIC
/begin CHARACTERISTIC CoEng_stShOffIrrCmb_C "#SSD Abstellpfade bei irregulärer Verbrennung" VALUE 0xC8514 Kw_Wu32 4294967295.00 OneToOne 0.00 4294967295.00 FORMAT "%13.2" /end CHARACTERISTIC
/begin CHARACTERISTIC CoEng_stShOffOvrSpd_C "#SSD Abstellpfade aufgrund Überdrehzahl" VALUE 0xC8518 Kw_Wu32 4294967295.00 OneToOne 0.00 4294967295.00 FORMAT "%13.2" /end CHARACTERISTIC
/begin CHARACTERISTIC CoEng_stShOffPresMin_C "#SSD Abstellpfade bei Mindestraildruck unteschritten" VALUE 0xC851C Kw_Wu32 4294967295.00 OneToOne 0.00 4294967295.00 FORMAT "%13.2" /end CHARACTERISTIC
/begin CHARACTERISTIC CoEng_stShOffRevSys1_C "#SSD Abstellpfade für reversible Systemfehler 1" VALUE 0xC8520 Kw_Wu32 4294967295.00 OneToOne 0.00 4294967295.00 FORMAT "%13.2" /end CHARACTERISTIC
/begin CHARACTERISTIC CoEng_stShOffRevSys2_C "#SSD Abstellpfade für reversible Systemfehler 2" VALUE 0xC8524 Kw_Wu32 4294967295.00 OneToOne 0.00 4294967295.00 FORMAT "%13.2" /end CHARACTERISTIC
/begin CHARACTERISTIC CoEng_stShOffRevVeh_C "#SSD Abstellpfade für reversible Fahrzeugfehler" VALUE 0xC8528 Kw_Wu32 4294967295.00 OneToOne 0.00 4294967295.00 FORMAT "%13.2" /end CHARACTERISTIC
/begin CHARACTERISTIC CoEng_stShOffRlOvrBar_C "#SSD Abstellpfade für Überrollbügel aktiv" VALUE 0xC852C Kw_Wu32 4294967295.00 OneToOne 0.00 4294967295.00 FORMAT "%13.2" /end CHARACTERISTIC
/begin CHARACTERISTIC CoEng_stShOffSV_C "#SSD Abstellpfade aufgrund dauerbestromtem Magnetventil" VALUE 0xC8530 Kw_Wu32 4294967295.00 OneToOne 0.00 4294967295.00 FORMAT "%13.2" /end CHARACTERISTIC
/begin CHARACTERISTIC CoEng_stShOffTstSel_C "#SSD Auswahl der möglichen Abstelltests (Bit 0: ESD/PSP, 1:PCV)" VALUE 0xC8574 Kw_Wu16 65535.00 OneToOne 0.00 65535.00 FORMAT "%8.2" /end CHARACTERISTIC
/begin CHARACTERISTIC CoEng_stSoftShOffAR_C "#SSD Abschaltanforderung im Nachlauf für Komfortabstellung" VALUE 0xC8578 Kw_Wu32 4294967295.00 OneToOne 0.00 4294967295.00 FORMAT "%13.2" /end CHARACTERISTIC
/begin CHARACTERISTIC CoEng_stSubsRgnMsk_C "Maske für Umschaltung auf Ersatzkennfeld" VALUE 0xC84CC Kw_Wu32 4294967295.00 OneToOne 0.00 4294967295.00 FORMAT "%13.2" /end CHARACTERISTIC
/begin CHARACTERISTIC CoEng_tiDlyT15_C "#SSD Zeit für Fehlerausblendung nach Klemme15 Ein (Abwarten der Init-Zeit anderer Steuergeräte)" VALUE 0xC8558 Kw_Wu16 5000.000 Time_ms 0.00 5000.000 FORMAT "%8.3" EXTENDED_LIMITS 0.00 655350.0 /end CHARACTERISTIC
/begin CHARACTERISTIC CoEng_tiMinAftRun_C "#SSD minimale Nachlaufzeit" VALUE 0xC826C Kw_Wu32 42949672950.0 Time_ms 0.00 42949672950.0 FORMAT "%13.1" /end CHARACTERISTIC
/begin CHARACTERISTIC CoEng_tiMRlyShutOffDel_C "delaytime for afterrun" VALUE 0xC8270 Kw_Wu16 655350.0 Time_ms 0.00 655350.0 FORMAT "%8.1" /end CHARACTERISTIC
/begin CHARACTERISTIC CoEng_tiNrml2Strt_C "Entprellzeit für Zustandsübergang von NORMAL nach START" VALUE 0xC85CE Kw_Wu16 655350.0 Time_ms 0.00 655350.0 FORMAT "%8.1" /end CHARACTERISTIC
/begin CHARACTERISTIC CoEng_tiOvrRunCoordDebPos_C "#SSD Entprellzeit für den Übergang ""Kein Schub -> Schub"" im Schubkoordinator" VALUE 0xC8550 Kw_Wu16 1000.000 Time_ms 0.00 1000.000 FORMAT "%8.3" EXTENDED_LIMITS 0.00 655350.0 /end CHARACTERISTIC
/begin CHARACTERISTIC CoEng_tiRepOvrFul_C "Sperrzeit für Overfueling timer" VALUE 0xC8694 Kw_Wu32 21474836.4700 Time_s 0.00 21474836.4700 FORMAT "%13.4" EXTENDED_LIMITS 0.00 42949672.9500 /end CHARACTERISTIC
/begin CHARACTERISTIC CoEng_tiRmpStrtDfl_C "Default Wartezeit nach Schuberkennung bis Rampe startet" VALUE 0xC85D8 Kw_Wu16 655350.0 Time_ms 0.00 655350.0 FORMAT "%8.1" /end CHARACTERISTIC
/begin CHARACTERISTIC CoEng_tiRmpStrt_CUR "Wartezeit nach Schuberkennung bei Grip bis Rampe startet" CURVE 0xC85DA Kl_Xs16_Ws16 10000.00 Time_ms 0.00 10000.00 FORMAT "%8.2" EXTENDED_LIMITS -327680.0 327670.0
 /begin AXIS_DESCR STD_AXIS DrvTrn_rTransDT TransR 7 0.00 10.00000 FORMAT "%8.5" EXTENDED_LIMITS -327.6800 327.6700 DEPOSIT ABSOLUTE /end AXIS_DESCR
/end CHARACTERISTIC
/begin CHARACTERISTIC CoEng_tiShOffTstFlSys_C "Zeit bis Ansteuerdauer == 0 beim Test des niederdruckseitigen Abstellpfades" VALUE 0xC857C Kw_Wu16 655350.0 Time_ms 0.00 655350.0 FORMAT "%8.1" /end CHARACTERISTIC
/begin CHARACTERISTIC CoEng_tiSoftShOff_CUR "#SSD Curve to calculate time delay for soft shutoff" CURVE 0xC857E Kl_Xs16_Ws16 600.0000 Time_ms 0.00 600.0000 FORMAT "%8.4" EXTENDED_LIMITS -327680.0 327670.0
 /begin AXIS_DESCR STD_AXIS Eng_nAvrg EngN 16 0.00 6000.000 FORMAT "%8.3" EXTENDED_LIMITS -32768.00 32767.00 DEPOSIT ABSOLUTE /end AXIS_DESCR
/end CHARACTERISTIC
/begin CHARACTERISTIC CoEng_tiSwtOffDfl_C "Default Wartezeit nach Schuberkennung bis Abschaltung" VALUE 0xC85F8 Kw_Wu16 655350.0 Time_ms 0.00 655350.0 FORMAT "%8.1" /end CHARACTERISTIC
/begin CHARACTERISTIC CoEng_tiSwtOff_CUR "Wartezeit nach Schuberkennung bei Grip bis Abschaltung" CURVE 0xC85FA Kl_Xs16_Ws16 10000.00 Time_ms 0.00 10000.00 FORMAT "%8.2" EXTENDED_LIMITS -327680.0 327670.0
 /begin AXIS_DESCR STD_AXIS DrvTrn_rTransDT TransR 7 0.00 10.00000 FORMAT "%8.5" EXTENDED_LIMITS -327.6800 327.6700 DEPOSIT ABSOLUTE /end AXIS_DESCR
/end CHARACTERISTIC
/begin CHARACTERISTIC CoEng_tiThresFuncPref_C "Schwelle für Betriebszeit Motor ein" VALUE 0xC8554 Kw_Wu32 100000.000000 TimeEngOn 0.00 100000.000000 FORMAT "%13.6" EXTENDED_LIMITS 0.00 4294967295.00 /end CHARACTERISTIC
/begin CHARACTERISTIC CoEng_tiTstMax_C "Maximale Zeit zwischen zwei Testanforderungen" VALUE 0xC8954 Kw_Wu16 655350.0 Time_ms 0.00 655350.0 FORMAT "%8.1" /end CHARACTERISTIC
/begin CHARACTERISTIC CoEng_tiWakeUp_C "delaytime for afterrun caused hidden pre glow" VALUE 0xC8274 Kw_Wu32 42949672950.0 Time_ms 0.00 42949672950.0 FORMAT "%13.1" /end CHARACTERISTIC
/begin CHARACTERISTIC CoEng_trqInrSetLim_CUR "Sollwert des inneren Moments wenn Schub erkannt wurde und die Schubüberwachung aktiv ist" CURVE 0xC8618 Kl_Xs16_Ws16 3276.700 Trq 0.00 3276.700 FORMAT "%8.3" EXTENDED_LIMITS -3276.800 3276.700
 /begin AXIS_DESCR STD_AXIS CoEng_tiOvRMon_mp Time_ms 3 0.00 327670.0 FORMAT "%8.1" EXTENDED_LIMITS -327680.0 327670.0 DEPOSIT ABSOLUTE /end AXIS_DESCR
/end CHARACTERISTIC
/begin CHARACTERISTIC CoEng_trqLimErr1_CUR "Kennlinie für Begrenzungsmoment abhängig von der Drehzahl im Fehlerfall" CURVE 0xC8698 Kl_Xs16_Ws16 1000.000 Trq 0.00 1000.000 FORMAT "%8.3" EXTENDED_LIMITS -3276.800 3276.700
 /begin AXIS_DESCR STD_AXIS Eng_nAvrg EngN 10 0.00 6000.000 FORMAT "%8.3" EXTENDED_LIMITS -32768.00 32767.00 DEPOSIT ABSOLUTE /end AXIS_DESCR
/end CHARACTERISTIC
/begin CHARACTERISTIC CoEng_trqLimErr2_CUR "Kennlinie für Begrenzungsmoment abhängig von der Drehzahl im Fehlerfall 2" CURVE 0xC86C2 Kl_Xs16_Ws16 1000.000 Trq 0.00 1000.000 FORMAT "%8.3" EXTENDED_LIMITS -3276.800 3276.700
 /begin AXIS_DESCR STD_AXIS Eng_nAvrg EngN 10 0.00 6000.000 FORMAT "%8.3" EXTENDED_LIMITS -32768.00 32767.00 DEPOSIT ABSOLUTE /end AXIS_DESCR
/end CHARACTERISTIC
/begin CHARACTERISTIC CoEng_trqLimErr3_CUR "Kennlinie für Begrenzungsmoment abhängig von der Drehzahl im Fehlerfall 3" CURVE 0xC86EC Kl_Xs16_Ws16 1000.000 Trq 0.00 1000.000 FORMAT "%8.3" EXTENDED_LIMITS -3276.800 3276.700
 /begin AXIS_DESCR STD_AXIS Eng_nAvrg EngN 10 0.00 6000.000 FORMAT "%8.3" EXTENDED_LIMITS -32768.00 32767.00 DEPOSIT ABSOLUTE /end AXIS_DESCR
/end CHARACTERISTIC
/begin CHARACTERISTIC CoEng_trqLimErr4_CUR "Kennlinie für Begrenzungsmoment abhängig von der Drehzahl im Fehlerfall 4" CURVE 0xC8716 Kl_Xs16_Ws16 1000.000 Trq 0.00 1000.000 FORMAT "%8.3" EXTENDED_LIMITS -3276.800 3276.700
 /begin AXIS_DESCR STD_AXIS Eng_nAvrg EngN 10 0.00 6000.000 FORMAT "%8.3" EXTENDED_LIMITS -32768.00 32767.00 DEPOSIT ABSOLUTE /end AXIS_DESCR
/end CHARACTERISTIC
/begin CHARACTERISTIC CoEng_trqLimErr_CUR "Kennlinie für das Begrenzungsmoment bei Systemfehlern" CURVE 0xC8740 Kl_Xs16_Ws16 1000.000 Trq 0.00 1000.000 FORMAT "%8.3" EXTENDED_LIMITS -3276.800 3276.700
 /begin AXIS_DESCR STD_AXIS Eng_nAvrg EngN 10 0.00 6000.000 FORMAT "%8.3" EXTENDED_LIMITS -32768.00 32767.00 DEPOSIT ABSOLUTE /end AXIS_DESCR
/end CHARACTERISTIC
/begin CHARACTERISTIC CoEng_trqLimPDiff1_CUR "Begrenzunsmoment aufgrund abasgegendruck" CURVE 0xC876A Kl_Xs16_Ws16 1500.000 Trq -500.0000 1000.000 FORMAT "%8.3" EXTENDED_LIMITS -3276.800 3276.700
 /begin AXIS_DESCR STD_AXIS PFlt_pDiff Pres_hPa 8 0.00 5000.000 FORMAT "%8.3" EXTENDED_LIMITS -32768.00 32767.00 DEPOSIT ABSOLUTE /end AXIS_DESCR
/end CHARACTERISTIC
/begin CHARACTERISTIC CoEng_trqLimPDiffNOffs_CUR "" CURVE 0xC878C Kl_Xs16_Ws16 1000.000 Trq 0.00 1000.000 FORMAT "%8.3" EXTENDED_LIMITS -3276.800 3276.700
 /begin AXIS_DESCR STD_AXIS Eng_nAvrg EngN 16 0.00 6000.000 FORMAT "%8.3" EXTENDED_LIMITS -32768.00 32767.00 DEPOSIT ABSOLUTE /end AXIS_DESCR
/end CHARACTERISTIC
/begin CHARACTERISTIC CoEng_trqLimPDiff_MAP "Limit für differentialdruck des Partikelfilters" MAP 0xC87CE Kf_Xs16_Ys16_Ws16 1500.000 Trq -500.0000 1000.000 FORMAT "%8.3" EXTENDED_LIMITS -3276.800 3276.700
 /begin AXIS_DESCR STD_AXIS CoEng_pDiffPFltPrdc_mp Pres_hPa 16 0.00 3500.000 FORMAT "%8.3" EXTENDED_LIMITS -32768.00 32767.00 DEPOSIT ABSOLUTE /end AXIS_DESCR
 /begin AXIS_DESCR STD_AXIS Eng_nAvrg EngN 8 0.00 6000.000 FORMAT "%8.3" EXTENDED_LIMITS -32768.00 32767.00 DEPOSIT ABSOLUTE /end AXIS_DESCR
/end CHARACTERISTIC
/begin CHARACTERISTIC CoEng_trqOffs_C "Offset auf Begrenzungsmoment, um Arbeitsbereich f. ARDsr zu schaffen" VALUE 0xC8626 Kw_Ws16 100.0000 Trq 0.00 100.0000 FORMAT "%8.4" EXTENDED_LIMITS -3276.800 3276.700 /end CHARACTERISTIC
/begin CHARACTERISTIC CoEng_trqOvrFulMax_C "oberer Wert für Overfueling Rampe" VALUE 0xC8902 Kw_Ws16 1000.000 Trq 0.00 1000.000 FORMAT "%8.3" EXTENDED_LIMITS -3276.800 3276.700 /end CHARACTERISTIC
/begin CHARACTERISTIC CoEng_trqOvrFulMin_C "unterer Wert für Overfueling Rampe" VALUE 0xC8904 Kw_Ws16 1000.000 Trq 0.00 1000.000 FORMAT "%8.3" EXTENDED_LIMITS -3276.800 3276.700 /end CHARACTERISTIC
/begin CHARACTERISTIC CoEng_trqOvrRunThres_C "#SSD Momentenschwelle zur Schuberkennung" VALUE 0xC8628 Kw_Ws16 10.00000 Trq 0.00 10.00000 FORMAT "%8.5" EXTENDED_LIMITS -3276.800 3276.700 /end CHARACTERISTIC
/begin CHARACTERISTIC CoEng_trqSlpLim_Vector "#SSD Bypass Label for CoEng_trqSlpLim (nicht verändern !)" VALUE 0xC3078 Kw_Wu8 255.0 OneToOne 0.00 255.0 FORMAT "%5.1" /end CHARACTERISTIC
/begin CHARACTERISTIC CoEng_trqSlpLim_Channel "#SSD Bypass Label für CoEng_trqSlpLim (nicht verändern !)" VALUE 0xC3079 Kw_Wu8 255.0 OneToOne 0.00 255.0 FORMAT "%5.1" /end CHARACTERISTIC
/begin CHARACTERISTIC CoEng_tShOffTstMin_C "minimale Wassertemperaturschwelle für Abstelltests" VALUE 0xC85C8 Kw_Ws16 950.000 Temp_Cels -50.140 899.860 FORMAT "%8.3" EXTENDED_LIMITS -3549.940 3003.560 /end CHARACTERISTIC
/begin CHARACTERISTIC CoEng_uHighBattPwrStgHysHi_C "Oberen schwelle der Hysterese für Höhere Grenze der Batteriespannung" VALUE 0xC855A Kw_Ws16 20000.00 Volt_Batt 0.00 20000.00 FORMAT "%8.2" EXTENDED_LIMITS -640625.6 640606.1 /end CHARACTERISTIC
/begin CHARACTERISTIC CoEng_uHighBattPwrStgHysLo_C "Unteren schwelle der Hysterese für Höhere Grenze der Batteriespannung" VALUE 0xC855C Kw_Ws16 20000.00 Volt_Batt 0.00 20000.00 FORMAT "%8.2" EXTENDED_LIMITS -640625.6 640606.1 /end CHARACTERISTIC
/begin CHARACTERISTIC CoEng_uLowBattPwrStgHysHi_C "Oberen schwelle der Hysterese für Untere Grenze der Batteriespannung" VALUE 0xC855E Kw_Ws16 15992.18 Volt_Batt 0.00 15992.18 FORMAT "%8.2" EXTENDED_LIMITS -640625.6 640606.1 /end CHARACTERISTIC
/begin CHARACTERISTIC CoEng_uLowBattPwrStgHysLo_C "Unteren schwelle der Hysterese für Untere Grenze der Batteriespannung" VALUE 0xC8560 Kw_Ws16 15992.18 Volt_Batt 0.00 15992.18 FORMAT "%8.2" EXTENDED_LIMITS -640625.6 640606.1 /end CHARACTERISTIC
/begin CHARACTERISTIC CoEng_vOvrFulMin_C "untere Hysteresegrenze für Overfueling Fahrgeschwindigkeit" VALUE 0xC8906 Kw_Ws16 300.0000 Vel 0.00 300.0000 FORMAT "%8.4" EXTENDED_LIMITS -327.6800 327.6700 /end CHARACTERISTIC
/begin CHARACTERISTIC CoEng_vOvrFulMax_C "obere Hysteresegrenze für Overfueling Fahrgeschwindigkeit" VALUE 0xC8908 Kw_Ws16 300.0000 Vel 0.00 300.0000 FORMAT "%8.4" EXTENDED_LIMITS -327.6800 327.6700 /end CHARACTERISTIC
/begin CHARACTERISTIC CoEng_stvOvrFulLow_C "Status für Overfueling Fahrgeschwindigkeit Hysterese aus" VALUE 0xC890A Kw_Ws16 65535.00 OneToOne -32768.00 32767.00 FORMAT "%8.2" READ_ONLY /end CHARACTERISTIC
/begin CHARACTERISTIC CoEng_stvOvrFulHigh_C "Status für Overfueling Fahrgeschwindigkeit Hysterese ein" VALUE 0xC890C Kw_Ws16 65535.00 OneToOne -32768.00 32767.00 FORMAT "%8.2" READ_ONLY /end CHARACTERISTIC
/begin CHARACTERISTIC CoEng_vShOffTstMin_C "minimale Fahrgeschwindigkeits-Schwelle für Abstelltests" VALUE 0xC85CA Kw_Ws16 327.6700 Vel 0.00 327.6700 FORMAT "%8.4" EXTENDED_LIMITS -327.6800 327.6700 /end CHARACTERISTIC
/begin CHARACTERISTIC CoEng_vSoftShOffMax_C "vehicle speed limit for soft shutoff" VALUE 0xC85C0 Kw_Ws16 327.6700 Vel 0.00 327.6700 FORMAT "%8.4" EXTENDED_LIMITS -327.6800 327.6700 /end CHARACTERISTIC
/begin CHARACTERISTIC ConvCD_DebPlaDef_C "Zählerwert zur Defektentprellung (PLA)" VALUE 0xC8956 Kw_Wu16 65535.00 OneToOne 0.00 65535.00 FORMAT "%8.2" /end CHARACTERISTIC
/begin CHARACTERISTIC ConvCD_DebPlaOk_C "Zählerwert zur Heilungsentprellung (PLA)" VALUE 0xC8958 Kw_Wu16 65535.00 OneToOne 0.00 65535.00 FORMAT "%8.2" /end CHARACTERISTIC
/begin CHARACTERISTIC ConvCD_tiDebPos_C "Entprellzeit für pos. Flanke des Kupplungssignals" VALUE 0xC895A Kw_Wu16 2000.000 TimeDeb 0.00 2000.000 FORMAT "%8.3" EXTENDED_LIMITS 0.00 655350.0 /end CHARACTERISTIC
/begin CHARACTERISTIC ConvCD_tiDebNeg_C "Entprellzeit für neg. Flanke des Kupplungssignals." VALUE 0xC895C Kw_Wu16 2000.000 TimeDeb 0.00 2000.000 FORMAT "%8.3" EXTENDED_LIMITS 0.00 655350.0 /end CHARACTERISTIC
/begin CHARACTERISTIC ConvCD_DebSigDef_C "Entprellzeit bis CAN-Botschaftsfehler defekt" VALUE 0xC895E Kw_Wu16 655350.0 Time_ms 0.00 655350.0 FORMAT "%8.1" /end CHARACTERISTIC
/begin CHARACTERISTIC ConvCD_DebSigOk_C "Entprellzeit bis CAN-Botschaftsfehler geheilt" VALUE 0xC8960 Kw_Wu16 655350.0 Time_ms 0.00 655350.0 FORMAT "%8.1" /end CHARACTERISTIC
/begin CHARACTERISTIC ConvCD_nNoGearShftDet_C "Grenzwert unter dem die Gangerkennung für die Plausibilitätsprüfung abgeschaltet werden muss" VALUE 0xC8962 Kw_Ws16 6000.000 EngN 0.00 6000.000 FORMAT "%8.3" EXTENDED_LIMITS -32768.00 32767.00 /end CHARACTERISTIC
/begin CHARACTERISTIC ConvCD_numDioIn_C "#SSD Applikationsparameter für den Pin des Kupplungssignals" VALUE 0xC8964 Kw_Wu8 14.0000000000 NumPinDioIn 0.00 14.0000000000 FORMAT "%13.10" /end CHARACTERISTIC
/begin CHARACTERISTIC ConvCD_numStepDef_C "Zählschrittweite für Aufwärtszählen zur Defektentprellung" VALUE 0xC8965 Kw_Wu8 3.000 OneToOne 0.00 3.000 FORMAT "%5.3" EXTENDED_LIMITS 0.00 255.0 /end CHARACTERISTIC
/begin CHARACTERISTIC ConvCD_numStepOK_C "Zählschrittweite für Abwärtszählen zur Heilungsentprellung" VALUE 0xC8966 Kw_Wu8 3.000 OneToOne 0.00 3.000 FORMAT "%5.3" EXTENDED_LIMITS 0.00 255.0 /end CHARACTERISTIC
/begin CHARACTERISTIC ConvCD_stDflVal_C "Kupplungssignal Vorgabewert" VALUE 0xC8967 Kw_Wu8 1.000 OneToOne 0.00 1.000 FORMAT "%5.3" EXTENDED_LIMITS 0.00 255.0 /end CHARACTERISTIC
/begin CHARACTERISTIC ConvCD_stGripCtlAST_C "Vorgabewert für autom. Schaltgetriebe bei fehlendem Kraftschluß (""rutschende Kupplung"")" VALUE 0xC8968 Kw_Wu8 1.000 OneToOne 0.00 1.000 FORMAT "%5.3" EXTENDED_LIMITS 0.00 255.0 /end CHARACTERISTIC
/begin CHARACTERISTIC ConvCD_swtInv_C "Schalter zum invertieren  des Kupplungsignals (0=nichtinvertiert,1=invertiert), Einfluss auf Digitaleingang und CAN" VALUE 0xC8969 Kw_Wu8 1.000 OneToOne 0.00 1.000 FORMAT "%5.3" EXTENDED_LIMITS 0.00 255.0 /end CHARACTERISTIC
/begin CHARACTERISTIC ConvCD_swtSigVal_C "Schalter für Signalquellenauswahl (0=HW-Eingang, 1=CAN)" VALUE 0xC896A Kw_Wu8 2.000 OneToOne 0.00 2.000 FORMAT "%5.3" EXTENDED_LIMITS 0.00 255.0 /end CHARACTERISTIC
/begin CHARACTERISTIC ConvCD_tiGearShft_C "Zeit für Entprellung zum Gangwechsel Erkennung." VALUE 0xC896C Kw_Wu16 655350.0 Time_ms 0.00 655350.0 FORMAT "%8.1" /end CHARACTERISTIC
/begin CHARACTERISTIC ConvCD_vNoGearShftDet_C "Grenzwert unter dem die Gangerkennung für die Plausibilitätsprüfung abgeschaltet werden muss" VALUE 0xC896E Kw_Ws16 300.0000 Vel 0.00 300.0000 FORMAT "%8.4" EXTENDED_LIMITS -327.6800 327.6700 /end CHARACTERISTIC
/begin CHARACTERISTIC CoVeh_dnLI_C "unterer Schwellenwert der Motordrehzahl die zur Leistung/Moment Umrechnung verwendet wird" VALUE 0xC8970 Kw_Ws16 1000.000 EngN 0.00 1000.000 FORMAT "%8.3" EXTENDED_LIMITS -32768.00 32767.00 /end CHARACTERISTIC
/begin CHARACTERISTIC CoVeh_dtrqLimDwn_C "Rampe für Systemfehler Drehmoment" VALUE 0xC8972 Kw_Ws16 327660.0 dTrqPrp_20ms 10.00000 327670.0 FORMAT "%8.1" EXTENDED_LIMITS -327680.0 327670.0 /end CHARACTERISTIC
/begin CHARACTERISTIC CoVeh_dtrqLimUp_C "Rampe für Heilung Systemfehler Drehmoment" VALUE 0xC8974 Kw_Ws16 327660.0 dTrqPrp_20ms 10.00000 327670.0 FORMAT "%8.1" EXTENDED_LIMITS -327680.0 327670.0 /end CHARACTERISTIC
/begin CHARACTERISTIC CoVeh_trqLim_CUR "Begrenzungswert bei Systemfehler Drehmoment" CURVE 0xC8976 Kl_Xs16_Ws16 11000.00 TrqPrp -5000.000 6000.000 FORMAT "%8.3" EXTENDED_LIMITS -6553.600 6553.400
 /begin AXIS_DESCR STD_AXIS Eng_nAvrg EngN 10 0.00 6000.000 FORMAT "%8.3" EXTENDED_LIMITS -32768.00 32767.00 DEPOSIT ABSOLUTE /end AXIS_DESCR
/end CHARACTERISTIC
/begin CHARACTERISTIC CoVeh_trqPrpDes_Vector "#SSD Bypass-Label für CoVeh_trqPrpDes (Nicht verstellen!)" VALUE 0xC307A Kw_Wu8 255.0 OneToOne 0.00 255.0 FORMAT "%5.1" /end CHARACTERISTIC
/begin CHARACTERISTIC CoVeh_trqPrpDes_Channel "#SSD Bypass label, nicht editieren" VALUE 0xC307B Kw_Wu8 255.0 OneToOne 0.00 255.0 FORMAT "%5.1" /end CHARACTERISTIC
/begin CHARACTERISTIC CoVeh_trqPrpLead_Vector "#SSD Bypass label, nicht editieren!" VALUE 0xC307C Kw_Wu8 255.0 OneToOne 0.00 255.0 FORMAT "%5.1" /end CHARACTERISTIC
/begin CHARACTERISTIC CoVeh_trqPrpLead_Channel "#SSD Bypass label, nicht editieren!" VALUE 0xC307D Kw_Wu8 255.0 OneToOne 0.00 255.0 FORMAT "%5.1" /end CHARACTERISTIC
/begin CHARACTERISTIC CoVM_amMAX_C "#SSD Grenzwert zur Erkennung der physikalischen Unplausibilität des MSR (DCS) Eingriffs" VALUE 0xC89A0 Kw_Wu16 327675.0 TrqPrpDT 0.00 327675.0 FORMAT "%8.1" /end CHARACTERISTIC
/begin CHARACTERISTIC CoVM_dtrqLeadCorUp_C "Rampe zum Aufbau ASR-Vorhalt" VALUE 0xC89A8 Kw_Wu32 13107199.9969 RmpTrqPrp 0.00 13107199.9969 FORMAT "%13.4" /end CHARACTERISTIC
/begin CHARACTERISTIC CoVM_dtrqLeadCorDwn_C "Rampe zum Abbau ASR-Vorhalt" VALUE 0xC89AC Kw_Wu32 13107199.9969 RmpTrqPrp 0.00 13107199.9969 FORMAT "%13.4" /end CHARACTERISTIC
/begin CHARACTERISTIC CoVM_swtIntvPrio_C "Priorisierung der Fahrdynamikeingriffe über die Getriebeeingriffe (1:keine Begrenzung der Getriebeeingriffe, 0: Begrenzung)" VALUE 0xC89B0 Kw_Wu8 1.000 OneToOne 0.00 1.000 FORMAT "%5.3" EXTENDED_LIMITS 0.00 255.0 /end CHARACTERISTIC
/begin CHARACTERISTIC CoVM_swtPlausChkVal_C "#SSD Konfigurationsschalter MSR-Momentenüberschussintegral (1: ein/ 0:aus)." VALUE 0xC89A2 Kw_Wu8 1.000 OneToOne 0.00 1.000 FORMAT "%5.3" EXTENDED_LIMITS 0.00 255.0 /end CHARACTERISTIC
/begin CHARACTERISTIC CoVM_swtPlausChkType_C "#SSD Softwareschalter Type für CoVM_swtSlipCtlVal_C" VALUE 0xC89A3 Kw_Wu8 2.000 OneToOne 0.00 2.000 FORMAT "%5.3" EXTENDED_LIMITS 0.00 255.0 /end CHARACTERISTIC
/begin CHARACTERISTIC CoVM_swtSlipCtlVal_C "Fahrdynamik-Konfiguration (0: ASR aus & MSR aus; 1: ASR an & MSR aus;  2: ASR aus & MSR an;  3: ASR an & MSR an)" VALUE 0xC89A4 Kw_Wu8 3.000 OneToOne 0.00 3.000 FORMAT "%5.3" EXTENDED_LIMITS 0.00 255.0 /end CHARACTERISTIC
/begin CHARACTERISTIC CoVM_swtSlipCtlType_C "Softwareschalter Type für CoVM_swtSlipCtlVal_C" VALUE 0xC89A5 Kw_Wu8 2.000 OneToOne 0.00 2.000 FORMAT "%5.3" EXTENDED_LIMITS 0.00 255.0 /end CHARACTERISTIC
/begin CHARACTERISTIC CoVM_swttrqDVCH_C "Schalter zur Korrektur von CoVM_trqDVCH mit Gearbx_trqFrc (1 = Korrektur, 0 = keine Korrektur)" VALUE 0xC89B1 Kw_Wu8 255.0 OneToOne 0.00 255.0 FORMAT "%5.1" /end CHARACTERISTIC
/begin CHARACTERISTIC CoVM_tiTrqRedMax_C "Zeitschwelle für ""langen"" ASR-Eingriff" VALUE 0xC89B2 Kw_Wu16 655.3500 Time_s 0.00 655.3500 FORMAT "%8.4" /end CHARACTERISTIC
/begin CHARACTERISTIC CoVM_trqDecMax_C "#SSD Maximum replacement value for torque decrement" VALUE 0xC89B4 Kw_Ws16 1000.000 TrqPrp -500.0000 500.0000 FORMAT "%8.4" EXTENDED_LIMITS -6553.600 6553.400 /end CHARACTERISTIC
/begin CHARACTERISTIC CoVM_dtrqLimUpDec_C "torque ramp up at decrease in torque" VALUE 0xC89B8 Kw_Wu32 13107199.9969 RmpTrqPrp 0.00 13107199.9969 FORMAT "%13.4" /end CHARACTERISTIC
/begin CHARACTERISTIC CoVM_dtrqLimDwnDec_C "torque ramp down at decrease in torque" VALUE 0xC89BC Kw_Wu32 13107199.9969 RmpTrqPrp 0.00 13107199.9969 FORMAT "%13.4" /end CHARACTERISTIC
/begin CHARACTERISTIC CoVM_trqDSCMax_C "Maximale Momentenerhöhung vom DSC Steuergerät" VALUE 0xC89C0 Kw_Ws16 1500.000 Trq -500.0000 1000.000 FORMAT "%8.3" EXTENDED_LIMITS -3276.800 3276.700 /end CHARACTERISTIC
/begin CHARACTERISTIC CoVM_trqIncMin_C "#SSD Replacement value for torque increment" VALUE 0xC89C2 Kw_Ws16 1000.000 TrqPrp -500.0000 500.0000 FORMAT "%8.4" EXTENDED_LIMITS -6553.600 6553.400 /end CHARACTERISTIC
/begin CHARACTERISTIC CoVM_dtrqLimUpInc_C "torque ramp up for increase in torque" VALUE 0xC89C4 Kw_Wu32 13107199.9969 RmpTrqPrp 0.00 13107199.9969 FORMAT "%13.4" /end CHARACTERISTIC
/begin CHARACTERISTIC CoVM_dtrqLimDwnInc_C "torque ramp down increase in torque" VALUE 0xC89C8 Kw_Wu32 13107199.9969 RmpTrqPrp 0.00 13107199.9969 FORMAT "%13.4" /end CHARACTERISTIC
/begin CHARACTERISTIC CpBVlv_numGear_C "Gang schwellwert" VALUE 0xC89CC Kw_Ws8 7.000 OneToOne -1.000 6.000 FORMAT "%5.3" EXTENDED_LIMITS -128.0 127.0 /end CHARACTERISTIC
/begin CHARACTERISTIC CpBVlv_qClose_MAP "MAP unterer schwellwert Kraftstoffmenge" MAP 0xC89CE Kf_Xs16_Ys16_Ws16 327.6700 InjMass 0.00 327.6700 FORMAT "%8.4" EXTENDED_LIMITS -327.6800 327.6700
 /begin AXIS_DESCR STD_AXIS Eng_nAvrg EngN 12 0.00 6000.000 FORMAT "%8.3" EXTENDED_LIMITS -32768.00 32767.00 DEPOSIT ABSOLUTE /end AXIS_DESCR
 /begin AXIS_DESCR STD_AXIS APSCD_pVal Pres_hPa 6 0.00 3500.000 FORMAT "%8.3" EXTENDED_LIMITS -32768.00 32767.00 DEPOSIT ABSOLUTE /end AXIS_DESCR
/end CHARACTERISTIC
/begin CHARACTERISTIC CpBVlv_qOpn_MAP "MAP oberer schwellwert Kraftstoffmenge" MAP 0xC8A86 Kf_Xs16_Ys16_Ws16 327.6700 InjMass 0.00 327.6700 FORMAT "%8.4" EXTENDED_LIMITS -327.6800 327.6700
 /begin AXIS_DESCR STD_AXIS Eng_nAvrg EngN 12 0.00 6000.000 FORMAT "%8.3" EXTENDED_LIMITS -32768.00 32767.00 DEPOSIT ABSOLUTE /end AXIS_DESCR
 /begin AXIS_DESCR STD_AXIS APSCD_pVal Pres_hPa 6 0.00 3500.000 FORMAT "%8.3" EXTENDED_LIMITS -32768.00 32767.00 DEPOSIT ABSOLUTE /end AXIS_DESCR
/end CHARACTERISTIC
/begin CHARACTERISTIC CpBVlv_stClose_C "Kompressor-Bypassventil geschlossen" VALUE 0xC8B3E Kw_Wu8 1.000 OneToOne 0.00 1.000 FORMAT "%5.3" EXTENDED_LIMITS 0.00 255.0 /end CHARACTERISTIC
/begin CHARACTERISTIC CpBVlv_stOpn_C "Kompressor-Bypassventil offen" VALUE 0xC8B3F Kw_Wu8 1.000 OneToOne 0.00 1.000 FORMAT "%5.3" EXTENDED_LIMITS 0.00 255.0 /end CHARACTERISTIC
/begin CHARACTERISTIC CpBVlv_swtQDesVal_C "Auswahlschalter Mengenreferenz (0: derzeitige Menge, 1: Rohmenge)" VALUE 0xC8B40 Kw_Wu8 1.000 OneToOne 0.00 1.000 FORMAT "%5.3" EXTENDED_LIMITS 0.00 255.0 /end CHARACTERISTIC
/begin CHARACTERISTIC CrCCD_tiDebMaxMFLDef_C "Defektentprellung Togglebittimeout" VALUE 0xC8B42 Kw_Wu16 655350.0 Time_ms 0.00 655350.0 FORMAT "%8.1" /end CHARACTERISTIC
/begin CHARACTERISTIC CrCCD_tiDebMaxMFLOk_C "Heilentprellung Togglebittimeout" VALUE 0xC8B44 Kw_Wu16 655350.0 Time_ms 0.00 655350.0 FORMAT "%8.1" /end CHARACTERISTIC
/begin CHARACTERISTIC CrCCD_tiDebMinMFLDef_C "Defektentprellung Framelänge außerhalb der Toleranz" VALUE 0xC8B46 Kw_Wu16 655350.0 Time_ms 0.00 655350.0 FORMAT "%8.1" /end CHARACTERISTIC
/begin CHARACTERISTIC CrCCD_tiDebMinMFLOk_C "Heilentprellung Framelänge außerhalb der Toleranz" VALUE 0xC8B48 Kw_Wu16 655350.0 Time_ms 0.00 655350.0 FORMAT "%8.1" /end CHARACTERISTIC
/begin CHARACTERISTIC CrCCD_tiDebNplMFLDef_C "Defektentprellung MFL-Signal nicht plausibel (Biterror)" VALUE 0xC8B4A Kw_Wu16 655350.0 Time_ms 0.00 655350.0 FORMAT "%8.1" /end CHARACTERISTIC
/begin CHARACTERISTIC CrCCD_tiDebNplMFLOk_C "Heilentprellung MFL-Signal nicht plausibel (Biterror)" VALUE 0xC8B4C Kw_Wu16 655350.0 Time_ms 0.00 655350.0 FORMAT "%8.1" /end CHARACTERISTIC
/begin CHARACTERISTIC CrCCD_tiDebSigMFLDef_C "Defektentprellung MFL-Signal Timeout" VALUE 0xC8B4E Kw_Wu16 655350.0 Time_ms 0.00 655350.0 FORMAT "%8.1" /end CHARACTERISTIC
/begin CHARACTERISTIC CrCCD_tiDebSigMFLOk_C "Heilentprellung MFL-Signal Timeout" VALUE 0xC8B50 Kw_Wu16 655350.0 Time_ms 0.00 655350.0 FORMAT "%8.1" /end CHARACTERISTIC
/begin CHARACTERISTIC CrCCD_stMSWModeAdjMax_C "Maximalwert vom Abgleichwert Mainswitch Mode" VALUE 0xC8B52 Kw_Wu8 1.000 OneToOne 0.00 1.000 FORMAT "%5.3" EXTENDED_LIMITS 0.00 255.0 /end CHARACTERISTIC
/begin CHARACTERISTIC CrCCD_stMSWModeAdjMin_C "Minimalwert vom Abgleichwert Mainswitch Mode" VALUE 0xC8B53 Kw_Wu8 1.000 OneToOne 0.00 1.000 FORMAT "%5.3" EXTENDED_LIMITS 0.00 255.0 /end CHARACTERISTIC
/begin CHARACTERISTIC CrCCD_stMSWModeDflt_C "Vorgabewert für Abgleichwert Mainswitch Mode bei fehlgeschlagener EEPROM Kommunikation" VALUE 0xC8B54 Kw_Wu8 1.000 OneToOne 0.00 1.000 FORMAT "%5.3" EXTENDED_LIMITS 0.00 255.0 /end CHARACTERISTIC
/begin CHARACTERISTIC CrCCD_swtDevType_C "SW-Schalter Typ für CrCCD_swtDev" VALUE 0xC8B55 Kw_Wu8 1.000 OneToOne 0.00 1.000 FORMAT "%5.3" EXTENDED_LIMITS 0.00 255.0 /end CHARACTERISTIC
/begin CHARACTERISTIC CrCCD_swtDevVal_C "Datensatzwert für SW-Schalter CrCCD_swtDev, eingebauter FGR-Bedienteiltyp (0: kein bedienteil, 1: TPU, 2: CAN)" VALUE 0xC8B56 Kw_Wu8 2.000 OneToOne 0.00 2.000 FORMAT "%5.3" EXTENDED_LIMITS 0.00 255.0 /end CHARACTERISTIC
/begin CHARACTERISTIC CrCCD_swtMSWType_C "MSW Mode vom EEPROM (1) oder Applikation (0)" VALUE 0xC8B57 Kw_Wu8 1.000 OneToOne 0.00 1.000 FORMAT "%5.3" EXTENDED_LIMITS 0.00 255.0 /end CHARACTERISTIC
/begin CHARACTERISTIC CrCCD_swtMSWVal_C "MSW Mode von der Applikation (1: MSW aktiviert, 0: MSW deaktiviert)" VALUE 0xC8B58 Kw_Wu8 1.000 OneToOne 0.00 1.000 FORMAT "%5.3" EXTENDED_LIMITS 0.00 255.0 /end CHARACTERISTIC
/begin CHARACTERISTIC CrCCD_tiDebSetMn_C "time for SET- detection" VALUE 0xC8B5A Kw_Wu16 1500.000 Time_ms 0.00 1500.000 FORMAT "%8.3" EXTENDED_LIMITS 0.00 655350.0 /end CHARACTERISTIC
/begin CHARACTERISTIC CrCCD_tiDebSetPl_C "time for SET+ detection" VALUE 0xC8B5C Kw_Wu16 1500.000 Time_ms 0.00 1500.000 FORMAT "%8.3" EXTENDED_LIMITS 0.00 655350.0 /end CHARACTERISTIC
/begin CHARACTERISTIC CrCCD_tiToggleMax_C "Maximalzeit bis Togglebitwechsel erfolgt sein muß" VALUE 0xC8B5E Kw_Wu16 1500.000 Time_ms 0.00 1500.000 FORMAT "%8.3" EXTENDED_LIMITS 0.00 655350.0 /end CHARACTERISTIC
/begin CHARACTERISTIC CrCtl_aAccLim_C "Minimal erlaubte Fahrzeugbeschleunigung für Übergang von SET+ zu HOLD" VALUE 0xC8B98 Kw_Ws16 10.00000 Acc 0.00 10.00000 FORMAT "%8.5" EXTENDED_LIMITS -32.76800 32.76700 /end CHARACTERISTIC
/begin CHARACTERISTIC CrCtl_aAccMax_C "Fahrzeugbeschleunigungsschwelle für CrCtl-Abschaltbedingung ""zu große Fahrzeugbeschleunigung""" VALUE 0xC8B60 Kw_Ws16 42.76800 Acc -32.76800 10.00000 FORMAT "%8.5" EXTENDED_LIMITS -32.76800 32.76700 /end CHARACTERISTIC
/begin CHARACTERISTIC CrCtl_AccGear2PKp_C "P-Reglerparametersatz für Beschleunigung 2.Gang" VALUE 0xC8B9C Kw_Wu32 1310719.99969 Kp_Vel2TrqPrp 0.00 1310719.99969 FORMAT "%13.5" /end CHARACTERISTIC
/begin CHARACTERISTIC CrCtl_AccGear2PKpPos_C "P-Reglerparametersatz für Beschleunigung 2.Gang" VALUE 0xC8BA0 Kw_Wu32 1310719.99969 Kp_Vel2TrqPrp 0.00 1310719.99969 FORMAT "%13.5" /end CHARACTERISTIC
/begin CHARACTERISTIC CrCtl_AccGear2PKpNeg_C "P-Reglerparametersatz für Beschleunigung 2.Gang" VALUE 0xC8BA4 Kw_Wu32 1310719.99969 Kp_Vel2TrqPrp 0.00 1310719.99969 FORMAT "%13.5" /end CHARACTERISTIC
/begin CHARACTERISTIC CrCtl_vAccGear2PWinPos_C "P-Reglerparametersatz für Beschleunigung 2.Gang" VALUE 0xC8BA8 Kw_Ws16 300.0000 Vel 0.00 300.0000 FORMAT "%8.4" EXTENDED_LIMITS -327.6800 327.6700 /end CHARACTERISTIC
/begin CHARACTERISTIC CrCtl_vAccGear2PWinNeg_C "P-Reglerparametersatz für Beschleunigung 2.Gang" VALUE 0xC8BAA Kw_Ws16 300.0000 Vel -300.0000 0.00 FORMAT "%8.4" EXTENDED_LIMITS -327.6800 327.6700 /end CHARACTERISTIC
/begin CHARACTERISTIC CrCtl_AccGear3PKp_C "P-Reglerparametersatz für Beschleunigung 3.Gang" VALUE 0xC8BAC Kw_Wu32 1310719.99969 Kp_Vel2TrqPrp 0.00 1310719.99969 FORMAT "%13.5" /end CHARACTERISTIC
/begin CHARACTERISTIC CrCtl_AccGear3PKpPos_C "P-Reglerparametersatz für Beschleunigung 3.Gang" VALUE 0xC8BB0 Kw_Wu32 1310719.99969 Kp_Vel2TrqPrp 0.00 1310719.99969 FORMAT "%13.5" /end CHARACTERISTIC
/begin CHARACTERISTIC CrCtl_AccGear3PKpNeg_C "P-Reglerparametersatz für Beschleunigung 3.Gang" VALUE 0xC8BB4 Kw_Wu32 1310719.99969 Kp_Vel2TrqPrp 0.00 1310719.99969 FORMAT "%13.5" /end CHARACTERISTIC
/begin CHARACTERISTIC CrCtl_vAccGear3PWinPos_C "P-Reglerparametersatz für Beschleunigung 3.Gang" VALUE 0xC8BB8 Kw_Ws16 300.0000 Vel 0.00 300.0000 FORMAT "%8.4" EXTENDED_LIMITS -327.6800 327.6700 /end CHARACTERISTIC
/begin CHARACTERISTIC CrCtl_vAccGear3PWinNeg_C "P-Reglerparametersatz für Beschleunigung 3.Gang" VALUE 0xC8BBA Kw_Ws16 300.0000 Vel -300.0000 0.00 FORMAT "%8.4" EXTENDED_LIMITS -327.6800 327.6700 /end CHARACTERISTIC
/begin CHARACTERISTIC CrCtl_AccGear4PKp_C "P-Reglerparametersatz für Beschleunigung 4.Gang" VALUE 0xC8BBC Kw_Wu32 1310719.99969 Kp_Vel2TrqPrp 0.00 1310719.99969 FORMAT "%13.5" /end CHARACTERISTIC
/begin CHARACTERISTIC CrCtl_AccGear4PKpPos_C "P-Reglerparametersatz für Beschleunigung 4.Gang" VALUE 0xC8BC0 Kw_Wu32 1310719.99969 Kp_Vel2TrqPrp 0.00 1310719.99969 FORMAT "%13.5" /end CHARACTERISTIC
/begin CHARACTERISTIC CrCtl_AccGear4PKpNeg_C "P-Reglerparametersatz für Beschleunigung 4.Gang" VALUE 0xC8BC4 Kw_Wu32 1310719.99969 Kp_Vel2TrqPrp 0.00 1310719.99969 FORMAT "%13.5" /end CHARACTERISTIC
/begin CHARACTERISTIC CrCtl_vAccGear4PWinPos_C "P-Reglerparametersatz für Beschleunigung 4.Gang" VALUE 0xC8BC8 Kw_Ws16 300.0000 Vel 0.00 300.0000 FORMAT "%8.4" EXTENDED_LIMITS -327.6800 327.6700 /end CHARACTERISTIC
/begin CHARACTERISTIC CrCtl_vAccGear4PWinNeg_C "P-Reglerparametersatz für Beschleunigung 4.Gang" VALUE 0xC8BCA Kw_Ws16 300.0000 Vel -300.0000 0.00 FORMAT "%8.4" EXTENDED_LIMITS -327.6800 327.6700 /end CHARACTERISTIC
/begin CHARACTERISTIC CrCtl_AccGear5PKp_C "P-Reglerparametersatz für Beschleunigung 5.Gang" VALUE 0xC8BCC Kw_Wu32 1310719.99969 Kp_Vel2TrqPrp 0.00 1310719.99969 FORMAT "%13.5" /end CHARACTERISTIC
/begin CHARACTERISTIC CrCtl_AccGear5PKpPos_C "P-Reglerparametersatz für Beschleunigung 5.Gang" VALUE 0xC8BD0 Kw_Wu32 1310719.99969 Kp_Vel2TrqPrp 0.00 1310719.99969 FORMAT "%13.5" /end CHARACTERISTIC
/begin CHARACTERISTIC CrCtl_AccGear5PKpNeg_C "P-Reglerparametersatz für Beschleunigung 5.Gang" VALUE 0xC8BD4 Kw_Wu32 1310719.99969 Kp_Vel2TrqPrp 0.00 1310719.99969 FORMAT "%13.5" /end CHARACTERISTIC
/begin CHARACTERISTIC CrCtl_vAccGear5PWinPos_C "P-Reglerparametersatz für Beschleunigung 5.Gang" VALUE 0xC8BD8 Kw_Ws16 300.0000 Vel 0.00 300.0000 FORMAT "%8.4" EXTENDED_LIMITS -327.6800 327.6700 /end CHARACTERISTIC
/begin CHARACTERISTIC CrCtl_vAccGear5PWinNeg_C "P-Reglerparametersatz für Beschleunigung 5.Gang" VALUE 0xC8BDA Kw_Ws16 300.0000 Vel -300.0000 0.00 FORMAT "%8.4" EXTENDED_LIMITS -327.6800 327.6700 /end CHARACTERISTIC
/begin CHARACTERISTIC CrCtl_AccGear6PKp_C "P-Reglerparametersatz für Beschleunigung 6.Gang" VALUE 0xC8BDC Kw_Wu32 1310719.99969 Kp_Vel2TrqPrp 0.00 1310719.99969 FORMAT "%13.5" /end CHARACTERISTIC
/begin CHARACTERISTIC CrCtl_AccGear6PKpPos_C "P-Reglerparametersatz für Beschleunigung 6.Gang" VALUE 0xC8BE0 Kw_Wu32 1310719.99969 Kp_Vel2TrqPrp 0.00 1310719.99969 FORMAT "%13.5" /end CHARACTERISTIC
/begin CHARACTERISTIC CrCtl_AccGear6PKpNeg_C "P-Reglerparametersatz für Beschleunigung 6.Gang" VALUE 0xC8BE4 Kw_Wu32 1310719.99969 Kp_Vel2TrqPrp 0.00 1310719.99969 FORMAT "%13.5" /end CHARACTERISTIC
/begin CHARACTERISTIC CrCtl_vAccGear6PWinPos_C "P-Reglerparametersatz für Beschleunigung 6.Gang" VALUE 0xC8BE8 Kw_Ws16 300.0000 Vel 0.00 300.0000 FORMAT "%8.4" EXTENDED_LIMITS -327.6800 327.6700 /end CHARACTERISTIC
/begin CHARACTERISTIC CrCtl_vAccGear6PWinNeg_C "P-Reglerparametersatz für Beschleunigung 6.Gang" VALUE 0xC8BEA Kw_Ws16 300.0000 Vel -300.0000 0.00 FORMAT "%8.4" EXTENDED_LIMITS -327.6800 327.6700 /end CHARACTERISTIC
/begin CHARACTERISTIC CrCtl_aDeclLim_C "neg. Beschleunigungsschwelle Übergang EIN- zu HALTEN" VALUE 0xC8BEC Kw_Ws16 10.00000 Acc -10.00000 0.00 FORMAT "%8.5" EXTENDED_LIMITS -32.76800 32.76700 /end CHARACTERISTIC
/begin CHARACTERISTIC CrCtl_aDecMax_C "max. zulässige neg. Beschleunigung für Abschaltung FGR" VALUE 0xC8B62 Kw_Ws16 32.76800 Acc -32.76800 0.00 FORMAT "%8.5" EXTENDED_LIMITS -32.76800 32.76700 /end CHARACTERISTIC
/begin CHARACTERISTIC CrCtl_ctMaxTip_C "Maximal erlaubte Tipanzahl ohne Erreichen der Sollgeschwindigkeit" VALUE 0xC8BEE Kw_Wu8 100.0 OneToOne 0.00 100.0 FORMAT "%5.1" EXTENDED_LIMITS 0.00 255.0 /end CHARACTERISTIC
/begin CHARACTERISTIC CrCtl_DeclGear2PKp_C "P-Reglerparametersatz für Verzögerung 2.Gang" VALUE 0xC8BF0 Kw_Wu32 1310719.99969 Kp_Vel2TrqPrp 0.00 1310719.99969 FORMAT "%13.5" /end CHARACTERISTIC
/begin CHARACTERISTIC CrCtl_DeclGear2PKpPos_C "P-Reglerparametersatz für Verzögerung 2.Gang" VALUE 0xC8BF4 Kw_Wu32 1310719.99969 Kp_Vel2TrqPrp 0.00 1310719.99969 FORMAT "%13.5" /end CHARACTERISTIC
/begin CHARACTERISTIC CrCtl_DeclGear2PKpNeg_C "P-Reglerparametersatz für Verzögerung 2.Gang" VALUE 0xC8BF8 Kw_Wu32 1310719.99969 Kp_Vel2TrqPrp 0.00 1310719.99969 FORMAT "%13.5" /end CHARACTERISTIC
/begin CHARACTERISTIC CrCtl_vDeclGear2PWinPos_C "P-Reglerparametersatz für Verzögerung 2.Gang" VALUE 0xC8BFC Kw_Ws16 300.0000 Vel 0.00 300.0000 FORMAT "%8.4" EXTENDED_LIMITS -327.6800 327.6700 /end CHARACTERISTIC
/begin CHARACTERISTIC CrCtl_vDeclGear2PWinNeg_C "P-Reglerparametersatz für Verzögerung 2.Gang" VALUE 0xC8BFE Kw_Ws16 300.0000 Vel -300.0000 0.00 FORMAT "%8.4" EXTENDED_LIMITS -327.6800 327.6700 /end CHARACTERISTIC
/begin CHARACTERISTIC CrCtl_DeclGear3PKp_C "P-Reglerparametersatz für Verzögerung 3.Gang" VALUE 0xC8C00 Kw_Wu32 1310719.99969 Kp_Vel2TrqPrp 0.00 1310719.99969 FORMAT "%13.5" /end CHARACTERISTIC
/begin CHARACTERISTIC CrCtl_DeclGear3PKpPos_C "P-Reglerparametersatz für Verzögerung 3.Gang" VALUE 0xC8C04 Kw_Wu32 1310719.99969 Kp_Vel2TrqPrp 0.00 1310719.99969 FORMAT "%13.5" /end CHARACTERISTIC
/begin CHARACTERISTIC CrCtl_DeclGear3PKpNeg_C "P-Reglerparametersatz für Verzögerung 3.Gang" VALUE 0xC8C08 Kw_Wu32 1310719.99969 Kp_Vel2TrqPrp 0.00 1310719.99969 FORMAT "%13.5" /end CHARACTERISTIC
/begin CHARACTERISTIC CrCtl_vDeclGear3PWinPos_C "P-Reglerparametersatz für Verzögerung 3.Gang" VALUE 0xC8C0C Kw_Ws16 300.0000 Vel 0.00 300.0000 FORMAT "%8.4" EXTENDED_LIMITS -327.6800 327.6700 /end CHARACTERISTIC
/begin CHARACTERISTIC CrCtl_vDeclGear3PWinNeg_C "P-Reglerparametersatz für Verzögerung 3.Gang" VALUE 0xC8C0E Kw_Ws16 300.0000 Vel -300.0000 0.00 FORMAT "%8.4" EXTENDED_LIMITS -327.6800 327.6700 /end CHARACTERISTIC
/begin CHARACTERISTIC CrCtl_DeclGear4PKp_C "P-Reglerparametersatz für Verzögerung 4.Gang" VALUE 0xC8C10 Kw_Wu32 1310719.99969 Kp_Vel2TrqPrp 0.00 1310719.99969 FORMAT "%13.5" /end CHARACTERISTIC
/begin CHARACTERISTIC CrCtl_DeclGear4PKpPos_C "P-Reglerparametersatz für Verzögerung 4.Gang" VALUE 0xC8C14 Kw_Wu32 1310719.99969 Kp_Vel2TrqPrp 0.00 1310719.99969 FORMAT "%13.5" /end CHARACTERISTIC
/begin CHARACTERISTIC CrCtl_DeclGear4PKpNeg_C "P-Reglerparametersatz für Verzögerung 4.Gang" VALUE 0xC8C18 Kw_Wu32 1310719.99969 Kp_Vel2TrqPrp 0.00 1310719.99969 FORMAT "%13.5" /end CHARACTERISTIC
/begin CHARACTERISTIC CrCtl_vDeclGear4PWinPos_C "P-Reglerparametersatz für Verzögerung 4.Gang" VALUE 0xC8C1C Kw_Ws16 300.0000 Vel 0.00 300.0000 FORMAT "%8.4" EXTENDED_LIMITS -327.6800 327.6700 /end CHARACTERISTIC
/begin CHARACTERISTIC CrCtl_vDeclGear4PWinNeg_C "P-Reglerparametersatz für Verzögerung 4.Gang" VALUE 0xC8C1E Kw_Ws16 300.0000 Vel -300.0000 0.00 FORMAT "%8.4" EXTENDED_LIMITS -327.6800 327.6700 /end CHARACTERISTIC
/begin CHARACTERISTIC CrCtl_DeclGear5PKp_C "P-Reglerparametersatz für Verzögerung 5.Gang" VALUE 0xC8C20 Kw_Wu32 1310719.99969 Kp_Vel2TrqPrp 0.00 1310719.99969 FORMAT "%13.5" /end CHARACTERISTIC
/begin CHARACTERISTIC CrCtl_DeclGear5PKpPos_C "P-Reglerparametersatz für Verzögerung 5.Gang" VALUE 0xC8C24 Kw_Wu32 1310719.99969 Kp_Vel2TrqPrp 0.00 1310719.99969 FORMAT "%13.5" /end CHARACTERISTIC
/begin CHARACTERISTIC CrCtl_DeclGear5PKpNeg_C "P-Reglerparametersatz für Verzögerung 5.Gang" VALUE 0xC8C28 Kw_Wu32 1310719.99969 Kp_Vel2TrqPrp 0.00 1310719.99969 FORMAT "%13.5" /end CHARACTERISTIC
/begin CHARACTERISTIC CrCtl_vDeclGear5PWinPos_C "P-Reglerparametersatz für Verzögerung 5.Gang" VALUE 0xC8C2C Kw_Ws16 300.0000 Vel 0.00 300.0000 FORMAT "%8.4" EXTENDED_LIMITS -327.6800 327.6700 /end CHARACTERISTIC
/begin CHARACTERISTIC CrCtl_vDeclGear5PWinNeg_C "P-Reglerparametersatz für Verzögerung 5.Gang" VALUE 0xC8C2E Kw_Ws16 300.0000 Vel -300.0000 0.00 FORMAT "%8.4" EXTENDED_LIMITS -327.6800 327.6700 /end CHARACTERISTIC
/begin CHARACTERISTIC CrCtl_DeclGear6PKp_C "P-Reglerparametersatz für Verzögerung 6.Gang" VALUE 0xC8C30 Kw_Wu32 1310719.99969 Kp_Vel2TrqPrp 0.00 1310719.99969 FORMAT "%13.5" /end CHARACTERISTIC
/begin CHARACTERISTIC CrCtl_DeclGear6PKpPos_C "P-Reglerparametersatz für Verzögerung 6.Gang" VALUE 0xC8C34 Kw_Wu32 1310719.99969 Kp_Vel2TrqPrp 0.00 1310719.99969 FORMAT "%13.5" /end CHARACTERISTIC
/begin CHARACTERISTIC CrCtl_DeclGear6PKpNeg_C "P-Reglerparametersatz für Verzögerung 6.Gang" VALUE 0xC8C38 Kw_Wu32 1310719.99969 Kp_Vel2TrqPrp 0.00 1310719.99969 FORMAT "%13.5" /end CHARACTERISTIC
/begin CHARACTERISTIC CrCtl_vDeclGear6PWinPos_C "P-Reglerparametersatz für Verzögerung 6.Gang" VALUE 0xC8C3C Kw_Ws16 300.0000 Vel 0.00 300.0000 FORMAT "%8.4" EXTENDED_LIMITS -327.6800 327.6700 /end CHARACTERISTIC
/begin CHARACTERISTIC CrCtl_vDeclGear6PWinNeg_C "P-Reglerparametersatz für Verzögerung 6.Gang" VALUE 0xC8C3E Kw_Ws16 300.0000 Vel -300.0000 0.00 FORMAT "%8.4" EXTENDED_LIMITS -327.6800 327.6700 /end CHARACTERISTIC
/begin CHARACTERISTIC CrCtl_dtrqAccDwn_C "FGR: EIN+: Anstieg Momentenverringerung nach Loslassen EIN+ Taste" VALUE 0xC8C40 Kw_Ws16 327670.0 dTrqPrp_20ms 0.00 327670.0 FORMAT "%8.1" EXTENDED_LIMITS -327680.0 327670.0 /end CHARACTERISTIC
/begin CHARACTERISTIC CrCtl_dtrqDeclUp_C "FGR, EIN-: Momentenanstieg nach Loslassen EIN- Taste" VALUE 0xC8C42 Kw_Ws16 327670.0 dTrqPrp_20ms 0.00 327670.0 FORMAT "%8.1" EXTENDED_LIMITS -327680.0 327670.0 /end CHARACTERISTIC
/begin CHARACTERISTIC CrCtl_dtrqOffComf1_C "Rampensteigung 1 Komfortabschaltung" VALUE 0xC8C44 Kw_Ws16 327670.0 dTrqPrp_20ms 0.00 327670.0 FORMAT "%8.1" EXTENDED_LIMITS -327680.0 327670.0 /end CHARACTERISTIC
/begin CHARACTERISTIC CrCtl_dtrqOffComf2_C "Rampensteigung 2 Komfortabschaltung" VALUE 0xC8C46 Kw_Ws16 327670.0 dTrqPrp_20ms 0.00 327670.0 FORMAT "%8.1" EXTENDED_LIMITS -327680.0 327670.0 /end CHARACTERISTIC
/begin CHARACTERISTIC CrCtl_dtrqOffFast1_CUR "Kurve für erste Rampe bei Schnellabschaltung" CURVE 0xC8C48 Kl_Xs16_Ws16 327670.0 dTrqPrp_20ms 0.00 327670.0 FORMAT "%8.1" EXTENDED_LIMITS -327680.0 327670.0
 /begin AXIS_DESCR STD_AXIS Gearbx_stGear OneToOne 8 -1.000 6.000 FORMAT "%5.3" EXTENDED_LIMITS -128.0 127.0 DEPOSIT ABSOLUTE /end AXIS_DESCR
/end CHARACTERISTIC
/begin CHARACTERISTIC CrCtl_dtrqOffFast2_CUR "Kurve für zweite Rampe bei Schnellabschaltung" CURVE 0xC8C6A Kl_Xs16_Ws16 327670.0 dTrqPrp_20ms 0.00 327670.0 FORMAT "%8.1" EXTENDED_LIMITS -327680.0 327670.0
 /begin AXIS_DESCR STD_AXIS Gearbx_stGear OneToOne 8 -1.000 6.000 FORMAT "%5.3" EXTENDED_LIMITS -128.0 127.0 DEPOSIT ABSOLUTE /end AXIS_DESCR
/end CHARACTERISTIC
/begin CHARACTERISTIC CrCtl_dtrqOffFast3_CUR "Kennfled für dritte Rampe bei Schnellabschaltung" CURVE 0xC8C8C Kl_Xs16_Ws16 327670.0 dTrqPrp_20ms 0.00 327670.0 FORMAT "%8.1" EXTENDED_LIMITS -327680.0 327670.0
 /begin AXIS_DESCR STD_AXIS Gearbx_stGear OneToOne 8 -1.000 6.000 FORMAT "%5.3" EXTENDED_LIMITS -128.0 127.0 DEPOSIT ABSOLUTE /end AXIS_DESCR
/end CHARACTERISTIC
/begin CHARACTERISTIC CrCtl_dvAccFDCG3_CUR "Curve for slope of ramp speed in acceleration <= 3th gear" CURVE 0xC8CAE Kl_Xs16_Ws16 16383.50 dVel_20ms 0.00 16383.50 FORMAT "%8.2" EXTENDED_LIMITS -16384.00 16383.50
 /begin AXIS_DESCR STD_AXIS CrCtl_vBeg Vel 3 0.00 300.0000 FORMAT "%8.4" EXTENDED_LIMITS -327.6800 327.6700 DEPOSIT ABSOLUTE /end AXIS_DESCR
/end CHARACTERISTIC
/begin CHARACTERISTIC CrCtl_dvAccFDCG4_CUR "Curve for slope of ramp speed in acceleration (EIN+), 4th gear" CURVE 0xC8CBC Kl_Xs16_Ws16 16383.50 dVel_20ms 0.00 16383.50 FORMAT "%8.2" EXTENDED_LIMITS -16384.00 16383.50
 /begin AXIS_DESCR STD_AXIS CrCtl_vBeg Vel 3 0.00 300.0000 FORMAT "%8.4" EXTENDED_LIMITS -327.6800 327.6700 DEPOSIT ABSOLUTE /end AXIS_DESCR
/end CHARACTERISTIC
/begin CHARACTERISTIC CrCtl_dvAccFDCG5_CUR "Curve for slope of ramp speed in acceleration (EIN+), 5th gear" CURVE 0xC8CCA Kl_Xs16_Ws16 16383.50 dVel_20ms 0.00 16383.50 FORMAT "%8.2" EXTENDED_LIMITS -16384.00 16383.50
 /begin AXIS_DESCR STD_AXIS CrCtl_vBeg Vel 3 0.00 300.0000 FORMAT "%8.4" EXTENDED_LIMITS -327.6800 327.6700 DEPOSIT ABSOLUTE /end AXIS_DESCR
/end CHARACTERISTIC
/begin CHARACTERISTIC CrCtl_dvAccFDCG6_CUR "Curve for slope of ramp speed in acceleration (EIN+), >= 6th gear" CURVE 0xC8CD8 Kl_Xs16_Ws16 16383.50 dVel_20ms 0.00 16383.50 FORMAT "%8.2" EXTENDED_LIMITS -16384.00 16383.50
 /begin AXIS_DESCR STD_AXIS CrCtl_vBeg Vel 3 0.00 300.0000 FORMAT "%8.4" EXTENDED_LIMITS -327.6800 327.6700 DEPOSIT ABSOLUTE /end AXIS_DESCR
/end CHARACTERISTIC
/begin CHARACTERISTIC CrCtl_dvAccG3_CUR "KL Anstieg FGR Rampengeschwindigkeit bei EIN+ für Gang <= 3" CURVE 0xC8CE6 Kl_Xs16_Ws16 16383.50 dVel_20ms 0.00 16383.50 FORMAT "%8.2" EXTENDED_LIMITS -16384.00 16383.50
 /begin AXIS_DESCR STD_AXIS CrCtl_vBeg Vel 3 0.00 300.0000 FORMAT "%8.4" EXTENDED_LIMITS -327.6800 327.6700 DEPOSIT ABSOLUTE /end AXIS_DESCR
/end CHARACTERISTIC
/begin CHARACTERISTIC CrCtl_dvAccG4_CUR "KL Anstieg FGR Rampengeschwindigkeit bei EIN+ für 4. Gang" CURVE 0xC8CF4 Kl_Xs16_Ws16 16383.50 dVel_20ms 0.00 16383.50 FORMAT "%8.2" EXTENDED_LIMITS -16384.00 16383.50
 /begin AXIS_DESCR STD_AXIS CrCtl_vBeg Vel 3 0.00 300.0000 FORMAT "%8.4" EXTENDED_LIMITS -327.6800 327.6700 DEPOSIT ABSOLUTE /end AXIS_DESCR
/end CHARACTERISTIC
/begin CHARACTERISTIC CrCtl_dvAccG5_CUR "KL Anstieg FGR Rampengeschwindigkeit bei EIN+ für 5. Gang" CURVE 0xC8D02 Kl_Xs16_Ws16 16383.50 dVel_20ms 0.00 16383.50 FORMAT "%8.2" EXTENDED_LIMITS -16384.00 16383.50
 /begin AXIS_DESCR STD_AXIS CrCtl_vBeg Vel 3 0.00 300.0000 FORMAT "%8.4" EXTENDED_LIMITS -327.6800 327.6700 DEPOSIT ABSOLUTE /end AXIS_DESCR
/end CHARACTERISTIC
/begin CHARACTERISTIC CrCtl_dvAccG6_CUR "KL Anstieg FGR Rampengeschwindigkeit bei EIN+ für 6. Gang" CURVE 0xC8D10 Kl_Xs16_Ws16 16383.50 dVel_20ms 0.00 16383.50 FORMAT "%8.2" EXTENDED_LIMITS -16384.00 16383.50
 /begin AXIS_DESCR STD_AXIS CrCtl_vBeg Vel 3 0.00 300.0000 FORMAT "%8.4" EXTENDED_LIMITS -327.6800 327.6700 DEPOSIT ABSOLUTE /end AXIS_DESCR
/end CHARACTERISTIC
/begin CHARACTERISTIC CrCtl_dvDeclFDCG3_CUR "Curve for slope of ramp speed in acceleration (EIN+), >= 3rd gear" CURVE 0xC8D1E Kl_Xs16_Ws16 16383.50 dVel_20ms 0.00 16383.50 FORMAT "%8.2" EXTENDED_LIMITS -16384.00 16383.50
 /begin AXIS_DESCR STD_AXIS CrCtl_vBeg Vel 3 0.00 300.0000 FORMAT "%8.4" EXTENDED_LIMITS -327.6800 327.6700 DEPOSIT ABSOLUTE /end AXIS_DESCR
/end CHARACTERISTIC
/begin CHARACTERISTIC CrCtl_dvDeclFDCG4_CUR "Curve for slope of ramp speed in deceleration (EIN-), 4th gear" CURVE 0xC8D2C Kl_Xs16_Ws16 16383.50 dVel_20ms 0.00 16383.50 FORMAT "%8.2" EXTENDED_LIMITS -16384.00 16383.50
 /begin AXIS_DESCR STD_AXIS CrCtl_vBeg Vel 3 0.00 300.0000 FORMAT "%8.4" EXTENDED_LIMITS -327.6800 327.6700 DEPOSIT ABSOLUTE /end AXIS_DESCR
/end CHARACTERISTIC
/begin CHARACTERISTIC CrCtl_dvDeclFDCG5_CUR "curve for ramp slope SET+ 5th gear for sport mode" CURVE 0xC8D3A Kl_Xs16_Ws16 16383.50 dVel_20ms 0.00 16383.50 FORMAT "%8.2" EXTENDED_LIMITS -16384.00 16383.50
 /begin AXIS_DESCR STD_AXIS CrCtl_vBeg Vel 3 0.00 300.0000 FORMAT "%8.4" EXTENDED_LIMITS -327.6800 327.6700 DEPOSIT ABSOLUTE /end AXIS_DESCR
/end CHARACTERISTIC
/begin CHARACTERISTIC CrCtl_dvDeclFDCG6_CUR "Curve for slope of ramp speed in deceleration (EIN-), >= 6th gear" CURVE 0xC8D48 Kl_Xs16_Ws16 16383.50 dVel_20ms 0.00 16383.50 FORMAT "%8.2" EXTENDED_LIMITS -16384.00 16383.50
 /begin AXIS_DESCR STD_AXIS CrCtl_vBeg Vel 3 0.00 300.0000 FORMAT "%8.4" EXTENDED_LIMITS -327.6800 327.6700 DEPOSIT ABSOLUTE /end AXIS_DESCR
/end CHARACTERISTIC
/begin CHARACTERISTIC CrCtl_dvDeclG3_CUR "KL Abstieg FGR Rampengeschwindigkeit bei EIN- für Gang <= 3" CURVE 0xC8D56 Kl_Xs16_Ws16 16383.50 dVel_20ms 0.00 16383.50 FORMAT "%8.2" EXTENDED_LIMITS -16384.00 16383.50
 /begin AXIS_DESCR STD_AXIS CrCtl_vBeg Vel 3 0.00 300.0000 FORMAT "%8.4" EXTENDED_LIMITS -327.6800 327.6700 DEPOSIT ABSOLUTE /end AXIS_DESCR
/end CHARACTERISTIC
/begin CHARACTERISTIC CrCtl_dvDeclG4_CUR "KL Abstieg FGR Rampengeschwindigkeit bei EIN- für 4. Gang" CURVE 0xC8D64 Kl_Xs16_Ws16 16383.50 dVel_20ms 0.00 16383.50 FORMAT "%8.2" EXTENDED_LIMITS -16384.00 16383.50
 /begin AXIS_DESCR STD_AXIS CrCtl_vBeg Vel 3 0.00 300.0000 FORMAT "%8.4" EXTENDED_LIMITS -327.6800 327.6700 DEPOSIT ABSOLUTE /end AXIS_DESCR
/end CHARACTERISTIC
/begin CHARACTERISTIC CrCtl_dvDeclG5_CUR "KL Abstieg FGR Rampengeschwindigkeit bei EIN- für 5. Gang" CURVE 0xC8D72 Kl_Xs16_Ws16 16383.50 dVel_20ms 0.00 16383.50 FORMAT "%8.2" EXTENDED_LIMITS -16384.00 16383.50
 /begin AXIS_DESCR STD_AXIS CrCtl_vBeg Vel 3 0.00 300.0000 FORMAT "%8.4" EXTENDED_LIMITS -327.6800 327.6700 DEPOSIT ABSOLUTE /end AXIS_DESCR
/end CHARACTERISTIC
/begin CHARACTERISTIC CrCtl_dvDeclG6_CUR "KL Abstieg FGR Rampengeschwindigkeit bei EIN- für 6. Gang" CURVE 0xC8D80 Kl_Xs16_Ws16 16383.50 dVel_20ms 0.00 16383.50 FORMAT "%8.2" EXTENDED_LIMITS -16384.00 16383.50
 /begin AXIS_DESCR STD_AXIS CrCtl_vBeg Vel 3 0.00 300.0000 FORMAT "%8.4" EXTENDED_LIMITS -327.6800 327.6700 DEPOSIT ABSOLUTE /end AXIS_DESCR
/end CHARACTERISTIC
/begin CHARACTERISTIC CrCtl_dvResAbvFDCG3_CUR "Curve for slope of set speed ramp RESUME ABOVE, >=3th gear" CURVE 0xC8D8E Kl_Xs16_Ws16 16383.50 dVel_20ms 0.00 16383.50 FORMAT "%8.2" EXTENDED_LIMITS -16384.00 16383.50
 /begin AXIS_DESCR STD_AXIS CrCtl_vBeg Vel 3 0.00 300.0000 FORMAT "%8.4" EXTENDED_LIMITS -327.6800 327.6700 DEPOSIT ABSOLUTE /end AXIS_DESCR
/end CHARACTERISTIC
/begin CHARACTERISTIC CrCtl_dvResAbvFDCG4_CUR "Curve for slope of set speed ramp RESUME ABOVE, >=4th gear" CURVE 0xC8D9C Kl_Xs16_Ws16 16383.50 dVel_20ms 0.00 16383.50 FORMAT "%8.2" EXTENDED_LIMITS -16384.00 16383.50
 /begin AXIS_DESCR STD_AXIS CrCtl_vBeg Vel 3 0.00 300.0000 FORMAT "%8.4" EXTENDED_LIMITS -327.6800 327.6700 DEPOSIT ABSOLUTE /end AXIS_DESCR
/end CHARACTERISTIC
/begin CHARACTERISTIC CrCtl_dvResAbvFDCG5_CUR "Curve for slope of set speed ramp RESUME ABOVE, >=5th gear" CURVE 0xC8DAA Kl_Xs16_Ws16 16383.50 dVel_20ms 0.00 16383.50 FORMAT "%8.2" EXTENDED_LIMITS -16384.00 16383.50
 /begin AXIS_DESCR STD_AXIS CrCtl_vBeg Vel 3 0.00 300.0000 FORMAT "%8.4" EXTENDED_LIMITS -327.6800 327.6700 DEPOSIT ABSOLUTE /end AXIS_DESCR
/end CHARACTERISTIC
/begin CHARACTERISTIC CrCtl_dvResAbvFDCG6_CUR "Curve for slope of set speed ramp RESUME ABOVE, >=6th gear" CURVE 0xC8DB8 Kl_Xs16_Ws16 16383.50 dVel_20ms 0.00 16383.50 FORMAT "%8.2" EXTENDED_LIMITS -16384.00 16383.50
 /begin AXIS_DESCR STD_AXIS CrCtl_vBeg Vel 3 0.00 300.0000 FORMAT "%8.4" EXTENDED_LIMITS -327.6800 327.6700 DEPOSIT ABSOLUTE /end AXIS_DESCR
/end CHARACTERISTIC
/begin CHARACTERISTIC CrCtl_dvResAbvG3_MAP "KF Abstieg FGR Rampengeschwindigkeit bei WA von oben für Gang <= 3" MAP 0xC8DC6 Kf_Xs16_Ys16_Ws16 16383.50 dVel_20ms 0.00 16383.50 FORMAT "%8.2" EXTENDED_LIMITS -16384.00 16383.50
 /begin AXIS_DESCR STD_AXIS CrCtl_vBeg Vel 3 0.00 300.0000 FORMAT "%8.4" EXTENDED_LIMITS -327.6800 327.6700 DEPOSIT ABSOLUTE /end AXIS_DESCR
 /begin AXIS_DESCR STD_AXIS CrCtl_vDiff_mp Vel 1 0.00 300.0000 FORMAT "%8.4" EXTENDED_LIMITS -327.6800 327.6700 DEPOSIT ABSOLUTE /end AXIS_DESCR
/end CHARACTERISTIC
/begin CHARACTERISTIC CrCtl_dvResAbvG4_MAP "KF Abstieg FGR Rampengeschwindigkeit bei WA von oben für 4. Gang" MAP 0xC8DD8 Kf_Xs16_Ys16_Ws16 16383.50 dVel_20ms 0.00 16383.50 FORMAT "%8.2" EXTENDED_LIMITS -16384.00 16383.50
 /begin AXIS_DESCR STD_AXIS CrCtl_vBeg Vel 3 0.00 300.0000 FORMAT "%8.4" EXTENDED_LIMITS -327.6800 327.6700 DEPOSIT ABSOLUTE /end AXIS_DESCR
 /begin AXIS_DESCR STD_AXIS CrCtl_vDiff_mp Vel 1 0.00 300.0000 FORMAT "%8.4" EXTENDED_LIMITS -327.6800 327.6700 DEPOSIT ABSOLUTE /end AXIS_DESCR
/end CHARACTERISTIC
/begin CHARACTERISTIC CrCtl_dvResAbvG5_MAP "KF Abstieg FGR Rampengeschwindigkeit bei WA von oben für 5. Gang" MAP 0xC8DEA Kf_Xs16_Ys16_Ws16 16383.50 dVel_20ms 0.00 16383.50 FORMAT "%8.2" EXTENDED_LIMITS -16384.00 16383.50
 /begin AXIS_DESCR STD_AXIS CrCtl_vBeg Vel 3 0.00 300.0000 FORMAT "%8.4" EXTENDED_LIMITS -327.6800 327.6700 DEPOSIT ABSOLUTE /end AXIS_DESCR
 /begin AXIS_DESCR STD_AXIS CrCtl_vDiff_mp Vel 1 0.00 300.0000 FORMAT "%8.4" EXTENDED_LIMITS -327.6800 327.6700 DEPOSIT ABSOLUTE /end AXIS_DESCR
/end CHARACTERISTIC
/begin CHARACTERISTIC CrCtl_dvResAbvG6_MAP "KF Abstieg FGR Rampengeschwindigkeit bei WA von oben für 6. Gang" MAP 0xC8DFC Kf_Xs16_Ys16_Ws16 16383.50 dVel_20ms 0.00 16383.50 FORMAT "%8.2" EXTENDED_LIMITS -16384.00 16383.50
 /begin AXIS_DESCR STD_AXIS CrCtl_vBeg Vel 3 0.00 300.0000 FORMAT "%8.4" EXTENDED_LIMITS -327.6800 327.6700 DEPOSIT ABSOLUTE /end AXIS_DESCR
 /begin AXIS_DESCR STD_AXIS CrCtl_vDiff_mp Vel 1 0.00 300.0000 FORMAT "%8.4" EXTENDED_LIMITS -327.6800 327.6700 DEPOSIT ABSOLUTE /end AXIS_DESCR
/end CHARACTERISTIC
/begin CHARACTERISTIC CrCtl_dvResBlwFDCG3_CUR "Curve for slope of set speed ramp RESUME BELOW, <= 3th gear" CURVE 0xC8E0E Kl_Xs16_Ws16 16383.50 dVel_20ms 0.00 16383.50 FORMAT "%8.2" EXTENDED_LIMITS -16384.00 16383.50
 /begin AXIS_DESCR STD_AXIS CrCtl_vBeg Vel 3 0.00 300.0000 FORMAT "%8.4" EXTENDED_LIMITS -327.6800 327.6700 DEPOSIT ABSOLUTE /end AXIS_DESCR
/end CHARACTERISTIC
/begin CHARACTERISTIC CrCtl_dvResBlwFDCG4_CUR "Curve for slope of set speed ramp RESUME BELOW, <= 4th gear" CURVE 0xC8E1C Kl_Xs16_Ws16 16383.50 dVel_20ms 0.00 16383.50 FORMAT "%8.2" EXTENDED_LIMITS -16384.00 16383.50
 /begin AXIS_DESCR STD_AXIS CrCtl_vBeg Vel 3 0.00 300.0000 FORMAT "%8.4" EXTENDED_LIMITS -327.6800 327.6700 DEPOSIT ABSOLUTE /end AXIS_DESCR
/end CHARACTERISTIC
/begin CHARACTERISTIC CrCtl_dvResBlwFDCG5_CUR "Curve for slope of set speed ramp RESUME BELOW, <= 5th gear" CURVE 0xC8E2A Kl_Xs16_Ws16 16383.50 dVel_20ms 0.00 16383.50 FORMAT "%8.2" EXTENDED_LIMITS -16384.00 16383.50
 /begin AXIS_DESCR STD_AXIS CrCtl_vBeg Vel 3 0.00 300.0000 FORMAT "%8.4" EXTENDED_LIMITS -327.6800 327.6700 DEPOSIT ABSOLUTE /end AXIS_DESCR
/end CHARACTERISTIC
/begin CHARACTERISTIC CrCtl_dvResBlwFDCG6_CUR "Curve for slope of set speed ramp RESUME BELOW, >=6th gear" CURVE 0xC8E38 Kl_Xs16_Ws16 16383.50 dVel_20ms 0.00 16383.50 FORMAT "%8.2" EXTENDED_LIMITS -16384.00 16383.50
 /begin AXIS_DESCR STD_AXIS CrCtl_vBeg Vel 3 0.00 300.0000 FORMAT "%8.4" EXTENDED_LIMITS -327.6800 327.6700 DEPOSIT ABSOLUTE /end AXIS_DESCR
/end CHARACTERISTIC
/begin CHARACTERISTIC CrCtl_dvResBlwG3_MAP "KF Anstieg FGR Rampengeschwindigkeit bei WA von unten für Gang <= 3" MAP 0xC8E46 Kf_Xs16_Ys16_Ws16 16383.50 dVel_20ms 0.00 16383.50 FORMAT "%8.2" EXTENDED_LIMITS -16384.00 16383.50
 /begin AXIS_DESCR STD_AXIS CrCtl_vBeg Vel 3 0.00 300.0000 FORMAT "%8.4" EXTENDED_LIMITS -327.6800 327.6700 DEPOSIT ABSOLUTE /end AXIS_DESCR
 /begin AXIS_DESCR STD_AXIS CrCtl_vDiff_mp Vel 1 0.00 300.0000 FORMAT "%8.4" EXTENDED_LIMITS -327.6800 327.6700 DEPOSIT ABSOLUTE /end AXIS_DESCR
/end CHARACTERISTIC
/begin CHARACTERISTIC CrCtl_dvResBlwG4_MAP "KF Anstieg FGR Rampengeschwindigkeit bei WA von unten für 4. Gang" MAP 0xC8E58 Kf_Xs16_Ys16_Ws16 16383.50 dVel_20ms 0.00 16383.50 FORMAT "%8.2" EXTENDED_LIMITS -16384.00 16383.50
 /begin AXIS_DESCR STD_AXIS CrCtl_vBeg Vel 3 0.00 300.0000 FORMAT "%8.4" EXTENDED_LIMITS -327.6800 327.6700 DEPOSIT ABSOLUTE /end AXIS_DESCR
 /begin AXIS_DESCR STD_AXIS CrCtl_vDiff_mp Vel 1 0.00 300.0000 FORMAT "%8.4" EXTENDED_LIMITS -327.6800 327.6700 DEPOSIT ABSOLUTE /end AXIS_DESCR
/end CHARACTERISTIC
/begin CHARACTERISTIC CrCtl_dvResBlwG5_MAP "KF Anstieg FGR Rampengeschwindigkeit bei WA von unten für 5. Gang" MAP 0xC8E6A Kf_Xs16_Ys16_Ws16 16383.50 dVel_20ms 0.00 16383.50 FORMAT "%8.2" EXTENDED_LIMITS -16384.00 16383.50
 /begin AXIS_DESCR STD_AXIS CrCtl_vBeg Vel 3 0.00 300.0000 FORMAT "%8.4" EXTENDED_LIMITS -327.6800 327.6700 DEPOSIT ABSOLUTE /end AXIS_DESCR
 /begin AXIS_DESCR STD_AXIS CrCtl_vDiff_mp Vel 1 0.00 300.0000 FORMAT "%8.4" EXTENDED_LIMITS -327.6800 327.6700 DEPOSIT ABSOLUTE /end AXIS_DESCR
/end CHARACTERISTIC
/begin CHARACTERISTIC CrCtl_dvResBlwG6_MAP "KF Anstieg FGR Rampengeschwindigkeit bei WA von unten für 6. Gang" MAP 0xC8E7C Kf_Xs16_Ys16_Ws16 16383.50 dVel_20ms 0.00 16383.50 FORMAT "%8.2" EXTENDED_LIMITS -16384.00 16383.50
 /begin AXIS_DESCR STD_AXIS CrCtl_vBeg Vel 3 0.00 300.0000 FORMAT "%8.4" EXTENDED_LIMITS -327.6800 327.6700 DEPOSIT ABSOLUTE /end AXIS_DESCR
 /begin AXIS_DESCR STD_AXIS CrCtl_vDiff_mp Vel 1 0.00 300.0000 FORMAT "%8.4" EXTENDED_LIMITS -327.6800 327.6700 DEPOSIT ABSOLUTE /end AXIS_DESCR
/end CHARACTERISTIC
/begin CHARACTERISTIC CrCtl_facIncSlope_CUR "Überhöhungskennlinie für SET+, SET-, WA+, WA-" CURVE 0xC8E8E Kl_Xs16_Ws16 7800.049 Prc_1000 -3900.024 3900.024 FORMAT "%8.3" EXTENDED_LIMITS -4000.000 3999.878
 /begin AXIS_DESCR STD_AXIS Rail_tiThresMonEna Time_ms 6 0.00 655350.0 FORMAT "%8.1" DEPOSIT ABSOLUTE /end AXIS_DESCR
/end CHARACTERISTIC
/begin CHARACTERISTIC CrCtl_facPropAcc_C "Proportionalfaktor für Initialmoment von Fahrgeschwindigkeit in EIN+/WAU des FGR" VALUE 0xC8EA8 Kw_Ws16 79.99756 Vel2TrqPrp 0.00 79.99756 FORMAT "%8.5" EXTENDED_LIMITS -80.00000 79.99756 /end CHARACTERISTIC
/begin CHARACTERISTIC CrCtl_facPropDecl_C "Proportionalfaktor für Offset von Fahrgeschwindigkeit zur Momentenerhöhung nach EIN-" VALUE 0xC8EAA Kw_Ws16 79.99756 Vel2TrqPrp 0.00 79.99756 FORMAT "%8.5" EXTENDED_LIMITS -80.00000 79.99756 /end CHARACTERISTIC
/begin CHARACTERISTIC CrCtl_facRedDecl_C "Faktor zur Momentenreduzierung bei Übergang HALTEN zu EIN- nach Ablauf TIP-Erkennung" VALUE 0xC8EAC Kw_Ws16 100.0000 Prc 0.00 100.0000 FORMAT "%8.4" EXTENDED_LIMITS -400.0000 399.9878 /end CHARACTERISTIC
/begin CHARACTERISTIC CrCtl_facRedHi_C "höherer Faktor Reduzierung FGR Moment bei Loslassen EIN+ (FGR-Moment > Schwelle)" VALUE 0xC8EAE Kw_Ws16 100.0000 Prc 0.00 100.0000 FORMAT "%8.4" EXTENDED_LIMITS -400.0000 399.9878 /end CHARACTERISTIC
/begin CHARACTERISTIC CrCtl_facRedLo_C "niederer Faktor Reduzierung FGR-Moment bei Loslassen EIN+ (FGR-Moment <= Schwelle)" VALUE 0xC8EB0 Kw_Ws16 100.0000 Prc 0.00 100.0000 FORMAT "%8.4" EXTENDED_LIMITS -400.0000 399.9878 /end CHARACTERISTIC
/begin CHARACTERISTIC CrCtl_facResAbvFDC_CUR "Curve for reducing the slope of ramp speed in WA- and Tip- at the end of the ramp" CURVE 0xC8EB2 Kl_Xs16_Ws16 99.97559 Prc_1000 0.00 99.97559 FORMAT "%8.4" EXTENDED_LIMITS -4000.000 3999.878
 /begin AXIS_DESCR STD_AXIS CrCtl_vDiffRed_mp Vel 6 -327.6800 327.6700 FORMAT "%8.4" DEPOSIT ABSOLUTE /end AXIS_DESCR
/end CHARACTERISTIC
/begin CHARACTERISTIC CrCtl_facResAbv_CUR "Abflachungskennlinie für WA-" CURVE 0xC8ECC Kl_Xs16_Ws16 99.97559 Prc_1000 0.00 99.97559 FORMAT "%8.4" EXTENDED_LIMITS -4000.000 3999.878
 /begin AXIS_DESCR STD_AXIS CrCtl_vDiffRed_mp Vel 3 -327.6800 327.6700 FORMAT "%8.4" DEPOSIT ABSOLUTE /end AXIS_DESCR
/end CHARACTERISTIC
/begin CHARACTERISTIC CrCtl_facResBlwFDC_CUR " Curve for reducing the slope of ramp speed in WA+ and Tip+ at the end of the ramp" CURVE 0xC8EDA Kl_Xs16_Ws16 99.97559 Prc_1000 0.00 99.97559 FORMAT "%8.4" EXTENDED_LIMITS -4000.000 3999.878
 /begin AXIS_DESCR STD_AXIS CrCtl_vDiffRed_mp Vel 6 -327.6800 327.6700 FORMAT "%8.4" DEPOSIT ABSOLUTE /end AXIS_DESCR
/end CHARACTERISTIC
/begin CHARACTERISTIC CrCtl_facResBlw_CUR "Abflachungskennlinie für WA+" CURVE 0xC8EF4 Kl_Xs16_Ws16 99.97559 Prc_1000 0.00 99.97559 FORMAT "%8.4" EXTENDED_LIMITS -4000.000 3999.878
 /begin AXIS_DESCR STD_AXIS CrCtl_vDiffRed_mp Vel 3 -327.6800 327.6700 FORMAT "%8.4" DEPOSIT ABSOLUTE /end AXIS_DESCR
/end CHARACTERISTIC
/begin CHARACTERISTIC CrCtl_facRmpRes_C "Faktor für Rampensteigung FGR-Geschwindigkeit WA (Endphase WA-Rampe)" VALUE 0xC8F02 Kw_Ws16 1.000000 Fact 0.00 1.000000 FORMAT "%8.6" EXTENDED_LIMITS -4.000000 3.999878 /end CHARACTERISTIC
/begin CHARACTERISTIC CrCtl_HoldGear2IKi_C "Integralverstärkung Ki Kleinsignalbereich in HALTEN für 2. Gang" VALUE 0xC8F04 Kw_Wu32 19999999.9953 Ki_Vel2TrqPrp 0.00 19999999.9953 FORMAT "%13.4" /end CHARACTERISTIC
/begin CHARACTERISTIC CrCtl_HoldGear2IKiPos_C "Integralverstärkung Ki pos. Großsignalbereich in HALTEN für 2. Gang" VALUE 0xC8F08 Kw_Wu32 19999999.9953 Ki_Vel2TrqPrp 0.00 19999999.9953 FORMAT "%13.4" /end CHARACTERISTIC
/begin CHARACTERISTIC CrCtl_HoldGear2IKiNeg_C "Integralverstärkung Ki neg. Großsignalbereich in HALTEN für 2. Gang" VALUE 0xC8F0C Kw_Wu32 19999999.9953 Ki_Vel2TrqPrp 0.00 19999999.9953 FORMAT "%13.4" /end CHARACTERISTIC
/begin CHARACTERISTIC CrCtl_vHoldGear2IWinPos_C "obere Grenze Kleinsignalbereich I-Anteil in HALTEN, 2. Gang" VALUE 0xC8F10 Kw_Ws16 300.0000 Vel 0.00 300.0000 FORMAT "%8.4" EXTENDED_LIMITS -327.6800 327.6700 /end CHARACTERISTIC
/begin CHARACTERISTIC CrCtl_vHoldGear2IWinNeg_C "untere Grenze Kleinsignalbereich I-Anteil in HALTEN, 2. Gang" VALUE 0xC8F12 Kw_Ws16 300.0000 Vel -300.0000 0.00 FORMAT "%8.4" EXTENDED_LIMITS -327.6800 327.6700 /end CHARACTERISTIC
/begin CHARACTERISTIC CrCtl_HoldGear2PKp_C "Proportionalverstärkung Kp Kleinsignalbereich in HALTEN, 2. Gang" VALUE 0xC8F14 Kw_Wu32 1310719.99969 Kp_Vel2TrqPrp 0.00 1310719.99969 FORMAT "%13.5" /end CHARACTERISTIC
/begin CHARACTERISTIC CrCtl_HoldGear2PKpPos_C "Proportionalverstärkung Kp pos. Großsignalbereich in HALTEN, 2. Gang" VALUE 0xC8F18 Kw_Wu32 1310719.99969 Kp_Vel2TrqPrp 0.00 1310719.99969 FORMAT "%13.5" /end CHARACTERISTIC
/begin CHARACTERISTIC CrCtl_HoldGear2PKpNeg_C "Proportionalverstärkung Kp neg. Großsignalbereich in HALTEN, 2. Gang" VALUE 0xC8F1C Kw_Wu32 1310719.99969 Kp_Vel2TrqPrp 0.00 1310719.99969 FORMAT "%13.5" /end CHARACTERISTIC
/begin CHARACTERISTIC CrCtl_vHoldGear2PWinPos_C "obere Grenze Kleinsignalbereich P-Anteil in HALTEN, 2. Gang" VALUE 0xC8F20 Kw_Ws16 300.0000 Vel 0.00 300.0000 FORMAT "%8.4" EXTENDED_LIMITS -327.6800 327.6700 /end CHARACTERISTIC
/begin CHARACTERISTIC CrCtl_vHoldGear2PWinNeg_C "untere Grenze Kleinsignalbereich P-Anteil in HALTEN, 2. Gang" VALUE 0xC8F22 Kw_Ws16 300.0000 Vel -300.0000 0.00 FORMAT "%8.4" EXTENDED_LIMITS -327.6800 327.6700 /end CHARACTERISTIC
/begin CHARACTERISTIC CrCtl_HoldGear3IKi_C "Integralverstärkung Kleinsignalbereich in HALTEN, 3. Gang" VALUE 0xC8F24 Kw_Wu32 19999999.9953 Ki_Vel2TrqPrp 0.00 19999999.9953 FORMAT "%13.4" /end CHARACTERISTIC
/begin CHARACTERISTIC CrCtl_HoldGear3IKiPos_C "Integralverstärkung Ki pos. Großsignalbereich in HALTEN, 3. Gang" VALUE 0xC8F28 Kw_Wu32 19999999.9953 Ki_Vel2TrqPrp 0.00 19999999.9953 FORMAT "%13.4" /end CHARACTERISTIC
/begin CHARACTERISTIC CrCtl_HoldGear3IKiNeg_C "Integralverstärkung Ki neg. Großsignalbereich in HALTEN, 3. Gang" VALUE 0xC8F2C Kw_Wu32 19999999.9953 Ki_Vel2TrqPrp 0.00 19999999.9953 FORMAT "%13.4" /end CHARACTERISTIC
/begin CHARACTERISTIC CrCtl_vHoldGear3IWinPos_C "obere Grenze Kleinsignalbereich I-Anteil in HALTEN, 3. Gang" VALUE 0xC8F30 Kw_Ws16 300.0000 Vel 0.00 300.0000 FORMAT "%8.4" EXTENDED_LIMITS -327.6800 327.6700 /end CHARACTERISTIC
/begin CHARACTERISTIC CrCtl_vHoldGear3IWinNeg_C "untere Grenze Kleinsignalbereich I-Anteil in HALTEN, 3. Gang" VALUE 0xC8F32 Kw_Ws16 300.0000 Vel -300.0000 0.00 FORMAT "%8.4" EXTENDED_LIMITS -327.6800 327.6700 /end CHARACTERISTIC
/begin CHARACTERISTIC CrCtl_HoldGear3PKp_C "Proportionalverstärkung Kp Kleinsignalbereich in HALTEN, 3. Gang" VALUE 0xC8F34 Kw_Wu32 1310719.99969 Kp_Vel2TrqPrp 0.00 1310719.99969 FORMAT "%13.5" /end CHARACTERISTIC
/begin CHARACTERISTIC CrCtl_HoldGear3PKpPos_C "Proportionalverstärkung Kp pos. Großsignalbereich in HALTEN, 3. Gang" VALUE 0xC8F38 Kw_Wu32 1310719.99969 Kp_Vel2TrqPrp 0.00 1310719.99969 FORMAT "%13.5" /end CHARACTERISTIC
/begin CHARACTERISTIC CrCtl_HoldGear3PKpNeg_C "Proportionalverstärkung Kp neg. Großsignalbereich in HALTEN, 3. Gang" VALUE 0xC8F3C Kw_Wu32 1310719.99969 Kp_Vel2TrqPrp 0.00 1310719.99969 FORMAT "%13.5" /end CHARACTERISTIC
/begin CHARACTERISTIC CrCtl_vHoldGear3PWinPos_C "obere Grenze Kleinsignalbereich P-Anteil in HALTEN, 3. Gang" VALUE 0xC8F40 Kw_Ws16 300.0000 Vel 0.00 300.0000 FORMAT "%8.4" EXTENDED_LIMITS -327.6800 327.6700 /end CHARACTERISTIC
/begin CHARACTERISTIC CrCtl_vHoldGear3PWinNeg_C "untere Grenze Kleinsignalbereich P-Anteil in HALTEN, 3. Gang" VALUE 0xC8F42 Kw_Ws16 300.0000 Vel -300.0000 0.00 FORMAT "%8.4" EXTENDED_LIMITS -327.6800 327.6700 /end CHARACTERISTIC
/begin CHARACTERISTIC CrCtl_HoldGear4IKi_C "Integralverstärkung Kleinsignalbereich in HALTEN, 4. Gang" VALUE 0xC8F44 Kw_Wu32 19999999.9953 Ki_Vel2TrqPrp 0.00 19999999.9953 FORMAT "%13.4" /end CHARACTERISTIC
/begin CHARACTERISTIC CrCtl_HoldGear4IKiPos_C "Integralverstärkung Ki pos. Großsignalbereich in HALTEN, 4. Gang" VALUE 0xC8F48 Kw_Wu32 19999999.9953 Ki_Vel2TrqPrp 0.00 19999999.9953 FORMAT "%13.4" /end CHARACTERISTIC
/begin CHARACTERISTIC CrCtl_HoldGear4IKiNeg_C "Integralverstärkung Ki neg. Großsignalbereich in HALTEN, 4. Gang" VALUE 0xC8F4C Kw_Wu32 19999999.9953 Ki_Vel2TrqPrp 0.00 19999999.9953 FORMAT "%13.4" /end CHARACTERISTIC
/begin CHARACTERISTIC CrCtl_vHoldGear4IWinPos_C "obere Grenze Kleinsignalbereich I-Anteil in HALTEN, 4. Gang" VALUE 0xC8F50 Kw_Ws16 300.0000 Vel 0.00 300.0000 FORMAT "%8.4" EXTENDED_LIMITS -327.6800 327.6700 /end CHARACTERISTIC
/begin CHARACTERISTIC CrCtl_vHoldGear4IWinNeg_C "untere Grenze Kleinsignalbereich I-Anteil in HALTEN, 4. Gang" VALUE 0xC8F52 Kw_Ws16 300.0000 Vel -300.0000 0.00 FORMAT "%8.4" EXTENDED_LIMITS -327.6800 327.6700 /end CHARACTERISTIC
/begin CHARACTERISTIC CrCtl_HoldGear4PKp_C "Proportionalverstärkung Kp Kleinsignalbereich in HALTEN, 4 Gang" VALUE 0xC8F54 Kw_Wu32 1310719.99969 Kp_Vel2TrqPrp 0.00 1310719.99969 FORMAT "%13.5" /end CHARACTERISTIC
/begin CHARACTERISTIC CrCtl_HoldGear4PKpPos_C "Proportionalverstärkung Kp pos. Großsignalbereich in HALTEN, 4. Gang" VALUE 0xC8F58 Kw_Wu32 1310719.99969 Kp_Vel2TrqPrp 0.00 1310719.99969 FORMAT "%13.5" /end CHARACTERISTIC
/begin CHARACTERISTIC CrCtl_HoldGear4PKpNeg_C "Proportionalverstärkung Kp neg. Großsignalbereich in HALTEN, 4. Gang" VALUE 0xC8F5C Kw_Wu32 1310719.99969 Kp_Vel2TrqPrp 0.00 1310719.99969 FORMAT "%13.5" /end CHARACTERISTIC
/begin CHARACTERISTIC CrCtl_vHoldGear4PWinPos_C "obere Grenze Kleinsignalbereich P-Anteil in HALTEN, 4. Gang" VALUE 0xC8F60 Kw_Ws16 300.0000 Vel 0.00 300.0000 FORMAT "%8.4" EXTENDED_LIMITS -327.6800 327.6700 /end CHARACTERISTIC
/begin CHARACTERISTIC CrCtl_vHoldGear4PWinNeg_C "untere Grenze Kleinsignalbereich P-Anteil in HALTEN, 4. Gang" VALUE 0xC8F62 Kw_Ws16 300.0000 Vel -300.0000 0.00 FORMAT "%8.4" EXTENDED_LIMITS -327.6800 327.6700 /end CHARACTERISTIC
/begin CHARACTERISTIC CrCtl_HoldGear5IKi_C "Integralverstärkung Kleinsignalbereich in HALTEN, 5. Gang" VALUE 0xC8F64 Kw_Wu32 19999999.9953 Ki_Vel2TrqPrp 0.00 19999999.9953 FORMAT "%13.4" /end CHARACTERISTIC
/begin CHARACTERISTIC CrCtl_HoldGear5IKiPos_C "Integralverstärkung Ki pos. Großsignalbereich in HALTEN, 5. Gang" VALUE 0xC8F68 Kw_Wu32 19999999.9953 Ki_Vel2TrqPrp 0.00 19999999.9953 FORMAT "%13.4" /end CHARACTERISTIC
/begin CHARACTERISTIC CrCtl_HoldGear5IKiNeg_C "Integralverstärkung Ki neg. Großsignalbereich in HALTEN, 5. Gang" VALUE 0xC8F6C Kw_Wu32 19999999.9953 Ki_Vel2TrqPrp 0.00 19999999.9953 FORMAT "%13.4" /end CHARACTERISTIC
/begin CHARACTERISTIC CrCtl_vHoldGear5IWinPos_C "obere Grenze Kleinsignalbereich I-Anteil in HALTEN, 5. Gang" VALUE 0xC8F70 Kw_Ws16 300.0000 Vel 0.00 300.0000 FORMAT "%8.4" EXTENDED_LIMITS -327.6800 327.6700 /end CHARACTERISTIC
/begin CHARACTERISTIC CrCtl_vHoldGear5IWinNeg_C "untere Grenze Kleinsignalbereich I-Anteil in HALTEN, 5. Gang" VALUE 0xC8F72 Kw_Ws16 300.0000 Vel -300.0000 0.00 FORMAT "%8.4" EXTENDED_LIMITS -327.6800 327.6700 /end CHARACTERISTIC
/begin CHARACTERISTIC CrCtl_HoldGear5PKp_C "Proportionalverstärkung Kp Kleinsignalbereich in HALTEN, 5 Gang" VALUE 0xC8F74 Kw_Wu32 1310719.99969 Kp_Vel2TrqPrp 0.00 1310719.99969 FORMAT "%13.5" /end CHARACTERISTIC
/begin CHARACTERISTIC CrCtl_HoldGear5PKpPos_C "Proportionalverstärkung Kp pos. Großsignalbereich in HALTEN, 5. Gang" VALUE 0xC8F78 Kw_Wu32 1310719.99969 Kp_Vel2TrqPrp 0.00 1310719.99969 FORMAT "%13.5" /end CHARACTERISTIC
/begin CHARACTERISTIC CrCtl_HoldGear5PKpNeg_C "Proportionalverstärkung Kp neg. Großsignalbereich in HALTEN, 5. Gang" VALUE 0xC8F7C Kw_Wu32 1310719.99969 Kp_Vel2TrqPrp 0.00 1310719.99969 FORMAT "%13.5" /end CHARACTERISTIC
/begin CHARACTERISTIC CrCtl_vHoldGear5PWinPos_C "obere Grenze Kleinsignalbereich P-Anteil in HALTEN, 5. Gang" VALUE 0xC8F80 Kw_Ws16 300.0000 Vel 0.00 300.0000 FORMAT "%8.4" EXTENDED_LIMITS -327.6800 327.6700 /end CHARACTERISTIC
/begin CHARACTERISTIC CrCtl_vHoldGear5PWinNeg_C "untere Grenze Kleinsignalbereich P-Anteil in HALTEN, 5. Gang" VALUE 0xC8F82 Kw_Ws16 300.0000 Vel -300.0000 0.00 FORMAT "%8.4" EXTENDED_LIMITS -327.6800 327.6700 /end CHARACTERISTIC
/begin CHARACTERISTIC CrCtl_HoldGear6IKi_C "Integralverstärkung Kleinsignalbereich in HALTEN, 6. Gang" VALUE 0xC8F84 Kw_Wu32 19999999.9953 Ki_Vel2TrqPrp 0.00 19999999.9953 FORMAT "%13.4" /end CHARACTERISTIC
/begin CHARACTERISTIC CrCtl_HoldGear6IKiPos_C "Integralverstärkung Ki neg. Großsignalbereich in HALTEN, 6. Gang" VALUE 0xC8F88 Kw_Wu32 19999999.9953 Ki_Vel2TrqPrp 0.00 19999999.9953 FORMAT "%13.4" /end CHARACTERISTIC
/begin CHARACTERISTIC CrCtl_HoldGear6IKiNeg_C "Integralverstärkung Ki neg. Großsignalbereich in HALTEN, 6. Gang" VALUE 0xC8F8C Kw_Wu32 19999999.9953 Ki_Vel2TrqPrp 0.00 19999999.9953 FORMAT "%13.4" /end CHARACTERISTIC
/begin CHARACTERISTIC CrCtl_vHoldGear6IWinPos_C "obere Grenze Kleinsignalbereich I-Anteil in HALTEN, 6. Gang" VALUE 0xC8F90 Kw_Ws16 300.0000 Vel 0.00 300.0000 FORMAT "%8.4" EXTENDED_LIMITS -327.6800 327.6700 /end CHARACTERISTIC
/begin CHARACTERISTIC CrCtl_vHoldGear6IWinNeg_C "untere Grenze Kleinsignalbereich I-Anteil in HALTEN, 6. Gang" VALUE 0xC8F92 Kw_Ws16 300.0000 Vel -300.0000 0.00 FORMAT "%8.4" EXTENDED_LIMITS -327.6800 327.6700 /end CHARACTERISTIC
/begin CHARACTERISTIC CrCtl_HoldGear6PKp_C "Proportionalverstärkung Kp Kleinsignalbereich in HALTEN, 6 Gang" VALUE 0xC8F94 Kw_Wu32 1310719.99969 Kp_Vel2TrqPrp 0.00 1310719.99969 FORMAT "%13.5" /end CHARACTERISTIC
/begin CHARACTERISTIC CrCtl_HoldGear6PKpPos_C "Proportionalverstärkung Kp pos. Großsignalbereich in HALTEN, 6. Gang" VALUE 0xC8F98 Kw_Wu32 1310719.99969 Kp_Vel2TrqPrp 0.00 1310719.99969 FORMAT "%13.5" /end CHARACTERISTIC
/begin CHARACTERISTIC CrCtl_HoldGear6PKpNeg_C "Proportionalverstärkung Kp neg. Großsignalbereich in HALTEN, 6. Gang" VALUE 0xC8F9C Kw_Wu32 1310719.99969 Kp_Vel2TrqPrp 0.00 1310719.99969 FORMAT "%13.5" /end CHARACTERISTIC
/begin CHARACTERISTIC CrCtl_vHoldGear6PWinPos_C "obere Grenze Kleinsignalbereich P-Anteil in HALTEN, 6. Gang" VALUE 0xC8FA0 Kw_Ws16 300.0000 Vel 0.00 300.0000 FORMAT "%8.4" EXTENDED_LIMITS -327.6800 327.6700 /end CHARACTERISTIC
/begin CHARACTERISTIC CrCtl_vHoldGear6PWinNeg_C "untere Grenze Kleinsignalbereich P-Anteil in HALTEN, 6. Gang" VALUE 0xC8FA2 Kw_Ws16 300.0000 Vel -300.0000 0.00 FORMAT "%8.4" EXTENDED_LIMITS -327.6800 327.6700 /end CHARACTERISTIC
/begin CHARACTERISTIC CrCtl_nMaxAlw_C "Obere Drehzahlschwelle Abschaltung FGR" VALUE 0xC8B64 Kw_Ws16 6000.000 EngN 0.00 6000.000 FORMAT "%8.3" EXTENDED_LIMITS -32768.00 32767.00 /end CHARACTERISTIC
/begin CHARACTERISTIC CrCtl_nMinAlw_C "untere Drehzahlschwelle Abschaltung FGR" VALUE 0xC8B66 Kw_Ws16 6000.000 EngN 0.00 6000.000 FORMAT "%8.3" EXTENDED_LIMITS -32768.00 32767.00 /end CHARACTERISTIC
/begin CHARACTERISTIC CrCtl_tiResAbvGear2DT1_C "DT1 Zeitkonstante T1 Endphase WA oben für 2. Gang" VALUE 0xC8FA4 Kw_Wu32 4294.9673 TimeDelay_s 0.0000010000000 4294.9673 FORMAT "%9.4" /end CHARACTERISTIC
/begin CHARACTERISTIC CrCtl_ResAbvGear2DT1Kd_C "Differentialverstärkung Endphase WA oben 2. Gang" VALUE 0xC8FA8 Kw_Ws32 1310719.99969 Kd_Vel2TrqPrp -655360.000000 655359.999695 FORMAT "%13.6" /end CHARACTERISTIC
/begin CHARACTERISTIC CrCtl_tiResAbvGear3DT1_C "DT1 Zeitkonstante T1 Endphase WA oben für 3. Gang" VALUE 0xC8FAC Kw_Wu32 4294.9673 TimeDelay_s 0.0000010000000 4294.9673 FORMAT "%9.4" /end CHARACTERISTIC
/begin CHARACTERISTIC CrCtl_ResAbvGear3DT1Kd_C "Differentialverstärkung Endphase WA oben 3. Gang" VALUE 0xC8FB0 Kw_Ws32 1310719.99969 Kd_Vel2TrqPrp -655360.000000 655359.999695 FORMAT "%13.6" /end CHARACTERISTIC
/begin CHARACTERISTIC CrCtl_tiResAbvGear4DT1_C "DT1 Zeitkonstante T1 Endphase WA oben für 4. Gang" VALUE 0xC8FB4 Kw_Wu32 4294.9673 TimeDelay_s 0.0000010000000 4294.9673 FORMAT "%9.4" /end CHARACTERISTIC
/begin CHARACTERISTIC CrCtl_ResAbvGear4DT1Kd_C "Differentialverstärkung Endphase WA oben 4. Gang" VALUE 0xC8FB8 Kw_Ws32 1310719.99969 Kd_Vel2TrqPrp -655360.000000 655359.999695 FORMAT "%13.6" /end CHARACTERISTIC
/begin CHARACTERISTIC CrCtl_tiResAbvGear5DT1_C "DT1 Zeitkonstante T1 Endphase WA oben für 5. Gang" VALUE 0xC8FBC Kw_Wu32 4294.9673 TimeDelay_s 0.0000010000000 4294.9673 FORMAT "%9.4" /end CHARACTERISTIC
/begin CHARACTERISTIC CrCtl_ResAbvGear5DT1Kd_C "Differentialverstärkung Endphase WA oben 5. Gang" VALUE 0xC8FC0 Kw_Ws32 1310719.99969 Kd_Vel2TrqPrp -655360.000000 655359.999695 FORMAT "%13.6" /end CHARACTERISTIC
/begin CHARACTERISTIC CrCtl_tiResAbvGear6DT1_C "DT1 Zeitkonstante T1 Endphase WA oben für 6. Gang" VALUE 0xC8FC4 Kw_Wu32 4294.9673 TimeDelay_s 0.0000010000000 4294.9673 FORMAT "%9.4" /end CHARACTERISTIC
/begin CHARACTERISTIC CrCtl_ResAbvGear6DT1Kd_C "Differentialverstärkung Endphase WA oben 6. Gang" VALUE 0xC8FC8 Kw_Ws32 1310719.99969 Kd_Vel2TrqPrp -655360.000000 655359.999695 FORMAT "%13.6" /end CHARACTERISTIC
/begin CHARACTERISTIC CrCtl_ResBlwGear2IKi_C "PI-Reglerparametersatz für WA+ 2.Gang" VALUE 0xC8FCC Kw_Wu32 19999999.9953 Ki_Vel2TrqPrp 0.00 19999999.9953 FORMAT "%13.4" /end CHARACTERISTIC
/begin CHARACTERISTIC CrCtl_ResBlwGear2IKiPos_C "PI-Reglerparametersatz für WA+ 2.Gang" VALUE 0xC8FD0 Kw_Wu32 19999999.9953 Ki_Vel2TrqPrp 0.00 19999999.9953 FORMAT "%13.4" /end CHARACTERISTIC
/begin CHARACTERISTIC CrCtl_ResBlwGear2IKiNeg_C "PI-Reglerparametersatz für WA+ 2.Gang" VALUE 0xC8FD4 Kw_Wu32 19999999.9953 Ki_Vel2TrqPrp 0.00 19999999.9953 FORMAT "%13.4" /end CHARACTERISTIC
/begin CHARACTERISTIC CrCtl_vResBlwGear2IWinPos_C "PI-Reglerparametersatz für WA+ 2.Gang" VALUE 0xC8FD8 Kw_Ws16 300.0000 Vel 0.00 300.0000 FORMAT "%8.4" EXTENDED_LIMITS -327.6800 327.6700 /end CHARACTERISTIC
/begin CHARACTERISTIC CrCtl_vResBlwGear2IWinNeg_C "PI-Reglerparametersatz für WA+ 2.Gang" VALUE 0xC8FDA Kw_Ws16 300.0000 Vel -300.0000 0.00 FORMAT "%8.4" EXTENDED_LIMITS -327.6800 327.6700 /end CHARACTERISTIC
/begin CHARACTERISTIC CrCtl_ResBlwGear2PKp_C "PI-Reglerparametersatz für WA+ 2.Gang" VALUE 0xC8FDC Kw_Wu32 1310719.99969 Kp_Vel2TrqPrp 0.00 1310719.99969 FORMAT "%13.5" /end CHARACTERISTIC
/begin CHARACTERISTIC CrCtl_ResBlwGear2PKpPos_C "PI-Reglerparametersatz für WA+ 2.Gang" VALUE 0xC8FE0 Kw_Wu32 1310719.99969 Kp_Vel2TrqPrp 0.00 1310719.99969 FORMAT "%13.5" /end CHARACTERISTIC
/begin CHARACTERISTIC CrCtl_ResBlwGear2PKpNeg_C "PI-Reglerparametersatz für WA+ 2.Gang" VALUE 0xC8FE4 Kw_Wu32 1310719.99969 Kp_Vel2TrqPrp 0.00 1310719.99969 FORMAT "%13.5" /end CHARACTERISTIC
/begin CHARACTERISTIC CrCtl_vResBlwGear2PWinPos_C "PI-Reglerparametersatz für WA+ 2.Gang" VALUE 0xC8FE8 Kw_Ws16 300.0000 Vel 0.00 300.0000 FORMAT "%8.4" EXTENDED_LIMITS -327.6800 327.6700 /end CHARACTERISTIC
/begin CHARACTERISTIC CrCtl_vResBlwGear2PWinNeg_C "PI-Reglerparametersatz für WA+ 2.Gang" VALUE 0xC8FEA Kw_Ws16 300.0000 Vel -300.0000 0.00 FORMAT "%8.4" EXTENDED_LIMITS -327.6800 327.6700 /end CHARACTERISTIC
/begin CHARACTERISTIC CrCtl_ResBlwGear3IKi_C "PI-Reglerparametersatz für WA+ 3.Gang" VALUE 0xC8FEC Kw_Wu32 19999999.9953 Ki_Vel2TrqPrp 0.00 19999999.9953 FORMAT "%13.4" /end CHARACTERISTIC
/begin CHARACTERISTIC CrCtl_ResBlwGear3IKiPos_C "PI-Reglerparametersatz für WA+ 3.Gang" VALUE 0xC8FF0 Kw_Wu32 19999999.9953 Ki_Vel2TrqPrp 0.00 19999999.9953 FORMAT "%13.4" /end CHARACTERISTIC
/begin CHARACTERISTIC CrCtl_ResBlwGear3IKiNeg_C "PI-Reglerparametersatz für WA+ 3.Gang" VALUE 0xC8FF4 Kw_Wu32 19999999.9953 Ki_Vel2TrqPrp 0.00 19999999.9953 FORMAT "%13.4" /end CHARACTERISTIC
/begin CHARACTERISTIC CrCtl_vResBlwGear3IWinPos_C "PI-Reglerparametersatz für WA+ 3.Gang" VALUE 0xC8FF8 Kw_Ws16 300.0000 Vel 0.00 300.0000 FORMAT "%8.4" EXTENDED_LIMITS -327.6800 327.6700 /end CHARACTERISTIC
/begin CHARACTERISTIC CrCtl_vResBlwGear3IWinNeg_C "PI-Reglerparametersatz für WA+ 3.Gang" VALUE 0xC8FFA Kw_Ws16 300.0000 Vel -300.0000 0.00 FORMAT "%8.4" EXTENDED_LIMITS -327.6800 327.6700 /end CHARACTERISTIC
/begin CHARACTERISTIC CrCtl_ResBlwGear3PKp_C "PI-Reglerparametersatz für WA+ 3.Gang" VALUE 0xC8FFC Kw_Wu32 1310719.99969 Kp_Vel2TrqPrp 0.00 1310719.99969 FORMAT "%13.5" /end CHARACTERISTIC
/begin CHARACTERISTIC CrCtl_ResBlwGear3PKpPos_C "PI-Reglerparametersatz für WA+ 3.Gang" VALUE 0xC9000 Kw_Wu32 1310719.99969 Kp_Vel2TrqPrp 0.00 1310719.99969 FORMAT "%13.5" /end CHARACTERISTIC
/begin CHARACTERISTIC CrCtl_ResBlwGear3PKpNeg_C "PI-Reglerparametersatz für WA+ 3.Gang" VALUE 0xC9004 Kw_Wu32 1310719.99969 Kp_Vel2TrqPrp 0.00 1310719.99969 FORMAT "%13.5" /end CHARACTERISTIC
/begin CHARACTERISTIC CrCtl_vResBlwGear3PWinPos_C "PI-Reglerparametersatz für WA+ 3.Gang" VALUE 0xC9008 Kw_Ws16 300.0000 Vel 0.00 300.0000 FORMAT "%8.4" EXTENDED_LIMITS -327.6800 327.6700 /end CHARACTERISTIC
/begin CHARACTERISTIC CrCtl_vResBlwGear3PWinNeg_C "PI-Reglerparametersatz für WA+ 3.Gang" VALUE 0xC900A Kw_Ws16 300.0000 Vel -300.0000 0.00 FORMAT "%8.4" EXTENDED_LIMITS -327.6800 327.6700 /end CHARACTERISTIC
/begin CHARACTERISTIC CrCtl_ResBlwGear4IKi_C "PI-Reglerparametersatz für WA+ 4.Gang" VALUE 0xC900C Kw_Wu32 19999999.9953 Ki_Vel2TrqPrp 0.00 19999999.9953 FORMAT "%13.4" /end CHARACTERISTIC
/begin CHARACTERISTIC CrCtl_ResBlwGear4IKiPos_C "PI-Reglerparametersatz für WA+ 4.Gang" VALUE 0xC9010 Kw_Wu32 19999999.9953 Ki_Vel2TrqPrp 0.00 19999999.9953 FORMAT "%13.4" /end CHARACTERISTIC
/begin CHARACTERISTIC CrCtl_ResBlwGear4IKiNeg_C "PI-Reglerparametersatz für WA+ 4.Gang" VALUE 0xC9014 Kw_Wu32 19999999.9953 Ki_Vel2TrqPrp 0.00 19999999.9953 FORMAT "%13.4" /end CHARACTERISTIC
/begin CHARACTERISTIC CrCtl_vResBlwGear4IWinPos_C "PI-Reglerparametersatz für WA+ 4.Gang" VALUE 0xC9018 Kw_Ws16 300.0000 Vel 0.00 300.0000 FORMAT "%8.4" EXTENDED_LIMITS -327.6800 327.6700 /end CHARACTERISTIC
/begin CHARACTERISTIC CrCtl_vResBlwGear4IWinNeg_C "PI-Reglerparametersatz für WA+ 4.Gang" VALUE 0xC901A Kw_Ws16 300.0000 Vel -300.0000 0.00 FORMAT "%8.4" EXTENDED_LIMITS -327.6800 327.6700 /end CHARACTERISTIC
/begin CHARACTERISTIC CrCtl_ResBlwGear4PKp_C "PI-Reglerparametersatz für WA+ 4.Gang" VALUE 0xC901C Kw_Wu32 1310719.99969 Kp_Vel2TrqPrp 0.00 1310719.99969 FORMAT "%13.5" /end CHARACTERISTIC
/begin CHARACTERISTIC CrCtl_ResBlwGear4PKpPos_C "PI-Reglerparametersatz für WA+ 4.Gang" VALUE 0xC9020 Kw_Wu32 1310719.99969 Kp_Vel2TrqPrp 0.00 1310719.99969 FORMAT "%13.5" /end CHARACTERISTIC
/begin CHARACTERISTIC CrCtl_ResBlwGear4PKpNeg_C "PI-Reglerparametersatz für WA+ 4.Gang" VALUE 0xC9024 Kw_Wu32 1310719.99969 Kp_Vel2TrqPrp 0.00 1310719.99969 FORMAT "%13.5" /end CHARACTERISTIC
/begin CHARACTERISTIC CrCtl_vResBlwGear4PWinPos_C "PI-Reglerparametersatz für WA+ 4.Gang" VALUE 0xC9028 Kw_Ws16 300.0000 Vel 0.00 300.0000 FORMAT "%8.4" EXTENDED_LIMITS -327.6800 327.6700 /end CHARACTERISTIC
/begin CHARACTERISTIC CrCtl_vResBlwGear4PWinNeg_C "PI-Reglerparametersatz für WA+ 4.Gang" VALUE 0xC902A Kw_Ws16 300.0000 Vel -300.0000 0.00 FORMAT "%8.4" EXTENDED_LIMITS -327.6800 327.6700 /end CHARACTERISTIC
/begin CHARACTERISTIC CrCtl_ResBlwGear5IKi_C "PI-Reglerparametersatz für WA+ 5.Gang" VALUE 0xC902C Kw_Wu32 19999999.9953 Ki_Vel2TrqPrp 0.00 19999999.9953 FORMAT "%13.4" /end CHARACTERISTIC
/begin CHARACTERISTIC CrCtl_ResBlwGear5IKiPos_C "PI-Reglerparametersatz für WA+ 5.Gang" VALUE 0xC9030 Kw_Wu32 19999999.9953 Ki_Vel2TrqPrp 0.00 19999999.9953 FORMAT "%13.4" /end CHARACTERISTIC
/begin CHARACTERISTIC CrCtl_ResBlwGear5IKiNeg_C "PI-Reglerparametersatz für WA+ 5.Gang" VALUE 0xC9034 Kw_Wu32 19999999.9953 Ki_Vel2TrqPrp 0.00 19999999.9953 FORMAT "%13.4" /end CHARACTERISTIC
/begin CHARACTERISTIC CrCtl_vResBlwGear5IWinPos_C "PI-Reglerparametersatz für WA+ 5.Gang" VALUE 0xC9038 Kw_Ws16 300.0000 Vel 0.00 300.0000 FORMAT "%8.4" EXTENDED_LIMITS -327.6800 327.6700 /end CHARACTERISTIC
/begin CHARACTERISTIC CrCtl_vResBlwGear5IWinNeg_C "PI-Reglerparametersatz für WA+ 5.Gang" VALUE 0xC903A Kw_Ws16 300.0000 Vel -300.0000 0.00 FORMAT "%8.4" EXTENDED_LIMITS -327.6800 327.6700 /end CHARACTERISTIC
/begin CHARACTERISTIC CrCtl_ResBlwGear5PKp_C "PI-Reglerparametersatz für WA+ 5.Gang" VALUE 0xC903C Kw_Wu32 1310719.99969 Kp_Vel2TrqPrp 0.00 1310719.99969 FORMAT "%13.5" /end CHARACTERISTIC
/begin CHARACTERISTIC CrCtl_ResBlwGear5PKpPos_C "PI-Reglerparametersatz für WA+ 5.Gang" VALUE 0xC9040 Kw_Wu32 1310719.99969 Kp_Vel2TrqPrp 0.00 1310719.99969 FORMAT "%13.5" /end CHARACTERISTIC
/begin CHARACTERISTIC CrCtl_ResBlwGear5PKpNeg_C "PI-Reglerparametersatz für WA+ 5.Gang" VALUE 0xC9044 Kw_Wu32 1310719.99969 Kp_Vel2TrqPrp 0.00 1310719.99969 FORMAT "%13.5" /end CHARACTERISTIC
/begin CHARACTERISTIC CrCtl_vResBlwGear5PWinPos_C "PI-Reglerparametersatz für WA+ 5.Gang" VALUE 0xC9048 Kw_Ws16 300.0000 Vel 0.00 300.0000 FORMAT "%8.4" EXTENDED_LIMITS -327.6800 327.6700 /end CHARACTERISTIC
/begin CHARACTERISTIC CrCtl_vResBlwGear5PWinNeg_C "PI-Reglerparametersatz für WA+ 5.Gang" VALUE 0xC904A Kw_Ws16 300.0000 Vel -300.0000 0.00 FORMAT "%8.4" EXTENDED_LIMITS -327.6800 327.6700 /end CHARACTERISTIC
/begin CHARACTERISTIC CrCtl_ResBlwGear6IKi_C "PI-Reglerparametersatz für WA+ 6.Gang" VALUE 0xC904C Kw_Wu32 19999999.9953 Ki_Vel2TrqPrp 0.00 19999999.9953 FORMAT "%13.4" /end CHARACTERISTIC
/begin CHARACTERISTIC CrCtl_ResBlwGear6IKiPos_C "PI-Reglerparametersatz für WA+ 6.Gang" VALUE 0xC9050 Kw_Wu32 19999999.9953 Ki_Vel2TrqPrp 0.00 19999999.9953 FORMAT "%13.4" /end CHARACTERISTIC
/begin CHARACTERISTIC CrCtl_ResBlwGear6IKiNeg_C "PI-Reglerparametersatz für WA+ 6.Gang" VALUE 0xC9054 Kw_Wu32 19999999.9953 Ki_Vel2TrqPrp 0.00 19999999.9953 FORMAT "%13.4" /end CHARACTERISTIC
/begin CHARACTERISTIC CrCtl_vResBlwGear6IWinPos_C "PI-Reglerparametersatz für WA+ 6.Gang" VALUE 0xC9058 Kw_Ws16 300.0000 Vel 0.00 300.0000 FORMAT "%8.4" EXTENDED_LIMITS -327.6800 327.6700 /end CHARACTERISTIC
/begin CHARACTERISTIC CrCtl_vResBlwGear6IWinNeg_C "PI-Reglerparametersatz für WA+ 6.Gang" VALUE 0xC905A Kw_Ws16 300.0000 Vel -300.0000 0.00 FORMAT "%8.4" EXTENDED_LIMITS -327.6800 327.6700 /end CHARACTERISTIC
/begin CHARACTERISTIC CrCtl_ResBlwGear6PKp_C "PI-Reglerparametersatz für WA+ 6.Gang" VALUE 0xC905C Kw_Wu32 1310719.99969 Kp_Vel2TrqPrp 0.00 1310719.99969 FORMAT "%13.5" /end CHARACTERISTIC
/begin CHARACTERISTIC CrCtl_ResBlwGear6PKpPos_C "PI-Reglerparametersatz für WA+ 6.Gang" VALUE 0xC9060 Kw_Wu32 1310719.99969 Kp_Vel2TrqPrp 0.00 1310719.99969 FORMAT "%13.5" /end CHARACTERISTIC
/begin CHARACTERISTIC CrCtl_ResBlwGear6PKpNeg_C "PI-Reglerparametersatz für WA+ 6.Gang" VALUE 0xC9064 Kw_Wu32 1310719.99969 Kp_Vel2TrqPrp 0.00 1310719.99969 FORMAT "%13.5" /end CHARACTERISTIC
/begin CHARACTERISTIC CrCtl_vResBlwGear6PWinPos_C "PI-Reglerparametersatz für WA+ 6.Gang" VALUE 0xC9068 Kw_Ws16 300.0000 Vel 0.00 300.0000 FORMAT "%8.4" EXTENDED_LIMITS -327.6800 327.6700 /end CHARACTERISTIC
/begin CHARACTERISTIC CrCtl_vResBlwGear6PWinNeg_C "PI-Reglerparametersatz für WA+ 6.Gang" VALUE 0xC906A Kw_Ws16 300.0000 Vel -300.0000 0.00 FORMAT "%8.4" EXTENDED_LIMITS -327.6800 327.6700 /end CHARACTERISTIC
/begin CHARACTERISTIC CrCtl_ResRmpGear2PKp_C "P-Reglerparametersatz für WA 2.Gang" VALUE 0xC906C Kw_Wu32 1310719.99969 Kp_Vel2TrqPrp 0.00 1310719.99969 FORMAT "%13.5" /end CHARACTERISTIC
/begin CHARACTERISTIC CrCtl_ResRmpGear2PKpPos_C "P-Reglerparametersatz für WA 2.Gang" VALUE 0xC9070 Kw_Wu32 1310719.99969 Kp_Vel2TrqPrp 0.00 1310719.99969 FORMAT "%13.5" /end CHARACTERISTIC
/begin CHARACTERISTIC CrCtl_ResRmpGear2PKpNeg_C "P-Reglerparametersatz für WA 2.Gang" VALUE 0xC9074 Kw_Wu32 1310719.99969 Kp_Vel2TrqPrp 0.00 1310719.99969 FORMAT "%13.5" /end CHARACTERISTIC
/begin CHARACTERISTIC CrCtl_vResRmpGear2PWinPos_C "P-Reglerparametersatz für WA 2.Gang" VALUE 0xC9078 Kw_Ws16 300.0000 Vel 0.00 300.0000 FORMAT "%8.4" EXTENDED_LIMITS -327.6800 327.6700 /end CHARACTERISTIC
/begin CHARACTERISTIC CrCtl_vResRmpGear2PWinNeg_C "P-Reglerparametersatz für WA 2.Gang" VALUE 0xC907A Kw_Ws16 300.0000 Vel -300.0000 0.00 FORMAT "%8.4" EXTENDED_LIMITS -327.6800 327.6700 /end CHARACTERISTIC
/begin CHARACTERISTIC CrCtl_ResRmpGear3PKp_C "P-Reglerparametersatz für WA 3.Gang" VALUE 0xC907C Kw_Wu32 1310719.99969 Kp_Vel2TrqPrp 0.00 1310719.99969 FORMAT "%13.5" /end CHARACTERISTIC
/begin CHARACTERISTIC CrCtl_ResRmpGear3PKpPos_C "P-Reglerparametersatz für WA 3.Gang" VALUE 0xC9080 Kw_Wu32 1310719.99969 Kp_Vel2TrqPrp 0.00 1310719.99969 FORMAT "%13.5" /end CHARACTERISTIC
/begin CHARACTERISTIC CrCtl_ResRmpGear3PKpNeg_C "P-Reglerparametersatz für WA 3.Gang" VALUE 0xC9084 Kw_Wu32 1310719.99969 Kp_Vel2TrqPrp 0.00 1310719.99969 FORMAT "%13.5" /end CHARACTERISTIC
/begin CHARACTERISTIC CrCtl_vResRmpGear3PWinPos_C "P-Reglerparametersatz für WA 3.Gang" VALUE 0xC9088 Kw_Ws16 300.0000 Vel 0.00 300.0000 FORMAT "%8.4" EXTENDED_LIMITS -327.6800 327.6700 /end CHARACTERISTIC
/begin CHARACTERISTIC CrCtl_vResRmpGear3PWinNeg_C "P-Reglerparametersatz für WA 3.Gang" VALUE 0xC908A Kw_Ws16 300.0000 Vel -300.0000 0.00 FORMAT "%8.4" EXTENDED_LIMITS -327.6800 327.6700 /end CHARACTERISTIC
/begin CHARACTERISTIC CrCtl_ResRmpGear4PKp_C "P-Reglerparametersatz für WA 4.Gang" VALUE 0xC908C Kw_Wu32 1310719.99969 Kp_Vel2TrqPrp 0.00 1310719.99969 FORMAT "%13.5" /end CHARACTERISTIC
/begin CHARACTERISTIC CrCtl_ResRmpGear4PKpPos_C "P-Reglerparametersatz für WA 4.Gang" VALUE 0xC9090 Kw_Wu32 1310719.99969 Kp_Vel2TrqPrp 0.00 1310719.99969 FORMAT "%13.5" /end CHARACTERISTIC
/begin CHARACTERISTIC CrCtl_ResRmpGear4PKpNeg_C "P-Reglerparametersatz für WA 4.Gang" VALUE 0xC9094 Kw_Wu32 1310719.99969 Kp_Vel2TrqPrp 0.00 1310719.99969 FORMAT "%13.5" /end CHARACTERISTIC
/begin CHARACTERISTIC CrCtl_vResRmpGear4PWinPos_C "P-Reglerparametersatz für WA 4.Gang" VALUE 0xC9098 Kw_Ws16 300.0000 Vel 0.00 300.0000 FORMAT "%8.4" EXTENDED_LIMITS -327.6800 327.6700 /end CHARACTERISTIC
/begin CHARACTERISTIC CrCtl_vResRmpGear4PWinNeg_C "P-Reglerparametersatz für WA 4.Gang" VALUE 0xC909A Kw_Ws16 300.0000 Vel -300.0000 0.00 FORMAT "%8.4" EXTENDED_LIMITS -327.6800 327.6700 /end CHARACTERISTIC
/begin CHARACTERISTIC CrCtl_ResRmpGear5PKp_C "P-Reglerparametersatz für WA 5.Gang" VALUE 0xC909C Kw_Wu32 1310719.99969 Kp_Vel2TrqPrp 0.00 1310719.99969 FORMAT "%13.5" /end CHARACTERISTIC
/begin CHARACTERISTIC CrCtl_ResRmpGear5PKpPos_C "P-Reglerparametersatz für WA 5.Gang" VALUE 0xC90A0 Kw_Wu32 1310719.99969 Kp_Vel2TrqPrp 0.00 1310719.99969 FORMAT "%13.5" /end CHARACTERISTIC
/begin CHARACTERISTIC CrCtl_ResRmpGear5PKpNeg_C "P-Reglerparametersatz für WA 5.Gang" VALUE 0xC90A4 Kw_Wu32 1310719.99969 Kp_Vel2TrqPrp 0.00 1310719.99969 FORMAT "%13.5" /end CHARACTERISTIC
/begin CHARACTERISTIC CrCtl_vResRmpGear5PWinPos_C "P-Reglerparametersatz für WA 5.Gang" VALUE 0xC90A8 Kw_Ws16 300.0000 Vel 0.00 300.0000 FORMAT "%8.4" EXTENDED_LIMITS -327.6800 327.6700 /end CHARACTERISTIC
/begin CHARACTERISTIC CrCtl_vResRmpGear5PWinNeg_C "P-Reglerparametersatz für WA 5.Gang" VALUE 0xC90AA Kw_Ws16 300.0000 Vel -300.0000 0.00 FORMAT "%8.4" EXTENDED_LIMITS -327.6800 327.6700 /end CHARACTERISTIC
/begin CHARACTERISTIC CrCtl_ResRmpGear6PKp_C "P-Reglerparametersatz für WA 6.Gang" VALUE 0xC90AC Kw_Wu32 1310719.99969 Kp_Vel2TrqPrp 0.00 1310719.99969 FORMAT "%13.5" /end CHARACTERISTIC
/begin CHARACTERISTIC CrCtl_ResRmpGear6PKpPos_C "P-Reglerparametersatz für WA 6.Gang" VALUE 0xC90B0 Kw_Wu32 1310719.99969 Kp_Vel2TrqPrp 0.00 1310719.99969 FORMAT "%13.5" /end CHARACTERISTIC
/begin CHARACTERISTIC CrCtl_ResRmpGear6PKpNeg_C "P-Reglerparametersatz für WA 6.Gang" VALUE 0xC90B4 Kw_Wu32 1310719.99969 Kp_Vel2TrqPrp 0.00 1310719.99969 FORMAT "%13.5" /end CHARACTERISTIC
/begin CHARACTERISTIC CrCtl_vResRmpGear6PWinPos_C "P-Reglerparametersatz für WA 6.Gang" VALUE 0xC90B8 Kw_Ws16 300.0000 Vel 0.00 300.0000 FORMAT "%8.4" EXTENDED_LIMITS -327.6800 327.6700 /end CHARACTERISTIC
/begin CHARACTERISTIC CrCtl_vResRmpGear6PWinNeg_C "P-Reglerparametersatz für WA 6.Gang" VALUE 0xC90BA Kw_Ws16 300.0000 Vel -300.0000 0.00 FORMAT "%8.4" EXTENDED_LIMITS -327.6800 327.6700 /end CHARACTERISTIC
/begin CHARACTERISTIC CrCtl_rVnDvtShutOff_C "Abweichung v/n-Verhältnis Abschalten FGR" VALUE 0xC8B68 Kw_Ws16 0.3276700 VelToN 0.00 0.3276700 FORMAT "%9.7" EXTENDED_LIMITS -0.3276800 0.3276700 /end CHARACTERISTIC
/begin CHARACTERISTIC CrCtl_stShutOffCodeMsk_C "#SSD Bitmaske zum Ausmaskieren von FGR-Abschaltbedingungen" VALUE 0xC8B6C Kw_Wu32 4294967295.00 OneToOne 0.00 4294967295.00 FORMAT "%13.2" /end CHARACTERISTIC
/begin CHARACTERISTIC CrCtl_stShutOffHDC_C "Shutoff of Hill descent Control" VALUE 0xC8B70 Kw_Wu8 255.0 OneToOne 0.00 255.0 FORMAT "%5.1" /end CHARACTERISTIC
/begin CHARACTERISTIC CrCtl_stShutOffInfoLR_C "informationswert zum ausschalten bei zu geringem abstand" VALUE 0xC8B71 Kw_Wu8 255.0 OneToOne 0.00 255.0 FORMAT "%5.1" /end CHARACTERISTIC
/begin CHARACTERISTIC CrCtl_stShutOffLR_C "Application data for shutoff of LR" VALUE 0xC8B72 Kw_Wu8 255.0 OneToOne 0.00 255.0 FORMAT "%5.1" /end CHARACTERISTIC
/begin CHARACTERISTIC CrCtl_swtResOff_C "0...keine Wiederaufnahme im Stufentemp. Zustand OFF; 1...Wiederaufnahme im Stufentempomat-Zustand OFF erlaubt" VALUE 0xC90BC Kw_Wu8 255.0 OneToOne 0.00 255.0 FORMAT "%5.1" /end CHARACTERISTIC
/begin CHARACTERISTIC CrCtl_swtSelKombi_C "Schalter zur Auswahl des Kombi-Typs (1: standard, 0: alte version)" VALUE 0xC8B73 Kw_Wu8 255.0 OneToOne 0.00 255.0 FORMAT "%5.1" /end CHARACTERISTIC
/begin CHARACTERISTIC CrCtl_swtShutOffOpt_C "Optionen Abschaltung FGR (bit 0: 1: Ansteuerung der Bremse vor Fahrgeschwindigkeitstest, 0: kein Ansteuern; bit1-7: ungebraucht)" VALUE 0xC8B74 Kw_Wu8 255.0 OneToOne 0.00 255.0 FORMAT "%5.1" /end CHARACTERISTIC
/begin CHARACTERISTIC CrCtl_tiAcc_C "Maximalzeit für Abschaltbedingung ""zu große Beschleunigung""" VALUE 0xC8B76 Kw_Wu16 655350.0 TimeDeb 0.00 655350.0 FORMAT "%8.1" /end CHARACTERISTIC
/begin CHARACTERISTIC CrCtl_tiAqpl_C "Maximalzeit für Aquaplaningerkennung" VALUE 0xC8B78 Kw_Wu16 655350.0 TimeDeb 0.00 655350.0 FORMAT "%8.1" /end CHARACTERISTIC
/begin CHARACTERISTIC CrCtl_tiClCtrDelayABS_C "Entprellung der FGR-Abschaltung bei ABS-Eingriff" VALUE 0xC8B7A Kw_Wu16 655350.0 TimeDeb 0.00 655350.0 FORMAT "%8.1" /end CHARACTERISTIC
/begin CHARACTERISTIC CrCtl_tiClCtrDelayASC_C "debounce time for ASC intervention" VALUE 0xC8B7C Kw_Wu16 655350.0 TimeDeb 0.00 655350.0 FORMAT "%8.1" /end CHARACTERISTIC
/begin CHARACTERISTIC CrCtl_tiClCtrDelayDSC_C "debounce time for DSC intervention" VALUE 0xC8B7E Kw_Wu16 655350.0 TimeDeb 0.00 655350.0 FORMAT "%8.1" /end CHARACTERISTIC
/begin CHARACTERISTIC CrCtl_tiClCtrDelayEBV_C "Entprellung der FGR-Abschaltung bei EBV-Eingriff" VALUE 0xC8B80 Kw_Wu16 655350.0 TimeDeb 0.00 655350.0 FORMAT "%8.1" /end CHARACTERISTIC
/begin CHARACTERISTIC CrCtl_tiClCtrDelayHBA_C "Entprellung der FGR-Abschaltung bei HBA-Eingriff" VALUE 0xC8B82 Kw_Wu16 655350.0 TimeDeb 0.00 655350.0 FORMAT "%8.1" /end CHARACTERISTIC
/begin CHARACTERISTIC CrCtl_tiClCtrDelayMSR_C "debounce time for MSR intervention" VALUE 0xC8B84 Kw_Wu16 655350.0 TimeDeb 0.00 655350.0 FORMAT "%8.1" /end CHARACTERISTIC
/begin CHARACTERISTIC CrCtl_tiDec_C "Entprellzeit zu große Fahrzeugverzögerung für Abschaltung FGR" VALUE 0xC8B86 Kw_Wu16 655350.0 TimeDeb 0.00 655350.0 FORMAT "%8.1" /end CHARACTERISTIC
/begin CHARACTERISTIC CrCtl_tiGearDeb_C "Entprellzeit neuer Gang für FGR" VALUE 0xC8B88 Kw_Wu16 655350.0 TimeDeb 0.00 655350.0 FORMAT "%8.1" /end CHARACTERISTIC
/begin CHARACTERISTIC CrCtl_tiNegDvtTi_C "Entprellzeit zu große neg. Geschwindigkeitsabweichung für Abschaltung FGR" VALUE 0xC8B8A Kw_Wu16 655350.0 TimeDeb 0.00 655350.0 FORMAT "%8.1" /end CHARACTERISTIC
/begin CHARACTERISTIC CrCtl_tiOff_C "Dauer zum niederrampen zum gewünschten Drehmoment" VALUE 0xC90BE Kw_Wu16 655350.0 TimeDeb 0.00 655350.0 FORMAT "%8.1" /end CHARACTERISTIC
/begin CHARACTERISTIC CrCtl_tiTipUpDn_C "Erkennungszeit TIP-UP/DOWN" VALUE 0xC90C0 Kw_Wu16 655350.0 Time_ms 0.00 655350.0 FORMAT "%8.1" /end CHARACTERISTIC
/begin CHARACTERISTIC CrCtl_trqDesThres_C "Momentenschwelle zur Entscheidung der Momentenrampensteigung zur Momentenreduzierung nach SET+" VALUE 0xC90C2 Kw_Ws16 500.0000 TrqPrp 0.00 500.0000 FORMAT "%8.4" EXTENDED_LIMITS -6553.600 6553.400 /end CHARACTERISTIC
/begin CHARACTERISTIC CrCtl_trqDes_Vector "#SSD Bypass label, nicht editieren!" VALUE 0xC307E Kw_Wu8 255.0 OneToOne 0.00 255.0 FORMAT "%5.1" /end CHARACTERISTIC
/begin CHARACTERISTIC CrCtl_trqDes_Channel "#SSD Bypass label, nicht editieren!" VALUE 0xC307F Kw_Wu8 255.0 OneToOne 0.00 255.0 FORMAT "%5.1" /end CHARACTERISTIC
/begin CHARACTERISTIC CrCtl_trqLead_Vector "#SSD Bypass label, nicht editieren!" VALUE 0xC3080 Kw_Wu8 255.0 OneToOne 0.00 255.0 FORMAT "%5.1" /end CHARACTERISTIC
/begin CHARACTERISTIC CrCtl_trqLead_Channel "#SSD Bypass label, nicht editieren!" VALUE 0xC3081 Kw_Wu8 255.0 OneToOne 0.00 255.0 FORMAT "%5.1" /end CHARACTERISTIC
/begin CHARACTERISTIC CrCtl_trqMaxOfs_C "Offset auf maximales Moment CoDT_trqMax" VALUE 0xC90C4 Kw_Ws16 500.0000 TrqPrp 0.00 500.0000 FORMAT "%8.4" EXTENDED_LIMITS -6553.600 6553.400 /end CHARACTERISTIC
/begin CHARACTERISTIC CrCtl_trqOffComf_C "Momentenschwelle für Umschaltung der Rampensteigung bei Komfortabschaltung" VALUE 0xC90C6 Kw_Ws16 11000.00 TrqPrp -5000.000 6000.000 FORMAT "%8.3" EXTENDED_LIMITS -6553.600 6553.400 /end CHARACTERISTIC
/begin CHARACTERISTIC CrCtl_trqOffFast12_C "Umschaltschwelle von Rampe 1 auf Rampe 2" VALUE 0xC90C8 Kw_Ws16 11000.00 TrqPrp -5000.000 6000.000 FORMAT "%8.3" EXTENDED_LIMITS -6553.600 6553.400 /end CHARACTERISTIC
/begin CHARACTERISTIC CrCtl_trqOffFast23_C "Umschaltschwelle von Rampe 2 auf Rampe 3" VALUE 0xC90CA Kw_Ws16 11000.00 TrqPrp -5000.000 6000.000 FORMAT "%8.3" EXTENDED_LIMITS -6553.600 6553.400 /end CHARACTERISTIC
/begin CHARACTERISTIC CrCtl_vAccSet_C "Setzwertkorrektur nach SET+" VALUE 0xC90CC Kw_Ws16 300.0000 Vel 0.00 300.0000 FORMAT "%8.4" EXTENDED_LIMITS -327.6800 327.6700 /end CHARACTERISTIC
/begin CHARACTERISTIC CrCtl_vAlwDvtThres_C "zulässige Regelabweichung für TIP-UP/DOWN FGR" VALUE 0xC90CE Kw_Ws16 300.0000 Vel 0.00 300.0000 FORMAT "%8.4" EXTENDED_LIMITS -327.6800 327.6700 /end CHARACTERISTIC
/begin CHARACTERISTIC CrCtl_vDeclSet_C "Setzwertkorrektur nach SET-" VALUE 0xC90D0 Kw_Ws16 300.0000 Vel 0.00 300.0000 FORMAT "%8.4" EXTENDED_LIMITS -327.6800 327.6700 /end CHARACTERISTIC
/begin CHARACTERISTIC CrCtl_vDiffAccMax_C "Geschwindigkeitsschwelle für Setzwertkorrektur nach SET+" VALUE 0xC90D2 Kw_Ws16 300.0000 Vel 0.00 300.0000 FORMAT "%8.4" EXTENDED_LIMITS -327.6800 327.6700 /end CHARACTERISTIC
/begin CHARACTERISTIC CrCtl_vDiffAcc_C "Geschwindigkeitsoffset für doppelte Momentenrampensteigung bei Übergang EIN+ zu HALTEN des FGR" VALUE 0xC90D4 Kw_Ws16 300.0000 Vel 0.00 300.0000 FORMAT "%8.4" EXTENDED_LIMITS -327.6800 327.6700 /end CHARACTERISTIC
/begin CHARACTERISTIC CrCtl_vDiffAqpl_C "Geschwindigkeitsdifferenz für Aquaplaningerkennung" VALUE 0xC8B8C Kw_Ws16 300.0000 Vel 0.00 300.0000 FORMAT "%8.4" EXTENDED_LIMITS -327.6800 327.6700 /end CHARACTERISTIC
/begin CHARACTERISTIC CrCtl_vDiffDeclMax_C "Geschwindigkeitsschwelle für Setzwertkorrektur nach SET-" VALUE 0xC90D6 Kw_Ws16 300.0000 Vel 0.00 300.0000 FORMAT "%8.4" EXTENDED_LIMITS -327.6800 327.6700 /end CHARACTERISTIC
/begin CHARACTERISTIC CrCtl_vDiffDecl_C "Geschwindigkeitsoffset für doppelte Momentenrampensteigung bei Übergang EIN- zu HALTEN des FGR" VALUE 0xC90D8 Kw_Ws16 300.0000 Vel 0.00 300.0000 FORMAT "%8.4" EXTENDED_LIMITS -327.6800 327.6700 /end CHARACTERISTIC
/begin CHARACTERISTIC CrCtl_vDiffResAbv_C "Schwelle Differenz Ist- und Sollgeschwindigkeit für Reduzierung Zielgeschwindigkeitsrampe bei WA von oben" VALUE 0xC90DA Kw_Ws16 300.0000 Vel 0.00 300.0000 FORMAT "%8.4" EXTENDED_LIMITS -327.6800 327.6700 /end CHARACTERISTIC
/begin CHARACTERISTIC CrCtl_vDiffResBlw_C "Schwelle Differenz Ist- und Sollgeschwindigkeit für Reduzierung Zielgeschwindigkeitsrampe bei WA von unten" VALUE 0xC90DC Kw_Ws16 300.0000 Vel 0.00 300.0000 FORMAT "%8.4" EXTENDED_LIMITS -327.6800 327.6700 /end CHARACTERISTIC
/begin CHARACTERISTIC CrCtl_vDvtNegTipDwn_C "FGR: zulässige negative Regelabweichung TIP-DWN" VALUE 0xC90DE Kw_Ws16 300.0000 Vel 0.00 300.0000 FORMAT "%8.4" EXTENDED_LIMITS -327.6800 327.6700 /end CHARACTERISTIC
/begin CHARACTERISTIC CrCtl_vDvtNegTipUp_C "FGR: zulässige negative Regelabweichung TIP-UP" VALUE 0xC90E0 Kw_Ws16 300.0000 Vel 0.00 300.0000 FORMAT "%8.4" EXTENDED_LIMITS -327.6800 327.6700 /end CHARACTERISTIC
/begin CHARACTERISTIC CrCtl_vDvtPosTipDwn_C "FGR: zulässige positive Regelabweichung TIP-DWN" VALUE 0xC90E2 Kw_Ws16 300.0000 Vel 0.00 300.0000 FORMAT "%8.4" EXTENDED_LIMITS -327.6800 327.6700 /end CHARACTERISTIC
/begin CHARACTERISTIC CrCtl_vMaxShutOff_C "obere Grenze Fahrgeschwindigkeit Abschaltung FGR" VALUE 0xC8B8E Kw_Ws16 300.0000 Vel 0.00 300.0000 FORMAT "%8.4" EXTENDED_LIMITS -327.6800 327.6700 /end CHARACTERISTIC
/begin CHARACTERISTIC CrCtl_vMinShutOff_C "untere Grenze Fahrgeschwindigkeit Abschaltung FGR" VALUE 0xC8B90 Kw_Ws16 300.0000 Vel 0.00 300.0000 FORMAT "%8.4" EXTENDED_LIMITS -327.6800 327.6700 /end CHARACTERISTIC
/begin CHARACTERISTIC CrCtl_vNegDvtTi_C "negative Geschwindigkeitsabweichung Abschaltung FGR nach Entprellzeit" VALUE 0xC8B92 Kw_Ws16 300.0000 Vel 0.00 300.0000 FORMAT "%8.4" EXTENDED_LIMITS -327.6800 327.6700 /end CHARACTERISTIC
/begin CHARACTERISTIC CrCtl_vNegDvt_C "negative Geschwindigkeitsabweichung Abschaltung FGR" VALUE 0xC8B94 Kw_Ws16 300.0000 Vel 0.00 300.0000 FORMAT "%8.4" EXTENDED_LIMITS -327.6800 327.6700 /end CHARACTERISTIC
/begin CHARACTERISTIC CrCtl_vOfsDecl_C "neg. Offset für Sollgeschwindigkeit für Übergang EIN- zu HALTEN des FGR" VALUE 0xC90E4 Kw_Ws16 300.0000 Vel 0.00 300.0000 FORMAT "%8.4" EXTENDED_LIMITS -327.6800 327.6700 /end CHARACTERISTIC
/begin CHARACTERISTIC CrCtl_vOfsResBlw_C "Geschwindigkeitsoffset für Übergang WA+ --> Konstantfahrt" VALUE 0xC90E6 Kw_Ws16 300.0000 Vel 0.00 300.0000 FORMAT "%8.4" EXTENDED_LIMITS -327.6800 327.6700 /end CHARACTERISTIC
/begin CHARACTERISTIC CrCtl_vOfsRes_C "Offset FGR-Sollgeschwindigkeit für Übergang WA zu HALTEN" VALUE 0xC90E8 Kw_Ws16 300.0000 Vel 0.00 300.0000 FORMAT "%8.4" EXTENDED_LIMITS -327.6800 327.6700 /end CHARACTERISTIC
/begin CHARACTERISTIC CrCtl_vPosDvt_C "positive Geschwindigkeitsabweichung Abschaltung FGR" VALUE 0xC8B96 Kw_Ws16 300.0000 Vel 0.00 300.0000 FORMAT "%8.4" EXTENDED_LIMITS -327.6800 327.6700 /end CHARACTERISTIC
/begin CHARACTERISTIC CrCtl_vRlsOfsI_C "FGR, Offset-Schwellwert für Freigabe Integrator" VALUE 0xC90EA Kw_Ws16 300.0000 Vel 0.00 300.0000 FORMAT "%8.4" EXTENDED_LIMITS -327.6800 327.6700 /end CHARACTERISTIC
/begin CHARACTERISTIC CrCtl_vTipStep_C "#SSD FGR TIP-UP/DOWN Geschwindigkeitsschritt" VALUE 0xC90EC Kw_Ws16 300.0000 Vel 0.00 300.0000 FORMAT "%8.4" EXTENDED_LIMITS -327.6800 327.6700 /end CHARACTERISTIC
/begin CHARACTERISTIC TMSGSGTMN "min zeit zwischen zwei botschaften" VALUE 0xC05AA KwWU8 5.100 t20msxs_ub_b5p1 0.00 5.100 FORMAT "%5.3" /end CHARACTERISTIC
/begin MEASUREMENT B_acmsggts "Bed. Min. Zeit in der keine Bit gesendet wurde ist verstrichen + Ereignis aufgetreten" UBYTE B_TRUE 1 100 0.00 1.00000000000 BIT_MASK 0x1 FORMAT "%13.11" ECU_ADDRESS 0x7F87CB /end MEASUREMENT
/begin MEASUREMENT B_cmsggts "Trigger Bit zum Senden der Botschaft" UBYTE B_TRUE 1 100 0.00 1.00000000000 BIT_MASK 0x1 FORMAT "%13.11" ECU_ADDRESS 0x7F87D0 /end MEASUREMENT
/begin MEASUREMENT B_ergacgt "Bedingung Ereignis (Änderung) bei Stufentempomat aufgetreten" UBYTE B_TRUE 1 100 0.00 1.00000000000 BIT_MASK 0x1 FORMAT "%13.11" ECU_ADDRESS 0x7F87D2 /end MEASUREMENT
/begin MEASUREMENT B_mrkvff "Bedingung Merker das B:_mrkv (Marker Veränderung) gesetzt war" UBYTE B_TRUE 1 100 0.00 1.00000000000 BIT_MASK 0x1 FORMAT "%13.11" ECU_ADDRESS 0x7F87E4 /end MEASUREMENT
/begin MEASUREMENT CoEng_CoordPrioFld_mp "Messpunktarray zur Darstellung der dynamische Priorität" UWORD OneToOne 1 100 0.00 65535.00 FORMAT "%8.2" ARRAY_SIZE 3 ECU_ADDRESS 0x8FE4FC /end MEASUREMENT
/begin MEASUREMENT CoEng_dnEngnAvrg_mp "Meßpunkt für Overfueling Drehzahlgradienten" SWORD dn_dZ20 1 100 -327680.0 327670.0 FORMAT "%8.1" ECU_ADDRESS 0x8FE532 /end MEASUREMENT
/begin MEASUREMENT CoEng_dvolFlConsum "Kraftstoffverbrauch" SWORD FlConsum_l_h 1 100 -327.6800 327.6700 FORMAT "%8.4" ECU_ADDRESS 0x7F8AF4 /end MEASUREMENT
/begin MEASUREMENT CoEng_dVolFlt_mp "Gefilterter Volumenstrom für Berechnung" SWORD CubMtrPerHr 1 100 -3276.800 3276.700 FORMAT "%8.3" ECU_ADDRESS 0x8FE534 /end MEASUREMENT
/begin MEASUREMENT CoEng_dvolPerStroke_mp "Kraftstoffverbrauch" SWORD InjQnt 1 100 -3276.800 3276.700 FORMAT "%8.3" ECU_ADDRESS 0x8FE4F0 /end MEASUREMENT
/begin MEASUREMENT CoEng_facAdj "EEPROM Abgleichwert zur Korrektur des Begrenzungsmomentes" SWORD Fact 1 100 -4.000000 3.999878 FORMAT "%8.6" ECU_ADDRESS 0x7F8AF6 /end MEASUREMENT
/begin MEASUREMENT CoEng_facFlConsumAdj_mp "Abgleichwert - Krafstoffverbrauchsabgleich" SWORD Fact 1 100 -4.000000 3.999878 FORMAT "%8.6" ECU_ADDRESS 0x8FE4F2 /end MEASUREMENT
/begin MEASUREMENT CoEng_nMax "Drehzahlintervall Maximum" SWORD EngN 1 100 -32768.00 32767.00 FORMAT "%8.2" ECU_ADDRESS 0x7F8AF8 /end MEASUREMENT
/begin MEASUREMENT CoEng_nMin "Drehzahlintervall Minimum" SWORD EngN 1 100 -32768.00 32767.00 FORMAT "%8.2" ECU_ADDRESS 0x7F8AFA /end MEASUREMENT
/begin MEASUREMENT CoEng_numShOffTstNewSel "ausgewählter Abstelltest des gegenwaertigen Fahrzyklus" UBYTE OneToOne 1 100 0.00 255.0 FORMAT "%5.1" ECU_ADDRESS 0x7F87FB /end MEASUREMENT
/begin MEASUREMENT CoEng_pDiffPFltPrdc_mp "Vorhergesagter Differenzdruck über Partikelfilter" SWORD Pres_hPa 1 100 -32768.00 32767.00 FORMAT "%8.2" ECU_ADDRESS 0x8FE536 /end MEASUREMENT
/begin MEASUREMENT CoEng_pRailT15Off "Raildruck bei Klemme 15 aus" SWORD Pres_Rail 1 100 -3276.800 3276.700 FORMAT "%5.3" ECU_ADDRESS 0x7F8AFC /end MEASUREMENT
/begin MEASUREMENT CoEng_qSubs_mp "Ersatzeinspritzmenge für KVA Berechnung" SWORD InjMassCyc 1 100 -327.6800 327.6700 FORMAT "%8.4" ECU_ADDRESS 0x8FE4F4 /end MEASUREMENT
/begin MEASUREMENT CoEng_qSum_mp "tatsächlicher Kraftstoffverbrauch" SWORD InjMassCyc 1 100 -327.6800 327.6700 FORMAT "%8.4" ECU_ADDRESS 0x8FE4F6 /end MEASUREMENT
/begin MEASUREMENT CoEng_resFlowFlt_mp "Gefilterter Strömungswiderstand für Berechnung" SWORD Res_hPaHrPerCM 1 100 -32.76800 32.76700 FORMAT "%8.5" ECU_ADDRESS 0x8FE538 /end MEASUREMENT
/begin MEASUREMENT CoEng_rTrq "Verhältnis aktuelles Moment zu Maximalmoment" SWORD Prc 1 100 -400.0000 399.9878 FORMAT "%8.4" ECU_ADDRESS 0x7F8AFE /end MEASUREMENT
/begin MEASUREMENT CoEng_stAftRun "nachlauf-interner Nachlauf-Zustand" UBYTE OneToOne 1 100 0.00 255.0 FORMAT "%5.1" ECU_ADDRESS 0x7F87FC /end MEASUREMENT
/begin MEASUREMENT CoEng_stAftRunPath "Abschaltpfade aufgrund Motorzustand Nachlauf" ULONG OneToOne 1 100 0.00 4294967295.00 FORMAT "%13.2" ECU_ADDRESS 0x7F90BC /end MEASUREMENT
/begin MEASUREMENT CoEng_stCoordFuncFld_mp "Messpunktarray zur Statusanzeige Schubkoordinator" UWORD OneToOne 1 100 0.00 65535.00 FORMAT "%8.2" ARRAY_SIZE 3 ECU_ADDRESS 0x8FE502 /end MEASUREMENT
/begin MEASUREMENT CoEng_stCoordFuncPref_mp "Status Zustand Koordinator" UBYTE OneToOne 1 100 0.00 255.0 FORMAT "%5.1" ECU_ADDRESS 0x8FE508 /end MEASUREMENT
/begin MEASUREMENT CoEng_stCurrLim "Statuswort zur Markierung der niedrigsten Begrenzungsmomente" UWORD OneToOne 1 100 0.00 65535.00 FORMAT "%8.2" ECU_ADDRESS 0x7F8B00 /end MEASUREMENT
/begin MEASUREMENT CoEng_stCurrLimActive "Statusword zur Markierung der wirksamen niedrigsten Begrenzungsmomente" UWORD OneToOne 1 100 0.00 65535.00 FORMAT "%8.2" ECU_ADDRESS 0x7F8B02 /end MEASUREMENT
/begin MEASUREMENT CoEng_stDisable "Status Schubabschaltung: 1: abgeschalten; 0: nicht abgeschalten" UBYTE OneToOne 1 100 0.00 255.0 FORMAT "%5.1" ECU_ADDRESS 0x7F87FD /end MEASUREMENT
/begin MEASUREMENT CoEng_stDlyT15_mp "Status Variable für Verzögerungszeti nach Klemme 15 ein" UBYTE OneToOne 1 100 0.00 255.0 FORMAT "%5.1" ECU_ADDRESS 0x8FE50A /end MEASUREMENT
/begin MEASUREMENT CoEng_stEEPStore_mp "Speicherstatus für EEPROM während Nachlauf" UBYTE OneToOne 1 100 0.00 255.0 FORMAT "%5.1" ECU_ADDRESS 0x8FE4EC /end MEASUREMENT
/begin MEASUREMENT CoEng_stEng "aktueller Motorzustand" UBYTE OneToOne 1 100 0.00 255.0 FORMAT "%5.1" ECU_ADDRESS 0x7F87FE /end MEASUREMENT
/begin MEASUREMENT CoEng_stEngOld "Motorstatus vor aktuellem Status" UBYTE OneToOne 1 100 0.00 255.0 FORMAT "%5.1" ECU_ADDRESS 0x7F87FF /end MEASUREMENT
/begin MEASUREMENT CoEng_stExtWait "Zustand ""warten auf externe Ereignisse vor Schreiben des EEPROM""" UBYTE OneToOne 1 100 0.00 255.0 FORMAT "%5.1" ECU_ADDRESS 0x7F8800 /end MEASUREMENT
/begin MEASUREMENT CoEng_stExtWait2 "Zustand ""Warten auf externe Ereignisse vor Öffnen des Hauptrelais""" UBYTE OneToOne 1 100 0.00 255.0 FORMAT "%5.1" ECU_ADDRESS 0x7F8801 /end MEASUREMENT
/begin MEASUREMENT CoEng_stIRevShutOff "irreversible Abschaltursachen (nach Maskierung)" ULONG OneToOne 1 100 0.00 4294967295.00 FORMAT "%13.2" ECU_ADDRESS 0x7F90C0 /end MEASUREMENT
/begin MEASUREMENT CoEng_stMonActrPrt "Zustand der Steuerung Stellerschutz" UBYTE OneToOne 1 100 0.00 255.0 FORMAT "%5.1" ECU_ADDRESS 0x7F8802 /end MEASUREMENT
/begin MEASUREMENT CoEng_stMonShOff "aktueller Zustand der Abstellsteuerung im Nachlauf" UBYTE OneToOne 1 100 0.00 255.0 FORMAT "%5.1" ECU_ADDRESS 0x7F8803 /end MEASUREMENT
/begin MEASUREMENT CoEng_stOvrFul_mp "Status Overfueling" UBYTE OneToOne 1 100 0.00 255.0 FORMAT "%5.1" ECU_ADDRESS 0x8FE53A /end MEASUREMENT
/begin MEASUREMENT CoEng_stOvrRun "Zustand Schuberkennung (0: kein Schub, 1: Schub)" UBYTE OneToOne 1 100 0.00 255.0 FORMAT "%5.1" ECU_ADDRESS 0x7F8804 /end MEASUREMENT
/begin MEASUREMENT CoEng_stOvrRunCoord "Status Schuberkennung des Schubkoordinators (0: kein Schub; 1: Schub)" UBYTE OneToOne 1 100 0.00 255.0 FORMAT "%5.1" ECU_ADDRESS 0x7F8805 /end MEASUREMENT
/begin MEASUREMENT CoEng_stOvrRunEGT_mp "Status Regenerationsanforderung Abgasnachbehandlung im Sinne des Schubkoordinators, 1:keine Freigabe für Funktionen" UBYTE OneToOne 1 100 0.00 255.0 FORMAT "%5.1" ECU_ADDRESS 0x8FE509 /end MEASUREMENT
/begin MEASUREMENT CoEng_stPwrDwn "Status des Diagnose Modus Power-down" UBYTE OneToOne 1 100 0.00 255.0 FORMAT "%5.1" ECU_ADDRESS 0x7F8806 /end MEASUREMENT
/begin MEASUREMENT CoEng_stPwrStgEnaCond "Steuergerätestatus, der für die Abschaltung der Endstufe/Endstufenfehlerdiagnose relevant ist" UBYTE OneToOne 1 100 0.00 255.0 FORMAT "%5.1" ECU_ADDRESS 0x7F8807 /end MEASUREMENT
/begin MEASUREMENT CoEng_stRevShutOff "reversible Abschaltursachen (nach Maskierung)" ULONG OneToOne 1 100 0.00 4294967295.00 FORMAT "%13.2" ECU_ADDRESS 0x7F90C4 /end MEASUREMENT
/begin MEASUREMENT CoEng_stRmp_mp "Status: Rampe der Schubabschaltung, 0: inaktiv, 1: aktiv" UBYTE OneToOne 1 100 0.00 255.0 FORMAT "%5.1" ECU_ADDRESS 0x8FE514 /end MEASUREMENT
/begin MEASUREMENT CoEng_stShOffAddReqIRev "Kundenspezifische irreversible Abschaltanforderung" UBYTE OneToOne 1 100 0.00 255.0 FORMAT "%5.1" ECU_ADDRESS 0x7F8808 /end MEASUREMENT
/begin MEASUREMENT CoEng_stShOffAddReqRev "Kundenspezifische reversible Abschaltanforderung" UBYTE OneToOne 1 100 0.00 255.0 FORMAT "%5.1" ECU_ADDRESS 0x7F8809 /end MEASUREMENT
/begin MEASUREMENT CoEng_stShOffTst "Status des Abstelltest" UBYTE OneToOne 1 100 0.00 255.0 FORMAT "%5.1" ECU_ADDRESS 0x7F880A /end MEASUREMENT
/begin MEASUREMENT CoEng_stShOffTstOldRes_mp "Testergebnis des letzten Fahrzyklus" UBYTE OneToOne 1 100 0.00 255.0 FORMAT "%5.1" ECU_ADDRESS 0x8FE50C /end MEASUREMENT
/begin MEASUREMENT CoEng_stShutOff "Typ der wirksamen Abschaltursache (0: Nachlauf; 1: reversibel; 2: irreversibel)" UBYTE OneToOne 1 100 0.00 255.0 FORMAT "%5.1" ECU_ADDRESS 0x7F880B /end MEASUREMENT
/begin MEASUREMENT CoEng_stShutOffPath "aktive Abstellpfade resultierend aus aktiven reversiblen, irreversiblen und Nachlauf-Abstellpfaden" ULONG OneToOne 1 100 0.00 4294967295.00 FORMAT "%13.2" ECU_ADDRESS 0x7F90C8 /end MEASUREMENT
/begin MEASUREMENT CoEng_stTrqLimErr "Status Begrenzungsmoment im Systemfehlerfall. Bit0: Begrenzung aktiv; Bit1: Rampe von/zu Begrenzungswert aktiv" UBYTE OneToOne 1 100 0.00 255.0 FORMAT "%5.1" ECU_ADDRESS 0x7F880C /end MEASUREMENT
/begin MEASUREMENT CoEng_stTrqLimErr1 "Begrenzungsmoment im Fehlerfall" UBYTE OneToOne 1 100 0.00 255.0 FORMAT "%5.1" ECU_ADDRESS 0x7F880D /end MEASUREMENT
/begin MEASUREMENT CoEng_stTrqLimErr2 "Begrenzungsmoment im Fehlerfall 2" UBYTE OneToOne 1 100 0.00 255.0 FORMAT "%5.1" ECU_ADDRESS 0x7F880E /end MEASUREMENT
/begin MEASUREMENT CoEng_stTrqLimErr3 "Begrenzungsmoment im Fehlerfall" UBYTE OneToOne 1 100 0.00 255.0 FORMAT "%5.1" ECU_ADDRESS 0x7F880F /end MEASUREMENT
/begin MEASUREMENT CoEng_stTrqLimErr4 "Begrenzungsmoment im Fehlerfall" UBYTE OneToOne 1 100 0.00 255.0 FORMAT "%5.1" ECU_ADDRESS 0x7F8810 /end MEASUREMENT
/begin MEASUREMENT CoEng_stTrqLimPFltErr "" UBYTE OneToOne 1 100 0.00 255.0 FORMAT "%5.1" ECU_ADDRESS 0x7F8811 /end MEASUREMENT
/begin MEASUREMENT CoEng_stTst "Zustand des Motortestkoordinators (= aktiver Testmodus)" UBYTE OneToOne 1 100 0.00 255.0 FORMAT "%5.1" ECU_ADDRESS 0x7F8812 /end MEASUREMENT
/begin MEASUREMENT CoEng_stZFCEmissionRoll "Freigabe Status der ZFC am Rollentester" UBYTE OneToOne 1 100 0.00 255.0 FORMAT "%5.1" ECU_ADDRESS 0x7F8813 /end MEASUREMENT
/begin MEASUREMENT CoEng_tiAfterrun "Zeit seit Erreichen des Motorzustands Nachlauf (COENG_STAFTERRUN)" ULONG Time_ms 1 100 0.00 42949672950.0 FORMAT "%13.1" ECU_ADDRESS 0x7F90CC /end MEASUREMENT
/begin MEASUREMENT CoEng_tiAfterrunRed "Zeit seit Erreichen des Motorzustands Nachlauf (COENG_STAFTERRUN, 0x30) mit reduzierter Auflösung als KL/KF Eingang" SWORD TimeRed 1 100 -5242.880 5242.720 FORMAT "%8.3" ECU_ADDRESS 0x7F8B04 /end MEASUREMENT
/begin MEASUREMENT CoEng_tiMinAftRun "Minimale Zeitdauer für die Verbindung vom elektronischen Steuergerät zum Hauptrelais" ULONG Time_ms 1 100 0.00 42949672950.0 FORMAT "%13.1" ECU_ADDRESS 0x7F90D0 /end MEASUREMENT
/begin MEASUREMENT CoEng_tiNormal "Zeit seit Erreichen des Zustands NORMAL" ULONG Time_ms 1 100 0.00 42949672950.0 FORMAT "%13.1" ECU_ADDRESS 0x7F90D4 /end MEASUREMENT
/begin MEASUREMENT CoEng_tiNormalRed "Zeit seit Erreichen Motorzustand NORMAL (0x04), mit reduzierter Auflösung als KL/KF Eingang" SWORD TimeRed 1 100 -5242.880 5242.720 FORMAT "%8.3" ECU_ADDRESS 0x7F8B06 /end MEASUREMENT
/begin MEASUREMENT CoEng_tiOvRMon_mp "Zeit seit Schub erkannt wurde und die Schubüberwachung aktiv ist" SWORD Time_ms 1 100 -327680.0 327670.0 FORMAT "%8.1" ECU_ADDRESS 0x8FE516 /end MEASUREMENT
/begin MEASUREMENT CoEng_tiRmpStrt "Time for Ramp Start" UWORD Time_ms 1 100 0.00 655350.0 FORMAT "%8.1" ECU_ADDRESS 0x7F8B08 /end MEASUREMENT
/begin MEASUREMENT CoEng_tiSoftShOff_mp "time delay for soft shutoff" UWORD Time_ms 1 100 0.00 655350.0 FORMAT "%8.1" ECU_ADDRESS 0x8FE50E /end MEASUREMENT
/begin MEASUREMENT CoEng_tiStart "Zeit seit Erreichen Motorzustand START (0x02)" ULONG Time_ms 1 100 0.00 42949672950.0 FORMAT "%13.1" ECU_ADDRESS 0x7F90D8 /end MEASUREMENT
/begin MEASUREMENT CoEng_tiStartRed "Zeit seit Erreichen Motorzustand START (0x02), mit reduzierter Auflösung als KL/KF Eingang" SWORD TimeRed 1 100 -5242.880 5242.720 FORMAT "%8.3" ECU_ADDRESS 0x7F8B0A /end MEASUREMENT
/begin MEASUREMENT CoEng_tiSwtOff "Time for Switch Off" UWORD Time_ms 1 100 0.00 655350.0 FORMAT "%8.1" ECU_ADDRESS 0x7F8B0C /end MEASUREMENT
/begin MEASUREMENT CoEng_tiWakeUp "Zeit seit Erreichen Zustand WAKEUP" ULONG Time_ms 1 100 0.00 42949672950.0 FORMAT "%13.1" ECU_ADDRESS 0x7F90DC /end MEASUREMENT
/begin MEASUREMENT CoEng_trq "aktuelles Motorausgangsmoment" SWORD Trq 1 100 -3276.800 3276.700 FORMAT "%8.3" ECU_ADDRESS 0x7F8B0E /end MEASUREMENT
/begin MEASUREMENT CoEng_trqBefRmp_mp "Sollmoment nach zweiter Begrenzung, vor Schubabschaltung in CoEng (als inneres Motormoment)" SWORD Trq 1 100 -3276.800 3276.700 FORMAT "%8.3" ECU_ADDRESS 0x8FE518 /end MEASUREMENT
/begin MEASUREMENT CoEng_trqCurrLim "Minimum aller Begrenzungen als aktuelles Motorausgangsmoment" SWORD Trq 1 100 -3276.800 3276.700 FORMAT "%8.3" ECU_ADDRESS 0x7F8B10 /end MEASUREMENT
/begin MEASUREMENT CoEng_trqInrCurr "inneres Moment aktueller Wert" SWORD Trq 1 100 -3276.800 3276.700 FORMAT "%8.3" ECU_ADDRESS 0x7F8B12 /end MEASUREMENT
/begin MEASUREMENT CoEng_trqInrCurrFast "inneres Wunschmoment (schneller Pfad) erzeugt aus CoDT_trqCurr" SWORD Trq 1 100 -3276.800 3276.700 FORMAT "%8.3" ECU_ADDRESS 0x7F8B14 /end MEASUREMENT
/begin MEASUREMENT CoEng_trqInrCurrFastBase_mp "inneres schnelles Wunschmoment im Curr-Pfad" SWORD Trq 1 100 -3276.800 3276.700 FORMAT "%8.3" ECU_ADDRESS 0x8FE52C /end MEASUREMENT
/begin MEASUREMENT CoEng_trqInrCurrLim "aktuell kleinstes Begrenzungsmoment (inneres Motormoment)" SWORD Trq 1 100 -3276.800 3276.700 FORMAT "%8.3" ECU_ADDRESS 0x7F8B16 /end MEASUREMENT
/begin MEASUREMENT CoEng_trqInrCurrPre_mp "aktuelles inneres Moment ahne Leerlaufreglerstellgrösse" SWORD Trq 1 100 -3276.800 3276.700 FORMAT "%8.3" ECU_ADDRESS 0x8FE51A /end MEASUREMENT
/begin MEASUREMENT CoEng_trqInrDes "Wunschmoment (inneres Motormoment)" SWORD Trq 1 100 -3276.800 3276.700 FORMAT "%8.3" ECU_ADDRESS 0x7F8B18 /end MEASUREMENT
/begin MEASUREMENT CoEng_trqInrDesFast "Wunschmoment (inneres Motormoment) (schneller Pfad) erzeugt aus CoDT_trqLead" SWORD Trq 1 100 -3276.800 3276.700 FORMAT "%8.3" ECU_ADDRESS 0x7F8B1A /end MEASUREMENT
/begin MEASUREMENT CoEng_trqInrDesFastBase_mp "inneres schnelles Wunschmoment ohne Veränderung" SWORD Trq 1 100 -3276.800 3276.700 FORMAT "%8.3" ECU_ADDRESS 0x8FE52E /end MEASUREMENT
/begin MEASUREMENT CoEng_trqInrDesFastUnLim_mp "inneres schnelles Wunschmoment vor Begrenzung" SWORD Trq 1 100 -3276.800 3276.700 FORMAT "%8.3" ECU_ADDRESS 0x8FE530 /end MEASUREMENT
/begin MEASUREMENT CoEng_trqInrDesSlow "inneres Moment Wunschwert (normaler Pfad) erzeugt aus CoDT_trqDes" SWORD Trq 1 100 -3276.800 3276.700 FORMAT "%8.3" ECU_ADDRESS 0x7F8B1C /end MEASUREMENT
/begin MEASUREMENT CoEng_trqInrDesSlowBase_mp "inneres langsames Wunschmoment ohne Veränderung" SWORD Trq 1 100 -3276.800 3276.700 FORMAT "%8.3" ECU_ADDRESS 0x8FE51C /end MEASUREMENT
/begin MEASUREMENT CoEng_trqInrDesSlowUnLim_mp "inneres langsames Wunschmoment vor Begrenzung" SWORD Trq 1 100 -3276.800 3276.700 FORMAT "%8.3" ECU_ADDRESS 0x8FE51E /end MEASUREMENT
/begin MEASUREMENT CoEng_trqInrGearbxInMax_mp "maximales Getriebeeingangsmoment als inneres Motormoment" SWORD Trq 1 100 -3276.800 3276.700 FORMAT "%8.3" ECU_ADDRESS 0x8FE510 /end MEASUREMENT
/begin MEASUREMENT CoEng_trqInrLiDesSlw "Momentenführungswert mit LiGov Ausgngswert beaufschlagt" SWORD Trq 1 100 -3276.800 3276.700 FORMAT "%8.3" ECU_ADDRESS 0x7F8B1E /end MEASUREMENT
/begin MEASUREMENT CoEng_trqInrLim "Begrenzungsmoment (inneres Motormoment)" SWORD Trq 1 100 -3276.800 3276.700 FORMAT "%8.3" ECU_ADDRESS 0x7F8B20 /end MEASUREMENT
/begin MEASUREMENT CoEng_trqInrLimDes "Begrenzungsmoment als inneres Motormoment, korrigiert um Leerlaufreglerstellgröße" SWORD Trq 1 100 -3276.800 3276.700 FORMAT "%8.3" ECU_ADDRESS 0x7F8B22 /end MEASUREMENT
/begin MEASUREMENT CoEng_trqInrLimLead "Begrenzungsmoment mit lang anhaltenden Begrenzungen" SWORD Trq 1 100 -3276.800 3276.700 FORMAT "%8.3" ECU_ADDRESS 0x7F8B24 /end MEASUREMENT
/begin MEASUREMENT CoEng_trqInrLimLead0_mp "Torque lead limitation after error condition #0" SWORD Trq 1 100 -3276.800 3276.700 FORMAT "%8.3" ECU_ADDRESS 0x8FE53C /end MEASUREMENT
/begin MEASUREMENT CoEng_trqInrLimLead1_mp "Torque lead limitation after error condition #1" SWORD Trq 1 100 -3276.800 3276.700 FORMAT "%8.3" ECU_ADDRESS 0x8FE53E /end MEASUREMENT
/begin MEASUREMENT CoEng_trqInrLimLead2_mp "Torque lead limitation after error condition #2" SWORD Trq 1 100 -3276.800 3276.700 FORMAT "%8.3" ECU_ADDRESS 0x8FE540 /end MEASUREMENT
/begin MEASUREMENT CoEng_trqInrLtd "inneres Moment Sollwert nach Begrenzung, vor Eingriff ARD-Störungsregler" SWORD Trq 1 100 -3276.800 3276.700 FORMAT "%8.3" ECU_ADDRESS 0x7F8B26 /end MEASUREMENT
/begin MEASUREMENT CoEng_trqInrPrpLimErr_mp "Begrenzungsmoment für Vortrieb im Falle eines Systemfehlers als inneres Motormoment" SWORD Trq 1 100 -3276.800 3276.700 FORMAT "%8.3" ECU_ADDRESS 0x8FE512 /end MEASUREMENT
/begin MEASUREMENT CoEng_trqInrRaw "inneres Moment Rohwert" SWORD Trq 1 100 -3276.800 3276.700 FORMAT "%8.3" ECU_ADDRESS 0x7F8B28 /end MEASUREMENT
/begin MEASUREMENT CoEng_trqInrRawPre_mp "Rohwet inneres Moment ohne Leerlaufreglerstellgrösse" SWORD Trq 1 100 -3276.800 3276.700 FORMAT "%8.3" ECU_ADDRESS 0x8FE520 /end MEASUREMENT
/begin MEASUREMENT CoEng_trqInrSet "inneres Moment Sollwert (>Mengenberechnung)" SWORD Trq 1 100 -3276.800 3276.700 FORMAT "%8.3" ECU_ADDRESS 0x7F8B2A /end MEASUREMENT
/begin MEASUREMENT CoEng_trqInrSetLim_mp "Begrenzter Sollwert des inneren Moments, wenn Schub erkannt wurde und die Schubüberwachung aktiv ist" SWORD Trq 1 100 -3276.800 3276.700 FORMAT "%8.3" ECU_ADDRESS 0x8FE522 /end MEASUREMENT
/begin MEASUREMENT CoEng_trqInrSetUnLtd_mp "Unbegrenzter Sollwert des inneren Moments bei erkanntem Schub" SWORD Trq 1 100 -3276.800 3276.700 FORMAT "%8.3" ECU_ADDRESS 0x8FE524 /end MEASUREMENT
/begin MEASUREMENT CoEng_trqLiLtd "begrenztes Leerlaufreglermoment" SWORD Trq 1 100 -3276.800 3276.700 FORMAT "%8.3" ECU_ADDRESS 0x7F8B2C /end MEASUREMENT
/begin MEASUREMENT CoEng_trqLimErr "Begrenzungsmoment im Falle eines Systemfehlers" SWORD Trq 1 100 -3276.800 3276.700 FORMAT "%8.3" ECU_ADDRESS 0x7F8B2E /end MEASUREMENT
/begin MEASUREMENT CoEng_trqLimErr1 "Begrenzungsmoment im Falle Systemfehler 1" SWORD Trq 1 100 -3276.800 3276.700 FORMAT "%8.3" ECU_ADDRESS 0x7F8B30 /end MEASUREMENT
/begin MEASUREMENT CoEng_trqLimErr2 "Begrenzungsmoment im Fall Systemfahler 2" SWORD Trq 1 100 -3276.800 3276.700 FORMAT "%8.3" ECU_ADDRESS 0x7F8B32 /end MEASUREMENT
/begin MEASUREMENT CoEng_trqLimErr3 "Begrenzungsmoment im Falle Systemfehler3" SWORD Trq 1 100 -3276.800 3276.700 FORMAT "%8.3" ECU_ADDRESS 0x7F8B34 /end MEASUREMENT
/begin MEASUREMENT CoEng_trqLimErr4 "Begrenzungsmoment im Fall Systemfehler 4" SWORD Trq 1 100 -3276.800 3276.700 FORMAT "%8.3" ECU_ADDRESS 0x7F8B36 /end MEASUREMENT
/begin MEASUREMENT CoEng_trqLimMin1_mp "Minimum von Motormechanikschutz und Rauchbegrenzung" SWORD Trq 1 100 -3276.800 3276.700 FORMAT "%8.3" ECU_ADDRESS 0x8FE542 /end MEASUREMENT
/begin MEASUREMENT CoEng_trqLimMinEEPVal_mp "Stored in EEPROM in case of errors in particle filter" SWORD Trq 1 100 -3276.800 3276.700 FORMAT "%8.3" ECU_ADDRESS 0x8FE544 /end MEASUREMENT
/begin MEASUREMENT CoEng_trqLimMin_mp "Begrenzungsmoment, falls kein momentenbegrenzender Systemfehler vorliegt (Minimum aus Rauchgrenze un Motormech.schutz)" SWORD Trq 1 100 -3276.800 3276.700 FORMAT "%8.3" ECU_ADDRESS 0x6F8010 /end MEASUREMENT
/begin MEASUREMENT CoEng_trqLimOffs "current torque limitation with offset for ASDdc" SWORD Trq 1 100 -3276.800 3276.700 FORMAT "%8.3" ECU_ADDRESS 0x7F8B38 /end MEASUREMENT
/begin MEASUREMENT CoEng_trqLimOffs_mp "aktueller Momentgrenzwert mit Offset f. ARD" SWORD Trq 1 100 -3276.800 3276.700 FORMAT "%8.3" ECU_ADDRESS 0x8FE526 /end MEASUREMENT
/begin MEASUREMENT CoEng_trqLimPDiff "Momentenbegrenzung aufgrund Druckdifferenz über Partikelfilter" SWORD Trq 1 100 -3276.800 3276.700 FORMAT "%8.3" ECU_ADDRESS 0x7F8B3A /end MEASUREMENT
/begin MEASUREMENT CoEng_trqLimPDiffNOffs_mp "" SWORD Trq 1 100 -3276.800 3276.700 FORMAT "%8.3" ECU_ADDRESS 0x8FE546 /end MEASUREMENT
/begin MEASUREMENT CoEng_trqLimPFlt1_mp "Pressure difference conversion to torque" SWORD Trq 1 100 -3276.800 3276.700 FORMAT "%8.3" ECU_ADDRESS 0x8FE548 /end MEASUREMENT
/begin MEASUREMENT CoEng_trqLimSwt "Ausgang des RampSwitch-Block zur Momentbegrenzung im Systemfehlerfall" SWORD Trq 1 100 -3276.800 3276.700 FORMAT "%8.3" ECU_ADDRESS 0x7F8B3C /end MEASUREMENT
/begin MEASUREMENT CoEng_trqLimSwt1_mp "Begrenzungsmoment im Fehlerfall" SWORD Trq 1 100 -3276.800 3276.700 FORMAT "%8.3" ECU_ADDRESS 0x8FE54A /end MEASUREMENT
/begin MEASUREMENT CoEng_trqLimSwt2_mp "Begrenzungsmoment im Fehlerfall 2" SWORD Trq 1 100 -3276.800 3276.700 FORMAT "%8.3" ECU_ADDRESS 0x8FE54C /end MEASUREMENT
/begin MEASUREMENT CoEng_trqLimSwt3_mp "Begrenzungsmoment im Fehlerfall" SWORD Trq 1 100 -3276.800 3276.700 FORMAT "%8.3" ECU_ADDRESS 0x8FE54E /end MEASUREMENT
/begin MEASUREMENT CoEng_trqLimSwt4_mp "Begrenzungsmoment im Fehlerfall" SWORD Trq 1 100 -3276.800 3276.700 FORMAT "%8.3" ECU_ADDRESS 0x8FE550 /end MEASUREMENT
/begin MEASUREMENT CoEng_trqMax "Momentintervall Maximum" SWORD Trq 1 100 -3276.800 3276.700 FORMAT "%8.3" ECU_ADDRESS 0x7F8B3E /end MEASUREMENT
/begin MEASUREMENT CoEng_trqMin "Schleppmoment" SWORD Trq 1 100 -3276.800 3276.700 FORMAT "%8.3" ECU_ADDRESS 0x7F8B40 /end MEASUREMENT
/begin MEASUREMENT CoEng_trqOvrFul "Overfueling Menge nach Rampe" SWORD Trq 1 100 -3276.800 3276.700 FORMAT "%8.3" ECU_ADDRESS 0x7F8B42 /end MEASUREMENT
/begin MEASUREMENT CoEng_trqRmp_mp "Ausgangsmoment Rampe der Schubabschaltung" SWORD Trq 1 100 -3276.800 3276.700 FORMAT "%8.3" ECU_ADDRESS 0x8FE528 /end MEASUREMENT
/begin MEASUREMENT CoEng_trqSetASDdc_mp "Sollmoment nach Eingriff Ruckeldämfer vor zweiter Begrenzung (mit Offset)" SWORD Trq 1 100 -3276.800 3276.700 FORMAT "%8.3" ECU_ADDRESS 0x8FE52A /end MEASUREMENT
/begin MEASUREMENT CoEng_trqSlpLim "Begrenzungsmoment für Rauchbegrenzung nach Turboschubbegrenzung" SWORD Trq 1 100 -3276.800 3276.700 FORMAT "%8.3" ECU_ADDRESS 0x7F8B46 /end MEASUREMENT
/begin MEASUREMENT CoEng_volFlConsum "absoluter Verbrauch" SLONG FlConsum_ul_20ms 1 100 -2147483648.00 2147483647.00 FORMAT "%13.2" ECU_ADDRESS 0x7F90E0 /end MEASUREMENT
/begin MEASUREMENT CoEng_volFlConsumAdj_mp "abgeglicher Kraftstoffverbrauch" SLONG FlConsum_ul_20ms 1 100 -2147483648.00 2147483647.00 FORMAT "%13.2" ECU_ADDRESS 0x8FE4F8 /end MEASUREMENT
/begin MEASUREMENT CoEng_voltotFlConsum "Absoluter Kraftstoffverbrauch" SLONG FlConsum_ul 1 100 -2147483648.00 2147483647.00 FORMAT "%13.2" ECU_ADDRESS 0x7F90E4 /end MEASUREMENT
/begin MEASUREMENT ComBas_stDiaReq "Message: Antwort von der Diagnose-Schnittstelle" UBYTE OneToOne 1 100 0.00 255.0 FORMAT "%5.1" ECU_ADDRESS 0x7F881C /end MEASUREMENT
/begin MEASUREMENT ConvCD_ctClutchDfct_mp "Defektzähler von Plausibitätfehler des Kupplungssignals" UWORD OneToOne 1 100 0.00 65535.00 FORMAT "%8.2" ECU_ADDRESS 0x8FE552 /end MEASUREMENT
/begin MEASUREMENT ConvCD_stClth "Kupplungszustand" UBYTE OneToOne 1 100 0.00 255.0 FORMAT "%5.1" ECU_ADDRESS 0x7F881D /end MEASUREMENT
/begin MEASUREMENT ConvCD_stClthRaw "Kupplungszustand nicht überwacht" UBYTE OneToOne 1 100 0.00 255.0 FORMAT "%5.1" ECU_ADDRESS 0x7F881E /end MEASUREMENT
/begin MEASUREMENT ConvCD_stClutchRecord "Message zur Kupplungsstatus Wechsel ( 0 --> 1)" UBYTE OneToOne 1 100 0.00 255.0 FORMAT "%5.1" ECU_ADDRESS 0x7F881F /end MEASUREMENT
/begin MEASUREMENT ConvCD_stDebVal "entprelltes Kupplungssignal" UBYTE OneToOne 1 100 0.00 255.0 FORMAT "%5.1" ECU_ADDRESS 0x7F8820 /end MEASUREMENT
/begin MEASUREMENT ConvCD_stIntDebVal "Entprellt Kupplung Status zur internen Verwendung" UBYTE OneToOne 1 100 0.00 255.0 FORMAT "%5.1" ECU_ADDRESS 0x7F8821 /end MEASUREMENT
/begin MEASUREMENT ConvCD_stLastDebVal "Letzter Kupplungssignalstatus." UBYTE OneToOne 1 100 0.00 255.0 FORMAT "%5.1" ECU_ADDRESS 0x7F8822 /end MEASUREMENT
/begin MEASUREMENT ConvCD_stLastGear "Gang von den letzten Zyklus" SBYTE OneToOne 1 100 -128.0 127.0 FORMAT "%5.1" ECU_ADDRESS 0x7F8823 /end MEASUREMENT
/begin MEASUREMENT ConvCD_stOldGear "Letzte gültigen Gang" SBYTE OneToOne 1 100 -128.0 127.0 FORMAT "%5.1" ECU_ADDRESS 0x7F8824 /end MEASUREMENT
/begin MEASUREMENT ConvCD_stRawVal "Kupplungssignal Rohwert" UBYTE OneToOne 1 100 0.00 255.0 FORMAT "%5.1" ECU_ADDRESS 0x7F8825 /end MEASUREMENT
/begin MEASUREMENT ConvCD_swtSig "Schalter für Kupplungssignalquelle (DIO/CAN)." UBYTE OneToOne 1 100 0.00 255.0 FORMAT "%5.1" ECU_ADDRESS 0x7F8826 /end MEASUREMENT
/begin MEASUREMENT Conv_rTrans "Übertragungsverhältins Momentenwandler (Kupplung)" SWORD TransR 1 100 -327.6800 327.6700 FORMAT "%8.4" ECU_ADDRESS 0x7F8B74 /end MEASUREMENT
/begin MEASUREMENT CoVeh_nAcsMax "maximale Drehzahl Nebenaggregate" SWORD EngN 1 100 -32768.00 32767.00 FORMAT "%8.2" ECU_ADDRESS 0x7F8B56 /end MEASUREMENT
/begin MEASUREMENT CoVeh_nAcsMin "minimale Drehzahl Nebenaggregate" SWORD EngN 1 100 -32768.00 32767.00 FORMAT "%8.2" ECU_ADDRESS 0x7F8B58 /end MEASUREMENT
/begin MEASUREMENT CoVeh_nLimEngSpd "limitierte Motordrehzahl für die Drehmomentenberechnung" SWORD EngN 1 100 -32768.00 32767.00 FORMAT "%8.2" ECU_ADDRESS 0x7F8B5A /end MEASUREMENT
/begin MEASUREMENT CoVeh_nMax "Auftrag maximale Motordrehzahl" SWORD EngN 1 100 -32768.00 32767.00 FORMAT "%8.2" ECU_ADDRESS 0x7F8B5C /end MEASUREMENT
/begin MEASUREMENT CoVeh_nMin "Auftrag minimale Motordrehzahl" SWORD EngN 1 100 -32768.00 32767.00 FORMAT "%8.2" ECU_ADDRESS 0x7F8B5E /end MEASUREMENT
/begin MEASUREMENT CoVeh_pwrAcsDes "Nebenaggregatleistung Auftrag" SWORD Pwr 1 100 -308831.1 308821.7 FORMAT "%8.1" ECU_ADDRESS 0x7F8B60 /end MEASUREMENT
/begin MEASUREMENT CoVeh_pwrAcsLead "Vorhalt Nebenaggregatleistung Auftrag" SWORD Pwr 1 100 -308831.1 308821.7 FORMAT "%8.1" ECU_ADDRESS 0x7F8B62 /end MEASUREMENT
/begin MEASUREMENT CoVeh_pwrAcsTempLim_mp "Power demand for all temporary accessories - limited based on PrpBrk_trqDes" SWORD Pwr 1 100 -308831.1 308821.7 FORMAT "%8.1" ECU_ADDRESS 0x8FE554 /end MEASUREMENT
/begin MEASUREMENT CoVeh_stOrd "Randbedingungen für physikalischen Auftrag" UBYTE OneToOne 1 100 0.00 255.0 FORMAT "%5.1" ECU_ADDRESS 0x7F881A /end MEASUREMENT
/begin MEASUREMENT CoVeh_trqAcs "Momentenanforderung der Nebenaggregate" SWORD Trq 1 100 -3276.800 3276.700 FORMAT "%8.3" ECU_ADDRESS 0x7F8B64 /end MEASUREMENT
/begin MEASUREMENT CoVeh_trqAcsDes "Momentenanforderung Nebenaggregate Wunschwert" SWORD Trq 1 100 -3276.800 3276.700 FORMAT "%8.3" ECU_ADDRESS 0x7F8B66 /end MEASUREMENT
/begin MEASUREMENT CoVeh_trqAcsLead "Momentenanforderung Nebenaggregate Vorhaltewert" SWORD Trq 1 100 -3276.800 3276.700 FORMAT "%8.3" ECU_ADDRESS 0x7F8B68 /end MEASUREMENT
/begin MEASUREMENT CoVeh_trqAcsLimCrSDes_mp "Torque demand" SWORD Trq 1 100 -3276.800 3276.700 FORMAT "%8.3" ECU_ADDRESS 0x8FE556 /end MEASUREMENT
/begin MEASUREMENT CoVeh_trqAcsPerm "Momentenbedarf permanente Nebenaggregate" SWORD Trq 1 100 -3276.800 3276.700 FORMAT "%8.3" ECU_ADDRESS 0x7F8B6A /end MEASUREMENT
/begin MEASUREMENT CoVeh_trqAcsTemp "Momentenbedarf zuschaltbare Nebenaggregate" SWORD Trq 1 100 -3276.800 3276.700 FORMAT "%8.3" ECU_ADDRESS 0x7F8B6C /end MEASUREMENT
/begin MEASUREMENT CoVeh_trqPrpDes "Vortriebsmoment Wunschwert" SWORD TrqPrp 1 100 -6553.600 6553.400 FORMAT "%8.3" ECU_ADDRESS 0x7F8B6E /end MEASUREMENT
/begin MEASUREMENT CoVeh_trqPrpLead "Vortriebsmoment Vorhaltewert" SWORD TrqPrp 1 100 -6553.600 6553.400 FORMAT "%8.3" ECU_ADDRESS 0x7F8B70 /end MEASUREMENT
/begin MEASUREMENT CoVeh_trqPrpLimErr "Begrenzungsmoment für Vortrieb im Falle eines Systemfehlers" SWORD TrqPrp 1 100 -6553.600 6553.400 FORMAT "%8.3" ECU_ADDRESS 0x7F8B72 /end MEASUREMENT
/begin MEASUREMENT CoVM_amAct_mp "Aktueller Integrationswert des  MSR-Momentenüberschußintegrals" SWORD TrqPrpDT 1 100 -163840.0 163835.0 FORMAT "%8.1" ECU_ADDRESS 0x8FE558 /end MEASUREMENT
/begin MEASUREMENT CoVM_stActDem "Status aktiv wirkender Fahrdynamikeingriffe" UBYTE OneToOne 1 100 0.00 255.0 FORMAT "%5.1" ECU_ADDRESS 0x7F8814 /end MEASUREMENT
/begin MEASUREMENT CoVM_stDemCheck "Steuerbits der Abschaltsteuerung der Fahrdynamikeingriffe" UBYTE OneToOne 1 100 0.00 255.0 FORMAT "%5.1" ECU_ADDRESS 0x7F8815 /end MEASUREMENT
/begin MEASUREMENT CoVM_stDemUnplaus_mp "Status der DCS Überwachung" UBYTE OneToOne 1 100 0.00 255.0 FORMAT "%5.1" ECU_ADDRESS 0x8FE55A /end MEASUREMENT
/begin MEASUREMENT CoVM_stOrd "Randbedingungen für physikalischen Auftrag" UBYTE OneToOne 1 100 0.00 255.0 FORMAT "%5.1" ECU_ADDRESS 0x7F8816 /end MEASUREMENT
/begin MEASUREMENT CoVM_stTrqLeadFrz "current status if SW timer running" UBYTE OneToOne 1 100 0.00 255.0 FORMAT "%5.1" ECU_ADDRESS 0x7F8817 /end MEASUREMENT
/begin MEASUREMENT CoVM_swtSlipCtl "Fahrdynamik-Konfiguration (0: ASR aus, MSR aus; 1: ASR an, MSR aus;  2: ASR aus, MSR an;  3: ASR an, MSR an)" UBYTE OneToOne 1 100 0.00 255.0 FORMAT "%5.1" ECU_ADDRESS 0x7F8819 /end MEASUREMENT
/begin MEASUREMENT CoVM_trqDec "Momenteneingriff von ASR" SWORD TrqPrp 1 100 -6553.600 6553.400 FORMAT "%8.3" ECU_ADDRESS 0x7F8B4A /end MEASUREMENT
/begin MEASUREMENT CoVM_trqDecSetVal_mp "decreasing  torque set value wheel-torque" SWORD TrqPrp 1 100 -6553.600 6553.400 FORMAT "%8.3" ECU_ADDRESS 0x8FE562 /end MEASUREMENT
/begin MEASUREMENT CoVM_trqDesIncMax_mp "Messpunkt des Maximumwertes zwischen PrpBrk_trqDes & CoVM_trqInc" SWORD TrqPrp 1 100 -6553.600 6553.400 FORMAT "%8.3" ECU_ADDRESS 0x8FE55E /end MEASUREMENT
/begin MEASUREMENT CoVM_trqDVCH "Fahrerwunschmoment für DSC, EGS" SWORD Trq 1 100 -3276.800 3276.700 FORMAT "%8.3" ECU_ADDRESS 0x7F8B48 /end MEASUREMENT
/begin MEASUREMENT CoVM_trqGearbxMax "Momentbegrenzung reduzierender Getriebeeingriff" SWORD Trq 1 100 -3276.800 3276.700 FORMAT "%8.3" ECU_ADDRESS 0x7F8B4C /end MEASUREMENT
/begin MEASUREMENT CoVM_trqGearbxMin "Momentbegrenzung erhöhender Getriebeeingriff" SWORD Trq 1 100 -3276.800 3276.700 FORMAT "%8.3" ECU_ADDRESS 0x7F8B4E /end MEASUREMENT
/begin MEASUREMENT CoVM_trqInc "Momenteneingriff von MSR" SWORD TrqPrp 1 100 -6553.600 6553.400 FORMAT "%8.3" ECU_ADDRESS 0x7F8B50 /end MEASUREMENT
/begin MEASUREMENT CoVM_trqIncSetVal_mp "increasing  torque set value  of wheel-torque" SWORD TrqPrp 1 100 -6553.600 6553.400 FORMAT "%8.3" ECU_ADDRESS 0x8FE564 /end MEASUREMENT
/begin MEASUREMENT CoVM_trqInt_mp "Aktuelles  Integrationsmoment des MSR-Momentenüberschußintegrals" SWORD TrqPrp 1 100 -6553.600 6553.400 FORMAT "%8.3" ECU_ADDRESS 0x8FE55C /end MEASUREMENT
/begin MEASUREMENT CoVM_trqLeadIncMax_mp "Messpunkt des Maximumwertes zwischen PrpBrk_trqLead & CoVM_trqInc" SWORD TrqPrp 1 100 -6553.600 6553.400 FORMAT "%8.3" ECU_ADDRESS 0x8FE560 /end MEASUREMENT
/begin MEASUREMENT CoVM_trqPrpDes "Wunsch Vortriebsmoment" SWORD TrqPrp 1 100 -6553.600 6553.400 FORMAT "%8.3" ECU_ADDRESS 0x7F8B52 /end MEASUREMENT
/begin MEASUREMENT CoVM_trqPrpLead "Vorhalt Vortriebsmoment" SWORD TrqPrp 1 100 -6553.600 6553.400 FORMAT "%8.3" ECU_ADDRESS 0x7F8B54 /end MEASUREMENT
/begin MEASUREMENT CpBVlv_stLogic "Logikstatus fuer Verdichterbypass" UBYTE OneToOne 1 100 0.00 255.0 FORMAT "%5.1" ECU_ADDRESS 0x7F8827 /end MEASUREMENT
/begin MEASUREMENT CpBVlv_stOpn "Zustand Kompressorbypass-Ventil" UBYTE OneToOne 1 100 0.00 255.0 FORMAT "%5.1" ECU_ADDRESS 0x7F8828 /end MEASUREMENT
/begin MEASUREMENT CrCCD_dMFLData_mp "Rohdaten vom MFL" UBYTE OneToOne 1 100 0.00 255.0 FORMAT "%5.1" ECU_ADDRESS 0x8FE566 /end MEASUREMENT
/begin MEASUREMENT CrCCD_stDev "Status FGR-Bedienteil (zusätzliche Abschaltbedingungen)" UBYTE OneToOne 1 100 0.00 255.0 FORMAT "%5.1" ECU_ADDRESS 0x7F8829 /end MEASUREMENT
/begin MEASUREMENT CrCCD_stKey "Rückgabewert ""Taste gedrückt""" UBYTE OneToOne 1 100 0.00 255.0 FORMAT "%5.1" ECU_ADDRESS 0x7F882A /end MEASUREMENT
/begin MEASUREMENT CrCCD_stKeyOff "tip up und tip down Taste bei deaktivierten CrCtl Hauptschalter" UBYTE OneToOne 1 100 0.00 255.0 FORMAT "%5.1" ECU_ADDRESS 0x7F882B /end MEASUREMENT
/begin MEASUREMENT CrCCD_swtDev "SW-Schalter eingebauter Typ FGR Bedienteil" UBYTE OneToOne 1 100 0.00 255.0 FORMAT "%5.1" ECU_ADDRESS 0x7F882C /end MEASUREMENT
/begin MEASUREMENT CrCCD_swtMSW "Schalterstellung vom MSW (1...MSW ein/0...MSW aus)" UBYTE OneToOne 1 100 0.00 255.0 FORMAT "%5.1" ECU_ADDRESS 0x7F882D /end MEASUREMENT
/begin MEASUREMENT CrCtl_dvAcc_mp "Rampensteigung bei Beschleunigung SET+" SWORD dVel_20ms 1 100 -16384.00 16383.50 FORMAT "%8.2" ECU_ADDRESS 0x8FE56C /end MEASUREMENT
/begin MEASUREMENT CrCtl_dvDecl_mp "Rampensteigung bei Verzögerung SET-" SWORD dVel_20ms 1 100 -16384.00 16383.50 FORMAT "%8.2" ECU_ADDRESS 0x8FE56E /end MEASUREMENT
/begin MEASUREMENT CrCtl_dvResAbv_mp "Rampensteigung bei WA-" SWORD dVel_20ms 1 100 -16384.00 16383.50 FORMAT "%8.2" ECU_ADDRESS 0x8FE570 /end MEASUREMENT
/begin MEASUREMENT CrCtl_dvResBlw_mp "Rampensteigung WA+" SWORD dVel_20ms 1 100 -16384.00 16383.50 FORMAT "%8.2" ECU_ADDRESS 0x8FE572 /end MEASUREMENT
/begin MEASUREMENT CrCtl_numGear "Gang FGR" SBYTE OneToOne 1 100 -128.0 127.0 FORMAT "%5.1" ECU_ADDRESS 0x7F882E /end MEASUREMENT
/begin MEASUREMENT CrCtl_rVnBeg "Verhältnis Geschwindigkeit zu Drehzahl bei Aktivierung FGR" SWORD VelToN 1 100 0.00 0.3276700 FORMAT "%9.7" ECU_ADDRESS 0x7F8B76 /end MEASUREMENT
/begin MEASUREMENT CrCtl_st "Status FGR" UBYTE OneToOne 1 100 0.00 255.0 FORMAT "%5.1" ECU_ADDRESS 0x7F8830 /end MEASUREMENT
/begin MEASUREMENT CrCtl_stActive "Flag aktiver FGR" UBYTE OneToOne 1 100 0.00 255.0 FORMAT "%5.1" ECU_ADDRESS 0x7F8831 /end MEASUREMENT
/begin MEASUREMENT CrCtl_stBrkBeforeCruise_mp "Meßpunkt für Bremsenanforderung" UBYTE OneToOne 1 100 0.00 255.0 FORMAT "%5.1" ECU_ADDRESS 0x8FE568 /end MEASUREMENT
/begin MEASUREMENT CrCtl_stCAN "Status der CrCtl für CAN" UBYTE OneToOne 1 100 0.00 255.0 FORMAT "%5.1" ECU_ADDRESS 0x7F8832 /end MEASUREMENT
/begin MEASUREMENT CrCtl_stClCtr_mp "Status nach DSC, ASC & MSR Eingriffen" UWORD OneToOne 1 100 0.00 65535.00 FORMAT "%8.2" ECU_ADDRESS 0x8FE56A /end MEASUREMENT
/begin MEASUREMENT CrCtl_stLampOut "Status der CrCtl-Lampe (wird über CAN versendet)" UBYTE OneToOne 1 100 0.00 255.0 FORMAT "%5.1" ECU_ADDRESS 0x7F8834 /end MEASUREMENT
/begin MEASUREMENT CrCtl_stRecFGR "Status ob FGR im Fahrzeug verbaut ist" UBYTE OneToOne 1 100 0.00 255.0 FORMAT "%5.1" ECU_ADDRESS 0x7F8835 /end MEASUREMENT
/begin MEASUREMENT CrCtl_stShutOffCode "Abschaltgrund FGR" ULONG OneToOne 1 100 0.00 4294967295.00 FORMAT "%13.2" ECU_ADDRESS 0x7F90E8 /end MEASUREMENT
/begin MEASUREMENT CrCtl_stShutOffCode1_mp "Low Byte von CrCtl_shutOffCode (Verwendung als Signal)" UWORD OneToOne 1 100 0.00 65535.00 FORMAT "%8.2" ECU_ADDRESS 0x6F8014 /end MEASUREMENT
/begin MEASUREMENT CrCtl_stShutOffCode2_mp "Low Byte von CrCtl_shutOffCode (Verwendung als Signal)" UWORD OneToOne 1 100 0.00 65535.00 FORMAT "%8.2" ECU_ADDRESS 0x6F8016 /end MEASUREMENT
/begin MEASUREMENT CrCtl_stShutOffFrz1_mp "latched shutoff reason" UWORD OneToOne 1 100 0.00 65535.00 FORMAT "%8.2" ECU_ADDRESS 0x6F8018 /end MEASUREMENT
/begin MEASUREMENT CrCtl_stShutOffFrz2_mp "latched shutoff reason" UWORD OneToOne 1 100 0.00 65535.00 FORMAT "%8.2" ECU_ADDRESS 0x6F801A /end MEASUREMENT
/begin MEASUREMENT CrCtl_stShutOffFrz_mp "eingefrorener Abschaltgrund FGR" ULONG OneToOne 1 100 0.00 4294967295.00 FORMAT "%13.2" ECU_ADDRESS 0x6F801C /end MEASUREMENT
/begin MEASUREMENT CrCtl_trqDes "Momentenanforderung FGR" SWORD TrqPrp 1 100 -6553.600 6553.400 FORMAT "%8.3" ECU_ADDRESS 0x7F8B78 /end MEASUREMENT
/begin MEASUREMENT CrCtl_trqDT1_mp "DT1 Ausgang FGR" SWORD TrqPrp 1 100 -6553.600 6553.400 FORMAT "%8.3" ECU_ADDRESS 0x8FE574 /end MEASUREMENT
/begin MEASUREMENT CrCtl_trqI_mp "I-Anteil FGR" SWORD TrqPrp 1 100 -6553.600 6553.400 FORMAT "%8.3" ECU_ADDRESS 0x8FE576 /end MEASUREMENT
/begin MEASUREMENT CrCtl_trqLead "Vorhaltmoment des FGR" SWORD TrqPrp 1 100 -6553.600 6553.400 FORMAT "%8.3" ECU_ADDRESS 0x7F8B7A /end MEASUREMENT
/begin MEASUREMENT CrCtl_trqMax_mp "Maximales Moment FGR" SWORD TrqPrp 1 100 -6553.600 6553.400 FORMAT "%8.3" ECU_ADDRESS 0x8FE578 /end MEASUREMENT
/begin MEASUREMENT CrCtl_trqP_mp "P-Anteil der Fahrgeschwindigkeits PI-Regelung" SWORD TrqPrp 1 100 -6553.600 6553.400 FORMAT "%8.3" ECU_ADDRESS 0x8FE57A /end MEASUREMENT
/begin MEASUREMENT CrCtl_vBeg "FGR: Fahrgeschwindigkeit am Anfang von EIN+, EIN- und WA" SWORD Vel 1 100 0.00 300.0000 FORMAT "%8.4" ECU_ADDRESS 0x7F8B80 /end MEASUREMENT
/begin MEASUREMENT CrCtl_vDes "Sollgeschwindigkeit FGR" SWORD Vel 1 100 0.00 300.0000 FORMAT "%8.4" ECU_ADDRESS 0x7F8B84 /end MEASUREMENT
/begin MEASUREMENT CrCtl_vDiffRed_mp "Geschwindigkeitsdifferenz für Abflachungskennlinie" SWORD Vel 1 100 -327.6800 327.6700 FORMAT "%8.4" ECU_ADDRESS 0x8FE57C /end MEASUREMENT
/begin MEASUREMENT CrCtl_vDiff_mp "FGR: | CrCtl_vDes - CrCtl_vBeg |, Differenz V_SOLL und v bei Anfang EIN+, EIN- und WA" SWORD Vel 1 100 -327.6800 327.6700 FORMAT "%8.4" ECU_ADDRESS 0x8FE57E /end MEASUREMENT
/begin MEASUREMENT CrCtl_vRmp "Rampenzielgeschwindigkeit FGR" SWORD Vel 1 100 0.00 300.0000 FORMAT "%8.4" ECU_ADDRESS 0x7F8B90 /end MEASUREMENT
/begin MEASUREMENT indexmrst "Index für vmrki..." UBYTE dez 1 100 0.00 255.0 FORMAT "%5.1" ECU_ADDRESS 0x7F89AE /end MEASUREMENT
/begin MEASUREMENT tnomgs60ms "Zeit in der keine CAN-Botschaft G_T versendet wurde" UBYTE t20msxs_ub_b5p1 1 100 0.00 5.100 FORMAT "%5.3" ECU_ADDRESS 0x7F89B5 /end MEASUREMENT
/begin MEASUREMENT vmrki1_w "v-Marke 1 für Botschaft" UWORD Vel 1 100 0.00 655.3500 FORMAT "%8.4" ECU_ADDRESS 0x7F9082 /end MEASUREMENT
/begin MEASUREMENT vmrki2_w "v-Marke 2 für Botschaft" UWORD Vel 1 100 0.00 655.3500 FORMAT "%8.4" ECU_ADDRESS 0x7F9084 /end MEASUREMENT
/begin MEASUREMENT vmrki3_w "v-Marke 3 für Botschaft" UWORD Vel 1 100 0.00 655.3500 FORMAT "%8.4" ECU_ADDRESS 0x7F9086 /end MEASUREMENT
/begin FUNCTION coeng_aftrunextwait "Warten auf externe Ereignisse während Nachlauf"
 /begin DEF_CHARACTERISTIC CoEng_ExtWaitMsk2_C CoEng_ExtWaitMsk_C CoEng_tiMinAftRun_C CoEng_tiMRlyShutOffDel_C CoEng_tiWakeUp_C /end DEF_CHARACTERISTIC
/end FUNCTION
/begin FUNCTION coeng_aftrunextwait_msg "" /begin OUT_MEASUREMENT CoEng_stExtWait CoEng_stExtWait2 CoEng_tiMinAftRun /end OUT_MEASUREMENT /end FUNCTION
/begin FUNCTION coeng_aftrunextwait_uic "" /end FUNCTION
/begin FUNCTION coeng_aftrun_msg "" /begin OUT_MEASUREMENT CoEng_stAftRun CoEng_stAftRunPath /end OUT_MEASUREMENT /end FUNCTION
/begin FUNCTION coeng_aftrun_uic "" /begin OUT_MEASUREMENT CoEng_stEEPStore_mp /end OUT_MEASUREMENT /end FUNCTION
/begin FUNCTION coeng_flconsum "Verbrauchsberechnung"
 /begin DEF_CHARACTERISTIC CoEng_dqSubsRgnRmpUp_C CoEng_dqSubsRgnRmpDwn_C CoEng_facFlConsumAdjDfl_C CoEng_facFlConsumAdjMax_C CoEng_facFlConsumAdjMin_C CoEng_qSubs_MAP CoEng_rhoFuel_C CoEng_stSubsRgnMsk_C /end DEF_CHARACTERISTIC
 /begin IN_MEASUREMENT CoEng_trq Eng_nAvrg /end IN_MEASUREMENT
/end FUNCTION
/begin FUNCTION coeng_flconsum_uic ""
 /begin OUT_MEASUREMENT CoEng_dvolPerStroke_mp CoEng_facFlConsumAdj_mp CoEng_qSubs_mp CoEng_qSum_mp CoEng_volFlConsumAdj_mp /end OUT_MEASUREMENT
/end FUNCTION
/begin FUNCTION coeng_flconsum_var "" /end FUNCTION
/begin FUNCTION coeng_flconsum_var_msg "" /end FUNCTION
/begin FUNCTION coeng_mon "Abschaltkoordinator"
 /begin DEF_CHARACTERISTIC CoEng_stIRevShutOff_C CoEng_stRevShutOff_C CoEng_stShOffAddReqIRev_C CoEng_stShOffAddReqRev_C CoEng_stShOffAirbFrnt_C CoEng_stShOffAirbRear_C CoEng_stShOffAirbSide_C CoEng_stShOffCycSigChk_C CoEng_stShOffDblCtl_C CoEng_stShOffDiaReqFI_C CoEng_stShOffFWOscDet_C CoEng_stShOffInit_C CoEng_stShOffInjMon_C CoEng_stShOffInjShCir_C CoEng_stShOffIRevSys1_C CoEng_stShOffIRevSys2_C CoEng_stShOffIRevVeh_C CoEng_stShOffIrrCmb_C CoEng_stShOffOvrSpd_C CoEng_stShOffPresMin_C CoEng_stShOffRevSys1_C CoEng_stShOffRevSys2_C CoEng_stShOffRevVeh_C CoEng_stShOffRlOvrBar_C CoEng_stShOffSV_C /end DEF_CHARACTERISTIC
/end FUNCTION
/begin FUNCTION coeng_monaddreq "Kundenspezifische Abschaltanforderungen an Abschaltkoordinator" /end FUNCTION
/begin FUNCTION coeng_monaddreq_msg "" /begin OUT_MEASUREMENT CoEng_stShOffAddReqIRev CoEng_stShOffAddReqRev /end OUT_MEASUREMENT /end FUNCTION
/begin FUNCTION coeng_monaddreq_uic "" /end FUNCTION
/begin FUNCTION coeng_mon_uic "" /end FUNCTION
/begin FUNCTION coeng_msg ""
 /begin OUT_MEASUREMENT CoEng_dvolFlConsum CoEng_facAdj CoEng_nMax CoEng_nMin CoEng_stDisable CoEng_stIRevShutOff CoEng_stMonActrPrt CoEng_stMonShOff CoEng_stOvrRun CoEng_stPwrDwn CoEng_stPwrStgEnaCond CoEng_stRevShutOff CoEng_stShutOff CoEng_stShutOffPath CoEng_stTrqLimErr CoEng_stTrqLimErr1 CoEng_stTrqLimErr2 CoEng_stTrqLimErr3 CoEng_stTrqLimErr4 CoEng_stTrqLimPFltErr CoEng_tiWakeUp CoEng_trq CoEng_trqCurrLim CoEng_trqInrCurr CoEng_trqInrCurrFast CoEng_trqInrDes CoEng_trqInrDesFast CoEng_trqInrDesSlow CoEng_trqInrLim CoEng_trqInrLimDes CoEng_trqInrLimLead CoEng_trqInrLtd CoEng_trqInrRaw CoEng_trqInrSet CoEng_trqLiLtd CoEng_trqLimErr CoEng_trqLimErr1 CoEng_trqLimErr2 CoEng_trqLimErr3 CoEng_trqLimErr4 CoEng_trqLimPDiff CoEng_trqLimSwt CoEng_trqMax CoEng_trqMin CoEng_trqOvrFul CoEng_trqSlpLim CoEng_volFlConsum CoEng_voltotFlConsum /end OUT_MEASUREMENT
/end FUNCTION
/begin FUNCTION coeng_ovrruncoord "Schubkoordinator"
 /begin DEF_CHARACTERISTIC CoEng_lSumFuncPref_C CoEng_numSelFuncPref_C CoEng_facActvFunc2_1_C CoEng_facActvFunc2_2_C CoEng_facActvFunc2_3_C CoEng_facActvFunc2_4_C CoEng_facActvFunc2_5_C CoEng_facActvFunc2_6_C CoEng_facActvFunc2_7_C CoEng_facActvFunc2_8_C CoEng_facActvFunc1_C CoEng_facActvFunc2_C CoEng_facActvFunc3_C CoEng_facActvFunc4_C CoEng_facActvFunc5_C CoEng_facActvFunc6_C CoEng_facActvFunc7_C CoEng_facActvFunc8_C CoEng_stCoopCapbl_C CoEng_stOvrRunRgnMsk_C CoEng_tiOvrRunCoordDebPos_C CoEng_tiThresFuncPref_C /end DEF_CHARACTERISTIC
/end FUNCTION
/begin FUNCTION coeng_ovrruncoord_msg "" /begin OUT_MEASUREMENT CoEng_stOvrRunCoord CoEng_stZFCEmissionRoll /end OUT_MEASUREMENT /end FUNCTION
/begin FUNCTION coeng_ovrruncoord_uic ""
 /begin OUT_MEASUREMENT CoEng_CoordPrioFld_mp CoEng_stCoordFuncFld_mp CoEng_stCoordFuncPref_mp CoEng_stOvrRunEGT_mp /end OUT_MEASUREMENT
/end FUNCTION
/begin FUNCTION coeng_pwrstgstatecalc "Endstufenkoordinator"
 /begin DEF_CHARACTERISTIC CoEng_tiDlyT15_C CoEng_uHighBattPwrStgHysHi_C CoEng_uHighBattPwrStgHysLo_C CoEng_uLowBattPwrStgHysHi_C CoEng_uLowBattPwrStgHysLo_C /end DEF_CHARACTERISTIC
/end FUNCTION
/begin FUNCTION coeng_pwrstgstatecalc_uic "" /begin OUT_MEASUREMENT CoEng_stDlyT15_mp /end OUT_MEASUREMENT /end FUNCTION
/begin FUNCTION coeng_shoff "Abstellsteuerung im Nachlauf"
 /begin DEF_CHARACTERISTIC CoEng_nSoftShOffMax_C CoEng_nSoftShOffMin_C CoEng_qSoftShOffMax_C CoEng_stShOffAftRun_C CoEng_stShOffExtReq_C CoEng_stShOffTstSel_C CoEng_stSoftShOffAR_C CoEng_tiShOffTstFlSys_C CoEng_tiSoftShOff_CUR CoEng_vSoftShOffMax_C /end DEF_CHARACTERISTIC
 /begin IN_MEASUREMENT Eng_nAvrg /end IN_MEASUREMENT
/end FUNCTION
/begin FUNCTION coeng_shofflib ""
 /begin DEF_CHARACTERISTIC CoEng_nShOffTstMax_C CoEng_nShOffTstMin_C CoEng_tShOffTstMin_C CoEng_vShOffTstMin_C /end DEF_CHARACTERISTIC
/end FUNCTION
/begin FUNCTION coeng_shofflib_uic "" /end FUNCTION
/begin FUNCTION coeng_shoff_msg "" /begin OUT_MEASUREMENT CoEng_numShOffTstNewSel CoEng_pRailT15Off CoEng_stShOffTst /end OUT_MEASUREMENT /end FUNCTION
/begin FUNCTION coeng_shoff_uic "" /begin OUT_MEASUREMENT CoEng_stShOffTstOldRes_mp CoEng_tiSoftShOff_mp /end OUT_MEASUREMENT /end FUNCTION
/begin FUNCTION coeng_steng "aktueller Motorzustand [-]" /begin DEF_CHARACTERISTIC CoEng_nThresNrml2Strt_C CoEng_tiNrml2Strt_C /end DEF_CHARACTERISTIC /end FUNCTION
/begin FUNCTION coeng_steng_msg ""
 /begin OUT_MEASUREMENT CoEng_stEng CoEng_stEngOld CoEng_tiAfterrun CoEng_tiAfterrunRed CoEng_tiNormal CoEng_tiNormalRed CoEng_tiStart CoEng_tiStartRed /end OUT_MEASUREMENT
/end FUNCTION
/begin FUNCTION coeng_steng_uic "" /end FUNCTION
/begin FUNCTION coeng_sttrqlimcalc "" /end FUNCTION
/begin FUNCTION coeng_sttrqlimcalc_msg ""
 /begin OUT_MEASUREMENT CoEng_rTrq CoEng_stCurrLim CoEng_stCurrLimActive CoEng_trqInrCurrLim /end OUT_MEASUREMENT
/end FUNCTION
/begin FUNCTION coeng_sttrqlimcalc_uic "" /begin OUT_MEASUREMENT CoEng_trqInrGearbxInMax_mp CoEng_trqInrPrpLimErr_mp /end OUT_MEASUREMENT /end FUNCTION
/begin FUNCTION coeng_trqcalc "Motormomentenberechnung"
 /begin DEF_CHARACTERISTIC CoEng_dtrqRmpUp_C CoEng_dtrqRmpDwn_C CoEng_tiRmpStrtDfl_C CoEng_tiRmpStrt_CUR CoEng_tiSwtOffDfl_C CoEng_tiSwtOff_CUR CoEng_trqInrSetLim_CUR CoEng_trqOffs_C CoEng_trqOvrRunThres_C /end DEF_CHARACTERISTIC
 /begin IN_MEASUREMENT CoEng_tiOvRMon_mp DrvTrn_rTransDT /end IN_MEASUREMENT
/end FUNCTION
/begin FUNCTION coeng_trqcalclead "" /end FUNCTION
/begin FUNCTION coeng_trqcalclead_uic ""
 /begin OUT_MEASUREMENT CoEng_trqInrCurrFastBase_mp CoEng_trqInrDesFastBase_mp CoEng_trqInrDesFastUnLim_mp /end OUT_MEASUREMENT
/end FUNCTION
/begin FUNCTION coeng_trqcalc_msg ""
 /begin OUT_MEASUREMENT CoEng_tiRmpStrt CoEng_tiSwtOff CoEng_trqInrLiDesSlw CoEng_trqLimOffs /end OUT_MEASUREMENT
/end FUNCTION
/begin FUNCTION coeng_trqcalc_uic ""
 /begin OUT_MEASUREMENT CoEng_stRmp_mp CoEng_tiOvRMon_mp CoEng_trqBefRmp_mp CoEng_trqInrCurrPre_mp CoEng_trqInrDesSlowBase_mp CoEng_trqInrDesSlowUnLim_mp CoEng_trqInrRawPre_mp CoEng_trqInrSetLim_mp CoEng_trqInrSetUnLtd_mp CoEng_trqLimOffs_mp CoEng_trqRmp_mp CoEng_trqSetASDdc_mp /end OUT_MEASUREMENT
/end FUNCTION
/begin FUNCTION coeng_trqcalc_var "" /end FUNCTION
/begin FUNCTION coeng_trqcalc_var_uic "" /end FUNCTION
/begin FUNCTION coeng_trqlim "Momentenbegrenzung als Motormoment"
 /begin DEF_CHARACTERISTIC CoEng_dnOvrFulMin_C CoEng_dnOvrFulMax_C CoEng_stdnOvrFulLow_C CoEng_stdnOvrFulHigh_C CoEng_dtrqEngPrtRgnMonUp_C CoEng_dtrqEngPrtRgnMonDwn_C CoEng_dtrqLimUp_C CoEng_dtrqLimDwn_C CoEng_dtrqLimUp1_C CoEng_dtrqLimDwn1_C CoEng_dtrqLimUp2_C CoEng_dtrqLimDwn2_C CoEng_dtrqLimUp3_C CoEng_dtrqLimDwn3_C CoEng_dtrqLimUp4_C CoEng_dtrqLimDwn4_C CoEng_tiOvrFulDT1_C CoEng_facOvrFulDKd_C CoEng_facAdjDfl_C CoEng_facAdjMax_C CoEng_facAdjMin_C CoEng_nOvrFulMin_C CoEng_nOvrFulMax_C CoEng_stnOvrFulLow_C CoEng_stnOvrFulHigh_C CoEng_tiPFltdVolPT1_C CoEng_tiPFltResFlowPT1_C CoEng_dtrqOvrFulUp_C CoEng_dtrqOvrFulDown_C CoEng_rOvrFulMin_C CoEng_rOvrFulMax_C CoEng_strOvrFulLow_C CoEng_strOvrFulHigh_C CoEng_tiRepOvrFul_C CoEng_trqLimErr1_CUR CoEng_trqLimErr2_CUR CoEng_trqLimErr3_CUR CoEng_trqLimErr4_CUR CoEng_trqLimErr_CUR CoEng_trqLimPDiff1_CUR CoEng_trqLimPDiffNOffs_CUR CoEng_trqLimPDiff_MAP CoEng_trqOvrFulMax_C CoEng_trqOvrFulMin_C CoEng_vOvrFulMin_C CoEng_vOvrFulMax_C CoEng_stvOvrFulLow_C CoEng_stvOvrFulHigh_C /end DEF_CHARACTERISTIC
 /begin IN_MEASUREMENT CoEng_pDiffPFltPrdc_mp Eng_nAvrg PFlt_pDiff /end IN_MEASUREMENT
/end FUNCTION
/begin FUNCTION coeng_trqlim_uic ""
 /begin OUT_MEASUREMENT CoEng_dnEngnAvrg_mp CoEng_dVolFlt_mp CoEng_pDiffPFltPrdc_mp CoEng_resFlowFlt_mp CoEng_stOvrFul_mp CoEng_trqInrLimLead0_mp CoEng_trqInrLimLead1_mp CoEng_trqInrLimLead2_mp CoEng_trqLimMin1_mp CoEng_trqLimMinEEPVal_mp CoEng_trqLimMin_mp CoEng_trqLimPDiffNOffs_mp CoEng_trqLimPFlt1_mp CoEng_trqLimSwt1_mp CoEng_trqLimSwt2_mp CoEng_trqLimSwt3_mp CoEng_trqLimSwt4_mp /end OUT_MEASUREMENT
/end FUNCTION
/begin FUNCTION coeng_trqslplim "Begrenzungsmoment für Rauchbegrenzung nach Turboschubbegrenzung"
 /begin DEF_CHARACTERISTIC CoEng_nSlpLimMin_C CoEng_dtrqSlpLimUpdef_C CoEng_dtrqSlpLimDwndef_C CoEng_dtrqSlpLimUp1_C CoEng_dtrqSlpLimDwn1_C CoEng_dtrqSlpLimUp2_C CoEng_dtrqSlpLimDwn2_C CoEng_dtrqSlpLimUp3_C CoEng_dtrqSlpLimDwn3_C CoEng_dtrqSlpLimUp4_C CoEng_dtrqSlpLimDwn4_C CoEng_dtrqSlpLimUp5_C CoEng_dtrqSlpLimDwn5_C CoEng_dtrqSlpLimUp6_C CoEng_dtrqSlpLimDwn6_C CoEng_dtrqSlpLimUpREV_C CoEng_dtrqSlpLimDwnREV_C /end DEF_CHARACTERISTIC
/end FUNCTION
/begin FUNCTION coeng_trqslplim_uic "" /begin DEF_CHARACTERISTIC CoEng_trqSlpLim_Vector CoEng_trqSlpLim_Channel /end DEF_CHARACTERISTIC /end FUNCTION
/begin FUNCTION coeng_tstco "Motortestkoordinator" /begin DEF_CHARACTERISTIC CoEng_tiTstMax_C /end DEF_CHARACTERISTIC /end FUNCTION
/begin FUNCTION coeng_tstco_msg "" /begin OUT_MEASUREMENT CoEng_stTst /end OUT_MEASUREMENT /end FUNCTION
/begin FUNCTION coeng_var "" /end FUNCTION
/begin FUNCTION coeng_var_ers "" /end FUNCTION
/begin FUNCTION coeng_var_ers_msg "" /end FUNCTION
/begin FUNCTION coeng_var_ers_uic "" /end FUNCTION
/begin FUNCTION combas_msg "" /begin OUT_MEASUREMENT ComBas_stDiaReq /end OUT_MEASUREMENT /end FUNCTION
/begin FUNCTION conf_proj "" /end FUNCTION
/begin FUNCTION convcd_co "Komponententreiber zur Mapping Funktion auf Struktur"
 /begin DEF_CHARACTERISTIC ConvCD_DebPlaDef_C ConvCD_DebPlaOk_C ConvCD_tiDebPos_C ConvCD_tiDebNeg_C ConvCD_DebSigDef_C ConvCD_DebSigOk_C ConvCD_nNoGearShftDet_C ConvCD_numDioIn_C ConvCD_numStepDef_C ConvCD_numStepOK_C ConvCD_stDflVal_C ConvCD_stGripCtlAST_C ConvCD_swtInv_C ConvCD_swtSigVal_C ConvCD_tiGearShft_C ConvCD_vNoGearShftDet_C /end DEF_CHARACTERISTIC
/end FUNCTION
/begin FUNCTION convcd_co_uic "" /begin OUT_MEASUREMENT ConvCD_ctClutchDfct_mp /end OUT_MEASUREMENT /end FUNCTION
/begin FUNCTION convcd_msg ""
 /begin OUT_MEASUREMENT ConvCD_stClth ConvCD_stClthRaw ConvCD_stClutchRecord ConvCD_stDebVal ConvCD_stIntDebVal ConvCD_stLastDebVal ConvCD_stLastGear ConvCD_stOldGear ConvCD_stRawVal ConvCD_swtSig /end OUT_MEASUREMENT
/end FUNCTION
/begin FUNCTION conv_grip "Function to calculate converter amplification factor" /end FUNCTION
/begin FUNCTION conv_grip_msg "" /begin OUT_MEASUREMENT Conv_rTrans /end OUT_MEASUREMENT /end FUNCTION
/begin FUNCTION coveh_acsmng "Koordination Nebenaggregate" /begin DEF_CHARACTERISTIC CoVeh_dnLI_C /end DEF_CHARACTERISTIC /end FUNCTION
/begin FUNCTION coveh_acsmng_msg ""
 /begin OUT_MEASUREMENT CoVeh_nAcsMax CoVeh_nAcsMin CoVeh_nLimEngSpd CoVeh_pwrAcsDes CoVeh_pwrAcsLead CoVeh_trqAcs CoVeh_trqAcsDes CoVeh_trqAcsLead CoVeh_trqAcsPerm CoVeh_trqAcsTemp /end OUT_MEASUREMENT
/end FUNCTION
/begin FUNCTION coveh_acsmng_uic "" /begin OUT_MEASUREMENT CoVeh_pwrAcsTempLim_mp CoVeh_trqAcsLimCrSDes_mp /end OUT_MEASUREMENT /end FUNCTION
/begin FUNCTION coveh_drvtrnord "Auftrag für Antrieb" /begin DEF_CHARACTERISTIC CoVeh_dtrqLimDwn_C CoVeh_dtrqLimUp_C CoVeh_trqLim_CUR /end DEF_CHARACTERISTIC /begin IN_MEASUREMENT Eng_nAvrg /end IN_MEASUREMENT /end FUNCTION
/begin FUNCTION coveh_drvtrnordlead_uic "" /begin DEF_CHARACTERISTIC CoVeh_trqPrpLead_Vector CoVeh_trqPrpLead_Channel /end DEF_CHARACTERISTIC /end FUNCTION
/begin FUNCTION coveh_drvtrnord_msg ""
 /begin OUT_MEASUREMENT CoVeh_nMax CoVeh_nMin CoVeh_stOrd CoVeh_trqPrpDes CoVeh_trqPrpLead CoVeh_trqPrpLimErr /end OUT_MEASUREMENT
/end FUNCTION
/begin FUNCTION coveh_drvtrnord_uic "" /begin DEF_CHARACTERISTIC CoVeh_trqPrpDes_Vector CoVeh_trqPrpDes_Channel /end DEF_CHARACTERISTIC /end FUNCTION
/begin FUNCTION covm_demcheck "Vortriebsstabilisierungsprüfung"
 /begin DEF_CHARACTERISTIC CoVM_amMAX_C CoVM_swtPlausChkVal_C CoVM_swtPlausChkType_C CoVM_swtSlipCtlVal_C CoVM_swtSlipCtlType_C /end DEF_CHARACTERISTIC
/end FUNCTION
/begin FUNCTION covm_demcheck_msg "" /begin OUT_MEASUREMENT CoVM_stDemCheck CoVM_swtSlipCtl /end OUT_MEASUREMENT /end FUNCTION
/begin FUNCTION covm_demcheck_uic "" /begin OUT_MEASUREMENT CoVM_amAct_mp CoVM_stDemUnplaus_mp CoVM_trqInt_mp /end OUT_MEASUREMENT /end FUNCTION
/begin FUNCTION covm_demcord "Anforderungskoordination"
 /begin DEF_CHARACTERISTIC CoVM_dtrqLeadCorUp_C CoVM_dtrqLeadCorDwn_C CoVM_swtIntvPrio_C CoVM_swttrqDVCH_C CoVM_tiTrqRedMax_C /end DEF_CHARACTERISTIC
/end FUNCTION
/begin FUNCTION covm_demcordlead_uic "" /begin OUT_MEASUREMENT CoVM_trqLeadIncMax_mp /end OUT_MEASUREMENT /end FUNCTION
/begin FUNCTION covm_demcord_msg ""
 /begin OUT_MEASUREMENT CoVM_stActDem CoVM_stOrd CoVM_stTrqLeadFrz CoVM_trqDVCH CoVM_trqGearbxMax CoVM_trqGearbxMin CoVM_trqPrpDes CoVM_trqPrpLead /end OUT_MEASUREMENT
/end FUNCTION
/begin FUNCTION covm_demcord_uic "" /begin OUT_MEASUREMENT CoVM_trqDesIncMax_mp /end OUT_MEASUREMENT /end FUNCTION
/begin FUNCTION covm_stabdem "Vortriebsstabilisierung"
 /begin DEF_CHARACTERISTIC CoVM_trqDecMax_C CoVM_dtrqLimUpDec_C CoVM_dtrqLimDwnDec_C CoVM_trqDSCMax_C CoVM_trqIncMin_C CoVM_dtrqLimUpInc_C CoVM_dtrqLimDwnInc_C /end DEF_CHARACTERISTIC
/end FUNCTION
/begin FUNCTION covm_stabdem_msg "" /begin OUT_MEASUREMENT CoVM_trqDec CoVM_trqInc /end OUT_MEASUREMENT /end FUNCTION
/begin FUNCTION covm_stabdem_uic "" /begin OUT_MEASUREMENT CoVM_trqDecSetVal_mp CoVM_trqIncSetVal_mp /end OUT_MEASUREMENT /end FUNCTION
/begin FUNCTION cpbvlv_logic ""
 /begin DEF_CHARACTERISTIC CpBVlv_numGear_C CpBVlv_qClose_MAP CpBVlv_qOpn_MAP CpBVlv_stClose_C CpBVlv_stOpn_C CpBVlv_swtQDesVal_C /end DEF_CHARACTERISTIC
 /begin IN_MEASUREMENT APSCD_pVal Eng_nAvrg /end IN_MEASUREMENT
/end FUNCTION
/begin FUNCTION cpbvlv_logic_msg "" /begin OUT_MEASUREMENT CpBVlv_stLogic CpBVlv_stOpn /end OUT_MEASUREMENT /end FUNCTION
/begin FUNCTION cpbvlv_logic_uic "" /end FUNCTION
/begin FUNCTION crccd_keydet "Bedienteilerfassung Fahrgeschwindigkeitsregler"
 /begin DEF_CHARACTERISTIC CrCCD_tiDebMaxMFLDef_C CrCCD_tiDebMaxMFLOk_C CrCCD_tiDebMinMFLDef_C CrCCD_tiDebMinMFLOk_C CrCCD_tiDebNplMFLDef_C CrCCD_tiDebNplMFLOk_C CrCCD_tiDebSigMFLDef_C CrCCD_tiDebSigMFLOk_C CrCCD_stMSWModeAdjMax_C CrCCD_stMSWModeAdjMin_C CrCCD_stMSWModeDflt_C CrCCD_swtDevType_C CrCCD_swtDevVal_C CrCCD_swtMSWType_C CrCCD_swtMSWVal_C CrCCD_tiDebSetMn_C CrCCD_tiDebSetPl_C CrCCD_tiToggleMax_C /end DEF_CHARACTERISTIC
/end FUNCTION
/begin FUNCTION crccd_keydet_msg ""
 /begin OUT_MEASUREMENT CrCCD_stDev CrCCD_stKey CrCCD_stKeyOff CrCCD_swtDev CrCCD_swtMSW /end OUT_MEASUREMENT
/end FUNCTION
/begin FUNCTION crccd_keydet_uic "" /begin OUT_MEASUREMENT CrCCD_dMFLData_mp /end OUT_MEASUREMENT /end FUNCTION
/begin FUNCTION crctl_detcrctl "" /end FUNCTION
/begin FUNCTION crctl_detcrctl_msg "" /begin OUT_MEASUREMENT CrCtl_stRecFGR /end OUT_MEASUREMENT /end FUNCTION
/begin FUNCTION crctl_detcrctl_uic "" /end FUNCTION
/begin FUNCTION crctl_msg "" /begin OUT_MEASUREMENT CrCtl_stActive CrCtl_trqDes CrCtl_trqLead /end OUT_MEASUREMENT /end FUNCTION
/begin FUNCTION crctl_sendvmrk "Aufbereitung Stufentempomatinformation für Kombi" /begin DEF_CHARACTERISTIC TMSGSGTMN /end DEF_CHARACTERISTIC /end FUNCTION
/begin FUNCTION crctl_sendvmrk_msg ""
 /begin OUT_MEASUREMENT B_acmsggts B_cmsggts B_ergacgt B_mrkvff indexmrst tnomgs60ms vmrki1_w vmrki2_w vmrki3_w /end OUT_MEASUREMENT
/end FUNCTION
/begin FUNCTION crctl_sendvmrk_uic "" /end FUNCTION
/begin FUNCTION crctl_shutoff "FGR-Abschaltung"
 /begin DEF_CHARACTERISTIC CrCtl_aAccMax_C CrCtl_aDecMax_C CrCtl_nMaxAlw_C CrCtl_nMinAlw_C CrCtl_rVnDvtShutOff_C CrCtl_stShutOffCodeMsk_C CrCtl_stShutOffHDC_C CrCtl_stShutOffInfoLR_C CrCtl_stShutOffLR_C CrCtl_swtSelKombi_C CrCtl_swtShutOffOpt_C CrCtl_tiAcc_C CrCtl_tiAqpl_C CrCtl_tiClCtrDelayABS_C CrCtl_tiClCtrDelayASC_C CrCtl_tiClCtrDelayDSC_C CrCtl_tiClCtrDelayEBV_C CrCtl_tiClCtrDelayHBA_C CrCtl_tiClCtrDelayMSR_C CrCtl_tiDec_C CrCtl_tiGearDeb_C CrCtl_tiNegDvtTi_C CrCtl_vDiffAqpl_C CrCtl_vMaxShutOff_C CrCtl_vMinShutOff_C CrCtl_vNegDvtTi_C CrCtl_vNegDvt_C CrCtl_vPosDvt_C /end DEF_CHARACTERISTIC
/end FUNCTION
/begin FUNCTION crctl_shutoff_msg "" /begin OUT_MEASUREMENT CrCtl_numGear CrCtl_stShutOffCode /end OUT_MEASUREMENT /end FUNCTION
/begin FUNCTION crctl_shutoff_uic ""
 /begin OUT_MEASUREMENT CrCtl_stBrkBeforeCruise_mp CrCtl_stClCtr_mp CrCtl_stShutOffCode1_mp CrCtl_stShutOffCode2_mp CrCtl_stShutOffFrz1_mp CrCtl_stShutOffFrz2_mp CrCtl_stShutOffFrz_mp /end OUT_MEASUREMENT
/end FUNCTION
/begin FUNCTION crctl_updatedem "FGR-Anforderungen Update (Abschalten + Regler)"
 /begin DEF_CHARACTERISTIC CrCtl_aAccLim_C CrCtl_AccGear2PKp_C CrCtl_AccGear2PKpPos_C CrCtl_AccGear2PKpNeg_C CrCtl_vAccGear2PWinPos_C CrCtl_vAccGear2PWinNeg_C CrCtl_AccGear3PKp_C CrCtl_AccGear3PKpPos_C CrCtl_AccGear3PKpNeg_C CrCtl_vAccGear3PWinPos_C CrCtl_vAccGear3PWinNeg_C CrCtl_AccGear4PKp_C CrCtl_AccGear4PKpPos_C CrCtl_AccGear4PKpNeg_C CrCtl_vAccGear4PWinPos_C CrCtl_vAccGear4PWinNeg_C CrCtl_AccGear5PKp_C CrCtl_AccGear5PKpPos_C CrCtl_AccGear5PKpNeg_C CrCtl_vAccGear5PWinPos_C CrCtl_vAccGear5PWinNeg_C CrCtl_AccGear6PKp_C CrCtl_AccGear6PKpPos_C CrCtl_AccGear6PKpNeg_C CrCtl_vAccGear6PWinPos_C CrCtl_vAccGear6PWinNeg_C CrCtl_aDeclLim_C CrCtl_ctMaxTip_C CrCtl_DeclGear2PKp_C CrCtl_DeclGear2PKpPos_C CrCtl_DeclGear2PKpNeg_C CrCtl_vDeclGear2PWinPos_C CrCtl_vDeclGear2PWinNeg_C CrCtl_DeclGear3PKp_C CrCtl_DeclGear3PKpPos_C CrCtl_DeclGear3PKpNeg_C CrCtl_vDeclGear3PWinPos_C CrCtl_vDeclGear3PWinNeg_C CrCtl_DeclGear4PKp_C CrCtl_DeclGear4PKpPos_C CrCtl_DeclGear4PKpNeg_C CrCtl_vDeclGear4PWinPos_C CrCtl_vDeclGear4PWinNeg_C CrCtl_DeclGear5PKp_C CrCtl_DeclGear5PKpPos_C CrCtl_DeclGear5PKpNeg_C CrCtl_vDeclGear5PWinPos_C CrCtl_vDeclGear5PWinNeg_C CrCtl_DeclGear6PKp_C CrCtl_DeclGear6PKpPos_C CrCtl_DeclGear6PKpNeg_C CrCtl_vDeclGear6PWinPos_C CrCtl_vDeclGear6PWinNeg_C CrCtl_dtrqAccDwn_C CrCtl_dtrqDeclUp_C CrCtl_dtrqOffComf1_C CrCtl_dtrqOffComf2_C CrCtl_dtrqOffFast1_CUR CrCtl_dtrqOffFast2_CUR CrCtl_dtrqOffFast3_CUR CrCtl_dvAccFDCG3_CUR CrCtl_dvAccFDCG4_CUR CrCtl_dvAccFDCG5_CUR CrCtl_dvAccFDCG6_CUR CrCtl_dvAccG3_CUR CrCtl_dvAccG4_CUR CrCtl_dvAccG5_CUR CrCtl_dvAccG6_CUR CrCtl_dvDeclFDCG3_CUR CrCtl_dvDeclFDCG4_CUR CrCtl_dvDeclFDCG5_CUR CrCtl_dvDeclFDCG6_CUR CrCtl_dvDeclG3_CUR CrCtl_dvDeclG4_CUR CrCtl_dvDeclG5_CUR CrCtl_dvDeclG6_CUR CrCtl_dvResAbvFDCG3_CUR CrCtl_dvResAbvFDCG4_CUR CrCtl_dvResAbvFDCG5_CUR CrCtl_dvResAbvFDCG6_CUR CrCtl_dvResAbvG3_MAP CrCtl_dvResAbvG4_MAP CrCtl_dvResAbvG5_MAP CrCtl_dvResAbvG6_MAP CrCtl_dvResBlwFDCG3_CUR CrCtl_dvResBlwFDCG4_CUR CrCtl_dvResBlwFDCG5_CUR CrCtl_dvResBlwFDCG6_CUR CrCtl_dvResBlwG3_MAP CrCtl_dvResBlwG4_MAP CrCtl_dvResBlwG5_MAP CrCtl_dvResBlwG6_MAP CrCtl_facIncSlope_CUR CrCtl_facPropAcc_C CrCtl_facPropDecl_C CrCtl_facRedDecl_C CrCtl_facRedHi_C CrCtl_facRedLo_C CrCtl_facResAbvFDC_CUR CrCtl_facResAbv_CUR CrCtl_facResBlwFDC_CUR CrCtl_facResBlw_CUR CrCtl_facRmpRes_C CrCtl_HoldGear2IKi_C CrCtl_HoldGear2IKiPos_C CrCtl_HoldGear2IKiNeg_C CrCtl_vHoldGear2IWinPos_C CrCtl_vHoldGear2IWinNeg_C CrCtl_HoldGear2PKp_C CrCtl_HoldGear2PKpPos_C CrCtl_HoldGear2PKpNeg_C CrCtl_vHoldGear2PWinPos_C CrCtl_vHoldGear2PWinNeg_C CrCtl_HoldGear3IKi_C CrCtl_HoldGear3IKiPos_C CrCtl_HoldGear3IKiNeg_C CrCtl_vHoldGear3IWinPos_C CrCtl_vHoldGear3IWinNeg_C CrCtl_HoldGear3PKp_C CrCtl_HoldGear3PKpPos_C CrCtl_HoldGear3PKpNeg_C CrCtl_vHoldGear3PWinPos_C CrCtl_vHoldGear3PWinNeg_C CrCtl_HoldGear4IKi_C CrCtl_HoldGear4IKiPos_C CrCtl_HoldGear4IKiNeg_C CrCtl_vHoldGear4IWinPos_C CrCtl_vHoldGear4IWinNeg_C CrCtl_HoldGear4PKp_C CrCtl_HoldGear4PKpPos_C CrCtl_HoldGear4PKpNeg_C CrCtl_vHoldGear4PWinPos_C CrCtl_vHoldGear4PWinNeg_C CrCtl_HoldGear5IKi_C CrCtl_HoldGear5IKiPos_C CrCtl_HoldGear5IKiNeg_C CrCtl_vHoldGear5IWinPos_C CrCtl_vHoldGear5IWinNeg_C CrCtl_HoldGear5PKp_C CrCtl_HoldGear5PKpPos_C CrCtl_HoldGear5PKpNeg_C CrCtl_vHoldGear5PWinPos_C CrCtl_vHoldGear5PWinNeg_C CrCtl_HoldGear6IKi_C CrCtl_HoldGear6IKiPos_C CrCtl_HoldGear6IKiNeg_C CrCtl_vHoldGear6IWinPos_C CrCtl_vHoldGear6IWinNeg_C CrCtl_HoldGear6PKp_C CrCtl_HoldGear6PKpPos_C CrCtl_HoldGear6PKpNeg_C CrCtl_vHoldGear6PWinPos_C CrCtl_vHoldGear6PWinNeg_C CrCtl_tiResAbvGear2DT1_C CrCtl_ResAbvGear2DT1Kd_C CrCtl_tiResAbvGear3DT1_C CrCtl_ResAbvGear3DT1Kd_C CrCtl_tiResAbvGear4DT1_C CrCtl_ResAbvGear4DT1Kd_C CrCtl_tiResAbvGear5DT1_C CrCtl_ResAbvGear5DT1Kd_C CrCtl_tiResAbvGear6DT1_C CrCtl_ResAbvGear6DT1Kd_C CrCtl_ResBlwGear2IKi_C CrCtl_ResBlwGear2IKiPos_C CrCtl_ResBlwGear2IKiNeg_C CrCtl_vResBlwGear2IWinPos_C CrCtl_vResBlwGear2IWinNeg_C CrCtl_ResBlwGear2PKp_C CrCtl_ResBlwGear2PKpPos_C CrCtl_ResBlwGear2PKpNeg_C CrCtl_vResBlwGear2PWinPos_C CrCtl_vResBlwGear2PWinNeg_C CrCtl_ResBlwGear3IKi_C CrCtl_ResBlwGear3IKiPos_C CrCtl_ResBlwGear3IKiNeg_C CrCtl_vResBlwGear3IWinPos_C CrCtl_vResBlwGear3IWinNeg_C CrCtl_ResBlwGear3PKp_C CrCtl_ResBlwGear3PKpPos_C CrCtl_ResBlwGear3PKpNeg_C CrCtl_vResBlwGear3PWinPos_C CrCtl_vResBlwGear3PWinNeg_C CrCtl_ResBlwGear4IKi_C CrCtl_ResBlwGear4IKiPos_C CrCtl_ResBlwGear4IKiNeg_C CrCtl_vResBlwGear4IWinPos_C CrCtl_vResBlwGear4IWinNeg_C CrCtl_ResBlwGear4PKp_C CrCtl_ResBlwGear4PKpPos_C CrCtl_ResBlwGear4PKpNeg_C CrCtl_vResBlwGear4PWinPos_C CrCtl_vResBlwGear4PWinNeg_C CrCtl_ResBlwGear5IKi_C CrCtl_ResBlwGear5IKiPos_C CrCtl_ResBlwGear5IKiNeg_C CrCtl_vResBlwGear5IWinPos_C CrCtl_vResBlwGear5IWinNeg_C CrCtl_ResBlwGear5PKp_C CrCtl_ResBlwGear5PKpPos_C CrCtl_ResBlwGear5PKpNeg_C CrCtl_vResBlwGear5PWinPos_C CrCtl_vResBlwGear5PWinNeg_C CrCtl_ResBlwGear6IKi_C CrCtl_ResBlwGear6IKiPos_C CrCtl_ResBlwGear6IKiNeg_C CrCtl_vResBlwGear6IWinPos_C CrCtl_vResBlwGear6IWinNeg_C CrCtl_ResBlwGear6PKp_C CrCtl_ResBlwGear6PKpPos_C CrCtl_ResBlwGear6PKpNeg_C CrCtl_vResBlwGear6PWinPos_C CrCtl_vResBlwGear6PWinNeg_C CrCtl_ResRmpGear2PKp_C CrCtl_ResRmpGear2PKpPos_C CrCtl_ResRmpGear2PKpNeg_C CrCtl_vResRmpGear2PWinPos_C CrCtl_vResRmpGear2PWinNeg_C CrCtl_ResRmpGear3PKp_C CrCtl_ResRmpGear3PKpPos_C CrCtl_ResRmpGear3PKpNeg_C CrCtl_vResRmpGear3PWinPos_C CrCtl_vResRmpGear3PWinNeg_C CrCtl_ResRmpGear4PKp_C CrCtl_ResRmpGear4PKpPos_C CrCtl_ResRmpGear4PKpNeg_C CrCtl_vResRmpGear4PWinPos_C CrCtl_vResRmpGear4PWinNeg_C CrCtl_ResRmpGear5PKp_C CrCtl_ResRmpGear5PKpPos_C CrCtl_ResRmpGear5PKpNeg_C CrCtl_vResRmpGear5PWinPos_C CrCtl_vResRmpGear5PWinNeg_C CrCtl_ResRmpGear6PKp_C CrCtl_ResRmpGear6PKpPos_C CrCtl_ResRmpGear6PKpNeg_C CrCtl_vResRmpGear6PWinPos_C CrCtl_vResRmpGear6PWinNeg_C CrCtl_swtResOff_C CrCtl_tiOff_C CrCtl_tiTipUpDn_C CrCtl_trqDesThres_C CrCtl_trqMaxOfs_C CrCtl_trqOffComf_C CrCtl_trqOffFast12_C CrCtl_trqOffFast23_C CrCtl_vAccSet_C CrCtl_vAlwDvtThres_C CrCtl_vDeclSet_C CrCtl_vDiffAccMax_C CrCtl_vDiffAcc_C CrCtl_vDiffDeclMax_C CrCtl_vDiffDecl_C CrCtl_vDiffResAbv_C CrCtl_vDiffResBlw_C CrCtl_vDvtNegTipDwn_C CrCtl_vDvtNegTipUp_C CrCtl_vDvtPosTipDwn_C CrCtl_vOfsDecl_C CrCtl_vOfsResBlw_C CrCtl_vOfsRes_C CrCtl_vRlsOfsI_C CrCtl_vTipStep_C /end DEF_CHARACTERISTIC
 /begin IN_MEASUREMENT CrCtl_vBeg CrCtl_vDiffRed_mp CrCtl_vDiff_mp Gearbx_stGear Rail_tiThresMonEna /end IN_MEASUREMENT
/end FUNCTION
/begin FUNCTION crctl_updatedem_msg ""
 /begin OUT_MEASUREMENT CrCtl_rVnBeg CrCtl_st CrCtl_stCAN CrCtl_stLampOut CrCtl_vBeg CrCtl_vDes CrCtl_vRmp /end OUT_MEASUREMENT
/end FUNCTION
/begin FUNCTION crctl_updatedem_uic ""
 /begin DEF_CHARACTERISTIC CrCtl_trqDes_Vector CrCtl_trqDes_Channel CrCtl_trqLead_Vector CrCtl_trqLead_Channel /end DEF_CHARACTERISTIC
 /begin OUT_MEASUREMENT CrCtl_dvAcc_mp CrCtl_dvDecl_mp CrCtl_dvResAbv_mp CrCtl_dvResBlw_mp CrCtl_trqDT1_mp CrCtl_trqI_mp CrCtl_trqMax_mp CrCtl_trqP_mp CrCtl_vDiffRed_mp CrCtl_vDiff_mp /end OUT_MEASUREMENT
/end FUNCTION
/begin COMPU_METHOD Acc "Fahrzeugbeschleunigung" RAT_FUNC "%6.5" "m/s^2" COEFFS 0 1000 0 0 0 1 /end COMPU_METHOD
/begin COMPU_METHOD B_TRUE "Umrechnung   ----> FALSE;    TRUE = TRUE" TAB_VERB "%6.3" "-" COMPU_TAB_REF B_TRUE /end COMPU_METHOD
/begin COMPU_VTAB B_TRUE "Umrechnung   ----> FALSE;    TRUE = TRUE" TAB_VERB 2 0 "FALSE" 1 "TRUE" /end COMPU_VTAB
/begin COMPU_METHOD CubMtrPerHr "Volumsstrom in m^3/h" RAT_FUNC "%6.3" "m^3/h" COEFFS 0 10 0 0 0 1 /end COMPU_METHOD
/begin COMPU_METHOD dez "K3 Umwandlungen" RAT_FUNC "%6.2" "-" COEFFS 0 1 0 0 0 1 /end COMPU_METHOD
/begin COMPU_METHOD dFlConsum "Ableitung des Kraftstoffverbrauchs" RAT_FUNC "%6.4" "l/h/s" COEFFS 0 100 0 0 0 1 /end COMPU_METHOD
/begin COMPU_METHOD Dia "Durchmesser des Rades" RAT_FUNC "%7.6" "m" COEFFS 0 10000 0 0 0 1 /end COMPU_METHOD
/begin COMPU_METHOD dn_dZ20 "Motorbeschleunigung pro Zeit (dn/dt) (im 20 ms Raster)" RAT_FUNC "%6.1" "rmp/s" COEFFS 0 0.1 0 0 0 1 /end COMPU_METHOD
/begin COMPU_METHOD dTrqPrp_20ms "Anstieg Vortriebsmoment im 20 ms Raster" RAT_FUNC "%6.1" "Nm/s" COEFFS 0 0.1 0 0 0 1 /end COMPU_METHOD
/begin COMPU_METHOD dVel_20ms "Anstieg Fahrgeschwindigkeit im 20 ms Raster" RAT_FUNC "%6.3" "(km/h)/s" COEFFS 0 2 0 0 0 1 /end COMPU_METHOD
/begin COMPU_METHOD EngN "Motordrehzahl" RAT_FUNC "%6.2" "rpm" COEFFS 0 1 0 0 0 1 /end COMPU_METHOD
/begin COMPU_METHOD Fact "Faktor mit Auflösung 1 / 8192, hauptsächlich für einen Faktorenbereich 0...1 verwendet" RAT_FUNC "%6.5" "-" COEFFS 0 8192 0 0 0 1 /end COMPU_METHOD
/begin COMPU_METHOD FlConsum_l_h "Kraftstoffverbrauch" RAT_FUNC "%6.4" "l/h" COEFFS 0 100 0 0 0 1 /end COMPU_METHOD
/begin COMPU_METHOD FlConsum_ul "Verbrauchsintegral (in Mikroliter)" RAT_FUNC "%6.2" "ul" COEFFS 0 1 0 0 0 1 /end COMPU_METHOD
/begin COMPU_METHOD FlConsum_ul_20ms "Verbrauchsintegral (in Mikroliter pro 20ms)" RAT_FUNC "%6.2" "ul/20ms" COEFFS 0 1 0 0 0 1 /end COMPU_METHOD
/begin COMPU_METHOD InjMass "Einspritzmenge" RAT_FUNC "%6.4" "mg/hub" COEFFS 0 100 0 0 0 1 /end COMPU_METHOD
/begin COMPU_METHOD InjMassCyc "Einspritzmenge pro Zyklus (mg/Zyklus)" RAT_FUNC "%6.4" "mg/cyc" COEFFS 0 100 0 0 0 1 /end COMPU_METHOD
/begin COMPU_METHOD InjQnt "Einspritzvolumen/Hub" RAT_FUNC "%6.3" "mm^3/hub" COEFFS 0 10 0 0 0 1 /end COMPU_METHOD
/begin COMPU_METHOD Kd_rpm2dndt "differential gain(engine speed to rate of change of engine speed)" RAT_FUNC "%8.7" "rmp/sec/rpm" COEFFS 0 131072 0 0 0 1 /end COMPU_METHOD
/begin COMPU_METHOD Kd_Vel2TrqPrp "Differentialverstärkung (Fahrgeschwindigkeit zu Vortriebsmoment)" RAT_FUNC "%6.5" "Nm/(km/h)" COEFFS 0 3276.8 0 0 0 1 /end COMPU_METHOD
/begin COMPU_METHOD Ki_Vel2TrqPrp "Integralverstärkung (Fahrgeschwindigkeit zu Vortriebsmoment)" RAT_FUNC "%6.4" "Nm/(km/h)/s" COEFFS 0 214.7483648 0 0 0 1 /end COMPU_METHOD
/begin COMPU_METHOD Kp_Vel2TrqPrp "Proportionalverstärkung (Fahrgeschwindigkeit zu Vortriebsmoment)" RAT_FUNC "%6.5" "Nm/(km/h)" COEFFS 0 3276.8 0 0 0 1 /end COMPU_METHOD
/begin COMPU_METHOD Length "Länge in Meter" RAT_FUNC "%6.2" "m" COEFFS 0 1 0 0 0 1 /end COMPU_METHOD
/begin COMPU_METHOD NumPinDioIn "Verbale Umrechnung für Digitaleingang Signale" TAB_VERB "%6.3" "-" COMPU_TAB_REF NumPinDioIn /end COMPU_METHOD
/begin COMPU_VTAB NumPinDioIn "Verbale Umrechnung für Digitaleingang Signale" TAB_VERB 15 0 "Terminal_15_207" 1 "Main_Brake_Switch_236" 2 "Redundant_Brake_Switch_223" 3 "Clutch_Switch" 4 "Terminal_50_224" 5 "ECU_selection_Switch_251" 6 "FlFlt_Switch_211" 7 "Coolant-heater_212" 8 "Redundant_Terminal_15_209(118)" 9 "AC-compressor_overboost_213" 10 "Additive_tank_level_switch_235" 11 "Terminal_61_113" 12 "Lambda_Regeneration" 13 "Oil_Level_sensor_138" 14 "DIO_IN_DUMMY_NOT_USED" /end COMPU_VTAB
/begin COMPU_METHOD OneToOne "eins zu eins (physikalischer Wert ist gleich dem internen Wert)" RAT_FUNC "%6.2" "-" COEFFS 0 1 0 0 0 1 /end COMPU_METHOD
/begin COMPU_METHOD Prc "Prozent, gleiche interne Auflösung wie Fact, aber Darstellung in Prozent (0...100%)" RAT_FUNC "%6.4" "%" COEFFS 0 81.92 0 0 0 1 /end COMPU_METHOD
/begin COMPU_METHOD Prc_1000 "Prozentumrechnung mit größerer Quantisierung, dafür größerer Wertebereich" RAT_FUNC "%6.3" "%" COEFFS 0 8.192 0 0 0 1 /end COMPU_METHOD
/begin COMPU_METHOD Pres_hPa "Druck (angezeigt in [hPa])" RAT_FUNC "%6.2" "hPa" COEFFS 0 1 0 0 0 1 /end COMPU_METHOD
/begin COMPU_METHOD Pres_Rail "Raildruck in hPa" RAT_FUNC "%4.3" "bar" COEFFS 0 10.000000 0 0 0 1 /end COMPU_METHOD
/begin COMPU_METHOD Pwr "Leistung" RAT_FUNC "%6.2" "W" COEFFS 0 0.10610329539459 0 0 0 1 /end COMPU_METHOD
/begin COMPU_METHOD Res_hPaHrPerCM "Strömungswiderstand [hPa h/m3]" RAT_FUNC "%6.5" "hPa/(m^3/h)" COEFFS 0 1000 0 0 0 1 /end COMPU_METHOD
/begin COMPU_METHOD RhoFuel "Kraftstoffdichte" RAT_FUNC "%6.3" "kg/m^3" COEFFS 0 10 0 0 0 1 /end COMPU_METHOD
/begin COMPU_METHOD RmpInjMassCyc "DT1 of Injection mass" RAT_FUNC "%6.5" "(mg/cyc)/s" COEFFS 0 6553.6 0 0 0 1 /end COMPU_METHOD
/begin COMPU_METHOD RmpTrq "Rampengradient für Motormoment" RAT_FUNC "%6.4" "Nm/s" COEFFS 0 655.36 0 0 0 1 /end COMPU_METHOD
/begin COMPU_METHOD RmpTrqPrp "Rampenanstieg für Vortriebsmoment [Nm/s]" RAT_FUNC "%6.4" "Nm/s" COEFFS 0 327.68 0 0 0 1 /end COMPU_METHOD
/begin COMPU_METHOD t20msxs_ub_b5p1 "K3 Umwandlungen" RAT_FUNC "%6.4" "s" COEFFS 0 1 0 0 0 0.02 /end COMPU_METHOD
/begin COMPU_METHOD Temp_Cels "Temperatur dargestellt in °C (gleiche interne Darstellung wie Temp_Kelv)" RAT_FUNC "%6.1" "deg C" COEFFS 0 10 2731.4 0 0 1 /end COMPU_METHOD
/begin COMPU_METHOD TimeDeb "Entprellzeit in Millisekunden für Libraryfunktion Debounce" RAT_FUNC "%6.1" "ms" COEFFS 0 0.1 0 0 0 1 /end COMPU_METHOD
/begin COMPU_METHOD TimeDelay_s "Zeitkonstante T1 (in s) für PT1, DT1, etc." RAT_FUNC "%9.3" "s" COEFFS 0 0 1 0 0.00023283064365387 0 /end COMPU_METHOD
/begin COMPU_METHOD TimeEngOn "Motorbetriebszeit in Sekunden" RAT_FUNC "%6.2" "s" COEFFS 0 1 0 0 0 1 /end COMPU_METHOD
/begin COMPU_METHOD TimeRed "Zeit in Sekunden mit reduzierter Auflösung für Ein/Ausgänge von KL/KF (sint16)" RAT_FUNC "%6.3" "s" COEFFS 0 6.25 0 0 0 1 /end COMPU_METHOD
/begin COMPU_METHOD Time_ms "Zeit in ms für Fehlerentprellung (DSM) und SW-Timer" RAT_FUNC "%6.1" "ms" COEFFS 0 0.1 0 0 0 1 /end COMPU_METHOD
/begin COMPU_METHOD Time_s "Zeit in s für Fehlerentprellung (DSM) und SW-Timer" RAT_FUNC "%6.4" "s" COEFFS 0 100 0 0 0 1 /end COMPU_METHOD
/begin COMPU_METHOD TransR "Übersetzungsverhältnis (Getriebe etc.)" RAT_FUNC "%6.4" "-" COEFFS 0 100 0 0 0 1 /end COMPU_METHOD
/begin COMPU_METHOD Trq "Motormoment" RAT_FUNC "%6.3" "Nm" COEFFS 0 10 0 0 0 1 /end COMPU_METHOD
/begin COMPU_METHOD TrqPrp "Vortriebsmoment" RAT_FUNC "%6.3" "Nm" COEFFS 0 5 0 0 0 1 /end COMPU_METHOD
/begin COMPU_METHOD TrqPrpDT "zeitlich aufintegriertes Vortriebsmoment" RAT_FUNC "%6.2" "Nm*s" COEFFS 0 0.2 0 0 0 1 /end COMPU_METHOD
/begin COMPU_METHOD Vel "Fahrzeuggeschwindigkeit, gleiche interne Auflösung wie Vel_SI" RAT_FUNC "%6.4" "km/h" COEFFS 0 100 0 0 0 1 /end COMPU_METHOD
/begin COMPU_METHOD Vel2TrqPrp "Umwandlung von Fahrgeschwindigkeit zu Vortriebsmoment" RAT_FUNC "%6.4" "Nm/(km/h)" COEFFS 0 409.6 0 0 0 1 /end COMPU_METHOD
/begin COMPU_METHOD VelToN "Verhältnis Fahrzeuggeschwindigkeit zu Motordrehzahl v/n" RAT_FUNC "%8.7" "(km/h)/rpm" COEFFS 0 100000 0 0 0 1 /end COMPU_METHOD
/begin COMPU_METHOD Volt_Batt "Batteriespannung" RAT_FUNC "%6.1" "mV" COEFFS 0 0.05115 0 0 0 1 /end COMPU_METHOD
/begin RECORD_LAYOUT Kf_Xs16_Ys16_Ws16 NO_AXIS_PTS_X 1 SWORD NO_AXIS_PTS_Y 2 SWORD AXIS_PTS_X 3 SWORD INDEX_INCR DIRECT AXIS_PTS_Y 4 SWORD INDEX_INCR DIRECT FNC_VALUES 5 SWORD COLUMN_DIR DIRECT /end RECORD_LAYOUT
/begin RECORD_LAYOUT Kl_Xs16_Ws16 NO_AXIS_PTS_X 1 SWORD AXIS_PTS_X 2 SWORD INDEX_INCR DIRECT FNC_VALUES 3 SWORD COLUMN_DIR DIRECT /end RECORD_LAYOUT
/begin RECORD_LAYOUT KwWU8 FNC_VALUES 1 UBYTE COLUMN_DIR DIRECT /end RECORD_LAYOUT
/begin RECORD_LAYOUT Kw_Ws16 FNC_VALUES 1 SWORD COLUMN_DIR DIRECT /end RECORD_LAYOUT
/begin RECORD_LAYOUT Kw_Ws32 FNC_VALUES 1 SLONG COLUMN_DIR DIRECT /end RECORD_LAYOUT
/begin RECORD_LAYOUT Kw_Ws8 FNC_VALUES 1 SBYTE COLUMN_DIR DIRECT /end RECORD_LAYOUT
/begin RECORD_LAYOUT Kw_Wu16 FNC_VALUES 1 UWORD COLUMN_DIR DIRECT /end RECORD_LAYOUT
/begin RECORD_LAYOUT Kw_Wu32 FNC_VALUES 1 ULONG COLUMN_DIR DIRECT /end RECORD_LAYOUT
/begin RECORD_LAYOUT Kw_Wu8 FNC_VALUES 1 UBYTE COLUMN_DIR DIRECT /end RECORD_LAYOUT
/end MODULE
/end PROJECT
