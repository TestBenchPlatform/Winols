ASAP2_VERSION 1 3
/begin PROJECT P389 "BMW DDE6.0 4-Zylinder V53.4 01.04.2004 CAN12H"
/begin HEADER "" VERSION "V53.4_4Z_CAN12H" PROJECT_NO P389 /end HEADER
/begin MODULE DIM ""
/begin MOD_COMMON "" BYTE_ORDER MSB_FIRST ALIGNMENT_BYTE 1 ALIGNMENT_WORD 2 ALIGNMENT_LONG 4 ALIGNMENT_FLOAT32_IEEE 4 /end MOD_COMMON
/begin CHARACTERISTIC InjCrv_dtiMI1RgnRmpUp_C "positive Rampensteigung bei Umschaltung auf Regenerationswert MI1" VALUE 0xDA8F4 Kw_Wu32 65535999.9847 Rmp 0.00 65535999.9847 FORMAT "%13.4" /end CHARACTERISTIC
/begin CHARACTERISTIC InjCrv_dtiMI1RgnRmpDwn_C "negative Rampensteigung bei Umschaltung auf Regenerationswert MI1" VALUE 0xDA8F8 Kw_Wu32 65535999.9847 Rmp 0.00 65535999.9847 FORMAT "%13.4" /end CHARACTERISTIC
/begin CHARACTERISTIC InjCrv_dtiPiI1RgnRmpUp_C "positive Rampensteigung bei Umschaltung auf Regenerationswert PiI1" VALUE 0xDFB54 Kw_Wu32 65535999.9847 Rmp 0.00 65535999.9847 FORMAT "%13.4" /end CHARACTERISTIC
/begin CHARACTERISTIC InjCrv_dtiPiI1RgnRmpDwn_C "negative Rampensteigung bei Umschaltung auf Regenerationswert PiI1" VALUE 0xDFB58 Kw_Wu32 65535999.9847 Rmp 0.00 65535999.9847 FORMAT "%13.4" /end CHARACTERISTIC
/begin CHARACTERISTIC InjCrv_dtiPiI2RgnRmpUp_C "positive Rampensteigung bei Umschaltung auf Regenerationswert PiI2" VALUE 0xDCD28 Kw_Wu32 65535999.9847 Rmp 0.00 65535999.9847 FORMAT "%13.4" /end CHARACTERISTIC
/begin CHARACTERISTIC InjCrv_dtiPiI2RgnRmpDwn_C "negative Rampensteigung bei Umschaltung auf Regenerationswert PiI2" VALUE 0xDCD2C Kw_Wu32 65535999.9847 Rmp 0.00 65535999.9847 FORMAT "%13.4" /end CHARACTERISTIC
/begin CHARACTERISTIC InjCrv_dtiPoI1RgnRmpUp_C "positive Rampensteigung bei Umschaltung auf Regenerationswerte PoI1" VALUE 0xE01E0 Kw_Wu32 65535999.9847 Rmp 0.00 65535999.9847 FORMAT "%13.4" /end CHARACTERISTIC
/begin CHARACTERISTIC InjCrv_dtiPoI1RgnRmpDwn_C "negative Rampensteigung bei Umschaltung auf Regenerationswerte PoI1" VALUE 0xE01E4 Kw_Wu32 65535999.9847 Rmp 0.00 65535999.9847 FORMAT "%13.4" /end CHARACTERISTIC
/begin CHARACTERISTIC InjCrv_dtiPoI1RgnTypeRmpUp_C "positive gradient for activation of regeneration ramp" VALUE 0xE01E8 Kw_Wu32 65535999.9847 Rmp 0.00 65535999.9847 FORMAT "%13.4" /end CHARACTERISTIC
/begin CHARACTERISTIC InjCrv_dtiPoI1RgnTypeRmpDwn_C "negative gradient for activation of regeneration ramp" VALUE 0xE01EC Kw_Wu32 65535999.9847 Rmp 0.00 65535999.9847 FORMAT "%13.4" /end CHARACTERISTIC
/begin CHARACTERISTIC InjCrv_facAPPiI1DynCor_CUR "Kennlinie für atmosphärendruckabhängigen Gewichtungsfaktor der Voreinspritzung Pil1" CURVE 0xDD0EC Kl_Xs16_Ws16 2.000000 Fact 0.00 2.000000 FORMAT "%8.6" EXTENDED_LIMITS -4.000000 3.999878
 /begin AXIS_DESCR STD_AXIS APSCD_pVal Pres_hPa 6 0.00 3500.000 FORMAT "%8.3" EXTENDED_LIMITS -32768.00 32767.00 DEPOSIT ABSOLUTE /end AXIS_DESCR
/end CHARACTERISTIC
/begin CHARACTERISTIC InjCrv_facAPPiI1DynQCor_CUR "atmosphärendruckabhängiger Gewichtungsfaktor" CURVE 0xDD106 Kl_Xs16_Ws16 2.000000 Fact 0.00 2.000000 FORMAT "%8.6" EXTENDED_LIMITS -4.000000 3.999878
 /begin AXIS_DESCR STD_AXIS APSCD_pVal Pres_hPa 6 0.00 3500.000 FORMAT "%8.3" EXTENDED_LIMITS -32768.00 32767.00 DEPOSIT ABSOLUTE /end AXIS_DESCR
/end CHARACTERISTIC
/begin CHARACTERISTIC InjCrv_facDQPiI1DynCor_CUR "Gewichtungskennlinie, abhängig vom Einspritzmengengradianten" CURVE 0xDCE50 Kl_Xs16_Ws16 4.000000 Fact -2.000000 2.000000 FORMAT "%8.6" EXTENDED_LIMITS -4.000000 3.999878
 /begin AXIS_DESCR STD_AXIS InjCrv_dqSetUnBalFltLim InjMassPerSec_20ms 6 -16384.00 16383.50 FORMAT "%8.2" DEPOSIT ABSOLUTE /end AXIS_DESCR
/end CHARACTERISTIC
/begin CHARACTERISTIC InjCrv_facDQPiI1DynQCor_CUR "Kennfeld für drehzahlabhängige Mengenkorrektur der Voreinspritzung PiI1" CURVE 0xDCE6A Kl_Xs16_Ws16 4.000000 Fact -2.000000 2.000000 FORMAT "%8.6" EXTENDED_LIMITS -4.000000 3.999878
 /begin AXIS_DESCR STD_AXIS InjCrv_dqSetUnBalFltLim InjMassPerSec_20ms 6 -16384.00 16383.50 FORMAT "%8.2" DEPOSIT ABSOLUTE /end AXIS_DESCR
/end CHARACTERISTIC
/begin CHARACTERISTIC InjCrv_facETPiI1DynCor_CUR "Kennlinie für motortemperaturabhängigen Gewichtungsfaktor der Voreinspritzung Pil1" CURVE 0xDD120 Kl_Xs16_Ws16 2.000000 Fact 0.00 2.000000 FORMAT "%8.6" EXTENDED_LIMITS -4.000000 3.999878
 /begin AXIS_DESCR STD_AXIS InjCrv_tEng Temp_Cels 6 -50.14000 199.8600 FORMAT "%8.4" EXTENDED_LIMITS -3549.940 3003.560 DEPOSIT ABSOLUTE /end AXIS_DESCR
/end CHARACTERISTIC
/begin CHARACTERISTIC InjCrv_facETPiI1DynQCor_CUR "Kennlinie für motortemperaturabhängigen Gewichtungsfaktor" CURVE 0xDD13A Kl_Xs16_Ws16 2.000000 Fact 0.00 2.000000 FORMAT "%8.6" EXTENDED_LIMITS -4.000000 3.999878
 /begin AXIS_DESCR STD_AXIS InjCrv_tEng Temp_Cels 6 -50.14000 199.8600 FORMAT "%8.4" EXTENDED_LIMITS -3549.940 3003.560 DEPOSIT ABSOLUTE /end AXIS_DESCR
/end CHARACTERISTIC
/begin CHARACTERISTIC InjCrv_facIAPiI1DynCor_CUR "Kennlinie für ansauglufttemperaturabhängigen Gewichtungsfaktor der Voreinspritzung PiI1" CURVE 0xDD154 Kl_Xs16_Ws16 2.000000 Fact 0.00 2.000000 FORMAT "%8.6" EXTENDED_LIMITS -4.000000 3.999878
 /begin AXIS_DESCR STD_AXIS IATSCD_tAir Temp_Cels 6 -50.14000 199.8600 FORMAT "%8.4" EXTENDED_LIMITS -3549.940 3003.560 DEPOSIT ABSOLUTE /end AXIS_DESCR
/end CHARACTERISTIC
/begin CHARACTERISTIC InjCrv_facMIETSPhiCorRgn_CUR "motortemperaturabhängige Ansteuerbeginnkorrekturkennlinie für MI1 im Regenerationsbetrieb" CURVE 0xDA526 Kl_Xs16_Ws16 1.000000 Fact 0.00 1.000000 FORMAT "%8.6" EXTENDED_LIMITS -4.000000 3.999878
 /begin AXIS_DESCR STD_AXIS CTSCD_tClnt Temp_Cels 8 -50.14000 199.8600 FORMAT "%8.4" EXTENDED_LIMITS -3549.940 3003.560 DEPOSIT ABSOLUTE /end AXIS_DESCR
/end CHARACTERISTIC
/begin CHARACTERISTIC InjCrv_facPhPoI2RgnAPCor_CUR "atmosphere pressure part of PoI2 regeneration setpoint correction" CURVE 0xE05AA Kl_Xs16_Ws16 2.000000 Fact 0.00 2.000000 FORMAT "%8.6" EXTENDED_LIMITS -4.000000 3.999878
 /begin AXIS_DESCR STD_AXIS APSCD_pLinVal Pres_hPa 1 0.00 3500.000 FORMAT "%8.3" EXTENDED_LIMITS -32768.00 32767.00 DEPOSIT ABSOLUTE /end AXIS_DESCR
/end CHARACTERISTIC
/begin CHARACTERISTIC InjCrv_facPhPoI2RgnETCor_CUR "engine temperature part of PoI2 regeneration setpoint correction" CURVE 0xE05B0 Kl_Xs16_Ws16 2.000000 Fact 0.00 2.000000 FORMAT "%8.6" EXTENDED_LIMITS -4.000000 3.999878
 /begin AXIS_DESCR STD_AXIS InjCrv_tEng Temp_Cels 1 -50.14000 199.8600 FORMAT "%8.4" EXTENDED_LIMITS -3549.940 3003.560 DEPOSIT ABSOLUTE /end AXIS_DESCR
/end CHARACTERISTIC
/begin CHARACTERISTIC InjCrv_facPiI1APSQCor2Strt_CUR "weighting factor of atmospheric pressure for quantity correction of PiI1 when PiI2 or PiI3 is active" CURVE 0xDEA98 Kl_Xs16_Ws16 1.000000 Fact 0.00 1.000000 FORMAT "%8.6" EXTENDED_LIMITS -4.000000 3.999878
 /begin AXIS_DESCR STD_AXIS APSCD_pVal Pres_hPa 8 0.00 3500.000 FORMAT "%8.3" EXTENDED_LIMITS -32768.00 32767.00 DEPOSIT ABSOLUTE /end AXIS_DESCR
/end CHARACTERISTIC
/begin CHARACTERISTIC InjCrv_facPiI1APSQCor2_CUR "atmosphärendruckabhängige Mengenkorrekturkennlinie für Voreinspritzung 1 wenn PiI2 oder PiI3 aktiv ist" CURVE 0xDEABA Gkl_Ws16 1.000000 Fact 0.00 1.000000 FORMAT "%8.6" EXTENDED_LIMITS -4.000000 3.999878
 /begin AXIS_DESCR COM_AXIS APSCD_pVal Pres_hPa 8 0.00 3500.000 FORMAT "%8.3" EXTENDED_LIMITS -32768.00 32767.00 AXIS_PTS_REF InjCrv_facPiI1APSQCor_AXIS /end AXIS_DESCR
/end CHARACTERISTIC
/begin CHARACTERISTIC InjCrv_facPiI1APSQCorStrt_CUR "weighting factor of atmospheric pressure for pilot injections quantity correction" CURVE 0xDEACA Kl_Xs16_Ws16 1.000000 Fact 0.00 1.000000 FORMAT "%8.6" EXTENDED_LIMITS -4.000000 3.999878
 /begin AXIS_DESCR STD_AXIS APSCD_pVal Pres_hPa 8 0.00 3500.000 FORMAT "%8.3" EXTENDED_LIMITS -32768.00 32767.00 DEPOSIT ABSOLUTE /end AXIS_DESCR
/end CHARACTERISTIC
/begin AXIS_PTS InjCrv_facPiI1APSQCor_AXIS "gemeinsame Stützstellen für atmosphärendruckabhängige Mengenkorrekturkennlinien für PiI1" 0xDEAEC APSCD_pVal GSst_Xs16 3500.000 Pres_hPa 8 0.00 3500.000 FORMAT "%8.3" EXTENDED_LIMITS -32768.00 32767.00 DEPOSIT ABSOLUTE /end AXIS_PTS
/begin CHARACTERISTIC InjCrv_facPiI1APSQCor_CUR "atmosphärendruckabhängige Mengenkorrekturkennlinie für Voreinspritzung 1" CURVE 0xDEAFE Gkl_Ws16 1.000000 Fact 0.00 1.000000 FORMAT "%8.6" EXTENDED_LIMITS -4.000000 3.999878
 /begin AXIS_DESCR COM_AXIS APSCD_pVal Pres_hPa 8 0.00 3500.000 FORMAT "%8.3" EXTENDED_LIMITS -32768.00 32767.00 AXIS_PTS_REF InjCrv_facPiI1APSQCor_AXIS /end AXIS_DESCR
/end CHARACTERISTIC
/begin CHARACTERISTIC InjCrv_facPiI1ATSQCor2Strt_CUR "weighting factor of intake air temperature for quantity correction of PiI1 when PiI2 or PiI3 is active" CURVE 0xDEB0E Kl_Xs16_Ws16 1.000000 Fact 0.00 1.000000 FORMAT "%8.6" EXTENDED_LIMITS -4.000000 3.999878
 /begin AXIS_DESCR STD_AXIS IATSCD_tAir Temp_Cels 8 -50.14000 199.8600 FORMAT "%8.4" EXTENDED_LIMITS -3549.940 3003.560 DEPOSIT ABSOLUTE /end AXIS_DESCR
/end CHARACTERISTIC
/begin CHARACTERISTIC InjCrv_facPiI1ATSQCor2_CUR "ansauglufttemperaturabhängige Mengenkorrekturkennlinie für Voreinspritzung 1 wenn PiI2 oder PiI3 aktiv ist" CURVE 0xDEB30 Gkl_Ws16 1.000000 Fact 0.00 1.000000 FORMAT "%8.6" EXTENDED_LIMITS -4.000000 3.999878
 /begin AXIS_DESCR COM_AXIS IATSCD_tAir Temp_Cels 8 -50.14000 199.8600 FORMAT "%8.4" EXTENDED_LIMITS -3549.940 3003.560 AXIS_PTS_REF InjCrv_facPiI1ATSQCor_AXIS /end AXIS_DESCR
/end CHARACTERISTIC
/begin CHARACTERISTIC InjCrv_facPiI1ATSQCorStrt_CUR "weighting factor of intake air temperature for pilot injections quantity correction" CURVE 0xDEB40 Kl_Xs16_Ws16 1.000000 Fact 0.00 1.000000 FORMAT "%8.6" EXTENDED_LIMITS -4.000000 3.999878
 /begin AXIS_DESCR STD_AXIS IATSCD_tAir Temp_Cels 8 -50.14000 199.8600 FORMAT "%8.4" EXTENDED_LIMITS -3549.940 3003.560 DEPOSIT ABSOLUTE /end AXIS_DESCR
/end CHARACTERISTIC
/begin AXIS_PTS InjCrv_facPiI1ATSQCor_AXIS "gemeinsame Stützstellen für ansauglufttemperaturabhängige Mengenkorrekturkennlinien für PiI1" 0xDEB62 IATSCD_tAir GSst_Xs16 250.0000 Temp_Cels 8 -50.14000 199.8600 FORMAT "%8.4" EXTENDED_LIMITS -3549.940 3003.560 DEPOSIT ABSOLUTE /end AXIS_PTS
/begin CHARACTERISTIC InjCrv_facPiI1ATSQCor_CUR "ansauglufttemperaturabhängige Mengenkorrekturkennlinie für Voreinspritzung 1" CURVE 0xDEB74 Gkl_Ws16 1.000000 Fact 0.00 1.000000 FORMAT "%8.6" EXTENDED_LIMITS -4.000000 3.999878
 /begin AXIS_DESCR COM_AXIS IATSCD_tAir Temp_Cels 8 -50.14000 199.8600 FORMAT "%8.4" EXTENDED_LIMITS -3549.940 3003.560 AXIS_PTS_REF InjCrv_facPiI1ATSQCor_AXIS /end AXIS_DESCR
/end CHARACTERISTIC
/begin CHARACTERISTIC InjCrv_facPiI1ATSSOECor_CUR "kennlinie für ansauglufttemperaturabhängigen Gewichtungsfaktor für PiI1" CURVE 0xDD16E Kl_Xs16_Ws16 1.000000 Fact 0.00 1.000000 FORMAT "%8.6" EXTENDED_LIMITS -4.000000 3.999878
 /begin AXIS_DESCR STD_AXIS IATSCD_tAir Temp_Cels 6 -50.14000 199.8600 FORMAT "%8.4" EXTENDED_LIMITS -3549.940 3003.560 DEPOSIT ABSOLUTE /end AXIS_DESCR
/end CHARACTERISTIC
/begin CHARACTERISTIC InjCrv_facPiI1ETSQCor12_CUR "motortemperaturabhängige Mengenkorrekturkennlinie für Voreinspritzung 1 bei inaktiver Voreinspritzung 2" CURVE 0xDEB84 Gkl_Ws16 1.000000 Fact 0.00 1.000000 FORMAT "%8.6" EXTENDED_LIMITS -4.000000 3.999878
 /begin AXIS_DESCR COM_AXIS InjCrv_tEng Temp_Cels 8 -50.14000 199.8600 FORMAT "%8.4" EXTENDED_LIMITS -3549.940 3003.560 AXIS_PTS_REF InjCrv_facPiI1ETSQCor1_AXIS /end AXIS_DESCR
/end CHARACTERISTIC
/begin AXIS_PTS InjCrv_facPiI1ETSQCor1_AXIS "Motortemperatur zur Mengenkorrektur der Voreinspritzung" 0xDEB94 InjCrv_tEng GSst_Xs16 250.0000 Temp_Cels 8 -50.14000 199.8600 FORMAT "%8.4" EXTENDED_LIMITS -3549.940 3003.560 DEPOSIT ABSOLUTE /end AXIS_PTS
/begin CHARACTERISTIC InjCrv_facPiI1ETSQCor1_CUR "motortemperaturabhängige Mengenkorrekturkennlinie -1 für Voreinspritzung 1" CURVE 0xDEBA6 Gkl_Ws16 1.000000 Fact 0.00 1.000000 FORMAT "%8.6" EXTENDED_LIMITS -4.000000 3.999878
 /begin AXIS_DESCR COM_AXIS InjCrv_tEng Temp_Cels 8 -50.14000 199.8600 FORMAT "%8.4" EXTENDED_LIMITS -3549.940 3003.560 AXIS_PTS_REF InjCrv_facPiI1ETSQCor1_AXIS /end AXIS_DESCR
/end CHARACTERISTIC
/begin CHARACTERISTIC InjCrv_facPiI1ETSQCor2Strt_CUR "weighting factor of engine temperature for quantity correction of PiI1 when PiI2 or PiI3 is active" CURVE 0xDEBB6 Kl_Xs16_Ws16 1.000000 Fact 0.00 1.000000 FORMAT "%8.6" EXTENDED_LIMITS -4.000000 3.999878
 /begin AXIS_DESCR STD_AXIS InjCrv_tEng Temp_Cels 8 -50.14000 199.8600 FORMAT "%8.4" EXTENDED_LIMITS -3549.940 3003.560 DEPOSIT ABSOLUTE /end AXIS_DESCR
/end CHARACTERISTIC
/begin CHARACTERISTIC InjCrv_facPiI1ETSQCor2_CUR "motortemperaturabhängige Mengenkorrekturkennlinie für Voreinspritzung 1 wenn PiI2 oder PiI3 aktiv ist" CURVE 0xDEBD8 Gkl_Ws16 1.000000 Fact 0.00 1.000000 FORMAT "%8.6" EXTENDED_LIMITS -4.000000 3.999878
 /begin AXIS_DESCR COM_AXIS InjCrv_tEng Temp_Cels 8 -50.14000 199.8600 FORMAT "%8.4" EXTENDED_LIMITS -3549.940 3003.560 AXIS_PTS_REF InjCrv_facPiI1ETSQCor_AXIS /end AXIS_DESCR
/end CHARACTERISTIC
/begin CHARACTERISTIC InjCrv_facPiI1ETSQCorStrt_CUR "weighting factor of engine temperature for pilot injection quantity correction" CURVE 0xDEBE8 Kl_Xs16_Ws16 1.000000 Fact 0.00 1.000000 FORMAT "%8.6" EXTENDED_LIMITS -4.000000 3.999878
 /begin AXIS_DESCR STD_AXIS InjCrv_tEng Temp_Cels 8 -50.14000 199.8600 FORMAT "%8.4" EXTENDED_LIMITS -3549.940 3003.560 DEPOSIT ABSOLUTE /end AXIS_DESCR
/end CHARACTERISTIC
/begin AXIS_PTS InjCrv_facPiI1ETSQCor_AXIS "gemeinsame Stützstellen für motortemperaturabhängige Mengenkorrekturkennlinien für PiI1" 0xDEC0A InjCrv_tEng GSst_Xs16 250.0000 Temp_Cels 8 -50.14000 199.8600 FORMAT "%8.4" EXTENDED_LIMITS -3549.940 3003.560 DEPOSIT ABSOLUTE /end AXIS_PTS
/begin CHARACTERISTIC InjCrv_facPiI1ETSQCor_CUR "motortemperaturabhängige Mengenkorrekturkennlinie für Voreinspritzung 1" CURVE 0xDEC1C Gkl_Ws16 1.000000 Fact 0.00 1.000000 FORMAT "%8.6" EXTENDED_LIMITS -4.000000 3.999878
 /begin AXIS_DESCR COM_AXIS InjCrv_tEng Temp_Cels 8 -50.14000 199.8600 FORMAT "%8.4" EXTENDED_LIMITS -3549.940 3003.560 AXIS_PTS_REF InjCrv_facPiI1ETSQCor_AXIS /end AXIS_DESCR
/end CHARACTERISTIC
/begin CHARACTERISTIC InjCrv_facPiI1ETSSOECor12_CUR "motortemperaturabhängige Ansteuerbeginnkorrekturkennlinie für Voreinspritzung 1 bei aktiver Voreinspritzung 2" CURVE 0xDEC2C Gkl_Ws16 1.000000 Fact 0.00 1.000000 FORMAT "%8.6" EXTENDED_LIMITS -4.000000 3.999878
 /begin AXIS_DESCR COM_AXIS InjCrv_tEng Temp_Cels 8 -50.14000 199.8600 FORMAT "%8.4" EXTENDED_LIMITS -3549.940 3003.560 AXIS_PTS_REF InjCrv_facPiI1ETSSOECor1_AXIS /end AXIS_DESCR
/end CHARACTERISTIC
/begin AXIS_PTS InjCrv_facPiI1ETSSOECor1_AXIS "Motortemperatur zur Startmengenkorrektur der Voreinspritzung" 0xDEC3C InjCrv_tEng GSst_Xs16 250.0000 Temp_Cels 8 -50.14000 199.8600 FORMAT "%8.4" EXTENDED_LIMITS -3549.940 3003.560 DEPOSIT ABSOLUTE /end AXIS_PTS
/begin CHARACTERISTIC InjCrv_facPiI1ETSSOECor1_CUR "motortemperaturabhängige Ansteuerbeginnkorrekturkennlinie -1 für Voreinspritzung 1" CURVE 0xDEC4E Gkl_Ws16 1.000000 Fact 0.00 1.000000 FORMAT "%8.6" EXTENDED_LIMITS -4.000000 3.999878
 /begin AXIS_DESCR COM_AXIS InjCrv_tEng Temp_Cels 8 -50.14000 199.8600 FORMAT "%8.4" EXTENDED_LIMITS -3549.940 3003.560 AXIS_PTS_REF InjCrv_facPiI1ETSSOECor1_AXIS /end AXIS_DESCR
/end CHARACTERISTIC
/begin CHARACTERISTIC InjCrv_facPiI1ETSSOECor2_CUR "motortemperaturabhängige Ansteuerbeginnkorrekturkennlinie -2 für Voreinspritzung 1" CURVE 0xDEC5E Gkl_Ws16 1.000000 Fact 0.00 1.000000 FORMAT "%8.6" EXTENDED_LIMITS -4.000000 3.999878
 /begin AXIS_DESCR COM_AXIS InjCrv_tEng Temp_Cels 8 -50.14000 199.8600 FORMAT "%8.4" EXTENDED_LIMITS -3549.940 3003.560 AXIS_PTS_REF InjCrv_facPiI1ETSSOECor_AXIS /end AXIS_DESCR
/end CHARACTERISTIC
/begin CHARACTERISTIC InjCrv_facPiI1ETSSOECorStrt_CUR "motortemperaturabhängige Ansteuerbeginnkorrekturkennlinie für Voreinspritzung 1 im Startfall" CURVE 0xDEC6E Kl_Xs16_Ws16 1.000000 Fact 0.00 1.000000 FORMAT "%8.6" EXTENDED_LIMITS -4.000000 3.999878
 /begin AXIS_DESCR STD_AXIS InjCrv_tEng Temp_Cels 8 -50.14000 199.8600 FORMAT "%8.4" EXTENDED_LIMITS -3549.940 3003.560 DEPOSIT ABSOLUTE /end AXIS_DESCR
/end CHARACTERISTIC
/begin AXIS_PTS InjCrv_facPiI1ETSSOECor_AXIS "gemeinsame Stützstellen für motortemperaturabhängige Ansteuerbeginnkorrekturkennlinien für PiI1" 0xDEC90 InjCrv_tEng GSst_Xs16 250.0000 Temp_Cels 8 -50.14000 199.8600 FORMAT "%8.4" EXTENDED_LIMITS -3549.940 3003.560 DEPOSIT ABSOLUTE /end AXIS_PTS
/begin CHARACTERISTIC InjCrv_facPiI1ETSSOECor_CUR "motortemperaturabhängige Ansteuerbeginnkorrekturkennlinie für Voreinspritzung 1" CURVE 0xDECA2 Gkl_Ws16 1.000000 Fact 0.00 1.000000 FORMAT "%8.6" EXTENDED_LIMITS -4.000000 3.999878
 /begin AXIS_DESCR COM_AXIS InjCrv_tEng Temp_Cels 8 -50.14000 199.8600 FORMAT "%8.4" EXTENDED_LIMITS -3549.940 3003.560 AXIS_PTS_REF InjCrv_facPiI1ETSSOECor_AXIS /end AXIS_DESCR
/end CHARACTERISTIC
/begin CHARACTERISTIC InjCrv_facPiI1QntMax_C "Wichtungsfaktor für die berechnete Sollmenge der Voreinspritzung 1" VALUE 0xDBF9C Kw_Ws16 1.000000 Fact1 0.00 1.000000 FORMAT "%8.6" EXTENDED_LIMITS -256.0000 255.9922 /end CHARACTERISTIC
/begin CHARACTERISTIC InjCrv_facPiI1QntMin_CUR "raildruckabhängige Kennlinie zur Ermittlung des Faktor fuer die Berechnung der Mindestmenge um die PiI1 abzuschalten" CURVE 0xDAB44 Kl_Xs16_Ws16 1.000000 Fact1 0.00 1.000000 FORMAT "%8.6" EXTENDED_LIMITS -256.0000 255.9922
 /begin AXIS_DESCR STD_AXIS RailCD_pPeak Pres_Rail 8 0.00 2000.000 FORMAT "%5.3" EXTENDED_LIMITS -3276.800 3276.700 DEPOSIT ABSOLUTE /end AXIS_DESCR
/end CHARACTERISTIC
/begin CHARACTERISTIC InjCrv_facPiI2APSQCorStrt_CUR "weighting factor of atmospheric pressure for PiI2 quantity correction" CURVE 0xDC9C0 Kl_Xs16_Ws16 1.000000 Fact 0.00 1.000000 FORMAT "%8.6" EXTENDED_LIMITS -4.000000 3.999878
 /begin AXIS_DESCR STD_AXIS APSCD_pVal Pres_hPa 8 0.00 3500.000 FORMAT "%8.3" EXTENDED_LIMITS -32768.00 32767.00 DEPOSIT ABSOLUTE /end AXIS_DESCR
/end CHARACTERISTIC
/begin CHARACTERISTIC InjCrv_facPiI2APSQCor_CUR "atmosphärendruckabhängige Mengenkorrekturkennlinie für Voreinspritzung 2" CURVE 0xDC9E2 Kl_Xs16_Ws16 1.000000 Fact 0.00 1.000000 FORMAT "%8.6" EXTENDED_LIMITS -4.000000 3.999878
 /begin AXIS_DESCR STD_AXIS APSCD_pVal Pres_hPa 8 0.00 3500.000 FORMAT "%8.3" EXTENDED_LIMITS -32768.00 32767.00 DEPOSIT ABSOLUTE /end AXIS_DESCR
/end CHARACTERISTIC
/begin CHARACTERISTIC InjCrv_facPiI2ATSQCorStrt_CUR "weighting factor of intake air temperature for PiI2 quantity correction" CURVE 0xDCA04 Kl_Xs16_Ws16 1.000000 Fact 0.00 1.000000 FORMAT "%8.6" EXTENDED_LIMITS -4.000000 3.999878
 /begin AXIS_DESCR STD_AXIS IATSCD_tAir Temp_Cels 8 -50.14000 199.8600 FORMAT "%8.4" EXTENDED_LIMITS -3549.940 3003.560 DEPOSIT ABSOLUTE /end AXIS_DESCR
/end CHARACTERISTIC
/begin CHARACTERISTIC InjCrv_facPiI2ATSQCor_CUR "ansauglufttemperaturabhängige Mengenkorrekturkennlinie für Voreinspritzung 2" CURVE 0xDCA26 Kl_Xs16_Ws16 1.000000 Fact 0.00 1.000000 FORMAT "%8.6" EXTENDED_LIMITS -4.000000 3.999878
 /begin AXIS_DESCR STD_AXIS IATSCD_tAir Temp_Cels 8 -50.14000 199.8600 FORMAT "%8.4" EXTENDED_LIMITS -3549.940 3003.560 DEPOSIT ABSOLUTE /end AXIS_DESCR
/end CHARACTERISTIC
/begin CHARACTERISTIC InjCrv_facPiI2ETSQCorStrt_CUR "weighting factor of engine temperature for PiI2 quantity correction" CURVE 0xDCA48 Kl_Xs16_Ws16 1.000000 Fact 0.00 1.000000 FORMAT "%8.6" EXTENDED_LIMITS -4.000000 3.999878
 /begin AXIS_DESCR STD_AXIS InjCrv_tEng Temp_Cels 8 -50.14000 199.8600 FORMAT "%8.4" EXTENDED_LIMITS -3549.940 3003.560 DEPOSIT ABSOLUTE /end AXIS_DESCR
/end CHARACTERISTIC
/begin CHARACTERISTIC InjCrv_facPiI2ETSQCor_CUR "motortemperaturabhängige Mengenkorrekturkennlinie für Voreinspritzung 2" CURVE 0xDCA6A Kl_Xs16_Ws16 1.000000 Fact 0.00 1.000000 FORMAT "%8.6" EXTENDED_LIMITS -4.000000 3.999878
 /begin AXIS_DESCR STD_AXIS InjCrv_tEng Temp_Cels 8 -50.14000 199.8600 FORMAT "%8.4" EXTENDED_LIMITS -3549.940 3003.560 DEPOSIT ABSOLUTE /end AXIS_DESCR
/end CHARACTERISTIC
/begin CHARACTERISTIC InjCrv_facPiI2ETSSOECorStrt_CUR "motortemperaturabhängige Ansteuerbeginnkorrekturkennlinie für Voreinspritzung 2 im Startfall" CURVE 0xDCA8C Kl_Xs16_Ws16 1.000000 Fact 0.00 1.000000 FORMAT "%8.6" EXTENDED_LIMITS -4.000000 3.999878
 /begin AXIS_DESCR STD_AXIS InjCrv_tEng Temp_Cels 8 -50.14000 199.8600 FORMAT "%8.4" EXTENDED_LIMITS -3549.940 3003.560 DEPOSIT ABSOLUTE /end AXIS_DESCR
/end CHARACTERISTIC
/begin CHARACTERISTIC InjCrv_facPiI2ETSSOECor_CUR "motortemperaturabhängige Ansteuerbeginnkorrekturkennlinie für Voreinspritzung 2" CURVE 0xDCAAE Kl_Xs16_Ws16 1.000000 Fact 0.00 1.000000 FORMAT "%8.6" EXTENDED_LIMITS -4.000000 3.999878
 /begin AXIS_DESCR STD_AXIS InjCrv_tEng Temp_Cels 8 -50.14000 199.8600 FORMAT "%8.4" EXTENDED_LIMITS -3549.940 3003.560 DEPOSIT ABSOLUTE /end AXIS_DESCR
/end CHARACTERISTIC
/begin CHARACTERISTIC InjCrv_facPiI2QntMin_CUR "Faktor zur Berechnung der Mindestmenge fuer die Abschaltung der Voreinspritzung PiI2" CURVE 0xDBF9E Kl_Xs16_Ws16 1.000000 Fact1 0.00 1.000000 FORMAT "%8.6" EXTENDED_LIMITS -256.0000 255.9922
 /begin AXIS_DESCR STD_AXIS RailCD_pPeak Pres_Rail 8 0.00 2000.000 FORMAT "%5.3" EXTENDED_LIMITS -3276.800 3276.700 DEPOSIT ABSOLUTE /end AXIS_DESCR
/end CHARACTERISTIC
/begin CHARACTERISTIC InjCrv_facPoI1APSQCor_CUR "atmospärendruckabhängige Mengenkorrekturkennlinie für PoI1" CURVE 0xDFC62 Kl_Xs16_Ws16 1.000000 Fact 0.00 1.000000 FORMAT "%8.6" EXTENDED_LIMITS -4.000000 3.999878
 /begin AXIS_DESCR STD_AXIS APSCD_pVal Pres_hPa 6 0.00 3500.000 FORMAT "%8.3" EXTENDED_LIMITS -32768.00 32767.00 DEPOSIT ABSOLUTE /end AXIS_DESCR
/end CHARACTERISTIC
/begin CHARACTERISTIC InjCrv_facPoI1ETSPhiCor_CUR "motortemperaturabhängige Winkelkorrekturkennlinie für PoI1" CURVE 0xDFC7C Kl_Xs16_Ws16 1.000000 Fact 0.00 1.000000 FORMAT "%8.6" EXTENDED_LIMITS -4.000000 3.999878
 /begin AXIS_DESCR STD_AXIS InjCrv_tEng Temp_Cels 1 -50.14000 199.8600 FORMAT "%8.4" EXTENDED_LIMITS -3549.940 3003.560 DEPOSIT ABSOLUTE /end AXIS_DESCR
/end CHARACTERISTIC
/begin CHARACTERISTIC InjCrv_facPoI1ETSQCor_CUR "motortemperaturabhängige Mengenkorrekturkennlinie für PoI1" CURVE 0xDFC82 Kl_Xs16_Ws16 1.000000 Fact 0.00 1.000000 FORMAT "%8.6" EXTENDED_LIMITS -4.000000 3.999878
 /begin AXIS_DESCR STD_AXIS InjCrv_tEng Temp_Cels 1 -50.14000 199.8600 FORMAT "%8.4" EXTENDED_LIMITS -3549.940 3003.560 DEPOSIT ABSOLUTE /end AXIS_DESCR
/end CHARACTERISTIC
/begin CHARACTERISTIC InjCrv_facPoI2ATSQCor_CUR "ansauglufttemperaturabhängige Mengenkorrekturkennlinie für Nacheinspritzung 2" CURVE 0xE060A Kl_Xs16_Ws16 1.000000 Fact 0.00 1.000000 FORMAT "%8.6" EXTENDED_LIMITS -4.000000 3.999878
 /begin AXIS_DESCR STD_AXIS IATSCD_tAir Temp_Cels 8 -50.14000 199.8600 FORMAT "%8.4" EXTENDED_LIMITS -3549.940 3003.560 DEPOSIT ABSOLUTE /end AXIS_DESCR
/end CHARACTERISTIC
/begin CHARACTERISTIC InjCrv_facPoI2ATSSOECor_CUR "ansauglufttemperaturabhängige Ansteuerbeginnkorrekturkennlinie für Nacheinspritzung 2" CURVE 0xE062C Kl_Xs16_Ws16 1.000000 Fact 0.00 1.000000 FORMAT "%8.6" EXTENDED_LIMITS -4.000000 3.999878
 /begin AXIS_DESCR STD_AXIS IATSCD_tAir Temp_Cels 8 -50.14000 199.8600 FORMAT "%8.4" EXTENDED_LIMITS -3549.940 3003.560 DEPOSIT ABSOLUTE /end AXIS_DESCR
/end CHARACTERISTIC
/begin CHARACTERISTIC InjCrv_facPoI2Eff1_MAP "map of PoI2 for the torque forming part of injection quantity" MAP 0xE0B7C Kf_Xs16_Ys16_Ws16 1.000000 Fact 0.00 1.000000 FORMAT "%8.6" EXTENDED_LIMITS -4.000000 3.999878
 /begin AXIS_DESCR STD_AXIS Eng_nAvrg EngN 8 0.00 6000.000 FORMAT "%8.3" EXTENDED_LIMITS -32768.00 32767.00 DEPOSIT ABSOLUTE /end AXIS_DESCR
 /begin AXIS_DESCR STD_AXIS InjCtl_qSetUnBal InjMassCyc 8 0.00 327.6700 FORMAT "%8.4" EXTENDED_LIMITS -327.6800 327.6700 DEPOSIT ABSOLUTE /end AXIS_DESCR
/end CHARACTERISTIC
/begin CHARACTERISTIC InjCrv_facPoI2Eff2_MAP "map of PoI2 for the torque forming part of injection quantity" MAP 0xE0C20 Kf_Xs16_Ys16_Ws16 1.000000 Fact 0.00 1.000000 FORMAT "%8.6" EXTENDED_LIMITS -4.000000 3.999878
 /begin AXIS_DESCR STD_AXIS Eng_nAvrg EngN 8 0.00 6000.000 FORMAT "%8.3" EXTENDED_LIMITS -32768.00 32767.00 DEPOSIT ABSOLUTE /end AXIS_DESCR
 /begin AXIS_DESCR STD_AXIS InjCtl_qSetUnBal InjMassCyc 8 0.00 327.6700 FORMAT "%8.4" EXTENDED_LIMITS -327.6800 327.6700 DEPOSIT ABSOLUTE /end AXIS_DESCR
/end CHARACTERISTIC
/begin CHARACTERISTIC InjCrv_facPoI2Eff_MAP "Faktor für Drehmoment bildenden Anteil der Einspritzmenge PoI2" MAP 0xE088C Kf_Xs16_Ys16_Ws16 1.000000 Fact 0.00 1.000000 FORMAT "%8.6" EXTENDED_LIMITS -4.000000 3.999878
 /begin AXIS_DESCR STD_AXIS Eng_nAvrg EngN 8 0.00 6000.000 FORMAT "%8.3" EXTENDED_LIMITS -32768.00 32767.00 DEPOSIT ABSOLUTE /end AXIS_DESCR
 /begin AXIS_DESCR STD_AXIS InjCtl_qSetUnBal InjMassCyc 8 0.00 327.6700 FORMAT "%8.4" EXTENDED_LIMITS -327.6800 327.6700 DEPOSIT ABSOLUTE /end AXIS_DESCR
/end CHARACTERISTIC
/begin CHARACTERISTIC InjCrv_facPoI2ETSQCor_CUR "motortemperaturabhängige Mengenkorrekturkennlinie für Nacheinspritzung 2" CURVE 0xE064E Kl_Xs16_Ws16 1.000000 Fact 0.00 1.000000 FORMAT "%8.6" EXTENDED_LIMITS -4.000000 3.999878
 /begin AXIS_DESCR STD_AXIS InjCrv_tEng Temp_Cels 8 -50.14000 199.8600 FORMAT "%8.4" EXTENDED_LIMITS -3549.940 3003.560 DEPOSIT ABSOLUTE /end AXIS_DESCR
/end CHARACTERISTIC
/begin CHARACTERISTIC InjCrv_facPoI2ETSSOECor_CUR "motortemperaturabhängige Ansteuerbeginnkorrekturkennlinie für PoI2" CURVE 0xE0670 Kl_Xs16_Ws16 1.000000 Fact 0.00 1.000000 FORMAT "%8.6" EXTENDED_LIMITS -4.000000 3.999878
 /begin AXIS_DESCR STD_AXIS InjCrv_tEng Temp_Cels 8 -50.14000 199.8600 FORMAT "%8.4" EXTENDED_LIMITS -3549.940 3003.560 DEPOSIT ABSOLUTE /end AXIS_DESCR
/end CHARACTERISTIC
/begin CHARACTERISTIC InjCrv_facPoI2QntMin_C "Faktor zur applikativen Abschaltung der PoI2 bei Unterschreitung der Mindestmenge" VALUE 0xE0930 Kw_Ws16 1.000000 Fact1 0.00 1.000000 FORMAT "%8.6" EXTENDED_LIMITS -256.0000 255.9922 /end CHARACTERISTIC
/begin CHARACTERISTIC InjCrv_facPOpPoI2ETSCor_CUR "motortemperaturabhängige Freigabekorrekturkennlinie für PoI2" CURVE 0xE0692 Kl_Xs16_Ws16 1.000000 Fact 0.00 1.000000 FORMAT "%8.6" EXTENDED_LIMITS -4.000000 3.999878
 /begin AXIS_DESCR STD_AXIS InjCrv_tEng Temp_Cels 8 -50.14000 199.8600 FORMAT "%8.4" EXTENDED_LIMITS -3549.940 3003.560 DEPOSIT ABSOLUTE /end AXIS_DESCR
/end CHARACTERISTIC
/begin CHARACTERISTIC InjCrv_facQPoI2RgnAPCor_CUR "atmosphere pressure part of PoI2 regeneration quantity correction" CURVE 0xE05B6 Kl_Xs16_Ws16 2.000000 Fact 0.00 2.000000 FORMAT "%8.6" EXTENDED_LIMITS -4.000000 3.999878
 /begin AXIS_DESCR STD_AXIS APSCD_pLinVal Pres_hPa 1 0.00 3500.000 FORMAT "%8.3" EXTENDED_LIMITS -32768.00 32767.00 DEPOSIT ABSOLUTE /end AXIS_DESCR
/end CHARACTERISTIC
/begin CHARACTERISTIC InjCrv_facQPoI2RgnETCor_CUR "engine temperature part of PoI2 regeneration quantity correction" CURVE 0xE05BC Kl_Xs16_Ws16 2.000000 Fact 0.00 2.000000 FORMAT "%8.6" EXTENDED_LIMITS -4.000000 3.999878
 /begin AXIS_DESCR STD_AXIS InjCrv_tEng Temp_Cels 1 -50.14000 199.8600 FORMAT "%8.4" EXTENDED_LIMITS -3549.940 3003.560 DEPOSIT ABSOLUTE /end AXIS_DESCR
/end CHARACTERISTIC
/begin CHARACTERISTIC InjCrv_facTiPoI2RgnAPCor_CUR " atmosphere pressure part of PoI2 regeneration time correction" CURVE 0xE05C2 Kl_Xs16_Ws16 2.000000 Fact 0.00 2.000000 FORMAT "%8.6" EXTENDED_LIMITS -4.000000 3.999878
 /begin AXIS_DESCR STD_AXIS APSCD_pLinVal Pres_hPa 1 0.00 3500.000 FORMAT "%8.3" EXTENDED_LIMITS -32768.00 32767.00 DEPOSIT ABSOLUTE /end AXIS_DESCR
/end CHARACTERISTIC
/begin CHARACTERISTIC InjCrv_facTiPoI2RgnETCor_CUR "engine temperature part of PoI2 regeneration time correction" CURVE 0xE05C8 Kl_Xs16_Ws16 2.000000 Fact 0.00 2.000000 FORMAT "%8.6" EXTENDED_LIMITS -4.000000 3.999878
 /begin AXIS_DESCR STD_AXIS InjCrv_tEng Temp_Cels 1 -50.14000 199.8600 FORMAT "%8.4" EXTENDED_LIMITS -3549.940 3003.560 DEPOSIT ABSOLUTE /end AXIS_DESCR
/end CHARACTERISTIC
/begin CHARACTERISTIC InjCrv_nDiffMin_C "Minimaler Drehzahlunterschied für die Freigabe der Voreinspritzung 2" VALUE 0xDBFC0 Kw_Ws16 6000.000 EngN 0.00 6000.000 FORMAT "%8.3" EXTENDED_LIMITS -32768.00 32767.00 /end CHARACTERISTIC
/begin CHARACTERISTIC InjCrv_numTDCPoI1Clsn_C "Nummer des kollidierenden Zylinders" VALUE 0xDFB60 Kw_Wu8 255.0 OneToOne 0.00 255.0 FORMAT "%5.1" /end CHARACTERISTIC
/begin CHARACTERISTIC InjCrv_phiDynOfs_CUR "Winkelvorhalt für schnelle dynamische Vorgänge" CURVE 0xDFB62 Kl_Xs16_Ws16 767.9766 AngleCrS 0.00 767.9766 FORMAT "%8.4" EXTENDED_LIMITS -768.0000 767.9766
 /begin AXIS_DESCR STD_AXIS Eng_nAvrg EngN 12 0.00 6000.000 FORMAT "%8.3" EXTENDED_LIMITS -32768.00 32767.00 DEPOSIT ABSOLUTE /end AXIS_DESCR
/end CHARACTERISTIC
/begin CHARACTERISTIC InjCrv_phiMI1BasStrt_MAP "1st base map of MI1 SOE" MAP 0xDA900 Kf_Xs16_Ys16_Ws16 50.01562 AngleCrS -10.00781 40.00781 FORMAT "%8.5" EXTENDED_LIMITS -768.0000 767.9766
 /begin AXIS_DESCR STD_AXIS Eng_nAvrg EngN 16 0.00 6000.000 FORMAT "%8.3" EXTENDED_LIMITS -32768.00 32767.00 DEPOSIT ABSOLUTE /end AXIS_DESCR
 /begin AXIS_DESCR STD_AXIS InjCtl_qSetUnBal InjMassCyc 16 0.00 327.6700 FORMAT "%8.4" EXTENDED_LIMITS -327.6800 327.6700 DEPOSIT ABSOLUTE /end AXIS_DESCR
/end CHARACTERISTIC
/begin CHARACTERISTIC InjCrv_phiMI1DesAdd_Vector "#SSD Bypass-Label für additiven Bypass von InjCrv_phiMI1Des (Nicht verstellen!)" VALUE 0xC309E Kw_Wu8 255.0 OneToOne 0.00 255.0 FORMAT "%5.1" /end CHARACTERISTIC
/begin CHARACTERISTIC InjCrv_phiMI1DesAdd_Channel "#SSD Bypass-Label für additiven Bypass von InjCrv_phiMI1Des (Nicht verstellen!)" VALUE 0xC309F Kw_Wu8 255.0 OneToOne 0.00 255.0 FORMAT "%5.1" /end CHARACTERISTIC
/begin CHARACTERISTIC InjCrv_phiMI1Des_Vector "#SSD Bypass-Label für InjCrv_phiMI1Des (Nicht verstellen!)" VALUE 0xC30A0 Kw_Wu8 255.0 OneToOne 0.00 255.0 FORMAT "%5.1" /end CHARACTERISTIC
/begin CHARACTERISTIC InjCrv_phiMI1Des_Channel "#SSD Bypass-Label für InjCrv_phiMI1Des (Nicht verstellen!)" VALUE 0xC30A1 Kw_Wu8 255.0 OneToOne 0.00 255.0 FORMAT "%5.1" /end CHARACTERISTIC
/begin CHARACTERISTIC InjCrv_phiMI1RgnAdd_Vector "Bypass-Label für InjCrv_phiMI1RgnAdd_Vector (Nicht verstellen!)" VALUE 0xC30A6 Kw_Wu8 255.0 OneToOne 0.00 255.0 FORMAT "%5.1" /end CHARACTERISTIC
/begin CHARACTERISTIC InjCrv_phiMI1RgnAdd_Channel "Bypass-Label für InjCrv_phiMI1RgnAdd_Channel (Nicht verstellen!)" VALUE 0xC30A7 Kw_Wu8 255.0 OneToOne 0.00 255.0 FORMAT "%5.1" /end CHARACTERISTIC
/begin CHARACTERISTIC InjCrv_phiMI1Rgn_MAP "Kennfeld für Ansteuerbeginn MI1 im Regenerationsbetrieb" MAP 0xDA548 Kf_Xs16_Ys16_Ws16 50.01562 AngleCrS -10.00781 40.00781 FORMAT "%8.5" EXTENDED_LIMITS -768.0000 767.9766
 /begin AXIS_DESCR STD_AXIS Eng_nAvrg EngN 16 0.00 6000.000 FORMAT "%8.3" EXTENDED_LIMITS -32768.00 32767.00 DEPOSIT ABSOLUTE /end AXIS_DESCR
 /begin AXIS_DESCR STD_AXIS InjCtl_qSetUnBal InjMassCyc 16 0.00 327.6700 FORMAT "%8.4" EXTENDED_LIMITS -327.6800 327.6700 DEPOSIT ABSOLUTE /end AXIS_DESCR
/end CHARACTERISTIC
/begin CHARACTERISTIC InjCrv_phiMI1Rgn_Vector "#SSD Bypass-Label, nicht editieren !" VALUE 0xC30A8 Kw_Wu8 255.0 OneToOne 0.00 255.0 FORMAT "%5.1" /end CHARACTERISTIC
/begin CHARACTERISTIC InjCrv_phiMI1Rgn_Channel "#SSD Bypass-Label, nicht editieren !" VALUE 0xC30A9 Kw_Wu8 255.0 OneToOne 0.00 255.0 FORMAT "%5.1" /end CHARACTERISTIC
/begin CHARACTERISTIC InjCrv_phiMIETSCorRgn_MAP "motortemperaturabhängiges Ansteuerbeginnkorrekturkennfeld für MI1 im Regenerationsbetrieb" MAP 0xDA78C Kf_Xs16_Ys16_Ws16 50.01562 AngleCrS -10.00781 40.00781 FORMAT "%8.5" EXTENDED_LIMITS -768.0000 767.9766
 /begin AXIS_DESCR STD_AXIS Eng_nAvrg EngN 12 0.00 6000.000 FORMAT "%8.3" EXTENDED_LIMITS -32768.00 32767.00 DEPOSIT ABSOLUTE /end AXIS_DESCR
 /begin AXIS_DESCR STD_AXIS InjCtl_qSetUnBal InjMassCyc 12 0.00 327.6700 FORMAT "%8.4" EXTENDED_LIMITS -327.6800 327.6700 DEPOSIT ABSOLUTE /end AXIS_DESCR
/end CHARACTERISTIC
/begin CHARACTERISTIC InjCrv_phiPiI1DesAdd_Vector "#SSD Bypass-Label für additiven Bypass von InjCrv_phiPiI1Des (Nicht verstellen!)" VALUE 0xC30BC Kw_Wu8 255.0 OneToOne 0.00 255.0 FORMAT "%5.1" /end CHARACTERISTIC
/begin CHARACTERISTIC InjCrv_phiPiI1DesAdd_Channel "#SSD Bypass-Label für additiven Bypass von InjCrv_phiPiI1Des (Nicht verstellen!)" VALUE 0xC30BD Kw_Wu8 255.0 OneToOne 0.00 255.0 FORMAT "%5.1" /end CHARACTERISTIC
/begin CHARACTERISTIC InjCrv_phiPiI1Des_Vector "#SSD Bypass-Label für InjCrv_phiPiI1Des (Nicht verstellen!)" VALUE 0xC30BE Kw_Wu8 255.0 OneToOne 0.00 255.0 FORMAT "%5.1" /end CHARACTERISTIC
/begin CHARACTERISTIC InjCrv_phiPiI1Des_Channel "#SSD Bypass-Label für InjCrv_phiPiI1Des (Nicht verstellen!)" VALUE 0xC30BF Kw_Wu8 255.0 OneToOne 0.00 255.0 FORMAT "%5.1" /end CHARACTERISTIC
/begin CHARACTERISTIC InjCrv_phiPiI1RgnAdd_Vector "Bypass-Label für InjCrv_phiPiI1RgnAdd_Vector (Nicht verstellen!)" VALUE 0xC30DE Kw_Wu8 255.0 OneToOne 0.00 255.0 FORMAT "%5.1" /end CHARACTERISTIC
/begin CHARACTERISTIC InjCrv_phiPiI1RgnAdd_Channel "Bypass-Label für InjCrv_phiPiI1RgnAdd_Channel (Nicht verstellen!)" VALUE 0xC30DF Kw_Wu8 255.0 OneToOne 0.00 255.0 FORMAT "%5.1" /end CHARACTERISTIC
/begin CHARACTERISTIC InjCrv_phiPiI1Rgn_MAP "Kennfeld für Winkelkomponente Ansteuerbeginn PiI1 im Regenerationsbetrieb" MAP 0xDF6B6 Kf_Xs16_Ys16_Ws16 90.00000 AngleCrS 0.00 90.00000 FORMAT "%8.5" EXTENDED_LIMITS -768.0000 767.9766
 /begin AXIS_DESCR STD_AXIS Eng_nAvrg EngN 2 0.00 6000.000 FORMAT "%8.3" EXTENDED_LIMITS -32768.00 32767.00 DEPOSIT ABSOLUTE /end AXIS_DESCR
 /begin AXIS_DESCR STD_AXIS InjCtl_qSetUnBal InjMassCyc 2 0.00 327.6700 FORMAT "%8.4" EXTENDED_LIMITS -327.6800 327.6700 DEPOSIT ABSOLUTE /end AXIS_DESCR
/end CHARACTERISTIC
/begin CHARACTERISTIC InjCrv_phiPiI1Rgn_Vector "#SSD Bypass-Label, nicht editieren !" VALUE 0xC30E0 Kw_Wu8 255.0 OneToOne 0.00 255.0 FORMAT "%5.1" /end CHARACTERISTIC
/begin CHARACTERISTIC InjCrv_phiPiI1Rgn_Channel "#SSD Bypass-Label, nicht editieren !" VALUE 0xC30E1 Kw_Wu8 255.0 OneToOne 0.00 255.0 FORMAT "%5.1" /end CHARACTERISTIC
/begin CHARACTERISTIC InjCrv_phiPiI2DesAdd_Vector "#SSD Bypass-Label für additiven Bypass von InjCrv_phiPiI2Des (Nicht verstellen!)" VALUE 0xC30C0 Kw_Wu8 255.0 OneToOne 0.00 255.0 FORMAT "%5.1" /end CHARACTERISTIC
/begin CHARACTERISTIC InjCrv_phiPiI2DesAdd_Channel "#SSD Bypass-Label für additiven Bypass von InjCrv_phiPiI2Des (Nicht verstellen!)" VALUE 0xC30C1 Kw_Wu8 255.0 OneToOne 0.00 255.0 FORMAT "%5.1" /end CHARACTERISTIC
/begin CHARACTERISTIC InjCrv_phiPiI2Des_Vector "#SSD Bypass-Label für InjCrv_phiPiI2Des (Nicht verstellen!)" VALUE 0xC30C2 Kw_Wu8 255.0 OneToOne 0.00 255.0 FORMAT "%5.1" /end CHARACTERISTIC
/begin CHARACTERISTIC InjCrv_phiPiI2Des_Channel "#SSD Bypass-Label für InjCrv_phiPiI2Des (Nicht verstellen!)" VALUE 0xC30C3 Kw_Wu8 255.0 OneToOne 0.00 255.0 FORMAT "%5.1" /end CHARACTERISTIC
/begin CHARACTERISTIC InjCrv_phiPiI2RgnAdd_Vector "Configuration label for Bypass" VALUE 0xC30B0 Kw_Wu8 255.0 OneToOne 0.00 255.0 FORMAT "%5.1" /end CHARACTERISTIC
/begin CHARACTERISTIC InjCrv_phiPiI2RgnAdd_Channel "Configuration label for Bypass" VALUE 0xC30B1 Kw_Wu8 255.0 OneToOne 0.00 255.0 FORMAT "%5.1" /end CHARACTERISTIC
/begin CHARACTERISTIC InjCrv_phiPiI2Rgn_Vector "#SSD Bypass-Label, nicht editieren !" VALUE 0xC30B2 Kw_Wu8 255.0 OneToOne 0.00 255.0 FORMAT "%5.1" /end CHARACTERISTIC
/begin CHARACTERISTIC InjCrv_phiPiI2Rgn_Channel "#SSD Bypass-Label, nicht editieren !" VALUE 0xC30B3 Kw_Wu8 255.0 OneToOne 0.00 255.0 FORMAT "%5.1" /end CHARACTERISTIC
/begin CHARACTERISTIC InjCrv_phiPiI3DesAdd_Vector "#SSD Bypass-Label für additiven Bypass von InjCrv_phiPiI3Des (Nicht verstellen!)" VALUE 0xC30C4 Kw_Wu8 255.0 OneToOne 0.00 255.0 FORMAT "%5.1" /end CHARACTERISTIC
/begin CHARACTERISTIC InjCrv_phiPiI3DesAdd_Channel "#SSD Bypass-Label für additiven Bypass von InjCrv_phiPiI3Des (Nicht verstellen!)" VALUE 0xC30C5 Kw_Wu8 255.0 OneToOne 0.00 255.0 FORMAT "%5.1" /end CHARACTERISTIC
/begin CHARACTERISTIC InjCrv_phiPiI3Des_Vector "#SSD Bypass-Label für InjCrv_phiPiI3Des (Nicht verstellen!)" VALUE 0xC30C6 Kw_Wu8 255.0 OneToOne 0.00 255.0 FORMAT "%5.1" /end CHARACTERISTIC
/begin CHARACTERISTIC InjCrv_phiPiI3Des_Channel "#SSD Bypass-Label für InjCrv_phiPiI3Des (Nicht verstellen!)" VALUE 0xC30C7 Kw_Wu8 255.0 OneToOne 0.00 255.0 FORMAT "%5.1" /end CHARACTERISTIC
/begin CHARACTERISTIC InjCrv_phiPiIMax_C "#SSD frühester absoluter Ansteuerbeginn einer PiI" VALUE 0xDAB66 Kw_Ws16 100.0078 AngleCrS 0.00 100.0078 FORMAT "%8.4" EXTENDED_LIMITS -768.0000 767.9766 /end CHARACTERISTIC
/begin CHARACTERISTIC InjCrv_phiPoI1Bas_MAP "Grundwert des Ansteuerbeginnwinkels PoI1" MAP 0xDFB94 Kf_Xs16_Ys16_Ws16 60.00000 AngleCrS -100.0078 -40.00781 FORMAT "%8.4" EXTENDED_LIMITS -768.0000 767.9766
 /begin AXIS_DESCR STD_AXIS Eng_nAvrg EngN 2 0.00 6000.000 FORMAT "%8.3" EXTENDED_LIMITS -32768.00 32767.00 DEPOSIT ABSOLUTE /end AXIS_DESCR
 /begin AXIS_DESCR STD_AXIS InjCtl_qSetUnBal InjMassCyc 2 0.00 327.6700 FORMAT "%8.4" EXTENDED_LIMITS -327.6800 327.6700 DEPOSIT ABSOLUTE /end AXIS_DESCR
/end CHARACTERISTIC
/begin CHARACTERISTIC InjCrv_phiPoI1DesAdd_Vector "#SSD Bypass-Label für additiven Bypass von InjCrv_phiPoI1Des (Nicht verstellen!)" VALUE 0xC30EA Kw_Wu8 255.0 OneToOne 0.00 255.0 FORMAT "%5.1" /end CHARACTERISTIC
/begin CHARACTERISTIC InjCrv_phiPoI1DesAdd_Channel "#SSD Bypass-Label für additiven Bypass von InjCrv_phiPoI1Des (Nicht verstellen!)" VALUE 0xC30EB Kw_Wu8 255.0 OneToOne 0.00 255.0 FORMAT "%5.1" /end CHARACTERISTIC
/begin CHARACTERISTIC InjCrv_phiPoI1Des_Vector "#SSD Bypass-Label für InjCrv_phiPoI1Des (Nicht verstellen!)" VALUE 0xC30EC Kw_Wu8 255.0 OneToOne 0.00 255.0 FORMAT "%5.1" /end CHARACTERISTIC
/begin CHARACTERISTIC InjCrv_phiPoI1Des_Channel "#SSD Bypass-Label für InjCrv_phiPoI1Des (Nicht verstellen!)" VALUE 0xC30ED Kw_Wu8 255.0 OneToOne 0.00 255.0 FORMAT "%5.1" /end CHARACTERISTIC
/begin CHARACTERISTIC InjCrv_phiPoI1ETSCor_MAP "motortemperaturabhängiges Winkelkorrekturkennfeld für PoI1" MAP 0xDFC26 Kf_Xs16_Ys16_Ws16 200.0156 AngleCrS -100.0078 100.0078 FORMAT "%8.4" EXTENDED_LIMITS -768.0000 767.9766
 /begin AXIS_DESCR STD_AXIS Eng_nAvrg EngN 2 0.00 6000.000 FORMAT "%8.3" EXTENDED_LIMITS -32768.00 32767.00 DEPOSIT ABSOLUTE /end AXIS_DESCR
 /begin AXIS_DESCR STD_AXIS InjCtl_qSetUnBal InjMassCyc 2 0.00 327.6700 FORMAT "%8.4" EXTENDED_LIMITS -327.6800 327.6700 DEPOSIT ABSOLUTE /end AXIS_DESCR
/end CHARACTERISTIC
/begin CHARACTERISTIC InjCrv_phiPoI1Max_C "#SSD Maximaler Ansteuerbeginnwinkel PoI1" VALUE 0xDFBA8 Kw_Ws16 60.00000 AngleCrS -100.0078 -40.00781 FORMAT "%8.4" EXTENDED_LIMITS -768.0000 767.9766 /end CHARACTERISTIC
/begin CHARACTERISTIC InjCrv_phiPoI1Rgn1_MAP "map for value for regeneration of angle comp. SOE PoI1" MAP 0xDFC8E Kf_Xs16_Ys16_Ws16 60.00000 AngleCrS -100.0078 -40.00781 FORMAT "%8.4" EXTENDED_LIMITS -768.0000 767.9766
 /begin AXIS_DESCR STD_AXIS Eng_nAvrg EngN 12 0.00 6000.000 FORMAT "%8.3" EXTENDED_LIMITS -32768.00 32767.00 DEPOSIT ABSOLUTE /end AXIS_DESCR
 /begin AXIS_DESCR STD_AXIS InjCtl_qSetUnBal InjMassCyc 12 0.00 327.6700 FORMAT "%8.4" EXTENDED_LIMITS -327.6800 327.6700 DEPOSIT ABSOLUTE /end AXIS_DESCR
/end CHARACTERISTIC
/begin CHARACTERISTIC InjCrv_phiPoI1Rgn2_MAP "map for value for regeneration of angle comp. SOE PoI1" MAP 0xDFDE2 Kf_Xs16_Ys16_Ws16 60.00000 AngleCrS -100.0078 -40.00781 FORMAT "%8.4" EXTENDED_LIMITS -768.0000 767.9766
 /begin AXIS_DESCR STD_AXIS Eng_nAvrg EngN 12 0.00 6000.000 FORMAT "%8.3" EXTENDED_LIMITS -32768.00 32767.00 DEPOSIT ABSOLUTE /end AXIS_DESCR
 /begin AXIS_DESCR STD_AXIS InjCtl_qSetUnBal InjMassCyc 12 0.00 327.6700 FORMAT "%8.4" EXTENDED_LIMITS -327.6800 327.6700 DEPOSIT ABSOLUTE /end AXIS_DESCR
/end CHARACTERISTIC
/begin CHARACTERISTIC InjCrv_phiPoI1RgnAdd_Vector "Bypass-Label für InjCrv_phiPoI1RgnAdd_Vector (Nicht verstellen!)" VALUE 0xC30F2 Kw_Wu8 255.0 OneToOne 0.00 255.0 FORMAT "%5.1" /end CHARACTERISTIC
/begin CHARACTERISTIC InjCrv_phiPoI1RgnAdd_Channel "Bypass-Label für InjCrv_phiPoI1RgnAdd_Channel (Nicht verstellen!)" VALUE 0xC30F3 Kw_Wu8 255.0 OneToOne 0.00 255.0 FORMAT "%5.1" /end CHARACTERISTIC
/begin CHARACTERISTIC InjCrv_phiPoI1Rgn_Vector "#SSD Bypass-Label, nicht editieren !" VALUE 0xC30F4 Kw_Wu8 255.0 OneToOne 0.00 255.0 FORMAT "%5.1" /end CHARACTERISTIC
/begin CHARACTERISTIC InjCrv_phiPoI1Rgn_Channel "#SSD Bypass-Label, nicht editieren !" VALUE 0xC30F5 Kw_Wu8 255.0 OneToOne 0.00 255.0 FORMAT "%5.1" /end CHARACTERISTIC
/begin CHARACTERISTIC InjCrv_phiPoI2ATSCor_MAP "kundenspez. ansauglufttemperaturabhängiger Korrekturgrundwert für die Winkelkomponente des Ansteuerbeginns der PoI2" MAP 0xE038A Kf_Xs16_Ys16_Ws16 40.00781 AngleCrS -40.00781 0.00 FORMAT "%8.5" EXTENDED_LIMITS -768.0000 767.9766
 /begin AXIS_DESCR STD_AXIS Eng_nAvrg EngN 16 0.00 6000.000 FORMAT "%8.3" EXTENDED_LIMITS -32768.00 32767.00 DEPOSIT ABSOLUTE /end AXIS_DESCR
 /begin AXIS_DESCR STD_AXIS InjCtl_qSetUnBal InjMassCyc 8 0.00 327.6700 FORMAT "%8.4" EXTENDED_LIMITS -327.6800 327.6700 DEPOSIT ABSOLUTE /end AXIS_DESCR
/end CHARACTERISTIC
/begin CHARACTERISTIC InjCrv_phiPoI2ETSCor_MAP "motortemperaturabhängiger Korrekturgrundwertekennfeld für die Winkelkomponente des Ansteuerbeginns der PoI2" MAP 0xE04BE Kf_Xs16_Ys16_Ws16 40.00781 AngleCrS -40.00781 0.00 FORMAT "%8.5" EXTENDED_LIMITS -768.0000 767.9766
 /begin AXIS_DESCR STD_AXIS Eng_nAvrg EngN 12 0.00 6000.000 FORMAT "%8.3" EXTENDED_LIMITS -32768.00 32767.00 DEPOSIT ABSOLUTE /end AXIS_DESCR
 /begin AXIS_DESCR STD_AXIS InjCtl_qSetUnBal InjMassCyc 8 0.00 327.6700 FORMAT "%8.4" EXTENDED_LIMITS -327.6800 327.6700 DEPOSIT ABSOLUTE /end AXIS_DESCR
/end CHARACTERISTIC
/begin CHARACTERISTIC InjCrv_phiPoI2Rgn1_MAP "Kennfeld Regenerationswert 1 Förderbeginn Nacheinspritzung" MAP 0xE0CC4 Kf_Xs16_Ys16_Ws16 40.00781 AngleCrS -40.00781 0.00 FORMAT "%8.5" EXTENDED_LIMITS -768.0000 767.9766
 /begin AXIS_DESCR STD_AXIS Eng_nAvrg EngN 2 0.00 6000.000 FORMAT "%8.3" EXTENDED_LIMITS -32768.00 32767.00 DEPOSIT ABSOLUTE /end AXIS_DESCR
 /begin AXIS_DESCR STD_AXIS InjCtl_qSetUnBal InjMassCyc 2 0.00 327.6700 FORMAT "%8.4" EXTENDED_LIMITS -327.6800 327.6700 DEPOSIT ABSOLUTE /end AXIS_DESCR
/end CHARACTERISTIC
/begin CHARACTERISTIC InjCrv_phiPoI2Rgn2_MAP "Kennfeld Regenerationswert 2 Förderbeginn Nacheinspritzung" MAP 0xE0CD8 Kf_Xs16_Ys16_Ws16 40.00781 AngleCrS -40.00781 0.00 FORMAT "%8.5" EXTENDED_LIMITS -768.0000 767.9766
 /begin AXIS_DESCR STD_AXIS Eng_nAvrg EngN 2 0.00 6000.000 FORMAT "%8.3" EXTENDED_LIMITS -32768.00 32767.00 DEPOSIT ABSOLUTE /end AXIS_DESCR
 /begin AXIS_DESCR STD_AXIS InjCtl_qSetUnBal InjMassCyc 2 0.00 327.6700 FORMAT "%8.4" EXTENDED_LIMITS -327.6800 327.6700 DEPOSIT ABSOLUTE /end AXIS_DESCR
/end CHARACTERISTIC
/begin CHARACTERISTIC InjCrv_phiPoI2RgnCor_MAP "regeneration map of PoI2 setpoint correction" MAP 0xE05CE Kf_Xs16_Ys16_Ws16 40.00781 AngleCrS -40.00781 0.00 FORMAT "%8.5" EXTENDED_LIMITS -768.0000 767.9766
 /begin AXIS_DESCR STD_AXIS Eng_nAvrg EngN 2 0.00 6000.000 FORMAT "%8.3" EXTENDED_LIMITS -32768.00 32767.00 DEPOSIT ABSOLUTE /end AXIS_DESCR
 /begin AXIS_DESCR STD_AXIS InjCtl_qSetUnBal InjMassCyc 2 0.00 327.6700 FORMAT "%8.4" EXTENDED_LIMITS -327.6800 327.6700 DEPOSIT ABSOLUTE /end AXIS_DESCR
/end CHARACTERISTIC
/begin CHARACTERISTIC InjCrv_POpPoI1Bas_MAP "Grundwert Freigabe PoI1" MAP 0xE01F8 Kf_Xs16_Ys16_Ws16 100.0000 OneToOne 0.00 100.0000 FORMAT "%8.4" EXTENDED_LIMITS -32768.00 32767.00
 /begin AXIS_DESCR STD_AXIS Eng_nAvrg EngN 2 0.00 6000.000 FORMAT "%8.3" EXTENDED_LIMITS -32768.00 32767.00 DEPOSIT ABSOLUTE /end AXIS_DESCR
 /begin AXIS_DESCR STD_AXIS InjCtl_qSetUnBal InjMassCyc 2 0.00 327.6700 FORMAT "%8.4" EXTENDED_LIMITS -327.6800 327.6700 DEPOSIT ABSOLUTE /end AXIS_DESCR
/end CHARACTERISTIC
/begin CHARACTERISTIC InjCrv_POpPoI1ETSCor_CUR "motortemperaturabhängige Freigabekorrekturkennlinie für PoI1" CURVE 0xDFC88 Kl_Xs16_Ws16 100.0000 OneToOne 0.00 100.0000 FORMAT "%8.4" EXTENDED_LIMITS -32768.00 32767.00
 /begin AXIS_DESCR STD_AXIS InjCrv_tEng Temp_Cels 1 -50.14000 199.8600 FORMAT "%8.4" EXTENDED_LIMITS -3549.940 3003.560 DEPOSIT ABSOLUTE /end AXIS_DESCR
/end CHARACTERISTIC
/begin CHARACTERISTIC InjCrv_POpPoI1High_C "obere Hystereseschwelle des Grundwertes Freigabe PoI1" VALUE 0xE020C Kw_Ws16 100.0000 OneToOne 0.00 100.0000 FORMAT "%8.4" EXTENDED_LIMITS -32768.00 32767.00 /end CHARACTERISTIC
/begin CHARACTERISTIC InjCrv_POpPoI1Low_C "Untere Hystereseschwelle des Grundwertes Freigabe PoI1" VALUE 0xE020E Kw_Ws16 100.0000 OneToOne 0.00 100.0000 FORMAT "%8.4" EXTENDED_LIMITS -32768.00 32767.00 /end CHARACTERISTIC
/begin CHARACTERISTIC InjCrv_POpPoI2ETSCor_MAP "Motortemperaturabhängiges Freigabekorrekturkennfeld für PoI2" MAP 0xE0210 Kf_Xs16_Ys16_Ws16 100.0000 OneToOne 0.00 100.0000 FORMAT "%8.4" EXTENDED_LIMITS -32768.00 32767.00
 /begin AXIS_DESCR STD_AXIS Eng_nAvrg EngN 8 0.00 6000.000 FORMAT "%8.3" EXTENDED_LIMITS -32768.00 32767.00 DEPOSIT ABSOLUTE /end AXIS_DESCR
 /begin AXIS_DESCR STD_AXIS InjCtl_qSetUnBal InjMassCyc 8 0.00 327.6700 FORMAT "%8.4" EXTENDED_LIMITS -327.6800 327.6700 DEPOSIT ABSOLUTE /end AXIS_DESCR
/end CHARACTERISTIC
/begin CHARACTERISTIC InjCrv_qDiffMin_C "Minimale positive Mengendifferenz für Freigabe Voreinspritzung 2" VALUE 0xDBFC2 Kw_Ws16 327.6700 InjMassInj 0.00 327.6700 FORMAT "%8.4" EXTENDED_LIMITS -327.6800 327.6700 /end CHARACTERISTIC
/begin CHARACTERISTIC InjCrv_qMI1DesAdd_Vector "#SSD Bypass-Label für additiven Bypass von InjCrv_qMI1Des (Nicht verstellen!)" VALUE 0xC30A2 Kw_Wu8 255.0 OneToOne 0.00 255.0 FORMAT "%5.1" /end CHARACTERISTIC
/begin CHARACTERISTIC InjCrv_qMI1DesAdd_Channel "#SSD Bypass-Label für additiven Bypass von InjCrv_qMI1Des (Nicht verstellen!)" VALUE 0xC30A3 Kw_Wu8 255.0 OneToOne 0.00 255.0 FORMAT "%5.1" /end CHARACTERISTIC
/begin CHARACTERISTIC InjCrv_qMI1Des_Vector "#SSD Bypass-Label für InjCrv_qMI1Des (Nicht verstellen!)" VALUE 0xC30A4 Kw_Wu8 255.0 OneToOne 0.00 255.0 FORMAT "%5.1" /end CHARACTERISTIC
/begin CHARACTERISTIC InjCrv_qMI1Des_Channel "#SSD Bypass-Label für InjCrv_qMI1Des (Nicht verstellen!)" VALUE 0xC30A5 Kw_Wu8 255.0 OneToOne 0.00 255.0 FORMAT "%5.1" /end CHARACTERISTIC
/begin CHARACTERISTIC InjCrv_qMI1MinPiI1DiffHys_C "Differenzmenge zwischen unterer und oberer Hystereseschwelle bei PiI1 für Freigabe PiI1 wenn genügend Menge für MI und PiI1" VALUE 0xDAB68 Kw_Ws16 10.00000 InjMassInj 0.00 10.00000 FORMAT "%8.5" EXTENDED_LIMITS -327.6800 327.6700 /end CHARACTERISTIC
/begin CHARACTERISTIC InjCrv_qMI1MinPiI2DiffHys_C "Differenzmenge zwischen unterer und oberer Hystereseschwelle bei PiI2 für Freigabe PiI2 wenn genügend Menge für MI und PiI2" VALUE 0xDBFC4 Kw_Ws16 10.00000 InjMassInj 0.00 10.00000 FORMAT "%8.5" EXTENDED_LIMITS -327.6800 327.6700 /end CHARACTERISTIC
/begin CHARACTERISTIC InjCrv_qMI1RgnAdd_Vector "Bypass-Label für InjCrv_qMI1RgnAdd_Vector (Nicht verstellen!)" VALUE 0xC30AA Kw_Wu8 255.0 OneToOne 0.00 255.0 FORMAT "%5.1" /end CHARACTERISTIC
/begin CHARACTERISTIC InjCrv_qMI1RgnAdd_Channel "Bypass-Label für InjCrv_qMI1RgnAdd_Channel (Nicht verstellen!)" VALUE 0xC30AB Kw_Wu8 255.0 OneToOne 0.00 255.0 FORMAT "%5.1" /end CHARACTERISTIC
/begin CHARACTERISTIC InjCrv_qMI1Rgn_Vector "#SSD Bypass-Label für InjCrv_qMI1Rgn (Nicht verstellen!)" VALUE 0xC30AC Kw_Wu8 255.0 OneToOne 0.00 255.0 FORMAT "%5.1" /end CHARACTERISTIC
/begin CHARACTERISTIC InjCrv_qMI1Rgn_Channel "#SSD Konfigurationslabel für Bypass message" VALUE 0xC30AD Kw_Wu8 255.0 OneToOne 0.00 255.0 FORMAT "%5.1" /end CHARACTERISTIC
/begin CHARACTERISTIC InjCrv_qPiI1APSCor2_MAP "atmosphärendruckabhängige Einspritzmengenkorrekturkennfeld -2 für PiI1 und PiI2" MAP 0xDD2BC Gkf_Ws16 10.00000 InjMassInj 0.00 10.00000 FORMAT "%8.5" EXTENDED_LIMITS -327.6800 327.6700
 /begin AXIS_DESCR COM_AXIS Eng_nAvrg EngN 16 0.00 6000.000 FORMAT "%8.3" EXTENDED_LIMITS -32768.00 32767.00 AXIS_PTS_REF InjCrv_qPiI1APSCor_X_AXIS /end AXIS_DESCR
 /begin AXIS_DESCR COM_AXIS InjCtl_qSetUnBal InjMassCyc 16 0.00 327.6700 FORMAT "%8.4" EXTENDED_LIMITS -327.6800 327.6700 AXIS_PTS_REF InjCrv_qPiI1APSCor_Y_AXIS /end AXIS_DESCR
/end CHARACTERISTIC
/begin CHARACTERISTIC InjCrv_qPiI1APSCorStrt_MAP "correction value for atmospheric pressure dependent pilot injections quantity correction" MAP 0xDD4BC Kf_Xs16_Ys16_Ws16 10.00000 InjMassInj 0.00 10.00000 FORMAT "%8.5" EXTENDED_LIMITS -327.6800 327.6700
 /begin AXIS_DESCR STD_AXIS Eng_nAvrg EngN 16 0.00 6000.000 FORMAT "%8.3" EXTENDED_LIMITS -32768.00 32767.00 DEPOSIT ABSOLUTE /end AXIS_DESCR
 /begin AXIS_DESCR STD_AXIS InjCtl_qSetUnBal InjMassCyc 16 0.00 327.6700 FORMAT "%8.4" EXTENDED_LIMITS -327.6800 327.6700 DEPOSIT ABSOLUTE /end AXIS_DESCR
/end CHARACTERISTIC
/begin CHARACTERISTIC InjCrv_qPiI1APSCor_MAP "atmosphärendruckabhängiges Mengenkorrekturkennfeld für Voreinspritzung 1" MAP 0xDD700 Gkf_Ws16 10.00000 InjMassInj 0.00 10.00000 FORMAT "%8.5" EXTENDED_LIMITS -327.6800 327.6700
 /begin AXIS_DESCR COM_AXIS Eng_nAvrg EngN 16 0.00 6000.000 FORMAT "%8.3" EXTENDED_LIMITS -32768.00 32767.00 AXIS_PTS_REF InjCrv_qPiI1APSCor_X_AXIS /end AXIS_DESCR
 /begin AXIS_DESCR COM_AXIS InjCtl_qSetUnBal InjMassCyc 16 0.00 327.6700 FORMAT "%8.4" EXTENDED_LIMITS -327.6800 327.6700 AXIS_PTS_REF InjCrv_qPiI1APSCor_Y_AXIS /end AXIS_DESCR
/end CHARACTERISTIC
/begin AXIS_PTS InjCrv_qPiI1APSCor_X_AXIS "gemeinsame X-Achse für atmosphärendruckabhängige Mengenkorrekturkennfelder für Voreinspritzung 1" 0xDD900 Eng_nAvrg GSst_Xs16 6000.000 EngN 16 0.00 6000.000 FORMAT "%8.3" EXTENDED_LIMITS -32768.00 32767.00 DEPOSIT ABSOLUTE /end AXIS_PTS
/begin AXIS_PTS InjCrv_qPiI1APSCor_Y_AXIS "gemeinsame Y-Achse für atmosphärendruckabhängige Mengenkorrekturkennfelder für Voreinspritzung 1" 0xDD922 InjCtl_qSetUnBal GSst_Xs16 327.6700 InjMassCyc 16 0.00 327.6700 FORMAT "%8.4" EXTENDED_LIMITS -327.6800 327.6700 DEPOSIT ABSOLUTE /end AXIS_PTS
/begin CHARACTERISTIC InjCrv_qPiI1ATSCor2_MAP "ansauglufttemperaturabhängiges Einspritzmengenkorrekturkennfeld -2 für PiI1 und PiI2" MAP 0xDD944 Gkf_Ws16 10.00000 InjMassInj 0.00 10.00000 FORMAT "%8.5" EXTENDED_LIMITS -327.6800 327.6700
 /begin AXIS_DESCR COM_AXIS Eng_nAvrg EngN 16 0.00 6000.000 FORMAT "%8.3" EXTENDED_LIMITS -32768.00 32767.00 AXIS_PTS_REF InjCrv_qPiI1ATSCor_X_AXIS /end AXIS_DESCR
 /begin AXIS_DESCR COM_AXIS InjCtl_qSetUnBal InjMassCyc 16 0.00 327.6700 FORMAT "%8.4" EXTENDED_LIMITS -327.6800 327.6700 AXIS_PTS_REF InjCrv_qPiI1ATSCor_Y_AXIS /end AXIS_DESCR
/end CHARACTERISTIC
/begin CHARACTERISTIC InjCrv_qPiI1ATSCorStrt_MAP "correction value for intake air temperature dependent pilot injections quantity correction" MAP 0xDDB44 Kf_Xs16_Ys16_Ws16 10.00000 InjMassInj 0.00 10.00000 FORMAT "%8.5" EXTENDED_LIMITS -327.6800 327.6700
 /begin AXIS_DESCR STD_AXIS Eng_nAvrg EngN 16 0.00 6000.000 FORMAT "%8.3" EXTENDED_LIMITS -32768.00 32767.00 DEPOSIT ABSOLUTE /end AXIS_DESCR
 /begin AXIS_DESCR STD_AXIS InjCtl_qSetUnBal InjMassCyc 16 0.00 327.6700 FORMAT "%8.4" EXTENDED_LIMITS -327.6800 327.6700 DEPOSIT ABSOLUTE /end AXIS_DESCR
/end CHARACTERISTIC
/begin CHARACTERISTIC InjCrv_qPiI1ATSCor_MAP "ansauglufttemperaturabhängiges Mengenkorrekturkennfeld für Voreinspritzung 1" MAP 0xDDD88 Gkf_Ws16 10.00000 InjMassInj 0.00 10.00000 FORMAT "%8.5" EXTENDED_LIMITS -327.6800 327.6700
 /begin AXIS_DESCR COM_AXIS Eng_nAvrg EngN 16 0.00 6000.000 FORMAT "%8.3" EXTENDED_LIMITS -32768.00 32767.00 AXIS_PTS_REF InjCrv_qPiI1ATSCor_X_AXIS /end AXIS_DESCR
 /begin AXIS_DESCR COM_AXIS InjCtl_qSetUnBal InjMassCyc 16 0.00 327.6700 FORMAT "%8.4" EXTENDED_LIMITS -327.6800 327.6700 AXIS_PTS_REF InjCrv_qPiI1ATSCor_Y_AXIS /end AXIS_DESCR
/end CHARACTERISTIC
/begin AXIS_PTS InjCrv_qPiI1ATSCor_X_AXIS "gemeinsame X-Achse für ansauglufttemperaturabhängige Mengenkennfelder für Voreinspritzung 1" 0xDDF88 Eng_nAvrg GSst_Xs16 6000.000 EngN 16 0.00 6000.000 FORMAT "%8.3" EXTENDED_LIMITS -32768.00 32767.00 DEPOSIT ABSOLUTE /end AXIS_PTS
/begin AXIS_PTS InjCrv_qPiI1ATSCor_Y_AXIS "gemeinsame Y-Achse für ansauglufttemperaturabhängige Mengenkennfelder für Voreinspritzung 1" 0xDDFAA InjCtl_qSetUnBal GSst_Xs16 327.6700 InjMassCyc 16 0.00 327.6700 FORMAT "%8.4" EXTENDED_LIMITS -327.6800 327.6700 DEPOSIT ABSOLUTE /end AXIS_PTS
/begin CHARACTERISTIC InjCrv_qPiI1Bas2_MAP "Einspritzmenge PiI1 Grundwertekennfeld 2" MAP 0xDAB6A Gkf_Ws16 10.00000 InjMassInj 0.00 10.00000 FORMAT "%8.5" EXTENDED_LIMITS -327.6800 327.6700
 /begin AXIS_DESCR COM_AXIS Eng_nAvrg EngN 16 0.00 6000.000 FORMAT "%8.3" EXTENDED_LIMITS -32768.00 32767.00 AXIS_PTS_REF InjCrv_qPiI1Bas_X_AXIS /end AXIS_DESCR
 /begin AXIS_DESCR COM_AXIS InjCtl_qSetUnBal InjMassCyc 16 0.00 327.6700 FORMAT "%8.4" EXTENDED_LIMITS -327.6800 327.6700 AXIS_PTS_REF InjCrv_qPiI1Bas_Y_AXIS /end AXIS_DESCR
/end CHARACTERISTIC
/begin CHARACTERISTIC InjCrv_qPiI1BasFDC_MAP "Base map of PiI1 injection quantity for sport mode" MAP 0xDAD6A Gkf_Ws16 10.00000 InjMassInj 0.00 10.00000 FORMAT "%8.5" EXTENDED_LIMITS -327.6800 327.6700
 /begin AXIS_DESCR COM_AXIS Eng_nAvrg EngN 16 0.00 6000.000 FORMAT "%8.3" EXTENDED_LIMITS -32768.00 32767.00 AXIS_PTS_REF InjCrv_qPiI1Bas_X_AXIS /end AXIS_DESCR
 /begin AXIS_DESCR COM_AXIS InjCtl_qSetUnBal InjMassCyc 16 0.00 327.6700 FORMAT "%8.4" EXTENDED_LIMITS -327.6800 327.6700 AXIS_PTS_REF InjCrv_qPiI1Bas_Y_AXIS /end AXIS_DESCR
/end CHARACTERISTIC
/begin CHARACTERISTIC InjCrv_qPiI1BasStrt_MAP "Grundwertkennlinie start" MAP 0xDBCB4 Kf_Xs16_Ys16_Ws16 10.00000 InjMassInj 0.00 10.00000 FORMAT "%8.5" EXTENDED_LIMITS -327.6800 327.6700
 /begin AXIS_DESCR STD_AXIS Eng_nAvrg EngN 16 0.00 6000.000 FORMAT "%8.3" EXTENDED_LIMITS -32768.00 32767.00 DEPOSIT ABSOLUTE /end AXIS_DESCR
 /begin AXIS_DESCR STD_AXIS InjCtl_qSetUnBal InjMassCyc 16 0.00 327.6700 FORMAT "%8.4" EXTENDED_LIMITS -327.6800 327.6700 DEPOSIT ABSOLUTE /end AXIS_DESCR
/end CHARACTERISTIC
/begin CHARACTERISTIC InjCrv_qPiI1Bas_MAP "Einspritzmenge PiI1 Grundwertekennfeld" MAP 0xDAF6A Gkf_Ws16 10.00000 InjMassInj 0.00 10.00000 FORMAT "%8.5" EXTENDED_LIMITS -327.6800 327.6700
 /begin AXIS_DESCR COM_AXIS Eng_nAvrg EngN 16 0.00 6000.000 FORMAT "%8.3" EXTENDED_LIMITS -32768.00 32767.00 AXIS_PTS_REF InjCrv_qPiI1Bas_X_AXIS /end AXIS_DESCR
 /begin AXIS_DESCR COM_AXIS InjCtl_qSetUnBal InjMassCyc 16 0.00 327.6700 FORMAT "%8.4" EXTENDED_LIMITS -327.6800 327.6700 AXIS_PTS_REF InjCrv_qPiI1Bas_Y_AXIS /end AXIS_DESCR
/end CHARACTERISTIC
/begin AXIS_PTS InjCrv_qPiI1Bas_X_AXIS "gemeinsame X-Achse für Einspritzmengengrundwertkennfelder für Voreinspritzung 1" 0xDB16A Eng_nAvrg GSst_Xs16 6000.000 EngN 16 0.00 6000.000 FORMAT "%8.3" EXTENDED_LIMITS -32768.00 32767.00 DEPOSIT ABSOLUTE /end AXIS_PTS
/begin AXIS_PTS InjCrv_qPiI1Bas_Y_AXIS "gemeinsame Y-Achse für Einspritzmengegrundwertkennfelder für Voreinspritzung 1" 0xDB18C InjCtl_qSetUnBal GSst_Xs16 327.6700 InjMassCyc 16 0.00 327.6700 FORMAT "%8.4" EXTENDED_LIMITS -327.6800 327.6700 DEPOSIT ABSOLUTE /end AXIS_PTS
/begin CHARACTERISTIC InjCrv_qPiI1DesAdd_Vector "#SSD Bypass-Label für additiven Bypass von InjCrv_qPiI1Des (Nicht verstellen!)" VALUE 0xC30C8 Kw_Wu8 255.0 OneToOne 0.00 255.0 FORMAT "%5.1" /end CHARACTERISTIC
/begin CHARACTERISTIC InjCrv_qPiI1DesAdd_Channel "#SSD Bypass-Label für additiven Bypass von InjCrv_qPiI1Des (Nicht verstellen!)" VALUE 0xC30C9 Kw_Wu8 255.0 OneToOne 0.00 255.0 FORMAT "%5.1" /end CHARACTERISTIC
/begin CHARACTERISTIC InjCrv_qPiI1Des_Vector "#SSD Bypass-Label für InjCrv_qPiI1Des (Nicht verstellen!)" VALUE 0xC30CA Kw_Wu8 255.0 OneToOne 0.00 255.0 FORMAT "%5.1" /end CHARACTERISTIC
/begin CHARACTERISTIC InjCrv_qPiI1Des_Channel "#SSD Bypass-Label für InjCrv_qPiI1Des (Nicht verstellen!)" VALUE 0xC30CB Kw_Wu8 255.0 OneToOne 0.00 255.0 FORMAT "%5.1" /end CHARACTERISTIC
/begin CHARACTERISTIC InjCrv_qPiI1DynQCor_MAP "Kennfeld für drehzahlabhängige Mengenkorrektur der Voreinspritzung PiI1" MAP 0xDCE84 Kf_Xs16_Ys16_Ws16 327.6700 InjMassInj 0.00 327.6700 FORMAT "%8.4" EXTENDED_LIMITS -327.6800 327.6700
 /begin AXIS_DESCR STD_AXIS Eng_nAvrg EngN 16 0.00 6000.000 FORMAT "%8.3" EXTENDED_LIMITS -32768.00 32767.00 DEPOSIT ABSOLUTE /end AXIS_DESCR
 /begin AXIS_DESCR STD_AXIS InjCtl_qSetUnBal InjMassCyc 8 0.00 327.6700 FORMAT "%8.4" EXTENDED_LIMITS -327.6800 327.6700 DEPOSIT ABSOLUTE /end AXIS_DESCR
/end CHARACTERISTIC
/begin CHARACTERISTIC InjCrv_qPiI1ETSCor12_MAP "motortemperaturabhängiges Mengenkorrekturkennfeld für PiI1 bei aktiver PiI2" MAP 0xDDFCC Gkf_Ws16 10.00000 InjMassInj 0.00 10.00000 FORMAT "%8.5" EXTENDED_LIMITS -327.6800 327.6700
 /begin AXIS_DESCR COM_AXIS Eng_nAvrg EngN 16 0.00 6000.000 FORMAT "%8.3" EXTENDED_LIMITS -32768.00 32767.00 AXIS_PTS_REF InjCrv_qPiI1ETSCor1_X_AXIS /end AXIS_DESCR
 /begin AXIS_DESCR COM_AXIS InjCtl_qSetUnBal InjMassCyc 16 0.00 327.6700 FORMAT "%8.4" EXTENDED_LIMITS -327.6800 327.6700 AXIS_PTS_REF InjCrv_qPiI1ETSCor1_Y_AXIS /end AXIS_DESCR
/end CHARACTERISTIC
/begin CHARACTERISTIC InjCrv_qPiI1ETSCor1_MAP "motortemperaturabhängiges Einspritzmengenkorrekturkennfeld -1 für PiI1 und PiI2" MAP 0xDE1CC Gkf_Ws16 10.00000 InjMassInj 0.00 10.00000 FORMAT "%8.5" EXTENDED_LIMITS -327.6800 327.6700
 /begin AXIS_DESCR COM_AXIS Eng_nAvrg EngN 16 0.00 6000.000 FORMAT "%8.3" EXTENDED_LIMITS -32768.00 32767.00 AXIS_PTS_REF InjCrv_qPiI1ETSCor1_X_AXIS /end AXIS_DESCR
 /begin AXIS_DESCR COM_AXIS InjCtl_qSetUnBal InjMassCyc 16 0.00 327.6700 FORMAT "%8.4" EXTENDED_LIMITS -327.6800 327.6700 AXIS_PTS_REF InjCrv_qPiI1ETSCor1_Y_AXIS /end AXIS_DESCR
/end CHARACTERISTIC
/begin AXIS_PTS InjCrv_qPiI1ETSCor1_X_AXIS "Achsenpunkte der mittleren Drehzahl für die Grundwertkennfelder der Pil1-Einspritzmenge" 0xDE3CC Eng_nAvrg GSst_Xs16 6000.000 EngN 16 0.00 6000.000 FORMAT "%8.3" EXTENDED_LIMITS -32768.00 32767.00 DEPOSIT ABSOLUTE /end AXIS_PTS
/begin AXIS_PTS InjCrv_qPiI1ETSCor1_Y_AXIS "Achsenpunkte der aktuellen Einspritzmenge für die Grundwertkennfelder der Pil1-Einspritzmenge" 0xDE3EE InjCtl_qSetUnBal GSst_Xs16 327.6700 InjMassCyc 16 0.00 327.6700 FORMAT "%8.4" EXTENDED_LIMITS -327.6800 327.6700 DEPOSIT ABSOLUTE /end AXIS_PTS
/begin CHARACTERISTIC InjCrv_qPiI1ETSCor2_MAP "motortemperaturabhängiges Einspritzmengenkorrekturkennfeld -2 für PiI1 und PiI2" MAP 0xDE410 Gkf_Ws16 10.00000 InjMassInj 0.00 10.00000 FORMAT "%8.5" EXTENDED_LIMITS -327.6800 327.6700
 /begin AXIS_DESCR COM_AXIS Eng_nAvrg EngN 16 0.00 6000.000 FORMAT "%8.3" EXTENDED_LIMITS -32768.00 32767.00 AXIS_PTS_REF InjCrv_qPiI1ETSCor_X_AXIS /end AXIS_DESCR
 /begin AXIS_DESCR COM_AXIS InjCtl_qSetUnBal InjMassCyc 16 0.00 327.6700 FORMAT "%8.4" EXTENDED_LIMITS -327.6800 327.6700 AXIS_PTS_REF InjCrv_qPiI1ETSCor_Y_AXIS /end AXIS_DESCR
/end CHARACTERISTIC
/begin CHARACTERISTIC InjCrv_qPiI1ETSCorStrt_MAP "correction value for engine temperature dependent pilot injections quantity correction" MAP 0xDE610 Kf_Xs16_Ys16_Ws16 10.00000 InjMassInj 0.00 10.00000 FORMAT "%8.5" EXTENDED_LIMITS -327.6800 327.6700
 /begin AXIS_DESCR STD_AXIS Eng_nAvrg EngN 16 0.00 6000.000 FORMAT "%8.3" EXTENDED_LIMITS -32768.00 32767.00 DEPOSIT ABSOLUTE /end AXIS_DESCR
 /begin AXIS_DESCR STD_AXIS InjCtl_qSetUnBal InjMassCyc 16 0.00 327.6700 FORMAT "%8.4" EXTENDED_LIMITS -327.6800 327.6700 DEPOSIT ABSOLUTE /end AXIS_DESCR
/end CHARACTERISTIC
/begin CHARACTERISTIC InjCrv_qPiI1ETSCor_MAP "motortemperaturabhängiges Mengenkorrekturkennfeld für Voreinspritzung 1" MAP 0xDE854 Gkf_Ws16 10.00000 InjMassInj 0.00 10.00000 FORMAT "%8.5" EXTENDED_LIMITS -327.6800 327.6700
 /begin AXIS_DESCR COM_AXIS Eng_nAvrg EngN 16 0.00 6000.000 FORMAT "%8.3" EXTENDED_LIMITS -32768.00 32767.00 AXIS_PTS_REF InjCrv_qPiI1ETSCor_X_AXIS /end AXIS_DESCR
 /begin AXIS_DESCR COM_AXIS InjCtl_qSetUnBal InjMassCyc 16 0.00 327.6700 FORMAT "%8.4" EXTENDED_LIMITS -327.6800 327.6700 AXIS_PTS_REF InjCrv_qPiI1ETSCor_Y_AXIS /end AXIS_DESCR
/end CHARACTERISTIC
/begin AXIS_PTS InjCrv_qPiI1ETSCor_X_AXIS "gemeinsame X-Achse für motortemperaturabhängige Mengenkorrekturkennfelder für Voreinspritzung 1" 0xDEA54 Eng_nAvrg GSst_Xs16 6000.000 EngN 16 0.00 6000.000 FORMAT "%8.3" EXTENDED_LIMITS -32768.00 32767.00 DEPOSIT ABSOLUTE /end AXIS_PTS
/begin AXIS_PTS InjCrv_qPiI1ETSCor_Y_AXIS "gemeinsame Y-Achse für motortemperaturabhängige Mengenkorrekturkennfelder für Voreinspritzung 1" 0xDEA76 InjCtl_qSetUnBal GSst_Xs16 327.6700 InjMassCyc 16 0.00 327.6700 FORMAT "%8.4" EXTENDED_LIMITS -327.6800 327.6700 DEPOSIT ABSOLUTE /end AXIS_PTS
/begin CHARACTERISTIC InjCrv_qPiI1Max2_MAP "Einspritzmenge PiI1 Maximalwertekennfeld 2" MAP 0xDB1AE Gkf_Ws16 10.00000 InjMassInj 0.00 10.00000 FORMAT "%8.5" EXTENDED_LIMITS -327.6800 327.6700
 /begin AXIS_DESCR COM_AXIS Eng_nAvrg EngN 8 0.00 6000.000 FORMAT "%8.3" EXTENDED_LIMITS -32768.00 32767.00 AXIS_PTS_REF InjCrv_qPiI1Max_X_AXIS /end AXIS_DESCR
 /begin AXIS_DESCR COM_AXIS InjCtl_qSetUnBal InjMassCyc 16 0.00 327.6700 FORMAT "%8.4" EXTENDED_LIMITS -327.6800 327.6700 AXIS_PTS_REF InjCrv_qPiI1Max_Y_AXIS /end AXIS_DESCR
/end CHARACTERISTIC
/begin CHARACTERISTIC InjCrv_qPiI1Max_MAP "Einspritzmenge PiI1 Maximalwertekennfeld" MAP 0xDB2AE Gkf_Ws16 10.00000 InjMassInj 0.00 10.00000 FORMAT "%8.5" EXTENDED_LIMITS -327.6800 327.6700
 /begin AXIS_DESCR COM_AXIS Eng_nAvrg EngN 8 0.00 6000.000 FORMAT "%8.3" EXTENDED_LIMITS -32768.00 32767.00 AXIS_PTS_REF InjCrv_qPiI1Max_X_AXIS /end AXIS_DESCR
 /begin AXIS_DESCR COM_AXIS InjCtl_qSetUnBal InjMassCyc 16 0.00 327.6700 FORMAT "%8.4" EXTENDED_LIMITS -327.6800 327.6700 AXIS_PTS_REF InjCrv_qPiI1Max_Y_AXIS /end AXIS_DESCR
/end CHARACTERISTIC
/begin AXIS_PTS InjCrv_qPiI1Max_X_AXIS "gemeinsame X-Achse für Einspritzmengenmaximalwertkennfelder für Voreinspritzung 1" 0xDB3AE Eng_nAvrg GSst_Xs16 6000.000 EngN 8 0.00 6000.000 FORMAT "%8.3" EXTENDED_LIMITS -32768.00 32767.00 DEPOSIT ABSOLUTE /end AXIS_PTS
/begin AXIS_PTS InjCrv_qPiI1Max_Y_AXIS "gemeinsame Y-Achse für Einspritzmengenmaximalwertkennfelder für Voreinspritzung 1" 0xDB3C0 InjCtl_qSetUnBal GSst_Xs16 327.6700 InjMassCyc 16 0.00 327.6700 FORMAT "%8.4" EXTENDED_LIMITS -327.6800 327.6700 DEPOSIT ABSOLUTE /end AXIS_PTS
/begin CHARACTERISTIC InjCrv_qPiI1MinDiff_C "Minimalmenge zwischen unteren und oberen Hystheresenschwelle für Voreinspritzung 1" VALUE 0xDB3E2 Kw_Ws16 10.00000 InjMassInj 0.00 10.00000 FORMAT "%8.5" EXTENDED_LIMITS -327.6800 327.6700 /end CHARACTERISTIC
/begin CHARACTERISTIC InjCrv_qPiI1RgnAdd_Vector "Bypass-Label für InjCrv_qPiI1RgnAdd_Vector (Nicht verstellen!)" VALUE 0xC30E2 Kw_Wu8 255.0 OneToOne 0.00 255.0 FORMAT "%5.1" /end CHARACTERISTIC
/begin CHARACTERISTIC InjCrv_qPiI1RgnAdd_Channel "Bypass-Label für InjCrv_qPiI1RgnAdd_Channel (Nicht verstellen!)" VALUE 0xC30E3 Kw_Wu8 255.0 OneToOne 0.00 255.0 FORMAT "%5.1" /end CHARACTERISTIC
/begin CHARACTERISTIC InjCrv_qPiI1Rgn_MAP "Kennfeld für Einspritzmenge PiI1 im Regenerationsbetrieb" MAP 0xDF6CA Kf_Xs16_Ys16_Ws16 10.00000 InjMassInj 0.00 10.00000 FORMAT "%8.5" EXTENDED_LIMITS -327.6800 327.6700
 /begin AXIS_DESCR STD_AXIS Eng_nAvrg EngN 16 0.00 6000.000 FORMAT "%8.3" EXTENDED_LIMITS -32768.00 32767.00 DEPOSIT ABSOLUTE /end AXIS_DESCR
 /begin AXIS_DESCR STD_AXIS InjCtl_qSetUnBal InjMassCyc 16 0.00 327.6700 FORMAT "%8.4" EXTENDED_LIMITS -327.6800 327.6700 DEPOSIT ABSOLUTE /end AXIS_DESCR
/end CHARACTERISTIC
/begin CHARACTERISTIC InjCrv_qPiI1Rgn_Vector "#SSD Bypass-Label, nicht editieren !" VALUE 0xC30E4 Kw_Wu8 255.0 OneToOne 0.00 255.0 FORMAT "%5.1" /end CHARACTERISTIC
/begin CHARACTERISTIC InjCrv_qPiI1Rgn_Channel "#SSD Bypass-Label, nicht editieren !" VALUE 0xC30E5 Kw_Wu8 255.0 OneToOne 0.00 255.0 FORMAT "%5.1" /end CHARACTERISTIC
/begin CHARACTERISTIC InjCrv_qPiI1SetByp_Vector "#SSD Bypass Label, NICHT AENDERN" VALUE 0xC30CC Kw_Wu8 255.0 OneToOne 0.00 255.0 FORMAT "%5.1" /end CHARACTERISTIC
/begin CHARACTERISTIC InjCrv_qPiI1SetByp_Channel "#SSD Bypass Label, NICHT AENDERN" VALUE 0xC30CD Kw_Wu8 255.0 OneToOne 0.00 255.0 FORMAT "%5.1" /end CHARACTERISTIC
/begin CHARACTERISTIC InjCrv_qPiI1WvCorMax_C "Schwelle zur Abschaltung der PiI2 bei Unterschreiten der Mindesteinspritzmenge durch PiI1 bei aktiver Wellenkorrektur" VALUE 0xDBFC6 Kw_Ws16 3.000000 InjMassInj -3.000000 0.00 FORMAT "%8.6" EXTENDED_LIMITS -327.6800 327.6700 /end CHARACTERISTIC
/begin CHARACTERISTIC InjCrv_qPiI2APSCorStrt_MAP "correction value for atmospheric pressure dependent PiI2 quantity correction" MAP 0xDC2B8 Kf_Xs16_Ys16_Ws16 10.00000 InjMassInj 0.00 10.00000 FORMAT "%8.5" EXTENDED_LIMITS -327.6800 327.6700
 /begin AXIS_DESCR STD_AXIS Eng_nAvrg EngN 2 0.00 6000.000 FORMAT "%8.3" EXTENDED_LIMITS -32768.00 32767.00 DEPOSIT ABSOLUTE /end AXIS_DESCR
 /begin AXIS_DESCR STD_AXIS InjCtl_qSetUnBal InjMassCyc 2 0.00 327.6700 FORMAT "%8.4" EXTENDED_LIMITS -327.6800 327.6700 DEPOSIT ABSOLUTE /end AXIS_DESCR
/end CHARACTERISTIC
/begin CHARACTERISTIC InjCrv_qPiI2APSCor_MAP "atmosphärendruckabhängiges Mengenkorrekturkennfeld für Voreinspritzung 2" MAP 0xDC2CC Kf_Xs16_Ys16_Ws16 10.00000 InjMassInj 0.00 10.00000 FORMAT "%8.5" EXTENDED_LIMITS -327.6800 327.6700
 /begin AXIS_DESCR STD_AXIS Eng_nAvrg EngN 16 0.00 6000.000 FORMAT "%8.3" EXTENDED_LIMITS -32768.00 32767.00 DEPOSIT ABSOLUTE /end AXIS_DESCR
 /begin AXIS_DESCR STD_AXIS InjCtl_qSetUnBal InjMassCyc 16 0.00 327.6700 FORMAT "%8.4" EXTENDED_LIMITS -327.6800 327.6700 DEPOSIT ABSOLUTE /end AXIS_DESCR
/end CHARACTERISTIC
/begin CHARACTERISTIC InjCrv_qPiI2ATSCorStrt_MAP "correction value for intake air temperature dependent PiI2 quantity correction" MAP 0xDC510 Kf_Xs16_Ys16_Ws16 10.00000 InjMassInj 0.00 10.00000 FORMAT "%8.5" EXTENDED_LIMITS -327.6800 327.6700
 /begin AXIS_DESCR STD_AXIS Eng_nAvrg EngN 2 0.00 6000.000 FORMAT "%8.3" EXTENDED_LIMITS -32768.00 32767.00 DEPOSIT ABSOLUTE /end AXIS_DESCR
 /begin AXIS_DESCR STD_AXIS InjCtl_qSetUnBal InjMassCyc 2 0.00 327.6700 FORMAT "%8.4" EXTENDED_LIMITS -327.6800 327.6700 DEPOSIT ABSOLUTE /end AXIS_DESCR
/end CHARACTERISTIC
/begin CHARACTERISTIC InjCrv_qPiI2ATSCor_MAP "ansauglufttemperaturabhängiges Mengenkorrekturkennfeld für Voreinspritzung 2" MAP 0xDC524 Kf_Xs16_Ys16_Ws16 10.00000 InjMassInj 0.00 10.00000 FORMAT "%8.5" EXTENDED_LIMITS -327.6800 327.6700
 /begin AXIS_DESCR STD_AXIS Eng_nAvrg EngN 16 0.00 6000.000 FORMAT "%8.3" EXTENDED_LIMITS -32768.00 32767.00 DEPOSIT ABSOLUTE /end AXIS_DESCR
 /begin AXIS_DESCR STD_AXIS InjCtl_qSetUnBal InjMassCyc 16 0.00 327.6700 FORMAT "%8.4" EXTENDED_LIMITS -327.6800 327.6700 DEPOSIT ABSOLUTE /end AXIS_DESCR
/end CHARACTERISTIC
/begin CHARACTERISTIC InjCrv_qPiI2BasStrt_MAP "Einspritzmenge PiI2 Grundwertekennfeld start" MAP 0xDCE28 Kf_Xs16_Ys16_Ws16 10.00000 InjMassInj 0.00 10.00000 FORMAT "%8.5" EXTENDED_LIMITS -327.6800 327.6700
 /begin AXIS_DESCR STD_AXIS Eng_nAvrg EngN 2 0.00 6000.000 FORMAT "%8.3" EXTENDED_LIMITS -32768.00 32767.00 DEPOSIT ABSOLUTE /end AXIS_DESCR
 /begin AXIS_DESCR STD_AXIS InjCtl_qSetUnBal InjMassCyc 2 0.00 327.6700 FORMAT "%8.4" EXTENDED_LIMITS -327.6800 327.6700 DEPOSIT ABSOLUTE /end AXIS_DESCR
/end CHARACTERISTIC
/begin CHARACTERISTIC InjCrv_qPiI2Bas_MAP "Einspritzmenge PiI2 Grundwertekennfeld" MAP 0xDBFC8 Kf_Xs16_Ys16_Ws16 10.00000 InjMassInj 0.00 10.00000 FORMAT "%8.5" EXTENDED_LIMITS -327.6800 327.6700
 /begin AXIS_DESCR STD_AXIS Eng_nAvrg EngN 16 0.00 6000.000 FORMAT "%8.3" EXTENDED_LIMITS -32768.00 32767.00 DEPOSIT ABSOLUTE /end AXIS_DESCR
 /begin AXIS_DESCR STD_AXIS InjCtl_qSetUnBal InjMassCyc 16 0.00 327.6700 FORMAT "%8.4" EXTENDED_LIMITS -327.6800 327.6700 DEPOSIT ABSOLUTE /end AXIS_DESCR
/end CHARACTERISTIC
/begin CHARACTERISTIC InjCrv_qPiI2DesAdd_Vector "#SSD Bypass-Label für additiven Bypass von InjCrv_qPiI2Des (Nicht verstellen!)" VALUE 0xC30CE Kw_Wu8 255.0 OneToOne 0.00 255.0 FORMAT "%5.1" /end CHARACTERISTIC
/begin CHARACTERISTIC InjCrv_qPiI2DesAdd_Channel "#SSD Bypass-Label für additiven Bypass von InjCrv_qPiI2Des (Nicht verstellen!)" VALUE 0xC30CF Kw_Wu8 255.0 OneToOne 0.00 255.0 FORMAT "%5.1" /end CHARACTERISTIC
/begin CHARACTERISTIC InjCrv_qPiI2Des_Vector "#SSD Bypass-Label für InjCrv_qPiI2Des (Nicht verstellen!)" VALUE 0xC30D0 Kw_Wu8 255.0 OneToOne 0.00 255.0 FORMAT "%5.1" /end CHARACTERISTIC
/begin CHARACTERISTIC InjCrv_qPiI2Des_Channel "#SSD Bypass-Label für InjCrv_qPiI2Des (Nicht verstellen!)" VALUE 0xC30D1 Kw_Wu8 255.0 OneToOne 0.00 255.0 FORMAT "%5.1" /end CHARACTERISTIC
/begin CHARACTERISTIC InjCrv_qPiI2ETSCorStrt_MAP "correction value for engine temperature dependent PiI2 quantity correction" MAP 0xDC768 Kf_Xs16_Ys16_Ws16 10.00000 InjMassInj 0.00 10.00000 FORMAT "%8.5" EXTENDED_LIMITS -327.6800 327.6700
 /begin AXIS_DESCR STD_AXIS Eng_nAvrg EngN 2 0.00 6000.000 FORMAT "%8.3" EXTENDED_LIMITS -32768.00 32767.00 DEPOSIT ABSOLUTE /end AXIS_DESCR
 /begin AXIS_DESCR STD_AXIS InjCtl_qSetUnBal InjMassCyc 2 0.00 327.6700 FORMAT "%8.4" EXTENDED_LIMITS -327.6800 327.6700 DEPOSIT ABSOLUTE /end AXIS_DESCR
/end CHARACTERISTIC
/begin CHARACTERISTIC InjCrv_qPiI2ETSCor_MAP "motortemperaturabhängiges Mengenkorrekturkennfeld für Voreinspritzung 2" MAP 0xDC77C Kf_Xs16_Ys16_Ws16 10.00000 InjMassInj 0.00 10.00000 FORMAT "%8.5" EXTENDED_LIMITS -327.6800 327.6700
 /begin AXIS_DESCR STD_AXIS Eng_nAvrg EngN 16 0.00 6000.000 FORMAT "%8.3" EXTENDED_LIMITS -32768.00 32767.00 DEPOSIT ABSOLUTE /end AXIS_DESCR
 /begin AXIS_DESCR STD_AXIS InjCtl_qSetUnBal InjMassCyc 16 0.00 327.6700 FORMAT "%8.4" EXTENDED_LIMITS -327.6800 327.6700 DEPOSIT ABSOLUTE /end AXIS_DESCR
/end CHARACTERISTIC
/begin CHARACTERISTIC InjCrv_qPiI2Max_MAP "Einspritzmenge PiI2 Maximalwertekennfeld" MAP 0xDC20C Kf_Xs16_Ys16_Ws16 10.00000 InjMassInj 0.00 10.00000 FORMAT "%8.5" EXTENDED_LIMITS -327.6800 327.6700
 /begin AXIS_DESCR STD_AXIS Eng_nAvrg EngN 8 0.00 6000.000 FORMAT "%8.3" EXTENDED_LIMITS -32768.00 32767.00 DEPOSIT ABSOLUTE /end AXIS_DESCR
 /begin AXIS_DESCR STD_AXIS InjCtl_qSetUnBal InjMassCyc 8 0.00 327.6700 FORMAT "%8.4" EXTENDED_LIMITS -327.6800 327.6700 DEPOSIT ABSOLUTE /end AXIS_DESCR
/end CHARACTERISTIC
/begin CHARACTERISTIC InjCrv_qPiI2MinDiff_C "Minimalmenge zwischen unteren und oberen Hystheresenschwelle für Voreinspritzung 2" VALUE 0xDC2B0 Kw_Ws16 10.00000 InjMassInj 0.00 10.00000 FORMAT "%8.5" EXTENDED_LIMITS -327.6800 327.6700 /end CHARACTERISTIC
/begin CHARACTERISTIC InjCrv_qPiI2RgnAdd_Vector "Konfigurationslabel für Beipass" VALUE 0xC30B4 Kw_Wu8 255.0 OneToOne 0.00 255.0 FORMAT "%5.1" /end CHARACTERISTIC
/begin CHARACTERISTIC InjCrv_qPiI2RgnAdd_Channel "Konfigurationslabel für Beipass" VALUE 0xC30B5 Kw_Wu8 255.0 OneToOne 0.00 255.0 FORMAT "%5.1" /end CHARACTERISTIC
/begin CHARACTERISTIC InjCrv_qPiI2Rgn_Vector "#SSD Bypass-Label, nicht editieren !" VALUE 0xC30B6 Kw_Wu8 255.0 OneToOne 0.00 255.0 FORMAT "%5.1" /end CHARACTERISTIC
/begin CHARACTERISTIC InjCrv_qPiI2Rgn_Channel "#SSD Bypass-Label, nicht editieren !" VALUE 0xC30B7 Kw_Wu8 255.0 OneToOne 0.00 255.0 FORMAT "%5.1" /end CHARACTERISTIC
/begin CHARACTERISTIC InjCrv_qPiI2SetByp_Vector "#SSD Bypass Label, NICHT AENDERN" VALUE 0xC30AE Kw_Wu8 255.0 OneToOne 0.00 255.0 FORMAT "%5.1" /end CHARACTERISTIC
/begin CHARACTERISTIC InjCrv_qPiI2SetByp_Channel "#SSD Bypass Label, NICHT AENDERN" VALUE 0xC30AF Kw_Wu8 255.0 OneToOne 0.00 255.0 FORMAT "%5.1" /end CHARACTERISTIC
/begin CHARACTERISTIC InjCrv_qPiI3DesAdd_Vector "#SSD Bypass-Label für additiven Bypass von InjCrv_qPiI3Des (Nicht verstellen!)" VALUE 0xC30D2 Kw_Wu8 255.0 OneToOne 0.00 255.0 FORMAT "%5.1" /end CHARACTERISTIC
/begin CHARACTERISTIC InjCrv_qPiI3DesAdd_Channel "#SSD Bypass-Label für additiven Bypass von InjCrv_qPiI3Des (Nicht verstellen!)" VALUE 0xC30D3 Kw_Wu8 255.0 OneToOne 0.00 255.0 FORMAT "%5.1" /end CHARACTERISTIC
/begin CHARACTERISTIC InjCrv_qPiI3Des_Vector "#SSD Bypass-Label für InjCrv_qPiI3Des (Nicht verstellen!)" VALUE 0xC30D4 Kw_Wu8 255.0 OneToOne 0.00 255.0 FORMAT "%5.1" /end CHARACTERISTIC
/begin CHARACTERISTIC InjCrv_qPiI3Des_Channel "#SSD Bypass-Label für InjCrv_qPiI3Des (Nicht verstellen!)" VALUE 0xC30D5 Kw_Wu8 255.0 OneToOne 0.00 255.0 FORMAT "%5.1" /end CHARACTERISTIC
/begin CHARACTERISTIC InjCrv_qPoI1APSCor_MAP "atmospärendruckabhängiges Mengenkorrekturkennfeld für PoI1" MAP 0xDFC3A Kf_Xs16_Ys16_Ws16 10.00000 InjMassInj 0.00 10.00000 FORMAT "%8.5" EXTENDED_LIMITS -327.6800 327.6700
 /begin AXIS_DESCR STD_AXIS Eng_nAvrg EngN 2 0.00 6000.000 FORMAT "%8.3" EXTENDED_LIMITS -32768.00 32767.00 DEPOSIT ABSOLUTE /end AXIS_DESCR
 /begin AXIS_DESCR STD_AXIS InjCtl_qSetUnBal InjMassCyc 2 0.00 327.6700 FORMAT "%8.4" EXTENDED_LIMITS -327.6800 327.6700 DEPOSIT ABSOLUTE /end AXIS_DESCR
/end CHARACTERISTIC
/begin CHARACTERISTIC InjCrv_qPoI1Bas_MAP "Grundwert der Einspritzmenge PoI1" MAP 0xDFBAA Kf_Xs16_Ys16_Ws16 10.00000 InjMassInj 0.00 10.00000 FORMAT "%8.5" EXTENDED_LIMITS -327.6800 327.6700
 /begin AXIS_DESCR STD_AXIS Eng_nAvrg EngN 2 0.00 6000.000 FORMAT "%8.3" EXTENDED_LIMITS -32768.00 32767.00 DEPOSIT ABSOLUTE /end AXIS_DESCR
 /begin AXIS_DESCR STD_AXIS InjCtl_qSetUnBal InjMassCyc 2 0.00 327.6700 FORMAT "%8.4" EXTENDED_LIMITS -327.6800 327.6700 DEPOSIT ABSOLUTE /end AXIS_DESCR
/end CHARACTERISTIC
/begin CHARACTERISTIC InjCrv_qPoI1DesAdd_Vector "#SSD Bypass-Label für additiven Bypass von InjCrv_qPoI1Des (Nicht verstellen!)" VALUE 0xC30EE Kw_Wu8 255.0 OneToOne 0.00 255.0 FORMAT "%5.1" /end CHARACTERISTIC
/begin CHARACTERISTIC InjCrv_qPoI1DesAdd_Channel "#SSD Bypass-Label für additiven Bypass von InjCrv_qPoI1Des (Nicht verstellen!)" VALUE 0xC30EF Kw_Wu8 255.0 OneToOne 0.00 255.0 FORMAT "%5.1" /end CHARACTERISTIC
/begin CHARACTERISTIC InjCrv_qPoI1Des_Vector "#SSD Bypass-Label für InjCrv_qPoI1Des (Nicht verstellen!)" VALUE 0xC30F0 Kw_Wu8 255.0 OneToOne 0.00 255.0 FORMAT "%5.1" /end CHARACTERISTIC
/begin CHARACTERISTIC InjCrv_qPoI1Des_Channel "#SSD Bypass-Label für InjCrv_qPoI1Des (Nicht verstellen!)" VALUE 0xC30F1 Kw_Wu8 255.0 OneToOne 0.00 255.0 FORMAT "%5.1" /end CHARACTERISTIC
/begin CHARACTERISTIC InjCrv_qPoI1ETSCor_MAP "motortemperaturabhängiges Mengenkorrekturkennfeld für PoI1" MAP 0xDFC4E Kf_Xs16_Ys16_Ws16 10.00000 InjMassInj 0.00 10.00000 FORMAT "%8.5" EXTENDED_LIMITS -327.6800 327.6700
 /begin AXIS_DESCR STD_AXIS Eng_nAvrg EngN 2 0.00 6000.000 FORMAT "%8.3" EXTENDED_LIMITS -32768.00 32767.00 DEPOSIT ABSOLUTE /end AXIS_DESCR
 /begin AXIS_DESCR STD_AXIS InjCtl_qSetUnBal InjMassCyc 2 0.00 327.6700 FORMAT "%8.4" EXTENDED_LIMITS -327.6800 327.6700 DEPOSIT ABSOLUTE /end AXIS_DESCR
/end CHARACTERISTIC
/begin CHARACTERISTIC InjCrv_qPoI1Max_MAP "Maximalwert der Einspritzmenge PoI1" MAP 0xDFBBE Kf_Xs16_Ys16_Ws16 10.00000 InjMassInj 0.00 10.00000 FORMAT "%8.5" EXTENDED_LIMITS -327.6800 327.6700
 /begin AXIS_DESCR STD_AXIS Eng_nAvrg EngN 6 0.00 6000.000 FORMAT "%8.3" EXTENDED_LIMITS -32768.00 32767.00 DEPOSIT ABSOLUTE /end AXIS_DESCR
 /begin AXIS_DESCR STD_AXIS InjCtl_qSetUnBal InjMassCyc 6 0.00 327.6700 FORMAT "%8.4" EXTENDED_LIMITS -327.6800 327.6700 DEPOSIT ABSOLUTE /end AXIS_DESCR
/end CHARACTERISTIC
/begin CHARACTERISTIC InjCrv_qPoI1Rgn1_MAP "map for value for regeneration of quantity PoI1" MAP 0xDFF36 Kf_Xs16_Ys16_Ws16 10.00000 InjMassInj 0.00 10.00000 FORMAT "%8.5" EXTENDED_LIMITS -327.6800 327.6700
 /begin AXIS_DESCR STD_AXIS Eng_nAvrg EngN 12 0.00 6000.000 FORMAT "%8.3" EXTENDED_LIMITS -32768.00 32767.00 DEPOSIT ABSOLUTE /end AXIS_DESCR
 /begin AXIS_DESCR STD_AXIS InjCtl_qSetUnBal InjMassCyc 12 0.00 327.6700 FORMAT "%8.4" EXTENDED_LIMITS -327.6800 327.6700 DEPOSIT ABSOLUTE /end AXIS_DESCR
/end CHARACTERISTIC
/begin CHARACTERISTIC InjCrv_qPoI1Rgn2_MAP "map for value for regeneration of quantity PoI1" MAP 0xE008A Kf_Xs16_Ys16_Ws16 10.00000 InjMassInj 0.00 10.00000 FORMAT "%8.5" EXTENDED_LIMITS -327.6800 327.6700
 /begin AXIS_DESCR STD_AXIS Eng_nAvrg EngN 12 0.00 6000.000 FORMAT "%8.3" EXTENDED_LIMITS -32768.00 32767.00 DEPOSIT ABSOLUTE /end AXIS_DESCR
 /begin AXIS_DESCR STD_AXIS InjCtl_qSetUnBal InjMassCyc 12 0.00 327.6700 FORMAT "%8.4" EXTENDED_LIMITS -327.6800 327.6700 DEPOSIT ABSOLUTE /end AXIS_DESCR
/end CHARACTERISTIC
/begin CHARACTERISTIC InjCrv_qPoI1RgnAdd_Vector "Konfigurationslabel für Bypass Freischnitt" VALUE 0xC30F6 Kw_Wu8 255.0 OneToOne 0.00 255.0 FORMAT "%5.1" /end CHARACTERISTIC
/begin CHARACTERISTIC InjCrv_qPoI1RgnAdd_Channel "Konfigurationslabel für Bypass Freischnitt" VALUE 0xC30F7 Kw_Wu8 255.0 OneToOne 0.00 255.0 FORMAT "%5.1" /end CHARACTERISTIC
/begin CHARACTERISTIC InjCrv_qPoI1Rgn_Vector "#SSD Bypass-Label, nicht editieren !" VALUE 0xC30F8 Kw_Wu8 255.0 OneToOne 0.00 255.0 FORMAT "%5.1" /end CHARACTERISTIC
/begin CHARACTERISTIC InjCrv_qPoI1Rgn_Channel "#SSD Bypass-Label, nicht editieren !" VALUE 0xC30F9 Kw_Wu8 255.0 OneToOne 0.00 255.0 FORMAT "%5.1" /end CHARACTERISTIC
/begin CHARACTERISTIC InjCrv_qPoI1SetLim_C "Minimum fuel quantity to enable PoI1" VALUE 0xDFC22 Kw_Ws16 327.6700 InjMassInj 0.00 327.6700 FORMAT "%8.4" EXTENDED_LIMITS -327.6800 327.6700 /end CHARACTERISTIC
/begin CHARACTERISTIC InjCrv_qPoI2ATSCor_MAP "ansauglufttemperaturabhängiges Mengenkorrekturkennfeld für PoI2" MAP 0xE02B4 Kf_Xs16_Ys16_Ws16 10.00000 InjMassInj 0.00 10.00000 FORMAT "%8.5" EXTENDED_LIMITS -327.6800 327.6700
 /begin AXIS_DESCR STD_AXIS Eng_nAvrg EngN 6 0.00 6000.000 FORMAT "%8.3" EXTENDED_LIMITS -32768.00 32767.00 DEPOSIT ABSOLUTE /end AXIS_DESCR
 /begin AXIS_DESCR STD_AXIS InjCtl_qSetUnBal InjMassCyc 6 0.00 327.6700 FORMAT "%8.4" EXTENDED_LIMITS -327.6800 327.6700 DEPOSIT ABSOLUTE /end AXIS_DESCR
/end CHARACTERISTIC
/begin CHARACTERISTIC InjCrv_qPoI2Bas_MAP "Einspritzmenge PoI2 Grundwert" MAP 0xE0932 Kf_Xs16_Ys16_Ws16 10.00000 InjMassInj 0.00 10.00000 FORMAT "%8.5" EXTENDED_LIMITS -327.6800 327.6700
 /begin AXIS_DESCR STD_AXIS Eng_nAvrg EngN 16 0.00 6000.000 FORMAT "%8.3" EXTENDED_LIMITS -32768.00 32767.00 DEPOSIT ABSOLUTE /end AXIS_DESCR
 /begin AXIS_DESCR STD_AXIS InjCtl_qSetUnBal InjMassCyc 16 0.00 327.6700 FORMAT "%8.4" EXTENDED_LIMITS -327.6800 327.6700 DEPOSIT ABSOLUTE /end AXIS_DESCR
/end CHARACTERISTIC
/begin CHARACTERISTIC InjCrv_qPoI2ETSCor_MAP "motortemperaturabhängiges Mengenkorrekturkennfeld für PoI2" MAP 0xE0318 Kf_Xs16_Ys16_Ws16 10.00000 InjMassInj 0.00 10.00000 FORMAT "%8.5" EXTENDED_LIMITS -327.6800 327.6700
 /begin AXIS_DESCR STD_AXIS Eng_nAvrg EngN 7 0.00 6000.000 FORMAT "%8.3" EXTENDED_LIMITS -32768.00 32767.00 DEPOSIT ABSOLUTE /end AXIS_DESCR
 /begin AXIS_DESCR STD_AXIS InjCtl_qSetUnBal InjMassCyc 6 0.00 327.6700 FORMAT "%8.4" EXTENDED_LIMITS -327.6800 327.6700 DEPOSIT ABSOLUTE /end AXIS_DESCR
/end CHARACTERISTIC
/begin CHARACTERISTIC InjCrv_qPoI2Rgn1_MAP "regeneration1 map of PoI2 injection quantity" MAP 0xE0CEC Kf_Xs16_Ys16_Ws16 10.00000 InjMassInj 0.00 10.00000 FORMAT "%8.5" EXTENDED_LIMITS -327.6800 327.6700
 /begin AXIS_DESCR STD_AXIS Eng_nAvrg EngN 16 0.00 6000.000 FORMAT "%8.3" EXTENDED_LIMITS -32768.00 32767.00 DEPOSIT ABSOLUTE /end AXIS_DESCR
 /begin AXIS_DESCR STD_AXIS InjCtl_qSetUnBal InjMassCyc 16 0.00 327.6700 FORMAT "%8.4" EXTENDED_LIMITS -327.6800 327.6700 DEPOSIT ABSOLUTE /end AXIS_DESCR
/end CHARACTERISTIC
/begin CHARACTERISTIC InjCrv_qPoI2Rgn2_MAP "regeneration2 map of PoI2 injection quantity" MAP 0xE0F30 Kf_Xs16_Ys16_Ws16 10.00000 InjMassInj 0.00 10.00000 FORMAT "%8.5" EXTENDED_LIMITS -327.6800 327.6700
 /begin AXIS_DESCR STD_AXIS Eng_nAvrg EngN 16 0.00 6000.000 FORMAT "%8.3" EXTENDED_LIMITS -32768.00 32767.00 DEPOSIT ABSOLUTE /end AXIS_DESCR
 /begin AXIS_DESCR STD_AXIS InjCtl_qSetUnBal InjMassCyc 16 0.00 327.6700 FORMAT "%8.4" EXTENDED_LIMITS -327.6800 327.6700 DEPOSIT ABSOLUTE /end AXIS_DESCR
/end CHARACTERISTIC
/begin CHARACTERISTIC InjCrv_qPoI2RgnCor_MAP "regeneration map of PoI2 injection quantity correction" MAP 0xE05E2 Kf_Xs16_Ys16_Ws16 10.00000 InjMassInj 0.00 10.00000 FORMAT "%8.5" EXTENDED_LIMITS -327.6800 327.6700
 /begin AXIS_DESCR STD_AXIS Eng_nAvrg EngN 2 0.00 6000.000 FORMAT "%8.3" EXTENDED_LIMITS -32768.00 32767.00 DEPOSIT ABSOLUTE /end AXIS_DESCR
 /begin AXIS_DESCR STD_AXIS InjCtl_qSetUnBal InjMassCyc 2 0.00 327.6700 FORMAT "%8.4" EXTENDED_LIMITS -327.6800 327.6700 DEPOSIT ABSOLUTE /end AXIS_DESCR
/end CHARACTERISTIC
/begin CHARACTERISTIC InjCrv_qPoI2SetLim_C "Threshold injection quantity" VALUE 0xE0B76 Kw_Ws16 327.6700 InjMassInj 0.00 327.6700 FORMAT "%8.4" EXTENDED_LIMITS -327.6800 327.6700 /end CHARACTERISTIC
/begin CHARACTERISTIC InjCrv_stMI1RgnMsk_C "Maske für Aktivierung  der Regeneration über MI1" VALUE 0xDA8FC Kw_Wu32 4294967295.00 OneToOne 0.00 4294967295.00 FORMAT "%13.2" /end CHARACTERISTIC
/begin CHARACTERISTIC InjCrv_stPiI1RgnDelMsk_C "Maske für die Deaktivierung der PiI1 Grundwerteberechnung im Regenerationsbetrieb" VALUE 0xDB3E4 Kw_Wu32 4294967295.00 OneToOne 0.00 4294967295.00 FORMAT "%13.2" /end CHARACTERISTIC
/begin CHARACTERISTIC InjCrv_stPiI1RgnMsk_C "Maske zur Aktivierung  der Regeneration über PiI1" VALUE 0xDFB5C Kw_Wu32 4294967295.00 OneToOne 0.00 4294967295.00 FORMAT "%13.2" /end CHARACTERISTIC
/begin CHARACTERISTIC InjCrv_stPiI2RgnDelMsk_C "Maske für die Deaktivierung der PiI2 Grundwerteberechnung im Regenerationsbetrieb" VALUE 0xDC2B4 Kw_Wu32 4294967295.00 OneToOne 0.00 4294967295.00 FORMAT "%13.2" /end CHARACTERISTIC
/begin CHARACTERISTIC InjCrv_stPiI2RgnMsk_C "Maske zur Aktivierung  der Regeneration über PiI2" VALUE 0xDCD30 Kw_Wu32 4294967295.00 OneToOne 0.00 4294967295.00 FORMAT "%13.2" /end CHARACTERISTIC
/begin CHARACTERISTIC InjCrv_stPoI1RgnMsk_C "Bitmaske für Aktivierung  des Regenerationsmodes PoI1" VALUE 0xE01F0 Kw_Wu32 4294967295.00 OneToOne 0.00 4294967295.00 FORMAT "%13.2" /end CHARACTERISTIC
/begin CHARACTERISTIC InjCrv_stPoI1RgnTypeMsk_C "Bitmask to activate switching to regeneration mode" VALUE 0xE01F4 Kw_Wu32 4294967295.00 OneToOne 0.00 4294967295.00 FORMAT "%13.2" /end CHARACTERISTIC
/begin CHARACTERISTIC InjCrv_stPoI2RgnDelMsk_C "Maske für die Deaktivierung der PoI2 Grundwerteberechnung im Regenerationsbetrieb" VALUE 0xE0B78 Kw_Wu32 4294967295.00 OneToOne 0.00 4294967295.00 FORMAT "%13.2" /end CHARACTERISTIC
/begin CHARACTERISTIC InjCrv_swtPoI1Clsn_C "Bit0: 1=Kollisionserkennung ein, 0=aus; Bit1:1=PoI1 aus, 0=aus bei Kollision; Bit2:1=Verteile fehlende mänge auf zylinder, 0=aus" VALUE 0xDFC24 Kw_Wu8 255.0 OneToOne 0.00 255.0 FORMAT "%5.1" /end CHARACTERISTIC
/begin CHARACTERISTIC InjCrv_tiMI1Rgn_MAP "base map of MI1 SOE time-component calculation" MAP 0xDA8E0 Kf_Xs16_Ys16_Ws16 13000.00 InjTime_us 0.00 13000.00 FORMAT "%8.2" EXTENDED_LIMITS -32768.00 32767.00
 /begin AXIS_DESCR STD_AXIS Eng_nAvrg EngN 2 0.00 6000.000 FORMAT "%8.3" EXTENDED_LIMITS -32768.00 32767.00 DEPOSIT ABSOLUTE /end AXIS_DESCR
 /begin AXIS_DESCR STD_AXIS InjCtl_qSetUnBal InjMassCyc 2 0.00 327.6700 FORMAT "%8.4" EXTENDED_LIMITS -327.6800 327.6700 DEPOSIT ABSOLUTE /end AXIS_DESCR
/end CHARACTERISTIC
/begin CHARACTERISTIC InjCrv_tiPiI1ATSCor_MAP "Kennfeld für drehzahl- und einrpritzmengenabhängige Zeitkorrektur für die PiI1" MAP 0xDD188 Kf_Xs16_Ys16_Ws16 26000.00 InjTime_us -13000.00 13000.00 FORMAT "%8.2" EXTENDED_LIMITS -32768.00 32767.00
 /begin AXIS_DESCR STD_AXIS Eng_nAvrg EngN 16 0.00 6000.000 FORMAT "%8.3" EXTENDED_LIMITS -32768.00 32767.00 DEPOSIT ABSOLUTE /end AXIS_DESCR
 /begin AXIS_DESCR STD_AXIS InjCtl_qSetUnBal InjMassCyc 8 0.00 327.6700 FORMAT "%8.4" EXTENDED_LIMITS -327.6800 327.6700 DEPOSIT ABSOLUTE /end AXIS_DESCR
/end CHARACTERISTIC
/begin CHARACTERISTIC InjCrv_tiPiI1Bas1FDC_MAP " base map of PiI1 SOE time calculation, if PiI2 is inactive for sport mode" MAP 0xDB5D4 Kf_Xs16_Ys16_Ws16 13000.00 InjTime_us 0.00 13000.00 FORMAT "%8.2" EXTENDED_LIMITS -32768.00 32767.00
 /begin AXIS_DESCR STD_AXIS Eng_nAvrg EngN 16 0.00 6000.000 FORMAT "%8.3" EXTENDED_LIMITS -32768.00 32767.00 DEPOSIT ABSOLUTE /end AXIS_DESCR
 /begin AXIS_DESCR STD_AXIS InjCtl_qSetUnBal InjMassCyc 16 0.00 327.6700 FORMAT "%8.4" EXTENDED_LIMITS -327.6800 327.6700 DEPOSIT ABSOLUTE /end AXIS_DESCR
/end CHARACTERISTIC
/begin CHARACTERISTIC InjCrv_tiPiI1Bas1_MAP "Zeitkomponente Ansteuerbeginn Grundwertekennfeld PiI1 ohne Freigabe PiI2" MAP 0xDB818 Kf_Xs16_Ys16_Ws16 13000.00 InjTime_us 0.00 13000.00 FORMAT "%8.2" EXTENDED_LIMITS -32768.00 32767.00
 /begin AXIS_DESCR STD_AXIS Eng_nAvrg EngN 16 0.00 6000.000 FORMAT "%8.3" EXTENDED_LIMITS -32768.00 32767.00 DEPOSIT ABSOLUTE /end AXIS_DESCR
 /begin AXIS_DESCR STD_AXIS InjCtl_qSetUnBal InjMassCyc 16 0.00 327.6700 FORMAT "%8.4" EXTENDED_LIMITS -327.6800 327.6700 DEPOSIT ABSOLUTE /end AXIS_DESCR
/end CHARACTERISTIC
/begin CHARACTERISTIC InjCrv_tiPiI1Bas2_MAP "Zeitkomponente Ansteuerbeginn Grundwertekennfeld PiI1 mit freigabe PiI2" MAP 0xDBA5C Kf_Xs16_Ys16_Ws16 13000.00 InjTime_us 0.00 13000.00 FORMAT "%8.2" EXTENDED_LIMITS -32768.00 32767.00
 /begin AXIS_DESCR STD_AXIS Eng_nAvrg EngN 16 0.00 6000.000 FORMAT "%8.3" EXTENDED_LIMITS -32768.00 32767.00 DEPOSIT ABSOLUTE /end AXIS_DESCR
 /begin AXIS_DESCR STD_AXIS InjCtl_qSetUnBal InjMassCyc 16 0.00 327.6700 FORMAT "%8.4" EXTENDED_LIMITS -327.6800 327.6700 DEPOSIT ABSOLUTE /end AXIS_DESCR
/end CHARACTERISTIC
/begin CHARACTERISTIC InjCrv_tiPiI1Bas3_MAP "Zeitkomponente Ansteuerbeginn Grundwertekennfeld PiI1 mit Freigabe PiI3" MAP 0xDBCA0 Kf_Xs16_Ys16_Ws16 13000.00 InjTime_us 0.00 13000.00 FORMAT "%8.2" EXTENDED_LIMITS -32768.00 32767.00
 /begin AXIS_DESCR STD_AXIS Eng_nAvrg EngN 2 0.00 6000.000 FORMAT "%8.3" EXTENDED_LIMITS -32768.00 32767.00 DEPOSIT ABSOLUTE /end AXIS_DESCR
 /begin AXIS_DESCR STD_AXIS InjCtl_qSetUnBal InjMassCyc 2 0.00 327.6700 FORMAT "%8.4" EXTENDED_LIMITS -327.6800 327.6700 DEPOSIT ABSOLUTE /end AXIS_DESCR
/end CHARACTERISTIC
/begin CHARACTERISTIC InjCrv_tiPiI1BasStrt_MAP "base map of PiI1 SOE time calculation, if PiI3 is active" MAP 0xDBEF8 Kf_Xs16_Ys16_Ws16 13000.00 InjTime_us 0.00 13000.00 FORMAT "%8.2" EXTENDED_LIMITS -32768.00 32767.00
 /begin AXIS_DESCR STD_AXIS Eng_nAvrg EngN 8 0.00 6000.000 FORMAT "%8.3" EXTENDED_LIMITS -32768.00 32767.00 DEPOSIT ABSOLUTE /end AXIS_DESCR
 /begin AXIS_DESCR STD_AXIS InjCtl_qSetUnBal InjMassCyc 8 0.00 327.6700 FORMAT "%8.4" EXTENDED_LIMITS -327.6800 327.6700 DEPOSIT ABSOLUTE /end AXIS_DESCR
/end CHARACTERISTIC
/begin CHARACTERISTIC InjCrv_tiPiI1DesAdd_Vector "#SSD Bypass-Label für additiven Bypass von InjCrv_tiPiI1Des (Nicht verstellen!)" VALUE 0xC30D6 Kw_Wu8 255.0 OneToOne 0.00 255.0 FORMAT "%5.1" /end CHARACTERISTIC
/begin CHARACTERISTIC InjCrv_tiPiI1DesAdd_Channel "#SSD Bypass-Label für additiven Bypass von InjCrv_tiPiI1Des (Nicht verstellen!)" VALUE 0xC30D7 Kw_Wu8 255.0 OneToOne 0.00 255.0 FORMAT "%5.1" /end CHARACTERISTIC
/begin CHARACTERISTIC InjCrv_tiPiI1Des_Vector "#SSD Bypass-Label für InjCrv_tiPiI1Des (Nicht verstellen!)" VALUE 0xC30D8 Kw_Wu8 255.0 OneToOne 0.00 255.0 FORMAT "%5.1" /end CHARACTERISTIC
/begin CHARACTERISTIC InjCrv_tiPiI1Des_Channel "#SSD Bypass-Label für InjCrv_tiPiI1Des (Nicht verstellen!)" VALUE 0xC30D9 Kw_Wu8 255.0 OneToOne 0.00 255.0 FORMAT "%5.1" /end CHARACTERISTIC
/begin CHARACTERISTIC InjCrv_tiPiI1DynCor_MAP "base correction map of pilot injection angle correction" MAP 0xDCFB8 Kf_Xs16_Ys16_Ws16 26000.00 InjTime_us -13000.00 13000.00 FORMAT "%8.2" EXTENDED_LIMITS -32768.00 32767.00
 /begin AXIS_DESCR STD_AXIS Eng_nAvrg EngN 16 0.00 6000.000 FORMAT "%8.3" EXTENDED_LIMITS -32768.00 32767.00 DEPOSIT ABSOLUTE /end AXIS_DESCR
 /begin AXIS_DESCR STD_AXIS InjCtl_qSetUnBal InjMassCyc 8 0.00 327.6700 FORMAT "%8.4" EXTENDED_LIMITS -327.6800 327.6700 DEPOSIT ABSOLUTE /end AXIS_DESCR
/end CHARACTERISTIC
/begin CHARACTERISTIC InjCrv_tiPiI1ETSCor12_MAP "motortemperaturabhängiges Korrekturgrundwertekennfeld für die Zeitkomponente des Ansteuerbeginns der PiI1bei aktiver PiI2" MAP 0xDECB2 Kf_Xs16_Ys16_Ws16 26000.00 InjTime_us -13000.00 13000.00 FORMAT "%8.2" EXTENDED_LIMITS -32768.00 32767.00
 /begin AXIS_DESCR STD_AXIS Eng_nAvrg EngN 10 0.00 6000.000 FORMAT "%8.3" EXTENDED_LIMITS -32768.00 32767.00 DEPOSIT ABSOLUTE /end AXIS_DESCR
 /begin AXIS_DESCR STD_AXIS InjCtl_qSetUnBal InjMassCyc 10 0.00 327.6700 FORMAT "%8.4" EXTENDED_LIMITS -327.6800 327.6700 DEPOSIT ABSOLUTE /end AXIS_DESCR
/end CHARACTERISTIC
/begin CHARACTERISTIC InjCrv_tiPiI1ETSCor1_MAP "motortemperaturabhängiges Korrekturgrundwertekennfeld -1 für die Zeitkomponente Ansteuerbeginn PiI1" MAP 0xDEDA6 Kf_Xs16_Ys16_Ws16 26000.00 InjTime_us -13000.00 13000.00 FORMAT "%8.2" EXTENDED_LIMITS -32768.00 32767.00
 /begin AXIS_DESCR STD_AXIS Eng_nAvrg EngN 16 0.00 6000.000 FORMAT "%8.3" EXTENDED_LIMITS -32768.00 32767.00 DEPOSIT ABSOLUTE /end AXIS_DESCR
 /begin AXIS_DESCR STD_AXIS InjCtl_qSetUnBal InjMassCyc 16 0.00 327.6700 FORMAT "%8.4" EXTENDED_LIMITS -327.6800 327.6700 DEPOSIT ABSOLUTE /end AXIS_DESCR
/end CHARACTERISTIC
/begin CHARACTERISTIC InjCrv_tiPiI1ETSCor2_MAP "motortemperaturabhängiges Korrekturgrundwertekennfeld -2 für die Zeitkomponente Ansteuerbeginn PiI1" MAP 0xDEFEA Kf_Xs16_Ys16_Ws16 26000.00 InjTime_us -13000.00 13000.00 FORMAT "%8.2" EXTENDED_LIMITS -32768.00 32767.00
 /begin AXIS_DESCR STD_AXIS Eng_nAvrg EngN 16 0.00 6000.000 FORMAT "%8.3" EXTENDED_LIMITS -32768.00 32767.00 DEPOSIT ABSOLUTE /end AXIS_DESCR
 /begin AXIS_DESCR STD_AXIS InjCtl_qSetUnBal InjMassCyc 16 0.00 327.6700 FORMAT "%8.4" EXTENDED_LIMITS -327.6800 327.6700 DEPOSIT ABSOLUTE /end AXIS_DESCR
/end CHARACTERISTIC
/begin CHARACTERISTIC InjCrv_tiPiI1ETSCorStrt_MAP "base correction map for time-component of SOE of PiI1" MAP 0xDF22E Kf_Xs16_Ys16_Ws16 26000.00 InjTime_us -13000.00 13000.00 FORMAT "%8.2" EXTENDED_LIMITS -32768.00 32767.00
 /begin AXIS_DESCR STD_AXIS Eng_nAvrg EngN 16 0.00 6000.000 FORMAT "%8.3" EXTENDED_LIMITS -32768.00 32767.00 DEPOSIT ABSOLUTE /end AXIS_DESCR
 /begin AXIS_DESCR STD_AXIS InjCtl_qSetUnBal InjMassCyc 16 0.00 327.6700 FORMAT "%8.4" EXTENDED_LIMITS -327.6800 327.6700 DEPOSIT ABSOLUTE /end AXIS_DESCR
/end CHARACTERISTIC
/begin CHARACTERISTIC InjCrv_tiPiI1ETSCor_MAP "motortemperaturabhängiger Korrekturgrundwertekennfeld für die Zeitkomponente des Ansteuerbeginns der PiI1" MAP 0xDF472 Kf_Xs16_Ys16_Ws16 26000.00 InjTime_us -13000.00 13000.00 FORMAT "%8.2" EXTENDED_LIMITS -32768.00 32767.00
 /begin AXIS_DESCR STD_AXIS Eng_nAvrg EngN 16 0.00 6000.000 FORMAT "%8.3" EXTENDED_LIMITS -32768.00 32767.00 DEPOSIT ABSOLUTE /end AXIS_DESCR
 /begin AXIS_DESCR STD_AXIS InjCtl_qSetUnBal InjMassCyc 16 0.00 327.6700 FORMAT "%8.4" EXTENDED_LIMITS -327.6800 327.6700 DEPOSIT ABSOLUTE /end AXIS_DESCR
/end CHARACTERISTIC
/begin CHARACTERISTIC InjCrv_tiPiI1MinRgn_MAP "" MAP 0xDB3E8 Kf_Xs16_Ys16_Ws16 13000.00 InjTime_us 0.00 13000.00 FORMAT "%8.2" EXTENDED_LIMITS -32768.00 32767.00
 /begin AXIS_DESCR STD_AXIS Eng_nAvrg EngN 10 0.00 6000.000 FORMAT "%8.3" EXTENDED_LIMITS -32768.00 32767.00 DEPOSIT ABSOLUTE /end AXIS_DESCR
 /begin AXIS_DESCR STD_AXIS InjCtl_qSetUnBal InjMassCyc 10 0.00 327.6700 FORMAT "%8.4" EXTENDED_LIMITS -327.6800 327.6700 DEPOSIT ABSOLUTE /end AXIS_DESCR
/end CHARACTERISTIC
/begin CHARACTERISTIC InjCrv_tiPiI1Min_MAP "Kennfeld zur Ermittlung der minimalen Zeit der PiI1 relativ zur MI" MAP 0xDB4DC Kf_Xs16_Ys16_Ws16 13000.00 InjTime_us 0.00 13000.00 FORMAT "%8.2" EXTENDED_LIMITS -32768.00 32767.00
 /begin AXIS_DESCR STD_AXIS Eng_nAvrg EngN 10 0.00 6000.000 FORMAT "%8.3" EXTENDED_LIMITS -32768.00 32767.00 DEPOSIT ABSOLUTE /end AXIS_DESCR
 /begin AXIS_DESCR STD_AXIS InjCtl_qSetUnBal InjMassCyc 10 0.00 327.6700 FORMAT "%8.4" EXTENDED_LIMITS -327.6800 327.6700 DEPOSIT ABSOLUTE /end AXIS_DESCR
/end CHARACTERISTIC
/begin CHARACTERISTIC InjCrv_tiPiI1RgnAdd_Vector "Bypass-Label für InjCrv_tiPiI1RgnAdd_Vector (Nicht verstellen!)" VALUE 0xC30E6 Kw_Wu8 255.0 OneToOne 0.00 255.0 FORMAT "%5.1" /end CHARACTERISTIC
/begin CHARACTERISTIC InjCrv_tiPiI1RgnAdd_Channel "Bypass-Label für InjCrv_tiPiI1RgnAdd_Channel (Nicht verstellen!)" VALUE 0xC30E7 Kw_Wu8 255.0 OneToOne 0.00 255.0 FORMAT "%5.1" /end CHARACTERISTIC
/begin CHARACTERISTIC InjCrv_tiPiI1Rgn_MAP "base map of PiI1 SOE time-component calculation" MAP 0xDF90E Kf_Xs16_Ys16_Ws16 13000.00 InjTime_us 0.00 13000.00 FORMAT "%8.2" EXTENDED_LIMITS -32768.00 32767.00
 /begin AXIS_DESCR STD_AXIS Eng_nAvrg EngN 16 0.00 6000.000 FORMAT "%8.3" EXTENDED_LIMITS -32768.00 32767.00 DEPOSIT ABSOLUTE /end AXIS_DESCR
 /begin AXIS_DESCR STD_AXIS InjCtl_qSetUnBal InjMassCyc 16 0.00 327.6700 FORMAT "%8.4" EXTENDED_LIMITS -327.6800 327.6700 DEPOSIT ABSOLUTE /end AXIS_DESCR
/end CHARACTERISTIC
/begin CHARACTERISTIC InjCrv_tiPiI1Rgn_Vector "#SSD Bypass-Label, nicht editieren !" VALUE 0xC30E8 Kw_Wu8 255.0 OneToOne 0.00 255.0 FORMAT "%5.1" /end CHARACTERISTIC
/begin CHARACTERISTIC InjCrv_tiPiI1Rgn_Channel "#SSD Bypass-Label, nicht editieren !" VALUE 0xC30E9 Kw_Wu8 255.0 OneToOne 0.00 255.0 FORMAT "%5.1" /end CHARACTERISTIC
/begin CHARACTERISTIC InjCrv_tiPiI2BasStrt_MAP "base map of PiI2 SOE time-component calculation" MAP 0xDCE3C Kf_Xs16_Ys16_Ws16 13000.00 InjTime_us 0.00 13000.00 FORMAT "%8.2" EXTENDED_LIMITS -32768.00 32767.00
 /begin AXIS_DESCR STD_AXIS Eng_nAvrg EngN 2 0.00 6000.000 FORMAT "%8.3" EXTENDED_LIMITS -32768.00 32767.00 DEPOSIT ABSOLUTE /end AXIS_DESCR
 /begin AXIS_DESCR STD_AXIS InjCtl_qSetUnBal InjMassCyc 2 0.00 327.6700 FORMAT "%8.4" EXTENDED_LIMITS -327.6800 327.6700 DEPOSIT ABSOLUTE /end AXIS_DESCR
/end CHARACTERISTIC
/begin CHARACTERISTIC InjCrv_tiPiI2Bas_MAP "Zeitkomponente Ansteuerbeginn Grundwertekennfeld PiI2" MAP 0xDCD34 Kf_Xs16_Ys16_Ws16 13000.00 InjTime_us 0.00 13000.00 FORMAT "%8.2" EXTENDED_LIMITS -32768.00 32767.00
 /begin AXIS_DESCR STD_AXIS Eng_nAvrg EngN 10 0.00 6000.000 FORMAT "%8.3" EXTENDED_LIMITS -32768.00 32767.00 DEPOSIT ABSOLUTE /end AXIS_DESCR
 /begin AXIS_DESCR STD_AXIS InjCtl_qSetUnBal InjMassCyc 10 0.00 327.6700 FORMAT "%8.4" EXTENDED_LIMITS -327.6800 327.6700 DEPOSIT ABSOLUTE /end AXIS_DESCR
/end CHARACTERISTIC
/begin CHARACTERISTIC InjCrv_tiPiI2DesAdd_Vector "#SSD Bypass-Label für additiven Bypass von InjCrv_tiPiI2Des (Nicht verstellen!)" VALUE 0xC30DA Kw_Wu8 255.0 OneToOne 0.00 255.0 FORMAT "%5.1" /end CHARACTERISTIC
/begin CHARACTERISTIC InjCrv_tiPiI2DesAdd_Channel "#SSD Bypass-Label für additiven Bypass von InjCrv_tiPiI2Des (Nicht verstellen!)" VALUE 0xC30DB Kw_Wu8 255.0 OneToOne 0.00 255.0 FORMAT "%5.1" /end CHARACTERISTIC
/begin CHARACTERISTIC InjCrv_tiPiI2Des_Vector "#SSD Bypass-Label für InjCrv_tiPiI2Des (Nicht verstellen!)" VALUE 0xC30DC Kw_Wu8 255.0 OneToOne 0.00 255.0 FORMAT "%5.1" /end CHARACTERISTIC
/begin CHARACTERISTIC InjCrv_tiPiI2Des_Channel "#SSD Bypass-Label für InjCrv_tiPiI2Des (Nicht verstellen!)" VALUE 0xC30DD Kw_Wu8 255.0 OneToOne 0.00 255.0 FORMAT "%5.1" /end CHARACTERISTIC
/begin CHARACTERISTIC InjCrv_tiPiI2ETSCorStrt_MAP "base correction map for time-component of SOE of PiI2" MAP 0xDCAD0 Kf_Xs16_Ys16_Ws16 26000.00 InjTime_us -13000.00 13000.00 FORMAT "%8.2" EXTENDED_LIMITS -32768.00 32767.00
 /begin AXIS_DESCR STD_AXIS Eng_nAvrg EngN 2 0.00 6000.000 FORMAT "%8.3" EXTENDED_LIMITS -32768.00 32767.00 DEPOSIT ABSOLUTE /end AXIS_DESCR
 /begin AXIS_DESCR STD_AXIS InjCtl_qSetUnBal InjMassCyc 2 0.00 327.6700 FORMAT "%8.4" EXTENDED_LIMITS -327.6800 327.6700 DEPOSIT ABSOLUTE /end AXIS_DESCR
/end CHARACTERISTIC
/begin CHARACTERISTIC InjCrv_tiPiI2ETSCor_MAP "motortemperaturabhängiger Korrekturgrundwertekennfeld für die Zeitkomponente des Ansteuerbeginns der PiI2" MAP 0xDCAE4 Kf_Xs16_Ys16_Ws16 26000.00 InjTime_us -13000.00 13000.00 FORMAT "%8.2" EXTENDED_LIMITS -32768.00 32767.00
 /begin AXIS_DESCR STD_AXIS Eng_nAvrg EngN 16 0.00 6000.000 FORMAT "%8.3" EXTENDED_LIMITS -32768.00 32767.00 DEPOSIT ABSOLUTE /end AXIS_DESCR
 /begin AXIS_DESCR STD_AXIS InjCtl_qSetUnBal InjMassCyc 16 0.00 327.6700 FORMAT "%8.4" EXTENDED_LIMITS -327.6800 327.6700 DEPOSIT ABSOLUTE /end AXIS_DESCR
/end CHARACTERISTIC
/begin CHARACTERISTIC InjCrv_tiPiI2RgnAdd_Vector "Konfigurationslabel für Beipass" VALUE 0xC30B8 Kw_Wu8 255.0 OneToOne 0.00 255.0 FORMAT "%5.1" /end CHARACTERISTIC
/begin CHARACTERISTIC InjCrv_tiPiI2RgnAdd_Channel "Konfigurationslabel für Beipass" VALUE 0xC30B9 Kw_Wu8 255.0 OneToOne 0.00 255.0 FORMAT "%5.1" /end CHARACTERISTIC
/begin CHARACTERISTIC InjCrv_tiPiI2Rgn_Vector "#SSD Bypass-Label, nicht editieren !" VALUE 0xC30BA Kw_Wu8 255.0 OneToOne 0.00 255.0 FORMAT "%5.1" /end CHARACTERISTIC
/begin CHARACTERISTIC InjCrv_tiPiI2Rgn_Channel "#SSD Bypass-Label, nicht editieren !" VALUE 0xC30BB Kw_Wu8 255.0 OneToOne 0.00 255.0 FORMAT "%5.1" /end CHARACTERISTIC
/begin CHARACTERISTIC InjCrv_tiPiIMax_C "#SSD maximale Zeitkomponente PiI, bedingt durch Hardware" VALUE 0xDB5D0 Kw_Ws16 13000.00 InjTime_us 0.00 13000.00 FORMAT "%8.2" EXTENDED_LIMITS -32768.00 32767.00 /end CHARACTERISTIC
/begin CHARACTERISTIC InjCrv_tiPoI2ATSCor_MAP "kundenspez. ansauglufttemperaturabhängiger Korrekturgrundwert für die Zeitkomponente des Ansteuerbeginns der PoI2" MAP 0xE06B4 Kf_Xs16_Ys16_Ws16 26000.00 InjTime_us -13000.00 13000.00 FORMAT "%8.2" EXTENDED_LIMITS -32768.00 32767.00
 /begin AXIS_DESCR STD_AXIS Eng_nAvrg EngN 12 0.00 6000.000 FORMAT "%8.3" EXTENDED_LIMITS -32768.00 32767.00 DEPOSIT ABSOLUTE /end AXIS_DESCR
 /begin AXIS_DESCR STD_AXIS InjCtl_qSetUnBal InjMassCyc 8 0.00 327.6700 FORMAT "%8.4" EXTENDED_LIMITS -327.6800 327.6700 DEPOSIT ABSOLUTE /end AXIS_DESCR
/end CHARACTERISTIC
/begin CHARACTERISTIC InjCrv_tiPoI2ETSCor_MAP "motortemperaturabhängiger Korrekturgrundwertekennfeld für die Zeitkomponente des Ansteuerbeginns der PoI2" MAP 0xE07A0 Kf_Xs16_Ys16_Ws16 26000.00 InjTime_us -13000.00 13000.00 FORMAT "%8.2" EXTENDED_LIMITS -32768.00 32767.00
 /begin AXIS_DESCR STD_AXIS Eng_nAvrg EngN 12 0.00 6000.000 FORMAT "%8.3" EXTENDED_LIMITS -32768.00 32767.00 DEPOSIT ABSOLUTE /end AXIS_DESCR
 /begin AXIS_DESCR STD_AXIS InjCtl_qSetUnBal InjMassCyc 8 0.00 327.6700 FORMAT "%8.4" EXTENDED_LIMITS -327.6800 327.6700 DEPOSIT ABSOLUTE /end AXIS_DESCR
/end CHARACTERISTIC
/begin CHARACTERISTIC InjCrv_tiPoI2Rgn1_MAP "regeneration1 map of PoI2 SOE time component" MAP 0xE1174 Kf_Xs16_Ys16_Ws16 18000.00 InjTime_us -13000.00 5000.00 FORMAT "%8.2" EXTENDED_LIMITS -32768.00 32767.00
 /begin AXIS_DESCR STD_AXIS Eng_nAvrg EngN 16 0.00 6000.000 FORMAT "%8.3" EXTENDED_LIMITS -32768.00 32767.00 DEPOSIT ABSOLUTE /end AXIS_DESCR
 /begin AXIS_DESCR STD_AXIS InjCtl_qSetUnBal InjMassCyc 16 0.00 327.6700 FORMAT "%8.4" EXTENDED_LIMITS -327.6800 327.6700 DEPOSIT ABSOLUTE /end AXIS_DESCR
/end CHARACTERISTIC
/begin CHARACTERISTIC InjCrv_tiPoI2Rgn2_MAP "regeneration2 map of PoI2 SOE time component" MAP 0xE13B8 Kf_Xs16_Ys16_Ws16 18000.00 InjTime_us -13000.00 5000.00 FORMAT "%8.2" EXTENDED_LIMITS -32768.00 32767.00
 /begin AXIS_DESCR STD_AXIS Eng_nAvrg EngN 16 0.00 6000.000 FORMAT "%8.3" EXTENDED_LIMITS -32768.00 32767.00 DEPOSIT ABSOLUTE /end AXIS_DESCR
 /begin AXIS_DESCR STD_AXIS InjCtl_qSetUnBal InjMassCyc 16 0.00 327.6700 FORMAT "%8.4" EXTENDED_LIMITS -327.6800 327.6700 DEPOSIT ABSOLUTE /end AXIS_DESCR
/end CHARACTERISTIC
/begin CHARACTERISTIC InjCrv_tiPoI2RgnCor_MAP "base map of PoI2 SOE time-component calculation" MAP 0xE05F6 Kf_Xs16_Ys16_Ws16 13000.00 InjTime_us 0.00 13000.00 FORMAT "%8.2" EXTENDED_LIMITS -32768.00 32767.00
 /begin AXIS_DESCR STD_AXIS Eng_nAvrg EngN 2 0.00 6000.000 FORMAT "%8.3" EXTENDED_LIMITS -32768.00 32767.00 DEPOSIT ABSOLUTE /end AXIS_DESCR
 /begin AXIS_DESCR STD_AXIS InjCtl_qSetUnBal InjMassCyc 2 0.00 327.6700 FORMAT "%8.4" EXTENDED_LIMITS -327.6800 327.6700 DEPOSIT ABSOLUTE /end AXIS_DESCR
/end CHARACTERISTIC
/begin MEASUREMENT InjCrv_facAPPiI1DynCor_mp "atmosphärendruckabhängiger Gewichtungsfaktor" SWORD Fact 1 100 -4.000000 3.999878 FORMAT "%8.6" ECU_ADDRESS 0x8FF2BA /end MEASUREMENT
/begin MEASUREMENT InjCrv_facAPPiI1DynQCor_mp "Atmosphärendruckabhängiger Gewichtungsfaktor" SWORD Fact 1 100 -4.000000 3.999878 FORMAT "%8.6" ECU_ADDRESS 0x8FF2BC /end MEASUREMENT
/begin MEASUREMENT InjCrv_facDQPiI1DynCor_mp "einspritzmengengradientenabhängiger Gewichtungsfaktor" SWORD Fact 1 100 -4.000000 3.999878 FORMAT "%8.6" ECU_ADDRESS 0x8FF2B2 /end MEASUREMENT
/begin MEASUREMENT InjCrv_facDQPiI1DynQCor_mp "einspritzmengengradientenabhängiger Gewichtungsfaktor für Voreinspritzmengenkorrektur" SWORD Fact 1 100 -4.000000 3.999878 FORMAT "%8.6" ECU_ADDRESS 0x8FF2B4 /end MEASUREMENT
/begin MEASUREMENT InjCrv_facETPiI1DynCor_mp "motortemperaturabhängiger Gewichtungsfaktor" SWORD Fact 1 100 -4.000000 3.999878 FORMAT "%8.6" ECU_ADDRESS 0x8FF2BE /end MEASUREMENT
/begin MEASUREMENT InjCrv_facETPiI1DynQCor_mp "Motortemperaturabhängiger Gewichtungfaktor" SWORD Fact 1 100 -4.000000 3.999878 FORMAT "%8.6" ECU_ADDRESS 0x8FF2C0 /end MEASUREMENT
/begin MEASUREMENT InjCrv_facPhPoI2RgnAPCor_mp "atmosphere pressure correction value for PoI2 setpoint" SWORD Fact 1 100 -4.000000 3.999878 FORMAT "%8.6" ECU_ADDRESS 0x8FF330 /end MEASUREMENT
/begin MEASUREMENT InjCrv_facPhPoI2RgnETCor_mp "engine temperature correction value for PoI2 setpoint" SWORD Fact 1 100 -4.000000 3.999878 FORMAT "%8.6" ECU_ADDRESS 0x8FF332 /end MEASUREMENT
/begin MEASUREMENT InjCrv_facPiI1APSQCor "atmosphärendruckabhängiger Mengenkorrekturfaktor für Voreinspritzung 1" SWORD Fact 1 100 -4.000000 3.999878 FORMAT "%8.6" ECU_ADDRESS 0x7F8DAC /end MEASUREMENT
/begin MEASUREMENT InjCrv_facPiI1APSQCor2 "atmosphärendruckabhängiger Mengenkorrekturfaktor -2 für Voreinspritzung 1" SWORD Fact 1 100 -4.000000 3.999878 FORMAT "%8.6" ECU_ADDRESS 0x7F8DAE /end MEASUREMENT
/begin MEASUREMENT InjCrv_facPiI1APSQCorStrt "atmosphärendruckabhängiger Mengenkorrekturfaktor für Voreinspritzung 1 bei inaktiver Voreinspritzung 2 im Startzustand" SWORD Fact 1 100 -4.000000 3.999878 FORMAT "%8.6" ECU_ADDRESS 0x7F8DB0 /end MEASUREMENT
/begin MEASUREMENT InjCrv_facPiI1ATSQCor "ansauglufttemperaturabhängiger Mengenkorrekturfaktor für Voreinspritzung 1" SWORD Fact 1 100 -4.000000 3.999878 FORMAT "%8.6" ECU_ADDRESS 0x7F8DB2 /end MEASUREMENT
/begin MEASUREMENT InjCrv_facPiI1ATSQCor2 "ansauglufttemperaturabhängiger Mengenkorrekturfaktor -2 für Voreinspritzung 1" SWORD Fact 1 100 -4.000000 3.999878 FORMAT "%8.6" ECU_ADDRESS 0x7F8DB4 /end MEASUREMENT
/begin MEASUREMENT InjCrv_facPiI1ATSQCorStrt "motortemperaturabhängiger Mengenkorrekturfaktor für Voreinspritzung 1 bei inaktiver Voreinspritzung 2 im Startzustand" SWORD Fact 1 100 -4.000000 3.999878 FORMAT "%8.6" ECU_ADDRESS 0x7F8DB6 /end MEASUREMENT
/begin MEASUREMENT InjCrv_facPiI1ATSSOECor "kundenspezifischer ansauglufttemperaturabhängiger Gewichtungsfaktor für PiI1" SWORD Fact 1 100 -4.000000 3.999878 FORMAT "%8.6" ECU_ADDRESS 0x7F8DB8 /end MEASUREMENT
/begin MEASUREMENT InjCrv_facPiI1DynQCor "dynamischer Mengenkorrekturfaktor für PiI1" SWORD Fact 1 100 -4.000000 3.999878 FORMAT "%8.6" ECU_ADDRESS 0x7F8DBA /end MEASUREMENT
/begin MEASUREMENT InjCrv_facPiI1DynSOECor "motortemperatur- und atmosphärendruckabhängiger Winkelkorrekturfaktor für Pil1" SWORD Fact 1 100 -4.000000 3.999878 FORMAT "%8.6" ECU_ADDRESS 0x7F8DBC /end MEASUREMENT
/begin MEASUREMENT InjCrv_facPiI1ETSQCor "motortemperaturabhängiger Mengenkorrekturfaktor für Voreinspritzung 1" SWORD Fact 1 100 -4.000000 3.999878 FORMAT "%8.6" ECU_ADDRESS 0x7F8DBE /end MEASUREMENT
/begin MEASUREMENT InjCrv_facPiI1ETSQCor1 "motortemperaturabhängiger Mengenkorrekturfaktor -1 für Voreinspritzung 1" SWORD Fact 1 100 -4.000000 3.999878 FORMAT "%8.6" ECU_ADDRESS 0x7F8DC0 /end MEASUREMENT
/begin MEASUREMENT InjCrv_facPiI1ETSQCor12 "motortemperaturabhängiger Mengenkorrekturfaktor für Voreinspritzung 1 bei inaktiver Voreinspritzung 2" SWORD Fact 1 100 -4.000000 3.999878 FORMAT "%8.6" ECU_ADDRESS 0x7F8DC2 /end MEASUREMENT
/begin MEASUREMENT InjCrv_facPiI1ETSQCor2 "motortemperaturabhängiger Mengenkorrekturfaktor -2 für Voreinspritzung 1" SWORD Fact 1 100 -4.000000 3.999878 FORMAT "%8.6" ECU_ADDRESS 0x7F8DC4 /end MEASUREMENT
/begin MEASUREMENT InjCrv_facPiI1ETSQCorStrt "motortemperaturabhängiger Mengenkorrekturfaktor für Voreinspritzung 1 bei inaktiver Voreinspritzung 2 im Startzustand" SWORD Fact 1 100 -4.000000 3.999878 FORMAT "%8.6" ECU_ADDRESS 0x7F8DC6 /end MEASUREMENT
/begin MEASUREMENT InjCrv_facPiI1ETSSOECor "motortemperaturabhängiger Ansteuerbeginnkorrekturfaktor für Voreinspritzung 1" SWORD Fact 1 100 -4.000000 3.999878 FORMAT "%8.6" ECU_ADDRESS 0x7F8DC8 /end MEASUREMENT
/begin MEASUREMENT InjCrv_facPiI1ETSSOECor1 "motortemperaturabhängiger Ansteuerbeginnkorrekturfaktor -1 für Voreinspritzung 1" SWORD Fact 1 100 -4.000000 3.999878 FORMAT "%8.6" ECU_ADDRESS 0x7F8DCA /end MEASUREMENT
/begin MEASUREMENT InjCrv_facPiI1ETSSOECor12 """motortemperaturabhängiger Ansteuerbeginnkorrekturfaktor für Voreinspritzung 1 bei inaktiver Voreinspritzung 2""" SWORD Fact 1 100 -4.000000 3.999878 FORMAT "%8.6" ECU_ADDRESS 0x7F8DCC /end MEASUREMENT
/begin MEASUREMENT InjCrv_facPiI1ETSSOECor2 "motortemperaturabhängiger Ansteuerbeginnkorrekturfaktor -2 für Voreinspritzung 1" SWORD Fact 1 100 -4.000000 3.999878 FORMAT "%8.6" ECU_ADDRESS 0x7F8DCE /end MEASUREMENT
/begin MEASUREMENT InjCrv_facPiI1ETSSOECorStrt """motortemperaturabhängiger Ansteuerbeginnkorrekturfaktor für Voreinspritzung 1 bei inaktiver Voreinspritzung 2 im Startzustand """ SWORD Fact 1 100 -4.000000 3.999878 FORMAT "%8.6" ECU_ADDRESS 0x7F8DD0 /end MEASUREMENT
/begin MEASUREMENT InjCrv_facPiI1QntMin_mp "Wichtungsfaktor zum Abschalten der Berechnung Voreinspritzung 1" SWORD Fact1 1 100 -256.0000 255.9922 FORMAT "%8.4" ECU_ADDRESS 0x8FF270 /end MEASUREMENT
/begin MEASUREMENT InjCrv_facPiI2APSQCor "atmosphärendruckabhängiger Mengenkorrekturfaktor für Voreinspritzung 2" SWORD Fact 1 100 -4.000000 3.999878 FORMAT "%8.6" ECU_ADDRESS 0x7F8DD2 /end MEASUREMENT
/begin MEASUREMENT InjCrv_facPiI2APSQCorStrt "atmospheric pressure dependent correction factor for quantity PiI2" SWORD Fact 1 100 -4.000000 3.999878 FORMAT "%8.6" ECU_ADDRESS 0x7F8DD4 /end MEASUREMENT
/begin MEASUREMENT InjCrv_facPiI2ATSQCor "ansauglufttemperaturabhängiger Mengenkorrekturfaktor für Voreinspritzung 2" SWORD Fact 1 100 -4.000000 3.999878 FORMAT "%8.6" ECU_ADDRESS 0x7F8DD6 /end MEASUREMENT
/begin MEASUREMENT InjCrv_facPiI2ATSQCorStrt "intake air temperature dependent correction factor for quantity PiI2" SWORD Fact 1 100 -4.000000 3.999878 FORMAT "%8.6" ECU_ADDRESS 0x7F8DD8 /end MEASUREMENT
/begin MEASUREMENT InjCrv_facPiI2ETSQCor "motortemperaturabhängiger Mengenkorrekturfaktor für Voreinspritzung 2" SWORD Fact 1 100 -4.000000 3.999878 FORMAT "%8.6" ECU_ADDRESS 0x7F8DDA /end MEASUREMENT
/begin MEASUREMENT InjCrv_facPiI2ETSQCorStrt "atmospheric pressure dependent correction factor for quantity PiI2" SWORD Fact 1 100 -4.000000 3.999878 FORMAT "%8.6" ECU_ADDRESS 0x7F8DDC /end MEASUREMENT
/begin MEASUREMENT InjCrv_facPiI2ETSSOECor "motortemperaturabhängiger Ansteuerbeginnkorrekturfaktor für Voreinspritzung 2" SWORD Fact 1 100 -4.000000 3.999878 FORMAT "%8.6" ECU_ADDRESS 0x7F8DDE /end MEASUREMENT
/begin MEASUREMENT InjCrv_facPiI2ETSSOECorStrt "engine temperature dependent correction factor for PiI2-SOE" SWORD Fact 1 100 -4.000000 3.999878 FORMAT "%8.6" ECU_ADDRESS 0x7F8DE0 /end MEASUREMENT
/begin MEASUREMENT InjCrv_facPiI2QntMin_mp "Wichtungsfaktor zum Abschalten der Berechnung Voreinspritzung 2" SWORD Fact1 1 100 -256.0000 255.9922 FORMAT "%8.4" ECU_ADDRESS 0x8FF224 /end MEASUREMENT
/begin MEASUREMENT InjCrv_facPoI1APSQCor "atmospärendruckabhängiger Mengenkorrekturfaktor für PoI1" SWORD Fact 1 100 -4.000000 3.999878 FORMAT "%8.6" ECU_ADDRESS 0x7F8DE2 /end MEASUREMENT
/begin MEASUREMENT InjCrv_facPoI1ETSPhiCor "motortemperaturabhängiger Winkelkorrekturfaktor für PoI1" SWORD Fact 1 100 -4.000000 3.999878 FORMAT "%8.6" ECU_ADDRESS 0x7F8DE4 /end MEASUREMENT
/begin MEASUREMENT InjCrv_facPoI1ETSQCor "motortemperaturabhängiger Mengenkorrekturfaktor für PoI1" SWORD Fact 1 100 -4.000000 3.999878 FORMAT "%8.6" ECU_ADDRESS 0x7F8DE6 /end MEASUREMENT
/begin MEASUREMENT InjCrv_facPoI2ATSQCor "ansauglufttemperaturabhängiger Mengenkorrekturfaktor für PoI2" SWORD Fact 1 100 -4.000000 3.999878 FORMAT "%8.6" ECU_ADDRESS 0x7F8DE8 /end MEASUREMENT
/begin MEASUREMENT InjCrv_facPoI2ATSSOECor "ansauglufttemperaturabhängiger Ansteuerbeginnkorrekturfaktor für PoI2" SWORD Fact 1 100 -4.000000 3.999878 FORMAT "%8.6" ECU_ADDRESS 0x7F8DEA /end MEASUREMENT
/begin MEASUREMENT InjCrv_facPoI2EffSet_mp "Faktor für den drehmomentbildenden Anteil der Einspritzmenge PoI2 (Sollwert)" SWORD Fact 1 100 -4.000000 3.999878 FORMAT "%8.6" ECU_ADDRESS 0x8FF340 /end MEASUREMENT
/begin MEASUREMENT InjCrv_facPoI2Eff_mp "Faktor für Drehmoment bildenden Anteil der Einspritzmenge PoI2" SWORD Fact 1 100 -4.000000 3.999878 FORMAT "%8.6" ECU_ADDRESS 0x8FF342 /end MEASUREMENT
/begin MEASUREMENT InjCrv_facPoI2ETSQCor "motortemperaturabhängiger Mengenkorrekturfaktor für PoI2" SWORD Fact 1 100 -4.000000 3.999878 FORMAT "%8.6" ECU_ADDRESS 0x7F8DEC /end MEASUREMENT
/begin MEASUREMENT InjCrv_facPoI2ETSSOECor "motortemperaturabhängiger Ansteuerbeginnkorrekturfaktor für PoI2" SWORD Fact 1 100 -4.000000 3.999878 FORMAT "%8.6" ECU_ADDRESS 0x7F8DEE /end MEASUREMENT
/begin MEASUREMENT InjCrv_facPOpPoI2ETSCor "Motortemperaturabhängiger Freigabekorrekturfaktor für  PoI2" SWORD Fact 1 100 -4.000000 3.999878 FORMAT "%8.6" ECU_ADDRESS 0x7F8DAA /end MEASUREMENT
/begin MEASUREMENT InjCrv_facQPoI2RgnAPCor_mp "atmosphere pressure correction value for PoI2 quantity" SWORD Fact 1 100 -4.000000 3.999878 FORMAT "%8.6" ECU_ADDRESS 0x8FF334 /end MEASUREMENT
/begin MEASUREMENT InjCrv_facQPoI2RgnETCor_mp "engine temperature correction value for PoI2 quantity" SWORD Fact 1 100 -4.000000 3.999878 FORMAT "%8.6" ECU_ADDRESS 0x8FF336 /end MEASUREMENT
/begin MEASUREMENT InjCrv_facTiPoI2RgnAPCor_mp "atmosphere pressure correction value for PoI2 time" SWORD Fact 1 100 -4.000000 3.999878 FORMAT "%8.6" ECU_ADDRESS 0x8FF338 /end MEASUREMENT
/begin MEASUREMENT InjCrv_facTiPoI2RgnETCor_mp "engine temperature correction value for PoI2 time" SWORD Fact 1 100 -4.000000 3.999878 FORMAT "%8.6" ECU_ADDRESS 0x8FF33A /end MEASUREMENT
/begin MEASUREMENT InjCrv_MI1RgnVal "Wert für Regenerationsstatus MI1" ULONG EGTSwt 1 100 0.00 262.143999939 FORMAT "%13.9" ECU_ADDRESS 0x7F914C /end MEASUREMENT
/begin MEASUREMENT InjCrv_phiDynOfs_mp "Winkelvorhalt für schnelle dynamische Vorgänge" SWORD AngleCrS 1 100 -768.0000 767.9766 FORMAT "%8.4" ECU_ADDRESS 0x8FF2EC /end MEASUREMENT
/begin MEASUREMENT InjCrv_phiMI1Bas_mp "Grundwert Ansteuerbeginn MI1" SWORD AngleCrS 1 100 -768.0000 767.9766 FORMAT "%8.4" ECU_ADDRESS 0x8FF1C4 /end MEASUREMENT
/begin MEASUREMENT InjCrv_phiMI1Cor_mp "korrigierter Grundwert Ansteuerbeginn MI1" SWORD AngleCrS 1 100 -768.0000 767.9766 FORMAT "%8.4" ECU_ADDRESS 0x8FF1C6 /end MEASUREMENT
/begin MEASUREMENT InjCrv_phiMI1Des "gewünschter Bezugswinkel für Beginn der MI1" SWORD AngleCrS 1 100 -768.0000 767.9766 FORMAT "%8.4" ECU_ADDRESS 0x7F8DF6 /end MEASUREMENT
/begin MEASUREMENT InjCrv_phiMI1DesByp_mp "Bypass-Label, Kopie von InjCrv_phiMI1Des" SWORD AngleCrS 1 100 -768.0000 767.9766 FORMAT "%8.4" ECU_ADDRESS 0x8FF1C8 /end MEASUREMENT
/begin MEASUREMENT InjCrv_phiMI1EnvCor "Ansteuerbeginn Korrekturwinkel für MI1" SWORD AngleCrS 1 100 -768.0000 767.9766 FORMAT "%8.4" ECU_ADDRESS 0x7F8DF8 /end MEASUREMENT
/begin MEASUREMENT InjCrv_phiMI1EnvCor2 "Ansteuerbeginnkorrekturwert -2 für MI1 (n sync)" SWORD AngleCrS 1 100 -768.0000 767.9766 FORMAT "%8.4" ECU_ADDRESS 0x7F8DFA /end MEASUREMENT
/begin MEASUREMENT InjCrv_phiMI1EnvCorStrt "Winkelkorektur für Haupteinspritzung bei Start" SWORD AngleCrS 1 100 -768.0000 767.9766 FORMAT "%8.4" ECU_ADDRESS 0x7F8DFC /end MEASUREMENT
/begin MEASUREMENT InjCrv_phiMI1Lim_mp "begrenzter Sollwert Ansteuerbeginn MI1" SWORD AngleCrS 1 100 -768.0000 767.9766 FORMAT "%8.4" ECU_ADDRESS 0x8FF1CA /end MEASUREMENT
/begin MEASUREMENT InjCrv_phiMI1Max_mp "frühester Ansteuerbeginn der MI1" SWORD AngleCrS 1 100 -768.0000 767.9766 FORMAT "%8.4" ECU_ADDRESS 0x8FF1CC /end MEASUREMENT
/begin MEASUREMENT InjCrv_phiMI1Min_mp "Latest SOE of MI1" SWORD AngleCrS 1 100 -768.0000 767.9766 FORMAT "%8.4" ECU_ADDRESS 0x8FF1CE /end MEASUREMENT
/begin MEASUREMENT InjCrv_phiMI1Rgn "Regenerationswert für den Ansteuerbeginn der MI1" SWORD AngleCrS 1 100 -768.0000 767.9766 FORMAT "%8.4" ECU_ADDRESS 0x7F8DFE /end MEASUREMENT
/begin MEASUREMENT InjCrv_phiMI1RgnByp_mp "Measure point for Bypass" SWORD AngleCrS 1 100 -768.0000 767.9766 FORMAT "%8.4" ECU_ADDRESS 0x8FF20E /end MEASUREMENT
/begin MEASUREMENT InjCrv_phiMI1Rgn_mp "Ansteuerbeginn der MI1 im Regenerationsbetrieb" SWORD AngleCrS 1 100 -768.0000 767.9766 FORMAT "%8.4" ECU_ADDRESS 0x8FF210 /end MEASUREMENT
/begin MEASUREMENT InjCrv_phiMI1StrtCor_mp "Korrekturwinkel der HE während des Starts" SWORD AngleCrS 1 100 -768.0000 767.9766 FORMAT "%8.4" ECU_ADDRESS 0x8FF216 /end MEASUREMENT
/begin MEASUREMENT InjCrv_phiMIAPSCor2_mp "atmosphärendruckabhängiger Korrekturwinkel für den Ansteuerbeginn der MI1 bei aktiver PiI2" SWORD AngleCrS 1 100 -768.0000 767.9766 FORMAT "%8.4" ECU_ADDRESS 0x8FF1F4 /end MEASUREMENT
/begin MEASUREMENT InjCrv_phiMIAPSCorStrt_mp "Correction phase angle value for main injection at the start of engine" SWORD AngleCrS 1 100 -768.0000 767.9766 FORMAT "%8.4" ECU_ADDRESS 0x8FF1F6 /end MEASUREMENT
/begin MEASUREMENT InjCrv_phiMIAPSCor_mp "atmosphärendruckabhängiger Korrekturwert für den Ansteuerbeginn der MI1" SWORD AngleCrS 1 100 -768.0000 767.9766 FORMAT "%8.4" ECU_ADDRESS 0x8FF1F8 /end MEASUREMENT
/begin MEASUREMENT InjCrv_phiMIATSCor2_mp "ansauglufttemperaturabhängiger Korrekturwinkel für den Ansteuerbeginn der MI1 bei aktiver PiI2" SWORD AngleCrS 1 100 -768.0000 767.9766 FORMAT "%8.4" ECU_ADDRESS 0x8FF1FA /end MEASUREMENT
/begin MEASUREMENT InjCrv_phiMIATSCorStrt_mp "ansauglufttemperaturabhängiger Korrekturwert für den Ansteuerbeginn der MI1 im Startzustand" SWORD AngleCrS 1 100 -768.0000 767.9766 FORMAT "%8.4" ECU_ADDRESS 0x8FF1FC /end MEASUREMENT
/begin MEASUREMENT InjCrv_phiMIATSCor_mp "ansauglufttemperaturabhängiger Korrekturwert für den Ansteuerbeginn der MI1" SWORD AngleCrS 1 100 -768.0000 767.9766 FORMAT "%8.4" ECU_ADDRESS 0x8FF1FE /end MEASUREMENT
/begin MEASUREMENT InjCrv_phiMIETSCor12_mp "kühlmitteltemperaturabhängiger Korrekturwert für den Ansteuerbeginn der MI1" SWORD AngleCrS 1 100 -768.0000 767.9766 FORMAT "%8.4" ECU_ADDRESS 0x8FF200 /end MEASUREMENT
/begin MEASUREMENT InjCrv_phiMIETSCor1_mp "motortemperaturabhängiger Korrekturwert -1 für Ansteuerbeginn MI1" SWORD AngleCrS 1 100 -768.0000 767.9766 FORMAT "%8.4" ECU_ADDRESS 0x8FF202 /end MEASUREMENT
/begin MEASUREMENT InjCrv_phiMIETSCor2_mp "motortemperaturabhängiger Korrekturwert -2 für Ansteuerbeginn MI1" SWORD AngleCrS 1 100 -768.0000 767.9766 FORMAT "%8.4" ECU_ADDRESS 0x8FF204 /end MEASUREMENT
/begin MEASUREMENT InjCrv_phiMIETSCorRgn_mp "Korrekturwinkel für Ansteuerbeginn Haupteinspritzung in Abhängigkeit der Motortemperatur im Regenerationsbetrieb" SWORD AngleCrS 1 100 -768.0000 767.9766 FORMAT "%8.4" ECU_ADDRESS 0x8FF212 /end MEASUREMENT
/begin MEASUREMENT InjCrv_phiMIETSCorStrt_mp "correction angle value = f(n, qSetUnBal, ETS)" SWORD AngleCrS 1 100 -768.0000 767.9766 FORMAT "%8.4" ECU_ADDRESS 0x8FF206 /end MEASUREMENT
/begin MEASUREMENT InjCrv_phiMIETSCor_mp "Korrekturwinkel für Ansteuerbeginn Haupteinspritzung in Abhängigkeit der Motortemperatur" SWORD AngleCrS 1 100 -768.0000 767.9766 FORMAT "%8.4" ECU_ADDRESS 0x8FF208 /end MEASUREMENT
/begin MEASUREMENT InjCrv_phiMIFTSRailCorStrt_mp "correction angle value = f(n, qSetUnBal, FTS,InjCrv_phiMIFTSRailCor_Max, InjCrv_phiMIFTSRailCor_Min)" SWORD AngleCrS 1 100 -768.0000 767.9766 FORMAT "%8.4" ECU_ADDRESS 0x8FF20A /end MEASUREMENT
/begin MEASUREMENT InjCrv_phiMIFTSRailCor_mp "Ansteuerbeginnkorrekturfaktor für MI1, abhängig von der kraftstofftemperaturabhängigen Raildruckkorrektur" SWORD AngleCrS 1 100 -768.0000 767.9766 FORMAT "%8.4" ECU_ADDRESS 0x8FF20C /end MEASUREMENT
/begin MEASUREMENT InjCrv_phiNxtCyl_mp "Winkel zwischen aktuellem OT und der frühesten Einspritzung des nächsten Zylinders auf derselben Bank" SWORD AngleCrS 1 100 -768.0000 767.9766 FORMAT "%8.4" ECU_ADDRESS 0x8FF2EE /end MEASUREMENT
/begin MEASUREMENT InjCrv_phiNxtTDCoB_mp "Winkel zw. aktuellem OT und OT des nächsten Zylinders auf derselben Bank" SWORD AngleCrS 1 100 -768.0000 767.9766 FORMAT "%8.4" ECU_ADDRESS 0x8FF2F0 /end MEASUREMENT
/begin MEASUREMENT InjCrv_phiPiI1AbsTot_mp "absoluter Ansteuerbeginn PiI1 aus Winkel- und Zeitkomponente" SWORD AngleCrS 1 100 -768.0000 767.9766 FORMAT "%8.4" ECU_ADDRESS 0x8FF272 /end MEASUREMENT
/begin MEASUREMENT InjCrv_phiPiI1Abs_mp "absolute Winkelkomponente Anteuerbeginn PiI1" SWORD AngleCrS 1 100 -768.0000 767.9766 FORMAT "%8.4" ECU_ADDRESS 0x8FF274 /end MEASUREMENT
/begin MEASUREMENT InjCrv_phiPiI1AddCor "kundenspezifischer Korrekturwinkel für PiI1" SWORD AngleCrS 1 100 -768.0000 767.9766 FORMAT "%8.4" ECU_ADDRESS 0x7F8E00 /end MEASUREMENT
/begin MEASUREMENT InjCrv_phiPiI1AddCor2 "kundenspezifischer Korrekturwinkel für PiI1 bei aktiver PiI2" SWORD AngleCrS 1 100 -768.0000 767.9766 FORMAT "%8.4" ECU_ADDRESS 0x7F8E02 /end MEASUREMENT
/begin MEASUREMENT InjCrv_phiPiI1Bas_mp "Winkelkomponente Ansteuerbeginn PiI1Grundwert" SWORD AngleCrS 1 100 -768.0000 767.9766 FORMAT "%8.4" ECU_ADDRESS 0x8FF218 /end MEASUREMENT
/begin MEASUREMENT InjCrv_phiPiI1Cor_mp "korrigierter Grundwert Winkelkomponente Ansteuerbeginn PiI1" SWORD AngleCrS 1 100 -768.0000 767.9766 FORMAT "%8.4" ECU_ADDRESS 0x8FF276 /end MEASUREMENT
/begin MEASUREMENT InjCrv_phiPiI1Des "gewünschter Winkelkomponente Ansteuerbeginn PiI1" SWORD AngleCrS 1 100 -768.0000 767.9766 FORMAT "%8.4" ECU_ADDRESS 0x7F8E04 /end MEASUREMENT
/begin MEASUREMENT InjCrv_phiPiI1DesByp_mp "Bypass-Label, Kopie von InjCrv_phiPiI1Des" SWORD AngleCrS 1 100 -768.0000 767.9766 FORMAT "%8.4" ECU_ADDRESS 0x8FF278 /end MEASUREMENT
/begin MEASUREMENT InjCrv_phiPiI1EnvCor "Korrekturwinkel für Voreinspritzung 1" SWORD AngleCrS 1 100 -768.0000 767.9766 FORMAT "%8.4" ECU_ADDRESS 0x7F8E06 /end MEASUREMENT
/begin MEASUREMENT InjCrv_phiPiI1EnvCor2 "Korrekturwinkel für PiI1 wenn PiI2 aktiv" SWORD AngleCrS 1 100 -768.0000 767.9766 FORMAT "%8.4" ECU_ADDRESS 0x7F8E08 /end MEASUREMENT
/begin MEASUREMENT InjCrv_phiPiI1Rel_mp "Winkelkomponente Ansteuerbeginn PiI1 relaitv zur MI" SWORD AngleCrS 1 100 -768.0000 767.9766 FORMAT "%8.4" ECU_ADDRESS 0x8FF27A /end MEASUREMENT
/begin MEASUREMENT InjCrv_phiPiI1Rgn "Regenerationswert für die  Winkelkomponente des Ansteuerbeginns der PiI1" SWORD AngleCrS 1 100 -768.0000 767.9766 FORMAT "%8.4" ECU_ADDRESS 0x7F8E0A /end MEASUREMENT
/begin MEASUREMENT InjCrv_phiPiI1RgnByp_mp "Measure point for Bypass" SWORD AngleCrS 1 100 -768.0000 767.9766 FORMAT "%8.4" ECU_ADDRESS 0x8FF2E2 /end MEASUREMENT
/begin MEASUREMENT InjCrv_phiPiI2AbsTot_mp "absoluter Ansteuerbeginn PiI2 aus Winkel- und Zeitkomponente" SWORD AngleCrS 1 100 -768.0000 767.9766 FORMAT "%8.4" ECU_ADDRESS 0x8FF226 /end MEASUREMENT
/begin MEASUREMENT InjCrv_phiPiI2Abs_mp "absolute Winkelkomponente Ansteuerbeginn PiI2" SWORD AngleCrS 1 100 -768.0000 767.9766 FORMAT "%8.4" ECU_ADDRESS 0x8FF228 /end MEASUREMENT
/begin MEASUREMENT InjCrv_phiPiI2AddCor "kundenspezifischer Korrekturwinkel für PiI2" SWORD AngleCrS 1 100 -768.0000 767.9766 FORMAT "%8.4" ECU_ADDRESS 0x7F8E0C /end MEASUREMENT
/begin MEASUREMENT InjCrv_phiPiI2Bas_mp "Winkelkomponente Ansteuerbeginn PiI2 Grundwert" SWORD AngleCrS 1 100 -768.0000 767.9766 FORMAT "%8.4" ECU_ADDRESS 0x8FF262 /end MEASUREMENT
/begin MEASUREMENT InjCrv_phiPiI2Cor_mp "korrigierter Grundwert Winkelkomponente Ansteuerbeginn PiI2" SWORD AngleCrS 1 100 -768.0000 767.9766 FORMAT "%8.4" ECU_ADDRESS 0x8FF22A /end MEASUREMENT
/begin MEASUREMENT InjCrv_phiPiI2Des "gewünschte Winkelkomponente Ansteuerbeginn PiI2" SWORD AngleCrS 1 100 -768.0000 767.9766 FORMAT "%8.4" ECU_ADDRESS 0x7F8E0E /end MEASUREMENT
/begin MEASUREMENT InjCrv_phiPiI2DesByp_mp "Bypass-Label, Kopie von InjCrv_phiPiI2Des" SWORD AngleCrS 1 100 -768.0000 767.9766 FORMAT "%8.4" ECU_ADDRESS 0x8FF27C /end MEASUREMENT
/begin MEASUREMENT InjCrv_phiPiI2EnvCor "Korrekturwinkel für Voreinspritzung 2" SWORD AngleCrS 1 100 -768.0000 767.9766 FORMAT "%8.4" ECU_ADDRESS 0x7F8E10 /end MEASUREMENT
/begin MEASUREMENT InjCrv_phiPiI2ETSCor_mp "motortemperaturabhängiger Korrekturgrundwert für die Winkelkomponente des Ansteuerbeginns der PiI2" SWORD AngleCrS 1 100 -768.0000 767.9766 FORMAT "%8.4" ECU_ADDRESS 0x8FF258 /end MEASUREMENT
/begin MEASUREMENT InjCrv_phiPiI2Rel_mp "Winkelkomponente Ansteuerbeginn PiI2 relativ zur MI" SWORD AngleCrS 1 100 -768.0000 767.9766 FORMAT "%8.4" ECU_ADDRESS 0x8FF22C /end MEASUREMENT
/begin MEASUREMENT InjCrv_phiPiI2Rgn "Regenerationswert für die  Winkelkomponente des Ansteuerbeginns der PiI2" SWORD AngleCrS 1 100 -768.0000 767.9766 FORMAT "%8.4" ECU_ADDRESS 0x7F8E12 /end MEASUREMENT
/begin MEASUREMENT InjCrv_phiPiI2RgnByp_mp "Measure point for Bypass" SWORD AngleCrS 1 100 -768.0000 767.9766 FORMAT "%8.4" ECU_ADDRESS 0x8FF25C /end MEASUREMENT
/begin MEASUREMENT InjCrv_phiPiI3Des "gewünschte Winkelkomponente Ansteuerbeginn PiI3" SWORD AngleCrS 1 100 -768.0000 767.9766 FORMAT "%8.4" ECU_ADDRESS 0x7F8E14 /end MEASUREMENT
/begin MEASUREMENT InjCrv_phiPiI3DesByp_mp "Bypass-Label, Kopie von InjCrv_phiPiI3Des" SWORD AngleCrS 1 100 -768.0000 767.9766 FORMAT "%8.4" ECU_ADDRESS 0x8FF27E /end MEASUREMENT
/begin MEASUREMENT InjCrv_phiPoI1AddCor "kundenspezifischer Korrekturwinkel für PoI1" SWORD AngleCrS 1 100 -768.0000 767.9766 FORMAT "%8.4" ECU_ADDRESS 0x7F8E16 /end MEASUREMENT
/begin MEASUREMENT InjCrv_phiPoI1Bas_mp "Grundwert des Ansteuerbeginnwinkels PoI1" SWORD AngleCrS 1 100 -768.0000 767.9766 FORMAT "%8.4" ECU_ADDRESS 0x8FF2F2 /end MEASUREMENT
/begin MEASUREMENT InjCrv_phiPoI1Des "gewünschter Bezugswinkel für Beginn der PoI1" SWORD AngleCrS 1 100 -768.0000 767.9766 FORMAT "%8.4" ECU_ADDRESS 0x7F8E18 /end MEASUREMENT
/begin MEASUREMENT InjCrv_phiPoI1DesByp_mp "Bypass-Label, Kopie von InjCrv_phiPoI1Des" SWORD AngleCrS 1 100 -768.0000 767.9766 FORMAT "%8.4" ECU_ADDRESS 0x8FF2F4 /end MEASUREMENT
/begin MEASUREMENT InjCrv_phiPoI1Dur_mp "Gesamtzeti PoI1 in Winkelgraden" SWORD AngleCrS 1 100 -768.0000 767.9766 FORMAT "%8.4" ECU_ADDRESS 0x8FF2F6 /end MEASUREMENT
/begin MEASUREMENT InjCrv_phiPoI1EnvCor "umgebungsbedingungsabhängiger Korrekturwinkel für PoI1" SWORD AngleCrS 1 100 -768.0000 767.9766 FORMAT "%8.4" ECU_ADDRESS 0x7F8E1A /end MEASUREMENT
/begin MEASUREMENT InjCrv_phiPoI1Lim_mp "begrenzeter Ansteuerbeginnwinkel PoI1" SWORD AngleCrS 1 100 -768.0000 767.9766 FORMAT "%8.4" ECU_ADDRESS 0x8FF2F8 /end MEASUREMENT
/begin MEASUREMENT InjCrv_phiPoI1Min_mp "spätester Ansteuerbeginnwinkel PoI1" SWORD AngleCrS 1 100 -768.0000 767.9766 FORMAT "%8.4" ECU_ADDRESS 0x8FF2FA /end MEASUREMENT
/begin MEASUREMENT InjCrv_phiPoI1Rgn "Grundwert der Winkelkomponente Ansteuerbeginn PoI1 im Regenerationsbetrieb" SWORD AngleCrS 1 100 -768.0000 767.9766 FORMAT "%8.4" ECU_ADDRESS 0x7F8E1C /end MEASUREMENT
/begin MEASUREMENT InjCrv_phiPoI1Rgn1_mp "Regeneration value 1 for the PoI1 start of energising angle component" SWORD AngleCrS 1 100 -768.0000 767.9766 FORMAT "%8.4" ECU_ADDRESS 0x8FF318 /end MEASUREMENT
/begin MEASUREMENT InjCrv_phiPoI1Rgn2_mp "Regeneration value 2 for the PoI1 start of energising angle component" SWORD AngleCrS 1 100 -768.0000 767.9766 FORMAT "%8.4" ECU_ADDRESS 0x8FF31A /end MEASUREMENT
/begin MEASUREMENT InjCrv_phiPoI1RgnByp_mp "Measure point for Bypass" SWORD AngleCrS 1 100 -768.0000 767.9766 FORMAT "%8.4" ECU_ADDRESS 0x8FF31C /end MEASUREMENT
/begin MEASUREMENT InjCrv_phiPoI1Set_mp "Sollwert des Ansteuerbeginnwinkels PoI1" SWORD AngleCrS 1 100 -768.0000 767.9766 FORMAT "%8.4" ECU_ADDRESS 0x8FF2FC /end MEASUREMENT
/begin MEASUREMENT InjCrv_phiPoI2AddCor "kundenspezifischer Korrekturwinkel für PoI2" SWORD AngleCrS 1 100 -768.0000 767.9766 FORMAT "%8.4" ECU_ADDRESS 0x7F8E1E /end MEASUREMENT
/begin MEASUREMENT InjCrv_phiPoI2ATSCor_mp "ansauglufttemperaturabhängiger Korrekturgrundwert für die Winkelkomponente des Ansteuerbeginns der PoI2" SWORD AngleCrS 1 100 -768.0000 767.9766 FORMAT "%8.4" ECU_ADDRESS 0x8FF32C /end MEASUREMENT
/begin MEASUREMENT InjCrv_phiPoI2EnvCor "Korrekturwinkel für PoI2" SWORD AngleCrS 1 100 -768.0000 767.9766 FORMAT "%8.4" ECU_ADDRESS 0x7F8E22 /end MEASUREMENT
/begin MEASUREMENT InjCrv_phiPoI2ETSCor_mp "motortemperaturabhängiger Korrekturgrundwert für die Winkelkomponente des Ansteuerbeginns der PoI2" SWORD AngleCrS 1 100 -768.0000 767.9766 FORMAT "%8.4" ECU_ADDRESS 0x8FF32E /end MEASUREMENT
/begin MEASUREMENT InjCrv_phiPoI2RgnCor "correction value for PoI2 setpoint" SWORD AngleCrS 1 100 -768.0000 767.9766 FORMAT "%8.4" ECU_ADDRESS 0x7F8E26 /end MEASUREMENT
/begin MEASUREMENT InjCrv_phiStrtInjSetPoint "Spritzbeginn-Sollwinkel" SWORD AngleCrS 1 100 -768.0000 767.9766 FORMAT "%8.4" ECU_ADDRESS 0x7F8E28 /end MEASUREMENT
/begin MEASUREMENT InjCrv_PiI1RgnVal_mp "Aktivierungswert für die Freigabe PiI1 über das Abgasnachbehandlungssystem" ULONG EGTSwt 1 100 0.00 262.143999939 FORMAT "%13.9" ECU_ADDRESS 0x8FF26C /end MEASUREMENT
/begin MEASUREMENT InjCrv_PiI2RgnVal_mp "Aktivierungswert für die Freigabe PiI2 über das Abgasnachbehandlungssystem" ULONG EGTSwt 1 100 0.00 262.143999939 FORMAT "%13.9" ECU_ADDRESS 0x8FF220 /end MEASUREMENT
/begin MEASUREMENT InjCrv_PoI1RgnTypeVal "activation value for PoI1 demanded by EGT-System" ULONG EGTSwt 1 100 0.00 262.143999939 FORMAT "%13.9" ECU_ADDRESS 0x7F9150 /end MEASUREMENT
/begin MEASUREMENT InjCrv_PoI1RgnVal_mp "Aktivierungswert für die Freigabe der PoI1 über das Abgasnachbehandlungssystem" ULONG EGTSwt 1 100 0.00 262.143999939 FORMAT "%13.9" ECU_ADDRESS 0x8FF2E8 /end MEASUREMENT
/begin MEASUREMENT InjCrv_PoI2EffVal "activation value for PoI2 demanded by EGT-System" ULONG EGTSwt 1 100 0.00 262.143999939 FORMAT "%13.9" ECU_ADDRESS 0x7F9154 /end MEASUREMENT
/begin MEASUREMENT InjCrv_POpPoI1AddCor "kundespezifischer Korrekturwert für Freigabe PoI1" SWORD OneToOne 1 100 -32768.00 32767.00 FORMAT "%8.2" ECU_ADDRESS 0x7F8D80 /end MEASUREMENT
/begin MEASUREMENT InjCrv_POpPoI1Bas_mp "grundwert Freigabe PoI1" SWORD OneToOne 1 100 -32768.00 32767.00 FORMAT "%8.2" ECU_ADDRESS 0x8FF324 /end MEASUREMENT
/begin MEASUREMENT InjCrv_POpPoI1EnvCor "Freigabekorrekturwert für PoI1" SWORD OneToOne 1 100 -32768.00 32767.00 FORMAT "%8.2" ECU_ADDRESS 0x7F8D82 /end MEASUREMENT
/begin MEASUREMENT InjCrv_POpPoI1_mp "korrigierter grundwert Freigabe PoI1" SWORD OneToOne 1 100 -32768.00 32767.00 FORMAT "%8.2" ECU_ADDRESS 0x8FF326 /end MEASUREMENT
/begin MEASUREMENT InjCrv_POpPoI2AddCor "kundenspezifischer Korrekturwert für Freigabe PoI2" SWORD OneToOne 1 100 -32768.00 32767.00 FORMAT "%8.2" ECU_ADDRESS 0x7F8D84 /end MEASUREMENT
/begin MEASUREMENT InjCrv_POpPoI2EnvCor "Korrekturwert für Freigabe PoI2" SWORD OneToOne 1 100 -32768.00 32767.00 FORMAT "%8.2" ECU_ADDRESS 0x7F8D86 /end MEASUREMENT
/begin MEASUREMENT InjCrv_qMI1Des "Sollmenge Haupteinspritzung" SWORD InjMassInj 1 100 -327.6800 327.6700 FORMAT "%8.4" ECU_ADDRESS 0x7F8E2C /end MEASUREMENT
/begin MEASUREMENT InjCrv_qMI1DesByp_mp "Bypass-Label, Kopie von InjCrv_qMI1Des" SWORD InjMassInj 1 100 -327.6800 327.6700 FORMAT "%8.4" ECU_ADDRESS 0x8FF1D0 /end MEASUREMENT
/begin MEASUREMENT InjCrv_qMI1MinPiI1_mp "Minimalmenge der MI1 wenn nur PiI1 abgesetzt wird" SWORD InjMassInj 1 100 -327.6800 327.6700 FORMAT "%8.4" ECU_ADDRESS 0x8FF280 /end MEASUREMENT
/begin MEASUREMENT InjCrv_qMI1MinPiI2_mp "Minimalmenge der MI1 wenn PiI1 und PiI2 abgesetzt werden" SWORD InjMassInj 1 100 -327.6800 327.6700 FORMAT "%8.4" ECU_ADDRESS 0x8FF22E /end MEASUREMENT
/begin MEASUREMENT InjCrv_qMI1MinPoI2_mp "Minimale Einspritzmenge der MI1 bei der PoI2 Berechnung" SWORD InjMassInj 1 100 -327.6800 327.6700 FORMAT "%8.4" ECU_ADDRESS 0x8FF344 /end MEASUREMENT
/begin MEASUREMENT InjCrv_qMI1Min_mp "Minimale Einspritzmenge der Haupteinspritzung 1" SWORD InjMassInj 1 100 -327.6800 327.6700 FORMAT "%8.4" ECU_ADDRESS 0x8FF1D2 /end MEASUREMENT
/begin MEASUREMENT InjCrv_qMI1Nrm_mp "Normalmenge der Einspritzung MI1" SWORD InjMassInj 1 100 -327.6800 327.6700 FORMAT "%8.4" ECU_ADDRESS 0x8FF1D4 /end MEASUREMENT
/begin MEASUREMENT InjCrv_qMI1Rgn "Regenerationswert für die Menge der MI1" SWORD InjMassInj 1 100 -327.6800 327.6700 FORMAT "%8.4" ECU_ADDRESS 0x7F8E2E /end MEASUREMENT
/begin MEASUREMENT InjCrv_qMI1RgnByp_mp "Measure point for Bypass" SWORD InjMassInj 1 100 -327.6800 327.6700 FORMAT "%8.4" ECU_ADDRESS 0x8FF214 /end MEASUREMENT
/begin MEASUREMENT InjCrv_qMI1Set_mp "Sollmenge der Einspritzung MI1" SWORD InjMassInj 1 100 -327.6800 327.6700 FORMAT "%8.4" ECU_ADDRESS 0x8FF1D6 /end MEASUREMENT
/begin MEASUREMENT InjCrv_qPiI1AddCor "kundenspezifische Korrekturmenge für PiI1" SWORD InjMassInj 1 100 -327.6800 327.6700 FORMAT "%8.4" ECU_ADDRESS 0x7F8E30 /end MEASUREMENT
/begin MEASUREMENT InjCrv_qPiI1AddCor2 "kundenspezifische Korrekturmenge für PiI1 bei freigegebener PiI2" SWORD InjMassInj 1 100 -327.6800 327.6700 FORMAT "%8.4" ECU_ADDRESS 0x7F8E32 /end MEASUREMENT
/begin MEASUREMENT InjCrv_qPiI1APSCor2_mp "atmosphärendruckabhängige Korrekturmenge -2 für PiI1 und PiI2" SWORD InjMassInj 1 100 -327.6800 327.6700 FORMAT "%8.4" ECU_ADDRESS 0x8FF2C2 /end MEASUREMENT
/begin MEASUREMENT InjCrv_qPiI1APSCorStrt_mp "quantity correction value dependent on atmospheric pressure" SWORD InjMassInj 1 100 -327.6800 327.6700 FORMAT "%8.4" ECU_ADDRESS 0x8FF2C4 /end MEASUREMENT
/begin MEASUREMENT InjCrv_qPiI1APSCor_mp "atmosphärendruckabhängige Korrekturmenge für Voreinspritzung 1" SWORD InjMassInj 1 100 -327.6800 327.6700 FORMAT "%8.4" ECU_ADDRESS 0x8FF2C6 /end MEASUREMENT
/begin MEASUREMENT InjCrv_qPiI1ATSCor2_mp "ansauglufttemperaturabhängige Korrekturmenge -2 für PiI1 und PiI2" SWORD InjMassInj 1 100 -327.6800 327.6700 FORMAT "%8.4" ECU_ADDRESS 0x8FF2C8 /end MEASUREMENT
/begin MEASUREMENT InjCrv_qPiI1ATSCorStrt_mp "quantity correction value dependent on intake air temperature" SWORD InjMassInj 1 100 -327.6800 327.6700 FORMAT "%8.4" ECU_ADDRESS 0x8FF2CA /end MEASUREMENT
/begin MEASUREMENT InjCrv_qPiI1ATSCor_mp "ansauglufttemperaturabhängige Korrekturmenge für Voreinspritzung 1" SWORD InjMassInj 1 100 -327.6800 327.6700 FORMAT "%8.4" ECU_ADDRESS 0x8FF2CC /end MEASUREMENT
/begin MEASUREMENT InjCrv_qPiI1BasStrt_mp "Einspritzmenge PiI 1 Grundwert im Startzustand" SWORD InjMassInj 1 100 -327.6800 327.6700 FORMAT "%8.4" ECU_ADDRESS 0x8FF21A /end MEASUREMENT
/begin MEASUREMENT InjCrv_qPiI1Bas_mp "Einspritzmenge PiI1 Grundwert" SWORD InjMassInj 1 100 -327.6800 327.6700 FORMAT "%8.4" ECU_ADDRESS 0x6F8168 /end MEASUREMENT
/begin MEASUREMENT InjCrv_qPiI1Des "gewünschte Einspritzmenge PiI 1" SWORD InjMassInj 1 100 -327.6800 327.6700 FORMAT "%8.4" ECU_ADDRESS 0x7F8E34 /end MEASUREMENT
/begin MEASUREMENT InjCrv_qPiI1DesByp_mp "Bypass-Label, Kopie von InjCrv_qPiI1Des" SWORD InjMassInj 1 100 -327.6800 327.6700 FORMAT "%8.4" ECU_ADDRESS 0x8FF282 /end MEASUREMENT
/begin MEASUREMENT InjCrv_qPiI1DynCor_mp "Korrekturgrundwert für dynamische Voreinspritzmengenkorrektur" SWORD InjMassInj 1 100 -327.6800 327.6700 FORMAT "%8.4" ECU_ADDRESS 0x8FF2B6 /end MEASUREMENT
/begin MEASUREMENT InjCrv_qPiI1EnvCor "Korrekturmenge für Voreinspritzung 1" SWORD InjMassInj 1 100 -327.6800 327.6700 FORMAT "%8.4" ECU_ADDRESS 0x7F8E36 /end MEASUREMENT
/begin MEASUREMENT InjCrv_qPiI1EnvCor2 "Korrekturmenge für Voreinspritzung 1 bei freigegebener PiI2" SWORD InjMassInj 1 100 -327.6800 327.6700 FORMAT "%8.4" ECU_ADDRESS 0x7F8E38 /end MEASUREMENT
/begin MEASUREMENT InjCrv_qPiI1EnvCorStrt "Korrekturmenge für Voreinspritzung 1 Start" SWORD InjMassInj 1 100 -327.6800 327.6700 FORMAT "%8.4" ECU_ADDRESS 0x7F8E3A /end MEASUREMENT
/begin MEASUREMENT InjCrv_qPiI1ETSCor12_mp """motortemperaturabhängige Korrekturmenge für PiI1 bei inaktiver PiI2""" SWORD InjMassInj 1 100 -327.6800 327.6700 FORMAT "%8.4" ECU_ADDRESS 0x8FF2CE /end MEASUREMENT
/begin MEASUREMENT InjCrv_qPiI1ETSCor1_mp "motortemperaturabhängige Korrekturmenge -1 für PiI1 und PiI2" SWORD InjMassInj 1 100 -327.6800 327.6700 FORMAT "%8.4" ECU_ADDRESS 0x8FF2D0 /end MEASUREMENT
/begin MEASUREMENT InjCrv_qPiI1ETSCor2_mp "motortemperaturabhängige Korrekturmenge -2 für PiI1 und PiI2" SWORD InjMassInj 1 100 -327.6800 327.6700 FORMAT "%8.4" ECU_ADDRESS 0x8FF2D2 /end MEASUREMENT
/begin MEASUREMENT InjCrv_qPiI1ETSCorStrt_mp "quantity correction value dependent on engine temperature" SWORD InjMassInj 1 100 -327.6800 327.6700 FORMAT "%8.4" ECU_ADDRESS 0x8FF2D4 /end MEASUREMENT
/begin MEASUREMENT InjCrv_qPiI1ETSCor_mp "motortemperaturabhängige Korrekturmenge für Voreinspritzung 1" SWORD InjMassInj 1 100 -327.6800 327.6700 FORMAT "%8.4" ECU_ADDRESS 0x8FF2D6 /end MEASUREMENT
/begin MEASUREMENT InjCrv_qPiI1Max_mp "maximale Einspritzmenge der PiI1" SWORD InjMassInj 1 100 -327.6800 327.6700 FORMAT "%8.4" ECU_ADDRESS 0x8FF284 /end MEASUREMENT
/begin MEASUREMENT InjCrv_qPiI1Rgn "Regenerationswert für die Einspritmenge der PiI1" SWORD InjMassInj 1 100 -327.6800 327.6700 FORMAT "%8.4" ECU_ADDRESS 0x7F8E3C /end MEASUREMENT
/begin MEASUREMENT InjCrv_qPiI1RgnByp_mp "Measure point for Bypass" SWORD InjMassInj 1 100 -327.6800 327.6700 FORMAT "%8.4" ECU_ADDRESS 0x8FF2E4 /end MEASUREMENT
/begin MEASUREMENT InjCrv_qPiI1SetLimMax_mp "begrenzte maximale Solleinspritzmenge PiI1" SWORD InjMassInj 1 100 -327.6800 327.6700 FORMAT "%8.4" ECU_ADDRESS 0x8FF286 /end MEASUREMENT
/begin MEASUREMENT InjCrv_qPiI1SetLim_mp "begrenzte Solleinspritzmenge PiI1" SWORD InjMassInj 1 100 -327.6800 327.6700 FORMAT "%8.4" ECU_ADDRESS 0x8FF288 /end MEASUREMENT
/begin MEASUREMENT InjCrv_qPiI1SetRaw_mp "Rohwert der Einspritzmenge PiI1" SWORD InjMassInj 1 100 -327.6800 327.6700 FORMAT "%8.4" ECU_ADDRESS 0x8FF28A /end MEASUREMENT
/begin MEASUREMENT InjCrv_qPiI1Set_mp "Sollwert der Einspritzmenge PiI1" SWORD InjMassInj 1 100 -327.6800 327.6700 FORMAT "%8.4" ECU_ADDRESS 0x8FF28C /end MEASUREMENT
/begin MEASUREMENT InjCrv_qPiI2AddCor "kundenspezifische Korrekturmenge für PiI2" SWORD InjMassInj 1 100 -327.6800 327.6700 FORMAT "%8.4" ECU_ADDRESS 0x7F8E3E /end MEASUREMENT
/begin MEASUREMENT InjCrv_qPiI2APSCorStrt_mp "PiI2 quantity correction value dependent on atmospheric pressure" SWORD InjMassInj 1 100 -327.6800 327.6700 FORMAT "%8.4" ECU_ADDRESS 0x8FF24C /end MEASUREMENT
/begin MEASUREMENT InjCrv_qPiI2APSCor_mp "atmosphärendruckabhängige Korrekturmenge für Voreinspritzung 2" SWORD InjMassInj 1 100 -327.6800 327.6700 FORMAT "%8.4" ECU_ADDRESS 0x8FF24E /end MEASUREMENT
/begin MEASUREMENT InjCrv_qPiI2ATSCorStrt_mp "PiI2 quantity correction value dependent on intake air temperature" SWORD InjMassInj 1 100 -327.6800 327.6700 FORMAT "%8.4" ECU_ADDRESS 0x8FF250 /end MEASUREMENT
/begin MEASUREMENT InjCrv_qPiI2ATSCor_mp "ansauglufttemperaturabhängige Korrekturmenge für Voreinspritzung 2" SWORD InjMassInj 1 100 -327.6800 327.6700 FORMAT "%8.4" ECU_ADDRESS 0x8FF252 /end MEASUREMENT
/begin MEASUREMENT InjCrv_qPiI2BasStrt_mp "Einspritzmenge PiI 2 Grundwert im Startzustand" SWORD InjMassInj 1 100 -327.6800 327.6700 FORMAT "%8.4" ECU_ADDRESS 0x8FF266 /end MEASUREMENT
/begin MEASUREMENT InjCrv_qPiI2Bas_mp "Einspritzmenge PiI2 Grundwert" SWORD InjMassInj 1 100 -327.6800 327.6700 FORMAT "%8.4" ECU_ADDRESS 0x6F8164 /end MEASUREMENT
/begin MEASUREMENT InjCrv_qPiI2Des "gewünschte Einspritzmenge PiI 2" SWORD InjMassInj 1 100 -327.6800 327.6700 FORMAT "%8.4" ECU_ADDRESS 0x7F8E40 /end MEASUREMENT
/begin MEASUREMENT InjCrv_qPiI2DesByp_mp "Bypass-Label, Kopie von InjCrv_qPiI2Des" SWORD InjMassInj 1 100 -327.6800 327.6700 FORMAT "%8.4" ECU_ADDRESS 0x8FF28E /end MEASUREMENT
/begin MEASUREMENT InjCrv_qPiI2EnvCor "Korrekturmenge für Voreinspritzung 2" SWORD InjMassInj 1 100 -327.6800 327.6700 FORMAT "%8.4" ECU_ADDRESS 0x7F8E42 /end MEASUREMENT
/begin MEASUREMENT InjCrv_qPiI2EnvCorStrt "Korrekturmenge für Voreinspritzung 2 start" SWORD InjMassInj 1 100 -327.6800 327.6700 FORMAT "%8.4" ECU_ADDRESS 0x7F8E44 /end MEASUREMENT
/begin MEASUREMENT InjCrv_qPiI2ETSCorStrt_mp "PiI2 quantity correction value dependent on engine temperature" SWORD InjMassInj 1 100 -327.6800 327.6700 FORMAT "%8.4" ECU_ADDRESS 0x8FF254 /end MEASUREMENT
/begin MEASUREMENT InjCrv_qPiI2ETSCor_mp "motortemperaturabhängige Korrekturmenge für Voreinspritzung 2" SWORD InjMassInj 1 100 -327.6800 327.6700 FORMAT "%8.4" ECU_ADDRESS 0x8FF256 /end MEASUREMENT
/begin MEASUREMENT InjCrv_qPiI2Max_mp "maximale Einspritzmenge der PiI2" SWORD InjMassInj 1 100 -327.6800 327.6700 FORMAT "%8.4" ECU_ADDRESS 0x8FF230 /end MEASUREMENT
/begin MEASUREMENT InjCrv_qPiI2Rgn "Regenerationswert für die Einspritmenge der PiI2" SWORD InjMassInj 1 100 -327.6800 327.6700 FORMAT "%8.4" ECU_ADDRESS 0x7F8E46 /end MEASUREMENT
/begin MEASUREMENT InjCrv_qPiI2RgnByp_mp "Measure point for Bypass" SWORD InjMassInj 1 100 -327.6800 327.6700 FORMAT "%8.4" ECU_ADDRESS 0x8FF25E /end MEASUREMENT
/begin MEASUREMENT InjCrv_qPiI2SetLimMax_mp "begrenzte maximale Solleinspritzmenge PiI2" SWORD InjMassInj 1 100 -327.6800 327.6700 FORMAT "%8.4" ECU_ADDRESS 0x8FF232 /end MEASUREMENT
/begin MEASUREMENT InjCrv_qPiI2SetLim_mp "begrenzte Solleinspritzmenge PiI2" SWORD InjMassInj 1 100 -327.6800 327.6700 FORMAT "%8.4" ECU_ADDRESS 0x8FF234 /end MEASUREMENT
/begin MEASUREMENT InjCrv_qPiI2SetRaw_mp "Rohwert der Einspritzmenge PiI2" SWORD InjMassInj 1 100 -327.6800 327.6700 FORMAT "%8.4" ECU_ADDRESS 0x8FF236 /end MEASUREMENT
/begin MEASUREMENT InjCrv_qPiI2Set_mp "Sollwert der Einspritzmenge PiI2" SWORD InjMassInj 1 100 -327.6800 327.6700 FORMAT "%8.4" ECU_ADDRESS 0x8FF238 /end MEASUREMENT
/begin MEASUREMENT InjCrv_qPiI3Des "gewünschte Einspritzmenge PiI 3" SWORD InjMassInj 1 100 -327.6800 327.6700 FORMAT "%8.4" ECU_ADDRESS 0x7F8E48 /end MEASUREMENT
/begin MEASUREMENT InjCrv_qPiI3DesByp_mp "Bypass-Label, Kopie von InjCrv_qPiI3Des" SWORD InjMassInj 1 100 -327.6800 327.6700 FORMAT "%8.4" ECU_ADDRESS 0x8FF290 /end MEASUREMENT
/begin MEASUREMENT InjCrv_qPiIMin_mp "minimale Einspritzmenge einer Voreinspritzung, ohne Wellenkorrektur" SWORD InjMassInj 1 100 -327.6800 327.6700 FORMAT "%8.4" ECU_ADDRESS 0x8FF292 /end MEASUREMENT
/begin MEASUREMENT InjCrv_qPoI1AddCor "kundenspezifische Korrekturmenge für PoI1" SWORD InjMassInj 1 100 -327.6800 327.6700 FORMAT "%8.4" ECU_ADDRESS 0x7F8E4A /end MEASUREMENT
/begin MEASUREMENT InjCrv_qPoI1APSCor_mp "atmospärendruckabhängige Korrekturmenge für PoI1" SWORD InjMassInj 1 100 -327.6800 327.6700 FORMAT "%8.4" ECU_ADDRESS 0x8FF314 /end MEASUREMENT
/begin MEASUREMENT InjCrv_qPoI1Bas_mp "Grundwert der Einspritzmenge PoI1" SWORD InjMassInj 1 100 -327.6800 327.6700 FORMAT "%8.4" ECU_ADDRESS 0x8FF2FE /end MEASUREMENT
/begin MEASUREMENT InjCrv_qPoI1Clsn "zylinderselektiver Mengenanteil PoI1 bei Kollision" SWORD InjMassInj 1 100 -327.6800 327.6700 FORMAT "%8.4" ECU_ADDRESS 0x7F8E4C /end MEASUREMENT
/begin MEASUREMENT InjCrv_qPoI1Des "gewünschte Einspritzmenge PoI1" SWORD InjMassInj 1 100 -327.6800 327.6700 FORMAT "%8.4" ARRAY_SIZE 6 ECU_ADDRESS 0x7F9234 /end MEASUREMENT
/begin MEASUREMENT InjCrv_qPoI1DesByp_mp "Bypass-Label, Kopie von InjCrv_qPoI1Des" SWORD InjMassInj 1 100 -327.6800 327.6700 FORMAT "%8.4" ECU_ADDRESS 0x8FF300 /end MEASUREMENT
/begin MEASUREMENT InjCrv_qPoI1Des_mp "Sollmenge Nacheinspritzung 1" SWORD InjMassInj 1 100 -327.6800 327.6700 FORMAT "%8.4" ECU_ADDRESS 0x8FF302 /end MEASUREMENT
/begin MEASUREMENT InjCrv_qPoI1EnvCor "umgebungsbedingungsabhängige Korrekturmenge für PoI1" SWORD InjMassInj 1 100 -327.6800 327.6700 FORMAT "%8.4" ECU_ADDRESS 0x7F8E4E /end MEASUREMENT
/begin MEASUREMENT InjCrv_qPoI1ETSCor_mp "motortemperaturabhängige Korrekturmenge für PoI1" SWORD InjMassInj 1 100 -327.6800 327.6700 FORMAT "%8.4" ECU_ADDRESS 0x8FF316 /end MEASUREMENT
/begin MEASUREMENT InjCrv_qPoI1Lim_mp "begrenzte Einspritzmenge PoI1" SWORD InjMassInj 1 100 -327.6800 327.6700 FORMAT "%8.4" ECU_ADDRESS 0x8FF304 /end MEASUREMENT
/begin MEASUREMENT InjCrv_qPoI1Max_mp "Maximalwert der Einspritzmenge PoI1" SWORD InjMassInj 1 100 -327.6800 327.6700 FORMAT "%8.4" ECU_ADDRESS 0x8FF306 /end MEASUREMENT
/begin MEASUREMENT InjCrv_qPoI1Min_mp "Minimalwert der Einspritzmenge PoI1" SWORD InjMassInj 1 100 -327.6800 327.6700 FORMAT "%8.4" ECU_ADDRESS 0x8FF308 /end MEASUREMENT
/begin MEASUREMENT InjCrv_qPoI1Rgn "Grundwert Einspritzmenge PoI1 im Regenerationsbetrieb" SWORD InjMassInj 1 100 -327.6800 327.6700 FORMAT "%8.4" ECU_ADDRESS 0x7F8E50 /end MEASUREMENT
/begin MEASUREMENT InjCrv_qPoI1Rgn1_mp "Regeneration value 1 for the PoI1 injectin quantity" SWORD InjMassInj 1 100 -327.6800 327.6700 FORMAT "%8.4" ECU_ADDRESS 0x8FF31E /end MEASUREMENT
/begin MEASUREMENT InjCrv_qPoI1Rgn2_mp "Regeneration value 2 for the PoI1 injectin quantity" SWORD InjMassInj 1 100 -327.6800 327.6700 FORMAT "%8.4" ECU_ADDRESS 0x8FF320 /end MEASUREMENT
/begin MEASUREMENT InjCrv_qPoI1RgnByp_mp "Measure point for Bypass" SWORD InjMassInj 1 100 -327.6800 327.6700 FORMAT "%8.4" ECU_ADDRESS 0x8FF322 /end MEASUREMENT
/begin MEASUREMENT InjCrv_qPoI1SetLim_mp "PoI1 total quantity before limitations" SWORD InjMassInj 1 100 -327.6800 327.6700 FORMAT "%8.4" ECU_ADDRESS 0x8FF30A /end MEASUREMENT
/begin MEASUREMENT InjCrv_qPoI1Set_mp "Sollwert der Einspritzmenge PoI1" SWORD InjMassInj 1 100 -327.6800 327.6700 FORMAT "%8.4" ECU_ADDRESS 0x8FF30C /end MEASUREMENT
/begin MEASUREMENT InjCrv_qPoI2AddCor "kundenspezifische Korrekturmenge für PoI2" SWORD InjMassInj 1 100 -327.6800 327.6700 FORMAT "%8.4" ECU_ADDRESS 0x7F8E52 /end MEASUREMENT
/begin MEASUREMENT InjCrv_qPoI2ATSCor_mp "ansauglufttemperaturabhängige Korrekturmenge für PoI2" SWORD InjMassInj 1 100 -327.6800 327.6700 FORMAT "%8.4" ECU_ADDRESS 0x8FF328 /end MEASUREMENT
/begin MEASUREMENT InjCrv_qPoI2Bas_mp "Einspritzmenge PoI2 Grundwert" SWORD InjMassInj 1 100 -327.6800 327.6700 FORMAT "%8.4" ECU_ADDRESS 0x8FF346 /end MEASUREMENT
/begin MEASUREMENT InjCrv_qPoI2Cor_mp "korrigierter Grundwert der Einspritzmenge PoI2" SWORD InjMassInj 1 100 -327.6800 327.6700 FORMAT "%8.4" ECU_ADDRESS 0x8FF348 /end MEASUREMENT
/begin MEASUREMENT InjCrv_qPoI2Des "Sollmenge Nacheinspritzung 2" SWORD InjMassInj 1 100 -327.6800 327.6700 FORMAT "%8.4" ARRAY_SIZE 6 ECU_ADDRESS 0x7F9240 /end MEASUREMENT
/begin MEASUREMENT InjCrv_qPoI2Des_mp "Sollmenge Nacheinspritzung 2" SWORD InjMassInj 1 100 -327.6800 327.6700 FORMAT "%8.4" ECU_ADDRESS 0x8FF34A /end MEASUREMENT
/begin MEASUREMENT InjCrv_qPoI2Eff "wirksame Einspritzmenge PoI2" SWORD InjMassInj 1 100 -327.6800 327.6700 FORMAT "%8.4" ARRAY_SIZE 6 ECU_ADDRESS 0x7F924C /end MEASUREMENT
/begin MEASUREMENT InjCrv_qPoI2Eff_mp "Wirksame Menge der PoI2" SWORD InjMassInj 1 100 -327.6800 327.6700 FORMAT "%8.4" ECU_ADDRESS 0x8FF34C /end MEASUREMENT
/begin MEASUREMENT InjCrv_qPoI2EnvCor "Korrekturmenge für PoI2" SWORD InjMassInj 1 100 -327.6800 327.6700 FORMAT "%8.4" ECU_ADDRESS 0x7F8E54 /end MEASUREMENT
/begin MEASUREMENT InjCrv_qPoI2ETSCor_mp "motortemperaturabhängige Korrekturmenge für PoI2" SWORD InjMassInj 1 100 -327.6800 327.6700 FORMAT "%8.4" ECU_ADDRESS 0x8FF32A /end MEASUREMENT
/begin MEASUREMENT InjCrv_qPoI2Lim_mp "begrenzter Sollwert, Einspritzmenge PoI2" SWORD InjMassInj 1 100 -327.6800 327.6700 FORMAT "%8.4" ECU_ADDRESS 0x8FF34E /end MEASUREMENT
/begin MEASUREMENT InjCrv_qPoI2Max_mp "maximale Einspritzmenge PoI2" SWORD InjMassInj 1 100 -327.6800 327.6700 FORMAT "%8.4" ECU_ADDRESS 0x8FF350 /end MEASUREMENT
/begin MEASUREMENT InjCrv_qPoI2Min_mp "minimale Einspritzmenge PoI2" SWORD InjMassInj 1 100 -327.6800 327.6700 FORMAT "%8.4" ECU_ADDRESS 0x8FF352 /end MEASUREMENT
/begin MEASUREMENT InjCrv_qPoI2RgnCor "correction value for PoI2 quantity" SWORD InjMassInj 1 100 -327.6800 327.6700 FORMAT "%8.4" ECU_ADDRESS 0x7F8E58 /end MEASUREMENT
/begin MEASUREMENT InjCrv_qPoI2Set_mp "Sollwert Einspritzmenge PoI2" SWORD InjMassInj 1 100 -327.6800 327.6700 FORMAT "%8.4" ECU_ADDRESS 0x8FF354 /end MEASUREMENT
/begin MEASUREMENT InjCrv_stPiI1_mp "Freigabestatus PiI1" UBYTE OneToOne 1 100 0.00 255.0 FORMAT "%5.1" ECU_ADDRESS 0x6F816A /end MEASUREMENT
/begin MEASUREMENT InjCrv_stPiI2_mp "Freigabestatus PiI2" UBYTE OneToOne 1 100 0.00 255.0 FORMAT "%5.1" ECU_ADDRESS 0x6F8166 /end MEASUREMENT
/begin MEASUREMENT InjCrv_stPoI1_mp "Freigabestatus PoI1" UBYTE OneToOne 1 100 0.00 255.0 FORMAT "%5.1" ECU_ADDRESS 0x8FF30E /end MEASUREMENT
/begin MEASUREMENT InjCrv_stPoI2 "Freigabestatus PoI2" UBYTE OneToOne 1 100 0.00 255.0 FORMAT "%5.1" ECU_ADDRESS 0x7F88F2 /end MEASUREMENT
/begin MEASUREMENT InjCrv_tiMI1ET "geschätzte Ansteuerdauer MI1" SWORD InjTime_us 1 100 -32768.00 32767.00 FORMAT "%8.2" ECU_ADDRESS 0x7F8E5E /end MEASUREMENT
/begin MEASUREMENT InjCrv_tiMI1Rgn "value for regeneration of time comp. SOE MI1" SWORD InjTime_us 1 100 -32768.00 32767.00 FORMAT "%8.2" ECU_ADDRESS 0x7F8E60 /end MEASUREMENT
/begin MEASUREMENT InjCrv_tiPiI1AddCor "kundenspezifische Korrekturzeit für PiI1" SWORD InjTime_us 1 100 -32768.00 32767.00 FORMAT "%8.2" ECU_ADDRESS 0x7F8E62 /end MEASUREMENT
/begin MEASUREMENT InjCrv_tiPiI1AddCor2 "zusätzliche Korrekturzeit -2 für PiI1 (n sync)" SWORD InjTime_us 1 100 -32768.00 32767.00 FORMAT "%8.2" ECU_ADDRESS 0x7F8E64 /end MEASUREMENT
/begin MEASUREMENT InjCrv_tiPiI1BasStrt_mp "korrigierter Grundwert Zeitkomponente im Startzustand" SWORD InjTime_us 1 100 -32768.00 32767.00 FORMAT "%8.2" ECU_ADDRESS 0x8FF21C /end MEASUREMENT
/begin MEASUREMENT InjCrv_tiPiI1Bas_mp "Zeitkomponente Ansteuerbeginn PiI1Grundwert" SWORD InjTime_us 1 100 -32768.00 32767.00 FORMAT "%8.2" ECU_ADDRESS 0x6F8162 /end MEASUREMENT
/begin MEASUREMENT InjCrv_tiPiI1CorRaw_mp "korrigierter Grundwert Zeitkomponente" SWORD InjTime_us 1 100 -32768.00 32767.00 FORMAT "%8.2" ECU_ADDRESS 0x8FF294 /end MEASUREMENT
/begin MEASUREMENT InjCrv_tiPiI1Cor_mp "korrigierter Grundwert der Zeitkomponente Ansteuerbeginn PiI" SWORD InjTime_us 1 100 -32768.00 32767.00 FORMAT "%8.2" ECU_ADDRESS 0x8FF296 /end MEASUREMENT
/begin MEASUREMENT InjCrv_tiPiI1Des "gewünschte Zeitkomponente Ansteuerbeginn PiI1" SWORD InjTime_us 1 100 -32768.00 32767.00 FORMAT "%8.2" ECU_ADDRESS 0x7F8E66 /end MEASUREMENT
/begin MEASUREMENT InjCrv_tiPiI1DesByp_mp "Bypass-Label, Kopie von InjCrv_tiPiI1Des" SWORD InjTime_us 1 100 -32768.00 32767.00 FORMAT "%8.2" ECU_ADDRESS 0x8FF298 /end MEASUREMENT
/begin MEASUREMENT InjCrv_tiPiI1DynCor_mp "time correction base value for ET, AP and DQ specific correction" SWORD InjTime_us 1 100 -32768.00 32767.00 FORMAT "%8.2" ECU_ADDRESS 0x8FF2B8 /end MEASUREMENT
/begin MEASUREMENT InjCrv_tiPiI1EnvCor "Korrekturzeit für PiI1" SWORD InjTime_us 1 100 -32768.00 32767.00 FORMAT "%8.2" ECU_ADDRESS 0x7F8E68 /end MEASUREMENT
/begin MEASUREMENT InjCrv_tiPiI1EnvCor2 "umgebungsabhängige Korrekturzeit -2 für PiI1 (n sync)" SWORD InjTime_us 1 100 -32768.00 32767.00 FORMAT "%8.2" ECU_ADDRESS 0x7F8E6A /end MEASUREMENT
/begin MEASUREMENT InjCrv_tiPiI1EnvCorStrt "Korrekturzeit für PiI1für inaktive PiI2" SWORD InjTime_us 1 100 -32768.00 32767.00 FORMAT "%8.2" ECU_ADDRESS 0x7F8E6C /end MEASUREMENT
/begin MEASUREMENT InjCrv_tiPiI1ETNoCor_mp "geschätzte Ansteuerdauer der PiI1 ohne Korrekturen" SWORD InjTime_us 1 100 -32768.00 32767.00 FORMAT "%8.2" ECU_ADDRESS 0x8FF29A /end MEASUREMENT
/begin MEASUREMENT InjCrv_tiPiI1ETSCor12_mp "motortemperaturabhängiger Korrekturgrundwert für die Zeitkomponente des Ansteuerbeginns der PiI1 bei inaktiver PiI2" SWORD InjTime_us 1 100 -32768.00 32767.00 FORMAT "%8.2" ECU_ADDRESS 0x8FF2D8 /end MEASUREMENT
/begin MEASUREMENT InjCrv_tiPiI1ETSCor1_mp "motortemperaturabhängiger Korrekturgrundwert -1 für die Zeitkomponente Ansteuerbeginn PiI1" SWORD InjTime_us 1 100 -32768.00 32767.00 FORMAT "%8.2" ECU_ADDRESS 0x8FF2DA /end MEASUREMENT
/begin MEASUREMENT InjCrv_tiPiI1ETSCor2_mp "motortemperaturabhängiger Korrekturgrundwert -2 für die Zeitkomponente Ansteuerbeginn PiI1" SWORD InjTime_us 1 100 -32768.00 32767.00 FORMAT "%8.2" ECU_ADDRESS 0x8FF2DC /end MEASUREMENT
/begin MEASUREMENT InjCrv_tiPiI1ETSCorStrt_mp "motortemperaturabhängiger Korrekturgrundwert für die Zeitkomponente des Ansteuerbeginns der PiI1 bei inaktiver PiI2 im Startzust" SWORD InjTime_us 1 100 -32768.00 32767.00 FORMAT "%8.2" ECU_ADDRESS 0x8FF2DE /end MEASUREMENT
/begin MEASUREMENT InjCrv_tiPiI1ETSCor_mp "motortemperaturabhängiger Korrekturgrundwert für die Zeitkomponente des Ansteuerbeginns der PiI1" SWORD InjTime_us 1 100 -32768.00 32767.00 FORMAT "%8.2" ECU_ADDRESS 0x8FF2E0 /end MEASUREMENT
/begin MEASUREMENT InjCrv_tiPiI1ET_mp "geschätzte Ansteuerdauer der PiI1" SWORD InjTime_us 1 100 -32768.00 32767.00 FORMAT "%8.2" ECU_ADDRESS 0x8FF29C /end MEASUREMENT
/begin MEASUREMENT InjCrv_tiPiI1Hyd_mp "Zeitkomponente Ansteuerbeginn PiI1 für die Berechnung des Ansteuerbeginns der PiI2" SWORD InjTime_us 1 100 -32768.00 32767.00 FORMAT "%8.2" ECU_ADDRESS 0x8FF29E /end MEASUREMENT
/begin MEASUREMENT InjCrv_tiPiI1Min_mp "Minimaler Zeitanteil für PiI1 relativ zur MI" SWORD InjTime_us 1 100 -32768.00 32767.00 FORMAT "%8.2" ECU_ADDRESS 0x8FF2A0 /end MEASUREMENT
/begin MEASUREMENT InjCrv_tiPiI1RelMI1_mp "Zeitkomponente Ansteuerbeginn PiI1 relativ zur MI1" SWORD InjTime_us 1 100 -32768.00 32767.00 FORMAT "%8.2" ECU_ADDRESS 0x8FF2A2 /end MEASUREMENT
/begin MEASUREMENT InjCrv_tiPiI1RelTot_mp "Ansteuerbeginnabstand PiI1 aus Winkel- und Zeitkomponente" SWORD InjTime_us 1 100 -32768.00 32767.00 FORMAT "%8.2" ECU_ADDRESS 0x8FF2A4 /end MEASUREMENT
/begin MEASUREMENT InjCrv_tiPiI1Rel_mp "Zeitkomponente Ansteuerbeginn PiI1 relativ zur MI" SWORD InjTime_us 1 100 -32768.00 32767.00 FORMAT "%8.2" ECU_ADDRESS 0x8FF2A6 /end MEASUREMENT
/begin MEASUREMENT InjCrv_tiPiI1Rgn "Regenerationswert für die  Zeitkomponente des Ansteuerbeginns der PiI1" SWORD InjTime_us 1 100 -32768.00 32767.00 FORMAT "%8.2" ECU_ADDRESS 0x7F8E6E /end MEASUREMENT
/begin MEASUREMENT InjCrv_tiPiI1RgnByp_mp "Measure point for Bypass" SWORD InjTime_us 1 100 -32768.00 32767.00 FORMAT "%8.2" ECU_ADDRESS 0x8FF2E6 /end MEASUREMENT
/begin MEASUREMENT InjCrv_tiPiI1Tot_mp "gesamte Ansteuerdauer der Pil1" SWORD InjTime_us 1 100 -32768.00 32767.00 FORMAT "%8.2" ECU_ADDRESS 0x8FF2A8 /end MEASUREMENT
/begin MEASUREMENT InjCrv_tiPiI2AddCor "kundenspezifische Korrekturzeit für PiI2" SWORD InjTime_us 1 100 -32768.00 32767.00 FORMAT "%8.2" ECU_ADDRESS 0x7F8E70 /end MEASUREMENT
/begin MEASUREMENT InjCrv_tiPiI2BasStrt_mp "korrigierter Grundwert Zeitkomponente im Startzustand" SWORD InjTime_us 1 100 -32768.00 32767.00 FORMAT "%8.2" ECU_ADDRESS 0x8FF268 /end MEASUREMENT
/begin MEASUREMENT InjCrv_tiPiI2Bas_mp "Zeitkomponente Ansteuerbeginn PiI2 Grundwert" SWORD InjTime_us 1 100 -32768.00 32767.00 FORMAT "%8.2" ECU_ADDRESS 0x8FF264 /end MEASUREMENT
/begin MEASUREMENT InjCrv_tiPiI2CorRaw_mp "korrigierter Grundwert Zeitkomponente" SWORD InjTime_us 1 100 -32768.00 32767.00 FORMAT "%8.2" ECU_ADDRESS 0x8FF23A /end MEASUREMENT
/begin MEASUREMENT InjCrv_tiPiI2Cor_mp "korrigierter Grundwert der  Zeitkomponente Ansteuerbeginn PiI2" SWORD InjTime_us 1 100 -32768.00 32767.00 FORMAT "%8.2" ECU_ADDRESS 0x8FF23C /end MEASUREMENT
/begin MEASUREMENT InjCrv_tiPiI2Des "gewünschte Zeitkomponente für Ansteuerbeginn PiI2" SWORD InjTime_us 1 100 -32768.00 32767.00 FORMAT "%8.2" ECU_ADDRESS 0x7F8E72 /end MEASUREMENT
/begin MEASUREMENT InjCrv_tiPiI2DesByp_mp "Bypass-Label, Kopie von InjCrv_tiPiI2Des" SWORD InjTime_us 1 100 -32768.00 32767.00 FORMAT "%8.2" ECU_ADDRESS 0x8FF2AA /end MEASUREMENT
/begin MEASUREMENT InjCrv_tiPiI2EnvCor "Korrekturzeit für PiI2" SWORD InjTime_us 1 100 -32768.00 32767.00 FORMAT "%8.2" ECU_ADDRESS 0x7F8E74 /end MEASUREMENT
/begin MEASUREMENT InjCrv_tiPiI2EnvCorStrt "" SWORD InjTime_us 1 100 -32768.00 32767.00 FORMAT "%8.2" ECU_ADDRESS 0x7F8E76 /end MEASUREMENT
/begin MEASUREMENT InjCrv_tiPiI2ETSCor_mp "motortemperaturabhängiger Korrekturgrundwert für die Zeitkomponente des Ansteuerbeginns der PiI2" SWORD InjTime_us 1 100 -32768.00 32767.00 FORMAT "%8.2" ECU_ADDRESS 0x8FF25A /end MEASUREMENT
/begin MEASUREMENT InjCrv_tiPiI2ET_mp "geschätzte Ansteuerdauer PiI2" SWORD InjTime_us 1 100 -32768.00 32767.00 FORMAT "%8.2" ECU_ADDRESS 0x8FF23E /end MEASUREMENT
/begin MEASUREMENT InjCrv_tiPiI2RelMI_mp "Zeitkomponente Ansteuerbeginn PiI2 relaitv zur MI" SWORD InjTime_us 1 100 -32768.00 32767.00 FORMAT "%8.2" ECU_ADDRESS 0x8FF240 /end MEASUREMENT
/begin MEASUREMENT InjCrv_tiPiI2RelPiI1_mp "Zeitkomponente Ansteuerbeginn PiI2 relativ zur PiI1" SWORD InjTime_us 1 100 -32768.00 32767.00 FORMAT "%8.2" ECU_ADDRESS 0x8FF242 /end MEASUREMENT
/begin MEASUREMENT InjCrv_tiPiI2RelTot_mp "Ansteuerbeginnabstand PiI2 aus Winkel- und Zeitkomponente" SWORD InjTime_us 1 100 -32768.00 32767.00 FORMAT "%8.2" ECU_ADDRESS 0x8FF244 /end MEASUREMENT
/begin MEASUREMENT InjCrv_tiPiI2Rgn "Regenerationswert für die  Zeitkomponente des Ansteuerbeginns der PiI2" SWORD InjTime_us 1 100 -32768.00 32767.00 FORMAT "%8.2" ECU_ADDRESS 0x7F8E78 /end MEASUREMENT
/begin MEASUREMENT InjCrv_tiPiI2RgnByp_mp "Measure point for Bypass" SWORD InjTime_us 1 100 -32768.00 32767.00 FORMAT "%8.2" ECU_ADDRESS 0x8FF260 /end MEASUREMENT
/begin MEASUREMENT InjCrv_tiPiI2Tot_mp "gesamte Ansteuerdauer der Pil2" SWORD InjTime_us 1 100 -32768.00 32767.00 FORMAT "%8.2" ECU_ADDRESS 0x8FF246 /end MEASUREMENT
/begin MEASUREMENT InjCrv_tiPoI1ET_mp "geschätzte Ansteuerdauer PoI1" SWORD InjTime_us 1 100 -32768.00 32767.00 FORMAT "%8.2" ECU_ADDRESS 0x8FF310 /end MEASUREMENT
/begin MEASUREMENT InjCrv_tiPoI2AddCor "kundenspezifische Korrekturzeit für PoI2" SWORD InjTime_us 1 100 -32768.00 32767.00 FORMAT "%8.2" ECU_ADDRESS 0x7F8E7A /end MEASUREMENT
/begin MEASUREMENT InjCrv_tiPoI2ATSCor_mp "ansauglufttemperaturabhängiger Korrekturgrundwert für die Zeitkomponente des Ansteuerbeginns der PoI2" SWORD InjTime_us 1 100 -32768.00 32767.00 FORMAT "%8.2" ECU_ADDRESS 0x8FF33C /end MEASUREMENT
/begin MEASUREMENT InjCrv_tiPoI2EnvCor "Korrekturzeit für PoI2" SWORD InjTime_us 1 100 -32768.00 32767.00 FORMAT "%8.2" ECU_ADDRESS 0x7F8E7E /end MEASUREMENT
/begin MEASUREMENT InjCrv_tiPoI2ETSCor_mp "motortemperaturabhängiger Korrekturgrundwert für die Zeitkomponente des Ansteuerbeginns der PoI2" SWORD InjTime_us 1 100 -32768.00 32767.00 FORMAT "%8.2" ECU_ADDRESS 0x8FF33E /end MEASUREMENT
/begin MEASUREMENT InjCrv_tiPoI2ET_mp "geschätzte Ansteuerdauer PoI2" SWORD InjTime_us 1 100 -32768.00 32767.00 FORMAT "%8.2" ECU_ADDRESS 0x8FF356 /end MEASUREMENT
/begin MEASUREMENT InjCrv_tiPoI2RgnCor "correction value for PoI2 time" SWORD InjTime_us 1 100 -32768.00 32767.00 FORMAT "%8.2" ECU_ADDRESS 0x7F8E82 /end MEASUREMENT
/begin MEASUREMENT InjCrv_volMI1Cor_mp "Einspritzvolumen MI1 mit Korrekturwerten" SWORD InjQntInj 1 100 -327.6800 327.6700 FORMAT "%8.4" ECU_ADDRESS 0x8FF1D8 /end MEASUREMENT
/begin MEASUREMENT InjCrv_volMI1_mp "Einspritzvolumen MI1" SWORD InjQntInj 1 100 -327.6800 327.6700 FORMAT "%8.4" ECU_ADDRESS 0x8FF1DA /end MEASUREMENT
/begin MEASUREMENT InjCrv_volPiI1Cor_mp "korrigiertes Einspritzvolumen zur Ansteuerdauerabschätzung der PiI1" SWORD InjQntInj 1 100 -327.6800 327.6700 FORMAT "%8.4" ECU_ADDRESS 0x8FF2AC /end MEASUREMENT
/begin MEASUREMENT InjCrv_volPiI1NoCor_mp "Einspritzvolumen ohne Korrekturen zur Ansteuerdauerabschätzung der PiI1" SWORD InjQntInj 1 100 -327.6800 327.6700 FORMAT "%8.4" ECU_ADDRESS 0x8FF2AE /end MEASUREMENT
/begin MEASUREMENT InjCrv_volPiI1_mp "begrenztes Einspritzvolumen PiI1" SWORD InjQntInj 1 100 -327.6800 327.6700 FORMAT "%8.4" ECU_ADDRESS 0x8FF2B0 /end MEASUREMENT
/begin MEASUREMENT InjCrv_volPiI2Cor_mp "korrigiertes Einspritzvolumen zur Ansteuerdauerabschätzung der PiI2" SWORD InjQntInj 1 100 -327.6800 327.6700 FORMAT "%8.4" ECU_ADDRESS 0x8FF248 /end MEASUREMENT
/begin MEASUREMENT InjCrv_volPiI2_mp "begrenztes Einspritzvolumen PiI2" SWORD InjQntInj 1 100 -327.6800 327.6700 FORMAT "%8.4" ECU_ADDRESS 0x8FF24A /end MEASUREMENT
/begin MEASUREMENT InjCrv_volPoI1_mp "begrenztes Einspritzvolumen PoI1" SWORD InjQntInj 1 100 -327.6800 327.6700 FORMAT "%8.4" ECU_ADDRESS 0x8FF312 /end MEASUREMENT
/begin MEASUREMENT InjCrv_volPoI2_mp "begrenztes Einspritzvolumen PoI2" SWORD InjQntInj 1 100 -327.6800 327.6700 FORMAT "%8.4" ECU_ADDRESS 0x8FF358 /end MEASUREMENT
/begin FUNCTION injcrv_mienvcor_msg ""
 /begin OUT_MEASUREMENT InjCrv_phiMI1EnvCor InjCrv_phiMI1EnvCor2 InjCrv_phiMI1EnvCorStrt /end OUT_MEASUREMENT
/end FUNCTION
/begin FUNCTION injcrv_mienvcor_uic ""
 /begin OUT_MEASUREMENT InjCrv_phiMIAPSCor2_mp InjCrv_phiMIAPSCorStrt_mp InjCrv_phiMIAPSCor_mp InjCrv_phiMIATSCor2_mp InjCrv_phiMIATSCorStrt_mp InjCrv_phiMIATSCor_mp InjCrv_phiMIETSCor12_mp InjCrv_phiMIETSCor1_mp InjCrv_phiMIETSCor2_mp InjCrv_phiMIETSCorStrt_mp InjCrv_phiMIETSCor_mp InjCrv_phiMIFTSRailCorStrt_mp InjCrv_phiMIFTSRailCor_mp /end OUT_MEASUREMENT
/end FUNCTION
/begin FUNCTION injcrv_mirgn "Haupteinspritzung Regenerationswertberechnung"
 /begin DEF_CHARACTERISTIC InjCrv_facMIETSPhiCorRgn_CUR InjCrv_phiMI1Rgn_MAP InjCrv_phiMIETSCorRgn_MAP InjCrv_tiMI1Rgn_MAP /end DEF_CHARACTERISTIC
 /begin IN_MEASUREMENT CTSCD_tClnt Eng_nAvrg InjCtl_qSetUnBal /end IN_MEASUREMENT
/end FUNCTION
/begin FUNCTION injcrv_mirgnlib "Regeneration function library for MI"
 /begin DEF_CHARACTERISTIC InjCrv_dtiMI1RgnRmpUp_C InjCrv_dtiMI1RgnRmpDwn_C InjCrv_stMI1RgnMsk_C /end DEF_CHARACTERISTIC
/end FUNCTION
/begin FUNCTION injcrv_mirgn_msg "" /begin OUT_MEASUREMENT InjCrv_phiMI1Rgn InjCrv_qMI1Rgn InjCrv_tiMI1Rgn /end OUT_MEASUREMENT /end FUNCTION
/begin FUNCTION injcrv_mirgn_uic ""
 /begin DEF_CHARACTERISTIC InjCrv_phiMI1RgnAdd_Vector InjCrv_phiMI1RgnAdd_Channel InjCrv_phiMI1Rgn_Vector InjCrv_phiMI1Rgn_Channel InjCrv_qMI1RgnAdd_Vector InjCrv_qMI1RgnAdd_Channel InjCrv_qMI1Rgn_Vector InjCrv_qMI1Rgn_Channel /end DEF_CHARACTERISTIC
 /begin OUT_MEASUREMENT InjCrv_phiMI1RgnByp_mp InjCrv_phiMI1Rgn_mp InjCrv_phiMIETSCorRgn_mp InjCrv_qMI1RgnByp_mp /end OUT_MEASUREMENT
/end FUNCTION
/begin FUNCTION injcrv_mirmtctl_uic "" /end FUNCTION
/begin FUNCTION injcrv_misoergn_msg "" /begin OUT_MEASUREMENT InjCrv_MI1RgnVal InjCrv_phiStrtInjSetPoint /end OUT_MEASUREMENT /end FUNCTION
/begin FUNCTION injcrv_misoergn_uic "" /end FUNCTION
/begin FUNCTION injcrv_mistrt "Berechnung Start der Einspritzung während Start" /begin DEF_CHARACTERISTIC InjCrv_phiMI1BasStrt_MAP /end DEF_CHARACTERISTIC /begin IN_MEASUREMENT Eng_nAvrg InjCtl_qSetUnBal /end IN_MEASUREMENT /end FUNCTION
/begin FUNCTION injcrv_mistrt_uic "" /begin OUT_MEASUREMENT InjCrv_phiMI1StrtCor_mp /end OUT_MEASUREMENT /end FUNCTION
/begin FUNCTION injcrv_mi_msg "" /begin OUT_MEASUREMENT InjCrv_phiMI1Des InjCrv_qMI1Des InjCrv_tiMI1ET /end OUT_MEASUREMENT /end FUNCTION
/begin FUNCTION injcrv_mi_uic ""
 /begin DEF_CHARACTERISTIC InjCrv_phiMI1DesAdd_Vector InjCrv_phiMI1DesAdd_Channel InjCrv_phiMI1Des_Vector InjCrv_phiMI1Des_Channel InjCrv_qMI1DesAdd_Vector InjCrv_qMI1DesAdd_Channel InjCrv_qMI1Des_Vector InjCrv_qMI1Des_Channel /end DEF_CHARACTERISTIC
 /begin OUT_MEASUREMENT InjCrv_phiMI1Bas_mp InjCrv_phiMI1Cor_mp InjCrv_phiMI1DesByp_mp InjCrv_phiMI1Lim_mp InjCrv_phiMI1Max_mp InjCrv_phiMI1Min_mp InjCrv_qMI1DesByp_mp InjCrv_qMI1Min_mp InjCrv_qMI1Nrm_mp InjCrv_qMI1Set_mp InjCrv_volMI1Cor_mp InjCrv_volMI1_mp /end OUT_MEASUREMENT
/end FUNCTION
/begin FUNCTION injcrv_pii "Einspritzverlauf - Voreinspritzung"
 /begin DEF_CHARACTERISTIC InjCrv_facPiI1QntMin_CUR InjCrv_phiPiIMax_C InjCrv_qMI1MinPiI1DiffHys_C InjCrv_qPiI1Bas2_MAP InjCrv_qPiI1BasFDC_MAP InjCrv_qPiI1Bas_MAP InjCrv_qPiI1Bas_X_AXIS InjCrv_qPiI1Bas_Y_AXIS InjCrv_qPiI1Max2_MAP InjCrv_qPiI1Max_MAP InjCrv_qPiI1Max_X_AXIS InjCrv_qPiI1Max_Y_AXIS InjCrv_qPiI1MinDiff_C InjCrv_stPiI1RgnDelMsk_C InjCrv_tiPiI1MinRgn_MAP InjCrv_tiPiI1Min_MAP InjCrv_tiPiIMax_C /end DEF_CHARACTERISTIC
 /begin IN_MEASUREMENT Eng_nAvrg InjCtl_qSetUnBal RailCD_pPeak /end IN_MEASUREMENT
 /begin OUT_MEASUREMENT InjCrv_PiI1RgnVal_mp /end OUT_MEASUREMENT
/end FUNCTION
/begin FUNCTION injcrv_pii1soephibas "" /end FUNCTION
/begin FUNCTION injcrv_pii1soephibas_uic "" /begin OUT_MEASUREMENT InjCrv_phiPiI1Bas_mp /end OUT_MEASUREMENT /end FUNCTION
/begin FUNCTION injcrv_pii1soetibas ""
 /begin DEF_CHARACTERISTIC InjCrv_tiPiI1Bas1FDC_MAP InjCrv_tiPiI1Bas1_MAP InjCrv_tiPiI1Bas2_MAP InjCrv_tiPiI1Bas3_MAP /end DEF_CHARACTERISTIC
 /begin IN_MEASUREMENT Eng_nAvrg InjCtl_qSetUnBal /end IN_MEASUREMENT
/end FUNCTION
/begin FUNCTION injcrv_pii1soetibas_uic "" /begin OUT_MEASUREMENT InjCrv_tiPiI1Bas_mp /end OUT_MEASUREMENT /end FUNCTION
/begin FUNCTION injcrv_pii1strt "" /begin DEF_CHARACTERISTIC InjCrv_qPiI1BasStrt_MAP InjCrv_tiPiI1BasStrt_MAP /end DEF_CHARACTERISTIC /begin IN_MEASUREMENT Eng_nAvrg InjCtl_qSetUnBal /end IN_MEASUREMENT /end FUNCTION
/begin FUNCTION injcrv_pii1strt_uic "" /begin OUT_MEASUREMENT InjCrv_qPiI1BasStrt_mp InjCrv_tiPiI1BasStrt_mp /end OUT_MEASUREMENT /end FUNCTION
/begin FUNCTION injcrv_pii2 "Einspritzverlauf - Voreinspritzung 2"
 /begin DEF_CHARACTERISTIC InjCrv_facPiI1QntMax_C InjCrv_facPiI2QntMin_CUR InjCrv_nDiffMin_C InjCrv_qDiffMin_C InjCrv_qMI1MinPiI2DiffHys_C InjCrv_qPiI1WvCorMax_C InjCrv_qPiI2Bas_MAP InjCrv_qPiI2Max_MAP InjCrv_qPiI2MinDiff_C InjCrv_stPiI2RgnDelMsk_C /end DEF_CHARACTERISTIC
 /begin IN_MEASUREMENT Eng_nAvrg InjCtl_qSetUnBal RailCD_pPeak /end IN_MEASUREMENT
 /begin OUT_MEASUREMENT InjCrv_PiI2RgnVal_mp /end OUT_MEASUREMENT
/end FUNCTION
/begin FUNCTION injcrv_pii2addcor "PiI2 - projektspezifische Korrektur" /end FUNCTION
/begin FUNCTION injcrv_pii2addcorphi "" /end FUNCTION
/begin FUNCTION injcrv_pii2addcorphi_uic "" /end FUNCTION
/begin FUNCTION injcrv_pii2addcorslow "Gewichtungsfaktor für projektspezifische Korrektur der PiI2" /end FUNCTION
/begin FUNCTION injcrv_pii2addcorslow_msg "" /end FUNCTION
/begin FUNCTION injcrv_pii2addcorslow_uic "" /end FUNCTION
/begin FUNCTION injcrv_pii2addcorti_uic "" /end FUNCTION
/begin FUNCTION injcrv_pii2addcor_msg ""
 /begin OUT_MEASUREMENT InjCrv_phiPiI2AddCor InjCrv_qPiI2AddCor InjCrv_tiPiI2AddCor /end OUT_MEASUREMENT
/end FUNCTION
/begin FUNCTION injcrv_pii2addcor_uic "" /end FUNCTION
/begin FUNCTION injcrv_pii2envcor "Voreinspritzung 2 - Umwelt -Korrekturen"
 /begin DEF_CHARACTERISTIC InjCrv_qPiI2APSCorStrt_MAP InjCrv_qPiI2APSCor_MAP InjCrv_qPiI2ATSCorStrt_MAP InjCrv_qPiI2ATSCor_MAP InjCrv_qPiI2ETSCorStrt_MAP InjCrv_qPiI2ETSCor_MAP /end DEF_CHARACTERISTIC
 /begin IN_MEASUREMENT Eng_nAvrg InjCtl_qSetUnBal /end IN_MEASUREMENT
/end FUNCTION
/begin FUNCTION injcrv_pii2envcorphi "" /end FUNCTION
/begin FUNCTION injcrv_pii2envcorphi_uic "" /begin OUT_MEASUREMENT InjCrv_phiPiI2ETSCor_mp /end OUT_MEASUREMENT /end FUNCTION
/begin FUNCTION injcrv_pii2envcorslow ""
 /begin DEF_CHARACTERISTIC InjCrv_facPiI2APSQCorStrt_CUR InjCrv_facPiI2APSQCor_CUR InjCrv_facPiI2ATSQCorStrt_CUR InjCrv_facPiI2ATSQCor_CUR InjCrv_facPiI2ETSQCorStrt_CUR InjCrv_facPiI2ETSQCor_CUR InjCrv_facPiI2ETSSOECorStrt_CUR InjCrv_facPiI2ETSSOECor_CUR /end DEF_CHARACTERISTIC
 /begin IN_MEASUREMENT APSCD_pVal IATSCD_tAir InjCrv_tEng /end IN_MEASUREMENT
/end FUNCTION
/begin FUNCTION injcrv_pii2envcorslow_msg ""
 /begin OUT_MEASUREMENT InjCrv_facPiI2APSQCor InjCrv_facPiI2APSQCorStrt InjCrv_facPiI2ATSQCor InjCrv_facPiI2ATSQCorStrt InjCrv_facPiI2ETSQCor InjCrv_facPiI2ETSQCorStrt InjCrv_facPiI2ETSSOECor InjCrv_facPiI2ETSSOECorStrt /end OUT_MEASUREMENT
/end FUNCTION
/begin FUNCTION injcrv_pii2envcorslow_uic "" /end FUNCTION
/begin FUNCTION injcrv_pii2envcorti "" /begin DEF_CHARACTERISTIC InjCrv_tiPiI2ETSCorStrt_MAP InjCrv_tiPiI2ETSCor_MAP /end DEF_CHARACTERISTIC /begin IN_MEASUREMENT Eng_nAvrg InjCtl_qSetUnBal /end IN_MEASUREMENT /end FUNCTION
/begin FUNCTION injcrv_pii2envcorti_uic "" /begin OUT_MEASUREMENT InjCrv_tiPiI2ETSCor_mp /end OUT_MEASUREMENT /end FUNCTION
/begin FUNCTION injcrv_pii2envcor_msg ""
 /begin OUT_MEASUREMENT InjCrv_phiPiI2EnvCor InjCrv_qPiI2EnvCor InjCrv_qPiI2EnvCorStrt InjCrv_tiPiI2EnvCor InjCrv_tiPiI2EnvCorStrt /end OUT_MEASUREMENT
/end FUNCTION
/begin FUNCTION injcrv_pii2envcor_uic ""
 /begin OUT_MEASUREMENT InjCrv_qPiI2APSCorStrt_mp InjCrv_qPiI2APSCor_mp InjCrv_qPiI2ATSCorStrt_mp InjCrv_qPiI2ATSCor_mp InjCrv_qPiI2ETSCorStrt_mp InjCrv_qPiI2ETSCor_mp /end OUT_MEASUREMENT
/end FUNCTION
/begin FUNCTION injcrv_pii2rgn "Voreinspritzung 2, Regenerationswertberechnung" /end FUNCTION
/begin FUNCTION injcrv_pii2rgnlib "Funktionsbibliothek für die Regenerationsumschaltung der Voreinspritzung 2"
 /begin DEF_CHARACTERISTIC InjCrv_dtiPiI2RgnRmpUp_C InjCrv_dtiPiI2RgnRmpDwn_C InjCrv_stPiI2RgnMsk_C /end DEF_CHARACTERISTIC
/end FUNCTION
/begin FUNCTION injcrv_pii2rgn_msg "" /begin OUT_MEASUREMENT InjCrv_phiPiI2Rgn InjCrv_qPiI2Rgn InjCrv_tiPiI2Rgn /end OUT_MEASUREMENT /end FUNCTION
/begin FUNCTION injcrv_pii2rgn_uic ""
 /begin DEF_CHARACTERISTIC InjCrv_phiPiI2RgnAdd_Vector InjCrv_phiPiI2RgnAdd_Channel InjCrv_phiPiI2Rgn_Vector InjCrv_phiPiI2Rgn_Channel InjCrv_qPiI2RgnAdd_Vector InjCrv_qPiI2RgnAdd_Channel InjCrv_qPiI2Rgn_Vector InjCrv_qPiI2Rgn_Channel InjCrv_tiPiI2RgnAdd_Vector InjCrv_tiPiI2RgnAdd_Channel InjCrv_tiPiI2Rgn_Vector InjCrv_tiPiI2Rgn_Channel /end DEF_CHARACTERISTIC
 /begin OUT_MEASUREMENT InjCrv_phiPiI2RgnByp_mp InjCrv_qPiI2RgnByp_mp InjCrv_tiPiI2RgnByp_mp /end OUT_MEASUREMENT
/end FUNCTION
/begin FUNCTION injcrv_pii2rmtctl_uic "" /end FUNCTION
/begin FUNCTION injcrv_pii2soephibas "" /end FUNCTION
/begin FUNCTION injcrv_pii2soephibas_uic "" /begin OUT_MEASUREMENT InjCrv_phiPiI2Bas_mp /end OUT_MEASUREMENT /end FUNCTION
/begin FUNCTION injcrv_pii2soetibas "" /begin DEF_CHARACTERISTIC InjCrv_tiPiI2Bas_MAP /end DEF_CHARACTERISTIC /begin IN_MEASUREMENT Eng_nAvrg InjCtl_qSetUnBal /end IN_MEASUREMENT /end FUNCTION
/begin FUNCTION injcrv_pii2soetibas_uic "" /begin OUT_MEASUREMENT InjCrv_tiPiI2Bas_mp /end OUT_MEASUREMENT /end FUNCTION
/begin FUNCTION injcrv_pii2strt "Einspitzverlaufsbestimmung Voreinspritzung 2 während Start" /begin DEF_CHARACTERISTIC InjCrv_qPiI2BasStrt_MAP InjCrv_tiPiI2BasStrt_MAP /end DEF_CHARACTERISTIC /begin IN_MEASUREMENT Eng_nAvrg InjCtl_qSetUnBal /end IN_MEASUREMENT /end FUNCTION
/begin FUNCTION injcrv_pii2strt_uic "" /begin OUT_MEASUREMENT InjCrv_qPiI2BasStrt_mp InjCrv_tiPiI2BasStrt_mp /end OUT_MEASUREMENT /end FUNCTION
/begin FUNCTION injcrv_pii2_uic "" /begin DEF_CHARACTERISTIC InjCrv_qPiI2SetByp_Vector InjCrv_qPiI2SetByp_Channel /end DEF_CHARACTERISTIC
 /begin OUT_MEASUREMENT InjCrv_facPiI2QntMin_mp InjCrv_phiPiI2AbsTot_mp InjCrv_phiPiI2Abs_mp InjCrv_phiPiI2Cor_mp InjCrv_phiPiI2Rel_mp InjCrv_qMI1MinPiI2_mp InjCrv_qPiI2Bas_mp InjCrv_qPiI2Max_mp InjCrv_qPiI2SetLimMax_mp InjCrv_qPiI2SetLim_mp InjCrv_qPiI2SetRaw_mp InjCrv_qPiI2Set_mp InjCrv_stPiI2_mp InjCrv_tiPiI2CorRaw_mp InjCrv_tiPiI2Cor_mp InjCrv_tiPiI2ET_mp InjCrv_tiPiI2RelMI_mp InjCrv_tiPiI2RelPiI1_mp InjCrv_tiPiI2RelTot_mp InjCrv_tiPiI2Tot_mp InjCrv_volPiI2Cor_mp InjCrv_volPiI2_mp /end OUT_MEASUREMENT
/end FUNCTION
/begin FUNCTION injcrv_pii3 "Berechnung von Menge und Ansteuerbeginn von Voreinspritzung 3" /end FUNCTION
/begin FUNCTION injcrv_pii3addcor "Calculation of customer specific correction values for pilot injection 3." /end FUNCTION
/begin FUNCTION injcrv_pii3addcor_msg "" /end FUNCTION
/begin FUNCTION injcrv_pii3addcor_uic "" /end FUNCTION
/begin FUNCTION injcrv_pii3envcor "Voreinspritzung 3 Korrektur durch Umweltbedingungen" /end FUNCTION
/begin FUNCTION injcrv_pii3envcorslow "" /end FUNCTION
/begin FUNCTION injcrv_pii3envcorslow_msg "" /end FUNCTION
/begin FUNCTION injcrv_pii3envcorslow_uic "" /end FUNCTION
/begin FUNCTION injcrv_pii3envcor_msg "" /end FUNCTION
/begin FUNCTION injcrv_pii3envcor_uic "" /end FUNCTION
/begin FUNCTION injcrv_pii3rgnlib "" /end FUNCTION
/begin FUNCTION injcrv_pii3rgn_msg "" /end FUNCTION
/begin FUNCTION injcrv_pii3rgn_uic "" /end FUNCTION
/begin FUNCTION injcrv_pii3rmtctl_uic "" /end FUNCTION
/begin FUNCTION injcrv_pii3strt "Calculation of start of energizing and injection quantity with engine in startup mode" /end FUNCTION
/begin FUNCTION injcrv_pii3strt_uic "" /end FUNCTION
/begin FUNCTION injcrv_pii3_uic "" /end FUNCTION
/begin FUNCTION injcrv_piiaddcor "Voreinspritzung - projektspezifische Korrektur"
 /begin DEF_CHARACTERISTIC InjCrv_facDQPiI1DynCor_CUR InjCrv_facDQPiI1DynQCor_CUR InjCrv_qPiI1DynQCor_MAP InjCrv_tiPiI1DynCor_MAP /end DEF_CHARACTERISTIC
 /begin IN_MEASUREMENT Eng_nAvrg InjCrv_dqSetUnBalFltLim InjCtl_qSetUnBal /end IN_MEASUREMENT
/end FUNCTION
/begin FUNCTION injcrv_piiaddcorphi "" /end FUNCTION
/begin FUNCTION injcrv_piiaddcorphi_uic "" /end FUNCTION
/begin FUNCTION injcrv_piiaddcorslow "Gewichtungsfaktor für projektspezifische Korrektur der PiI1"
 /begin DEF_CHARACTERISTIC InjCrv_facAPPiI1DynCor_CUR InjCrv_facAPPiI1DynQCor_CUR InjCrv_facETPiI1DynCor_CUR InjCrv_facETPiI1DynQCor_CUR InjCrv_facIAPiI1DynCor_CUR InjCrv_facPiI1ATSSOECor_CUR /end DEF_CHARACTERISTIC
 /begin IN_MEASUREMENT APSCD_pVal IATSCD_tAir InjCrv_tEng /end IN_MEASUREMENT
/end FUNCTION
/begin FUNCTION injcrv_piiaddcorslow_msg ""
 /begin OUT_MEASUREMENT InjCrv_facPiI1ATSSOECor InjCrv_facPiI1DynQCor InjCrv_facPiI1DynSOECor /end OUT_MEASUREMENT
/end FUNCTION
/begin FUNCTION injcrv_piiaddcorslow_uic ""
 /begin OUT_MEASUREMENT InjCrv_facAPPiI1DynCor_mp InjCrv_facAPPiI1DynQCor_mp InjCrv_facETPiI1DynCor_mp InjCrv_facETPiI1DynQCor_mp /end OUT_MEASUREMENT
/end FUNCTION
/begin FUNCTION injcrv_piiaddcorti "" /begin DEF_CHARACTERISTIC InjCrv_tiPiI1ATSCor_MAP /end DEF_CHARACTERISTIC /begin IN_MEASUREMENT Eng_nAvrg InjCtl_qSetUnBal /end IN_MEASUREMENT /end FUNCTION
/begin FUNCTION injcrv_piiaddcorti_uic "" /end FUNCTION
/begin FUNCTION injcrv_piiaddcor_msg ""
 /begin OUT_MEASUREMENT InjCrv_phiPiI1AddCor InjCrv_phiPiI1AddCor2 InjCrv_qPiI1AddCor InjCrv_qPiI1AddCor2 InjCrv_tiPiI1AddCor InjCrv_tiPiI1AddCor2 /end OUT_MEASUREMENT
/end FUNCTION
/begin FUNCTION injcrv_piiaddcor_uic ""
 /begin OUT_MEASUREMENT InjCrv_facDQPiI1DynCor_mp InjCrv_facDQPiI1DynQCor_mp InjCrv_qPiI1DynCor_mp InjCrv_tiPiI1DynCor_mp /end OUT_MEASUREMENT
/end FUNCTION
/begin FUNCTION injcrv_piienvcor "Voreinspritzung - Umwelt -Korrekturen"
 /begin DEF_CHARACTERISTIC InjCrv_qPiI1APSCor2_MAP InjCrv_qPiI1APSCorStrt_MAP InjCrv_qPiI1APSCor_MAP InjCrv_qPiI1APSCor_X_AXIS InjCrv_qPiI1APSCor_Y_AXIS InjCrv_qPiI1ATSCor2_MAP InjCrv_qPiI1ATSCorStrt_MAP InjCrv_qPiI1ATSCor_MAP InjCrv_qPiI1ATSCor_X_AXIS InjCrv_qPiI1ATSCor_Y_AXIS InjCrv_qPiI1ETSCor12_MAP InjCrv_qPiI1ETSCor1_MAP InjCrv_qPiI1ETSCor1_X_AXIS InjCrv_qPiI1ETSCor1_Y_AXIS InjCrv_qPiI1ETSCor2_MAP InjCrv_qPiI1ETSCorStrt_MAP InjCrv_qPiI1ETSCor_MAP InjCrv_qPiI1ETSCor_X_AXIS InjCrv_qPiI1ETSCor_Y_AXIS /end DEF_CHARACTERISTIC
 /begin IN_MEASUREMENT Eng_nAvrg InjCtl_qSetUnBal /end IN_MEASUREMENT
/end FUNCTION
/begin FUNCTION injcrv_piienvcorrgn "Haupteinspritzung - Umwelt - Gewichtungsfaktoren für den Regenerationsbetrieb" /end FUNCTION
/begin FUNCTION injcrv_piienvcorrgn_msg "" /end FUNCTION
/begin FUNCTION injcrv_piienvcorrgn_uic "" /end FUNCTION
/begin FUNCTION injcrv_piienvcorslow "Berechnung der Gewichtungsfunktionen für die Voreinspritzung"
 /begin DEF_CHARACTERISTIC InjCrv_facPiI1APSQCor2Strt_CUR InjCrv_facPiI1APSQCor2_CUR InjCrv_facPiI1APSQCorStrt_CUR InjCrv_facPiI1APSQCor_AXIS InjCrv_facPiI1APSQCor_CUR InjCrv_facPiI1ATSQCor2Strt_CUR InjCrv_facPiI1ATSQCor2_CUR InjCrv_facPiI1ATSQCorStrt_CUR InjCrv_facPiI1ATSQCor_AXIS InjCrv_facPiI1ATSQCor_CUR InjCrv_facPiI1ETSQCor12_CUR InjCrv_facPiI1ETSQCor1_AXIS InjCrv_facPiI1ETSQCor1_CUR InjCrv_facPiI1ETSQCor2Strt_CUR InjCrv_facPiI1ETSQCor2_CUR InjCrv_facPiI1ETSQCorStrt_CUR InjCrv_facPiI1ETSQCor_AXIS InjCrv_facPiI1ETSQCor_CUR InjCrv_facPiI1ETSSOECor12_CUR InjCrv_facPiI1ETSSOECor1_AXIS InjCrv_facPiI1ETSSOECor1_CUR InjCrv_facPiI1ETSSOECor2_CUR InjCrv_facPiI1ETSSOECorStrt_CUR InjCrv_facPiI1ETSSOECor_AXIS InjCrv_facPiI1ETSSOECor_CUR /end DEF_CHARACTERISTIC
 /begin IN_MEASUREMENT APSCD_pVal IATSCD_tAir InjCrv_tEng /end IN_MEASUREMENT
/end FUNCTION
/begin FUNCTION injcrv_piienvcorslowrgn "Voreinspritzung - Umwelt - Gewichtungsfaktoren für den Regenerationsbetrieb" /end FUNCTION
/begin FUNCTION injcrv_piienvcorslowrgn_msg "" /end FUNCTION
/begin FUNCTION injcrv_piienvcorslowrgn_uic "" /end FUNCTION
/begin FUNCTION injcrv_piienvcorslow_msg ""
 /begin OUT_MEASUREMENT InjCrv_facPiI1APSQCor InjCrv_facPiI1APSQCor2 InjCrv_facPiI1APSQCorStrt InjCrv_facPiI1ATSQCor InjCrv_facPiI1ATSQCor2 InjCrv_facPiI1ATSQCorStrt InjCrv_facPiI1ETSQCor InjCrv_facPiI1ETSQCor1 InjCrv_facPiI1ETSQCor12 InjCrv_facPiI1ETSQCor2 InjCrv_facPiI1ETSQCorStrt InjCrv_facPiI1ETSSOECor InjCrv_facPiI1ETSSOECor1 InjCrv_facPiI1ETSSOECor12 InjCrv_facPiI1ETSSOECor2 InjCrv_facPiI1ETSSOECorStrt /end OUT_MEASUREMENT
/end FUNCTION
/begin FUNCTION injcrv_piienvcorslow_uic "" /end FUNCTION
/begin FUNCTION injcrv_piienvcorti ""
 /begin DEF_CHARACTERISTIC InjCrv_tiPiI1ETSCor12_MAP InjCrv_tiPiI1ETSCor1_MAP InjCrv_tiPiI1ETSCor2_MAP InjCrv_tiPiI1ETSCorStrt_MAP InjCrv_tiPiI1ETSCor_MAP /end DEF_CHARACTERISTIC
 /begin IN_MEASUREMENT Eng_nAvrg InjCtl_qSetUnBal /end IN_MEASUREMENT
/end FUNCTION
/begin FUNCTION injcrv_piienvcorti_uic ""
 /begin OUT_MEASUREMENT InjCrv_tiPiI1ETSCor12_mp InjCrv_tiPiI1ETSCor1_mp InjCrv_tiPiI1ETSCor2_mp InjCrv_tiPiI1ETSCorStrt_mp InjCrv_tiPiI1ETSCor_mp /end OUT_MEASUREMENT
/end FUNCTION
/begin FUNCTION injcrv_piienvcor_msg ""
 /begin OUT_MEASUREMENT InjCrv_phiPiI1EnvCor InjCrv_phiPiI1EnvCor2 InjCrv_qPiI1EnvCor InjCrv_qPiI1EnvCor2 InjCrv_qPiI1EnvCorStrt InjCrv_tiPiI1EnvCor InjCrv_tiPiI1EnvCor2 InjCrv_tiPiI1EnvCorStrt /end OUT_MEASUREMENT
/end FUNCTION
/begin FUNCTION injcrv_piienvcor_uic ""
 /begin OUT_MEASUREMENT InjCrv_qPiI1APSCor2_mp InjCrv_qPiI1APSCorStrt_mp InjCrv_qPiI1APSCor_mp InjCrv_qPiI1ATSCor2_mp InjCrv_qPiI1ATSCorStrt_mp InjCrv_qPiI1ATSCor_mp InjCrv_qPiI1ETSCor12_mp InjCrv_qPiI1ETSCor1_mp InjCrv_qPiI1ETSCor2_mp InjCrv_qPiI1ETSCorStrt_mp InjCrv_qPiI1ETSCor_mp /end OUT_MEASUREMENT
/end FUNCTION
/begin FUNCTION injcrv_piirgn "Voreinspritzung 1, Regenerationswertberechnung"
 /begin DEF_CHARACTERISTIC InjCrv_phiPiI1Rgn_MAP InjCrv_qPiI1Rgn_MAP InjCrv_tiPiI1Rgn_MAP /end DEF_CHARACTERISTIC
 /begin IN_MEASUREMENT Eng_nAvrg InjCtl_qSetUnBal /end IN_MEASUREMENT
/end FUNCTION
/begin FUNCTION injcrv_piirgnlib "Funktionsbibliothek für die Regenerationsumschaltung der Voreinspritzung 1"
 /begin DEF_CHARACTERISTIC InjCrv_dtiPiI1RgnRmpUp_C InjCrv_dtiPiI1RgnRmpDwn_C InjCrv_stPiI1RgnMsk_C /end DEF_CHARACTERISTIC
/end FUNCTION
/begin FUNCTION injcrv_piirgn_msg "" /begin OUT_MEASUREMENT InjCrv_phiPiI1Rgn InjCrv_qPiI1Rgn InjCrv_tiPiI1Rgn /end OUT_MEASUREMENT /end FUNCTION
/begin FUNCTION injcrv_piirgn_uic ""
 /begin DEF_CHARACTERISTIC InjCrv_phiPiI1RgnAdd_Vector InjCrv_phiPiI1RgnAdd_Channel InjCrv_phiPiI1Rgn_Vector InjCrv_phiPiI1Rgn_Channel InjCrv_qPiI1RgnAdd_Vector InjCrv_qPiI1RgnAdd_Channel InjCrv_qPiI1Rgn_Vector InjCrv_qPiI1Rgn_Channel InjCrv_tiPiI1RgnAdd_Vector InjCrv_tiPiI1RgnAdd_Channel InjCrv_tiPiI1Rgn_Vector InjCrv_tiPiI1Rgn_Channel /end DEF_CHARACTERISTIC
 /begin OUT_MEASUREMENT InjCrv_phiPiI1RgnByp_mp InjCrv_qPiI1RgnByp_mp InjCrv_tiPiI1RgnByp_mp /end OUT_MEASUREMENT
/end FUNCTION
/begin FUNCTION injcrv_piirmtctl_uic "" /end FUNCTION
/begin FUNCTION injcrv_pii_msg ""
 /begin OUT_MEASUREMENT InjCrv_phiPiI1Des InjCrv_phiPiI2Des InjCrv_phiPiI3Des InjCrv_qPiI1Des InjCrv_qPiI2Des InjCrv_qPiI3Des InjCrv_tiPiI1Des InjCrv_tiPiI2Des /end OUT_MEASUREMENT
/end FUNCTION
/begin FUNCTION injcrv_pii_uic ""
 /begin DEF_CHARACTERISTIC InjCrv_phiPiI1DesAdd_Vector InjCrv_phiPiI1DesAdd_Channel InjCrv_phiPiI1Des_Vector InjCrv_phiPiI1Des_Channel InjCrv_phiPiI2DesAdd_Vector InjCrv_phiPiI2DesAdd_Channel InjCrv_phiPiI2Des_Vector InjCrv_phiPiI2Des_Channel InjCrv_phiPiI3DesAdd_Vector InjCrv_phiPiI3DesAdd_Channel InjCrv_phiPiI3Des_Vector InjCrv_phiPiI3Des_Channel InjCrv_qPiI1DesAdd_Vector InjCrv_qPiI1DesAdd_Channel InjCrv_qPiI1Des_Vector InjCrv_qPiI1Des_Channel InjCrv_qPiI1SetByp_Vector InjCrv_qPiI1SetByp_Channel InjCrv_qPiI2DesAdd_Vector InjCrv_qPiI2DesAdd_Channel InjCrv_qPiI2Des_Vector InjCrv_qPiI2Des_Channel InjCrv_qPiI3DesAdd_Vector InjCrv_qPiI3DesAdd_Channel InjCrv_qPiI3Des_Vector InjCrv_qPiI3Des_Channel InjCrv_tiPiI1DesAdd_Vector InjCrv_tiPiI1DesAdd_Channel InjCrv_tiPiI1Des_Vector InjCrv_tiPiI1Des_Channel InjCrv_tiPiI2DesAdd_Vector InjCrv_tiPiI2DesAdd_Channel InjCrv_tiPiI2Des_Vector InjCrv_tiPiI2Des_Channel /end DEF_CHARACTERISTIC
 /begin OUT_MEASUREMENT InjCrv_facPiI1QntMin_mp InjCrv_phiPiI1AbsTot_mp InjCrv_phiPiI1Abs_mp InjCrv_phiPiI1Cor_mp InjCrv_phiPiI1DesByp_mp InjCrv_phiPiI1Rel_mp InjCrv_phiPiI2DesByp_mp InjCrv_phiPiI3DesByp_mp InjCrv_qMI1MinPiI1_mp InjCrv_qPiI1Bas_mp InjCrv_qPiI1DesByp_mp InjCrv_qPiI1Max_mp InjCrv_qPiI1SetLimMax_mp InjCrv_qPiI1SetLim_mp InjCrv_qPiI1SetRaw_mp InjCrv_qPiI1Set_mp InjCrv_qPiI2DesByp_mp InjCrv_qPiI3DesByp_mp InjCrv_qPiIMin_mp InjCrv_stPiI1_mp InjCrv_tiPiI1CorRaw_mp InjCrv_tiPiI1Cor_mp InjCrv_tiPiI1DesByp_mp InjCrv_tiPiI1ETNoCor_mp InjCrv_tiPiI1ET_mp InjCrv_tiPiI1Hyd_mp InjCrv_tiPiI1Min_mp InjCrv_tiPiI1RelMI1_mp InjCrv_tiPiI1RelTot_mp InjCrv_tiPiI1Rel_mp InjCrv_tiPiI1Tot_mp InjCrv_tiPiI2DesByp_mp InjCrv_volPiI1Cor_mp InjCrv_volPiI1NoCor_mp InjCrv_volPiI1_mp /end OUT_MEASUREMENT
/end FUNCTION
/begin FUNCTION injcrv_poi1 "Einspritzverlauf - Nacheinspritzung 1"
 /begin DEF_CHARACTERISTIC InjCrv_numTDCPoI1Clsn_C InjCrv_phiDynOfs_CUR InjCrv_phiPoI1Bas_MAP InjCrv_phiPoI1Max_C InjCrv_qPoI1Bas_MAP InjCrv_qPoI1Max_MAP InjCrv_qPoI1SetLim_C InjCrv_swtPoI1Clsn_C /end DEF_CHARACTERISTIC
 /begin IN_MEASUREMENT Eng_nAvrg InjCtl_qSetUnBal /end IN_MEASUREMENT
 /begin OUT_MEASUREMENT InjCrv_PoI1RgnVal_mp /end OUT_MEASUREMENT
/end FUNCTION
/begin FUNCTION injcrv_poi1addcor "Nacheinspritzung 1 - projektspezifische Korrekturen" /end FUNCTION
/begin FUNCTION injcrv_poi1addcor_msg ""
 /begin OUT_MEASUREMENT InjCrv_phiPoI1AddCor InjCrv_POpPoI1AddCor InjCrv_qPoI1AddCor /end OUT_MEASUREMENT
/end FUNCTION
/begin FUNCTION injcrv_poi1addcor_uic "" /end FUNCTION
/begin FUNCTION injcrv_poi1envcor "Nacheinspritzung 1 - Umwelt- Korrekturen (20 ms task)"
 /begin DEF_CHARACTERISTIC InjCrv_phiPoI1ETSCor_MAP InjCrv_qPoI1APSCor_MAP InjCrv_qPoI1ETSCor_MAP /end DEF_CHARACTERISTIC
 /begin IN_MEASUREMENT Eng_nAvrg InjCtl_qSetUnBal /end IN_MEASUREMENT
/end FUNCTION
/begin FUNCTION injcrv_poi1envcorslow "Nacheinspritzung 1 - Umwelt- Korrekturen (100ms task)"
 /begin DEF_CHARACTERISTIC InjCrv_facPoI1APSQCor_CUR InjCrv_facPoI1ETSPhiCor_CUR InjCrv_facPoI1ETSQCor_CUR InjCrv_POpPoI1ETSCor_CUR /end DEF_CHARACTERISTIC
 /begin IN_MEASUREMENT APSCD_pVal InjCrv_tEng /end IN_MEASUREMENT
/end FUNCTION
/begin FUNCTION injcrv_poi1envcorslow_msg ""
 /begin OUT_MEASUREMENT InjCrv_facPoI1APSQCor InjCrv_facPoI1ETSPhiCor InjCrv_facPoI1ETSQCor InjCrv_POpPoI1EnvCor /end OUT_MEASUREMENT
/end FUNCTION
/begin FUNCTION injcrv_poi1envcorslow_uic "" /end FUNCTION
/begin FUNCTION injcrv_poi1envcor_msg "" /begin OUT_MEASUREMENT InjCrv_phiPoI1EnvCor InjCrv_qPoI1EnvCor /end OUT_MEASUREMENT /end FUNCTION
/begin FUNCTION injcrv_poi1envcor_uic "" /begin OUT_MEASUREMENT InjCrv_qPoI1APSCor_mp InjCrv_qPoI1ETSCor_mp /end OUT_MEASUREMENT /end FUNCTION
/begin FUNCTION injcrv_poi1rgn "Regenerationswertberechnung der PoI1"
 /begin DEF_CHARACTERISTIC InjCrv_phiPoI1Rgn1_MAP InjCrv_phiPoI1Rgn2_MAP InjCrv_qPoI1Rgn1_MAP InjCrv_qPoI1Rgn2_MAP /end DEF_CHARACTERISTIC
 /begin IN_MEASUREMENT Eng_nAvrg InjCtl_qSetUnBal /end IN_MEASUREMENT
/end FUNCTION
/begin FUNCTION injcrv_poi1rgnlib "Funktionbibliothek der Regenerationswetberechnung für PoI1"
 /begin DEF_CHARACTERISTIC InjCrv_dtiPoI1RgnRmpUp_C InjCrv_dtiPoI1RgnRmpDwn_C InjCrv_dtiPoI1RgnTypeRmpUp_C InjCrv_dtiPoI1RgnTypeRmpDwn_C InjCrv_stPoI1RgnMsk_C InjCrv_stPoI1RgnTypeMsk_C /end DEF_CHARACTERISTIC
/end FUNCTION
/begin FUNCTION injcrv_poi1rgn_msg "" /begin OUT_MEASUREMENT InjCrv_phiPoI1Rgn InjCrv_PoI1RgnTypeVal InjCrv_qPoI1Rgn /end OUT_MEASUREMENT /end FUNCTION
/begin FUNCTION injcrv_poi1rgn_uic ""
 /begin DEF_CHARACTERISTIC InjCrv_phiPoI1RgnAdd_Vector InjCrv_phiPoI1RgnAdd_Channel InjCrv_phiPoI1Rgn_Vector InjCrv_phiPoI1Rgn_Channel InjCrv_qPoI1RgnAdd_Vector InjCrv_qPoI1RgnAdd_Channel InjCrv_qPoI1Rgn_Vector InjCrv_qPoI1Rgn_Channel /end DEF_CHARACTERISTIC
 /begin OUT_MEASUREMENT InjCrv_phiPoI1Rgn1_mp InjCrv_phiPoI1Rgn2_mp InjCrv_phiPoI1RgnByp_mp InjCrv_qPoI1Rgn1_mp InjCrv_qPoI1Rgn2_mp InjCrv_qPoI1RgnByp_mp /end OUT_MEASUREMENT
/end FUNCTION
/begin FUNCTION injcrv_poi1rls "Freigabe der PoI1"
 /begin DEF_CHARACTERISTIC InjCrv_POpPoI1Bas_MAP InjCrv_POpPoI1High_C InjCrv_POpPoI1Low_C /end DEF_CHARACTERISTIC
 /begin IN_MEASUREMENT Eng_nAvrg InjCtl_qSetUnBal /end IN_MEASUREMENT
/end FUNCTION
/begin FUNCTION injcrv_poi1rls_uic "" /begin OUT_MEASUREMENT InjCrv_POpPoI1Bas_mp InjCrv_POpPoI1_mp /end OUT_MEASUREMENT /end FUNCTION
/begin FUNCTION injcrv_poi1rmtctl_uic "" /end FUNCTION
/begin FUNCTION injcrv_poi1_msg "" /begin OUT_MEASUREMENT InjCrv_phiPoI1Des InjCrv_qPoI1Clsn InjCrv_qPoI1Des /end OUT_MEASUREMENT /end FUNCTION
/begin FUNCTION injcrv_poi1_uic ""
 /begin DEF_CHARACTERISTIC InjCrv_phiPoI1DesAdd_Vector InjCrv_phiPoI1DesAdd_Channel InjCrv_phiPoI1Des_Vector InjCrv_phiPoI1Des_Channel InjCrv_qPoI1DesAdd_Vector InjCrv_qPoI1DesAdd_Channel InjCrv_qPoI1Des_Vector InjCrv_qPoI1Des_Channel /end DEF_CHARACTERISTIC
 /begin OUT_MEASUREMENT InjCrv_phiDynOfs_mp InjCrv_phiNxtCyl_mp InjCrv_phiNxtTDCoB_mp InjCrv_phiPoI1Bas_mp InjCrv_phiPoI1DesByp_mp InjCrv_phiPoI1Dur_mp InjCrv_phiPoI1Lim_mp InjCrv_phiPoI1Min_mp InjCrv_phiPoI1Set_mp InjCrv_qPoI1Bas_mp InjCrv_qPoI1DesByp_mp InjCrv_qPoI1Des_mp InjCrv_qPoI1Lim_mp InjCrv_qPoI1Max_mp InjCrv_qPoI1Min_mp InjCrv_qPoI1SetLim_mp InjCrv_qPoI1Set_mp InjCrv_stPoI1_mp InjCrv_tiPoI1ET_mp InjCrv_volPoI1_mp /end OUT_MEASUREMENT
/end FUNCTION
/begin FUNCTION injcrv_poi2addcor "Nacheinspritzung 2 - projektspezifische Korrekturen" /end FUNCTION
/begin FUNCTION injcrv_poi2addcor_msg ""
 /begin OUT_MEASUREMENT InjCrv_phiPoI2AddCor InjCrv_POpPoI2AddCor InjCrv_qPoI2AddCor InjCrv_tiPoI2AddCor /end OUT_MEASUREMENT
/end FUNCTION
/begin FUNCTION injcrv_poi2addcor_uic "" /end FUNCTION
/begin FUNCTION injcrv_poi2agabstdc "Umschaltung des Ansteuerbeginns PoI2 in Winkel absolut zum TDC" /end FUNCTION
/begin FUNCTION injcrv_poi2agabstdc_uic "" /end FUNCTION
/begin FUNCTION injcrv_poi2envcor "Nacheinspritzung 2 - Umwelt- Korrekturen"
 /begin DEF_CHARACTERISTIC InjCrv_POpPoI2ETSCor_MAP InjCrv_qPoI2ATSCor_MAP InjCrv_qPoI2ETSCor_MAP /end DEF_CHARACTERISTIC
 /begin IN_MEASUREMENT Eng_nAvrg InjCtl_qSetUnBal /end IN_MEASUREMENT
/end FUNCTION
/begin FUNCTION injcrv_poi2envcorphi "" /begin DEF_CHARACTERISTIC InjCrv_phiPoI2ATSCor_MAP InjCrv_phiPoI2ETSCor_MAP /end DEF_CHARACTERISTIC /begin IN_MEASUREMENT Eng_nAvrg InjCtl_qSetUnBal /end IN_MEASUREMENT /end FUNCTION
/begin FUNCTION injcrv_poi2envcorphi_uic "" /begin OUT_MEASUREMENT InjCrv_phiPoI2ATSCor_mp InjCrv_phiPoI2ETSCor_mp /end OUT_MEASUREMENT /end FUNCTION
/begin FUNCTION injcrv_poi2envcorrgn "Injection Curve Post Injection Regeneration Correction"
 /begin DEF_CHARACTERISTIC InjCrv_facPhPoI2RgnAPCor_CUR InjCrv_facPhPoI2RgnETCor_CUR InjCrv_facQPoI2RgnAPCor_CUR InjCrv_facQPoI2RgnETCor_CUR InjCrv_facTiPoI2RgnAPCor_CUR InjCrv_facTiPoI2RgnETCor_CUR InjCrv_phiPoI2RgnCor_MAP InjCrv_qPoI2RgnCor_MAP InjCrv_tiPoI2RgnCor_MAP /end DEF_CHARACTERISTIC
 /begin IN_MEASUREMENT APSCD_pLinVal Eng_nAvrg InjCrv_tEng InjCtl_qSetUnBal /end IN_MEASUREMENT
/end FUNCTION
/begin FUNCTION injcrv_poi2envcorrgn_msg ""
 /begin OUT_MEASUREMENT InjCrv_phiPoI2RgnCor InjCrv_qPoI2RgnCor InjCrv_tiPoI2RgnCor /end OUT_MEASUREMENT
/end FUNCTION
/begin FUNCTION injcrv_poi2envcorrgn_uic ""
 /begin OUT_MEASUREMENT InjCrv_facPhPoI2RgnAPCor_mp InjCrv_facPhPoI2RgnETCor_mp InjCrv_facQPoI2RgnAPCor_mp InjCrv_facQPoI2RgnETCor_mp InjCrv_facTiPoI2RgnAPCor_mp InjCrv_facTiPoI2RgnETCor_mp /end OUT_MEASUREMENT
/end FUNCTION
/begin FUNCTION injcrv_poi2envcorslow ""
 /begin DEF_CHARACTERISTIC InjCrv_facPoI2ATSQCor_CUR InjCrv_facPoI2ATSSOECor_CUR InjCrv_facPoI2ETSQCor_CUR InjCrv_facPoI2ETSSOECor_CUR InjCrv_facPOpPoI2ETSCor_CUR /end DEF_CHARACTERISTIC
 /begin IN_MEASUREMENT IATSCD_tAir InjCrv_tEng /end IN_MEASUREMENT
/end FUNCTION
/begin FUNCTION injcrv_poi2envcorslowrgn "PoI2 Korrekturwerte für Umweltbedingungen im Regenerationsmodus" /end FUNCTION
/begin FUNCTION injcrv_poi2envcorslowrgn_msg "" /end FUNCTION
/begin FUNCTION injcrv_poi2envcorslowrgn_uic "" /end FUNCTION
/begin FUNCTION injcrv_poi2envcorslow_msg ""
 /begin OUT_MEASUREMENT InjCrv_facPoI2ATSQCor InjCrv_facPoI2ATSSOECor InjCrv_facPoI2ETSQCor InjCrv_facPoI2ETSSOECor InjCrv_facPOpPoI2ETSCor /end OUT_MEASUREMENT
/end FUNCTION
/begin FUNCTION injcrv_poi2envcorslow_uic "" /end FUNCTION
/begin FUNCTION injcrv_poi2envcorti "" /begin DEF_CHARACTERISTIC InjCrv_tiPoI2ATSCor_MAP InjCrv_tiPoI2ETSCor_MAP /end DEF_CHARACTERISTIC /begin IN_MEASUREMENT Eng_nAvrg InjCtl_qSetUnBal /end IN_MEASUREMENT /end FUNCTION
/begin FUNCTION injcrv_poi2envcorti_uic "" /begin OUT_MEASUREMENT InjCrv_tiPoI2ATSCor_mp InjCrv_tiPoI2ETSCor_mp /end OUT_MEASUREMENT /end FUNCTION
/begin FUNCTION injcrv_poi2envcor_msg ""
 /begin OUT_MEASUREMENT InjCrv_phiPoI2EnvCor InjCrv_POpPoI2EnvCor InjCrv_qPoI2EnvCor InjCrv_tiPoI2EnvCor /end OUT_MEASUREMENT
/end FUNCTION
/begin FUNCTION injcrv_poi2envcor_uic "" /begin OUT_MEASUREMENT InjCrv_qPoI2ATSCor_mp InjCrv_qPoI2ETSCor_mp /end OUT_MEASUREMENT /end FUNCTION
/begin FUNCTION injcrv_poi2q "Nacheinspritzung 2, Mengenberechnung"
 /begin DEF_CHARACTERISTIC InjCrv_facPoI2Eff_MAP InjCrv_facPoI2QntMin_C InjCrv_qPoI2Bas_MAP InjCrv_qPoI2SetLim_C InjCrv_stPoI2RgnDelMsk_C /end DEF_CHARACTERISTIC
 /begin IN_MEASUREMENT Eng_nAvrg InjCtl_qSetUnBal /end IN_MEASUREMENT
/end FUNCTION
/begin FUNCTION injcrv_poi2qrmtctl_uic "" /end FUNCTION
/begin FUNCTION injcrv_poi2q_msg ""
 /begin OUT_MEASUREMENT InjCrv_PoI2EffVal InjCrv_qPoI2Des InjCrv_qPoI2Eff InjCrv_stPoI2 /end OUT_MEASUREMENT
/end FUNCTION
/begin FUNCTION injcrv_poi2q_uic ""
 /begin OUT_MEASUREMENT InjCrv_facPoI2EffSet_mp InjCrv_facPoI2Eff_mp InjCrv_qMI1MinPoI2_mp InjCrv_qPoI2Bas_mp InjCrv_qPoI2Cor_mp InjCrv_qPoI2Des_mp InjCrv_qPoI2Eff_mp InjCrv_qPoI2Lim_mp InjCrv_qPoI2Max_mp InjCrv_qPoI2Min_mp InjCrv_qPoI2Set_mp InjCrv_tiPoI2ET_mp InjCrv_volPoI2_mp /end OUT_MEASUREMENT
/end FUNCTION
/begin FUNCTION injcrv_poi2rgn "Nacheinspritzung 2, Regenerationswertberechnung"
 /begin DEF_CHARACTERISTIC InjCrv_facPoI2Eff1_MAP InjCrv_facPoI2Eff2_MAP InjCrv_phiPoI2Rgn1_MAP InjCrv_phiPoI2Rgn2_MAP InjCrv_qPoI2Rgn1_MAP InjCrv_qPoI2Rgn2_MAP InjCrv_tiPoI2Rgn1_MAP InjCrv_tiPoI2Rgn2_MAP /end DEF_CHARACTERISTIC
 /begin IN_MEASUREMENT Eng_nAvrg InjCtl_qSetUnBal /end IN_MEASUREMENT
/end FUNCTION
/begin COMPU_METHOD AngleCrS "Winkel Kurbelwelle" RAT_FUNC "%6.4" "deg CrS" COEFFS 0 42.6666666666667 0 0 0 1 /end COMPU_METHOD
/begin COMPU_METHOD EGTSwt "Umrechnung für EGT Rampenschalter (1 / 1000*2^14 )" RAT_FUNC "%10.9" "-" COEFFS 0 16384000 0 0 0 1 /end COMPU_METHOD
/begin COMPU_METHOD EngN "Motordrehzahl" RAT_FUNC "%6.2" "rpm" COEFFS 0 1 0 0 0 1 /end COMPU_METHOD
/begin COMPU_METHOD Fact "Faktor mit Auflösung 1 / 8192, hauptsächlich für einen Faktorenbereich 0...1 verwendet" RAT_FUNC "%6.5" "-" COEFFS 0 8192 0 0 0 1 /end COMPU_METHOD
/begin COMPU_METHOD Fact1 "Faktor mit Auflösung 0,01 (100 mal höherer Bereich als Fact)" RAT_FUNC "%6.4" "-" COEFFS 0 128 0 0 0 1 /end COMPU_METHOD
/begin COMPU_METHOD InjMassCyc "Einspritzmenge pro Zyklus (mg/Zyklus)" RAT_FUNC "%6.4" "mg/cyc" COEFFS 0 100 0 0 0 1 /end COMPU_METHOD
/begin COMPU_METHOD InjMassInj "Einspritzmenge pro Einspritzung (mg/Einspritzung)" RAT_FUNC "%6.4" "mg/inj" COEFFS 0 100 0 0 0 1 /end COMPU_METHOD
/begin COMPU_METHOD InjMassPerSec_20ms "Einspritzmengenänderung pro Sekunde für 20ms-Tasks" RAT_FUNC "%6.3" "mg/hub/s" COEFFS 0 2 0 0 0 1 /end COMPU_METHOD
/begin COMPU_METHOD InjQntInj "Einspritzmenge der einzelnen Einspritzung" RAT_FUNC "%6.4" "mm^3/inj" COEFFS 0 100 0 0 0 1 /end COMPU_METHOD
/begin COMPU_METHOD InjTime_us "Zeit in Microsekunden für das Einspritztiming" RAT_FUNC "%6.2" "us" COEFFS 0 1 0 0 0 1 /end COMPU_METHOD
/begin COMPU_METHOD Ki_Trq2TrqT2 "Integrale Verstärkung Ki (Kupplungsmoment über die Zeit aufintegriert)" RAT_FUNC "%6.4" "Nms" COEFFS 0 429.4967296 0 0 0 1 /end COMPU_METHOD
/begin COMPU_METHOD Kp_LmbdRec2InjMass_2 "Proportionale Verstärkung Kp (reziprokes Lambda zu Einspritzmenge)" RAT_FUNC "%6.4" "mg/stroke" COEFFS 0 81.92 0 0 0 1 /end COMPU_METHOD
/begin COMPU_METHOD Kp_rpm2Nm_1 "Proportional Verstärkung (Umdrehungen nach Moment), Umrechnung für sint16 Werte" RAT_FUNC "%6.4" "Nm/rpm" COEFFS 0 320 0 0 0 1 /end COMPU_METHOD
/begin COMPU_METHOD OneToOne "eins zu eins (physikalischer Wert ist gleich dem internen Wert)" RAT_FUNC "%6.2" "-" COEFFS 0 1 0 0 0 1 /end COMPU_METHOD
/begin COMPU_METHOD Pres_hPa "Druck (angezeigt in [hPa])" RAT_FUNC "%6.2" "hPa" COEFFS 0 1 0 0 0 1 /end COMPU_METHOD
/begin COMPU_METHOD Pres_Rail "Raildruck in hPa" RAT_FUNC "%4.3" "bar" COEFFS 0 10.000000 0 0 0 1 /end COMPU_METHOD
/begin COMPU_METHOD Rmp "einheitenloser Rampengradient (für Library Ramp, etc.)" RAT_FUNC "%6.4" "1/s" COEFFS 0 65.536 0 0 0 1 /end COMPU_METHOD
/begin COMPU_METHOD Temp_Cels "Temperatur dargestellt in °C (gleiche interne Darstellung wie Temp_Kelv)" RAT_FUNC "%6.1" "deg C" COEFFS 0 10 2731.4 0 0 1 /end COMPU_METHOD
/begin RECORD_LAYOUT Gkf_Ws16 FNC_VALUES 1 SWORD COLUMN_DIR DIRECT /end RECORD_LAYOUT
/begin RECORD_LAYOUT Gkl_Ws16 FNC_VALUES 1 SWORD COLUMN_DIR DIRECT /end RECORD_LAYOUT
/begin RECORD_LAYOUT GSst_Xs16 NO_AXIS_PTS_X 1 SWORD AXIS_PTS_X 2 SWORD INDEX_INCR DIRECT /end RECORD_LAYOUT
/begin RECORD_LAYOUT Kf_Xs16_Ys16_Ws16 NO_AXIS_PTS_X 1 SWORD NO_AXIS_PTS_Y 2 SWORD AXIS_PTS_X 3 SWORD INDEX_INCR DIRECT AXIS_PTS_Y 4 SWORD INDEX_INCR DIRECT FNC_VALUES 5 SWORD COLUMN_DIR DIRECT /end RECORD_LAYOUT
/begin RECORD_LAYOUT Kl_Xs16_Ws16 NO_AXIS_PTS_X 1 SWORD AXIS_PTS_X 2 SWORD INDEX_INCR DIRECT FNC_VALUES 3 SWORD COLUMN_DIR DIRECT /end RECORD_LAYOUT
/begin RECORD_LAYOUT Kw_Ws16 FNC_VALUES 1 SWORD COLUMN_DIR DIRECT /end RECORD_LAYOUT
/begin RECORD_LAYOUT Kw_Wu32 FNC_VALUES 1 ULONG COLUMN_DIR DIRECT /end RECORD_LAYOUT
/begin RECORD_LAYOUT Kw_Wu8 FNC_VALUES 1 UBYTE COLUMN_DIR DIRECT /end RECORD_LAYOUT
/end MODULE
/end PROJECT
