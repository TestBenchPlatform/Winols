ASAP2_VERSION 1 3
/begin PROJECT P411 "BMW DDE6.0 6-Zylinder V66.1 07.01.2004 CAN12H"
/begin HEADER "" VERSION "V571_6Z_CAN12H" PROJECT_NO P411 /end HEADER
/begin MODULE DIM ""
/begin MOD_COMMON "" BYTE_ORDER MSB_FIRST ALIGNMENT_BYTE 1 ALIGNMENT_WORD 2 ALIGNMENT_LONG 4 ALIGNMENT_FLOAT32_IEEE 4 /end MOD_COMMON
/begin CHARACTERISTIC DSM_CDCDfp_Layer_TANS_C "CARB spezifischer Fehlercode fuer Fehlerpfad Dfp_Layer_TANS" VAL_BLK 0xC9110 Kwb_Wu16 65535.00 OneToOne 0.00 65535.00 FORMAT "%8.2" NUMBER 4 /end CHARACTERISTIC
/begin CHARACTERISTIC DSM_CDCDfp_ACCDCmpr_C "CARB spezifischer Fehlercode fuer Fehlerpfad Dfp_ACCDCmpr" VAL_BLK 0xC9118 Kwb_Wu16 65535.00 OneToOne 0.00 65535.00 FORMAT "%8.2" NUMBER 4 /end CHARACTERISTIC
/begin CHARACTERISTIC DSM_CDCDfp_ACCDPres_C "CARB spezifischer Fehlercode fuer Fehlerpfad Dfp_ACCDPres" VAL_BLK 0xC9120 Kwb_Wu16 65535.00 OneToOne 0.00 65535.00 FORMAT "%8.2" NUMBER 4 /end CHARACTERISTIC
/begin CHARACTERISTIC DSM_CDCDfp_ACCDPres1_C "CARB spezifischer Fehlercode fuer Fehlerpfad Dfp_ACCDPres1" VAL_BLK 0xC9128 Kwb_Wu16 65535.00 OneToOne 0.00 65535.00 FORMAT "%8.2" NUMBER 4 /end CHARACTERISTIC
/begin CHARACTERISTIC DSM_CDCDfp_ACCDPresAna_C "CARB spezifischer Fehlercode fuer Fehlerpfad Dfp_ACCDPresAna" VAL_BLK 0xC9130 Kwb_Wu16 65535.00 OneToOne 0.00 65535.00 FORMAT "%8.2" NUMBER 4 /end CHARACTERISTIC
/begin CHARACTERISTIC DSM_CDCDfp_ACCDSwtin_C "CARB spezifischer Fehlercode fuer Fehlerpfad Dfp_ACCDSwtin" VAL_BLK 0xC9138 Kwb_Wu16 65535.00 OneToOne 0.00 65535.00 FORMAT "%8.2" NUMBER 4 /end CHARACTERISTIC
/begin CHARACTERISTIC DSM_CDCDfp_ACC_PlausTrqDes_C "CARB spezifischer Fehlercode fuer Fehlerpfad Dfp_ACC_PlausTrqDes" VAL_BLK 0xC9140 Kwb_Wu16 65535.00 OneToOne 0.00 65535.00 FORMAT "%8.2" NUMBER 4 /end CHARACTERISTIC
/begin CHARACTERISTIC DSM_CDCDfp_ACC_trqInr_C "CARB spezifischer Fehlercode fuer Fehlerpfad Dfp_ACC_trqInr" VAL_BLK 0xC9148 Kwb_Wu16 65535.00 OneToOne 0.00 65535.00 FORMAT "%8.2" NUMBER 4 /end CHARACTERISTIC
/begin CHARACTERISTIC DSM_CDCDfp_ACTrq_C "CARB spezifischer Fehlercode fuer Fehlerpfad Dfp_ACTrq" VAL_BLK 0xC9150 Kwb_Wu16 65535.00 OneToOne 0.00 65535.00 FORMAT "%8.2" NUMBER 4 /end CHARACTERISTIC
/begin CHARACTERISTIC DSM_CDCDfp_ADCMon_C "CARB spezifischer Fehlercode fuer Fehlerpfad Dfp_ADCMon" VAL_BLK 0xC9158 Kwb_Wu16 65535.00 OneToOne 0.00 65535.00 FORMAT "%8.2" NUMBER 4 /end CHARACTERISTIC
/begin CHARACTERISTIC DSM_CDCDfp_AFSCDIdlAdjVal_C "CARB spezifischer Fehlercode fuer Fehlerpfad Dfp_AFSCDIdlAdjVal" VAL_BLK 0xC9160 Kwb_Wu16 65535.00 OneToOne 0.00 65535.00 FORMAT "%8.2" NUMBER 4 /end CHARACTERISTIC
/begin CHARACTERISTIC DSM_CDCDfp_AFSCDLdAdjVal_C "CARB spezifischer Fehlercode fuer Fehlerpfad Dfp_AFSCDLdAdjVal" VAL_BLK 0xC9168 Kwb_Wu16 65535.00 OneToOne 0.00 65535.00 FORMAT "%8.2" NUMBER 4 /end CHARACTERISTIC
/begin CHARACTERISTIC DSM_CDCDfp_AFSCD_AirTempDcyc_C "CARB spezifischer Fehlercode fuer Fehlerpfad Dfp_AFSCD_AirTempDcyc" VAL_BLK 0xC9170 Kwb_Wu16 65535.00 OneToOne 0.00 65535.00 FORMAT "%8.2" NUMBER 4 /end CHARACTERISTIC
/begin CHARACTERISTIC DSM_CDCDfp_AFSCD_PlOffsDrft_C "CARB spezifischer Fehlercode fuer Fehlerpfad Dfp_AFSCD_PlOffsDrft" VAL_BLK 0xC9178 Kwb_Wu16 65535.00 OneToOne 0.00 65535.00 FORMAT "%8.2" NUMBER 4 /end CHARACTERISTIC
/begin CHARACTERISTIC DSM_CDCDfp_AFSCD_PlSetyDrft_C "CARB spezifischer Fehlercode fuer Fehlerpfad Dfp_AFSCD_PlSetyDrft" VAL_BLK 0xC9180 Kwb_Wu16 65535.00 OneToOne 0.00 65535.00 FORMAT "%8.2" NUMBER 4 /end CHARACTERISTIC
/begin CHARACTERISTIC DSM_CDCDfp_AFSCD_SRCAirTemp_C "CARB spezifischer Fehlercode fuer Fehlerpfad Dfp_AFSCD_SRCAirTemp" VAL_BLK 0xC9188 Kwb_Wu16 65535.00 OneToOne 0.00 65535.00 FORMAT "%8.2" NUMBER 4 /end CHARACTERISTIC
/begin CHARACTERISTIC DSM_CDCDfp_AFSCD_SRCBatt_C "CARB spezifischer Fehlercode fuer Fehlerpfad Dfp_AFSCD_SRCBatt" VAL_BLK 0xC9190 Kwb_Wu16 65535.00 OneToOne 0.00 65535.00 FORMAT "%8.2" NUMBER 4 /end CHARACTERISTIC
/begin CHARACTERISTIC DSM_CDCDfp_AFSCD_SRCCorrAirm_C "CARB spezifischer Fehlercode fuer Fehlerpfad Dfp_AFSCD_SRCCorrAirm" VAL_BLK 0xC9198 Kwb_Wu16 65535.00 OneToOne 0.00 65535.00 FORMAT "%8.2" NUMBER 4 /end CHARACTERISTIC
/begin CHARACTERISTIC DSM_CDCDfp_AFSCD_SRCRawAirm_C "CARB spezifischer Fehlercode fuer Fehlerpfad Dfp_AFSCD_SRCRawAirm" VAL_BLK 0xC91A0 Kwb_Wu16 65535.00 OneToOne 0.00 65535.00 FORMAT "%8.2" NUMBER 4 /end CHARACTERISTIC
/begin CHARACTERISTIC DSM_CDCDfp_Layer_TUMG_C "CARB spezifischer Fehlercode fuer Fehlerpfad Dfp_Layer_TUMG" VAL_BLK 0xC91A8 Kwb_Wu16 65535.00 OneToOne 0.00 65535.00 FORMAT "%8.2" NUMBER 4 /end CHARACTERISTIC
/begin CHARACTERISTIC DSM_CDCDfp_AFSCD_SRCRefSigPer_C "CARB spezifischer Fehlercode fuer Fehlerpfad Dfp_AFSCD_SRCRefSigPer" VAL_BLK 0xC91B0 Kwb_Wu16 65535.00 OneToOne 0.00 65535.00 FORMAT "%8.2" NUMBER 4 /end CHARACTERISTIC
/begin CHARACTERISTIC DSM_CDCDfp_AOHtCD_C "CARB spezifischer Fehlercode fuer Fehlerpfad Dfp_AOHtCD" VAL_BLK 0xC91B8 Kwb_Wu16 65535.00 OneToOne 0.00 65535.00 FORMAT "%8.2" NUMBER 4 /end CHARACTERISTIC
/begin CHARACTERISTIC DSM_CDCDfp_Layer_GEN_C "CARB spezifischer Fehlercode fuer Fehlerpfad Dfp_Layer_GEN" VAL_BLK 0xC91C0 Kwb_Wu16 65535.00 OneToOne 0.00 65535.00 FORMAT "%8.2" NUMBER 4 /end CHARACTERISTIC
/begin CHARACTERISTIC DSM_CDCDfp_Layer_BSD_C "CARB spezifischer Fehlercode fuer Fehlerpfad Dfp_Layer_BSD" VAL_BLK 0xC91C8 Kwb_Wu16 65535.00 OneToOne 0.00 65535.00 FORMAT "%8.2" NUMBER 4 /end CHARACTERISTIC
/begin CHARACTERISTIC DSM_CDCDfp_AOHtCD_AOHtDia1_C "CARB spezifischer Fehlercode fuer Fehlerpfad Dfp_AOHtCD_AOHtDia1" VAL_BLK 0xC91D0 Kwb_Wu16 65535.00 OneToOne 0.00 65535.00 FORMAT "%8.2" NUMBER 4 /end CHARACTERISTIC
/begin CHARACTERISTIC DSM_CDCDfp_AOHtCD_AOHtDia2_C "CARB spezifischer Fehlercode fuer Fehlerpfad Dfp_AOHtCD_AOHtDia2" VAL_BLK 0xC91D8 Kwb_Wu16 65535.00 OneToOne 0.00 65535.00 FORMAT "%8.2" NUMBER 4 /end CHARACTERISTIC
/begin CHARACTERISTIC DSM_CDCDfp_AOHtCD_AOHtDia3_C "CARB spezifischer Fehlercode fuer Fehlerpfad Dfp_AOHtCD_AOHtDia3" VAL_BLK 0xC91E0 Kwb_Wu16 65535.00 OneToOne 0.00 65535.00 FORMAT "%8.2" NUMBER 4 /end CHARACTERISTIC
/begin CHARACTERISTIC DSM_CDCDfp_APP1_C "CARB spezifischer Fehlercode fuer Fehlerpfad Dfp_APP1" VAL_BLK 0xC91E8 Kwb_Wu16 65535.00 OneToOne 0.00 65535.00 FORMAT "%8.2" NUMBER 4 /end CHARACTERISTIC
/begin CHARACTERISTIC DSM_CDCDfp_APP2_C "CARB spezifischer Fehlercode fuer Fehlerpfad Dfp_APP2" VAL_BLK 0xC91F0 Kwb_Wu16 65535.00 OneToOne 0.00 65535.00 FORMAT "%8.2" NUMBER 4 /end CHARACTERISTIC
/begin CHARACTERISTIC DSM_CDCDfp_APPSync_C "CARB spezifischer Fehlercode fuer Fehlerpfad Dfp_APPSync" VAL_BLK 0xC91F8 Kwb_Wu16 65535.00 OneToOne 0.00 65535.00 FORMAT "%8.2" NUMBER 4 /end CHARACTERISTIC
/begin CHARACTERISTIC DSM_CDCDfp_APSCD_C "CARB spezifischer Fehlercode fuer Fehlerpfad Dfp_APSCD" VAL_BLK 0xC9200 Kwb_Wu16 65535.00 OneToOne 0.00 65535.00 FORMAT "%8.2" NUMBER 4 /end CHARACTERISTIC
/begin CHARACTERISTIC DSM_CDCDfp_ARS_C "CARB spezifischer Fehlercode fuer Fehlerpfad Dfp_ARS" VAL_BLK 0xC9208 Kwb_Wu16 65535.00 OneToOne 0.00 65535.00 FORMAT "%8.2" NUMBER 4 /end CHARACTERISTIC
/begin CHARACTERISTIC DSM_CDCDfp_AccPedPlausBrk_C "CARB spezifischer Fehlercode fuer Fehlerpfad Dfp_AccPedPlausBrk" VAL_BLK 0xC9210 Kwb_Wu16 65535.00 OneToOne 0.00 65535.00 FORMAT "%8.2" NUMBER 4 /end CHARACTERISTIC
/begin CHARACTERISTIC DSM_CDCDfp_AirCtlPlateBreak_C "DSM variable for Dfp_AirCtlPlateBreak_mp" VAL_BLK 0xC9218 Kwb_Wu16 65535.00 OneToOne 0.00 65535.00 FORMAT "%8.2" NUMBER 4 /end CHARACTERISTIC
/begin CHARACTERISTIC DSM_CDCDfp_Layer_QLT_C "CARB spezifischer Fehlercode fuer Fehlerpfad Dfp_Layer_QLT" VAL_BLK 0xC9220 Kwb_Wu16 65535.00 OneToOne 0.00 65535.00 FORMAT "%8.2" NUMBER 4 /end CHARACTERISTIC
/begin CHARACTERISTIC DSM_CDCDfp_AirCtl_GovNegDev_C "CARB spezifischer Fehlercode fuer Fehlerpfad Dfp_AirCtl_GovNegDev" VAL_BLK 0xC9228 Kwb_Wu16 65535.00 OneToOne 0.00 65535.00 FORMAT "%8.2" NUMBER 4 /end CHARACTERISTIC
/begin CHARACTERISTIC DSM_CDCDfp_Layer_IBS1_C "CARB spezifischer Fehlercode fuer Fehlerpfad Dfp_Layer_IBS1" VAL_BLK 0xC9230 Kwb_Wu16 65535.00 OneToOne 0.00 65535.00 FORMAT "%8.2" NUMBER 4 /end CHARACTERISTIC
/begin CHARACTERISTIC DSM_CDCDfp_Layer_IBS2_C "CARB spezifischer Fehlercode fuer Fehlerpfad Dfp_Layer_IBS2" VAL_BLK 0xC9238 Kwb_Wu16 65535.00 OneToOne 0.00 65535.00 FORMAT "%8.2" NUMBER 4 /end CHARACTERISTIC
/begin CHARACTERISTIC DSM_CDCDfp_Layer_IBS3_C "CARB spezifischer Fehlercode fuer Fehlerpfad Dfp_Layer_IBS3" VAL_BLK 0xC9240 Kwb_Wu16 65535.00 OneToOne 0.00 65535.00 FORMAT "%8.2" NUMBER 4 /end CHARACTERISTIC
/begin CHARACTERISTIC DSM_CDCDfp_Layer_PMBN_C "CARB spezifischer Fehlercode fuer Fehlerpfad Dfp_Layer_PMBN" VAL_BLK 0xC9248 Kwb_Wu16 65535.00 OneToOne 0.00 65535.00 FORMAT "%8.2" NUMBER 4 /end CHARACTERISTIC
/begin CHARACTERISTIC DSM_CDCDfp_Layer_PMBATT_C "CARB spezifischer Fehlercode fuer Fehlerpfad Dfp_Layer_PMBATT" VAL_BLK 0xC9250 Kwb_Wu16 65535.00 OneToOne 0.00 65535.00 FORMAT "%8.2" NUMBER 4 /end CHARACTERISTIC
/begin CHARACTERISTIC DSM_CDCDfp_AirCtl_GovNegDev2_C "CARB spezifischer Fehlercode fuer Fehlerpfad Dfp_AirCtl_GovNegDev2" VAL_BLK 0xC9258 Kwb_Wu16 65535.00 OneToOne 0.00 65535.00 FORMAT "%8.2" NUMBER 4 /end CHARACTERISTIC
/begin CHARACTERISTIC DSM_CDCDfp_AirCtl_GovPosDev_C "CARB spezifischer Fehlercode fuer Fehlerpfad Dfp_AirCtl_GovPosDev" VAL_BLK 0xC9260 Kwb_Wu16 65535.00 OneToOne 0.00 65535.00 FORMAT "%8.2" NUMBER 4 /end CHARACTERISTIC
/begin CHARACTERISTIC DSM_CDCDfp_AirCtl_GovPosDev2_C "CARB spezifischer Fehlercode fuer Fehlerpfad Dfp_AirCtl_GovPosDev2" VAL_BLK 0xC9268 Kwb_Wu16 65535.00 OneToOne 0.00 65535.00 FORMAT "%8.2" NUMBER 4 /end CHARACTERISTIC
/begin CHARACTERISTIC DSM_CDCDfp_AltCD_C "CARB spezifischer Fehlercode fuer Fehlerpfad Dfp_AltCD" VAL_BLK 0xC9270 Kwb_Wu16 65535.00 OneToOne 0.00 65535.00 FORMAT "%8.2" NUMBER 4 /end CHARACTERISTIC
/begin CHARACTERISTIC DSM_CDCDfp_AltCD_Load_C "CARB spezifischer Fehlercode fuer Fehlerpfad Dfp_AltCD_Load" VAL_BLK 0xC9278 Kwb_Wu16 65535.00 OneToOne 0.00 65535.00 FORMAT "%8.2" NUMBER 4 /end CHARACTERISTIC
/begin CHARACTERISTIC DSM_CDCDfp_BPACD_BPADia1_C "CARB spezifischer Fehlercode fuer Fehlerpfad Dfp_BPACD_BPADia1" VAL_BLK 0xC9280 Kwb_Wu16 65535.00 OneToOne 0.00 65535.00 FORMAT "%8.2" NUMBER 4 /end CHARACTERISTIC
/begin CHARACTERISTIC DSM_CDCDfp_BPACD_BPADia2_C "CARB spezifischer Fehlercode fuer Fehlerpfad Dfp_BPACD_BPADia2" VAL_BLK 0xC9288 Kwb_Wu16 65535.00 OneToOne 0.00 65535.00 FORMAT "%8.2" NUMBER 4 /end CHARACTERISTIC
/begin CHARACTERISTIC DSM_CDCDfp_BPACD_BPADia3_C "CARB spezifischer Fehlercode fuer Fehlerpfad Dfp_BPACD_BPADia3" VAL_BLK 0xC9290 Kwb_Wu16 65535.00 OneToOne 0.00 65535.00 FORMAT "%8.2" NUMBER 4 /end CHARACTERISTIC
/begin CHARACTERISTIC DSM_CDCDfp_BPACD_Max_C "CARB spezifischer Fehlercode fuer Fehlerpfad Dfp_BPACD_Max" VAL_BLK 0xC9298 Kwb_Wu16 65535.00 OneToOne 0.00 65535.00 FORMAT "%8.2" NUMBER 4 /end CHARACTERISTIC
/begin CHARACTERISTIC DSM_CDCDfp_BPACD_Min_C "CARB spezifischer Fehlercode fuer Fehlerpfad Dfp_BPACD_Min" VAL_BLK 0xC92A0 Kwb_Wu16 65535.00 OneToOne 0.00 65535.00 FORMAT "%8.2" NUMBER 4 /end CHARACTERISTIC
/begin CHARACTERISTIC DSM_CDCDfp_BPACD_SigNpl_C "CARB spezifischer Fehlercode fuer Fehlerpfad Dfp_BPACD_SigNpl" VAL_BLK 0xC92A8 Kwb_Wu16 65535.00 OneToOne 0.00 65535.00 FORMAT "%8.2" NUMBER 4 /end CHARACTERISTIC
/begin CHARACTERISTIC DSM_CDCDfp_BPSCD_C "CARB spezifischer Fehlercode fuer Fehlerpfad Dfp_BPSCD" VAL_BLK 0xC92B0 Kwb_Wu16 65535.00 OneToOne 0.00 65535.00 FORMAT "%8.2" NUMBER 4 /end CHARACTERISTIC
/begin CHARACTERISTIC DSM_CDCDfp_BattCD_C "CARB spezifischer Fehlercode fuer Fehlerpfad Dfp_BattCD" VAL_BLK 0xC92B8 Kwb_Wu16 65535.00 OneToOne 0.00 65535.00 FORMAT "%8.2" NUMBER 4 /end CHARACTERISTIC
/begin CHARACTERISTIC DSM_CDCDfp_BrkCD_C "CARB spezifischer Fehlercode fuer Fehlerpfad Dfp_BrkCD" VAL_BLK 0xC92C0 Kwb_Wu16 65535.00 OneToOne 0.00 65535.00 FORMAT "%8.2" NUMBER 4 /end CHARACTERISTIC
/begin CHARACTERISTIC DSM_CDCDfp_Bss_C "CARB spezifischer Fehlercode fuer Fehlerpfad Dfp_Bss" VAL_BLK 0xC92C8 Kwb_Wu16 65535.00 OneToOne 0.00 65535.00 FORMAT "%8.2" NUMBER 4 /end CHARACTERISTIC
/begin CHARACTERISTIC DSM_CDCDfp_CBACD_C "CARB spezifischer Fehlercode fuer Fehlerpfad Dfp_CBACD" VAL_BLK 0xC92D0 Kwb_Wu16 65535.00 OneToOne 0.00 65535.00 FORMAT "%8.2" NUMBER 4 /end CHARACTERISTIC
/begin CHARACTERISTIC DSM_CDCDfp_CTSCD_C "CARB spezifischer Fehlercode fuer Fehlerpfad Dfp_CTSCD" VAL_BLK 0xC92D8 Kwb_Wu16 65535.00 OneToOne 0.00 65535.00 FORMAT "%8.2" NUMBER 4 /end CHARACTERISTIC
/begin CHARACTERISTIC DSM_CDCDfp_Clg_DynTst_C "CARB spezifischer Fehlercode fuer Fehlerpfad Dfp_Clg_DynTst" VAL_BLK 0xC92E0 Kwb_Wu16 65535.00 OneToOne 0.00 65535.00 FORMAT "%8.2" NUMBER 4 /end CHARACTERISTIC
/begin CHARACTERISTIC DSM_CDCDfp_CmbChbMisfire1_C "CARB spezifischer Fehlercode fuer Fehlerpfad Dfp_CmbChbMisfire1" VAL_BLK 0xC92E8 Kwb_Wu16 65535.00 OneToOne 0.00 65535.00 FORMAT "%8.2" NUMBER 4 /end CHARACTERISTIC
/begin CHARACTERISTIC DSM_CDCDfp_CmbChbMisfire2_C "CARB spezifischer Fehlercode fuer Fehlerpfad Dfp_CmbChbMisfire2" VAL_BLK 0xC92F0 Kwb_Wu16 65535.00 OneToOne 0.00 65535.00 FORMAT "%8.2" NUMBER 4 /end CHARACTERISTIC
/begin CHARACTERISTIC DSM_CDCDfp_CmbChbMisfire3_C "CARB spezifischer Fehlercode fuer Fehlerpfad Dfp_CmbChbMisfire3" VAL_BLK 0xC92F8 Kwb_Wu16 65535.00 OneToOne 0.00 65535.00 FORMAT "%8.2" NUMBER 4 /end CHARACTERISTIC
/begin CHARACTERISTIC DSM_CDCDfp_CmbChbMisfire4_C "CARB spezifischer Fehlercode fuer Fehlerpfad Dfp_CmbChbMisfire4" VAL_BLK 0xC9300 Kwb_Wu16 65535.00 OneToOne 0.00 65535.00 FORMAT "%8.2" NUMBER 4 /end CHARACTERISTIC
/begin CHARACTERISTIC DSM_CDCDfp_CmbChbMisfire5_C "CARB spezifischer Fehlercode fuer Fehlerpfad Dfp_CmbChbMisfire5" VAL_BLK 0xC9308 Kwb_Wu16 65535.00 OneToOne 0.00 65535.00 FORMAT "%8.2" NUMBER 4 /end CHARACTERISTIC
/begin CHARACTERISTIC DSM_CDCDfp_CmbChbMisfire6_C "CARB spezifischer Fehlercode fuer Fehlerpfad Dfp_CmbChbMisfire6" VAL_BLK 0xC9310 Kwb_Wu16 65535.00 OneToOne 0.00 65535.00 FORMAT "%8.2" NUMBER 4 /end CHARACTERISTIC
/begin CHARACTERISTIC DSM_CDCDfp_CmbChbMisfireMul_C "CARB spezifischer Fehlercode fuer Fehlerpfad Dfp_CmbChbMisfireMul" VAL_BLK 0xC9318 Kwb_Wu16 65535.00 OneToOne 0.00 65535.00 FORMAT "%8.2" NUMBER 4 /end CHARACTERISTIC
/begin CHARACTERISTIC DSM_CDCDfp_CoVMDCSh_C "CARB spezifischer Fehlercode fuer Fehlerpfad Dfp_CoVMDCSh" VAL_BLK 0xC9320 Kwb_Wu16 65535.00 OneToOne 0.00 65535.00 FORMAT "%8.2" NUMBER 4 /end CHARACTERISTIC
/begin CHARACTERISTIC DSM_CDCDfp_ConvCD_C "CARB spezifischer Fehlercode fuer Fehlerpfad Dfp_ConvCD" VAL_BLK 0xC9328 Kwb_Wu16 65535.00 OneToOne 0.00 65535.00 FORMAT "%8.2" NUMBER 4 /end CHARACTERISTIC
/begin CHARACTERISTIC DSM_CDCDfp_CrCCDMFL_C "CARB spezifischer Fehlercode fuer Fehlerpfad Dfp_CrCCDMFL" VAL_BLK 0xC9330 Kwb_Wu16 65535.00 OneToOne 0.00 65535.00 FORMAT "%8.2" NUMBER 4 /end CHARACTERISTIC
/begin CHARACTERISTIC DSM_CDCDfp_CrCtl_vCrCtl_C "CARB spezifischer Fehlercode fuer Fehlerpfad Dfp_CrCtl_vCrCtl" VAL_BLK 0xC9338 Kwb_Wu16 65535.00 OneToOne 0.00 65535.00 FORMAT "%8.2" NUMBER 4 /end CHARACTERISTIC
/begin CHARACTERISTIC DSM_CDCDfp_Dummy1_C "CARB spezifischer Fehlercode fuer Fehlerpfad Dfp_Dummy1" VAL_BLK 0xC9340 Kwb_Wu16 65535.00 OneToOne 0.00 65535.00 FORMAT "%8.2" NUMBER 4 /end CHARACTERISTIC
/begin CHARACTERISTIC DSM_CDCDfp_EATSCD_C "CARB spezifischer Fehlercode fuer Fehlerpfad Dfp_EATSCD" VAL_BLK 0xC9348 Kwb_Wu16 65535.00 OneToOne 0.00 65535.00 FORMAT "%8.2" NUMBER 4 /end CHARACTERISTIC
/begin CHARACTERISTIC DSM_CDCDfp_EBAFCD_C "CARB spezifischer Fehlercode fuer Fehlerpfad Dfp_EBAFCD" VAL_BLK 0xC9350 Kwb_Wu16 65535.00 OneToOne 0.00 65535.00 FORMAT "%8.2" NUMBER 4 /end CHARACTERISTIC
/begin CHARACTERISTIC DSM_CDCDfp_Layer_PMRUHVERL_C "CARB spezifischer Fehlercode fuer Fehlerpfad Dfp_Layer_PMRUHVERL" VAL_BLK 0xC9358 Kwb_Wu16 65535.00 OneToOne 0.00 65535.00 FORMAT "%8.2" NUMBER 4 /end CHARACTERISTIC
/begin CHARACTERISTIC DSM_CDCDfp_EBFCD_C "CARB spezifischer Fehlercode fuer Fehlerpfad Dfp_EBFCD" VAL_BLK 0xC9360 Kwb_Wu16 65535.00 OneToOne 0.00 65535.00 FORMAT "%8.2" NUMBER 4 /end CHARACTERISTIC
/begin CHARACTERISTIC DSM_CDCDfp_EBTSCD_C "CARB spezifischer Fehlercode fuer Fehlerpfad Dfp_EBTSCD" VAL_BLK 0xC9368 Kwb_Wu16 65535.00 OneToOne 0.00 65535.00 FORMAT "%8.2" NUMBER 4 /end CHARACTERISTIC
/begin CHARACTERISTIC DSM_CDCDfp_EBTSCD_OvrTemp_C "CARB spezifischer Fehlercode fuer Fehlerpfad Dfp_EBTSCD_OvrTemp" VAL_BLK 0xC9370 Kwb_Wu16 65535.00 OneToOne 0.00 65535.00 FORMAT "%8.2" NUMBER 4 /end CHARACTERISTIC
/begin CHARACTERISTIC DSM_CDCDfp_EEPCDVarMng_C "CARB spezifischer Fehlercode fuer Fehlerpfad Dfp_EEPCDVarMng" VAL_BLK 0xC9378 Kwb_Wu16 65535.00 OneToOne 0.00 65535.00 FORMAT "%8.2" NUMBER 4 /end CHARACTERISTIC
/begin CHARACTERISTIC DSM_CDCDfp_Layer_TOENS_C "CARB spezifischer Fehlercode fuer Fehlerpfad Dfp_Layer_TOENS" VAL_BLK 0xC9380 Kwb_Wu16 65535.00 OneToOne 0.00 65535.00 FORMAT "%8.2" NUMBER 4 /end CHARACTERISTIC
/begin CHARACTERISTIC DSM_CDCDfp_Layer_MANHYDR_C "CARB spezifischer Fehlercode fuer Fehlerpfad Dfp_Layer_MANHYDR" VAL_BLK 0xC9388 Kwb_Wu16 65535.00 OneToOne 0.00 65535.00 FORMAT "%8.2" NUMBER 4 /end CHARACTERISTIC
/begin CHARACTERISTIC DSM_CDCDfp_Layer_MANLUFT_C "CARB spezifischer Fehlercode fuer Fehlerpfad Dfp_Layer_MANLUFT" VAL_BLK 0xC9390 Kwb_Wu16 65535.00 OneToOne 0.00 65535.00 FORMAT "%8.2" NUMBER 4 /end CHARACTERISTIC
/begin CHARACTERISTIC DSM_CDCDfp_EGPpCD_C "CARB spezifischer Fehlercode fuer Fehlerpfad Dfp_EGPpCD" VAL_BLK 0xC9398 Kwb_Wu16 65535.00 OneToOne 0.00 65535.00 FORMAT "%8.2" NUMBER 4 /end CHARACTERISTIC
/begin CHARACTERISTIC DSM_CDCDfp_EGPpCDTPreTrbn_C "CARB spezifischer Fehlercode fuer Fehlerpfad Dfp_EgPpCDTPreTrbn" VAL_BLK 0xC93A0 Kwb_Wu16 65535.00 OneToOne 0.00 65535.00 FORMAT "%8.2" NUMBER 4 /end CHARACTERISTIC
/begin CHARACTERISTIC DSM_CDCDfp_EGRCD_Max_C "CARB spezifischer Fehlercode fuer Fehlerpfad Dfp_EGRCD_Max" VAL_BLK 0xC93A8 Kwb_Wu16 65535.00 OneToOne 0.00 65535.00 FORMAT "%8.2" NUMBER 4 /end CHARACTERISTIC
/begin CHARACTERISTIC DSM_CDCDfp_EGRCD_Min_C "CARB spezifischer Fehlercode fuer Fehlerpfad Dfp_EGRCD_Min" VAL_BLK 0xC93B0 Kwb_Wu16 65535.00 OneToOne 0.00 65535.00 FORMAT "%8.2" NUMBER 4 /end CHARACTERISTIC
/begin CHARACTERISTIC DSM_CDCDfp_EGRCD_SigNpl_C "CARB spezifischer Fehlercode fuer Fehlerpfad Dfp_EGRCD_SigNpl" VAL_BLK 0xC93B8 Kwb_Wu16 65535.00 OneToOne 0.00 65535.00 FORMAT "%8.2" NUMBER 4 /end CHARACTERISTIC
/begin CHARACTERISTIC DSM_CDCDfp_EGTRgnOilDil_C "CARB spezifischer Fehlercode fuer Fehlerpfad Dfp_EGTRgnOilDil" VAL_BLK 0xC93C0 Kwb_Wu16 65535.00 OneToOne 0.00 65535.00 FORMAT "%8.2" NUMBER 4 /end CHARACTERISTIC
/begin CHARACTERISTIC DSM_CDCDfp_EMCCDNoLoad1_C "" VAL_BLK 0xC93C8 Kwb_Wu16 65535.00 OneToOne 0.00 65535.00 FORMAT "%8.2" NUMBER 4 /end CHARACTERISTIC
/begin CHARACTERISTIC DSM_CDCDfp_EMCCDNoLoad2_C "" VAL_BLK 0xC93D0 Kwb_Wu16 65535.00 OneToOne 0.00 65535.00 FORMAT "%8.2" NUMBER 4 /end CHARACTERISTIC
/begin CHARACTERISTIC DSM_CDCDfp_EMCCDSCBat1_C "" VAL_BLK 0xC93D8 Kwb_Wu16 65535.00 OneToOne 0.00 65535.00 FORMAT "%8.2" NUMBER 4 /end CHARACTERISTIC
/begin CHARACTERISTIC DSM_CDCDfp_EMCCDSCBat2_C "" VAL_BLK 0xC93E0 Kwb_Wu16 65535.00 OneToOne 0.00 65535.00 FORMAT "%8.2" NUMBER 4 /end CHARACTERISTIC
/begin CHARACTERISTIC DSM_CDCDfp_EMCCDSCGnd1_C "" VAL_BLK 0xC93E8 Kwb_Wu16 65535.00 OneToOne 0.00 65535.00 FORMAT "%8.2" NUMBER 4 /end CHARACTERISTIC
/begin CHARACTERISTIC DSM_CDCDfp_EMCCDSCGnd2_C "" VAL_BLK 0xC93F0 Kwb_Wu16 65535.00 OneToOne 0.00 65535.00 FORMAT "%8.2" NUMBER 4 /end CHARACTERISTIC
/begin CHARACTERISTIC DSM_CDCDfp_EMCCD_ADC1_C "" VAL_BLK 0xC93F8 Kwb_Wu16 65535.00 OneToOne 0.00 65535.00 FORMAT "%8.2" NUMBER 4 /end CHARACTERISTIC
/begin CHARACTERISTIC DSM_CDCDfp_EMCCD_ADC2_C "" VAL_BLK 0xC9400 Kwb_Wu16 65535.00 OneToOne 0.00 65535.00 FORMAT "%8.2" NUMBER 4 /end CHARACTERISTIC
/begin CHARACTERISTIC DSM_CDCDfp_ETClbETFltInj1_C "CARB spezifischer Fehlercode fuer Fehlerpfad Dfp_ETClbETFltInj1" VAL_BLK 0xC9408 Kwb_Wu16 65535.00 OneToOne 0.00 65535.00 FORMAT "%8.2" NUMBER 4 /end CHARACTERISTIC
/begin CHARACTERISTIC DSM_CDCDfp_ETClbETFltInj2_C "CARB spezifischer Fehlercode fuer Fehlerpfad Dfp_ETClbETFltInj2" VAL_BLK 0xC9410 Kwb_Wu16 65535.00 OneToOne 0.00 65535.00 FORMAT "%8.2" NUMBER 4 /end CHARACTERISTIC
/begin CHARACTERISTIC DSM_CDCDfp_ETClbETFltInj3_C "CARB spezifischer Fehlercode fuer Fehlerpfad Dfp_ETClbETFltInj3" VAL_BLK 0xC9418 Kwb_Wu16 65535.00 OneToOne 0.00 65535.00 FORMAT "%8.2" NUMBER 4 /end CHARACTERISTIC
/begin CHARACTERISTIC DSM_CDCDfp_ETClbETFltInj4_C "CARB spezifischer Fehlercode fuer Fehlerpfad Dfp_ETClbETFltInj4" VAL_BLK 0xC9420 Kwb_Wu16 65535.00 OneToOne 0.00 65535.00 FORMAT "%8.2" NUMBER 4 /end CHARACTERISTIC
/begin CHARACTERISTIC DSM_CDCDfp_ETClbETFltInj5_C "CARB spezifischer Fehlercode fuer Fehlerpfad Dfp_ETClbETFltInj5" VAL_BLK 0xC9428 Kwb_Wu16 65535.00 OneToOne 0.00 65535.00 FORMAT "%8.2" NUMBER 4 /end CHARACTERISTIC
/begin CHARACTERISTIC DSM_CDCDfp_ETClbETFltInj6_C "CARB spezifischer Fehlercode fuer Fehlerpfad Dfp_ETClbETFltInj6" VAL_BLK 0xC9430 Kwb_Wu16 65535.00 OneToOne 0.00 65535.00 FORMAT "%8.2" NUMBER 4 /end CHARACTERISTIC
/begin CHARACTERISTIC DSM_CDCDfp_ETClbInj1_C "CARB spezifischer Fehlercode fuer Fehlerpfad Dfp_ETClbInj1" VAL_BLK 0xC9438 Kwb_Wu16 65535.00 OneToOne 0.00 65535.00 FORMAT "%8.2" NUMBER 4 /end CHARACTERISTIC
/begin CHARACTERISTIC DSM_CDCDfp_ETClbInj2_C "CARB spezifischer Fehlercode fuer Fehlerpfad Dfp_ETClbInj2" VAL_BLK 0xC9440 Kwb_Wu16 65535.00 OneToOne 0.00 65535.00 FORMAT "%8.2" NUMBER 4 /end CHARACTERISTIC
/begin CHARACTERISTIC DSM_CDCDfp_ETClbInj3_C "CARB spezifischer Fehlercode fuer Fehlerpfad Dfp_ETClbInj3" VAL_BLK 0xC9448 Kwb_Wu16 65535.00 OneToOne 0.00 65535.00 FORMAT "%8.2" NUMBER 4 /end CHARACTERISTIC
/begin CHARACTERISTIC DSM_CDCDfp_ETClbInj4_C "CARB spezifischer Fehlercode fuer Fehlerpfad Dfp_ETClbInj4" VAL_BLK 0xC9450 Kwb_Wu16 65535.00 OneToOne 0.00 65535.00 FORMAT "%8.2" NUMBER 4 /end CHARACTERISTIC
/begin CHARACTERISTIC DSM_CDCDfp_ETClbInj5_C "CARB spezifischer Fehlercode fuer Fehlerpfad Dfp_ETClbInj5" VAL_BLK 0xC9458 Kwb_Wu16 65535.00 OneToOne 0.00 65535.00 FORMAT "%8.2" NUMBER 4 /end CHARACTERISTIC
/begin CHARACTERISTIC DSM_CDCDfp_ETClbInj6_C "CARB spezifischer Fehlercode fuer Fehlerpfad Dfp_ETClbInj6" VAL_BLK 0xC9460 Kwb_Wu16 65535.00 OneToOne 0.00 65535.00 FORMAT "%8.2" NUMBER 4 /end CHARACTERISTIC
/begin CHARACTERISTIC DSM_CDCDfp_EngMCaS1_C "CARB spezifischer Fehlercode fuer Fehlerpfad Dfp_EngMCaS1" VAL_BLK 0xC9468 Kwb_Wu16 65535.00 OneToOne 0.00 65535.00 FORMAT "%8.2" NUMBER 4 /end CHARACTERISTIC
/begin CHARACTERISTIC DSM_CDCDfp_EngMCrS1_C "CARB spezifischer Fehlercode fuer Fehlerpfad Dfp_EngMCrS1" VAL_BLK 0xC9470 Kwb_Wu16 65535.00 OneToOne 0.00 65535.00 FORMAT "%8.2" NUMBER 4 /end CHARACTERISTIC
/begin CHARACTERISTIC DSM_CDCDfp_EngMOfsCaSCrS_C "CARB spezifischer Fehlercode fuer Fehlerpfad Dfp_EngMOfsCaSCrS" VAL_BLK 0xC9478 Kwb_Wu16 65535.00 OneToOne 0.00 65535.00 FORMAT "%8.2" NUMBER 4 /end CHARACTERISTIC
/begin CHARACTERISTIC DSM_CDCDfp_EngPrtFWODet_C "CARB spezifischer Fehlercode fuer Fehlerpfad Dfp_EngPrtFWODet" VAL_BLK 0xC9480 Kwb_Wu16 65535.00 OneToOne 0.00 65535.00 FORMAT "%8.2" NUMBER 4 /end CHARACTERISTIC
/begin CHARACTERISTIC DSM_CDCDfp_FBCqDvt_C "CARB spezifischer Fehlercode fuer Fehlerpfad Dfp_FBCqDvt" VAL_BLK 0xC9488 Kwb_Wu16 65535.00 OneToOne 0.00 65535.00 FORMAT "%8.2" NUMBER 4 /end CHARACTERISTIC
/begin CHARACTERISTIC DSM_CDCDfp_FMTC_NonMonotonMap_C "CARB spezifischer Fehlercode fuer Fehlerpfad Dfp_FMTC_NonMonotonMap" VAL_BLK 0xC9490 Kwb_Wu16 65535.00 OneToOne 0.00 65535.00 FORMAT "%8.2" NUMBER 4 /end CHARACTERISTIC
/begin CHARACTERISTIC DSM_CDCDfp_FTSCD_C "CARB spezifischer Fehlercode fuer Fehlerpfad Dfp_FTSCD" VAL_BLK 0xC9498 Kwb_Wu16 65535.00 OneToOne 0.00 65535.00 FORMAT "%8.2" NUMBER 4 /end CHARACTERISTIC
/begin CHARACTERISTIC DSM_CDCDfp_FanCD_C "CARB spezifischer Fehlercode fuer Fehlerpfad Dfp_FanCD" VAL_BLK 0xC94A0 Kwb_Wu16 65535.00 OneToOne 0.00 65535.00 FORMAT "%8.2" NUMBER 4 /end CHARACTERISTIC
/begin CHARACTERISTIC DSM_CDCDfp_FanCD_FanCtlr1_C "CARB spezifischer Fehlercode fuer Fehlerpfad Dfp_FanCD_FanCtlr1" VAL_BLK 0xC94A8 Kwb_Wu16 65535.00 OneToOne 0.00 65535.00 FORMAT "%8.2" NUMBER 4 /end CHARACTERISTIC
/begin CHARACTERISTIC DSM_CDCDfp_FanCD_FanCtlr2_C "CARB spezifischer Fehlercode fuer Fehlerpfad Dfp_FanCD_FanCtlr2" VAL_BLK 0xC94B0 Kwb_Wu16 65535.00 OneToOne 0.00 65535.00 FORMAT "%8.2" NUMBER 4 /end CHARACTERISTIC
/begin CHARACTERISTIC DSM_CDCDfp_FanCD_FanCtlr3_C "CARB spezifischer Fehlercode fuer Fehlerpfad Dfp_FanCD_FanCtlr3" VAL_BLK 0xC94B8 Kwb_Wu16 65535.00 OneToOne 0.00 65535.00 FORMAT "%8.2" NUMBER 4 /end CHARACTERISTIC
/begin CHARACTERISTIC DSM_CDCDfp_FlFCD_C "CARB spezifischer Fehlercode fuer Fehlerpfad Dfp_FlFCD" VAL_BLK 0xC94C0 Kwb_Wu16 65535.00 OneToOne 0.00 65535.00 FORMAT "%8.2" NUMBER 4 /end CHARACTERISTIC
/begin CHARACTERISTIC DSM_CDCDfp_FlMngSmkDefect_C "CARB spezifischer Fehlercode fuer Fehlerpfad Dfp_FlMngSmkDefect" VAL_BLK 0xC94C8 Kwb_Wu16 65535.00 OneToOne 0.00 65535.00 FORMAT "%8.2" NUMBER 4 /end CHARACTERISTIC
/begin CHARACTERISTIC DSM_CDCDfp_FrmMngASC1_C "CARB spezifischer Fehlercode fuer Fehlerpfad Dfp_FrmMngASC1" VAL_BLK 0xC94D0 Kwb_Wu16 65535.00 OneToOne 0.00 65535.00 FORMAT "%8.2" NUMBER 4 /end CHARACTERISTIC
/begin CHARACTERISTIC DSM_CDCDfp_FrmMngASC2_C "CARB spezifischer Fehlercode fuer Fehlerpfad Dfp_FrmMngASC2" VAL_BLK 0xC94D8 Kwb_Wu16 65535.00 OneToOne 0.00 65535.00 FORMAT "%8.2" NUMBER 4 /end CHARACTERISTIC
/begin CHARACTERISTIC DSM_CDCDfp_FrmMngASC3_C "CARB spezifischer Fehlercode fuer Fehlerpfad Dfp_FrmMngASC3" VAL_BLK 0xC94E0 Kwb_Wu16 65535.00 OneToOne 0.00 65535.00 FORMAT "%8.2" NUMBER 4 /end CHARACTERISTIC
/begin CHARACTERISTIC DSM_CDCDfp_FrmMngASC4_C "CARB spezifischer Fehlercode fuer Fehlerpfad Dfp_FrmMngASC4" VAL_BLK 0xC94E8 Kwb_Wu16 65535.00 OneToOne 0.00 65535.00 FORMAT "%8.2" NUMBER 4 /end CHARACTERISTIC
/begin CHARACTERISTIC DSM_CDCDfp_FrmMngBOS_RESET_C "CARB spezifischer Fehlercode fuer Fehlerpfad Dfp_FrmMngBOS_RESET" VAL_BLK 0xC94F0 Kwb_Wu16 65535.00 OneToOne 0.00 65535.00 FORMAT "%8.2" NUMBER 4 /end CHARACTERISTIC
/begin CHARACTERISTIC DSM_CDCDfp_FrmMngBOS_RESET_2_C "" VAL_BLK 0xC94F8 Kwb_Wu16 65535.00 OneToOne 0.00 65535.00 FORMAT "%8.2" NUMBER 4 /end CHARACTERISTIC
/begin CHARACTERISTIC DSM_CDCDfp_FrmMngDMANFAFS_C "CARB spezifischer Fehlercode fuer Fehlerpfad Dfp_FrmMngDMANFAFS" VAL_BLK 0xC9500 Kwb_Wu16 65535.00 OneToOne 0.00 65535.00 FORMAT "%8.2" NUMBER 4 /end CHARACTERISTIC
/begin CHARACTERISTIC DSM_CDCDfp_FrmMngDRMANFSSG_C "CARB spezifischer Fehlercode fuer Fehlerpfad Dfp_FrmMngDRMANFSSG" VAL_BLK 0xC9508 Kwb_Wu16 65535.00 OneToOne 0.00 65535.00 FORMAT "%8.2" NUMBER 4 /end CHARACTERISTIC
/begin CHARACTERISTIC DSM_CDCDfp_FrmMngEGS1_C "CARB spezifischer Fehlercode fuer Fehlerpfad Dfp_FrmMngEGS1" VAL_BLK 0xC9510 Kwb_Wu16 65535.00 OneToOne 0.00 65535.00 FORMAT "%8.2" NUMBER 4 /end CHARACTERISTIC
/begin CHARACTERISTIC DSM_CDCDfp_FrmMngEGS2_C "CARB spezifischer Fehlercode fuer Fehlerpfad Dfp_FrmMngEGS2" VAL_BLK 0xC9518 Kwb_Wu16 65535.00 OneToOne 0.00 65535.00 FORMAT "%8.2" NUMBER 4 /end CHARACTERISTIC
/begin CHARACTERISTIC DSM_CDCDfp_FrmMngGEARBX_DATA_C "P-Code (CARB) for faults in path" VAL_BLK 0xC9520 Kwb_Wu16 65535.00 OneToOne 0.00 65535.00 FORMAT "%8.2" NUMBER 4 /end CHARACTERISTIC
/begin CHARACTERISTIC DSM_CDCDfp_FrmMngGEARBX_DATA2_C "CARB spezifischer Fehlercode fuer Fehlerpfad Dfp_FrmMngGEARBX_DATA2" VAL_BLK 0xC9528 Kwb_Wu16 65535.00 OneToOne 0.00 65535.00 FORMAT "%8.2" NUMBER 4 /end CHARACTERISTIC
/begin CHARACTERISTIC DSM_CDCDfp_FrmMngHEAT_AC_C "P-Code (CARB) for faults in path" VAL_BLK 0xC9530 Kwb_Wu16 65535.00 OneToOne 0.00 65535.00 FORMAT "%8.2" NUMBER 4 /end CHARACTERISTIC
/begin CHARACTERISTIC DSM_CDCDfp_FrmMngINSTR2_C "CARB spezifischer Fehlercode fuer Fehlerpfad Dfp_FrmMngINSTR2" VAL_BLK 0xC9538 Kwb_Wu16 65535.00 OneToOne 0.00 65535.00 FORMAT "%8.2" NUMBER 4 /end CHARACTERISTIC
/begin CHARACTERISTIC DSM_CDCDfp_FrmMngINSTR3_C "CARB spezifischer Fehlercode fuer Fehlerpfad Dfp_FrmMngINSTR3" VAL_BLK 0xC9540 Kwb_Wu16 65535.00 OneToOne 0.00 65535.00 FORMAT "%8.2" NUMBER 4 /end CHARACTERISTIC
/begin CHARACTERISTIC DSM_CDCDfp_FrmMngLENKRADWINKEL_C "CARB spezifischer Fehlercode fuer Fehlerpfad Dfp_FrmMngLENKRADWINKEL" VAL_BLK 0xC9548 Kwb_Wu16 65535.00 OneToOne 0.00 65535.00 FORMAT "%8.2" NUMBER 4 /end CHARACTERISTIC
/begin CHARACTERISTIC DSM_CDCDfp_FrmMngMILEAGE_RANGE_C "CARB spezifischer Fehlercode fuer Fehlerpfad Dfp_FrmMngMILEAGE_RANGE" VAL_BLK 0xC9550 Kwb_Wu16 65535.00 OneToOne 0.00 65535.00 FORMAT "%8.2" NUMBER 4 /end CHARACTERISTIC
/begin CHARACTERISTIC DSM_CDCDfp_FrmMngOPCRCTLACC_C "CARB spezifischer Fehlercode fuer Fehlerpfad Dfp_FrmMngOPCRCTLACC" VAL_BLK 0xC9558 Kwb_Wu16 65535.00 OneToOne 0.00 65535.00 FORMAT "%8.2" NUMBER 4 /end CHARACTERISTIC
/begin CHARACTERISTIC DSM_CDCDfp_FrmMngPRGG_CCTR_C "CARB spezifischer Fehlercode fuer Fehlerpfad Dfp_FrmMngPRGG_CCTR" VAL_BLK 0xC9560 Kwb_Wu16 65535.00 OneToOne 0.00 65535.00 FORMAT "%8.2" NUMBER 4 /end CHARACTERISTIC
/begin CHARACTERISTIC DSM_CDCDfp_FrmMngPWRMNG_LOADV_C "CARB spezifischer Fehlercode fuer Fehlerpfad Dfp_FrmMngPWRMNG_LOADV" VAL_BLK 0xC9568 Kwb_Wu16 65535.00 OneToOne 0.00 65535.00 FORMAT "%8.2" NUMBER 4 /end CHARACTERISTIC
/begin CHARACTERISTIC DSM_CDCDfp_FrmMngParkConsumer_C "CARB spezifischer Fehlercode fuer Fehlerpfad Dfp_FrmMngParkConsumer" VAL_BLK 0xC9570 Kwb_Wu16 65535.00 OneToOne 0.00 65535.00 FORMAT "%8.2" NUMBER 4 /end CHARACTERISTIC
/begin CHARACTERISTIC DSM_CDCDfp_FrmMngRQSTGEFAN_C "RQ_STG_EFAN - CAN-message related errors" VAL_BLK 0xC9578 Kwb_Wu16 65535.00 OneToOne 0.00 65535.00 FORMAT "%8.2" NUMBER 4 /end CHARACTERISTIC
/begin CHARACTERISTIC DSM_CDCDfp_FrmMngSSGErr_C "CARB spezifischer Fehlercode fuer Fehlerpfad Dfp_FrmMngSSGErr" VAL_BLK 0xC9580 Kwb_Wu16 65535.00 OneToOne 0.00 65535.00 FORMAT "%8.2" NUMBER 4 /end CHARACTERISTIC
/begin CHARACTERISTIC DSM_CDCDfp_FrmMngSSGShOff_C "CARB spezifischer Fehlercode fuer Fehlerpfad Dfp_FrmMngSSGShOff" VAL_BLK 0xC9588 Kwb_Wu16 65535.00 OneToOne 0.00 65535.00 FORMAT "%8.2" NUMBER 4 /end CHARACTERISTIC
/begin CHARACTERISTIC DSM_CDCDfp_FrmMngSTAT_ANH_C "CARB spezifischer Fehlercode fuer Fehlerpfad Dfp_FrmMngSTAT_ANH" VAL_BLK 0xC9590 Kwb_Wu16 65535.00 OneToOne 0.00 65535.00 FORMAT "%8.2" NUMBER 4 /end CHARACTERISTIC
/begin CHARACTERISTIC DSM_CDCDfp_FrmMngSTAT_ARS_C "P-Code (CARB) for faults in path" VAL_BLK 0xC9598 Kwb_Wu16 65535.00 OneToOne 0.00 65535.00 FORMAT "%8.2" NUMBER 4 /end CHARACTERISTIC
/begin CHARACTERISTIC DSM_CDCDfp_FrmMngSTAT_DSC_C "P-Code (CARB) for faults in path" VAL_BLK 0xC95A0 Kwb_Wu16 65535.00 OneToOne 0.00 65535.00 FORMAT "%8.2" NUMBER 4 /end CHARACTERISTIC
/begin CHARACTERISTIC DSM_CDCDfp_FrmMngSTAT_EKP_C "CARB spezifischer Fehlercode fuer Fehlerpfad Dfp_FrmMngSTAT_EKP" VAL_BLK 0xC95A8 Kwb_Wu16 65535.00 OneToOne 0.00 65535.00 FORMAT "%8.2" NUMBER 4 /end CHARACTERISTIC
/begin CHARACTERISTIC DSM_CDCDfp_FrmMngSTAT_KOMBI_C "CARB spezifischer Fehlercode fuer Fehlerpfad Dfp_FrmMngSTAT_KOMBI" VAL_BLK 0xC95B0 Kwb_Wu16 65535.00 OneToOne 0.00 65535.00 FORMAT "%8.2" NUMBER 4 /end CHARACTERISTIC
/begin CHARACTERISTIC DSM_CDCDfp_FrmMngSTAT_SITZ_C "CARB spezifischer Fehlercode fuer Fehlerpfad Dfp_FrmMngSTAT_SITZ" VAL_BLK 0xC95B8 Kwb_Wu16 65535.00 OneToOne 0.00 65535.00 FORMAT "%8.2" NUMBER 4 /end CHARACTERISTIC
/begin CHARACTERISTIC DSM_CDCDfp_FrmMngStOBDGbxMilOf_C "CARB spezifischer Fehlercode fuer Fehlerpfad Dfp_FrmMngStOBDGbxMilOf" VAL_BLK 0xC95C0 Kwb_Wu16 65535.00 OneToOne 0.00 65535.00 FORMAT "%8.2" NUMBER 4 /end CHARACTERISTIC
/begin CHARACTERISTIC DSM_CDCDfp_FrmMngStOBDGbxMilOn_C "CARB spezifischer Fehlercode fuer Fehlerpfad Dfp_FrmMngStOBDGbxMilOn" VAL_BLK 0xC95C8 Kwb_Wu16 65535.00 OneToOne 0.00 65535.00 FORMAT "%8.2" NUMBER 4 /end CHARACTERISTIC
/begin CHARACTERISTIC DSM_CDCDfp_FrmMngTEMPRELTIME_C "CARB spezifischer Fehlercode fuer Fehlerpfad Dfp_FrmMngTEMPRELTIME" VAL_BLK 0xC95D0 Kwb_Wu16 65535.00 OneToOne 0.00 65535.00 FORMAT "%8.2" NUMBER 4 /end CHARACTERISTIC
/begin CHARACTERISTIC DSM_CDCDfp_FrmMngTERMINAL_C "P-Code (CARB) for faults in path" VAL_BLK 0xC95D8 Kwb_Wu16 65535.00 OneToOne 0.00 65535.00 FORMAT "%8.2" NUMBER 4 /end CHARACTERISTIC
/begin CHARACTERISTIC DSM_CDCDfp_FrmMngTIME_DATE_C "CARB spezifischer Fehlercode fuer Fehlerpfad Dfp_FrmMngTIME_DATE" VAL_BLK 0xC95E0 Kwb_Wu16 65535.00 OneToOne 0.00 65535.00 FORMAT "%8.2" NUMBER 4 /end CHARACTERISTIC
/begin CHARACTERISTIC DSM_CDCDfp_FrmMngTORQUE_DSC_C "P-Code (CARB) for faults in path" VAL_BLK 0xC95E8 Kwb_Wu16 65535.00 OneToOne 0.00 65535.00 FORMAT "%8.2" NUMBER 4 /end CHARACTERISTIC
/begin CHARACTERISTIC DSM_CDCDfp_FrmMngTORQUE_GEARBX_C "P-Code (CARB) for faults in path" VAL_BLK 0xC95F0 Kwb_Wu16 65535.00 OneToOne 0.00 65535.00 FORMAT "%8.2" NUMBER 4 /end CHARACTERISTIC
/begin CHARACTERISTIC DSM_CDCDfp_FrmMngTrq_ReqACC_C "CARB spezifischer Fehlercode fuer Fehlerpfad Dfp_FrmMngTrq_ReqACC" VAL_BLK 0xC95F8 Kwb_Wu16 65535.00 OneToOne 0.00 65535.00 FORMAT "%8.2" NUMBER 4 /end CHARACTERISTIC
/begin CHARACTERISTIC DSM_CDCDfp_FrmMngVEH_MOD_C "VEH_MOD - CAN-message related errors" VAL_BLK 0xC9600 Kwb_Wu16 65535.00 OneToOne 0.00 65535.00 FORMAT "%8.2" NUMBER 4 /end CHARACTERISTIC
/begin CHARACTERISTIC DSM_CDCDfp_FrmMngVELOCITY_C "P-Code (CARB) for faults in path" VAL_BLK 0xC9608 Kwb_Wu16 65535.00 OneToOne 0.00 65535.00 FORMAT "%8.2" NUMBER 4 /end CHARACTERISTIC
/begin CHARACTERISTIC DSM_CDCDfp_FrmMngWHEEL_SPEED_C "CARB spezifischer Fehlercode fuer Fehlerpfad Dfp_FrmMngWHEEL_SPEED" VAL_BLK 0xC9610 Kwb_Wu16 65535.00 OneToOne 0.00 65535.00 FORMAT "%8.2" NUMBER 4 /end CHARACTERISTIC
/begin CHARACTERISTIC DSM_CDCDfp_FrmMngstCurr_C "Fehlercode Feld für Dfp_FrmMngstCurr" VAL_BLK 0xC9618 Kwb_Wu16 65535.00 OneToOne 0.00 65535.00 FORMAT "%8.2" NUMBER 4 /end CHARACTERISTIC
/begin CHARACTERISTIC DSM_CDCDfp_FrmMngswtPSPOff_C "Fehlercode Feld für Dfp_FrmMngswtPSP" VAL_BLK 0xC9620 Kwb_Wu16 65535.00 OneToOne 0.00 65535.00 FORMAT "%8.2" NUMBER 4 /end CHARACTERISTIC
/begin CHARACTERISTIC DSM_CDCDfp_GearbxIncMax_C "CARB spezifischer Fehlercode fuer Fehlerpfad Dfp_GearbxIncMax" VAL_BLK 0xC9628 Kwb_Wu16 65535.00 OneToOne 0.00 65535.00 FORMAT "%8.2" NUMBER 4 /end CHARACTERISTIC
/begin CHARACTERISTIC DSM_CDCDfp_GlwCD_C "CARB spezifischer Fehlercode fuer Fehlerpfad Dfp_GlwCD" VAL_BLK 0xC9630 Kwb_Wu16 65535.00 OneToOne 0.00 65535.00 FORMAT "%8.2" NUMBER 4 /end CHARACTERISTIC
/begin CHARACTERISTIC DSM_CDCDfp_GlwCDGlwCirc1_C "CARB spezifischer Fehlercode fuer Fehlerpfad Dfp_GlwCDGlwCirc1" VAL_BLK 0xC9638 Kwb_Wu16 65535.00 OneToOne 0.00 65535.00 FORMAT "%8.2" NUMBER 4 /end CHARACTERISTIC
/begin CHARACTERISTIC DSM_CDCDfp_GlwCDGlwCirc2_C "CARB spezifischer Fehlercode fuer Fehlerpfad Dfp_GlwCDGlwCirc2" VAL_BLK 0xC9640 Kwb_Wu16 65535.00 OneToOne 0.00 65535.00 FORMAT "%8.2" NUMBER 4 /end CHARACTERISTIC
/begin CHARACTERISTIC DSM_CDCDfp_GlwCDGlwCirc3_C "CARB spezifischer Fehlercode fuer Fehlerpfad Dfp_GlwCDGlwCirc3" VAL_BLK 0xC9648 Kwb_Wu16 65535.00 OneToOne 0.00 65535.00 FORMAT "%8.2" NUMBER 4 /end CHARACTERISTIC
/begin CHARACTERISTIC DSM_CDCDfp_GlwCDGlwCirc4_C "CARB spezifischer Fehlercode fuer Fehlerpfad Dfp_GlwCDGlwCirc4" VAL_BLK 0xC9650 Kwb_Wu16 65535.00 OneToOne 0.00 65535.00 FORMAT "%8.2" NUMBER 4 /end CHARACTERISTIC
/begin CHARACTERISTIC DSM_CDCDfp_GlwCDGlwCirc5_C "CARB spezifischer Fehlercode fuer Fehlerpfad Dfp_GlwCDGlwCirc5" VAL_BLK 0xC9658 Kwb_Wu16 65535.00 OneToOne 0.00 65535.00 FORMAT "%8.2" NUMBER 4 /end CHARACTERISTIC
/begin CHARACTERISTIC DSM_CDCDfp_GlwCDGlwCirc6_C "CARB spezifischer Fehlercode fuer Fehlerpfad Dfp_GlwCDGlwCirc6" VAL_BLK 0xC9660 Kwb_Wu16 65535.00 OneToOne 0.00 65535.00 FORMAT "%8.2" NUMBER 4 /end CHARACTERISTIC
/begin CHARACTERISTIC DSM_CDCDfp_GlwCDGlwCirc7_C "CARB spezifischer Fehlercode fuer Fehlerpfad Dfp_GlwCDGlwCirc7" VAL_BLK 0xC9668 Kwb_Wu16 65535.00 OneToOne 0.00 65535.00 FORMAT "%8.2" NUMBER 4 /end CHARACTERISTIC
/begin CHARACTERISTIC DSM_CDCDfp_GlwCDGlwCirc8_C "CARB spezifischer Fehlercode fuer Fehlerpfad Dfp_GlwCDGlwCirc8" VAL_BLK 0xC9670 Kwb_Wu16 65535.00 OneToOne 0.00 65535.00 FORMAT "%8.2" NUMBER 4 /end CHARACTERISTIC
/begin CHARACTERISTIC DSM_CDCDfp_GlwCtl_C "CARB spezifischer Fehlercode fuer Fehlerpfad Dfp_GlwCtl" VAL_BLK 0xC9678 Kwb_Wu16 65535.00 OneToOne 0.00 65535.00 FORMAT "%8.2" NUMBER 4 /end CHARACTERISTIC
/begin CHARACTERISTIC DSM_CDCDfp_HWEMonCom_C "CARB spezifischer Fehlercode fuer Fehlerpfad Dfp_HWEMonCom" VAL_BLK 0xC9680 Kwb_Wu16 65535.00 OneToOne 0.00 65535.00 FORMAT "%8.2" NUMBER 4 /end CHARACTERISTIC
/begin CHARACTERISTIC DSM_CDCDfp_HWEMonEEPROM_C "CARB spezifischer Fehlercode fuer Fehlerpfad Dfp_HWEMonEEPROM" VAL_BLK 0xC9688 Kwb_Wu16 65535.00 OneToOne 0.00 65535.00 FORMAT "%8.2" NUMBER 4 /end CHARACTERISTIC
/begin CHARACTERISTIC DSM_CDCDfp_HWEMonRcyLocked_C "CARB spezifischer Fehlercode fuer Fehlerpfad Dfp_HWEMonRcyLocked" VAL_BLK 0xC9690 Kwb_Wu16 65535.00 OneToOne 0.00 65535.00 FORMAT "%8.2" NUMBER 4 /end CHARACTERISTIC
/begin CHARACTERISTIC DSM_CDCDfp_HWEMonRcySuppressed_C "CARB spezifischer Fehlercode fuer Fehlerpfad Dfp_HWEMonRcySuppressed" VAL_BLK 0xC9698 Kwb_Wu16 65535.00 OneToOne 0.00 65535.00 FORMAT "%8.2" NUMBER 4 /end CHARACTERISTIC
/begin CHARACTERISTIC DSM_CDCDfp_HWEMonRcyVisible_C "CARB spezifischer Fehlercode fuer Fehlerpfad Dfp_HWEMonRcyVisible" VAL_BLK 0xC96A0 Kwb_Wu16 65535.00 OneToOne 0.00 65535.00 FORMAT "%8.2" NUMBER 4 /end CHARACTERISTIC
/begin CHARACTERISTIC DSM_CDCDfp_HWEMonUMaxSupply_C "CARB spezifischer Fehlercode fuer Fehlerpfad Dfp_HWEMonUMaxSupply" VAL_BLK 0xC96A8 Kwb_Wu16 65535.00 OneToOne 0.00 65535.00 FORMAT "%8.2" NUMBER 4 /end CHARACTERISTIC
/begin CHARACTERISTIC DSM_CDCDfp_HWEMonUMinSupply_C "CARB spezifischer Fehlercode fuer Fehlerpfad Dfp_HWEMonUMinSupply" VAL_BLK 0xC96B0 Kwb_Wu16 65535.00 OneToOne 0.00 65535.00 FORMAT "%8.2" NUMBER 4 /end CHARACTERISTIC
/begin CHARACTERISTIC DSM_CDCDfp_IATSCD_C "CARB spezifischer Fehlercode fuer Fehlerpfad Dfp_IATSCD" VAL_BLK 0xC96B8 Kwb_Wu16 65535.00 OneToOne 0.00 65535.00 FORMAT "%8.2" NUMBER 4 /end CHARACTERISTIC
/begin CHARACTERISTIC DSM_CDCDfp_IATSCD_CATS_C "CARB spezifischer Fehlercode fuer Fehlerpfad Dfp_IATSCD_CATS" VAL_BLK 0xC96C0 Kwb_Wu16 65535.00 OneToOne 0.00 65535.00 FORMAT "%8.2" NUMBER 4 /end CHARACTERISTIC
/begin CHARACTERISTIC DSM_CDCDfp_ImmCtlImmCD_C "CARB spezifischer Fehlercode fuer Fehlerpfad Dfp_ImmCtlImmCD" VAL_BLK 0xC96C8 Kwb_Wu16 65535.00 OneToOne 0.00 65535.00 FORMAT "%8.2" NUMBER 4 /end CHARACTERISTIC
/begin CHARACTERISTIC DSM_CDCDfp_ImmCtlImmEep_C "CARB spezifischer Fehlercode fuer Fehlerpfad Dfp_ImmCtlImmEep" VAL_BLK 0xC96D0 Kwb_Wu16 65535.00 OneToOne 0.00 65535.00 FORMAT "%8.2" NUMBER 4 /end CHARACTERISTIC
/begin CHARACTERISTIC DSM_CDCDfp_ImmCtlMpl_C "CARB spezifischer Fehlercode fuer Fehlerpfad Dfp_ImmCtlMpl" VAL_BLK 0xC96D8 Kwb_Wu16 65535.00 OneToOne 0.00 65535.00 FORMAT "%8.2" NUMBER 4 /end CHARACTERISTIC
/begin CHARACTERISTIC DSM_CDCDfp_IndSys1_C "CARB spezifischer Fehlercode fuer Fehlerpfad Dfp_IndSys1" VAL_BLK 0xC96E0 Kwb_Wu16 65535.00 OneToOne 0.00 65535.00 FORMAT "%8.2" NUMBER 4 /end CHARACTERISTIC
/begin CHARACTERISTIC DSM_CDCDfp_IndSys2_C "CARB spezifischer Fehlercode fuer Fehlerpfad Dfp_IndSys2" VAL_BLK 0xC96E8 Kwb_Wu16 65535.00 OneToOne 0.00 65535.00 FORMAT "%8.2" NUMBER 4 /end CHARACTERISTIC
/begin CHARACTERISTIC DSM_CDCDfp_InjCrv_InjLim_C "CARB spezifischer Fehlercode fuer Fehlerpfad Dfp_InjCrv_InjLim" VAL_BLK 0xC96F0 Kwb_Wu16 65535.00 OneToOne 0.00 65535.00 FORMAT "%8.2" NUMBER 4 /end CHARACTERISTIC
/begin CHARACTERISTIC DSM_CDCDfp_InjCtlAdjQnt_C "CARB spezifischer Fehlercode fuer Fehlerpfad Dfp_InjCtlAdjQnt" VAL_BLK 0xC96F8 Kwb_Wu16 65535.00 OneToOne 0.00 65535.00 FORMAT "%8.2" NUMBER 4 /end CHARACTERISTIC
/begin CHARACTERISTIC DSM_CDCDfp_InjCtlDrift_C "CARB spezifischer Fehlercode fuer Fehlerpfad Dfp_InjCtlDrift" VAL_BLK 0xC9700 Kwb_Wu16 65535.00 OneToOne 0.00 65535.00 FORMAT "%8.2" NUMBER 4 /end CHARACTERISTIC
/begin CHARACTERISTIC DSM_CDCDfp_InjVlvBnk1A_C "CARB spezifischer Fehlercode fuer Fehlerpfad Dfp_InjVlvBnk1A" VAL_BLK 0xC9708 Kwb_Wu16 65535.00 OneToOne 0.00 65535.00 FORMAT "%8.2" NUMBER 4 /end CHARACTERISTIC
/begin CHARACTERISTIC DSM_CDCDfp_InjVlvBnk1B_C "CARB spezifischer Fehlercode fuer Fehlerpfad Dfp_InjVlvBnk1B" VAL_BLK 0xC9710 Kwb_Wu16 65535.00 OneToOne 0.00 65535.00 FORMAT "%8.2" NUMBER 4 /end CHARACTERISTIC
/begin CHARACTERISTIC DSM_CDCDfp_InjVlvBnk2A_C "CARB spezifischer Fehlercode fuer Fehlerpfad Dfp_InjVlvBnk2A" VAL_BLK 0xC9718 Kwb_Wu16 65535.00 OneToOne 0.00 65535.00 FORMAT "%8.2" NUMBER 4 /end CHARACTERISTIC
/begin CHARACTERISTIC DSM_CDCDfp_InjVlvBnk2B_C "CARB spezifischer Fehlercode fuer Fehlerpfad Dfp_InjVlvBnk2B" VAL_BLK 0xC9720 Kwb_Wu16 65535.00 OneToOne 0.00 65535.00 FORMAT "%8.2" NUMBER 4 /end CHARACTERISTIC
/begin CHARACTERISTIC DSM_CDCDfp_InjVlvChipA_C "CARB spezifischer Fehlercode fuer Fehlerpfad Dfp_InjVlvChipA" VAL_BLK 0xC9728 Kwb_Wu16 65535.00 OneToOne 0.00 65535.00 FORMAT "%8.2" NUMBER 4 /end CHARACTERISTIC
/begin CHARACTERISTIC DSM_CDCDfp_InjVlvChipB_C "CARB spezifischer Fehlercode fuer Fehlerpfad Dfp_InjVlvChipB" VAL_BLK 0xC9730 Kwb_Wu16 65535.00 OneToOne 0.00 65535.00 FORMAT "%8.2" NUMBER 4 /end CHARACTERISTIC
/begin CHARACTERISTIC DSM_CDCDfp_InjVlvCyl1A_C "CARB spezifischer Fehlercode fuer Fehlerpfad Dfp_InjVlvCyl1A" VAL_BLK 0xC9738 Kwb_Wu16 65535.00 OneToOne 0.00 65535.00 FORMAT "%8.2" NUMBER 4 /end CHARACTERISTIC
/begin CHARACTERISTIC DSM_CDCDfp_InjVlvCyl1B_C "CARB spezifischer Fehlercode fuer Fehlerpfad Dfp_InjVlvCyl1B" VAL_BLK 0xC9740 Kwb_Wu16 65535.00 OneToOne 0.00 65535.00 FORMAT "%8.2" NUMBER 4 /end CHARACTERISTIC
/begin CHARACTERISTIC DSM_CDCDfp_InjVlvCyl2A_C "CARB spezifischer Fehlercode fuer Fehlerpfad Dfp_InjVlvCyl2A" VAL_BLK 0xC9748 Kwb_Wu16 65535.00 OneToOne 0.00 65535.00 FORMAT "%8.2" NUMBER 4 /end CHARACTERISTIC
/begin CHARACTERISTIC DSM_CDCDfp_InjVlvCyl2B_C "CARB spezifischer Fehlercode fuer Fehlerpfad Dfp_InjVlvCyl2B" VAL_BLK 0xC9750 Kwb_Wu16 65535.00 OneToOne 0.00 65535.00 FORMAT "%8.2" NUMBER 4 /end CHARACTERISTIC
/begin CHARACTERISTIC DSM_CDCDfp_InjVlvCyl3A_C "CARB spezifischer Fehlercode fuer Fehlerpfad Dfp_InjVlvCyl3A" VAL_BLK 0xC9758 Kwb_Wu16 65535.00 OneToOne 0.00 65535.00 FORMAT "%8.2" NUMBER 4 /end CHARACTERISTIC
/begin CHARACTERISTIC DSM_CDCDfp_InjVlvCyl3B_C "CARB spezifischer Fehlercode fuer Fehlerpfad Dfp_InjVlvCyl3B" VAL_BLK 0xC9760 Kwb_Wu16 65535.00 OneToOne 0.00 65535.00 FORMAT "%8.2" NUMBER 4 /end CHARACTERISTIC
/begin CHARACTERISTIC DSM_CDCDfp_InjVlvCyl4A_C "CARB spezifischer Fehlercode fuer Fehlerpfad Dfp_InjVlvCyl4A" VAL_BLK 0xC9768 Kwb_Wu16 65535.00 OneToOne 0.00 65535.00 FORMAT "%8.2" NUMBER 4 /end CHARACTERISTIC
/begin CHARACTERISTIC DSM_CDCDfp_InjVlvCyl4B_C "CARB spezifischer Fehlercode fuer Fehlerpfad Dfp_InjVlvCyl4B" VAL_BLK 0xC9770 Kwb_Wu16 65535.00 OneToOne 0.00 65535.00 FORMAT "%8.2" NUMBER 4 /end CHARACTERISTIC
/begin CHARACTERISTIC DSM_CDCDfp_InjVlvCyl5A_C "CARB spezifischer Fehlercode fuer Fehlerpfad Dfp_InjVlvCyl5A" VAL_BLK 0xC9778 Kwb_Wu16 65535.00 OneToOne 0.00 65535.00 FORMAT "%8.2" NUMBER 4 /end CHARACTERISTIC
/begin CHARACTERISTIC DSM_CDCDfp_InjVlvCyl5B_C "CARB spezifischer Fehlercode fuer Fehlerpfad Dfp_InjVlvCyl5B" VAL_BLK 0xC9780 Kwb_Wu16 65535.00 OneToOne 0.00 65535.00 FORMAT "%8.2" NUMBER 4 /end CHARACTERISTIC
/begin CHARACTERISTIC DSM_CDCDfp_InjVlvCyl6A_C "CARB spezifischer Fehlercode fuer Fehlerpfad Dfp_InjVlvCyl6A" VAL_BLK 0xC9788 Kwb_Wu16 65535.00 OneToOne 0.00 65535.00 FORMAT "%8.2" NUMBER 4 /end CHARACTERISTIC
/begin CHARACTERISTIC DSM_CDCDfp_InjVlvCyl6B_C "CARB spezifischer Fehlercode fuer Fehlerpfad Dfp_InjVlvCyl6B" VAL_BLK 0xC9790 Kwb_Wu16 65535.00 OneToOne 0.00 65535.00 FORMAT "%8.2" NUMBER 4 /end CHARACTERISTIC
/begin CHARACTERISTIC DSM_CDCDfp_LPACD_Max_C "CARB spezifischer Fehlercode fuer Fehlerpfad Dfp_LPACD_Max" VAL_BLK 0xC9798 Kwb_Wu16 65535.00 OneToOne 0.00 65535.00 FORMAT "%8.2" NUMBER 4 /end CHARACTERISTIC
/begin CHARACTERISTIC DSM_CDCDfp_LPACD_Min_C "CARB spezifischer Fehlercode fuer Fehlerpfad Dfp_LPACD_Min" VAL_BLK 0xC97A0 Kwb_Wu16 65535.00 OneToOne 0.00 65535.00 FORMAT "%8.2" NUMBER 4 /end CHARACTERISTIC
/begin CHARACTERISTIC DSM_CDCDfp_LPACD_SigNpl_C "CARB spezifischer Fehlercode fuer Fehlerpfad Dfp_LPACD_SigNpl" VAL_BLK 0xC97A8 Kwb_Wu16 65535.00 OneToOne 0.00 65535.00 FORMAT "%8.2" NUMBER 4 /end CHARACTERISTIC
/begin CHARACTERISTIC DSM_CDCDfp_LSUCDCircNernst0_C "CARB spezifischer Fehlercode fuer Fehlerpfad Dfp_LSUCDCircNernst0" VAL_BLK 0xC97B0 Kwb_Wu16 65535.00 OneToOne 0.00 65535.00 FORMAT "%8.2" NUMBER 4 /end CHARACTERISTIC
/begin CHARACTERISTIC DSM_CDCDfp_LSUCDCircPumpCur0_C "CARB spezifischer Fehlercode fuer Fehlerpfad Dfp_LSUCDCircPumpCur0" VAL_BLK 0xC97B8 Kwb_Wu16 65535.00 OneToOne 0.00 65535.00 FORMAT "%8.2" NUMBER 4 /end CHARACTERISTIC
/begin CHARACTERISTIC DSM_CDCDfp_LSUCDCircVirtGnd0_C "CARB spezifischer Fehlercode fuer Fehlerpfad Dfp_LSUCDCircVirtGnd0" VAL_BLK 0xC97C0 Kwb_Wu16 65535.00 OneToOne 0.00 65535.00 FORMAT "%8.2" NUMBER 4 /end CHARACTERISTIC
/begin CHARACTERISTIC DSM_CDCDfp_LSUCDHeater0_C "CARB spezifischer Fehlercode fuer Fehlerpfad Dfp_LSUCDHeater0" VAL_BLK 0xC97C8 Kwb_Wu16 65535.00 OneToOne 0.00 65535.00 FORMAT "%8.2" NUMBER 4 /end CHARACTERISTIC
/begin CHARACTERISTIC DSM_CDCDfp_LSUCDHtCoup0_C "CARB spezifischer Fehlercode fuer Fehlerpfad Dfp_LSUCDHtCoup0" VAL_BLK 0xC97D0 Kwb_Wu16 65535.00 OneToOne 0.00 65535.00 FORMAT "%8.2" NUMBER 4 /end CHARACTERISTIC
/begin CHARACTERISTIC DSM_CDCDfp_LSUCDO20_C "CARB spezifischer Fehlercode fuer Fehlerpfad Dfp_LSUCDO20" VAL_BLK 0xC97D8 Kwb_Wu16 65535.00 OneToOne 0.00 65535.00 FORMAT "%8.2" NUMBER 4 /end CHARACTERISTIC
/begin CHARACTERISTIC DSM_CDCDfp_LSUCDO2Clb0_C "CARB spezifischer Fehlercode fuer Fehlerpfad Dfp_LSUCDO2Clb0" VAL_BLK 0xC97E0 Kwb_Wu16 65535.00 OneToOne 0.00 65535.00 FORMAT "%8.2" NUMBER 4 /end CHARACTERISTIC
/begin CHARACTERISTIC DSM_CDCDfp_LSUCDRiClb0_C "CARB spezifischer Fehlercode fuer Fehlerpfad Dfp_LSUCDRiClb0" VAL_BLK 0xC97E8 Kwb_Wu16 65535.00 OneToOne 0.00 65535.00 FORMAT "%8.2" NUMBER 4 /end CHARACTERISTIC
/begin CHARACTERISTIC DSM_CDCDfp_LSUCDSPI0_C "CARB spezifischer Fehlercode fuer Fehlerpfad Dfp_LSUCDSPI0" VAL_BLK 0xC97F0 Kwb_Wu16 65535.00 OneToOne 0.00 65535.00 FORMAT "%8.2" NUMBER 4 /end CHARACTERISTIC
/begin CHARACTERISTIC DSM_CDCDfp_LSUCDSPIBattLow0_C "CARB spezifischer Fehlercode fuer Fehlerpfad Dfp_LSUCDSPIBattLow0" VAL_BLK 0xC97F8 Kwb_Wu16 65535.00 OneToOne 0.00 65535.00 FORMAT "%8.2" NUMBER 4 /end CHARACTERISTIC
/begin CHARACTERISTIC DSM_CDCDfp_LSUCDWireIP0_C "CARB spezifischer Fehlercode fuer Fehlerpfad Dfp_LSUCDWireIP0" VAL_BLK 0xC9800 Kwb_Wu16 65535.00 OneToOne 0.00 65535.00 FORMAT "%8.2" NUMBER 4 /end CHARACTERISTIC
/begin CHARACTERISTIC DSM_CDCDfp_LSUCtlRiExc0_C "CARB spezifischer Fehlercode fuer Fehlerpfad Dfp_LSUCtlRiExc0" VAL_BLK 0xC9808 Kwb_Wu16 65535.00 OneToOne 0.00 65535.00 FORMAT "%8.2" NUMBER 4 /end CHARACTERISTIC
/begin CHARACTERISTIC DSM_CDCDfp_LSUMon1Sens_C "CARB spezifischer Fehlercode fuer Fehlerpfad Dfp_LSUMon1Sens" VAL_BLK 0xC9810 Kwb_Wu16 65535.00 OneToOne 0.00 65535.00 FORMAT "%8.2" NUMBER 4 /end CHARACTERISTIC
/begin CHARACTERISTIC DSM_CDCDfp_LSUMon2Sens_C "CARB spezifischer Fehlercode fuer Fehlerpfad Dfp_LSUMon2Sens" VAL_BLK 0xC9818 Kwb_Wu16 65535.00 OneToOne 0.00 65535.00 FORMAT "%8.2" NUMBER 4 /end CHARACTERISTIC
/begin CHARACTERISTIC DSM_CDCDfp_LubCD_C "CARB spezifischer Fehlercode fuer Fehlerpfad Dfp_LubCD" VAL_BLK 0xC9820 Kwb_Wu16 65535.00 OneToOne 0.00 65535.00 FORMAT "%8.2" NUMBER 4 /end CHARACTERISTIC
/begin CHARACTERISTIC DSM_CDCDfp_MIL_C "CARB spezifischer Fehlercode fuer Fehlerpfad Dfp_MIL" VAL_BLK 0xC9828 Kwb_Wu16 65535.00 OneToOne 0.00 65535.00 FORMAT "%8.2" NUMBER 4 /end CHARACTERISTIC
/begin CHARACTERISTIC DSM_CDCDfp_MRlyCD_C "CARB spezifischer Fehlercode fuer Fehlerpfad Dfp_MRlyCD" VAL_BLK 0xC9830 Kwb_Wu16 65535.00 OneToOne 0.00 65535.00 FORMAT "%8.2" NUMBER 4 /end CHARACTERISTIC
/begin CHARACTERISTIC DSM_CDCDfp_MSidCD_Comm_C "CARB spezifischer Fehlercode fuer Fehlerpfad Dfp_MSidCD_Comm" VAL_BLK 0xC9838 Kwb_Wu16 65535.00 OneToOne 0.00 65535.00 FORMAT "%8.2" NUMBER 4 /end CHARACTERISTIC
/begin CHARACTERISTIC DSM_CDCDfp_MSidCD_Pin_C "CARB spezifischer Fehlercode fuer Fehlerpfad Dfp_MSidCD_Pin" VAL_BLK 0xC9840 Kwb_Wu16 65535.00 OneToOne 0.00 65535.00 FORMAT "%8.2" NUMBER 4 /end CHARACTERISTIC
/begin CHARACTERISTIC DSM_CDCDfp_MSidCD_Sel_INI_C "CARB spezifischer Fehlercode fuer Fehlerpfad Dfp_MSidCD_Sel_INI" VAL_BLK 0xC9848 Kwb_Wu16 65535.00 OneToOne 0.00 65535.00 FORMAT "%8.2" NUMBER 4 /end CHARACTERISTIC
/begin CHARACTERISTIC DSM_CDCDfp_MSidCD_Select_C "CARB spezifischer Fehlercode fuer Fehlerpfad Dfp_MSidCD_Select" VAL_BLK 0xC9850 Kwb_Wu16 65535.00 OneToOne 0.00 65535.00 FORMAT "%8.2" NUMBER 4 /end CHARACTERISTIC
/begin CHARACTERISTIC DSM_CDCDfp_MeUnCDNoLoad_C "CARB spezifischer Fehlercode fuer Fehlerpfad Dfp_MeUnCDNoLoad" VAL_BLK 0xC9858 Kwb_Wu16 65535.00 OneToOne 0.00 65535.00 FORMAT "%8.2" NUMBER 4 /end CHARACTERISTIC
/begin CHARACTERISTIC DSM_CDCDfp_MeUnCDSCBat_C "CARB spezifischer Fehlercode fuer Fehlerpfad Dfp_MeUnCDSCBat" VAL_BLK 0xC9860 Kwb_Wu16 65535.00 OneToOne 0.00 65535.00 FORMAT "%8.2" NUMBER 4 /end CHARACTERISTIC
/begin CHARACTERISTIC DSM_CDCDfp_MeUnCDSCGnd_C "CARB spezifischer Fehlercode fuer Fehlerpfad Dfp_MeUnCDSCGnd" VAL_BLK 0xC9868 Kwb_Wu16 65535.00 OneToOne 0.00 65535.00 FORMAT "%8.2" NUMBER 4 /end CHARACTERISTIC
/begin CHARACTERISTIC DSM_CDCDfp_MeUnCD_ADC_C "CARB spezifischer Fehlercode fuer Fehlerpfad Dfp_MeUnCD_ADC" VAL_BLK 0xC9870 Kwb_Wu16 65535.00 OneToOne 0.00 65535.00 FORMAT "%8.2" NUMBER 4 /end CHARACTERISTIC
/begin CHARACTERISTIC DSM_CDCDfp_MeUnCD_SigTst_C "CARB spezifischer Fehlercode fuer Fehlerpfad Dfp_MeUnCD_SigTst" VAL_BLK 0xC9878 Kwb_Wu16 65535.00 OneToOne 0.00 65535.00 FORMAT "%8.2" NUMBER 4 /end CHARACTERISTIC
/begin CHARACTERISTIC DSM_CDCDfp_Montr_C "CARB spezifischer Fehlercode fuer Fehlerpfad Dfp_Montr" VAL_BLK 0xC9880 Kwb_Wu16 65535.00 OneToOne 0.00 65535.00 FORMAT "%8.2" NUMBER 4 /end CHARACTERISTIC
/begin CHARACTERISTIC DSM_CDCDfp_NetMngDeviceA_C "CARB spezifischer Fehlercode fuer Fehlerpfad Dfp_NetMngDeviceA" VAL_BLK 0xC9888 Kwb_Wu16 65535.00 OneToOne 0.00 65535.00 FORMAT "%8.2" NUMBER 4 /end CHARACTERISTIC
/begin CHARACTERISTIC DSM_CDCDfp_NetMngDeviceB_C "CARB spezifischer Fehlercode fuer Fehlerpfad Dfp_NetMngDeviceB" VAL_BLK 0xC9890 Kwb_Wu16 65535.00 OneToOne 0.00 65535.00 FORMAT "%8.2" NUMBER 4 /end CHARACTERISTIC
/begin CHARACTERISTIC DSM_CDCDfp_NetMngDeviceC_C "CARB spezifischer Fehlercode fuer Fehlerpfad Dfp_NetMngDeviceC" VAL_BLK 0xC9898 Kwb_Wu16 65535.00 OneToOne 0.00 65535.00 FORMAT "%8.2" NUMBER 4 /end CHARACTERISTIC
/begin CHARACTERISTIC DSM_CDCDfp_OPSCD_Lamp_C "CARB spezifischer Fehlercode fuer Fehlerpfad Dfp_OPSCD_Lamp" VAL_BLK 0xC98A0 Kwb_Wu16 65535.00 OneToOne 0.00 65535.00 FORMAT "%8.2" NUMBER 4 /end CHARACTERISTIC
/begin CHARACTERISTIC DSM_CDCDfp_OPSCD_anain_C "CARB spezifischer Fehlercode fuer Fehlerpfad Dfp_OPSCD_anain" VAL_BLK 0xC98A8 Kwb_Wu16 65535.00 OneToOne 0.00 65535.00 FORMAT "%8.2" NUMBER 4 /end CHARACTERISTIC
/begin CHARACTERISTIC DSM_CDCDfp_OTSCD_C "CARB spezifischer Fehlercode fuer Fehlerpfad Dfp_OTSCD" VAL_BLK 0xC98B0 Kwb_Wu16 65535.00 OneToOne 0.00 65535.00 FORMAT "%8.2" NUMBER 4 /end CHARACTERISTIC
/begin CHARACTERISTIC DSM_CDCDfp_OvRMon_C "CARB spezifischer Fehlercode fuer Fehlerpfad Dfp_OvRMon" VAL_BLK 0xC98B8 Kwb_Wu16 65535.00 OneToOne 0.00 65535.00 FORMAT "%8.2" NUMBER 4 /end CHARACTERISTIC
/begin CHARACTERISTIC DSM_CDCDfp_OvRMonBrk_C "CARB specific fault code for fault path Dfp_OvRMonBrk" VAL_BLK 0xC98C0 Kwb_Wu16 65535.00 OneToOne 0.00 65535.00 FORMAT "%8.2" NUMBER 4 /end CHARACTERISTIC
/begin CHARACTERISTIC DSM_CDCDfp_OvRMonSigA_C "CARB spezifischer Fehlercode fuer Fehlerpfad Dfp_OvRMonSigA" VAL_BLK 0xC98C8 Kwb_Wu16 65535.00 OneToOne 0.00 65535.00 FORMAT "%8.2" NUMBER 4 /end CHARACTERISTIC
/begin CHARACTERISTIC DSM_CDCDfp_OxiCCDTPre_C "CARB spezifischer Fehlercode fuer Fehlerpfad Dfp_OxiCCDTPre" VAL_BLK 0xC98D0 Kwb_Wu16 65535.00 OneToOne 0.00 65535.00 FORMAT "%8.2" NUMBER 4 /end CHARACTERISTIC
/begin CHARACTERISTIC DSM_CDCDfp_PCR_GovDevNeg_C "CARB spezifischer Fehlercode fuer Fehlerpfad Dfp_PCR_GovDevNeg" VAL_BLK 0xC98D8 Kwb_Wu16 65535.00 OneToOne 0.00 65535.00 FORMAT "%8.2" NUMBER 4 /end CHARACTERISTIC
/begin CHARACTERISTIC DSM_CDCDfp_PCR_GovDevPos_C "CARB spezifischer Fehlercode fuer Fehlerpfad Dfp_PCR_GovDevPos" VAL_BLK 0xC98E0 Kwb_Wu16 65535.00 OneToOne 0.00 65535.00 FORMAT "%8.2" NUMBER 4 /end CHARACTERISTIC
/begin CHARACTERISTIC DSM_CDCDfp_PCVCDNoLoad_C "CARB spezifischer Fehlercode fuer Fehlerpfad Dfp_PCVCDNoLoad" VAL_BLK 0xC98E8 Kwb_Wu16 65535.00 OneToOne 0.00 65535.00 FORMAT "%8.2" NUMBER 4 /end CHARACTERISTIC
/begin CHARACTERISTIC DSM_CDCDfp_PCVCDSCBat_C "CARB spezifischer Fehlercode fuer Fehlerpfad Dfp_PCVCDSCBat" VAL_BLK 0xC98F0 Kwb_Wu16 65535.00 OneToOne 0.00 65535.00 FORMAT "%8.2" NUMBER 4 /end CHARACTERISTIC
/begin CHARACTERISTIC DSM_CDCDfp_PCVCDSCGnd_C "CARB spezifischer Fehlercode fuer Fehlerpfad Dfp_PCVCDSCGnd" VAL_BLK 0xC98F8 Kwb_Wu16 65535.00 OneToOne 0.00 65535.00 FORMAT "%8.2" NUMBER 4 /end CHARACTERISTIC
/begin CHARACTERISTIC DSM_CDCDfp_PCVCD_ADC_C "CARB spezifischer Fehlercode fuer Fehlerpfad Dfp_PCVCD_ADC" VAL_BLK 0xC9900 Kwb_Wu16 65535.00 OneToOne 0.00 65535.00 FORMAT "%8.2" NUMBER 4 /end CHARACTERISTIC
/begin CHARACTERISTIC DSM_CDCDfp_PCVCD_SigTst_C "CARB spezifischer Fehlercode fuer Fehlerpfad Dfp_PCVCD_SigTst" VAL_BLK 0xC9908 Kwb_Wu16 65535.00 OneToOne 0.00 65535.00 FORMAT "%8.2" NUMBER 4 /end CHARACTERISTIC
/begin CHARACTERISTIC DSM_CDCDfp_PFltAPSens_C "CARB spezifischer Fehlercode fuer Fehlerpfad Dfp_PFltAPSens" VAL_BLK 0xC9910 Kwb_Wu16 65535.00 OneToOne 0.00 65535.00 FORMAT "%8.2" NUMBER 4 /end CHARACTERISTIC
/begin CHARACTERISTIC DSM_CDCDfp_PFltCDPPre_C "CARB spezifischer Fehlercode fuer Fehlerpfad Dfp_PFltCDPPre" VAL_BLK 0xC9918 Kwb_Wu16 65535.00 OneToOne 0.00 65535.00 FORMAT "%8.2" NUMBER 4 /end CHARACTERISTIC
/begin CHARACTERISTIC DSM_CDCDfp_PFltCDTempPre_C "CARB spezifischer Fehlercode fuer Fehlerpfad Dfp_PFltCDTempPre" VAL_BLK 0xC9920 Kwb_Wu16 65535.00 OneToOne 0.00 65535.00 FORMAT "%8.2" NUMBER 4 /end CHARACTERISTIC
/begin CHARACTERISTIC DSM_CDCDfp_PFltChar_C "CARB spezifischer Fehlercode fuer Fehlerpfad Dfp_PFltChar" VAL_BLK 0xC9928 Kwb_Wu16 65535.00 OneToOne 0.00 65535.00 FORMAT "%8.2" NUMBER 4 /end CHARACTERISTIC
/begin CHARACTERISTIC DSM_CDCDfp_PFltEngPrt_C "CARB spezifischer Fehlercode fuer Fehlerpfad Dfp_PFltEngPrt" VAL_BLK 0xC9930 Kwb_Wu16 65535.00 OneToOne 0.00 65535.00 FORMAT "%8.2" NUMBER 4 /end CHARACTERISTIC
/begin CHARACTERISTIC DSM_CDCDfp_PFltPresDynPlaus_C "CARB spezifischer Fehlercode fuer Fehlerpfad Dfp_PFltPresDynPlaus" VAL_BLK 0xC9938 Kwb_Wu16 65535.00 OneToOne 0.00 65535.00 FORMAT "%8.2" NUMBER 4 /end CHARACTERISTIC
/begin CHARACTERISTIC DSM_CDCDfp_PFltPresSens_C "CARB spezifischer Fehlercode fuer Fehlerpfad Dfp_PFltPresSens" VAL_BLK 0xC9940 Kwb_Wu16 65535.00 OneToOne 0.00 65535.00 FORMAT "%8.2" NUMBER 4 /end CHARACTERISTIC
/begin CHARACTERISTIC DSM_CDCDfp_PFltPresSensFrz_C "CARB spezifischer Fehlercode fuer Fehlerpfad Dfp_PFltPresSensFrz" VAL_BLK 0xC9948 Kwb_Wu16 65535.00 OneToOne 0.00 65535.00 FORMAT "%8.2" NUMBER 4 /end CHARACTERISTIC
/begin CHARACTERISTIC DSM_CDCDfp_PFltPresSensHsLn_C "CARB spezifischer Fehlercode fuer Fehlerpfad Dfp_PFltPresSensHsLn" VAL_BLK 0xC9950 Kwb_Wu16 65535.00 OneToOne 0.00 65535.00 FORMAT "%8.2" NUMBER 4 /end CHARACTERISTIC
/begin CHARACTERISTIC DSM_CDCDfp_PFltPresSensSot_C "CARB spezifischer Fehlercode fuer Fehlerpfad Dfp_PFltPresSensSot" VAL_BLK 0xC9958 Kwb_Wu16 65535.00 OneToOne 0.00 65535.00 FORMAT "%8.2" NUMBER 4 /end CHARACTERISTIC
/begin CHARACTERISTIC DSM_CDCDfp_PFltRgnPerm_C "CARB spezifischer Fehlercode fuer Fehlerpfad Dfp_PFltRgnPerm" VAL_BLK 0xC9960 Kwb_Wu16 65535.00 OneToOne 0.00 65535.00 FORMAT "%8.2" NUMBER 4 /end CHARACTERISTIC
/begin CHARACTERISTIC DSM_CDCDfp_PFltTempDwnStrm_C "CARB spezifischer Fehlercode fuer Fehlerpfad Dfp_PFltTempDwnStrm" VAL_BLK 0xC9968 Kwb_Wu16 65535.00 OneToOne 0.00 65535.00 FORMAT "%8.2" NUMBER 4 /end CHARACTERISTIC
/begin CHARACTERISTIC DSM_CDCDfp_PFltTempSens_C "CARB spezifischer Fehlercode fuer Fehlerpfad Dfp_PFltTempSens" VAL_BLK 0xC9970 Kwb_Wu16 65535.00 OneToOne 0.00 65535.00 FORMAT "%8.2" NUMBER 4 /end CHARACTERISTIC
/begin CHARACTERISTIC DSM_CDCDfp_PFltTempUpStrm_C "CARB spezifischer Fehlercode fuer Fehlerpfad Dfp_PFltTempUpStrm" VAL_BLK 0xC9978 Kwb_Wu16 65535.00 OneToOne 0.00 65535.00 FORMAT "%8.2" NUMBER 4 /end CHARACTERISTIC
/begin CHARACTERISTIC DSM_CDCDfp_PFltmSotDiffMax_C "CARB spezifischer Fehlercode fuer Fehlerpfad Dfp_PFltmSotDiffMax" VAL_BLK 0xC9980 Kwb_Wu16 65535.00 OneToOne 0.00 65535.00 FORMAT "%8.2" NUMBER 4 /end CHARACTERISTIC
/begin CHARACTERISTIC DSM_CDCDfp_PSPCD_Actr_C "CARB spezifischer Fehlercode fuer Fehlerpfad Dfp_PSPCD_Actr" VAL_BLK 0xC9988 Kwb_Wu16 65535.00 OneToOne 0.00 65535.00 FORMAT "%8.2" NUMBER 4 /end CHARACTERISTIC
/begin CHARACTERISTIC DSM_CDCDfp_QLTCD_C "CARB spezifischer Fehlercode fuer Fehlerpfad Dfp_QLTCD" VAL_BLK 0xC9990 Kwb_Wu16 65535.00 OneToOne 0.00 65535.00 FORMAT "%8.2" NUMBER 4 /end CHARACTERISTIC
/begin CHARACTERISTIC DSM_CDCDfp_RailCD_C "CARB spezifischer Fehlercode fuer Fehlerpfad Dfp_RailCD" VAL_BLK 0xC9998 Kwb_Wu16 65535.00 OneToOne 0.00 65535.00 FORMAT "%8.2" NUMBER 4 /end CHARACTERISTIC
/begin CHARACTERISTIC DSM_CDCDfp_RailCDOfsTst_C "CARB spezifischer Fehlercode fuer Fehlerpfad Dfp_RailCDOfsTst" VAL_BLK 0xC99A0 Kwb_Wu16 65535.00 OneToOne 0.00 65535.00 FORMAT "%8.2" NUMBER 4 /end CHARACTERISTIC
/begin CHARACTERISTIC DSM_CDCDfp_RailCD_PMonStrt_C "CARB spezifischer Fehlercode fuer Fehlerpfad Dfp_RailCD_PMonStrt" VAL_BLK 0xC99A8 Kwb_Wu16 65535.00 OneToOne 0.00 65535.00 FORMAT "%8.2" NUMBER 4 /end CHARACTERISTIC
/begin CHARACTERISTIC DSM_CDCDfp_RailCtlModeMeUnDiag_C "CARB spezifischer Fehlercode fuer Fehlerpfad Dfp_RailCtlModeMeUnDiag" VAL_BLK 0xC99B0 Kwb_Wu16 65535.00 OneToOne 0.00 65535.00 FORMAT "%8.2" NUMBER 4 /end CHARACTERISTIC
/begin CHARACTERISTIC DSM_CDCDfp_RailCtlModePCVDiag_C "CARB spezifischer Fehlercode fuer Fehlerpfad Dfp_RailCtlModePCVDiag" VAL_BLK 0xC99B8 Kwb_Wu16 65535.00 OneToOne 0.00 65535.00 FORMAT "%8.2" NUMBER 4 /end CHARACTERISTIC
/begin CHARACTERISTIC DSM_CDCDfp_RailMeUn0_C "CARB spezifischer Fehlercode fuer Fehlerpfad Dfp_RailMeUn0" VAL_BLK 0xC99C0 Kwb_Wu16 65535.00 OneToOne 0.00 65535.00 FORMAT "%8.2" NUMBER 4 /end CHARACTERISTIC
/begin CHARACTERISTIC DSM_CDCDfp_RailMeUn1_C "CARB spezifischer Fehlercode fuer Fehlerpfad Dfp_RailMeUn1" VAL_BLK 0xC99C8 Kwb_Wu16 65535.00 OneToOne 0.00 65535.00 FORMAT "%8.2" NUMBER 4 /end CHARACTERISTIC
/begin CHARACTERISTIC DSM_CDCDfp_RailMeUn2_C "CARB spezifischer Fehlercode fuer Fehlerpfad Dfp_RailMeUn2" VAL_BLK 0xC99D0 Kwb_Wu16 65535.00 OneToOne 0.00 65535.00 FORMAT "%8.2" NUMBER 4 /end CHARACTERISTIC
/begin CHARACTERISTIC DSM_CDCDfp_RailMeUn3_C "CARB spezifischer Fehlercode fuer Fehlerpfad Dfp_RailMeUn3" VAL_BLK 0xC99D8 Kwb_Wu16 65535.00 OneToOne 0.00 65535.00 FORMAT "%8.2" NUMBER 4 /end CHARACTERISTIC
/begin CHARACTERISTIC DSM_CDCDfp_RailMeUn4_C "CARB spezifischer Fehlercode fuer Fehlerpfad Dfp_RailMeUn4" VAL_BLK 0xC99E0 Kwb_Wu16 65535.00 OneToOne 0.00 65535.00 FORMAT "%8.2" NUMBER 4 /end CHARACTERISTIC
/begin CHARACTERISTIC DSM_CDCDfp_RailPCV0_C "CARB spezifischer Fehlercode fuer Fehlerpfad Dfp_RailPCV0" VAL_BLK 0xC99E8 Kwb_Wu16 65535.00 OneToOne 0.00 65535.00 FORMAT "%8.2" NUMBER 4 /end CHARACTERISTIC
/begin CHARACTERISTIC DSM_CDCDfp_RailPCV1_C "CARB spezifischer Fehlercode fuer Fehlerpfad Dfp_RailPCV1" VAL_BLK 0xC99F0 Kwb_Wu16 65535.00 OneToOne 0.00 65535.00 FORMAT "%8.2" NUMBER 4 /end CHARACTERISTIC
/begin CHARACTERISTIC DSM_CDCDfp_RailPCV2_C "CARB spezifischer Fehlercode fuer Fehlerpfad Dfp_RailPCV2" VAL_BLK 0xC99F8 Kwb_Wu16 65535.00 OneToOne 0.00 65535.00 FORMAT "%8.2" NUMBER 4 /end CHARACTERISTIC
/begin CHARACTERISTIC DSM_CDCDfp_RailPCV3_C "CARB spezifischer Fehlercode fuer Fehlerpfad Dfp_RailPCV3" VAL_BLK 0xC9A00 Kwb_Wu16 65535.00 OneToOne 0.00 65535.00 FORMAT "%8.2" NUMBER 4 /end CHARACTERISTIC
/begin CHARACTERISTIC DSM_CDCDfp_RailPCV4_C "CARB spezifischer Fehlercode fuer Fehlerpfad Dfp_RailPCV4" VAL_BLK 0xC9A08 Kwb_Wu16 65535.00 OneToOne 0.00 65535.00 FORMAT "%8.2" NUMBER 4 /end CHARACTERISTIC
/begin CHARACTERISTIC DSM_CDCDfp_RailPCV5_C "CARB spezifischer Fehlercode fuer Fehlerpfad Dfp_RailPCV5" VAL_BLK 0xC9A10 Kwb_Wu16 65535.00 OneToOne 0.00 65535.00 FORMAT "%8.2" NUMBER 4 /end CHARACTERISTIC
/begin CHARACTERISTIC DSM_CDCDfp_SOPTst_C "CARB spezifischer Fehlercode fuer Fehlerpfad Dfp_SOPTst" VAL_BLK 0xC9A18 Kwb_Wu16 65535.00 OneToOne 0.00 65535.00 FORMAT "%8.2" NUMBER 4 /end CHARACTERISTIC
/begin CHARACTERISTIC DSM_CDCDfp_SSpMon1_C "CARB spezifischer Fehlercode fuer Fehlerpfad Dfp_SSpMon1" VAL_BLK 0xC9A20 Kwb_Wu16 65535.00 OneToOne 0.00 65535.00 FORMAT "%8.2" NUMBER 4 /end CHARACTERISTIC
/begin CHARACTERISTIC DSM_CDCDfp_SSpMon2_C "CARB spezifischer Fehlercode fuer Fehlerpfad Dfp_SSpMon2" VAL_BLK 0xC9A28 Kwb_Wu16 65535.00 OneToOne 0.00 65535.00 FORMAT "%8.2" NUMBER 4 /end CHARACTERISTIC
/begin CHARACTERISTIC DSM_CDCDfp_SSpMon3_C "CARB spezifischer Fehlercode fuer Fehlerpfad Dfp_SSpMon3" VAL_BLK 0xC9A30 Kwb_Wu16 65535.00 OneToOne 0.00 65535.00 FORMAT "%8.2" NUMBER 4 /end CHARACTERISTIC
/begin CHARACTERISTIC DSM_CDCDfp_SWChk_CycSigChkDat_C "CARB spezifischer Fehlercode fuer Fehlerpfad Dfp_SWChk_CycSigChkDat" VAL_BLK 0xC9A38 Kwb_Wu16 65535.00 OneToOne 0.00 65535.00 FORMAT "%8.2" NUMBER 4 /end CHARACTERISTIC
/begin CHARACTERISTIC DSM_CDCDfp_SWChk_CycSigChkPrg_C "CARB spezifischer Fehlercode fuer Fehlerpfad Dfp_SWChk_CycSigChkPrg" VAL_BLK 0xC9A40 Kwb_Wu16 65535.00 OneToOne 0.00 65535.00 FORMAT "%8.2" NUMBER 4 /end CHARACTERISTIC
/begin CHARACTERISTIC DSM_CDCDfp_ShutCD_C "CARB spezifischer Fehlercode fuer Fehlerpfad Dfp_ShutCD" VAL_BLK 0xC9A48 Kwb_Wu16 65535.00 OneToOne 0.00 65535.00 FORMAT "%8.2" NUMBER 4 /end CHARACTERISTIC
/begin CHARACTERISTIC DSM_CDCDfp_StSysTrqShutOff_C "CARB spezifischer Fehlercode fuer Fehlerpfad Dfp_StSysTrqShutOff" VAL_BLK 0xC9A50 Kwb_Wu16 65535.00 OneToOne 0.00 65535.00 FORMAT "%8.2" NUMBER 4 /end CHARACTERISTIC
/begin CHARACTERISTIC DSM_CDCDfp_StrtCD_Actr_C "CARB spezifischer Fehlercode fuer Fehlerpfad Dfp_StrtCD_Actr" VAL_BLK 0xC9A58 Kwb_Wu16 65535.00 OneToOne 0.00 65535.00 FORMAT "%8.2" NUMBER 4 /end CHARACTERISTIC
/begin CHARACTERISTIC DSM_CDCDfp_SysLamp_C "CARB spezifischer Fehlercode fuer Fehlerpfad Dfp_SysLamp" VAL_BLK 0xC9A60 Kwb_Wu16 65535.00 OneToOne 0.00 65535.00 FORMAT "%8.2" NUMBER 4 /end CHARACTERISTIC
/begin CHARACTERISTIC DSM_CDCDfp_T15CD_C "CARB spezifischer Fehlercode fuer Fehlerpfad Dfp_T15CD" VAL_BLK 0xC9A68 Kwb_Wu16 65535.00 OneToOne 0.00 65535.00 FORMAT "%8.2" NUMBER 4 /end CHARACTERISTIC
/begin CHARACTERISTIC DSM_CDCDfp_TGearbx_C "CARB spezifischer Fehlercode fuer Fehlerpfad Dfp_TGearbx" VAL_BLK 0xC9A70 Kwb_Wu16 65535.00 OneToOne 0.00 65535.00 FORMAT "%8.2" NUMBER 4 /end CHARACTERISTIC
/begin CHARACTERISTIC DSM_CDCDfp_TPUMon_C "CARB spezifischer Fehlercode fuer Fehlerpfad Dfp_TPUMon" VAL_BLK 0xC9A78 Kwb_Wu16 65535.00 OneToOne 0.00 65535.00 FORMAT "%8.2" NUMBER 4 /end CHARACTERISTIC
/begin CHARACTERISTIC DSM_CDCDfp_TVACD_Max_C "CARB spezifischer Fehlercode fuer Fehlerpfad Dfp_TVACD_Max" VAL_BLK 0xC9A80 Kwb_Wu16 65535.00 OneToOne 0.00 65535.00 FORMAT "%8.2" NUMBER 4 /end CHARACTERISTIC
/begin CHARACTERISTIC DSM_CDCDfp_TVACD_Min_C "CARB spezifischer Fehlercode fuer Fehlerpfad Dfp_TVACD_Min" VAL_BLK 0xC9A88 Kwb_Wu16 65535.00 OneToOne 0.00 65535.00 FORMAT "%8.2" NUMBER 4 /end CHARACTERISTIC
/begin CHARACTERISTIC DSM_CDCDfp_TVACD_SigNpl_C "CARB spezifischer Fehlercode fuer Fehlerpfad Dfp_TVACD_SigNpl" VAL_BLK 0xC9A90 Kwb_Wu16 65535.00 OneToOne 0.00 65535.00 FORMAT "%8.2" NUMBER 4 /end CHARACTERISTIC
/begin CHARACTERISTIC DSM_CDCDfp_TVACD_TVADia1_C "CARB spezifischer Fehlercode fuer Fehlerpfad Dfp_TVACD_TVADia1" VAL_BLK 0xC9A98 Kwb_Wu16 65535.00 OneToOne 0.00 65535.00 FORMAT "%8.2" NUMBER 4 /end CHARACTERISTIC
/begin CHARACTERISTIC DSM_CDCDfp_TVACD_TVADia2_C "CARB spezifischer Fehlercode fuer Fehlerpfad Dfp_TVACD_TVADia2" VAL_BLK 0xC9AA0 Kwb_Wu16 65535.00 OneToOne 0.00 65535.00 FORMAT "%8.2" NUMBER 4 /end CHARACTERISTIC
/begin CHARACTERISTIC DSM_CDCDfp_TVACD_TVADia3_C "CARB spezifischer Fehlercode fuer Fehlerpfad Dfp_TVACD_TVADia3" VAL_BLK 0xC9AA8 Kwb_Wu16 65535.00 OneToOne 0.00 65535.00 FORMAT "%8.2" NUMBER 4 /end CHARACTERISTIC
/begin CHARACTERISTIC DSM_CDCDfp_TVACD_TVADia4_C "CARB spezifischer Fehlercode fuer Fehlerpfad Dfp_TVACD_TVADia4" VAL_BLK 0xC9AB0 Kwb_Wu16 65535.00 OneToOne 0.00 65535.00 FORMAT "%8.2" NUMBER 4 /end CHARACTERISTIC
/begin CHARACTERISTIC DSM_CDCDfp_VSACD_DioInDia1_C "CARB spezifischer Fehlercode fuer Fehlerpfad Dfp_VSACD_DioInDia1" VAL_BLK 0xC9AB8 Kwb_Wu16 65535.00 OneToOne 0.00 65535.00 FORMAT "%8.2" NUMBER 4 /end CHARACTERISTIC
/begin CHARACTERISTIC DSM_CDCDfp_VSACD_DioInDia2_C "CARB spezifischer Fehlercode fuer Fehlerpfad Dfp_VSACD_DioInDia2" VAL_BLK 0xC9AC0 Kwb_Wu16 65535.00 OneToOne 0.00 65535.00 FORMAT "%8.2" NUMBER 4 /end CHARACTERISTIC
/begin CHARACTERISTIC DSM_CDCDfp_VSACD_DioInDia3_C "CARB spezifischer Fehlercode fuer Fehlerpfad Dfp_VSACD_DioInDia3" VAL_BLK 0xC9AC8 Kwb_Wu16 65535.00 OneToOne 0.00 65535.00 FORMAT "%8.2" NUMBER 4 /end CHARACTERISTIC
/begin CHARACTERISTIC DSM_CDCDfp_VSACD_DioInDia4_C "CARB spezifischer Fehlercode fuer Fehlerpfad Dfp_VSACD_DioInDia4" VAL_BLK 0xC9AD0 Kwb_Wu16 65535.00 OneToOne 0.00 65535.00 FORMAT "%8.2" NUMBER 4 /end CHARACTERISTIC
/begin CHARACTERISTIC DSM_CDCDfp_VSACD_DioInMin_C "CARB spezifischer Fehlercode fuer Fehlerpfad Dfp_VSACD_DioInMin" VAL_BLK 0xC9AD8 Kwb_Wu16 65535.00 OneToOne 0.00 65535.00 FORMAT "%8.2" NUMBER 4 /end CHARACTERISTIC
/begin CHARACTERISTIC DSM_CDCDfp_VSACD_Max_C "CARB spezifischer Fehlercode fuer Fehlerpfad Dfp_VSACD_Max" VAL_BLK 0xC9AE0 Kwb_Wu16 65535.00 OneToOne 0.00 65535.00 FORMAT "%8.2" NUMBER 4 /end CHARACTERISTIC
/begin CHARACTERISTIC DSM_CDCDfp_VSACD_Min_C "CARB spezifischer Fehlercode fuer Fehlerpfad Dfp_VSACD_Min" VAL_BLK 0xC9AE8 Kwb_Wu16 65535.00 OneToOne 0.00 65535.00 FORMAT "%8.2" NUMBER 4 /end CHARACTERISTIC
/begin CHARACTERISTIC DSM_CDCDfp_VSACD_SigNpl_C "CARB spezifischer Fehlercode fuer Fehlerpfad Dfp_VSACD_SigNpl" VAL_BLK 0xC9AF0 Kwb_Wu16 65535.00 OneToOne 0.00 65535.00 FORMAT "%8.2" NUMBER 4 /end CHARACTERISTIC
/begin CHARACTERISTIC DSM_CDCDfp_VSACD_VSADia1_C "CARB spezifischer Fehlercode fuer Fehlerpfad Dfp_VSACD_VSADia1" VAL_BLK 0xC9AF8 Kwb_Wu16 65535.00 OneToOne 0.00 65535.00 FORMAT "%8.2" NUMBER 4 /end CHARACTERISTIC
/begin CHARACTERISTIC DSM_CDCDfp_VSACD_VSADia2_C "CARB spezifischer Fehlercode fuer Fehlerpfad Dfp_VSACD_VSADia2" VAL_BLK 0xC9B00 Kwb_Wu16 65535.00 OneToOne 0.00 65535.00 FORMAT "%8.2" NUMBER 4 /end CHARACTERISTIC
/begin CHARACTERISTIC DSM_CDCDfp_VSACD_VSADia3_C "CARB spezifischer Fehlercode fuer Fehlerpfad Dfp_VSACD_VSADia3" VAL_BLK 0xC9B08 Kwb_Wu16 65535.00 OneToOne 0.00 65535.00 FORMAT "%8.2" NUMBER 4 /end CHARACTERISTIC
/begin CHARACTERISTIC DSM_CDCDfp_VSACD_VSADia4_C "CARB spezifischer Fehlercode fuer Fehlerpfad Dfp_VSACD_VSADia4" VAL_BLK 0xC9B10 Kwb_Wu16 65535.00 OneToOne 0.00 65535.00 FORMAT "%8.2" NUMBER 4 /end CHARACTERISTIC
/begin CHARACTERISTIC DSM_CDCDfp_VSSCD1_C "CARB spezifischer Fehlercode fuer Fehlerpfad Dfp_VSSCD1" VAL_BLK 0xC9B18 Kwb_Wu16 65535.00 OneToOne 0.00 65535.00 FORMAT "%8.2" NUMBER 4 /end CHARACTERISTIC
/begin CHARACTERISTIC DSM_CDCDfp_VSSCD2_C "CARB spezifischer Fehlercode fuer Fehlerpfad Dfp_VSSCD2" VAL_BLK 0xC9B20 Kwb_Wu16 65535.00 OneToOne 0.00 65535.00 FORMAT "%8.2" NUMBER 4 /end CHARACTERISTIC
/begin CHARACTERISTIC DSM_CDCDfp_WdCom_C "CARB spezifischer Fehlercode fuer Fehlerpfad Dfp_WdCom" VAL_BLK 0xC9B28 Kwb_Wu16 65535.00 OneToOne 0.00 65535.00 FORMAT "%8.2" NUMBER 4 /end CHARACTERISTIC
/begin CHARACTERISTIC DSM_CDKDfp_Layer_TANS_C "Kundenspezifischer Fehlercode fuer Fehlerpfad Dfp_Layer_TANS" VAL_BLK 0xC9B30 Kwb_Wu16 65535.00 OneToOne 0.00 65535.00 FORMAT "%8.2" NUMBER 4 /end CHARACTERISTIC
/begin CHARACTERISTIC DSM_CDKDfp_ACCDCmpr_C "Kundenspezifischer Fehlercode fuer Fehlerpfad Dfp_ACCDCmpr" VAL_BLK 0xC9B38 Kwb_Wu16 65535.00 OneToOne 0.00 65535.00 FORMAT "%8.2" NUMBER 4 /end CHARACTERISTIC
/begin CHARACTERISTIC DSM_CDKDfp_ACCDPres_C "Kundenspezifischer Fehlercode fuer Fehlerpfad Dfp_ACCDPres" VAL_BLK 0xC9B40 Kwb_Wu16 65535.00 OneToOne 0.00 65535.00 FORMAT "%8.2" NUMBER 4 /end CHARACTERISTIC
/begin CHARACTERISTIC DSM_CDKDfp_ACCDPres1_C "Kundenspezifischer Fehlercode fuer Fehlerpfad Dfp_ACCDPres1" VAL_BLK 0xC9B48 Kwb_Wu16 65535.00 OneToOne 0.00 65535.00 FORMAT "%8.2" NUMBER 4 /end CHARACTERISTIC
/begin CHARACTERISTIC DSM_CDKDfp_ACCDPresAna_C "Kundenspezifischer Fehlercode fuer Fehlerpfad Dfp_ACCDPresAna" VAL_BLK 0xC9B50 Kwb_Wu16 65535.00 OneToOne 0.00 65535.00 FORMAT "%8.2" NUMBER 4 /end CHARACTERISTIC
/begin CHARACTERISTIC DSM_CDKDfp_ACCDSwtin_C "Kundenspezifischer Fehlercode fuer Fehlerpfad Dfp_ACCDSwtin" VAL_BLK 0xC9B58 Kwb_Wu16 65535.00 OneToOne 0.00 65535.00 FORMAT "%8.2" NUMBER 4 /end CHARACTERISTIC
/begin CHARACTERISTIC DSM_CDKDfp_ACC_PlausTrqDes_C "Kundenspezifischer Fehlercode fuer Fehlerpfad Dfp_ACC_PlausTrqDes" VAL_BLK 0xC9B60 Kwb_Wu16 65535.00 OneToOne 0.00 65535.00 FORMAT "%8.2" NUMBER 4 /end CHARACTERISTIC
/begin CHARACTERISTIC DSM_CDKDfp_ACC_trqInr_C "Kundenspezifischer Fehlercode fuer Fehlerpfad Dfp_ACC_trqInr" VAL_BLK 0xC9B68 Kwb_Wu16 65535.00 OneToOne 0.00 65535.00 FORMAT "%8.2" NUMBER 4 /end CHARACTERISTIC
/begin CHARACTERISTIC DSM_CDKDfp_ACTrq_C "Kundenspezifischer Fehlercode fuer Fehlerpfad Dfp_ACTrq" VAL_BLK 0xC9B70 Kwb_Wu16 65535.00 OneToOne 0.00 65535.00 FORMAT "%8.2" NUMBER 4 /end CHARACTERISTIC
/begin CHARACTERISTIC DSM_CDKDfp_ADCMon_C "Kundenspezifischer Fehlercode fuer Fehlerpfad Dfp_ADCMon" VAL_BLK 0xC9B78 Kwb_Wu16 65535.00 OneToOne 0.00 65535.00 FORMAT "%8.2" NUMBER 4 /end CHARACTERISTIC
/begin CHARACTERISTIC DSM_CDKDfp_AFSCDIdlAdjVal_C "Kundenspezifischer Fehlercode fuer Fehlerpfad Dfp_AFSCDIdlAdjVal" VAL_BLK 0xC9B80 Kwb_Wu16 65535.00 OneToOne 0.00 65535.00 FORMAT "%8.2" NUMBER 4 /end CHARACTERISTIC
/begin CHARACTERISTIC DSM_CDKDfp_AFSCDLdAdjVal_C "Kundenspezifischer Fehlercode fuer Fehlerpfad Dfp_AFSCDLdAdjVal" VAL_BLK 0xC9B88 Kwb_Wu16 65535.00 OneToOne 0.00 65535.00 FORMAT "%8.2" NUMBER 4 /end CHARACTERISTIC
/begin CHARACTERISTIC DSM_CDKDfp_AFSCD_AirTempDcyc_C "Kundenspezifischer Fehlercode fuer Fehlerpfad Dfp_AFSCD_AirTempDcyc" VAL_BLK 0xC9B90 Kwb_Wu16 65535.00 OneToOne 0.00 65535.00 FORMAT "%8.2" NUMBER 4 /end CHARACTERISTIC
/begin CHARACTERISTIC DSM_CDKDfp_AFSCD_PlOffsDrft_C "Kundenspezifischer Fehlercode fuer Fehlerpfad Dfp_AFSCD_PlOffsDrft" VAL_BLK 0xC9B98 Kwb_Wu16 65535.00 OneToOne 0.00 65535.00 FORMAT "%8.2" NUMBER 4 /end CHARACTERISTIC
/begin CHARACTERISTIC DSM_CDKDfp_AFSCD_PlSetyDrft_C "Kundenspezifischer Fehlercode fuer Fehlerpfad Dfp_AFSCD_PlSetyDrft" VAL_BLK 0xC9BA0 Kwb_Wu16 65535.00 OneToOne 0.00 65535.00 FORMAT "%8.2" NUMBER 4 /end CHARACTERISTIC
/begin CHARACTERISTIC DSM_CDKDfp_AFSCD_SRCAirTemp_C "Kundenspezifischer Fehlercode fuer Fehlerpfad Dfp_AFSCD_SRCAirTemp" VAL_BLK 0xC9BA8 Kwb_Wu16 65535.00 OneToOne 0.00 65535.00 FORMAT "%8.2" NUMBER 4 /end CHARACTERISTIC
/begin CHARACTERISTIC DSM_CDKDfp_AFSCD_SRCBatt_C "Kundenspezifischer Fehlercode fuer Fehlerpfad Dfp_AFSCD_SRCBatt" VAL_BLK 0xC9BB0 Kwb_Wu16 65535.00 OneToOne 0.00 65535.00 FORMAT "%8.2" NUMBER 4 /end CHARACTERISTIC
/begin CHARACTERISTIC DSM_CDKDfp_AFSCD_SRCCorrAirm_C "Kundenspezifischer Fehlercode fuer Fehlerpfad Dfp_AFSCD_SRCCorrAirm" VAL_BLK 0xC9BB8 Kwb_Wu16 65535.00 OneToOne 0.00 65535.00 FORMAT "%8.2" NUMBER 4 /end CHARACTERISTIC
/begin CHARACTERISTIC DSM_CDKDfp_AFSCD_SRCRawAirm_C "Kundenspezifischer Fehlercode fuer Fehlerpfad Dfp_AFSCD_SRCRawAirm" VAL_BLK 0xC9BC0 Kwb_Wu16 65535.00 OneToOne 0.00 65535.00 FORMAT "%8.2" NUMBER 4 /end CHARACTERISTIC
/begin CHARACTERISTIC DSM_CDKDfp_Layer_TUMG_C "Kundenspezifischer Fehlercode fuer Fehlerpfad Dfp_Layer_TUMG" VAL_BLK 0xC9BC8 Kwb_Wu16 65535.00 OneToOne 0.00 65535.00 FORMAT "%8.2" NUMBER 4 /end CHARACTERISTIC
/begin CHARACTERISTIC DSM_CDKDfp_AFSCD_SRCRefSigPer_C "Kundenspezifischer Fehlercode fuer Fehlerpfad Dfp_AFSCD_SRCRefSigPer" VAL_BLK 0xC9BD0 Kwb_Wu16 65535.00 OneToOne 0.00 65535.00 FORMAT "%8.2" NUMBER 4 /end CHARACTERISTIC
/begin CHARACTERISTIC DSM_CDKDfp_AOHtCD_C "Kundenspezifischer Fehlercode fuer Fehlerpfad Dfp_AOHtCD" VAL_BLK 0xC9BD8 Kwb_Wu16 65535.00 OneToOne 0.00 65535.00 FORMAT "%8.2" NUMBER 4 /end CHARACTERISTIC
/begin CHARACTERISTIC DSM_CDKDfp_Layer_GEN_C "Kundenspezifischer Fehlercode fuer Fehlerpfad Dfp_Layer_GEN" VAL_BLK 0xC9BE0 Kwb_Wu16 65535.00 OneToOne 0.00 65535.00 FORMAT "%8.2" NUMBER 4 /end CHARACTERISTIC
/begin CHARACTERISTIC DSM_CDKDfp_Layer_BSD_C "Kundenspezifischer Fehlercode fuer Fehlerpfad Dfp_Layer_BSD" VAL_BLK 0xC9BE8 Kwb_Wu16 65535.00 OneToOne 0.00 65535.00 FORMAT "%8.2" NUMBER 4 /end CHARACTERISTIC
/begin CHARACTERISTIC DSM_CDKDfp_AOHtCD_AOHtDia1_C "Kundenspezifischer Fehlercode fuer Fehlerpfad Dfp_AOHtCD_AOHtDia1" VAL_BLK 0xC9BF0 Kwb_Wu16 65535.00 OneToOne 0.00 65535.00 FORMAT "%8.2" NUMBER 4 /end CHARACTERISTIC
/begin CHARACTERISTIC DSM_CDKDfp_AOHtCD_AOHtDia2_C "Kundenspezifischer Fehlercode fuer Fehlerpfad Dfp_AOHtCD_AOHtDia2" VAL_BLK 0xC9BF8 Kwb_Wu16 65535.00 OneToOne 0.00 65535.00 FORMAT "%8.2" NUMBER 4 /end CHARACTERISTIC
/begin CHARACTERISTIC DSM_CDKDfp_AOHtCD_AOHtDia3_C "Kundenspezifischer Fehlercode fuer Fehlerpfad Dfp_AOHtCD_AOHtDia3" VAL_BLK 0xC9C00 Kwb_Wu16 65535.00 OneToOne 0.00 65535.00 FORMAT "%8.2" NUMBER 4 /end CHARACTERISTIC
/begin CHARACTERISTIC DSM_CDKDfp_APP1_C "Kundenspezifischer Fehlercode fuer Fehlerpfad Dfp_APP1" VAL_BLK 0xC9C08 Kwb_Wu16 65535.00 OneToOne 0.00 65535.00 FORMAT "%8.2" NUMBER 4 /end CHARACTERISTIC
/begin CHARACTERISTIC DSM_CDKDfp_APP2_C "Kundenspezifischer Fehlercode fuer Fehlerpfad Dfp_APP2" VAL_BLK 0xC9C10 Kwb_Wu16 65535.00 OneToOne 0.00 65535.00 FORMAT "%8.2" NUMBER 4 /end CHARACTERISTIC
/begin CHARACTERISTIC DSM_CDKDfp_APPSync_C "Kundenspezifischer Fehlercode fuer Fehlerpfad Dfp_APPSync" VAL_BLK 0xC9C18 Kwb_Wu16 65535.00 OneToOne 0.00 65535.00 FORMAT "%8.2" NUMBER 4 /end CHARACTERISTIC
/begin CHARACTERISTIC DSM_CDKDfp_APSCD_C "Kundenspezifischer Fehlercode fuer Fehlerpfad Dfp_APSCD" VAL_BLK 0xC9C20 Kwb_Wu16 65535.00 OneToOne 0.00 65535.00 FORMAT "%8.2" NUMBER 4 /end CHARACTERISTIC
/begin CHARACTERISTIC DSM_CDKDfp_ARS_C "Kundenspezifischer Fehlercode fuer Fehlerpfad Dfp_ARS" VAL_BLK 0xC9C28 Kwb_Wu16 65535.00 OneToOne 0.00 65535.00 FORMAT "%8.2" NUMBER 4 /end CHARACTERISTIC
/begin CHARACTERISTIC DSM_CDKDfp_AccPedPlausBrk_C "Kundenspezifischer Fehlercode fuer Fehlerpfad Dfp_AccPedPlausBrk" VAL_BLK 0xC9C30 Kwb_Wu16 65535.00 OneToOne 0.00 65535.00 FORMAT "%8.2" NUMBER 4 /end CHARACTERISTIC
/begin CHARACTERISTIC DSM_CDKDfp_AirCtlPlateBreak_C "DSM variable for Dfp_AirCtlPlateBreak_mp" VAL_BLK 0xC9C38 Kwb_Wu16 65535.00 OneToOne 0.00 65535.00 FORMAT "%8.2" NUMBER 4 /end CHARACTERISTIC
/begin CHARACTERISTIC DSM_CDKDfp_Layer_QLT_C "Kundenspezifischer Fehlercode fuer Fehlerpfad Dfp_Layer_QLT" VAL_BLK 0xC9C40 Kwb_Wu16 65535.00 OneToOne 0.00 65535.00 FORMAT "%8.2" NUMBER 4 /end CHARACTERISTIC
/begin CHARACTERISTIC DSM_CDKDfp_AirCtl_GovNegDev_C "Kundenspezifischer Fehlercode fuer Fehlerpfad Dfp_AirCtl_GovNegDev" VAL_BLK 0xC9C48 Kwb_Wu16 65535.00 OneToOne 0.00 65535.00 FORMAT "%8.2" NUMBER 4 /end CHARACTERISTIC
/begin CHARACTERISTIC DSM_CDKDfp_Layer_IBS1_C "Kundenspezifischer Fehlercode fuer Fehlerpfad Dfp_Layer_IBS1" VAL_BLK 0xC9C50 Kwb_Wu16 65535.00 OneToOne 0.00 65535.00 FORMAT "%8.2" NUMBER 4 /end CHARACTERISTIC
/begin CHARACTERISTIC DSM_CDKDfp_Layer_IBS2_C "Kundenspezifischer Fehlercode fuer Fehlerpfad Dfp_Layer_IBS2" VAL_BLK 0xC9C58 Kwb_Wu16 65535.00 OneToOne 0.00 65535.00 FORMAT "%8.2" NUMBER 4 /end CHARACTERISTIC
/begin CHARACTERISTIC DSM_CDKDfp_Layer_IBS3_C "Kundenspezifischer Fehlercode fuer Fehlerpfad Dfp_Layer_IBS3" VAL_BLK 0xC9C60 Kwb_Wu16 65535.00 OneToOne 0.00 65535.00 FORMAT "%8.2" NUMBER 4 /end CHARACTERISTIC
/begin CHARACTERISTIC DSM_CDKDfp_Layer_PMBN_C "Kundenspezifischer Fehlercode fuer Fehlerpfad Dfp_Layer_PMBN" VAL_BLK 0xC9C68 Kwb_Wu16 65535.00 OneToOne 0.00 65535.00 FORMAT "%8.2" NUMBER 4 /end CHARACTERISTIC
/begin CHARACTERISTIC DSM_CDKDfp_Layer_PMBATT_C "Kundenspezifischer Fehlercode fuer Fehlerpfad Dfp_Layer_PMBATT" VAL_BLK 0xC9C70 Kwb_Wu16 65535.00 OneToOne 0.00 65535.00 FORMAT "%8.2" NUMBER 4 /end CHARACTERISTIC
/begin CHARACTERISTIC DSM_CDKDfp_AirCtl_GovNegDev2_C "Kundenspezifischer Fehlercode fuer Fehlerpfad Dfp_AirCtl_GovNegDev2" VAL_BLK 0xC9C78 Kwb_Wu16 65535.00 OneToOne 0.00 65535.00 FORMAT "%8.2" NUMBER 4 /end CHARACTERISTIC
/begin CHARACTERISTIC DSM_CDKDfp_AirCtl_GovPosDev_C "Kundenspezifischer Fehlercode fuer Fehlerpfad Dfp_AirCtl_GovPosDev" VAL_BLK 0xC9C80 Kwb_Wu16 65535.00 OneToOne 0.00 65535.00 FORMAT "%8.2" NUMBER 4 /end CHARACTERISTIC
/begin CHARACTERISTIC DSM_CDKDfp_AirCtl_GovPosDev2_C "Kundenspezifischer Fehlercode fuer Fehlerpfad Dfp_AirCtl_GovPosDev2" VAL_BLK 0xC9C88 Kwb_Wu16 65535.00 OneToOne 0.00 65535.00 FORMAT "%8.2" NUMBER 4 /end CHARACTERISTIC
/begin CHARACTERISTIC DSM_CDKDfp_AltCD_C "Kundenspezifischer Fehlercode fuer Fehlerpfad Dfp_AltCD" VAL_BLK 0xC9C90 Kwb_Wu16 65535.00 OneToOne 0.00 65535.00 FORMAT "%8.2" NUMBER 4 /end CHARACTERISTIC
/begin CHARACTERISTIC DSM_CDKDfp_AltCD_Load_C "Kundenspezifischer Fehlercode fuer Fehlerpfad Dfp_AltCD_Load" VAL_BLK 0xC9C98 Kwb_Wu16 65535.00 OneToOne 0.00 65535.00 FORMAT "%8.2" NUMBER 4 /end CHARACTERISTIC
/begin CHARACTERISTIC DSM_CDKDfp_BPACD_BPADia1_C "Kundenspezifischer Fehlercode fuer Fehlerpfad Dfp_BPACD_BPADia1" VAL_BLK 0xC9CA0 Kwb_Wu16 65535.00 OneToOne 0.00 65535.00 FORMAT "%8.2" NUMBER 4 /end CHARACTERISTIC
/begin CHARACTERISTIC DSM_CDKDfp_BPACD_BPADia2_C "Kundenspezifischer Fehlercode fuer Fehlerpfad Dfp_BPACD_BPADia2" VAL_BLK 0xC9CA8 Kwb_Wu16 65535.00 OneToOne 0.00 65535.00 FORMAT "%8.2" NUMBER 4 /end CHARACTERISTIC
/begin CHARACTERISTIC DSM_CDKDfp_BPACD_BPADia3_C "Kundenspezifischer Fehlercode fuer Fehlerpfad Dfp_BPACD_BPADia3" VAL_BLK 0xC9CB0 Kwb_Wu16 65535.00 OneToOne 0.00 65535.00 FORMAT "%8.2" NUMBER 4 /end CHARACTERISTIC
/begin CHARACTERISTIC DSM_CDKDfp_BPACD_Max_C "Kundenspezifischer Fehlercode fuer Fehlerpfad Dfp_BPACD_Max" VAL_BLK 0xC9CB8 Kwb_Wu16 65535.00 OneToOne 0.00 65535.00 FORMAT "%8.2" NUMBER 4 /end CHARACTERISTIC
/begin CHARACTERISTIC DSM_CDKDfp_BPACD_Min_C "Kundenspezifischer Fehlercode fuer Fehlerpfad Dfp_BPACD_Min" VAL_BLK 0xC9CC0 Kwb_Wu16 65535.00 OneToOne 0.00 65535.00 FORMAT "%8.2" NUMBER 4 /end CHARACTERISTIC
/begin CHARACTERISTIC DSM_CDKDfp_BPACD_SigNpl_C "Kundenspezifischer Fehlercode fuer Fehlerpfad Dfp_BPACD_SigNpl" VAL_BLK 0xC9CC8 Kwb_Wu16 65535.00 OneToOne 0.00 65535.00 FORMAT "%8.2" NUMBER 4 /end CHARACTERISTIC
/begin CHARACTERISTIC DSM_CDKDfp_BPSCD_C "Kundenspezifischer Fehlercode fuer Fehlerpfad Dfp_BPSCD" VAL_BLK 0xC9CD0 Kwb_Wu16 65535.00 OneToOne 0.00 65535.00 FORMAT "%8.2" NUMBER 4 /end CHARACTERISTIC
/begin CHARACTERISTIC DSM_CDKDfp_BattCD_C "Kundenspezifischer Fehlercode fuer Fehlerpfad Dfp_BattCD" VAL_BLK 0xC9CD8 Kwb_Wu16 65535.00 OneToOne 0.00 65535.00 FORMAT "%8.2" NUMBER 4 /end CHARACTERISTIC
/begin CHARACTERISTIC DSM_CDKDfp_BrkCD_C "Kundenspezifischer Fehlercode fuer Fehlerpfad Dfp_BrkCD" VAL_BLK 0xC9CE0 Kwb_Wu16 65535.00 OneToOne 0.00 65535.00 FORMAT "%8.2" NUMBER 4 /end CHARACTERISTIC
/begin CHARACTERISTIC DSM_CDKDfp_Bss_C "Kundenspezifischer Fehlercode fuer Fehlerpfad Dfp_Bss" VAL_BLK 0xC9CE8 Kwb_Wu16 65535.00 OneToOne 0.00 65535.00 FORMAT "%8.2" NUMBER 4 /end CHARACTERISTIC
/begin CHARACTERISTIC DSM_CDKDfp_CBACD_C "Kundenspezifischer Fehlercode fuer Fehlerpfad Dfp_CBACD" VAL_BLK 0xC9CF0 Kwb_Wu16 65535.00 OneToOne 0.00 65535.00 FORMAT "%8.2" NUMBER 4 /end CHARACTERISTIC
/begin CHARACTERISTIC DSM_CDKDfp_CTSCD_C "Kundenspezifischer Fehlercode fuer Fehlerpfad Dfp_CTSCD" VAL_BLK 0xC9CF8 Kwb_Wu16 65535.00 OneToOne 0.00 65535.00 FORMAT "%8.2" NUMBER 4 /end CHARACTERISTIC
/begin CHARACTERISTIC DSM_CDKDfp_Clg_DynTst_C "Kundenspezifischer Fehlercode fuer Fehlerpfad Dfp_Clg_DynTst" VAL_BLK 0xC9D00 Kwb_Wu16 65535.00 OneToOne 0.00 65535.00 FORMAT "%8.2" NUMBER 4 /end CHARACTERISTIC
/begin CHARACTERISTIC DSM_CDKDfp_CmbChbMisfire1_C "Kundenspezifischer Fehlercode fuer Fehlerpfad Dfp_CmbChbMisfire1" VAL_BLK 0xC9D08 Kwb_Wu16 65535.00 OneToOne 0.00 65535.00 FORMAT "%8.2" NUMBER 4 /end CHARACTERISTIC
/begin CHARACTERISTIC DSM_CDKDfp_CmbChbMisfire2_C "Kundenspezifischer Fehlercode fuer Fehlerpfad Dfp_CmbChbMisfire2" VAL_BLK 0xC9D10 Kwb_Wu16 65535.00 OneToOne 0.00 65535.00 FORMAT "%8.2" NUMBER 4 /end CHARACTERISTIC
/begin CHARACTERISTIC DSM_CDKDfp_CmbChbMisfire3_C "Kundenspezifischer Fehlercode fuer Fehlerpfad Dfp_CmbChbMisfire3" VAL_BLK 0xC9D18 Kwb_Wu16 65535.00 OneToOne 0.00 65535.00 FORMAT "%8.2" NUMBER 4 /end CHARACTERISTIC
/begin CHARACTERISTIC DSM_CDKDfp_CmbChbMisfire4_C "Kundenspezifischer Fehlercode fuer Fehlerpfad Dfp_CmbChbMisfire4" VAL_BLK 0xC9D20 Kwb_Wu16 65535.00 OneToOne 0.00 65535.00 FORMAT "%8.2" NUMBER 4 /end CHARACTERISTIC
/begin CHARACTERISTIC DSM_CDKDfp_CmbChbMisfire5_C "Kundenspezifischer Fehlercode fuer Fehlerpfad Dfp_CmbChbMisfire5" VAL_BLK 0xC9D28 Kwb_Wu16 65535.00 OneToOne 0.00 65535.00 FORMAT "%8.2" NUMBER 4 /end CHARACTERISTIC
/begin CHARACTERISTIC DSM_CDKDfp_CmbChbMisfire6_C "Kundenspezifischer Fehlercode fuer Fehlerpfad Dfp_CmbChbMisfire6" VAL_BLK 0xC9D30 Kwb_Wu16 65535.00 OneToOne 0.00 65535.00 FORMAT "%8.2" NUMBER 4 /end CHARACTERISTIC
/begin CHARACTERISTIC DSM_CDKDfp_CmbChbMisfireMul_C "Kundenspezifischer Fehlercode fuer Fehlerpfad Dfp_CmbChbMisfireMul" VAL_BLK 0xC9D38 Kwb_Wu16 65535.00 OneToOne 0.00 65535.00 FORMAT "%8.2" NUMBER 4 /end CHARACTERISTIC
/begin CHARACTERISTIC DSM_CDKDfp_CoVMDCSh_C "Kundenspezifischer Fehlercode fuer Fehlerpfad Dfp_CoVMDCSh" VAL_BLK 0xC9D40 Kwb_Wu16 65535.00 OneToOne 0.00 65535.00 FORMAT "%8.2" NUMBER 4 /end CHARACTERISTIC
/begin CHARACTERISTIC DSM_CDKDfp_ConvCD_C "Kundenspezifischer Fehlercode fuer Fehlerpfad Dfp_ConvCD" VAL_BLK 0xC9D48 Kwb_Wu16 65535.00 OneToOne 0.00 65535.00 FORMAT "%8.2" NUMBER 4 /end CHARACTERISTIC
/begin CHARACTERISTIC DSM_CDKDfp_CrCCDMFL_C "Kundenspezifischer Fehlercode fuer Fehlerpfad Dfp_CrCCDMFL" VAL_BLK 0xC9D50 Kwb_Wu16 65535.00 OneToOne 0.00 65535.00 FORMAT "%8.2" NUMBER 4 /end CHARACTERISTIC
/begin CHARACTERISTIC DSM_CDKDfp_CrCtl_vCrCtl_C "Kundenspezifischer Fehlercode fuer Fehlerpfad Dfp_CrCtl_vCrCtl" VAL_BLK 0xC9D58 Kwb_Wu16 65535.00 OneToOne 0.00 65535.00 FORMAT "%8.2" NUMBER 4 /end CHARACTERISTIC
/begin CHARACTERISTIC DSM_CDKDfp_Dummy1_C "Kundenspezifischer Fehlercode fuer Fehlerpfad Dfp_Dummy1" VAL_BLK 0xC9D60 Kwb_Wu16 65535.00 OneToOne 0.00 65535.00 FORMAT "%8.2" NUMBER 4 /end CHARACTERISTIC
/begin CHARACTERISTIC DSM_CDKDfp_EATSCD_C "Kundenspezifischer Fehlercode fuer Fehlerpfad Dfp_EATSCD" VAL_BLK 0xC9D68 Kwb_Wu16 65535.00 OneToOne 0.00 65535.00 FORMAT "%8.2" NUMBER 4 /end CHARACTERISTIC
/begin CHARACTERISTIC DSM_CDKDfp_EBAFCD_C "Kundenspezifischer Fehlercode fuer Fehlerpfad Dfp_EBAFCD" VAL_BLK 0xC9D70 Kwb_Wu16 65535.00 OneToOne 0.00 65535.00 FORMAT "%8.2" NUMBER 4 /end CHARACTERISTIC
/begin CHARACTERISTIC DSM_CDKDfp_Layer_PMRUHVERL_C "Kundenspezifischer Fehlercode fuer Fehlerpfad Dfp_Layer_PMRUHVERL" VAL_BLK 0xC9D78 Kwb_Wu16 65535.00 OneToOne 0.00 65535.00 FORMAT "%8.2" NUMBER 4 /end CHARACTERISTIC
/begin CHARACTERISTIC DSM_CDKDfp_EBFCD_C "Kundenspezifischer Fehlercode fuer Fehlerpfad Dfp_EBFCD" VAL_BLK 0xC9D80 Kwb_Wu16 65535.00 OneToOne 0.00 65535.00 FORMAT "%8.2" NUMBER 4 /end CHARACTERISTIC
/begin CHARACTERISTIC DSM_CDKDfp_EBTSCD_C "Kundenspezifischer Fehlercode fuer Fehlerpfad Dfp_EBTSCD" VAL_BLK 0xC9D88 Kwb_Wu16 65535.00 OneToOne 0.00 65535.00 FORMAT "%8.2" NUMBER 4 /end CHARACTERISTIC
/begin CHARACTERISTIC DSM_CDKDfp_EBTSCD_OvrTemp_C "Kundenspezifischer Fehlercode fuer Fehlerpfad Dfp_EBTSCD_OvrTemp" VAL_BLK 0xC9D90 Kwb_Wu16 65535.00 OneToOne 0.00 65535.00 FORMAT "%8.2" NUMBER 4 /end CHARACTERISTIC
/begin CHARACTERISTIC DSM_CDKDfp_EEPCDVarMng_C "Kundenspezifischer Fehlercode fuer Fehlerpfad Dfp_EEPCD_VarMng" VAL_BLK 0xC9D98 Kwb_Wu16 65535.00 OneToOne 0.00 65535.00 FORMAT "%8.2" NUMBER 4 /end CHARACTERISTIC
/begin CHARACTERISTIC DSM_CDKDfp_Layer_TOENS_C "Kundenspezifischer Fehlercode fuer Fehlerpfad Dfp_Layer_TOENS" VAL_BLK 0xC9DA0 Kwb_Wu16 65535.00 OneToOne 0.00 65535.00 FORMAT "%8.2" NUMBER 4 /end CHARACTERISTIC
/begin CHARACTERISTIC DSM_CDKDfp_Layer_MANHYDR_C "Kundenspezifischer Fehlercode fuer Fehlerpfad Dfp_Layer_MANHYDR" VAL_BLK 0xC9DA8 Kwb_Wu16 65535.00 OneToOne 0.00 65535.00 FORMAT "%8.2" NUMBER 4 /end CHARACTERISTIC
/begin CHARACTERISTIC DSM_CDKDfp_Layer_MANLUFT_C "Kundenspezifischer Fehlercode fuer Fehlerpfad Dfp_Layer_MANLUFT" VAL_BLK 0xC9DB0 Kwb_Wu16 65535.00 OneToOne 0.00 65535.00 FORMAT "%8.2" NUMBER 4 /end CHARACTERISTIC
/begin CHARACTERISTIC DSM_CDKDfp_EGPpCD_C "Kundenspezifischer Fehlercode fuer Fehlerpfad Dfp_EGPpCD" VAL_BLK 0xC9DB8 Kwb_Wu16 65535.00 OneToOne 0.00 65535.00 FORMAT "%8.2" NUMBER 4 /end CHARACTERISTIC
/begin CHARACTERISTIC DSM_CDKDfp_EGPpCDTPreTrbn_C "Kundenspezifischer Fehlercode fuer Fehlerpfad Dfp_EgPpCDTPreTrbn" VAL_BLK 0xC9DC0 Kwb_Wu16 65535.00 OneToOne 0.00 65535.00 FORMAT "%8.2" NUMBER 4 /end CHARACTERISTIC
/begin CHARACTERISTIC DSM_CDKDfp_EGRCD_Max_C "Kundenspezifischer Fehlercode fuer Fehlerpfad Dfp_EGRCD_Max" VAL_BLK 0xC9DC8 Kwb_Wu16 65535.00 OneToOne 0.00 65535.00 FORMAT "%8.2" NUMBER 4 /end CHARACTERISTIC
/begin CHARACTERISTIC DSM_CDKDfp_EGRCD_Min_C "Kundenspezifischer Fehlercode fuer Fehlerpfad Dfp_EGRCD_Min" VAL_BLK 0xC9DD0 Kwb_Wu16 65535.00 OneToOne 0.00 65535.00 FORMAT "%8.2" NUMBER 4 /end CHARACTERISTIC
/begin CHARACTERISTIC DSM_CDKDfp_EGRCD_SigNpl_C "Kundenspezifischer Fehlercode fuer Fehlerpfad Dfp_EGRCD_SigNpl" VAL_BLK 0xC9DD8 Kwb_Wu16 65535.00 OneToOne 0.00 65535.00 FORMAT "%8.2" NUMBER 4 /end CHARACTERISTIC
/begin CHARACTERISTIC DSM_CDKDfp_EGTRgnOilDil_C "Kundenspezifischer Fehlercode fuer Fehlerpfad Dfp_EGTRgnOilDil" VAL_BLK 0xC9DE0 Kwb_Wu16 65535.00 OneToOne 0.00 65535.00 FORMAT "%8.2" NUMBER 4 /end CHARACTERISTIC
/begin CHARACTERISTIC DSM_CDKDfp_EMCCDNoLoad1_C "" VAL_BLK 0xC9DE8 Kwb_Wu16 65535.00 OneToOne 0.00 65535.00 FORMAT "%8.2" NUMBER 4 /end CHARACTERISTIC
/begin CHARACTERISTIC DSM_CDKDfp_EMCCDNoLoad2_C "" VAL_BLK 0xC9DF0 Kwb_Wu16 65535.00 OneToOne 0.00 65535.00 FORMAT "%8.2" NUMBER 4 /end CHARACTERISTIC
/begin CHARACTERISTIC DSM_CDKDfp_EMCCDSCBat1_C "" VAL_BLK 0xC9DF8 Kwb_Wu16 65535.00 OneToOne 0.00 65535.00 FORMAT "%8.2" NUMBER 4 /end CHARACTERISTIC
/begin CHARACTERISTIC DSM_CDKDfp_EMCCDSCBat2_C "" VAL_BLK 0xC9E00 Kwb_Wu16 65535.00 OneToOne 0.00 65535.00 FORMAT "%8.2" NUMBER 4 /end CHARACTERISTIC
/begin CHARACTERISTIC DSM_CDKDfp_EMCCDSCGnd1_C "" VAL_BLK 0xC9E08 Kwb_Wu16 65535.00 OneToOne 0.00 65535.00 FORMAT "%8.2" NUMBER 4 /end CHARACTERISTIC
/begin CHARACTERISTIC DSM_CDKDfp_EMCCDSCGnd2_C "" VAL_BLK 0xC9E10 Kwb_Wu16 65535.00 OneToOne 0.00 65535.00 FORMAT "%8.2" NUMBER 4 /end CHARACTERISTIC
/begin CHARACTERISTIC DSM_CDKDfp_EMCCD_ADC1_C "" VAL_BLK 0xC9E18 Kwb_Wu16 65535.00 OneToOne 0.00 65535.00 FORMAT "%8.2" NUMBER 4 /end CHARACTERISTIC
/begin CHARACTERISTIC DSM_CDKDfp_EMCCD_ADC2_C "" VAL_BLK 0xC9E20 Kwb_Wu16 65535.00 OneToOne 0.00 65535.00 FORMAT "%8.2" NUMBER 4 /end CHARACTERISTIC
/begin CHARACTERISTIC DSM_CDKDfp_ETClbETFltInj1_C "Kundenspezifischer Fehlercode fuer Fehlerpfad Dfp_ETClbETFltInj1" VAL_BLK 0xC9E28 Kwb_Wu16 65535.00 OneToOne 0.00 65535.00 FORMAT "%8.2" NUMBER 4 /end CHARACTERISTIC
/begin CHARACTERISTIC DSM_CDKDfp_ETClbETFltInj2_C "Kundenspezifischer Fehlercode fuer Fehlerpfad Dfp_ETClbETFltInj2" VAL_BLK 0xC9E30 Kwb_Wu16 65535.00 OneToOne 0.00 65535.00 FORMAT "%8.2" NUMBER 4 /end CHARACTERISTIC
/begin CHARACTERISTIC DSM_CDKDfp_ETClbETFltInj3_C "Kundenspezifischer Fehlercode fuer Fehlerpfad Dfp_ETClbETFltInj3" VAL_BLK 0xC9E38 Kwb_Wu16 65535.00 OneToOne 0.00 65535.00 FORMAT "%8.2" NUMBER 4 /end CHARACTERISTIC
/begin CHARACTERISTIC DSM_CDKDfp_ETClbETFltInj4_C "Kundenspezifischer Fehlercode fuer Fehlerpfad Dfp_ETClbETFltInj4" VAL_BLK 0xC9E40 Kwb_Wu16 65535.00 OneToOne 0.00 65535.00 FORMAT "%8.2" NUMBER 4 /end CHARACTERISTIC
/begin CHARACTERISTIC DSM_CDKDfp_ETClbETFltInj5_C "Kundenspezifischer Fehlercode fuer Fehlerpfad Dfp_ETClbETFltInj5" VAL_BLK 0xC9E48 Kwb_Wu16 65535.00 OneToOne 0.00 65535.00 FORMAT "%8.2" NUMBER 4 /end CHARACTERISTIC
/begin CHARACTERISTIC DSM_CDKDfp_ETClbETFltInj6_C "Kundenspezifischer Fehlercode fuer Fehlerpfad Dfp_ETClbETFltInj6" VAL_BLK 0xC9E50 Kwb_Wu16 65535.00 OneToOne 0.00 65535.00 FORMAT "%8.2" NUMBER 4 /end CHARACTERISTIC
/begin CHARACTERISTIC DSM_CDKDfp_ETClbInj1_C "Kundenspezifischer Fehlercode fuer Fehlerpfad Dfp_ETClbInj1" VAL_BLK 0xC9E58 Kwb_Wu16 65535.00 OneToOne 0.00 65535.00 FORMAT "%8.2" NUMBER 4 /end CHARACTERISTIC
/begin CHARACTERISTIC DSM_CDKDfp_ETClbInj2_C "Kundenspezifischer Fehlercode fuer Fehlerpfad Dfp_ETClbInj2" VAL_BLK 0xC9E60 Kwb_Wu16 65535.00 OneToOne 0.00 65535.00 FORMAT "%8.2" NUMBER 4 /end CHARACTERISTIC
/begin CHARACTERISTIC DSM_CDKDfp_ETClbInj3_C "Kundenspezifischer Fehlercode fuer Fehlerpfad Dfp_ETClbInj3" VAL_BLK 0xC9E68 Kwb_Wu16 65535.00 OneToOne 0.00 65535.00 FORMAT "%8.2" NUMBER 4 /end CHARACTERISTIC
/begin CHARACTERISTIC DSM_CDKDfp_ETClbInj4_C "Kundenspezifischer Fehlercode fuer Fehlerpfad Dfp_ETClbInj4" VAL_BLK 0xC9E70 Kwb_Wu16 65535.00 OneToOne 0.00 65535.00 FORMAT "%8.2" NUMBER 4 /end CHARACTERISTIC
/begin CHARACTERISTIC DSM_CDKDfp_ETClbInj5_C "Kundenspezifischer Fehlercode fuer Fehlerpfad Dfp_ETClbInj5" VAL_BLK 0xC9E78 Kwb_Wu16 65535.00 OneToOne 0.00 65535.00 FORMAT "%8.2" NUMBER 4 /end CHARACTERISTIC
/begin CHARACTERISTIC DSM_CDKDfp_ETClbInj6_C "Kundenspezifischer Fehlercode fuer Fehlerpfad Dfp_ETClbInj6" VAL_BLK 0xC9E80 Kwb_Wu16 65535.00 OneToOne 0.00 65535.00 FORMAT "%8.2" NUMBER 4 /end CHARACTERISTIC
/begin CHARACTERISTIC DSM_CDKDfp_EngMCaS1_C "Kundenspezifischer Fehlercode fuer Fehlerpfad Dfp_EngMCaS1" VAL_BLK 0xC9E88 Kwb_Wu16 65535.00 OneToOne 0.00 65535.00 FORMAT "%8.2" NUMBER 4 /end CHARACTERISTIC
/begin CHARACTERISTIC DSM_CDKDfp_EngMCrS1_C "Kundenspezifischer Fehlercode fuer Fehlerpfad Dfp_EngMCrS1" VAL_BLK 0xC9E90 Kwb_Wu16 65535.00 OneToOne 0.00 65535.00 FORMAT "%8.2" NUMBER 4 /end CHARACTERISTIC
/begin CHARACTERISTIC DSM_CDKDfp_EngMOfsCaSCrS_C "Kundenspezifischer Fehlercode fuer Fehlerpfad Dfp_EngMOfsCaSCrS" VAL_BLK 0xC9E98 Kwb_Wu16 65535.00 OneToOne 0.00 65535.00 FORMAT "%8.2" NUMBER 4 /end CHARACTERISTIC
/begin CHARACTERISTIC DSM_CDKDfp_EngPrtFWODet_C "Kundenspezifischer Fehlercode fuer Fehlerpfad Dfp_EngPrtFWODet" VAL_BLK 0xC9EA0 Kwb_Wu16 65535.00 OneToOne 0.00 65535.00 FORMAT "%8.2" NUMBER 4 /end CHARACTERISTIC
/begin CHARACTERISTIC DSM_CDKDfp_FBCqDvt_C "Kundenspezifischer Fehlercode fuer Fehlerpfad Dfp_FBCqDvt" VAL_BLK 0xC9EA8 Kwb_Wu16 65535.00 OneToOne 0.00 65535.00 FORMAT "%8.2" NUMBER 4 /end CHARACTERISTIC
/begin CHARACTERISTIC DSM_CDKDfp_FMTC_NonMonotonMap_C "Kundenspezifischer Fehlercode fuer Fehlerpfad Dfp_FMTC_NonMonotonMap" VAL_BLK 0xC9EB0 Kwb_Wu16 65535.00 OneToOne 0.00 65535.00 FORMAT "%8.2" NUMBER 4 /end CHARACTERISTIC
/begin CHARACTERISTIC DSM_CDKDfp_FTSCD_C "Kundenspezifischer Fehlercode fuer Fehlerpfad Dfp_FTSCD" VAL_BLK 0xC9EB8 Kwb_Wu16 65535.00 OneToOne 0.00 65535.00 FORMAT "%8.2" NUMBER 4 /end CHARACTERISTIC
/begin CHARACTERISTIC DSM_CDKDfp_FanCD_C "Kundenspezifischer Fehlercode fuer Fehlerpfad Dfp_FanCD" VAL_BLK 0xC9EC0 Kwb_Wu16 65535.00 OneToOne 0.00 65535.00 FORMAT "%8.2" NUMBER 4 /end CHARACTERISTIC
/begin CHARACTERISTIC DSM_CDKDfp_FanCD_FanCtlr1_C "Kundenspezifischer Fehlercode fuer Fehlerpfad Dfp_FanCD_FanCtlr1" VAL_BLK 0xC9EC8 Kwb_Wu16 65535.00 OneToOne 0.00 65535.00 FORMAT "%8.2" NUMBER 4 /end CHARACTERISTIC
/begin CHARACTERISTIC DSM_CDKDfp_FanCD_FanCtlr2_C "Kundenspezifischer Fehlercode fuer Fehlerpfad Dfp_FanCD_FanCtlr2" VAL_BLK 0xC9ED0 Kwb_Wu16 65535.00 OneToOne 0.00 65535.00 FORMAT "%8.2" NUMBER 4 /end CHARACTERISTIC
/begin CHARACTERISTIC DSM_CDKDfp_FanCD_FanCtlr3_C "Kundenspezifischer Fehlercode fuer Fehlerpfad Dfp_FanCD_FanCtlr3" VAL_BLK 0xC9ED8 Kwb_Wu16 65535.00 OneToOne 0.00 65535.00 FORMAT "%8.2" NUMBER 4 /end CHARACTERISTIC
/begin CHARACTERISTIC DSM_CDKDfp_FlFCD_C "Kundenspezifischer Fehlercode fuer Fehlerpfad Dfp_FlFCD" VAL_BLK 0xC9EE0 Kwb_Wu16 65535.00 OneToOne 0.00 65535.00 FORMAT "%8.2" NUMBER 4 /end CHARACTERISTIC
/begin CHARACTERISTIC DSM_CDKDfp_FlMngSmkDefect_C "Kundenspezifischer Fehlercode fuer Fehlerpfad Dfp_FlMngSmkDefect" VAL_BLK 0xC9EE8 Kwb_Wu16 65535.00 OneToOne 0.00 65535.00 FORMAT "%8.2" NUMBER 4 /end CHARACTERISTIC
/begin CHARACTERISTIC DSM_CDKDfp_FrmMngASC1_C "Kundenspezifischer Fehlercode fuer Fehlerpfad Dfp_FrmMngASC1" VAL_BLK 0xC9EF0 Kwb_Wu16 65535.00 OneToOne 0.00 65535.00 FORMAT "%8.2" NUMBER 4 /end CHARACTERISTIC
/begin CHARACTERISTIC DSM_CDKDfp_FrmMngASC2_C "Kundenspezifischer Fehlercode fuer Fehlerpfad Dfp_FrmMngASC2" VAL_BLK 0xC9EF8 Kwb_Wu16 65535.00 OneToOne 0.00 65535.00 FORMAT "%8.2" NUMBER 4 /end CHARACTERISTIC
/begin CHARACTERISTIC DSM_CDKDfp_FrmMngASC3_C "Kundenspezifischer Fehlercode fuer Fehlerpfad Dfp_FrmMngASC3" VAL_BLK 0xC9F00 Kwb_Wu16 65535.00 OneToOne 0.00 65535.00 FORMAT "%8.2" NUMBER 4 /end CHARACTERISTIC
/begin CHARACTERISTIC DSM_CDKDfp_FrmMngASC4_C "Kundenspezifischer Fehlercode fuer Fehlerpfad Dfp_FrmMngASC4" VAL_BLK 0xC9F08 Kwb_Wu16 65535.00 OneToOne 0.00 65535.00 FORMAT "%8.2" NUMBER 4 /end CHARACTERISTIC
/begin CHARACTERISTIC DSM_CDKDfp_FrmMngBOS_RESET_C "Kundenspezifischer Fehlercode fuer Fehlerpfad Dfp_FrmMngBOS_RESET" VAL_BLK 0xC9F10 Kwb_Wu16 65535.00 OneToOne 0.00 65535.00 FORMAT "%8.2" NUMBER 4 /end CHARACTERISTIC
/begin CHARACTERISTIC DSM_CDKDfp_FrmMngBOS_RESET_2_C "" VAL_BLK 0xC9F18 Kwb_Wu16 65535.00 OneToOne 0.00 65535.00 FORMAT "%8.2" NUMBER 4 /end CHARACTERISTIC
/begin CHARACTERISTIC DSM_CDKDfp_FrmMngDMANFAFS_C "Kundenspezifischer Fehlercode fuer Fehlerpfad Dfp_FrmMngDMANFAFS" VAL_BLK 0xC9F20 Kwb_Wu16 65535.00 OneToOne 0.00 65535.00 FORMAT "%8.2" NUMBER 4 /end CHARACTERISTIC
/begin CHARACTERISTIC DSM_CDKDfp_FrmMngDRMANFSSG_C "Kundenspezifischer Fehlercode fuer Fehlerpfad Dfp_FrmMngDRMANFSSG" VAL_BLK 0xC9F28 Kwb_Wu16 65535.00 OneToOne 0.00 65535.00 FORMAT "%8.2" NUMBER 4 /end CHARACTERISTIC
/begin CHARACTERISTIC DSM_CDKDfp_FrmMngEGS1_C "Kundenspezifischer Fehlercode fuer Fehlerpfad Dfp_FrmMngEGS1" VAL_BLK 0xC9F30 Kwb_Wu16 65535.00 OneToOne 0.00 65535.00 FORMAT "%8.2" NUMBER 4 /end CHARACTERISTIC
/begin CHARACTERISTIC DSM_CDKDfp_FrmMngEGS2_C "Kundenspezifischer Fehlercode fuer Fehlerpfad Dfp_FrmMngEGS2" VAL_BLK 0xC9F38 Kwb_Wu16 65535.00 OneToOne 0.00 65535.00 FORMAT "%8.2" NUMBER 4 /end CHARACTERISTIC
/begin CHARACTERISTIC DSM_CDKDfp_FrmMngGEARBX_DATA_C "defect-code (customer-specific) for path" VAL_BLK 0xC9F40 Kwb_Wu16 65535.00 OneToOne 0.00 65535.00 FORMAT "%8.2" NUMBER 4 /end CHARACTERISTIC
/begin CHARACTERISTIC DSM_CDKDfp_FrmMngGEARBX_DATA2_C "Kundenspezifischer Fehlercode fuer Fehlerpfad Dfp_FrmMngGEARBX_DATA2" VAL_BLK 0xC9F48 Kwb_Wu16 65535.00 OneToOne 0.00 65535.00 FORMAT "%8.2" NUMBER 4 /end CHARACTERISTIC
/begin CHARACTERISTIC DSM_CDKDfp_FrmMngHEAT_AC_C "defect-code (customer-specific) for path" VAL_BLK 0xC9F50 Kwb_Wu16 65535.00 OneToOne 0.00 65535.00 FORMAT "%8.2" NUMBER 4 /end CHARACTERISTIC
/begin CHARACTERISTIC DSM_CDKDfp_FrmMngINSTR2_C "Kundenspezifischer Fehlercode fuer Fehlerpfad Dfp_FrmMngINSTR2" VAL_BLK 0xC9F58 Kwb_Wu16 65535.00 OneToOne 0.00 65535.00 FORMAT "%8.2" NUMBER 4 /end CHARACTERISTIC
/begin CHARACTERISTIC DSM_CDKDfp_FrmMngINSTR3_C "Kundenspezifischer Fehlercode fuer Fehlerpfad Dfp_FrmMngINSTR3" VAL_BLK 0xC9F60 Kwb_Wu16 65535.00 OneToOne 0.00 65535.00 FORMAT "%8.2" NUMBER 4 /end CHARACTERISTIC
/begin CHARACTERISTIC DSM_CDKDfp_FrmMngLENKRADWINKEL_C "Kundenspezifischer Fehlercode fuer Fehlerpfad Dfp_FrmMngLENKRADWINKEL" VAL_BLK 0xC9F68 Kwb_Wu16 65535.00 OneToOne 0.00 65535.00 FORMAT "%8.2" NUMBER 4 /end CHARACTERISTIC
/begin CHARACTERISTIC DSM_CDKDfp_FrmMngMILEAGE_RANGE_C "Kundenspezifischer Fehlercode fuer Fehlerpfad Dfp_FrmMngMILEAGE_RANGE" VAL_BLK 0xC9F70 Kwb_Wu16 65535.00 OneToOne 0.00 65535.00 FORMAT "%8.2" NUMBER 4 /end CHARACTERISTIC
/begin CHARACTERISTIC DSM_CDKDfp_FrmMngOPCRCTLACC_C "Kundenspezifischer Fehlercode fuer Fehlerpfad Dfp_FrmMngOPCRCTLACC" VAL_BLK 0xC9F78 Kwb_Wu16 65535.00 OneToOne 0.00 65535.00 FORMAT "%8.2" NUMBER 4 /end CHARACTERISTIC
/begin CHARACTERISTIC DSM_CDKDfp_FrmMngPRGG_CCTR_C "Kundenspezifischer Fehlercode fuer Fehlerpfad Dfp_FrmMngPRGG_CCTR" VAL_BLK 0xC9F80 Kwb_Wu16 65535.00 OneToOne 0.00 65535.00 FORMAT "%8.2" NUMBER 4 /end CHARACTERISTIC
/begin CHARACTERISTIC DSM_CDKDfp_FrmMngPWRMNG_LOADV_C "Kundenspezifischer Fehlercode fuer Fehlerpfad Dfp_FrmMngPWRMNG_LOADV" VAL_BLK 0xC9F88 Kwb_Wu16 65535.00 OneToOne 0.00 65535.00 FORMAT "%8.2" NUMBER 4 /end CHARACTERISTIC
/begin CHARACTERISTIC DSM_CDKDfp_FrmMngParkConsumer_C "Kundenspezifischer Fehlercode fuer Fehlerpfad Dfp_FrmMngParkConsumer" VAL_BLK 0xC9F90 Kwb_Wu16 65535.00 OneToOne 0.00 65535.00 FORMAT "%8.2" NUMBER 4 /end CHARACTERISTIC
/begin CHARACTERISTIC DSM_CDKDfp_FrmMngRQSTGEFAN_C "RQ_STG_EFAN - CAN-message related errors" VAL_BLK 0xC9F98 Kwb_Wu16 65535.00 OneToOne 0.00 65535.00 FORMAT "%8.2" NUMBER 4 /end CHARACTERISTIC
/begin CHARACTERISTIC DSM_CDKDfp_FrmMngSSGErr_C "Kundenspezifischer Fehlercode fuer Fehlerpfad Dfp_FrmMngSSGErr" VAL_BLK 0xC9FA0 Kwb_Wu16 65535.00 OneToOne 0.00 65535.00 FORMAT "%8.2" NUMBER 4 /end CHARACTERISTIC
/begin CHARACTERISTIC DSM_CDKDfp_FrmMngSSGShOff_C "Kundenspezifischer Fehlercode fuer Fehlerpfad Dfp_FrmMngSSGShOff" VAL_BLK 0xC9FA8 Kwb_Wu16 65535.00 OneToOne 0.00 65535.00 FORMAT "%8.2" NUMBER 4 /end CHARACTERISTIC
/begin CHARACTERISTIC DSM_CDKDfp_FrmMngSTAT_ANH_C "Kundenspezifischer Fehlercode fuer Fehlerpfad Dfp_FrmMngSTAT_ANH" VAL_BLK 0xC9FB0 Kwb_Wu16 65535.00 OneToOne 0.00 65535.00 FORMAT "%8.2" NUMBER 4 /end CHARACTERISTIC
/begin CHARACTERISTIC DSM_CDKDfp_FrmMngSTAT_ARS_C "defect-code (customer-specific) for path" VAL_BLK 0xC9FB8 Kwb_Wu16 65535.00 OneToOne 0.00 65535.00 FORMAT "%8.2" NUMBER 4 /end CHARACTERISTIC
/begin CHARACTERISTIC DSM_CDKDfp_FrmMngSTAT_DSC_C "defect-code (customer-specific) for path" VAL_BLK 0xC9FC0 Kwb_Wu16 65535.00 OneToOne 0.00 65535.00 FORMAT "%8.2" NUMBER 4 /end CHARACTERISTIC
/begin CHARACTERISTIC DSM_CDKDfp_FrmMngSTAT_EKP_C "Kundenspezifischer Fehlercode fuer Fehlerpfad Dfp_FrmMngSTAT_EKP" VAL_BLK 0xC9FC8 Kwb_Wu16 65535.00 OneToOne 0.00 65535.00 FORMAT "%8.2" NUMBER 4 /end CHARACTERISTIC
/begin CHARACTERISTIC DSM_CDKDfp_FrmMngSTAT_KOMBI_C "Kundenspezifischer Fehlercode fuer Fehlerpfad Dfp_FrmMngSTAT_KOMBI" VAL_BLK 0xC9FD0 Kwb_Wu16 65535.00 OneToOne 0.00 65535.00 FORMAT "%8.2" NUMBER 4 /end CHARACTERISTIC
/begin CHARACTERISTIC DSM_CDKDfp_FrmMngSTAT_SITZ_C "Kundenspezifischer Fehlercode fuer Fehlerpfad Dfp_FrmMngSTAT_SITZ" VAL_BLK 0xC9FD8 Kwb_Wu16 65535.00 OneToOne 0.00 65535.00 FORMAT "%8.2" NUMBER 4 /end CHARACTERISTIC
/begin CHARACTERISTIC DSM_CDKDfp_FrmMngStOBDGbxMilOf_C "Kundenspezifischer Fehlercode fuer Fehlerpfad Dfp_FrmMngStOBDGbxMilOf" VAL_BLK 0xC9FE0 Kwb_Wu16 65535.00 OneToOne 0.00 65535.00 FORMAT "%8.2" NUMBER 4 /end CHARACTERISTIC
/begin CHARACTERISTIC DSM_CDKDfp_FrmMngStOBDGbxMilOn_C "Kundenspezifischer Fehlercode fuer Fehlerpfad Dfp_FrmMngStOBDGbxMilOn" VAL_BLK 0xC9FE8 Kwb_Wu16 65535.00 OneToOne 0.00 65535.00 FORMAT "%8.2" NUMBER 4 /end CHARACTERISTIC
/begin CHARACTERISTIC DSM_CDKDfp_FrmMngTEMPRELTIME_C "Kundenspezifischer Fehlercode fuer Fehlerpfad Dfp_FrmMngTEMPRELTIME" VAL_BLK 0xC9FF0 Kwb_Wu16 65535.00 OneToOne 0.00 65535.00 FORMAT "%8.2" NUMBER 4 /end CHARACTERISTIC
/begin CHARACTERISTIC DSM_CDKDfp_FrmMngTERMINAL_C "defect-code (customer-specific) for path" VAL_BLK 0xC9FF8 Kwb_Wu16 65535.00 OneToOne 0.00 65535.00 FORMAT "%8.2" NUMBER 4 /end CHARACTERISTIC
/begin CHARACTERISTIC DSM_CDKDfp_FrmMngTIME_DATE_C "Kundenspezifischer Fehlercode fuer Fehlerpfad Dfp_FrmMngTIME_DATE" VAL_BLK 0xCA000 Kwb_Wu16 65535.00 OneToOne 0.00 65535.00 FORMAT "%8.2" NUMBER 4 /end CHARACTERISTIC
/begin CHARACTERISTIC DSM_CDKDfp_FrmMngTORQUE_DSC_C "defect-code (customer-specific) for path" VAL_BLK 0xCA008 Kwb_Wu16 65535.00 OneToOne 0.00 65535.00 FORMAT "%8.2" NUMBER 4 /end CHARACTERISTIC
/begin CHARACTERISTIC DSM_CDKDfp_FrmMngTORQUE_GEARBX_C "defect-code (customer-specific) for path" VAL_BLK 0xCA010 Kwb_Wu16 65535.00 OneToOne 0.00 65535.00 FORMAT "%8.2" NUMBER 4 /end CHARACTERISTIC
/begin CHARACTERISTIC DSM_CDKDfp_FrmMngTrq_ReqACC_C "Kundenspezifischer Fehlercode fuer Fehlerpfad Dfp_FrmMngTrq_ReqACC" VAL_BLK 0xCA018 Kwb_Wu16 65535.00 OneToOne 0.00 65535.00 FORMAT "%8.2" NUMBER 4 /end CHARACTERISTIC
/begin CHARACTERISTIC DSM_CDKDfp_FrmMngVEH_MOD_C "VEH_MOD - CAN-message related errors" VAL_BLK 0xCA020 Kwb_Wu16 65535.00 OneToOne 0.00 65535.00 FORMAT "%8.2" NUMBER 4 /end CHARACTERISTIC
/begin CHARACTERISTIC DSM_CDKDfp_FrmMngVELOCITY_C "defect-code (customer-specific) for path" VAL_BLK 0xCA028 Kwb_Wu16 65535.00 OneToOne 0.00 65535.00 FORMAT "%8.2" NUMBER 4 /end CHARACTERISTIC
/begin CHARACTERISTIC DSM_CDKDfp_FrmMngWHEEL_SPEED_C "Kundenspezifischer Fehlercode fuer Fehlerpfad Dfp_FrmMngWHEEL_SPEED" VAL_BLK 0xCA030 Kwb_Wu16 65535.00 OneToOne 0.00 65535.00 FORMAT "%8.2" NUMBER 4 /end CHARACTERISTIC
/begin CHARACTERISTIC DSM_CDKDfp_FrmMngstCurr_C "Fehlercode für Dfp_FrmMngstCurr" VAL_BLK 0xCA038 Kwb_Wu16 65535.00 OneToOne 0.00 65535.00 FORMAT "%8.2" NUMBER 4 /end CHARACTERISTIC
/begin CHARACTERISTIC DSM_CDKDfp_FrmMngswtPSPOff_C "Fehlercode Feld für Dfp_FrmMngswtPSP" VAL_BLK 0xCA040 Kwb_Wu16 65535.00 OneToOne 0.00 65535.00 FORMAT "%8.2" NUMBER 4 /end CHARACTERISTIC
/begin CHARACTERISTIC DSM_CDKDfp_GearbxIncMax_C "Kundenspezifischer Fehlercode fuer Fehlerpfad Dfp_GearbxIncMax" VAL_BLK 0xCA048 Kwb_Wu16 65535.00 OneToOne 0.00 65535.00 FORMAT "%8.2" NUMBER 4 /end CHARACTERISTIC
/begin CHARACTERISTIC DSM_CDKDfp_GlwCD_C "Kundenspezifischer Fehlercode fuer Fehlerpfad Dfp_GlwCD" VAL_BLK 0xCA050 Kwb_Wu16 65535.00 OneToOne 0.00 65535.00 FORMAT "%8.2" NUMBER 4 /end CHARACTERISTIC
/begin CHARACTERISTIC DSM_CDKDfp_GlwCDGlwCirc1_C "Kundenspezifischer Fehlercode fuer Fehlerpfad Dfp_GlwCDGlwCirc1" VAL_BLK 0xCA058 Kwb_Wu16 65535.00 OneToOne 0.00 65535.00 FORMAT "%8.2" NUMBER 4 /end CHARACTERISTIC
/begin CHARACTERISTIC DSM_CDKDfp_GlwCDGlwCirc2_C "Kundenspezifischer Fehlercode fuer Fehlerpfad Dfp_GlwCDGlwCirc2" VAL_BLK 0xCA060 Kwb_Wu16 65535.00 OneToOne 0.00 65535.00 FORMAT "%8.2" NUMBER 4 /end CHARACTERISTIC
/begin CHARACTERISTIC DSM_CDKDfp_GlwCDGlwCirc3_C "Kundenspezifischer Fehlercode fuer Fehlerpfad Dfp_GlwCDGlwCirc3" VAL_BLK 0xCA068 Kwb_Wu16 65535.00 OneToOne 0.00 65535.00 FORMAT "%8.2" NUMBER 4 /end CHARACTERISTIC
/begin CHARACTERISTIC DSM_CDKDfp_GlwCDGlwCirc4_C "Kundenspezifischer Fehlercode fuer Fehlerpfad Dfp_GlwCDGlwCirc4" VAL_BLK 0xCA070 Kwb_Wu16 65535.00 OneToOne 0.00 65535.00 FORMAT "%8.2" NUMBER 4 /end CHARACTERISTIC
/begin CHARACTERISTIC DSM_CDKDfp_GlwCDGlwCirc5_C "Kundenspezifischer Fehlercode fuer Fehlerpfad Dfp_GlwCDGlwCirc5" VAL_BLK 0xCA078 Kwb_Wu16 65535.00 OneToOne 0.00 65535.00 FORMAT "%8.2" NUMBER 4 /end CHARACTERISTIC
/begin CHARACTERISTIC DSM_CDKDfp_GlwCDGlwCirc6_C "Kundenspezifischer Fehlercode fuer Fehlerpfad Dfp_GlwCDGlwCirc6" VAL_BLK 0xCA080 Kwb_Wu16 65535.00 OneToOne 0.00 65535.00 FORMAT "%8.2" NUMBER 4 /end CHARACTERISTIC
/begin CHARACTERISTIC DSM_CDKDfp_GlwCDGlwCirc7_C "Kundenspezifischer Fehlercode fuer Fehlerpfad Dfp_GlwCDGlwCirc7" VAL_BLK 0xCA088 Kwb_Wu16 65535.00 OneToOne 0.00 65535.00 FORMAT "%8.2" NUMBER 4 /end CHARACTERISTIC
/begin CHARACTERISTIC DSM_CDKDfp_GlwCDGlwCirc8_C "Kundenspezifischer Fehlercode fuer Fehlerpfad Dfp_GlwCDGlwCirc8" VAL_BLK 0xCA090 Kwb_Wu16 65535.00 OneToOne 0.00 65535.00 FORMAT "%8.2" NUMBER 4 /end CHARACTERISTIC
/begin CHARACTERISTIC DSM_CDKDfp_GlwCtl_C "Kundenspezifischer Fehlercode fuer Fehlerpfad Dfp_GlwCtl" VAL_BLK 0xCA098 Kwb_Wu16 65535.00 OneToOne 0.00 65535.00 FORMAT "%8.2" NUMBER 4 /end CHARACTERISTIC
/begin CHARACTERISTIC DSM_CDKDfp_HWEMonCom_C "Kundenspezifischer Fehlercode fuer Fehlerpfad Dfp_HWEMonCom" VAL_BLK 0xCA0A0 Kwb_Wu16 65535.00 OneToOne 0.00 65535.00 FORMAT "%8.2" NUMBER 4 /end CHARACTERISTIC
/begin CHARACTERISTIC DSM_CDKDfp_HWEMonEEPROM_C "Kundenspezifischer Fehlercode fuer Fehlerpfad Dfp_HWEMonEEPROM" VAL_BLK 0xCA0A8 Kwb_Wu16 65535.00 OneToOne 0.00 65535.00 FORMAT "%8.2" NUMBER 4 /end CHARACTERISTIC
/begin CHARACTERISTIC DSM_CDKDfp_HWEMonRcyLocked_C "Kundenspezifischer Fehlercode fuer Fehlerpfad Dfp_HWEMonRcyLocked" VAL_BLK 0xCA0B0 Kwb_Wu16 65535.00 OneToOne 0.00 65535.00 FORMAT "%8.2" NUMBER 4 /end CHARACTERISTIC
/begin CHARACTERISTIC DSM_CDKDfp_HWEMonRcySuppressed_C "Kundenspezifischer Fehlercode fuer Fehlerpfad Dfp_HWEMonRcySuppressed" VAL_BLK 0xCA0B8 Kwb_Wu16 65535.00 OneToOne 0.00 65535.00 FORMAT "%8.2" NUMBER 4 /end CHARACTERISTIC
/begin CHARACTERISTIC DSM_CDKDfp_HWEMonRcyVisible_C "Kundenspezifischer Fehlercode fuer Fehlerpfad Dfp_HWEMonRcyVisible" VAL_BLK 0xCA0C0 Kwb_Wu16 65535.00 OneToOne 0.00 65535.00 FORMAT "%8.2" NUMBER 4 /end CHARACTERISTIC
/begin CHARACTERISTIC DSM_CDKDfp_HWEMonUMaxSupply_C "Kundenspezifischer Fehlercode fuer Fehlerpfad Dfp_HWEMonUMaxSupply" VAL_BLK 0xCA0C8 Kwb_Wu16 65535.00 OneToOne 0.00 65535.00 FORMAT "%8.2" NUMBER 4 /end CHARACTERISTIC
/begin CHARACTERISTIC DSM_CDKDfp_HWEMonUMinSupply_C "Kundenspezifischer Fehlercode fuer Fehlerpfad Dfp_HWEMonUMinSupply" VAL_BLK 0xCA0D0 Kwb_Wu16 65535.00 OneToOne 0.00 65535.00 FORMAT "%8.2" NUMBER 4 /end CHARACTERISTIC
/begin CHARACTERISTIC DSM_CDKDfp_IATSCD_C "Kundenspezifischer Fehlercode fuer Fehlerpfad Dfp_IATSCD" VAL_BLK 0xCA0D8 Kwb_Wu16 65535.00 OneToOne 0.00 65535.00 FORMAT "%8.2" NUMBER 4 /end CHARACTERISTIC
/begin CHARACTERISTIC DSM_CDKDfp_IATSCD_CATS_C "Kundenspezifischer Fehlercode fuer Fehlerpfad Dfp_IATSCD_CATS" VAL_BLK 0xCA0E0 Kwb_Wu16 65535.00 OneToOne 0.00 65535.00 FORMAT "%8.2" NUMBER 4 /end CHARACTERISTIC
/begin CHARACTERISTIC DSM_CDKDfp_ImmCtlImmCD_C "Kundenspezifischer Fehlercode fuer Fehlerpfad Dfp_ImmCtlImmCD" VAL_BLK 0xCA0E8 Kwb_Wu16 65535.00 OneToOne 0.00 65535.00 FORMAT "%8.2" NUMBER 4 /end CHARACTERISTIC
/begin CHARACTERISTIC DSM_CDKDfp_ImmCtlImmEep_C "Kundenspezifischer Fehlercode fuer Fehlerpfad Dfp_ImmCtlImmEep" VAL_BLK 0xCA0F0 Kwb_Wu16 65535.00 OneToOne 0.00 65535.00 FORMAT "%8.2" NUMBER 4 /end CHARACTERISTIC
/begin CHARACTERISTIC DSM_CDKDfp_ImmCtlMpl_C "Kundenspezifischer Fehlercode fuer Fehlerpfad Dfp_ImmCtlMpl" VAL_BLK 0xCA0F8 Kwb_Wu16 65535.00 OneToOne 0.00 65535.00 FORMAT "%8.2" NUMBER 4 /end CHARACTERISTIC
/begin CHARACTERISTIC DSM_CDKDfp_IndSys1_C "Kundenspezifischer Fehlercode fuer Fehlerpfad Dfp_IndSys1" VAL_BLK 0xCA100 Kwb_Wu16 65535.00 OneToOne 0.00 65535.00 FORMAT "%8.2" NUMBER 4 /end CHARACTERISTIC
/begin CHARACTERISTIC DSM_CDKDfp_IndSys2_C "Kundenspezifischer Fehlercode fuer Fehlerpfad Dfp_IndSys2" VAL_BLK 0xCA108 Kwb_Wu16 65535.00 OneToOne 0.00 65535.00 FORMAT "%8.2" NUMBER 4 /end CHARACTERISTIC
/begin CHARACTERISTIC DSM_CDKDfp_InjCrv_InjLim_C "Kundenspezifischer Fehlercode fuer Fehlerpfad Dfp_InjCrv_InjLim" VAL_BLK 0xCA110 Kwb_Wu16 65535.00 OneToOne 0.00 65535.00 FORMAT "%8.2" NUMBER 4 /end CHARACTERISTIC
/begin CHARACTERISTIC DSM_CDKDfp_InjCtlAdjQnt_C "Kundenspezifischer Fehlercode fuer Fehlerpfad Dfp_InjCtlAdjQnt" VAL_BLK 0xCA118 Kwb_Wu16 65535.00 OneToOne 0.00 65535.00 FORMAT "%8.2" NUMBER 4 /end CHARACTERISTIC
/begin CHARACTERISTIC DSM_CDKDfp_InjCtlDrift_C "Kundenspezifischer Fehlercode fuer Fehlerpfad Dfp_InjCtlDrift" VAL_BLK 0xCA120 Kwb_Wu16 65535.00 OneToOne 0.00 65535.00 FORMAT "%8.2" NUMBER 4 /end CHARACTERISTIC
/begin CHARACTERISTIC DSM_CDKDfp_InjVlvBnk1A_C "Kundenspezifischer Fehlercode fuer Fehlerpfad Dfp_InjVlvBnk1A" VAL_BLK 0xCA128 Kwb_Wu16 65535.00 OneToOne 0.00 65535.00 FORMAT "%8.2" NUMBER 4 /end CHARACTERISTIC
/begin CHARACTERISTIC DSM_CDKDfp_InjVlvBnk1B_C "Kundenspezifischer Fehlercode fuer Fehlerpfad Dfp_InjVlvBnk1B" VAL_BLK 0xCA130 Kwb_Wu16 65535.00 OneToOne 0.00 65535.00 FORMAT "%8.2" NUMBER 4 /end CHARACTERISTIC
/begin CHARACTERISTIC DSM_CDKDfp_InjVlvBnk2A_C "Kundenspezifischer Fehlercode fuer Fehlerpfad Dfp_InjVlvBnk2A" VAL_BLK 0xCA138 Kwb_Wu16 65535.00 OneToOne 0.00 65535.00 FORMAT "%8.2" NUMBER 4 /end CHARACTERISTIC
/begin CHARACTERISTIC DSM_CDKDfp_InjVlvBnk2B_C "Kundenspezifischer Fehlercode fuer Fehlerpfad Dfp_InjVlvBnk2B" VAL_BLK 0xCA140 Kwb_Wu16 65535.00 OneToOne 0.00 65535.00 FORMAT "%8.2" NUMBER 4 /end CHARACTERISTIC
/begin CHARACTERISTIC DSM_CDKDfp_InjVlvChipA_C "Kundenspezifischer Fehlercode fuer Fehlerpfad Dfp_InjVlvChipA" VAL_BLK 0xCA148 Kwb_Wu16 65535.00 OneToOne 0.00 65535.00 FORMAT "%8.2" NUMBER 4 /end CHARACTERISTIC
/begin CHARACTERISTIC DSM_CDKDfp_InjVlvChipB_C "Kundenspezifischer Fehlercode fuer Fehlerpfad Dfp_InjVlvChipB" VAL_BLK 0xCA150 Kwb_Wu16 65535.00 OneToOne 0.00 65535.00 FORMAT "%8.2" NUMBER 4 /end CHARACTERISTIC
/begin CHARACTERISTIC DSM_CDKDfp_InjVlvCyl1A_C "Kundenspezifischer Fehlercode fuer Fehlerpfad Dfp_InjVlvCyl1A" VAL_BLK 0xCA158 Kwb_Wu16 65535.00 OneToOne 0.00 65535.00 FORMAT "%8.2" NUMBER 4 /end CHARACTERISTIC
/begin CHARACTERISTIC DSM_CDKDfp_InjVlvCyl1B_C "Kundenspezifischer Fehlercode fuer Fehlerpfad Dfp_InjVlvCyl1B" VAL_BLK 0xCA160 Kwb_Wu16 65535.00 OneToOne 0.00 65535.00 FORMAT "%8.2" NUMBER 4 /end CHARACTERISTIC
/begin CHARACTERISTIC DSM_CDKDfp_InjVlvCyl2A_C "Kundenspezifischer Fehlercode fuer Fehlerpfad Dfp_InjVlvCyl2A" VAL_BLK 0xCA168 Kwb_Wu16 65535.00 OneToOne 0.00 65535.00 FORMAT "%8.2" NUMBER 4 /end CHARACTERISTIC
/begin CHARACTERISTIC DSM_CDKDfp_InjVlvCyl2B_C "Kundenspezifischer Fehlercode fuer Fehlerpfad Dfp_InjVlvCyl2B" VAL_BLK 0xCA170 Kwb_Wu16 65535.00 OneToOne 0.00 65535.00 FORMAT "%8.2" NUMBER 4 /end CHARACTERISTIC
/begin CHARACTERISTIC DSM_CDKDfp_InjVlvCyl3A_C "Kundenspezifischer Fehlercode fuer Fehlerpfad Dfp_InjVlvCyl3A" VAL_BLK 0xCA178 Kwb_Wu16 65535.00 OneToOne 0.00 65535.00 FORMAT "%8.2" NUMBER 4 /end CHARACTERISTIC
/begin CHARACTERISTIC DSM_CDKDfp_InjVlvCyl3B_C "Kundenspezifischer Fehlercode fuer Fehlerpfad Dfp_InjVlvCyl3B" VAL_BLK 0xCA180 Kwb_Wu16 65535.00 OneToOne 0.00 65535.00 FORMAT "%8.2" NUMBER 4 /end CHARACTERISTIC
/begin CHARACTERISTIC DSM_CDKDfp_InjVlvCyl4A_C "Kundenspezifischer Fehlercode fuer Fehlerpfad Dfp_InjVlvCyl4A" VAL_BLK 0xCA188 Kwb_Wu16 65535.00 OneToOne 0.00 65535.00 FORMAT "%8.2" NUMBER 4 /end CHARACTERISTIC
/begin CHARACTERISTIC DSM_CDKDfp_InjVlvCyl4B_C "Kundenspezifischer Fehlercode fuer Fehlerpfad Dfp_InjVlvCyl4B" VAL_BLK 0xCA190 Kwb_Wu16 65535.00 OneToOne 0.00 65535.00 FORMAT "%8.2" NUMBER 4 /end CHARACTERISTIC
/begin CHARACTERISTIC DSM_CDKDfp_InjVlvCyl5A_C "Kundenspezifischer Fehlercode fuer Fehlerpfad Dfp_InjVlvCyl5A" VAL_BLK 0xCA198 Kwb_Wu16 65535.00 OneToOne 0.00 65535.00 FORMAT "%8.2" NUMBER 4 /end CHARACTERISTIC
/begin CHARACTERISTIC DSM_CDKDfp_InjVlvCyl5B_C "Kundenspezifischer Fehlercode fuer Fehlerpfad Dfp_InjVlvCyl5B" VAL_BLK 0xCA1A0 Kwb_Wu16 65535.00 OneToOne 0.00 65535.00 FORMAT "%8.2" NUMBER 4 /end CHARACTERISTIC
/begin CHARACTERISTIC DSM_CDKDfp_InjVlvCyl6A_C "Kundenspezifischer Fehlercode fuer Fehlerpfad Dfp_InjVlvCyl6A" VAL_BLK 0xCA1A8 Kwb_Wu16 65535.00 OneToOne 0.00 65535.00 FORMAT "%8.2" NUMBER 4 /end CHARACTERISTIC
/begin CHARACTERISTIC DSM_CDKDfp_InjVlvCyl6B_C "Kundenspezifischer Fehlercode fuer Fehlerpfad Dfp_InjVlvCyl6B" VAL_BLK 0xCA1B0 Kwb_Wu16 65535.00 OneToOne 0.00 65535.00 FORMAT "%8.2" NUMBER 4 /end CHARACTERISTIC
/begin CHARACTERISTIC DSM_CDKDfp_LPACD_Max_C "Kundenspezifischer Fehlercode fuer Fehlerpfad Dfp_LPACD_Max" VAL_BLK 0xCA1B8 Kwb_Wu16 65535.00 OneToOne 0.00 65535.00 FORMAT "%8.2" NUMBER 4 /end CHARACTERISTIC
/begin CHARACTERISTIC DSM_CDKDfp_LPACD_Min_C "Kundenspezifischer Fehlercode fuer Fehlerpfad Dfp_LPACD_Min" VAL_BLK 0xCA1C0 Kwb_Wu16 65535.00 OneToOne 0.00 65535.00 FORMAT "%8.2" NUMBER 4 /end CHARACTERISTIC
/begin CHARACTERISTIC DSM_CDKDfp_LPACD_SigNpl_C "Kundenspezifischer Fehlercode fuer Fehlerpfad Dfp_LPACD_SigNpl" VAL_BLK 0xCA1C8 Kwb_Wu16 65535.00 OneToOne 0.00 65535.00 FORMAT "%8.2" NUMBER 4 /end CHARACTERISTIC
/begin CHARACTERISTIC DSM_CDKDfp_LSUCDCircNernst0_C "Kundenspezifischer Fehlercode fuer Fehlerpfad Dfp_LSUCDCircNernst0" VAL_BLK 0xCA1D0 Kwb_Wu16 65535.00 OneToOne 0.00 65535.00 FORMAT "%8.2" NUMBER 4 /end CHARACTERISTIC
/begin CHARACTERISTIC DSM_CDKDfp_LSUCDCircPumpCur0_C "Kundenspezifischer Fehlercode fuer Fehlerpfad Dfp_LSUCDCircPumpCur0" VAL_BLK 0xCA1D8 Kwb_Wu16 65535.00 OneToOne 0.00 65535.00 FORMAT "%8.2" NUMBER 4 /end CHARACTERISTIC
/begin CHARACTERISTIC DSM_CDKDfp_LSUCDCircVirtGnd0_C "Kundenspezifischer Fehlercode fuer Fehlerpfad Dfp_LSUCDCircVirtGnd0" VAL_BLK 0xCA1E0 Kwb_Wu16 65535.00 OneToOne 0.00 65535.00 FORMAT "%8.2" NUMBER 4 /end CHARACTERISTIC
/begin CHARACTERISTIC DSM_CDKDfp_LSUCDHeater0_C "Kundenspezifischer Fehlercode fuer Fehlerpfad Dfp_LSUCDHeater0" VAL_BLK 0xCA1E8 Kwb_Wu16 65535.00 OneToOne 0.00 65535.00 FORMAT "%8.2" NUMBER 4 /end CHARACTERISTIC
/begin CHARACTERISTIC DSM_CDKDfp_LSUCDHtCoup0_C "Kundenspezifischer Fehlercode fuer Fehlerpfad Dfp_LSUCDHtCoup0" VAL_BLK 0xCA1F0 Kwb_Wu16 65535.00 OneToOne 0.00 65535.00 FORMAT "%8.2" NUMBER 4 /end CHARACTERISTIC
/begin CHARACTERISTIC DSM_CDKDfp_LSUCDO20_C "Kundenspezifischer Fehlercode fuer Fehlerpfad Dfp_LSUCDO20" VAL_BLK 0xCA1F8 Kwb_Wu16 65535.00 OneToOne 0.00 65535.00 FORMAT "%8.2" NUMBER 4 /end CHARACTERISTIC
/begin CHARACTERISTIC DSM_CDKDfp_LSUCDO2Clb0_C "Kundenspezifischer Fehlercode fuer Fehlerpfad Dfp_LSUCDO2Clb0" VAL_BLK 0xCA200 Kwb_Wu16 65535.00 OneToOne 0.00 65535.00 FORMAT "%8.2" NUMBER 4 /end CHARACTERISTIC
/begin CHARACTERISTIC DSM_CDKDfp_LSUCDRiClb0_C "Kundenspezifischer Fehlercode fuer Fehlerpfad Dfp_LSUCDRiClb0" VAL_BLK 0xCA208 Kwb_Wu16 65535.00 OneToOne 0.00 65535.00 FORMAT "%8.2" NUMBER 4 /end CHARACTERISTIC
/begin CHARACTERISTIC DSM_CDKDfp_LSUCDSPI0_C "Kundenspezifischer Fehlercode fuer Fehlerpfad Dfp_LSUCDSPI0" VAL_BLK 0xCA210 Kwb_Wu16 65535.00 OneToOne 0.00 65535.00 FORMAT "%8.2" NUMBER 4 /end CHARACTERISTIC
/begin CHARACTERISTIC DSM_CDKDfp_LSUCDSPIBattLow0_C "Kundenspezifischer Fehlercode fuer Fehlerpfad Dfp_LSUCDSPIBattLow0" VAL_BLK 0xCA218 Kwb_Wu16 65535.00 OneToOne 0.00 65535.00 FORMAT "%8.2" NUMBER 4 /end CHARACTERISTIC
/begin CHARACTERISTIC DSM_CDKDfp_LSUCDWireIP0_C "Kundenspezifischer Fehlercode fuer Fehlerpfad Dfp_LSUCDWireIP0" VAL_BLK 0xCA220 Kwb_Wu16 65535.00 OneToOne 0.00 65535.00 FORMAT "%8.2" NUMBER 4 /end CHARACTERISTIC
/begin CHARACTERISTIC DSM_CDKDfp_LSUCtlRiExc0_C "Kundenspezifischer Fehlercode fuer Fehlerpfad Dfp_LSUCtlRiExc0" VAL_BLK 0xCA228 Kwb_Wu16 65535.00 OneToOne 0.00 65535.00 FORMAT "%8.2" NUMBER 4 /end CHARACTERISTIC
/begin CHARACTERISTIC DSM_CDKDfp_LSUMon1Sens_C "Kundenspezifischer Fehlercode fuer Fehlerpfad Dfp_LSUMon1Sens" VAL_BLK 0xCA230 Kwb_Wu16 65535.00 OneToOne 0.00 65535.00 FORMAT "%8.2" NUMBER 4 /end CHARACTERISTIC
/begin CHARACTERISTIC DSM_CDKDfp_LSUMon2Sens_C "Kundenspezifischer Fehlercode fuer Fehlerpfad Dfp_LSUMon2Sens" VAL_BLK 0xCA238 Kwb_Wu16 65535.00 OneToOne 0.00 65535.00 FORMAT "%8.2" NUMBER 4 /end CHARACTERISTIC
/begin CHARACTERISTIC DSM_CDKDfp_LubCD_C "Kundenspezifischer Fehlercode fuer Fehlerpfad Dfp_LubCD" VAL_BLK 0xCA240 Kwb_Wu16 65535.00 OneToOne 0.00 65535.00 FORMAT "%8.2" NUMBER 4 /end CHARACTERISTIC
/begin CHARACTERISTIC DSM_CDKDfp_MIL_C "Kundenspezifischer Fehlercode fuer Fehlerpfad Dfp_MIL" VAL_BLK 0xCA248 Kwb_Wu16 65535.00 OneToOne 0.00 65535.00 FORMAT "%8.2" NUMBER 4 /end CHARACTERISTIC
/begin CHARACTERISTIC DSM_CDKDfp_MRlyCD_C "Kundenspezifischer Fehlercode fuer Fehlerpfad Dfp_MRlyCD" VAL_BLK 0xCA250 Kwb_Wu16 65535.00 OneToOne 0.00 65535.00 FORMAT "%8.2" NUMBER 4 /end CHARACTERISTIC
/begin CHARACTERISTIC DSM_CDKDfp_MSidCD_Comm_C "Kundenspezifischer Fehlercode fuer Fehlerpfad Dfp_MSidCD_Comm" VAL_BLK 0xCA258 Kwb_Wu16 65535.00 OneToOne 0.00 65535.00 FORMAT "%8.2" NUMBER 4 /end CHARACTERISTIC
/begin CHARACTERISTIC DSM_CDKDfp_MSidCD_Pin_C "Kundenspezifischer Fehlercode fuer Fehlerpfad Dfp_MSidCD_Pin" VAL_BLK 0xCA260 Kwb_Wu16 65535.00 OneToOne 0.00 65535.00 FORMAT "%8.2" NUMBER 4 /end CHARACTERISTIC
/begin CHARACTERISTIC DSM_CDKDfp_MSidCD_Sel_INI_C "Kundenspezifischer Fehlercode fuer Fehlerpfad Dfp_MSidCD_Sel_INI" VAL_BLK 0xCA268 Kwb_Wu16 65535.00 OneToOne 0.00 65535.00 FORMAT "%8.2" NUMBER 4 /end CHARACTERISTIC
/begin CHARACTERISTIC DSM_CDKDfp_MSidCD_Select_C "Kundenspezifischer Fehlercode fuer Fehlerpfad Dfp_MSidCD_Select" VAL_BLK 0xCA270 Kwb_Wu16 65535.00 OneToOne 0.00 65535.00 FORMAT "%8.2" NUMBER 4 /end CHARACTERISTIC
/begin CHARACTERISTIC DSM_CDKDfp_MeUnCDNoLoad_C "Kundenspezifischer Fehlercode fuer Fehlerpfad Dfp_MeUnCDNoLoad" VAL_BLK 0xCA278 Kwb_Wu16 65535.00 OneToOne 0.00 65535.00 FORMAT "%8.2" NUMBER 4 /end CHARACTERISTIC
/begin CHARACTERISTIC DSM_CDKDfp_MeUnCDSCBat_C "Kundenspezifischer Fehlercode fuer Fehlerpfad Dfp_MeUnCDSCBat" VAL_BLK 0xCA280 Kwb_Wu16 65535.00 OneToOne 0.00 65535.00 FORMAT "%8.2" NUMBER 4 /end CHARACTERISTIC
/begin CHARACTERISTIC DSM_CDKDfp_MeUnCDSCGnd_C "Kundenspezifischer Fehlercode fuer Fehlerpfad Dfp_MeUnCDSCGnd" VAL_BLK 0xCA288 Kwb_Wu16 65535.00 OneToOne 0.00 65535.00 FORMAT "%8.2" NUMBER 4 /end CHARACTERISTIC
/begin CHARACTERISTIC DSM_CDKDfp_MeUnCD_ADC_C "Kundenspezifischer Fehlercode fuer Fehlerpfad Dfp_MeUnCD_ADC" VAL_BLK 0xCA290 Kwb_Wu16 65535.00 OneToOne 0.00 65535.00 FORMAT "%8.2" NUMBER 4 /end CHARACTERISTIC
/begin CHARACTERISTIC DSM_CDKDfp_MeUnCD_SigTst_C "Kundenspezifischer Fehlercode fuer Fehlerpfad Dfp_MeUnCD_SigTst" VAL_BLK 0xCA298 Kwb_Wu16 65535.00 OneToOne 0.00 65535.00 FORMAT "%8.2" NUMBER 4 /end CHARACTERISTIC
/begin CHARACTERISTIC DSM_CDKDfp_Montr_C "Kundenspezifischer Fehlercode fuer Fehlerpfad Dfp_Montr" VAL_BLK 0xCA2A0 Kwb_Wu16 65535.00 OneToOne 0.00 65535.00 FORMAT "%8.2" NUMBER 4 /end CHARACTERISTIC
/begin CHARACTERISTIC DSM_CDKDfp_NetMngDeviceA_C "Kundenspezifischer Fehlercode fuer Fehlerpfad Dfp_NetMngDeviceB" VAL_BLK 0xCA2A8 Kwb_Wu16 65535.00 OneToOne 0.00 65535.00 FORMAT "%8.2" NUMBER 4 /end CHARACTERISTIC
/begin CHARACTERISTIC DSM_CDKDfp_NetMngDeviceB_C "Kundenspezifischer Fehlercode fuer Fehlerpfad Dfp_NetMngDeviceB" VAL_BLK 0xCA2B0 Kwb_Wu16 65535.00 OneToOne 0.00 65535.00 FORMAT "%8.2" NUMBER 4 /end CHARACTERISTIC
/begin CHARACTERISTIC DSM_CDKDfp_NetMngDeviceC_C "Kundenspezifischer Fehlercode fuer Fehlerpfad Dfp_NetMngDeviceC" VAL_BLK 0xCA2B8 Kwb_Wu16 65535.00 OneToOne 0.00 65535.00 FORMAT "%8.2" NUMBER 4 /end CHARACTERISTIC
/begin CHARACTERISTIC DSM_CDKDfp_OPSCD_Lamp_C "Kundenspezifischer Fehlercode fuer Fehlerpfad Dfp_OPSCD_Lamp" VAL_BLK 0xCA2C0 Kwb_Wu16 65535.00 OneToOne 0.00 65535.00 FORMAT "%8.2" NUMBER 4 /end CHARACTERISTIC
/begin CHARACTERISTIC DSM_CDKDfp_OPSCD_anain_C "Kundenspezifischer Fehlercode fuer Fehlerpfad Dfp_OPSCD_anain" VAL_BLK 0xCA2C8 Kwb_Wu16 65535.00 OneToOne 0.00 65535.00 FORMAT "%8.2" NUMBER 4 /end CHARACTERISTIC
/begin CHARACTERISTIC DSM_CDKDfp_OTSCD_C "Kundenspezifischer Fehlercode fuer Fehlerpfad Dfp_OTSCD" VAL_BLK 0xCA2D0 Kwb_Wu16 65535.00 OneToOne 0.00 65535.00 FORMAT "%8.2" NUMBER 4 /end CHARACTERISTIC
/begin CHARACTERISTIC DSM_CDKDfp_OvRMon_C "Kundenspezifischer Fehlercode fuer Fehlerpfad Dfp_OvRMon" VAL_BLK 0xCA2D8 Kwb_Wu16 65535.00 OneToOne 0.00 65535.00 FORMAT "%8.2" NUMBER 4 /end CHARACTERISTIC
/begin CHARACTERISTIC DSM_CDKDfp_OvRMonBrk_C "Kundenspezifischer Fehlercode fuer Fehlerpfad Dfp_OvRMonBrk" VAL_BLK 0xCA2E0 Kwb_Wu16 65535.00 OneToOne 0.00 65535.00 FORMAT "%8.2" NUMBER 4 /end CHARACTERISTIC
/begin CHARACTERISTIC DSM_CDKDfp_OvRMonSigA_C "Kundenspezifischer Fehlercode fuer Fehlerpfad Dfp_OvRMonSigA" VAL_BLK 0xCA2E8 Kwb_Wu16 65535.00 OneToOne 0.00 65535.00 FORMAT "%8.2" NUMBER 4 /end CHARACTERISTIC
/begin CHARACTERISTIC DSM_CDKDfp_OxiCCDTPre_C "Kundenspezifischer Fehlercode fuer Fehlerpfad Dfp_OxiCCDTPre" VAL_BLK 0xCA2F0 Kwb_Wu16 65535.00 OneToOne 0.00 65535.00 FORMAT "%8.2" NUMBER 4 /end CHARACTERISTIC
/begin CHARACTERISTIC DSM_CDKDfp_PCR_GovDevNeg_C "Kundenspezifischer Fehlercode fuer Fehlerpfad Dfp_PCR_GovDevNeg" VAL_BLK 0xCA2F8 Kwb_Wu16 65535.00 OneToOne 0.00 65535.00 FORMAT "%8.2" NUMBER 4 /end CHARACTERISTIC
/begin CHARACTERISTIC DSM_CDKDfp_PCR_GovDevPos_C "Kundenspezifischer Fehlercode fuer Fehlerpfad Dfp_PCR_GovDevPos" VAL_BLK 0xCA300 Kwb_Wu16 65535.00 OneToOne 0.00 65535.00 FORMAT "%8.2" NUMBER 4 /end CHARACTERISTIC
/begin CHARACTERISTIC DSM_CDKDfp_PCVCDNoLoad_C "Kundenspezifischer Fehlercode fuer Fehlerpfad Dfp_PCVCDNoLoad" VAL_BLK 0xCA308 Kwb_Wu16 65535.00 OneToOne 0.00 65535.00 FORMAT "%8.2" NUMBER 4 /end CHARACTERISTIC
/begin CHARACTERISTIC DSM_CDKDfp_PCVCDSCBat_C "Kundenspezifischer Fehlercode fuer Fehlerpfad Dfp_PCVCDSCBat" VAL_BLK 0xCA310 Kwb_Wu16 65535.00 OneToOne 0.00 65535.00 FORMAT "%8.2" NUMBER 4 /end CHARACTERISTIC
/begin CHARACTERISTIC DSM_CDKDfp_PCVCDSCGnd_C "Kundenspezifischer Fehlercode fuer Fehlerpfad Dfp_PCVCDSCGnd" VAL_BLK 0xCA318 Kwb_Wu16 65535.00 OneToOne 0.00 65535.00 FORMAT "%8.2" NUMBER 4 /end CHARACTERISTIC
/begin CHARACTERISTIC DSM_CDKDfp_PCVCD_ADC_C "Kundenspezifischer Fehlercode fuer Fehlerpfad Dfp_PCVCD_ADC" VAL_BLK 0xCA320 Kwb_Wu16 65535.00 OneToOne 0.00 65535.00 FORMAT "%8.2" NUMBER 4 /end CHARACTERISTIC
/begin CHARACTERISTIC DSM_CDKDfp_PCVCD_SigTst_C "Kundenspezifischer Fehlercode fuer Fehlerpfad Dfp_PCVCD_SigTst" VAL_BLK 0xCA328 Kwb_Wu16 65535.00 OneToOne 0.00 65535.00 FORMAT "%8.2" NUMBER 4 /end CHARACTERISTIC
/begin CHARACTERISTIC DSM_CDKDfp_PFltAPSens_C "Kundenspezifischer Fehlercode fuer Fehlerpfad Dfp_PFltAPSens" VAL_BLK 0xCA330 Kwb_Wu16 65535.00 OneToOne 0.00 65535.00 FORMAT "%8.2" NUMBER 4 /end CHARACTERISTIC
/begin CHARACTERISTIC DSM_CDKDfp_PFltCDPPre_C "Kundenspezifischer Fehlercode fuer Fehlerpfad Dfp_PFltCDPPre" VAL_BLK 0xCA338 Kwb_Wu16 65535.00 OneToOne 0.00 65535.00 FORMAT "%8.2" NUMBER 4 /end CHARACTERISTIC
/begin CHARACTERISTIC DSM_CDKDfp_PFltCDTempPre_C "Kundenspezifischer Fehlercode fuer Fehlerpfad Dfp_PFltCDTempPre" VAL_BLK 0xCA340 Kwb_Wu16 65535.00 OneToOne 0.00 65535.00 FORMAT "%8.2" NUMBER 4 /end CHARACTERISTIC
/begin CHARACTERISTIC DSM_CDKDfp_PFltChar_C "Kundenspezifischer Fehlercode fuer Fehlerpfad Dfp_PFltChar" VAL_BLK 0xCA348 Kwb_Wu16 65535.00 OneToOne 0.00 65535.00 FORMAT "%8.2" NUMBER 4 /end CHARACTERISTIC
/begin CHARACTERISTIC DSM_CDKDfp_PFltEngPrt_C "Kundenspezifischer Fehlercode fuer Fehlerpfad Dfp_PFltEngPrt" VAL_BLK 0xCA350 Kwb_Wu16 65535.00 OneToOne 0.00 65535.00 FORMAT "%8.2" NUMBER 4 /end CHARACTERISTIC
/begin CHARACTERISTIC DSM_CDKDfp_PFltPresDynPlaus_C "Kundenspezifischer Fehlercode fuer Fehlerpfad Dfp_PFltPresDynPlaus" VAL_BLK 0xCA358 Kwb_Wu16 65535.00 OneToOne 0.00 65535.00 FORMAT "%8.2" NUMBER 4 /end CHARACTERISTIC
/begin CHARACTERISTIC DSM_CDKDfp_PFltPresSens_C "Kundenspezifischer Fehlercode fuer Fehlerpfad Dfp_PFltPresSens" VAL_BLK 0xCA360 Kwb_Wu16 65535.00 OneToOne 0.00 65535.00 FORMAT "%8.2" NUMBER 4 /end CHARACTERISTIC
/begin CHARACTERISTIC DSM_CDKDfp_PFltPresSensFrz_C "Kundenspezifischer Fehlercode fuer Fehlerpfad Dfp_PFltPresSensFrz" VAL_BLK 0xCA368 Kwb_Wu16 65535.00 OneToOne 0.00 65535.00 FORMAT "%8.2" NUMBER 4 /end CHARACTERISTIC
/begin CHARACTERISTIC DSM_CDKDfp_PFltPresSensHsLn_C "Kundenspezifischer Fehlercode fuer Fehlerpfad Dfp_PFltPresSensHsLn" VAL_BLK 0xCA370 Kwb_Wu16 65535.00 OneToOne 0.00 65535.00 FORMAT "%8.2" NUMBER 4 /end CHARACTERISTIC
/begin CHARACTERISTIC DSM_CDKDfp_PFltPresSensSot_C "Kundenspezifischer Fehlercode fuer Fehlerpfad Dfp_PFltPresSensSot" VAL_BLK 0xCA378 Kwb_Wu16 65535.00 OneToOne 0.00 65535.00 FORMAT "%8.2" NUMBER 4 /end CHARACTERISTIC
/begin CHARACTERISTIC DSM_CDKDfp_PFltRgnPerm_C "Kundenspezifischer Fehlercode fuer Fehlerpfad Dfp_PFltRgnPerm" VAL_BLK 0xCA380 Kwb_Wu16 65535.00 OneToOne 0.00 65535.00 FORMAT "%8.2" NUMBER 4 /end CHARACTERISTIC
/begin CHARACTERISTIC DSM_CDKDfp_PFltTempDwnStrm_C "Kundenspezifischer Fehlercode fuer Fehlerpfad Dfp_PFltTempDwnStrm" VAL_BLK 0xCA388 Kwb_Wu16 65535.00 OneToOne 0.00 65535.00 FORMAT "%8.2" NUMBER 4 /end CHARACTERISTIC
/begin CHARACTERISTIC DSM_CDKDfp_PFltTempSens_C "Kundenspezifischer Fehlercode fuer Fehlerpfad Dfp_PFltTempSens" VAL_BLK 0xCA390 Kwb_Wu16 65535.00 OneToOne 0.00 65535.00 FORMAT "%8.2" NUMBER 4 /end CHARACTERISTIC
/begin CHARACTERISTIC DSM_CDKDfp_PFltTempUpStrm_C "Kundenspezifischer Fehlercode fuer Fehlerpfad Dfp_PFltTempUpStrm" VAL_BLK 0xCA398 Kwb_Wu16 65535.00 OneToOne 0.00 65535.00 FORMAT "%8.2" NUMBER 4 /end CHARACTERISTIC
/begin CHARACTERISTIC DSM_CDKDfp_PFltmSotDiffMax_C "Kundenspezifischer Fehlercode fuer Fehlerpfad Dfp_PFltmSotDiffMax" VAL_BLK 0xCA3A0 Kwb_Wu16 65535.00 OneToOne 0.00 65535.00 FORMAT "%8.2" NUMBER 4 /end CHARACTERISTIC
/begin CHARACTERISTIC DSM_CDKDfp_PSPCD_Actr_C "Kundenspezifischer Fehlercode fuer Fehlerpfad Dfp_PSPCD_Actr" VAL_BLK 0xCA3A8 Kwb_Wu16 65535.00 OneToOne 0.00 65535.00 FORMAT "%8.2" NUMBER 4 /end CHARACTERISTIC
/begin CHARACTERISTIC DSM_CDKDfp_QLTCD_C "Kundenspezifischer Fehlercode fuer Fehlerpfad Dfp_QLTCD" VAL_BLK 0xCA3B0 Kwb_Wu16 65535.00 OneToOne 0.00 65535.00 FORMAT "%8.2" NUMBER 4 /end CHARACTERISTIC
/begin CHARACTERISTIC DSM_CDKDfp_RailCD_C "Kundenspezifischer Fehlercode fuer Fehlerpfad Dfp_RailCD" VAL_BLK 0xCA3B8 Kwb_Wu16 65535.00 OneToOne 0.00 65535.00 FORMAT "%8.2" NUMBER 4 /end CHARACTERISTIC
/begin CHARACTERISTIC DSM_CDKDfp_RailCDOfsTst_C "Kundenspezifischer Fehlercode fuer Fehlerpfad Dfp_RailCDOfsTst" VAL_BLK 0xCA3C0 Kwb_Wu16 65535.00 OneToOne 0.00 65535.00 FORMAT "%8.2" NUMBER 4 /end CHARACTERISTIC
/begin CHARACTERISTIC DSM_CDKDfp_RailCD_PMonStrt_C "Kundenspezifischer Fehlercode fuer Fehlerpfad Dfp_RailCD_PMonStrt" VAL_BLK 0xCA3C8 Kwb_Wu16 65535.00 OneToOne 0.00 65535.00 FORMAT "%8.2" NUMBER 4 /end CHARACTERISTIC
/begin CHARACTERISTIC DSM_CDKDfp_RailCtlModeMeUnDiag_C "Kundenspezifischer Fehlercode fuer Fehlerpfad Dfp_RailCtlModeMeUnDiag" VAL_BLK 0xCA3D0 Kwb_Wu16 65535.00 OneToOne 0.00 65535.00 FORMAT "%8.2" NUMBER 4 /end CHARACTERISTIC
/begin CHARACTERISTIC DSM_CDKDfp_RailCtlModePCVDiag_C "Kundenspezifischer Fehlercode fuer Fehlerpfad Dfp_RailCtlModePCVDiag" VAL_BLK 0xCA3D8 Kwb_Wu16 65535.00 OneToOne 0.00 65535.00 FORMAT "%8.2" NUMBER 4 /end CHARACTERISTIC
/begin CHARACTERISTIC DSM_CDKDfp_RailMeUn0_C "Kundenspezifischer Fehlercode fuer Fehlerpfad Dfp_RailMeUn0" VAL_BLK 0xCA3E0 Kwb_Wu16 65535.00 OneToOne 0.00 65535.00 FORMAT "%8.2" NUMBER 4 /end CHARACTERISTIC
/begin CHARACTERISTIC DSM_CDKDfp_RailMeUn1_C "Kundenspezifischer Fehlercode fuer Fehlerpfad Dfp_RailMeUn1" VAL_BLK 0xCA3E8 Kwb_Wu16 65535.00 OneToOne 0.00 65535.00 FORMAT "%8.2" NUMBER 4 /end CHARACTERISTIC
/begin CHARACTERISTIC DSM_CDKDfp_RailMeUn2_C "Kundenspezifischer Fehlercode fuer Fehlerpfad Dfp_RailMeUn2" VAL_BLK 0xCA3F0 Kwb_Wu16 65535.00 OneToOne 0.00 65535.00 FORMAT "%8.2" NUMBER 4 /end CHARACTERISTIC
/begin CHARACTERISTIC DSM_CDKDfp_RailMeUn3_C "Kundenspezifischer Fehlercode fuer Fehlerpfad Dfp_RailMeUn3" VAL_BLK 0xCA3F8 Kwb_Wu16 65535.00 OneToOne 0.00 65535.00 FORMAT "%8.2" NUMBER 4 /end CHARACTERISTIC
/begin CHARACTERISTIC DSM_CDKDfp_RailMeUn4_C "Kundenspezifischer Fehlercode fuer Fehlerpfad Dfp_RailMeUn4" VAL_BLK 0xCA400 Kwb_Wu16 65535.00 OneToOne 0.00 65535.00 FORMAT "%8.2" NUMBER 4 /end CHARACTERISTIC
/begin CHARACTERISTIC DSM_CDKDfp_RailPCV0_C "Kundenspezifischer Fehlercode fuer Fehlerpfad Dfp_RailPCV0" VAL_BLK 0xCA408 Kwb_Wu16 65535.00 OneToOne 0.00 65535.00 FORMAT "%8.2" NUMBER 4 /end CHARACTERISTIC
/begin CHARACTERISTIC DSM_CDKDfp_RailPCV1_C "Kundenspezifischer Fehlercode fuer Fehlerpfad Dfp_RailPCV1" VAL_BLK 0xCA410 Kwb_Wu16 65535.00 OneToOne 0.00 65535.00 FORMAT "%8.2" NUMBER 4 /end CHARACTERISTIC
/begin CHARACTERISTIC DSM_CDKDfp_RailPCV2_C "Kundenspezifischer Fehlercode fuer Fehlerpfad Dfp_RailPCV2" VAL_BLK 0xCA418 Kwb_Wu16 65535.00 OneToOne 0.00 65535.00 FORMAT "%8.2" NUMBER 4 /end CHARACTERISTIC
/begin CHARACTERISTIC DSM_CDKDfp_RailPCV3_C "Kundenspezifischer Fehlercode fuer Fehlerpfad Dfp_RailPCV3" VAL_BLK 0xCA420 Kwb_Wu16 65535.00 OneToOne 0.00 65535.00 FORMAT "%8.2" NUMBER 4 /end CHARACTERISTIC
/begin CHARACTERISTIC DSM_CDKDfp_RailPCV4_C "Kundenspezifischer Fehlercode fuer Fehlerpfad Dfp_RailPCV4" VAL_BLK 0xCA428 Kwb_Wu16 65535.00 OneToOne 0.00 65535.00 FORMAT "%8.2" NUMBER 4 /end CHARACTERISTIC
/begin CHARACTERISTIC DSM_CDKDfp_RailPCV5_C "Kundenspezifischer Fehlercode fuer Fehlerpfad Dfp_RailPCV5" VAL_BLK 0xCA430 Kwb_Wu16 65535.00 OneToOne 0.00 65535.00 FORMAT "%8.2" NUMBER 4 /end CHARACTERISTIC
/begin CHARACTERISTIC DSM_CDKDfp_SOPTst_C "Kundenspezifischer Fehlercode fuer Fehlerpfad Dfp_SOPTst" VAL_BLK 0xCA438 Kwb_Wu16 65535.00 OneToOne 0.00 65535.00 FORMAT "%8.2" NUMBER 4 /end CHARACTERISTIC
/begin CHARACTERISTIC DSM_CDKDfp_SSpMon1_C "Kundenspezifischer Fehlercode fuer Fehlerpfad Dfp_SSpMon1" VAL_BLK 0xCA440 Kwb_Wu16 65535.00 OneToOne 0.00 65535.00 FORMAT "%8.2" NUMBER 4 /end CHARACTERISTIC
/begin CHARACTERISTIC DSM_CDKDfp_SSpMon2_C "Kundenspezifischer Fehlercode fuer Fehlerpfad Dfp_SSpMon2" VAL_BLK 0xCA448 Kwb_Wu16 65535.00 OneToOne 0.00 65535.00 FORMAT "%8.2" NUMBER 4 /end CHARACTERISTIC
/begin CHARACTERISTIC DSM_CDKDfp_SSpMon3_C "Kundenspezifischer Fehlercode fuer Fehlerpfad Dfp_SSpMon3" VAL_BLK 0xCA450 Kwb_Wu16 65535.00 OneToOne 0.00 65535.00 FORMAT "%8.2" NUMBER 4 /end CHARACTERISTIC
/begin CHARACTERISTIC DSM_CDKDfp_SWChk_CycSigChkDat_C "Kundenspezifischer Fehlercode fuer Fehlerpfad Dfp_SWChk_CycSigChkDat" VAL_BLK 0xCA458 Kwb_Wu16 65535.00 OneToOne 0.00 65535.00 FORMAT "%8.2" NUMBER 4 /end CHARACTERISTIC
/begin CHARACTERISTIC DSM_CDKDfp_SWChk_CycSigChkPrg_C "Kundenspezifischer Fehlercode fuer Fehlerpfad Dfp_SWChk_CycSigChkPrg" VAL_BLK 0xCA460 Kwb_Wu16 65535.00 OneToOne 0.00 65535.00 FORMAT "%8.2" NUMBER 4 /end CHARACTERISTIC
/begin CHARACTERISTIC DSM_CDKDfp_ShutCD_C "Kundenspezifischer Fehlercode fuer Fehlerpfad Dfp_ShutCD" VAL_BLK 0xCA468 Kwb_Wu16 65535.00 OneToOne 0.00 65535.00 FORMAT "%8.2" NUMBER 4 /end CHARACTERISTIC
/begin CHARACTERISTIC DSM_CDKDfp_StSysTrqShutOff_C "Kundenspezifischer Fehlercode fuer Fehlerpfad Dfp_StSysTrqShutOff" VAL_BLK 0xCA470 Kwb_Wu16 65535.00 OneToOne 0.00 65535.00 FORMAT "%8.2" NUMBER 4 /end CHARACTERISTIC
/begin CHARACTERISTIC DSM_CDKDfp_StrtCD_Actr_C "Kundenspezifischer Fehlercode fuer Fehlerpfad Dfp_StrtCD_Actr" VAL_BLK 0xCA478 Kwb_Wu16 65535.00 OneToOne 0.00 65535.00 FORMAT "%8.2" NUMBER 4 /end CHARACTERISTIC
/begin CHARACTERISTIC DSM_CDKDfp_SysLamp_C "Kundenspezifischer Fehlercode fuer Fehlerpfad Dfp_SysLamp" VAL_BLK 0xCA480 Kwb_Wu16 65535.00 OneToOne 0.00 65535.00 FORMAT "%8.2" NUMBER 4 /end CHARACTERISTIC
/begin CHARACTERISTIC DSM_CDKDfp_T15CD_C "Kundenspezifischer Fehlercode fuer Fehlerpfad Dfp_T15CD" VAL_BLK 0xCA488 Kwb_Wu16 65535.00 OneToOne 0.00 65535.00 FORMAT "%8.2" NUMBER 4 /end CHARACTERISTIC
/begin CHARACTERISTIC DSM_CDKDfp_TGearbx_C "Kundenspezifischer Fehlercode fuer Fehlerpfad Dfp_TGearbx" VAL_BLK 0xCA490 Kwb_Wu16 65535.00 OneToOne 0.00 65535.00 FORMAT "%8.2" NUMBER 4 /end CHARACTERISTIC
/begin CHARACTERISTIC DSM_CDKDfp_TPUMon_C "Kundenspezifischer Fehlercode fuer Fehlerpfad Dfp_TPUMon" VAL_BLK 0xCA498 Kwb_Wu16 65535.00 OneToOne 0.00 65535.00 FORMAT "%8.2" NUMBER 4 /end CHARACTERISTIC
/begin CHARACTERISTIC DSM_CDKDfp_TVACD_Max_C "Kundenspezifischer Fehlercode fuer Fehlerpfad Dfp_TVACD_Max" VAL_BLK 0xCA4A0 Kwb_Wu16 65535.00 OneToOne 0.00 65535.00 FORMAT "%8.2" NUMBER 4 /end CHARACTERISTIC
/begin CHARACTERISTIC DSM_CDKDfp_TVACD_Min_C "Kundenspezifischer Fehlercode fuer Fehlerpfad Dfp_TVACD_Min" VAL_BLK 0xCA4A8 Kwb_Wu16 65535.00 OneToOne 0.00 65535.00 FORMAT "%8.2" NUMBER 4 /end CHARACTERISTIC
/begin CHARACTERISTIC DSM_CDKDfp_TVACD_SigNpl_C "Kundenspezifischer Fehlercode fuer Fehlerpfad Dfp_TVACD_SigNpl" VAL_BLK 0xCA4B0 Kwb_Wu16 65535.00 OneToOne 0.00 65535.00 FORMAT "%8.2" NUMBER 4 /end CHARACTERISTIC
/begin CHARACTERISTIC DSM_CDKDfp_TVACD_TVADia1_C "Kundenspezifischer Fehlercode fuer Fehlerpfad Dfp_TVACD_TVADia1" VAL_BLK 0xCA4B8 Kwb_Wu16 65535.00 OneToOne 0.00 65535.00 FORMAT "%8.2" NUMBER 4 /end CHARACTERISTIC
/begin CHARACTERISTIC DSM_CDKDfp_TVACD_TVADia2_C "Kundenspezifischer Fehlercode fuer Fehlerpfad Dfp_TVACD_TVADia2" VAL_BLK 0xCA4C0 Kwb_Wu16 65535.00 OneToOne 0.00 65535.00 FORMAT "%8.2" NUMBER 4 /end CHARACTERISTIC
/begin CHARACTERISTIC DSM_CDKDfp_TVACD_TVADia3_C "Kundenspezifischer Fehlercode fuer Fehlerpfad Dfp_TVACD_TVADia3" VAL_BLK 0xCA4C8 Kwb_Wu16 65535.00 OneToOne 0.00 65535.00 FORMAT "%8.2" NUMBER 4 /end CHARACTERISTIC
/begin CHARACTERISTIC DSM_CDKDfp_TVACD_TVADia4_C "Kundenspezifischer Fehlercode fuer Fehlerpfad Dfp_TVACD_TVADia4" VAL_BLK 0xCA4D0 Kwb_Wu16 65535.00 OneToOne 0.00 65535.00 FORMAT "%8.2" NUMBER 4 /end CHARACTERISTIC
/begin CHARACTERISTIC DSM_CDKDfp_VSACD_DioInDia1_C "Kundenspezifischer Fehlercode fuer Fehlerpfad Dfp_VSACD_DioInDia1" VAL_BLK 0xCA4D8 Kwb_Wu16 65535.00 OneToOne 0.00 65535.00 FORMAT "%8.2" NUMBER 4 /end CHARACTERISTIC
/begin CHARACTERISTIC DSM_CDKDfp_VSACD_DioInDia2_C "Kundenspezifischer Fehlercode fuer Fehlerpfad Dfp_VSACD_DioInDia2" VAL_BLK 0xCA4E0 Kwb_Wu16 65535.00 OneToOne 0.00 65535.00 FORMAT "%8.2" NUMBER 4 /end CHARACTERISTIC
/begin CHARACTERISTIC DSM_CDKDfp_VSACD_DioInDia3_C "Kundenspezifischer Fehlercode fuer Fehlerpfad Dfp_VSACD_DioInDia3" VAL_BLK 0xCA4E8 Kwb_Wu16 65535.00 OneToOne 0.00 65535.00 FORMAT "%8.2" NUMBER 4 /end CHARACTERISTIC
/begin CHARACTERISTIC DSM_CDKDfp_VSACD_DioInDia4_C "Kundenspezifischer Fehlercode fuer Fehlerpfad Dfp_VSACD_DioInDia4" VAL_BLK 0xCA4F0 Kwb_Wu16 65535.00 OneToOne 0.00 65535.00 FORMAT "%8.2" NUMBER 4 /end CHARACTERISTIC
/begin CHARACTERISTIC DSM_CDKDfp_VSACD_DioInMin_C "Kundenspezifischer Fehlercode fuer Fehlerpfad Dfp_VSACD_DioInMin" VAL_BLK 0xCA4F8 Kwb_Wu16 65535.00 OneToOne 0.00 65535.00 FORMAT "%8.2" NUMBER 4 /end CHARACTERISTIC
/begin CHARACTERISTIC DSM_CDKDfp_VSACD_Max_C "Kundenspezifischer Fehlercode fuer Fehlerpfad Dfp_VSACD_Max" VAL_BLK 0xCA500 Kwb_Wu16 65535.00 OneToOne 0.00 65535.00 FORMAT "%8.2" NUMBER 4 /end CHARACTERISTIC
/begin CHARACTERISTIC DSM_CDKDfp_VSACD_Min_C "Kundenspezifischer Fehlercode fuer Fehlerpfad Dfp_VSACD_Min" VAL_BLK 0xCA508 Kwb_Wu16 65535.00 OneToOne 0.00 65535.00 FORMAT "%8.2" NUMBER 4 /end CHARACTERISTIC
/begin CHARACTERISTIC DSM_CDKDfp_VSACD_SigNpl_C "Kundenspezifischer Fehlercode fuer Fehlerpfad Dfp_VSACD_SigNpl" VAL_BLK 0xCA510 Kwb_Wu16 65535.00 OneToOne 0.00 65535.00 FORMAT "%8.2" NUMBER 4 /end CHARACTERISTIC
/begin CHARACTERISTIC DSM_CDKDfp_VSACD_VSADia1_C "Kundenspezifischer Fehlercode fuer Fehlerpfad Dfp_VSACD_VSADia1" VAL_BLK 0xCA518 Kwb_Wu16 65535.00 OneToOne 0.00 65535.00 FORMAT "%8.2" NUMBER 4 /end CHARACTERISTIC
/begin CHARACTERISTIC DSM_CDKDfp_VSACD_VSADia2_C "Kundenspezifischer Fehlercode fuer Fehlerpfad Dfp_VSACD_VSADia2" VAL_BLK 0xCA520 Kwb_Wu16 65535.00 OneToOne 0.00 65535.00 FORMAT "%8.2" NUMBER 4 /end CHARACTERISTIC
/begin CHARACTERISTIC DSM_CDKDfp_VSACD_VSADia3_C "Kundenspezifischer Fehlercode fuer Fehlerpfad Dfp_VSACD_VSADia3" VAL_BLK 0xCA528 Kwb_Wu16 65535.00 OneToOne 0.00 65535.00 FORMAT "%8.2" NUMBER 4 /end CHARACTERISTIC
/begin CHARACTERISTIC DSM_CDKDfp_VSACD_VSADia4_C "Kundenspezifischer Fehlercode fuer Fehlerpfad Dfp_VSACD_VSADia4" VAL_BLK 0xCA530 Kwb_Wu16 65535.00 OneToOne 0.00 65535.00 FORMAT "%8.2" NUMBER 4 /end CHARACTERISTIC
/begin CHARACTERISTIC DSM_CDKDfp_VSSCD1_C "Kundenspezifischer Fehlercode fuer Fehlerpfad Dfp_VSSCD1" VAL_BLK 0xCA538 Kwb_Wu16 65535.00 OneToOne 0.00 65535.00 FORMAT "%8.2" NUMBER 4 /end CHARACTERISTIC
/begin CHARACTERISTIC DSM_CDKDfp_VSSCD2_C "Kundenspezifischer Fehlercode fuer Fehlerpfad Dfp_VSSCD2" VAL_BLK 0xCA540 Kwb_Wu16 65535.00 OneToOne 0.00 65535.00 FORMAT "%8.2" NUMBER 4 /end CHARACTERISTIC
/begin CHARACTERISTIC DSM_CDKDfp_WdCom_C "Kundenspezifischer Fehlercode fuer Fehlerpfad Dfp_WdCom" VAL_BLK 0xCA548 Kwb_Wu16 65535.00 OneToOne 0.00 65535.00 FORMAT "%8.2" NUMBER 4 /end CHARACTERISTIC
/begin FUNCTION dsm_auto_cdc ""
 /begin DEF_CHARACTERISTIC DSM_CDCDfp_Layer_TANS_C DSM_CDCDfp_ACCDCmpr_C DSM_CDCDfp_ACCDPres_C DSM_CDCDfp_ACCDPres1_C DSM_CDCDfp_ACCDPresAna_C DSM_CDCDfp_ACCDSwtin_C DSM_CDCDfp_ACC_PlausTrqDes_C DSM_CDCDfp_ACC_trqInr_C DSM_CDCDfp_ACTrq_C DSM_CDCDfp_ADCMon_C DSM_CDCDfp_AFSCDIdlAdjVal_C DSM_CDCDfp_AFSCDLdAdjVal_C DSM_CDCDfp_AFSCD_AirTempDcyc_C DSM_CDCDfp_AFSCD_PlOffsDrft_C DSM_CDCDfp_AFSCD_PlSetyDrft_C DSM_CDCDfp_AFSCD_SRCAirTemp_C DSM_CDCDfp_AFSCD_SRCBatt_C DSM_CDCDfp_AFSCD_SRCCorrAirm_C DSM_CDCDfp_AFSCD_SRCRawAirm_C DSM_CDCDfp_Layer_TUMG_C DSM_CDCDfp_AFSCD_SRCRefSigPer_C DSM_CDCDfp_AOHtCD_C DSM_CDCDfp_Layer_GEN_C DSM_CDCDfp_Layer_BSD_C DSM_CDCDfp_AOHtCD_AOHtDia1_C DSM_CDCDfp_AOHtCD_AOHtDia2_C DSM_CDCDfp_AOHtCD_AOHtDia3_C DSM_CDCDfp_APP1_C DSM_CDCDfp_APP2_C DSM_CDCDfp_APPSync_C DSM_CDCDfp_APSCD_C DSM_CDCDfp_ARS_C DSM_CDCDfp_AccPedPlausBrk_C DSM_CDCDfp_AirCtlPlateBreak_C DSM_CDCDfp_Layer_QLT_C DSM_CDCDfp_AirCtl_GovNegDev_C DSM_CDCDfp_Layer_IBS1_C DSM_CDCDfp_Layer_IBS2_C DSM_CDCDfp_Layer_IBS3_C DSM_CDCDfp_Layer_PMBN_C DSM_CDCDfp_Layer_PMBATT_C DSM_CDCDfp_AirCtl_GovNegDev2_C DSM_CDCDfp_AirCtl_GovPosDev_C DSM_CDCDfp_AirCtl_GovPosDev2_C DSM_CDCDfp_AltCD_C DSM_CDCDfp_AltCD_Load_C DSM_CDCDfp_BPACD_BPADia1_C DSM_CDCDfp_BPACD_BPADia2_C DSM_CDCDfp_BPACD_BPADia3_C DSM_CDCDfp_BPACD_Max_C DSM_CDCDfp_BPACD_Min_C DSM_CDCDfp_BPACD_SigNpl_C DSM_CDCDfp_BPSCD_C DSM_CDCDfp_BattCD_C DSM_CDCDfp_BrkCD_C DSM_CDCDfp_Bss_C DSM_CDCDfp_CBACD_C DSM_CDCDfp_CTSCD_C DSM_CDCDfp_Clg_DynTst_C DSM_CDCDfp_CmbChbMisfire1_C DSM_CDCDfp_CmbChbMisfire2_C DSM_CDCDfp_CmbChbMisfire3_C DSM_CDCDfp_CmbChbMisfire4_C DSM_CDCDfp_CmbChbMisfire5_C DSM_CDCDfp_CmbChbMisfire6_C DSM_CDCDfp_CmbChbMisfireMul_C DSM_CDCDfp_CoVMDCSh_C DSM_CDCDfp_ConvCD_C DSM_CDCDfp_CrCCDMFL_C DSM_CDCDfp_CrCtl_vCrCtl_C DSM_CDCDfp_Dummy1_C DSM_CDCDfp_EATSCD_C DSM_CDCDfp_EBAFCD_C DSM_CDCDfp_Layer_PMRUHVERL_C DSM_CDCDfp_EBFCD_C DSM_CDCDfp_EBTSCD_C DSM_CDCDfp_EBTSCD_OvrTemp_C DSM_CDCDfp_EEPCDVarMng_C DSM_CDCDfp_Layer_TOENS_C DSM_CDCDfp_Layer_MANHYDR_C DSM_CDCDfp_Layer_MANLUFT_C DSM_CDCDfp_EGPpCD_C DSM_CDCDfp_EGPpCDTPreTrbn_C DSM_CDCDfp_EGRCD_Max_C DSM_CDCDfp_EGRCD_Min_C DSM_CDCDfp_EGRCD_SigNpl_C DSM_CDCDfp_EGTRgnOilDil_C DSM_CDCDfp_EMCCDNoLoad1_C DSM_CDCDfp_EMCCDNoLoad2_C DSM_CDCDfp_EMCCDSCBat1_C DSM_CDCDfp_EMCCDSCBat2_C DSM_CDCDfp_EMCCDSCGnd1_C DSM_CDCDfp_EMCCDSCGnd2_C DSM_CDCDfp_EMCCD_ADC1_C DSM_CDCDfp_EMCCD_ADC2_C DSM_CDCDfp_ETClbETFltInj1_C DSM_CDCDfp_ETClbETFltInj2_C DSM_CDCDfp_ETClbETFltInj3_C DSM_CDCDfp_ETClbETFltInj4_C DSM_CDCDfp_ETClbETFltInj5_C DSM_CDCDfp_ETClbETFltInj6_C DSM_CDCDfp_ETClbInj1_C DSM_CDCDfp_ETClbInj2_C DSM_CDCDfp_ETClbInj3_C DSM_CDCDfp_ETClbInj4_C DSM_CDCDfp_ETClbInj5_C DSM_CDCDfp_ETClbInj6_C DSM_CDCDfp_EngMCaS1_C DSM_CDCDfp_EngMCrS1_C DSM_CDCDfp_EngMOfsCaSCrS_C DSM_CDCDfp_EngPrtFWODet_C DSM_CDCDfp_FBCqDvt_C DSM_CDCDfp_FMTC_NonMonotonMap_C DSM_CDCDfp_FTSCD_C DSM_CDCDfp_FanCD_C DSM_CDCDfp_FanCD_FanCtlr1_C DSM_CDCDfp_FanCD_FanCtlr2_C DSM_CDCDfp_FanCD_FanCtlr3_C DSM_CDCDfp_FlFCD_C DSM_CDCDfp_FlMngSmkDefect_C DSM_CDCDfp_FrmMngASC1_C DSM_CDCDfp_FrmMngASC2_C DSM_CDCDfp_FrmMngASC3_C DSM_CDCDfp_FrmMngASC4_C DSM_CDCDfp_FrmMngBOS_RESET_C DSM_CDCDfp_FrmMngBOS_RESET_2_C DSM_CDCDfp_FrmMngDMANFAFS_C DSM_CDCDfp_FrmMngDRMANFSSG_C DSM_CDCDfp_FrmMngEGS1_C DSM_CDCDfp_FrmMngEGS2_C DSM_CDCDfp_FrmMngGEARBX_DATA_C DSM_CDCDfp_FrmMngGEARBX_DATA2_C DSM_CDCDfp_FrmMngHEAT_AC_C DSM_CDCDfp_FrmMngINSTR2_C DSM_CDCDfp_FrmMngINSTR3_C DSM_CDCDfp_FrmMngLENKRADWINKEL_C DSM_CDCDfp_FrmMngMILEAGE_RANGE_C DSM_CDCDfp_FrmMngOPCRCTLACC_C DSM_CDCDfp_FrmMngPRGG_CCTR_C DSM_CDCDfp_FrmMngPWRMNG_LOADV_C DSM_CDCDfp_FrmMngParkConsumer_C DSM_CDCDfp_FrmMngRQSTGEFAN_C DSM_CDCDfp_FrmMngSSGErr_C DSM_CDCDfp_FrmMngSSGShOff_C DSM_CDCDfp_FrmMngSTAT_ANH_C DSM_CDCDfp_FrmMngSTAT_ARS_C DSM_CDCDfp_FrmMngSTAT_DSC_C DSM_CDCDfp_FrmMngSTAT_EKP_C DSM_CDCDfp_FrmMngSTAT_KOMBI_C DSM_CDCDfp_FrmMngSTAT_SITZ_C DSM_CDCDfp_FrmMngStOBDGbxMilOf_C DSM_CDCDfp_FrmMngStOBDGbxMilOn_C DSM_CDCDfp_FrmMngTEMPRELTIME_C DSM_CDCDfp_FrmMngTERMINAL_C DSM_CDCDfp_FrmMngTIME_DATE_C DSM_CDCDfp_FrmMngTORQUE_DSC_C DSM_CDCDfp_FrmMngTORQUE_GEARBX_C DSM_CDCDfp_FrmMngTrq_ReqACC_C DSM_CDCDfp_FrmMngVEH_MOD_C DSM_CDCDfp_FrmMngVELOCITY_C DSM_CDCDfp_FrmMngWHEEL_SPEED_C DSM_CDCDfp_FrmMngstCurr_C DSM_CDCDfp_FrmMngswtPSPOff_C DSM_CDCDfp_GearbxIncMax_C DSM_CDCDfp_GlwCD_C DSM_CDCDfp_GlwCDGlwCirc1_C DSM_CDCDfp_GlwCDGlwCirc2_C DSM_CDCDfp_GlwCDGlwCirc3_C DSM_CDCDfp_GlwCDGlwCirc4_C DSM_CDCDfp_GlwCDGlwCirc5_C DSM_CDCDfp_GlwCDGlwCirc6_C DSM_CDCDfp_GlwCDGlwCirc7_C DSM_CDCDfp_GlwCDGlwCirc8_C DSM_CDCDfp_GlwCtl_C DSM_CDCDfp_HWEMonCom_C DSM_CDCDfp_HWEMonEEPROM_C DSM_CDCDfp_HWEMonRcyLocked_C DSM_CDCDfp_HWEMonRcySuppressed_C DSM_CDCDfp_HWEMonRcyVisible_C DSM_CDCDfp_HWEMonUMaxSupply_C DSM_CDCDfp_HWEMonUMinSupply_C DSM_CDCDfp_IATSCD_C DSM_CDCDfp_IATSCD_CATS_C DSM_CDCDfp_ImmCtlImmCD_C DSM_CDCDfp_ImmCtlImmEep_C DSM_CDCDfp_ImmCtlMpl_C DSM_CDCDfp_IndSys1_C DSM_CDCDfp_IndSys2_C DSM_CDCDfp_InjCrv_InjLim_C DSM_CDCDfp_InjCtlAdjQnt_C DSM_CDCDfp_InjCtlDrift_C DSM_CDCDfp_InjVlvBnk1A_C DSM_CDCDfp_InjVlvBnk1B_C DSM_CDCDfp_InjVlvBnk2A_C DSM_CDCDfp_InjVlvBnk2B_C DSM_CDCDfp_InjVlvChipA_C DSM_CDCDfp_InjVlvChipB_C DSM_CDCDfp_InjVlvCyl1A_C DSM_CDCDfp_InjVlvCyl1B_C DSM_CDCDfp_InjVlvCyl2A_C DSM_CDCDfp_InjVlvCyl2B_C DSM_CDCDfp_InjVlvCyl3A_C DSM_CDCDfp_InjVlvCyl3B_C DSM_CDCDfp_InjVlvCyl4A_C DSM_CDCDfp_InjVlvCyl4B_C DSM_CDCDfp_InjVlvCyl5A_C DSM_CDCDfp_InjVlvCyl5B_C DSM_CDCDfp_InjVlvCyl6A_C DSM_CDCDfp_InjVlvCyl6B_C DSM_CDCDfp_LPACD_Max_C DSM_CDCDfp_LPACD_Min_C DSM_CDCDfp_LPACD_SigNpl_C DSM_CDCDfp_LSUCDCircNernst0_C DSM_CDCDfp_LSUCDCircPumpCur0_C DSM_CDCDfp_LSUCDCircVirtGnd0_C DSM_CDCDfp_LSUCDHeater0_C DSM_CDCDfp_LSUCDHtCoup0_C DSM_CDCDfp_LSUCDO20_C DSM_CDCDfp_LSUCDO2Clb0_C DSM_CDCDfp_LSUCDRiClb0_C DSM_CDCDfp_LSUCDSPI0_C DSM_CDCDfp_LSUCDSPIBattLow0_C DSM_CDCDfp_LSUCDWireIP0_C DSM_CDCDfp_LSUCtlRiExc0_C DSM_CDCDfp_LSUMon1Sens_C DSM_CDCDfp_LSUMon2Sens_C DSM_CDCDfp_LubCD_C DSM_CDCDfp_MIL_C DSM_CDCDfp_MRlyCD_C DSM_CDCDfp_MSidCD_Comm_C DSM_CDCDfp_MSidCD_Pin_C DSM_CDCDfp_MSidCD_Sel_INI_C DSM_CDCDfp_MSidCD_Select_C DSM_CDCDfp_MeUnCDNoLoad_C DSM_CDCDfp_MeUnCDSCBat_C DSM_CDCDfp_MeUnCDSCGnd_C DSM_CDCDfp_MeUnCD_ADC_C DSM_CDCDfp_MeUnCD_SigTst_C DSM_CDCDfp_Montr_C DSM_CDCDfp_NetMngDeviceA_C DSM_CDCDfp_NetMngDeviceB_C DSM_CDCDfp_NetMngDeviceC_C DSM_CDCDfp_OPSCD_Lamp_C DSM_CDCDfp_OPSCD_anain_C DSM_CDCDfp_OTSCD_C DSM_CDCDfp_OvRMon_C DSM_CDCDfp_OvRMonBrk_C DSM_CDCDfp_OvRMonSigA_C DSM_CDCDfp_OxiCCDTPre_C DSM_CDCDfp_PCR_GovDevNeg_C DSM_CDCDfp_PCR_GovDevPos_C DSM_CDCDfp_PCVCDNoLoad_C DSM_CDCDfp_PCVCDSCBat_C DSM_CDCDfp_PCVCDSCGnd_C DSM_CDCDfp_PCVCD_ADC_C DSM_CDCDfp_PCVCD_SigTst_C DSM_CDCDfp_PFltAPSens_C DSM_CDCDfp_PFltCDPPre_C DSM_CDCDfp_PFltCDTempPre_C DSM_CDCDfp_PFltChar_C DSM_CDCDfp_PFltEngPrt_C DSM_CDCDfp_PFltPresDynPlaus_C DSM_CDCDfp_PFltPresSens_C DSM_CDCDfp_PFltPresSensFrz_C DSM_CDCDfp_PFltPresSensHsLn_C DSM_CDCDfp_PFltPresSensSot_C DSM_CDCDfp_PFltRgnPerm_C DSM_CDCDfp_PFltTempDwnStrm_C DSM_CDCDfp_PFltTempSens_C DSM_CDCDfp_PFltTempUpStrm_C DSM_CDCDfp_PFltmSotDiffMax_C DSM_CDCDfp_PSPCD_Actr_C DSM_CDCDfp_QLTCD_C DSM_CDCDfp_RailCD_C DSM_CDCDfp_RailCDOfsTst_C DSM_CDCDfp_RailCD_PMonStrt_C DSM_CDCDfp_RailCtlModeMeUnDiag_C DSM_CDCDfp_RailCtlModePCVDiag_C DSM_CDCDfp_RailMeUn0_C DSM_CDCDfp_RailMeUn1_C DSM_CDCDfp_RailMeUn2_C DSM_CDCDfp_RailMeUn3_C DSM_CDCDfp_RailMeUn4_C DSM_CDCDfp_RailPCV0_C DSM_CDCDfp_RailPCV1_C DSM_CDCDfp_RailPCV2_C DSM_CDCDfp_RailPCV3_C DSM_CDCDfp_RailPCV4_C DSM_CDCDfp_RailPCV5_C DSM_CDCDfp_SOPTst_C DSM_CDCDfp_SSpMon1_C DSM_CDCDfp_SSpMon2_C DSM_CDCDfp_SSpMon3_C DSM_CDCDfp_SWChk_CycSigChkDat_C DSM_CDCDfp_SWChk_CycSigChkPrg_C DSM_CDCDfp_ShutCD_C DSM_CDCDfp_StSysTrqShutOff_C DSM_CDCDfp_StrtCD_Actr_C DSM_CDCDfp_SysLamp_C DSM_CDCDfp_T15CD_C DSM_CDCDfp_TGearbx_C DSM_CDCDfp_TPUMon_C DSM_CDCDfp_TVACD_Max_C DSM_CDCDfp_TVACD_Min_C DSM_CDCDfp_TVACD_SigNpl_C DSM_CDCDfp_TVACD_TVADia1_C DSM_CDCDfp_TVACD_TVADia2_C DSM_CDCDfp_TVACD_TVADia3_C DSM_CDCDfp_TVACD_TVADia4_C DSM_CDCDfp_VSACD_DioInDia1_C DSM_CDCDfp_VSACD_DioInDia2_C DSM_CDCDfp_VSACD_DioInDia3_C DSM_CDCDfp_VSACD_DioInDia4_C DSM_CDCDfp_VSACD_DioInMin_C DSM_CDCDfp_VSACD_Max_C DSM_CDCDfp_VSACD_Min_C DSM_CDCDfp_VSACD_SigNpl_C DSM_CDCDfp_VSACD_VSADia1_C DSM_CDCDfp_VSACD_VSADia2_C DSM_CDCDfp_VSACD_VSADia3_C DSM_CDCDfp_VSACD_VSADia4_C DSM_CDCDfp_VSSCD1_C DSM_CDCDfp_VSSCD2_C DSM_CDCDfp_WdCom_C /end DEF_CHARACTERISTIC
/end FUNCTION
/begin FUNCTION dsm_auto_cdk ""
 /begin DEF_CHARACTERISTIC DSM_CDKDfp_Layer_TANS_C DSM_CDKDfp_ACCDCmpr_C DSM_CDKDfp_ACCDPres_C DSM_CDKDfp_ACCDPres1_C DSM_CDKDfp_ACCDPresAna_C DSM_CDKDfp_ACCDSwtin_C DSM_CDKDfp_ACC_PlausTrqDes_C DSM_CDKDfp_ACC_trqInr_C DSM_CDKDfp_ACTrq_C DSM_CDKDfp_ADCMon_C DSM_CDKDfp_AFSCDIdlAdjVal_C DSM_CDKDfp_AFSCDLdAdjVal_C DSM_CDKDfp_AFSCD_AirTempDcyc_C DSM_CDKDfp_AFSCD_PlOffsDrft_C DSM_CDKDfp_AFSCD_PlSetyDrft_C DSM_CDKDfp_AFSCD_SRCAirTemp_C DSM_CDKDfp_AFSCD_SRCBatt_C DSM_CDKDfp_AFSCD_SRCCorrAirm_C DSM_CDKDfp_AFSCD_SRCRawAirm_C DSM_CDKDfp_Layer_TUMG_C DSM_CDKDfp_AFSCD_SRCRefSigPer_C DSM_CDKDfp_AOHtCD_C DSM_CDKDfp_Layer_GEN_C DSM_CDKDfp_Layer_BSD_C DSM_CDKDfp_AOHtCD_AOHtDia1_C DSM_CDKDfp_AOHtCD_AOHtDia2_C DSM_CDKDfp_AOHtCD_AOHtDia3_C DSM_CDKDfp_APP1_C DSM_CDKDfp_APP2_C DSM_CDKDfp_APPSync_C DSM_CDKDfp_APSCD_C DSM_CDKDfp_ARS_C DSM_CDKDfp_AccPedPlausBrk_C DSM_CDKDfp_AirCtlPlateBreak_C DSM_CDKDfp_Layer_QLT_C DSM_CDKDfp_AirCtl_GovNegDev_C DSM_CDKDfp_Layer_IBS1_C DSM_CDKDfp_Layer_IBS2_C DSM_CDKDfp_Layer_IBS3_C DSM_CDKDfp_Layer_PMBN_C DSM_CDKDfp_Layer_PMBATT_C DSM_CDKDfp_AirCtl_GovNegDev2_C DSM_CDKDfp_AirCtl_GovPosDev_C DSM_CDKDfp_AirCtl_GovPosDev2_C DSM_CDKDfp_AltCD_C DSM_CDKDfp_AltCD_Load_C DSM_CDKDfp_BPACD_BPADia1_C DSM_CDKDfp_BPACD_BPADia2_C DSM_CDKDfp_BPACD_BPADia3_C DSM_CDKDfp_BPACD_Max_C DSM_CDKDfp_BPACD_Min_C DSM_CDKDfp_BPACD_SigNpl_C DSM_CDKDfp_BPSCD_C DSM_CDKDfp_BattCD_C DSM_CDKDfp_BrkCD_C DSM_CDKDfp_Bss_C DSM_CDKDfp_CBACD_C DSM_CDKDfp_CTSCD_C DSM_CDKDfp_Clg_DynTst_C DSM_CDKDfp_CmbChbMisfire1_C DSM_CDKDfp_CmbChbMisfire2_C DSM_CDKDfp_CmbChbMisfire3_C DSM_CDKDfp_CmbChbMisfire4_C DSM_CDKDfp_CmbChbMisfire5_C DSM_CDKDfp_CmbChbMisfire6_C DSM_CDKDfp_CmbChbMisfireMul_C DSM_CDKDfp_CoVMDCSh_C DSM_CDKDfp_ConvCD_C DSM_CDKDfp_CrCCDMFL_C DSM_CDKDfp_CrCtl_vCrCtl_C DSM_CDKDfp_Dummy1_C DSM_CDKDfp_EATSCD_C DSM_CDKDfp_EBAFCD_C DSM_CDKDfp_Layer_PMRUHVERL_C DSM_CDKDfp_EBFCD_C DSM_CDKDfp_EBTSCD_C DSM_CDKDfp_EBTSCD_OvrTemp_C DSM_CDKDfp_EEPCDVarMng_C DSM_CDKDfp_Layer_TOENS_C DSM_CDKDfp_Layer_MANHYDR_C DSM_CDKDfp_Layer_MANLUFT_C DSM_CDKDfp_EGPpCD_C DSM_CDKDfp_EGPpCDTPreTrbn_C DSM_CDKDfp_EGRCD_Max_C DSM_CDKDfp_EGRCD_Min_C DSM_CDKDfp_EGRCD_SigNpl_C DSM_CDKDfp_EGTRgnOilDil_C DSM_CDKDfp_EMCCDNoLoad1_C DSM_CDKDfp_EMCCDNoLoad2_C DSM_CDKDfp_EMCCDSCBat1_C DSM_CDKDfp_EMCCDSCBat2_C DSM_CDKDfp_EMCCDSCGnd1_C DSM_CDKDfp_EMCCDSCGnd2_C DSM_CDKDfp_EMCCD_ADC1_C DSM_CDKDfp_EMCCD_ADC2_C DSM_CDKDfp_ETClbETFltInj1_C DSM_CDKDfp_ETClbETFltInj2_C DSM_CDKDfp_ETClbETFltInj3_C DSM_CDKDfp_ETClbETFltInj4_C DSM_CDKDfp_ETClbETFltInj5_C DSM_CDKDfp_ETClbETFltInj6_C DSM_CDKDfp_ETClbInj1_C DSM_CDKDfp_ETClbInj2_C DSM_CDKDfp_ETClbInj3_C DSM_CDKDfp_ETClbInj4_C DSM_CDKDfp_ETClbInj5_C DSM_CDKDfp_ETClbInj6_C DSM_CDKDfp_EngMCaS1_C DSM_CDKDfp_EngMCrS1_C DSM_CDKDfp_EngMOfsCaSCrS_C DSM_CDKDfp_EngPrtFWODet_C DSM_CDKDfp_FBCqDvt_C DSM_CDKDfp_FMTC_NonMonotonMap_C DSM_CDKDfp_FTSCD_C DSM_CDKDfp_FanCD_C DSM_CDKDfp_FanCD_FanCtlr1_C DSM_CDKDfp_FanCD_FanCtlr2_C DSM_CDKDfp_FanCD_FanCtlr3_C DSM_CDKDfp_FlFCD_C DSM_CDKDfp_FlMngSmkDefect_C DSM_CDKDfp_FrmMngASC1_C DSM_CDKDfp_FrmMngASC2_C DSM_CDKDfp_FrmMngASC3_C DSM_CDKDfp_FrmMngASC4_C DSM_CDKDfp_FrmMngBOS_RESET_C DSM_CDKDfp_FrmMngBOS_RESET_2_C DSM_CDKDfp_FrmMngDMANFAFS_C DSM_CDKDfp_FrmMngDRMANFSSG_C DSM_CDKDfp_FrmMngEGS1_C DSM_CDKDfp_FrmMngEGS2_C DSM_CDKDfp_FrmMngGEARBX_DATA_C DSM_CDKDfp_FrmMngGEARBX_DATA2_C DSM_CDKDfp_FrmMngHEAT_AC_C DSM_CDKDfp_FrmMngINSTR2_C DSM_CDKDfp_FrmMngINSTR3_C DSM_CDKDfp_FrmMngLENKRADWINKEL_C DSM_CDKDfp_FrmMngMILEAGE_RANGE_C DSM_CDKDfp_FrmMngOPCRCTLACC_C DSM_CDKDfp_FrmMngPRGG_CCTR_C DSM_CDKDfp_FrmMngPWRMNG_LOADV_C DSM_CDKDfp_FrmMngParkConsumer_C DSM_CDKDfp_FrmMngRQSTGEFAN_C DSM_CDKDfp_FrmMngSSGErr_C DSM_CDKDfp_FrmMngSSGShOff_C DSM_CDKDfp_FrmMngSTAT_ANH_C DSM_CDKDfp_FrmMngSTAT_ARS_C DSM_CDKDfp_FrmMngSTAT_DSC_C DSM_CDKDfp_FrmMngSTAT_EKP_C DSM_CDKDfp_FrmMngSTAT_KOMBI_C DSM_CDKDfp_FrmMngSTAT_SITZ_C DSM_CDKDfp_FrmMngStOBDGbxMilOf_C DSM_CDKDfp_FrmMngStOBDGbxMilOn_C DSM_CDKDfp_FrmMngTEMPRELTIME_C DSM_CDKDfp_FrmMngTERMINAL_C DSM_CDKDfp_FrmMngTIME_DATE_C DSM_CDKDfp_FrmMngTORQUE_DSC_C DSM_CDKDfp_FrmMngTORQUE_GEARBX_C DSM_CDKDfp_FrmMngTrq_ReqACC_C DSM_CDKDfp_FrmMngVEH_MOD_C DSM_CDKDfp_FrmMngVELOCITY_C DSM_CDKDfp_FrmMngWHEEL_SPEED_C DSM_CDKDfp_FrmMngstCurr_C DSM_CDKDfp_FrmMngswtPSPOff_C DSM_CDKDfp_GearbxIncMax_C DSM_CDKDfp_GlwCD_C DSM_CDKDfp_GlwCDGlwCirc1_C DSM_CDKDfp_GlwCDGlwCirc2_C DSM_CDKDfp_GlwCDGlwCirc3_C DSM_CDKDfp_GlwCDGlwCirc4_C DSM_CDKDfp_GlwCDGlwCirc5_C DSM_CDKDfp_GlwCDGlwCirc6_C DSM_CDKDfp_GlwCDGlwCirc7_C DSM_CDKDfp_GlwCDGlwCirc8_C DSM_CDKDfp_GlwCtl_C DSM_CDKDfp_HWEMonCom_C DSM_CDKDfp_HWEMonEEPROM_C DSM_CDKDfp_HWEMonRcyLocked_C DSM_CDKDfp_HWEMonRcySuppressed_C DSM_CDKDfp_HWEMonRcyVisible_C DSM_CDKDfp_HWEMonUMaxSupply_C DSM_CDKDfp_HWEMonUMinSupply_C DSM_CDKDfp_IATSCD_C DSM_CDKDfp_IATSCD_CATS_C DSM_CDKDfp_ImmCtlImmCD_C DSM_CDKDfp_ImmCtlImmEep_C DSM_CDKDfp_ImmCtlMpl_C DSM_CDKDfp_IndSys1_C DSM_CDKDfp_IndSys2_C DSM_CDKDfp_InjCrv_InjLim_C DSM_CDKDfp_InjCtlAdjQnt_C DSM_CDKDfp_InjCtlDrift_C DSM_CDKDfp_InjVlvBnk1A_C DSM_CDKDfp_InjVlvBnk1B_C DSM_CDKDfp_InjVlvBnk2A_C DSM_CDKDfp_InjVlvBnk2B_C DSM_CDKDfp_InjVlvChipA_C DSM_CDKDfp_InjVlvChipB_C DSM_CDKDfp_InjVlvCyl1A_C DSM_CDKDfp_InjVlvCyl1B_C DSM_CDKDfp_InjVlvCyl2A_C DSM_CDKDfp_InjVlvCyl2B_C DSM_CDKDfp_InjVlvCyl3A_C DSM_CDKDfp_InjVlvCyl3B_C DSM_CDKDfp_InjVlvCyl4A_C DSM_CDKDfp_InjVlvCyl4B_C DSM_CDKDfp_InjVlvCyl5A_C DSM_CDKDfp_InjVlvCyl5B_C DSM_CDKDfp_InjVlvCyl6A_C DSM_CDKDfp_InjVlvCyl6B_C DSM_CDKDfp_LPACD_Max_C DSM_CDKDfp_LPACD_Min_C DSM_CDKDfp_LPACD_SigNpl_C DSM_CDKDfp_LSUCDCircNernst0_C DSM_CDKDfp_LSUCDCircPumpCur0_C DSM_CDKDfp_LSUCDCircVirtGnd0_C DSM_CDKDfp_LSUCDHeater0_C DSM_CDKDfp_LSUCDHtCoup0_C DSM_CDKDfp_LSUCDO20_C DSM_CDKDfp_LSUCDO2Clb0_C DSM_CDKDfp_LSUCDRiClb0_C DSM_CDKDfp_LSUCDSPI0_C DSM_CDKDfp_LSUCDSPIBattLow0_C DSM_CDKDfp_LSUCDWireIP0_C DSM_CDKDfp_LSUCtlRiExc0_C DSM_CDKDfp_LSUMon1Sens_C DSM_CDKDfp_LSUMon2Sens_C DSM_CDKDfp_LubCD_C DSM_CDKDfp_MIL_C DSM_CDKDfp_MRlyCD_C DSM_CDKDfp_MSidCD_Comm_C DSM_CDKDfp_MSidCD_Pin_C DSM_CDKDfp_MSidCD_Sel_INI_C DSM_CDKDfp_MSidCD_Select_C DSM_CDKDfp_MeUnCDNoLoad_C DSM_CDKDfp_MeUnCDSCBat_C DSM_CDKDfp_MeUnCDSCGnd_C DSM_CDKDfp_MeUnCD_ADC_C DSM_CDKDfp_MeUnCD_SigTst_C DSM_CDKDfp_Montr_C DSM_CDKDfp_NetMngDeviceA_C DSM_CDKDfp_NetMngDeviceB_C DSM_CDKDfp_NetMngDeviceC_C DSM_CDKDfp_OPSCD_Lamp_C DSM_CDKDfp_OPSCD_anain_C DSM_CDKDfp_OTSCD_C DSM_CDKDfp_OvRMon_C DSM_CDKDfp_OvRMonBrk_C DSM_CDKDfp_OvRMonSigA_C DSM_CDKDfp_OxiCCDTPre_C DSM_CDKDfp_PCR_GovDevNeg_C DSM_CDKDfp_PCR_GovDevPos_C DSM_CDKDfp_PCVCDNoLoad_C DSM_CDKDfp_PCVCDSCBat_C DSM_CDKDfp_PCVCDSCGnd_C DSM_CDKDfp_PCVCD_ADC_C DSM_CDKDfp_PCVCD_SigTst_C DSM_CDKDfp_PFltAPSens_C DSM_CDKDfp_PFltCDPPre_C DSM_CDKDfp_PFltCDTempPre_C DSM_CDKDfp_PFltChar_C DSM_CDKDfp_PFltEngPrt_C DSM_CDKDfp_PFltPresDynPlaus_C DSM_CDKDfp_PFltPresSens_C DSM_CDKDfp_PFltPresSensFrz_C DSM_CDKDfp_PFltPresSensHsLn_C DSM_CDKDfp_PFltPresSensSot_C DSM_CDKDfp_PFltRgnPerm_C DSM_CDKDfp_PFltTempDwnStrm_C DSM_CDKDfp_PFltTempSens_C DSM_CDKDfp_PFltTempUpStrm_C DSM_CDKDfp_PFltmSotDiffMax_C DSM_CDKDfp_PSPCD_Actr_C DSM_CDKDfp_QLTCD_C DSM_CDKDfp_RailCD_C DSM_CDKDfp_RailCDOfsTst_C DSM_CDKDfp_RailCD_PMonStrt_C DSM_CDKDfp_RailCtlModeMeUnDiag_C DSM_CDKDfp_RailCtlModePCVDiag_C DSM_CDKDfp_RailMeUn0_C DSM_CDKDfp_RailMeUn1_C DSM_CDKDfp_RailMeUn2_C DSM_CDKDfp_RailMeUn3_C DSM_CDKDfp_RailMeUn4_C DSM_CDKDfp_RailPCV0_C DSM_CDKDfp_RailPCV1_C DSM_CDKDfp_RailPCV2_C DSM_CDKDfp_RailPCV3_C DSM_CDKDfp_RailPCV4_C DSM_CDKDfp_RailPCV5_C DSM_CDKDfp_SOPTst_C DSM_CDKDfp_SSpMon1_C DSM_CDKDfp_SSpMon2_C DSM_CDKDfp_SSpMon3_C DSM_CDKDfp_SWChk_CycSigChkDat_C DSM_CDKDfp_SWChk_CycSigChkPrg_C DSM_CDKDfp_ShutCD_C DSM_CDKDfp_StSysTrqShutOff_C DSM_CDKDfp_StrtCD_Actr_C DSM_CDKDfp_SysLamp_C DSM_CDKDfp_T15CD_C DSM_CDKDfp_TGearbx_C DSM_CDKDfp_TPUMon_C DSM_CDKDfp_TVACD_Max_C DSM_CDKDfp_TVACD_Min_C DSM_CDKDfp_TVACD_SigNpl_C DSM_CDKDfp_TVACD_TVADia1_C DSM_CDKDfp_TVACD_TVADia2_C DSM_CDKDfp_TVACD_TVADia3_C DSM_CDKDfp_TVACD_TVADia4_C DSM_CDKDfp_VSACD_DioInDia1_C DSM_CDKDfp_VSACD_DioInDia2_C DSM_CDKDfp_VSACD_DioInDia3_C DSM_CDKDfp_VSACD_DioInDia4_C DSM_CDKDfp_VSACD_DioInMin_C DSM_CDKDfp_VSACD_Max_C DSM_CDKDfp_VSACD_Min_C DSM_CDKDfp_VSACD_SigNpl_C DSM_CDKDfp_VSACD_VSADia1_C DSM_CDKDfp_VSACD_VSADia2_C DSM_CDKDfp_VSACD_VSADia3_C DSM_CDKDfp_VSACD_VSADia4_C DSM_CDKDfp_VSSCD1_C DSM_CDKDfp_VSSCD2_C DSM_CDKDfp_WdCom_C /end DEF_CHARACTERISTIC
/end FUNCTION
/begin COMPU_METHOD OneToOne "eins zu eins (physikalischer Wert ist gleich dem internen Wert)" RAT_FUNC "%6.2" "-" COEFFS 0 1 0 0 0 1 /end COMPU_METHOD
/begin RECORD_LAYOUT Kwb_Wu16 FNC_VALUES 1 UWORD COLUMN_DIR DIRECT /end RECORD_LAYOUT
/end MODULE
/end PROJECT
