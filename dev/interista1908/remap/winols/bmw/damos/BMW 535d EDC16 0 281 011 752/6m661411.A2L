ASAP2_VERSION 1 3
/begin PROJECT P411 "BMW DDE6.0 6-Zylinder V66.1 07.01.2004 CAN12H"
/begin HEADER "" VERSION "V571_6Z_CAN12H" PROJECT_NO P411 /end HEADER
/begin MODULE DIM ""
/begin MOD_COMMON "" BYTE_ORDER MSB_FIRST ALIGNMENT_BYTE 1 ALIGNMENT_WORD 2 ALIGNMENT_LONG 4 ALIGNMENT_FLOAT32_IEEE 4 /end MOD_COMMON
/begin CHARACTERISTIC EBFCD_ctPwrStgOnMax_C "" VALUE 0xCCC4A Kw_Wu16 65535.00 OneToOne 0.00 65535.00 FORMAT "%8.2" /end CHARACTERISTIC
/begin CHARACTERISTIC EBFCD_DebExcTempDef_C "time for final defect of excess temperature defect" VALUE 0xCCC4C Kw_Wu16 655350.0 Time_ms 0.00 655350.0 FORMAT "%8.1" /end CHARACTERISTIC
/begin CHARACTERISTIC EBFCD_DebExcTempOk_C "time for healing of excess temperature defect" VALUE 0xCCC4E Kw_Wu16 655350.0 Time_ms 0.00 655350.0 FORMAT "%8.1" /end CHARACTERISTIC
/begin CHARACTERISTIC EBFCD_DebNoLoadDef_C "time for final defect of no load" VALUE 0xCCC50 Kw_Wu16 655350.0 Time_ms 0.00 655350.0 FORMAT "%8.1" /end CHARACTERISTIC
/begin CHARACTERISTIC EBFCD_DebNoLoadOk_C "time for healing of no load defect" VALUE 0xCCC52 Kw_Wu16 655350.0 Time_ms 0.00 655350.0 FORMAT "%8.1" /end CHARACTERISTIC
/begin CHARACTERISTIC EBFCD_DebShortCircBatDef_C "time for final defect for short circuit to battery" VALUE 0xCCC54 Kw_Wu16 655350.0 Time_ms 0.00 655350.0 FORMAT "%8.1" /end CHARACTERISTIC
/begin CHARACTERISTIC EBFCD_DebShortCircBatOk_C "time for healing of short circuit to battery" VALUE 0xCCC56 Kw_Wu16 655350.0 Time_ms 0.00 655350.0 FORMAT "%8.1" /end CHARACTERISTIC
/begin CHARACTERISTIC EBFCD_DebShortCircGndDef_C "time for final defect of short circuit to ground" VALUE 0xCCC58 Kw_Wu16 655350.0 Time_ms 0.00 655350.0 FORMAT "%8.1" /end CHARACTERISTIC
/begin CHARACTERISTIC EBFCD_DebShortCircGndOk_C "time for final defect of short circuit to ground" VALUE 0xCCC5A Kw_Wu16 655350.0 Time_ms 0.00 655350.0 FORMAT "%8.1" /end CHARACTERISTIC
/begin CHARACTERISTIC EBFCD_numDiaOut_C "#SSD application parameter for EBFCD diagnostic signal" VALUE 0xCCC5C Kw_Wu8 27.0000000000 NumPinDia 0.00 27.0000000000 FORMAT "%13.10" /end CHARACTERISTIC
/begin CHARACTERISTIC EBFCD_numDioOut_C "#SSD application parameter for fan output signal" VALUE 0xCCC5D Kw_Wu8 10.0000000000 NumPinDioOut 0.00 10.0000000000 FORMAT "%13.10" /end CHARACTERISTIC
/begin CHARACTERISTIC EBFCD_stDigInvOut_C "Digital output signal invert information" VALUE 0xCCC5E Kw_Wu8 1.000 OneToOne 0.00 1.000 FORMAT "%5.3" EXTENDED_LIMITS 0.00 255.0 /end CHARACTERISTIC
/begin CHARACTERISTIC EBFCD_stSigOutErr_C "Default value if error occurs" VALUE 0xCCC5F Kw_Wu8 1.000 OneToOne 0.00 1.000 FORMAT "%5.3" EXTENDED_LIMITS 0.00 255.0 /end CHARACTERISTIC
/begin CHARACTERISTIC EBFCD_stSPICtl_C "" VALUE 0xCCC60 Kw_Wu8 1.000 OneToOne 0.00 1.000 FORMAT "%5.3" EXTENDED_LIMITS 0.00 255.0 /end CHARACTERISTIC
/begin CHARACTERISTIC EBFCD_swtOnOff_C "Switch for switching the functionality ON/OFF" VALUE 0xCCC61 Kw_Wu8 1.000 OneToOne 0.00 1.000 FORMAT "%5.3" EXTENDED_LIMITS 0.00 255.0 /end CHARACTERISTIC
/begin CHARACTERISTIC EBFCD_tECUXLow_C "Minimum value for the input of the hysteresis" VALUE 0xCCC62 Kw_Ws16 250.0000 Temp_Cels -50.1400 199.8600 FORMAT "%8.4" EXTENDED_LIMITS -3549.940 3003.560 /end CHARACTERISTIC
/begin CHARACTERISTIC EBFCD_tECUXHigh_C "Maximum value for the input of the hysteresis" VALUE 0xCCC64 Kw_Ws16 250.0000 Temp_Cels -50.1400 199.8600 FORMAT "%8.4" EXTENDED_LIMITS -3549.940 3003.560 /end CHARACTERISTIC
/begin CHARACTERISTIC EBFCD_stECUYLow_C "Minimum value for the output of the hysteresis" VALUE 0xCCC66 Kw_Ws16 1.000000 OneToOne 0.00 1.000000 FORMAT "%8.6" EXTENDED_LIMITS -32768.00 32767.00 /end CHARACTERISTIC
/begin CHARACTERISTIC EBFCD_stECUYHigh_C "Maximum value for the output of the hysteresis" VALUE 0xCCC68 Kw_Ws16 1.000000 OneToOne 0.00 1.000000 FORMAT "%8.6" EXTENDED_LIMITS -32768.00 32767.00 /end CHARACTERISTIC
/begin CHARACTERISTIC EBFCD_tiBtwTst_C "" VALUE 0xCCC6A Kw_Wu16 29980.00 Time_ms 20.00000 30000.00 FORMAT "%8.2" EXTENDED_LIMITS 0.00 655350.0 /end CHARACTERISTIC
/begin CHARACTERISTIC EBFCD_tiPwrStgOn_C "" VALUE 0xCCC6C Kw_Wu16 655140.0 Time_ms 0.00 655140.0 FORMAT "%8.1" EXTENDED_LIMITS 0.00 655350.0 /end CHARACTERISTIC
/begin CHARACTERISTIC EBTSCD_uSRCMin_C "#SSD min. value of SRC" VALUE 0xCCC70 Kw_Ws16 5200.391 Volt 0.00 5200.391 FORMAT "%8.3" EXTENDED_LIMITS -160156.4 160151.5 /end CHARACTERISTIC
/begin CHARACTERISTIC EBTSCD_uSRCMax_C "#SSD max. value of SRC" VALUE 0xCCC72 Kw_Ws16 5200.391 Volt 0.00 5200.391 FORMAT "%8.3" EXTENDED_LIMITS -160156.4 160151.5 /end CHARACTERISTIC
/begin CHARACTERISTIC EBTSCD_tLin_CUR "#SSD curve for linearisation in EBTSCD" CURVE 0xCCC74 Kl_Xs16_Ws16 250.0000 Temp_Cels -50.14000 199.8600 FORMAT "%8.4" EXTENDED_LIMITS -3549.940 3003.560
 /begin AXIS_DESCR STD_AXIS EBTSCD_uRawTECU_mp Volt 5 0.00 5200.391 FORMAT "%8.3" EXTENDED_LIMITS -160156.4 160151.5 DEPOSIT ABSOLUTE /end AXIS_DESCR
/end CHARACTERISTIC
/begin CHARACTERISTIC EBTSCD_OvrDebSRCHighDef_C "#SSD Error debounce time for Over temperature error" VALUE 0xCCC8A Kw_Wu16 655350.0 Time_ms 0.00 655350.0 FORMAT "%8.1" /end CHARACTERISTIC
/begin CHARACTERISTIC EBTSCD_OvrDebSRCHighOk_C "Healing debounce time for over temperature  error" VALUE 0xCCC8C Kw_Wu16 655350.0 Time_ms 0.00 655350.0 FORMAT "%8.1" /end CHARACTERISTIC
/begin CHARACTERISTIC EBTSCD_DebSRCHighDef_C "#SSD Error debounce time for SRC-High error" VALUE 0xCCC8E Kw_Wu16 655350.0 Time_ms 0.00 655350.0 FORMAT "%8.1" /end CHARACTERISTIC
/begin CHARACTERISTIC EBTSCD_DebSRCHighOk_C "Healing debounce time for SRC-High error" VALUE 0xCCC90 Kw_Wu16 655350.0 Time_ms 0.00 655350.0 FORMAT "%8.1" /end CHARACTERISTIC
/begin CHARACTERISTIC EBTSCD_DebSRCLowDef_C "#SSD Error debounce time for SRC-Low error" VALUE 0xCCC92 Kw_Wu16 655350.0 Time_ms 0.00 655350.0 FORMAT "%8.1" /end CHARACTERISTIC
/begin CHARACTERISTIC EBTSCD_DebSRCLowOk_C "Healing debounce time for SRC-Low error" VALUE 0xCCC94 Kw_Wu16 655350.0 Time_ms 0.00 655350.0 FORMAT "%8.1" /end CHARACTERISTIC
/begin CHARACTERISTIC EBTSCD_numAdc_C "#SSD application parameter for ECU temperature" VALUE 0xCCC96 Kw_Wu8 26.0000000000 NumPinAdc 0.00 26.0000000000 FORMAT "%13.10" /end CHARACTERISTIC
/begin CHARACTERISTIC EBTSCD_dtRmpSlpUp_C "#SSD ramp slope up" VALUE 0xCCC98 Kw_Wu32 6553598.99749 RmpTemp 1.00097656250 6553599.99847 FORMAT "%13.5" EXTENDED_LIMITS 0.00 6553599.99847 /end CHARACTERISTIC
/begin CHARACTERISTIC EBTSCD_dtRmpSlpDwn_C "#SSD ramp slope down" VALUE 0xCCC9C Kw_Wu32 6553598.99749 RmpTemp 1.00097656250 6553599.99847 FORMAT "%13.5" EXTENDED_LIMITS 0.00 6553599.99847 /end CHARACTERISTIC
/begin CHARACTERISTIC EBTSCD_tiTECUPT1_C "#SSD Time constant of PT1 delay element" VALUE 0xCCCA0 Kw_Wu32 4294.9663 TimeDelay_s 0.0010000001 4294.9673 FORMAT "%9.4" EXTENDED_LIMITS 0.0000010000000 4294.9673 /end CHARACTERISTIC
/begin CHARACTERISTIC EBTSCD_tOvrTemp_C "#SSD over temperature threshold" VALUE 0xCCCA4 Kw_Ws16 250.0000 Temp_Cels -50.1400 199.8600 FORMAT "%8.4" EXTENDED_LIMITS -3549.940 3003.560 /end CHARACTERISTIC
/begin CHARACTERISTIC EBTSCD_stSensIDWord_C "#SSD ID-Word for transition stage" VALUE 0xCCCA6 Kw_Wu16 65535.00 OneToOne 0.00 65535.00 FORMAT "%8.2" /end CHARACTERISTIC
/begin CHARACTERISTIC EBTSCD_tDfl_C "#SSD default value if error occurs" VALUE 0xCCCA8 Kw_Ws16 250.0000 Temp_Cels -50.14000 199.8600 FORMAT "%8.4" EXTENDED_LIMITS -3549.940 3003.560 /end CHARACTERISTIC
/begin CHARACTERISTIC ECU_vPrgThres_C "#SSD obere Geschwindigkeitsgrenze für die FLASH Programmierung" VALUE 0xCCCAC Kw_Ws16 327.6700 Vel 0.00 327.6700 FORMAT "%8.4" EXTENDED_LIMITS -327.6800 327.6700 /end CHARACTERISTIC
/begin CHARACTERISTIC EEPCD_stMILDfl_C "Vorgabezewert fr MIL von EEPCD defekt" VALUE 0xCCCAE Kw_Wu8 1.000 OneToOne 0.00 1.000 FORMAT "%5.3" EXTENDED_LIMITS 0.00 255.0 /end CHARACTERISTIC
/begin CHARACTERISTIC EepInit_AirCtlTrm_C "Trimmwert Sollwertbildung AGR" VALUE 0xCCCB0 Kw_Ws16 3276.700 AirMassPerCyl 0.00 3276.700 FORMAT "%8.3" EXTENDED_LIMITS -3276.800 3276.700 /end CHARACTERISTIC
/begin CHARACTERISTIC EGPpCD_ctPwrStgOnMax_C "" VALUE 0xCCDD4 Kw_Wu16 65535.00 OneToOne 0.00 65535.00 FORMAT "%8.2" /end CHARACTERISTIC
/begin CHARACTERISTIC EGPpCD_numDia_C "#SSD Application parameter for Exhaust gas pressure pump actuator diagnostic signal" VALUE 0xCCDD6 Kw_Wu8 27.0000000000 NumPinDia 0.00 27.0000000000 FORMAT "%13.10" /end CHARACTERISTIC
/begin CHARACTERISTIC EGPpCD_numDioOut_C "#SSD Application parameter for Exhaust gas pressure pump actuator output pin" VALUE 0xCCDD7 Kw_Wu8 10.0000000000 NumPinDioOut 0.00 10.0000000000 FORMAT "%13.10" /end CHARACTERISTIC
/begin CHARACTERISTIC EGPpCD_stInvOut_C "Digital output invert information for Exhaust gas pressure pump actuator" VALUE 0xCCDD8 Kw_Wu8 1.000 OneToOne 0.00 1.000 FORMAT "%5.3" EXTENDED_LIMITS 0.00 255.0 /end CHARACTERISTIC
/begin CHARACTERISTIC EGPpCD_stPwrStgActv_C "Status word for deactivation of the powerstage diagnostics" VALUE 0xCCDD9 Kw_Wu8 255.0 OneToOne 0.00 255.0 FORMAT "%5.1" /end CHARACTERISTIC
/begin CHARACTERISTIC EGPpCD_stSPICtl_C "" VALUE 0xCCDDA Kw_Wu8 1.000 OneToOne 0.00 1.000 FORMAT "%5.3" EXTENDED_LIMITS 0.00 255.0 /end CHARACTERISTIC
/begin CHARACTERISTIC EGPpCD_tiBtwTst_C "" VALUE 0xCCDDC Kw_Wu16 655140.0 Time_ms 0.00 655140.0 FORMAT "%8.1" EXTENDED_LIMITS 0.00 655350.0 /end CHARACTERISTIC
/begin CHARACTERISTIC EGPpCD_tiDebExcTempDef_C "Debounce duration for excess temperature error detection" VALUE 0xCCDDE Kw_Wu16 655350.0 Time_ms 0.00 655350.0 FORMAT "%8.1" /end CHARACTERISTIC
/begin CHARACTERISTIC EGPpCD_tiDebExcTempOk_C "Debounce duration for excess temperature error healing" VALUE 0xCCDE0 Kw_Wu16 655350.0 Time_ms 0.00 655350.0 FORMAT "%8.1" /end CHARACTERISTIC
/begin CHARACTERISTIC EGPpCD_tiDebNoLoadDef_C "Debounce duration for no load error detection" VALUE 0xCCDE2 Kw_Wu16 655350.0 Time_ms 0.00 655350.0 FORMAT "%8.1" /end CHARACTERISTIC
/begin CHARACTERISTIC EGPpCD_tiDebNoLoadOk_C "Debounce duration for no load error healing" VALUE 0xCCDE4 Kw_Wu16 655350.0 Time_ms 0.00 655350.0 FORMAT "%8.1" /end CHARACTERISTIC
/begin CHARACTERISTIC EGPpCD_tiDebShortCircBatDef_C "Debounce duration for short circuit to battery error detection" VALUE 0xCCDE6 Kw_Wu16 655350.0 Time_ms 0.00 655350.0 FORMAT "%8.1" /end CHARACTERISTIC
/begin CHARACTERISTIC EGPpCD_tiDebShortCircBatOk_C "Debounce duration for short circuit to battery error healing" VALUE 0xCCDE8 Kw_Wu16 655350.0 Time_ms 0.00 655350.0 FORMAT "%8.1" /end CHARACTERISTIC
/begin CHARACTERISTIC EGPpCD_tiDebShortCircGndDef_C "Debounce duration for short circuit to ground error detection" VALUE 0xCCDEA Kw_Wu16 655350.0 Time_ms 0.00 655350.0 FORMAT "%8.1" /end CHARACTERISTIC
/begin CHARACTERISTIC EGPpCD_tiDebShortCircGndOk_C "Debounce duration for short circuit to ground error healing" VALUE 0xCCDEC Kw_Wu16 655350.0 Time_ms 0.00 655350.0 FORMAT "%8.1" /end CHARACTERISTIC
/begin CHARACTERISTIC EGPpCD_tiPwrStgOn_C "" VALUE 0xCCDEE Kw_Wu16 655140.0 Time_ms 0.00 655140.0 FORMAT "%8.1" EXTENDED_LIMITS 0.00 655350.0 /end CHARACTERISTIC
/begin CHARACTERISTIC EGPp_facGeoSil2_C "Geometric factor silencer" VALUE 0xCCCD0 Kw_Ws16 100.0000 Fact1 0.00 100.0000 FORMAT "%8.4" EXTENDED_LIMITS -256.0000 255.9922 /end CHARACTERISTIC
/begin CHARACTERISTIC EGPp_facGeoSil_C "geometrischer Faktor Schalldämpfer" VALUE 0xCCCD2 Kw_Ws16 100.0000 Fact1 0.00 100.0000 FORMAT "%8.4" EXTENDED_LIMITS -256.0000 255.9922 /end CHARACTERISTIC
/begin CHARACTERISTIC EGPp_facPow_CUR "Potenzfunktion für Abgasvolumenstrom" CURVE 0xCCCD4 Kl_Xs16_Ws16 250.0000 Fact1 0.00 250.0000 FORMAT "%8.4" EXTENDED_LIMITS -256.0000 255.9922 READ_ONLY
 /begin AXIS_DESCR STD_AXIS EGPp_dvolSil_mp CubMtrPerHr 11 0.00 3200.000 FORMAT "%8.3" EXTENDED_LIMITS -3276.800 3276.700 DEPOSIT ABSOLUTE /end AXIS_DESCR
/end CHARACTERISTIC
/begin CHARACTERISTIC EGPp_facRhoEta_CUR "temperaturabhängiger Dichte- und Viskositätsfaktor" CURVE 0xCCD02 Kl_Xs16_Ws16 4.000000 Fact 0.00 4.000000 FORMAT "%8.6" EXTENDED_LIMITS -4.000000 3.999878 READ_ONLY
 /begin AXIS_DESCR STD_AXIS PFlt_tPstSim Temp_Cels 9 -50.140 899.860 FORMAT "%8.3" EXTENDED_LIMITS -3549.940 3003.560 DEPOSIT ABSOLUTE /end AXIS_DESCR
/end CHARACTERISTIC
/begin CHARACTERISTIC EGPp_pPstPFlt_MAP "Druckabfallkennfeld" MAP 0xCCD28 Kf_Xs16_Ys16_Ws16 3500.0000 Pres_hPa 0.00 3500.0000 FORMAT "%8.4" EXTENDED_LIMITS -32768.00 32767.00
 /begin AXIS_DESCR STD_AXIS Eng_nAvrg EngN 8 0.00 8000.000 FORMAT "%8.3" EXTENDED_LIMITS -32768.00 32767.00 DEPOSIT ABSOLUTE /end AXIS_DESCR
 /begin AXIS_DESCR STD_AXIS InjCtl_qSetUnBal InjMassCyc 8 0.00 200.0000 FORMAT "%8.4" EXTENDED_LIMITS -327.6800 327.6700 DEPOSIT ABSOLUTE /end AXIS_DESCR
/end CHARACTERISTIC
/begin CHARACTERISTIC EGPp_tiPresFltPT1_C "PT1 Filterzeit für die Druckmodellierung im Abgasrohr" VALUE 0xCCDCC Kw_Wu32 4294.9673 TimeDelay_s 0.0000010000000 4294.9673 FORMAT "%9.4" /end CHARACTERISTIC
/begin CHARACTERISTIC EGPp_stFlap_MAP "Exhaust Gas Pump status calculation map" MAP 0xCCCB8 Kf_Xs16_Ys16_Ws16 1.000000 OneToOne 0.00 1.000000 FORMAT "%8.6" EXTENDED_LIMITS -32768.00 32767.00
 /begin AXIS_DESCR STD_AXIS Eng_nAvrg EngN 2 40.00000 6000.000 FORMAT "%8.3" EXTENDED_LIMITS -32768.00 32767.00 DEPOSIT ABSOLUTE /end AXIS_DESCR
 /begin AXIS_DESCR STD_AXIS InjCtl_qCurr InjMassCyc 2 0.00 200.0000 FORMAT "%8.4" EXTENDED_LIMITS -327.6800 327.6700 DEPOSIT ABSOLUTE /end AXIS_DESCR
/end CHARACTERISTIC
/begin CHARACTERISTIC EGPp_swtPresCalc_C "Schalter für Druckberechnung (0-Kennfeld, 1- Simulation)" VALUE 0xCCDD0 Kw_Wu8 1.000 OneToOne 0.00 1.000 FORMAT "%5.3" EXTENDED_LIMITS 0.00 255.0 /end CHARACTERISTIC
/begin CHARACTERISTIC EGPp_tiStartDelay_C "Time threshold for engine start status" VALUE 0xCCCCC Kw_Ws16 9000.000 Time_ms 1000.000 10000.00 FORMAT "%8.2" EXTENDED_LIMITS -327680.0 327670.0 /end CHARACTERISTIC
/begin CHARACTERISTIC EGRCD_ctPwrStgOnMax_C "Maximum number of powerstage switch on per driving cycle in case of SCB or excess temperature" VALUE 0xCCDF0 Kw_Wu16 65535.00 OneToOne 0.00 65535.00 FORMAT "%8.2" /end CHARACTERISTIC
/begin CHARACTERISTIC EGRCD_DebExcTempDef_C "#SSD Fehlerentprellzeit für Übertemperatur" VALUE 0xCCDF2 Kw_Wu16 655350.0 Time_ms 0.00 655350.0 FORMAT "%8.1" /end CHARACTERISTIC
/begin CHARACTERISTIC EGRCD_DebExcTempOk_C "Heilungsentprellzeit für Übertemperatur" VALUE 0xCCDF4 Kw_Wu16 655350.0 Time_ms 0.00 655350.0 FORMAT "%8.1" /end CHARACTERISTIC
/begin CHARACTERISTIC EGRCD_DebNoLoadDef_C "#SSD Fehlerentprellzeit für Lastabfall" VALUE 0xCCDF6 Kw_Wu16 655350.0 Time_ms 0.00 655350.0 FORMAT "%8.1" /end CHARACTERISTIC
/begin CHARACTERISTIC EGRCD_DebNoLoadOk_C "Heilungsentprellzeit für Lastabfall" VALUE 0xCCDF8 Kw_Wu16 655350.0 Time_ms 0.00 655350.0 FORMAT "%8.1" /end CHARACTERISTIC
/begin CHARACTERISTIC EGRCD_DebShortCircBatDef_C "#SSD Fehlerentprellzeit für Kurzschluß nach Batteriespannung" VALUE 0xCCDFA Kw_Wu16 655350.0 Time_ms 0.00 655350.0 FORMAT "%8.1" /end CHARACTERISTIC
/begin CHARACTERISTIC EGRCD_DebShortCircBatOk_C "Heilungsentprellzeit für Kurzschluß nach Batteriespannung" VALUE 0xCCDFC Kw_Wu16 655350.0 Time_ms 0.00 655350.0 FORMAT "%8.1" /end CHARACTERISTIC
/begin CHARACTERISTIC EGRCD_DebShortCircGndDef_C "#SSD Fehlerentprellzeit für Kurzschluß nach Masse" VALUE 0xCCDFE Kw_Wu16 655350.0 Time_ms 0.00 655350.0 FORMAT "%8.1" /end CHARACTERISTIC
/begin CHARACTERISTIC EGRCD_DebShortCircGndOk_C "Heilungsentprellzeit für Kurzschluß nach Masse" VALUE 0xCCE00 Kw_Wu16 655350.0 Time_ms 0.00 655350.0 FORMAT "%8.1" /end CHARACTERISTIC
/begin CHARACTERISTIC EGRCD_numDia_C "#SSD Applikationsparameter fuer Diagnose Signal :EGR-Steller" VALUE 0xCCE02 Kw_Wu8 27.0000000000 NumPinDia 0.00 27.0000000000 FORMAT "%13.10" /end CHARACTERISTIC
/begin CHARACTERISTIC EGRCD_numPwmOut_C "#SSD Applikationsparameter fuer EGR-Steller" VALUE 0xCCE03 Kw_Wu8 12.0000000000 NumPinPwmOut 0.00 12.0000000000 FORMAT "%13.10" /end CHARACTERISTIC
/begin CHARACTERISTIC EGRCD_stInvOut_C "Invertierungsparameter für das Signal der Abgasrückführstellerendstufe" VALUE 0xCCE04 Kw_Wu8 1.000 OneToOne 0.00 1.000 FORMAT "%5.3" EXTENDED_LIMITS 0.00 255.0 /end CHARACTERISTIC
/begin CHARACTERISTIC EGRCD_tiPer_C "Periodendauer Abgasrückführsteller" VALUE 0xCCE06 Kw_Ws16 6553.500 Period -3276.800 3276.700 FORMAT "%8.3" /end CHARACTERISTIC
/begin CHARACTERISTIC EGRCD_rCnv_MAP "Kennfeld zur konvertierung in Tastverhältnis" MAP 0xCCE08 Kf_Xs16_Ys16_Ws16 100.0000 DtyCyc 0.00 100.0000 FORMAT "%8.4" EXTENDED_LIMITS -327.6800 327.6700
 /begin AXIS_DESCR STD_AXIS Eng_nAvrg EngN 8 0.00 8000.000 FORMAT "%8.3" EXTENDED_LIMITS -32768.00 32767.00 DEPOSIT ABSOLUTE /end AXIS_DESCR
 /begin AXIS_DESCR STD_AXIS EGRVlv_rEGR Prc 8 -400.0000 399.9878 FORMAT "%8.4" DEPOSIT ABSOLUTE /end AXIS_DESCR
/end CHARACTERISTIC
/begin CHARACTERISTIC EGRCD_rOutMax_C "Maximal auszugebendes Tastverhältnis" VALUE 0xCCEAC Kw_Ws16 655.3500 DtyCyc -327.6800 327.6700 FORMAT "%8.4" /end CHARACTERISTIC
/begin CHARACTERISTIC EGRCD_rOutMin_C "Minimal auszugebendes Tastverhältnis" VALUE 0xCCEAE Kw_Ws16 655.3500 DtyCyc -327.6800 327.6700 FORMAT "%8.4" /end CHARACTERISTIC
/begin CHARACTERISTIC EGRCD_stPwrStgActv_C "Aktivierung der Abschaltbedingungen der Endstufe" VALUE 0xCCEB0 Kw_Wu8 255.0 OneToOne 0.00 255.0 FORMAT "%5.1" /end CHARACTERISTIC
/begin CHARACTERISTIC EGRCD_stPwrStgDia_C "#SSD Aktivierung der Abschaltbedingungen der Endstufendiagnose" VALUE 0xCCEB1 Kw_Wu8 255.0 OneToOne 0.00 255.0 FORMAT "%5.1" /end CHARACTERISTIC
/begin CHARACTERISTIC EGRCD_stSPICtl_C "0 = Non SPI powerstage )" VALUE 0xCCEB2 Kw_Wu8 1.000 OneToOne 0.00 1.000 FORMAT "%5.3" EXTENDED_LIMITS 0.00 255.0 /end CHARACTERISTIC
/begin CHARACTERISTIC EGRCD_swt_C "Schalter Batteriesspannungskorrektur (0 = AUS, 1 = EIN)" VALUE 0xCCEB3 Kw_Wu8 255.0 OneToOne 0.00 255.0 FORMAT "%5.1" /end CHARACTERISTIC
/begin CHARACTERISTIC EGRCD_tiBtwTst_C "Zeitabstand, in dem im Fehlerfall die Endstufe getestet wird" VALUE 0xCCEB4 Kw_Wu16 29980.00 Time_ms 20.00000 30000.00 FORMAT "%8.2" EXTENDED_LIMITS 0.00 655350.0 /end CHARACTERISTIC
/begin CHARACTERISTIC EGRCD_tiPwrStgOn_C "Time for which the powerstage is switched on in case of non SPI powerstage" VALUE 0xCCEB6 Kw_Wu16 655140.0 Time_ms 0.00 655140.0 FORMAT "%8.1" EXTENDED_LIMITS 0.00 655350.0 /end CHARACTERISTIC
/begin CHARACTERISTIC EGRVlv_rEGR2_Vector "#SSD Bypass-Label for exhaust gas recirculation coordinator2" VALUE 0xC2EB2 Kw_Wu8 255.0 OneToOne 0.00 255.0 FORMAT "%5.1" /end CHARACTERISTIC
/begin CHARACTERISTIC EGRVlv_rEGR2_Channel "#SSD Bypass-Label for exhaust gas recirculation coordinator2" VALUE 0xC2EB3 Kw_Wu8 255.0 OneToOne 0.00 255.0 FORMAT "%5.1" /end CHARACTERISTIC
/begin CHARACTERISTIC EGRVlv_rEGR_Vector "#SSD Bypass-Label für EGRVlv_rEGR" VALUE 0xC2EB4 Kw_Wu8 255.0 OneToOne 0.00 255.0 FORMAT "%5.1" /end CHARACTERISTIC
/begin CHARACTERISTIC EGRVlv_rEGR_Channel "#SSD Bypass-Label für EGRVlv_rEGR" VALUE 0xC2EB5 Kw_Wu8 255.0 OneToOne 0.00 255.0 FORMAT "%5.1" /end CHARACTERISTIC
/begin CHARACTERISTIC EGSys_AlpFreeCnvtTube_C "Wärmeübertragungskoeffizient am Abgasrohr aufgrund freier Konvektion" VAL_BLK 0xCD7A0 Kwb_Ws16 999.9000 ThermalCoEff 0.1000000 1000.000 FORMAT "%8.3" EXTENDED_LIMITS -3276.800 3276.700 NUMBER 2 /end CHARACTERISTIC
/begin CHARACTERISTIC EGSys_CalValFl_C "Unterer Heizwert Kraftstoff" VALUE 0xCD590 Kw_Wu16 65535.00 Calory 0.00 65535.00 FORMAT "%8.2" /end CHARACTERISTIC
/begin CHARACTERISTIC EGSys_cndHtEG_CUR "Wärmeleitfähigkeit Abgas (nicht applizierbar)" CURVE 0xCD0C4 Kl_Xs16_Ws16 1.000000 Fact 0.00 1.000000 FORMAT "%8.6" EXTENDED_LIMITS -4.000000 3.999878 READ_ONLY
 /begin AXIS_DESCR STD_AXIS EGSys_tEGLSUInpCrv0_mp Temp_Cels 8 -50.140 899.860 FORMAT "%8.3" EXTENDED_LIMITS -3549.940 3003.560 DEPOSIT ABSOLUTE /end AXIS_DESCR
/end CHARACTERISTIC
/begin CHARACTERISTIC EGSys_cpChrg_C "Wärmekapazität Turbolader" VALUE 0xCD6CC Kw_Ws16 3000.000 HeatCapacity 0.00 3000.000 FORMAT "%8.3" EXTENDED_LIMITS -3276.800 3276.700 /end CHARACTERISTIC
/begin CHARACTERISTIC EGSys_cpEG_MAP "Wärmekapazität Abgas (nicht applizierbar)" MAP 0xCD0E6 Kf_Xs16_Ys16_Ws16 2.000000 SpecificHeat 0.00 2.000000 FORMAT "%8.6" EXTENDED_LIMITS -3.276800 3.276700 READ_ONLY
 /begin AXIS_DESCR STD_AXIS EGSys_tEGLSUInpCrv0_mp Temp_Cels 6 -50.140 899.860 FORMAT "%8.3" EXTENDED_LIMITS -3549.940 3003.560 DEPOSIT ABSOLUTE /end AXIS_DESCR
 /begin AXIS_DESCR STD_AXIS EGSys_rLmbdAprx lambda 6 -30.00000 30.00000 FORMAT "%8.5" EXTENDED_LIMITS -32.76800 32.76700 DEPOSIT ABSOLUTE /end AXIS_DESCR
/end CHARACTERISTIC
/begin CHARACTERISTIC EGSys_cpNSC_C "Wärmekapazität NSC" VALUE 0xCD4E0 Kw_Ws16 2999.900 HeatCapacity 0.1000000 3000.000 FORMAT "%8.3" EXTENDED_LIMITS -3276.800 3276.700 /end CHARACTERISTIC
/begin CHARACTERISTIC EGSys_cpOxiCat_C "Wärmekapazität Oxidationskatalysator" VALUE 0xCD592 Kw_Ws16 2999.900 HeatCapacity 0.1000000 3000.000 FORMAT "%8.3" EXTENDED_LIMITS -3276.800 3276.700 /end CHARACTERISTIC
/begin CHARACTERISTIC EGSys_cpTube_C "Wärmekapazität Abgasrohr" VAL_BLK 0xCD7A4 Kwb_Ws16 2999.900 HeatCapacity 0.1000000 3000.000 FORMAT "%8.3" EXTENDED_LIMITS -3276.800 3276.700 NUMBER 2 /end CHARACTERISTIC
/begin CHARACTERISTIC EGSys_dmAir_MAP "Kennfeld zur Ermittlung Luftmassenstrom im Auslegungspunkt (zur Temperaturkorrektur)" MAP 0xCD1A0 Kf_Xs16_Ys16_Ws16 1000.000 AirMassPerTime 0.00 1000.000 FORMAT "%8.3" EXTENDED_LIMITS -3276.800 3276.700
 /begin AXIS_DESCR STD_AXIS Eng_nAvrg EngN 8 0.00 8000.000 FORMAT "%8.3" EXTENDED_LIMITS -32768.00 32767.00 DEPOSIT ABSOLUTE /end AXIS_DESCR
 /begin AXIS_DESCR STD_AXIS InjCtl_qCurr InjMassCyc 8 0.00 100.0000 FORMAT "%8.4" EXTENDED_LIMITS -327.6800 327.6700 DEPOSIT ABSOLUTE /end AXIS_DESCR
/end CHARACTERISTIC
/begin CHARACTERISTIC EGSys_dmEGMinVal_C "Kleinstwert Abgasmassenstrom für thermische Modellierung" VALUE 0xCD14A Kw_Ws16 1000.000 AirMassPerTime 0.00 1000.000 FORMAT "%8.3" EXTENDED_LIMITS -3276.800 3276.700 /end CHARACTERISTIC
/begin CHARACTERISTIC EGSys_dmPlsThresLSU_C "Minimaler Massenstrom für gültigen Gasstoß" VAL_BLK 0xCCEB8 Kwb_Ws16 1000.000 AirMassPerTime 0.00 1000.000 FORMAT "%8.3" EXTENDED_LIMITS -3276.800 3276.700 NUMBER 1 /end CHARACTERISTIC
/begin CHARACTERISTIC EGSys_dpExhGas_MAP "Kennfeld für Abgasgegendruck" MAP 0xCCFCC Kf_Xs16_Ys16_Ws16 65535.00 Pres_hPa -32768.00 32767.00 FORMAT "%8.2"
 /begin AXIS_DESCR STD_AXIS Eng_nAvrg EngN 10 -32768.00 32767.00 FORMAT "%8.2" DEPOSIT ABSOLUTE /end AXIS_DESCR
 /begin AXIS_DESCR STD_AXIS InjCtl_qSetUnBal InjMassCyc 10 -327.6800 327.6700 FORMAT "%8.4" DEPOSIT ABSOLUTE /end AXIS_DESCR
/end CHARACTERISTIC
/begin CHARACTERISTIC EGSys_etaChrg_MAP "Kennfeld Gesamtwirkungsgrad Turbolader" MAP 0xCD6CE Kf_Xs16_Ys16_Ws16 0.9998779 Fact 0.0001220703 1.000000 FORMAT "%8.6" EXTENDED_LIMITS -4.000000 3.999878
 /begin AXIS_DESCR STD_AXIS AFSCD_dmAirPerTime AirMassPerTime 8 0.00 1000.000 FORMAT "%8.3" EXTENDED_LIMITS -3276.800 3276.700 DEPOSIT ABSOLUTE /end AXIS_DESCR
 /begin AXIS_DESCR STD_AXIS EGSys_rPresCmpr_mp Fact 8 0.00 8.000000 FORMAT "%8.6" EXTENDED_LIMITS -4.000000 3.999878 DEPOSIT ABSOLUTE /end AXIS_DESCR
/end CHARACTERISTIC
/begin CHARACTERISTIC EGSys_facAirMass_CUR "Kennlinie zur Luftmassenabhängigen Temperaturkorrektur" CURVE 0xCD244 Kl_Xs16_Ws16 2.000000 Fact 0.00 2.000000 FORMAT "%8.6" EXTENDED_LIMITS -4.000000 3.999878
 /begin AXIS_DESCR STD_AXIS EGSys_rAirPerTime_mp Fact 8 0.00 8.000000 FORMAT "%8.6" EXTENDED_LIMITS -4.000000 3.999878 DEPOSIT ABSOLUTE /end AXIS_DESCR
/end CHARACTERISTIC
/begin CHARACTERISTIC EGSys_facCldStrtLSU_C "Faktor für Schwellwerterhöhung bei wiederholtem Kaltstart" VAL_BLK 0xCCEBA Kwb_Ws16 1.000000 Fact 0.00 1.000000 FORMAT "%8.6" EXTENDED_LIMITS -4.000000 3.999878 NUMBER 1 /end CHARACTERISTIC
/begin CHARACTERISTIC EGSys_facCorrCldEng_CUR "Kennlinie zur Abgastemperatur-Korrektur beim kaltem Motor" CURVE 0xCD266 Kl_Xs16_Ws16 2.000000 Fact 0.00 2.000000 FORMAT "%8.6" EXTENDED_LIMITS -4.000000 3.999878
 /begin AXIS_DESCR STD_AXIS EGSys_tDiffCldEng_mp TempDiff_Cels 8 -3276.800 3276.700 FORMAT "%8.3" DEPOSIT ABSOLUTE /end AXIS_DESCR
/end CHARACTERISTIC
/begin CHARACTERISTIC EGSys_facIAT_CUR "Kennlinie zur ansauglufttemperaturabhängigen Korrektur der Abgastemperatur" CURVE 0xCD288 Kl_Xs16_Ws16 2.000000 Fact 0.00 2.000000 FORMAT "%8.6" EXTENDED_LIMITS -4.000000 3.999878
 /begin AXIS_DESCR STD_AXIS EGSys_tDiffIAT_mp TempDiff_Cels 8 -3276.800 3276.700 FORMAT "%8.3" DEPOSIT ABSOLUTE /end AXIS_DESCR
/end CHARACTERISTIC
/begin CHARACTERISTIC EGSys_facPlsLSU_C "Faktor für Abnahme der Wärmeschwelle bei gültigem Gasstoß" VAL_BLK 0xCCEBC Kwb_Ws16 1.000000 Fact 0.00 1.000000 FORMAT "%8.6" EXTENDED_LIMITS -4.000000 3.999878 NUMBER 1 /end CHARACTERISTIC
/begin CHARACTERISTIC EGSys_facPlsThresLSU_C "minimaler Wärmemengenschwellwert zur Aktivierung der Gasstoß-Erkennung" VAL_BLK 0xCCEBE Kwb_Ws16 1.000000 Fact 0.00 1.000000 FORMAT "%8.6" EXTENDED_LIMITS -4.000000 3.999878 NUMBER 1 /end CHARACTERISTIC
/begin CHARACTERISTIC EGSys_facStrtDlv_CUR "Kennlinie zur Förderbeginnabhängigen Temperaturkorrektur" CURVE 0xCD2AA Kl_Xs16_Ws16 2.000000 Fact 0.00 2.000000 FORMAT "%8.6" EXTENDED_LIMITS -4.000000 3.999878
 /begin AXIS_DESCR STD_AXIS EGSys_phiDiffStrt_mp AngleCrS 8 -49.99219 49.99219 FORMAT "%8.5" EXTENDED_LIMITS -768.0000 767.9766 DEPOSIT ABSOLUTE /end AXIS_DESCR
/end CHARACTERISTIC
/begin CHARACTERISTIC EGSys_facTempClg_CUR "Abkühlkennlinie abgasführende Bauteile" CURVE 0xCD664 Kl_Xs16_Ws16 2.000000 Fact 0.00 2.000000 FORMAT "%8.6" EXTENDED_LIMITS -4.000000 3.999878
 /begin AXIS_DESCR STD_AXIS EGSys_rTimeTrb_mp Fact1 8 0.00 8.000000 FORMAT "%8.6" EXTENDED_LIMITS -256.0000 255.9922 DEPOSIT ABSOLUTE /end AXIS_DESCR
/end CHARACTERISTIC
/begin CHARACTERISTIC EGSys_facTempCmb_CUR "Temperaturabhängiger Faktor zur Korrektur der im Oxidationskatalysator abreagierenden Kraftstoffmasse" CURVE 0xCD594 Kl_Xs16_Ws16 2.000000 Fact 0.00 2.000000 FORMAT "%8.6" EXTENDED_LIMITS -4.000000 3.999878
 /begin AXIS_DESCR STD_AXIS EGSys_tAvrgOxiCat_mp Temp_Cels 8 -50.140 899.860 FORMAT "%8.3" EXTENDED_LIMITS -3549.940 3003.560 DEPOSIT ABSOLUTE /end AXIS_DESCR
/end CHARACTERISTIC
/begin CHARACTERISTIC EGSys_facTimeClg_CUR "inverse Abkühlkennlinie Motor" CURVE 0xCD686 Kl_Xs16_Ws16 255.0000 Fact1 0.00 255.0000 FORMAT "%8.4" EXTENDED_LIMITS -256.0000 255.9922
 /begin AXIS_DESCR STD_AXIS EGSys_rTempClnt_mp Fact 8 0.00 3.900024 FORMAT "%8.6" EXTENDED_LIMITS -4.000000 3.999878 DEPOSIT ABSOLUTE /end AXIS_DESCR
/end CHARACTERISTIC
/begin CHARACTERISTIC EGSys_lDiamTube_C "Durchmesser Abgasrohr" VAL_BLK 0xCD7A8 Kwb_Ws16 99.99219 Length1 0.007812500 100.0000 FORMAT "%8.4" EXTENDED_LIMITS -256.0000 255.9922 NUMBER 2 /end CHARACTERISTIC
/begin CHARACTERISTIC EGSys_lLngthTube_C "Länge Abgasrohr" VAL_BLK 0xCD7AC Kwb_Ws16 99.99219 Length1 0.007812500 100.0000 FORMAT "%8.4" EXTENDED_LIMITS -256.0000 255.9922 NUMBER 2 /end CHARACTERISTIC
/begin CHARACTERISTIC EGSys_tiPT1NSC_C "Feste thermische Zeitkonstante zur NSC-Modellierung" VALUE 0xCD4E4 Kw_Wu32 4294.9663 TimeDelay_s 0.0010000001 4294.9673 FORMAT "%9.4" EXTENDED_LIMITS 0.0000010000000 4294.9673 /end CHARACTERISTIC
/begin CHARACTERISTIC EGSys_numECU_C "Anzahl der Steuergeräte" VALUE 0xCD14C Kw_Wu8 254.0 OneToOne 1.000 255.0 FORMAT "%5.1" EXTENDED_LIMITS 0.00 255.0 /end CHARACTERISTIC
/begin CHARACTERISTIC EGSys_numMaxCldStrt_C "Maximale Anzahl der zu zählenden Kaltstarts" VAL_BLK 0xCCEC0 Kwb_Wu8 10.00 OneToOne 0.00 10.00 FORMAT "%5.2" EXTENDED_LIMITS 0.00 255.0 NUMBER 1 /end CHARACTERISTIC
/begin CHARACTERISTIC EGSys_numRdPosLSU2_C "Leseindex im Temperaturarray für Abgastemperatur(en) am Sensoreinbauort (im Fehlerfall)" VAL_BLK 0xCD14D Kwb_Wu8 12.00 OneToOne 0.00 12.00 FORMAT "%5.2" EXTENDED_LIMITS 0.00 255.0 NUMBER 1 /end CHARACTERISTIC
/begin CHARACTERISTIC EGSys_numRdPosLSUWall_C "Leseindex der Rohrwandtemperatur im Temperaturarray" VAL_BLK 0xCD14E Kwb_Wu8 14.00 OneToOne 0.00 14.00 FORMAT "%5.2" EXTENDED_LIMITS 0.00 255.0 NUMBER 1 /end CHARACTERISTIC
/begin CHARACTERISTIC EGSys_numRdPosLSU_C "Leseindex im Temperaturarray für Abgastemperatur(en) am Sensoreinbauort" VAL_BLK 0xCD14F Kwb_Wu8 12.00 OneToOne 0.00 12.00 FORMAT "%5.2" EXTENDED_LIMITS 0.00 255.0 NUMBER 1 /end CHARACTERISTIC
/begin CHARACTERISTIC EGSys_numRdPosNSC2_C "Leseindex im Temperaturarray für NSC Einlaßtemperatur (im Fehlerfall)" VALUE 0xCD150 Kw_Wu8 12.00 OneToOne 0.00 12.00 FORMAT "%5.2" EXTENDED_LIMITS 0.00 255.0 /end CHARACTERISTIC
/begin CHARACTERISTIC EGSys_numRdPosNSC_C "Leseindex im Temperaturarray für NSC Einlaßtemperatur" VALUE 0xCD151 Kw_Wu8 12.00 OneToOne 0.00 12.00 FORMAT "%5.2" EXTENDED_LIMITS 0.00 255.0 /end CHARACTERISTIC
/begin CHARACTERISTIC EGSys_numRdPosOxiCat2_C "Leseindex im Temperaturarray für Oxydations-Katalysator-Einlaßtemperatur (im Fehlerfall)" VALUE 0xCD152 Kw_Wu8 12.00 OneToOne 0.00 12.00 FORMAT "%5.2" EXTENDED_LIMITS 0.00 255.0 /end CHARACTERISTIC
/begin CHARACTERISTIC EGSys_numRdPosOxiCat_C "Leseindex im Temperaturarray für Oxydations-Katalysator-Einlaßtemperatur" VALUE 0xCD153 Kw_Wu8 12.00 OneToOne 0.00 12.00 FORMAT "%5.2" EXTENDED_LIMITS 0.00 255.0 /end CHARACTERISTIC
/begin CHARACTERISTIC EGSys_numRdPosTrbn2_C "Leseindex im Temperaturarray für Turbineneinlaßtemperatur (im Fehlerfall)" VALUE 0xCD154 Kw_Wu8 12.00 OneToOne 0.00 12.00 FORMAT "%5.2" EXTENDED_LIMITS 0.00 255.0 /end CHARACTERISTIC
/begin CHARACTERISTIC EGSys_numRdPosTrbn_C "Leseindex im Temperaturarray für Turbineneinlaßtemperatur" VALUE 0xCD155 Kw_Wu8 12.00 OneToOne 0.00 12.00 FORMAT "%5.2" EXTENDED_LIMITS 0.00 255.0 /end CHARACTERISTIC
/begin CHARACTERISTIC EGSys_numRdPosTube2_C "Leseindex im Temperaturarray für Rohr-Einlaßtemperaturen (im Fehlerfall)" VAL_BLK 0xCD156 Kwb_Wu8 12.00 OneToOne 0.00 12.00 FORMAT "%5.2" EXTENDED_LIMITS 0.00 255.0 NUMBER 2 /end CHARACTERISTIC
/begin CHARACTERISTIC EGSys_numRdPosTube_C "Leseindex im Temperaturarray für Rohr-Einlaßtemperaturen" VAL_BLK 0xCD158 Kwb_Wu8 12.00 OneToOne 0.00 12.00 FORMAT "%5.2" EXTENDED_LIMITS 0.00 255.0 NUMBER 2 /end CHARACTERISTIC
/begin CHARACTERISTIC EGSys_NuTubeEnv_CUR "Nusselt-Zahl Abgasrohr-Aussenumströmung (nicht applizierbar)" CURVE 0xCD7B0 Kl_Xs16_Ws16 5309.000 OneToOne 0.00 5309.000 FORMAT "%8.3" EXTENDED_LIMITS -32768.00 32767.00 READ_ONLY
 /begin AXIS_DESCR STD_AXIS EGSys_ReTubeEnvInpCrv_mp OneToOne 8 0.00 3750.000 FORMAT "%8.3" EXTENDED_LIMITS -32768.00 32767.00 DEPOSIT ABSOLUTE /end AXIS_DESCR
/end CHARACTERISTIC
/begin CHARACTERISTIC EGSys_NuTube_CUR "Nusselt-Zahl für Abgasrohrdurchströmung (nicht applizierbar)" CURVE 0xCD7D2 Kl_Xs16_Ws16 1130.000 OneToOne 0.00 1130.000 FORMAT "%8.3" EXTENDED_LIMITS -32768.00 32767.00 READ_ONLY
 /begin AXIS_DESCR STD_AXIS EGSys_ReTubeInpCrv_mp ReynoldsNum 8 0.00 800000.0 FORMAT "%8.1" EXTENDED_LIMITS -3276800. 3276700. DEPOSIT ABSOLUTE /end AXIS_DESCR
/end CHARACTERISTIC
/begin CHARACTERISTIC EGSys_tiPT1OxiCat_C "Feste thermische Zeitkonstante zur Oxidationskatalysator-Modellierung" VALUE 0xCD5B8 Kw_Wu32 4294.9663 TimeDelay_s 0.0010000001 4294.9673 FORMAT "%9.4" EXTENDED_LIMITS 0.0000010000000 4294.9673 /end CHARACTERISTIC
/begin CHARACTERISTIC EGSys_pConstVal_C "Normdruck" VALUE 0xCD0C0 Kw_Ws16 65535.00 Pres_hPa -32768.00 32767.00 FORMAT "%8.2" READ_ONLY /end CHARACTERISTIC
/begin CHARACTERISTIC EGSys_phiStrtDlv_MAP "Kennfeld zur Ermittlung Förderbeginn MI1 im Auslegungspunkt (zur Temperaturkorrektur)" MAP 0xCD2CC Kf_Xs16_Ys16_Ws16 99.98437 AngleCrS -49.99219 49.99219 FORMAT "%8.5" EXTENDED_LIMITS -768.0000 767.9766
 /begin AXIS_DESCR STD_AXIS Eng_nAvrg EngN 8 0.00 8000.000 FORMAT "%8.3" EXTENDED_LIMITS -32768.00 32767.00 DEPOSIT ABSOLUTE /end AXIS_DESCR
 /begin AXIS_DESCR STD_AXIS InjCtl_qCurr InjMassCyc 8 0.00 100.0000 FORMAT "%8.4" EXTENDED_LIMITS -327.6800 327.6700 DEPOSIT ABSOLUTE /end AXIS_DESCR
/end CHARACTERISTIC
/begin CHARACTERISTIC EGSys_tiChrgPT1_C "Feste thermische Zeitkonstante Turbolader" VALUE 0xCD774 Kw_Wu32 4294.9663 TimeDelay_s 0.0010000001 4294.9673 FORMAT "%9.4" EXTENDED_LIMITS 0.0000010000000 4294.9673 /end CHARACTERISTIC
/begin CHARACTERISTIC EGSys_pValDfl_C "Vorgabewert Umgebungsdruck für Turboladermodell" VALUE 0xCD778 Kw_Ws16 3000.000 Pres_hPa 500.0000 3500.000 FORMAT "%8.3" EXTENDED_LIMITS -32768.00 32767.00 /end CHARACTERISTIC
/begin CHARACTERISTIC EGSys_rSqTube_C "Anteil der vom Fahrtwind beaufschlagten Oberfläche Abgasrohr" VAL_BLK 0xCD7F4 Kwb_Ws16 3.800049 Fact 0.09997559 3.900024 FORMAT "%8.6" EXTENDED_LIMITS -4.000000 3.999878 NUMBER 2 /end CHARACTERISTIC
/begin CHARACTERISTIC EGSys_rTempAdbt_CUR "Kennlinie für die adiabatische Zustandänderung der Temperatur (nicht applizierbar)" CURVE 0xCD77A Kl_Xs16_Ws16 0.4000244 Fact 1.000000 1.400024 FORMAT "%8.6" EXTENDED_LIMITS -4.000000 3.999878 READ_ONLY
 /begin AXIS_DESCR STD_AXIS EGSys_rPresCmpr_mp Fact 8 1.000000 8.000000 FORMAT "%8.6" EXTENDED_LIMITS -4.000000 3.999878 DEPOSIT ABSOLUTE /end AXIS_DESCR
/end CHARACTERISTIC
/begin CHARACTERISTIC EGSys_swtDewDetShOff_C "Umschalter für Ersatzfunktion (Zeitapplikation)" VAL_BLK 0xCCEC1 Kwb_Wu8 10.00 OneToOne 0.00 10.00 FORMAT "%5.2" EXTENDED_LIMITS 0.00 255.0 NUMBER 1 /end CHARACTERISTIC
/begin CHARACTERISTIC EGSys_swtPresSel_C "#SSD Auswahl, ob Atmosphaerendruck (=1) oder Druck vor Partikelfilter (=0)" VALUE 0xCD0C2 Kw_Wu8 1.000 OneToOne 0.00 1.000 FORMAT "%5.3" EXTENDED_LIMITS 0.00 255.0 /end CHARACTERISTIC
/begin CHARACTERISTIC EGSys_swtTAirSens_C "Umschalter für Umgebungstemperatursensor" VALUE 0xCD6A8 Kw_Wu8 1.000 OneToOne 0.00 1.000 FORMAT "%5.3" EXTENDED_LIMITS 0.00 255.0 /end CHARACTERISTIC
/begin CHARACTERISTIC EGSys_swtTimeChrg_C "Schalter zur Verwendung fester oder variabler thermischer Zeitkonstante für Turbolader" VALUE 0xCD79C Kw_Wu8 1.000 OneToOne 0.00 1.000 FORMAT "%5.3" EXTENDED_LIMITS 0.00 255.0 /end CHARACTERISTIC
/begin CHARACTERISTIC EGSys_swtTimeNSC_C "Schalter zur Verwendung fester oder variabler thermischer Zeitkonstante für NSC" VALUE 0xCD4E8 Kw_Wu8 1.000 OneToOne 0.00 1.000 FORMAT "%5.3" EXTENDED_LIMITS 0.00 255.0 /end CHARACTERISTIC
/begin CHARACTERISTIC EGSys_swtTimeOxiCat_C "Schalter zur Verwendung fester oder variabler thermischer Zeitkonstante für Oxidationskatalysator" VALUE 0xCD5BC Kw_Wu8 1.000 OneToOne 0.00 1.000 FORMAT "%5.3" EXTENDED_LIMITS 0.00 255.0 /end CHARACTERISTIC
/begin CHARACTERISTIC EGSys_tEGPstTrbnDfl_C "Ersatzwert Turbinentemperatur im Fehlerfall" VALUE 0xCD79E Kw_Ws16 950.000 Temp_Cels -50.140 899.860 FORMAT "%8.3" EXTENDED_LIMITS -3549.940 3003.560 /end CHARACTERISTIC
/begin CHARACTERISTIC EGSys_tEGTubeDfl_C "Ersatzwert Abgastemperatur im Abgasrohr" VAL_BLK 0xCD7F8 Kwb_Ws16 950.000 Temp_Cels -50.140 899.860 FORMAT "%8.3" EXTENDED_LIMITS -3549.940 3003.560 NUMBER 2 /end CHARACTERISTIC
/begin CHARACTERISTIC EGSys_tEngStat_C "Kühlmitteltemperatur (bzw Motortemperatur) betriebswarmer Motor unter normalen Bendingungen" VALUE 0xCD370 Kw_Ws16 950.000 Temp_Cels -50.140 899.860 FORMAT "%8.3" EXTENDED_LIMITS -3549.940 3003.560 /end CHARACTERISTIC
/begin CHARACTERISTIC EGSys_tExcClntDfl_C "Ersatzwert für Motor-Übertemperatur" VALUE 0xCD19E Kw_Ws16 1095.000 TempDiff_Cels -45.00000 1050.000 FORMAT "%8.3" EXTENDED_LIMITS -3276.800 3276.700 /end CHARACTERISTIC
/begin CHARACTERISTIC EGSys_tIAT_MAP "Kennfeld Ansauglufttemperatur im Auslegungspunkt zur Korrektur der stationären Krümmeraustrittstemperatur" MAP 0xCD372 Kf_Xs16_Ys16_Ws16 950.000 Temp_Cels -50.140 899.860 FORMAT "%8.3" EXTENDED_LIMITS -3549.940 3003.560
 /begin AXIS_DESCR STD_AXIS Eng_nAvrg EngN 8 0.00 8000.000 FORMAT "%8.3" EXTENDED_LIMITS -32768.00 32767.00 DEPOSIT ABSOLUTE /end AXIS_DESCR
 /begin AXIS_DESCR STD_AXIS InjCtl_qCurr InjMassCyc 8 0.00 100.0000 FORMAT "%8.4" EXTENDED_LIMITS -327.6800 327.6700 DEPOSIT ABSOLUTE /end AXIS_DESCR
/end CHARACTERISTIC
/begin CHARACTERISTIC EGSys_tiDebLSU0_C "Entprellzeit Heizungsfreigabe Lambdasonde 0" VAL_BLK 0xCCEC2 Kwb_Wu16 20.00000 Time_s 0.00 20.00000 FORMAT "%8.5" EXTENDED_LIMITS 0.00 655.3500 NUMBER 1 /end CHARACTERISTIC
/begin CHARACTERISTIC EGSys_tiDebNrmTransOk_C "Entprellzeit zur Verzögerung der Berechnungen nach Start bis gültige Temperaturen anliegen" VALUE 0xCCEC4 Kw_Ws16 1000.000 TimeDeb 0.00 1000.000 FORMAT "%8.3" EXTENDED_LIMITS -327680.0 327670.0 /end CHARACTERISTIC
/begin CHARACTERISTIC EGSys_tiHaValClnt_C "Abkühl-Halbwertszeit Motor" VALUE 0xCD6AC Kw_Wu32 42949672.9500 Time_s 0.00 42949672.9500 FORMAT "%13.4" /end CHARACTERISTIC
/begin CHARACTERISTIC EGSys_tiHaValNSC_C "Abkühl-Halbwertszeit NSC" VALUE 0xCD6B0 Kw_Wu32 42949672.9500 Time_s 0.00 42949672.9500 FORMAT "%13.4" /end CHARACTERISTIC
/begin CHARACTERISTIC EGSys_tiHaValOxiCat_C "Abkühl-Halbwertszeit Oxidationskatalysator" VALUE 0xCD6B4 Kw_Wu32 42949672.9500 Time_s 0.00 42949672.9500 FORMAT "%13.4" /end CHARACTERISTIC
/begin CHARACTERISTIC EGSys_tiHaValTrb_C "Abkühlen der Halbzeit-Periode turbocharge" VALUE 0xCD6B8 Kw_Wu32 42949672.9500 Time_s 0.00 42949672.9500 FORMAT "%13.4" /end CHARACTERISTIC
/begin CHARACTERISTIC EGSys_tiHaValTube_C "Abkühl-Halbwertszeit Abgasrohr" VAL_BLK 0xCD6BC Kwb_Wu32 42949672.9500 Time_s 0.00 42949672.9500 FORMAT "%13.4" NUMBER 2 /end CHARACTERISTIC
/begin CHARACTERISTIC EGSys_tiHtgDelLSU_C "Verzögerung der Heizungsfreigabe im Fehlerfall" VAL_BLK 0xCCEC8 Kwb_Wu32 42949672.9500 Time_s 0.00 42949672.9500 FORMAT "%13.4" NUMBER 1 /end CHARACTERISTIC
/begin CHARACTERISTIC EGSys_tIntegIni_C "Temperaturschwellwert für die Aktivierung des Wärmemengenintegrators" VAL_BLK 0xCCECC Kwb_Ws16 250.0000 Temp_Cels -50.1400 199.8600 FORMAT "%8.4" EXTENDED_LIMITS -3549.940 3003.560 NUMBER 1 /end CHARACTERISTIC
/begin CHARACTERISTIC EGSys_tiOfsClg_C "Abkühlzeitkorrektur Motor wg. Stauwärmeeffekten" VALUE 0xCD6C4 Kw_Wu32 42949672.9500 Time_s 0.00 42949672.9500 FORMAT "%13.4" /end CHARACTERISTIC
/begin CHARACTERISTIC EGSys_tiPlsLSU_C "Minimale Dauer für gültigen Gaspuls" VAL_BLK 0xCCECE Kwb_Wu16 20.00000 Time_s 0.00 20.00000 FORMAT "%8.5" EXTENDED_LIMITS 0.00 655.3500 NUMBER 1 /end CHARACTERISTIC
/begin CHARACTERISTIC EGSys_tManfDfl_C "Vorgabewert Abgaskrümmertemperatur im Fehlerfall" VALUE 0xCD416 Kw_Ws16 950.000 Temp_Cels -50.140 899.860 FORMAT "%8.3" EXTENDED_LIMITS -3549.940 3003.560 /end CHARACTERISTIC
/begin CHARACTERISTIC EGSys_tManfStat_MAP "Kennfeld zur Ermittlung der stationären Abgaskrümmertemperatur" MAP 0xCD418 Kf_Xs16_Ys16_Ws16 950.000 Temp_Cels -50.140 899.860 FORMAT "%8.3" EXTENDED_LIMITS -3549.940 3003.560
 /begin AXIS_DESCR STD_AXIS Eng_nAvrg EngN 10 0.00 8000.000 FORMAT "%8.3" EXTENDED_LIMITS -32768.00 32767.00 DEPOSIT ABSOLUTE /end AXIS_DESCR
 /begin AXIS_DESCR STD_AXIS InjCtl_qCurr InjMassCyc 8 0.00 100.0000 FORMAT "%8.4" EXTENDED_LIMITS -327.6800 327.6700 DEPOSIT ABSOLUTE /end AXIS_DESCR
/end CHARACTERISTIC
/begin CHARACTERISTIC EGSys_tNSCDfl_C "Ersatzwert für NSC Temperatur" VALUE 0xCD4EA Kw_Ws16 950.000 Temp_Cels -50.140 899.860 FORMAT "%8.3" EXTENDED_LIMITS -3549.940 3003.560 /end CHARACTERISTIC
/begin CHARACTERISTIC EGSys_tNSCExoIncr_MAP "Kennfeld für Temperaturerhöhung im NSC aufgrund chemischer Reaktionen" MAP 0xCD4EC Kf_Xs16_Ys16_Ws16 1095.000 TempDiff_Cels -45.00000 1050.000 FORMAT "%8.3" EXTENDED_LIMITS -3276.800 3276.700
 /begin AXIS_DESCR STD_AXIS EGSys_tAvrgNSC_mp Temp_Cels 8 -50.140 899.860 FORMAT "%8.3" EXTENDED_LIMITS -3549.940 3003.560 DEPOSIT ABSOLUTE /end AXIS_DESCR
 /begin AXIS_DESCR STD_AXIS EGSys_rLmbdAprx lambda 8 -30.00000 30.00000 FORMAT "%8.5" EXTENDED_LIMITS -32.76800 32.76700 DEPOSIT ABSOLUTE /end AXIS_DESCR
/end CHARACTERISTIC
/begin CHARACTERISTIC EGSys_tOxiCatDfl_C "Ersatzwert Oxidationskatalysatortemperatur" VALUE 0xCD5BE Kw_Ws16 950.000 Temp_Cels -50.140 899.860 FORMAT "%8.3" EXTENDED_LIMITS -3549.940 3003.560 /end CHARACTERISTIC
/begin CHARACTERISTIC EGSys_tOxiCatExoIncr_MAP "Kennfeld für Tempertaturerhöhung im Oxidationskatalysator aufgrund chemischer Reaktionen" MAP 0xCD5C0 Kf_Xs16_Ys16_Ws16 1095.000 TempDiff_Cels -45.00000 1050.000 FORMAT "%8.3" EXTENDED_LIMITS -3276.800 3276.700
 /begin AXIS_DESCR STD_AXIS EGSys_tAvrgOxiCat_mp Temp_Cels 8 -50.140 899.860 FORMAT "%8.3" EXTENDED_LIMITS -3549.940 3003.560 DEPOSIT ABSOLUTE /end AXIS_DESCR
 /begin AXIS_DESCR STD_AXIS EGSys_rLmbdAprx lambda 8 -30.00000 30.00000 FORMAT "%8.5" EXTENDED_LIMITS -32.76800 32.76700 DEPOSIT ABSOLUTE /end AXIS_DESCR
/end CHARACTERISTIC
/begin CHARACTERISTIC EGSys_tStrtCsRepl_C "Ersatzwert für Initialisierungstemperaturen der abgasführen den Bauteile im Fehlerfall" VALUE 0xCD6C8 Kw_Ws16 950.000 Temp_Cels -50.140 899.860 FORMAT "%8.3" EXTENDED_LIMITS -3549.940 3003.560 /end CHARACTERISTIC
/begin CHARACTERISTIC EGSys_tThresLSUAct_C "Temperaturschwellwert für reversible TPE" VAL_BLK 0xCCED0 Kwb_Ws16 250.0000 Temp_Cels -50.1400 199.8600 FORMAT "%8.4" EXTENDED_LIMITS -3549.940 3003.560 NUMBER 1 /end CHARACTERISTIC
/begin CHARACTERISTIC EGSys_tTubeDfl_C "Ersatzwert Abgasrohr-Temperatur" VAL_BLK 0xCD7FC Kwb_Ws16 950.000 Temp_Cels -50.140 899.860 FORMAT "%8.3" EXTENDED_LIMITS -3549.940 3003.560 NUMBER 2 /end CHARACTERISTIC
/begin CHARACTERISTIC EGSys_tTubeIKi_C "I-Verstärkung Integrator zur Abgasrohr-Temperaturmodellierung" VALUE 0xCD800 Kw_Wu32 4.00003045797 Ki_Kelv_Sec 0.00 4.00003045797 FORMAT "%13.11" EXTENDED_LIMITS 0.00 9999999.99767 /end CHARACTERISTIC
/begin CHARACTERISTIC EGSys_tTubeIKiPos_C "I-Verstärkung Integrator Abgasrohr-Temperaturmodellierung für pos. Großsignalbereich" VALUE 0xCD804 Kw_Wu32 4.00003045797 Ki_Kelv_Sec 0.00 4.00003045797 FORMAT "%13.11" EXTENDED_LIMITS 0.00 9999999.99767 /end CHARACTERISTIC
/begin CHARACTERISTIC EGSys_tTubeIKiNeg_C "I-Verstärkung Integrator Abgasrohr-Temperaturmodellierung für neg. Großsignalbereich" VALUE 0xCD808 Kw_Wu32 4.00003045797 Ki_Kelv_Sec 0.00 4.00003045797 FORMAT "%13.11" EXTENDED_LIMITS 0.00 9999999.99767 /end CHARACTERISTIC
/begin CHARACTERISTIC EGSys_tTubeIWinPos_C "Obere Kleinstwertgrenze Integrator zur Abgasrohr-Temperaturmodellierung" VALUE 0xCD80C Kw_Ws16 65535.00 OneToOne -32768.00 32767.00 FORMAT "%8.2" READ_ONLY /end CHARACTERISTIC
/begin CHARACTERISTIC EGSys_tTubeIWinNeg_C "Untere Kleinstwertgrenze Integrator zur Abgasrohr-Temperaturmodellierung" VALUE 0xCD80E Kw_Ws16 65535.00 OneToOne -32768.00 32767.00 FORMAT "%8.2" READ_ONLY /end CHARACTERISTIC
/begin CHARACTERISTIC EGSys_tWtEquiv_C "äquivalente Wassertemperatur beim Verdampfen" VAL_BLK 0xCCED2 Kwb_Ws16 950.000 Temp_Cels -50.140 899.860 FORMAT "%8.3" EXTENDED_LIMITS -3549.940 3003.560 NUMBER 1 /end CHARACTERISTIC
/begin CHARACTERISTIC EGSys_vscDynEG_CUR "Dynamische Viskosität Abgas (nicht applizierbar)" CURVE 0xCD15A Kl_Xs16_Ws16 0.9998779 Fact 0.0001220703 1.000000 FORMAT "%8.6" EXTENDED_LIMITS -4.000000 3.999878 READ_ONLY
 /begin AXIS_DESCR STD_AXIS EGSys_tEGLSUInpCrv0_mp Temp_Cels 8 -50.140 899.860 FORMAT "%8.3" EXTENDED_LIMITS -3549.940 3003.560 DEPOSIT ABSOLUTE /end AXIS_DESCR
/end CHARACTERISTIC
/begin CHARACTERISTIC EGSys_vscKinEG_CUR "Kinematische Viskosität Abgas (nicht applizierbar)" CURVE 0xCD17C Kl_Xs16_Ws16 0.9998779 Fact 0.0001220703 1.000000 FORMAT "%8.6" EXTENDED_LIMITS -4.000000 3.999878 READ_ONLY
 /begin AXIS_DESCR STD_AXIS EGSys_tEGLSUInpCrv0_mp Temp_Cels 8 -50.140 899.860 FORMAT "%8.3" EXTENDED_LIMITS -3549.940 3003.560 DEPOSIT ABSOLUTE /end AXIS_DESCR
/end CHARACTERISTIC
/begin CHARACTERISTIC EGSys_wLSUIKi_C "Verstärkung des Integrators" VAL_BLK 0xCCED4 Kwb_Ws16 5.000000 OneToOne 0.00 5.000000 FORMAT "%8.6" EXTENDED_LIMITS -32768.00 32767.00 NUMBER 1 /end CHARACTERISTIC
/begin CHARACTERISTIC EGSys_wThresLSU0_MAP "Wärmeschwellen Grundkennfeld Lambdasonde 0" MAP 0xCCED6 Kf_Xs16_Ys16_Ws16 6000.000 Energy 0.00 6000.000 FORMAT "%8.3" EXTENDED_LIMITS -32768.00 32767.00
 /begin AXIS_DESCR STD_AXIS EGSys_tEGLSUInpCrv0_mp Temp_Cels 10 -50.140 899.860 FORMAT "%8.3" EXTENDED_LIMITS -3549.940 3003.560 DEPOSIT ABSOLUTE /end AXIS_DESCR
 /begin AXIS_DESCR STD_AXIS Eng_tEng Temp_Cels 10 -50.140 899.860 FORMAT "%8.3" EXTENDED_LIMITS -3549.940 3003.560 DEPOSIT ABSOLUTE /end AXIS_DESCR
/end CHARACTERISTIC
/begin CHARACTERISTIC EGT_facKiAMPT_MAP "Grundwert I-Anteil des Reglereingriffs über Luftmasse" MAP 0xCD824 Kf_Xs16_Ys16_Ws16 0.06000046 Ki_Temp2EGTFact 0.00 0.06000046 FORMAT "%10.8" EXTENDED_LIMITS -0.03814697 0.03814581
 /begin AXIS_DESCR STD_AXIS Eng_nAvrg EngN 8 0.00 6000.000 FORMAT "%8.3" EXTENDED_LIMITS -32768.00 32767.00 DEPOSIT ABSOLUTE /end AXIS_DESCR
 /begin AXIS_DESCR STD_AXIS InjCtl_qSetUnBal InjMassCyc 8 0.00 327.6700 FORMAT "%8.4" EXTENDED_LIMITS -327.6800 327.6700 DEPOSIT ABSOLUTE /end AXIS_DESCR
/end CHARACTERISTIC
/begin CHARACTERISTIC EGT_facKiInrTempGvnr_C "Korrekturfaktor des I-Anteils bei Großsignalverstärkung des inneren Reglers" VALUE 0xCD8C8 Kw_Wu32 4.00000000000 Fact1 0.00 4.00000000000 FORMAT "%13.11" EXTENDED_LIMITS 0.00 33554431.9922 /end CHARACTERISTIC
/begin CHARACTERISTIC EGT_facKiOutrTempGvnr_C "Korrekturfaktor des I-Anteils bei Großsignalvertsärkung des äußeren Reglers" VALUE 0xCD8CC Kw_Wu32 4.00000000000 Fact1 0.00 4.00000000000 FORMAT "%13.11" EXTENDED_LIMITS 0.00 33554431.9922 /end CHARACTERISTIC
/begin CHARACTERISTIC EGT_facKiQntPoI1_MAP "Grundwert I-Anteil des äußeren Reglers bei Eingriff über Einspritzung" MAP 0xCD8D0 Kf_Xs16_Ys16_Ws16 0.06000046 Ki_Temp2EGTFact 0.00 0.06000046 FORMAT "%10.8" EXTENDED_LIMITS -0.03814697 0.03814581
 /begin AXIS_DESCR STD_AXIS Eng_nAvrg EngN 8 0.00 6000.000 FORMAT "%8.3" EXTENDED_LIMITS -32768.00 32767.00 DEPOSIT ABSOLUTE /end AXIS_DESCR
 /begin AXIS_DESCR STD_AXIS InjCtl_qSetUnBal InjMassCyc 8 0.00 327.6700 FORMAT "%8.4" EXTENDED_LIMITS -327.6800 327.6700 DEPOSIT ABSOLUTE /end AXIS_DESCR
/end CHARACTERISTIC
/begin CHARACTERISTIC EGT_facKiQntPoI2_MAP "Grundwert I-Anteil des inneren Reglers bei Eingriff über Einspritzung" MAP 0xCD974 Kf_Xs16_Ys16_Ws16 0.06000046 Ki_Temp2EGTFact 0.00 0.06000046 FORMAT "%10.8" EXTENDED_LIMITS -0.03814697 0.03814581
 /begin AXIS_DESCR STD_AXIS Eng_nAvrg EngN 8 0.00 6000.000 FORMAT "%8.3" EXTENDED_LIMITS -32768.00 32767.00 DEPOSIT ABSOLUTE /end AXIS_DESCR
 /begin AXIS_DESCR STD_AXIS InjCtl_qSetUnBal InjMassCyc 8 0.00 327.6700 FORMAT "%8.4" EXTENDED_LIMITS -327.6800 327.6700 DEPOSIT ABSOLUTE /end AXIS_DESCR
/end CHARACTERISTIC
/begin CHARACTERISTIC EGT_facKiTempInrCor_MAP "Grundwert I-Anteil des inneren Reglers bei Eingriff über Temperatursollwert" MAP 0xCDA18 Kf_Xs16_Ys16_Ws16 0.06000046 Ki_Temp2EGTFact 0.00 0.06000046 FORMAT "%10.8" EXTENDED_LIMITS -0.03814697 0.03814581
 /begin AXIS_DESCR STD_AXIS Eng_nAvrg EngN 8 0.00 6000.000 FORMAT "%8.3" EXTENDED_LIMITS -32768.00 32767.00 DEPOSIT ABSOLUTE /end AXIS_DESCR
 /begin AXIS_DESCR STD_AXIS InjCtl_qSetUnBal InjMassCyc 8 0.00 327.6700 FORMAT "%8.4" EXTENDED_LIMITS -327.6800 327.6700 DEPOSIT ABSOLUTE /end AXIS_DESCR
/end CHARACTERISTIC
/begin CHARACTERISTIC EGT_facKpAMPT_MAP "Grundwert P-Anteil des inneren Reglers bei Eingriff über Luftmasse" MAP 0xCDABC Kf_Xs16_Ys16_Ws16 0.06000000 Kp_Temp2EGTFact 0.00 0.06000000 FORMAT "%10.8" EXTENDED_LIMITS -0.6400000 0.6399805
 /begin AXIS_DESCR STD_AXIS Eng_nAvrg EngN 8 0.00 6000.000 FORMAT "%8.3" EXTENDED_LIMITS -32768.00 32767.00 DEPOSIT ABSOLUTE /end AXIS_DESCR
 /begin AXIS_DESCR STD_AXIS InjCtl_qSetUnBal InjMassCyc 8 0.00 327.6700 FORMAT "%8.4" EXTENDED_LIMITS -327.6800 327.6700 DEPOSIT ABSOLUTE /end AXIS_DESCR
/end CHARACTERISTIC
/begin CHARACTERISTIC EGT_facKpInrTempGvnr_C "Korrekturfaktor P-Anteil bei Großsignalverstärkung des inneren Reglers" VALUE 0xCDB60 Kw_Ws32 4.00000000000 Fact1 0.00 4.00000000000 FORMAT "%13.11" EXTENDED_LIMITS -16777216.0000 16777215.9922 /end CHARACTERISTIC
/begin CHARACTERISTIC EGT_facKpOutrTempGvnr_C "Korrekturfaktor P-Anteil bei Großsignalverstärkung des äußeren Reglers" VALUE 0xCDB64 Kw_Ws32 4.00000000000 Fact1 0.00 4.00000000000 FORMAT "%13.11" EXTENDED_LIMITS -16777216.0000 16777215.9922 /end CHARACTERISTIC
/begin CHARACTERISTIC EGT_facKpQntPoI1_MAP "Grundwert P-Anteil des äußeren Reglers bei Eingriff über Einspritzung" MAP 0xCDB68 Kf_Xs16_Ys16_Ws16 0.06000000 Kp_Temp2EGTFact 0.00 0.06000000 FORMAT "%10.8" EXTENDED_LIMITS -0.6400000 0.6399805
 /begin AXIS_DESCR STD_AXIS Eng_nAvrg EngN 8 0.00 6000.000 FORMAT "%8.3" EXTENDED_LIMITS -32768.00 32767.00 DEPOSIT ABSOLUTE /end AXIS_DESCR
 /begin AXIS_DESCR STD_AXIS InjCtl_qSetUnBal InjMassCyc 8 0.00 327.6700 FORMAT "%8.4" EXTENDED_LIMITS -327.6800 327.6700 DEPOSIT ABSOLUTE /end AXIS_DESCR
/end CHARACTERISTIC
/begin CHARACTERISTIC EGT_facKpQntPoI2_MAP "Grundwert P-Anteil des inneren Reglers bei Eingriff über Einspritzung" MAP 0xCDC0C Kf_Xs16_Ys16_Ws16 0.06000000 Kp_Temp2EGTFact 0.00 0.06000000 FORMAT "%10.8" EXTENDED_LIMITS -0.6400000 0.6399805
 /begin AXIS_DESCR STD_AXIS Eng_nAvrg EngN 8 0.00 6000.000 FORMAT "%8.3" EXTENDED_LIMITS -32768.00 32767.00 DEPOSIT ABSOLUTE /end AXIS_DESCR
 /begin AXIS_DESCR STD_AXIS InjCtl_qSetUnBal InjMassCyc 8 0.00 327.6700 FORMAT "%8.4" EXTENDED_LIMITS -327.6800 327.6700 DEPOSIT ABSOLUTE /end AXIS_DESCR
/end CHARACTERISTIC
/begin CHARACTERISTIC EGT_facKpTempInrCor_MAP "Grundwert P-Anteil des inneren Reglers bei Eingriff über Temperatursollwert" MAP 0xCDCB0 Kf_Xs16_Ys16_Ws16 0.06000000 Kp_Temp2EGTFact 0.00 0.06000000 FORMAT "%10.8" EXTENDED_LIMITS -0.6400000 0.6399805
 /begin AXIS_DESCR STD_AXIS Eng_nAvrg EngN 8 0.00 6000.000 FORMAT "%8.3" EXTENDED_LIMITS -32768.00 32767.00 DEPOSIT ABSOLUTE /end AXIS_DESCR
 /begin AXIS_DESCR STD_AXIS InjCtl_qSetUnBal InjMassCyc 8 0.00 327.6700 FORMAT "%8.4" EXTENDED_LIMITS -327.6800 327.6700 DEPOSIT ABSOLUTE /end AXIS_DESCR
/end CHARACTERISTIC
/begin CHARACTERISTIC EGT_facQntPoI2Rmp_CUR "Anpassung Rampenwert an PoI2" CURVE 0xCF4B8 Kl_Xs16_Ws16 1.000000 EGTSwt_S16 0.00 1.000000 FORMAT "%8.6" EXTENDED_LIMITS -2.000000 1.999939
 /begin AXIS_DESCR STD_AXIS EGT_facRmp_mp EGTSwt_S16 3 0.00 1.000000 FORMAT "%8.6" EXTENDED_LIMITS -2.000000 1.999939 DEPOSIT ABSOLUTE /end AXIS_DESCR
/end CHARACTERISTIC
/begin CHARACTERISTIC EGT_mAirDesTempGvnrMnl_C "Manueller Defaultwert für Luftmassensollwertkorektur" VALUE 0xCF4C6 Kw_Ws16 10000.00 AirMassPerCyl -5000.000 5000.000 FORMAT "%8.3" EXTENDED_LIMITS -3276.800 3276.700 /end CHARACTERISTIC
/begin CHARACTERISTIC EGT_mAirLmbd_CUR "Luftmassenkorrektur über Lambdawert" CURVE 0xCF4C8 Kl_Xs16_Ws16 10000.00 AirMassPerCyl -5000.000 5000.000 FORMAT "%8.3" EXTENDED_LIMITS -3276.800 3276.700
 /begin AXIS_DESCR STD_AXIS PFlt_rLmbd lambda 8 0.00 7.000000 FORMAT "%8.6" EXTENDED_LIMITS -32.76800 32.76700 DEPOSIT ABSOLUTE /end AXIS_DESCR
/end CHARACTERISTIC
/begin CHARACTERISTIC EGT_mAirTempGvnrMax_MAP "Maximal mögliche Luftmassensollwertkorrektur" MAP 0xCDD54 Kf_Xs16_Ys16_Ws16 5000.000 AirMassPerCyl 0.00 5000.000 FORMAT "%8.3" EXTENDED_LIMITS -3276.800 3276.700
 /begin AXIS_DESCR STD_AXIS Eng_nAvrg EngN 16 0.00 6000.000 FORMAT "%8.3" EXTENDED_LIMITS -32768.00 32767.00 DEPOSIT ABSOLUTE /end AXIS_DESCR
 /begin AXIS_DESCR STD_AXIS InjCtl_qSetUnBal InjMassCyc 16 0.00 327.6700 FORMAT "%8.4" EXTENDED_LIMITS -327.6800 327.6700 DEPOSIT ABSOLUTE /end AXIS_DESCR
/end CHARACTERISTIC
/begin CHARACTERISTIC EGT_mAirTempGvnrMin_MAP "Minimal mögliche Luftmassensollwertkorrektur" MAP 0xCDF98 Kf_Xs16_Ys16_Ws16 5000.000 AirMassPerCyl -5000.000 0.00 FORMAT "%8.3" EXTENDED_LIMITS -3276.800 3276.700
 /begin AXIS_DESCR STD_AXIS Eng_nAvrg EngN 16 0.00 6000.000 FORMAT "%8.3" EXTENDED_LIMITS -32768.00 32767.00 DEPOSIT ABSOLUTE /end AXIS_DESCR
 /begin AXIS_DESCR STD_AXIS InjCtl_qSetUnBal InjMassCyc 16 0.00 327.6700 FORMAT "%8.4" EXTENDED_LIMITS -327.6800 327.6700 DEPOSIT ABSOLUTE /end AXIS_DESCR
/end CHARACTERISTIC
/begin CHARACTERISTIC EGT_phiPoI1TempGvnr_MAP "Additive Winkelkorrektur der verzögerten Nacheinspritzung" MAP 0xCF4EA Kf_Xs16_Ys16_Ws16 399.9844 AngleCrS -199.9922 199.9922 FORMAT "%8.4" EXTENDED_LIMITS -768.0000 767.9766
 /begin AXIS_DESCR STD_AXIS Eng_nAvrg EngN 8 0.00 6000.000 FORMAT "%8.3" EXTENDED_LIMITS -32768.00 32767.00 DEPOSIT ABSOLUTE /end AXIS_DESCR
 /begin AXIS_DESCR STD_AXIS InjCtl_qSetUnBal InjMassCyc 8 0.00 327.6700 FORMAT "%8.4" EXTENDED_LIMITS -327.6800 327.6700 DEPOSIT ABSOLUTE /end AXIS_DESCR
/end CHARACTERISTIC
/begin CHARACTERISTIC EGT_qHCQntPoI1_CUR "Einspritzmengenkorrektur für HC-Dosierventil" CURVE 0xCF58E Kl_Xs16_Ws16 400.0000 InjMassInj -200.0000 200.0000 FORMAT "%8.4" EXTENDED_LIMITS -327.6800 327.6700
 /begin AXIS_DESCR STD_AXIS EGT_qPoI1OutrTempGvnr InjMassInj 1 -200.0000 200.0000 FORMAT "%8.4" EXTENDED_LIMITS -327.6800 327.6700 DEPOSIT ABSOLUTE /end AXIS_DESCR
/end CHARACTERISTIC
/begin CHARACTERISTIC EGT_qPoI1Min_C "Minimalwert der angelagerten Nacheinspritzung" VALUE 0xCE1DC Kw_Ws16 327.6700 InjMassInj 0.00 327.6700 FORMAT "%8.4" EXTENDED_LIMITS -327.6800 327.6700 /end CHARACTERISTIC
/begin CHARACTERISTIC EGT_qPoI1TempGvnrMax_MAP "Maximal mögliche Korrektur der angelagerten Nacheinspritzung" MAP 0xCE1DE Kf_Xs16_Ys16_Ws16 200.0000 InjMassInj 0.00 200.0000 FORMAT "%8.4" EXTENDED_LIMITS -327.6800 327.6700
 /begin AXIS_DESCR STD_AXIS Eng_nAvrg EngN 16 0.00 6000.000 FORMAT "%8.3" EXTENDED_LIMITS -32768.00 32767.00 DEPOSIT ABSOLUTE /end AXIS_DESCR
 /begin AXIS_DESCR STD_AXIS InjCtl_qSetUnBal InjMassCyc 16 0.00 327.6700 FORMAT "%8.4" EXTENDED_LIMITS -327.6800 327.6700 DEPOSIT ABSOLUTE /end AXIS_DESCR
/end CHARACTERISTIC
/begin CHARACTERISTIC EGT_qPoI1TempGvnrMin_MAP "Minimal mögliche Korrektur der angelagerten Nacheinspritzung" MAP 0xCE422 Kf_Xs16_Ys16_Ws16 200.0000 InjMassInj -200.0000 0.00 FORMAT "%8.4" EXTENDED_LIMITS -327.6800 327.6700
 /begin AXIS_DESCR STD_AXIS Eng_nAvrg EngN 16 0.00 6000.000 FORMAT "%8.3" EXTENDED_LIMITS -32768.00 32767.00 DEPOSIT ABSOLUTE /end AXIS_DESCR
 /begin AXIS_DESCR STD_AXIS InjCtl_qSetUnBal InjMassCyc 16 0.00 327.6700 FORMAT "%8.4" EXTENDED_LIMITS -327.6800 327.6700 DEPOSIT ABSOLUTE /end AXIS_DESCR
/end CHARACTERISTIC
/begin CHARACTERISTIC EGT_qPoI1TempGvnrMnl_C "Manueller Defaultwert der angelagerten Nacheinspritzung" VALUE 0xCF594 Kw_Ws16 400.0000 InjMassInj -200.0000 200.0000 FORMAT "%8.4" EXTENDED_LIMITS -327.6800 327.6700 /end CHARACTERISTIC
/begin CHARACTERISTIC EGT_qPoI2Min_C "Minimalwert der angelagerten Nacheinspritzung" VALUE 0xCE666 Kw_Ws16 327.6700 InjMassInj 0.00 327.6700 FORMAT "%8.4" EXTENDED_LIMITS -327.6800 327.6700 /end CHARACTERISTIC
/begin CHARACTERISTIC EGT_qPoI2TempGvnrMax_MAP "Maximal mögliche Korrekturmenge der angelagerten Nacheinspritzung" MAP 0xCE668 Kf_Xs16_Ys16_Ws16 200.0000 InjMassInj 0.00 200.0000 FORMAT "%8.4" EXTENDED_LIMITS -327.6800 327.6700
 /begin AXIS_DESCR STD_AXIS Eng_nAvrg EngN 16 0.00 6000.000 FORMAT "%8.3" EXTENDED_LIMITS -32768.00 32767.00 DEPOSIT ABSOLUTE /end AXIS_DESCR
 /begin AXIS_DESCR STD_AXIS InjCtl_qSetUnBal InjMassCyc 16 0.00 327.6700 FORMAT "%8.4" EXTENDED_LIMITS -327.6800 327.6700 DEPOSIT ABSOLUTE /end AXIS_DESCR
/end CHARACTERISTIC
/begin CHARACTERISTIC EGT_qPoI2TempGvnrMin_MAP "Minimal mögliche Korrekturmenge der angelagerten Nacheinspritzung" MAP 0xCE8AC Kf_Xs16_Ys16_Ws16 200.0000 InjMassInj -200.0000 0.00 FORMAT "%8.4" EXTENDED_LIMITS -327.6800 327.6700
 /begin AXIS_DESCR STD_AXIS Eng_nAvrg EngN 16 0.00 6000.000 FORMAT "%8.3" EXTENDED_LIMITS -32768.00 32767.00 DEPOSIT ABSOLUTE /end AXIS_DESCR
 /begin AXIS_DESCR STD_AXIS InjCtl_qSetUnBal InjMassCyc 16 0.00 327.6700 FORMAT "%8.4" EXTENDED_LIMITS -327.6800 327.6700 DEPOSIT ABSOLUTE /end AXIS_DESCR
/end CHARACTERISTIC
/begin CHARACTERISTIC EGT_qPoI2TempGvnrMnl_C "Manueller Defaultwert der angelagerten Nacheinspritzung" VALUE 0xCF596 Kw_Ws16 400.0000 InjMassInj -200.0000 200.0000 FORMAT "%8.4" EXTENDED_LIMITS -327.6800 327.6700 /end CHARACTERISTIC
/begin CHARACTERISTIC EGT_rInrDvtThres_C "Schwelle für Großsignalverstärkung des inneren Reglers" VALUE 0xCEAF0 Kw_Ws16 6.000000 EGTFact -3.000000 3.000000 FORMAT "%8.6" EXTENDED_LIMITS -32.76800 32.76700 /end CHARACTERISTIC
/begin CHARACTERISTIC EGT_rOutrDvtThres_C "Schwelle für Großsignalverstärkung des äußeren Regelkreises" VALUE 0xCEAF2 Kw_Ws16 6.000000 EGTFact -3.000000 3.000000 FORMAT "%8.6" EXTENDED_LIMITS -32.76800 32.76700 /end CHARACTERISTIC
/begin CHARACTERISTIC EGT_stMskClsThrVlv_C "Bitmaske Anforderung maximale Androsselung" VALUE 0xCEAF4 Kw_Wu32 2147483647.00 OneToOne 0.00 2147483647.00 FORMAT "%13.2" EXTENDED_LIMITS 0.00 4294967295.00 /end CHARACTERISTIC
/begin CHARACTERISTIC EGT_stMskInrTempGvnr_C "Maske Aktivierung innerer Regelkreis" VALUE 0xCF49C Kw_Wu32 2147483647.00 OneToOne 0.00 2147483647.00 FORMAT "%13.2" EXTENDED_LIMITS 0.00 4294967295.00 /end CHARACTERISTIC
/begin CHARACTERISTIC EGT_stMskOutrTempGvnr_C "Maske Aktivierung äußerer Regelkreis" VALUE 0xCF4A0 Kw_Wu32 2147483647.00 OneToOne 0.00 2147483647.00 FORMAT "%13.2" EXTENDED_LIMITS 0.00 4294967295.00 /end CHARACTERISTIC
/begin CHARACTERISTIC EGT_stRgnLckMsk_C "Maske zur Blockierung und Aktivierung der Regenerationsmaßnahmen" VALUE 0xCD810 Kw_Wu32 2147483647.00 OneToOne 0.00 2147483647.00 FORMAT "%13.2" EXTENDED_LIMITS 0.00 4294967295.00 /end CHARACTERISTIC
/begin CHARACTERISTIC EGT_stTSync_Vector "#SSD Konfigurationslabel für Bypass" VALUE 0xC2EB6 Kw_Wu8 255.0 OneToOne 0.00 255.0 FORMAT "%5.1" /end CHARACTERISTIC
/begin CHARACTERISTIC EGT_stTSync_Channel "#SSD Konfigurationslabels für Bypass" VALUE 0xC2EB7 Kw_Wu8 255.0 OneToOne 0.00 255.0 FORMAT "%5.1" /end CHARACTERISTIC
/begin CHARACTERISTIC EGT_swtBiTrbTempGvnr_C "Bi-Turbo Schalter" VALUE 0xCEAF8 Kw_Wu8 1.000 OneToOne 0.00 1.000 FORMAT "%5.3" EXTENDED_LIMITS 0.00 255.0 /end CHARACTERISTIC
/begin CHARACTERISTIC EGT_swtInrTempOutr_C "Innerer Regelkreis aktiv" VALUE 0xCEAF9 Kw_Wu8 1.000 OneToOne 0.00 1.000 FORMAT "%5.3" EXTENDED_LIMITS 0.00 255.0 /end CHARACTERISTIC
/begin CHARACTERISTIC EGT_swtQntPoI1HC_C "Umschaltung angelagerte Nacheinspritzung / HC Dosierventil" VALUE 0xCF598 Kw_Wu8 1.000 OneToOne 0.00 1.000 FORMAT "%5.3" EXTENDED_LIMITS 0.00 255.0 /end CHARACTERISTIC
/begin CHARACTERISTIC EGT_swtRgnLckRst_C "Schalter zum Rücksetzen der Verriegelung der Regenerationsmaßnahmen bei kritischer Ölverdünnungszeit" VALUE 0xCD814 Kw_Wu8 1.000 OneToOne 0.00 1.000 FORMAT "%5.3" EXTENDED_LIMITS 0.00 255.0 /end CHARACTERISTIC
/begin CHARACTERISTIC EGT_swtServiceVal_C "Serviceschalter zur Rücksetzung nach Ölwechsel" VALUE 0xCD815 Kw_Wu8 1.000 OneToOne 0.00 1.000 FORMAT "%5.3" EXTENDED_LIMITS 0.00 255.0 /end CHARACTERISTIC
/begin CHARACTERISTIC EGT_swtTempInrDes_C "Schalter für kundenspezifischen Sollwert (innerer Regelkreis)" VALUE 0xCEF88 Kw_Wu8 1.000 OneToOne 0.00 1.000 FORMAT "%5.3" EXTENDED_LIMITS 0.00 255.0 /end CHARACTERISTIC
/begin CHARACTERISTIC EGT_swtTempOutrDes_C "Schalter für kundenspezifischen Sollwert (äußerer Regelkreis)" VALUE 0xCEF89 Kw_Wu8 1.000 OneToOne 0.00 1.000 FORMAT "%5.3" EXTENDED_LIMITS 0.00 255.0 /end CHARACTERISTIC
/begin CHARACTERISTIC EGT_swtTempTurbPre_C "Schalter für Umschaltung Temperatur vor Turbine" VALUE 0xCEF8A Kw_Wu8 1.000 OneToOne 0.00 1.000 FORMAT "%5.3" EXTENDED_LIMITS 0.00 255.0 /end CHARACTERISTIC
/begin CHARACTERISTIC EGT_tiHiLoTempGvnr_C "Entprellzeit der Aktivierungsschwellen (high -> low) der Reglerkreise" VALUE 0xCF4A4 Kw_Wu16 30.00000 Time_s 0.00 30.00000 FORMAT "%8.5" EXTENDED_LIMITS 0.00 655.3500 /end CHARACTERISTIC
/begin CHARACTERISTIC EGT_tiLoHiTempGvnr_C "Entprellzeit für Aktivierungsschwellen (low -> high) der Reglerkreise" VALUE 0xCF4A6 Kw_Wu16 30.00000 Time_s 0.00 30.00000 FORMAT "%8.5" EXTENDED_LIMITS 0.00 655.3500 /end CHARACTERISTIC
/begin CHARACTERISTIC EGT_tInrCorTempGvnrMax_MAP "Maximal erlaubte Sollwertkorrektur des inneren Regelkreises" MAP 0xCEAFA Kf_Xs16_Ys16_Ws16 1600.000 TempDiff_Cels -100.0000 1500.000 FORMAT "%8.3" EXTENDED_LIMITS -3276.800 3276.700
 /begin AXIS_DESCR STD_AXIS Eng_nAvrg EngN 16 0.00 6000.000 FORMAT "%8.3" EXTENDED_LIMITS -32768.00 32767.00 DEPOSIT ABSOLUTE /end AXIS_DESCR
 /begin AXIS_DESCR STD_AXIS InjCtl_qSetUnBal InjMassCyc 16 0.00 327.6700 FORMAT "%8.4" EXTENDED_LIMITS -327.6800 327.6700 DEPOSIT ABSOLUTE /end AXIS_DESCR
/end CHARACTERISTIC
/begin CHARACTERISTIC EGT_tInrCorTempGvnrMin_MAP "Minimal erlaubte Sollwertkorrektur des inneren Regelkreises" MAP 0xCED3E Kf_Xs16_Ys16_Ws16 1500.000 TempDiff_Cels -1500.000 0.00 FORMAT "%8.3" EXTENDED_LIMITS -3276.800 3276.700
 /begin AXIS_DESCR STD_AXIS Eng_nAvrg EngN 16 0.00 6000.000 FORMAT "%8.3" EXTENDED_LIMITS -32768.00 32767.00 DEPOSIT ABSOLUTE /end AXIS_DESCR
 /begin AXIS_DESCR STD_AXIS InjCtl_qSetUnBal InjMassCyc 16 0.00 327.6700 FORMAT "%8.4" EXTENDED_LIMITS -327.6800 327.6700 DEPOSIT ABSOLUTE /end AXIS_DESCR
/end CHARACTERISTIC
/begin CHARACTERISTIC EGT_tInrDesTempTurb_CUR "Sollwertkorrektur des inneren Regelkreises in Abhängigkeit der Temperatur vor Turbolader" CURVE 0xCEF8C Kl_Xs16_Ws16 1600.000 TempDiff_Cels -100.0000 1500.000 FORMAT "%8.3" EXTENDED_LIMITS -3276.800 3276.700
 /begin AXIS_DESCR STD_AXIS PFlt_tTurbPre Temp_Cels 8 -50.140 899.860 FORMAT "%8.3" EXTENDED_LIMITS -3549.940 3003.560 DEPOSIT ABSOLUTE /end AXIS_DESCR
/end CHARACTERISTIC
/begin CHARACTERISTIC EGT_tInrDes_MAP "Grundwert der Solltemperatur des inneren Regelkreises" MAP 0xCEFAE Kf_Xs16_Ys16_Ws16 950.000 Temp_Cels -50.140 899.860 FORMAT "%8.3" EXTENDED_LIMITS -3549.940 3003.560
 /begin AXIS_DESCR STD_AXIS Eng_nAvrg EngN 16 0.00 6000.000 FORMAT "%8.3" EXTENDED_LIMITS -32768.00 32767.00 DEPOSIT ABSOLUTE /end AXIS_DESCR
 /begin AXIS_DESCR STD_AXIS InjCtl_qSetUnBal InjMassCyc 16 0.00 327.6700 FORMAT "%8.4" EXTENDED_LIMITS -327.6800 327.6700 DEPOSIT ABSOLUTE /end AXIS_DESCR
/end CHARACTERISTIC
/begin CHARACTERISTIC EGT_tInrThresDwn_C "Untere Temperaturschwelle des inneren Regelkreises" VALUE 0xCF4A8 Kw_Ws16 950.000 Temp_Cels -50.140 899.860 FORMAT "%8.3" EXTENDED_LIMITS -3549.940 3003.560 /end CHARACTERISTIC
/begin CHARACTERISTIC EGT_tInrThresUp_C "Obere Temperaturschwelle des inneren Regelkreises" VALUE 0xCF4AA Kw_Ws16 950.000 Temp_Cels -50.140 899.860 FORMAT "%8.3" EXTENDED_LIMITS -3549.940 3003.560 /end CHARACTERISTIC
/begin CHARACTERISTIC EGT_tiPoI1TThres_C "Wartezeit für Freigabe PoI1" VALUE 0xCEF84 Kw_Wu32 100.000000000 Time_s 0.00 100.000000000 FORMAT "%13.9" EXTENDED_LIMITS 0.00 42949672.9500 /end CHARACTERISTIC
/begin CHARACTERISTIC EGT_tiPoI2TempGvnr_MAP "Additive angle correction of the close post injection" MAP 0xCF59A Kf_Xs16_Ys16_Ws16 18000.00 InjTime_us -13000.00 5000.00 FORMAT "%8.2" EXTENDED_LIMITS -32768.00 32767.00
 /begin AXIS_DESCR STD_AXIS Eng_nAvrg EngN 8 0.00 6000.000 FORMAT "%8.3" EXTENDED_LIMITS -32768.00 32767.00 DEPOSIT ABSOLUTE /end AXIS_DESCR
 /begin AXIS_DESCR STD_AXIS InjCtl_qSetUnBal InjMassCyc 8 0.00 327.6700 FORMAT "%8.4" EXTENDED_LIMITS -327.6800 327.6700 DEPOSIT ABSOLUTE /end AXIS_DESCR
/end CHARACTERISTIC
/begin CHARACTERISTIC EGT_tiPoIHiLoTempGvnr_C "Entprellzeit für Nacheinspritzung (high -> low)" VALUE 0xCF4AC Kw_Wu16 30.00000 Time_s 0.00 30.00000 FORMAT "%8.5" EXTENDED_LIMITS 0.00 655.3500 /end CHARACTERISTIC
/begin CHARACTERISTIC EGT_tiPoILoHiTempGvnr_C "Entprellzeit für Nacheinspritzung (low -> high)" VALUE 0xCF4AE Kw_Wu16 30.00000 Time_s 0.00 30.00000 FORMAT "%8.5" EXTENDED_LIMITS 0.00 655.3500 /end CHARACTERISTIC
/begin CHARACTERISTIC EGT_tiRgnOilDilMax_C "Maximalschwelle für kritische Ölverdünnungszeit" VALUE 0xCD818 Kw_Wu32 500.000000000 Time_s 0.00 500.000000000 FORMAT "%13.9" EXTENDED_LIMITS 0.00 42949672.9500 /end CHARACTERISTIC
/begin CHARACTERISTIC EGT_tiRgnOilDilSubs_C "EEPROM Ersatzwert für kritische Ölverdünnungszeit" VALUE 0xCD81C Kw_Wu32 500.000000000 Time_s 0.00 500.000000000 FORMAT "%13.9" EXTENDED_LIMITS 0.00 42949672.9500 /end CHARACTERISTIC
/begin CHARACTERISTIC EGT_tiRmpSlpMax_C "Maximale Rampenlaufzeit für EGT-Mehrfachschalter" VALUE 0xCD820 Kw_Wu32 15.391030303030304 TimeEGTRmp 0.99296969696969695 16.384000000000000 FORMAT "%19.16" EXTENDED_LIMITS 0.000000015258789066052715 65.536000000000001 /end CHARACTERISTIC
/begin CHARACTERISTIC EGT_tiRmpSlpTempGvnr_C "Rampenzeit für Temperaturregler" VALUE 0xCF640 Kw_Wu32 31.775030303030302 TimeEGTRmp 0.99296969696969695 32.768000000000001 FORMAT "%19.16" EXTENDED_LIMITS 0.000000015258789066052715 65.536000000000001 /end CHARACTERISTIC
/begin CHARACTERISTIC EGT_tOutrDesMflO2_CUR "Sollwertkorrektur des äußeren Regelkreises in Abhängigkeit des Sauerstoffmasssenstromes" CURVE 0xCF1F2 Kl_Xs16_Ws16 1600.000 TempDiff_Cels -100.0000 1500.000 FORMAT "%8.3" EXTENDED_LIMITS -3276.800 3276.700
 /begin AXIS_DESCR STD_AXIS PFlt_dmO2Aprx AirMassPerTime 8 0.00 300.0000 FORMAT "%8.4" EXTENDED_LIMITS -3276.800 3276.700 DEPOSIT ABSOLUTE /end AXIS_DESCR
/end CHARACTERISTIC
/begin CHARACTERISTIC EGT_tOutrDesMsSot_CUR "Sollwertkorrektur des äußeren Regelkreises in Abhängigkeit der Rußmassenbeladung des Partikelfilters" CURVE 0xCF214 Kl_Xs16_Ws16 1600.000 TempDiff_Cels -100.0000 1500.000 FORMAT "%8.3" EXTENDED_LIMITS -3276.800 3276.700
 /begin AXIS_DESCR STD_AXIS PFlt_mSot mSoot_g 8 0.00 300.0000 FORMAT "%8.4" EXTENDED_LIMITS -327.6800 327.6700 DEPOSIT ABSOLUTE /end AXIS_DESCR
/end CHARACTERISTIC
/begin CHARACTERISTIC EGT_tOutrDesTempPst_CUR "Sollwertkorrektur in Abhängigkeit der Temperatur unterhalb Oxidationskatalysator" CURVE 0xCF236 Kl_Xs16_Ws16 1600.000 TempDiff_Cels -100.0000 1500.000 FORMAT "%8.3" EXTENDED_LIMITS -3276.800 3276.700
 /begin AXIS_DESCR STD_AXIS PFlt_tOxiPst Temp_Cels 8 -50.140 899.860 FORMAT "%8.3" EXTENDED_LIMITS -3549.940 3003.560 DEPOSIT ABSOLUTE /end AXIS_DESCR
/end CHARACTERISTIC
/begin CHARACTERISTIC EGT_tOutrDes_MAP "Grundsollwert des äußeren Regelkreises" MAP 0xCF258 Kf_Xs16_Ys16_Ws16 950.000 Temp_Cels -50.140 899.860 FORMAT "%8.3" EXTENDED_LIMITS -3549.940 3003.560
 /begin AXIS_DESCR STD_AXIS Eng_nAvrg EngN 16 0.00 6000.000 FORMAT "%8.3" EXTENDED_LIMITS -32768.00 32767.00 DEPOSIT ABSOLUTE /end AXIS_DESCR
 /begin AXIS_DESCR STD_AXIS InjCtl_qSetUnBal InjMassCyc 16 0.00 327.6700 FORMAT "%8.4" EXTENDED_LIMITS -327.6800 327.6700 DEPOSIT ABSOLUTE /end AXIS_DESCR
/end CHARACTERISTIC
/begin CHARACTERISTIC EGT_tOutrThresDwn_C "Untere Temperaturschwelle des äußeren Regelkreises" VALUE 0xCF4B0 Kw_Ws16 950.000 Temp_Cels -50.140 899.860 FORMAT "%8.3" EXTENDED_LIMITS -3549.940 3003.560 /end CHARACTERISTIC
/begin CHARACTERISTIC EGT_tOutrThresUp_C "Obere Temperaturschwelle des äußeren Regelkreises" VALUE 0xCF4B2 Kw_Ws16 950.000 Temp_Cels -50.140 899.860 FORMAT "%8.3" EXTENDED_LIMITS -3549.940 3003.560 /end CHARACTERISTIC
/begin CHARACTERISTIC EGT_tOxiPreThresBrn_C "Untere Schwelle Temperatur vor Oxidationskatalysator des äußeren Regelkreises" VALUE 0xCF4B4 Kw_Ws16 950.000 Temp_Cels -50.140 899.860 FORMAT "%8.3" EXTENDED_LIMITS -3549.940 3003.560 /end CHARACTERISTIC
/begin CHARACTERISTIC EMCCD_uSRCMinActVal1_C "" VALUE 0xCF644 Kw_Ws16 5200.391 Volt 0.00 5200.391 FORMAT "%8.3" EXTENDED_LIMITS -160156.4 160151.5 /end CHARACTERISTIC
/begin CHARACTERISTIC EMCCD_uSRCMaxActVal1_C "" VALUE 0xCF646 Kw_Ws16 5200.391 Volt 0.00 5200.391 FORMAT "%8.3" EXTENDED_LIMITS -160156.4 160151.5 /end CHARACTERISTIC
/begin CHARACTERISTIC EMCCD_iLinActVal1_CUR "" CURVE 0xCF648 Kl_Xs16_Ws16 5000.000 Curr 0.00 5000.000 FORMAT "%8.3" EXTENDED_LIMITS -32768.00 32767.00
 /begin AXIS_DESCR STD_AXIS EMCCD_uRawActVal1_mp Volt 2 0.00 5200.391 FORMAT "%8.3" EXTENDED_LIMITS -160156.4 160151.5 DEPOSIT ABSOLUTE /end AXIS_DESCR
/end CHARACTERISTIC
/begin CHARACTERISTIC EMCCD_uSRCMinActVal2_C "" VALUE 0xCF652 Kw_Ws16 5200.391 Volt 0.00 5200.391 FORMAT "%8.3" EXTENDED_LIMITS -160156.4 160151.5 /end CHARACTERISTIC
/begin CHARACTERISTIC EMCCD_uSRCMaxActVal2_C "" VALUE 0xCF654 Kw_Ws16 5200.391 Volt 0.00 5200.391 FORMAT "%8.3" EXTENDED_LIMITS -160156.4 160151.5 /end CHARACTERISTIC
/begin CHARACTERISTIC EMCCD_iLinActVal2_CUR "" CURVE 0xCF656 Kl_Xs16_Ws16 5000.000 Curr 0.00 5000.000 FORMAT "%8.3" EXTENDED_LIMITS -32768.00 32767.00
 /begin AXIS_DESCR STD_AXIS EMCCD_uRawActVal2_mp Volt 2 0.00 5200.391 FORMAT "%8.3" EXTENDED_LIMITS -160156.4 160151.5 DEPOSIT ABSOLUTE /end AXIS_DESCR
/end CHARACTERISTIC
/begin CHARACTERISTIC EMCCD_ctPwrStgOnMax1_C "" VALUE 0xCF660 Kw_Wu16 65535.00 OneToOne 0.00 65535.00 FORMAT "%8.2" /end CHARACTERISTIC
/begin CHARACTERISTIC EMCCD_ctPwrStgOnMax2_C "" VALUE 0xCF662 Kw_Wu16 65535.00 OneToOne 0.00 65535.00 FORMAT "%8.2" /end CHARACTERISTIC
/begin CHARACTERISTIC EMCCD_dcycCurrOff_MAP "" MAP 0xCF664 Kf_Xs16_Ys16_Ws16 655.3500 DtyCyc -327.6800 327.6700 FORMAT "%8.4"
 /begin AXIS_DESCR STD_AXIS BattCD_u Volt_Batt 7 0.00 28602.15 FORMAT "%8.2" EXTENDED_LIMITS -640625.6 640606.1 DEPOSIT ABSOLUTE /end AXIS_DESCR
 /begin AXIS_DESCR STD_AXIS EMCCD_resAct1 Resist 16 0.00 5000.000 FORMAT "%8.3" EXTENDED_LIMITS -3276.800 3276.700 DEPOSIT ABSOLUTE /end AXIS_DESCR
/end CHARACTERISTIC
/begin CHARACTERISTIC EMCCD_dcycCurrOnHi_MAP "" MAP 0xCF776 Kf_Xs16_Ys16_Ws16 655.3500 DtyCyc -327.6800 327.6700 FORMAT "%8.4"
 /begin AXIS_DESCR STD_AXIS BattCD_u Volt_Batt 7 0.00 28602.15 FORMAT "%8.2" EXTENDED_LIMITS -640625.6 640606.1 DEPOSIT ABSOLUTE /end AXIS_DESCR
 /begin AXIS_DESCR STD_AXIS EMCCD_resAct1 Resist 16 0.00 5000.000 FORMAT "%8.3" EXTENDED_LIMITS -3276.800 3276.700 DEPOSIT ABSOLUTE /end AXIS_DESCR
/end CHARACTERISTIC
/begin CHARACTERISTIC EMCCD_dcycCurrOnLow_MAP "" MAP 0xCF888 Kf_Xs16_Ys16_Ws16 655.3500 DtyCyc -327.6800 327.6700 FORMAT "%8.4"
 /begin AXIS_DESCR STD_AXIS BattCD_u Volt_Batt 7 0.00 28602.15 FORMAT "%8.2" EXTENDED_LIMITS -640625.6 640606.1 DEPOSIT ABSOLUTE /end AXIS_DESCR
 /begin AXIS_DESCR STD_AXIS EMCCD_resAct1 Resist 16 0.00 5000.000 FORMAT "%8.3" EXTENDED_LIMITS -3276.800 3276.700 DEPOSIT ABSOLUTE /end AXIS_DESCR
/end CHARACTERISTIC
/begin CHARACTERISTIC EMCCD_dcycMax_C "" VALUE 0xCF99A Kw_Ws16 655.3500 DtyCyc -327.6800 327.6700 FORMAT "%8.4" /end CHARACTERISTIC
/begin CHARACTERISTIC EMCCD_dcycMin_C "" VALUE 0xCF99C Kw_Ws16 655.3500 DtyCyc -327.6800 327.6700 FORMAT "%8.4" /end CHARACTERISTIC
/begin CHARACTERISTIC EMCCD_dcycWarmUp_MAP "" MAP 0xCF99E Kf_Xs16_Ys16_Ws16 655.3500 DtyCyc -327.6800 327.6700 FORMAT "%8.4"
 /begin AXIS_DESCR STD_AXIS Eng_tEng Temp_Cels 15 -50.14000 199.8600 FORMAT "%8.4" EXTENDED_LIMITS -3549.940 3003.560 DEPOSIT ABSOLUTE /end AXIS_DESCR
 /begin AXIS_DESCR STD_AXIS EATSCD_tAir Temp_Cels 15 -50.14000 199.8600 FORMAT "%8.4" EXTENDED_LIMITS -3549.940 3003.560 DEPOSIT ABSOLUTE /end AXIS_DESCR
/end CHARACTERISTIC
/begin CHARACTERISTIC EMCCD_DebExcTempDef1_C "" VALUE 0xCFBA0 Kw_Wu16 655350.0 Time_ms 0.00 655350.0 FORMAT "%8.1" /end CHARACTERISTIC
/begin CHARACTERISTIC EMCCD_DebExcTempOk1_C "" VALUE 0xCFBA2 Kw_Wu16 655350.0 Time_ms 0.00 655350.0 FORMAT "%8.1" /end CHARACTERISTIC
/begin CHARACTERISTIC EMCCD_DebExcTempDef2_C "" VALUE 0xCFBA4 Kw_Wu16 655350.0 Time_ms 0.00 655350.0 FORMAT "%8.1" /end CHARACTERISTIC
/begin CHARACTERISTIC EMCCD_DebExcTempOk2_C "" VALUE 0xCFBA6 Kw_Wu16 655350.0 Time_ms 0.00 655350.0 FORMAT "%8.1" /end CHARACTERISTIC
/begin CHARACTERISTIC EMCCD_DebNoLoadDef1_C "" VALUE 0xCFBA8 Kw_Wu16 655350.0 Time_ms 0.00 655350.0 FORMAT "%8.1" /end CHARACTERISTIC
/begin CHARACTERISTIC EMCCD_DebNoLoadOk1_C "" VALUE 0xCFBAA Kw_Wu16 655350.0 Time_ms 0.00 655350.0 FORMAT "%8.1" /end CHARACTERISTIC
/begin CHARACTERISTIC EMCCD_DebNoLoadDef2_C "" VALUE 0xCFBAC Kw_Wu16 655350.0 Time_ms 0.00 655350.0 FORMAT "%8.1" /end CHARACTERISTIC
/begin CHARACTERISTIC EMCCD_DebNoLoadOk2_C "" VALUE 0xCFBAE Kw_Wu16 655350.0 Time_ms 0.00 655350.0 FORMAT "%8.1" /end CHARACTERISTIC
/begin CHARACTERISTIC EMCCD_DebShortCircBatDef1_C "" VALUE 0xCFBB0 Kw_Wu16 655350.0 Time_ms 0.00 655350.0 FORMAT "%8.1" /end CHARACTERISTIC
/begin CHARACTERISTIC EMCCD_DebShortCircBatOk1_C "" VALUE 0xCFBB2 Kw_Wu16 655350.0 Time_ms 0.00 655350.0 FORMAT "%8.1" /end CHARACTERISTIC
/begin CHARACTERISTIC EMCCD_DebShortCircBatDef2_C "" VALUE 0xCFBB4 Kw_Wu16 655350.0 Time_ms 0.00 655350.0 FORMAT "%8.1" /end CHARACTERISTIC
/begin CHARACTERISTIC EMCCD_DebShortCircBatOk2_C "" VALUE 0xCFBB6 Kw_Wu16 655350.0 Time_ms 0.00 655350.0 FORMAT "%8.1" /end CHARACTERISTIC
/begin CHARACTERISTIC EMCCD_DebShortCircGndDef1_C "" VALUE 0xCFBB8 Kw_Wu16 655350.0 Time_ms 0.00 655350.0 FORMAT "%8.1" /end CHARACTERISTIC
/begin CHARACTERISTIC EMCCD_DebShortCircGndOk1_C "" VALUE 0xCFBBA Kw_Wu16 655350.0 Time_ms 0.00 655350.0 FORMAT "%8.1" /end CHARACTERISTIC
/begin CHARACTERISTIC EMCCD_DebShortCircGndDef2_C "" VALUE 0xCFBBC Kw_Wu16 655350.0 Time_ms 0.00 655350.0 FORMAT "%8.1" /end CHARACTERISTIC
/begin CHARACTERISTIC EMCCD_DebShortCircGndOk2_C "" VALUE 0xCFBBE Kw_Wu16 655350.0 Time_ms 0.00 655350.0 FORMAT "%8.1" /end CHARACTERISTIC
/begin CHARACTERISTIC EMCCD_DebSRCHighDef1_C "" VALUE 0xCFBC0 Kw_Wu16 655350.0 Time_ms 0.00 655350.0 FORMAT "%8.1" /end CHARACTERISTIC
/begin CHARACTERISTIC EMCCD_DebSRCHighOk1_C "" VALUE 0xCFBC2 Kw_Wu16 655350.0 Time_ms 0.00 655350.0 FORMAT "%8.1" /end CHARACTERISTIC
/begin CHARACTERISTIC EMCCD_DebSRCHighDef2_C "" VALUE 0xCFBC4 Kw_Wu16 655350.0 Time_ms 0.00 655350.0 FORMAT "%8.1" /end CHARACTERISTIC
/begin CHARACTERISTIC EMCCD_DebSRCHighOk2_C "" VALUE 0xCFBC6 Kw_Wu16 655350.0 Time_ms 0.00 655350.0 FORMAT "%8.1" /end CHARACTERISTIC
/begin CHARACTERISTIC EMCCD_DebSRCLowDef1_C "" VALUE 0xCFBC8 Kw_Wu16 655350.0 Time_ms 0.00 655350.0 FORMAT "%8.1" /end CHARACTERISTIC
/begin CHARACTERISTIC EMCCD_DebSRCLowOk1_C "" VALUE 0xCFBCA Kw_Wu16 655350.0 Time_ms 0.00 655350.0 FORMAT "%8.1" /end CHARACTERISTIC
/begin CHARACTERISTIC EMCCD_DebSRCLowDef2_C "" VALUE 0xCFBCC Kw_Wu16 655350.0 Time_ms 0.00 655350.0 FORMAT "%8.1" /end CHARACTERISTIC
/begin CHARACTERISTIC EMCCD_DebSRCLowOk2_C "" VALUE 0xCFBCE Kw_Wu16 655350.0 Time_ms 0.00 655350.0 FORMAT "%8.1" /end CHARACTERISTIC
/begin CHARACTERISTIC EMCCD_dtRmpSlpUpActVal1_C "" VALUE 0xCFBD0 Kw_Wu32 65535999.9847 RmpCurr 0.00 65535999.9847 FORMAT "%13.4" /end CHARACTERISTIC
/begin CHARACTERISTIC EMCCD_dtRmpSlpDwnActVal1_C "" VALUE 0xCFBD4 Kw_Wu32 65535999.9847 RmpCurr 0.00 65535999.9847 FORMAT "%13.4" /end CHARACTERISTIC
/begin CHARACTERISTIC EMCCD_dtRmpSlpUpActVal2_C "" VALUE 0xCFBD8 Kw_Wu32 65535999.9847 RmpCurr 0.00 65535999.9847 FORMAT "%13.4" /end CHARACTERISTIC
/begin CHARACTERISTIC EMCCD_dtRmpSlpDwnActVal2_C "" VALUE 0xCFBDC Kw_Wu32 65535999.9847 RmpCurr 0.00 65535999.9847 FORMAT "%13.4" /end CHARACTERISTIC
/begin CHARACTERISTIC EMCCD_numAdc1_C "" VALUE 0xCFBE0 Kw_Wu8 26.0000000000 NumPinAdc 0.00 26.0000000000 FORMAT "%13.10" /end CHARACTERISTIC
/begin CHARACTERISTIC EMCCD_numAdc2_C "" VALUE 0xCFBE1 Kw_Wu8 26.0000000000 NumPinAdc 0.00 26.0000000000 FORMAT "%13.10" /end CHARACTERISTIC
/begin CHARACTERISTIC EMCCD_numDiaOut1_C "" VALUE 0xCFBE2 Kw_Wu8 27.0000000000 NumPinDia 0.00 27.0000000000 FORMAT "%13.10" /end CHARACTERISTIC
/begin CHARACTERISTIC EMCCD_numDiaOut2_C "" VALUE 0xCFBE3 Kw_Wu8 27.0000000000 NumPinDia 0.00 27.0000000000 FORMAT "%13.10" /end CHARACTERISTIC
/begin CHARACTERISTIC EMCCD_numPwmOut1_C "" VALUE 0xCFBE4 Kw_Wu8 12.0000000000 NumPinPwmOut 0.00 12.0000000000 FORMAT "%13.10" /end CHARACTERISTIC
/begin CHARACTERISTIC EMCCD_numPwmOut2_C "" VALUE 0xCFBE5 Kw_Wu8 12.0000000000 NumPinPwmOut 0.00 12.0000000000 FORMAT "%13.10" /end CHARACTERISTIC
/begin CHARACTERISTIC EMCCD_tiActValPT1_1_C "" VALUE 0xCFBE8 Kw_Wu32 4294.9663 TimeDelay_s 0.0010000001 4294.9673 FORMAT "%9.4" EXTENDED_LIMITS 0.0000010000000 4294.9673 /end CHARACTERISTIC
/begin CHARACTERISTIC EMCCD_tiActValPT1_2_C "" VALUE 0xCFBEC Kw_Wu32 4294.9663 TimeDelay_s 0.0010000001 4294.9673 FORMAT "%9.4" EXTENDED_LIMITS 0.0000010000000 4294.9673 /end CHARACTERISTIC
/begin CHARACTERISTIC EMCCD_stInvOut1_C "" VALUE 0xCFBF0 Kw_Wu8 1.000 OneToOne 0.00 1.000 FORMAT "%5.3" EXTENDED_LIMITS 0.00 255.0 /end CHARACTERISTIC
/begin CHARACTERISTIC EMCCD_tiPer1_C "" VALUE 0xCFBF2 Kw_Ws16 6553.500 Period -3276.800 3276.700 FORMAT "%8.3" /end CHARACTERISTIC
/begin CHARACTERISTIC EMCCD_stInvOut2_C "" VALUE 0xCFBF4 Kw_Wu8 1.000 OneToOne 0.00 1.000 FORMAT "%5.3" EXTENDED_LIMITS 0.00 255.0 /end CHARACTERISTIC
/begin CHARACTERISTIC EMCCD_tiPer2_C "" VALUE 0xCFBF6 Kw_Ws16 6553.500 Period -3276.800 3276.700 FORMAT "%8.3" /end CHARACTERISTIC
/begin CHARACTERISTIC EMCCD_stSPICtl1_C "Parameter to indicate the type of powerstage used ( 1 = SPI controllable powerstage, 0 = Non SPI powerstage )" VALUE 0xCFBF8 Kw_Wu8 1.000 OneToOne 0.00 1.000 FORMAT "%5.3" EXTENDED_LIMITS 0.00 255.0 /end CHARACTERISTIC
/begin CHARACTERISTIC EMCCD_stSPICtl2_C "Parameter to indicate the type of powerstage used ( 1 = SPI controllable powerstage, 0 = Non SPI powerstage )" VALUE 0xCFBF9 Kw_Wu8 1.000 OneToOne 0.00 1.000 FORMAT "%5.3" EXTENDED_LIMITS 0.00 255.0 /end CHARACTERISTIC
/begin CHARACTERISTIC EMCCD_swtRegOn_C "" VALUE 0xCFBFA Kw_Wu8 255.0 OneToOne 0.00 255.0 FORMAT "%5.1" /end CHARACTERISTIC
/begin CHARACTERISTIC EMCCD_tiBtwTst1_C "Zeitabstand, in dem die Endstufe im Fehlerfall getestet wird" VALUE 0xCFBFC Kw_Wu16 29980.00 Time_ms 20.00000 30000.00 FORMAT "%8.2" EXTENDED_LIMITS 0.00 655350.0 /end CHARACTERISTIC
/begin CHARACTERISTIC EMCCD_tiBtwTst2_C "Zeitabstand, in dem die Endstufe im Fehlerfall getestet wird" VALUE 0xCFBFE Kw_Wu16 29980.00 Time_ms 20.00000 30000.00 FORMAT "%8.2" EXTENDED_LIMITS 0.00 655350.0 /end CHARACTERISTIC
/begin CHARACTERISTIC EMCCD_tiCurrOnHi_C "" VALUE 0xCFC00 Kw_Wu16 655.3500 Time_s 0.00 655.3500 FORMAT "%8.4" /end CHARACTERISTIC
/begin CHARACTERISTIC EMCCD_tiPwrStgOn1_C "" VALUE 0xCFC02 Kw_Wu16 655140.0 Time_ms 0.00 655140.0 FORMAT "%8.1" EXTENDED_LIMITS 0.00 655350.0 /end CHARACTERISTIC
/begin CHARACTERISTIC EMCCD_tiPwrStgOn2_C "" VALUE 0xCFC04 Kw_Wu16 655140.0 Time_ms 0.00 655140.0 FORMAT "%8.1" EXTENDED_LIMITS 0.00 655350.0 /end CHARACTERISTIC
/begin CHARACTERISTIC EMCCD_tiWarmUp_C "" VALUE 0xCFC06 Kw_Wu16 655.3500 Time_s 0.00 655.3500 FORMAT "%8.4" /end CHARACTERISTIC
/begin CHARACTERISTIC EMCCD_stSensIDWordActVal1_C "" VALUE 0xCFC08 Kw_Wu16 65535.00 OneToOne 0.00 65535.00 FORMAT "%8.2" /end CHARACTERISTIC
/begin CHARACTERISTIC EMCCD_iDflActVal1_C "" VALUE 0xCFC0A Kw_Ws16 5000.000 Curr 0.00 5000.000 FORMAT "%8.3" EXTENDED_LIMITS -32768.00 32767.00 /end CHARACTERISTIC
/begin CHARACTERISTIC EMCCD_stSensIDWordActVal2_C "" VALUE 0xCFC0C Kw_Wu16 65535.00 OneToOne 0.00 65535.00 FORMAT "%8.2" /end CHARACTERISTIC
/begin CHARACTERISTIC EMCCD_iDflActVal2_C "" VALUE 0xCFC0E Kw_Ws16 5000.000 Curr 0.00 5000.000 FORMAT "%8.3" EXTENDED_LIMITS -32768.00 32767.00 /end CHARACTERISTIC
/begin CHARACTERISTIC EngM_ctOfsCaSCrS_C "#SSD Anzahl von Interrupts mit CaS/CrS Verdrehung (> EngM_phiDelta_C) im WAIT_PHASE State bis Verdreherkennung" VALUE 0xCFE70 Kw_Wu8 255.0 default 0.00 255.0 FORMAT "%5.1" /end CHARACTERISTIC
/begin CHARACTERISTIC EngM_ctPhWhlRev_C "#SSD Anzahl von Phasenradumdrehungen bis zum Abbruch der Plausibilitätsprüfung" VALUE 0xCFE71 Kw_Wu8 255.0 default 0.00 255.0 FORMAT "%5.1" /end CHARACTERISTIC
/begin CHARACTERISTIC EngM_ctPostSync_C "#SSD Anzahl statischer Interrupts bis zum Verlassen des Zustands POST" VALUE 0xCFE72 Kw_Wu8 255.0 default 0.00 255.0 FORMAT "%5.1" /end CHARACTERISTIC
/begin CHARACTERISTIC EngM_ctPwrStgOnMax1_C "" VALUE 0xCFC10 Kw_Wu16 65535.00 OneToOne 0.00 65535.00 FORMAT "%8.2" /end CHARACTERISTIC
/begin CHARACTERISTIC EngM_ctPwrStgOnMax2_C "" VALUE 0xCFC12 Kw_Wu16 65535.00 OneToOne 0.00 65535.00 FORMAT "%8.2" /end CHARACTERISTIC
/begin CHARACTERISTIC EngM_ctReSync_C "#SSD Max. Anzahl von Versuchen das System umzusynchronisieren" VALUE 0xCFE73 Kw_Wu8 255.0 default 0.00 255.0 FORMAT "%5.1" /end CHARACTERISTIC
/begin CHARACTERISTIC EngM_ctSpdtoZero_C "#SSD Anzahl Timeoutinterrupts bis Motordrehzahl  = Null" VALUE 0xCFE98 Kw_Wu16 65535.00 OneToOne 0.00 65535.00 FORMAT "%8.2" /end CHARACTERISTIC
/begin CHARACTERISTIC EngM_ctVerSync_C "#SSD Anzahl der MAIN, PILOT, UPDATE, SEGMENT  Interrupts zur Plausibilisierung der Nockenwelle mit der Kurbelwelle" VALUE 0xCFE74 Kw_Wu8 255.0 default 0.00 255.0 FORMAT "%5.1" /end CHARACTERISTIC
/begin CHARACTERISTIC EngM_DebIncCaSErrSigDef_C "#SSD Inkrementdefektentprellung  für Nockenwellen-Signalstörung" VALUE 0xCFE9A Kw_Wu16 65535.00 OneToOne 0.00 65535.00 FORMAT "%8.2" /end CHARACTERISTIC
/begin CHARACTERISTIC EngM_DebIncCaSErrSigOK_C "#SSD Inkrementheilungsentprellung bis NW-Position gueltig" VALUE 0xCFE9C Kw_Wu16 65535.00 OneToOne 0.00 65535.00 FORMAT "%8.2" /end CHARACTERISTIC
/begin CHARACTERISTIC EngM_DebIncCaSNoSigDef_C "#SSD Inkrementdefektentprellung für Nockenwellen-Signalausfall" VALUE 0xCFE9E Kw_Wu16 65535.00 OneToOne 0.00 65535.00 FORMAT "%8.2" /end CHARACTERISTIC
/begin CHARACTERISTIC EngM_DebIncCrSErrSigDef_C "#SSD Inkrementdefektentprellung für gestörtes Kurbelwellen-Signal" VALUE 0xCFEA0 Kw_Wu16 65535.00 OneToOne 0.00 65535.00 FORMAT "%8.2" /end CHARACTERISTIC
/begin CHARACTERISTIC EngM_DebIncCrSErrSigOK_C "#SSD Inkrementheilungsprellung für gestörtes Kurbelwellen-Signal" VALUE 0xCFEA2 Kw_Wu16 65535.00 OneToOne 0.00 65535.00 FORMAT "%8.2" /end CHARACTERISTIC
/begin CHARACTERISTIC EngM_DebIncOfsSigCaSCrSDef_C "#SSD Inkremententprellung zur Unterdrückung doppelter Fehlereinträge von Signal Störung / Verdrehung" VALUE 0xCFEA4 Kw_Wu16 65535.00 OneToOne 0.00 65535.00 FORMAT "%8.2" /end CHARACTERISTIC
/begin CHARACTERISTIC EngM_DebPhCrSErrSigDef_C "#SSD Entprellung des Kurbelwellensignalausfalls über die Anzahl von Nockenwellenzaehnen" VALUE 0xCFEA6 Kw_Wu16 65535.00 OneToOne 0.00 65535.00 FORMAT "%8.2" /end CHARACTERISTIC
/begin CHARACTERISTIC EngM_dLimitCond_ASD_CA "#SSD Abschrankbedingung fuer die ASD-Task" VAL_BLK 0xCFE48 Kwb_Wu8 255.0 OneToOne 0.00 255.0 FORMAT "%5.1" NUMBER 3 /end CHARACTERISTIC
/begin CHARACTERISTIC EngM_dLimitCond_Common_CA "#SSD Abschrankbedingung fuer die Common-Task" VAL_BLK 0xCFE4B Kwb_Wu8 255.0 OneToOne 0.00 255.0 FORMAT "%5.1" NUMBER 3 /end CHARACTERISTIC
/begin CHARACTERISTIC EngM_dLimitCond_FBC_CA "#SSD Abschrankbedingung fuer die FBC-Task" VAL_BLK 0xCFE4E Kwb_Wu8 255.0 OneToOne 0.00 255.0 FORMAT "%5.1" NUMBER 3 /end CHARACTERISTIC
/begin CHARACTERISTIC EngM_dLimitCond_Joint_CA "#SSD Abschrankbedingung fuer die Joint-Task" VAL_BLK 0xCFE51 Kwb_Wu8 255.0 OneToOne 0.00 255.0 FORMAT "%5.1" NUMBER 3 /end CHARACTERISTIC
/begin CHARACTERISTIC EngM_dLimitCond_LiGov_CA "#SSD Abschrankbedingung fuer die LiGov-Task" VAL_BLK 0xCFE54 Kwb_Wu8 255.0 OneToOne 0.00 255.0 FORMAT "%5.1" NUMBER 3 /end CHARACTERISTIC
/begin CHARACTERISTIC EngM_dLimitCond_Pilot_CA "#SSD Abschrankbedingung fuer die Pilot-Task" VAL_BLK 0xCFE57 Kwb_Wu8 255.0 OneToOne 0.00 255.0 FORMAT "%5.1" NUMBER 3 /end CHARACTERISTIC
/begin CHARACTERISTIC EngM_dtrqFrcPDiffUp_C "Negative Rampensteigung für Umschaltung auf Drehmomentverlust bei erkanntem Systemfehler" VALUE 0xCFF20 Kw_Wu32 6553649.99847 RmpTrq -50.0000000000 6553599.99847 FORMAT "%13.5" EXTENDED_LIMITS 0.00 6553599.99847 /end CHARACTERISTIC
/begin CHARACTERISTIC EngM_dtrqFrcPDiffDwn_C "Negative Rampensteigung für Umschaltung auf Drehmomentverlust bei geheiltem Systemfehler" VALUE 0xCFF24 Kw_Wu32 6553649.99847 RmpTrq -50.0000000000 6553599.99847 FORMAT "%13.5" EXTENDED_LIMITS 0.00 6553599.99847 /end CHARACTERISTIC
/begin CHARACTERISTIC EngM_facT1Reliabl_C "Multiplikationsfaktor für Zuverlässigkeitsbestimmung der Reibmomentenadaption" VALUE 0xD0194 Kw_Wu8 255.0 OneToOne 0.00 255.0 FORMAT "%5.1" /end CHARACTERISTIC
/begin CHARACTERISTIC EngM_facTrqFrcPDiff_CUR "Faktor zur Korrektur Momentenverlust aufgrund Differenzdruck über Partikelfilter nach Einbau eines Partikelfilters" CURVE 0xCFF28 Kl_Xs16_Ws16 512.0000 Fact1 -256.0000 256.0000 FORMAT "%8.4" EXTENDED_LIMITS -256.0000 255.9922
 /begin AXIS_DESCR STD_AXIS Eng_nAvrg EngN 8 0.00 5000.000 FORMAT "%8.3" EXTENDED_LIMITS -32768.00 32767.00 DEPOSIT ABSOLUTE /end AXIS_DESCR
/end CHARACTERISTIC
/begin CHARACTERISTIC EngM_tiFltACoff_C "Adaptionsfilterzeitkonstante für Zustand ""Klima aus"" der Reibmomentenadaption" VALUE 0xD0198 Kw_Wu32 4294.9673 TimeDelay_s 0.0000010000000 4294.9673 FORMAT "%9.4" /end CHARACTERISTIC
/begin CHARACTERISTIC EngM_tiFltACon_C "Adaptionsfilterzeitkonstante für Zustand ""Klima an"" der Reibmomentenadaption" VALUE 0xD019C Kw_Wu32 4294.9673 TimeDelay_s 0.0000010000000 4294.9673 FORMAT "%9.4" /end CHARACTERISTIC
/begin CHARACTERISTIC EngM_HldCurr_MAP "" MAP 0xCFC14 Kf_Xs16_Ys16_Ws16 655.3500 DtyCyc -327.6800 327.6700 FORMAT "%8.4"
 /begin AXIS_DESCR STD_AXIS BattCD_u Volt_Batt 6 0.00 28602.15 FORMAT "%8.2" EXTENDED_LIMITS -640625.6 640606.1 DEPOSIT ABSOLUTE /end AXIS_DESCR
 /begin AXIS_DESCR STD_AXIS Eng_tEng Temp_Cels 15 -50.14000 199.8600 FORMAT "%8.4" EXTENDED_LIMITS -3549.940 3003.560 DEPOSIT ABSOLUTE /end AXIS_DESCR
/end CHARACTERISTIC
/begin CHARACTERISTIC EngM_nAvrgHysDelta_C "speed threshold for calculating Hysterisis lower limit" VALUE 0xCFEAC Kw_Ws16 6000.000 EngN 0.00 6000.000 FORMAT "%8.3" EXTENDED_LIMITS -32768.00 32767.00 /end CHARACTERISTIC
/begin CHARACTERISTIC EngM_nAvrgHysHigh_CUR "curve for max. cutout speed = f ( engine-temp. )" CURVE 0xCFEAE Kl_Xs16_Ws16 6000.000 EngN 0.00 6000.000 FORMAT "%8.3" EXTENDED_LIMITS -32768.00 32767.00
 /begin AXIS_DESCR STD_AXIS Eng_tEng Temp_Cels 25 -50.14000 199.8600 FORMAT "%8.4" EXTENDED_LIMITS -3549.940 3003.560 DEPOSIT ABSOLUTE /end AXIS_DESCR
/end CHARACTERISTIC
/begin CHARACTERISTIC EngM_nAvrgLim_C "Engine speed limiting  value" VALUE 0xCFF14 Kw_Ws16 6000.000 EngN 0.00 6000.000 FORMAT "%8.3" EXTENDED_LIMITS -32768.00 32767.00 /end CHARACTERISTIC
/begin CHARACTERISTIC EngM_nLimitInj_C "#SSD Drehzahlschwelle zur Abschrankung der Mengen- und Ansteuerbeginnberechnung" VALUE 0xCFE5A Kw_Wu16 6000.000 EngN 0.00 6000.000 FORMAT "%8.3" EXTENDED_LIMITS 0.00 65535.00 /end CHARACTERISTIC
/begin CHARACTERISTIC EngM_nLimitThreshHyst_CA "#SSD Hysteresebreite der Abschrankdrehzahl" VAL_BLK 0xCFE5C Kwb_Wu16 600.0000 EngN 0.00 600.0000 FORMAT "%8.4" EXTENDED_LIMITS 0.00 65535.00 NUMBER 3 /end CHARACTERISTIC
/begin CHARACTERISTIC EngM_nLimitThresh_CA "#SSD Drehzahlschwellen zur Taskabschrankung" VAL_BLK 0xCFE62 Kwb_Wu16 6000.000 EngN 0.00 6000.000 FORMAT "%8.3" EXTENDED_LIMITS 0.00 65535.00 NUMBER 3 /end CHARACTERISTIC
/begin CHARACTERISTIC EngM_nLISetDiffOffs_C "Maximale zulässige Leerlaufreglerabweichung für Reibmomentenadaption" VALUE 0xD01A0 Kw_Wu16 50.00000 EngN 0.00 50.00000 FORMAT "%8.5" EXTENDED_LIMITS 0.00 65535.00 /end CHARACTERISTIC
/begin CHARACTERISTIC EngM_nMaxStrtBackUp_C "#SSD Max. Drehzahl für Start nur mit Nockenwellensignal" VALUE 0xCFEA8 Kw_Ws16 300.0000 EngN 900.0000 1200.000 FORMAT "%8.3" EXTENDED_LIMITS -32768.00 32767.00 /end CHARACTERISTIC
/begin CHARACTERISTIC EngM_nMaxStrt_C "#SSD Motordrehzahl unterhalb dieser Schwelle; Einspritzung für redundanten Start mit Kurbelwelle ist erlaubt" VALUE 0xCFE76 Kw_Ws16 65535.00 EngN -32768.00 32767.00 FORMAT "%8.2" /end CHARACTERISTIC
/begin CHARACTERISTIC EngM_nMinDiag_C "#SSD Nockenwellendiagnose ab minimale Motordrehzahl" VALUE 0xC048C Kw_Ws16 480.0000 EngN 20.00000 500.0000 FORMAT "%8.4" EXTENDED_LIMITS -32768.00 32767.00 /end CHARACTERISTIC
/begin CHARACTERISTIC EngM_nSwtCoMa_C "#SSD Schwellendrehzahl für die Umschaltung der Aufrufreihenfolge von Common- und MainInj-Task" VALUE 0xCFE68 Kw_Wu16 6000.000 EngN 0.00 6000.000 FORMAT "%8.3" EXTENDED_LIMITS 0.00 65535.00 /end CHARACTERISTIC
/begin CHARACTERISTIC EngM_numLimitInj_C "#SSD Berechnungshäufigkeit bei aktiver Abschrankung der Mengen- und Ansteuerbeginnberechnung" VALUE 0xCFE6A Kw_Wu8 9.000 OneToOne 1.000 10.00 FORMAT "%5.2" EXTENDED_LIMITS 0.00 255.0 /end CHARACTERISTIC
/begin CHARACTERISTIC EngM_numPin_C "#SSD Zuordnungstabelle phyikalischer Zylinder zu SG-Endstufe (SG-Pin)" VAL_BLK 0xC0470 Kwb_Wu8 255.0 OneToOne 0.00 255.0 FORMAT "%5.1" NUMBER 6 /end CHARACTERISTIC
/begin CHARACTERISTIC EngM_numTrqFrc_C "Parameter für die Auswahl einer Motortemperatur aus dem Temperaturfeld Eng_tFld für die Reibmomentenberechnung" VALUE 0xCFF4A Kw_Wu8 2.00000000000 EngTempFldSel 0.00 2.00000000000 FORMAT "%13.11" /end CHARACTERISTIC
/begin CHARACTERISTIC EngM_nWaitIncSig_C "#SSD Inkrementdrehzahl ab der das Signal im Start ausgeblendet wird" VALUE 0xCFE78 Kw_Ws16 6000.000 EngN 0.00 6000.000 FORMAT "%8.3" EXTENDED_LIMITS -32768.00 32767.00 /end CHARACTERISTIC
/begin CHARACTERISTIC EngM_phiDelayPhNoSig_C "#SSD Winkelverzoegerung für die Erkennung kein Nockenwellensignal" VALUE 0xCFE7A Kw_Ws16 720.0000 AngleCrS 0.00 720.0000 FORMAT "%8.4" EXTENDED_LIMITS -768.0000 767.9766 /end CHARACTERISTIC
/begin CHARACTERISTIC EngM_phiDeltaExtSync_C "#SSD Toleranz zwischen Kurbelwelle und Nockenwelle bei freigeschalteten CAN-Synchronisation" VALUE 0xCFE7C Kw_Ws16 720.0000 AngleCrS 0.00 720.0000 FORMAT "%8.4" EXTENDED_LIMITS -768.0000 767.9766 /end CHARACTERISTIC
/begin CHARACTERISTIC EngM_phiDelta_C "#SSD Toleranz zwischen Kurbelwelle und Nockenwelle" VALUE 0xCFE7E Kw_Ws16 720.0000 AngleCrS 0.00 720.0000 FORMAT "%8.4" EXTENDED_LIMITS -768.0000 767.9766 /end CHARACTERISTIC
/begin CHARACTERISTIC EngM_phiFrstInjInt_C "#SSD Position des ersten Interrupts vor OT zur Berechnung der ersten Einspritzung" VALUE 0xCFE80 Kw_Ws16 0.00 AngleCrS 739.9922 739.9922 FORMAT "%8.4" EXTENDED_LIMITS -768.0000 767.9766 /end CHARACTERISTIC
/begin CHARACTERISTIC EngM_phiInt_C "#SSD Positionen der stat. Interrupts vor jedem OT" VAL_BLK 0xCFE82 Kwb_Ws16 720.0000 AngleCrS 0.00 720.0000 FORMAT "%8.4" EXTENDED_LIMITS -768.0000 767.9766 NUMBER 5 /end CHARACTERISTIC
/begin CHARACTERISTIC EngM_phiMax_C "#SSD Max. physikalischer Winkel im System" VALUE 0xC0478 Kw_Ws32 360.000000000 AngleCrS 360.000000000 720.000000000 FORMAT "%13.9" EXTENDED_LIMITS -50331648.0000 50331647.9766 /end CHARACTERISTIC
/begin CHARACTERISTIC EngM_phiTDC_C "#SSD Vektor der OT-Winkel aller Zylinder" VAL_BLK 0xC047C Kwb_Ws16 720.0000 AngleCrS 0.00 720.0000 FORMAT "%8.4" EXTENDED_LIMITS -768.0000 767.9766 NUMBER 6 /end CHARACTERISTIC
/begin CHARACTERISTIC EngM_RetCurr_MAP "" MAP 0xCFCF6 Kf_Xs16_Ys16_Ws16 655.3500 DtyCyc -327.6800 327.6700 FORMAT "%8.4"
 /begin AXIS_DESCR STD_AXIS BattCD_u Volt_Batt 6 0.00 28602.15 FORMAT "%8.2" EXTENDED_LIMITS -640625.6 640606.1 DEPOSIT ABSOLUTE /end AXIS_DESCR
 /begin AXIS_DESCR STD_AXIS Eng_tEng Temp_Cels 15 -50.14000 199.8600 FORMAT "%8.4" EXTENDED_LIMITS -3549.940 3003.560 DEPOSIT ABSOLUTE /end AXIS_DESCR
/end CHARACTERISTIC
/begin CHARACTERISTIC EngM_stBackUpVar_C "#SSD Variante: 0->Wechsel in BU-mode erfolgt bei einen Timeout von CrSCD  1->Wechsel erfolgt sobald Fehlerpf. CrS1 gesetzt ist" VALUE 0xCFEAA Kw_Wu8 1.000 OneToOne 0.00 1.000 FORMAT "%5.3" EXTENDED_LIMITS 0.00 255.0 /end CHARACTERISTIC
/begin CHARACTERISTIC EngM_stChkPN_C "Auswahlschalter:  Abfrage P/N-Status für Adaptionsfreigabe" VALUE 0xD01A2 Kw_Wu8 1.000 OneToOne 0.00 1.000 FORMAT "%5.3" EXTENDED_LIMITS 0.00 255.0 /end CHARACTERISTIC
/begin CHARACTERISTIC EngM_stEnaBackUp_C "#SSD Schalter zur Aktivierung des Betriebsmodus nur mit Nockenwellensignal" VALUE 0xCFEAB Kw_Wu8 1.000 OneToOne 0.00 1.000 FORMAT "%5.3" EXTENDED_LIMITS 0.00 255.0 /end CHARACTERISTIC
/begin CHARACTERISTIC EngM_stOutHard_C "Hard control Bearing" VALUE 0xCFF16 Kw_Wu8 1.000 OneToOne 0.00 1.000 FORMAT "%5.3" EXTENDED_LIMITS 0.00 255.0 /end CHARACTERISTIC
/begin CHARACTERISTIC EngM_stOutSoft_C "soft control Bearing" VALUE 0xCFF17 Kw_Wu8 1.000 OneToOne 0.00 1.000 FORMAT "%5.3" EXTENDED_LIMITS 0.00 255.0 /end CHARACTERISTIC
/begin CHARACTERISTIC EngM_stSyncBefGap_C "#SSD Synchronisation ohne  Luecke" VALUE 0xCFE8C Kw_Wu8 1.000 OneToOne 0.00 1.000 FORMAT "%5.3" EXTENDED_LIMITS 0.00 255.0 /end CHARACTERISTIC
/begin CHARACTERISTIC EngM_swtExitOfs_C "#SSD Aussprungbedingung aus dem SYNC_OFFSET State" VALUE 0xCFE8D Kw_Wu8 255.0 default 0.00 255.0 FORMAT "%5.1" /end CHARACTERISTIC
/begin CHARACTERISTIC EngM_swtFirSeqFBC_C "#SSD Schalter zur Auswahl der FBC Zählweise" VALUE 0xCFE8E Kw_Wu8 1.000 default 0.00 1.000 FORMAT "%5.3" EXTENDED_LIMITS 0.00 255.0 /end CHARACTERISTIC
/begin CHARACTERISTIC EngM_swtNumCylVal_C "#SSD Zylinderanzahl, bei Applikation nicht verändern" VALUE 0xCFE6B Kw_Wu8 3.000 OneToOne 3.000 6.000 FORMAT "%5.3" EXTENDED_LIMITS 0.00 255.0 /end CHARACTERISTIC
/begin CHARACTERISTIC EngM_swtNumCylType_C "#SSD Sw-Schaltertyp für Zylinderanzahl" VALUE 0xCFE6C Kw_Wu8 2.000 OneToOne 0.00 2.000 FORMAT "%5.3" EXTENDED_LIMITS 0.00 255.0 /end CHARACTERISTIC
/begin CHARACTERISTIC EngM_swtSyncViaCAN_C "#SSD Ein-, Ausschalten 1/0 der Master-Slave Synchronisation via CAN" VALUE 0xCFE8F Kw_Wu8 1.000 OneToOne 0.00 1.000 FORMAT "%5.3" EXTENDED_LIMITS 0.00 255.0 /end CHARACTERISTIC
/begin CHARACTERISTIC EngM_tAdptMin_C "Minimalmotortemperatur für Reibmomentenadaption" VALUE 0xD01A4 Kw_Wu16 950.000 Temp_Cels -50.140 899.860 FORMAT "%8.3" EXTENDED_LIMITS -273.1400 6280.360 /end CHARACTERISTIC
/begin CHARACTERISTIC EngM_tEngMax_C "" VALUE 0xCFDD8 Kw_Ws16 250.0000 Temp_Cels -50.1400 199.8600 FORMAT "%8.4" EXTENDED_LIMITS -3549.940 3003.560 /end CHARACTERISTIC
/begin CHARACTERISTIC EngM_tEngMin_C "" VALUE 0xCFDDA Kw_Ws16 250.0000 Temp_Cels -50.1400 199.8600 FORMAT "%8.4" EXTENDED_LIMITS -3549.940 3003.560 /end CHARACTERISTIC
/begin CHARACTERISTIC EngM_tiCpuTimeOut_C "#SSD CPU timeout Periode" VALUE 0xC0488 Kw_Wu32 100000.000000 TimeDT 0.00 100000.000000 FORMAT "%13.6" EXTENDED_LIMITS 0.00 4294967295.00 /end CHARACTERISTIC
/begin CHARACTERISTIC EngM_tiDiffInt_C "#SSD Minimaler Abstand swischen zwei stat. Interrupts" VALUE 0xCFE90 Kw_Wu32 1228361874.73 TimeSys_us 0.00 1228361874.73 FORMAT "%13.2" /end CHARACTERISTIC
/begin CHARACTERISTIC EngM_tiEngMntCtl_C "" VALUE 0xCFDDC Kw_Wu16 655.3500 Time_s 0.00 655.3500 FORMAT "%8.4" /end CHARACTERISTIC
/begin CHARACTERISTIC EngM_tiHardAftrGear_C "time after which the ramp is activated for gear state" VALUE 0xCFF18 Kw_Wu16 655.3500 Time_s 0.00 655.3500 FORMAT "%8.4" /end CHARACTERISTIC
/begin CHARACTERISTIC EngM_tiRelAdpt_C "Entprellzeit für Übergang NO_ADAPT --> ADAPT der Reibmomentenadaption" VALUE 0xD01A6 Kw_Wu16 655350.0 TimeDeb 0.00 655350.0 FORMAT "%8.1" /end CHARACTERISTIC
/begin CHARACTERISTIC EngM_tiSoftAftrStrt_C "time after which the ramp is activated for engine state" VALUE 0xCFF1A Kw_Wu16 655.3500 Time_s 0.00 655.3500 FORMAT "%8.4" /end CHARACTERISTIC
/begin CHARACTERISTIC EngM_tiWaitIncSig_C "#SSD Zeit zum Ausblenden des Inkrementsignals im Start" VALUE 0xCFE94 Kw_Wu16 20000.00 Time_ms 0.00 20000.00 FORMAT "%8.2" EXTENDED_LIMITS 0.00 655350.0 /end CHARACTERISTIC
/begin CHARACTERISTIC EngM_trqFrcPDiffMin_C "Untere Begrenzung des Drehmomentenverlustes durch Abgasgegendruck aufgrund eingebautem Partikelfilter" VALUE 0xCFF4C Kw_Ws16 600.0000 Trq -300.0000 300.0000 FORMAT "%8.4" EXTENDED_LIMITS -3276.800 3276.700 /end CHARACTERISTIC
/begin CHARACTERISTIC EngM_trqFrc_Vector "#SSD Bypass Label für EngM_trqFrc (nicht verändern !)" VALUE 0xC2EB8 Kw_Wu8 255.0 OneToOne 0.00 255.0 FORMAT "%5.1" /end CHARACTERISTIC
/begin CHARACTERISTIC EngM_trqFrc_Channel "#SSD Bypass Label for EngM_trqFrc (nicht verändern !)" VALUE 0xC2EB9 Kw_Wu8 255.0 OneToOne 0.00 255.0 FORMAT "%5.1" /end CHARACTERISTIC
/begin CHARACTERISTIC EngM_trqFrc_MAP "Schleppkennfeld, Reibkennfeld" MAP 0xCFF4E Kf_Xs16_Ys16_Ws16 6553.500 Trq -3276.800 3276.700 FORMAT "%8.3"
 /begin AXIS_DESCR STD_AXIS Eng_nAvrg EngN 16 0.00 32767.00 FORMAT "%8.2" EXTENDED_LIMITS -32768.00 32767.00 DEPOSIT ABSOLUTE /end AXIS_DESCR
 /begin AXIS_DESCR STD_AXIS EngM_tTrqFrc_mp Temp_Cels 16 -50.140 899.860 FORMAT "%8.3" EXTENDED_LIMITS -3549.940 3003.560 DEPOSIT ABSOLUTE /end AXIS_DESCR
/end CHARACTERISTIC
/begin CHARACTERISTIC EngM_uBattMax_C "" VALUE 0xCFDDE Kw_Ws16 17008.80 Volt_Batt 0.00 17008.80 FORMAT "%8.2" EXTENDED_LIMITS -640625.6 640606.1 /end CHARACTERISTIC
/begin CHARACTERISTIC EngM_uBattMin_C "" VALUE 0xCFDE0 Kw_Ws16 2991.202 Volt_Batt 0.00 2991.202 FORMAT "%8.3" EXTENDED_LIMITS -640625.6 640606.1 /end CHARACTERISTIC
/begin CHARACTERISTIC EngM_vLimRefuse_C "Schwellgeschwindigkeit für Zustandsübergang REFUSE_ADAPT --> NO_ADAPT der Reibmomentenadaption" VALUE 0xD01A8 Kw_Wu16 655.3500 Vel 0.00 655.3500 FORMAT "%8.4" /end CHARACTERISTIC
/begin CHARACTERISTIC EngM_vThresAdpt_C "vehicle speed threshold for release of adaption" VALUE 0xD01AA Kw_Wu16 655.3500 Vel 0.00 655.3500 FORMAT "%8.4" /end CHARACTERISTIC
/begin CHARACTERISTIC EngM_vVSSCDHysHigh_C "high threshold for vechile speed hysteresis" VALUE 0xCFF1C Kw_Ws16 300.0000 Vel 0.00 300.0000 FORMAT "%8.4" EXTENDED_LIMITS -327.6800 327.6700 /end CHARACTERISTIC
/begin CHARACTERISTIC EngM_vVSSCDHysLow_C "low threshold for vechile speed hysteresis" VALUE 0xCFF1E Kw_Ws16 300.0000 Vel 0.00 300.0000 FORMAT "%8.4" EXTENDED_LIMITS -327.6800 327.6700 /end CHARACTERISTIC
/begin CHARACTERISTIC Eng_ctEngSpdDiffCalc_C "Anzahl der Drehzahlwerte zur Mittelung" VALUE 0xCFDE4 Kw_Wu8 4.000 OneToOne 1.000 5.000 FORMAT "%5.3" EXTENDED_LIMITS 0.00 255.0 /end CHARACTERISTIC
/begin CHARACTERISTIC Eng_tOvrHi2_C "high hysteresis limit for setting of overheat status" VALUE 0xCFDE6 Kw_Ws16 250.0000 Temp_Cels -50.14000 199.8600 FORMAT "%8.4" EXTENDED_LIMITS -3549.940 3003.560 /end CHARACTERISTIC
/begin CHARACTERISTIC Eng_tOvrHi_C "Obere Hystereseschwelle für Erkennung Übertemperatur" VALUE 0xCFDE8 Kw_Ws16 250.0000 Temp_Cels -50.14000 199.8600 FORMAT "%8.4" EXTENDED_LIMITS -3549.940 3003.560 /end CHARACTERISTIC
/begin CHARACTERISTIC Eng_tOvrLo2_C "low hysteresis limit for setting of overheat status" VALUE 0xCFDEA Kw_Ws16 250.0000 Temp_Cels -50.14000 199.8600 FORMAT "%8.4" EXTENDED_LIMITS -3549.940 3003.560 /end CHARACTERISTIC
/begin CHARACTERISTIC Eng_tOvrLo_C "Untere Hystereseschwelle für Erkennung Übertemperatur" VALUE 0xCFDEC Kw_Ws16 250.0000 Temp_Cels -50.14000 199.8600 FORMAT "%8.4" EXTENDED_LIMITS -3549.940 3003.560 /end CHARACTERISTIC
/begin CHARACTERISTIC Eng_trqSpd_CUR "Drehmomentkennlinie" CURVE 0xCFDEE Kl_Xs16_Ws16 3276.700 Trq 0.00 3276.700 FORMAT "%8.3" EXTENDED_LIMITS -3276.800 3276.700
 /begin AXIS_DESCR STD_AXIS Eng_nAvrg EngN 21 0.00 6000.000 FORMAT "%8.3" EXTENDED_LIMITS -32768.00 32767.00 DEPOSIT ABSOLUTE /end AXIS_DESCR
/end CHARACTERISTIC
/begin MEASUREMENT EBFCD_stOut "status output of EBFCD" UBYTE OneToOne 1 100 0.00 255.0 FORMAT "%5.1" ECU_ADDRESS 0x7F8828 /end MEASUREMENT
/begin MEASUREMENT EBFCD_st_mp "Status of output of EBFCD" UBYTE OneToOne 1 100 0.00 255.0 FORMAT "%5.1" ECU_ADDRESS 0x8FEC6D /end MEASUREMENT
/begin MEASUREMENT EBTSCD_tCIntLin "ECU temperature linearized value" SWORD Temp_Cels 1 100 -50.140 899.860 FORMAT "%8.3" ECU_ADDRESS 0x7F8BA8 /end MEASUREMENT
/begin MEASUREMENT EBTSCD_tECU "ECU temperature current value" SWORD Temp_Cels 1 100 -50.140 899.860 FORMAT "%8.3" ECU_ADDRESS 0x7F8BAA /end MEASUREMENT
/begin MEASUREMENT EBTSCD_uRawTECU_mp "Raw sensor voltage" SWORD Volt 1 100 -160156.4 160151.5 FORMAT "%8.1" ECU_ADDRESS 0x8FEC6E /end MEASUREMENT
/begin MEASUREMENT EEPCD_stErrSet "Allgemeiner Fehlerzustand bei der Aktivierung einer Konfiguration" UBYTE OneToOne 1 100 0.00 255.0 FORMAT "%5.1" ECU_ADDRESS 0x7F8829 /end MEASUREMENT
/begin MEASUREMENT EEPCD_stMIL "Variant manager default status of MIL lamp" UBYTE OneToOne 1 100 0.00 255.0 FORMAT "%5.1" ECU_ADDRESS 0x7F882A /end MEASUREMENT
/begin MEASUREMENT EGPpCD_stActrOut "status of exhaust gas pressure pipe actuator" UBYTE OneToOne 1 100 0.00 255.0 FORMAT "%5.1" ECU_ADDRESS 0x7F882B /end MEASUREMENT
/begin MEASUREMENT EGPp_dvolSil_mp "Abgasvolumenstrom nach Partikelfilter" SWORD CubMtrPerHr 1 100 -3276.800 3276.700 FORMAT "%8.3" ECU_ADDRESS 0x8FEC70 /end MEASUREMENT
/begin MEASUREMENT EGPp_pPstPFlt "Druckabfall des Abgassystems nach Partikelfilter" SWORD Pres_hPa 1 100 -32768.00 32767.00 FORMAT "%8.2" ECU_ADDRESS 0x7F8BAE /end MEASUREMENT
/begin MEASUREMENT EGPp_pPstPFltMap_mp "Druckabfall nach Partikelfilter aus Kennfeldberechnung" SWORD Pres_hPa 1 100 -32768.00 32767.00 FORMAT "%8.2" ECU_ADDRESS 0x8FEC72 /end MEASUREMENT
/begin MEASUREMENT EGPp_pPstPFltSim_mp "Druckabfall nach Partikelfilter aus Simulation" SWORD Pres_hPa 1 100 -32768.00 32767.00 FORMAT "%8.2" ECU_ADDRESS 0x8FEC74 /end MEASUREMENT
/begin MEASUREMENT EGPp_stLogicOut "Status of Exhaust gas pressure pump" UBYTE OneToOne 1 100 0.00 255.0 FORMAT "%5.1" ECU_ADDRESS 0x7F882C /end MEASUREMENT
/begin MEASUREMENT EGRCD_rCnv_mp "Tastverhältnis  basierend auf dem Ausgang des Abgasrückführreglers" SWORD DtyCyc 1 100 -327.6800 327.6700 FORMAT "%8.4" ECU_ADDRESS 0x8FEC76 /end MEASUREMENT
/begin MEASUREMENT EGRCD_rOut "Tastverhältnis zür Endstufenansteuerung" SWORD DtyCyc 1 100 -327.6800 327.6700 FORMAT "%8.4" ECU_ADDRESS 0x7F8BB0 /end MEASUREMENT
/begin MEASUREMENT EGRVlv_rEGR "Ansteuertastverhältnis für ARF-Ventil" SWORD Prc 1 100 -400.0000 399.9878 FORMAT "%8.4" ECU_ADDRESS 0x7F8BB2 /end MEASUREMENT
/begin MEASUREMENT EGRVlv_rEGR2 "Sollwert für Abgasrückführung Coordinator 2" SWORD Prc 1 100 -400.0000 399.9878 FORMAT "%8.4" ECU_ADDRESS 0x7F8BB4 /end MEASUREMENT
/begin MEASUREMENT EGRVlv_rEGR2Byp_mp "measuringpoint2 to be able to read value by ASCET before bypass" SWORD Prc 1 100 -400.0000 399.9878 FORMAT "%8.4" ECU_ADDRESS 0x8FEC78 /end MEASUREMENT
/begin MEASUREMENT EGRVlv_rEGRByp_mp "Bypass-Label, Kopie von EGRVlv_rEGR" SWORD Prc 1 100 -400.0000 399.9878 FORMAT "%8.4" ECU_ADDRESS 0x8FEC7A /end MEASUREMENT
/begin MEASUREMENT EGSys_AlpEGTube_mp "Wärmeübertragungskoeffizient zwischen Abgas und Abgasrohr" SWORD ThermalCoEff 1 100 -3276.800 3276.700 FORMAT "%8.3" ARRAY_SIZE 2 ECU_ADDRESS 0x8FED00 /end MEASUREMENT
/begin MEASUREMENT EGSys_AlpTubeEnv_mp "Wärmeübertragungskoeffizient zwischen Abgasrohr und Umgebung" SWORD ThermalCoEff 1 100 -3276.800 3276.700 FORMAT "%8.3" ARRAY_SIZE 2 ECU_ADDRESS 0x8FED04 /end MEASUREMENT
/begin MEASUREMENT EGSys_cndHtEGi_mp "Wärmeleitfähigkeit Abgas im Rohr" SWORD Fact 1 100 -4.000000 3.999878 FORMAT "%8.6" ARRAY_SIZE 2 ECU_ADDRESS 0x8FED08 /end MEASUREMENT
/begin MEASUREMENT EGSys_cndHtEGo_mp "Wärmeleitfähigkeit Luft ausserhalb des Rohres" SWORD Fact 1 100 -4.000000 3.999878 FORMAT "%8.6" ARRAY_SIZE 2 ECU_ADDRESS 0x8FED0C /end MEASUREMENT
/begin MEASUREMENT EGSys_cpEGLSU_mp "Spezifische Wärmekapazität des Abgases" SWORD SpecificHeat 1 100 -3.276800 3.276700 FORMAT "%8.6" ARRAY_SIZE 1 ECU_ADDRESS 0x8FEC7C /end MEASUREMENT
/begin MEASUREMENT EGSys_cpEGNSC_mp "Spezifische Wärmekapazität Abgas im NSC" SWORD SpecificHeat 1 100 -3.276800 3.276700 FORMAT "%8.6" ECU_ADDRESS 0x8FECC4 /end MEASUREMENT
/begin MEASUREMENT EGSys_cpEGOxiCat_mp "Spezifische Wärmekapazität Abgas im Oxidationskatalysator" SWORD SpecificHeat 1 100 -3.276800 3.276700 FORMAT "%8.6" ECU_ADDRESS 0x8FECCC /end MEASUREMENT
/begin MEASUREMENT EGSys_cpEGTrbn_mp "Spezifische Wärmekapazität Abgas in Turbine" SWORD SpecificHeat 1 100 -3.276800 3.276700 FORMAT "%8.6" ECU_ADDRESS 0x8FECF4 /end MEASUREMENT
/begin MEASUREMENT EGSys_cpEGTube_mp "Spezifsche Wärmekapazität Abgas im Abgasrohr" SWORD SpecificHeat 1 100 -3.276800 3.276700 FORMAT "%8.6" ARRAY_SIZE 2 ECU_ADDRESS 0x8FED10 /end MEASUREMENT
/begin MEASUREMENT EGSys_ctCldStrtLSU_mp "Zähler für wiederholte Kaltstarts" UBYTE OneToOne 1 100 0.00 255.0 FORMAT "%5.1" ARRAY_SIZE 1 ECU_ADDRESS 0x6F8082 /end MEASUREMENT
/begin MEASUREMENT EGSys_dmEG "näherungsweiser Abgasmassenstrom" SWORD AirMassPerTime 1 100 -3276.800 3276.700 FORMAT "%8.3" ECU_ADDRESS 0x7F8BB6 /end MEASUREMENT
/begin MEASUREMENT EGSys_dtTube_mp "Temperaturänderung Abgasrohr" SWORD Temp_Kelv_Sec 1 100 -327.6800 327.6700 FORMAT "%8.4" ARRAY_SIZE 2 ECU_ADDRESS 0x8FED14 /end MEASUREMENT
/begin MEASUREMENT EGSys_dwFlCmb_mp "Wärmestrom durch spät nacheingespritzte Kraftstoffmenge" SLONG Pwr1 1 100 -214748364.800 214748364.700 FORMAT "%13.3" ECU_ADDRESS 0x8FECD0 /end MEASUREMENT
/begin MEASUREMENT EGSys_dwLSU_mp "Abgaswärmestrom an Sondenposition" SWORD Pwr_kW_Sec 1 100 -327.6800 327.6700 FORMAT "%8.4" ARRAY_SIZE 1 ECU_ADDRESS 0x8FEC7E /end MEASUREMENT
/begin MEASUREMENT EGSys_dwTubeIn_mp "Eintretender Wärmestrom Abgasrohr" SLONG Pwr1 1 100 -214748364.800 214748364.700 FORMAT "%13.3" ARRAY_SIZE 2 ECU_ADDRESS 0x8FED18 /end MEASUREMENT
/begin MEASUREMENT EGSys_dwTubeOut_mp "Austretender Wärmestrom Abgasrohr" SLONG Pwr1 1 100 -214748364.800 214748364.700 FORMAT "%13.3" ARRAY_SIZE 2 ECU_ADDRESS 0x8FED20 /end MEASUREMENT
/begin MEASUREMENT EGSys_dwTube_mp "Wärmeänderung Abgasrohr" SLONG Pwr1 1 100 -214748364.800 214748364.700 FORMAT "%13.3" ARRAY_SIZE 2 ECU_ADDRESS 0x8FED28 /end MEASUREMENT
/begin MEASUREMENT EGSys_etaChrg_mp "Gesamtwirkungsgrad Turbolader" SWORD Fact 1 100 -4.000000 3.999878 FORMAT "%8.6" ECU_ADDRESS 0x8FECF6 /end MEASUREMENT
/begin MEASUREMENT EGSys_facAirMass_mp "Luftmassen-Korrekturfaktor für stationäre Abgaskrümmertemperatur" SWORD Fact 1 100 -4.000000 3.999878 FORMAT "%8.6" ECU_ADDRESS 0x8FECB2 /end MEASUREMENT
/begin MEASUREMENT EGSys_facPT1Chrg_mp "Variabler Faktor für thermische Zeitkonstante Lader" SWORD Fact_PT1 1 100 -256.0000 255.9922 FORMAT "%8.4" ECU_ADDRESS 0x8FECF8 /end MEASUREMENT
/begin MEASUREMENT EGSys_facStrtDlv_mp "Förderbeginn-Korrekturfaktor für stationäre Abgaskrümmertemperatur" SWORD Fact 1 100 -4.000000 3.999878 FORMAT "%8.6" ECU_ADDRESS 0x8FECB4 /end MEASUREMENT
/begin MEASUREMENT EGSys_NuTubeEnv_mp "Nusselt-Zahl Aussenumströmung Abgasrohr" SWORD OneToOne 1 100 -32768.00 32767.00 FORMAT "%8.2" ARRAY_SIZE 2 ECU_ADDRESS 0x8FED30 /end MEASUREMENT
/begin MEASUREMENT EGSys_NuTube_mp "Nusselt-Zahl im Abgasrohr" SWORD OneToOne 1 100 -32768.00 32767.00 FORMAT "%8.2" ARRAY_SIZE 2 ECU_ADDRESS 0x8FED34 /end MEASUREMENT
/begin MEASUREMENT EGSys_pExhGas "Abgasgegendruck" SWORD Pres_hPa 1 100 -32768.00 32767.00 FORMAT "%8.2" ARRAY_SIZE 1 ECU_ADDRESS 0x7F8BB8 /end MEASUREMENT
/begin MEASUREMENT EGSys_phiDiffStrt_mp "Differenz zwischen Förderbeginn im Auslegungspunkt und aktuellem Wert" SWORD AngleCrS 1 100 -768.0000 767.9766 FORMAT "%8.4" ECU_ADDRESS 0x8FECB6 /end MEASUREMENT
/begin MEASUREMENT EGSys_pwrCmpr_mp "Verdichterleistung" SWORD Pwr 1 100 -308831.1 308821.7 FORMAT "%8.1" ECU_ADDRESS 0x8FECFA /end MEASUREMENT
/begin MEASUREMENT EGSys_qMIStd "Vor- und haupteingespritzte Kraftstoffmenge (im Brennraum verbrannt)" SWORD InjMassCyc 1 100 -327.6800 327.6700 FORMAT "%8.4" ECU_ADDRESS 0x7F8BBA /end MEASUREMENT
/begin MEASUREMENT EGSys_qPoIRgn "Spät nacheingespritzte Kraftstoffmenge (nicht im Brennraum verbrannt)" SWORD InjMassInj 1 100 -327.6800 327.6700 FORMAT "%8.4" ECU_ADDRESS 0x7F8BBC /end MEASUREMENT
/begin MEASUREMENT EGSys_rAirPerTime_mp "Verhältnis Luftmassenstrom im Auslegungspunkt zu aktuellem Wert" SWORD Fact 1 100 -4.000000 3.999878 FORMAT "%8.6" ECU_ADDRESS 0x8FECB8 /end MEASUREMENT
/begin MEASUREMENT EGSys_ReTubeEnvInpCrv_mp "Messpunkt Eingangswert Kurve EGSys_NuTubeEnv_CUR" SWORD OneToOne 1 100 -32768.00 32767.00 FORMAT "%8.2" ECU_ADDRESS 0x8FED38 /end MEASUREMENT
/begin MEASUREMENT EGSys_ReTubeEnv_mp "Reynolds-Zahl Aussenumströmung Abgasrohr" SWORD OneToOne 1 100 -32768.00 32767.00 FORMAT "%8.2" ARRAY_SIZE 2 ECU_ADDRESS 0x8FED3A /end MEASUREMENT
/begin MEASUREMENT EGSys_ReTubeInpCrv_mp "Messpunkt Eingang Kurve EGSys_NuTube_CUR" SWORD ReynoldsNum 1 100 -3276800. 3276700. FORMAT "%8.0" ECU_ADDRESS 0x8FED3E /end MEASUREMENT
/begin MEASUREMENT EGSys_ReTube_mp "Reynolds-Zahl im Abgasrohr" SWORD ReynoldsNum 1 100 -3276800. 3276700. FORMAT "%8.0" ARRAY_SIZE 2 ECU_ADDRESS 0x8FED40 /end MEASUREMENT
/begin MEASUREMENT EGSys_rLmbdAprx "näherungsweiser Lambda-Wert" SWORD lambda 1 100 -32.76800 32.76700 FORMAT "%8.5" ECU_ADDRESS 0x7F8BBE /end MEASUREMENT
/begin MEASUREMENT EGSys_rPresCmpr_mp "Verdichterdruckverhältnis" SWORD Fact 1 100 -4.000000 3.999878 FORMAT "%8.6" ECU_ADDRESS 0x8FECFC /end MEASUREMENT
/begin MEASUREMENT EGSys_rTempClnt_mp "Verhältnis Motorübertemperatur Motorstart / -stop" SWORD Fact 1 100 -4.000000 3.999878 FORMAT "%8.6" ECU_ADDRESS 0x8FECE0 /end MEASUREMENT
/begin MEASUREMENT EGSys_rTimeNSC_mp "Verhältnis Standzeit zu Halbwertszeit NSC" SWORD Fact1 1 100 -256.0000 255.9922 FORMAT "%8.4" ECU_ADDRESS 0x8FECE2 /end MEASUREMENT
/begin MEASUREMENT EGSys_rTimeOxiCat_mp "Verhältnis Standzeit zu Halbwertszeit Oxidationskatalysator" SWORD Fact1 1 100 -256.0000 255.9922 FORMAT "%8.4" ECU_ADDRESS 0x8FECE4 /end MEASUREMENT
/begin MEASUREMENT EGSys_rTimeTrb_mp "Verhältnis-Stillstand-Zeit / Halbzeit-Periode turbocharger" SWORD Fact1 1 100 -256.0000 255.9922 FORMAT "%8.4" ECU_ADDRESS 0x8FECE6 /end MEASUREMENT
/begin MEASUREMENT EGSys_rTimeTube_mp "Verhältnis Standzeit zu Halbwertszeit Abgasrohr" SWORD Fact1 1 100 -256.0000 255.9922 FORMAT "%8.4" ARRAY_SIZE 2 ECU_ADDRESS 0x8FECDC /end MEASUREMENT
/begin MEASUREMENT EGSys_sqTube_mp "Oberfläche Abgasrohr" SWORD Area 1 100 -4.000000 3.999878 FORMAT "%8.6" ARRAY_SIZE 2 ECU_ADDRESS 0x8FED44 /end MEASUREMENT
/begin MEASUREMENT EGSys_stHtgLSU "Statusbit Freigabe Sensor-Heizung" UBYTE OneToOne 1 100 0.00 255.0 FORMAT "%5.1" ARRAY_SIZE 1 ECU_ADDRESS 0x7F882D /end MEASUREMENT
/begin MEASUREMENT EGSys_stHtgLSULstTrp_mp "Status der Taupunktfreigabe des letzten Fahrzyklus" UBYTE OneToOne 1 100 0.00 255.0 FORMAT "%5.1" ARRAY_SIZE 1 ECU_ADDRESS 0x8FEC80 /end MEASUREMENT
/begin MEASUREMENT EGSys_stHtgThresLSUHit_mp "Statusmessage für Überschreiten des Wärmemengenschwellwertes" UBYTE OneToOne 1 100 0.00 255.0 FORMAT "%5.1" ARRAY_SIZE 1 ECU_ADDRESS 0x8FEC81 /end MEASUREMENT
/begin MEASUREMENT EGSys_stIntegIni_mp "Status Integrator Initialisierung" UBYTE OneToOne 1 100 0.00 255.0 FORMAT "%5.1" ARRAY_SIZE 1 ECU_ADDRESS 0x8FEC82 /end MEASUREMENT
/begin MEASUREMENT EGSys_stPlsLSU_mp "Status-Bit gültiger Gaspuls" UBYTE OneToOne 1 100 0.00 255.0 FORMAT "%5.1" ARRAY_SIZE 1 ECU_ADDRESS 0x8FEC83 /end MEASUREMENT
/begin MEASUREMENT EGSys_tAvrgEGTrbn_mp "Mittlere Abgastemperatur in Turbine" SWORD Temp_Cels 1 100 -50.140 899.860 FORMAT "%8.3" ECU_ADDRESS 0x8FECFE /end MEASUREMENT
/begin MEASUREMENT EGSys_tAvrgEGTube_mp "Mittlere Abgastemperatur im Abgasrohr" SWORD Temp_Cels 1 100 -50.140 899.860 FORMAT "%8.3" ARRAY_SIZE 2 ECU_ADDRESS 0x8FED48 /end MEASUREMENT
/begin MEASUREMENT EGSys_tAvrgNSC_mp "Mittlere Temperatur NSC" SWORD Temp_Cels 1 100 -50.140 899.860 FORMAT "%8.3" ECU_ADDRESS 0x8FECC6 /end MEASUREMENT
/begin MEASUREMENT EGSys_tAvrgOxiCat_mp "Mittlere Temperatur Oxidationskatalysator" SWORD Temp_Cels 1 100 -50.140 899.860 FORMAT "%8.3" ECU_ADDRESS 0x8FECD4 /end MEASUREMENT
/begin MEASUREMENT EGSys_tCorrIAT_mp "Temperaturoffset aufgrund Schwankungen der Ansauglufttemperatur" SWORD TempDiff_Cels 1 100 -3276.800 3276.700 FORMAT "%8.3" ECU_ADDRESS 0x8FECBA /end MEASUREMENT
/begin MEASUREMENT EGSys_tCorrManf_mp "Temperaturoffset Krümmer bei kaltem Motor" SWORD TempDiff_Cels 1 100 -3276.800 3276.700 FORMAT "%8.3" ECU_ADDRESS 0x8FECBC /end MEASUREMENT
/begin MEASUREMENT EGSys_tDiffCldEng_mp "Abweichung aktuelle Motortemperatur von stationärem Wert" SWORD TempDiff_Cels 1 100 -3276.800 3276.700 FORMAT "%8.3" ECU_ADDRESS 0x8FECBE /end MEASUREMENT
/begin MEASUREMENT EGSys_tDiffEGTube_mp "Temperaturdifferenz Abgas / Abgasrohr" SWORD TempDiff_Cels 1 100 -3276.800 3276.700 FORMAT "%8.3" ARRAY_SIZE 2 ECU_ADDRESS 0x8FED4C /end MEASUREMENT
/begin MEASUREMENT EGSys_tDiffIAT_mp "Differenz zwischen Ansaulglufttemperatur im Auslegungspunkt und aktuellem Wert" SWORD TempDiff_Cels 1 100 -3276.800 3276.700 FORMAT "%8.3" ECU_ADDRESS 0x8FECC0 /end MEASUREMENT
/begin MEASUREMENT EGSys_tDiffTubeEnv_mp "Temperaturdifferenz Abgasrohr / Umgebung" SWORD TempDiff_Cels 1 100 -3276.800 3276.700 FORMAT "%8.3" ARRAY_SIZE 2 ECU_ADDRESS 0x8FED50 /end MEASUREMENT
/begin MEASUREMENT EGSys_tEGLSU "Abgas-Temperatur an Sensor-Position" SWORD Temp_Cels 1 100 -50.140 899.860 FORMAT "%8.3" ARRAY_SIZE 1 ECU_ADDRESS 0x7F8BC0 /end MEASUREMENT
/begin MEASUREMENT EGSys_tEGLSUInpCrv0_mp "Messpunkt Eingang der Kennlinien" SWORD Temp_Cels 1 100 -50.140 899.860 FORMAT "%8.3" ECU_ADDRESS 0x8FEC8C /end MEASUREMENT
/begin MEASUREMENT EGSys_tEGLSUInpCrv1_mp "Messpunkt Eingang des Kennfeldes EGSys_wTresLSU1_MAP" SWORD Temp_Cels 1 100 -50.140 899.860 FORMAT "%8.3" ECU_ADDRESS 0x8FEC8E /end MEASUREMENT
/begin MEASUREMENT EGSys_tEGLSUInpCrv2_mp "Messpunkt Eingang des Kennfeldes EGSys_wTresLSU2_MAP" SWORD Temp_Cels 1 100 -50.140 899.860 FORMAT "%8.3" ECU_ADDRESS 0x8FEC90 /end MEASUREMENT
/begin MEASUREMENT EGSys_tEGLSUInpCrv3_mp "Messpunkt Eingang des Kennfeldes EGSys_wTresLSU3_MAP" SWORD Temp_Cels 1 100 -50.140 899.860 FORMAT "%8.3" ECU_ADDRESS 0x8FEC92 /end MEASUREMENT
/begin MEASUREMENT EGSys_tEGPreNSC "Abgastemperatur am NSC-Eintritt" SWORD Temp_Cels 1 100 -50.140 899.860 FORMAT "%8.3" ECU_ADDRESS 0x7F8BC2 /end MEASUREMENT
/begin MEASUREMENT EGSys_tEGPreOxiCat "Abgastemperatur am Oxidationskatalysator-Eintritt" SWORD Temp_Cels 1 100 -50.140 899.860 FORMAT "%8.3" ECU_ADDRESS 0x7F8BC4 /end MEASUREMENT
/begin MEASUREMENT EGSys_tEGPreTrbn "Abgas-Temperatur vor Turbine" SWORD Temp_Cels 1 100 -50.140 899.860 FORMAT "%8.3" ECU_ADDRESS 0x7F8BC6 /end MEASUREMENT
/begin MEASUREMENT EGSys_tEGPreTube "Abgastemperatur am Abgasrohr-Eintritt" SWORD Temp_Cels 1 100 -50.140 899.860 FORMAT "%8.3" ARRAY_SIZE 2 ECU_ADDRESS 0x7F9100 /end MEASUREMENT
/begin MEASUREMENT EGSys_tEGPstTrbn "Abgas-Temperatur nach Turbolader" SWORD Temp_Cels 1 100 -50.140 899.860 FORMAT "%8.3" ECU_ADDRESS 0x7F8BC8 /end MEASUREMENT
/begin MEASUREMENT EGSys_tEGPstTube "Abgastemperatur am Abgasrohr-Auslass" SWORD Temp_Cels 1 100 -50.140 899.860 FORMAT "%8.3" ARRAY_SIZE 2 ECU_ADDRESS 0x7F9104 /end MEASUREMENT
/begin MEASUREMENT EGSys_tExcClntStrtCs_mp "Motorübertemperatur bei Motorstart" SWORD TempDiff_Cels 1 100 -3276.800 3276.700 FORMAT "%8.3" ECU_ADDRESS 0x8FECE8 /end MEASUREMENT
/begin MEASUREMENT EGSys_tiClg_mp "Abkühlzeit" ULONG Time_s 1 100 0.00 42949672.9500 FORMAT "%13.4" ECU_ADDRESS 0x8FECEC /end MEASUREMENT
/begin MEASUREMENT EGSys_tIncrPoI_mp "Temperaturerhöhung im Oxidationskatalysator aufgrund später Nacheinspritzung" SWORD TempDiff_Cels 1 100 -3276.800 3276.700 FORMAT "%8.3" ECU_ADDRESS 0x8FECD6 /end MEASUREMENT
/begin MEASUREMENT EGSys_tiRefClg_mp "Referenz-Abkühlzeit aus Motor-Abkühlung" ULONG Time_s 1 100 0.00 42949672.9500 FORMAT "%13.4" ECU_ADDRESS 0x8FECF0 /end MEASUREMENT
/begin MEASUREMENT EGSys_tManfStat "stationäre Abgastemperatur im Abgaskrümmer" SWORD Temp_Cels 1 100 -50.140 899.860 FORMAT "%8.3" ECU_ADDRESS 0x7F8BCA /end MEASUREMENT
/begin MEASUREMENT EGSys_tManfStat_mp "stationäre Abgastemperatur im Abgaskrümmer ohne Korrekturen" SWORD Temp_Cels 1 100 -50.140 899.860 FORMAT "%8.3" ECU_ADDRESS 0x8FECC2 /end MEASUREMENT
/begin MEASUREMENT EGSys_tMem_mp "Zwischenspeicher für Temperaturen" SWORD Temp_Cels 1 100 -50.140 899.860 FORMAT "%8.3" ARRAY_SIZE 14 ECU_ADDRESS 0x8FEC94 /end MEASUREMENT
/begin MEASUREMENT EGSys_tMidEGTube_mp "Mittlere Temperatur zwischen Abgas und Abgasrohrwand" SWORD Temp_Cels 1 100 -50.140 899.860 FORMAT "%8.3" ARRAY_SIZE 2 ECU_ADDRESS 0x8FED54 /end MEASUREMENT
/begin MEASUREMENT EGSys_tMidTubeEnv_mp "Mittlere Temperatur zwischen Abgasrohr und Umgebung" SWORD Temp_Cels 1 100 -50.140 899.860 FORMAT "%8.3" ARRAY_SIZE 2 ECU_ADDRESS 0x8FED58 /end MEASUREMENT
/begin MEASUREMENT EGSys_tNSC "Temperatur NSC (Austritt)" SWORD Temp_Cels 1 100 -50.140 899.860 FORMAT "%8.3" ECU_ADDRESS 0x7F8BCC /end MEASUREMENT
/begin MEASUREMENT EGSys_tNSCExoIncr_mp "Temperaturerhöhung im NSC durch chemische Reaktionen" SWORD TempDiff_Cels 1 100 -3276.800 3276.700 FORMAT "%8.3" ECU_ADDRESS 0x8FECC8 /end MEASUREMENT
/begin MEASUREMENT EGSys_tNSCStat_mp "Stationäre Temperatur NSC" SWORD Temp_Cels 1 100 -50.140 899.860 FORMAT "%8.3" ECU_ADDRESS 0x8FECCA /end MEASUREMENT
/begin MEASUREMENT EGSys_tNSCStrtCs "Temperatur NSC bei Motorstart" SWORD Temp_Cels 1 100 -50.140 899.860 FORMAT "%8.3" ECU_ADDRESS 0x7F8BCE /end MEASUREMENT
/begin MEASUREMENT EGSys_tOxiCat "Temperatur Oxidationskatalysator (Austritt)" SWORD Temp_Cels 1 100 -50.140 899.860 FORMAT "%8.3" ECU_ADDRESS 0x7F8BD0 /end MEASUREMENT
/begin MEASUREMENT EGSys_tOxiCatExoIncr_mp "Temperaturerhöhung im Oxidationskatalysator durch chemische Reaktionen" SWORD TempDiff_Cels 1 100 -3276.800 3276.700 FORMAT "%8.3" ECU_ADDRESS 0x8FECD8 /end MEASUREMENT
/begin MEASUREMENT EGSys_tOxiCatStat_mp "Stationäre Temperatur Oxidationskatalysator" SWORD Temp_Cels 1 100 -50.140 899.860 FORMAT "%8.3" ECU_ADDRESS 0x8FECDA /end MEASUREMENT
/begin MEASUREMENT EGSys_tOxiCatStrtCs "Temperatur Oxidationskatalysator bei Motorstart" SWORD Temp_Cels 1 100 -50.140 899.860 FORMAT "%8.3" ECU_ADDRESS 0x7F8BD2 /end MEASUREMENT
/begin MEASUREMENT EGSys_tShOffTExcClnt_mp "Motorübertemperature bei Motorstop" SWORD TempDiff_Cels 1 100 -3276.800 3276.700 FORMAT "%8.3" ECU_ADDRESS 0x8FECB0 /end MEASUREMENT
/begin MEASUREMENT EGSys_tTrbStrtCs "Turbocharger Temperatur an Maschinenanfang" SWORD Temp_Cels 1 100 -50.140 899.860 FORMAT "%8.3" ECU_ADDRESS 0x7F8BD4 /end MEASUREMENT
/begin MEASUREMENT EGSys_tTube "Wandtemperatur Abgasrohr" SWORD Temp_Cels 1 100 -50.140 899.860 FORMAT "%8.3" ARRAY_SIZE 2 ECU_ADDRESS 0x7F9108 /end MEASUREMENT
/begin MEASUREMENT EGSys_tTubeStrtCs "Temperatur Abgasrohr bei Motorstart" SWORD Temp_Cels 1 100 -50.140 899.860 FORMAT "%8.3" ARRAY_SIZE 2 ECU_ADDRESS 0x7F910C /end MEASUREMENT
/begin MEASUREMENT EGSys_tWallLSU "Wandtemperatur am Sondeneinbauort" SWORD Temp_Cels 1 100 -50.140 899.860 FORMAT "%8.3" ARRAY_SIZE 1 ECU_ADDRESS 0x7F8BD6 /end MEASUREMENT
/begin MEASUREMENT EGSys_wLSU_mp " integrierte Wärmemenge an Sensor-Position." SWORD Energy 1 100 -32768.00 32767.00 FORMAT "%8.2" ARRAY_SIZE 1 ECU_ADDRESS 0x6F8084 /end MEASUREMENT
/begin MEASUREMENT EGSys_wThresLSUAct_mp "aktueller Wärmeschwellwert an Sensorposition." SWORD Energy 1 100 -32768.00 32767.00 FORMAT "%8.2" ARRAY_SIZE 1 ECU_ADDRESS 0x8FEC84 /end MEASUREMENT
/begin MEASUREMENT EGSys_wThresLSUNoPls_mp "Hitzeschwelle ohne gültigen Gaspuls." SWORD Energy 1 100 -32768.00 32767.00 FORMAT "%8.2" ARRAY_SIZE 1 ECU_ADDRESS 0x8FEC86 /end MEASUREMENT
/begin MEASUREMENT EGSys_wThresLSUPls_mp "Hitzeschwelle für gültigen Gaspuls" SWORD Energy 1 100 -32768.00 32767.00 FORMAT "%8.2" ARRAY_SIZE 1 ECU_ADDRESS 0x8FEC88 /end MEASUREMENT
/begin MEASUREMENT EGSys_wThresLSU_mp "Grundlegender Wert-Hitzeschwelle-Sensor" SWORD Energy 1 100 -32768.00 32767.00 FORMAT "%8.2" ARRAY_SIZE 1 ECU_ADDRESS 0x8FEC8A /end MEASUREMENT
/begin MEASUREMENT EGT_facRmpVal "Zentraler Rampenwert (drehzahlsynchron)" SWORD EGTSwt_S16 1 100 -2.000000 1.999939 FORMAT "%8.6" ECU_ADDRESS 0x7F8BD8 /end MEASUREMENT
/begin MEASUREMENT EGT_facRmpValTempGvnr_mp "aktueller Rampenwert des EGT Temperaturreglers" ULONG EGTSwt 1 100 0.00 262.143999939 FORMAT "%13.9" ECU_ADDRESS 0x8FED98 /end MEASUREMENT
/begin MEASUREMENT EGT_facRmp_mp "Rampenwert für Umwandlung 32bit -> 16bit" SWORD EGTSwt_S16 1 100 -2.000000 1.999939 FORMAT "%8.6" ECU_ADDRESS 0x8FED9C /end MEASUREMENT
/begin MEASUREMENT EGT_mAirDesInrTempGvnr "Additive Luftmassensollwertkorrektur" SWORD AirMassPerCyl 1 100 -3276.800 3276.700 FORMAT "%8.3" ECU_ADDRESS 0x7F8BDA /end MEASUREMENT
/begin MEASUREMENT EGT_mAirDesTempGvnr "Temperaturreglerkorrektur für den Luftmassensollwert" SWORD AirMassPerCyl 1 100 -3276.800 3276.700 FORMAT "%8.3" ECU_ADDRESS 0x7F8BDC /end MEASUREMENT
/begin MEASUREMENT EGT_mAirLmbdTempGvnr_mp "Luftmassenkorrektur durch Lambda" SWORD AirMassPerCyl 1 100 -3276.800 3276.700 FORMAT "%8.3" ECU_ADDRESS 0x8FED9E /end MEASUREMENT
/begin MEASUREMENT EGT_mAirTempGvnrMin_mp "Minimal mögliche Luftmassensollwertkorrektur" SWORD AirMassPerCyl 1 100 -3276.800 3276.700 FORMAT "%8.3" ECU_ADDRESS 0x8FED6C /end MEASUREMENT
/begin MEASUREMENT EGT_mAirTempGvnrRng_mp "Korrekturbereich der Luftmassensollwertkorrektur" SWORD AirMassPerCyl 1 100 -3276.800 3276.700 FORMAT "%8.3" ECU_ADDRESS 0x8FED6E /end MEASUREMENT
/begin MEASUREMENT EGT_phiPoI1TempGvnr "Additive Winkelkorrektur der verzögerten Nacheinspritzung" SWORD AngleCrS 1 100 -768.0000 767.9766 FORMAT "%8.4" ECU_ADDRESS 0x7F8BDE /end MEASUREMENT
/begin MEASUREMENT EGT_qHCTempGvnr "Additive Einpritzmengenkorrektur des HC-Dosierventils" SWORD InjMassInj 1 100 -327.6800 327.6700 FORMAT "%8.4" ECU_ADDRESS 0x7F8BE0 /end MEASUREMENT
/begin MEASUREMENT EGT_qPoI1Min_mp "Minimal erlaubte Korrektur der angelagerten Nacheinspritzung" SWORD InjMassInj 1 100 -327.6800 327.6700 FORMAT "%8.4" ECU_ADDRESS 0x8FED70 /end MEASUREMENT
/begin MEASUREMENT EGT_qPoI1OutrTempGvnr "Additive Korrektur der angelagerten Nacheinspritzung" SWORD InjMassInj 1 100 -327.6800 327.6700 FORMAT "%8.4" ECU_ADDRESS 0x7F8BE2 /end MEASUREMENT
/begin MEASUREMENT EGT_qPoI1Rng_mp "Korrekturbereich der angelagerten Nacheinspritzung" SWORD InjMassInj 1 100 -327.6800 327.6700 FORMAT "%8.4" ECU_ADDRESS 0x8FED72 /end MEASUREMENT
/begin MEASUREMENT EGT_qPoI1TempGvnr "EGT Temperaturregler PoI1 Menge während einer Regeneration" SWORD InjMassInj 1 100 -327.6800 327.6700 FORMAT "%8.4" ECU_ADDRESS 0x7F8BE4 /end MEASUREMENT
/begin MEASUREMENT EGT_qPoI2InrTempGvnr "Additive fortgeschrittene Nacheinspritzmengenkorrektur" SWORD InjMassInj 1 100 -327.6800 327.6700 FORMAT "%8.4" ECU_ADDRESS 0x7F8BE6 /end MEASUREMENT
/begin MEASUREMENT EGT_qPoI2Min_mp "Minimal erlaubte Korrekturmenge der angelagerten Nacheinspritzung" SWORD InjMassInj 1 100 -327.6800 327.6700 FORMAT "%8.4" ECU_ADDRESS 0x8FED74 /end MEASUREMENT
/begin MEASUREMENT EGT_qPoI2Rng_mp "Korrekturbereich der Einpritzmengenkorrektur" SWORD InjMassInj 1 100 -327.6800 327.6700 FORMAT "%8.4" ECU_ADDRESS 0x8FED76 /end MEASUREMENT
/begin MEASUREMENT EGT_qPoI2TempGvnr "EGT Temperaturreglerkorrektur der angelagerten Nacheinspritzung 2 während einer Partikelfilterregeneration" SWORD InjMassInj 1 100 -327.6800 327.6700 FORMAT "%8.4" ECU_ADDRESS 0x7F8BE8 /end MEASUREMENT
/begin MEASUREMENT EGT_rIInrTempGvnr_mp "Reglerausgang des inneren Regelkreises: I-Anteil" SWORD EGTFact 1 100 -32.76800 32.76700 FORMAT "%8.5" ECU_ADDRESS 0x8FED78 /end MEASUREMENT
/begin MEASUREMENT EGT_rInrTempGvnr_mp "Reglerausgang des inneren Regelkreises" SWORD EGTFact 1 100 -32.76800 32.76700 FORMAT "%8.5" ECU_ADDRESS 0x8FED7A /end MEASUREMENT
/begin MEASUREMENT EGT_rIOutrTempGvnr_mp "Reglerausgang der äußeren Regelkreises: I-Anteil" SWORD EGTFact 1 100 -32.76800 32.76700 FORMAT "%8.5" ECU_ADDRESS 0x8FED7C /end MEASUREMENT
/begin MEASUREMENT EGT_rOutrTempGvnr_mp "Regelerausgang des äußeren Regelkreises" SWORD EGTFact 1 100 -32.76800 32.76700 FORMAT "%8.5" ECU_ADDRESS 0x8FED7E /end MEASUREMENT
/begin MEASUREMENT EGT_rPInrTempGvnr_mp "Regelerausgnag des inneren Regelkreises: P-Anteil" SWORD EGTFact 1 100 -32.76800 32.76700 FORMAT "%8.5" ECU_ADDRESS 0x8FED80 /end MEASUREMENT
/begin MEASUREMENT EGT_rPOutrTempGvnr_mp "Reglerausgang des äußeren Regelkreises: P-Anteil" SWORD EGTFact 1 100 -32.76800 32.76700 FORMAT "%8.5" ECU_ADDRESS 0x8FED82 /end MEASUREMENT
/begin MEASUREMENT EGT_rStyInrTempGvnr_mp "Modellierten stationärer Reglerausgang des inneren Regelkreises" SWORD EGTFact 1 100 -32.76800 32.76700 FORMAT "%8.5" ECU_ADDRESS 0x8FED84 /end MEASUREMENT
/begin MEASUREMENT EGT_rStyOutrTempGvnr_mp "Modellierter stationärer Reglerausgang des äußeren Regelkreises" SWORD EGTFact 1 100 -32.76800 32.76700 FORMAT "%8.5" ECU_ADDRESS 0x8FED86 /end MEASUREMENT
/begin MEASUREMENT EGT_st "Regenerationsanforderung für Abgasnachbehandlung (drehzahlsynchron)" ULONG OneToOne 1 100 0.00 4294967295.00 FORMAT "%13.2" ECU_ADDRESS 0x7F9110 /end MEASUREMENT
/begin MEASUREMENT EGT_stClsThrVlv_mp "Maximale Androsselung aktiv" UBYTE OneToOne 1 100 0.00 255.0 FORMAT "%5.1" ECU_ADDRESS 0x8FED88 /end MEASUREMENT
/begin MEASUREMENT EGT_stCoRgn "Innerer Zustand des Regenerationskoordinator (drehzahlsynchron)" UBYTE OneToOne 1 100 0.00 255.0 FORMAT "%5.1" ECU_ADDRESS 0x7F882E /end MEASUREMENT
/begin MEASUREMENT EGT_stCoRgnOld_mp "Alter Wert für den inneren Zustand des Regenerationkoordinators" UBYTE OneToOne 1 100 0.00 255.0 FORMAT "%5.1" ECU_ADDRESS 0x8FED5C /end MEASUREMENT
/begin MEASUREMENT EGT_stCoRgnTSync "Innerer Zustand des Regenerationskoordinator (zeitsynchron)" UBYTE OneToOne 1 100 0.00 255.0 FORMAT "%5.1" ECU_ADDRESS 0x7F882F /end MEASUREMENT
/begin MEASUREMENT EGT_stDel "Verzögerte Regenerationsanforderung für Abgasnachbehandlung (drehzahl synchron)" UBYTE OneToOne 1 100 0.00 255.0 FORMAT "%5.1" ECU_ADDRESS 0x7F9114 /end MEASUREMENT
/begin MEASUREMENT EGT_stLck "Status EGT_stTSync-Kopiervorgang (drehzahlsynchron)" UBYTE OneToOne 1 100 0.00 255.0 FORMAT "%5.1" ECU_ADDRESS 0x7F8830 /end MEASUREMENT
/begin MEASUREMENT EGT_stRgnOilDil_mp "Status Bit Bedingungen erfüllt für Ölverdünnung" UBYTE OneToOne 1 100 0.00 255.0 FORMAT "%5.1" ECU_ADDRESS 0x8FED5D /end MEASUREMENT
/begin MEASUREMENT EGT_stTempGvnr "Status des Abgastemperaturreglers" UWORD OneToOne 1 100 0.00 65535.00 FORMAT "%8.2" ECU_ADDRESS 0x7F8BEA /end MEASUREMENT
/begin MEASUREMENT EGT_stTSync "Regenerationsanforderung für Abgasnachbehandlung (zeitsynchron)" ULONG OneToOne 1 100 0.00 4294967295.00 FORMAT "%13.2" ECU_ADDRESS 0x7F9118 /end MEASUREMENT
/begin MEASUREMENT EGT_stTSyncDes_mp "Regeneration demand for exhaust gas treatment for state machine" ULONG OneToOne 1 100 0.00 4294967295.00 FORMAT "%13.2" ECU_ADDRESS 0x8FED60 /end MEASUREMENT
/begin MEASUREMENT EGT_stTSyncLck "Status Kopieren der Regenerationsanforderung (zeit-synchron)" UBYTE OneToOne 1 100 0.00 255.0 FORMAT "%5.1" ECU_ADDRESS 0x7F8831 /end MEASUREMENT
/begin MEASUREMENT EGT_swtRgnLck_mp "Schalter zur Unterdrückung der Regenerationsmaßnahmen" UBYTE OneToOne 1 100 0.00 255.0 FORMAT "%5.1" ECU_ADDRESS 0x8FED64 /end MEASUREMENT
/begin MEASUREMENT EGT_tInrCorMax_mp "Maximal erlaubte Korrektur des inneren Regelkreises" SWORD TempDiff_Cels 1 100 -3276.800 3276.700 FORMAT "%8.3" ECU_ADDRESS 0x8FED8A /end MEASUREMENT
/begin MEASUREMENT EGT_tInrCorRng_mp "Korrekturbereich der Sollwertkorrektur des inneren Regelkreises" SWORD TempDiff_Cels 1 100 -3276.800 3276.700 FORMAT "%8.3" ECU_ADDRESS 0x8FED8C /end MEASUREMENT
/begin MEASUREMENT EGT_tInrDesCorTempGvnr "Solllwertkorrektur der inneren Kaskade" SWORD TempDiff_Cels 1 100 -3276.800 3276.700 FORMAT "%8.3" ECU_ADDRESS 0x7F8BF0 /end MEASUREMENT
/begin MEASUREMENT EGT_tInrDesTempGvnr "Sollwert für den inneren Abgastemperaturregelkreis" SWORD Temp_Cels 1 100 -50.140 899.860 FORMAT "%8.3" ECU_ADDRESS 0x7F8BF4 /end MEASUREMENT
/begin MEASUREMENT EGT_tInrDvtTempGvnr_mp "Reglerabweichung des inneren Regelkreises" SWORD TempDiff_Cels 1 100 -3276.800 3276.700 FORMAT "%8.3" ECU_ADDRESS 0x8FED8E /end MEASUREMENT
/begin MEASUREMENT EGT_tInrTempGvnr "Aktueller Wert des inneren Abgastemperaturreglers" SWORD Temp_Cels 1 100 -50.140 899.860 FORMAT "%8.3" ECU_ADDRESS 0x7F8BF6 /end MEASUREMENT
/begin MEASUREMENT EGT_tiPoI1ActvCnt_mp "Wartezeit aktive PoI1" ULONG Time_s 1 100 0.00 42949672.9500 FORMAT "%13.4" ECU_ADDRESS 0x8FED90 /end MEASUREMENT
/begin MEASUREMENT EGT_tiPoI2TempGvnr "Additive close point injection time correction" SWORD InjTime_us 1 100 -32768.00 32767.00 FORMAT "%8.2" ECU_ADDRESS 0x7F8BFE /end MEASUREMENT
/begin MEASUREMENT EGT_tiRgn "Zeit seit letzter Änderung von EGT_st (drehzahlsynchron)" ULONG Time_s 1 100 0.00 42949672.9500 FORMAT "%13.4" ECU_ADDRESS 0x7F911C /end MEASUREMENT
/begin MEASUREMENT EGT_tiRgnOilDil "Kritische Zeit für Ölverdünnung" ULONG Time_s 1 100 0.00 42949672.9500 FORMAT "%13.4" ECU_ADDRESS 0x7F9120 /end MEASUREMENT
/begin MEASUREMENT EGT_tiRgnTSync "Zeit seit letzter Änderung von EGT_st (zeitsynchron)" ULONG Time_s 1 100 0.00 42949672.9500 FORMAT "%13.4" ECU_ADDRESS 0x7F9124 /end MEASUREMENT
/begin MEASUREMENT EGT_tiRgnTSyncPre_mp "Gesamtzeit seit letzter EGT-Statusänderung" ULONG Time_s 1 100 0.00 42949672.9500 FORMAT "%13.4" ECU_ADDRESS 0x8FED68 /end MEASUREMENT
/begin MEASUREMENT EGT_tiRmpSlpMax "Maximale Rampenlaufzeit für EGT-Mehrfachschalter" ULONG TimeEGTRmp 1 100 0.000000015258789066052715 65.536000000000001 FORMAT "%19.16" ECU_ADDRESS 0x7F9128 /end MEASUREMENT
/begin MEASUREMENT EGT_tOutrDesTempGvnr "Sollwert des äußeren Abgastemperaturregelkreises" SWORD Temp_Cels 1 100 -50.140 899.860 FORMAT "%8.3" ECU_ADDRESS 0x7F8BFA /end MEASUREMENT
/begin MEASUREMENT EGT_tOutrDvtTempGvnr_mp "Reglerabweichung des äußeren Regelkreises" SWORD TempDiff_Cels 1 100 -3276.800 3276.700 FORMAT "%8.3" ECU_ADDRESS 0x8FED94 /end MEASUREMENT
/begin MEASUREMENT EGT_tOutrTempGvnr "Aktueller Wert des äußeren Abgastemperaturregelkreises" SWORD Temp_Cels 1 100 -50.140 899.860 FORMAT "%8.3" ECU_ADDRESS 0x7F8BFC /end MEASUREMENT
/begin MEASUREMENT EMCCD_dcycCurrOff1_mp "" SWORD DtyCyc 1 100 -327.6800 327.6700 FORMAT "%8.4" ECU_ADDRESS 0x8FEDA0 /end MEASUREMENT
/begin MEASUREMENT EMCCD_dcycCurrOff2_mp "" SWORD DtyCyc 1 100 -327.6800 327.6700 FORMAT "%8.4" ECU_ADDRESS 0x8FEDA2 /end MEASUREMENT
/begin MEASUREMENT EMCCD_dcycCurrOn1_mp "" SWORD DtyCyc 1 100 -327.6800 327.6700 FORMAT "%8.4" ECU_ADDRESS 0x8FEDA4 /end MEASUREMENT
/begin MEASUREMENT EMCCD_dcycCurrOn2_mp "" SWORD DtyCyc 1 100 -327.6800 327.6700 FORMAT "%8.4" ECU_ADDRESS 0x8FEDA6 /end MEASUREMENT
/begin MEASUREMENT EMCCD_dcycMntCtlOut1_mp "" SWORD DtyCyc 1 100 -327.6800 327.6700 FORMAT "%8.4" ECU_ADDRESS 0x8FEDA8 /end MEASUREMENT
/begin MEASUREMENT EMCCD_dcycMntCtlOut2_mp "" SWORD DtyCyc 1 100 -327.6800 327.6700 FORMAT "%8.4" ECU_ADDRESS 0x8FEDAA /end MEASUREMENT
/begin MEASUREMENT EMCCD_dcycOut1_mp "" SWORD DtyCyc 1 100 -327.6800 327.6700 FORMAT "%8.4" ECU_ADDRESS 0x8FEDAC /end MEASUREMENT
/begin MEASUREMENT EMCCD_dcycOut2_mp "" SWORD DtyCyc 1 100 -327.6800 327.6700 FORMAT "%8.4" ECU_ADDRESS 0x8FEDAE /end MEASUREMENT
/begin MEASUREMENT EMCCD_iActVal1 "" SWORD Curr 1 100 -32768.00 32767.00 FORMAT "%8.2" ECU_ADDRESS 0x7F8C00 /end MEASUREMENT
/begin MEASUREMENT EMCCD_iActVal2 "" SWORD Curr 1 100 -32768.00 32767.00 FORMAT "%8.2" ECU_ADDRESS 0x7F8C02 /end MEASUREMENT
/begin MEASUREMENT EMCCD_iActValFlt1_mp "" SWORD Curr 1 100 -32768.00 32767.00 FORMAT "%8.2" ECU_ADDRESS 0x8FEDB0 /end MEASUREMENT
/begin MEASUREMENT EMCCD_iActValFlt2_mp "" SWORD Curr 1 100 -32768.00 32767.00 FORMAT "%8.2" ECU_ADDRESS 0x8FEDB2 /end MEASUREMENT
/begin MEASUREMENT EMCCD_resAct1 "" SWORD Resist 1 100 -3276.800 3276.700 FORMAT "%8.3" ECU_ADDRESS 0x7F8C04 /end MEASUREMENT
/begin MEASUREMENT EMCCD_resAct2 "" SWORD Resist 1 100 -3276.800 3276.700 FORMAT "%8.3" ECU_ADDRESS 0x7F8C06 /end MEASUREMENT
/begin MEASUREMENT EMCCD_rHWE1_mp "" SWORD DtyCyc 1 100 -327.6800 327.6700 FORMAT "%8.4" ECU_ADDRESS 0x8FEDB4 /end MEASUREMENT
/begin MEASUREMENT EMCCD_rHWE2_mp "" SWORD DtyCyc 1 100 -327.6800 327.6700 FORMAT "%8.4" ECU_ADDRESS 0x8FEDB6 /end MEASUREMENT
/begin MEASUREMENT EMCCD_stOut_mp "" UBYTE OneToOne 1 100 0.00 255.0 FORMAT "%5.1" ECU_ADDRESS 0x8FEDB8 /end MEASUREMENT
/begin MEASUREMENT EMCCD_uRawActVal1_mp "" SWORD Volt 1 100 -160156.4 160151.5 FORMAT "%8.1" ECU_ADDRESS 0x8FEDBA /end MEASUREMENT
/begin MEASUREMENT EMCCD_uRawActVal2_mp "" SWORD Volt 1 100 -160156.4 160151.5 FORMAT "%8.1" ECU_ADDRESS 0x8FEDBC /end MEASUREMENT
/begin MEASUREMENT EngMon_stShOffIrrCmb "Abschaltbotschaft an Abschaltkoordinator auf Grund irregulärer Verbrennung" UBYTE OneToOne 1 100 0.00 255.0 FORMAT "%5.1" ECU_ADDRESS 0x7F8845 /end MEASUREMENT
/begin MEASUREMENT EngM_ctIncErrSigDiagCaSDef_mp "Inkrementezaehlerstand zur Erkennung gestörtes Nockenwellensignal" UWORD OneToOne 1 100 0.00 65535.00 FORMAT "%8.2" ECU_ADDRESS 0x8FEDD4 /end MEASUREMENT
/begin MEASUREMENT EngM_ctIncErrSigDiagCaSOk_mp "Inkrementezaehlerstand zur Erkennung gestörtes Nockenwellensignal geheilt" UWORD OneToOne 1 100 0.00 65535.00 FORMAT "%8.2" ECU_ADDRESS 0x8FEDD6 /end MEASUREMENT
/begin MEASUREMENT EngM_ctIncErrSigDiagCrSDef_mp "Inkrementezaehlerstand zur Erkennung eines gestörten Kurbelwellensignal" UWORD OneToOne 1 100 0.00 65535.00 FORMAT "%8.2" ECU_ADDRESS 0x8FEDD8 /end MEASUREMENT
/begin MEASUREMENT EngM_ctIncErrSigDiagCrSOK_mp "Inkrementezaehlerstand zur Erkennung Kurbelwellensignal ohne Störungen" UWORD OneToOne 1 100 0.00 65535.00 FORMAT "%8.2" ECU_ADDRESS 0x8FEDDA /end MEASUREMENT
/begin MEASUREMENT EngM_ctIncErrSigDiagmaxCaSDef_mp "maximaler Inkrementezaehlerstand bei Erkennung gestörtes Nockenwellensignal" UWORD OneToOne 1 100 0.00 65535.00 FORMAT "%8.2" ECU_ADDRESS 0x8FEDDC /end MEASUREMENT
/begin MEASUREMENT EngM_ctIncErrSigDiagmaxCaSOk_mp "maximaler Inkrementezaehlerstand bei Erkennung gestörtes Nockenwellensignal geheilt" UWORD OneToOne 1 100 0.00 65535.00 FORMAT "%8.2" ECU_ADDRESS 0x8FEDDE /end MEASUREMENT
/begin MEASUREMENT EngM_ctIncErrSigDiagmaxCrSDef_mp "maximeler Inkrementezaehlerstand bei Erkennung gestörtes Kurbelwellensignal" UWORD OneToOne 1 100 0.00 65535.00 FORMAT "%8.2" ECU_ADDRESS 0x8FEDE0 /end MEASUREMENT
/begin MEASUREMENT EngM_ctIncNoSigDiagCaS_mp "Inkrementezaehlerstand zur Erkennung ausgefallenes Nockenwellensignal" UWORD OneToOne 1 100 0.00 65535.00 FORMAT "%8.2" ECU_ADDRESS 0x8FEDE2 /end MEASUREMENT
/begin MEASUREMENT EngM_ctIncNoSigDiagmaxCaS_mp "maximaler Inkrementezaehlerstand bei Erkennung ausgefallenes Nockenwellensignal" UWORD OneToOne 1 100 0.00 65535.00 FORMAT "%8.2" ECU_ADDRESS 0x8FEDE4 /end MEASUREMENT
/begin MEASUREMENT EngM_ctIntOvrLoad_mp "Anzahl der statischen Interrupts, bei denen der zeitliche Abstand zu kurz ist" UBYTE OneToOne 1 100 0.00 255.0 FORMAT "%5.1" ECU_ADDRESS 0x8FEDC0 /end MEASUREMENT
/begin MEASUREMENT EngM_ctPhErrSigDiagCrSDef_mp "Anzahl Nockenwellenzaehne zur Erkennung eines gestörten Kurbelwellensignal" UWORD OneToOne 1 100 0.00 65535.00 FORMAT "%8.2" ECU_ADDRESS 0x8FEDE6 /end MEASUREMENT
/begin MEASUREMENT EngM_ctPhErrSigDiagmaxCrSDef_mp "maximale Anzahl Nockenwellenzaehne bei Erkennung ausgefallenes Kurbelwellensignal" UWORD OneToOne 1 100 0.00 65535.00 FORMAT "%8.2" ECU_ADDRESS 0x8FEDE8 /end MEASUREMENT
/begin MEASUREMENT EngM_ctPostSync_mp "Interruptzähler im State EngM_stSync = 64 (Post-Synchron)" UBYTE OneToOne 1 100 0.00 255.0 FORMAT "%5.1" ECU_ADDRESS 0x8FEDC1 /end MEASUREMENT
/begin MEASUREMENT EngM_ctReSync_mp "Resynchronisationszähler, wird bei jeder Resynchronisation inkrementiert" UBYTE OneToOne 1 100 0.00 255.0 FORMAT "%5.1" ECU_ADDRESS 0x8FEDC2 /end MEASUREMENT
/begin MEASUREMENT EngM_ctSpdtoZero_mp "Zähler Timeoutinterrupts bis Motordrehzahl  = Null" ULONG OneToOne 1 100 0.00 4294967295.00 FORMAT "%13.2" ECU_ADDRESS 0x8FEDEC /end MEASUREMENT
/begin MEASUREMENT EngM_ctVerSync_mp "Verif.zähler der Sync; Anzahl der MAIN, PILOT, UPDATE, SEGMENT Interrupts zur Plaus. der NW mit der KW" UBYTE OneToOne 1 100 0.00 255.0 FORMAT "%5.1" ECU_ADDRESS 0x8FEDC3 /end MEASUREMENT
/begin MEASUREMENT EngM_nAvrgHysHigh_mp "engine speed hysteresis higher limit" SWORD EngN 1 100 -32768.00 32767.00 FORMAT "%8.2" ECU_ADDRESS 0x8FEDF0 /end MEASUREMENT
/begin MEASUREMENT EngM_nAvrgHysLow_mp "engine speed hysteresis lower limit" SWORD EngN 1 100 -32768.00 32767.00 FORMAT "%8.2" ECU_ADDRESS 0x8FEDF2 /end MEASUREMENT
/begin MEASUREMENT EngM_nDyn "dynamische Drehzahl" SWORD EngN 1 100 -32768.00 32767.00 FORMAT "%8.2" ECU_ADDRESS 0x7F8C16 /end MEASUREMENT
/begin MEASUREMENT EngM_nLISetDiff_mp "Betrag Leerlaufreglerabweichung" SWORD EngN 1 100 -32768.00 32767.00 FORMAT "%8.2" ECU_ADDRESS 0x8FEE04 /end MEASUREMENT
/begin MEASUREMENT EngM_numCyl "Zylinderanzahl" UBYTE OneToOne 1 100 0.00 255.0 FORMAT "%5.1" ECU_ADDRESS 0x7F8834 /end MEASUREMENT
/begin MEASUREMENT EngM_numInt "Interreupt-Klasse" UBYTE OneToOne 1 100 0.00 255.0 FORMAT "%5.1" ECU_ADDRESS 0x7F8836 /end MEASUREMENT
/begin MEASUREMENT EngM_numLastTDC "Vorhergehender Zünd-OT" UBYTE OneToOne 1 100 0.00 255.0 FORMAT "%5.1" ECU_ADDRESS 0x7F8837 /end MEASUREMENT
/begin MEASUREMENT EngM_numRevCnt_mp "Zähler der Kurbelwellenumdrehungen" UWORD OneToOne 1 100 0.00 65535.00 FORMAT "%8.2" ECU_ADDRESS 0x8FEDC4 /end MEASUREMENT
/begin MEASUREMENT EngM_numSyncTDC "Zylindernummer an dem die Synchronisation erkannt wurde" UBYTE OneToOne 1 100 0.00 255.0 FORMAT "%5.1" ECU_ADDRESS 0x7F8838 /end MEASUREMENT
/begin MEASUREMENT EngM_numTDC "Aktueller Zünd-OT" UBYTE OneToOne 1 100 0.00 255.0 FORMAT "%5.1" ECU_ADDRESS 0x7F8839 /end MEASUREMENT
/begin MEASUREMENT EngM_phiDiffTDC "Winkel zwischen TDC1 und dem in der Zündreihenfolge nächsten TDC auf diesem Steuergerät" SWORD AngleCrS 1 100 -768.0000 767.9766 FORMAT "%8.4" ECU_ADDRESS 0x7F8C18 /end MEASUREMENT
/begin MEASUREMENT EngM_phiInt "aktuelle Interrupt-Position" SWORD AngleCrS 1 100 -768.0000 767.9766 FORMAT "%8.4" ECU_ADDRESS 0x7F8C1A /end MEASUREMENT
/begin MEASUREMENT EngM_phiIntExt "aktuelle Interrupt-Position, extern vom Master zum Slave über CAN" SWORD AngleCrS 1 100 -768.0000 767.9766 FORMAT "%8.4" ECU_ADDRESS 0x7F8C1C /end MEASUREMENT
/begin MEASUREMENT EngM_phiIntExtCorr_mp "aktuelle Winkelposition an der Masterseite nach der Korrektur im Slave-Steuergerät" SWORD AngleCrS 1 100 -768.0000 767.9766 FORMAT "%8.4" ECU_ADDRESS 0x8FEDC6 /end MEASUREMENT
/begin MEASUREMENT EngM_phiTDC "OT-Position der aktuellen Zumessung" SWORD AngleCrS 1 100 -768.0000 767.9766 FORMAT "%8.4" ECU_ADDRESS 0x7F8C20 /end MEASUREMENT
/begin MEASUREMENT EngM_rCurrProf_mp "" SWORD DtyCyc 1 100 -327.6800 327.6700 FORMAT "%8.4" ECU_ADDRESS 0x8FEDF4 /end MEASUREMENT
/begin MEASUREMENT EngM_SchedDelta_mp "Sprungweite in der Schedule-Tabelle" UBYTE OneToOne 1 100 0.00 255.0 FORMAT "%5.1" ECU_ADDRESS 0x8FEDC8 /end MEASUREMENT
/begin MEASUREMENT EngM_SchedIndex_mp "Anzahl der abgearbeiteten Anweisungen der Schedule-Sequenz" UBYTE OneToOne 1 100 0.00 255.0 FORMAT "%5.1" ECU_ADDRESS 0x8FEDC9 /end MEASUREMENT
/begin MEASUREMENT EngM_SchedLimitInt_mp "Nummer des Abschrankintervalls" UBYTE OneToOne 1 100 0.00 255.0 FORMAT "%5.1" ECU_ADDRESS 0x8FEDCA /end MEASUREMENT
/begin MEASUREMENT EngM_SchedSegID_mp "Nummer des Segments vor dem Interrupt" UBYTE OneToOne 1 100 0.00 255.0 FORMAT "%5.1" ECU_ADDRESS 0x8FEDCB /end MEASUREMENT
/begin MEASUREMENT EngM_stAdpt "Zustand Reibmomentenadaption" UBYTE OneToOne 1 100 0.00 255.0 FORMAT "%5.1" ECU_ADDRESS 0x7F883A /end MEASUREMENT
/begin MEASUREMENT EngM_stCaSExt "Statusinformation CaSCD_stPhaseSig_mp vom Mastersteuergeraet über CAN" UWORD OneToOne 1 100 0.00 65535.00 FORMAT "%8.2" ECU_ADDRESS 0x7F8C22 /end MEASUREMENT
/begin MEASUREMENT EngM_stCaSVerifyDiag "Statusinformation der Diagnose aus den VERIFY Zustand" UBYTE OneToOne 1 100 0.00 255.0 FORMAT "%5.1" ECU_ADDRESS 0x7F883B /end MEASUREMENT
/begin MEASUREMENT EngM_stEngMntCtl_mp "status of error bit values" UBYTE OneToOne 1 100 0.00 255.0 FORMAT "%5.1" ECU_ADDRESS 0x8FEDF6 /end MEASUREMENT
/begin MEASUREMENT EngM_stErrCanExt "CAN-Errorstatus der Botschaft MS_PHI_SNYC extern vom Master mit: EngM_phiIntExt, EngM_stNextExt" UBYTE OneToOne 1 100 0.00 255.0 FORMAT "%5.1" ECU_ADDRESS 0x7F883C /end MEASUREMENT
/begin MEASUREMENT EngM_stEvent "Interruptereignis" UBYTE OneToOne 1 100 0.00 255.0 FORMAT "%5.1" ECU_ADDRESS 0x7F883D /end MEASUREMENT
/begin MEASUREMENT EngM_stEventEnable_mp "n-synchrone Interrupts freigegeben" UWORD OneToOne 1 100 0.00 65535.00 FORMAT "%8.2" ECU_ADDRESS 0x8FEDCC /end MEASUREMENT
/begin MEASUREMENT EngM_stEventServed_mp "Aktuell bediente Interrupts" UWORD OneToOne 1 100 0.00 65535.00 FORMAT "%8.2" ECU_ADDRESS 0x8FEDCE /end MEASUREMENT
/begin MEASUREMENT EngM_stGbxRel_mp "Status Freigabebedingung: Antriebsstrang offen" UBYTE OneToOne 1 100 0.00 255.0 FORMAT "%5.1" ECU_ADDRESS 0x8FEE06 /end MEASUREMENT
/begin MEASUREMENT EngM_stGenRel_mp "Status generelle Freigabebedingungen für Reibmomentenadaption" UBYTE OneToOne 1 100 0.00 255.0 FORMAT "%5.1" ECU_ADDRESS 0x8FEE07 /end MEASUREMENT
/begin MEASUREMENT EngM_stInjCharSetVal "Zeigt den Zustand der erlaubten Einspritzungen" UBYTE OneToOne 1 100 0.00 255.0 FORMAT "%5.1" ECU_ADDRESS 0x7F883E /end MEASUREMENT
/begin MEASUREMENT EngM_stNDiffRng_mp "Status Leerlaufreglerabweichung innerhalb zulässiger Schwellwerte" UBYTE OneToOne 1 100 0.00 255.0 FORMAT "%5.1" ECU_ADDRESS 0x8FEE08 /end MEASUREMENT
/begin MEASUREMENT EngM_stNext "Meta-Status der KW- und NW-Ereignisverwaltung (Motorpositions-Management), ohne Interim-Zustände" UBYTE OneToOne 1 100 0.00 255.0 FORMAT "%5.1" ECU_ADDRESS 0x7F883F /end MEASUREMENT
/begin MEASUREMENT EngM_stNextExt "Meta-Status der KW- und NW-Ereignisverwaltung, ohne Interim-Zustände, extern vom Master zum Slave über CAN" UBYTE OneToOne 1 100 0.00 255.0 FORMAT "%5.1" ECU_ADDRESS 0x7F8840 /end MEASUREMENT
/begin MEASUREMENT EngM_stOut "state of engine bearing depending on engine speed, engine temperature and gear state" UBYTE OneToOne 1 100 0.00 255.0 FORMAT "%5.1" ECU_ADDRESS 0x7F8841 /end MEASUREMENT
/begin MEASUREMENT EngM_stReliablAdpt "Zuverlässigkeitsstatus des adaptierten Verlustmoments" UBYTE OneToOne 1 100 0.00 255.0 FORMAT "%5.1" ECU_ADDRESS 0x7F8842 /end MEASUREMENT
/begin MEASUREMENT EngM_stSpd "Status der Motordrehzahl" UBYTE OneToOne 1 100 0.00 255.0 FORMAT "%5.1" ECU_ADDRESS 0x7F8843 /end MEASUREMENT
/begin MEASUREMENT EngM_stSync "Meta-Status der KW- und NW-Ereignisverwaltung (Motorpositions-Management)" UBYTE OneToOne 1 100 0.00 255.0 FORMAT "%5.1" ECU_ADDRESS 0x7F8844 /end MEASUREMENT
/begin MEASUREMENT EngM_stTrqFrcPDiffErr_mp "Statusmesspunkt für Ersatzdrehmomentverlust im Systemfehlerefall" UBYTE OneToOne 1 100 0.00 255.0 FORMAT "%5.1" ECU_ADDRESS 0x8FEDF8 /end MEASUREMENT
/begin MEASUREMENT EngM_tiDiffInt_mp "Differenz zwischen zwei statische interrupts" ULONG TimeSys_us 1 100 0.00 1228361874.73 FORMAT "%13.2" ECU_ADDRESS 0x8FEDD0 /end MEASUREMENT
/begin MEASUREMENT EngM_tiSeg "Segmentzeit" UWORD TimeDT 1 100 0.00 65535.00 FORMAT "%8.2" ECU_ADDRESS 0x7F8C24 /end MEASUREMENT
/begin MEASUREMENT EngM_tiSegLimAvrg "gemittelte beschränkte Segmentzeit" UWORD TimeDT 1 100 0.00 65535.00 FORMAT "%8.2" ECU_ADDRESS 0x7F8C26 /end MEASUREMENT
/begin MEASUREMENT EngM_tiSegTwo "Dauer der vergangenen beiden Segmente" UWORD TimeDT 1 100 0.00 65535.00 FORMAT "%8.2" ECU_ADDRESS 0x7F8C28 /end MEASUREMENT
/begin MEASUREMENT EngM_trqDiffAdpt "Adaptiertes Differenzmoment" SWORD Trq 1 100 -3276.800 3276.700 FORMAT "%8.3" ECU_ADDRESS 0x7F8C2A /end MEASUREMENT
/begin MEASUREMENT EngM_trqFltACoff_mp "Adaptionsfilter-Ausgang für Zustand ""Klima Kompressor aus""" SWORD Trq 1 100 -3276.800 3276.700 FORMAT "%8.3" ECU_ADDRESS 0x8FEE0A /end MEASUREMENT
/begin MEASUREMENT EngM_trqFltACon_mp "Adaptionsfilter-Ausgang für Zustand ""Klimakompressor an""" SWORD Trq 1 100 -3276.800 3276.700 FORMAT "%8.3" ECU_ADDRESS 0x8FEE0C /end MEASUREMENT
/begin MEASUREMENT EngM_trqFrc "aktuelles Reibmoment" SWORD Trq 1 100 -3276.800 3276.700 FORMAT "%8.3" ECU_ADDRESS 0x7F8C2C /end MEASUREMENT
/begin MEASUREMENT EngM_trqFrcPDiffLim_mp "limitierter Momentenverlust aufgrund Differenzdruck über Partikelfilter" SWORD Trq 1 100 -3276.800 3276.700 FORMAT "%8.3" ECU_ADDRESS 0x8FEDFA /end MEASUREMENT
/begin MEASUREMENT EngM_trqFrcPDiffRaw_mp "Rohwert des Momentenverlustes aufgrund Differenzdruck über Partikelfilter" SWORD Trq 1 100 -3276.800 3276.700 FORMAT "%8.3" ECU_ADDRESS 0x8FEDFC /end MEASUREMENT
/begin MEASUREMENT EngM_trqFrcPDiff_mp "Momentenverlust aufgrund Differenzdruck über Partikelfilter" SWORD Trq 1 100 -3276.800 3276.700 FORMAT "%8.3" ECU_ADDRESS 0x8FEDFE /end MEASUREMENT
/begin MEASUREMENT EngM_trqFrcT_mp "ausgewählte Temperature zur Berechnung Reibmoment" SWORD Trq 1 100 -3276.800 3276.700 FORMAT "%8.3" ECU_ADDRESS 0x8FEE00 /end MEASUREMENT
/begin MEASUREMENT EngM_trqLossAdpt "Adaptiertes Gesamtverlustmoment des Motors" SWORD Trq 1 100 -3276.800 3276.700 FORMAT "%8.3" ECU_ADDRESS 0x7F8C2E /end MEASUREMENT
/begin MEASUREMENT EngM_trqLossCompl_mp "komplettes Motor-Verlustmoment" SWORD Trq 1 100 -3276.800 3276.700 FORMAT "%8.3" ECU_ADDRESS 0x8FEE0E /end MEASUREMENT
/begin MEASUREMENT EngM_trqLossDiff_mp "Differenzverlustmoment der Reibmomenten-Adaption" SWORD Trq 1 100 -3276.800 3276.700 FORMAT "%8.3" ECU_ADDRESS 0x8FEE10 /end MEASUREMENT
/begin MEASUREMENT EngM_tTrqFrc_mp "Ausgewählte Temperatur für die Reibmomentenberechnung" SWORD Temp_Cels 1 100 -50.140 899.860 FORMAT "%8.3" ECU_ADDRESS 0x8FEE02 /end MEASUREMENT
/begin FUNCTION ebfcd_actoutebox "E-Box Cooler Fan component driver"
 /begin DEF_CHARACTERISTIC EBFCD_ctPwrStgOnMax_C EBFCD_DebExcTempDef_C EBFCD_DebExcTempOk_C EBFCD_DebNoLoadDef_C EBFCD_DebNoLoadOk_C EBFCD_DebShortCircBatDef_C EBFCD_DebShortCircBatOk_C EBFCD_DebShortCircGndDef_C EBFCD_DebShortCircGndOk_C EBFCD_numDiaOut_C EBFCD_numDioOut_C EBFCD_stDigInvOut_C EBFCD_stSigOutErr_C EBFCD_stSPICtl_C EBFCD_swtOnOff_C EBFCD_tECUXLow_C EBFCD_tECUXHigh_C EBFCD_stECUYLow_C EBFCD_stECUYHigh_C EBFCD_tiBtwTst_C EBFCD_tiPwrStgOn_C /end DEF_CHARACTERISTIC
/end FUNCTION
/begin FUNCTION ebfcd_actoutebox_msg "" /begin OUT_MEASUREMENT EBFCD_stOut /end OUT_MEASUREMENT /end FUNCTION
/begin FUNCTION ebfcd_actoutebox_uic "" /begin OUT_MEASUREMENT EBFCD_st_mp /end OUT_MEASUREMENT /end FUNCTION
/begin FUNCTION ebtscd_gettempebox "ECU Temperature sensor component driver"
 /begin DEF_CHARACTERISTIC EBTSCD_uSRCMin_C EBTSCD_uSRCMax_C EBTSCD_tLin_CUR EBTSCD_OvrDebSRCHighDef_C EBTSCD_OvrDebSRCHighOk_C EBTSCD_DebSRCHighDef_C EBTSCD_DebSRCHighOk_C EBTSCD_DebSRCLowDef_C EBTSCD_DebSRCLowOk_C EBTSCD_numAdc_C EBTSCD_dtRmpSlpUp_C EBTSCD_dtRmpSlpDwn_C EBTSCD_tiTECUPT1_C EBTSCD_tOvrTemp_C EBTSCD_stSensIDWord_C EBTSCD_tDfl_C /end DEF_CHARACTERISTIC
 /begin IN_MEASUREMENT EBTSCD_uRawTECU_mp /end IN_MEASUREMENT
/end FUNCTION
/begin FUNCTION ebtscd_gettempebox_msg "" /begin OUT_MEASUREMENT EBTSCD_tCIntLin EBTSCD_tECU /end OUT_MEASUREMENT /end FUNCTION
/begin FUNCTION ebtscd_gettempebox_uic "" /begin OUT_MEASUREMENT EBTSCD_uRawTECU_mp /end OUT_MEASUREMENT /end FUNCTION
/begin FUNCTION ecu "" /begin DEF_CHARACTERISTIC ECU_vPrgThres_C /end DEF_CHARACTERISTIC /end FUNCTION
/begin FUNCTION eepcd "Komponenten Treiber für EEPROM Zugriffe" /begin DEF_CHARACTERISTIC EEPCD_stMILDfl_C /end DEF_CHARACTERISTIC /end FUNCTION
/begin FUNCTION eepcd_msg "" /begin OUT_MEASUREMENT EEPCD_stErrSet EEPCD_stMIL /end OUT_MEASUREMENT /end FUNCTION
/begin FUNCTION eepinit "EEPROM Erstinitialisierung" /begin DEF_CHARACTERISTIC EepInit_AirCtlTrm_C /end DEF_CHARACTERISTIC /end FUNCTION
/begin FUNCTION eepinit_develop "ließt Bloecke vom EEPROM und schreibt ein Byte an waelbare Positionen" /begin DEF_CHARACTERISTIC /end DEF_CHARACTERISTIC /begin OUT_MEASUREMENT /end OUT_MEASUREMENT /end FUNCTION
/begin FUNCTION egppcd_actrout "Exhaust Gas pressure Pump Component Driver"
 /begin DEF_CHARACTERISTIC EGPpCD_ctPwrStgOnMax_C EGPpCD_numDia_C EGPpCD_numDioOut_C EGPpCD_stInvOut_C EGPpCD_stPwrStgActv_C EGPpCD_stSPICtl_C EGPpCD_tiBtwTst_C EGPpCD_tiDebExcTempDef_C EGPpCD_tiDebExcTempOk_C EGPpCD_tiDebNoLoadDef_C EGPpCD_tiDebNoLoadOk_C EGPpCD_tiDebShortCircBatDef_C EGPpCD_tiDebShortCircBatOk_C EGPpCD_tiDebShortCircGndDef_C EGPpCD_tiDebShortCircGndOk_C EGPpCD_tiPwrStgOn_C /end DEF_CHARACTERISTIC
/end FUNCTION
/begin FUNCTION egppcd_actrout_msg "" /begin OUT_MEASUREMENT EGPpCD_stActrOut /end OUT_MEASUREMENT /end FUNCTION
/begin FUNCTION egppcd_actrout_uic "" /end FUNCTION
/begin FUNCTION egpp_logic "Calculates the status of the Exhaust gas pressure pump" /begin DEF_CHARACTERISTIC EGPp_stFlap_MAP EGPp_tiStartDelay_C /end DEF_CHARACTERISTIC /begin IN_MEASUREMENT Eng_nAvrg InjCtl_qCurr /end IN_MEASUREMENT /end FUNCTION
/begin FUNCTION egpp_logic_msg "" /begin OUT_MEASUREMENT EGPp_stLogicOut /end OUT_MEASUREMENT /end FUNCTION
/begin FUNCTION egpp_logic_uic "" /end FUNCTION
/begin FUNCTION egpp_prescalc "Berechnung des Abgasdruckes"
 /begin DEF_CHARACTERISTIC EGPp_facGeoSil2_C EGPp_facGeoSil_C EGPp_facPow_CUR EGPp_facRhoEta_CUR EGPp_pPstPFlt_MAP EGPp_tiPresFltPT1_C EGPp_swtPresCalc_C /end DEF_CHARACTERISTIC
 /begin IN_MEASUREMENT EGPp_dvolSil_mp Eng_nAvrg InjCtl_qSetUnBal PFlt_tPstSim /end IN_MEASUREMENT
/end FUNCTION
/begin FUNCTION egpp_prescalc_msg "" /begin OUT_MEASUREMENT EGPp_pPstPFlt /end OUT_MEASUREMENT /end FUNCTION
/begin FUNCTION egpp_prescalc_uic "" /begin OUT_MEASUREMENT EGPp_dvolSil_mp EGPp_pPstPFltMap_mp EGPp_pPstPFltSim_mp /end OUT_MEASUREMENT /end FUNCTION
/begin FUNCTION egrcd "Komponententreiber Abgasrückführsteller"
 /begin DEF_CHARACTERISTIC EGRCD_ctPwrStgOnMax_C EGRCD_DebExcTempDef_C EGRCD_DebExcTempOk_C EGRCD_DebNoLoadDef_C EGRCD_DebNoLoadOk_C EGRCD_DebShortCircBatDef_C EGRCD_DebShortCircBatOk_C EGRCD_DebShortCircGndDef_C EGRCD_DebShortCircGndOk_C EGRCD_numDia_C EGRCD_numPwmOut_C EGRCD_stInvOut_C EGRCD_tiPer_C EGRCD_rCnv_MAP EGRCD_rOutMax_C EGRCD_rOutMin_C EGRCD_stPwrStgActv_C EGRCD_stPwrStgDia_C EGRCD_stSPICtl_C EGRCD_swt_C EGRCD_tiBtwTst_C EGRCD_tiPwrStgOn_C /end DEF_CHARACTERISTIC
 /begin IN_MEASUREMENT EGRVlv_rEGR Eng_nAvrg /end IN_MEASUREMENT
/end FUNCTION
/begin FUNCTION egrcd_msg "" /begin OUT_MEASUREMENT EGRCD_rOut /end OUT_MEASUREMENT /end FUNCTION
/begin FUNCTION egrcd_uic "" /begin OUT_MEASUREMENT EGRCD_rCnv_mp /end OUT_MEASUREMENT /end FUNCTION
/begin FUNCTION egrvlv_co "Stellerkoordinator Abgasrückführung" /end FUNCTION
/begin FUNCTION egrvlv_co_msg "" /begin OUT_MEASUREMENT EGRVlv_rEGR EGRVlv_rEGR2 /end OUT_MEASUREMENT /end FUNCTION
/begin FUNCTION egrvlv_co_uic ""
 /begin DEF_CHARACTERISTIC EGRVlv_rEGR2_Vector EGRVlv_rEGR2_Channel EGRVlv_rEGR_Vector EGRVlv_rEGR_Channel /end DEF_CHARACTERISTIC
 /begin OUT_MEASUREMENT EGRVlv_rEGR2Byp_mp EGRVlv_rEGRByp_mp /end OUT_MEASUREMENT
/end FUNCTION
/begin FUNCTION egsys_dewdet "Taupunktbestimmungslogik"
 /begin DEF_CHARACTERISTIC EGSys_dmPlsThresLSU_C EGSys_facCldStrtLSU_C EGSys_facPlsLSU_C EGSys_facPlsThresLSU_C EGSys_numMaxCldStrt_C EGSys_swtDewDetShOff_C EGSys_tiDebLSU0_C EGSys_tiDebNrmTransOk_C EGSys_tiHtgDelLSU_C EGSys_tIntegIni_C EGSys_tiPlsLSU_C EGSys_tThresLSUAct_C EGSys_tWtEquiv_C EGSys_wLSUIKi_C EGSys_wThresLSU0_MAP /end DEF_CHARACTERISTIC
 /begin IN_MEASUREMENT EGSys_tEGLSUInpCrv0_mp Eng_tEng /end IN_MEASUREMENT
 /begin OUT_MEASUREMENT EGSys_cpEGLSU_mp EGSys_ctCldStrtLSU_mp EGSys_dwLSU_mp EGSys_stHtgLSULstTrp_mp EGSys_stHtgThresLSUHit_mp EGSys_stIntegIni_mp EGSys_stPlsLSU_mp EGSys_wLSU_mp EGSys_wThresLSUAct_mp EGSys_wThresLSUNoPls_mp EGSys_wThresLSUPls_mp EGSys_wThresLSU_mp /end OUT_MEASUREMENT
/end FUNCTION
/begin FUNCTION egsys_dewdet_msg "" /begin OUT_MEASUREMENT EGSys_stHtgLSU /end OUT_MEASUREMENT /end FUNCTION
/begin FUNCTION egsys_dewdet_uic "" /end FUNCTION
/begin FUNCTION egsys_mdlbackpres "Berechnung des Abgasgegendrucks" /begin DEF_CHARACTERISTIC EGSys_dpExhGas_MAP EGSys_pConstVal_C EGSys_swtPresSel_C /end DEF_CHARACTERISTIC /begin IN_MEASUREMENT Eng_nAvrg InjCtl_qSetUnBal /end IN_MEASUREMENT /end FUNCTION
/begin FUNCTION egsys_mdlbackpres_msg "" /begin OUT_MEASUREMENT EGSys_pExhGas /end OUT_MEASUREMENT /end FUNCTION
/begin FUNCTION egsys_mdlbackpres_uic "" /end FUNCTION
/begin FUNCTION egsys_tegco "Schnittstellenkoordinator für Abgastemperaturmodell"
 /begin DEF_CHARACTERISTIC EGSys_cndHtEG_CUR EGSys_cpEG_MAP EGSys_dmEGMinVal_C EGSys_numECU_C EGSys_numRdPosLSU2_C EGSys_numRdPosLSUWall_C EGSys_numRdPosLSU_C EGSys_numRdPosNSC2_C EGSys_numRdPosNSC_C EGSys_numRdPosOxiCat2_C EGSys_numRdPosOxiCat_C EGSys_numRdPosTrbn2_C EGSys_numRdPosTrbn_C EGSys_numRdPosTube2_C EGSys_numRdPosTube_C EGSys_vscDynEG_CUR EGSys_vscKinEG_CUR /end DEF_CHARACTERISTIC
 /begin IN_MEASUREMENT EGSys_rLmbdAprx /end IN_MEASUREMENT
 /begin OUT_MEASUREMENT EGSys_tEGLSUInpCrv0_mp EGSys_tEGLSUInpCrv1_mp EGSys_tEGLSUInpCrv2_mp EGSys_tEGLSUInpCrv3_mp EGSys_tMem_mp /end OUT_MEASUREMENT
/end FUNCTION
/begin FUNCTION egsys_tegco_msg ""
 /begin OUT_MEASUREMENT EGSys_dmEG EGSys_qMIStd EGSys_qPoIRgn EGSys_rLmbdAprx EGSys_tEGLSU EGSys_tEGPreNSC EGSys_tEGPreOxiCat EGSys_tEGPreTrbn EGSys_tEGPreTube EGSys_tWallLSU /end OUT_MEASUREMENT
/end FUNCTION
/begin FUNCTION egsys_tegco_uic "" /begin OUT_MEASUREMENT EGSys_tShOffTExcClnt_mp /end OUT_MEASUREMENT /end FUNCTION
/begin FUNCTION egsys_tegco_var "" /begin DEF_CHARACTERISTIC EGSys_tExcClntDfl_C /end DEF_CHARACTERISTIC /end FUNCTION
/begin FUNCTION egsys_tegmod "Abgastemperaturmodell"
 /begin DEF_CHARACTERISTIC EGSys_dmAir_MAP EGSys_facAirMass_CUR EGSys_facCorrCldEng_CUR EGSys_facIAT_CUR EGSys_facStrtDlv_CUR EGSys_phiStrtDlv_MAP EGSys_tEngStat_C EGSys_tIAT_MAP EGSys_tManfDfl_C EGSys_tManfStat_MAP /end DEF_CHARACTERISTIC
 /begin IN_MEASUREMENT EGSys_phiDiffStrt_mp EGSys_rAirPerTime_mp EGSys_tDiffCldEng_mp EGSys_tDiffIAT_mp Eng_nAvrg InjCtl_qCurr /end IN_MEASUREMENT
/end FUNCTION
/begin FUNCTION egsys_tegmod_msg "" /begin OUT_MEASUREMENT EGSys_tManfStat /end OUT_MEASUREMENT /end FUNCTION
/begin FUNCTION egsys_tegmod_uic ""
 /begin OUT_MEASUREMENT EGSys_facAirMass_mp EGSys_facStrtDlv_mp EGSys_phiDiffStrt_mp EGSys_rAirPerTime_mp EGSys_tCorrIAT_mp EGSys_tCorrManf_mp EGSys_tDiffCldEng_mp EGSys_tDiffIAT_mp EGSys_tManfStat_mp /end OUT_MEASUREMENT
/end FUNCTION
/begin FUNCTION egsys_tnscmod "Temperaturmodell für NOx-Speicherkatalysator"
 /begin DEF_CHARACTERISTIC EGSys_cpNSC_C EGSys_tiPT1NSC_C EGSys_swtTimeNSC_C EGSys_tNSCDfl_C EGSys_tNSCExoIncr_MAP /end DEF_CHARACTERISTIC
 /begin IN_MEASUREMENT EGSys_rLmbdAprx EGSys_tAvrgNSC_mp /end IN_MEASUREMENT
/end FUNCTION
/begin FUNCTION egsys_tnscmod_msg "" /begin OUT_MEASUREMENT EGSys_tNSC /end OUT_MEASUREMENT /end FUNCTION
/begin FUNCTION egsys_tnscmod_uic ""
 /begin OUT_MEASUREMENT EGSys_cpEGNSC_mp EGSys_tAvrgNSC_mp EGSys_tNSCExoIncr_mp EGSys_tNSCStat_mp /end OUT_MEASUREMENT
/end FUNCTION
/begin FUNCTION egsys_toxicatmod "Temperaturmodel für Oxidationskatalysator"
 /begin DEF_CHARACTERISTIC EGSys_CalValFl_C EGSys_cpOxiCat_C EGSys_facTempCmb_CUR EGSys_tiPT1OxiCat_C EGSys_swtTimeOxiCat_C EGSys_tOxiCatDfl_C EGSys_tOxiCatExoIncr_MAP /end DEF_CHARACTERISTIC
 /begin IN_MEASUREMENT EGSys_rLmbdAprx EGSys_tAvrgOxiCat_mp /end IN_MEASUREMENT
/end FUNCTION
/begin FUNCTION egsys_toxicatmod_msg "" /begin OUT_MEASUREMENT EGSys_tOxiCat /end OUT_MEASUREMENT /end FUNCTION
/begin FUNCTION egsys_toxicatmod_uic ""
 /begin OUT_MEASUREMENT EGSys_cpEGOxiCat_mp EGSys_dwFlCmb_mp EGSys_tAvrgOxiCat_mp EGSys_tIncrPoI_mp EGSys_tOxiCatExoIncr_mp EGSys_tOxiCatStat_mp /end OUT_MEASUREMENT
/end FUNCTION
/begin FUNCTION egsys_tstrtcalc "Temperaturmodell für Fahrzeugstillstand"
 /begin DEF_CHARACTERISTIC EGSys_facTempClg_CUR EGSys_facTimeClg_CUR EGSys_swtTAirSens_C EGSys_tiHaValClnt_C EGSys_tiHaValNSC_C EGSys_tiHaValOxiCat_C EGSys_tiHaValTrb_C EGSys_tiHaValTube_C EGSys_tiOfsClg_C EGSys_tStrtCsRepl_C /end DEF_CHARACTERISTIC
 /begin IN_MEASUREMENT EGSys_rTempClnt_mp EGSys_rTimeTrb_mp /end IN_MEASUREMENT
 /begin OUT_MEASUREMENT EGSys_rTimeTube_mp /end OUT_MEASUREMENT
/end FUNCTION
/begin FUNCTION egsys_tstrtcalc_msg ""
 /begin OUT_MEASUREMENT EGSys_tNSCStrtCs EGSys_tOxiCatStrtCs EGSys_tTrbStrtCs EGSys_tTubeStrtCs /end OUT_MEASUREMENT
/end FUNCTION
/begin FUNCTION egsys_tstrtcalc_uic ""
 /begin OUT_MEASUREMENT EGSys_rTempClnt_mp EGSys_rTimeNSC_mp EGSys_rTimeOxiCat_mp EGSys_rTimeTrb_mp EGSys_tExcClntStrtCs_mp EGSys_tiClg_mp EGSys_tiRefClg_mp /end OUT_MEASUREMENT
/end FUNCTION
/begin FUNCTION egsys_ttrbmod ""
 /begin DEF_CHARACTERISTIC EGSys_cpChrg_C EGSys_etaChrg_MAP EGSys_tiChrgPT1_C EGSys_pValDfl_C EGSys_rTempAdbt_CUR EGSys_swtTimeChrg_C EGSys_tEGPstTrbnDfl_C /end DEF_CHARACTERISTIC
 /begin IN_MEASUREMENT AFSCD_dmAirPerTime EGSys_rPresCmpr_mp /end IN_MEASUREMENT
/end FUNCTION
/begin FUNCTION egsys_ttrbmod_msg "" /begin OUT_MEASUREMENT EGSys_tEGPstTrbn /end OUT_MEASUREMENT /end FUNCTION
/begin FUNCTION egsys_ttrbmod_uic ""
 /begin OUT_MEASUREMENT EGSys_cpEGTrbn_mp EGSys_etaChrg_mp EGSys_facPT1Chrg_mp EGSys_pwrCmpr_mp EGSys_rPresCmpr_mp EGSys_tAvrgEGTrbn_mp /end OUT_MEASUREMENT
/end FUNCTION
/begin FUNCTION egsys_ttubemod "Temperaturmodell für Abgasrohr"
 /begin DEF_CHARACTERISTIC EGSys_AlpFreeCnvtTube_C EGSys_cpTube_C EGSys_lDiamTube_C EGSys_lLngthTube_C EGSys_NuTubeEnv_CUR EGSys_NuTube_CUR EGSys_rSqTube_C EGSys_tEGTubeDfl_C EGSys_tTubeDfl_C EGSys_tTubeIKi_C EGSys_tTubeIKiPos_C EGSys_tTubeIKiNeg_C EGSys_tTubeIWinPos_C EGSys_tTubeIWinNeg_C /end DEF_CHARACTERISTIC
 /begin OUT_MEASUREMENT EGSys_AlpEGTube_mp EGSys_AlpTubeEnv_mp EGSys_cndHtEGi_mp EGSys_cndHtEGo_mp EGSys_cpEGTube_mp EGSys_dtTube_mp EGSys_dwTubeIn_mp EGSys_dwTubeOut_mp EGSys_dwTube_mp EGSys_NuTubeEnv_mp EGSys_NuTube_mp EGSys_ReTubeEnvInpCrv_mp EGSys_ReTubeEnv_mp EGSys_ReTubeInpCrv_mp EGSys_ReTube_mp EGSys_sqTube_mp EGSys_tAvrgEGTube_mp EGSys_tDiffEGTube_mp EGSys_tDiffTubeEnv_mp EGSys_tMidEGTube_mp EGSys_tMidTubeEnv_mp /end OUT_MEASUREMENT
/end FUNCTION
/begin FUNCTION egsys_ttubemod_msg "" /begin OUT_MEASUREMENT EGSys_tEGPstTube EGSys_tTube /end OUT_MEASUREMENT /end FUNCTION
/begin FUNCTION egsys_ttubemod_uic "" /end FUNCTION
/begin FUNCTION egt_corgntsync "Regenerationskoordinator Abgasnachbehandlung (zeitsynchron)"
 /begin DEF_CHARACTERISTIC EGT_stRgnLckMsk_C EGT_swtRgnLckRst_C EGT_swtServiceVal_C EGT_tiRgnOilDilMax_C EGT_tiRgnOilDilSubs_C EGT_tiRmpSlpMax_C /end DEF_CHARACTERISTIC
/end FUNCTION
/begin FUNCTION egt_corgntsync_msg ""
 /begin OUT_MEASUREMENT EGT_stCoRgnTSync EGT_stDel EGT_stTSync EGT_stTSyncLck EGT_tiRgnOilDil EGT_tiRgnTSync EGT_tiRmpSlpMax /end OUT_MEASUREMENT
/end FUNCTION
/begin FUNCTION egt_corgntsync_uic "" /begin DEF_CHARACTERISTIC EGT_stTSync_Vector EGT_stTSync_Channel /end DEF_CHARACTERISTIC
 /begin OUT_MEASUREMENT EGT_stCoRgnOld_mp EGT_stRgnOilDil_mp EGT_stTSyncDes_mp EGT_swtRgnLck_mp EGT_tiRgnTSyncPre_mp /end OUT_MEASUREMENT
/end FUNCTION
/begin FUNCTION egt_corgn_msg "" /begin OUT_MEASUREMENT EGT_facRmpVal EGT_st EGT_stCoRgn EGT_stLck EGT_tiRgn /end OUT_MEASUREMENT /end FUNCTION
/begin FUNCTION egt_corgn_uic "" /end FUNCTION
/begin FUNCTION egt_tempgvnr "EGT temperature governor"
 /begin DEF_CHARACTERISTIC EGT_facKiAMPT_MAP EGT_facKiInrTempGvnr_C EGT_facKiOutrTempGvnr_C EGT_facKiQntPoI1_MAP EGT_facKiQntPoI2_MAP EGT_facKiTempInrCor_MAP EGT_facKpAMPT_MAP EGT_facKpInrTempGvnr_C EGT_facKpOutrTempGvnr_C EGT_facKpQntPoI1_MAP EGT_facKpQntPoI2_MAP EGT_facKpTempInrCor_MAP EGT_mAirTempGvnrMax_MAP EGT_mAirTempGvnrMin_MAP EGT_qPoI1Min_C EGT_qPoI1TempGvnrMax_MAP EGT_qPoI1TempGvnrMin_MAP EGT_qPoI2Min_C EGT_qPoI2TempGvnrMax_MAP EGT_qPoI2TempGvnrMin_MAP EGT_rInrDvtThres_C EGT_rOutrDvtThres_C EGT_stMskClsThrVlv_C EGT_swtBiTrbTempGvnr_C EGT_swtInrTempOutr_C EGT_tInrCorTempGvnrMax_MAP EGT_tInrCorTempGvnrMin_MAP EGT_tiPoI1TThres_C /end DEF_CHARACTERISTIC
 /begin IN_MEASUREMENT Eng_nAvrg InjCtl_qSetUnBal /end IN_MEASUREMENT
/end FUNCTION
/begin FUNCTION egt_tempgvnrdesval "Sollwertbildung des Abgastemperaturreglers"
 /begin DEF_CHARACTERISTIC EGT_swtTempInrDes_C EGT_swtTempOutrDes_C EGT_swtTempTurbPre_C EGT_tInrDesTempTurb_CUR EGT_tInrDes_MAP EGT_tOutrDesMflO2_CUR EGT_tOutrDesMsSot_CUR EGT_tOutrDesTempPst_CUR EGT_tOutrDes_MAP /end DEF_CHARACTERISTIC
 /begin IN_MEASUREMENT Eng_nAvrg InjCtl_qSetUnBal PFlt_dmO2Aprx PFlt_mSot PFlt_tOxiPst PFlt_tTurbPre /end IN_MEASUREMENT
/end FUNCTION
/begin FUNCTION egt_tempgvnrdesval_msg ""
 /begin OUT_MEASUREMENT EGT_tInrDesTempGvnr EGT_tInrTempGvnr EGT_tOutrDesTempGvnr EGT_tOutrTempGvnr /end OUT_MEASUREMENT
/end FUNCTION
/begin FUNCTION egt_tempgvnrdesval_uic "" /end FUNCTION
/begin FUNCTION egt_tempgvnrmonitor "Überwachung des Abgastemperaturreglers"
 /begin DEF_CHARACTERISTIC EGT_stMskInrTempGvnr_C EGT_stMskOutrTempGvnr_C EGT_tiHiLoTempGvnr_C EGT_tiLoHiTempGvnr_C EGT_tInrThresDwn_C EGT_tInrThresUp_C EGT_tiPoIHiLoTempGvnr_C EGT_tiPoILoHiTempGvnr_C EGT_tOutrThresDwn_C EGT_tOutrThresUp_C EGT_tOxiPreThresBrn_C /end DEF_CHARACTERISTIC
/end FUNCTION
/begin FUNCTION egt_tempgvnrmonitor_msg "" /begin OUT_MEASUREMENT EGT_stTempGvnr /end OUT_MEASUREMENT /end FUNCTION
/begin FUNCTION egt_tempgvnrmonitor_uic "" /end FUNCTION
/begin FUNCTION egt_tempgvnroutval "Ausgabeschnittstelle der Abgastemperaturregelung"
 /begin DEF_CHARACTERISTIC EGT_facQntPoI2Rmp_CUR EGT_mAirDesTempGvnrMnl_C EGT_mAirLmbd_CUR EGT_phiPoI1TempGvnr_MAP EGT_qHCQntPoI1_CUR EGT_qPoI1TempGvnrMnl_C EGT_qPoI2TempGvnrMnl_C EGT_swtQntPoI1HC_C EGT_tiPoI2TempGvnr_MAP EGT_tiRmpSlpTempGvnr_C /end DEF_CHARACTERISTIC
 /begin IN_MEASUREMENT EGT_facRmp_mp EGT_qPoI1OutrTempGvnr Eng_nAvrg InjCtl_qSetUnBal PFlt_rLmbd /end IN_MEASUREMENT
/end FUNCTION
/begin FUNCTION egt_tempgvnroutval_msg ""
 /begin OUT_MEASUREMENT EGT_mAirDesTempGvnr EGT_phiPoI1TempGvnr EGT_qHCTempGvnr EGT_qPoI1TempGvnr EGT_qPoI2TempGvnr EGT_tiPoI2TempGvnr /end OUT_MEASUREMENT
/end FUNCTION
/begin FUNCTION egt_tempgvnroutval_uic ""
 /begin OUT_MEASUREMENT EGT_facRmpValTempGvnr_mp EGT_facRmp_mp EGT_mAirLmbdTempGvnr_mp /end OUT_MEASUREMENT
/end FUNCTION
/begin FUNCTION egt_tempgvnr_msg ""
 /begin OUT_MEASUREMENT EGT_mAirDesInrTempGvnr EGT_qPoI1OutrTempGvnr EGT_qPoI2InrTempGvnr EGT_tInrDesCorTempGvnr /end OUT_MEASUREMENT
/end FUNCTION
/begin FUNCTION egt_tempgvnr_uic ""
 /begin OUT_MEASUREMENT EGT_mAirTempGvnrMin_mp EGT_mAirTempGvnrRng_mp EGT_qPoI1Min_mp EGT_qPoI1Rng_mp EGT_qPoI2Min_mp EGT_qPoI2Rng_mp EGT_rIInrTempGvnr_mp EGT_rInrTempGvnr_mp EGT_rIOutrTempGvnr_mp EGT_rOutrTempGvnr_mp EGT_rPInrTempGvnr_mp EGT_rPOutrTempGvnr_mp EGT_rStyInrTempGvnr_mp EGT_rStyOutrTempGvnr_mp EGT_stClsThrVlv_mp EGT_tInrCorMax_mp EGT_tInrCorRng_mp EGT_tInrDvtTempGvnr_mp EGT_tiPoI1ActvCnt_mp EGT_tOutrDvtTempGvnr_mp /end OUT_MEASUREMENT
/end FUNCTION
/begin FUNCTION emccd "Komponententreiber der Motorlagersteuerung"
 /begin DEF_CHARACTERISTIC EMCCD_uSRCMinActVal1_C EMCCD_uSRCMaxActVal1_C EMCCD_iLinActVal1_CUR EMCCD_uSRCMinActVal2_C EMCCD_uSRCMaxActVal2_C EMCCD_iLinActVal2_CUR EMCCD_ctPwrStgOnMax1_C EMCCD_ctPwrStgOnMax2_C EMCCD_dcycCurrOff_MAP EMCCD_dcycCurrOnHi_MAP EMCCD_dcycCurrOnLow_MAP EMCCD_dcycMax_C EMCCD_dcycMin_C EMCCD_dcycWarmUp_MAP EMCCD_DebExcTempDef1_C EMCCD_DebExcTempOk1_C EMCCD_DebExcTempDef2_C EMCCD_DebExcTempOk2_C EMCCD_DebNoLoadDef1_C EMCCD_DebNoLoadOk1_C EMCCD_DebNoLoadDef2_C EMCCD_DebNoLoadOk2_C EMCCD_DebShortCircBatDef1_C EMCCD_DebShortCircBatOk1_C EMCCD_DebShortCircBatDef2_C EMCCD_DebShortCircBatOk2_C EMCCD_DebShortCircGndDef1_C EMCCD_DebShortCircGndOk1_C EMCCD_DebShortCircGndDef2_C EMCCD_DebShortCircGndOk2_C EMCCD_DebSRCHighDef1_C EMCCD_DebSRCHighOk1_C EMCCD_DebSRCHighDef2_C EMCCD_DebSRCHighOk2_C EMCCD_DebSRCLowDef1_C EMCCD_DebSRCLowOk1_C EMCCD_DebSRCLowDef2_C EMCCD_DebSRCLowOk2_C EMCCD_dtRmpSlpUpActVal1_C EMCCD_dtRmpSlpDwnActVal1_C EMCCD_dtRmpSlpUpActVal2_C EMCCD_dtRmpSlpDwnActVal2_C EMCCD_numAdc1_C EMCCD_numAdc2_C EMCCD_numDiaOut1_C EMCCD_numDiaOut2_C EMCCD_numPwmOut1_C EMCCD_numPwmOut2_C EMCCD_tiActValPT1_1_C EMCCD_tiActValPT1_2_C EMCCD_stInvOut1_C EMCCD_tiPer1_C EMCCD_stInvOut2_C EMCCD_tiPer2_C EMCCD_stSPICtl1_C EMCCD_stSPICtl2_C EMCCD_swtRegOn_C EMCCD_tiBtwTst1_C EMCCD_tiBtwTst2_C EMCCD_tiCurrOnHi_C EMCCD_tiPwrStgOn1_C EMCCD_tiPwrStgOn2_C EMCCD_tiWarmUp_C EMCCD_stSensIDWordActVal1_C EMCCD_iDflActVal1_C EMCCD_stSensIDWordActVal2_C EMCCD_iDflActVal2_C EngM_ctPwrStgOnMax1_C EngM_ctPwrStgOnMax2_C EngM_HldCurr_MAP EngM_RetCurr_MAP EngM_tEngMax_C EngM_tEngMin_C EngM_tiEngMntCtl_C EngM_uBattMax_C EngM_uBattMin_C /end DEF_CHARACTERISTIC
 /begin IN_MEASUREMENT BattCD_u EATSCD_tAir EMCCD_resAct1 EMCCD_uRawActVal1_mp EMCCD_uRawActVal2_mp Eng_tEng /end IN_MEASUREMENT
/end FUNCTION
/begin FUNCTION emccd_msg "" /begin OUT_MEASUREMENT EMCCD_iActVal1 EMCCD_iActVal2 EMCCD_resAct1 EMCCD_resAct2 /end OUT_MEASUREMENT /end FUNCTION
/begin FUNCTION emccd_uic ""
 /begin OUT_MEASUREMENT EMCCD_dcycCurrOff1_mp EMCCD_dcycCurrOff2_mp EMCCD_dcycCurrOn1_mp EMCCD_dcycCurrOn2_mp EMCCD_dcycMntCtlOut1_mp EMCCD_dcycMntCtlOut2_mp EMCCD_dcycOut1_mp EMCCD_dcycOut2_mp EMCCD_iActValFlt1_mp EMCCD_iActValFlt2_mp EMCCD_rHWE1_mp EMCCD_rHWE2_mp EMCCD_stOut_mp EMCCD_uRawActVal1_mp EMCCD_uRawActVal2_mp /end OUT_MEASUREMENT
/end FUNCTION
/begin FUNCTION eng "Motor"
 /begin DEF_CHARACTERISTIC Eng_ctEngSpdDiffCalc_C Eng_tOvrHi2_C Eng_tOvrHi_C Eng_tOvrLo2_C Eng_tOvrLo_C Eng_trqSpd_CUR /end DEF_CHARACTERISTIC
 /begin IN_MEASUREMENT Eng_nAvrg /end IN_MEASUREMENT
/end FUNCTION
/begin FUNCTION engm "Motormechanik"
 /begin DEF_CHARACTERISTIC EngM_dLimitCond_ASD_CA EngM_dLimitCond_Common_CA EngM_dLimitCond_FBC_CA EngM_dLimitCond_Joint_CA EngM_dLimitCond_LiGov_CA EngM_dLimitCond_Pilot_CA EngM_nLimitInj_C EngM_nLimitThreshHyst_CA EngM_nLimitThresh_CA EngM_nSwtCoMa_C EngM_numLimitInj_C EngM_swtNumCylVal_C EngM_swtNumCylType_C /end DEF_CHARACTERISTIC
/end FUNCTION
/begin FUNCTION engmon_irrcmb "Verbrennungserkennung mit Lambdasonde" /end FUNCTION
/begin FUNCTION engmon_irrcmb_msg "" /begin OUT_MEASUREMENT EngMon_stShOffIrrCmb /end OUT_MEASUREMENT /end FUNCTION
/begin FUNCTION engmon_irrcmb_uic "" /end FUNCTION
/begin FUNCTION engm_ang ""
 /begin DEF_CHARACTERISTIC EngM_ctOfsCaSCrS_C EngM_ctPhWhlRev_C EngM_ctPostSync_C EngM_ctReSync_C EngM_ctVerSync_C EngM_nMaxStrt_C EngM_numPin_C EngM_nWaitIncSig_C EngM_phiDelayPhNoSig_C EngM_phiDeltaExtSync_C EngM_phiDelta_C EngM_phiFrstInjInt_C EngM_phiInt_C EngM_phiMax_C EngM_phiTDC_C EngM_stSyncBefGap_C EngM_swtExitOfs_C EngM_swtFirSeqFBC_C EngM_swtSyncViaCAN_C EngM_tiCpuTimeOut_C EngM_tiDiffInt_C EngM_tiWaitIncSig_C /end DEF_CHARACTERISTIC
/end FUNCTION
/begin FUNCTION engm_angdiag "Diagnose des Kurbelwellen- und Nockenwellensignals"
 /begin DEF_CHARACTERISTIC EngM_ctSpdtoZero_C EngM_DebIncCaSErrSigDef_C EngM_DebIncCaSErrSigOK_C EngM_DebIncCaSNoSigDef_C EngM_DebIncCrSErrSigDef_C EngM_DebIncCrSErrSigOK_C EngM_DebIncOfsSigCaSCrSDef_C EngM_DebPhCrSErrSigDef_C EngM_nMinDiag_C /end DEF_CHARACTERISTIC
/end FUNCTION
/begin FUNCTION engm_angdiag_uic ""
 /begin OUT_MEASUREMENT EngM_ctIncErrSigDiagCaSDef_mp EngM_ctIncErrSigDiagCaSOk_mp EngM_ctIncErrSigDiagCrSDef_mp EngM_ctIncErrSigDiagCrSOK_mp EngM_ctIncErrSigDiagmaxCaSDef_mp EngM_ctIncErrSigDiagmaxCaSOk_mp EngM_ctIncErrSigDiagmaxCrSDef_mp EngM_ctIncNoSigDiagCaS_mp EngM_ctIncNoSigDiagmaxCaS_mp EngM_ctPhErrSigDiagCrSDef_mp EngM_ctPhErrSigDiagmaxCrSDef_mp EngM_ctSpdtoZero_mp /end OUT_MEASUREMENT
/end FUNCTION
/begin FUNCTION engm_ang_msg ""
 /begin OUT_MEASUREMENT EngM_nDyn EngM_numInt EngM_numLastTDC EngM_numSyncTDC EngM_numTDC EngM_phiDiffTDC EngM_phiInt EngM_phiIntExt EngM_phiTDC EngM_stCaSExt EngM_stCaSVerifyDiag EngM_stErrCanExt EngM_stEvent EngM_stInjCharSetVal EngM_stNext EngM_stNextExt EngM_stSync EngM_tiSeg EngM_tiSegLimAvrg EngM_tiSegTwo /end OUT_MEASUREMENT
/end FUNCTION
/begin FUNCTION engm_ang_uic ""
 /begin OUT_MEASUREMENT EngM_ctIntOvrLoad_mp EngM_ctPostSync_mp EngM_ctReSync_mp EngM_ctVerSync_mp EngM_numRevCnt_mp EngM_phiIntExtCorr_mp EngM_SchedDelta_mp EngM_SchedIndex_mp EngM_SchedLimitInt_mp EngM_SchedSegID_mp EngM_stEventEnable_mp EngM_stEventServed_mp EngM_tiDiffInt_mp /end OUT_MEASUREMENT
/end FUNCTION
/begin FUNCTION engm_backup "Start und Betrieb des Motors nur mit Nockenwellensignal"
 /begin DEF_CHARACTERISTIC EngM_nMaxStrtBackUp_C EngM_stBackUpVar_C EngM_stEnaBackUp_C /end DEF_CHARACTERISTIC
/end FUNCTION
/begin FUNCTION engm_backup_uic "" /end FUNCTION
/begin FUNCTION engm_engmntctl "Motorlagersteuerung"
 /begin DEF_CHARACTERISTIC EngM_nAvrgHysDelta_C EngM_nAvrgHysHigh_CUR EngM_nAvrgLim_C EngM_stOutHard_C EngM_stOutSoft_C EngM_tiHardAftrGear_C EngM_tiSoftAftrStrt_C EngM_vVSSCDHysHigh_C EngM_vVSSCDHysLow_C /end DEF_CHARACTERISTIC
 /begin IN_MEASUREMENT Eng_tEng /end IN_MEASUREMENT
/end FUNCTION
/begin FUNCTION engm_engmntctl_msg "" /begin OUT_MEASUREMENT EngM_stOut /end OUT_MEASUREMENT /end FUNCTION
/begin FUNCTION engm_engmntctl_uic ""
 /begin OUT_MEASUREMENT EngM_nAvrgHysHigh_mp EngM_nAvrgHysLow_mp EngM_rCurrProf_mp EngM_stEngMntCtl_mp /end OUT_MEASUREMENT
/end FUNCTION
/begin FUNCTION engm_msg "" /begin OUT_MEASUREMENT EngM_numCyl EngM_stSpd /end OUT_MEASUREMENT /end FUNCTION
/begin FUNCTION engm_soptst "" /end FUNCTION
/begin FUNCTION engm_trqfrc "aktuelles Reibmoment"
 /begin DEF_CHARACTERISTIC EngM_dtrqFrcPDiffUp_C EngM_dtrqFrcPDiffDwn_C EngM_facTrqFrcPDiff_CUR EngM_numTrqFrc_C EngM_trqFrcPDiffMin_C EngM_trqFrc_MAP /end DEF_CHARACTERISTIC
 /begin IN_MEASUREMENT EngM_tTrqFrc_mp Eng_nAvrg /end IN_MEASUREMENT
/end FUNCTION
/begin FUNCTION engm_trqfrcadpt "Reibmomentenadaption"
 /begin DEF_CHARACTERISTIC EngM_facT1Reliabl_C EngM_tiFltACoff_C EngM_tiFltACon_C EngM_nLISetDiffOffs_C EngM_stChkPN_C EngM_tAdptMin_C EngM_tiRelAdpt_C EngM_vLimRefuse_C EngM_vThresAdpt_C /end DEF_CHARACTERISTIC
/end FUNCTION
/begin FUNCTION engm_trqfrcadpt_msg ""
 /begin OUT_MEASUREMENT EngM_stAdpt EngM_stReliablAdpt EngM_trqDiffAdpt EngM_trqLossAdpt /end OUT_MEASUREMENT
/end FUNCTION
/begin FUNCTION engm_trqfrcadpt_uic ""
 /begin OUT_MEASUREMENT EngM_nLISetDiff_mp EngM_stGbxRel_mp EngM_stGenRel_mp EngM_stNDiffRng_mp EngM_trqFltACoff_mp EngM_trqFltACon_mp EngM_trqLossCompl_mp EngM_trqLossDiff_mp /end OUT_MEASUREMENT
/end FUNCTION
/begin FUNCTION engm_trqfrc_msg "" /begin OUT_MEASUREMENT EngM_trqFrc /end OUT_MEASUREMENT /end FUNCTION
/begin FUNCTION engm_trqfrc_uic "" /begin DEF_CHARACTERISTIC EngM_trqFrc_Vector EngM_trqFrc_Channel /end DEF_CHARACTERISTIC
 /begin OUT_MEASUREMENT EngM_stTrqFrcPDiffErr_mp EngM_trqFrcPDiffLim_mp EngM_trqFrcPDiffRaw_mp EngM_trqFrcPDiff_mp EngM_trqFrcT_mp EngM_tTrqFrc_mp /end OUT_MEASUREMENT
/end FUNCTION
/begin FUNCTION engm_uic "" /end FUNCTION
/begin COMPU_METHOD AirMassPerCyl "Luftmasse pro Zylinder" RAT_FUNC "%6.3" "mg/Hub" COEFFS 0 10 0 0 0 1 /end COMPU_METHOD
/begin COMPU_METHOD AirMassPerTime "Luftmasse pro Zeit" RAT_FUNC "%6.3" "Kg/h" COEFFS 0 10 0 0 0 1 /end COMPU_METHOD
/begin COMPU_METHOD AngleCrS "Winkel Kurbelwelle" RAT_FUNC "%6.4" "deg CrS" COEFFS 0 42.6666666666667 0 0 0 1 /end COMPU_METHOD
/begin COMPU_METHOD Area "Flaeche mit hoher Aufloesung" RAT_FUNC "%6.5" "m*m" COEFFS 0 8192 0 0 0 1 /end COMPU_METHOD
/begin COMPU_METHOD Calory "Heizwert" RAT_FUNC "%6.2" "J/g" COEFFS 0 1 0 0 0 1 /end COMPU_METHOD
/begin COMPU_METHOD CubMtrPerHr "Volumsstrom in m^3/h" RAT_FUNC "%6.3" "m^3/h" COEFFS 0 10 0 0 0 1 /end COMPU_METHOD
/begin COMPU_METHOD Curr "Strom" RAT_FUNC "%6.2" "mA" COEFFS 0 1 0 0 0 1 /end COMPU_METHOD
/begin COMPU_METHOD DtyCyc "Tastverhaeltnis" RAT_FUNC "%6.4" "%" COEFFS 0 100 0 0 0 1 /end COMPU_METHOD
/begin COMPU_METHOD EGTFact "Umrechnung für EGT_TempGvnr Ausgabeschnittstellen und Messpunkte" RAT_FUNC "%6.5" "-" COEFFS 0 1000 0 0 0 1 /end COMPU_METHOD
/begin COMPU_METHOD EGTSwt "Umrechnung für EGT Rampenschalter (1 / 1000*2^14 )" RAT_FUNC "%10.9" "-" COEFFS 0 16384000 0 0 0 1 /end COMPU_METHOD
/begin COMPU_METHOD EGTSwt_S16 "Faktor (0...1) für sint16 Type mit 0.000061 Auflösung" RAT_FUNC "%7.6" "-" COEFFS 0 16384 0 0 0 1 /end COMPU_METHOD
/begin COMPU_METHOD Energy "Energie in Joule" RAT_FUNC "%6.2" "kJ" COEFFS 0 1 0 0 0 1 /end COMPU_METHOD
/begin COMPU_METHOD EngN "Motordrehzahl" RAT_FUNC "%6.2" "rpm" COEFFS 0 1 0 0 0 1 /end COMPU_METHOD
/begin COMPU_METHOD EngTempFldSel "Verbale Umrechnung für Auswahl aus dem Motortemperatur-Feld Eng_tFld" TAB_VERB "%6.3" "-" COMPU_TAB_REF EngTempFldSel /end COMPU_METHOD
/begin COMPU_VTAB EngTempFldSel "Verbale Umrechnung für Auswahl aus dem Motortemperatur-Feld Eng_tFld" TAB_VERB 3 0 "Coolant_Temperature" 1 "Oil_Temperature" 2 "Eng_tEng" /end COMPU_VTAB
/begin COMPU_METHOD Fact "Faktor mit Auflösung 1 / 8192, hauptsächlich für einen Faktorenbereich 0...1 verwendet" RAT_FUNC "%6.5" "-" COEFFS 0 8192 0 0 0 1 /end COMPU_METHOD
/begin COMPU_METHOD Fact1 "Faktor mit Auflösung 0,01 (100 mal höherer Bereich als Fact)" RAT_FUNC "%6.4" "-" COEFFS 0 128 0 0 0 1 /end COMPU_METHOD
/begin COMPU_METHOD FactLow "Faktor mit Auflösung 1/1024, hauptsächlich für einen Faktorenbereich 1...50 verwendet" RAT_FUNC "%6.5" "-" COEFFS 0 8192 0 0 0 1 /end COMPU_METHOD
/begin COMPU_METHOD Fact_PT1 "Faktor um die Zeitkonstante eines PT1 filters festzulegen (Taupunktermittlung)" RAT_FUNC "%6.4" "W/K" COEFFS 0 128 0 0 0 1 /end COMPU_METHOD
/begin COMPU_METHOD HeatCapacity "Waermekapazitaet einer Substanz" RAT_FUNC "%6.3" "J/K" COEFFS 0 10 0 0 0 1 /end COMPU_METHOD
/begin COMPU_METHOD InjMassCorr "Korrektureinspritzmenge" RAT_FUNC "%6.5" "mg/hub" COEFFS 0 1000 0 0 0 1 /end COMPU_METHOD
/begin COMPU_METHOD InjMassCyc "Einspritzmenge pro Zyklus (mg/Zyklus)" RAT_FUNC "%6.4" "mg/cyc" COEFFS 0 100 0 0 0 1 /end COMPU_METHOD
/begin COMPU_METHOD InjMassInj "Einspritzmenge pro Einspritzung (mg/Einspritzung)" RAT_FUNC "%6.4" "mg/inj" COEFFS 0 100 0 0 0 1 /end COMPU_METHOD
/begin COMPU_METHOD InjTime_us "Zeit in Microsekunden für das Einspritztiming" RAT_FUNC "%6.2" "us" COEFFS 0 1 0 0 0 1 /end COMPU_METHOD
/begin COMPU_METHOD Ki_Kelv_Sec "Verstärkungskonstante für Integrator für zeitliche Ableitung der Temperatur" RAT_FUNC "%6.4" "1/s" COEFFS 0 429.4967296 0 0 0 1 /end COMPU_METHOD
/begin COMPU_METHOD Ki_Temp2EGTFact "Umrechnung für die Integrator Verstärkung des PI Reglers im EGT_TempGvnr [1/K]" RAT_FUNC "%8.7" "1/(K*s)" COEFFS 0 858993.4592 0 0 0 1 /end COMPU_METHOD
/begin COMPU_METHOD Kp_Temp2EGTFact "Umrechnung für die Proportional Verstärkung des PI Reglers im EGT_TempGvnr [1/K]" RAT_FUNC "%7.6" "1/K" COEFFS 0 51200 0 0 0 1 /end COMPU_METHOD
/begin COMPU_METHOD lambda "Lambda" RAT_FUNC "%6.5" "-" COEFFS 0 1000 0 0 0 1 /end COMPU_METHOD
/begin COMPU_METHOD Length1 "Abstand in Meter" RAT_FUNC "%6.4" "m" COEFFS 0 128 0 0 0 1 /end COMPU_METHOD
/begin COMPU_METHOD mSoot_g "Rußmasse [g]" RAT_FUNC "%6.4" "g" COEFFS 0 100 0 0 0 1 /end COMPU_METHOD
/begin COMPU_METHOD NumPinAdc "verbale Umrechnung für ADC Signale" TAB_VERB "%6.3" "-" COMPU_TAB_REF NumPinAdc /end COMPU_METHOD
/begin COMPU_VTAB NumPinAdc "verbale Umrechnung für ADC Signale" TAB_VERB 27 0 "Water_Temperature_Sensor_182" 1 "Intake_Air_Temperature_Sensor_157" 2 "Charge_Air_Temperature_Sensor_183" 3 "Exhaust_Temperature_Sensor_2_134" 4 "Exhaust_Temperature_Sensor_1_158" 5 "1st_APP_Sensor_252" 6 "2nd_APP_Sensor_239" 7 "ADC_REF" 8 "Boost_Pressure_Sensor_154" 9 "Atmospheric_Pressure_Sensor" 10 "Battery_Voltage_Sensor" 11 "Rail_Pressure_Sensor_156" 12 "Rail_Pressure_Peak_Value_156" 13 "Booster_Voltage_Sensor" 14 "Current_MeUn_Sensor" 15 "Current_PCV_Sensor" 16 "Voltage_Bank_1" 17 "Voltage_Bank_2" 18 "Pressure_Upstream_Particle_Filter_159" 19 "Engine_Oil_Pressure_110" 20 "Temperature_ECU_PCB" 21 "Voltage_Lambda_Ua" 22 "Voltage_Lambda_Ri" 23 "EMCCD_Current_Governor1_124" 24 "EMCCD_Current_Governor2_121" 25 "ADC_DUMMY_NOT_USED" 26 "ADC_DUMMY_A_NOT_USED" /end COMPU_VTAB
/begin COMPU_METHOD NumPinDia "Verbale Umrechnung für Diagnose Signale" TAB_VERB "%6.3" "-" COMPU_TAB_REF NumPinDia /end COMPU_METHOD
/begin COMPU_VTAB NumPinDia "Verbale Umrechnung für Diagnose Signale" TAB_VERB 28 0 "CJ945_Diagnostic_Signal" 1 "AC_Compressor_DiaSig" 2 "Fuel_Pump_Diagnostic_Signal_232" 3 "Starter_234" 4 "Oil_Pressure_Lamp_Switch_245" 5 "Engine_Bay_Air_Flaps_123" 6 "Ebox_Fan_Actuator_Diagnostic_Signal_219" 7 "Shuttr_Actuator_Diagnostic_Signal_231" 8 "Twostage_TurboLoading_SW_DiaSig" 9 "DIO_OUT_DIAGNOSTIC_DUMMY_NOT_USED" 10 "Alternator" 11 "Boost_Pressure_Actuator_Diagnostic_Signal_193" 12 "EGR_Actuator_Diagnostic_Signal_194" 13 "1st_Pressure_Control_Valve_Diagnostic_Signal_172" 14 "2nd_Pressure_Control_Valve_Diagnostic_Signal_172" 15 "1st_Metering_Unit_Diagnostic_Signal_171" 16 "2nd_Metering_Unit_Diagnostic_Signal_171" 17 "Variable_Swirl_Actuator_Diagnostic_Signal_195" 18 "FAN_240" 19 "Add_On_Heater_244" 20 "EngM_Bearing_Actuator_Diagnostic_Signal_124" 21 "EngM_Bearing_Actuator_Diagnostic_Signal_121" 22 "Throttle_Valve_Diagnostic_Signal_196" 23 "Low pressure stage BPA_Diagnostic_Signal_117" 24 "PWM_DIAGNOSTIC_DUMMY_NOT_USED" 25 "1st_Sensor_Supply_Voltage_DiaSig" 26 "2nd_Sensor_Supply_Voltage_DiaSig" 27 "3rd_Sensor_Supply_Voltage_DiaSig" /end COMPU_VTAB
/begin COMPU_METHOD NumPinDioOut "Verbale Umrechnung für Digitalausgang Signale" TAB_VERB "%6.3" "-" COMPU_TAB_REF NumPinDioOut /end COMPU_METHOD
/begin COMPU_VTAB NumPinDioOut "Verbale Umrechnung für Digitalausgang Signale" TAB_VERB 11 0 "Main_Relay_220(144)" 1 "AC_Compressor" 2 "Fuel_Pump_232" 3 "Starter_234" 4 "OPS_Lamp_245" 5 "EBAF_123" 6 "Ebox_Fan_Actuator_219" 7 "Shuttr_Actuator_231" 8 "STATREG_PSOFF_Bit" 9 "Twostage_TurboLoading_120" 10 "DIO_OUT_DUMMY_NOT_USED" /end COMPU_VTAB
/begin COMPU_METHOD NumPinPwmOut "Verbale Umrechnung für PWM-Ausgang Signale" TAB_VERB "%6.3" "-" COMPU_TAB_REF NumPinPwmOut /end COMPU_METHOD
/begin COMPU_VTAB NumPinPwmOut "Verbale Umrechnung für PWM-Ausgang Signale" TAB_VERB 13 0 "Boost_Pressure_Actuator_193" 1 "EGR_Actuator_194" 2 "PCV_Actuator_172" 3 "MeUn_Actuator_171" 4 "Variable_Swirl_Actuator_195" 5 "Fan_Actuator_240" 6 "Add_On_Heater_244" 7 "EngM_Bearing_Actuator_124" 8 "EngM_Bearing_Actuator_121" 9 "Throttle_Valve_196" 10 "LSU_Heater_PWMOutput" 11 "Low pressure stage BPA_117" 12 "PWM_DUMMY_NOT_USED" /end COMPU_VTAB
/begin COMPU_METHOD OneToOne "eins zu eins (physikalischer Wert ist gleich dem internen Wert)" RAT_FUNC "%6.2" "-" COEFFS 0 1 0 0 0 1 /end COMPU_METHOD
/begin COMPU_METHOD Period "Periodendauer" RAT_FUNC "%6.3" "ms" COEFFS 0 10 0 0 0 1 /end COMPU_METHOD
/begin COMPU_METHOD Prc "Prozent, gleiche interne Auflösung wie Fact, aber Darstellung in Prozent (0...100%)" RAT_FUNC "%6.4" "%" COEFFS 0 81.92 0 0 0 1 /end COMPU_METHOD
/begin COMPU_METHOD Pres_hPa "Druck (angezeigt in [hPa])" RAT_FUNC "%6.2" "hPa" COEFFS 0 1 0 0 0 1 /end COMPU_METHOD
/begin COMPU_METHOD Pwr "Leistung" RAT_FUNC "%6.2" "W" COEFFS 0 0.10610329539459 0 0 0 1 /end COMPU_METHOD
/begin COMPU_METHOD Pwr1 "Leistung mit Hoher Aufloesung" RAT_FUNC "%6.3" "W" COEFFS 0 10 0 0 0 1 /end COMPU_METHOD
/begin COMPU_METHOD Pwr_kW_Sec "Leistungsaenderungsrate in kW/s" RAT_FUNC "%6.4" "kW/s" COEFFS 0 100 0 0 0 1 /end COMPU_METHOD
/begin COMPU_METHOD Resist "Widerstand" RAT_FUNC "%6.3" "Ohm" COEFFS 0 10 0 0 0 1 /end COMPU_METHOD
/begin COMPU_METHOD ReynoldsNum "Reynolds Nummer um den thermischen Koeffizienten zu bestimmen" RAT_FUNC "%6.0" "-" COEFFS 0 0.01 0 0 0 1 /end COMPU_METHOD
/begin COMPU_METHOD RmpCurr "Current ramp gradient in [ mA/s ] for BPA Current Feedback" RAT_FUNC "%6.4" "mA/s" COEFFS 0 65.536 0 0 0 1 /end COMPU_METHOD
/begin COMPU_METHOD RmpTemp "Rampengradient für Temperatur" RAT_FUNC "%6.4" "deg C/s" COEFFS 0 655.36 0 0 0 1 /end COMPU_METHOD
/begin COMPU_METHOD RmpTrq "Rampengradient für Motormoment" RAT_FUNC "%6.4" "Nm/s" COEFFS 0 655.36 0 0 0 1 /end COMPU_METHOD
/begin COMPU_METHOD SpecificHeat "spezifische Waermekapazitaet einer Substanz" RAT_FUNC "%7.6" "J/g/K" COEFFS 0 10000 0 0 0 1 /end COMPU_METHOD
/begin COMPU_METHOD TempDiff_Cels "difference/offset temperature displayed in degree celcius" RAT_FUNC "%6.3" "deg C" COEFFS 0 10 0 0 0 1 /end COMPU_METHOD
/begin COMPU_METHOD Temp_Cels "Temperatur dargestellt in °C (gleiche interne Darstellung wie Temp_Kelv)" RAT_FUNC "%6.1" "deg C" COEFFS 0 10 2731.4 0 0 1 /end COMPU_METHOD
/begin COMPU_METHOD Temp_Kelv_Sec "Temperaturaenderungsrate" RAT_FUNC "%6.4" "K/s" COEFFS 0 100 0 0 0 1 /end COMPU_METHOD
/begin COMPU_METHOD ThermalCoEff "Waermekoeffiziens einer Substanz" RAT_FUNC "%6.3" "W/m/m/K" COEFFS 0 10 0 0 0 1 /end COMPU_METHOD
/begin COMPU_METHOD TimeDeb "Entprellzeit in Millisekunden für Libraryfunktion Debounce" RAT_FUNC "%6.1" "ms" COEFFS 0 0.1 0 0 0 1 /end COMPU_METHOD
/begin COMPU_METHOD TimeDelay_s "Zeitkonstante T1 (in s) für PT1, DT1, etc." RAT_FUNC "%9.3" "s" COEFFS 0 0 1 0 0.00023283064365387 0 /end COMPU_METHOD
/begin COMPU_METHOD TimeDT "Abtastzeit (in us) für Library Regler, Filter, etc." RAT_FUNC "%6.2" "us" COEFFS 0 1 0 0 0 1 /end COMPU_METHOD
/begin COMPU_METHOD TimeEGTRmp "Umrechnung  Zeit in Rampensteigung,  Verwendet in EGT-Bibliothek" RAT_FUNC "%6.3" "s" COEFFS 0 0 1 0 0.0152587890625 0 /end COMPU_METHOD
/begin COMPU_METHOD TimeSys_us "Zeit in [us] mit Systemzeit-Auflösung" RAT_FUNC "%6.3" "us" COEFFS 0 3.4965 0 0 0 1 /end COMPU_METHOD
/begin COMPU_METHOD Time_ms "Zeit in ms für Fehlerentprellung (DSM) und SW-Timer" RAT_FUNC "%6.1" "ms" COEFFS 0 0.1 0 0 0 1 /end COMPU_METHOD
/begin COMPU_METHOD Time_s "Zeit in s für Fehlerentprellung (DSM) und SW-Timer" RAT_FUNC "%6.4" "s" COEFFS 0 100 0 0 0 1 /end COMPU_METHOD
/begin COMPU_METHOD Trq "Motormoment" RAT_FUNC "%6.3" "Nm" COEFFS 0 10 0 0 0 1 /end COMPU_METHOD
/begin COMPU_METHOD Vel "Fahrzeuggeschwindigkeit, gleiche interne Auflösung wie Vel_SI" RAT_FUNC "%6.4" "km/h" COEFFS 0 100 0 0 0 1 /end COMPU_METHOD
/begin COMPU_METHOD Volt "Spannung in V (von ADC)" RAT_FUNC "%6.2" "mV" COEFFS 0 0.2046 0 0 0 1 /end COMPU_METHOD
/begin COMPU_METHOD Volt_Batt "Batteriespannung" RAT_FUNC "%6.1" "mV" COEFFS 0 0.05115 0 0 0 1 /end COMPU_METHOD
/begin COMPU_METHOD default "" RAT_FUNC "%6.2" "-" COEFFS 0 1 0 0 0 1 /end COMPU_METHOD
/begin RECORD_LAYOUT Kf_Xs16_Ys16_Ws16 NO_AXIS_PTS_X 1 SWORD NO_AXIS_PTS_Y 2 SWORD AXIS_PTS_X 3 SWORD INDEX_INCR DIRECT AXIS_PTS_Y 4 SWORD INDEX_INCR DIRECT FNC_VALUES 5 SWORD COLUMN_DIR DIRECT /end RECORD_LAYOUT
/begin RECORD_LAYOUT Kl_Xs16_Ws16 NO_AXIS_PTS_X 1 SWORD AXIS_PTS_X 2 SWORD INDEX_INCR DIRECT FNC_VALUES 3 SWORD COLUMN_DIR DIRECT /end RECORD_LAYOUT
/begin RECORD_LAYOUT Kwb_Ws16 FNC_VALUES 1 SWORD COLUMN_DIR DIRECT /end RECORD_LAYOUT
/begin RECORD_LAYOUT Kwb_Wu16 FNC_VALUES 1 UWORD COLUMN_DIR DIRECT /end RECORD_LAYOUT
/begin RECORD_LAYOUT Kwb_Wu32 FNC_VALUES 1 ULONG COLUMN_DIR DIRECT /end RECORD_LAYOUT
/begin RECORD_LAYOUT Kwb_Wu8 FNC_VALUES 1 UBYTE COLUMN_DIR DIRECT /end RECORD_LAYOUT
/begin RECORD_LAYOUT Kw_Ws16 FNC_VALUES 1 SWORD COLUMN_DIR DIRECT /end RECORD_LAYOUT
/begin RECORD_LAYOUT Kw_Ws32 FNC_VALUES 1 SLONG COLUMN_DIR DIRECT /end RECORD_LAYOUT
/begin RECORD_LAYOUT Kw_Wu16 FNC_VALUES 1 UWORD COLUMN_DIR DIRECT /end RECORD_LAYOUT
/begin RECORD_LAYOUT Kw_Wu32 FNC_VALUES 1 ULONG COLUMN_DIR DIRECT /end RECORD_LAYOUT
/begin RECORD_LAYOUT Kw_Wu8 FNC_VALUES 1 UBYTE COLUMN_DIR DIRECT /end RECORD_LAYOUT
/end MODULE
/end PROJECT
