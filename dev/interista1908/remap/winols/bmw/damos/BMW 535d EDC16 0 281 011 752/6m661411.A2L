ASAP2_VERSION 1 3
/begin PROJECT P411 "BMW DDE6.0 6-Zylinder V66.1 07.01.2004 CAN12H"
/begin HEADER "" VERSION "V571_6Z_CAN12H" PROJECT_NO P411 /end HEADER
/begin MODULE DIM ""
/begin MOD_COMMON "" BYTE_ORDER MSB_FIRST ALIGNMENT_BYTE 1 ALIGNMENT_WORD 2 ALIGNMENT_LONG 4 ALIGNMENT_FLOAT32_IEEE 4 /end MOD_COMMON
/begin CHARACTERISTIC DSMDur_DfctDur1Mode_C "Betriebsart des globalen Fehlerdauerzählers 1" VALUE 0xCCB7C Kw_Wu8 2.000 OneToOne 0.00 2.000 FORMAT "%5.3" EXTENDED_LIMITS 0.00 255.0 /end CHARACTERISTIC
/begin CHARACTERISTIC DSMDur_DfctDur2Mode_C "Betriebsart des globalen Fehlerdauerzählers 2" VALUE 0xCCB7D Kw_Wu8 2.000 OneToOne 0.00 2.000 FORMAT "%5.3" EXTENDED_LIMITS 0.00 255.0 /end CHARACTERISTIC
/begin CHARACTERISTIC DSMDur_stDfctDur1Enable_C "Aktivierungsbedingungen für den globalen Defektdauerzähler 1" VALUE 0xCCB7E Kw_Wu8 255.0 OneToOne 0.00 255.0 FORMAT "%5.1" /end CHARACTERISTIC
/begin CHARACTERISTIC DSMDur_stDfctDur2Enable_C "Aktivierungsbedingungen für den globalen Defektdauerzähler 2" VALUE 0xCCB7F Kw_Wu8 255.0 OneToOne 0.00 255.0 FORMAT "%5.1" /end CHARACTERISTIC
/begin CHARACTERISTIC DSMDur_stDfctDur1Reset_C "Rücksetzbedingungen für den globalen Defektdauerzähler 1" VALUE 0xCCB80 Kw_Wu8 255.0 OneToOne 0.00 255.0 FORMAT "%5.1" /end CHARACTERISTIC
/begin CHARACTERISTIC DSMDur_stDfctDur2Reset_C "Rücksetzbedingungen für den globalen Defektdauerzähler 2" VALUE 0xCCB81 Kw_Wu8 255.0 OneToOne 0.00 255.0 FORMAT "%5.1" /end CHARACTERISTIC
/begin CHARACTERISTIC DSM_cnvMilKmFCM_Offset_C "Offset für Umrechnung Meilen/Kilometer beim Fehlerspeicher lesen" VALUE 0xC8E76 Kw_Ws16 65535.00 LengthKm -32768.00 32767.00 FORMAT "%8.2" /end CHARACTERISTIC
/begin CHARACTERISTIC DSM_cnvMilKmFCM_Slope_C "Slope für Umrechnung Meilen/Kilometer beim Fehlerspeicher lesen" VALUE 0xC8E78 Kw_Ws16 65.53500 SlopeRes1000 -32.76800 32.76700 FORMAT "%8.5" /end CHARACTERISTIC
/begin CHARACTERISTIC DSM_Class1Mil_C "Art der MIL Ansteuerung" VALUE 0xC8E7A Kw_Wu8 2.00000000000 Mil 0.00 2.00000000000 FORMAT "%13.11" /end CHARACTERISTIC
/begin CHARACTERISTIC DSM_Class1TFlc_C "Trigger Art für Fehlereintrags Bestätigungsentprellung (->Lampe an)" VALUE 0xC8E7B Kw_Wu8 3.00000000000 ClassTrigger 0.00 3.00000000000 FORMAT "%13.11" /end CHARACTERISTIC
/begin CHARACTERISTIC DSM_Class1Flc_C "Anzahl Triggerereignisse für Fehlereintrags Bestätigungsentprellung (->Lampe an)" VALUE 0xC8E7C Kw_Wu8 255.0 OneToOne 0.00 255.0 FORMAT "%5.1" /end CHARACTERISTIC
/begin CHARACTERISTIC DSM_Class1THlc_C "Trigger Art für Fehlerheilung (->Lampe aus)" VALUE 0xC8E7D Kw_Wu8 3.00000000000 ClassTrigger 0.00 3.00000000000 FORMAT "%13.11" /end CHARACTERISTIC
/begin CHARACTERISTIC DSM_Class1Hlc_C "Anzahl Triggerereignisse für Fehlerheilung (->Lampe aus)" VALUE 0xC8E7E Kw_Wu8 255.0 OneToOne 0.00 255.0 FORMAT "%5.1" /end CHARACTERISTIC
/begin CHARACTERISTIC DSM_Class1Scatt_C "Fehler ist lesbar für OBD Scan tool tester (SCATT) wenn Wert = 1" VALUE 0xC8E7F Kw_Wu8 1.00000000000 Scatt 0.00 1.00000000000 FORMAT "%13.11" /end CHARACTERISTIC
/begin CHARACTERISTIC DSM_Class1TDlcPen_C "Trigger Art für Löschentprellung von nicht bestätigten Fehlern (pending)" VALUE 0xC8E80 Kw_Wu8 3.00000000000 ClassTriggerTDlc 0.00 3.00000000000 FORMAT "%13.11" /end CHARACTERISTIC
/begin CHARACTERISTIC DSM_Class1DlcPen_C "Anzahl Triggerereignisse für die Löschung von nicht bestätigten Fehlern (pending)" VALUE 0xC8E81 Kw_Wu8 255.0 OneToOne 0.00 255.0 FORMAT "%5.1" /end CHARACTERISTIC
/begin CHARACTERISTIC DSM_Class1TDlc_C "Trigger Art für Löschentprellung" VALUE 0xC8E82 Kw_Wu8 3.00000000000 ClassTriggerTDlc 0.00 3.00000000000 FORMAT "%13.11" /end CHARACTERISTIC
/begin CHARACTERISTIC DSM_Class1DlcKd_C "Anzahl Triggerereignisse für die Löschung von Fehlereinträgen mit Status Kundendienst" VALUE 0xC8E83 Kw_Wu8 255.0 OneToOne 0.00 255.0 FORMAT "%5.1" /end CHARACTERISTIC
/begin CHARACTERISTIC DSM_Class1Dlc_C "Anzahl Triggerereignisse für die Löschung von Fehlereinträgen" VALUE 0xC8E84 Kw_Wu8 255.0 OneToOne 0.00 255.0 FORMAT "%5.1" /end CHARACTERISTIC
/begin CHARACTERISTIC DSM_Class1Prio_C "Priorität des Fehlereintrages für Verdrängung und freeze frame Zuordnung" VALUE 0xC8E85 Kw_Wu8 255.0 OneToOne 0.00 255.0 FORMAT "%5.1" /end CHARACTERISTIC
/begin CHARACTERISTIC DSM_Class1SysLamp_C "Art der Systemlampenansteuerung" VALUE 0xC8E86 Kw_Wu8 2.00000000000 SysLamp 0.00 2.00000000000 FORMAT "%13.11" /end CHARACTERISTIC
/begin CHARACTERISTIC DSM_Class1ResErf_C "Verhalten Fehlerflags bei Reset und abgebrochenem Nachlauf" VALUE 0xC8E87 Kw_Wu8 3.00000000000 ResErf 0.00 3.00000000000 FORMAT "%13.11" /end CHARACTERISTIC
/begin CHARACTERISTIC DSM_Class1Readiness_C "Zuordnung Entprellklasse zu Readiness Flags" VALUE 0xC8E88 Kw_Wu8 64.0000000000 Readiness 0.00 64.0000000000 FORMAT "%13.10" /end CHARACTERISTIC
/begin CHARACTERISTIC DSM_Class2Mil_C "Art der MIL Ansteuerung" VALUE 0xC8E89 Kw_Wu8 2.00000000000 Mil 0.00 2.00000000000 FORMAT "%13.11" /end CHARACTERISTIC
/begin CHARACTERISTIC DSM_Class2TFlc_C "Trigger Art für Fehlereintrags Bestätigungsentprellung (->Lampe an)" VALUE 0xC8E8A Kw_Wu8 3.00000000000 ClassTrigger 0.00 3.00000000000 FORMAT "%13.11" /end CHARACTERISTIC
/begin CHARACTERISTIC DSM_Class2Flc_C "Anzahl Triggerereignisse für Fehlereintrags Bestätigungsentprellung (->Lampe an)" VALUE 0xC8E8B Kw_Wu8 255.0 OneToOne 0.00 255.0 FORMAT "%5.1" /end CHARACTERISTIC
/begin CHARACTERISTIC DSM_Class2THlc_C "Trigger Art für Fehlerheilung (->Lampe aus)" VALUE 0xC8E8C Kw_Wu8 3.00000000000 ClassTrigger 0.00 3.00000000000 FORMAT "%13.11" /end CHARACTERISTIC
/begin CHARACTERISTIC DSM_Class2Hlc_C "Anzahl Triggerereignisse für Fehlerheilung (->Lampe aus)" VALUE 0xC8E8D Kw_Wu8 255.0 OneToOne 0.00 255.0 FORMAT "%5.1" /end CHARACTERISTIC
/begin CHARACTERISTIC DSM_Class2Scatt_C "Fehler ist lesbar für OBD Scan tool tester (SCATT) wenn Wert = 1" VALUE 0xC8E8E Kw_Wu8 1.00000000000 Scatt 0.00 1.00000000000 FORMAT "%13.11" /end CHARACTERISTIC
/begin CHARACTERISTIC DSM_Class2TDlcPen_C "Trigger Art für Löschentprellung von nicht bestätigten Fehlern (pending)" VALUE 0xC8E8F Kw_Wu8 3.00000000000 ClassTriggerTDlc 0.00 3.00000000000 FORMAT "%13.11" /end CHARACTERISTIC
/begin CHARACTERISTIC DSM_Class2DlcPen_C "Anzahl Triggerereignisse für die Löschung von nicht bestätigten Fehlern (pending)" VALUE 0xC8E90 Kw_Wu8 255.0 OneToOne 0.00 255.0 FORMAT "%5.1" /end CHARACTERISTIC
/begin CHARACTERISTIC DSM_Class2TDlc_C "Trigger Art für Löschentprellung" VALUE 0xC8E91 Kw_Wu8 3.00000000000 ClassTriggerTDlc 0.00 3.00000000000 FORMAT "%13.11" /end CHARACTERISTIC
/begin CHARACTERISTIC DSM_Class2DlcKd_C "Anzahl Triggerereignisse für die Löschung von Fehlereinträgen mit Status Kundendienst" VALUE 0xC8E92 Kw_Wu8 255.0 OneToOne 0.00 255.0 FORMAT "%5.1" /end CHARACTERISTIC
/begin CHARACTERISTIC DSM_Class2Dlc_C "Anzahl Triggerereignisse für die Löschung von Fehlereinträgen" VALUE 0xC8E93 Kw_Wu8 255.0 OneToOne 0.00 255.0 FORMAT "%5.1" /end CHARACTERISTIC
/begin CHARACTERISTIC DSM_Class2Prio_C "Priorität des Fehlereintrages für Verdrängung und freeze frame Zuordnung" VALUE 0xC8E94 Kw_Wu8 255.0 OneToOne 0.00 255.0 FORMAT "%5.1" /end CHARACTERISTIC
/begin CHARACTERISTIC DSM_Class2SysLamp_C "Art der Systemlampenansteuerung" VALUE 0xC8E95 Kw_Wu8 2.00000000000 SysLamp 0.00 2.00000000000 FORMAT "%13.11" /end CHARACTERISTIC
/begin CHARACTERISTIC DSM_Class2ResErf_C "Verhalten Fehlerflags bei Reset und abgebrochenem Nachlauf" VALUE 0xC8E96 Kw_Wu8 3.00000000000 ResErf 0.00 3.00000000000 FORMAT "%13.11" /end CHARACTERISTIC
/begin CHARACTERISTIC DSM_Class2Readiness_C "Zuordnung Entprellklasse zu Readiness Flags" VALUE 0xC8E97 Kw_Wu8 64.0000000000 Readiness 0.00 64.0000000000 FORMAT "%13.10" /end CHARACTERISTIC
/begin CHARACTERISTIC DSM_Class3Mil_C "Art der MIL Ansteuerung" VALUE 0xC8E98 Kw_Wu8 2.00000000000 Mil 0.00 2.00000000000 FORMAT "%13.11" /end CHARACTERISTIC
/begin CHARACTERISTIC DSM_Class3TFlc_C "Trigger Art für Fehlereintrags Bestätigungsentprellung (->Lampe an)" VALUE 0xC8E99 Kw_Wu8 3.00000000000 ClassTrigger 0.00 3.00000000000 FORMAT "%13.11" /end CHARACTERISTIC
/begin CHARACTERISTIC DSM_Class3Flc_C "Anzahl Triggerereignisse für Fehlereintrags Bestätigungsentprellung (->Lampe an)" VALUE 0xC8E9A Kw_Wu8 255.0 OneToOne 0.00 255.0 FORMAT "%5.1" /end CHARACTERISTIC
/begin CHARACTERISTIC DSM_Class3THlc_C "Trigger Art für Fehlerheilung (->Lampe aus)" VALUE 0xC8E9B Kw_Wu8 3.00000000000 ClassTrigger 0.00 3.00000000000 FORMAT "%13.11" /end CHARACTERISTIC
/begin CHARACTERISTIC DSM_Class3Hlc_C "Anzahl Triggerereignisse für Fehlerheilung (->Lampe aus)" VALUE 0xC8E9C Kw_Wu8 255.0 OneToOne 0.00 255.0 FORMAT "%5.1" /end CHARACTERISTIC
/begin CHARACTERISTIC DSM_Class3Scatt_C "Fehler ist lesbar für OBD Scan tool tester (SCATT) wenn Wert = 1" VALUE 0xC8E9D Kw_Wu8 1.00000000000 Scatt 0.00 1.00000000000 FORMAT "%13.11" /end CHARACTERISTIC
/begin CHARACTERISTIC DSM_Class3TDlcPen_C "Trigger Art für Löschentprellung von nicht bestätigten Fehlern (pending)" VALUE 0xC8E9E Kw_Wu8 3.00000000000 ClassTriggerTDlc 0.00 3.00000000000 FORMAT "%13.11" /end CHARACTERISTIC
/begin CHARACTERISTIC DSM_Class3DlcPen_C "Anzahl Triggerereignisse für die Löschung von nicht bestätigten Fehlern (pending)" VALUE 0xC8E9F Kw_Wu8 255.0 OneToOne 0.00 255.0 FORMAT "%5.1" /end CHARACTERISTIC
/begin CHARACTERISTIC DSM_Class3TDlc_C "Trigger Art für Löschentprellung" VALUE 0xC8EA0 Kw_Wu8 3.00000000000 ClassTriggerTDlc 0.00 3.00000000000 FORMAT "%13.11" /end CHARACTERISTIC
/begin CHARACTERISTIC DSM_Class3DlcKd_C "Anzahl Triggerereignisse für die Löschung von Fehlereinträgen mit Status Kundendienst" VALUE 0xC8EA1 Kw_Wu8 255.0 OneToOne 0.00 255.0 FORMAT "%5.1" /end CHARACTERISTIC
/begin CHARACTERISTIC DSM_Class3Dlc_C "Anzahl Triggerereignisse für die Löschung von Fehlereinträgen" VALUE 0xC8EA2 Kw_Wu8 255.0 OneToOne 0.00 255.0 FORMAT "%5.1" /end CHARACTERISTIC
/begin CHARACTERISTIC DSM_Class3Prio_C "Priorität des Fehlereintrages für Verdrängung und freeze frame Zuordnung" VALUE 0xC8EA3 Kw_Wu8 255.0 OneToOne 0.00 255.0 FORMAT "%5.1" /end CHARACTERISTIC
/begin CHARACTERISTIC DSM_Class3SysLamp_C "Art der Systemlampenansteuerung" VALUE 0xC8EA4 Kw_Wu8 2.00000000000 SysLamp 0.00 2.00000000000 FORMAT "%13.11" /end CHARACTERISTIC
/begin CHARACTERISTIC DSM_Class3ResErf_C "Verhalten Fehlerflags bei Reset und abgebrochenem Nachlauf" VALUE 0xC8EA5 Kw_Wu8 3.00000000000 ResErf 0.00 3.00000000000 FORMAT "%13.11" /end CHARACTERISTIC
/begin CHARACTERISTIC DSM_Class3Readiness_C "Zuordnung Entprellklasse zu Readiness Flags" VALUE 0xC8EA6 Kw_Wu8 64.0000000000 Readiness 0.00 64.0000000000 FORMAT "%13.10" /end CHARACTERISTIC
/begin CHARACTERISTIC DSM_Class4Mil_C "Art der MIL Ansteuerung" VALUE 0xC8EA7 Kw_Wu8 2.00000000000 Mil 0.00 2.00000000000 FORMAT "%13.11" /end CHARACTERISTIC
/begin CHARACTERISTIC DSM_Class4TFlc_C "Trigger Art für Fehlereintrags Bestätigungsentprellung (->Lampe an)" VALUE 0xC8EA8 Kw_Wu8 3.00000000000 ClassTrigger 0.00 3.00000000000 FORMAT "%13.11" /end CHARACTERISTIC
/begin CHARACTERISTIC DSM_Class4Flc_C "Anzahl Triggerereignisse für Fehlereintrags Bestätigungsentprellung (->Lampe an)" VALUE 0xC8EA9 Kw_Wu8 255.0 OneToOne 0.00 255.0 FORMAT "%5.1" /end CHARACTERISTIC
/begin CHARACTERISTIC DSM_Class4THlc_C "Trigger Art für Fehlerheilung (->Lampe aus)" VALUE 0xC8EAA Kw_Wu8 3.00000000000 ClassTrigger 0.00 3.00000000000 FORMAT "%13.11" /end CHARACTERISTIC
/begin CHARACTERISTIC DSM_Class4Hlc_C "Anzahl Triggerereignisse für Fehlerheilung (->Lampe aus)" VALUE 0xC8EAB Kw_Wu8 255.0 OneToOne 0.00 255.0 FORMAT "%5.1" /end CHARACTERISTIC
/begin CHARACTERISTIC DSM_Class4Scatt_C "Fehler ist lesbar für OBD Scan tool tester (SCATT) wenn Wert = 1" VALUE 0xC8EAC Kw_Wu8 1.00000000000 Scatt 0.00 1.00000000000 FORMAT "%13.11" /end CHARACTERISTIC
/begin CHARACTERISTIC DSM_Class4TDlcPen_C "Trigger Art für Löschentprellung von nicht bestätigten Fehlern (pending)" VALUE 0xC8EAD Kw_Wu8 3.00000000000 ClassTriggerTDlc 0.00 3.00000000000 FORMAT "%13.11" /end CHARACTERISTIC
/begin CHARACTERISTIC DSM_Class4DlcPen_C "Anzahl Triggerereignisse für die Löschung von nicht bestätigten Fehlern (pending)" VALUE 0xC8EAE Kw_Wu8 255.0 OneToOne 0.00 255.0 FORMAT "%5.1" /end CHARACTERISTIC
/begin CHARACTERISTIC DSM_Class4TDlc_C "Trigger Art für Löschentprellung" VALUE 0xC8EAF Kw_Wu8 3.00000000000 ClassTriggerTDlc 0.00 3.00000000000 FORMAT "%13.11" /end CHARACTERISTIC
/begin CHARACTERISTIC DSM_Class4DlcKd_C "Anzahl Triggerereignisse für die Löschung von Fehlereinträgen mit Status Kundendienst" VALUE 0xC8EB0 Kw_Wu8 255.0 OneToOne 0.00 255.0 FORMAT "%5.1" /end CHARACTERISTIC
/begin CHARACTERISTIC DSM_Class4Dlc_C "Anzahl Triggerereignisse für die Löschung von Fehlereinträgen" VALUE 0xC8EB1 Kw_Wu8 255.0 OneToOne 0.00 255.0 FORMAT "%5.1" /end CHARACTERISTIC
/begin CHARACTERISTIC DSM_Class4Prio_C "Priorität des Fehlereintrages für Verdrängung und freeze frame Zuordnung" VALUE 0xC8EB2 Kw_Wu8 255.0 OneToOne 0.00 255.0 FORMAT "%5.1" /end CHARACTERISTIC
/begin CHARACTERISTIC DSM_Class4SysLamp_C "Art der Systemlampenansteuerung" VALUE 0xC8EB3 Kw_Wu8 2.00000000000 SysLamp 0.00 2.00000000000 FORMAT "%13.11" /end CHARACTERISTIC
/begin CHARACTERISTIC DSM_Class4ResErf_C "Verhalten Fehlerflags bei Reset und abgebrochenem Nachlauf" VALUE 0xC8EB4 Kw_Wu8 3.00000000000 ResErf 0.00 3.00000000000 FORMAT "%13.11" /end CHARACTERISTIC
/begin CHARACTERISTIC DSM_Class4Readiness_C "Zuordnung Entprellklasse zu Readiness Flags" VALUE 0xC8EB5 Kw_Wu8 64.0000000000 Readiness 0.00 64.0000000000 FORMAT "%13.10" /end CHARACTERISTIC
/begin CHARACTERISTIC DSM_Class5Mil_C "Art der MIL Ansteuerung" VALUE 0xC8EB6 Kw_Wu8 2.00000000000 Mil 0.00 2.00000000000 FORMAT "%13.11" /end CHARACTERISTIC
/begin CHARACTERISTIC DSM_Class5TFlc_C "Trigger Art für Fehlereintrags Bestätigungsentprellung (->Lampe an)" VALUE 0xC8EB7 Kw_Wu8 3.00000000000 ClassTrigger 0.00 3.00000000000 FORMAT "%13.11" /end CHARACTERISTIC
/begin CHARACTERISTIC DSM_Class5Flc_C "Anzahl Triggerereignisse für Fehlereintrags Bestätigungsentprellung (->Lampe an)" VALUE 0xC8EB8 Kw_Wu8 255.0 OneToOne 0.00 255.0 FORMAT "%5.1" /end CHARACTERISTIC
/begin CHARACTERISTIC DSM_Class5THlc_C "Trigger Art für Fehlerheilung (->Lampe aus)" VALUE 0xC8EB9 Kw_Wu8 3.00000000000 ClassTrigger 0.00 3.00000000000 FORMAT "%13.11" /end CHARACTERISTIC
/begin CHARACTERISTIC DSM_Class5Hlc_C "Anzahl Triggerereignisse für Fehlerheilung (->Lampe aus)" VALUE 0xC8EBA Kw_Wu8 255.0 OneToOne 0.00 255.0 FORMAT "%5.1" /end CHARACTERISTIC
/begin CHARACTERISTIC DSM_Class5Scatt_C "Fehler ist lesbar für OBD Scan tool tester (SCATT) wenn Wert = 1" VALUE 0xC8EBB Kw_Wu8 1.00000000000 Scatt 0.00 1.00000000000 FORMAT "%13.11" /end CHARACTERISTIC
/begin CHARACTERISTIC DSM_Class5TDlcPen_C "Trigger Art für Löschentprellung von nicht bestätigten Fehlern (pending)" VALUE 0xC8EBC Kw_Wu8 3.00000000000 ClassTriggerTDlc 0.00 3.00000000000 FORMAT "%13.11" /end CHARACTERISTIC
/begin CHARACTERISTIC DSM_Class5DlcPen_C "Anzahl Triggerereignisse für die Löschung von nicht bestätigten Fehlern (pending)" VALUE 0xC8EBD Kw_Wu8 255.0 OneToOne 0.00 255.0 FORMAT "%5.1" /end CHARACTERISTIC
/begin CHARACTERISTIC DSM_Class5TDlc_C "Trigger Art für Löschentprellung" VALUE 0xC8EBE Kw_Wu8 3.00000000000 ClassTriggerTDlc 0.00 3.00000000000 FORMAT "%13.11" /end CHARACTERISTIC
/begin CHARACTERISTIC DSM_Class5DlcKd_C "Anzahl Triggerereignisse für die Löschung von Fehlereinträgen mit Status Kundendienst" VALUE 0xC8EBF Kw_Wu8 255.0 OneToOne 0.00 255.0 FORMAT "%5.1" /end CHARACTERISTIC
/begin CHARACTERISTIC DSM_Class5Dlc_C "Anzahl Triggerereignisse für die Löschung von Fehlereinträgen" VALUE 0xC8EC0 Kw_Wu8 255.0 OneToOne 0.00 255.0 FORMAT "%5.1" /end CHARACTERISTIC
/begin CHARACTERISTIC DSM_Class5Prio_C "Priorität des Fehlereintrages für Verdrängung und freeze frame Zuordnung" VALUE 0xC8EC1 Kw_Wu8 255.0 OneToOne 0.00 255.0 FORMAT "%5.1" /end CHARACTERISTIC
/begin CHARACTERISTIC DSM_Class5SysLamp_C "Art der Systemlampenansteuerung" VALUE 0xC8EC2 Kw_Wu8 2.00000000000 SysLamp 0.00 2.00000000000 FORMAT "%13.11" /end CHARACTERISTIC
/begin CHARACTERISTIC DSM_Class5ResErf_C "Verhalten Fehlerflags bei Reset und abgebrochenem Nachlauf" VALUE 0xC8EC3 Kw_Wu8 3.00000000000 ResErf 0.00 3.00000000000 FORMAT "%13.11" /end CHARACTERISTIC
/begin CHARACTERISTIC DSM_Class5Readiness_C "Zuordnung Entprellklasse zu Readiness Flags" VALUE 0xC8EC4 Kw_Wu8 64.0000000000 Readiness 0.00 64.0000000000 FORMAT "%13.10" /end CHARACTERISTIC
/begin CHARACTERISTIC DSM_Class6Mil_C "Art der MIL Ansteuerung" VALUE 0xC8EC5 Kw_Wu8 2.00000000000 Mil 0.00 2.00000000000 FORMAT "%13.11" /end CHARACTERISTIC
/begin CHARACTERISTIC DSM_Class6TFlc_C "Trigger Art für Fehlereintrags Bestätigungsentprellung (->Lampe an)" VALUE 0xC8EC6 Kw_Wu8 3.00000000000 ClassTrigger 0.00 3.00000000000 FORMAT "%13.11" /end CHARACTERISTIC
/begin CHARACTERISTIC DSM_Class6Flc_C "Anzahl Triggerereignisse für Fehlereintrags Bestätigungsentprellung (->Lampe an)" VALUE 0xC8EC7 Kw_Wu8 255.0 OneToOne 0.00 255.0 FORMAT "%5.1" /end CHARACTERISTIC
/begin CHARACTERISTIC DSM_Class6THlc_C "Trigger Art für Fehlerheilung (->Lampe aus)" VALUE 0xC8EC8 Kw_Wu8 3.00000000000 ClassTrigger 0.00 3.00000000000 FORMAT "%13.11" /end CHARACTERISTIC
/begin CHARACTERISTIC DSM_Class6Hlc_C "Anzahl Triggerereignisse für Fehlerheilung (->Lampe aus)" VALUE 0xC8EC9 Kw_Wu8 255.0 OneToOne 0.00 255.0 FORMAT "%5.1" /end CHARACTERISTIC
/begin CHARACTERISTIC DSM_Class6Scatt_C "Fehler ist lesbar für OBD Scan tool tester (SCATT) wenn Wert = 1" VALUE 0xC8ECA Kw_Wu8 1.00000000000 Scatt 0.00 1.00000000000 FORMAT "%13.11" /end CHARACTERISTIC
/begin CHARACTERISTIC DSM_Class6TDlcPen_C "Trigger Art für Löschentprellung von nicht bestätigten Fehlern (pending)" VALUE 0xC8ECB Kw_Wu8 3.00000000000 ClassTriggerTDlc 0.00 3.00000000000 FORMAT "%13.11" /end CHARACTERISTIC
/begin CHARACTERISTIC DSM_Class6DlcPen_C "Anzahl Triggerereignisse für die Löschung von nicht bestätigten Fehlern (pending)" VALUE 0xC8ECC Kw_Wu8 255.0 OneToOne 0.00 255.0 FORMAT "%5.1" /end CHARACTERISTIC
/begin CHARACTERISTIC DSM_Class6TDlc_C "Trigger Art für Löschentprellung" VALUE 0xC8ECD Kw_Wu8 3.00000000000 ClassTriggerTDlc 0.00 3.00000000000 FORMAT "%13.11" /end CHARACTERISTIC
/begin CHARACTERISTIC DSM_Class6DlcKd_C "Anzahl Triggerereignisse für die Löschung von Fehlereinträgen mit Status Kundendienst" VALUE 0xC8ECE Kw_Wu8 255.0 OneToOne 0.00 255.0 FORMAT "%5.1" /end CHARACTERISTIC
/begin CHARACTERISTIC DSM_Class6Dlc_C "Anzahl Triggerereignisse für die Löschung von Fehlereinträgen" VALUE 0xC8ECF Kw_Wu8 255.0 OneToOne 0.00 255.0 FORMAT "%5.1" /end CHARACTERISTIC
/begin CHARACTERISTIC DSM_Class6Prio_C "Priorität des Fehlereintrages für Verdrängung und freeze frame Zuordnung" VALUE 0xC8ED0 Kw_Wu8 255.0 OneToOne 0.00 255.0 FORMAT "%5.1" /end CHARACTERISTIC
/begin CHARACTERISTIC DSM_Class6SysLamp_C "Art der Systemlampenansteuerung" VALUE 0xC8ED1 Kw_Wu8 2.00000000000 SysLamp 0.00 2.00000000000 FORMAT "%13.11" /end CHARACTERISTIC
/begin CHARACTERISTIC DSM_Class6ResErf_C "Verhalten Fehlerflags bei Reset und abgebrochenem Nachlauf" VALUE 0xC8ED2 Kw_Wu8 3.00000000000 ResErf 0.00 3.00000000000 FORMAT "%13.11" /end CHARACTERISTIC
/begin CHARACTERISTIC DSM_Class6Readiness_C "Zuordnung Entprellklasse zu Readiness Flags" VALUE 0xC8ED3 Kw_Wu8 64.0000000000 Readiness 0.00 64.0000000000 FORMAT "%13.10" /end CHARACTERISTIC
/begin CHARACTERISTIC DSM_Class7Mil_C "Art der MIL Ansteuerung" VALUE 0xC8ED4 Kw_Wu8 2.00000000000 Mil 0.00 2.00000000000 FORMAT "%13.11" /end CHARACTERISTIC
/begin CHARACTERISTIC DSM_Class7TFlc_C "Trigger Art für Fehlereintrags Bestätigungsentprellung (->Lampe an)" VALUE 0xC8ED5 Kw_Wu8 3.00000000000 ClassTrigger 0.00 3.00000000000 FORMAT "%13.11" /end CHARACTERISTIC
/begin CHARACTERISTIC DSM_Class7Flc_C "Anzahl Triggerereignisse für Fehlereintrags Bestätigungsentprellung (->Lampe an)" VALUE 0xC8ED6 Kw_Wu8 255.0 OneToOne 0.00 255.0 FORMAT "%5.1" /end CHARACTERISTIC
/begin CHARACTERISTIC DSM_Class7THlc_C "Trigger Art für Fehlerheilung (->Lampe aus)" VALUE 0xC8ED7 Kw_Wu8 3.00000000000 ClassTrigger 0.00 3.00000000000 FORMAT "%13.11" /end CHARACTERISTIC
/begin CHARACTERISTIC DSM_Class7Hlc_C "Anzahl Triggerereignisse für Fehlerheilung (->Lampe aus)" VALUE 0xC8ED8 Kw_Wu8 255.0 OneToOne 0.00 255.0 FORMAT "%5.1" /end CHARACTERISTIC
/begin CHARACTERISTIC DSM_Class7Scatt_C "Fehler ist lesbar für OBD Scan tool tester (SCATT) wenn Wert = 1" VALUE 0xC8ED9 Kw_Wu8 1.00000000000 Scatt 0.00 1.00000000000 FORMAT "%13.11" /end CHARACTERISTIC
/begin CHARACTERISTIC DSM_Class7TDlcPen_C "Trigger Art für Löschentprellung von nicht bestätigten Fehlern (pending)" VALUE 0xC8EDA Kw_Wu8 3.00000000000 ClassTriggerTDlc 0.00 3.00000000000 FORMAT "%13.11" /end CHARACTERISTIC
/begin CHARACTERISTIC DSM_Class7DlcPen_C "Anzahl Triggerereignisse für die Löschung von nicht bestätigten Fehlern (pending)" VALUE 0xC8EDB Kw_Wu8 255.0 OneToOne 0.00 255.0 FORMAT "%5.1" /end CHARACTERISTIC
/begin CHARACTERISTIC DSM_Class7TDlc_C "Trigger Art für Löschentprellung" VALUE 0xC8EDC Kw_Wu8 3.00000000000 ClassTriggerTDlc 0.00 3.00000000000 FORMAT "%13.11" /end CHARACTERISTIC
/begin CHARACTERISTIC DSM_Class7DlcKd_C "Anzahl Triggerereignisse für die Löschung von Fehlereinträgen mit Status Kundendienst" VALUE 0xC8EDD Kw_Wu8 255.0 OneToOne 0.00 255.0 FORMAT "%5.1" /end CHARACTERISTIC
/begin CHARACTERISTIC DSM_Class7Dlc_C "Anzahl Triggerereignisse für die Löschung von Fehlereinträgen" VALUE 0xC8EDE Kw_Wu8 255.0 OneToOne 0.00 255.0 FORMAT "%5.1" /end CHARACTERISTIC
/begin CHARACTERISTIC DSM_Class7Prio_C "Priorität des Fehlereintrages für Verdrängung und freeze frame Zuordnung" VALUE 0xC8EDF Kw_Wu8 255.0 OneToOne 0.00 255.0 FORMAT "%5.1" /end CHARACTERISTIC
/begin CHARACTERISTIC DSM_Class7SysLamp_C "Art der Systemlampenansteuerung" VALUE 0xC8EE0 Kw_Wu8 2.00000000000 SysLamp 0.00 2.00000000000 FORMAT "%13.11" /end CHARACTERISTIC
/begin CHARACTERISTIC DSM_Class7ResErf_C "Verhalten Fehlerflags bei Reset und abgebrochenem Nachlauf" VALUE 0xC8EE1 Kw_Wu8 3.00000000000 ResErf 0.00 3.00000000000 FORMAT "%13.11" /end CHARACTERISTIC
/begin CHARACTERISTIC DSM_Class7Readiness_C "Zuordnung Entprellklasse zu Readiness Flags" VALUE 0xC8EE2 Kw_Wu8 64.0000000000 Readiness 0.00 64.0000000000 FORMAT "%13.10" /end CHARACTERISTIC
/begin CHARACTERISTIC DSM_Class8Mil_C "Art der MIL Ansteuerung" VALUE 0xC8EE3 Kw_Wu8 2.00000000000 Mil 0.00 2.00000000000 FORMAT "%13.11" /end CHARACTERISTIC
/begin CHARACTERISTIC DSM_Class8TFlc_C "Trigger Art für Fehlereintrags Bestätigungsentprellung (->Lampe an)" VALUE 0xC8EE4 Kw_Wu8 3.00000000000 ClassTrigger 0.00 3.00000000000 FORMAT "%13.11" /end CHARACTERISTIC
/begin CHARACTERISTIC DSM_Class8Flc_C "Anzahl Triggerereignisse für Fehlereintrags Bestätigungsentprellung (->Lampe an)" VALUE 0xC8EE5 Kw_Wu8 255.0 OneToOne 0.00 255.0 FORMAT "%5.1" /end CHARACTERISTIC
/begin CHARACTERISTIC DSM_Class8THlc_C "Trigger Art für Fehlerheilung (->Lampe aus)" VALUE 0xC8EE6 Kw_Wu8 3.00000000000 ClassTrigger 0.00 3.00000000000 FORMAT "%13.11" /end CHARACTERISTIC
/begin CHARACTERISTIC DSM_Class8Hlc_C "Anzahl Triggerereignisse für Fehlerheilung (->Lampe aus)" VALUE 0xC8EE7 Kw_Wu8 255.0 OneToOne 0.00 255.0 FORMAT "%5.1" /end CHARACTERISTIC
/begin CHARACTERISTIC DSM_Class8Scatt_C "Fehler ist lesbar für OBD Scan tool tester (SCATT) wenn Wert = 1" VALUE 0xC8EE8 Kw_Wu8 1.00000000000 Scatt 0.00 1.00000000000 FORMAT "%13.11" /end CHARACTERISTIC
/begin CHARACTERISTIC DSM_Class8TDlcPen_C "Trigger Art für Löschentprellung von nicht bestätigten Fehlern (pending)" VALUE 0xC8EE9 Kw_Wu8 3.00000000000 ClassTriggerTDlc 0.00 3.00000000000 FORMAT "%13.11" /end CHARACTERISTIC
/begin CHARACTERISTIC DSM_Class8DlcPen_C "Anzahl Triggerereignisse für die Löschung von nicht bestätigten Fehlern (pending)" VALUE 0xC8EEA Kw_Wu8 255.0 OneToOne 0.00 255.0 FORMAT "%5.1" /end CHARACTERISTIC
/begin CHARACTERISTIC DSM_Class8TDlc_C "Trigger Art für Löschentprellung" VALUE 0xC8EEB Kw_Wu8 3.00000000000 ClassTriggerTDlc 0.00 3.00000000000 FORMAT "%13.11" /end CHARACTERISTIC
/begin CHARACTERISTIC DSM_Class8DlcKd_C "Anzahl Triggerereignisse für die Löschung von Fehlereinträgen mit Status Kundendienst" VALUE 0xC8EEC Kw_Wu8 255.0 OneToOne 0.00 255.0 FORMAT "%5.1" /end CHARACTERISTIC
/begin CHARACTERISTIC DSM_Class8Dlc_C "Anzahl Triggerereignisse für die Löschung von Fehlereinträgen" VALUE 0xC8EED Kw_Wu8 255.0 OneToOne 0.00 255.0 FORMAT "%5.1" /end CHARACTERISTIC
/begin CHARACTERISTIC DSM_Class8Prio_C "Priorität des Fehlereintrages für Verdrängung und freeze frame Zuordnung" VALUE 0xC8EEE Kw_Wu8 255.0 OneToOne 0.00 255.0 FORMAT "%5.1" /end CHARACTERISTIC
/begin CHARACTERISTIC DSM_Class8SysLamp_C "Art der Systemlampenansteuerung" VALUE 0xC8EEF Kw_Wu8 2.00000000000 SysLamp 0.00 2.00000000000 FORMAT "%13.11" /end CHARACTERISTIC
/begin CHARACTERISTIC DSM_Class8ResErf_C "Verhalten Fehlerflags bei Reset und abgebrochenem Nachlauf" VALUE 0xC8EF0 Kw_Wu8 3.00000000000 ResErf 0.00 3.00000000000 FORMAT "%13.11" /end CHARACTERISTIC
/begin CHARACTERISTIC DSM_Class8Readiness_C "Zuordnung Entprellklasse zu Readiness Flags" VALUE 0xC8EF1 Kw_Wu8 64.0000000000 Readiness 0.00 64.0000000000 FORMAT "%13.10" /end CHARACTERISTIC
/begin CHARACTERISTIC DSM_Class9Mil_C "Art der MIL Ansteuerung" VALUE 0xC8EF2 Kw_Wu8 2.00000000000 Mil 0.00 2.00000000000 FORMAT "%13.11" /end CHARACTERISTIC
/begin CHARACTERISTIC DSM_Class9TFlc_C "Trigger Art für Fehlereintrags Bestätigungsentprellung (->Lampe an)" VALUE 0xC8EF3 Kw_Wu8 3.00000000000 ClassTrigger 0.00 3.00000000000 FORMAT "%13.11" /end CHARACTERISTIC
/begin CHARACTERISTIC DSM_Class9Flc_C "Anzahl Triggerereignisse für Fehlereintrags Bestätigungsentprellung (->Lampe an)" VALUE 0xC8EF4 Kw_Wu8 255.0 OneToOne 0.00 255.0 FORMAT "%5.1" /end CHARACTERISTIC
/begin CHARACTERISTIC DSM_Class9THlc_C "Trigger Art für Fehlerheilung (->Lampe aus)" VALUE 0xC8EF5 Kw_Wu8 3.00000000000 ClassTrigger 0.00 3.00000000000 FORMAT "%13.11" /end CHARACTERISTIC
/begin CHARACTERISTIC DSM_Class9Hlc_C "Anzahl Triggerereignisse für Fehlerheilung (->Lampe aus)" VALUE 0xC8EF6 Kw_Wu8 255.0 OneToOne 0.00 255.0 FORMAT "%5.1" /end CHARACTERISTIC
/begin CHARACTERISTIC DSM_Class9Scatt_C "Fehler ist lesbar für OBD Scan tool tester (SCATT) wenn Wert = 1" VALUE 0xC8EF7 Kw_Wu8 1.00000000000 Scatt 0.00 1.00000000000 FORMAT "%13.11" /end CHARACTERISTIC
/begin CHARACTERISTIC DSM_Class9TDlcPen_C "Trigger Art für Löschentprellung von nicht bestätigten Fehlern (pending)" VALUE 0xC8EF8 Kw_Wu8 3.00000000000 ClassTriggerTDlc 0.00 3.00000000000 FORMAT "%13.11" /end CHARACTERISTIC
/begin CHARACTERISTIC DSM_Class9DlcPen_C "Anzahl Triggerereignisse für die Löschung von nicht bestätigten Fehlern (pending)" VALUE 0xC8EF9 Kw_Wu8 255.0 OneToOne 0.00 255.0 FORMAT "%5.1" /end CHARACTERISTIC
/begin CHARACTERISTIC DSM_Class9TDlc_C "Trigger Art für Löschentprellung" VALUE 0xC8EFA Kw_Wu8 3.00000000000 ClassTriggerTDlc 0.00 3.00000000000 FORMAT "%13.11" /end CHARACTERISTIC
/begin CHARACTERISTIC DSM_Class9DlcKd_C "Anzahl Triggerereignisse für die Löschung von Fehlereinträgen mit Status Kundendienst" VALUE 0xC8EFB Kw_Wu8 255.0 OneToOne 0.00 255.0 FORMAT "%5.1" /end CHARACTERISTIC
/begin CHARACTERISTIC DSM_Class9Dlc_C "Anzahl Triggerereignisse für die Löschung von Fehlereinträgen" VALUE 0xC8EFC Kw_Wu8 255.0 OneToOne 0.00 255.0 FORMAT "%5.1" /end CHARACTERISTIC
/begin CHARACTERISTIC DSM_Class9Prio_C "Priorität des Fehlereintrages für Verdrängung und freeze frame Zuordnung" VALUE 0xC8EFD Kw_Wu8 255.0 OneToOne 0.00 255.0 FORMAT "%5.1" /end CHARACTERISTIC
/begin CHARACTERISTIC DSM_Class9SysLamp_C "Art der Systemlampenansteuerung" VALUE 0xC8EFE Kw_Wu8 2.00000000000 SysLamp 0.00 2.00000000000 FORMAT "%13.11" /end CHARACTERISTIC
/begin CHARACTERISTIC DSM_Class9ResErf_C "Verhalten Fehlerflags bei Reset und abgebrochenem Nachlauf" VALUE 0xC8EFF Kw_Wu8 3.00000000000 ResErf 0.00 3.00000000000 FORMAT "%13.11" /end CHARACTERISTIC
/begin CHARACTERISTIC DSM_Class9Readiness_C "Zuordnung Entprellklasse zu Readiness Flags" VALUE 0xC8F00 Kw_Wu8 64.0000000000 Readiness 0.00 64.0000000000 FORMAT "%13.10" /end CHARACTERISTIC
/begin CHARACTERISTIC DSM_Class10Mil_C "Art der MIL Ansteuerung" VALUE 0xC8F01 Kw_Wu8 2.00000000000 Mil 0.00 2.00000000000 FORMAT "%13.11" /end CHARACTERISTIC
/begin CHARACTERISTIC DSM_Class10TFlc_C "Trigger Art für Fehlereintrags Bestätigungsentprellung (->Lampe an)" VALUE 0xC8F02 Kw_Wu8 3.00000000000 ClassTrigger 0.00 3.00000000000 FORMAT "%13.11" /end CHARACTERISTIC
/begin CHARACTERISTIC DSM_Class10Flc_C "Anzahl Triggerereignisse für Fehlereintrags Bestätigungsentprellung (->Lampe an)" VALUE 0xC8F03 Kw_Wu8 255.0 OneToOne 0.00 255.0 FORMAT "%5.1" /end CHARACTERISTIC
/begin CHARACTERISTIC DSM_Class10THlc_C "Trigger Art für Fehlerheilung (->Lampe aus)" VALUE 0xC8F04 Kw_Wu8 3.00000000000 ClassTrigger 0.00 3.00000000000 FORMAT "%13.11" /end CHARACTERISTIC
/begin CHARACTERISTIC DSM_Class10Hlc_C "Anzahl Triggerereignisse für Fehlerheilung (->Lampe aus)" VALUE 0xC8F05 Kw_Wu8 255.0 OneToOne 0.00 255.0 FORMAT "%5.1" /end CHARACTERISTIC
/begin CHARACTERISTIC DSM_Class10Scatt_C "Fehler ist lesbar für OBD Scan tool tester (SCATT) wenn Wert = 1" VALUE 0xC8F06 Kw_Wu8 1.00000000000 Scatt 0.00 1.00000000000 FORMAT "%13.11" /end CHARACTERISTIC
/begin CHARACTERISTIC DSM_Class10TDlcPen_C "Trigger Art für Löschentprellung von nicht bestätigten Fehlern (pending)" VALUE 0xC8F07 Kw_Wu8 3.00000000000 ClassTriggerTDlc 0.00 3.00000000000 FORMAT "%13.11" /end CHARACTERISTIC
/begin CHARACTERISTIC DSM_Class10DlcPen_C "Anzahl Triggerereignisse für die Löschung von nicht bestätigten Fehlern (pending)" VALUE 0xC8F08 Kw_Wu8 255.0 OneToOne 0.00 255.0 FORMAT "%5.1" /end CHARACTERISTIC
/begin CHARACTERISTIC DSM_Class10TDlc_C "Trigger Art für Löschentprellung" VALUE 0xC8F09 Kw_Wu8 3.00000000000 ClassTriggerTDlc 0.00 3.00000000000 FORMAT "%13.11" /end CHARACTERISTIC
/begin CHARACTERISTIC DSM_Class10DlcKd_C "Anzahl Triggerereignisse für die Löschung von Fehlereinträgen mit Status Kundendienst" VALUE 0xC8F0A Kw_Wu8 255.0 OneToOne 0.00 255.0 FORMAT "%5.1" /end CHARACTERISTIC
/begin CHARACTERISTIC DSM_Class10Dlc_C "Anzahl Triggerereignisse für die Löschung von Fehlereinträgen" VALUE 0xC8F0B Kw_Wu8 255.0 OneToOne 0.00 255.0 FORMAT "%5.1" /end CHARACTERISTIC
/begin CHARACTERISTIC DSM_Class10Prio_C "Priorität des Fehlereintrages für Verdrängung und freeze frame Zuordnung" VALUE 0xC8F0C Kw_Wu8 255.0 OneToOne 0.00 255.0 FORMAT "%5.1" /end CHARACTERISTIC
/begin CHARACTERISTIC DSM_Class10SysLamp_C "Art der Systemlampenansteuerung" VALUE 0xC8F0D Kw_Wu8 2.00000000000 SysLamp 0.00 2.00000000000 FORMAT "%13.11" /end CHARACTERISTIC
/begin CHARACTERISTIC DSM_Class10ResErf_C "Verhalten Fehlerflags bei Reset und abgebrochenem Nachlauf" VALUE 0xC8F0E Kw_Wu8 3.00000000000 ResErf 0.00 3.00000000000 FORMAT "%13.11" /end CHARACTERISTIC
/begin CHARACTERISTIC DSM_Class10Readiness_C "Zuordnung Entprellklasse zu Readiness Flags" VALUE 0xC8F0F Kw_Wu8 64.0000000000 Readiness 0.00 64.0000000000 FORMAT "%13.10" /end CHARACTERISTIC
/begin CHARACTERISTIC DSM_Class11Mil_C "Art der MIL Ansteuerung" VALUE 0xC8F10 Kw_Wu8 2.00000000000 Mil 0.00 2.00000000000 FORMAT "%13.11" /end CHARACTERISTIC
/begin CHARACTERISTIC DSM_Class11TFlc_C "Trigger Art für Fehlereintrags Bestätigungsentprellung (->Lampe an)" VALUE 0xC8F11 Kw_Wu8 3.00000000000 ClassTrigger 0.00 3.00000000000 FORMAT "%13.11" /end CHARACTERISTIC
/begin CHARACTERISTIC DSM_Class11Flc_C "Anzahl Triggerereignisse für Fehlereintrags Bestätigungsentprellung (->Lampe an)" VALUE 0xC8F12 Kw_Wu8 255.0 OneToOne 0.00 255.0 FORMAT "%5.1" /end CHARACTERISTIC
/begin CHARACTERISTIC DSM_Class11THlc_C "Trigger Art für Fehlerheilung (->Lampe aus)" VALUE 0xC8F13 Kw_Wu8 3.00000000000 ClassTrigger 0.00 3.00000000000 FORMAT "%13.11" /end CHARACTERISTIC
/begin CHARACTERISTIC DSM_Class11Hlc_C "Anzahl Triggerereignisse für Fehlerheilung (->Lampe aus)" VALUE 0xC8F14 Kw_Wu8 255.0 OneToOne 0.00 255.0 FORMAT "%5.1" /end CHARACTERISTIC
/begin CHARACTERISTIC DSM_Class11Scatt_C "Fehler ist lesbar für OBD Scan tool tester (SCATT) wenn Wert = 1" VALUE 0xC8F15 Kw_Wu8 1.00000000000 Scatt 0.00 1.00000000000 FORMAT "%13.11" /end CHARACTERISTIC
/begin CHARACTERISTIC DSM_Class11TDlcPen_C "Trigger Art für Löschentprellung von nicht bestätigten Fehlern (pending)" VALUE 0xC8F16 Kw_Wu8 3.00000000000 ClassTriggerTDlc 0.00 3.00000000000 FORMAT "%13.11" /end CHARACTERISTIC
/begin CHARACTERISTIC DSM_Class11DlcPen_C "Anzahl Triggerereignisse für die Löschung von nicht bestätigten Fehlern (pending)" VALUE 0xC8F17 Kw_Wu8 255.0 OneToOne 0.00 255.0 FORMAT "%5.1" /end CHARACTERISTIC
/begin CHARACTERISTIC DSM_Class11TDlc_C "Trigger Art für Löschentprellung" VALUE 0xC8F18 Kw_Wu8 3.00000000000 ClassTriggerTDlc 0.00 3.00000000000 FORMAT "%13.11" /end CHARACTERISTIC
/begin CHARACTERISTIC DSM_Class11DlcKd_C "Anzahl Triggerereignisse für die Löschung von Fehlereinträgen mit Status Kundendienst" VALUE 0xC8F19 Kw_Wu8 255.0 OneToOne 0.00 255.0 FORMAT "%5.1" /end CHARACTERISTIC
/begin CHARACTERISTIC DSM_Class11Dlc_C "Anzahl Triggerereignisse für die Löschung von Fehlereinträgen" VALUE 0xC8F1A Kw_Wu8 255.0 OneToOne 0.00 255.0 FORMAT "%5.1" /end CHARACTERISTIC
/begin CHARACTERISTIC DSM_Class11Prio_C "Priorität des Fehlereintrages für Verdrängung und freeze frame Zuordnung" VALUE 0xC8F1B Kw_Wu8 255.0 OneToOne 0.00 255.0 FORMAT "%5.1" /end CHARACTERISTIC
/begin CHARACTERISTIC DSM_Class11SysLamp_C "Art der Systemlampenansteuerung" VALUE 0xC8F1C Kw_Wu8 2.00000000000 SysLamp 0.00 2.00000000000 FORMAT "%13.11" /end CHARACTERISTIC
/begin CHARACTERISTIC DSM_Class11ResErf_C "Verhalten Fehlerflags bei Reset und abgebrochenem Nachlauf" VALUE 0xC8F1D Kw_Wu8 3.00000000000 ResErf 0.00 3.00000000000 FORMAT "%13.11" /end CHARACTERISTIC
/begin CHARACTERISTIC DSM_Class11Readiness_C "Zuordnung Entprellklasse zu Readiness Flags" VALUE 0xC8F1E Kw_Wu8 64.0000000000 Readiness 0.00 64.0000000000 FORMAT "%13.10" /end CHARACTERISTIC
/begin CHARACTERISTIC DSM_Class12Mil_C "Art der MIL Ansteuerung" VALUE 0xC8F1F Kw_Wu8 2.00000000000 Mil 0.00 2.00000000000 FORMAT "%13.11" /end CHARACTERISTIC
/begin CHARACTERISTIC DSM_Class12TFlc_C "Trigger Art für Fehlereintrags Bestätigungsentprellung (->Lampe an)" VALUE 0xC8F20 Kw_Wu8 3.00000000000 ClassTrigger 0.00 3.00000000000 FORMAT "%13.11" /end CHARACTERISTIC
/begin CHARACTERISTIC DSM_Class12Flc_C "Anzahl Triggerereignisse für Fehlereintrags Bestätigungsentprellung (->Lampe an)" VALUE 0xC8F21 Kw_Wu8 255.0 OneToOne 0.00 255.0 FORMAT "%5.1" /end CHARACTERISTIC
/begin CHARACTERISTIC DSM_Class12THlc_C "Trigger Art für Fehlerheilung (->Lampe aus)" VALUE 0xC8F22 Kw_Wu8 3.00000000000 ClassTrigger 0.00 3.00000000000 FORMAT "%13.11" /end CHARACTERISTIC
/begin CHARACTERISTIC DSM_Class12Hlc_C "Anzahl Triggerereignisse für Fehlerheilung (->Lampe aus)" VALUE 0xC8F23 Kw_Wu8 255.0 OneToOne 0.00 255.0 FORMAT "%5.1" /end CHARACTERISTIC
/begin CHARACTERISTIC DSM_Class12Scatt_C "Fehler ist lesbar für OBD Scan tool tester (SCATT) wenn Wert = 1" VALUE 0xC8F24 Kw_Wu8 1.00000000000 Scatt 0.00 1.00000000000 FORMAT "%13.11" /end CHARACTERISTIC
/begin CHARACTERISTIC DSM_Class12TDlcPen_C "Trigger Art für Löschentprellung von nicht bestätigten Fehlern (pending)" VALUE 0xC8F25 Kw_Wu8 3.00000000000 ClassTriggerTDlc 0.00 3.00000000000 FORMAT "%13.11" /end CHARACTERISTIC
/begin CHARACTERISTIC DSM_Class12DlcPen_C "Anzahl Triggerereignisse für die Löschung von nicht bestätigten Fehlern (pending)" VALUE 0xC8F26 Kw_Wu8 255.0 OneToOne 0.00 255.0 FORMAT "%5.1" /end CHARACTERISTIC
/begin CHARACTERISTIC DSM_Class12TDlc_C "Trigger Art für Löschentprellung" VALUE 0xC8F27 Kw_Wu8 3.00000000000 ClassTriggerTDlc 0.00 3.00000000000 FORMAT "%13.11" /end CHARACTERISTIC
/begin CHARACTERISTIC DSM_Class12DlcKd_C "Anzahl Triggerereignisse für die Löschung von Fehlereinträgen mit Status Kundendienst" VALUE 0xC8F28 Kw_Wu8 255.0 OneToOne 0.00 255.0 FORMAT "%5.1" /end CHARACTERISTIC
/begin CHARACTERISTIC DSM_Class12Dlc_C "Anzahl Triggerereignisse für die Löschung von Fehlereinträgen" VALUE 0xC8F29 Kw_Wu8 255.0 OneToOne 0.00 255.0 FORMAT "%5.1" /end CHARACTERISTIC
/begin CHARACTERISTIC DSM_Class12Prio_C "Priorität des Fehlereintrages für Verdrängung und freeze frame Zuordnung" VALUE 0xC8F2A Kw_Wu8 255.0 OneToOne 0.00 255.0 FORMAT "%5.1" /end CHARACTERISTIC
/begin CHARACTERISTIC DSM_Class12SysLamp_C "Art der Systemlampenansteuerung" VALUE 0xC8F2B Kw_Wu8 2.00000000000 SysLamp 0.00 2.00000000000 FORMAT "%13.11" /end CHARACTERISTIC
/begin CHARACTERISTIC DSM_Class12ResErf_C "Verhalten Fehlerflags bei Reset und abgebrochenem Nachlauf" VALUE 0xC8F2C Kw_Wu8 3.00000000000 ResErf 0.00 3.00000000000 FORMAT "%13.11" /end CHARACTERISTIC
/begin CHARACTERISTIC DSM_Class12Readiness_C "Zuordnung Entprellklasse zu Readiness Flags" VALUE 0xC8F2D Kw_Wu8 64.0000000000 Readiness 0.00 64.0000000000 FORMAT "%13.10" /end CHARACTERISTIC
/begin CHARACTERISTIC DSM_Class13Mil_C "Art der MIL Ansteuerung" VALUE 0xC8F2E Kw_Wu8 2.00000000000 Mil 0.00 2.00000000000 FORMAT "%13.11" /end CHARACTERISTIC
/begin CHARACTERISTIC DSM_Class13TFlc_C "Trigger Art für Fehlereintrags Bestätigungsentprellung (->Lampe an)" VALUE 0xC8F2F Kw_Wu8 3.00000000000 ClassTrigger 0.00 3.00000000000 FORMAT "%13.11" /end CHARACTERISTIC
/begin CHARACTERISTIC DSM_Class13Flc_C "Anzahl Triggerereignisse für Fehlereintrags Bestätigungsentprellung (->Lampe an)" VALUE 0xC8F30 Kw_Wu8 255.0 OneToOne 0.00 255.0 FORMAT "%5.1" /end CHARACTERISTIC
/begin CHARACTERISTIC DSM_Class13THlc_C "Trigger Art für Fehlerheilung (->Lampe aus)" VALUE 0xC8F31 Kw_Wu8 3.00000000000 ClassTrigger 0.00 3.00000000000 FORMAT "%13.11" /end CHARACTERISTIC
/begin CHARACTERISTIC DSM_Class13Hlc_C "Anzahl Triggerereignisse für Fehlerheilung (->Lampe aus)" VALUE 0xC8F32 Kw_Wu8 255.0 OneToOne 0.00 255.0 FORMAT "%5.1" /end CHARACTERISTIC
/begin CHARACTERISTIC DSM_Class13Scatt_C "Fehler ist lesbar für OBD Scan tool tester (SCATT) wenn Wert = 1" VALUE 0xC8F33 Kw_Wu8 1.00000000000 Scatt 0.00 1.00000000000 FORMAT "%13.11" /end CHARACTERISTIC
/begin CHARACTERISTIC DSM_Class13TDlcPen_C "Trigger Art für Löschentprellung von nicht bestätigten Fehlern (pending)" VALUE 0xC8F34 Kw_Wu8 3.00000000000 ClassTriggerTDlc 0.00 3.00000000000 FORMAT "%13.11" /end CHARACTERISTIC
/begin CHARACTERISTIC DSM_Class13DlcPen_C "Anzahl Triggerereignisse für die Löschung von nicht bestätigten Fehlern (pending)" VALUE 0xC8F35 Kw_Wu8 255.0 OneToOne 0.00 255.0 FORMAT "%5.1" /end CHARACTERISTIC
/begin CHARACTERISTIC DSM_Class13TDlc_C "Trigger Art für Löschentprellung" VALUE 0xC8F36 Kw_Wu8 3.00000000000 ClassTriggerTDlc 0.00 3.00000000000 FORMAT "%13.11" /end CHARACTERISTIC
/begin CHARACTERISTIC DSM_Class13DlcKd_C "Anzahl Triggerereignisse für die Löschung von Fehlereinträgen mit Status Kundendienst" VALUE 0xC8F37 Kw_Wu8 255.0 OneToOne 0.00 255.0 FORMAT "%5.1" /end CHARACTERISTIC
/begin CHARACTERISTIC DSM_Class13Dlc_C "Anzahl Triggerereignisse für die Löschung von Fehlereinträgen" VALUE 0xC8F38 Kw_Wu8 255.0 OneToOne 0.00 255.0 FORMAT "%5.1" /end CHARACTERISTIC
/begin CHARACTERISTIC DSM_Class13Prio_C "Priorität des Fehlereintrages für Verdrängung und freeze frame Zuordnung" VALUE 0xC8F39 Kw_Wu8 255.0 OneToOne 0.00 255.0 FORMAT "%5.1" /end CHARACTERISTIC
/begin CHARACTERISTIC DSM_Class13SysLamp_C "Art der Systemlampenansteuerung" VALUE 0xC8F3A Kw_Wu8 2.00000000000 SysLamp 0.00 2.00000000000 FORMAT "%13.11" /end CHARACTERISTIC
/begin CHARACTERISTIC DSM_Class13ResErf_C "Verhalten Fehlerflags bei Reset und abgebrochenem Nachlauf" VALUE 0xC8F3B Kw_Wu8 3.00000000000 ResErf 0.00 3.00000000000 FORMAT "%13.11" /end CHARACTERISTIC
/begin CHARACTERISTIC DSM_Class13Readiness_C "Zuordnung Entprellklasse zu Readiness Flags" VALUE 0xC8F3C Kw_Wu8 64.0000000000 Readiness 0.00 64.0000000000 FORMAT "%13.10" /end CHARACTERISTIC
/begin CHARACTERISTIC DSM_Class14Mil_C "Art der MIL Ansteuerung" VALUE 0xC8F3D Kw_Wu8 2.00000000000 Mil 0.00 2.00000000000 FORMAT "%13.11" /end CHARACTERISTIC
/begin CHARACTERISTIC DSM_Class14TFlc_C "Trigger Art für Fehlereintrags Bestätigungsentprellung (->Lampe an)" VALUE 0xC8F3E Kw_Wu8 3.00000000000 ClassTrigger 0.00 3.00000000000 FORMAT "%13.11" /end CHARACTERISTIC
/begin CHARACTERISTIC DSM_Class14Flc_C "Anzahl Triggerereignisse für Fehlereintrags Bestätigungsentprellung (->Lampe an)" VALUE 0xC8F3F Kw_Wu8 255.0 OneToOne 0.00 255.0 FORMAT "%5.1" /end CHARACTERISTIC
/begin CHARACTERISTIC DSM_Class14THlc_C "Trigger Art für Fehlerheilung (->Lampe aus)" VALUE 0xC8F40 Kw_Wu8 3.00000000000 ClassTrigger 0.00 3.00000000000 FORMAT "%13.11" /end CHARACTERISTIC
/begin CHARACTERISTIC DSM_Class14Hlc_C "Anzahl Triggerereignisse für Fehlerheilung (->Lampe aus)" VALUE 0xC8F41 Kw_Wu8 255.0 OneToOne 0.00 255.0 FORMAT "%5.1" /end CHARACTERISTIC
/begin CHARACTERISTIC DSM_Class14Scatt_C "Fehler ist lesbar für OBD Scan tool tester (SCATT) wenn Wert = 1" VALUE 0xC8F42 Kw_Wu8 1.00000000000 Scatt 0.00 1.00000000000 FORMAT "%13.11" /end CHARACTERISTIC
/begin CHARACTERISTIC DSM_Class14TDlcPen_C "Trigger Art für Löschentprellung von nicht bestätigten Fehlern (pending)" VALUE 0xC8F43 Kw_Wu8 3.00000000000 ClassTriggerTDlc 0.00 3.00000000000 FORMAT "%13.11" /end CHARACTERISTIC
/begin CHARACTERISTIC DSM_Class14DlcPen_C "Anzahl Triggerereignisse für die Löschung von nicht bestätigten Fehlern (pending)" VALUE 0xC8F44 Kw_Wu8 255.0 OneToOne 0.00 255.0 FORMAT "%5.1" /end CHARACTERISTIC
/begin CHARACTERISTIC DSM_Class14TDlc_C "Trigger Art für Löschentprellung" VALUE 0xC8F45 Kw_Wu8 3.00000000000 ClassTriggerTDlc 0.00 3.00000000000 FORMAT "%13.11" /end CHARACTERISTIC
/begin CHARACTERISTIC DSM_Class14DlcKd_C "Anzahl Triggerereignisse für die Löschung von Fehlereinträgen mit Status Kundendienst" VALUE 0xC8F46 Kw_Wu8 255.0 OneToOne 0.00 255.0 FORMAT "%5.1" /end CHARACTERISTIC
/begin CHARACTERISTIC DSM_Class14Dlc_C "Anzahl Triggerereignisse für die Löschung von Fehlereinträgen" VALUE 0xC8F47 Kw_Wu8 255.0 OneToOne 0.00 255.0 FORMAT "%5.1" /end CHARACTERISTIC
/begin CHARACTERISTIC DSM_Class14Prio_C "Priorität des Fehlereintrages für Verdrängung und freeze frame Zuordnung" VALUE 0xC8F48 Kw_Wu8 255.0 OneToOne 0.00 255.0 FORMAT "%5.1" /end CHARACTERISTIC
/begin CHARACTERISTIC DSM_Class14SysLamp_C "Art der Systemlampenansteuerung" VALUE 0xC8F49 Kw_Wu8 2.00000000000 SysLamp 0.00 2.00000000000 FORMAT "%13.11" /end CHARACTERISTIC
/begin CHARACTERISTIC DSM_Class14ResErf_C "Verhalten Fehlerflags bei Reset und abgebrochenem Nachlauf" VALUE 0xC8F4A Kw_Wu8 3.00000000000 ResErf 0.00 3.00000000000 FORMAT "%13.11" /end CHARACTERISTIC
/begin CHARACTERISTIC DSM_Class14Readiness_C "Zuordnung Entprellklasse zu Readiness Flags" VALUE 0xC8F4B Kw_Wu8 64.0000000000 Readiness 0.00 64.0000000000 FORMAT "%13.10" /end CHARACTERISTIC
/begin CHARACTERISTIC DSM_Class15Mil_C "Art der MIL Ansteuerung" VALUE 0xC8F4C Kw_Wu8 2.00000000000 Mil 0.00 2.00000000000 FORMAT "%13.11" /end CHARACTERISTIC
/begin CHARACTERISTIC DSM_Class15TFlc_C "Trigger Art für Fehlereintrags Bestätigungsentprellung (->Lampe an)" VALUE 0xC8F4D Kw_Wu8 3.00000000000 ClassTrigger 0.00 3.00000000000 FORMAT "%13.11" /end CHARACTERISTIC
/begin CHARACTERISTIC DSM_Class15Flc_C "Anzahl Triggerereignisse für Fehlereintrags Bestätigungsentprellung (->Lampe an)" VALUE 0xC8F4E Kw_Wu8 255.0 OneToOne 0.00 255.0 FORMAT "%5.1" /end CHARACTERISTIC
/begin CHARACTERISTIC DSM_Class15THlc_C "Trigger Art für Fehlerheilung (->Lampe aus)" VALUE 0xC8F4F Kw_Wu8 3.00000000000 ClassTrigger 0.00 3.00000000000 FORMAT "%13.11" /end CHARACTERISTIC
/begin CHARACTERISTIC DSM_Class15Hlc_C "Anzahl Triggerereignisse für Fehlerheilung (->Lampe aus)" VALUE 0xC8F50 Kw_Wu8 255.0 OneToOne 0.00 255.0 FORMAT "%5.1" /end CHARACTERISTIC
/begin CHARACTERISTIC DSM_Class15Scatt_C "Fehler ist lesbar für OBD Scan tool tester (SCATT) wenn Wert = 1" VALUE 0xC8F51 Kw_Wu8 1.00000000000 Scatt 0.00 1.00000000000 FORMAT "%13.11" /end CHARACTERISTIC
/begin CHARACTERISTIC DSM_Class15TDlcPen_C "Trigger Art für Löschentprellung von nicht bestätigten Fehlern (pending)" VALUE 0xC8F52 Kw_Wu8 3.00000000000 ClassTriggerTDlc 0.00 3.00000000000 FORMAT "%13.11" /end CHARACTERISTIC
/begin CHARACTERISTIC DSM_Class15DlcPen_C "Anzahl Triggerereignisse für die Löschung von nicht bestätigten Fehlern (pending)" VALUE 0xC8F53 Kw_Wu8 255.0 OneToOne 0.00 255.0 FORMAT "%5.1" /end CHARACTERISTIC
/begin CHARACTERISTIC DSM_Class15TDlc_C "Trigger Art für Löschentprellung" VALUE 0xC8F54 Kw_Wu8 3.00000000000 ClassTriggerTDlc 0.00 3.00000000000 FORMAT "%13.11" /end CHARACTERISTIC
/begin CHARACTERISTIC DSM_Class15DlcKd_C "Anzahl Triggerereignisse für die Löschung von Fehlereinträgen mit Status Kundendienst" VALUE 0xC8F55 Kw_Wu8 255.0 OneToOne 0.00 255.0 FORMAT "%5.1" /end CHARACTERISTIC
/begin CHARACTERISTIC DSM_Class15Dlc_C "Anzahl Triggerereignisse für die Löschung von Fehlereinträgen" VALUE 0xC8F56 Kw_Wu8 255.0 OneToOne 0.00 255.0 FORMAT "%5.1" /end CHARACTERISTIC
/begin CHARACTERISTIC DSM_Class15Prio_C "Priorität des Fehlereintrages für Verdrängung und freeze frame Zuordnung" VALUE 0xC8F57 Kw_Wu8 255.0 OneToOne 0.00 255.0 FORMAT "%5.1" /end CHARACTERISTIC
/begin CHARACTERISTIC DSM_Class15SysLamp_C "Art der Systemlampenansteuerung" VALUE 0xC8F58 Kw_Wu8 2.00000000000 SysLamp 0.00 2.00000000000 FORMAT "%13.11" /end CHARACTERISTIC
/begin CHARACTERISTIC DSM_Class15ResErf_C "Verhalten Fehlerflags bei Reset und abgebrochenem Nachlauf" VALUE 0xC8F59 Kw_Wu8 3.00000000000 ResErf 0.00 3.00000000000 FORMAT "%13.11" /end CHARACTERISTIC
/begin CHARACTERISTIC DSM_Class15Readiness_C "Zuordnung Entprellklasse zu Readiness Flags" VALUE 0xC8F5A Kw_Wu8 64.0000000000 Readiness 0.00 64.0000000000 FORMAT "%13.10" /end CHARACTERISTIC
/begin CHARACTERISTIC DSM_Class16Mil_C "Art der MIL Ansteuerung" VALUE 0xC8F5B Kw_Wu8 2.00000000000 Mil 0.00 2.00000000000 FORMAT "%13.11" /end CHARACTERISTIC
/begin CHARACTERISTIC DSM_Class16TFlc_C "Trigger Art für Fehlereintrags Bestätigungsentprellung (->Lampe an)" VALUE 0xC8F5C Kw_Wu8 3.00000000000 ClassTrigger 0.00 3.00000000000 FORMAT "%13.11" /end CHARACTERISTIC
/begin CHARACTERISTIC DSM_Class16Flc_C "Anzahl Triggerereignisse für Fehlereintrags Bestätigungsentprellung (->Lampe an)" VALUE 0xC8F5D Kw_Wu8 255.0 OneToOne 0.00 255.0 FORMAT "%5.1" /end CHARACTERISTIC
/begin CHARACTERISTIC DSM_Class16THlc_C "Trigger Art für Fehlerheilung (->Lampe aus)" VALUE 0xC8F5E Kw_Wu8 3.00000000000 ClassTrigger 0.00 3.00000000000 FORMAT "%13.11" /end CHARACTERISTIC
/begin CHARACTERISTIC DSM_Class16Hlc_C "Anzahl Triggerereignisse für Fehlerheilung (->Lampe aus)" VALUE 0xC8F5F Kw_Wu8 255.0 OneToOne 0.00 255.0 FORMAT "%5.1" /end CHARACTERISTIC
/begin CHARACTERISTIC DSM_Class16Scatt_C "Fehler ist lesbar für OBD Scan tool tester (SCATT) wenn Wert = 1" VALUE 0xC8F60 Kw_Wu8 1.00000000000 Scatt 0.00 1.00000000000 FORMAT "%13.11" /end CHARACTERISTIC
/begin CHARACTERISTIC DSM_Class16TDlcPen_C "Trigger Art für Löschentprellung von nicht bestätigten Fehlern (pending)" VALUE 0xC8F61 Kw_Wu8 3.00000000000 ClassTriggerTDlc 0.00 3.00000000000 FORMAT "%13.11" /end CHARACTERISTIC
/begin CHARACTERISTIC DSM_Class16DlcPen_C "Anzahl Triggerereignisse für die Löschung von nicht bestätigten Fehlern (pending)" VALUE 0xC8F62 Kw_Wu8 255.0 OneToOne 0.00 255.0 FORMAT "%5.1" /end CHARACTERISTIC
/begin CHARACTERISTIC DSM_Class16TDlc_C "Trigger Art für Löschentprellung" VALUE 0xC8F63 Kw_Wu8 3.00000000000 ClassTriggerTDlc 0.00 3.00000000000 FORMAT "%13.11" /end CHARACTERISTIC
/begin CHARACTERISTIC DSM_Class16DlcKd_C "Anzahl Triggerereignisse für die Löschung von Fehlereinträgen mit Status Kundendienst" VALUE 0xC8F64 Kw_Wu8 255.0 OneToOne 0.00 255.0 FORMAT "%5.1" /end CHARACTERISTIC
/begin CHARACTERISTIC DSM_Class16Dlc_C "Anzahl Triggerereignisse für die Löschung von Fehlereinträgen" VALUE 0xC8F65 Kw_Wu8 255.0 OneToOne 0.00 255.0 FORMAT "%5.1" /end CHARACTERISTIC
/begin CHARACTERISTIC DSM_Class16Prio_C "Priorität des Fehlereintrages für Verdrängung und freeze frame Zuordnung" VALUE 0xC8F66 Kw_Wu8 255.0 OneToOne 0.00 255.0 FORMAT "%5.1" /end CHARACTERISTIC
/begin CHARACTERISTIC DSM_Class16SysLamp_C "Art der Systemlampenansteuerung" VALUE 0xC8F67 Kw_Wu8 2.00000000000 SysLamp 0.00 2.00000000000 FORMAT "%13.11" /end CHARACTERISTIC
/begin CHARACTERISTIC DSM_Class16ResErf_C "Verhalten Fehlerflags bei Reset und abgebrochenem Nachlauf" VALUE 0xC8F68 Kw_Wu8 3.00000000000 ResErf 0.00 3.00000000000 FORMAT "%13.11" /end CHARACTERISTIC
/begin CHARACTERISTIC DSM_Class16Readiness_C "Zuordnung Entprellklasse zu Readiness Flags" VALUE 0xC8F69 Kw_Wu8 64.0000000000 Readiness 0.00 64.0000000000 FORMAT "%13.10" /end CHARACTERISTIC
/begin CHARACTERISTIC DSM_Class17Mil_C "Art der MIL Ansteuerung" VALUE 0xC8F6A Kw_Wu8 2.00000000000 Mil 0.00 2.00000000000 FORMAT "%13.11" /end CHARACTERISTIC
/begin CHARACTERISTIC DSM_Class17TFlc_C "Trigger Art für Fehlereintrags Bestätigungsentprellung (->Lampe an)" VALUE 0xC8F6B Kw_Wu8 3.00000000000 ClassTrigger 0.00 3.00000000000 FORMAT "%13.11" /end CHARACTERISTIC
/begin CHARACTERISTIC DSM_Class17Flc_C "Anzahl Triggerereignisse für Fehlereintrags Bestätigungsentprellung (->Lampe an)" VALUE 0xC8F6C Kw_Wu8 255.0 OneToOne 0.00 255.0 FORMAT "%5.1" /end CHARACTERISTIC
/begin CHARACTERISTIC DSM_Class17THlc_C "Trigger Art für Fehlerheilung (->Lampe aus)" VALUE 0xC8F6D Kw_Wu8 3.00000000000 ClassTrigger 0.00 3.00000000000 FORMAT "%13.11" /end CHARACTERISTIC
/begin CHARACTERISTIC DSM_Class17Hlc_C "Anzahl Triggerereignisse für Fehlerheilung (->Lampe aus)" VALUE 0xC8F6E Kw_Wu8 255.0 OneToOne 0.00 255.0 FORMAT "%5.1" /end CHARACTERISTIC
/begin CHARACTERISTIC DSM_Class17Scatt_C "Fehler ist lesbar für OBD Scan tool tester (SCATT) wenn Wert = 1" VALUE 0xC8F6F Kw_Wu8 1.00000000000 Scatt 0.00 1.00000000000 FORMAT "%13.11" /end CHARACTERISTIC
/begin CHARACTERISTIC DSM_Class17TDlcPen_C "Trigger Art für Löschentprellung von nicht bestätigten Fehlern (pending)" VALUE 0xC8F70 Kw_Wu8 3.00000000000 ClassTriggerTDlc 0.00 3.00000000000 FORMAT "%13.11" /end CHARACTERISTIC
/begin CHARACTERISTIC DSM_Class17DlcPen_C "Anzahl Triggerereignisse für die Löschung von nicht bestätigten Fehlern (pending)" VALUE 0xC8F71 Kw_Wu8 255.0 OneToOne 0.00 255.0 FORMAT "%5.1" /end CHARACTERISTIC
/begin CHARACTERISTIC DSM_Class17TDlc_C "Trigger Art für Löschentprellung" VALUE 0xC8F72 Kw_Wu8 3.00000000000 ClassTriggerTDlc 0.00 3.00000000000 FORMAT "%13.11" /end CHARACTERISTIC
/begin CHARACTERISTIC DSM_Class17DlcKd_C "Anzahl Triggerereignisse für die Löschung von Fehlereinträgen mit Status Kundendienst" VALUE 0xC8F73 Kw_Wu8 255.0 OneToOne 0.00 255.0 FORMAT "%5.1" /end CHARACTERISTIC
/begin CHARACTERISTIC DSM_Class17Dlc_C "Anzahl Triggerereignisse für die Löschung von Fehlereinträgen" VALUE 0xC8F74 Kw_Wu8 255.0 OneToOne 0.00 255.0 FORMAT "%5.1" /end CHARACTERISTIC
/begin CHARACTERISTIC DSM_Class17Prio_C "Priorität des Fehlereintrages für Verdrängung und freeze frame Zuordnung" VALUE 0xC8F75 Kw_Wu8 255.0 OneToOne 0.00 255.0 FORMAT "%5.1" /end CHARACTERISTIC
/begin CHARACTERISTIC DSM_Class17SysLamp_C "Art der Systemlampenansteuerung" VALUE 0xC8F76 Kw_Wu8 2.00000000000 SysLamp 0.00 2.00000000000 FORMAT "%13.11" /end CHARACTERISTIC
/begin CHARACTERISTIC DSM_Class17ResErf_C "Verhalten Fehlerflags bei Reset und abgebrochenem Nachlauf" VALUE 0xC8F77 Kw_Wu8 3.00000000000 ResErf 0.00 3.00000000000 FORMAT "%13.11" /end CHARACTERISTIC
/begin CHARACTERISTIC DSM_Class17Readiness_C "Zuordnung Entprellklasse zu Readiness Flags" VALUE 0xC8F78 Kw_Wu8 64.0000000000 Readiness 0.00 64.0000000000 FORMAT "%13.10" /end CHARACTERISTIC
/begin CHARACTERISTIC DSM_Class18Mil_C "Art der MIL Ansteuerung" VALUE 0xC8F79 Kw_Wu8 2.00000000000 Mil 0.00 2.00000000000 FORMAT "%13.11" /end CHARACTERISTIC
/begin CHARACTERISTIC DSM_Class18TFlc_C "Trigger Art für Fehlereintrags Bestätigungsentprellung (->Lampe an)" VALUE 0xC8F7A Kw_Wu8 3.00000000000 ClassTrigger 0.00 3.00000000000 FORMAT "%13.11" /end CHARACTERISTIC
/begin CHARACTERISTIC DSM_Class18Flc_C "Anzahl Triggerereignisse für Fehlereintrags Bestätigungsentprellung (->Lampe an)" VALUE 0xC8F7B Kw_Wu8 255.0 OneToOne 0.00 255.0 FORMAT "%5.1" /end CHARACTERISTIC
/begin CHARACTERISTIC DSM_Class18THlc_C "Trigger Art für Fehlerheilung (->Lampe aus)" VALUE 0xC8F7C Kw_Wu8 3.00000000000 ClassTrigger 0.00 3.00000000000 FORMAT "%13.11" /end CHARACTERISTIC
/begin CHARACTERISTIC DSM_Class18Hlc_C "Anzahl Triggerereignisse für Fehlerheilung (->Lampe aus)" VALUE 0xC8F7D Kw_Wu8 255.0 OneToOne 0.00 255.0 FORMAT "%5.1" /end CHARACTERISTIC
/begin CHARACTERISTIC DSM_Class18Scatt_C "Fehler ist lesbar für OBD Scan tool tester (SCATT) wenn Wert = 1" VALUE 0xC8F7E Kw_Wu8 1.00000000000 Scatt 0.00 1.00000000000 FORMAT "%13.11" /end CHARACTERISTIC
/begin CHARACTERISTIC DSM_Class18TDlcPen_C "Trigger Art für Löschentprellung von nicht bestätigten Fehlern (pending)" VALUE 0xC8F7F Kw_Wu8 3.00000000000 ClassTriggerTDlc 0.00 3.00000000000 FORMAT "%13.11" /end CHARACTERISTIC
/begin CHARACTERISTIC DSM_Class18DlcPen_C "Anzahl Triggerereignisse für die Löschung von nicht bestätigten Fehlern (pending)" VALUE 0xC8F80 Kw_Wu8 255.0 OneToOne 0.00 255.0 FORMAT "%5.1" /end CHARACTERISTIC
/begin CHARACTERISTIC DSM_Class18TDlc_C "Trigger Art für Löschentprellung" VALUE 0xC8F81 Kw_Wu8 3.00000000000 ClassTriggerTDlc 0.00 3.00000000000 FORMAT "%13.11" /end CHARACTERISTIC
/begin CHARACTERISTIC DSM_Class18DlcKd_C "Anzahl Triggerereignisse für die Löschung von Fehlereinträgen mit Status Kundendienst" VALUE 0xC8F82 Kw_Wu8 255.0 OneToOne 0.00 255.0 FORMAT "%5.1" /end CHARACTERISTIC
/begin CHARACTERISTIC DSM_Class18Dlc_C "Anzahl Triggerereignisse für die Löschung von Fehlereinträgen" VALUE 0xC8F83 Kw_Wu8 255.0 OneToOne 0.00 255.0 FORMAT "%5.1" /end CHARACTERISTIC
/begin CHARACTERISTIC DSM_Class18Prio_C "Priorität des Fehlereintrages für Verdrängung und freeze frame Zuordnung" VALUE 0xC8F84 Kw_Wu8 255.0 OneToOne 0.00 255.0 FORMAT "%5.1" /end CHARACTERISTIC
/begin CHARACTERISTIC DSM_Class18SysLamp_C "Art der Systemlampenansteuerung" VALUE 0xC8F85 Kw_Wu8 2.00000000000 SysLamp 0.00 2.00000000000 FORMAT "%13.11" /end CHARACTERISTIC
/begin CHARACTERISTIC DSM_Class18ResErf_C "Verhalten Fehlerflags bei Reset und abgebrochenem Nachlauf" VALUE 0xC8F86 Kw_Wu8 3.00000000000 ResErf 0.00 3.00000000000 FORMAT "%13.11" /end CHARACTERISTIC
/begin CHARACTERISTIC DSM_Class18Readiness_C "Zuordnung Entprellklasse zu Readiness Flags" VALUE 0xC8F87 Kw_Wu8 64.0000000000 Readiness 0.00 64.0000000000 FORMAT "%13.10" /end CHARACTERISTIC
/begin CHARACTERISTIC DSM_Class19Mil_C "Art der MIL Ansteuerung" VALUE 0xC8F88 Kw_Wu8 2.00000000000 Mil 0.00 2.00000000000 FORMAT "%13.11" /end CHARACTERISTIC
/begin CHARACTERISTIC DSM_Class19TFlc_C "Trigger Art für Fehlereintrags Bestätigungsentprellung (->Lampe an)" VALUE 0xC8F89 Kw_Wu8 3.00000000000 ClassTrigger 0.00 3.00000000000 FORMAT "%13.11" /end CHARACTERISTIC
/begin CHARACTERISTIC DSM_Class19Flc_C "Anzahl Triggerereignisse für Fehlereintrags Bestätigungsentprellung (->Lampe an)" VALUE 0xC8F8A Kw_Wu8 255.0 OneToOne 0.00 255.0 FORMAT "%5.1" /end CHARACTERISTIC
/begin CHARACTERISTIC DSM_Class19THlc_C "Trigger Art für Fehlerheilung (->Lampe aus)" VALUE 0xC8F8B Kw_Wu8 3.00000000000 ClassTrigger 0.00 3.00000000000 FORMAT "%13.11" /end CHARACTERISTIC
/begin CHARACTERISTIC DSM_Class19Hlc_C "Anzahl Triggerereignisse für Fehlerheilung (->Lampe aus)" VALUE 0xC8F8C Kw_Wu8 255.0 OneToOne 0.00 255.0 FORMAT "%5.1" /end CHARACTERISTIC
/begin CHARACTERISTIC DSM_Class19Scatt_C "Fehler ist lesbar für OBD Scan tool tester (SCATT) wenn Wert = 1" VALUE 0xC8F8D Kw_Wu8 1.00000000000 Scatt 0.00 1.00000000000 FORMAT "%13.11" /end CHARACTERISTIC
/begin CHARACTERISTIC DSM_Class19TDlcPen_C "Trigger Art für Löschentprellung von nicht bestätigten Fehlern (pending)" VALUE 0xC8F8E Kw_Wu8 3.00000000000 ClassTriggerTDlc 0.00 3.00000000000 FORMAT "%13.11" /end CHARACTERISTIC
/begin CHARACTERISTIC DSM_Class19DlcPen_C "Anzahl Triggerereignisse für die Löschung von nicht bestätigten Fehlern (pending)" VALUE 0xC8F8F Kw_Wu8 255.0 OneToOne 0.00 255.0 FORMAT "%5.1" /end CHARACTERISTIC
/begin CHARACTERISTIC DSM_Class19TDlc_C "Trigger Art für Löschentprellung" VALUE 0xC8F90 Kw_Wu8 3.00000000000 ClassTriggerTDlc 0.00 3.00000000000 FORMAT "%13.11" /end CHARACTERISTIC
/begin CHARACTERISTIC DSM_Class19DlcKd_C "Anzahl Triggerereignisse für die Löschung von Fehlereinträgen mit Status Kundendienst" VALUE 0xC8F91 Kw_Wu8 255.0 OneToOne 0.00 255.0 FORMAT "%5.1" /end CHARACTERISTIC
/begin CHARACTERISTIC DSM_Class19Dlc_C "Anzahl Triggerereignisse für die Löschung von Fehlereinträgen" VALUE 0xC8F92 Kw_Wu8 255.0 OneToOne 0.00 255.0 FORMAT "%5.1" /end CHARACTERISTIC
/begin CHARACTERISTIC DSM_Class19Prio_C "Priorität des Fehlereintrages für Verdrängung und freeze frame Zuordnung" VALUE 0xC8F93 Kw_Wu8 255.0 OneToOne 0.00 255.0 FORMAT "%5.1" /end CHARACTERISTIC
/begin CHARACTERISTIC DSM_Class19SysLamp_C "Art der Systemlampenansteuerung" VALUE 0xC8F94 Kw_Wu8 2.00000000000 SysLamp 0.00 2.00000000000 FORMAT "%13.11" /end CHARACTERISTIC
/begin CHARACTERISTIC DSM_Class19ResErf_C "Verhalten Fehlerflags bei Reset und abgebrochenem Nachlauf" VALUE 0xC8F95 Kw_Wu8 3.00000000000 ResErf 0.00 3.00000000000 FORMAT "%13.11" /end CHARACTERISTIC
/begin CHARACTERISTIC DSM_Class19Readiness_C "Zuordnung Entprellklasse zu Readiness Flags" VALUE 0xC8F96 Kw_Wu8 64.0000000000 Readiness 0.00 64.0000000000 FORMAT "%13.10" /end CHARACTERISTIC
/begin CHARACTERISTIC DSM_Class20Mil_C "Art der MIL Ansteuerung" VALUE 0xC8F97 Kw_Wu8 2.00000000000 Mil 0.00 2.00000000000 FORMAT "%13.11" /end CHARACTERISTIC
/begin CHARACTERISTIC DSM_Class20TFlc_C "Trigger Art für Fehlereintrags Bestätigungsentprellung (->Lampe an)" VALUE 0xC8F98 Kw_Wu8 3.00000000000 ClassTrigger 0.00 3.00000000000 FORMAT "%13.11" /end CHARACTERISTIC
/begin CHARACTERISTIC DSM_Class20Flc_C "Anzahl Triggerereignisse für Fehlereintrags Bestätigungsentprellung (->Lampe an)" VALUE 0xC8F99 Kw_Wu8 255.0 OneToOne 0.00 255.0 FORMAT "%5.1" /end CHARACTERISTIC
/begin CHARACTERISTIC DSM_Class20THlc_C "Trigger Art für Fehlerheilung (->Lampe aus)" VALUE 0xC8F9A Kw_Wu8 3.00000000000 ClassTrigger 0.00 3.00000000000 FORMAT "%13.11" /end CHARACTERISTIC
/begin CHARACTERISTIC DSM_Class20Hlc_C "Anzahl Triggerereignisse für Fehlerheilung (->Lampe aus)" VALUE 0xC8F9B Kw_Wu8 255.0 OneToOne 0.00 255.0 FORMAT "%5.1" /end CHARACTERISTIC
/begin CHARACTERISTIC DSM_Class20Scatt_C "Fehler ist lesbar für OBD Scan tool tester (SCATT) wenn Wert = 1" VALUE 0xC8F9C Kw_Wu8 1.00000000000 Scatt 0.00 1.00000000000 FORMAT "%13.11" /end CHARACTERISTIC
/begin CHARACTERISTIC DSM_Class20TDlcPen_C "Trigger Art für Löschentprellung von nicht bestätigten Fehlern (pending)" VALUE 0xC8F9D Kw_Wu8 3.00000000000 ClassTriggerTDlc 0.00 3.00000000000 FORMAT "%13.11" /end CHARACTERISTIC
/begin CHARACTERISTIC DSM_Class20DlcPen_C "Anzahl Triggerereignisse für die Löschung von nicht bestätigten Fehlern (pending)" VALUE 0xC8F9E Kw_Wu8 255.0 OneToOne 0.00 255.0 FORMAT "%5.1" /end CHARACTERISTIC
/begin CHARACTERISTIC DSM_Class20TDlc_C "Trigger Art für Löschentprellung" VALUE 0xC8F9F Kw_Wu8 3.00000000000 ClassTriggerTDlc 0.00 3.00000000000 FORMAT "%13.11" /end CHARACTERISTIC
/begin CHARACTERISTIC DSM_Class20DlcKd_C "Anzahl Triggerereignisse für die Löschung von Fehlereinträgen mit Status Kundendienst" VALUE 0xC8FA0 Kw_Wu8 255.0 OneToOne 0.00 255.0 FORMAT "%5.1" /end CHARACTERISTIC
/begin CHARACTERISTIC DSM_Class20Dlc_C "Anzahl Triggerereignisse für die Löschung von Fehlereinträgen" VALUE 0xC8FA1 Kw_Wu8 255.0 OneToOne 0.00 255.0 FORMAT "%5.1" /end CHARACTERISTIC
/begin CHARACTERISTIC DSM_Class20Prio_C "Priorität des Fehlereintrages für Verdrängung und freeze frame Zuordnung" VALUE 0xC8FA2 Kw_Wu8 255.0 OneToOne 0.00 255.0 FORMAT "%5.1" /end CHARACTERISTIC
/begin CHARACTERISTIC DSM_Class20SysLamp_C "Art der Systemlampenansteuerung" VALUE 0xC8FA3 Kw_Wu8 2.00000000000 SysLamp 0.00 2.00000000000 FORMAT "%13.11" /end CHARACTERISTIC
/begin CHARACTERISTIC DSM_Class20ResErf_C "Verhalten Fehlerflags bei Reset und abgebrochenem Nachlauf" VALUE 0xC8FA4 Kw_Wu8 3.00000000000 ResErf 0.00 3.00000000000 FORMAT "%13.11" /end CHARACTERISTIC
/begin CHARACTERISTIC DSM_Class20Readiness_C "Zuordnung Entprellklasse zu Readiness Flags" VALUE 0xC8FA5 Kw_Wu8 64.0000000000 Readiness 0.00 64.0000000000 FORMAT "%13.10" /end CHARACTERISTIC
/begin CHARACTERISTIC DSM_FCMClear_C "Fehlerspeicher löschen über Label" VALUE 0xC8FA6 Kw_Wu8 1.000 OneToOne 0.00 1.000 FORMAT "%5.3" EXTENDED_LIMITS 0.00 255.0 /end CHARACTERISTIC
/begin CHARACTERISTIC DSM_FMKDfp_Layer_TANS_C "Ausblendbedingungen fuer Fehlerpfad Dfp_Layer_TANS" VALUE 0xC8FCC Kw_Wu8 255.0 OneToOne 0.00 255.0 FORMAT "%5.1" /end CHARACTERISTIC
/begin CHARACTERISTIC DSM_FMKDfp_ACCDCmpr_C "Ausblendbedingungen fuer Fehlerpfad Dfp_ACCDCmpr" VALUE 0xC8FCD Kw_Wu8 255.0 OneToOne 0.00 255.0 FORMAT "%5.1" /end CHARACTERISTIC
/begin CHARACTERISTIC DSM_FMKDfp_ACCDPres_C "Ausblendbedingungen fuer Fehlerpfad Dfp_ACCDPres" VALUE 0xC8FCE Kw_Wu8 255.0 OneToOne 0.00 255.0 FORMAT "%5.1" /end CHARACTERISTIC
/begin CHARACTERISTIC DSM_FMKDfp_ACCDPres1_C "Ausblendbedingungen fuer Fehlerpfad Dfp_ACCDPres1" VALUE 0xC8FCF Kw_Wu8 255.0 OneToOne 0.00 255.0 FORMAT "%5.1" /end CHARACTERISTIC
/begin CHARACTERISTIC DSM_FMKDfp_ACCDPresAna_C "Ausblendbedingungen fuer Fehlerpfad Dfp_ACCDPresAna" VALUE 0xC8FD0 Kw_Wu8 255.0 OneToOne 0.00 255.0 FORMAT "%5.1" /end CHARACTERISTIC
/begin CHARACTERISTIC DSM_FMKDfp_ACCDSwtin_C "Ausblendbedingungen fuer Fehlerpfad Dfp_ACCDSwtin" VALUE 0xC8FD1 Kw_Wu8 255.0 OneToOne 0.00 255.0 FORMAT "%5.1" /end CHARACTERISTIC
/begin CHARACTERISTIC DSM_FMKDfp_ACC_PlausTrqDes_C "Ausblendbedingungen fuer Fehlerpfad Dfp_ACC_PlausTrqDes" VALUE 0xC8FD2 Kw_Wu8 255.0 OneToOne 0.00 255.0 FORMAT "%5.1" /end CHARACTERISTIC
/begin CHARACTERISTIC DSM_FMKDfp_ACC_trqInr_C "Ausblendbedingungen fuer Fehlerpfad Dfp_ACC_trqInr" VALUE 0xC8FD3 Kw_Wu8 255.0 OneToOne 0.00 255.0 FORMAT "%5.1" /end CHARACTERISTIC
/begin CHARACTERISTIC DSM_FMKDfp_ACTrq_C "Ausblendbedingungen fuer Fehlerpfad Dfp_ACTrq" VALUE 0xC8FD4 Kw_Wu8 255.0 OneToOne 0.00 255.0 FORMAT "%5.1" /end CHARACTERISTIC
/begin CHARACTERISTIC DSM_FMKDfp_ADCMon_C "Ausblendbedingungen fuer Fehlerpfad Dfp_ADCMon" VALUE 0xC8FD5 Kw_Wu8 255.0 OneToOne 0.00 255.0 FORMAT "%5.1" /end CHARACTERISTIC
/begin CHARACTERISTIC DSM_FMKDfp_AFSCDIdlAdjVal_C "Ausblendbedingungen fuer Fehlerpfad Dfp_AFSCDIdlAdjVal" VALUE 0xC8FD6 Kw_Wu8 255.0 OneToOne 0.00 255.0 FORMAT "%5.1" /end CHARACTERISTIC
/begin CHARACTERISTIC DSM_FMKDfp_AFSCDLdAdjVal_C "Ausblendbedingungen fuer Fehlerpfad Dfp_AFSCDLdAdjVal" VALUE 0xC8FD7 Kw_Wu8 255.0 OneToOne 0.00 255.0 FORMAT "%5.1" /end CHARACTERISTIC
/begin CHARACTERISTIC DSM_FMKDfp_AFSCD_AirTempDcyc_C "Ausblendbedingungen fuer Fehlerpfad Dfp_AFSCD_AirTempDcyc" VALUE 0xC8FD8 Kw_Wu8 255.0 OneToOne 0.00 255.0 FORMAT "%5.1" /end CHARACTERISTIC
/begin CHARACTERISTIC DSM_FMKDfp_AFSCD_PlOffsDrft_C "Ausblendbedingungen fuer Fehlerpfad Dfp_AFSCD_PlOffsDrft" VALUE 0xC8FD9 Kw_Wu8 255.0 OneToOne 0.00 255.0 FORMAT "%5.1" /end CHARACTERISTIC
/begin CHARACTERISTIC DSM_FMKDfp_AFSCD_PlSetyDrft_C "Ausblendbedingungen fuer Fehlerpfad Dfp_AFSCD_PlSetyDrft" VALUE 0xC8FDA Kw_Wu8 255.0 OneToOne 0.00 255.0 FORMAT "%5.1" /end CHARACTERISTIC
/begin CHARACTERISTIC DSM_FMKDfp_AFSCD_SRCAirTemp_C "Ausblendbedingungen fuer Fehlerpfad Dfp_AFSCD_SRCAirTemp" VALUE 0xC8FDB Kw_Wu8 255.0 OneToOne 0.00 255.0 FORMAT "%5.1" /end CHARACTERISTIC
/begin CHARACTERISTIC DSM_FMKDfp_AFSCD_SRCBatt_C "Ausblendbedingungen fuer Fehlerpfad Dfp_AFSCD_SRCBatt" VALUE 0xC8FDC Kw_Wu8 255.0 OneToOne 0.00 255.0 FORMAT "%5.1" /end CHARACTERISTIC
/begin CHARACTERISTIC DSM_FMKDfp_AFSCD_SRCCorrAirm_C "Ausblendbedingungen fuer Fehlerpfad Dfp_AFSCD_SRCCorrAirm" VALUE 0xC8FDD Kw_Wu8 255.0 OneToOne 0.00 255.0 FORMAT "%5.1" /end CHARACTERISTIC
/begin CHARACTERISTIC DSM_FMKDfp_AFSCD_SRCRawAirm_C "Ausblendbedingungen fuer Fehlerpfad Dfp_AFSCD_SRCRawAirm" VALUE 0xC8FDE Kw_Wu8 255.0 OneToOne 0.00 255.0 FORMAT "%5.1" /end CHARACTERISTIC
/begin CHARACTERISTIC DSM_FMKDfp_Layer_TUMG_C "Ausblendbedingungen fuer Fehlerpfad Dfp_Layer_TUMG" VALUE 0xC8FDF Kw_Wu8 255.0 OneToOne 0.00 255.0 FORMAT "%5.1" /end CHARACTERISTIC
/begin CHARACTERISTIC DSM_FMKDfp_AFSCD_SRCRefSigPer_C "Ausblendbedingungen fuer Fehlerpfad Dfp_AFSCD_SRCRefSigPer" VALUE 0xC8FE0 Kw_Wu8 255.0 OneToOne 0.00 255.0 FORMAT "%5.1" /end CHARACTERISTIC
/begin CHARACTERISTIC DSM_FMKDfp_AOHtCD_C "Ausblendbedingungen fuer Fehlerpfad Dfp_AOHtCD" VALUE 0xC8FE1 Kw_Wu8 255.0 OneToOne 0.00 255.0 FORMAT "%5.1" /end CHARACTERISTIC
/begin CHARACTERISTIC DSM_FMKDfp_Layer_GEN_C "Ausblendbedingungen fuer Fehlerpfad Dfp_Layer_GEN" VALUE 0xC8FE2 Kw_Wu8 255.0 OneToOne 0.00 255.0 FORMAT "%5.1" /end CHARACTERISTIC
/begin CHARACTERISTIC DSM_FMKDfp_Layer_BSD_C "Ausblendbedingungen fuer Fehlerpfad Dfp_Layer_BSD" VALUE 0xC8FE3 Kw_Wu8 255.0 OneToOne 0.00 255.0 FORMAT "%5.1" /end CHARACTERISTIC
/begin CHARACTERISTIC DSM_FMKDfp_AOHtCD_AOHtDia1_C "Ausblendbedingungen fuer Fehlerpfad Dfp_AOHtCD_AOHtDia1" VALUE 0xC8FE4 Kw_Wu8 255.0 OneToOne 0.00 255.0 FORMAT "%5.1" /end CHARACTERISTIC
/begin CHARACTERISTIC DSM_FMKDfp_AOHtCD_AOHtDia2_C "Ausblendbedingungen fuer Fehlerpfad Dfp_AOHtCD_AOHtDia2" VALUE 0xC8FE5 Kw_Wu8 255.0 OneToOne 0.00 255.0 FORMAT "%5.1" /end CHARACTERISTIC
/begin CHARACTERISTIC DSM_FMKDfp_AOHtCD_AOHtDia3_C "Ausblendbedingungen fuer Fehlerpfad Dfp_AOHtCD_AOHtDia3" VALUE 0xC8FE6 Kw_Wu8 255.0 OneToOne 0.00 255.0 FORMAT "%5.1" /end CHARACTERISTIC
/begin CHARACTERISTIC DSM_FMKDfp_APP1_C "Ausblendbedingungen fuer Fehlerpfad Dfp_APP1" VALUE 0xC8FE7 Kw_Wu8 255.0 OneToOne 0.00 255.0 FORMAT "%5.1" /end CHARACTERISTIC
/begin CHARACTERISTIC DSM_FMKDfp_APP2_C "Ausblendbedingungen fuer Fehlerpfad Dfp_APP2" VALUE 0xC8FE8 Kw_Wu8 255.0 OneToOne 0.00 255.0 FORMAT "%5.1" /end CHARACTERISTIC
/begin CHARACTERISTIC DSM_FMKDfp_APPSync_C "Ausblendbedingungen fuer Fehlerpfad Dfp_APPSync" VALUE 0xC8FE9 Kw_Wu8 255.0 OneToOne 0.00 255.0 FORMAT "%5.1" /end CHARACTERISTIC
/begin CHARACTERISTIC DSM_FMKDfp_APSCD_C "Ausblendbedingungen fuer Fehlerpfad Dfp_APSCD" VALUE 0xC8FEA Kw_Wu8 255.0 OneToOne 0.00 255.0 FORMAT "%5.1" /end CHARACTERISTIC
/begin CHARACTERISTIC DSM_FMKDfp_ARS_C "Ausblendbedingungen fuer Fehlerpfad Dfp_ARS" VALUE 0xC8FEB Kw_Wu8 255.0 OneToOne 0.00 255.0 FORMAT "%5.1" /end CHARACTERISTIC
/begin CHARACTERISTIC DSM_FMKDfp_AccPedPlausBrk_C "Ausblendbedingungen fuer Fehlerpfad Dfp_AccPedPlausBrk" VALUE 0xC8FEC Kw_Wu8 255.0 OneToOne 0.00 255.0 FORMAT "%5.1" /end CHARACTERISTIC
/begin CHARACTERISTIC DSM_FMKDfp_AirCtlPlateBreak_C "DSM variable for Dfp_AirCtlPlateBreak_mp" VALUE 0xC8FED Kw_Wu8 255.0 OneToOne 0.00 255.0 FORMAT "%5.1" /end CHARACTERISTIC
/begin CHARACTERISTIC DSM_FMKDfp_Layer_QLT_C "Ausblendbedingungen fuer Fehlerpfad Dfp_Layer_QLT" VALUE 0xC8FEE Kw_Wu8 255.0 OneToOne 0.00 255.0 FORMAT "%5.1" /end CHARACTERISTIC
/begin CHARACTERISTIC DSM_FMKDfp_AirCtl_GovNegDev_C "Ausblendbedingungen fuer Fehlerpfad Dfp_AirCtl_GovNegDev" VALUE 0xC8FEF Kw_Wu8 255.0 OneToOne 0.00 255.0 FORMAT "%5.1" /end CHARACTERISTIC
/begin CHARACTERISTIC DSM_FMKDfp_Layer_IBS1_C "Ausblendbedingungen fuer Fehlerpfad Dfp_Layer_IBS1" VALUE 0xC8FF0 Kw_Wu8 255.0 OneToOne 0.00 255.0 FORMAT "%5.1" /end CHARACTERISTIC
/begin CHARACTERISTIC DSM_FMKDfp_Layer_IBS2_C "Ausblendbedingungen fuer Fehlerpfad Dfp_Layer_IBS2" VALUE 0xC8FF1 Kw_Wu8 255.0 OneToOne 0.00 255.0 FORMAT "%5.1" /end CHARACTERISTIC
/begin CHARACTERISTIC DSM_FMKDfp_Layer_IBS3_C "Ausblendbedingungen fuer Fehlerpfad Dfp_Layer_IBS3" VALUE 0xC8FF2 Kw_Wu8 255.0 OneToOne 0.00 255.0 FORMAT "%5.1" /end CHARACTERISTIC
/begin CHARACTERISTIC DSM_FMKDfp_Layer_PMBN_C "Ausblendbedingungen fuer Fehlerpfad Dfp_Layer_PMBN" VALUE 0xC8FF3 Kw_Wu8 255.0 OneToOne 0.00 255.0 FORMAT "%5.1" /end CHARACTERISTIC
/begin CHARACTERISTIC DSM_FMKDfp_Layer_PMBATT_C "Ausblendbedingungen fuer Fehlerpfad Dfp_Layer_PMBATT" VALUE 0xC8FF4 Kw_Wu8 255.0 OneToOne 0.00 255.0 FORMAT "%5.1" /end CHARACTERISTIC
/begin CHARACTERISTIC DSM_FMKDfp_AirCtl_GovNegDev2_C "Ausblendbedingungen fuer Fehlerpfad Dfp_AirCtl_GovNegDev2" VALUE 0xC8FF5 Kw_Wu8 255.0 OneToOne 0.00 255.0 FORMAT "%5.1" /end CHARACTERISTIC
/begin CHARACTERISTIC DSM_FMKDfp_AirCtl_GovPosDev_C "Ausblendbedingungen fuer Fehlerpfad Dfp_AirCtl_GovPosDev" VALUE 0xC8FF6 Kw_Wu8 255.0 OneToOne 0.00 255.0 FORMAT "%5.1" /end CHARACTERISTIC
/begin CHARACTERISTIC DSM_FMKDfp_AirCtl_GovPosDev2_C "Ausblendbedingungen fuer Fehlerpfad Dfp_AirCtl_GovPosDev2" VALUE 0xC8FF7 Kw_Wu8 255.0 OneToOne 0.00 255.0 FORMAT "%5.1" /end CHARACTERISTIC
/begin CHARACTERISTIC DSM_FMKDfp_AltCD_C "Ausblendbedingungen fuer Fehlerpfad Dfp_AltCD" VALUE 0xC8FF8 Kw_Wu8 255.0 OneToOne 0.00 255.0 FORMAT "%5.1" /end CHARACTERISTIC
/begin CHARACTERISTIC DSM_FMKDfp_AltCD_Load_C "Ausblendbedingungen fuer Fehlerpfad Dfp_AltCD_Load" VALUE 0xC8FF9 Kw_Wu8 255.0 OneToOne 0.00 255.0 FORMAT "%5.1" /end CHARACTERISTIC
/begin CHARACTERISTIC DSM_FMKDfp_BPACD_BPADia1_C "Ausblendbedingungen fuer Fehlerpfad Dfp_BPACD_BPADia1" VALUE 0xC8FFA Kw_Wu8 255.0 OneToOne 0.00 255.0 FORMAT "%5.1" /end CHARACTERISTIC
/begin CHARACTERISTIC DSM_FMKDfp_BPACD_BPADia2_C "Ausblendbedingungen fuer Fehlerpfad Dfp_BPACD_BPADia2" VALUE 0xC8FFB Kw_Wu8 255.0 OneToOne 0.00 255.0 FORMAT "%5.1" /end CHARACTERISTIC
/begin CHARACTERISTIC DSM_FMKDfp_BPACD_BPADia3_C "Ausblendbedingungen fuer Fehlerpfad Dfp_BPACD_BPADia3" VALUE 0xC8FFC Kw_Wu8 255.0 OneToOne 0.00 255.0 FORMAT "%5.1" /end CHARACTERISTIC
/begin CHARACTERISTIC DSM_FMKDfp_BPACD_Max_C "Ausblendbedingungen fuer Fehlerpfad Dfp_BPACD_Max" VALUE 0xC8FFD Kw_Wu8 255.0 OneToOne 0.00 255.0 FORMAT "%5.1" /end CHARACTERISTIC
/begin CHARACTERISTIC DSM_FMKDfp_BPACD_Min_C "Ausblendbedingungen fuer Fehlerpfad Dfp_BPACD_Min" VALUE 0xC8FFE Kw_Wu8 255.0 OneToOne 0.00 255.0 FORMAT "%5.1" /end CHARACTERISTIC
/begin CHARACTERISTIC DSM_FMKDfp_BPACD_SigNpl_C "Ausblendbedingungen fuer Fehlerpfad Dfp_BPACD_SigNpl" VALUE 0xC8FFF Kw_Wu8 255.0 OneToOne 0.00 255.0 FORMAT "%5.1" /end CHARACTERISTIC
/begin CHARACTERISTIC DSM_FMKDfp_BPSCD_C "Ausblendbedingungen fuer Fehlerpfad Dfp_BPSCD" VALUE 0xC9000 Kw_Wu8 255.0 OneToOne 0.00 255.0 FORMAT "%5.1" /end CHARACTERISTIC
/begin CHARACTERISTIC DSM_FMKDfp_BattCD_C "Ausblendbedingungen fuer Fehlerpfad Dfp_BattCD" VALUE 0xC9001 Kw_Wu8 255.0 OneToOne 0.00 255.0 FORMAT "%5.1" /end CHARACTERISTIC
/begin CHARACTERISTIC DSM_FMKDfp_BrkCD_C "Ausblendbedingungen fuer Fehlerpfad Dfp_BrkCD" VALUE 0xC9002 Kw_Wu8 255.0 OneToOne 0.00 255.0 FORMAT "%5.1" /end CHARACTERISTIC
/begin CHARACTERISTIC DSM_FMKDfp_Bss_C "Ausblendbedingungen fuer Fehlerpfad Dfp_Bss" VALUE 0xC9003 Kw_Wu8 255.0 OneToOne 0.00 255.0 FORMAT "%5.1" /end CHARACTERISTIC
/begin CHARACTERISTIC DSM_FMKDfp_CBACD_C "Ausblendbedingungen fuer Fehlerpfad Dfp_CBACD" VALUE 0xC9004 Kw_Wu8 255.0 OneToOne 0.00 255.0 FORMAT "%5.1" /end CHARACTERISTIC
/begin CHARACTERISTIC DSM_FMKDfp_CTSCD_C "Ausblendbedingungen fuer Fehlerpfad Dfp_CTSCD" VALUE 0xC9005 Kw_Wu8 255.0 OneToOne 0.00 255.0 FORMAT "%5.1" /end CHARACTERISTIC
/begin CHARACTERISTIC DSM_FMKDfp_Clg_DynTst_C "Ausblendbedingungen fuer Fehlerpfad Dfp_Clg_DynTst" VALUE 0xC9006 Kw_Wu8 255.0 OneToOne 0.00 255.0 FORMAT "%5.1" /end CHARACTERISTIC
/begin CHARACTERISTIC DSM_FMKDfp_CmbChbMisfire1_C "Ausblendbedingungen fuer Fehlerpfad Dfp_CmbChbMisfire1" VALUE 0xC9007 Kw_Wu8 255.0 OneToOne 0.00 255.0 FORMAT "%5.1" /end CHARACTERISTIC
/begin CHARACTERISTIC DSM_FMKDfp_CmbChbMisfire2_C "Ausblendbedingungen fuer Fehlerpfad Dfp_CmbChbMisfire2" VALUE 0xC9008 Kw_Wu8 255.0 OneToOne 0.00 255.0 FORMAT "%5.1" /end CHARACTERISTIC
/begin CHARACTERISTIC DSM_FMKDfp_CmbChbMisfire3_C "Ausblendbedingungen fuer Fehlerpfad Dfp_CmbChbMisfire3" VALUE 0xC9009 Kw_Wu8 255.0 OneToOne 0.00 255.0 FORMAT "%5.1" /end CHARACTERISTIC
/begin CHARACTERISTIC DSM_FMKDfp_CmbChbMisfire4_C "Ausblendbedingungen fuer Fehlerpfad Dfp_CmbChbMisfire4" VALUE 0xC900A Kw_Wu8 255.0 OneToOne 0.00 255.0 FORMAT "%5.1" /end CHARACTERISTIC
/begin CHARACTERISTIC DSM_FMKDfp_CmbChbMisfire5_C "Ausblendbedingungen fuer Fehlerpfad Dfp_CmbChbMisfire5" VALUE 0xC900B Kw_Wu8 255.0 OneToOne 0.00 255.0 FORMAT "%5.1" /end CHARACTERISTIC
/begin CHARACTERISTIC DSM_FMKDfp_CmbChbMisfire6_C "Ausblendbedingungen fuer Fehlerpfad Dfp_CmbChbMisfire6" VALUE 0xC900C Kw_Wu8 255.0 OneToOne 0.00 255.0 FORMAT "%5.1" /end CHARACTERISTIC
/begin CHARACTERISTIC DSM_FMKDfp_CmbChbMisfireMul_C "Ausblendbedingungen fuer Fehlerpfad Dfp_CmbChbMisfireMul" VALUE 0xC900D Kw_Wu8 255.0 OneToOne 0.00 255.0 FORMAT "%5.1" /end CHARACTERISTIC
/begin CHARACTERISTIC DSM_FMKDfp_CoVMDCSh_C "Ausblendbedingungen fuer Fehlerpfad Dfp_CoVMDCSh" VALUE 0xC900E Kw_Wu8 255.0 OneToOne 0.00 255.0 FORMAT "%5.1" /end CHARACTERISTIC
/begin CHARACTERISTIC DSM_FMKDfp_ConvCD_C "Ausblendbedingungen fuer Fehlerpfad Dfp_ConvCD" VALUE 0xC900F Kw_Wu8 255.0 OneToOne 0.00 255.0 FORMAT "%5.1" /end CHARACTERISTIC
/begin CHARACTERISTIC DSM_FMKDfp_CrCCDMFL_C "Ausblendbedingungen fuer Fehlerpfad Dfp_CrCCDMFL" VALUE 0xC9010 Kw_Wu8 255.0 OneToOne 0.00 255.0 FORMAT "%5.1" /end CHARACTERISTIC
/begin CHARACTERISTIC DSM_FMKDfp_CrCtl_vCrCtl_C "Ausblendbedingungen fuer Fehlerpfad Dfp_CrCtl_vCrCtl" VALUE 0xC9011 Kw_Wu8 255.0 OneToOne 0.00 255.0 FORMAT "%5.1" /end CHARACTERISTIC
/begin CHARACTERISTIC DSM_FMKDfp_Dummy1_C "Ausblendbedingungen fuer Fehlerpfad Dfp_Dummy1" VALUE 0xC9012 Kw_Wu8 255.0 OneToOne 0.00 255.0 FORMAT "%5.1" /end CHARACTERISTIC
/begin CHARACTERISTIC DSM_FMKDfp_EATSCD_C "Ausblendbedingungen fuer Fehlerpfad Dfp_EATSCD" VALUE 0xC9013 Kw_Wu8 255.0 OneToOne 0.00 255.0 FORMAT "%5.1" /end CHARACTERISTIC
/begin CHARACTERISTIC DSM_FMKDfp_EBAFCD_C "Ausblendbedingungen fuer Fehlerpfad Dfp_EBAFCD" VALUE 0xC9014 Kw_Wu8 255.0 OneToOne 0.00 255.0 FORMAT "%5.1" /end CHARACTERISTIC
/begin CHARACTERISTIC DSM_FMKDfp_Layer_PMRUHVERL_C "Ausblendbedingungen fuer Fehlerpfad Dfp_Layer_PMRUHVERL" VALUE 0xC9015 Kw_Wu8 255.0 OneToOne 0.00 255.0 FORMAT "%5.1" /end CHARACTERISTIC
/begin CHARACTERISTIC DSM_FMKDfp_EBFCD_C "Ausblendbedingungen fuer Fehlerpfad Dfp_EBFCD" VALUE 0xC9016 Kw_Wu8 255.0 OneToOne 0.00 255.0 FORMAT "%5.1" /end CHARACTERISTIC
/begin CHARACTERISTIC DSM_FMKDfp_EBTSCD_C "Ausblendbedingungen fuer Fehlerpfad Dfp_EBTSCD" VALUE 0xC9017 Kw_Wu8 255.0 OneToOne 0.00 255.0 FORMAT "%5.1" /end CHARACTERISTIC
/begin CHARACTERISTIC DSM_FMKDfp_EBTSCD_OvrTemp_C "Ausblendbedingungen fuer Fehlerpfad Dfp_EBTSCD_OvrTemp" VALUE 0xC9018 Kw_Wu8 255.0 OneToOne 0.00 255.0 FORMAT "%5.1" /end CHARACTERISTIC
/begin CHARACTERISTIC DSM_FMKDfp_EEPCDVarMng_C "Ausblendbedingungen fuer Fehlerpfad Dfp_EEPCDVarMng" VALUE 0xC9019 Kw_Wu8 255.0 OneToOne 0.00 255.0 FORMAT "%5.1" /end CHARACTERISTIC
/begin CHARACTERISTIC DSM_FMKDfp_Layer_TOENS_C "Ausblendbedingungen fuer Fehlerpfad Dfp_Layer_TOENS" VALUE 0xC901A Kw_Wu8 255.0 OneToOne 0.00 255.0 FORMAT "%5.1" /end CHARACTERISTIC
/begin CHARACTERISTIC DSM_FMKDfp_Layer_MANHYDR_C "Ausblendbedingungen fuer Fehlerpfad Dfp_Layer_MANHYDR" VALUE 0xC901B Kw_Wu8 255.0 OneToOne 0.00 255.0 FORMAT "%5.1" /end CHARACTERISTIC
/begin CHARACTERISTIC DSM_FMKDfp_Layer_MANLUFT_C "Ausblendbedingungen fuer Fehlerpfad Dfp_Layer_MANLUFT" VALUE 0xC901C Kw_Wu8 255.0 OneToOne 0.00 255.0 FORMAT "%5.1" /end CHARACTERISTIC
/begin CHARACTERISTIC DSM_FMKDfp_EGPpCD_C "Ausblendbedingungen fuer Fehlerpfad Dfp_EGPpCD" VALUE 0xC901D Kw_Wu8 255.0 OneToOne 0.00 255.0 FORMAT "%5.1" /end CHARACTERISTIC
/begin CHARACTERISTIC DSM_FMKDfp_EGPpCDTPreTrbn_C "Ausblendbedingungen fuer Fehlerpfad Dfp_EgPpCDTPreTrbn" VALUE 0xC901E Kw_Wu8 255.0 OneToOne 0.00 255.0 FORMAT "%5.1" /end CHARACTERISTIC
/begin CHARACTERISTIC DSM_FMKDfp_EGRCD_Max_C "Ausblendbedingungen fuer Fehlerpfad Dfp_EGRCD_Max" VALUE 0xC901F Kw_Wu8 255.0 OneToOne 0.00 255.0 FORMAT "%5.1" /end CHARACTERISTIC
/begin CHARACTERISTIC DSM_FMKDfp_EGRCD_Min_C "Ausblendbedingungen fuer Fehlerpfad Dfp_EGRCD_Min" VALUE 0xC9020 Kw_Wu8 255.0 OneToOne 0.00 255.0 FORMAT "%5.1" /end CHARACTERISTIC
/begin CHARACTERISTIC DSM_FMKDfp_EGRCD_SigNpl_C "Ausblendbedingungen fuer Fehlerpfad Dfp_EGRCD_SigNpl" VALUE 0xC9021 Kw_Wu8 255.0 OneToOne 0.00 255.0 FORMAT "%5.1" /end CHARACTERISTIC
/begin CHARACTERISTIC DSM_FMKDfp_EGTRgnOilDil_C "Ausblendbedingungen fuer Fehlerpfad Dfp_EGTRgnOilDil" VALUE 0xC9022 Kw_Wu8 255.0 OneToOne 0.00 255.0 FORMAT "%5.1" /end CHARACTERISTIC
/begin CHARACTERISTIC DSM_FMKDfp_EMCCDNoLoad1_C "" VALUE 0xC9023 Kw_Wu8 255.0 OneToOne 0.00 255.0 FORMAT "%5.1" /end CHARACTERISTIC
/begin CHARACTERISTIC DSM_FMKDfp_EMCCDNoLoad2_C "" VALUE 0xC9024 Kw_Wu8 255.0 OneToOne 0.00 255.0 FORMAT "%5.1" /end CHARACTERISTIC
/begin CHARACTERISTIC DSM_FMKDfp_EMCCDSCBat1_C "" VALUE 0xC9025 Kw_Wu8 255.0 OneToOne 0.00 255.0 FORMAT "%5.1" /end CHARACTERISTIC
/begin CHARACTERISTIC DSM_FMKDfp_EMCCDSCBat2_C "" VALUE 0xC9026 Kw_Wu8 255.0 OneToOne 0.00 255.0 FORMAT "%5.1" /end CHARACTERISTIC
/begin CHARACTERISTIC DSM_FMKDfp_EMCCDSCGnd1_C "" VALUE 0xC9027 Kw_Wu8 255.0 OneToOne 0.00 255.0 FORMAT "%5.1" /end CHARACTERISTIC
/begin CHARACTERISTIC DSM_FMKDfp_EMCCDSCGnd2_C "" VALUE 0xC9028 Kw_Wu8 255.0 OneToOne 0.00 255.0 FORMAT "%5.1" /end CHARACTERISTIC
/begin CHARACTERISTIC DSM_FMKDfp_EMCCD_ADC1_C "" VALUE 0xC9029 Kw_Wu8 255.0 OneToOne 0.00 255.0 FORMAT "%5.1" /end CHARACTERISTIC
/begin CHARACTERISTIC DSM_FMKDfp_EMCCD_ADC2_C "" VALUE 0xC902A Kw_Wu8 255.0 OneToOne 0.00 255.0 FORMAT "%5.1" /end CHARACTERISTIC
/begin CHARACTERISTIC DSM_FMKDfp_ETClbETFltInj1_C "Ausblendbedingungen fuer Fehlerpfad Dfp_ETClbETFltInj1" VALUE 0xC902B Kw_Wu8 255.0 OneToOne 0.00 255.0 FORMAT "%5.1" /end CHARACTERISTIC
/begin CHARACTERISTIC DSM_FMKDfp_ETClbETFltInj2_C "Ausblendbedingungen fuer Fehlerpfad Dfp_ETClbETFltInj2" VALUE 0xC902C Kw_Wu8 255.0 OneToOne 0.00 255.0 FORMAT "%5.1" /end CHARACTERISTIC
/begin CHARACTERISTIC DSM_FMKDfp_ETClbETFltInj3_C "Ausblendbedingungen fuer Fehlerpfad Dfp_ETClbETFltInj3" VALUE 0xC902D Kw_Wu8 255.0 OneToOne 0.00 255.0 FORMAT "%5.1" /end CHARACTERISTIC
/begin CHARACTERISTIC DSM_FMKDfp_ETClbETFltInj4_C "Ausblendbedingungen fuer Fehlerpfad Dfp_ETClbETFltInj4" VALUE 0xC902E Kw_Wu8 255.0 OneToOne 0.00 255.0 FORMAT "%5.1" /end CHARACTERISTIC
/begin CHARACTERISTIC DSM_FMKDfp_ETClbETFltInj5_C "Ausblendbedingungen fuer Fehlerpfad Dfp_ETClbETFltInj5" VALUE 0xC902F Kw_Wu8 255.0 OneToOne 0.00 255.0 FORMAT "%5.1" /end CHARACTERISTIC
/begin CHARACTERISTIC DSM_FMKDfp_ETClbETFltInj6_C "Ausblendbedingungen fuer Fehlerpfad Dfp_ETClbETFltInj6" VALUE 0xC9030 Kw_Wu8 255.0 OneToOne 0.00 255.0 FORMAT "%5.1" /end CHARACTERISTIC
/begin CHARACTERISTIC DSM_FMKDfp_ETClbInj1_C "Ausblendbedingungen fuer Fehlerpfad Dfp_ETClbInj1" VALUE 0xC9031 Kw_Wu8 255.0 OneToOne 0.00 255.0 FORMAT "%5.1" /end CHARACTERISTIC
/begin CHARACTERISTIC DSM_FMKDfp_ETClbInj2_C "Ausblendbedingungen fuer Fehlerpfad Dfp_ETClbInj2" VALUE 0xC9032 Kw_Wu8 255.0 OneToOne 0.00 255.0 FORMAT "%5.1" /end CHARACTERISTIC
/begin CHARACTERISTIC DSM_FMKDfp_ETClbInj3_C "Ausblendbedingungen fuer Fehlerpfad Dfp_ETClbInj3" VALUE 0xC9033 Kw_Wu8 255.0 OneToOne 0.00 255.0 FORMAT "%5.1" /end CHARACTERISTIC
/begin CHARACTERISTIC DSM_FMKDfp_ETClbInj4_C "Ausblendbedingungen fuer Fehlerpfad Dfp_ETClbInj4" VALUE 0xC9034 Kw_Wu8 255.0 OneToOne 0.00 255.0 FORMAT "%5.1" /end CHARACTERISTIC
/begin CHARACTERISTIC DSM_FMKDfp_ETClbInj5_C "Ausblendbedingungen fuer Fehlerpfad Dfp_ETClbInj5" VALUE 0xC9035 Kw_Wu8 255.0 OneToOne 0.00 255.0 FORMAT "%5.1" /end CHARACTERISTIC
/begin CHARACTERISTIC DSM_FMKDfp_ETClbInj6_C "Ausblendbedingungen fuer Fehlerpfad Dfp_ETClbInj6" VALUE 0xC9036 Kw_Wu8 255.0 OneToOne 0.00 255.0 FORMAT "%5.1" /end CHARACTERISTIC
/begin CHARACTERISTIC DSM_FMKDfp_EngMCaS1_C "Ausblendbedingungen fuer Fehlerpfad Dfp_EngMCaS1" VALUE 0xC9037 Kw_Wu8 255.0 OneToOne 0.00 255.0 FORMAT "%5.1" /end CHARACTERISTIC
/begin CHARACTERISTIC DSM_FMKDfp_EngMCrS1_C "Ausblendbedingungen fuer Fehlerpfad Dfp_EngMCrS1" VALUE 0xC9038 Kw_Wu8 255.0 OneToOne 0.00 255.0 FORMAT "%5.1" /end CHARACTERISTIC
/begin CHARACTERISTIC DSM_FMKDfp_EngMOfsCaSCrS_C "Ausblendbedingungen fuer Fehlerpfad Dfp_EngMOfsCaSCrS" VALUE 0xC9039 Kw_Wu8 255.0 OneToOne 0.00 255.0 FORMAT "%5.1" /end CHARACTERISTIC
/begin CHARACTERISTIC DSM_FMKDfp_EngPrtFWODet_C "Ausblendbedingungen fuer Fehlerpfad Dfp_EngPrtFWODet" VALUE 0xC903A Kw_Wu8 255.0 OneToOne 0.00 255.0 FORMAT "%5.1" /end CHARACTERISTIC
/begin CHARACTERISTIC DSM_FMKDfp_FBCqDvt_C "Ausblendbedingungen fuer Fehlerpfad Dfp_FBCqDvt" VALUE 0xC903B Kw_Wu8 255.0 OneToOne 0.00 255.0 FORMAT "%5.1" /end CHARACTERISTIC
/begin CHARACTERISTIC DSM_FMKDfp_FMTC_NonMonotonMap_C "Ausblendbedingungen fuer Fehlerpfad Dfp_FMTC_NonMonotonMap" VALUE 0xC903C Kw_Wu8 255.0 OneToOne 0.00 255.0 FORMAT "%5.1" /end CHARACTERISTIC
/begin CHARACTERISTIC DSM_FMKDfp_FTSCD_C "Ausblendbedingungen fuer Fehlerpfad Dfp_FTSCD" VALUE 0xC903D Kw_Wu8 255.0 OneToOne 0.00 255.0 FORMAT "%5.1" /end CHARACTERISTIC
/begin CHARACTERISTIC DSM_FMKDfp_FanCD_C "Ausblendbedingungen fuer Fehlerpfad Dfp_FanCD" VALUE 0xC903E Kw_Wu8 255.0 OneToOne 0.00 255.0 FORMAT "%5.1" /end CHARACTERISTIC
/begin CHARACTERISTIC DSM_FMKDfp_FanCD_FanCtlr1_C "Ausblendbedingungen fuer Fehlerpfad Dfp_FanCD_FanCtlr1" VALUE 0xC903F Kw_Wu8 255.0 OneToOne 0.00 255.0 FORMAT "%5.1" /end CHARACTERISTIC
/begin CHARACTERISTIC DSM_FMKDfp_FanCD_FanCtlr2_C "Ausblendbedingungen fuer Fehlerpfad Dfp_FanCD_FanCtlr2" VALUE 0xC9040 Kw_Wu8 255.0 OneToOne 0.00 255.0 FORMAT "%5.1" /end CHARACTERISTIC
/begin CHARACTERISTIC DSM_FMKDfp_FanCD_FanCtlr3_C "Ausblendbedingungen fuer Fehlerpfad Dfp_FanCD_FanCtlr3" VALUE 0xC9041 Kw_Wu8 255.0 OneToOne 0.00 255.0 FORMAT "%5.1" /end CHARACTERISTIC
/begin CHARACTERISTIC DSM_FMKDfp_FlFCD_C "Ausblendbedingungen fuer Fehlerpfad Dfp_FlFCD" VALUE 0xC9042 Kw_Wu8 255.0 OneToOne 0.00 255.0 FORMAT "%5.1" /end CHARACTERISTIC
/begin CHARACTERISTIC DSM_FMKDfp_FlMngSmkDefect_C "Ausblendbedingungen fuer Fehlerpfad Dfp_FlMngSmkDefect" VALUE 0xC9043 Kw_Wu8 255.0 OneToOne 0.00 255.0 FORMAT "%5.1" /end CHARACTERISTIC
/begin CHARACTERISTIC DSM_FMKDfp_FrmMngASC1_C "Ausblendbedingungen fuer Fehlerpfad Dfp_FrmMngASC1" VALUE 0xC9044 Kw_Wu8 255.0 OneToOne 0.00 255.0 FORMAT "%5.1" /end CHARACTERISTIC
/begin CHARACTERISTIC DSM_FMKDfp_FrmMngASC2_C "Ausblendbedingungen fuer Fehlerpfad Dfp_FrmMngASC2" VALUE 0xC9045 Kw_Wu8 255.0 OneToOne 0.00 255.0 FORMAT "%5.1" /end CHARACTERISTIC
/begin CHARACTERISTIC DSM_FMKDfp_FrmMngASC3_C "Ausblendbedingungen fuer Fehlerpfad Dfp_FrmMngASC3" VALUE 0xC9046 Kw_Wu8 255.0 OneToOne 0.00 255.0 FORMAT "%5.1" /end CHARACTERISTIC
/begin CHARACTERISTIC DSM_FMKDfp_FrmMngASC4_C "Ausblendbedingungen fuer Fehlerpfad Dfp_FrmMngASC4" VALUE 0xC9047 Kw_Wu8 255.0 OneToOne 0.00 255.0 FORMAT "%5.1" /end CHARACTERISTIC
/begin CHARACTERISTIC DSM_FMKDfp_FrmMngBOS_RESET_C "Ausblendbedingungen fuer Fehlerpfad Dfp_FrmMngBOS_RESET" VALUE 0xC9048 Kw_Wu8 255.0 OneToOne 0.00 255.0 FORMAT "%5.1" /end CHARACTERISTIC
/begin CHARACTERISTIC DSM_FMKDfp_FrmMngBOS_RESET_2_C "" VALUE 0xC9049 Kw_Wu8 255.0 OneToOne 0.00 255.0 FORMAT "%5.1" /end CHARACTERISTIC
/begin CHARACTERISTIC DSM_FMKDfp_FrmMngDMANFAFS_C "Ausblendbedingungen fuer Fehlerpfad Dfp_FrmMngDMANFAFS" VALUE 0xC904A Kw_Wu8 255.0 OneToOne 0.00 255.0 FORMAT "%5.1" /end CHARACTERISTIC
/begin CHARACTERISTIC DSM_FMKDfp_FrmMngDRMANFSSG_C "Ausblendbedingungen fuer Fehlerpfad Dfp_FrmMngDRMANFSSG" VALUE 0xC904B Kw_Wu8 255.0 OneToOne 0.00 255.0 FORMAT "%5.1" /end CHARACTERISTIC
/begin CHARACTERISTIC DSM_FMKDfp_FrmMngEGS1_C "Ausblendbedingungen fuer Fehlerpfad Dfp_FrmMngEGS1" VALUE 0xC904C Kw_Wu8 255.0 OneToOne 0.00 255.0 FORMAT "%5.1" /end CHARACTERISTIC
/begin CHARACTERISTIC DSM_FMKDfp_FrmMngEGS2_C "Ausblendbedingungen fuer Fehlerpfad Dfp_FrmMngEGS2" VALUE 0xC904D Kw_Wu8 255.0 OneToOne 0.00 255.0 FORMAT "%5.1" /end CHARACTERISTIC
/begin CHARACTERISTIC DSM_FMKDfp_FrmMngGEARBX_DATA_C "Ausblendbedingungen fuer Fehlerpfad Dfp_FrmMngGEARBX_DATA" VALUE 0xC904E Kw_Wu8 255.0 OneToOne 0.00 255.0 FORMAT "%5.1" /end CHARACTERISTIC
/begin CHARACTERISTIC DSM_FMKDfp_FrmMngGEARBX_DATA2_C "Ausblendbedingungen fuer Fehlerpfad Dfp_FrmMngGEARBX_DATA2" VALUE 0xC904F Kw_Wu8 255.0 OneToOne 0.00 255.0 FORMAT "%5.1" /end CHARACTERISTIC
/begin CHARACTERISTIC DSM_FMKDfp_FrmMngHEAT_AC_C "Ausblendbedingungen fuer Fehlerpfad Dfp_FrmMngHEAT_AC" VALUE 0xC9050 Kw_Wu8 255.0 OneToOne 0.00 255.0 FORMAT "%5.1" /end CHARACTERISTIC
/begin CHARACTERISTIC DSM_FMKDfp_FrmMngINSTR2_C "Ausblendbedingungen fuer Fehlerpfad Dfp_FrmMngINSTR2" VALUE 0xC9051 Kw_Wu8 255.0 OneToOne 0.00 255.0 FORMAT "%5.1" /end CHARACTERISTIC
/begin CHARACTERISTIC DSM_FMKDfp_FrmMngINSTR3_C "Ausblendbedingungen fuer Fehlerpfad Dfp_FrmMngINSTR3" VALUE 0xC9052 Kw_Wu8 255.0 OneToOne 0.00 255.0 FORMAT "%5.1" /end CHARACTERISTIC
/begin CHARACTERISTIC DSM_FMKDfp_FrmMngLENKRADWINKEL_C "Ausblendbedingungen fuer Fehlerpfad Dfp_FrmMngLENKRADWINKEL" VALUE 0xC9053 Kw_Wu8 255.0 OneToOne 0.00 255.0 FORMAT "%5.1" /end CHARACTERISTIC
/begin CHARACTERISTIC DSM_FMKDfp_FrmMngMILEAGE_RANGE_C "Ausblendbedingungen fuer Fehlerpfad Dfp_FrmMngMILEAGE_RANGE" VALUE 0xC9054 Kw_Wu8 255.0 OneToOne 0.00 255.0 FORMAT "%5.1" /end CHARACTERISTIC
/begin CHARACTERISTIC DSM_FMKDfp_FrmMngOPCRCTLACC_C "Ausblendbedingungen fuer Fehlerpfad Dfp_FrmMngOPCRCTLACC" VALUE 0xC9055 Kw_Wu8 255.0 OneToOne 0.00 255.0 FORMAT "%5.1" /end CHARACTERISTIC
/begin CHARACTERISTIC DSM_FMKDfp_FrmMngPRGG_CCTR_C "Ausblendbedingungen fuer Fehlerpfad Dfp_FrmMngPRGG_CCTR" VALUE 0xC9056 Kw_Wu8 255.0 OneToOne 0.00 255.0 FORMAT "%5.1" /end CHARACTERISTIC
/begin CHARACTERISTIC DSM_FMKDfp_FrmMngPWRMNG_LOADV_C "Ausblendbedingungen fuer Fehlerpfad Dfp_FrmMngPWRMNG_LOADV" VALUE 0xC9057 Kw_Wu8 255.0 OneToOne 0.00 255.0 FORMAT "%5.1" /end CHARACTERISTIC
/begin CHARACTERISTIC DSM_FMKDfp_FrmMngParkConsumer_C "Ausblendbedingungen fuer Fehlerpfad Dfp_FrmMngParkConsumer" VALUE 0xC9058 Kw_Wu8 255.0 OneToOne 0.00 255.0 FORMAT "%5.1" /end CHARACTERISTIC
/begin CHARACTERISTIC DSM_FMKDfp_FrmMngRQSTGEFAN_C "RQ_STG_EFAN - CAN-message related errors" VALUE 0xC9059 Kw_Wu8 255.0 OneToOne 0.00 255.0 FORMAT "%5.1" /end CHARACTERISTIC
/begin CHARACTERISTIC DSM_FMKDfp_FrmMngSSGErr_C "Ausblendbedingungen fuer Fehlerpfad Dfp_FrmMngSSGErr" VALUE 0xC905A Kw_Wu8 255.0 OneToOne 0.00 255.0 FORMAT "%5.1" /end CHARACTERISTIC
/begin CHARACTERISTIC DSM_FMKDfp_FrmMngSSGShOff_C "Ausblendbedingungen fuer Fehlerpfad Dfp_FrmMngSSGShOff" VALUE 0xC905B Kw_Wu8 255.0 OneToOne 0.00 255.0 FORMAT "%5.1" /end CHARACTERISTIC
/begin CHARACTERISTIC DSM_FMKDfp_FrmMngSTAT_ANH_C "Ausblendbedingungen fuer Fehlerpfad Dfp_FrmMngSTAT_ANH" VALUE 0xC905C Kw_Wu8 255.0 OneToOne 0.00 255.0 FORMAT "%5.1" /end CHARACTERISTIC
/begin CHARACTERISTIC DSM_FMKDfp_FrmMngSTAT_ARS_C "Ausblendbedingungen fuer Fehlerpfad Dfp_FrmMngSTAT_ARS" VALUE 0xC905D Kw_Wu8 255.0 OneToOne 0.00 255.0 FORMAT "%5.1" /end CHARACTERISTIC
/begin CHARACTERISTIC DSM_FMKDfp_FrmMngSTAT_DSC_C "Ausblendbedingungen fuer Fehlerpfad Dfp_FrmMngSTAT_DSC" VALUE 0xC905E Kw_Wu8 255.0 OneToOne 0.00 255.0 FORMAT "%5.1" /end CHARACTERISTIC
/begin CHARACTERISTIC DSM_FMKDfp_FrmMngSTAT_EKP_C "Ausblendbedingungen fuer Fehlerpfad Dfp_FrmMngSTAT_EKP" VALUE 0xC905F Kw_Wu8 255.0 OneToOne 0.00 255.0 FORMAT "%5.1" /end CHARACTERISTIC
/begin CHARACTERISTIC DSM_FMKDfp_FrmMngSTAT_KOMBI_C "Ausblendbedingungen fuer Fehlerpfad Dfp_FrmMngSTAT_KOMBI" VALUE 0xC9060 Kw_Wu8 255.0 OneToOne 0.00 255.0 FORMAT "%5.1" /end CHARACTERISTIC
/begin CHARACTERISTIC DSM_FMKDfp_FrmMngSTAT_SITZ_C "Ausblendbedingungen fuer Fehlerpfad  Dfp_FrmMngSTAT_SITZ" VALUE 0xC9061 Kw_Wu8 255.0 OneToOne 0.00 255.0 FORMAT "%5.1" /end CHARACTERISTIC
/begin CHARACTERISTIC DSM_FMKDfp_FrmMngStOBDGbxMilOf_C "Ausblendbedingungen fuer Fehlerpfad Dfp_FrmMngStOBDGbxMilOf" VALUE 0xC9062 Kw_Wu8 255.0 OneToOne 0.00 255.0 FORMAT "%5.1" /end CHARACTERISTIC
/begin CHARACTERISTIC DSM_FMKDfp_FrmMngStOBDGbxMilOn_C "Ausblendbedingungen fuer Fehlerpfad Dfp_FrmMngStOBDGbxMilOn" VALUE 0xC9063 Kw_Wu8 255.0 OneToOne 0.00 255.0 FORMAT "%5.1" /end CHARACTERISTIC
/begin CHARACTERISTIC DSM_FMKDfp_FrmMngTEMPRELTIME_C "Ausblendbedingungen fuer Fehlerpfad Dfp_FrmMngTEMPRELTIME" VALUE 0xC9064 Kw_Wu8 255.0 OneToOne 0.00 255.0 FORMAT "%5.1" /end CHARACTERISTIC
/begin CHARACTERISTIC DSM_FMKDfp_FrmMngTERMINAL_C "Ausblendbedingungen fuer Fehlerpfad Dfp_FrmMngTERMINAL" VALUE 0xC9065 Kw_Wu8 255.0 OneToOne 0.00 255.0 FORMAT "%5.1" /end CHARACTERISTIC
/begin CHARACTERISTIC DSM_FMKDfp_FrmMngTIME_DATE_C "Ausblendbedingungen fuer Fehlerpfad Dfp_FrmMngTIME_DATE" VALUE 0xC9066 Kw_Wu8 255.0 OneToOne 0.00 255.0 FORMAT "%5.1" /end CHARACTERISTIC
/begin CHARACTERISTIC DSM_FMKDfp_FrmMngTORQUE_DSC_C "Ausblendbedingungen fuer Fehlerpfad Dfp_FrmMngTORQUE_DSC" VALUE 0xC9067 Kw_Wu8 255.0 OneToOne 0.00 255.0 FORMAT "%5.1" /end CHARACTERISTIC
/begin CHARACTERISTIC DSM_FMKDfp_FrmMngTORQUE_GEARBX_C "Ausblendbedingungen fuer Fehlerpfad Dfp_FrmMngTORQUE_GEARBX" VALUE 0xC9068 Kw_Wu8 255.0 OneToOne 0.00 255.0 FORMAT "%5.1" /end CHARACTERISTIC
/begin CHARACTERISTIC DSM_FMKDfp_FrmMngTrq_ReqACC_C "Ausblendbedingungen fuer Fehlerpfad Dfp_FrmMngTrq_ReqACC" VALUE 0xC9069 Kw_Wu8 255.0 OneToOne 0.00 255.0 FORMAT "%5.1" /end CHARACTERISTIC
/begin CHARACTERISTIC DSM_FMKDfp_FrmMngVEH_MOD_C "VEH_MOD - CAN-message related errors" VALUE 0xC906A Kw_Wu8 255.0 OneToOne 0.00 255.0 FORMAT "%5.1" /end CHARACTERISTIC
/begin CHARACTERISTIC DSM_FMKDfp_FrmMngVELOCITY_C "Ausblendbedingungen fuer Fehlerpfad Dfp_FrmMngVELOCITY" VALUE 0xC906B Kw_Wu8 255.0 OneToOne 0.00 255.0 FORMAT "%5.1" /end CHARACTERISTIC
/begin CHARACTERISTIC DSM_FMKDfp_FrmMngWHEEL_SPEED_C "Ausblendbedingungen fuer Fehlerpfad Dfp_FrmMngWHEEL_SPEED" VALUE 0xC906C Kw_Wu8 255.0 OneToOne 0.00 255.0 FORMAT "%5.1" /end CHARACTERISTIC
/begin CHARACTERISTIC DSM_FMKDfp_FrmMngstCurr_C "Maskenlabel für Dfp_FrmMngstCurr" VALUE 0xC906D Kw_Wu8 255.0 OneToOne 0.00 255.0 FORMAT "%5.1" /end CHARACTERISTIC
/begin CHARACTERISTIC DSM_FMKDfp_FrmMngswtPSPOff_C "Maskenlabel für Dfp_FrmMngswtPSPOff" VALUE 0xC906E Kw_Wu8 255.0 OneToOne 0.00 255.0 FORMAT "%5.1" /end CHARACTERISTIC
/begin CHARACTERISTIC DSM_FMKDfp_GearbxIncMax_C "Ausblendbedingungen fuer Fehlerpfad Dfp_GearbxIncMax" VALUE 0xC906F Kw_Wu8 255.0 OneToOne 0.00 255.0 FORMAT "%5.1" /end CHARACTERISTIC
/begin CHARACTERISTIC DSM_FMKDfp_GlwCD_C "Ausblendbedingungen fuer Fehlerpfad Dfp_GlwCD" VALUE 0xC9070 Kw_Wu8 255.0 OneToOne 0.00 255.0 FORMAT "%5.1" /end CHARACTERISTIC
/begin CHARACTERISTIC DSM_FMKDfp_GlwCDGlwCirc1_C "Ausblendbedingungen fuer Fehlerpfad Dfp_GlwCDGlwCirc1" VALUE 0xC9071 Kw_Wu8 255.0 OneToOne 0.00 255.0 FORMAT "%5.1" /end CHARACTERISTIC
/begin CHARACTERISTIC DSM_FMKDfp_GlwCDGlwCirc2_C "Ausblendbedingungen fuer Fehlerpfad Dfp_GlwCDGlwCirc2" VALUE 0xC9072 Kw_Wu8 255.0 OneToOne 0.00 255.0 FORMAT "%5.1" /end CHARACTERISTIC
/begin CHARACTERISTIC DSM_FMKDfp_GlwCDGlwCirc3_C "Ausblendbedingungen fuer Fehlerpfad Dfp_GlwCDGlwCirc3" VALUE 0xC9073 Kw_Wu8 255.0 OneToOne 0.00 255.0 FORMAT "%5.1" /end CHARACTERISTIC
/begin CHARACTERISTIC DSM_FMKDfp_GlwCDGlwCirc4_C "Ausblendbedingungen fuer Fehlerpfad Dfp_GlwCDGlwCirc4" VALUE 0xC9074 Kw_Wu8 255.0 OneToOne 0.00 255.0 FORMAT "%5.1" /end CHARACTERISTIC
/begin CHARACTERISTIC DSM_FMKDfp_GlwCDGlwCirc5_C "Ausblendbedingungen fuer Fehlerpfad Dfp_GlwCDGlwCirc5" VALUE 0xC9075 Kw_Wu8 255.0 OneToOne 0.00 255.0 FORMAT "%5.1" /end CHARACTERISTIC
/begin CHARACTERISTIC DSM_FMKDfp_GlwCDGlwCirc6_C "Ausblendbedingungen fuer Fehlerpfad Dfp_GlwCDGlwCirc6" VALUE 0xC9076 Kw_Wu8 255.0 OneToOne 0.00 255.0 FORMAT "%5.1" /end CHARACTERISTIC
/begin CHARACTERISTIC DSM_FMKDfp_GlwCDGlwCirc7_C "Ausblendbedingungen fuer Fehlerpfad Dfp_GlwCDGlwCirc7" VALUE 0xC9077 Kw_Wu8 255.0 OneToOne 0.00 255.0 FORMAT "%5.1" /end CHARACTERISTIC
/begin CHARACTERISTIC DSM_FMKDfp_GlwCDGlwCirc8_C "Ausblendbedingungen fuer Fehlerpfad Dfp_GlwCDGlwCirc8" VALUE 0xC9078 Kw_Wu8 255.0 OneToOne 0.00 255.0 FORMAT "%5.1" /end CHARACTERISTIC
/begin CHARACTERISTIC DSM_FMKDfp_GlwCtl_C "Ausblendbedingungen fuer Fehlerpfad Dfp_GlwCtl" VALUE 0xC9079 Kw_Wu8 255.0 OneToOne 0.00 255.0 FORMAT "%5.1" /end CHARACTERISTIC
/begin CHARACTERISTIC DSM_FMKDfp_HWEMonCom_C "Ausblendbedingungen fuer Fehlerpfad Dfp_HWEMonCom" VALUE 0xC907A Kw_Wu8 255.0 OneToOne 0.00 255.0 FORMAT "%5.1" /end CHARACTERISTIC
/begin CHARACTERISTIC DSM_FMKDfp_HWEMonEEPROM_C "Ausblendbedingungen fuer Fehlerpfad Dfp_HWEMonEEPROM" VALUE 0xC907B Kw_Wu8 255.0 OneToOne 0.00 255.0 FORMAT "%5.1" /end CHARACTERISTIC
/begin CHARACTERISTIC DSM_FMKDfp_HWEMonRcyLocked_C "Ausblendbedingungen fuer Fehlerpfad Dfp_HWEMonRcyLocked" VALUE 0xC907C Kw_Wu8 255.0 OneToOne 0.00 255.0 FORMAT "%5.1" /end CHARACTERISTIC
/begin CHARACTERISTIC DSM_FMKDfp_HWEMonRcySuppressed_C "Ausblendbedingungen fuer Fehlerpfad Dfp_HWEMonRcySuppressed" VALUE 0xC907D Kw_Wu8 255.0 OneToOne 0.00 255.0 FORMAT "%5.1" /end CHARACTERISTIC
/begin CHARACTERISTIC DSM_FMKDfp_HWEMonRcyVisible_C "Ausblendbedingungen fuer Fehlerpfad Dfp_HWEMonRcyVisible" VALUE 0xC907E Kw_Wu8 255.0 OneToOne 0.00 255.0 FORMAT "%5.1" /end CHARACTERISTIC
/begin CHARACTERISTIC DSM_FMKDfp_HWEMonUMaxSupply_C "Ausblendbedingungen fuer Fehlerpfad Dfp_HWEMonUMaxSupply" VALUE 0xC907F Kw_Wu8 255.0 OneToOne 0.00 255.0 FORMAT "%5.1" /end CHARACTERISTIC
/begin CHARACTERISTIC DSM_FMKDfp_HWEMonUMinSupply_C "Ausblendbedingungen fuer Fehlerpfad Dfp_HWEMonUMinSupply" VALUE 0xC9080 Kw_Wu8 255.0 OneToOne 0.00 255.0 FORMAT "%5.1" /end CHARACTERISTIC
/begin CHARACTERISTIC DSM_FMKDfp_IATSCD_C "Ausblendbedingungen fuer Fehlerpfad Dfp_IATSCD" VALUE 0xC9081 Kw_Wu8 255.0 OneToOne 0.00 255.0 FORMAT "%5.1" /end CHARACTERISTIC
/begin CHARACTERISTIC DSM_FMKDfp_IATSCD_CATS_C "Ausblendbedingungen fuer Fehlerpfad Dfp_IATSCD_CATS" VALUE 0xC9082 Kw_Wu8 255.0 OneToOne 0.00 255.0 FORMAT "%5.1" /end CHARACTERISTIC
/begin CHARACTERISTIC DSM_FMKDfp_ImmCtlImmCD_C "Ausblendbedingungen fuer Fehlerpfad Dfp_ImmCtlImmCD" VALUE 0xC9083 Kw_Wu8 255.0 OneToOne 0.00 255.0 FORMAT "%5.1" /end CHARACTERISTIC
/begin CHARACTERISTIC DSM_FMKDfp_ImmCtlImmEep_C "Ausblendbedingungen fuer Fehlerpfad Dfp_ImmCtlImmEep" VALUE 0xC9084 Kw_Wu8 255.0 OneToOne 0.00 255.0 FORMAT "%5.1" /end CHARACTERISTIC
/begin CHARACTERISTIC DSM_FMKDfp_ImmCtlMpl_C "Ausblendbedingungen fuer Fehlerpfad Dfp_ImmCtlMpl" VALUE 0xC9085 Kw_Wu8 255.0 OneToOne 0.00 255.0 FORMAT "%5.1" /end CHARACTERISTIC
/begin CHARACTERISTIC DSM_FMKDfp_IndSys1_C "Ausblendbedingungen fuer Fehlerpfad Dfp_IndSys1" VALUE 0xC9086 Kw_Wu8 255.0 OneToOne 0.00 255.0 FORMAT "%5.1" /end CHARACTERISTIC
/begin CHARACTERISTIC DSM_FMKDfp_IndSys2_C "Ausblendbedingungen fuer Fehlerpfad Dfp_IndSys2" VALUE 0xC9087 Kw_Wu8 255.0 OneToOne 0.00 255.0 FORMAT "%5.1" /end CHARACTERISTIC
/begin CHARACTERISTIC DSM_FMKDfp_InjCrv_InjLim_C "Ausblendbedingungen fuer Fehlerpfad Dfp_InjCrv_InjLim" VALUE 0xC9088 Kw_Wu8 255.0 OneToOne 0.00 255.0 FORMAT "%5.1" /end CHARACTERISTIC
/begin CHARACTERISTIC DSM_FMKDfp_InjCtlAdjQnt_C "Ausblendbedingungen fuer Fehlerpfad Dfp_InjCtlAdjQnt" VALUE 0xC9089 Kw_Wu8 255.0 OneToOne 0.00 255.0 FORMAT "%5.1" /end CHARACTERISTIC
/begin CHARACTERISTIC DSM_FMKDfp_InjCtlDrift_C "Ausblendbedingungen fuer Fehlerpfad Dfp_InjCtlDrift" VALUE 0xC908A Kw_Wu8 255.0 OneToOne 0.00 255.0 FORMAT "%5.1" /end CHARACTERISTIC
/begin CHARACTERISTIC DSM_FMKDfp_InjVlvBnk1A_C "Ausblendbedingungen fuer Fehlerpfad Dfp_InjVlvBnk1A" VALUE 0xC908B Kw_Wu8 255.0 OneToOne 0.00 255.0 FORMAT "%5.1" /end CHARACTERISTIC
/begin CHARACTERISTIC DSM_FMKDfp_InjVlvBnk1B_C "Ausblendbedingungen fuer Fehlerpfad Dfp_InjVlvBnk1B" VALUE 0xC908C Kw_Wu8 255.0 OneToOne 0.00 255.0 FORMAT "%5.1" /end CHARACTERISTIC
/begin CHARACTERISTIC DSM_FMKDfp_InjVlvBnk2A_C "Ausblendbedingungen fuer Fehlerpfad Dfp_InjVlvBnk2A" VALUE 0xC908D Kw_Wu8 255.0 OneToOne 0.00 255.0 FORMAT "%5.1" /end CHARACTERISTIC
/begin CHARACTERISTIC DSM_FMKDfp_InjVlvBnk2B_C "Ausblendbedingungen fuer Fehlerpfad Dfp_InjVlvBnk2B" VALUE 0xC908E Kw_Wu8 255.0 OneToOne 0.00 255.0 FORMAT "%5.1" /end CHARACTERISTIC
/begin CHARACTERISTIC DSM_FMKDfp_InjVlvChipA_C "Ausblendbedingungen fuer Fehlerpfad Dfp_InjVlvChipA" VALUE 0xC908F Kw_Wu8 255.0 OneToOne 0.00 255.0 FORMAT "%5.1" /end CHARACTERISTIC
/begin CHARACTERISTIC DSM_FMKDfp_InjVlvChipB_C "Ausblendbedingungen fuer Fehlerpfad Dfp_InjVlvChipB" VALUE 0xC9090 Kw_Wu8 255.0 OneToOne 0.00 255.0 FORMAT "%5.1" /end CHARACTERISTIC
/begin CHARACTERISTIC DSM_FMKDfp_InjVlvCyl1A_C "Ausblendbedingungen fuer Fehlerpfad Dfp_InjVlvCyl1A" VALUE 0xC9091 Kw_Wu8 255.0 OneToOne 0.00 255.0 FORMAT "%5.1" /end CHARACTERISTIC
/begin CHARACTERISTIC DSM_FMKDfp_InjVlvCyl1B_C "Ausblendbedingungen fuer Fehlerpfad Dfp_InjVlvCyl1B" VALUE 0xC9092 Kw_Wu8 255.0 OneToOne 0.00 255.0 FORMAT "%5.1" /end CHARACTERISTIC
/begin CHARACTERISTIC DSM_FMKDfp_InjVlvCyl2A_C "Ausblendbedingungen fuer Fehlerpfad Dfp_InjVlvCyl2A" VALUE 0xC9093 Kw_Wu8 255.0 OneToOne 0.00 255.0 FORMAT "%5.1" /end CHARACTERISTIC
/begin CHARACTERISTIC DSM_FMKDfp_InjVlvCyl2B_C "Ausblendbedingungen fuer Fehlerpfad Dfp_InjVlvCyl2B" VALUE 0xC9094 Kw_Wu8 255.0 OneToOne 0.00 255.0 FORMAT "%5.1" /end CHARACTERISTIC
/begin CHARACTERISTIC DSM_FMKDfp_InjVlvCyl3A_C "Ausblendbedingungen fuer Fehlerpfad Dfp_InjVlvCyl3A" VALUE 0xC9095 Kw_Wu8 255.0 OneToOne 0.00 255.0 FORMAT "%5.1" /end CHARACTERISTIC
/begin CHARACTERISTIC DSM_FMKDfp_InjVlvCyl3B_C "Ausblendbedingungen fuer Fehlerpfad Dfp_InjVlvCyl3B" VALUE 0xC9096 Kw_Wu8 255.0 OneToOne 0.00 255.0 FORMAT "%5.1" /end CHARACTERISTIC
/begin CHARACTERISTIC DSM_FMKDfp_InjVlvCyl4A_C "Ausblendbedingungen fuer Fehlerpfad Dfp_InjVlvCyl4A" VALUE 0xC9097 Kw_Wu8 255.0 OneToOne 0.00 255.0 FORMAT "%5.1" /end CHARACTERISTIC
/begin CHARACTERISTIC DSM_FMKDfp_InjVlvCyl4B_C "Ausblendbedingungen fuer Fehlerpfad Dfp_InjVlvCyl4B" VALUE 0xC9098 Kw_Wu8 255.0 OneToOne 0.00 255.0 FORMAT "%5.1" /end CHARACTERISTIC
/begin CHARACTERISTIC DSM_FMKDfp_InjVlvCyl5A_C "Ausblendbedingungen fuer Fehlerpfad Dfp_InjVlvCyl5A" VALUE 0xC9099 Kw_Wu8 255.0 OneToOne 0.00 255.0 FORMAT "%5.1" /end CHARACTERISTIC
/begin CHARACTERISTIC DSM_FMKDfp_InjVlvCyl5B_C "Ausblendbedingungen fuer Fehlerpfad Dfp_InjVlvCyl5B" VALUE 0xC909A Kw_Wu8 255.0 OneToOne 0.00 255.0 FORMAT "%5.1" /end CHARACTERISTIC
/begin CHARACTERISTIC DSM_FMKDfp_InjVlvCyl6A_C "Ausblendbedingungen fuer Fehlerpfad Dfp_InjVlvCyl6A" VALUE 0xC909B Kw_Wu8 255.0 OneToOne 0.00 255.0 FORMAT "%5.1" /end CHARACTERISTIC
/begin CHARACTERISTIC DSM_FMKDfp_InjVlvCyl6B_C "Ausblendbedingungen fuer Fehlerpfad Dfp_InjVlvCyl6B" VALUE 0xC909C Kw_Wu8 255.0 OneToOne 0.00 255.0 FORMAT "%5.1" /end CHARACTERISTIC
/begin CHARACTERISTIC DSM_FMKDfp_LPACD_Max_C "Ausblendbedingungen fuer Fehlerpfad Dfp_LPACD_Max" VALUE 0xC909D Kw_Wu8 255.0 OneToOne 0.00 255.0 FORMAT "%5.1" /end CHARACTERISTIC
/begin CHARACTERISTIC DSM_FMKDfp_LPACD_Min_C "Ausblendbedingungen fuer Fehlerpfad Dfp_LPACD_Min" VALUE 0xC909E Kw_Wu8 255.0 OneToOne 0.00 255.0 FORMAT "%5.1" /end CHARACTERISTIC
/begin CHARACTERISTIC DSM_FMKDfp_LPACD_SigNpl_C "Ausblendbedingungen fuer Fehlerpfad Dfp_LPACD_SigNpl" VALUE 0xC909F Kw_Wu8 255.0 OneToOne 0.00 255.0 FORMAT "%5.1" /end CHARACTERISTIC
/begin CHARACTERISTIC DSM_FMKDfp_LSUCDCircNernst0_C "Ausblendbedingungen fuer Fehlerpfad Dfp_LSUCDCircNernst0" VALUE 0xC90A0 Kw_Wu8 255.0 OneToOne 0.00 255.0 FORMAT "%5.1" /end CHARACTERISTIC
/begin CHARACTERISTIC DSM_FMKDfp_LSUCDCircPumpCur0_C "Ausblendbedingungen fuer Fehlerpfad Dfp_LSUCDCircPumpCur0" VALUE 0xC90A1 Kw_Wu8 255.0 OneToOne 0.00 255.0 FORMAT "%5.1" /end CHARACTERISTIC
/begin CHARACTERISTIC DSM_FMKDfp_LSUCDCircVirtGnd0_C "Ausblendbedingungen fuer Fehlerpfad Dfp_LSUCDCircVirtGnd0" VALUE 0xC90A2 Kw_Wu8 255.0 OneToOne 0.00 255.0 FORMAT "%5.1" /end CHARACTERISTIC
/begin CHARACTERISTIC DSM_FMKDfp_LSUCDHeater0_C "Ausblendbedingungen fuer Fehlerpfad Dfp_LSUCDHeater0" VALUE 0xC90A3 Kw_Wu8 255.0 OneToOne 0.00 255.0 FORMAT "%5.1" /end CHARACTERISTIC
/begin CHARACTERISTIC DSM_FMKDfp_LSUCDHtCoup0_C "Ausblendbedingungen fuer Fehlerpfad Dfp_LSUCDHtCoup0" VALUE 0xC90A4 Kw_Wu8 255.0 OneToOne 0.00 255.0 FORMAT "%5.1" /end CHARACTERISTIC
/begin CHARACTERISTIC DSM_FMKDfp_LSUCDO20_C "Ausblendbedingungen fuer Fehlerpfad Dfp_LSUCDO20" VALUE 0xC90A5 Kw_Wu8 255.0 OneToOne 0.00 255.0 FORMAT "%5.1" /end CHARACTERISTIC
/begin CHARACTERISTIC DSM_FMKDfp_LSUCDO2Clb0_C "Ausblendbedingungen fuer Fehlerpfad Dfp_LSUCDO2Clb0" VALUE 0xC90A6 Kw_Wu8 255.0 OneToOne 0.00 255.0 FORMAT "%5.1" /end CHARACTERISTIC
/begin CHARACTERISTIC DSM_FMKDfp_LSUCDRiClb0_C "Ausblendbedingungen fuer Fehlerpfad Dfp_LSUCDRiClb0" VALUE 0xC90A7 Kw_Wu8 255.0 OneToOne 0.00 255.0 FORMAT "%5.1" /end CHARACTERISTIC
/begin CHARACTERISTIC DSM_FMKDfp_LSUCDSPI0_C "Ausblendbedingungen fuer Fehlerpfad Dfp_LSUCDSPI0" VALUE 0xC90A8 Kw_Wu8 255.0 OneToOne 0.00 255.0 FORMAT "%5.1" /end CHARACTERISTIC
/begin CHARACTERISTIC DSM_FMKDfp_LSUCDSPIBattLow0_C "Ausblendbedingungen fuer Fehlerpfad Dfp_LSUCDSPIBattLow0" VALUE 0xC90A9 Kw_Wu8 255.0 OneToOne 0.00 255.0 FORMAT "%5.1" /end CHARACTERISTIC
/begin CHARACTERISTIC DSM_FMKDfp_LSUCDWireIP0_C "Ausblendbedingungen fuer Fehlerpfad Dfp_LSUCDWireIP0" VALUE 0xC90AA Kw_Wu8 255.0 OneToOne 0.00 255.0 FORMAT "%5.1" /end CHARACTERISTIC
/begin CHARACTERISTIC DSM_FMKDfp_LSUCtlRiExc0_C "Ausblendbedingungen fuer Fehlerpfad Dfp_LSUCtlRiExc0" VALUE 0xC90AB Kw_Wu8 255.0 OneToOne 0.00 255.0 FORMAT "%5.1" /end CHARACTERISTIC
/begin CHARACTERISTIC DSM_FMKDfp_LSUMon1Sens_C "Ausblendbedingungen fuer Fehlerpfad Dfp_LSUMon1Sens" VALUE 0xC90AC Kw_Wu8 255.0 OneToOne 0.00 255.0 FORMAT "%5.1" /end CHARACTERISTIC
/begin CHARACTERISTIC DSM_FMKDfp_LSUMon2Sens_C "Ausblendbedingungen fuer Fehlerpfad Dfp_LSUMon2Sens" VALUE 0xC90AD Kw_Wu8 255.0 OneToOne 0.00 255.0 FORMAT "%5.1" /end CHARACTERISTIC
/begin CHARACTERISTIC DSM_FMKDfp_LubCD_C "Ausblendbedingungen fuer Fehlerpfad Dfp_LubCD" VALUE 0xC90AE Kw_Wu8 255.0 OneToOne 0.00 255.0 FORMAT "%5.1" /end CHARACTERISTIC
/begin CHARACTERISTIC DSM_FMKDfp_MIL_C "Ausblendbedingungen fuer Fehlerpfad Dfp_MIL" VALUE 0xC90AF Kw_Wu8 255.0 OneToOne 0.00 255.0 FORMAT "%5.1" /end CHARACTERISTIC
/begin CHARACTERISTIC DSM_FMKDfp_MRlyCD_C "Ausblendbedingungen fuer Fehlerpfad Dfp_MRlyCD" VALUE 0xC90B0 Kw_Wu8 255.0 OneToOne 0.00 255.0 FORMAT "%5.1" /end CHARACTERISTIC
/begin CHARACTERISTIC DSM_FMKDfp_MSidCD_Comm_C "Ausblendbedingungen fuer Fehlerpfad Dfp_MSidCD_Comm" VALUE 0xC90B1 Kw_Wu8 255.0 OneToOne 0.00 255.0 FORMAT "%5.1" /end CHARACTERISTIC
/begin CHARACTERISTIC DSM_FMKDfp_MSidCD_Pin_C "Ausblendbedingungen fuer Fehlerpfad Dfp_MSidCD_Pin" VALUE 0xC90B2 Kw_Wu8 255.0 OneToOne 0.00 255.0 FORMAT "%5.1" /end CHARACTERISTIC
/begin CHARACTERISTIC DSM_FMKDfp_MSidCD_Sel_INI_C "Ausblendbedingungen fuer Fehlerpfad Dfp_MSidCD_Sel_INI" VALUE 0xC90B3 Kw_Wu8 255.0 OneToOne 0.00 255.0 FORMAT "%5.1" /end CHARACTERISTIC
/begin CHARACTERISTIC DSM_FMKDfp_MSidCD_Select_C "Ausblendbedingungen fuer Fehlerpfad Dfp_MSidCD_Select" VALUE 0xC90B4 Kw_Wu8 255.0 OneToOne 0.00 255.0 FORMAT "%5.1" /end CHARACTERISTIC
/begin CHARACTERISTIC DSM_FMKDfp_MeUnCDNoLoad_C "Ausblendbedingungen fuer Fehlerpfad Dfp_MeUnCDNoLoad" VALUE 0xC90B5 Kw_Wu8 255.0 OneToOne 0.00 255.0 FORMAT "%5.1" /end CHARACTERISTIC
/begin CHARACTERISTIC DSM_FMKDfp_MeUnCDSCBat_C "Ausblendbedingungen fuer Fehlerpfad Dfp_MeUnCDSCBat" VALUE 0xC90B6 Kw_Wu8 255.0 OneToOne 0.00 255.0 FORMAT "%5.1" /end CHARACTERISTIC
/begin CHARACTERISTIC DSM_FMKDfp_MeUnCDSCGnd_C "Ausblendbedingungen fuer Fehlerpfad Dfp_MeUnCDSCGnd" VALUE 0xC90B7 Kw_Wu8 255.0 OneToOne 0.00 255.0 FORMAT "%5.1" /end CHARACTERISTIC
/begin CHARACTERISTIC DSM_FMKDfp_MeUnCD_ADC_C "Ausblendbedingungen fuer Fehlerpfad Dfp_MeUnCD_ADC" VALUE 0xC90B8 Kw_Wu8 255.0 OneToOne 0.00 255.0 FORMAT "%5.1" /end CHARACTERISTIC
/begin CHARACTERISTIC DSM_FMKDfp_MeUnCD_SigTst_C "Ausblendbedingungen fuer Fehlerpfad Dfp_MeUnCD_SigTst" VALUE 0xC90B9 Kw_Wu8 255.0 OneToOne 0.00 255.0 FORMAT "%5.1" /end CHARACTERISTIC
/begin CHARACTERISTIC DSM_FMKDfp_Montr_C "Ausblendbedingungen fuer Fehlerpfad Dfp_Montr" VALUE 0xC90BA Kw_Wu8 255.0 OneToOne 0.00 255.0 FORMAT "%5.1" /end CHARACTERISTIC
/begin CHARACTERISTIC DSM_FMKDfp_NetMngDeviceA_C "Ausblendbedingungen fuer Fehlerpfad Dfp_NetMngDeviceA" VALUE 0xC90BB Kw_Wu8 255.0 OneToOne 0.00 255.0 FORMAT "%5.1" /end CHARACTERISTIC
/begin CHARACTERISTIC DSM_FMKDfp_NetMngDeviceB_C "Ausblendbedingungen fuer Fehlerpfad Dfp_NetMngDeviceB" VALUE 0xC90BC Kw_Wu8 255.0 OneToOne 0.00 255.0 FORMAT "%5.1" /end CHARACTERISTIC
/begin CHARACTERISTIC DSM_FMKDfp_NetMngDeviceC_C "Ausblendbedingungen fuer Fehlerpfad Dfp_NetMngDeviceC" VALUE 0xC90BD Kw_Wu8 255.0 OneToOne 0.00 255.0 FORMAT "%5.1" /end CHARACTERISTIC
/begin CHARACTERISTIC DSM_FMKDfp_OPSCD_Lamp_C "Ausblendbedingungen fuer Fehlerpfad Dfp_OPSCD_Lamp" VALUE 0xC90BE Kw_Wu8 255.0 OneToOne 0.00 255.0 FORMAT "%5.1" /end CHARACTERISTIC
/begin CHARACTERISTIC DSM_FMKDfp_OPSCD_anain_C "Ausblendbedingungen fuer Fehlerpfad Dfp_OPSCD_anain" VALUE 0xC90BF Kw_Wu8 255.0 OneToOne 0.00 255.0 FORMAT "%5.1" /end CHARACTERISTIC
/begin CHARACTERISTIC DSM_FMKDfp_OTSCD_C "Ausblendbedingungen fuer Fehlerpfad Dfp_OTSCD" VALUE 0xC90C0 Kw_Wu8 255.0 OneToOne 0.00 255.0 FORMAT "%5.1" /end CHARACTERISTIC
/begin CHARACTERISTIC DSM_FMKDfp_OvRMon_C "Ausblendbedingungen fuer Fehlerpfad Dfp_OvRMon" VALUE 0xC90C1 Kw_Wu8 255.0 OneToOne 0.00 255.0 FORMAT "%5.1" /end CHARACTERISTIC
/begin CHARACTERISTIC DSM_FMKDfp_OvRMonBrk_C "Ausblendbedingungen fuer Fehlerpfad Dfp_OvRMonBrk" VALUE 0xC90C2 Kw_Wu8 255.0 OneToOne 0.00 255.0 FORMAT "%5.1" /end CHARACTERISTIC
/begin CHARACTERISTIC DSM_FMKDfp_OvRMonSigA_C "Ausblendbedingungen fuer Fehlerpfad Dfp_OvRMonSigA" VALUE 0xC90C3 Kw_Wu8 255.0 OneToOne 0.00 255.0 FORMAT "%5.1" /end CHARACTERISTIC
/begin CHARACTERISTIC DSM_FMKDfp_OxiCCDTPre_C "Ausblendbedingungen fuer Fehlerpfad Dfp_OxiCCDTPre" VALUE 0xC90C4 Kw_Wu8 255.0 OneToOne 0.00 255.0 FORMAT "%5.1" /end CHARACTERISTIC
/begin CHARACTERISTIC DSM_FMKDfp_PCR_GovDevNeg_C "Ausblendbedingungen fuer Fehlerpfad Dfp_PCR_GovDevNeg" VALUE 0xC90C5 Kw_Wu8 255.0 OneToOne 0.00 255.0 FORMAT "%5.1" /end CHARACTERISTIC
/begin CHARACTERISTIC DSM_FMKDfp_PCR_GovDevPos_C "Ausblendbedingungen fuer Fehlerpfad Dfp_PCR_GovDevPos" VALUE 0xC90C6 Kw_Wu8 255.0 OneToOne 0.00 255.0 FORMAT "%5.1" /end CHARACTERISTIC
/begin CHARACTERISTIC DSM_FMKDfp_PCVCDNoLoad_C "Ausblendbedingungen fuer Fehlerpfad Dfp_PCVCDNoLoad" VALUE 0xC90C7 Kw_Wu8 255.0 OneToOne 0.00 255.0 FORMAT "%5.1" /end CHARACTERISTIC
/begin CHARACTERISTIC DSM_FMKDfp_PCVCDSCBat_C "Ausblendbedingungen fuer Fehlerpfad Dfp_PCVCDSCBat" VALUE 0xC90C8 Kw_Wu8 255.0 OneToOne 0.00 255.0 FORMAT "%5.1" /end CHARACTERISTIC
/begin CHARACTERISTIC DSM_FMKDfp_PCVCDSCGnd_C "Ausblendbedingungen fuer Fehlerpfad Dfp_PCVCDSCGnd" VALUE 0xC90C9 Kw_Wu8 255.0 OneToOne 0.00 255.0 FORMAT "%5.1" /end CHARACTERISTIC
/begin CHARACTERISTIC DSM_FMKDfp_PCVCD_ADC_C "Ausblendbedingungen fuer Fehlerpfad Dfp_PCVCD_ADC" VALUE 0xC90CA Kw_Wu8 255.0 OneToOne 0.00 255.0 FORMAT "%5.1" /end CHARACTERISTIC
/begin CHARACTERISTIC DSM_FMKDfp_PCVCD_SigTst_C "Ausblendbedingungen fuer Fehlerpfad Dfp_PCVCD_SigTst" VALUE 0xC90CB Kw_Wu8 255.0 OneToOne 0.00 255.0 FORMAT "%5.1" /end CHARACTERISTIC
/begin CHARACTERISTIC DSM_FMKDfp_PFltAPSens_C "Ausblendbedingungen fuer Fehlerpfad Dfp_PFltAPSens" VALUE 0xC90CC Kw_Wu8 255.0 OneToOne 0.00 255.0 FORMAT "%5.1" /end CHARACTERISTIC
/begin CHARACTERISTIC DSM_FMKDfp_PFltCDPPre_C "Ausblendbedingungen fuer Fehlerpfad Dfp_PFltCDPPre" VALUE 0xC90CD Kw_Wu8 255.0 OneToOne 0.00 255.0 FORMAT "%5.1" /end CHARACTERISTIC
/begin CHARACTERISTIC DSM_FMKDfp_PFltCDTempPre_C "Ausblendbedingungen fuer Fehlerpfad Dfp_PFltCDTempPre" VALUE 0xC90CE Kw_Wu8 255.0 OneToOne 0.00 255.0 FORMAT "%5.1" /end CHARACTERISTIC
/begin CHARACTERISTIC DSM_FMKDfp_PFltChar_C "Ausblendbedingungen fuer Fehlerpfad Dfp_PFltChar" VALUE 0xC90CF Kw_Wu8 255.0 OneToOne 0.00 255.0 FORMAT "%5.1" /end CHARACTERISTIC
/begin CHARACTERISTIC DSM_FMKDfp_PFltEngPrt_C "Ausblendbedingungen fuer Fehlerpfad Dfp_PFltEngPrt" VALUE 0xC90D0 Kw_Wu8 255.0 OneToOne 0.00 255.0 FORMAT "%5.1" /end CHARACTERISTIC
/begin CHARACTERISTIC DSM_FMKDfp_PFltPresDynPlaus_C "Ausblendbedingungen fuer Fehlerpfad Dfp_PFltPresDynPlaus" VALUE 0xC90D1 Kw_Wu8 255.0 OneToOne 0.00 255.0 FORMAT "%5.1" /end CHARACTERISTIC
/begin CHARACTERISTIC DSM_FMKDfp_PFltPresSens_C "Ausblendbedingungen fuer Fehlerpfad Dfp_PFltPresSens" VALUE 0xC90D2 Kw_Wu8 255.0 OneToOne 0.00 255.0 FORMAT "%5.1" /end CHARACTERISTIC
/begin CHARACTERISTIC DSM_FMKDfp_PFltPresSensFrz_C "Ausblendbedingungen fuer Fehlerpfad Dfp_PFltPresSensFrz" VALUE 0xC90D3 Kw_Wu8 255.0 OneToOne 0.00 255.0 FORMAT "%5.1" /end CHARACTERISTIC
/begin CHARACTERISTIC DSM_FMKDfp_PFltPresSensHsLn_C "Ausblendbedingungen fuer Fehlerpfad Dfp_PFltPresSensHsLn" VALUE 0xC90D4 Kw_Wu8 255.0 OneToOne 0.00 255.0 FORMAT "%5.1" /end CHARACTERISTIC
/begin CHARACTERISTIC DSM_FMKDfp_PFltPresSensSot_C "Ausblendbedingungen fuer Fehlerpfad Dfp_PFltPresSensSot" VALUE 0xC90D5 Kw_Wu8 255.0 OneToOne 0.00 255.0 FORMAT "%5.1" /end CHARACTERISTIC
/begin CHARACTERISTIC DSM_FMKDfp_PFltRgnPerm_C "Ausblendbedingungen fuer Fehlerpfad Dfp_PFltRgnPerm" VALUE 0xC90D6 Kw_Wu8 255.0 OneToOne 0.00 255.0 FORMAT "%5.1" /end CHARACTERISTIC
/begin CHARACTERISTIC DSM_FMKDfp_PFltTempDwnStrm_C "Ausblendbedingungen fuer Fehlerpfad Dfp_PFltTempDwnStrm" VALUE 0xC90D7 Kw_Wu8 255.0 OneToOne 0.00 255.0 FORMAT "%5.1" /end CHARACTERISTIC
/begin CHARACTERISTIC DSM_FMKDfp_PFltTempSens_C "Ausblendbedingungen fuer Fehlerpfad Dfp_PFltTempSens" VALUE 0xC90D8 Kw_Wu8 255.0 OneToOne 0.00 255.0 FORMAT "%5.1" /end CHARACTERISTIC
/begin CHARACTERISTIC DSM_FMKDfp_PFltTempUpStrm_C "Ausblendbedingungen fuer Fehlerpfad Dfp_PFltTempUpStrm" VALUE 0xC90D9 Kw_Wu8 255.0 OneToOne 0.00 255.0 FORMAT "%5.1" /end CHARACTERISTIC
/begin CHARACTERISTIC DSM_FMKDfp_PFltmSotDiffMax_C "Ausblendbedingungen fuer Fehlerpfad Dfp_PFltmSotDiffMax" VALUE 0xC90DA Kw_Wu8 255.0 OneToOne 0.00 255.0 FORMAT "%5.1" /end CHARACTERISTIC
/begin CHARACTERISTIC DSM_FMKDfp_PSPCD_Actr_C "Ausblendbedingungen fuer Fehlerpfad Dfp_PSPCD_Actr" VALUE 0xC90DB Kw_Wu8 255.0 OneToOne 0.00 255.0 FORMAT "%5.1" /end CHARACTERISTIC
/begin CHARACTERISTIC DSM_FMKDfp_QLTCD_C "Ausblendbedingungen fuer Fehlerpfad Dfp_QLTCD" VALUE 0xC90DC Kw_Wu8 255.0 OneToOne 0.00 255.0 FORMAT "%5.1" /end CHARACTERISTIC
/begin CHARACTERISTIC DSM_FMKDfp_RailCD_C "Ausblendbedingungen fuer Fehlerpfad Dfp_RailCD" VALUE 0xC90DD Kw_Wu8 255.0 OneToOne 0.00 255.0 FORMAT "%5.1" /end CHARACTERISTIC
/begin CHARACTERISTIC DSM_FMKDfp_RailCDOfsTst_C "Ausblendbedingungen fuer Fehlerpfad Dfp_RailCDOfsTst" VALUE 0xC90DE Kw_Wu8 255.0 OneToOne 0.00 255.0 FORMAT "%5.1" /end CHARACTERISTIC
/begin CHARACTERISTIC DSM_FMKDfp_RailCD_PMonStrt_C "Ausblendbedingungen fuer Fehlerpfad Dfp_RailCD_PMonStrt" VALUE 0xC90DF Kw_Wu8 255.0 OneToOne 0.00 255.0 FORMAT "%5.1" /end CHARACTERISTIC
/begin CHARACTERISTIC DSM_FMKDfp_RailCtlModeMeUnDiag_C "Ausblendbedingungen fuer Fehlerpfad Dfp_RailCtlModeMeUnDiag" VALUE 0xC90E0 Kw_Wu8 255.0 OneToOne 0.00 255.0 FORMAT "%5.1" /end CHARACTERISTIC
/begin CHARACTERISTIC DSM_FMKDfp_RailCtlModePCVDiag_C "Ausblendbedingungen fuer Fehlerpfad Dfp_RailCtlModePCVDiag" VALUE 0xC90E1 Kw_Wu8 255.0 OneToOne 0.00 255.0 FORMAT "%5.1" /end CHARACTERISTIC
/begin CHARACTERISTIC DSM_FMKDfp_RailMeUn0_C "Ausblendbedingungen fuer Fehlerpfad Dfp_RailMeUn0" VALUE 0xC90E2 Kw_Wu8 255.0 OneToOne 0.00 255.0 FORMAT "%5.1" /end CHARACTERISTIC
/begin CHARACTERISTIC DSM_FMKDfp_RailMeUn1_C "Ausblendbedingungen fuer Fehlerpfad Dfp_RailMeUn1" VALUE 0xC90E3 Kw_Wu8 255.0 OneToOne 0.00 255.0 FORMAT "%5.1" /end CHARACTERISTIC
/begin CHARACTERISTIC DSM_FMKDfp_RailMeUn2_C "Ausblendbedingungen fuer Fehlerpfad Dfp_RailMeUn2" VALUE 0xC90E4 Kw_Wu8 255.0 OneToOne 0.00 255.0 FORMAT "%5.1" /end CHARACTERISTIC
/begin CHARACTERISTIC DSM_FMKDfp_RailMeUn3_C "Ausblendbedingungen fuer Fehlerpfad Dfp_RailMeUn3" VALUE 0xC90E5 Kw_Wu8 255.0 OneToOne 0.00 255.0 FORMAT "%5.1" /end CHARACTERISTIC
/begin CHARACTERISTIC DSM_FMKDfp_RailMeUn4_C "Ausblendbedingungen fuer Fehlerpfad Dfp_RailMeUn4" VALUE 0xC90E6 Kw_Wu8 255.0 OneToOne 0.00 255.0 FORMAT "%5.1" /end CHARACTERISTIC
/begin CHARACTERISTIC DSM_FMKDfp_RailPCV0_C "Ausblendbedingungen fuer Fehlerpfad Dfp_RailPCV0" VALUE 0xC90E7 Kw_Wu8 255.0 OneToOne 0.00 255.0 FORMAT "%5.1" /end CHARACTERISTIC
/begin CHARACTERISTIC DSM_FMKDfp_RailPCV1_C "Ausblendbedingungen fuer Fehlerpfad Dfp_RailPCV1" VALUE 0xC90E8 Kw_Wu8 255.0 OneToOne 0.00 255.0 FORMAT "%5.1" /end CHARACTERISTIC
/begin CHARACTERISTIC DSM_FMKDfp_RailPCV2_C "Ausblendbedingungen fuer Fehlerpfad Dfp_RailPCV2" VALUE 0xC90E9 Kw_Wu8 255.0 OneToOne 0.00 255.0 FORMAT "%5.1" /end CHARACTERISTIC
/begin CHARACTERISTIC DSM_FMKDfp_RailPCV3_C "Ausblendbedingungen fuer Fehlerpfad Dfp_RailPCV3" VALUE 0xC90EA Kw_Wu8 255.0 OneToOne 0.00 255.0 FORMAT "%5.1" /end CHARACTERISTIC
/begin CHARACTERISTIC DSM_FMKDfp_RailPCV4_C "Ausblendbedingungen fuer Fehlerpfad Dfp_RailPCV4" VALUE 0xC90EB Kw_Wu8 255.0 OneToOne 0.00 255.0 FORMAT "%5.1" /end CHARACTERISTIC
/begin CHARACTERISTIC DSM_FMKDfp_RailPCV5_C "Ausblendbedingungen fuer Fehlerpfad Dfp_RailPCV5" VALUE 0xC90EC Kw_Wu8 255.0 OneToOne 0.00 255.0 FORMAT "%5.1" /end CHARACTERISTIC
/begin CHARACTERISTIC DSM_FMKDfp_SOPTst_C "Ausblendbedingungen fuer Fehlerpfad Dfp_SOPTst" VALUE 0xC90ED Kw_Wu8 255.0 OneToOne 0.00 255.0 FORMAT "%5.1" /end CHARACTERISTIC
/begin CHARACTERISTIC DSM_FMKDfp_SSpMon1_C "Ausblendbedingungen fuer Fehlerpfad Dfp_SSpMon1" VALUE 0xC90EE Kw_Wu8 255.0 OneToOne 0.00 255.0 FORMAT "%5.1" /end CHARACTERISTIC
/begin CHARACTERISTIC DSM_FMKDfp_SSpMon2_C "Ausblendbedingungen fuer Fehlerpfad Dfp_SSpMon2" VALUE 0xC90EF Kw_Wu8 255.0 OneToOne 0.00 255.0 FORMAT "%5.1" /end CHARACTERISTIC
/begin CHARACTERISTIC DSM_FMKDfp_SSpMon3_C "Ausblendbedingungen fuer Fehlerpfad Dfp_SSpMon3" VALUE 0xC90F0 Kw_Wu8 255.0 OneToOne 0.00 255.0 FORMAT "%5.1" /end CHARACTERISTIC
/begin CHARACTERISTIC DSM_FMKDfp_SWChk_CycSigChkDat_C "Ausblendbedingungen fuer Fehlerpfad Dfp_SWChk_CycSigChkDat" VALUE 0xC90F1 Kw_Wu8 255.0 OneToOne 0.00 255.0 FORMAT "%5.1" /end CHARACTERISTIC
/begin CHARACTERISTIC DSM_FMKDfp_SWChk_CycSigChkPrg_C "Ausblendbedingungen fuer Fehlerpfad Dfp_SWChk_CycSigChkPrg" VALUE 0xC90F2 Kw_Wu8 255.0 OneToOne 0.00 255.0 FORMAT "%5.1" /end CHARACTERISTIC
/begin CHARACTERISTIC DSM_FMKDfp_ShutCD_C "Ausblendbedingungen fuer Fehlerpfad Dfp_ShutCD" VALUE 0xC90F3 Kw_Wu8 255.0 OneToOne 0.00 255.0 FORMAT "%5.1" /end CHARACTERISTIC
/begin CHARACTERISTIC DSM_FMKDfp_StSysTrqShutOff_C "Ausblendbedingungen fuer Fehlerpfad Dfp_StSysTrqShutOff" VALUE 0xC90F4 Kw_Wu8 255.0 OneToOne 0.00 255.0 FORMAT "%5.1" /end CHARACTERISTIC
/begin CHARACTERISTIC DSM_FMKDfp_StrtCD_Actr_C "Ausblendbedingungen fuer Fehlerpfad Dfp_StrtCD_Actr" VALUE 0xC90F5 Kw_Wu8 255.0 OneToOne 0.00 255.0 FORMAT "%5.1" /end CHARACTERISTIC
/begin CHARACTERISTIC DSM_FMKDfp_SysLamp_C "Ausblendbedingungen fuer Fehlerpfad Dfp_SysLamp" VALUE 0xC90F6 Kw_Wu8 255.0 OneToOne 0.00 255.0 FORMAT "%5.1" /end CHARACTERISTIC
/begin CHARACTERISTIC DSM_FMKDfp_T15CD_C "Ausblendbedingungen fuer Fehlerpfad Dfp_T15CD" VALUE 0xC90F7 Kw_Wu8 255.0 OneToOne 0.00 255.0 FORMAT "%5.1" /end CHARACTERISTIC
/begin CHARACTERISTIC DSM_FMKDfp_TGearbx_C "Ausblendbedingungen fuer Fehlerpfad Dfp_TGearbx" VALUE 0xC90F8 Kw_Wu8 255.0 OneToOne 0.00 255.0 FORMAT "%5.1" /end CHARACTERISTIC
/begin CHARACTERISTIC DSM_FMKDfp_TPUMon_C "Ausblendbedingungen fuer Fehlerpfad Dfp_TPUMon" VALUE 0xC90F9 Kw_Wu8 255.0 OneToOne 0.00 255.0 FORMAT "%5.1" /end CHARACTERISTIC
/begin CHARACTERISTIC DSM_FMKDfp_TVACD_Max_C "Ausblendbedingungen fuer Fehlerpfad Dfp_TVACD_Max" VALUE 0xC90FA Kw_Wu8 255.0 OneToOne 0.00 255.0 FORMAT "%5.1" /end CHARACTERISTIC
/begin CHARACTERISTIC DSM_FMKDfp_TVACD_Min_C "Ausblendbedingungen fuer Fehlerpfad Dfp_TVACD_Min" VALUE 0xC90FB Kw_Wu8 255.0 OneToOne 0.00 255.0 FORMAT "%5.1" /end CHARACTERISTIC
/begin CHARACTERISTIC DSM_FMKDfp_TVACD_SigNpl_C "Ausblendbedingungen fuer Fehlerpfad Dfp_TVACD_SigNpl" VALUE 0xC90FC Kw_Wu8 255.0 OneToOne 0.00 255.0 FORMAT "%5.1" /end CHARACTERISTIC
/begin CHARACTERISTIC DSM_FMKDfp_TVACD_TVADia1_C "Ausblendbedingungen fuer Fehlerpfad Dfp_TVACD_TVADia1" VALUE 0xC90FD Kw_Wu8 255.0 OneToOne 0.00 255.0 FORMAT "%5.1" /end CHARACTERISTIC
/begin CHARACTERISTIC DSM_FMKDfp_TVACD_TVADia2_C "Ausblendbedingungen fuer Fehlerpfad Dfp_TVACD_TVADia2" VALUE 0xC90FE Kw_Wu8 255.0 OneToOne 0.00 255.0 FORMAT "%5.1" /end CHARACTERISTIC
/begin CHARACTERISTIC DSM_FMKDfp_TVACD_TVADia3_C "Ausblendbedingungen fuer Fehlerpfad Dfp_TVACD_TVADia3" VALUE 0xC90FF Kw_Wu8 255.0 OneToOne 0.00 255.0 FORMAT "%5.1" /end CHARACTERISTIC
/begin CHARACTERISTIC DSM_FMKDfp_TVACD_TVADia4_C "Ausblendbedingungen fuer Fehlerpfad Dfp_TVACD_TVADia4" VALUE 0xC9100 Kw_Wu8 255.0 OneToOne 0.00 255.0 FORMAT "%5.1" /end CHARACTERISTIC
/begin CHARACTERISTIC DSM_FMKDfp_VSACD_DioInDia1_C "Ausblendbedingungen fuer Fehlerpfad Dfp_VSACD_DioInDia1" VALUE 0xC9101 Kw_Wu8 255.0 OneToOne 0.00 255.0 FORMAT "%5.1" /end CHARACTERISTIC
/begin CHARACTERISTIC DSM_FMKDfp_VSACD_DioInDia2_C "Ausblendbedingungen fuer Fehlerpfad Dfp_VSACD_DioInDia2" VALUE 0xC9102 Kw_Wu8 255.0 OneToOne 0.00 255.0 FORMAT "%5.1" /end CHARACTERISTIC
/begin CHARACTERISTIC DSM_FMKDfp_VSACD_DioInDia3_C "Ausblendbedingungen fuer Fehlerpfad Dfp_VSACD_DioInDia3" VALUE 0xC9103 Kw_Wu8 255.0 OneToOne 0.00 255.0 FORMAT "%5.1" /end CHARACTERISTIC
/begin CHARACTERISTIC DSM_FMKDfp_VSACD_DioInDia4_C "Ausblendbedingungen fuer Fehlerpfad Dfp_VSACD_DioInDia4" VALUE 0xC9104 Kw_Wu8 255.0 OneToOne 0.00 255.0 FORMAT "%5.1" /end CHARACTERISTIC
/begin CHARACTERISTIC DSM_FMKDfp_VSACD_DioInMin_C "Ausblendbedingungen fuer Fehlerpfad Dfp_VSACD_DioInMin" VALUE 0xC9105 Kw_Wu8 255.0 OneToOne 0.00 255.0 FORMAT "%5.1" /end CHARACTERISTIC
/begin CHARACTERISTIC DSM_FMKDfp_VSACD_Max_C "Ausblendbedingungen fuer Fehlerpfad Dfp_VSACD_Max" VALUE 0xC9106 Kw_Wu8 255.0 OneToOne 0.00 255.0 FORMAT "%5.1" /end CHARACTERISTIC
/begin CHARACTERISTIC DSM_FMKDfp_VSACD_Min_C "Ausblendbedingungen fuer Fehlerpfad Dfp_VSACD_Min" VALUE 0xC9107 Kw_Wu8 255.0 OneToOne 0.00 255.0 FORMAT "%5.1" /end CHARACTERISTIC
/begin CHARACTERISTIC DSM_FMKDfp_VSACD_SigNpl_C "Ausblendbedingungen fuer Fehlerpfad Dfp_VSACD_SigNpl" VALUE 0xC9108 Kw_Wu8 255.0 OneToOne 0.00 255.0 FORMAT "%5.1" /end CHARACTERISTIC
/begin CHARACTERISTIC DSM_FMKDfp_VSACD_VSADia1_C "Ausblendbedingungen fuer Fehlerpfad Dfp_VSACD_VSADia1" VALUE 0xC9109 Kw_Wu8 255.0 OneToOne 0.00 255.0 FORMAT "%5.1" /end CHARACTERISTIC
/begin CHARACTERISTIC DSM_FMKDfp_VSACD_VSADia2_C "Ausblendbedingungen fuer Fehlerpfad Dfp_VSACD_VSADia2" VALUE 0xC910A Kw_Wu8 255.0 OneToOne 0.00 255.0 FORMAT "%5.1" /end CHARACTERISTIC
/begin CHARACTERISTIC DSM_FMKDfp_VSACD_VSADia3_C "Ausblendbedingungen fuer Fehlerpfad Dfp_VSACD_VSADia3" VALUE 0xC910B Kw_Wu8 255.0 OneToOne 0.00 255.0 FORMAT "%5.1" /end CHARACTERISTIC
/begin CHARACTERISTIC DSM_FMKDfp_VSACD_VSADia4_C "Ausblendbedingungen fuer Fehlerpfad Dfp_VSACD_VSADia4" VALUE 0xC910C Kw_Wu8 255.0 OneToOne 0.00 255.0 FORMAT "%5.1" /end CHARACTERISTIC
/begin CHARACTERISTIC DSM_FMKDfp_VSSCD1_C "Ausblendbedingungen fuer Fehlerpfad Dfp_VSSCD1" VALUE 0xC910D Kw_Wu8 255.0 OneToOne 0.00 255.0 FORMAT "%5.1" /end CHARACTERISTIC
/begin CHARACTERISTIC DSM_FMKDfp_VSSCD2_C "Ausblendbedingungen fuer Fehlerpfad Dfp_VSSCD2" VALUE 0xC910E Kw_Wu8 255.0 OneToOne 0.00 255.0 FORMAT "%5.1" /end CHARACTERISTIC
/begin CHARACTERISTIC DSM_FMKDfp_WdCom_C "Ausblendbedingungen fuer Fehlerpfad Dfp_WdCom" VALUE 0xC910F Kw_Wu8 255.0 OneToOne 0.00 255.0 FORMAT "%5.1" /end CHARACTERISTIC
/begin CHARACTERISTIC DSM_FrzFrEnvironment_C "Freeze frame, Auswahl der Umweltbedingungen" VAL_BLK 0xC8FA8 Kwb_Wu16 255.000000000 SigName 0.00 255.000000000 FORMAT "%13.9" NUMBER 11 /end CHARACTERISTIC
/begin CHARACTERISTIC DSM_stStepWidth_CA "Schrittweite der Ereignisentprellung der up/down counter" VAL_BLK 0xC8FBE Kwb_Wu8 255.0 OneToOne 0.00 255.0 FORMAT "%5.1" NUMBER 4 /end CHARACTERISTIC
/begin CHARACTERISTIC DSM_SysLampMode_C "Aktivierungsbedingung der System Lampe (1= aktuelle Fehler, 0 = bestätigte Fehlerspeichereinträge)" VALUE 0xC8FC2 Kw_Wu8 2.00000000000 SysLampMode 0.00 2.00000000000 FORMAT "%13.11" /end CHARACTERISTIC
/begin CHARACTERISTIC DSM_tiDCMin_C "Mindestzeit für driving cycle Erkennung (Maximalwert = Nachlauf)" VALUE 0xC8FC4 Kw_Wu16 65535.00 TimeDsmDC 0.00 65535.00 FORMAT "%8.2" /end CHARACTERISTIC
/begin CHARACTERISTIC DSM_tiWucDelay_C "Zeitverzögerung für die Abtasung der Kühlwassertemperatur bei Start zur Warm Up Cycle Ermittlung" VALUE 0xC8FC6 Kw_Wu16 655350.0 Time_ms 0.00 655350.0 FORMAT "%8.1" /end CHARACTERISTIC
/begin CHARACTERISTIC DSM_WucMinDiff_C "Minimale Differenztemperatur für warm up cycle" VALUE 0xC8FC8 Kw_Ws16 6553.500 TempDiff_Cels -3276.800 3276.700 FORMAT "%8.3" /end CHARACTERISTIC
/begin CHARACTERISTIC DSM_WucMinTemp_C "Minimaltemperatur für warm up cycle" VALUE 0xC8FCA Kw_Ws16 950.000 Temp_Cels -50.140 899.860 FORMAT "%8.3" EXTENDED_LIMITS -3549.940 3003.560 /end CHARACTERISTIC
/begin MEASUREMENT DSMDur_ctDfctDur1 "Wert Fehlerdauerzähler" UWORD OneToOne 1 100 0.00 65535.00 FORMAT "%8.2" ECU_ADDRESS 0x7F8B92 /end MEASUREMENT
/begin MEASUREMENT DSMDur_ctDfctDur2 "Wert Fehlerdauerzähler 2" UWORD OneToOne 1 100 0.00 65535.00 FORMAT "%8.2" ECU_ADDRESS 0x7F8B94 /end MEASUREMENT
/begin MEASUREMENT DSMDur_stGlobalDefCnt_mp "Aktivierungs und Resetzustand der beiden globalen Fehlerdauerzähler" UBYTE OneToOne 1 100 0.00 255.0 FORMAT "%5.1" ECU_ADDRESS 0x6F8080 /end MEASUREMENT
/begin FUNCTION dsm ""
 /begin DEF_CHARACTERISTIC DSM_cnvMilKmFCM_Offset_C DSM_cnvMilKmFCM_Slope_C DSM_Class1Mil_C DSM_Class1TFlc_C DSM_Class1Flc_C DSM_Class1THlc_C DSM_Class1Hlc_C DSM_Class1Scatt_C DSM_Class1TDlcPen_C DSM_Class1DlcPen_C DSM_Class1TDlc_C DSM_Class1DlcKd_C DSM_Class1Dlc_C DSM_Class1Prio_C DSM_Class1SysLamp_C DSM_Class1ResErf_C DSM_Class1Readiness_C DSM_Class2Mil_C DSM_Class2TFlc_C DSM_Class2Flc_C DSM_Class2THlc_C DSM_Class2Hlc_C DSM_Class2Scatt_C DSM_Class2TDlcPen_C DSM_Class2DlcPen_C DSM_Class2TDlc_C DSM_Class2DlcKd_C DSM_Class2Dlc_C DSM_Class2Prio_C DSM_Class2SysLamp_C DSM_Class2ResErf_C DSM_Class2Readiness_C DSM_Class3Mil_C DSM_Class3TFlc_C DSM_Class3Flc_C DSM_Class3THlc_C DSM_Class3Hlc_C DSM_Class3Scatt_C DSM_Class3TDlcPen_C DSM_Class3DlcPen_C DSM_Class3TDlc_C DSM_Class3DlcKd_C DSM_Class3Dlc_C DSM_Class3Prio_C DSM_Class3SysLamp_C DSM_Class3ResErf_C DSM_Class3Readiness_C DSM_Class4Mil_C DSM_Class4TFlc_C DSM_Class4Flc_C DSM_Class4THlc_C DSM_Class4Hlc_C DSM_Class4Scatt_C DSM_Class4TDlcPen_C DSM_Class4DlcPen_C DSM_Class4TDlc_C DSM_Class4DlcKd_C DSM_Class4Dlc_C DSM_Class4Prio_C DSM_Class4SysLamp_C DSM_Class4ResErf_C DSM_Class4Readiness_C DSM_Class5Mil_C DSM_Class5TFlc_C DSM_Class5Flc_C DSM_Class5THlc_C DSM_Class5Hlc_C DSM_Class5Scatt_C DSM_Class5TDlcPen_C DSM_Class5DlcPen_C DSM_Class5TDlc_C DSM_Class5DlcKd_C DSM_Class5Dlc_C DSM_Class5Prio_C DSM_Class5SysLamp_C DSM_Class5ResErf_C DSM_Class5Readiness_C DSM_Class6Mil_C DSM_Class6TFlc_C DSM_Class6Flc_C DSM_Class6THlc_C DSM_Class6Hlc_C DSM_Class6Scatt_C DSM_Class6TDlcPen_C DSM_Class6DlcPen_C DSM_Class6TDlc_C DSM_Class6DlcKd_C DSM_Class6Dlc_C DSM_Class6Prio_C DSM_Class6SysLamp_C DSM_Class6ResErf_C DSM_Class6Readiness_C DSM_Class7Mil_C DSM_Class7TFlc_C DSM_Class7Flc_C DSM_Class7THlc_C DSM_Class7Hlc_C DSM_Class7Scatt_C DSM_Class7TDlcPen_C DSM_Class7DlcPen_C DSM_Class7TDlc_C DSM_Class7DlcKd_C DSM_Class7Dlc_C DSM_Class7Prio_C DSM_Class7SysLamp_C DSM_Class7ResErf_C DSM_Class7Readiness_C DSM_Class8Mil_C DSM_Class8TFlc_C DSM_Class8Flc_C DSM_Class8THlc_C DSM_Class8Hlc_C DSM_Class8Scatt_C DSM_Class8TDlcPen_C DSM_Class8DlcPen_C DSM_Class8TDlc_C DSM_Class8DlcKd_C DSM_Class8Dlc_C DSM_Class8Prio_C DSM_Class8SysLamp_C DSM_Class8ResErf_C DSM_Class8Readiness_C DSM_Class9Mil_C DSM_Class9TFlc_C DSM_Class9Flc_C DSM_Class9THlc_C DSM_Class9Hlc_C DSM_Class9Scatt_C DSM_Class9TDlcPen_C DSM_Class9DlcPen_C DSM_Class9TDlc_C DSM_Class9DlcKd_C DSM_Class9Dlc_C DSM_Class9Prio_C DSM_Class9SysLamp_C DSM_Class9ResErf_C DSM_Class9Readiness_C DSM_Class10Mil_C DSM_Class10TFlc_C DSM_Class10Flc_C DSM_Class10THlc_C DSM_Class10Hlc_C DSM_Class10Scatt_C DSM_Class10TDlcPen_C DSM_Class10DlcPen_C DSM_Class10TDlc_C DSM_Class10DlcKd_C DSM_Class10Dlc_C DSM_Class10Prio_C DSM_Class10SysLamp_C DSM_Class10ResErf_C DSM_Class10Readiness_C DSM_Class11Mil_C DSM_Class11TFlc_C DSM_Class11Flc_C DSM_Class11THlc_C DSM_Class11Hlc_C DSM_Class11Scatt_C DSM_Class11TDlcPen_C DSM_Class11DlcPen_C DSM_Class11TDlc_C DSM_Class11DlcKd_C DSM_Class11Dlc_C DSM_Class11Prio_C DSM_Class11SysLamp_C DSM_Class11ResErf_C DSM_Class11Readiness_C DSM_Class12Mil_C DSM_Class12TFlc_C DSM_Class12Flc_C DSM_Class12THlc_C DSM_Class12Hlc_C DSM_Class12Scatt_C DSM_Class12TDlcPen_C DSM_Class12DlcPen_C DSM_Class12TDlc_C DSM_Class12DlcKd_C DSM_Class12Dlc_C DSM_Class12Prio_C DSM_Class12SysLamp_C DSM_Class12ResErf_C DSM_Class12Readiness_C DSM_Class13Mil_C DSM_Class13TFlc_C DSM_Class13Flc_C DSM_Class13THlc_C DSM_Class13Hlc_C DSM_Class13Scatt_C DSM_Class13TDlcPen_C DSM_Class13DlcPen_C DSM_Class13TDlc_C DSM_Class13DlcKd_C DSM_Class13Dlc_C DSM_Class13Prio_C DSM_Class13SysLamp_C DSM_Class13ResErf_C DSM_Class13Readiness_C DSM_Class14Mil_C DSM_Class14TFlc_C DSM_Class14Flc_C DSM_Class14THlc_C DSM_Class14Hlc_C DSM_Class14Scatt_C DSM_Class14TDlcPen_C DSM_Class14DlcPen_C DSM_Class14TDlc_C DSM_Class14DlcKd_C DSM_Class14Dlc_C DSM_Class14Prio_C DSM_Class14SysLamp_C DSM_Class14ResErf_C DSM_Class14Readiness_C DSM_Class15Mil_C DSM_Class15TFlc_C DSM_Class15Flc_C DSM_Class15THlc_C DSM_Class15Hlc_C DSM_Class15Scatt_C DSM_Class15TDlcPen_C DSM_Class15DlcPen_C DSM_Class15TDlc_C DSM_Class15DlcKd_C DSM_Class15Dlc_C DSM_Class15Prio_C DSM_Class15SysLamp_C DSM_Class15ResErf_C DSM_Class15Readiness_C DSM_Class16Mil_C DSM_Class16TFlc_C DSM_Class16Flc_C DSM_Class16THlc_C DSM_Class16Hlc_C DSM_Class16Scatt_C DSM_Class16TDlcPen_C DSM_Class16DlcPen_C DSM_Class16TDlc_C DSM_Class16DlcKd_C DSM_Class16Dlc_C DSM_Class16Prio_C DSM_Class16SysLamp_C DSM_Class16ResErf_C DSM_Class16Readiness_C DSM_Class17Mil_C DSM_Class17TFlc_C DSM_Class17Flc_C DSM_Class17THlc_C DSM_Class17Hlc_C DSM_Class17Scatt_C DSM_Class17TDlcPen_C DSM_Class17DlcPen_C DSM_Class17TDlc_C DSM_Class17DlcKd_C DSM_Class17Dlc_C DSM_Class17Prio_C DSM_Class17SysLamp_C DSM_Class17ResErf_C DSM_Class17Readiness_C DSM_Class18Mil_C DSM_Class18TFlc_C DSM_Class18Flc_C DSM_Class18THlc_C DSM_Class18Hlc_C DSM_Class18Scatt_C DSM_Class18TDlcPen_C DSM_Class18DlcPen_C DSM_Class18TDlc_C DSM_Class18DlcKd_C DSM_Class18Dlc_C DSM_Class18Prio_C DSM_Class18SysLamp_C DSM_Class18ResErf_C DSM_Class18Readiness_C DSM_Class19Mil_C DSM_Class19TFlc_C DSM_Class19Flc_C DSM_Class19THlc_C DSM_Class19Hlc_C DSM_Class19Scatt_C DSM_Class19TDlcPen_C DSM_Class19DlcPen_C DSM_Class19TDlc_C DSM_Class19DlcKd_C DSM_Class19Dlc_C DSM_Class19Prio_C DSM_Class19SysLamp_C DSM_Class19ResErf_C DSM_Class19Readiness_C DSM_Class20Mil_C DSM_Class20TFlc_C DSM_Class20Flc_C DSM_Class20THlc_C DSM_Class20Hlc_C DSM_Class20Scatt_C DSM_Class20TDlcPen_C DSM_Class20DlcPen_C DSM_Class20TDlc_C DSM_Class20DlcKd_C DSM_Class20Dlc_C DSM_Class20Prio_C DSM_Class20SysLamp_C DSM_Class20ResErf_C DSM_Class20Readiness_C DSM_FCMClear_C DSM_FrzFrEnvironment_C DSM_stStepWidth_CA DSM_SysLampMode_C DSM_tiDCMin_C DSM_tiWucDelay_C DSM_WucMinDiff_C DSM_WucMinTemp_C /end DEF_CHARACTERISTIC
/end FUNCTION
/begin FUNCTION dsmdur ""
 /begin DEF_CHARACTERISTIC DSMDur_DfctDur1Mode_C DSMDur_DfctDur2Mode_C DSMDur_stDfctDur1Enable_C DSMDur_stDfctDur2Enable_C DSMDur_stDfctDur1Reset_C DSMDur_stDfctDur2Reset_C /end DEF_CHARACTERISTIC
/end FUNCTION
/begin FUNCTION dsmdur_msg "" /begin OUT_MEASUREMENT DSMDur_ctDfctDur1 DSMDur_ctDfctDur2 /end OUT_MEASUREMENT /end FUNCTION
/begin FUNCTION dsmdur_uic "" /begin OUT_MEASUREMENT DSMDur_stGlobalDefCnt_mp /end OUT_MEASUREMENT /end FUNCTION
/begin FUNCTION dsm_auto_blk ""
 /begin DEF_CHARACTERISTIC DSM_FMKDfp_Layer_TANS_C DSM_FMKDfp_ACCDCmpr_C DSM_FMKDfp_ACCDPres_C DSM_FMKDfp_ACCDPres1_C DSM_FMKDfp_ACCDPresAna_C DSM_FMKDfp_ACCDSwtin_C DSM_FMKDfp_ACC_PlausTrqDes_C DSM_FMKDfp_ACC_trqInr_C DSM_FMKDfp_ACTrq_C DSM_FMKDfp_ADCMon_C DSM_FMKDfp_AFSCDIdlAdjVal_C DSM_FMKDfp_AFSCDLdAdjVal_C DSM_FMKDfp_AFSCD_AirTempDcyc_C DSM_FMKDfp_AFSCD_PlOffsDrft_C DSM_FMKDfp_AFSCD_PlSetyDrft_C DSM_FMKDfp_AFSCD_SRCAirTemp_C DSM_FMKDfp_AFSCD_SRCBatt_C DSM_FMKDfp_AFSCD_SRCCorrAirm_C DSM_FMKDfp_AFSCD_SRCRawAirm_C DSM_FMKDfp_Layer_TUMG_C DSM_FMKDfp_AFSCD_SRCRefSigPer_C DSM_FMKDfp_AOHtCD_C DSM_FMKDfp_Layer_GEN_C DSM_FMKDfp_Layer_BSD_C DSM_FMKDfp_AOHtCD_AOHtDia1_C DSM_FMKDfp_AOHtCD_AOHtDia2_C DSM_FMKDfp_AOHtCD_AOHtDia3_C DSM_FMKDfp_APP1_C DSM_FMKDfp_APP2_C DSM_FMKDfp_APPSync_C DSM_FMKDfp_APSCD_C DSM_FMKDfp_ARS_C DSM_FMKDfp_AccPedPlausBrk_C DSM_FMKDfp_AirCtlPlateBreak_C DSM_FMKDfp_Layer_QLT_C DSM_FMKDfp_AirCtl_GovNegDev_C DSM_FMKDfp_Layer_IBS1_C DSM_FMKDfp_Layer_IBS2_C DSM_FMKDfp_Layer_IBS3_C DSM_FMKDfp_Layer_PMBN_C DSM_FMKDfp_Layer_PMBATT_C DSM_FMKDfp_AirCtl_GovNegDev2_C DSM_FMKDfp_AirCtl_GovPosDev_C DSM_FMKDfp_AirCtl_GovPosDev2_C DSM_FMKDfp_AltCD_C DSM_FMKDfp_AltCD_Load_C DSM_FMKDfp_BPACD_BPADia1_C DSM_FMKDfp_BPACD_BPADia2_C DSM_FMKDfp_BPACD_BPADia3_C DSM_FMKDfp_BPACD_Max_C DSM_FMKDfp_BPACD_Min_C DSM_FMKDfp_BPACD_SigNpl_C DSM_FMKDfp_BPSCD_C DSM_FMKDfp_BattCD_C DSM_FMKDfp_BrkCD_C DSM_FMKDfp_Bss_C DSM_FMKDfp_CBACD_C DSM_FMKDfp_CTSCD_C DSM_FMKDfp_Clg_DynTst_C DSM_FMKDfp_CmbChbMisfire1_C DSM_FMKDfp_CmbChbMisfire2_C DSM_FMKDfp_CmbChbMisfire3_C DSM_FMKDfp_CmbChbMisfire4_C DSM_FMKDfp_CmbChbMisfire5_C DSM_FMKDfp_CmbChbMisfire6_C DSM_FMKDfp_CmbChbMisfireMul_C DSM_FMKDfp_CoVMDCSh_C DSM_FMKDfp_ConvCD_C DSM_FMKDfp_CrCCDMFL_C DSM_FMKDfp_CrCtl_vCrCtl_C DSM_FMKDfp_Dummy1_C DSM_FMKDfp_EATSCD_C DSM_FMKDfp_EBAFCD_C DSM_FMKDfp_Layer_PMRUHVERL_C DSM_FMKDfp_EBFCD_C DSM_FMKDfp_EBTSCD_C DSM_FMKDfp_EBTSCD_OvrTemp_C DSM_FMKDfp_EEPCDVarMng_C DSM_FMKDfp_Layer_TOENS_C DSM_FMKDfp_Layer_MANHYDR_C DSM_FMKDfp_Layer_MANLUFT_C DSM_FMKDfp_EGPpCD_C DSM_FMKDfp_EGPpCDTPreTrbn_C DSM_FMKDfp_EGRCD_Max_C DSM_FMKDfp_EGRCD_Min_C DSM_FMKDfp_EGRCD_SigNpl_C DSM_FMKDfp_EGTRgnOilDil_C DSM_FMKDfp_EMCCDNoLoad1_C DSM_FMKDfp_EMCCDNoLoad2_C DSM_FMKDfp_EMCCDSCBat1_C DSM_FMKDfp_EMCCDSCBat2_C DSM_FMKDfp_EMCCDSCGnd1_C DSM_FMKDfp_EMCCDSCGnd2_C DSM_FMKDfp_EMCCD_ADC1_C DSM_FMKDfp_EMCCD_ADC2_C DSM_FMKDfp_ETClbETFltInj1_C DSM_FMKDfp_ETClbETFltInj2_C DSM_FMKDfp_ETClbETFltInj3_C DSM_FMKDfp_ETClbETFltInj4_C DSM_FMKDfp_ETClbETFltInj5_C DSM_FMKDfp_ETClbETFltInj6_C DSM_FMKDfp_ETClbInj1_C DSM_FMKDfp_ETClbInj2_C DSM_FMKDfp_ETClbInj3_C DSM_FMKDfp_ETClbInj4_C DSM_FMKDfp_ETClbInj5_C DSM_FMKDfp_ETClbInj6_C DSM_FMKDfp_EngMCaS1_C DSM_FMKDfp_EngMCrS1_C DSM_FMKDfp_EngMOfsCaSCrS_C DSM_FMKDfp_EngPrtFWODet_C DSM_FMKDfp_FBCqDvt_C DSM_FMKDfp_FMTC_NonMonotonMap_C DSM_FMKDfp_FTSCD_C DSM_FMKDfp_FanCD_C DSM_FMKDfp_FanCD_FanCtlr1_C DSM_FMKDfp_FanCD_FanCtlr2_C DSM_FMKDfp_FanCD_FanCtlr3_C DSM_FMKDfp_FlFCD_C DSM_FMKDfp_FlMngSmkDefect_C DSM_FMKDfp_FrmMngASC1_C DSM_FMKDfp_FrmMngASC2_C DSM_FMKDfp_FrmMngASC3_C DSM_FMKDfp_FrmMngASC4_C DSM_FMKDfp_FrmMngBOS_RESET_C DSM_FMKDfp_FrmMngBOS_RESET_2_C DSM_FMKDfp_FrmMngDMANFAFS_C DSM_FMKDfp_FrmMngDRMANFSSG_C DSM_FMKDfp_FrmMngEGS1_C DSM_FMKDfp_FrmMngEGS2_C DSM_FMKDfp_FrmMngGEARBX_DATA_C DSM_FMKDfp_FrmMngGEARBX_DATA2_C DSM_FMKDfp_FrmMngHEAT_AC_C DSM_FMKDfp_FrmMngINSTR2_C DSM_FMKDfp_FrmMngINSTR3_C DSM_FMKDfp_FrmMngLENKRADWINKEL_C DSM_FMKDfp_FrmMngMILEAGE_RANGE_C DSM_FMKDfp_FrmMngOPCRCTLACC_C DSM_FMKDfp_FrmMngPRGG_CCTR_C DSM_FMKDfp_FrmMngPWRMNG_LOADV_C DSM_FMKDfp_FrmMngParkConsumer_C DSM_FMKDfp_FrmMngRQSTGEFAN_C DSM_FMKDfp_FrmMngSSGErr_C DSM_FMKDfp_FrmMngSSGShOff_C DSM_FMKDfp_FrmMngSTAT_ANH_C DSM_FMKDfp_FrmMngSTAT_ARS_C DSM_FMKDfp_FrmMngSTAT_DSC_C DSM_FMKDfp_FrmMngSTAT_EKP_C DSM_FMKDfp_FrmMngSTAT_KOMBI_C DSM_FMKDfp_FrmMngSTAT_SITZ_C DSM_FMKDfp_FrmMngStOBDGbxMilOf_C DSM_FMKDfp_FrmMngStOBDGbxMilOn_C DSM_FMKDfp_FrmMngTEMPRELTIME_C DSM_FMKDfp_FrmMngTERMINAL_C DSM_FMKDfp_FrmMngTIME_DATE_C DSM_FMKDfp_FrmMngTORQUE_DSC_C DSM_FMKDfp_FrmMngTORQUE_GEARBX_C DSM_FMKDfp_FrmMngTrq_ReqACC_C DSM_FMKDfp_FrmMngVEH_MOD_C DSM_FMKDfp_FrmMngVELOCITY_C DSM_FMKDfp_FrmMngWHEEL_SPEED_C DSM_FMKDfp_FrmMngstCurr_C DSM_FMKDfp_FrmMngswtPSPOff_C DSM_FMKDfp_GearbxIncMax_C DSM_FMKDfp_GlwCD_C DSM_FMKDfp_GlwCDGlwCirc1_C DSM_FMKDfp_GlwCDGlwCirc2_C DSM_FMKDfp_GlwCDGlwCirc3_C DSM_FMKDfp_GlwCDGlwCirc4_C DSM_FMKDfp_GlwCDGlwCirc5_C DSM_FMKDfp_GlwCDGlwCirc6_C DSM_FMKDfp_GlwCDGlwCirc7_C DSM_FMKDfp_GlwCDGlwCirc8_C DSM_FMKDfp_GlwCtl_C DSM_FMKDfp_HWEMonCom_C DSM_FMKDfp_HWEMonEEPROM_C DSM_FMKDfp_HWEMonRcyLocked_C DSM_FMKDfp_HWEMonRcySuppressed_C DSM_FMKDfp_HWEMonRcyVisible_C DSM_FMKDfp_HWEMonUMaxSupply_C DSM_FMKDfp_HWEMonUMinSupply_C DSM_FMKDfp_IATSCD_C DSM_FMKDfp_IATSCD_CATS_C DSM_FMKDfp_ImmCtlImmCD_C DSM_FMKDfp_ImmCtlImmEep_C DSM_FMKDfp_ImmCtlMpl_C DSM_FMKDfp_IndSys1_C DSM_FMKDfp_IndSys2_C DSM_FMKDfp_InjCrv_InjLim_C DSM_FMKDfp_InjCtlAdjQnt_C DSM_FMKDfp_InjCtlDrift_C DSM_FMKDfp_InjVlvBnk1A_C DSM_FMKDfp_InjVlvBnk1B_C DSM_FMKDfp_InjVlvBnk2A_C DSM_FMKDfp_InjVlvBnk2B_C DSM_FMKDfp_InjVlvChipA_C DSM_FMKDfp_InjVlvChipB_C DSM_FMKDfp_InjVlvCyl1A_C DSM_FMKDfp_InjVlvCyl1B_C DSM_FMKDfp_InjVlvCyl2A_C DSM_FMKDfp_InjVlvCyl2B_C DSM_FMKDfp_InjVlvCyl3A_C DSM_FMKDfp_InjVlvCyl3B_C DSM_FMKDfp_InjVlvCyl4A_C DSM_FMKDfp_InjVlvCyl4B_C DSM_FMKDfp_InjVlvCyl5A_C DSM_FMKDfp_InjVlvCyl5B_C DSM_FMKDfp_InjVlvCyl6A_C DSM_FMKDfp_InjVlvCyl6B_C DSM_FMKDfp_LPACD_Max_C DSM_FMKDfp_LPACD_Min_C DSM_FMKDfp_LPACD_SigNpl_C DSM_FMKDfp_LSUCDCircNernst0_C DSM_FMKDfp_LSUCDCircPumpCur0_C DSM_FMKDfp_LSUCDCircVirtGnd0_C DSM_FMKDfp_LSUCDHeater0_C DSM_FMKDfp_LSUCDHtCoup0_C DSM_FMKDfp_LSUCDO20_C DSM_FMKDfp_LSUCDO2Clb0_C DSM_FMKDfp_LSUCDRiClb0_C DSM_FMKDfp_LSUCDSPI0_C DSM_FMKDfp_LSUCDSPIBattLow0_C DSM_FMKDfp_LSUCDWireIP0_C DSM_FMKDfp_LSUCtlRiExc0_C DSM_FMKDfp_LSUMon1Sens_C DSM_FMKDfp_LSUMon2Sens_C DSM_FMKDfp_LubCD_C DSM_FMKDfp_MIL_C DSM_FMKDfp_MRlyCD_C DSM_FMKDfp_MSidCD_Comm_C DSM_FMKDfp_MSidCD_Pin_C DSM_FMKDfp_MSidCD_Sel_INI_C DSM_FMKDfp_MSidCD_Select_C DSM_FMKDfp_MeUnCDNoLoad_C DSM_FMKDfp_MeUnCDSCBat_C DSM_FMKDfp_MeUnCDSCGnd_C DSM_FMKDfp_MeUnCD_ADC_C DSM_FMKDfp_MeUnCD_SigTst_C DSM_FMKDfp_Montr_C DSM_FMKDfp_NetMngDeviceA_C DSM_FMKDfp_NetMngDeviceB_C DSM_FMKDfp_NetMngDeviceC_C DSM_FMKDfp_OPSCD_Lamp_C DSM_FMKDfp_OPSCD_anain_C DSM_FMKDfp_OTSCD_C DSM_FMKDfp_OvRMon_C DSM_FMKDfp_OvRMonBrk_C DSM_FMKDfp_OvRMonSigA_C DSM_FMKDfp_OxiCCDTPre_C DSM_FMKDfp_PCR_GovDevNeg_C DSM_FMKDfp_PCR_GovDevPos_C DSM_FMKDfp_PCVCDNoLoad_C DSM_FMKDfp_PCVCDSCBat_C DSM_FMKDfp_PCVCDSCGnd_C DSM_FMKDfp_PCVCD_ADC_C DSM_FMKDfp_PCVCD_SigTst_C DSM_FMKDfp_PFltAPSens_C DSM_FMKDfp_PFltCDPPre_C DSM_FMKDfp_PFltCDTempPre_C DSM_FMKDfp_PFltChar_C DSM_FMKDfp_PFltEngPrt_C DSM_FMKDfp_PFltPresDynPlaus_C DSM_FMKDfp_PFltPresSens_C DSM_FMKDfp_PFltPresSensFrz_C DSM_FMKDfp_PFltPresSensHsLn_C DSM_FMKDfp_PFltPresSensSot_C DSM_FMKDfp_PFltRgnPerm_C DSM_FMKDfp_PFltTempDwnStrm_C DSM_FMKDfp_PFltTempSens_C DSM_FMKDfp_PFltTempUpStrm_C DSM_FMKDfp_PFltmSotDiffMax_C DSM_FMKDfp_PSPCD_Actr_C DSM_FMKDfp_QLTCD_C DSM_FMKDfp_RailCD_C DSM_FMKDfp_RailCDOfsTst_C DSM_FMKDfp_RailCD_PMonStrt_C DSM_FMKDfp_RailCtlModeMeUnDiag_C DSM_FMKDfp_RailCtlModePCVDiag_C DSM_FMKDfp_RailMeUn0_C DSM_FMKDfp_RailMeUn1_C DSM_FMKDfp_RailMeUn2_C DSM_FMKDfp_RailMeUn3_C DSM_FMKDfp_RailMeUn4_C DSM_FMKDfp_RailPCV0_C DSM_FMKDfp_RailPCV1_C DSM_FMKDfp_RailPCV2_C DSM_FMKDfp_RailPCV3_C DSM_FMKDfp_RailPCV4_C DSM_FMKDfp_RailPCV5_C DSM_FMKDfp_SOPTst_C DSM_FMKDfp_SSpMon1_C DSM_FMKDfp_SSpMon2_C DSM_FMKDfp_SSpMon3_C DSM_FMKDfp_SWChk_CycSigChkDat_C DSM_FMKDfp_SWChk_CycSigChkPrg_C DSM_FMKDfp_ShutCD_C DSM_FMKDfp_StSysTrqShutOff_C DSM_FMKDfp_StrtCD_Actr_C DSM_FMKDfp_SysLamp_C DSM_FMKDfp_T15CD_C DSM_FMKDfp_TGearbx_C DSM_FMKDfp_TPUMon_C DSM_FMKDfp_TVACD_Max_C DSM_FMKDfp_TVACD_Min_C DSM_FMKDfp_TVACD_SigNpl_C DSM_FMKDfp_TVACD_TVADia1_C DSM_FMKDfp_TVACD_TVADia2_C DSM_FMKDfp_TVACD_TVADia3_C DSM_FMKDfp_TVACD_TVADia4_C DSM_FMKDfp_VSACD_DioInDia1_C DSM_FMKDfp_VSACD_DioInDia2_C DSM_FMKDfp_VSACD_DioInDia3_C DSM_FMKDfp_VSACD_DioInDia4_C DSM_FMKDfp_VSACD_DioInMin_C DSM_FMKDfp_VSACD_Max_C DSM_FMKDfp_VSACD_Min_C DSM_FMKDfp_VSACD_SigNpl_C DSM_FMKDfp_VSACD_VSADia1_C DSM_FMKDfp_VSACD_VSADia2_C DSM_FMKDfp_VSACD_VSADia3_C DSM_FMKDfp_VSACD_VSADia4_C DSM_FMKDfp_VSSCD1_C DSM_FMKDfp_VSSCD2_C DSM_FMKDfp_WdCom_C /end DEF_CHARACTERISTIC
/end FUNCTION
/begin COMPU_METHOD ClassTrigger "Verbale Umrechnung für DSM_Class%TFlc_C und DSM_Class%THlc_C" TAB_VERB "%6.3" "-" COMPU_TAB_REF ClassTrigger /end COMPU_METHOD
/begin COMPU_VTAB ClassTrigger "Verbale Umrechnung für DSM_Class%TFlc_C und DSM_Class%THlc_C" TAB_VERB 4 0 "no handling" 1 "time quantum" 2 "driving cycle" 3 "warm up cycle" /end COMPU_VTAB
/begin COMPU_METHOD ClassTriggerTDlc "Verbale Umrechnung für DSM_Class%TDlc_C und DSM_Class%TDlcPen_C" TAB_VERB "%6.3" "-" COMPU_TAB_REF ClassTriggerTDlc /end COMPU_METHOD
/begin COMPU_VTAB ClassTriggerTDlc "Verbale Umrechnung für DSM_Class%TDlc_C und DSM_Class%TDlcPen_C" TAB_VERB 4 0 "no handling" 1 "each afterrun_1" 2 "each afterrun_2" 3 "warm up cycle" /end COMPU_VTAB
/begin COMPU_METHOD LengthKm "Länge in Kilometer" RAT_FUNC "%6.2" "km" COEFFS 0 1 0 0 0 1 /end COMPU_METHOD
/begin COMPU_METHOD Mil "Verbale Umrechnung für DSM_Class%Mil_C" TAB_VERB "%6.3" "-" COMPU_TAB_REF Mil /end COMPU_METHOD
/begin COMPU_VTAB Mil "Verbale Umrechnung für DSM_Class%Mil_C" TAB_VERB 3 0 "Mil OFF" 1 "Mil ON" 2 "Mil BLINK" /end COMPU_VTAB
/begin COMPU_METHOD OneToOne "eins zu eins (physikalischer Wert ist gleich dem internen Wert)" RAT_FUNC "%6.2" "-" COEFFS 0 1 0 0 0 1 /end COMPU_METHOD
/begin COMPU_METHOD Readiness "Verbale Umrechnung für DSM_Class%Readiness_C" TAB_VERB "%6.3" "-" COMPU_TAB_REF Readiness /end COMPU_METHOD
/begin COMPU_VTAB Readiness "Verbale Umrechnung für DSM_Class%Readiness_C" TAB_VERB 8 0 "non" 1 "EGR system monitoring" 2 "catalyst monitoring" 4 "misfire monitoring" 8 "fuel system" 16 "comprehensive components" 32 "oxygen sensor" 64 "oxygen sensor heater" /end COMPU_VTAB
/begin COMPU_METHOD ResErf "Verbale Umrechnung für DSM_Class%ResErf_C" TAB_VERB "%6.3" "-" COMPU_TAB_REF ResErf /end COMPU_METHOD
/begin COMPU_VTAB ResErf "Verbale Umrechnung für DSM_Class%ResErf_C" TAB_VERB 4 0 "no Reset" 1 "Reset on Init" 2 "Reset on Restart" 3 "Reset on Init or Restart" /end COMPU_VTAB
/begin COMPU_METHOD Scatt "Verbale Umrechnugn für DSM_Class%Scatt_C" TAB_VERB "%6.3" "-" COMPU_TAB_REF Scatt /end COMPU_METHOD
/begin COMPU_VTAB Scatt "Verbale Umrechnugn für DSM_Class%Scatt_C" TAB_VERB 2 0 "not visible for OBD-Tester" 1 "visible for OBD-Tester" /end COMPU_VTAB
/begin COMPU_METHOD SigName "Verbale Umrechnung für Signal Referenz Nummern" TAB_VERB "%6.3" "-" COMPU_TAB_REF SigName /end COMPU_METHOD
/begin COMPU_VTAB SigName "Verbale Umrechnung für Signal Referenz Nummern" TAB_VERB 109 0 "Sig_unused" 4 "CoEng_rTrq__Carb_r_DLen1" 5 "CTSCD_tClntLin__Carb_t_DLen1" 11 "BPSCD_pLin__Carb_p_DLen1" 12 "Eng_nAvrg__Carb_n_DLen2" 13 "VSSCD_vSensVal__Carb_v_DLen1" 15 "AFSCD_tAir_mp__Carb_t_DLen1" 16 "AFSCD_dmAirRawPerTime__Carb_mAirTim_DLen2" 28 "Signals_PID0x1C_C__OneToOne_DLen1" 33 "DSMDur_ctDfctDur1__Carb_l_DLen2" 128 "AFSCD_dmAirPerTime__mAirTim_DLen2" 129 "AFSCD_mAirPerCyl__mAirCyl_DLen2" 131 "AFSCD_rAir__dcyc_DLen2" 133 "AOHtCD_rOut_mp__dcyc_DLen2" 134 "APPCD_rFlt__r_DLen2" 137 "APPCD_uRawAPP1__u_DLen2" 138 "APPCD_uRawAPP2__u_DLen2" 139 "APSCD_pVal__p_DLen2" 140 "APSCD_uRaw__u_DLen2" 141 "AirCtl_mDesVal__mAirCyl_DLen2" 142 "AltCD_rAltLoad__r_DLen2" 143 "BPACD_rOut__dcyc_DLen2" 145 "BPSCD_pOutVal__p_DLen2" 146 "BPSCD_uRawVal__u_DLen2" 147 "BattCD_u__uBatt_DLen2" 148 "CBACD_stLogicOut_mp__OneToOne_DLen1" 149 "CTSCD_tClnt__t_DLen2" 150 "CTSCD_uRaw__u_DLen2" 151 "CoEng_trq__trq_DLen2" 152 "EBAFCD_stSigOut__OneToOne_DLen1" 153 "EGRCD_rOut__dcyc_DLen2" 155 "EGT_st__ShftRght0Byte_DLen2" 156 "EngM_stOut__OneToOne_DLen1" 157 "EngM_stSync__OneToOne_DLen1" 158 "Eng_nAvrg__n_DLen2" 159 "FMTC_trqInr__trq_DLen2" 160 "FTSCD_tFuel__t_DLen2" 161 "FTSCD_uRaw__u_DLen2" 162 "FanCD_dcycRaw_mp__dcyc_DLen2" 163 "FlFCD_stFlFltRawVal__OneToOne_DLen1" 164 "FrmMng_nPSP__nPSPSpd_DLen2" 165 "FrmMng_rPSPSetPoint__r_DLen2" 166 "GlwCtl_rPwrOut__OneToOne_DLen1" 167 "GlwCtl_stLampOut__OneToOne_DLen1" 168 "HWEMon_numRecovery__ShftRght0Byte_DLen2" 169 "HWEMon_numRecovery__ShftRght1Byte_DLen2" 170 "HWEMon_recLocLow_mp__ShftRght0Byte_DLen2" 171 "HWEMon_recLocLow_mp__ShftRght1Byte_DLen2" 172 "HWEMon_recLocHigh_mp__ShftRght0Byte_DLen2" 173 "IATSCD_tAir__t_DLen2" 174 "IATSCD_tAirCats__t_DLen2" 176 "IATSCD_uRawCats__u_DLen2" 181 "InjCtl_qCurr__qInjMassCyc_DLen2" 182 "InjCtl_qSetUnBal__qInjMassCyc_DLen2" 183 "LIGov_nSetpoint__n_DLen2" 184 "LIGov_trq__trq_DLen2" 185 "LPACD_rOut__dcyc_DLen2" 186 "LSUCD_rO2Raw[0]__O2_DLen2" 187 "LSUCD_uO2Raw[0]__u_DLen2" 188 "LSU_rLmbd[0]__Lambda_DLen2" 189 "LSU_rO2Adpt[0]__O2_DLen2" 190 "MeUnCD_dcycOut_mp__dcyc_DLen2" 191 "OPSCD_stSigOut__OneToOne_DLen1" 192 "OPSCD_stpOEL__OneToOne_DLen1" 193 "OTSCD_tEngOil__t_DLen2" 194 "OxiCCD_tPre__tExhaustgas_DLen2" 196 "OxiCCD_uRawTempPre__u_DLen2" 198 "PCR_pDesVal__p_DLen2" 199 "PCVCD_dcycOut_mp__dcyc_DLen2" 200 "PFltCD_pPre__p_DLen2" 202 "PFltCD_tPre__tExhaustgas_DLen2" 204 "PFltCD_uRawPresPre_mp__u_DLen2" 206 "PFltCD_uRawTempPre__u_DLen2" 208 "PFlt_dvol__volph_DLen2" 209 "PFlt_lSnceRgnu16_mp__lenrgnu16PFlt_DLen2" 211 "PFlt_mAshOil__mSoot_DLen2" 212 "PFlt_mSot__mSoot_DLen2" 213 "PFlt_mSotSim__mSoot_DLen2" 214 "PFlt_numEngPOp__OneToOne_DLen1" 215 "PFlt_numRgn_mp__OneToOne_DLen1" 216 "PFlt_pDiff__p_DLen2" 217 "PFlt_qFl_mp__FlConPFlt_DLen2" 219 "PFlt_stEngPOp__OneToOne_DLen1" 220 "PFlt_stIntr_mp__OneToOne_DLen1" 221 "PFlt_stLck_mp__OneToOne_DLen1" 222 "PSPCD_dvolOut__FlCon_DLen2" 223 "RailCD_pPeak__pRail_DLen2" 224 "RailCD_uPeakRaw__u_DLen2" 225 "Rail_pSetPoint__pRail_DLen2" 226 "TVACD_rOut__dcyc_DLen2" 228 "VSACD_rOut__dcyc_DLen2" 229 "VSSCD_v__v_DLen2" 230 "VehDa_tiEngOn__timEng_DLen2" 240 "Absch_korr__FSwQ0p00153_DLen2" 241 "D_soc__FSwB100_DLen2" 242 "I_batt__IUwQ0p08O200_DLen2" 243 "Oz_oelkm__KmUwQ10_DLen2" 244 "Oz_oelnivkurz__TdUbQ0p5_DLen1" 245 "Oz_oelnivnorm__TdUbQ0p5_DLen1" 246 "Oz_oelnivori__TdUbQ0p5_DLen1" 247 "Pm_klemmstat__DezUbQ1_DLen1" 248 "Stat_sv_reg1__DezUbQ1_DLen1" 249 "Stat_sv_reg2__DezUbQ1_DLen1" 250 "T2histshort__TdUbQ14p9333_DLen1" 251 "T3histshort__TdUbQ14p9333_DLen1" 252 "T4histshort__TdUbQ14p9333_DLen1" 253 "Toel__TSwQ0p1_DLen2" 254 "T_batt__TSwQ0p1_DLen2" 255 "U_batt__UUwQ0p25em3_DLen2" /end COMPU_VTAB
/begin COMPU_METHOD SlopeRes1000 "Umrechnung für Slope: Slopewert mit Verhältnis 0,001" RAT_FUNC "%6.5" "-" COEFFS 0 1000 0 0 0 1 /end COMPU_METHOD
/begin COMPU_METHOD SysLamp "Verbale Umrechnung für DSM_Class%SysLamp_C" TAB_VERB "%6.3" "-" COMPU_TAB_REF SysLamp /end COMPU_METHOD
/begin COMPU_VTAB SysLamp "Verbale Umrechnung für DSM_Class%SysLamp_C" TAB_VERB 3 0 "SysLamp OFF" 1 "SysLamp ON" 2 "SysLamp BLINK" /end COMPU_VTAB
/begin COMPU_METHOD SysLampMode "Verbale Umrechnung für DSM_SysLampMode_C" TAB_VERB "%6.3" "-" COMPU_TAB_REF SysLampMode /end COMPU_METHOD
/begin COMPU_VTAB SysLampMode "Verbale Umrechnung für DSM_SysLampMode_C" TAB_VERB 3 0 "controlled by FCM Statemachine" 1 "controlled by entry defect Status" 2 "controlled by dfp Status" /end COMPU_VTAB
/begin COMPU_METHOD TempDiff_Cels "difference/offset temperature displayed in degree celcius" RAT_FUNC "%6.3" "deg C" COEFFS 0 10 0 0 0 1 /end COMPU_METHOD
/begin COMPU_METHOD Temp_Cels "Temperatur dargestellt in °C (gleiche interne Darstellung wie Temp_Kelv)" RAT_FUNC "%6.1" "deg C" COEFFS 0 10 2731.4 0 0 1 /end COMPU_METHOD
/begin COMPU_METHOD TimeDsmDC "Skalierung Zeit DSM Driving cycle Verzögerung" RAT_FUNC "%6.2" "s" COEFFS 0 1 0 0 0 1 /end COMPU_METHOD
/begin COMPU_METHOD Time_ms "Zeit in ms für Fehlerentprellung (DSM) und SW-Timer" RAT_FUNC "%6.1" "ms" COEFFS 0 0.1 0 0 0 1 /end COMPU_METHOD
/begin RECORD_LAYOUT Kwb_Wu16 FNC_VALUES 1 UWORD COLUMN_DIR DIRECT /end RECORD_LAYOUT
/begin RECORD_LAYOUT Kwb_Wu8 FNC_VALUES 1 UBYTE COLUMN_DIR DIRECT /end RECORD_LAYOUT
/begin RECORD_LAYOUT Kw_Ws16 FNC_VALUES 1 SWORD COLUMN_DIR DIRECT /end RECORD_LAYOUT
/begin RECORD_LAYOUT Kw_Wu16 FNC_VALUES 1 UWORD COLUMN_DIR DIRECT /end RECORD_LAYOUT
/begin RECORD_LAYOUT Kw_Wu8 FNC_VALUES 1 UBYTE COLUMN_DIR DIRECT /end RECORD_LAYOUT
/end MODULE
/end PROJECT
