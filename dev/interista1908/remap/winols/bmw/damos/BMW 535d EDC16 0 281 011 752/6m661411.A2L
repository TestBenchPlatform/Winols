ASAP2_VERSION 1 3
/begin PROJECT P411 "BMW DDE6.0 6-Zylinder V66.1 07.01.2004 CAN12H"
/begin HEADER "" VERSION "V571_6Z_CAN12H" PROJECT_NO P411 /end HEADER
/begin MODULE DIM ""
/begin MOD_COMMON "" BYTE_ORDER MSB_FIRST ALIGNMENT_BYTE 1 ALIGNMENT_WORD 2 ALIGNMENT_LONG 4 ALIGNMENT_FLOAT32_IEEE 4 /end MOD_COMMON
/begin CHARACTERISTIC DSM_ClaDfp_Layer_TANS_C "Fehlerklasse fuer Fehlerpfad Dfp_Layer_TANS" VALUE 0xCA550 Kw_Wu8 20.00 OneToOne 0.00 20.00 FORMAT "%5.2" EXTENDED_LIMITS 0.00 255.0 /end CHARACTERISTIC
/begin CHARACTERISTIC DSM_ClaDfp_ACCDCmpr_C "Fehlerklasse fuer Fehlerpfad Dfp_ACCDCmpr" VALUE 0xCA551 Kw_Wu8 20.00 OneToOne 0.00 20.00 FORMAT "%5.2" EXTENDED_LIMITS 0.00 255.0 /end CHARACTERISTIC
/begin CHARACTERISTIC DSM_ClaDfp_ACCDPres_C "Fehlerklasse fuer Fehlerpfad Dfp_ACCDPres" VALUE 0xCA552 Kw_Wu8 20.00 OneToOne 0.00 20.00 FORMAT "%5.2" EXTENDED_LIMITS 0.00 255.0 /end CHARACTERISTIC
/begin CHARACTERISTIC DSM_ClaDfp_ACCDPres1_C "Fehlerklasse fuer Fehlerpfad Dfp_ACCDPres1" VALUE 0xCA553 Kw_Wu8 20.00 OneToOne 0.00 20.00 FORMAT "%5.2" EXTENDED_LIMITS 0.00 255.0 /end CHARACTERISTIC
/begin CHARACTERISTIC DSM_ClaDfp_ACCDPresAna_C "Fehlerklasse fuer Fehlerpfad Dfp_ACCDPresAna" VALUE 0xCA554 Kw_Wu8 20.00 OneToOne 0.00 20.00 FORMAT "%5.2" EXTENDED_LIMITS 0.00 255.0 /end CHARACTERISTIC
/begin CHARACTERISTIC DSM_ClaDfp_ACCDSwtin_C "Fehlerklasse fuer Fehlerpfad Dfp_ACCDSwtin" VALUE 0xCA555 Kw_Wu8 20.00 OneToOne 0.00 20.00 FORMAT "%5.2" EXTENDED_LIMITS 0.00 255.0 /end CHARACTERISTIC
/begin CHARACTERISTIC DSM_ClaDfp_ACC_PlausTrqDes_C "Fehlerklasse fuer Fehlerpfad Dfp_ACC_PlausTrqDes" VALUE 0xCA556 Kw_Wu8 20.00 OneToOne 0.00 20.00 FORMAT "%5.2" EXTENDED_LIMITS 0.00 255.0 /end CHARACTERISTIC
/begin CHARACTERISTIC DSM_ClaDfp_ACC_trqInr_C "Fehlerklasse fuer Fehlerpfad Dfp_ACC_trqInr" VALUE 0xCA557 Kw_Wu8 20.00 OneToOne 0.00 20.00 FORMAT "%5.2" EXTENDED_LIMITS 0.00 255.0 /end CHARACTERISTIC
/begin CHARACTERISTIC DSM_ClaDfp_ACTrq_C "Fehlerklasse fuer Fehlerpfad Dfp_ACTrq" VALUE 0xCA558 Kw_Wu8 20.00 OneToOne 0.00 20.00 FORMAT "%5.2" EXTENDED_LIMITS 0.00 255.0 /end CHARACTERISTIC
/begin CHARACTERISTIC DSM_ClaDfp_ADCMon_C "Fehlerklasse fuer Fehlerpfad Dfp_ADCMon" VALUE 0xCA559 Kw_Wu8 20.00 OneToOne 0.00 20.00 FORMAT "%5.2" EXTENDED_LIMITS 0.00 255.0 /end CHARACTERISTIC
/begin CHARACTERISTIC DSM_ClaDfp_AFSCDIdlAdjVal_C "Fehlerklasse fuer Fehlerpfad Dfp_AFSCDIdlAdjVal" VALUE 0xCA55A Kw_Wu8 20.00 OneToOne 0.00 20.00 FORMAT "%5.2" EXTENDED_LIMITS 0.00 255.0 /end CHARACTERISTIC
/begin CHARACTERISTIC DSM_ClaDfp_AFSCDLdAdjVal_C "Fehlerklasse fuer Fehlerpfad Dfp_AFSCDLdAdjVal" VALUE 0xCA55B Kw_Wu8 20.00 OneToOne 0.00 20.00 FORMAT "%5.2" EXTENDED_LIMITS 0.00 255.0 /end CHARACTERISTIC
/begin CHARACTERISTIC DSM_ClaDfp_AFSCD_AirTempDcyc_C "Fehlerklasse fuer Fehlerpfad Dfp_AFSCD_AirTempDcyc" VALUE 0xCA55C Kw_Wu8 20.00 OneToOne 0.00 20.00 FORMAT "%5.2" EXTENDED_LIMITS 0.00 255.0 /end CHARACTERISTIC
/begin CHARACTERISTIC DSM_ClaDfp_AFSCD_PlOffsDrft_C "Fehlerklasse fuer Fehlerpfad Dfp_AFSCD_PlOffsDrft" VALUE 0xCA55D Kw_Wu8 20.00 OneToOne 0.00 20.00 FORMAT "%5.2" EXTENDED_LIMITS 0.00 255.0 /end CHARACTERISTIC
/begin CHARACTERISTIC DSM_ClaDfp_AFSCD_PlSetyDrft_C "Fehlerklasse fuer Fehlerpfad Dfp_AFSCD_PlSetyDrft" VALUE 0xCA55E Kw_Wu8 20.00 OneToOne 0.00 20.00 FORMAT "%5.2" EXTENDED_LIMITS 0.00 255.0 /end CHARACTERISTIC
/begin CHARACTERISTIC DSM_ClaDfp_AFSCD_SRCAirTemp_C "Fehlerklasse fuer Fehlerpfad Dfp_AFSCD_SRCAirTemp" VALUE 0xCA55F Kw_Wu8 20.00 OneToOne 0.00 20.00 FORMAT "%5.2" EXTENDED_LIMITS 0.00 255.0 /end CHARACTERISTIC
/begin CHARACTERISTIC DSM_ClaDfp_AFSCD_SRCBatt_C "Fehlerklasse fuer Fehlerpfad Dfp_AFSCD_SRCBatt" VALUE 0xCA560 Kw_Wu8 20.00 OneToOne 0.00 20.00 FORMAT "%5.2" EXTENDED_LIMITS 0.00 255.0 /end CHARACTERISTIC
/begin CHARACTERISTIC DSM_ClaDfp_AFSCD_SRCCorrAirm_C "Fehlerklasse fuer Fehlerpfad Dfp_AFSCD_SRCCorrAirm" VALUE 0xCA561 Kw_Wu8 20.00 OneToOne 0.00 20.00 FORMAT "%5.2" EXTENDED_LIMITS 0.00 255.0 /end CHARACTERISTIC
/begin CHARACTERISTIC DSM_ClaDfp_AFSCD_SRCRawAirm_C "Fehlerklasse fuer Fehlerpfad Dfp_AFSCD_SRCRawAirm" VALUE 0xCA562 Kw_Wu8 20.00 OneToOne 0.00 20.00 FORMAT "%5.2" EXTENDED_LIMITS 0.00 255.0 /end CHARACTERISTIC
/begin CHARACTERISTIC DSM_ClaDfp_Layer_TUMG_C "Fehlerklasse fuer Fehlerpfad Dfp_Layer_TUMG" VALUE 0xCA563 Kw_Wu8 20.00 OneToOne 0.00 20.00 FORMAT "%5.2" EXTENDED_LIMITS 0.00 255.0 /end CHARACTERISTIC
/begin CHARACTERISTIC DSM_ClaDfp_AFSCD_SRCRefSigPer_C "Fehlerklasse fuer Fehlerpfad Dfp_AFSCD_SRCRefSigPer" VALUE 0xCA564 Kw_Wu8 20.00 OneToOne 0.00 20.00 FORMAT "%5.2" EXTENDED_LIMITS 0.00 255.0 /end CHARACTERISTIC
/begin CHARACTERISTIC DSM_ClaDfp_AOHtCD_C "Fehlerklasse fuer Fehlerpfad Dfp_AOHtCD" VALUE 0xCA565 Kw_Wu8 20.00 OneToOne 0.00 20.00 FORMAT "%5.2" EXTENDED_LIMITS 0.00 255.0 /end CHARACTERISTIC
/begin CHARACTERISTIC DSM_ClaDfp_Layer_GEN_C "Fehlerklasse fuer Fehlerpfad Dfp_Layer_GEN" VALUE 0xCA566 Kw_Wu8 20.00 OneToOne 0.00 20.00 FORMAT "%5.2" EXTENDED_LIMITS 0.00 255.0 /end CHARACTERISTIC
/begin CHARACTERISTIC DSM_ClaDfp_Layer_BSD_C "Fehlerklasse fuer Fehlerpfad Dfp_Layer_BSD" VALUE 0xCA567 Kw_Wu8 20.00 OneToOne 0.00 20.00 FORMAT "%5.2" EXTENDED_LIMITS 0.00 255.0 /end CHARACTERISTIC
/begin CHARACTERISTIC DSM_ClaDfp_AOHtCD_AOHtDia1_C "Fehlerklasse fuer Fehlerpfad Dfp_AOHtCD_AOHtDia1" VALUE 0xCA568 Kw_Wu8 20.00 OneToOne 0.00 20.00 FORMAT "%5.2" EXTENDED_LIMITS 0.00 255.0 /end CHARACTERISTIC
/begin CHARACTERISTIC DSM_ClaDfp_AOHtCD_AOHtDia2_C "Fehlerklasse fuer Fehlerpfad Dfp_AOHtCD_AOHtDia2" VALUE 0xCA569 Kw_Wu8 20.00 OneToOne 0.00 20.00 FORMAT "%5.2" EXTENDED_LIMITS 0.00 255.0 /end CHARACTERISTIC
/begin CHARACTERISTIC DSM_ClaDfp_AOHtCD_AOHtDia3_C "Fehlerklasse fuer Fehlerpfad Dfp_AOHtCD_AOHtDia3" VALUE 0xCA56A Kw_Wu8 20.00 OneToOne 0.00 20.00 FORMAT "%5.2" EXTENDED_LIMITS 0.00 255.0 /end CHARACTERISTIC
/begin CHARACTERISTIC DSM_ClaDfp_APP1_C "Fehlerklasse fuer Fehlerpfad Dfp_APP1" VALUE 0xCA56B Kw_Wu8 20.00 OneToOne 0.00 20.00 FORMAT "%5.2" EXTENDED_LIMITS 0.00 255.0 /end CHARACTERISTIC
/begin CHARACTERISTIC DSM_ClaDfp_APP2_C "Fehlerklasse fuer Fehlerpfad Dfp_APP2" VALUE 0xCA56C Kw_Wu8 20.00 OneToOne 0.00 20.00 FORMAT "%5.2" EXTENDED_LIMITS 0.00 255.0 /end CHARACTERISTIC
/begin CHARACTERISTIC DSM_ClaDfp_APPSync_C "Fehlerklasse fuer Fehlerpfad Dfp_APPSync" VALUE 0xCA56D Kw_Wu8 20.00 OneToOne 0.00 20.00 FORMAT "%5.2" EXTENDED_LIMITS 0.00 255.0 /end CHARACTERISTIC
/begin CHARACTERISTIC DSM_ClaDfp_APSCD_C "Fehlerklasse fuer Fehlerpfad Dfp_APSCD" VALUE 0xCA56E Kw_Wu8 20.00 OneToOne 0.00 20.00 FORMAT "%5.2" EXTENDED_LIMITS 0.00 255.0 /end CHARACTERISTIC
/begin CHARACTERISTIC DSM_ClaDfp_ARS_C "Fehlerklasse fuer Fehlerpfad Dfp_ARS" VALUE 0xCA56F Kw_Wu8 20.00 OneToOne 0.00 20.00 FORMAT "%5.2" EXTENDED_LIMITS 0.00 255.0 /end CHARACTERISTIC
/begin CHARACTERISTIC DSM_ClaDfp_AccPedPlausBrk_C "Fehlerklasse fuer Fehlerpfad Dfp_AccPedPlausBrk" VALUE 0xCA570 Kw_Wu8 20.00 OneToOne 0.00 20.00 FORMAT "%5.2" EXTENDED_LIMITS 0.00 255.0 /end CHARACTERISTIC
/begin CHARACTERISTIC DSM_ClaDfp_AirCtlPlateBreak_C "DSM variable for Dfp_AirCtlPlateBreak_mp" VALUE 0xCA571 Kw_Wu8 20.00 OneToOne 0.00 20.00 FORMAT "%5.2" EXTENDED_LIMITS 0.00 255.0 /end CHARACTERISTIC
/begin CHARACTERISTIC DSM_ClaDfp_Layer_QLT_C "Fehlerklasse fuer Fehlerpfad Dfp_Layer_QLT" VALUE 0xCA572 Kw_Wu8 20.00 OneToOne 0.00 20.00 FORMAT "%5.2" EXTENDED_LIMITS 0.00 255.0 /end CHARACTERISTIC
/begin CHARACTERISTIC DSM_ClaDfp_AirCtl_GovNegDev_C "Fehlerklasse fuer Fehlerpfad Dfp_AirCtl_GovNegDev" VALUE 0xCA573 Kw_Wu8 20.00 OneToOne 0.00 20.00 FORMAT "%5.2" EXTENDED_LIMITS 0.00 255.0 /end CHARACTERISTIC
/begin CHARACTERISTIC DSM_ClaDfp_Layer_IBS1_C "Fehlerklasse fuer Fehlerpfad Dfp_Layer_IBS1" VALUE 0xCA574 Kw_Wu8 20.00 OneToOne 0.00 20.00 FORMAT "%5.2" EXTENDED_LIMITS 0.00 255.0 /end CHARACTERISTIC
/begin CHARACTERISTIC DSM_ClaDfp_Layer_IBS2_C "Fehlerklasse fuer Fehlerpfad Dfp_Layer_IBS2" VALUE 0xCA575 Kw_Wu8 20.00 OneToOne 0.00 20.00 FORMAT "%5.2" EXTENDED_LIMITS 0.00 255.0 /end CHARACTERISTIC
/begin CHARACTERISTIC DSM_ClaDfp_Layer_IBS3_C "Fehlerklasse fuer Fehlerpfad Dfp_Layer_IBS3" VALUE 0xCA576 Kw_Wu8 20.00 OneToOne 0.00 20.00 FORMAT "%5.2" EXTENDED_LIMITS 0.00 255.0 /end CHARACTERISTIC
/begin CHARACTERISTIC DSM_ClaDfp_Layer_PMBN_C "Fehlerklasse fuer Fehlerpfad Dfp_Layer_PMBN" VALUE 0xCA577 Kw_Wu8 20.00 OneToOne 0.00 20.00 FORMAT "%5.2" EXTENDED_LIMITS 0.00 255.0 /end CHARACTERISTIC
/begin CHARACTERISTIC DSM_ClaDfp_Layer_PMBATT_C "Fehlerklasse fuer Fehlerpfad Dfp_Layer_PMBATT" VALUE 0xCA578 Kw_Wu8 20.00 OneToOne 0.00 20.00 FORMAT "%5.2" EXTENDED_LIMITS 0.00 255.0 /end CHARACTERISTIC
/begin CHARACTERISTIC DSM_ClaDfp_AirCtl_GovNegDev2_C "Fehlerklasse fuer Fehlerpfad Dfp_AirCtl_GovNegDev2" VALUE 0xCA579 Kw_Wu8 20.00 OneToOne 0.00 20.00 FORMAT "%5.2" EXTENDED_LIMITS 0.00 255.0 /end CHARACTERISTIC
/begin CHARACTERISTIC DSM_ClaDfp_AirCtl_GovPosDev_C "Fehlerklasse fuer Fehlerpfad Dfp_AirCtl_GovPosDev" VALUE 0xCA57A Kw_Wu8 20.00 OneToOne 0.00 20.00 FORMAT "%5.2" EXTENDED_LIMITS 0.00 255.0 /end CHARACTERISTIC
/begin CHARACTERISTIC DSM_ClaDfp_AirCtl_GovPosDev2_C "Fehlerklasse fuer Fehlerpfad Dfp_AirCtl_GovPosDev2" VALUE 0xCA57B Kw_Wu8 20.00 OneToOne 0.00 20.00 FORMAT "%5.2" EXTENDED_LIMITS 0.00 255.0 /end CHARACTERISTIC
/begin CHARACTERISTIC DSM_ClaDfp_AltCD_C "Fehlerklasse fuer Fehlerpfad Dfp_AltCD" VALUE 0xCA57C Kw_Wu8 20.00 OneToOne 0.00 20.00 FORMAT "%5.2" EXTENDED_LIMITS 0.00 255.0 /end CHARACTERISTIC
/begin CHARACTERISTIC DSM_ClaDfp_AltCD_Load_C "Fehlerklasse fuer Fehlerpfad Dfp_AltCD_Load" VALUE 0xCA57D Kw_Wu8 20.00 OneToOne 0.00 20.00 FORMAT "%5.2" EXTENDED_LIMITS 0.00 255.0 /end CHARACTERISTIC
/begin CHARACTERISTIC DSM_ClaDfp_BPACD_BPADia1_C "Fehlerklasse fuer Fehlerpfad Dfp_BPACD_BPADia1" VALUE 0xCA57E Kw_Wu8 20.00 OneToOne 0.00 20.00 FORMAT "%5.2" EXTENDED_LIMITS 0.00 255.0 /end CHARACTERISTIC
/begin CHARACTERISTIC DSM_ClaDfp_BPACD_BPADia2_C "Fehlerklasse fuer Fehlerpfad Dfp_BPACD_BPADia2" VALUE 0xCA57F Kw_Wu8 20.00 OneToOne 0.00 20.00 FORMAT "%5.2" EXTENDED_LIMITS 0.00 255.0 /end CHARACTERISTIC
/begin CHARACTERISTIC DSM_ClaDfp_BPACD_BPADia3_C "Fehlerklasse fuer Fehlerpfad Dfp_BPACD_BPADia3" VALUE 0xCA580 Kw_Wu8 20.00 OneToOne 0.00 20.00 FORMAT "%5.2" EXTENDED_LIMITS 0.00 255.0 /end CHARACTERISTIC
/begin CHARACTERISTIC DSM_ClaDfp_BPACD_Max_C "Fehlerklasse fuer Fehlerpfad Dfp_BPACD_Max" VALUE 0xCA581 Kw_Wu8 20.00 OneToOne 0.00 20.00 FORMAT "%5.2" EXTENDED_LIMITS 0.00 255.0 /end CHARACTERISTIC
/begin CHARACTERISTIC DSM_ClaDfp_BPACD_Min_C "Fehlerklasse fuer Fehlerpfad Dfp_BPACD_Min" VALUE 0xCA582 Kw_Wu8 20.00 OneToOne 0.00 20.00 FORMAT "%5.2" EXTENDED_LIMITS 0.00 255.0 /end CHARACTERISTIC
/begin CHARACTERISTIC DSM_ClaDfp_BPACD_SigNpl_C "Fehlerklasse fuer Fehlerpfad Dfp_BPACD_SigNpl" VALUE 0xCA583 Kw_Wu8 20.00 OneToOne 0.00 20.00 FORMAT "%5.2" EXTENDED_LIMITS 0.00 255.0 /end CHARACTERISTIC
/begin CHARACTERISTIC DSM_ClaDfp_BPSCD_C "Fehlerklasse fuer Fehlerpfad Dfp_BPSCD" VALUE 0xCA584 Kw_Wu8 20.00 OneToOne 0.00 20.00 FORMAT "%5.2" EXTENDED_LIMITS 0.00 255.0 /end CHARACTERISTIC
/begin CHARACTERISTIC DSM_ClaDfp_BattCD_C "Fehlerklasse fuer Fehlerpfad Dfp_BattCD" VALUE 0xCA585 Kw_Wu8 20.00 OneToOne 0.00 20.00 FORMAT "%5.2" EXTENDED_LIMITS 0.00 255.0 /end CHARACTERISTIC
/begin CHARACTERISTIC DSM_ClaDfp_BrkCD_C "Fehlerklasse fuer Fehlerpfad Dfp_BrkCD" VALUE 0xCA586 Kw_Wu8 20.00 OneToOne 0.00 20.00 FORMAT "%5.2" EXTENDED_LIMITS 0.00 255.0 /end CHARACTERISTIC
/begin CHARACTERISTIC DSM_ClaDfp_Bss_C "Fehlerklasse fuer Fehlerpfad Dfp_Bss" VALUE 0xCA587 Kw_Wu8 20.00 OneToOne 0.00 20.00 FORMAT "%5.2" EXTENDED_LIMITS 0.00 255.0 /end CHARACTERISTIC
/begin CHARACTERISTIC DSM_ClaDfp_CBACD_C "Fehlerklasse fuer Fehlerpfad Dfp_CBACD" VALUE 0xCA588 Kw_Wu8 20.00 OneToOne 0.00 20.00 FORMAT "%5.2" EXTENDED_LIMITS 0.00 255.0 /end CHARACTERISTIC
/begin CHARACTERISTIC DSM_ClaDfp_CTSCD_C "Fehlerklasse fuer Fehlerpfad Dfp_CTSCD" VALUE 0xCA589 Kw_Wu8 20.00 OneToOne 0.00 20.00 FORMAT "%5.2" EXTENDED_LIMITS 0.00 255.0 /end CHARACTERISTIC
/begin CHARACTERISTIC DSM_ClaDfp_Clg_DynTst_C "Fehlerklasse fuer Fehlerpfad Dfp_Clg_DynTst" VALUE 0xCA58A Kw_Wu8 20.00 OneToOne 0.00 20.00 FORMAT "%5.2" EXTENDED_LIMITS 0.00 255.0 /end CHARACTERISTIC
/begin CHARACTERISTIC DSM_ClaDfp_CmbChbMisfire1_C "Fehlerklasse fuer Fehlerpfad Dfp_CmbChbMisfire1" VALUE 0xCA58B Kw_Wu8 20.00 OneToOne 0.00 20.00 FORMAT "%5.2" EXTENDED_LIMITS 0.00 255.0 /end CHARACTERISTIC
/begin CHARACTERISTIC DSM_ClaDfp_CmbChbMisfire2_C "Fehlerklasse fuer Fehlerpfad Dfp_CmbChbMisfire2" VALUE 0xCA58C Kw_Wu8 20.00 OneToOne 0.00 20.00 FORMAT "%5.2" EXTENDED_LIMITS 0.00 255.0 /end CHARACTERISTIC
/begin CHARACTERISTIC DSM_ClaDfp_CmbChbMisfire3_C "Fehlerklasse fuer Fehlerpfad Dfp_CmbChbMisfire3" VALUE 0xCA58D Kw_Wu8 20.00 OneToOne 0.00 20.00 FORMAT "%5.2" EXTENDED_LIMITS 0.00 255.0 /end CHARACTERISTIC
/begin CHARACTERISTIC DSM_ClaDfp_CmbChbMisfire4_C "Fehlerklasse fuer Fehlerpfad Dfp_CmbChbMisfire4" VALUE 0xCA58E Kw_Wu8 20.00 OneToOne 0.00 20.00 FORMAT "%5.2" EXTENDED_LIMITS 0.00 255.0 /end CHARACTERISTIC
/begin CHARACTERISTIC DSM_ClaDfp_CmbChbMisfire5_C "Fehlerklasse fuer Fehlerpfad Dfp_CmbChbMisfire5" VALUE 0xCA58F Kw_Wu8 20.00 OneToOne 0.00 20.00 FORMAT "%5.2" EXTENDED_LIMITS 0.00 255.0 /end CHARACTERISTIC
/begin CHARACTERISTIC DSM_ClaDfp_CmbChbMisfire6_C "Fehlerklasse fuer Fehlerpfad Dfp_CmbChbMisfire6" VALUE 0xCA590 Kw_Wu8 20.00 OneToOne 0.00 20.00 FORMAT "%5.2" EXTENDED_LIMITS 0.00 255.0 /end CHARACTERISTIC
/begin CHARACTERISTIC DSM_ClaDfp_CmbChbMisfireMul_C "Fehlerklasse fuer Fehlerpfad Dfp_CmbChb_MisfireMul" VALUE 0xCA591 Kw_Wu8 20.00 OneToOne 0.00 20.00 FORMAT "%5.2" EXTENDED_LIMITS 0.00 255.0 /end CHARACTERISTIC
/begin CHARACTERISTIC DSM_ClaDfp_CoVMDCSh_C "Fehlerklasse fuer Fehlerpfad Dfp_CoVMDCSh" VALUE 0xCA592 Kw_Wu8 20.00 OneToOne 0.00 20.00 FORMAT "%5.2" EXTENDED_LIMITS 0.00 255.0 /end CHARACTERISTIC
/begin CHARACTERISTIC DSM_ClaDfp_ConvCD_C "Fehlerklasse fuer Fehlerpfad Dfp_ConvCD" VALUE 0xCA593 Kw_Wu8 20.00 OneToOne 0.00 20.00 FORMAT "%5.2" EXTENDED_LIMITS 0.00 255.0 /end CHARACTERISTIC
/begin CHARACTERISTIC DSM_ClaDfp_CrCCDMFL_C "Fehlerklasse fuer Fehlerpfad Dfp_CrCCDMFL" VALUE 0xCA594 Kw_Wu8 20.00 OneToOne 0.00 20.00 FORMAT "%5.2" EXTENDED_LIMITS 0.00 255.0 /end CHARACTERISTIC
/begin CHARACTERISTIC DSM_ClaDfp_CrCtl_vCrCtl_C "Fehlerklasse fuer Fehlerpfad Dfp_CrCtl_vCrCtl" VALUE 0xCA595 Kw_Wu8 20.00 OneToOne 0.00 20.00 FORMAT "%5.2" EXTENDED_LIMITS 0.00 255.0 /end CHARACTERISTIC
/begin CHARACTERISTIC DSM_ClaDfp_Dummy1_C "Fehlerklasse fuer Fehlerpfad Dfp_Dummy1" VALUE 0xCA596 Kw_Wu8 20.00 OneToOne 0.00 20.00 FORMAT "%5.2" EXTENDED_LIMITS 0.00 255.0 /end CHARACTERISTIC
/begin CHARACTERISTIC DSM_ClaDfp_EATSCD_C "Fehlerklasse fuer Fehlerpfad Dfp_EATSCD" VALUE 0xCA597 Kw_Wu8 20.00 OneToOne 0.00 20.00 FORMAT "%5.2" EXTENDED_LIMITS 0.00 255.0 /end CHARACTERISTIC
/begin CHARACTERISTIC DSM_ClaDfp_EBAFCD_C "Fehlerklasse fuer Fehlerpfad Dfp_EBAFCD" VALUE 0xCA598 Kw_Wu8 20.00 OneToOne 0.00 20.00 FORMAT "%5.2" EXTENDED_LIMITS 0.00 255.0 /end CHARACTERISTIC
/begin CHARACTERISTIC DSM_ClaDfp_Layer_PMRUHVERL_C "Fehlerklasse fuer Fehlerpfad Dfp_Layer_PMRUHVERL" VALUE 0xCA599 Kw_Wu8 20.00 OneToOne 0.00 20.00 FORMAT "%5.2" EXTENDED_LIMITS 0.00 255.0 /end CHARACTERISTIC
/begin CHARACTERISTIC DSM_ClaDfp_EBFCD_C "Fehlerklasse fuer Fehlerpfad Dfp_EBFCD" VALUE 0xCA59A Kw_Wu8 20.00 OneToOne 0.00 20.00 FORMAT "%5.2" EXTENDED_LIMITS 0.00 255.0 /end CHARACTERISTIC
/begin CHARACTERISTIC DSM_ClaDfp_EBTSCD_C "Fehlerklasse fuer Fehlerpfad Dfp_EBTSCD" VALUE 0xCA59B Kw_Wu8 20.00 OneToOne 0.00 20.00 FORMAT "%5.2" EXTENDED_LIMITS 0.00 255.0 /end CHARACTERISTIC
/begin CHARACTERISTIC DSM_ClaDfp_EBTSCD_OvrTemp_C "Fehlerklasse fuer Fehlerpfad Dfp_EBTSCD_OvrTemp" VALUE 0xCA59C Kw_Wu8 20.00 OneToOne 0.00 20.00 FORMAT "%5.2" EXTENDED_LIMITS 0.00 255.0 /end CHARACTERISTIC
/begin CHARACTERISTIC DSM_ClaDfp_EEPCDVarMng_C "Fehlerklasse fuer Fehlerpfad Dfp_EEPCDVarMng" VALUE 0xCA59D Kw_Wu8 20.00 OneToOne 0.00 20.00 FORMAT "%5.2" EXTENDED_LIMITS 0.00 255.0 /end CHARACTERISTIC
/begin CHARACTERISTIC DSM_ClaDfp_Layer_TOENS_C "Fehlerklasse fuer Fehlerpfad Dfp_Layer_TOENS" VALUE 0xCA59E Kw_Wu8 20.00 OneToOne 0.00 20.00 FORMAT "%5.2" EXTENDED_LIMITS 0.00 255.0 /end CHARACTERISTIC
/begin CHARACTERISTIC DSM_ClaDfp_Layer_MANHYDR_C "Fehlerklasse fuer Fehlerpfad Dfp_Layer_MANHYDR" VALUE 0xCA59F Kw_Wu8 20.00 OneToOne 0.00 20.00 FORMAT "%5.2" EXTENDED_LIMITS 0.00 255.0 /end CHARACTERISTIC
/begin CHARACTERISTIC DSM_ClaDfp_Layer_MANLUFT_C "Fehlerklasse fuer Fehlerpfad Dfp_Layer_MANLUFT" VALUE 0xCA5A0 Kw_Wu8 20.00 OneToOne 0.00 20.00 FORMAT "%5.2" EXTENDED_LIMITS 0.00 255.0 /end CHARACTERISTIC
/begin CHARACTERISTIC DSM_ClaDfp_EGPpCD_C "Fehlerklassen fuer Fehlerpfad Dfp_EGPpCD" VALUE 0xCA5A1 Kw_Wu8 20.00 OneToOne 0.00 20.00 FORMAT "%5.2" EXTENDED_LIMITS 0.00 255.0 /end CHARACTERISTIC
/begin CHARACTERISTIC DSM_ClaDfp_EGPpCDTPreTrbn_C "Fehlerklasse fuer Fehlerpfad Dfp_EgPpCDTPreTrbn" VALUE 0xCA5A2 Kw_Wu8 20.00 OneToOne 0.00 20.00 FORMAT "%5.2" EXTENDED_LIMITS 0.00 255.0 /end CHARACTERISTIC
/begin CHARACTERISTIC DSM_ClaDfp_EGRCD_Max_C "Fehlerklasse fuer Fehlerpfad Dfp_EGRCD_Max" VALUE 0xCA5A3 Kw_Wu8 20.00 OneToOne 0.00 20.00 FORMAT "%5.2" EXTENDED_LIMITS 0.00 255.0 /end CHARACTERISTIC
/begin CHARACTERISTIC DSM_ClaDfp_EGRCD_Min_C "Fehlerklasse fuer Fehlerpfad Dfp_EGRCD_Min" VALUE 0xCA5A4 Kw_Wu8 20.00 OneToOne 0.00 20.00 FORMAT "%5.2" EXTENDED_LIMITS 0.00 255.0 /end CHARACTERISTIC
/begin CHARACTERISTIC DSM_ClaDfp_EGRCD_SigNpl_C "Fehlerklasse fuer Fehlerpfad Dfp_EGRCD_SigNpl" VALUE 0xCA5A5 Kw_Wu8 20.00 OneToOne 0.00 20.00 FORMAT "%5.2" EXTENDED_LIMITS 0.00 255.0 /end CHARACTERISTIC
/begin CHARACTERISTIC DSM_ClaDfp_EGTRgnOilDil_C "Fehlerklasse fuer Fehlerpfad Dfp_EGTRgnOilDil" VALUE 0xCA5A6 Kw_Wu8 20.00 OneToOne 0.00 20.00 FORMAT "%5.2" EXTENDED_LIMITS 0.00 255.0 /end CHARACTERISTIC
/begin CHARACTERISTIC DSM_ClaDfp_EMCCDNoLoad1_C "" VALUE 0xCA5A7 Kw_Wu8 20.00 OneToOne 0.00 20.00 FORMAT "%5.2" EXTENDED_LIMITS 0.00 255.0 /end CHARACTERISTIC
/begin CHARACTERISTIC DSM_ClaDfp_EMCCDNoLoad2_C "" VALUE 0xCA5A8 Kw_Wu8 20.00 OneToOne 0.00 20.00 FORMAT "%5.2" EXTENDED_LIMITS 0.00 255.0 /end CHARACTERISTIC
/begin CHARACTERISTIC DSM_ClaDfp_EMCCDSCBat1_C "" VALUE 0xCA5A9 Kw_Wu8 20.00 OneToOne 0.00 20.00 FORMAT "%5.2" EXTENDED_LIMITS 0.00 255.0 /end CHARACTERISTIC
/begin CHARACTERISTIC DSM_ClaDfp_EMCCDSCBat2_C "" VALUE 0xCA5AA Kw_Wu8 20.00 OneToOne 0.00 20.00 FORMAT "%5.2" EXTENDED_LIMITS 0.00 255.0 /end CHARACTERISTIC
/begin CHARACTERISTIC DSM_ClaDfp_EMCCDSCGnd1_C "" VALUE 0xCA5AB Kw_Wu8 20.00 OneToOne 0.00 20.00 FORMAT "%5.2" EXTENDED_LIMITS 0.00 255.0 /end CHARACTERISTIC
/begin CHARACTERISTIC DSM_ClaDfp_EMCCDSCGnd2_C "" VALUE 0xCA5AC Kw_Wu8 20.00 OneToOne 0.00 20.00 FORMAT "%5.2" EXTENDED_LIMITS 0.00 255.0 /end CHARACTERISTIC
/begin CHARACTERISTIC DSM_ClaDfp_EMCCD_ADC1_C "" VALUE 0xCA5AD Kw_Wu8 20.00 OneToOne 0.00 20.00 FORMAT "%5.2" EXTENDED_LIMITS 0.00 255.0 /end CHARACTERISTIC
/begin CHARACTERISTIC DSM_ClaDfp_EMCCD_ADC2_C "" VALUE 0xCA5AE Kw_Wu8 20.00 OneToOne 0.00 20.00 FORMAT "%5.2" EXTENDED_LIMITS 0.00 255.0 /end CHARACTERISTIC
/begin CHARACTERISTIC DSM_ClaDfp_ETClbETFltInj1_C "Fehlerklasse fuer Fehlerpfad Dfp_ETClbETFltInj1" VALUE 0xCA5AF Kw_Wu8 20.00 OneToOne 0.00 20.00 FORMAT "%5.2" EXTENDED_LIMITS 0.00 255.0 /end CHARACTERISTIC
/begin CHARACTERISTIC DSM_ClaDfp_ETClbETFltInj2_C "Fehlerklasse fuer Fehlerpfad Dfp_ETClbETFltInj2" VALUE 0xCA5B0 Kw_Wu8 20.00 OneToOne 0.00 20.00 FORMAT "%5.2" EXTENDED_LIMITS 0.00 255.0 /end CHARACTERISTIC
/begin CHARACTERISTIC DSM_ClaDfp_ETClbETFltInj3_C "Fehlerklasse fuer Fehlerpfad Dfp_ETClbETFltInj3" VALUE 0xCA5B1 Kw_Wu8 20.00 OneToOne 0.00 20.00 FORMAT "%5.2" EXTENDED_LIMITS 0.00 255.0 /end CHARACTERISTIC
/begin CHARACTERISTIC DSM_ClaDfp_ETClbETFltInj4_C "Fehlerklasse fuer Fehlerpfad Dfp_ETClbETFltInj4" VALUE 0xCA5B2 Kw_Wu8 20.00 OneToOne 0.00 20.00 FORMAT "%5.2" EXTENDED_LIMITS 0.00 255.0 /end CHARACTERISTIC
/begin CHARACTERISTIC DSM_ClaDfp_ETClbETFltInj5_C "Fehlerklasse fuer Fehlerpfad Dfp_ETClbETFltInj5" VALUE 0xCA5B3 Kw_Wu8 20.00 OneToOne 0.00 20.00 FORMAT "%5.2" EXTENDED_LIMITS 0.00 255.0 /end CHARACTERISTIC
/begin CHARACTERISTIC DSM_ClaDfp_ETClbETFltInj6_C "Fehlerklasse fuer Fehlerpfad Dfp_ETClbETFltInj6" VALUE 0xCA5B4 Kw_Wu8 20.00 OneToOne 0.00 20.00 FORMAT "%5.2" EXTENDED_LIMITS 0.00 255.0 /end CHARACTERISTIC
/begin CHARACTERISTIC DSM_ClaDfp_ETClbInj1_C "Fehlerklasse fuer Fehlerpfad Dfp_ETClbInj1" VALUE 0xCA5B5 Kw_Wu8 20.00 OneToOne 0.00 20.00 FORMAT "%5.2" EXTENDED_LIMITS 0.00 255.0 /end CHARACTERISTIC
/begin CHARACTERISTIC DSM_ClaDfp_ETClbInj2_C "Fehlerklasse fuer Fehlerpfad Dfp_ETClbInj2" VALUE 0xCA5B6 Kw_Wu8 20.00 OneToOne 0.00 20.00 FORMAT "%5.2" EXTENDED_LIMITS 0.00 255.0 /end CHARACTERISTIC
/begin CHARACTERISTIC DSM_ClaDfp_ETClbInj3_C "Fehlerklasse fuer Fehlerpfad Dfp_ETClbInj3" VALUE 0xCA5B7 Kw_Wu8 20.00 OneToOne 0.00 20.00 FORMAT "%5.2" EXTENDED_LIMITS 0.00 255.0 /end CHARACTERISTIC
/begin CHARACTERISTIC DSM_ClaDfp_ETClbInj4_C "Fehlerklasse fuer Fehlerpfad Dfp_ETClbInj4" VALUE 0xCA5B8 Kw_Wu8 20.00 OneToOne 0.00 20.00 FORMAT "%5.2" EXTENDED_LIMITS 0.00 255.0 /end CHARACTERISTIC
/begin CHARACTERISTIC DSM_ClaDfp_ETClbInj5_C "Fehlerklasse fuer Fehlerpfad Dfp_ETClbInj5" VALUE 0xCA5B9 Kw_Wu8 20.00 OneToOne 0.00 20.00 FORMAT "%5.2" EXTENDED_LIMITS 0.00 255.0 /end CHARACTERISTIC
/begin CHARACTERISTIC DSM_ClaDfp_ETClbInj6_C "Fehlerklasse fuer Fehlerpfad Dfp_ETClbInj6" VALUE 0xCA5BA Kw_Wu8 20.00 OneToOne 0.00 20.00 FORMAT "%5.2" EXTENDED_LIMITS 0.00 255.0 /end CHARACTERISTIC
/begin CHARACTERISTIC DSM_ClaDfp_EngMCaS1_C "Fehlerklasse fuer Fehlerpfad Dfp_EngMCaS1" VALUE 0xCA5BB Kw_Wu8 20.00 OneToOne 0.00 20.00 FORMAT "%5.2" EXTENDED_LIMITS 0.00 255.0 /end CHARACTERISTIC
/begin CHARACTERISTIC DSM_ClaDfp_EngMCrS1_C "Fehlerklasse fuer Fehlerpfad Dfp_EngMCrS1" VALUE 0xCA5BC Kw_Wu8 20.00 OneToOne 0.00 20.00 FORMAT "%5.2" EXTENDED_LIMITS 0.00 255.0 /end CHARACTERISTIC
/begin CHARACTERISTIC DSM_ClaDfp_EngMOfsCaSCrS_C "Fehlerklasse fuer Fehlerpfad Dfp_EngMOfsCaSCrS" VALUE 0xCA5BD Kw_Wu8 20.00 OneToOne 0.00 20.00 FORMAT "%5.2" EXTENDED_LIMITS 0.00 255.0 /end CHARACTERISTIC
/begin CHARACTERISTIC DSM_ClaDfp_EngPrtFWODet_C "Fehlerklasse fuer Fehlerpfad Dfp_EngPrtFWODet" VALUE 0xCA5BE Kw_Wu8 20.00 OneToOne 0.00 20.00 FORMAT "%5.2" EXTENDED_LIMITS 0.00 255.0 /end CHARACTERISTIC
/begin CHARACTERISTIC DSM_ClaDfp_FBCqDvt_C "Fehlerklasse fuer Fehlerpfad Dfp_FBCqDvt" VALUE 0xCA5BF Kw_Wu8 20.00 OneToOne 0.00 20.00 FORMAT "%5.2" EXTENDED_LIMITS 0.00 255.0 /end CHARACTERISTIC
/begin CHARACTERISTIC DSM_ClaDfp_FMTC_NonMonotonMap_C "Fehlerklasse fuer Fehlerpfad Dfp_FMTC_NonMonotonMap" VALUE 0xCA5C0 Kw_Wu8 20.00 OneToOne 0.00 20.00 FORMAT "%5.2" EXTENDED_LIMITS 0.00 255.0 /end CHARACTERISTIC
/begin CHARACTERISTIC DSM_ClaDfp_FTSCD_C "Fehlerklasse fuer Fehlerpfad Dfp_FTSCD" VALUE 0xCA5C1 Kw_Wu8 20.00 OneToOne 0.00 20.00 FORMAT "%5.2" EXTENDED_LIMITS 0.00 255.0 /end CHARACTERISTIC
/begin CHARACTERISTIC DSM_ClaDfp_FanCD_C "Fehlerklasse fuer Fehlerpfad Dfp_FanCD" VALUE 0xCA5C2 Kw_Wu8 20.00 OneToOne 0.00 20.00 FORMAT "%5.2" EXTENDED_LIMITS 0.00 255.0 /end CHARACTERISTIC
/begin CHARACTERISTIC DSM_ClaDfp_FanCD_FanCtlr1_C "Fehlerklasse fuer Fehlerpfad Dfp_FanCD_FanCtlr1" VALUE 0xCA5C3 Kw_Wu8 20.00 OneToOne 0.00 20.00 FORMAT "%5.2" EXTENDED_LIMITS 0.00 255.0 /end CHARACTERISTIC
/begin CHARACTERISTIC DSM_ClaDfp_FanCD_FanCtlr2_C "Fehlerklasse fuer Fehlerpfad Dfp_FanCD_FanCtlr2" VALUE 0xCA5C4 Kw_Wu8 20.00 OneToOne 0.00 20.00 FORMAT "%5.2" EXTENDED_LIMITS 0.00 255.0 /end CHARACTERISTIC
/begin CHARACTERISTIC DSM_ClaDfp_FanCD_FanCtlr3_C "Fehlerklasse fuer Fehlerpfad Dfp_FanCD_FanCtlr3" VALUE 0xCA5C5 Kw_Wu8 20.00 OneToOne 0.00 20.00 FORMAT "%5.2" EXTENDED_LIMITS 0.00 255.0 /end CHARACTERISTIC
/begin CHARACTERISTIC DSM_ClaDfp_FlFCD_C "Fehlerklasse fuer Fehlerpfad Dfp_FlFCD" VALUE 0xCA5C6 Kw_Wu8 20.00 OneToOne 0.00 20.00 FORMAT "%5.2" EXTENDED_LIMITS 0.00 255.0 /end CHARACTERISTIC
/begin CHARACTERISTIC DSM_ClaDfp_FlMngSmkDefect_C "Fehlerklasse fuer Fehlerpfad Dfp_FlMngSmkDefect" VALUE 0xCA5C7 Kw_Wu8 20.00 OneToOne 0.00 20.00 FORMAT "%5.2" EXTENDED_LIMITS 0.00 255.0 /end CHARACTERISTIC
/begin CHARACTERISTIC DSM_ClaDfp_FrmMngASC1_C "Fehlerklasse fuer Fehlerpfad Dfp_FrmMngASC1" VALUE 0xCA5C8 Kw_Wu8 20.00 OneToOne 0.00 20.00 FORMAT "%5.2" EXTENDED_LIMITS 0.00 255.0 /end CHARACTERISTIC
/begin CHARACTERISTIC DSM_ClaDfp_FrmMngASC2_C "Fehlerklasse fuer Fehlerpfad Dfp_FrmMngASC2" VALUE 0xCA5C9 Kw_Wu8 20.00 OneToOne 0.00 20.00 FORMAT "%5.2" EXTENDED_LIMITS 0.00 255.0 /end CHARACTERISTIC
/begin CHARACTERISTIC DSM_ClaDfp_FrmMngASC3_C "Fehlerklasse fuer Fehlerpfad Dfp_FrmMngASC3" VALUE 0xCA5CA Kw_Wu8 20.00 OneToOne 0.00 20.00 FORMAT "%5.2" EXTENDED_LIMITS 0.00 255.0 /end CHARACTERISTIC
/begin CHARACTERISTIC DSM_ClaDfp_FrmMngASC4_C "Fehlerklasse fuer Fehlerpfad Dfp_FrmMngASC4" VALUE 0xCA5CB Kw_Wu8 20.00 OneToOne 0.00 20.00 FORMAT "%5.2" EXTENDED_LIMITS 0.00 255.0 /end CHARACTERISTIC
/begin CHARACTERISTIC DSM_ClaDfp_FrmMngBOS_RESET_C "Fehlerklasse fuer Fehlerpfad Dfp_FrmMngBOS_RESET" VALUE 0xCA5CC Kw_Wu8 20.00 OneToOne 0.00 20.00 FORMAT "%5.2" EXTENDED_LIMITS 0.00 255.0 /end CHARACTERISTIC
/begin CHARACTERISTIC DSM_ClaDfp_FrmMngBOS_RESET_2_C "" VALUE 0xCA5CD Kw_Wu8 20.00 OneToOne 0.00 20.00 FORMAT "%5.2" EXTENDED_LIMITS 0.00 255.0 /end CHARACTERISTIC
/begin CHARACTERISTIC DSM_ClaDfp_FrmMngDMANFAFS_C "Fehlerklasse fuer Fehlerpfad Dfp_FrmMngDMANFAFS" VALUE 0xCA5CE Kw_Wu8 20.00 OneToOne 0.00 20.00 FORMAT "%5.2" EXTENDED_LIMITS 0.00 255.0 /end CHARACTERISTIC
/begin CHARACTERISTIC DSM_ClaDfp_FrmMngDRMANFSSG_C "Fehlerklasse fuer Fehlerpfad Dfp_FrmMngDRMANFSSG" VALUE 0xCA5CF Kw_Wu8 20.00 OneToOne 0.00 20.00 FORMAT "%5.2" EXTENDED_LIMITS 0.00 255.0 /end CHARACTERISTIC
/begin CHARACTERISTIC DSM_ClaDfp_FrmMngEGS1_C "Fehlerklasse fuer Fehlerpfad Dfp_FrmMngEGS1" VALUE 0xCA5D0 Kw_Wu8 20.00 OneToOne 0.00 20.00 FORMAT "%5.2" EXTENDED_LIMITS 0.00 255.0 /end CHARACTERISTIC
/begin CHARACTERISTIC DSM_ClaDfp_FrmMngEGS2_C "Fehlerklasse fuer Fehlerpfad Dfp_FrmMngEGS2" VALUE 0xCA5D1 Kw_Wu8 20.00 OneToOne 0.00 20.00 FORMAT "%5.2" EXTENDED_LIMITS 0.00 255.0 /end CHARACTERISTIC
/begin CHARACTERISTIC DSM_ClaDfp_FrmMngGEARBX_DATA_C "class for path" VALUE 0xCA5D2 Kw_Wu8 20.00 OneToOne 0.00 20.00 FORMAT "%5.2" EXTENDED_LIMITS 0.00 255.0 /end CHARACTERISTIC
/begin CHARACTERISTIC DSM_ClaDfp_FrmMngGEARBX_DATA2_C "Fehlerklasse fuer Fehlerpfad Dfp_FrmMngGEARBX_DATA2" VALUE 0xCA5D3 Kw_Wu8 20.00 OneToOne 0.00 20.00 FORMAT "%5.2" EXTENDED_LIMITS 0.00 255.0 /end CHARACTERISTIC
/begin CHARACTERISTIC DSM_ClaDfp_FrmMngHEAT_AC_C "class for path" VALUE 0xCA5D4 Kw_Wu8 20.00 OneToOne 0.00 20.00 FORMAT "%5.2" EXTENDED_LIMITS 0.00 255.0 /end CHARACTERISTIC
/begin CHARACTERISTIC DSM_ClaDfp_FrmMngINSTR2_C "Fehlerklasse fuer Fehlerpfad Dfp_FrmMngINSTR2" VALUE 0xCA5D5 Kw_Wu8 20.00 OneToOne 0.00 20.00 FORMAT "%5.2" EXTENDED_LIMITS 0.00 255.0 /end CHARACTERISTIC
/begin CHARACTERISTIC DSM_ClaDfp_FrmMngINSTR3_C "Fehlerklasse fuer Fehlerpfad Dfp_FrmMngINSTR3" VALUE 0xCA5D6 Kw_Wu8 20.00 OneToOne 0.00 20.00 FORMAT "%5.2" EXTENDED_LIMITS 0.00 255.0 /end CHARACTERISTIC
/begin CHARACTERISTIC DSM_ClaDfp_FrmMngLENKRADWINKEL_C "Fehlerklasse fuer Fehlerpfad Dfp_FrmMngLENKRADWINKEL" VALUE 0xCA5D7 Kw_Wu8 20.00 OneToOne 0.00 20.00 FORMAT "%5.2" EXTENDED_LIMITS 0.00 255.0 /end CHARACTERISTIC
/begin CHARACTERISTIC DSM_ClaDfp_FrmMngMILEAGE_RANGE_C "Fehlerklasse fuer Fehlerpfad Dfp_FrmMngMILEAGE_RANGE" VALUE 0xCA5D8 Kw_Wu8 20.00 OneToOne 0.00 20.00 FORMAT "%5.2" EXTENDED_LIMITS 0.00 255.0 /end CHARACTERISTIC
/begin CHARACTERISTIC DSM_ClaDfp_FrmMngOPCRCTLACC_C "Fehlerklasse fuer Fehlerpfad Dfp_FrmMngOPCRCTLACC" VALUE 0xCA5D9 Kw_Wu8 20.00 OneToOne 0.00 20.00 FORMAT "%5.2" EXTENDED_LIMITS 0.00 255.0 /end CHARACTERISTIC
/begin CHARACTERISTIC DSM_ClaDfp_FrmMngPRGG_CCTR_C "Fehlerklasse fuer Fehlerpfad Dfp_FrmMngPRGG_CCTR" VALUE 0xCA5DA Kw_Wu8 20.00 OneToOne 0.00 20.00 FORMAT "%5.2" EXTENDED_LIMITS 0.00 255.0 /end CHARACTERISTIC
/begin CHARACTERISTIC DSM_ClaDfp_FrmMngPWRMNG_LOADV_C "Fehlerklasse fuer Fehlerpfad Dfp_FrmMngPWRMNG_LOADV" VALUE 0xCA5DB Kw_Wu8 20.00 OneToOne 0.00 20.00 FORMAT "%5.2" EXTENDED_LIMITS 0.00 255.0 /end CHARACTERISTIC
/begin CHARACTERISTIC DSM_ClaDfp_FrmMngParkConsumer_C "Fehlerklasse fuer Fehlerpfad Dfp_FrmMngParkConsumer" VALUE 0xCA5DC Kw_Wu8 20.00 OneToOne 0.00 20.00 FORMAT "%5.2" EXTENDED_LIMITS 0.00 255.0 /end CHARACTERISTIC
/begin CHARACTERISTIC DSM_ClaDfp_FrmMngRQSTGEFAN_C "RQ_STG_EFAN - CAN-message related errors" VALUE 0xCA5DD Kw_Wu8 20.00 OneToOne 0.00 20.00 FORMAT "%5.2" EXTENDED_LIMITS 0.00 255.0 /end CHARACTERISTIC
/begin CHARACTERISTIC DSM_ClaDfp_FrmMngSSGErr_C "Fehlerklasse fuer Fehlerpfad Dfp_FrmMngSSGErr" VALUE 0xCA5DE Kw_Wu8 20.00 OneToOne 0.00 20.00 FORMAT "%5.2" EXTENDED_LIMITS 0.00 255.0 /end CHARACTERISTIC
/begin CHARACTERISTIC DSM_ClaDfp_FrmMngSSGShOff_C "Fehlerklasse fuer Fehlerpfad Dfp_FrmMngSSGShOff" VALUE 0xCA5DF Kw_Wu8 20.00 OneToOne 0.00 20.00 FORMAT "%5.2" EXTENDED_LIMITS 0.00 255.0 /end CHARACTERISTIC
/begin CHARACTERISTIC DSM_ClaDfp_FrmMngSTAT_ANH_C "Fehlerklasse fuer Fehlerpfad Dfp_FrmMngSTAT_ANH" VALUE 0xCA5E0 Kw_Wu8 20.00 OneToOne 0.00 20.00 FORMAT "%5.2" EXTENDED_LIMITS 0.00 255.0 /end CHARACTERISTIC
/begin CHARACTERISTIC DSM_ClaDfp_FrmMngSTAT_ARS_C "class for path" VALUE 0xCA5E1 Kw_Wu8 20.00 OneToOne 0.00 20.00 FORMAT "%5.2" EXTENDED_LIMITS 0.00 255.0 /end CHARACTERISTIC
/begin CHARACTERISTIC DSM_ClaDfp_FrmMngSTAT_DSC_C "class for path" VALUE 0xCA5E2 Kw_Wu8 20.00 OneToOne 0.00 20.00 FORMAT "%5.2" EXTENDED_LIMITS 0.00 255.0 /end CHARACTERISTIC
/begin CHARACTERISTIC DSM_ClaDfp_FrmMngSTAT_EKP_C "Fehlerklasse fuer Fehlerpfad Dfp_FrmMngSTAT_EKP" VALUE 0xCA5E3 Kw_Wu8 20.00 OneToOne 0.00 20.00 FORMAT "%5.2" EXTENDED_LIMITS 0.00 255.0 /end CHARACTERISTIC
/begin CHARACTERISTIC DSM_ClaDfp_FrmMngSTAT_KOMBI_C "Fehlerklasse fuer Fehlerpfad Dfp_FrmMngSTAT_KOMBI" VALUE 0xCA5E4 Kw_Wu8 20.00 OneToOne 0.00 20.00 FORMAT "%5.2" EXTENDED_LIMITS 0.00 255.0 /end CHARACTERISTIC
/begin CHARACTERISTIC DSM_ClaDfp_FrmMngSTAT_SITZ_C "Fehlerklasse fuer Fehlerpfad Dfp_FrmMngSTAT_SITZ" VALUE 0xCA5E5 Kw_Wu8 20.00 OneToOne 0.00 20.00 FORMAT "%5.2" EXTENDED_LIMITS 0.00 255.0 /end CHARACTERISTIC
/begin CHARACTERISTIC DSM_ClaDfp_FrmMngStOBDGbxMilOf_C "Fehlerklasse fuer Fehlerpfad Dfp_FrmMngStOBDGbxMilOf" VALUE 0xCA5E6 Kw_Wu8 20.00 OneToOne 0.00 20.00 FORMAT "%5.2" EXTENDED_LIMITS 0.00 255.0 /end CHARACTERISTIC
/begin CHARACTERISTIC DSM_ClaDfp_FrmMngStOBDGbxMilOn_C "Fehlerklasse fuer Fehlerpfad Dfp_FrmMngStOBDGbxMilOn" VALUE 0xCA5E7 Kw_Wu8 20.00 OneToOne 0.00 20.00 FORMAT "%5.2" EXTENDED_LIMITS 0.00 255.0 /end CHARACTERISTIC
/begin CHARACTERISTIC DSM_ClaDfp_FrmMngTEMPRELTIME_C "Fehlerklasse fuer Fehlerpfad Dfp_FrmMngTEMPRELTIME" VALUE 0xCA5E8 Kw_Wu8 20.00 OneToOne 0.00 20.00 FORMAT "%5.2" EXTENDED_LIMITS 0.00 255.0 /end CHARACTERISTIC
/begin CHARACTERISTIC DSM_ClaDfp_FrmMngTERMINAL_C "class for path" VALUE 0xCA5E9 Kw_Wu8 20.00 OneToOne 0.00 20.00 FORMAT "%5.2" EXTENDED_LIMITS 0.00 255.0 /end CHARACTERISTIC
/begin CHARACTERISTIC DSM_ClaDfp_FrmMngTIME_DATE_C "Fehlerklasse fuer Fehlerpfad Dfp_FrmMngTIME_DATE" VALUE 0xCA5EA Kw_Wu8 20.00 OneToOne 0.00 20.00 FORMAT "%5.2" EXTENDED_LIMITS 0.00 255.0 /end CHARACTERISTIC
/begin CHARACTERISTIC DSM_ClaDfp_FrmMngTORQUE_DSC_C "class for path" VALUE 0xCA5EB Kw_Wu8 20.00 OneToOne 0.00 20.00 FORMAT "%5.2" EXTENDED_LIMITS 0.00 255.0 /end CHARACTERISTIC
/begin CHARACTERISTIC DSM_ClaDfp_FrmMngTORQUE_GEARBX_C "class for path" VALUE 0xCA5EC Kw_Wu8 20.00 OneToOne 0.00 20.00 FORMAT "%5.2" EXTENDED_LIMITS 0.00 255.0 /end CHARACTERISTIC
/begin CHARACTERISTIC DSM_ClaDfp_FrmMngTrq_ReqACC_C "Fehlerklasse fuer Fehlerpfad Dfp_FrmMngTrq_ReqACC" VALUE 0xCA5ED Kw_Wu8 20.00 OneToOne 0.00 20.00 FORMAT "%5.2" EXTENDED_LIMITS 0.00 255.0 /end CHARACTERISTIC
/begin CHARACTERISTIC DSM_ClaDfp_FrmMngVEH_MOD_C "VEH_MOD - CAN-message related errors" VALUE 0xCA5EE Kw_Wu8 20.00 OneToOne 0.00 20.00 FORMAT "%5.2" EXTENDED_LIMITS 0.00 255.0 /end CHARACTERISTIC
/begin CHARACTERISTIC DSM_ClaDfp_FrmMngVELOCITY_C "class for path" VALUE 0xCA5EF Kw_Wu8 20.00 OneToOne 0.00 20.00 FORMAT "%5.2" EXTENDED_LIMITS 0.00 255.0 /end CHARACTERISTIC
/begin CHARACTERISTIC DSM_ClaDfp_FrmMngWHEEL_SPEED_C "Fehlerklasse fuer Fehlerpfad Dfp_FrmMngWHEEL_SPEED" VALUE 0xCA5F0 Kw_Wu8 20.00 OneToOne 0.00 20.00 FORMAT "%5.2" EXTENDED_LIMITS 0.00 255.0 /end CHARACTERISTIC
/begin CHARACTERISTIC DSM_ClaDfp_FrmMngstCurr_C "Fehlerklasse für Dfp_FrmMngstCurr" VALUE 0xCA5F1 Kw_Wu8 20.00 OneToOne 0.00 20.00 FORMAT "%5.2" EXTENDED_LIMITS 0.00 255.0 /end CHARACTERISTIC
/begin CHARACTERISTIC DSM_ClaDfp_FrmMngswtPSPOff_C "Fehlerklasse für Dfp_FrmMngswtPSPOff" VALUE 0xCA5F2 Kw_Wu8 20.00 OneToOne 0.00 20.00 FORMAT "%5.2" EXTENDED_LIMITS 0.00 255.0 /end CHARACTERISTIC
/begin CHARACTERISTIC DSM_ClaDfp_GearbxIncMax_C "Fehlerklasse fuer Fehlerpfad Dfp_GearbxIncMax" VALUE 0xCA5F3 Kw_Wu8 20.00 OneToOne 0.00 20.00 FORMAT "%5.2" EXTENDED_LIMITS 0.00 255.0 /end CHARACTERISTIC
/begin CHARACTERISTIC DSM_ClaDfp_GlwCD_C "Fehlerklasse fuer Fehlerpfad Dfp_GlwCD" VALUE 0xCA5F4 Kw_Wu8 20.00 OneToOne 0.00 20.00 FORMAT "%5.2" EXTENDED_LIMITS 0.00 255.0 /end CHARACTERISTIC
/begin CHARACTERISTIC DSM_ClaDfp_GlwCDGlwCirc1_C "Fehlerklasse fuer Fehlerpfad Dfp_GlwCDGlwCirc1" VALUE 0xCA5F5 Kw_Wu8 20.00 OneToOne 0.00 20.00 FORMAT "%5.2" EXTENDED_LIMITS 0.00 255.0 /end CHARACTERISTIC
/begin CHARACTERISTIC DSM_ClaDfp_GlwCDGlwCirc2_C "Fehlerklasse fuer Fehlerpfad Dfp_GlwCDGlwCirc2" VALUE 0xCA5F6 Kw_Wu8 20.00 OneToOne 0.00 20.00 FORMAT "%5.2" EXTENDED_LIMITS 0.00 255.0 /end CHARACTERISTIC
/begin CHARACTERISTIC DSM_ClaDfp_GlwCDGlwCirc3_C "Fehlerklasse fuer Fehlerpfad Dfp_GlwCDGlwCirc3" VALUE 0xCA5F7 Kw_Wu8 20.00 OneToOne 0.00 20.00 FORMAT "%5.2" EXTENDED_LIMITS 0.00 255.0 /end CHARACTERISTIC
/begin CHARACTERISTIC DSM_ClaDfp_GlwCDGlwCirc4_C "Fehlerklasse fuer Fehlerpfad Dfp_GlwCDGlwCirc4" VALUE 0xCA5F8 Kw_Wu8 20.00 OneToOne 0.00 20.00 FORMAT "%5.2" EXTENDED_LIMITS 0.00 255.0 /end CHARACTERISTIC
/begin CHARACTERISTIC DSM_ClaDfp_GlwCDGlwCirc5_C "Fehlerklasse fuer Fehlerpfad Dfp_GlwCDGlwCirc5" VALUE 0xCA5F9 Kw_Wu8 20.00 OneToOne 0.00 20.00 FORMAT "%5.2" EXTENDED_LIMITS 0.00 255.0 /end CHARACTERISTIC
/begin CHARACTERISTIC DSM_ClaDfp_GlwCDGlwCirc6_C "Fehlerklasse fuer Fehlerpfad Dfp_GlwCDGlwCirc6" VALUE 0xCA5FA Kw_Wu8 20.00 OneToOne 0.00 20.00 FORMAT "%5.2" EXTENDED_LIMITS 0.00 255.0 /end CHARACTERISTIC
/begin CHARACTERISTIC DSM_ClaDfp_GlwCDGlwCirc7_C "Fehlerklasse fuer Fehlerpfad Dfp_GlwCDGlwCirc7" VALUE 0xCA5FB Kw_Wu8 20.00 OneToOne 0.00 20.00 FORMAT "%5.2" EXTENDED_LIMITS 0.00 255.0 /end CHARACTERISTIC
/begin CHARACTERISTIC DSM_ClaDfp_GlwCDGlwCirc8_C "Fehlerklasse fuer Fehlerpfad Dfp_GlwCDGlwCirc8" VALUE 0xCA5FC Kw_Wu8 20.00 OneToOne 0.00 20.00 FORMAT "%5.2" EXTENDED_LIMITS 0.00 255.0 /end CHARACTERISTIC
/begin CHARACTERISTIC DSM_ClaDfp_GlwCtl_C "Fehlerklasse fuer Fehlerpfad Dfp_GlwCtl" VALUE 0xCA5FD Kw_Wu8 20.00 OneToOne 0.00 20.00 FORMAT "%5.2" EXTENDED_LIMITS 0.00 255.0 /end CHARACTERISTIC
/begin CHARACTERISTIC DSM_ClaDfp_HWEMonCom_C "Fehlerklasse fuer Fehlerpfad Dfp_HWEMonCom" VALUE 0xCA5FE Kw_Wu8 20.00 OneToOne 0.00 20.00 FORMAT "%5.2" EXTENDED_LIMITS 0.00 255.0 /end CHARACTERISTIC
/begin CHARACTERISTIC DSM_ClaDfp_HWEMonEEPROM_C "Fehlerklasse fuer Fehlerpfad Dfp_HWEMonEEPROM" VALUE 0xCA5FF Kw_Wu8 20.00 OneToOne 0.00 20.00 FORMAT "%5.2" EXTENDED_LIMITS 0.00 255.0 /end CHARACTERISTIC
/begin CHARACTERISTIC DSM_ClaDfp_HWEMonRcyLocked_C "Fehlerklasse fuer Fehlerpfad Dfp_HWEMonRcyLocked" VALUE 0xCA600 Kw_Wu8 20.00 OneToOne 0.00 20.00 FORMAT "%5.2" EXTENDED_LIMITS 0.00 255.0 /end CHARACTERISTIC
/begin CHARACTERISTIC DSM_ClaDfp_HWEMonRcySuppressed_C "Fehlerklasse fuer Fehlerpfad Dfp_HWEMonRcySuppressed" VALUE 0xCA601 Kw_Wu8 20.00 OneToOne 0.00 20.00 FORMAT "%5.2" EXTENDED_LIMITS 0.00 255.0 /end CHARACTERISTIC
/begin CHARACTERISTIC DSM_ClaDfp_HWEMonRcyVisible_C "Fehlerklasse fuer Fehlerpfad Dfp_HWEMonRcyVisible" VALUE 0xCA602 Kw_Wu8 20.00 OneToOne 0.00 20.00 FORMAT "%5.2" EXTENDED_LIMITS 0.00 255.0 /end CHARACTERISTIC
/begin CHARACTERISTIC DSM_ClaDfp_HWEMonUMaxSupply_C "Fehlerklasse fuer Fehlerpfad Dfp_HWEMonUMaxSupply" VALUE 0xCA603 Kw_Wu8 20.00 OneToOne 0.00 20.00 FORMAT "%5.2" EXTENDED_LIMITS 0.00 255.0 /end CHARACTERISTIC
/begin CHARACTERISTIC DSM_ClaDfp_HWEMonUMinSupply_C "Fehlerklasse fuer Fehlerpfad Dfp_HWEMonUMinSupply" VALUE 0xCA604 Kw_Wu8 20.00 OneToOne 0.00 20.00 FORMAT "%5.2" EXTENDED_LIMITS 0.00 255.0 /end CHARACTERISTIC
/begin CHARACTERISTIC DSM_ClaDfp_IATSCD_C "Fehlerklasse fuer Fehlerpfad Dfp_IATSCD" VALUE 0xCA605 Kw_Wu8 20.00 OneToOne 0.00 20.00 FORMAT "%5.2" EXTENDED_LIMITS 0.00 255.0 /end CHARACTERISTIC
/begin CHARACTERISTIC DSM_ClaDfp_IATSCD_CATS_C "Fehlerklasse fuer Fehlerpfad Dfp_IATSCD_CATS" VALUE 0xCA606 Kw_Wu8 20.00 OneToOne 0.00 20.00 FORMAT "%5.2" EXTENDED_LIMITS 0.00 255.0 /end CHARACTERISTIC
/begin CHARACTERISTIC DSM_ClaDfp_ImmCtlImmCD_C "Fehlerklasse fuer Fehlerpfad Dfp_ImmCtlImmCD" VALUE 0xCA607 Kw_Wu8 20.00 OneToOne 0.00 20.00 FORMAT "%5.2" EXTENDED_LIMITS 0.00 255.0 /end CHARACTERISTIC
/begin CHARACTERISTIC DSM_ClaDfp_ImmCtlImmEep_C "Fehlerklasse fuer Fehlerpfad Dfp_ImmCtlImmEep" VALUE 0xCA608 Kw_Wu8 20.00 OneToOne 0.00 20.00 FORMAT "%5.2" EXTENDED_LIMITS 0.00 255.0 /end CHARACTERISTIC
/begin CHARACTERISTIC DSM_ClaDfp_ImmCtlMpl_C "Fehlerklasse fuer Fehlerpfad Dfp_ImmCtlMpl" VALUE 0xCA609 Kw_Wu8 20.00 OneToOne 0.00 20.00 FORMAT "%5.2" EXTENDED_LIMITS 0.00 255.0 /end CHARACTERISTIC
/begin CHARACTERISTIC DSM_ClaDfp_IndSys1_C "Fehlerklasse fuer Fehlerpfad Dfp_IndSys1" VALUE 0xCA60A Kw_Wu8 20.00 OneToOne 0.00 20.00 FORMAT "%5.2" EXTENDED_LIMITS 0.00 255.0 /end CHARACTERISTIC
/begin CHARACTERISTIC DSM_ClaDfp_IndSys2_C "Fehlerklasse fuer Fehlerpfad Dfp_IndSys2" VALUE 0xCA60B Kw_Wu8 20.00 OneToOne 0.00 20.00 FORMAT "%5.2" EXTENDED_LIMITS 0.00 255.0 /end CHARACTERISTIC
/begin CHARACTERISTIC DSM_ClaDfp_InjCrv_InjLim_C "Fehlerklasse fuer Fehlerpfad Dfp_InjCrv_injLim" VALUE 0xCA60C Kw_Wu8 20.00 OneToOne 0.00 20.00 FORMAT "%5.2" EXTENDED_LIMITS 0.00 255.0 /end CHARACTERISTIC
/begin CHARACTERISTIC DSM_ClaDfp_InjCtlAdjQnt_C "Fehlerklasse fuer Fehlerpfad Dfp_InjCtlAdjQnt" VALUE 0xCA60D Kw_Wu8 20.00 OneToOne 0.00 20.00 FORMAT "%5.2" EXTENDED_LIMITS 0.00 255.0 /end CHARACTERISTIC
/begin CHARACTERISTIC DSM_ClaDfp_InjCtlDrift_C "Fehlerklasse fuer Fehlerpfad Dfp_InjCtlDrift" VALUE 0xCA60E Kw_Wu8 20.00 OneToOne 0.00 20.00 FORMAT "%5.2" EXTENDED_LIMITS 0.00 255.0 /end CHARACTERISTIC
/begin CHARACTERISTIC DSM_ClaDfp_InjVlvBnk1A_C "Fehlerklasse fuer Fehlerpfad Dfp_InjVlvBnk1A" VALUE 0xCA60F Kw_Wu8 20.00 OneToOne 0.00 20.00 FORMAT "%5.2" EXTENDED_LIMITS 0.00 255.0 /end CHARACTERISTIC
/begin CHARACTERISTIC DSM_ClaDfp_InjVlvBnk1B_C "Fehlerklasse fuer Fehlerpfad Dfp_InjVlvBnk1B" VALUE 0xCA610 Kw_Wu8 20.00 OneToOne 0.00 20.00 FORMAT "%5.2" EXTENDED_LIMITS 0.00 255.0 /end CHARACTERISTIC
/begin CHARACTERISTIC DSM_ClaDfp_InjVlvBnk2A_C "Fehlerklasse fuer Fehlerpfad Dfp_InjVlvBnk2A" VALUE 0xCA611 Kw_Wu8 20.00 OneToOne 0.00 20.00 FORMAT "%5.2" EXTENDED_LIMITS 0.00 255.0 /end CHARACTERISTIC
/begin CHARACTERISTIC DSM_ClaDfp_InjVlvBnk2B_C "Fehlerklasse fuer Fehlerpfad Dfp_InjVlvBnk2B" VALUE 0xCA612 Kw_Wu8 20.00 OneToOne 0.00 20.00 FORMAT "%5.2" EXTENDED_LIMITS 0.00 255.0 /end CHARACTERISTIC
/begin CHARACTERISTIC DSM_ClaDfp_InjVlvChipA_C "Fehlerklasse fuer Fehlerpfad Dfp_InjVlvChipA" VALUE 0xCA613 Kw_Wu8 20.00 OneToOne 0.00 20.00 FORMAT "%5.2" EXTENDED_LIMITS 0.00 255.0 /end CHARACTERISTIC
/begin CHARACTERISTIC DSM_ClaDfp_InjVlvChipB_C "Fehlerklasse fuer Fehlerpfad Dfp_InjVlvChipB" VALUE 0xCA614 Kw_Wu8 20.00 OneToOne 0.00 20.00 FORMAT "%5.2" EXTENDED_LIMITS 0.00 255.0 /end CHARACTERISTIC
/begin CHARACTERISTIC DSM_ClaDfp_InjVlvCyl1A_C "Fehlerklasse fuer Fehlerpfad Dfp_InjVlvCyl1A" VALUE 0xCA615 Kw_Wu8 20.00 OneToOne 0.00 20.00 FORMAT "%5.2" EXTENDED_LIMITS 0.00 255.0 /end CHARACTERISTIC
/begin CHARACTERISTIC DSM_ClaDfp_InjVlvCyl1B_C "Fehlerklasse fuer Fehlerpfad Dfp_InjVlvCyl1B" VALUE 0xCA616 Kw_Wu8 20.00 OneToOne 0.00 20.00 FORMAT "%5.2" EXTENDED_LIMITS 0.00 255.0 /end CHARACTERISTIC
/begin CHARACTERISTIC DSM_ClaDfp_InjVlvCyl2A_C "Fehlerklasse fuer Fehlerpfad Dfp_InjVlvCyl2A" VALUE 0xCA617 Kw_Wu8 20.00 OneToOne 0.00 20.00 FORMAT "%5.2" EXTENDED_LIMITS 0.00 255.0 /end CHARACTERISTIC
/begin CHARACTERISTIC DSM_ClaDfp_InjVlvCyl2B_C "Fehlerklasse fuer Fehlerpfad Dfp_InjVlvCyl2B" VALUE 0xCA618 Kw_Wu8 20.00 OneToOne 0.00 20.00 FORMAT "%5.2" EXTENDED_LIMITS 0.00 255.0 /end CHARACTERISTIC
/begin CHARACTERISTIC DSM_ClaDfp_InjVlvCyl3A_C "Fehlerklasse fuer Fehlerpfad Dfp_InjVlvCyl3A" VALUE 0xCA619 Kw_Wu8 20.00 OneToOne 0.00 20.00 FORMAT "%5.2" EXTENDED_LIMITS 0.00 255.0 /end CHARACTERISTIC
/begin CHARACTERISTIC DSM_ClaDfp_InjVlvCyl3B_C "Fehlerklasse fuer Fehlerpfad Dfp_InjVlvCyl3B" VALUE 0xCA61A Kw_Wu8 20.00 OneToOne 0.00 20.00 FORMAT "%5.2" EXTENDED_LIMITS 0.00 255.0 /end CHARACTERISTIC
/begin CHARACTERISTIC DSM_ClaDfp_InjVlvCyl4A_C "Fehlerklasse fuer Fehlerpfad Dfp_InjVlvCyl4A" VALUE 0xCA61B Kw_Wu8 20.00 OneToOne 0.00 20.00 FORMAT "%5.2" EXTENDED_LIMITS 0.00 255.0 /end CHARACTERISTIC
/begin CHARACTERISTIC DSM_ClaDfp_InjVlvCyl4B_C "Fehlerklasse fuer Fehlerpfad Dfp_InjVlvCyl4B" VALUE 0xCA61C Kw_Wu8 20.00 OneToOne 0.00 20.00 FORMAT "%5.2" EXTENDED_LIMITS 0.00 255.0 /end CHARACTERISTIC
/begin CHARACTERISTIC DSM_ClaDfp_InjVlvCyl5A_C "Fehlerklasse fuer Fehlerpfad Dfp_InjVlvCyl5A" VALUE 0xCA61D Kw_Wu8 20.00 OneToOne 0.00 20.00 FORMAT "%5.2" EXTENDED_LIMITS 0.00 255.0 /end CHARACTERISTIC
/begin CHARACTERISTIC DSM_ClaDfp_InjVlvCyl5B_C "Fehlerklasse fuer Fehlerpfad Dfp_InjVlvCyl5B" VALUE 0xCA61E Kw_Wu8 20.00 OneToOne 0.00 20.00 FORMAT "%5.2" EXTENDED_LIMITS 0.00 255.0 /end CHARACTERISTIC
/begin CHARACTERISTIC DSM_ClaDfp_InjVlvCyl6A_C "Fehlerklasse fuer Fehlerpfad Dfp_InjVlvCyl6A" VALUE 0xCA61F Kw_Wu8 20.00 OneToOne 0.00 20.00 FORMAT "%5.2" EXTENDED_LIMITS 0.00 255.0 /end CHARACTERISTIC
/begin CHARACTERISTIC DSM_ClaDfp_InjVlvCyl6B_C "Fehlerklasse fuer Fehlerpfad Dfp_InjVlvCyl6B" VALUE 0xCA620 Kw_Wu8 20.00 OneToOne 0.00 20.00 FORMAT "%5.2" EXTENDED_LIMITS 0.00 255.0 /end CHARACTERISTIC
/begin CHARACTERISTIC DSM_ClaDfp_LPACD_Max_C "Fehlerklasse fuer Fehlerpfad Dfp_LPACD_Max" VALUE 0xCA621 Kw_Wu8 20.00 OneToOne 0.00 20.00 FORMAT "%5.2" EXTENDED_LIMITS 0.00 255.0 /end CHARACTERISTIC
/begin CHARACTERISTIC DSM_ClaDfp_LPACD_Min_C "Fehlerklasse fuer Fehlerpfad Dfp_LPACD_Min" VALUE 0xCA622 Kw_Wu8 20.00 OneToOne 0.00 20.00 FORMAT "%5.2" EXTENDED_LIMITS 0.00 255.0 /end CHARACTERISTIC
/begin CHARACTERISTIC DSM_ClaDfp_LPACD_SigNpl_C "Fehlerklasse fuer Fehlerpfad Dfp_LPACD_SigNpl" VALUE 0xCA623 Kw_Wu8 20.00 OneToOne 0.00 20.00 FORMAT "%5.2" EXTENDED_LIMITS 0.00 255.0 /end CHARACTERISTIC
/begin CHARACTERISTIC DSM_ClaDfp_LSUCDCircNernst0_C "Fehlerklasse fuer Fehlerpfad Dfp_LSUCDCircNernst0" VALUE 0xCA624 Kw_Wu8 20.00 OneToOne 0.00 20.00 FORMAT "%5.2" EXTENDED_LIMITS 0.00 255.0 /end CHARACTERISTIC
/begin CHARACTERISTIC DSM_ClaDfp_LSUCDCircPumpCur0_C "Fehlerklasse fuer Fehlerpfad Dfp_LSUCDCircPumpCur0" VALUE 0xCA625 Kw_Wu8 20.00 OneToOne 0.00 20.00 FORMAT "%5.2" EXTENDED_LIMITS 0.00 255.0 /end CHARACTERISTIC
/begin CHARACTERISTIC DSM_ClaDfp_LSUCDCircVirtGnd0_C "Fehlerklasse fuer Fehlerpfad Dfp_LSUCDCircVirtGnd0" VALUE 0xCA626 Kw_Wu8 20.00 OneToOne 0.00 20.00 FORMAT "%5.2" EXTENDED_LIMITS 0.00 255.0 /end CHARACTERISTIC
/begin CHARACTERISTIC DSM_ClaDfp_LSUCDHeater0_C "Fehlerklasse fuer Fehlerpfad Dfp_LSUCDHeater0" VALUE 0xCA627 Kw_Wu8 20.00 OneToOne 0.00 20.00 FORMAT "%5.2" EXTENDED_LIMITS 0.00 255.0 /end CHARACTERISTIC
/begin CHARACTERISTIC DSM_ClaDfp_LSUCDHtCoup0_C "Fehlerklasse fuer Fehlerpfad Dfp_LSUCDHtCoup0" VALUE 0xCA628 Kw_Wu8 20.00 OneToOne 0.00 20.00 FORMAT "%5.2" EXTENDED_LIMITS 0.00 255.0 /end CHARACTERISTIC
/begin CHARACTERISTIC DSM_ClaDfp_LSUCDO20_C "Fehlerklasse fuer Fehlerpfad Dfp_LSUCDO20" VALUE 0xCA629 Kw_Wu8 20.00 OneToOne 0.00 20.00 FORMAT "%5.2" EXTENDED_LIMITS 0.00 255.0 /end CHARACTERISTIC
/begin CHARACTERISTIC DSM_ClaDfp_LSUCDO2Clb0_C "Fehlerklasse fuer Fehlerpfad Dfp_LSUCDO2Clb0" VALUE 0xCA62A Kw_Wu8 20.00 OneToOne 0.00 20.00 FORMAT "%5.2" EXTENDED_LIMITS 0.00 255.0 /end CHARACTERISTIC
/begin CHARACTERISTIC DSM_ClaDfp_LSUCDRiClb0_C "Fehlerklasse fuer Fehlerpfad Dfp_LSUCDRiClb0" VALUE 0xCA62B Kw_Wu8 20.00 OneToOne 0.00 20.00 FORMAT "%5.2" EXTENDED_LIMITS 0.00 255.0 /end CHARACTERISTIC
/begin CHARACTERISTIC DSM_ClaDfp_LSUCDSPI0_C "Fehlerklasse fuer Fehlerpfad Dfp_LSUCDSPI0" VALUE 0xCA62C Kw_Wu8 20.00 OneToOne 0.00 20.00 FORMAT "%5.2" EXTENDED_LIMITS 0.00 255.0 /end CHARACTERISTIC
/begin CHARACTERISTIC DSM_ClaDfp_LSUCDSPIBattLow0_C "Fehlerklasse fuer Fehlerpfad Dfp_LSUCDSPIBattLow0" VALUE 0xCA62D Kw_Wu8 20.00 OneToOne 0.00 20.00 FORMAT "%5.2" EXTENDED_LIMITS 0.00 255.0 /end CHARACTERISTIC
/begin CHARACTERISTIC DSM_ClaDfp_LSUCDWireIP0_C "Fehlerklasse fuer Fehlerpfad Dfp_LSUCDWireIP0" VALUE 0xCA62E Kw_Wu8 20.00 OneToOne 0.00 20.00 FORMAT "%5.2" EXTENDED_LIMITS 0.00 255.0 /end CHARACTERISTIC
/begin CHARACTERISTIC DSM_ClaDfp_LSUCtlRiExc0_C "Fehlerklasse fuer Fehlerpfad Dfp_LSUCtlRiExc0" VALUE 0xCA62F Kw_Wu8 20.00 OneToOne 0.00 20.00 FORMAT "%5.2" EXTENDED_LIMITS 0.00 255.0 /end CHARACTERISTIC
/begin CHARACTERISTIC DSM_ClaDfp_LSUMon1Sens_C "Fehlerklasse fuer Fehlerpfad Dfp_LSUMon1Sens" VALUE 0xCA630 Kw_Wu8 20.00 OneToOne 0.00 20.00 FORMAT "%5.2" EXTENDED_LIMITS 0.00 255.0 /end CHARACTERISTIC
/begin CHARACTERISTIC DSM_ClaDfp_LSUMon2Sens_C "Fehlerklasse fuer Fehlerpfad Dfp_LSUMon2Sens" VALUE 0xCA631 Kw_Wu8 20.00 OneToOne 0.00 20.00 FORMAT "%5.2" EXTENDED_LIMITS 0.00 255.0 /end CHARACTERISTIC
/begin CHARACTERISTIC DSM_ClaDfp_LubCD_C "Fehlerklasse fuer Fehlerpfad Dfp_LubCD" VALUE 0xCA632 Kw_Wu8 20.00 OneToOne 0.00 20.00 FORMAT "%5.2" EXTENDED_LIMITS 0.00 255.0 /end CHARACTERISTIC
/begin CHARACTERISTIC DSM_ClaDfp_MIL_C "Fehlerklasse fuer Fehlerpfad Dfp_MIL" VALUE 0xCA633 Kw_Wu8 20.00 OneToOne 0.00 20.00 FORMAT "%5.2" EXTENDED_LIMITS 0.00 255.0 /end CHARACTERISTIC
/begin CHARACTERISTIC DSM_ClaDfp_MRlyCD_C "Fehlerklasse fuer Fehlerpfad Dfp_MRlyCD" VALUE 0xCA634 Kw_Wu8 20.00 OneToOne 0.00 20.00 FORMAT "%5.2" EXTENDED_LIMITS 0.00 255.0 /end CHARACTERISTIC
/begin CHARACTERISTIC DSM_ClaDfp_MSidCD_Comm_C "Fehlerklasse fuer Fehlerpfad Dfp_MSidCD_Comm" VALUE 0xCA635 Kw_Wu8 20.00 OneToOne 0.00 20.00 FORMAT "%5.2" EXTENDED_LIMITS 0.00 255.0 /end CHARACTERISTIC
/begin CHARACTERISTIC DSM_ClaDfp_MSidCD_Pin_C "Fehlerklasse fuer Fehlerpfad Dfp_MSidCD_Pin" VALUE 0xCA636 Kw_Wu8 20.00 OneToOne 0.00 20.00 FORMAT "%5.2" EXTENDED_LIMITS 0.00 255.0 /end CHARACTERISTIC
/begin CHARACTERISTIC DSM_ClaDfp_MSidCD_Sel_INI_C "Fehlerklasse fuer Fehlerpfad Dfp_MSidCD_Sel_INI" VALUE 0xCA637 Kw_Wu8 20.00 OneToOne 0.00 20.00 FORMAT "%5.2" EXTENDED_LIMITS 0.00 255.0 /end CHARACTERISTIC
/begin CHARACTERISTIC DSM_ClaDfp_MSidCD_Select_C "Fehlerklasse fuer Fehlerpfad Dfp_MSidCD_Select" VALUE 0xCA638 Kw_Wu8 20.00 OneToOne 0.00 20.00 FORMAT "%5.2" EXTENDED_LIMITS 0.00 255.0 /end CHARACTERISTIC
/begin CHARACTERISTIC DSM_ClaDfp_MeUnCDNoLoad_C "Fehlerklasse fuer Fehlerpfad Dfp_MeUnCDNoLoad" VALUE 0xCA639 Kw_Wu8 20.00 OneToOne 0.00 20.00 FORMAT "%5.2" EXTENDED_LIMITS 0.00 255.0 /end CHARACTERISTIC
/begin CHARACTERISTIC DSM_ClaDfp_MeUnCDSCBat_C "Fehlerklasse fuer Fehlerpfad Dfp_MeUnCDSCBat" VALUE 0xCA63A Kw_Wu8 20.00 OneToOne 0.00 20.00 FORMAT "%5.2" EXTENDED_LIMITS 0.00 255.0 /end CHARACTERISTIC
/begin CHARACTERISTIC DSM_ClaDfp_MeUnCDSCGnd_C "Fehlerklasse fuer Fehlerpfad Dfp_MeUnCDSCGnd" VALUE 0xCA63B Kw_Wu8 20.00 OneToOne 0.00 20.00 FORMAT "%5.2" EXTENDED_LIMITS 0.00 255.0 /end CHARACTERISTIC
/begin CHARACTERISTIC DSM_ClaDfp_MeUnCD_ADC_C "Fehlerklasse fuer Fehlerpfad Dfp_MeUnCD_ADC" VALUE 0xCA63C Kw_Wu8 20.00 OneToOne 0.00 20.00 FORMAT "%5.2" EXTENDED_LIMITS 0.00 255.0 /end CHARACTERISTIC
/begin CHARACTERISTIC DSM_ClaDfp_MeUnCD_SigTst_C "Fehlerklasse fuer Fehlerpfad Dfp_MeUnCD_SigTst" VALUE 0xCA63D Kw_Wu8 20.00 OneToOne 0.00 20.00 FORMAT "%5.2" EXTENDED_LIMITS 0.00 255.0 /end CHARACTERISTIC
/begin CHARACTERISTIC DSM_ClaDfp_Montr_C "Fehlerklasse fuer Fehlerpfad Dfp_Montr" VALUE 0xCA63E Kw_Wu8 20.00 OneToOne 0.00 20.00 FORMAT "%5.2" EXTENDED_LIMITS 0.00 255.0 /end CHARACTERISTIC
/begin CHARACTERISTIC DSM_ClaDfp_NetMngDeviceA_C "Fehlerklasse fuer Fehlerpfad Dfp_NetMngDeviceA" VALUE 0xCA63F Kw_Wu8 20.00 OneToOne 0.00 20.00 FORMAT "%5.2" EXTENDED_LIMITS 0.00 255.0 /end CHARACTERISTIC
/begin CHARACTERISTIC DSM_ClaDfp_NetMngDeviceB_C "Fehlerklasse fuer Fehlerpfad Dfp_NetMngDeviceB" VALUE 0xCA640 Kw_Wu8 20.00 OneToOne 0.00 20.00 FORMAT "%5.2" EXTENDED_LIMITS 0.00 255.0 /end CHARACTERISTIC
/begin CHARACTERISTIC DSM_ClaDfp_NetMngDeviceC_C "Fehlerklasse fuer Fehlerpfad Dfp_NetMngDeviceC" VALUE 0xCA641 Kw_Wu8 20.00 OneToOne 0.00 20.00 FORMAT "%5.2" EXTENDED_LIMITS 0.00 255.0 /end CHARACTERISTIC
/begin CHARACTERISTIC DSM_ClaDfp_OPSCD_Lamp_C "Fehlerklasse fuer Fehlerpfad Dfp_OPSCD_Lamp" VALUE 0xCA642 Kw_Wu8 20.00 OneToOne 0.00 20.00 FORMAT "%5.2" EXTENDED_LIMITS 0.00 255.0 /end CHARACTERISTIC
/begin CHARACTERISTIC DSM_ClaDfp_OPSCD_anain_C "Fehlerklasse fuer Fehlerpfad Dfp_OPSCD_anain" VALUE 0xCA643 Kw_Wu8 20.00 OneToOne 0.00 20.00 FORMAT "%5.2" EXTENDED_LIMITS 0.00 255.0 /end CHARACTERISTIC
/begin CHARACTERISTIC DSM_ClaDfp_OTSCD_C "Fehlerklasse fuer Fehlerpfad Dfp_OTSCD" VALUE 0xCA644 Kw_Wu8 20.00 OneToOne 0.00 20.00 FORMAT "%5.2" EXTENDED_LIMITS 0.00 255.0 /end CHARACTERISTIC
/begin CHARACTERISTIC DSM_ClaDfp_OvRMon_C "Fehlerklasse fuer Fehlerpfad Dfp_OvRMon" VALUE 0xCA645 Kw_Wu8 20.00 OneToOne 0.00 20.00 FORMAT "%5.2" EXTENDED_LIMITS 0.00 255.0 /end CHARACTERISTIC
/begin CHARACTERISTIC DSM_ClaDfp_OvRMonBrk_C "Fehlerklasse fuer Fehlerpfad Dfp_OvRMonBrk" VALUE 0xCA646 Kw_Wu8 20.00 OneToOne 0.00 20.00 FORMAT "%5.2" EXTENDED_LIMITS 0.00 255.0 /end CHARACTERISTIC
/begin CHARACTERISTIC DSM_ClaDfp_OvRMonSigA_C "Fehlerklasse fuer Fehlerpfad Dfp_OvRMonSigA" VALUE 0xCA647 Kw_Wu8 20.00 OneToOne 0.00 20.00 FORMAT "%5.2" EXTENDED_LIMITS 0.00 255.0 /end CHARACTERISTIC
/begin CHARACTERISTIC DSM_ClaDfp_OxiCCDTPre_C "Fehlerklasse fuer Fehlerpfad Dfp_OxiCCDTPre" VALUE 0xCA648 Kw_Wu8 20.00 OneToOne 0.00 20.00 FORMAT "%5.2" EXTENDED_LIMITS 0.00 255.0 /end CHARACTERISTIC
/begin CHARACTERISTIC DSM_ClaDfp_PCR_GovDevNeg_C "Fehlerklasse fuer Fehlerpfad Dfp_PCR_GovDevNeg" VALUE 0xCA649 Kw_Wu8 20.00 OneToOne 0.00 20.00 FORMAT "%5.2" EXTENDED_LIMITS 0.00 255.0 /end CHARACTERISTIC
/begin CHARACTERISTIC DSM_ClaDfp_PCR_GovDevPos_C "Fehlerklasse fuer Fehlerpfad Dfp_PCR_GovDevPos" VALUE 0xCA64A Kw_Wu8 20.00 OneToOne 0.00 20.00 FORMAT "%5.2" EXTENDED_LIMITS 0.00 255.0 /end CHARACTERISTIC
/begin CHARACTERISTIC DSM_ClaDfp_PCVCDNoLoad_C "Fehlerklasse fuer Fehlerpfad Dfp_PCVCDNoLoad" VALUE 0xCA64B Kw_Wu8 20.00 OneToOne 0.00 20.00 FORMAT "%5.2" EXTENDED_LIMITS 0.00 255.0 /end CHARACTERISTIC
/begin CHARACTERISTIC DSM_ClaDfp_PCVCDSCBat_C "Fehlerklasse fuer Fehlerpfad Dfp_PCVCDSCBat" VALUE 0xCA64C Kw_Wu8 20.00 OneToOne 0.00 20.00 FORMAT "%5.2" EXTENDED_LIMITS 0.00 255.0 /end CHARACTERISTIC
/begin CHARACTERISTIC DSM_ClaDfp_PCVCDSCGnd_C "Fehlerklasse fuer Fehlerpfad Dfp_PCVCDSCGnd" VALUE 0xCA64D Kw_Wu8 20.00 OneToOne 0.00 20.00 FORMAT "%5.2" EXTENDED_LIMITS 0.00 255.0 /end CHARACTERISTIC
/begin CHARACTERISTIC DSM_ClaDfp_PCVCD_ADC_C "Fehlerklasse fuer Fehlerpfad Dfp_PCVCD_ADC" VALUE 0xCA64E Kw_Wu8 20.00 OneToOne 0.00 20.00 FORMAT "%5.2" EXTENDED_LIMITS 0.00 255.0 /end CHARACTERISTIC
/begin CHARACTERISTIC DSM_ClaDfp_PCVCD_SigTst_C "Fehlerklasse fuer Fehlerpfad Dfp_PCVCD_SigTst" VALUE 0xCA64F Kw_Wu8 20.00 OneToOne 0.00 20.00 FORMAT "%5.2" EXTENDED_LIMITS 0.00 255.0 /end CHARACTERISTIC
/begin CHARACTERISTIC DSM_ClaDfp_PFltAPSens_C "Fehlerklasse fuer Fehlerpfad Dfp_PFltAPSens" VALUE 0xCA650 Kw_Wu8 20.00 OneToOne 0.00 20.00 FORMAT "%5.2" EXTENDED_LIMITS 0.00 255.0 /end CHARACTERISTIC
/begin CHARACTERISTIC DSM_ClaDfp_PFltCDPPre_C "Fehlerklasse fuer Fehlerpfad Dfp_PFltCDPPre" VALUE 0xCA651 Kw_Wu8 20.00 OneToOne 0.00 20.00 FORMAT "%5.2" EXTENDED_LIMITS 0.00 255.0 /end CHARACTERISTIC
/begin CHARACTERISTIC DSM_ClaDfp_PFltCDTempPre_C "Fehlerklasse fuer Fehlerpfad Dfp_PFltCDTempPre" VALUE 0xCA652 Kw_Wu8 20.00 OneToOne 0.00 20.00 FORMAT "%5.2" EXTENDED_LIMITS 0.00 255.0 /end CHARACTERISTIC
/begin CHARACTERISTIC DSM_ClaDfp_PFltChar_C "Fehlerklasse fuer Fehlerpfad Dfp_PFltChar" VALUE 0xCA653 Kw_Wu8 20.00 OneToOne 0.00 20.00 FORMAT "%5.2" EXTENDED_LIMITS 0.00 255.0 /end CHARACTERISTIC
/begin CHARACTERISTIC DSM_ClaDfp_PFltEngPrt_C "Fehlerklasse fuer Fehlerpfad Dfp_PFltEngPrt" VALUE 0xCA654 Kw_Wu8 20.00 OneToOne 0.00 20.00 FORMAT "%5.2" EXTENDED_LIMITS 0.00 255.0 /end CHARACTERISTIC
/begin CHARACTERISTIC DSM_ClaDfp_PFltPresDynPlaus_C "Fehlerklasse fuer Fehlerpfad Dfp_PFltPresDynPlaus" VALUE 0xCA655 Kw_Wu8 20.00 OneToOne 0.00 20.00 FORMAT "%5.2" EXTENDED_LIMITS 0.00 255.0 /end CHARACTERISTIC
/begin CHARACTERISTIC DSM_ClaDfp_PFltPresSens_C "Fehlerklasse fuer Fehlerpfad Dfp_PFltPresSens" VALUE 0xCA656 Kw_Wu8 20.00 OneToOne 0.00 20.00 FORMAT "%5.2" EXTENDED_LIMITS 0.00 255.0 /end CHARACTERISTIC
/begin CHARACTERISTIC DSM_ClaDfp_PFltPresSensFrz_C "Fehlerklasse fuer Fehlerpfad Dfp_PFltPresSensFrz" VALUE 0xCA657 Kw_Wu8 20.00 OneToOne 0.00 20.00 FORMAT "%5.2" EXTENDED_LIMITS 0.00 255.0 /end CHARACTERISTIC
/begin CHARACTERISTIC DSM_ClaDfp_PFltPresSensHsLn_C "Fehlerklasse fuer Fehlerpfad Dfp_PFltPresSensHsLn" VALUE 0xCA658 Kw_Wu8 20.00 OneToOne 0.00 20.00 FORMAT "%5.2" EXTENDED_LIMITS 0.00 255.0 /end CHARACTERISTIC
/begin CHARACTERISTIC DSM_ClaDfp_PFltPresSensSot_C "Fehlerklasse fuer Fehlerpfad Dfp_PFltPresSensSot" VALUE 0xCA659 Kw_Wu8 20.00 OneToOne 0.00 20.00 FORMAT "%5.2" EXTENDED_LIMITS 0.00 255.0 /end CHARACTERISTIC
/begin CHARACTERISTIC DSM_ClaDfp_PFltRgnPerm_C "Fehlerklasse fuer Fehlerpfad Dfp_PFltRgnPerm" VALUE 0xCA65A Kw_Wu8 20.00 OneToOne 0.00 20.00 FORMAT "%5.2" EXTENDED_LIMITS 0.00 255.0 /end CHARACTERISTIC
/begin CHARACTERISTIC DSM_ClaDfp_PFltTempDwnStrm_C "Fehlerklasse fuer Fehlerpfad Dfp_PFltTempDwnStrm" VALUE 0xCA65B Kw_Wu8 20.00 OneToOne 0.00 20.00 FORMAT "%5.2" EXTENDED_LIMITS 0.00 255.0 /end CHARACTERISTIC
/begin CHARACTERISTIC DSM_ClaDfp_PFltTempSens_C "Fehlerklasse fuer Fehlerpfad Dfp_PFltTempSens" VALUE 0xCA65C Kw_Wu8 20.00 OneToOne 0.00 20.00 FORMAT "%5.2" EXTENDED_LIMITS 0.00 255.0 /end CHARACTERISTIC
/begin CHARACTERISTIC DSM_ClaDfp_PFltTempUpStrm_C "Fehlerklasse fuer Fehlerpfad Dfp_PFltTempUpStrm" VALUE 0xCA65D Kw_Wu8 20.00 OneToOne 0.00 20.00 FORMAT "%5.2" EXTENDED_LIMITS 0.00 255.0 /end CHARACTERISTIC
/begin CHARACTERISTIC DSM_ClaDfp_PFltmSotDiffMax_C "Fehlerklasse fuer Fehlerpfad Dfp_PFltmSotDiffMax" VALUE 0xCA65E Kw_Wu8 20.00 OneToOne 0.00 20.00 FORMAT "%5.2" EXTENDED_LIMITS 0.00 255.0 /end CHARACTERISTIC
/begin CHARACTERISTIC DSM_ClaDfp_PSPCD_Actr_C "Fehlerklasse fuer Fehlerpfad Dfp_PSPCD_Actr" VALUE 0xCA65F Kw_Wu8 20.00 OneToOne 0.00 20.00 FORMAT "%5.2" EXTENDED_LIMITS 0.00 255.0 /end CHARACTERISTIC
/begin CHARACTERISTIC DSM_ClaDfp_QLTCD_C "Fehlerklasse fuer Fehlerpfad Dfp_QLTCD" VALUE 0xCA660 Kw_Wu8 20.00 OneToOne 0.00 20.00 FORMAT "%5.2" EXTENDED_LIMITS 0.00 255.0 /end CHARACTERISTIC
/begin CHARACTERISTIC DSM_ClaDfp_RailCD_C "Fehlerklasse fuer Fehlerpfad Dfp_RailCD" VALUE 0xCA661 Kw_Wu8 20.00 OneToOne 0.00 20.00 FORMAT "%5.2" EXTENDED_LIMITS 0.00 255.0 /end CHARACTERISTIC
/begin CHARACTERISTIC DSM_ClaDfp_RailCDOfsTst_C "Fehlerklasse fuer Fehlerpfad Dfp_RailCDOfsTst" VALUE 0xCA662 Kw_Wu8 20.00 OneToOne 0.00 20.00 FORMAT "%5.2" EXTENDED_LIMITS 0.00 255.0 /end CHARACTERISTIC
/begin CHARACTERISTIC DSM_ClaDfp_RailCD_PMonStrt_C "Fehlerklasse fuer Fehlerpfad Dfp_RailCD_PMonStrt" VALUE 0xCA663 Kw_Wu8 20.00 OneToOne 0.00 20.00 FORMAT "%5.2" EXTENDED_LIMITS 0.00 255.0 /end CHARACTERISTIC
/begin CHARACTERISTIC DSM_ClaDfp_RailCtlModeMeUnDiag_C "Fehlerklasse fuer Fehlerpfad Dfp_RailCtlModeMeUnDiag" VALUE 0xCA664 Kw_Wu8 20.00 OneToOne 0.00 20.00 FORMAT "%5.2" EXTENDED_LIMITS 0.00 255.0 /end CHARACTERISTIC
/begin CHARACTERISTIC DSM_ClaDfp_RailCtlModePCVDiag_C "Fehlerklasse fuer Fehlerpfad Dfp_RailCtlModePCVDiag" VALUE 0xCA665 Kw_Wu8 20.00 OneToOne 0.00 20.00 FORMAT "%5.2" EXTENDED_LIMITS 0.00 255.0 /end CHARACTERISTIC
/begin CHARACTERISTIC DSM_ClaDfp_RailMeUn0_C "Fehlerklasse fuer Fehlerpfad Dfp_RailMeUn0" VALUE 0xCA666 Kw_Wu8 20.00 OneToOne 0.00 20.00 FORMAT "%5.2" EXTENDED_LIMITS 0.00 255.0 /end CHARACTERISTIC
/begin CHARACTERISTIC DSM_ClaDfp_RailMeUn1_C "Fehlerklasse fuer Fehlerpfad Dfp_RailMeUn1" VALUE 0xCA667 Kw_Wu8 20.00 OneToOne 0.00 20.00 FORMAT "%5.2" EXTENDED_LIMITS 0.00 255.0 /end CHARACTERISTIC
/begin CHARACTERISTIC DSM_ClaDfp_RailMeUn2_C "Fehlerklasse fuer Fehlerpfad Dfp_RailMeUn2" VALUE 0xCA668 Kw_Wu8 20.00 OneToOne 0.00 20.00 FORMAT "%5.2" EXTENDED_LIMITS 0.00 255.0 /end CHARACTERISTIC
/begin CHARACTERISTIC DSM_ClaDfp_RailMeUn3_C "Fehlerklasse fuer Fehlerpfad Dfp_RailMeUn3" VALUE 0xCA669 Kw_Wu8 20.00 OneToOne 0.00 20.00 FORMAT "%5.2" EXTENDED_LIMITS 0.00 255.0 /end CHARACTERISTIC
/begin CHARACTERISTIC DSM_ClaDfp_RailMeUn4_C "Fehlerklasse fuer Fehlerpfad Dfp_RailMeUn4" VALUE 0xCA66A Kw_Wu8 20.00 OneToOne 0.00 20.00 FORMAT "%5.2" EXTENDED_LIMITS 0.00 255.0 /end CHARACTERISTIC
/begin CHARACTERISTIC DSM_ClaDfp_RailPCV0_C "Fehlerklasse fuer Fehlerpfad Dfp_RailPCV0" VALUE 0xCA66B Kw_Wu8 20.00 OneToOne 0.00 20.00 FORMAT "%5.2" EXTENDED_LIMITS 0.00 255.0 /end CHARACTERISTIC
/begin CHARACTERISTIC DSM_ClaDfp_RailPCV1_C "Fehlerklasse fuer Fehlerpfad Dfp_RailPCV1" VALUE 0xCA66C Kw_Wu8 20.00 OneToOne 0.00 20.00 FORMAT "%5.2" EXTENDED_LIMITS 0.00 255.0 /end CHARACTERISTIC
/begin CHARACTERISTIC DSM_ClaDfp_RailPCV2_C "Fehlerklasse fuer Fehlerpfad Dfp_RailPCV2" VALUE 0xCA66D Kw_Wu8 20.00 OneToOne 0.00 20.00 FORMAT "%5.2" EXTENDED_LIMITS 0.00 255.0 /end CHARACTERISTIC
/begin CHARACTERISTIC DSM_ClaDfp_RailPCV3_C "Fehlerklasse fuer Fehlerpfad Dfp_RailPCV3" VALUE 0xCA66E Kw_Wu8 20.00 OneToOne 0.00 20.00 FORMAT "%5.2" EXTENDED_LIMITS 0.00 255.0 /end CHARACTERISTIC
/begin CHARACTERISTIC DSM_ClaDfp_RailPCV4_C "Fehlerklasse fuer Fehlerpfad Dfp_RailPCV4" VALUE 0xCA66F Kw_Wu8 20.00 OneToOne 0.00 20.00 FORMAT "%5.2" EXTENDED_LIMITS 0.00 255.0 /end CHARACTERISTIC
/begin CHARACTERISTIC DSM_ClaDfp_RailPCV5_C "Fehlerklasse fuer Fehlerpfad Dfp_RailPCV5" VALUE 0xCA670 Kw_Wu8 20.00 OneToOne 0.00 20.00 FORMAT "%5.2" EXTENDED_LIMITS 0.00 255.0 /end CHARACTERISTIC
/begin CHARACTERISTIC DSM_ClaDfp_SOPTst_C "Fehlerklasse fuer Fehlerpfad Dfp_SOPTst" VALUE 0xCA671 Kw_Wu8 20.00 OneToOne 0.00 20.00 FORMAT "%5.2" EXTENDED_LIMITS 0.00 255.0 /end CHARACTERISTIC
/begin CHARACTERISTIC DSM_ClaDfp_SSpMon1_C "Fehlerklasse fuer Fehlerpfad Dfp_SSpMon1" VALUE 0xCA672 Kw_Wu8 20.00 OneToOne 0.00 20.00 FORMAT "%5.2" EXTENDED_LIMITS 0.00 255.0 /end CHARACTERISTIC
/begin CHARACTERISTIC DSM_ClaDfp_SSpMon2_C "Fehlerklasse fuer Fehlerpfad Dfp_SSpMon2" VALUE 0xCA673 Kw_Wu8 20.00 OneToOne 0.00 20.00 FORMAT "%5.2" EXTENDED_LIMITS 0.00 255.0 /end CHARACTERISTIC
/begin CHARACTERISTIC DSM_ClaDfp_SSpMon3_C "Fehlerklasse fuer Fehlerpfad Dfp_SSpMon3" VALUE 0xCA674 Kw_Wu8 20.00 OneToOne 0.00 20.00 FORMAT "%5.2" EXTENDED_LIMITS 0.00 255.0 /end CHARACTERISTIC
/begin CHARACTERISTIC DSM_ClaDfp_SWChk_CycSigChkDat_C "Fehlerklasse fuer Fehlerpfad Dfp_SWChk_CycSigChkDat" VALUE 0xCA675 Kw_Wu8 20.00 OneToOne 0.00 20.00 FORMAT "%5.2" EXTENDED_LIMITS 0.00 255.0 /end CHARACTERISTIC
/begin CHARACTERISTIC DSM_ClaDfp_SWChk_CycSigChkPrg_C "Fehlerklasse fuer Fehlerpfad Dfp_SWChk_CycSigChkPrg" VALUE 0xCA676 Kw_Wu8 20.00 OneToOne 0.00 20.00 FORMAT "%5.2" EXTENDED_LIMITS 0.00 255.0 /end CHARACTERISTIC
/begin CHARACTERISTIC DSM_ClaDfp_ShutCD_C "Fehlerklasse fuer Fehlerpfad Dfp_ShutCD" VALUE 0xCA677 Kw_Wu8 20.00 OneToOne 0.00 20.00 FORMAT "%5.2" EXTENDED_LIMITS 0.00 255.0 /end CHARACTERISTIC
/begin CHARACTERISTIC DSM_ClaDfp_StSysTrqShutOff_C "Fehlerklasse fuer Fehlerpfad Dfp_StSysTrqShutOff" VALUE 0xCA678 Kw_Wu8 20.00 OneToOne 0.00 20.00 FORMAT "%5.2" EXTENDED_LIMITS 0.00 255.0 /end CHARACTERISTIC
/begin CHARACTERISTIC DSM_ClaDfp_StrtCD_Actr_C "Fehlerklasse fuer Fehlerpfad Dfp_StrtCD_Actr" VALUE 0xCA679 Kw_Wu8 20.00 OneToOne 0.00 20.00 FORMAT "%5.2" EXTENDED_LIMITS 0.00 255.0 /end CHARACTERISTIC
/begin CHARACTERISTIC DSM_ClaDfp_SysLamp_C "Fehlerklasse fuer Fehlerpfad Dfp_SysLamp" VALUE 0xCA67A Kw_Wu8 20.00 OneToOne 0.00 20.00 FORMAT "%5.2" EXTENDED_LIMITS 0.00 255.0 /end CHARACTERISTIC
/begin CHARACTERISTIC DSM_ClaDfp_T15CD_C "Fehlerklasse fuer Fehlerpfad Dfp_T15CD" VALUE 0xCA67B Kw_Wu8 20.00 OneToOne 0.00 20.00 FORMAT "%5.2" EXTENDED_LIMITS 0.00 255.0 /end CHARACTERISTIC
/begin CHARACTERISTIC DSM_ClaDfp_TGearbx_C "Fehlerklasse fuer Fehlerpfad Dfp_TGearbx" VALUE 0xCA67C Kw_Wu8 20.00 OneToOne 0.00 20.00 FORMAT "%5.2" EXTENDED_LIMITS 0.00 255.0 /end CHARACTERISTIC
/begin CHARACTERISTIC DSM_ClaDfp_TPUMon_C "Fehlerklasse fuer Fehlerpfad Dfp_TPUMon" VALUE 0xCA67D Kw_Wu8 20.00 OneToOne 0.00 20.00 FORMAT "%5.2" EXTENDED_LIMITS 0.00 255.0 /end CHARACTERISTIC
/begin CHARACTERISTIC DSM_ClaDfp_TVACD_Max_C "Fehlerklasse fuer Fehlerpfad Dfp_TVACD_Max" VALUE 0xCA67E Kw_Wu8 20.00 OneToOne 0.00 20.00 FORMAT "%5.2" EXTENDED_LIMITS 0.00 255.0 /end CHARACTERISTIC
/begin CHARACTERISTIC DSM_ClaDfp_TVACD_Min_C "Fehlerklasse fuer Fehlerpfad Dfp_TVACD_Min" VALUE 0xCA67F Kw_Wu8 20.00 OneToOne 0.00 20.00 FORMAT "%5.2" EXTENDED_LIMITS 0.00 255.0 /end CHARACTERISTIC
/begin CHARACTERISTIC DSM_ClaDfp_TVACD_SigNpl_C "Fehlerklasse fuer Fehlerpfad Dfp_TVACD_SigNpl" VALUE 0xCA680 Kw_Wu8 20.00 OneToOne 0.00 20.00 FORMAT "%5.2" EXTENDED_LIMITS 0.00 255.0 /end CHARACTERISTIC
/begin CHARACTERISTIC DSM_ClaDfp_TVACD_TVADia1_C "Fehlerklasse fuer Fehlerpfad Dfp_TVACD_TVADia1" VALUE 0xCA681 Kw_Wu8 20.00 OneToOne 0.00 20.00 FORMAT "%5.2" EXTENDED_LIMITS 0.00 255.0 /end CHARACTERISTIC
/begin CHARACTERISTIC DSM_ClaDfp_TVACD_TVADia2_C "Fehlerklasse fuer Fehlerpfad Dfp_TVACD_TVADia2" VALUE 0xCA682 Kw_Wu8 20.00 OneToOne 0.00 20.00 FORMAT "%5.2" EXTENDED_LIMITS 0.00 255.0 /end CHARACTERISTIC
/begin CHARACTERISTIC DSM_ClaDfp_TVACD_TVADia3_C "Fehlerklasse fuer Fehlerpfad Dfp_TVACD_TVADia3" VALUE 0xCA683 Kw_Wu8 20.00 OneToOne 0.00 20.00 FORMAT "%5.2" EXTENDED_LIMITS 0.00 255.0 /end CHARACTERISTIC
/begin CHARACTERISTIC DSM_ClaDfp_TVACD_TVADia4_C "Fehlerklasse fuer Fehlerpfad Dfp_TVACD_TVADia4" VALUE 0xCA684 Kw_Wu8 20.00 OneToOne 0.00 20.00 FORMAT "%5.2" EXTENDED_LIMITS 0.00 255.0 /end CHARACTERISTIC
/begin CHARACTERISTIC DSM_ClaDfp_VSACD_DioInDia1_C "Fehlerklasse fuer Fehlerpfad Dfp_VSACD_DioInDia1" VALUE 0xCA685 Kw_Wu8 20.00 OneToOne 0.00 20.00 FORMAT "%5.2" EXTENDED_LIMITS 0.00 255.0 /end CHARACTERISTIC
/begin CHARACTERISTIC DSM_ClaDfp_VSACD_DioInDia2_C "Fehlerklasse fuer Fehlerpfad Dfp_VSACD_DioInDia2" VALUE 0xCA686 Kw_Wu8 20.00 OneToOne 0.00 20.00 FORMAT "%5.2" EXTENDED_LIMITS 0.00 255.0 /end CHARACTERISTIC
/begin CHARACTERISTIC DSM_ClaDfp_VSACD_DioInDia3_C "Fehlerklasse fuer Fehlerpfad Dfp_VSACD_DioInDia3" VALUE 0xCA687 Kw_Wu8 20.00 OneToOne 0.00 20.00 FORMAT "%5.2" EXTENDED_LIMITS 0.00 255.0 /end CHARACTERISTIC
/begin CHARACTERISTIC DSM_ClaDfp_VSACD_DioInDia4_C "Fehlerklasse fuer Fehlerpfad Dfp_VSACD_DioInDia4" VALUE 0xCA688 Kw_Wu8 20.00 OneToOne 0.00 20.00 FORMAT "%5.2" EXTENDED_LIMITS 0.00 255.0 /end CHARACTERISTIC
/begin CHARACTERISTIC DSM_ClaDfp_VSACD_DioInMin_C "Fehlerklasse fuer Fehlerpfad Dfp_VSACD_DioInMin" VALUE 0xCA689 Kw_Wu8 20.00 OneToOne 0.00 20.00 FORMAT "%5.2" EXTENDED_LIMITS 0.00 255.0 /end CHARACTERISTIC
/begin CHARACTERISTIC DSM_ClaDfp_VSACD_Max_C "Fehlerklasse fuer Fehlerpfad Dfp_VSACD_Max" VALUE 0xCA68A Kw_Wu8 20.00 OneToOne 0.00 20.00 FORMAT "%5.2" EXTENDED_LIMITS 0.00 255.0 /end CHARACTERISTIC
/begin CHARACTERISTIC DSM_ClaDfp_VSACD_Min_C "Fehlerklasse fuer Fehlerpfad Dfp_VSACD_Min" VALUE 0xCA68B Kw_Wu8 20.00 OneToOne 0.00 20.00 FORMAT "%5.2" EXTENDED_LIMITS 0.00 255.0 /end CHARACTERISTIC
/begin CHARACTERISTIC DSM_ClaDfp_VSACD_SigNpl_C "Fehlerklasse fuer Fehlerpfad Dfp_VSACD_SigNpl" VALUE 0xCA68C Kw_Wu8 20.00 OneToOne 0.00 20.00 FORMAT "%5.2" EXTENDED_LIMITS 0.00 255.0 /end CHARACTERISTIC
/begin CHARACTERISTIC DSM_ClaDfp_VSACD_VSADia1_C "Fehlerklasse fuer Fehlerpfad Dfp_VSACD_VSADia1" VALUE 0xCA68D Kw_Wu8 20.00 OneToOne 0.00 20.00 FORMAT "%5.2" EXTENDED_LIMITS 0.00 255.0 /end CHARACTERISTIC
/begin CHARACTERISTIC DSM_ClaDfp_VSACD_VSADia2_C "Fehlerklasse fuer Fehlerpfad Dfp_VSACD_VSADia2" VALUE 0xCA68E Kw_Wu8 20.00 OneToOne 0.00 20.00 FORMAT "%5.2" EXTENDED_LIMITS 0.00 255.0 /end CHARACTERISTIC
/begin CHARACTERISTIC DSM_ClaDfp_VSACD_VSADia3_C "Fehlerklasse fuer Fehlerpfad Dfp_VSACD_VSADia3" VALUE 0xCA68F Kw_Wu8 20.00 OneToOne 0.00 20.00 FORMAT "%5.2" EXTENDED_LIMITS 0.00 255.0 /end CHARACTERISTIC
/begin CHARACTERISTIC DSM_ClaDfp_VSACD_VSADia4_C "Fehlerklasse fuer Fehlerpfad Dfp_VSACD_VSADia4" VALUE 0xCA690 Kw_Wu8 20.00 OneToOne 0.00 20.00 FORMAT "%5.2" EXTENDED_LIMITS 0.00 255.0 /end CHARACTERISTIC
/begin CHARACTERISTIC DSM_ClaDfp_VSSCD1_C "Fehlerklasse fuer Fehlerpfad Dfp_VSSCD1" VALUE 0xCA691 Kw_Wu8 20.00 OneToOne 0.00 20.00 FORMAT "%5.2" EXTENDED_LIMITS 0.00 255.0 /end CHARACTERISTIC
/begin CHARACTERISTIC DSM_ClaDfp_VSSCD2_C "Fehlerklasse fuer Fehlerpfad Dfp_VSSCD2" VALUE 0xCA692 Kw_Wu8 20.00 OneToOne 0.00 20.00 FORMAT "%5.2" EXTENDED_LIMITS 0.00 255.0 /end CHARACTERISTIC
/begin CHARACTERISTIC DSM_ClaDfp_WdCom_C "Fehlerklasse fuer Fehlerpfad Dfp_WdCom" VALUE 0xCA693 Kw_Wu8 20.00 OneToOne 0.00 20.00 FORMAT "%5.2" EXTENDED_LIMITS 0.00 255.0 /end CHARACTERISTIC
/begin MEASUREMENT Dfp_ACCDCmpr_mp "Messpunkt fuer Fehlerpfad  Dfp_ACCDCmpr" UWORD OneToOne 1 100 0.00 65535.00 FORMAT "%8.2" ECU_ADDRESS 0x8FE5CC /end MEASUREMENT
/begin MEASUREMENT Dfp_ACCDPres1_mp "Messpunkt fuer Fehlerpfad  Dfp_ACCDPres1" UWORD OneToOne 1 100 0.00 65535.00 FORMAT "%8.2" ECU_ADDRESS 0x8FE5CE /end MEASUREMENT
/begin MEASUREMENT Dfp_ACCDPresAna_mp "Messpunkt fuer Fehlerpfad  Dfp_ACCDPresAna" UWORD OneToOne 1 100 0.00 65535.00 FORMAT "%8.2" ECU_ADDRESS 0x8FE5D0 /end MEASUREMENT
/begin MEASUREMENT Dfp_ACCDPres_mp "Messpunkt fuer Fehlerpfad  Dfp_ACCDPres" UWORD OneToOne 1 100 0.00 65535.00 FORMAT "%8.2" ECU_ADDRESS 0x8FE5D2 /end MEASUREMENT
/begin MEASUREMENT Dfp_ACCDSwtin_mp "Messpunkt fuer Fehlerpfad  Dfp_ACCDSwtin" UWORD OneToOne 1 100 0.00 65535.00 FORMAT "%8.2" ECU_ADDRESS 0x8FE5D4 /end MEASUREMENT
/begin MEASUREMENT Dfp_AccPedPlausBrk_mp "Fehlerpfad für Unplausibilität AccPed-Brk" UWORD OneToOne 1 100 0.00 65535.00 FORMAT "%8.2" ECU_ADDRESS 0x8FE5D6 /end MEASUREMENT
/begin MEASUREMENT Dfp_ACC_PlausTrqDes_mp "Bremse ist ACC_PlausTrqTmrDead_C [s] getreten & ACC fordert noch immer Moment." UWORD OneToOne 1 100 0.00 65535.00 FORMAT "%8.2" ECU_ADDRESS 0x8FE5D8 /end MEASUREMENT
/begin MEASUREMENT Dfp_ACC_trqInr_mp "Too much Torque ACC" UWORD OneToOne 1 100 0.00 65535.00 FORMAT "%8.2" ECU_ADDRESS 0x8FE5DA /end MEASUREMENT
/begin MEASUREMENT Dfp_ACTrq_mp "Messpunkt fuer Fehlerpfad  Dfp_ACTrq" UWORD OneToOne 1 100 0.00 65535.00 FORMAT "%8.2" ECU_ADDRESS 0x8FE5DC /end MEASUREMENT
/begin MEASUREMENT Dfp_ADCMon_mp "Messpunkt fuer Fehlerpfad  Dfp_ADCMon" UWORD OneToOne 1 100 0.00 65535.00 FORMAT "%8.2" ECU_ADDRESS 0x8FE5DE /end MEASUREMENT
/begin MEASUREMENT Dfp_AFSCDIdlAdjVal_mp "Messpunkt fuer Fehlerpfad  Dfp_AFSCDIdlAdjVal" UWORD OneToOne 1 100 0.00 65535.00 FORMAT "%8.2" ECU_ADDRESS 0x8FE5E0 /end MEASUREMENT
/begin MEASUREMENT Dfp_AFSCDLdAdjVal_mp "Messpunkt fuer Fehlerpfad  Dfp_AFSCDLdAdjVal" UWORD OneToOne 1 100 0.00 65535.00 FORMAT "%8.2" ECU_ADDRESS 0x8FE5E2 /end MEASUREMENT
/begin MEASUREMENT Dfp_AFSCD_AirTempDcyc_mp "Messpunkt fuer Fehlerpfad  Dfp_AFSCD_AirTempDcyc" UWORD OneToOne 1 100 0.00 65535.00 FORMAT "%8.2" ECU_ADDRESS 0x8FE5E4 /end MEASUREMENT
/begin MEASUREMENT Dfp_AFSCD_PlOffsDrft_mp "Messpunkt fuer Fehlerpfad  Dfp_AFSCD_PlOffsDrft" UWORD OneToOne 1 100 0.00 65535.00 FORMAT "%8.2" ECU_ADDRESS 0x8FE5E6 /end MEASUREMENT
/begin MEASUREMENT Dfp_AFSCD_PlSetyDrft_mp "Messpunkt fuer Fehlerpfad  Dfp_AFSCD_PlSetyDrft" UWORD OneToOne 1 100 0.00 65535.00 FORMAT "%8.2" ECU_ADDRESS 0x8FE5E8 /end MEASUREMENT
/begin MEASUREMENT Dfp_AFSCD_SRCAirTemp_mp "Fehlerpfad für Prüfung auf optimal Lufttemperatur" UWORD OneToOne 1 100 0.00 65535.00 FORMAT "%8.2" ECU_ADDRESS 0x8FE5EA /end MEASUREMENT
/begin MEASUREMENT Dfp_AFSCD_SRCBatt_mp "Fehlerpfad für Prüfung auf optimale Batteriespannung" UWORD OneToOne 1 100 0.00 65535.00 FORMAT "%8.2" ECU_ADDRESS 0x8FE5EC /end MEASUREMENT
/begin MEASUREMENT Dfp_AFSCD_SRCCorrAirm_mp "Fehlerpfad für SRC des korrigierten Sensorsignals (HFM6)" UWORD OneToOne 1 100 0.00 65535.00 FORMAT "%8.2" ECU_ADDRESS 0x8FE5EE /end MEASUREMENT
/begin MEASUREMENT Dfp_AFSCD_SRCRawAirm_mp "Fehlerpfad für SRC des unkorrigierten Sensorsignals (HFM6)" UWORD OneToOne 1 100 0.00 65535.00 FORMAT "%8.2" ECU_ADDRESS 0x8FE5F0 /end MEASUREMENT
/begin MEASUREMENT Dfp_AFSCD_SRCRefSigPer_mp "Fehlerpfad für SRC des Referenzsignals (Lufttemperatur-Periodendauer beim HFM6)" UWORD OneToOne 1 100 0.00 65535.00 FORMAT "%8.2" ECU_ADDRESS 0x8FE5F2 /end MEASUREMENT
/begin MEASUREMENT Dfp_AirCtlPlateBreak_mp "Dfp for plate break monitoring" UWORD OneToOne 1 100 0.00 65535.00 FORMAT "%8.2" ECU_ADDRESS 0x8FE5F4 /end MEASUREMENT
/begin MEASUREMENT Dfp_AirCtl_GovNegDev2_mp "AirCtl permanent governor2 negative deviatio" UWORD OneToOne 1 100 0.00 65535.00 FORMAT "%8.2" ECU_ADDRESS 0x8FE5F6 /end MEASUREMENT
/begin MEASUREMENT Dfp_AirCtl_GovNegDev_mp "Messpunkt fuer Fehlerpfad  Dfp_AirCtl_GovNegDev" UWORD OneToOne 1 100 0.00 65535.00 FORMAT "%8.2" ECU_ADDRESS 0x8FE5F8 /end MEASUREMENT
/begin MEASUREMENT Dfp_AirCtl_GovPosDev2_mp "AirCtl permanent governor2 positive deviation" UWORD OneToOne 1 100 0.00 65535.00 FORMAT "%8.2" ECU_ADDRESS 0x8FE5FA /end MEASUREMENT
/begin MEASUREMENT Dfp_AirCtl_GovPosDev_mp "Messpunkt fuer Fehlerpfad  Dfp_AirCtl_GovPosDev" UWORD OneToOne 1 100 0.00 65535.00 FORMAT "%8.2" ECU_ADDRESS 0x8FE5FC /end MEASUREMENT
/begin MEASUREMENT Dfp_AltCD_Load_mp "Messpunkt fuer Fehlerpfad  Dfp_AltCD_Load" UWORD OneToOne 1 100 0.00 65535.00 FORMAT "%8.2" ECU_ADDRESS 0x8FE5FE /end MEASUREMENT
/begin MEASUREMENT Dfp_AltCD_mp "Fehlerpfad des Generators (Kommunikationsfehler)" UWORD OneToOne 1 100 0.00 65535.00 FORMAT "%8.2" ECU_ADDRESS 0x8FE600 /end MEASUREMENT
/begin MEASUREMENT Dfp_AOHtCD_AOHtDia1_mp "Messpunkt fuer Fehlerpfad  Dfp_AOHtCD_AOHtDia1" UWORD OneToOne 1 100 0.00 65535.00 FORMAT "%8.2" ECU_ADDRESS 0x8FE602 /end MEASUREMENT
/begin MEASUREMENT Dfp_AOHtCD_AOHtDia2_mp "Messpunkt fuer Fehlerpfad  Dfp_AOHtCD_AOHtDia2" UWORD OneToOne 1 100 0.00 65535.00 FORMAT "%8.2" ECU_ADDRESS 0x8FE604 /end MEASUREMENT
/begin MEASUREMENT Dfp_AOHtCD_AOHtDia3_mp "Messpunkt fuer Fehlerpfad  Dfp_AOHtCD_AOHtDia3" UWORD OneToOne 1 100 0.00 65535.00 FORMAT "%8.2" ECU_ADDRESS 0x8FE606 /end MEASUREMENT
/begin MEASUREMENT Dfp_AOHtCD_mp "Messpunkt fuer Fehlerpfad bei PWM Endstufenfehler" UWORD OneToOne 1 100 0.00 65535.00 FORMAT "%8.2" ECU_ADDRESS 0x8FE608 /end MEASUREMENT
/begin MEASUREMENT Dfp_APP1_mp "Messpunkt fuer Fehlerpfad  Dfp_APP1" UWORD OneToOne 1 100 0.00 65535.00 FORMAT "%8.2" ECU_ADDRESS 0x8FE60A /end MEASUREMENT
/begin MEASUREMENT Dfp_APP2_mp "Messpunkt fuer Fehlerpfad  Dfp_APP2" UWORD OneToOne 1 100 0.00 65535.00 FORMAT "%8.2" ECU_ADDRESS 0x8FE60C /end MEASUREMENT
/begin MEASUREMENT Dfp_APPSync_mp "Messpunkt für Fehlerpfad Dfp_APPSync" UWORD OneToOne 1 100 0.00 65535.00 FORMAT "%8.2" ECU_ADDRESS 0x8FE60E /end MEASUREMENT
/begin MEASUREMENT Dfp_APSCD_mp "Messpunkt fuer Fehlerpfad  Dfp_APSCD" UWORD OneToOne 1 100 0.00 65535.00 FORMAT "%8.2" ECU_ADDRESS 0x8FE610 /end MEASUREMENT
/begin MEASUREMENT Dfp_ARS_mp "Fault path for ARS" UWORD OneToOne 1 100 0.00 65535.00 FORMAT "%8.2" ECU_ADDRESS 0x8FE612 /end MEASUREMENT
/begin MEASUREMENT Dfp_BattCD_mp "Messpunkt fuer Fehlerpfad  Dfp_BattCD" UWORD OneToOne 1 100 0.00 65535.00 FORMAT "%8.2" ECU_ADDRESS 0x8FE614 /end MEASUREMENT
/begin MEASUREMENT Dfp_BPACD_BPADia1_mp "Messpunkt fuer Fehlerpfad  Dfp_BPACD_BPADia1" UWORD OneToOne 1 100 0.00 65535.00 FORMAT "%8.2" ECU_ADDRESS 0x8FE616 /end MEASUREMENT
/begin MEASUREMENT Dfp_BPACD_BPADia2_mp "Messpunkt fuer Fehlerpfad  Dfp_BPACD_BPADia2" UWORD OneToOne 1 100 0.00 65535.00 FORMAT "%8.2" ECU_ADDRESS 0x8FE618 /end MEASUREMENT
/begin MEASUREMENT Dfp_BPACD_BPADia3_mp "Messpunkt fuer Fehlerpfad  Dfp_BPACD_BPADia3" UWORD OneToOne 1 100 0.00 65535.00 FORMAT "%8.2" ECU_ADDRESS 0x8FE61A /end MEASUREMENT
/begin MEASUREMENT Dfp_BPACD_Max_mp "Fehlerpfad für Kurzschluss nach Batteriespannung des Ladedruckstrellers" UWORD OneToOne 1 100 0.00 65535.00 FORMAT "%8.2" ECU_ADDRESS 0x8FE61C /end MEASUREMENT
/begin MEASUREMENT Dfp_BPACD_Min_mp "Fehlerpfad für Kurzschluss nach Masse des Ladedruckstellers" UWORD OneToOne 1 100 0.00 65535.00 FORMAT "%8.2" ECU_ADDRESS 0x8FE61E /end MEASUREMENT
/begin MEASUREMENT Dfp_BPACD_SigNpl_mp "Fehlerpfad für Lastabfall und Übertemperatur des Ladedruckstellers" UWORD OneToOne 1 100 0.00 65535.00 FORMAT "%8.2" ECU_ADDRESS 0x8FE620 /end MEASUREMENT
/begin MEASUREMENT Dfp_BPSCD_mp "Messpunkt fuer Fehlerpfad  Dfp_BPSCD" UWORD OneToOne 1 100 0.00 65535.00 FORMAT "%8.2" ECU_ADDRESS 0x8FE622 /end MEASUREMENT
/begin MEASUREMENT Dfp_BrkCD_mp "Messpunkt fuer Fehlerpfad  Dfp_BrkCD" UWORD OneToOne 1 100 0.00 65535.00 FORMAT "%8.2" ECU_ADDRESS 0x8FE624 /end MEASUREMENT
/begin MEASUREMENT Dfp_Bss_mp "Messpunkt fuer Fehlerpfad  Dfp_Bss" UWORD OneToOne 1 100 0.00 65535.00 FORMAT "%8.2" ECU_ADDRESS 0x8FE626 /end MEASUREMENT
/begin MEASUREMENT Dfp_CBACD_mp "Messpunkt fuer Fehlerpfad  Dfp_CBACD" UWORD OneToOne 1 100 0.00 65535.00 FORMAT "%8.2" ECU_ADDRESS 0x8FE628 /end MEASUREMENT
/begin MEASUREMENT Dfp_Clg_DynTst_mp "Messpunkt fuer Fehlerpfad  Dfp_Clg_DynTst" UWORD OneToOne 1 100 0.00 65535.00 FORMAT "%8.2" ECU_ADDRESS 0x8FE62A /end MEASUREMENT
/begin MEASUREMENT Dfp_CmbChbMisfire1_mp "Fehlerpfad Zündaussetzer in Zylinder 1" UWORD OneToOne 1 100 0.00 65535.00 FORMAT "%8.2" ECU_ADDRESS 0x8FE62C /end MEASUREMENT
/begin MEASUREMENT Dfp_CmbChbMisfire2_mp "Fehlerpfad Zündaussetzer in Zylinder 2" UWORD OneToOne 1 100 0.00 65535.00 FORMAT "%8.2" ECU_ADDRESS 0x8FE62E /end MEASUREMENT
/begin MEASUREMENT Dfp_CmbChbMisfire3_mp "Fehlerpfad Zündaussetzer in Zylinder 3" UWORD OneToOne 1 100 0.00 65535.00 FORMAT "%8.2" ECU_ADDRESS 0x8FE630 /end MEASUREMENT
/begin MEASUREMENT Dfp_CmbChbMisfire4_mp "Fehlerpfad Zündaussetzer in Zylinder 4" UWORD OneToOne 1 100 0.00 65535.00 FORMAT "%8.2" ECU_ADDRESS 0x8FE632 /end MEASUREMENT
/begin MEASUREMENT Dfp_CmbChbMisfire5_mp "Fehlerpfad Zündaussetzer in Zylinder 5" UWORD OneToOne 1 100 0.00 65535.00 FORMAT "%8.2" ECU_ADDRESS 0x8FE634 /end MEASUREMENT
/begin MEASUREMENT Dfp_CmbChbMisfire6_mp "Fehlerpfad Zündaussetzer in Zylinder 6" UWORD OneToOne 1 100 0.00 65535.00 FORMAT "%8.2" ECU_ADDRESS 0x8FE636 /end MEASUREMENT
/begin MEASUREMENT Dfp_CmbChbMisfireMul_mp "Fehlerpfad Zündaussetzer in mehreren Zylindern" UWORD OneToOne 1 100 0.00 65535.00 FORMAT "%8.2" ECU_ADDRESS 0x8FE638 /end MEASUREMENT
/begin MEASUREMENT Dfp_ConvCD_mp "Messpunkt fuer Fehlerpfad  Dfp_ConvCD" UWORD OneToOne 1 100 0.00 65535.00 FORMAT "%8.2" ECU_ADDRESS 0x8FE63A /end MEASUREMENT
/begin MEASUREMENT Dfp_CoVMDCSh_mp "Fehlerpfade physikalische Unplausibilität der  Motorschlupfregelung" UWORD OneToOne 1 100 0.00 65535.00 FORMAT "%8.2" ECU_ADDRESS 0x8FE63C /end MEASUREMENT
/begin MEASUREMENT Dfp_CrCCDMFL_mp "Messpunkt fuer Fehlerpfad  Dfp_CrCCDMFL" UWORD OneToOne 1 100 0.00 65535.00 FORMAT "%8.2" ECU_ADDRESS 0x8FE63E /end MEASUREMENT
/begin MEASUREMENT Dfp_CrCtl_vCrCtl_mp "Erkennung gefilterte Offset-Geschwindigkeit über Grenze beim Stufentempomat" UWORD OneToOne 1 100 0.00 65535.00 FORMAT "%8.2" ECU_ADDRESS 0x8FE640 /end MEASUREMENT
/begin MEASUREMENT Dfp_CTSCD_mp "Messpunkt fuer Fehlerpfad  Dfp_CTSCD" UWORD OneToOne 1 100 0.00 65535.00 FORMAT "%8.2" ECU_ADDRESS 0x8FE642 /end MEASUREMENT
/begin MEASUREMENT Dfp_Dummy1_mp "Messpunkt fuer Fehlerpfad  Dfp_Dummy1" UWORD OneToOne 1 100 0.00 65535.00 FORMAT "%8.2" ECU_ADDRESS 0x8FE644 /end MEASUREMENT
/begin MEASUREMENT Dfp_EATSCD_mp "Messpunkt fuer Fehlerpfad  Dfp_EATSCD" UWORD OneToOne 1 100 0.00 65535.00 FORMAT "%8.2" ECU_ADDRESS 0x8FE646 /end MEASUREMENT
/begin MEASUREMENT Dfp_EBAFCD_mp "Messpunkt fuer Fehlerpfad  Dfp_EBAFCD" UWORD OneToOne 1 100 0.00 65535.00 FORMAT "%8.2" ECU_ADDRESS 0x8FE648 /end MEASUREMENT
/begin MEASUREMENT Dfp_EBFCD_mp "Messpunkt fuer Fehlerpfad  Dfp_EBFCD" UWORD OneToOne 1 100 0.00 65535.00 FORMAT "%8.2" ECU_ADDRESS 0x8FE64A /end MEASUREMENT
/begin MEASUREMENT Dfp_EBTSCD_mp "Messpunkt fuer Fehlerpfad  Dfp_EBTSCD" UWORD OneToOne 1 100 0.00 65535.00 FORMAT "%8.2" ECU_ADDRESS 0x8FE64C /end MEASUREMENT
/begin MEASUREMENT Dfp_EBTSCD_OvrTemp_mp "Messpunkt fuer Fehlerpfad  Dfp_EBTSCD_OvrTemp" UWORD OneToOne 1 100 0.00 65535.00 FORMAT "%8.2" ECU_ADDRESS 0x8FE64E /end MEASUREMENT
/begin MEASUREMENT Dfp_EEPCDVarMng_mp "Messpunkt fuer Fehlerpfad  Dfp_EEPCDVarMng" UWORD OneToOne 1 100 0.00 65535.00 FORMAT "%8.2" ECU_ADDRESS 0x8FE650 /end MEASUREMENT
/begin MEASUREMENT Dfp_EGPpCDTPreTrbn_mp "Messpunkt fuer Fehlerpfad  Dfp_EgPpCD" UWORD OneToOne 1 100 0.00 65535.00 FORMAT "%8.2" ECU_ADDRESS 0x8FE652 /end MEASUREMENT
/begin MEASUREMENT Dfp_EGPpCD_mp "Messpunkt fuer Fehlerpfad  Dfp_EGPpCD" UWORD OneToOne 1 100 0.00 65535.00 FORMAT "%8.2" ECU_ADDRESS 0x8FE654 /end MEASUREMENT
/begin MEASUREMENT Dfp_EGRCD_Max_mp "Fehlerpfad für Kurzschluss nach Batteriespannung des Abgasrückführstellers" UWORD OneToOne 1 100 0.00 65535.00 FORMAT "%8.2" ECU_ADDRESS 0x8FE656 /end MEASUREMENT
/begin MEASUREMENT Dfp_EGRCD_Min_mp "Fehlerpfad für Kurzschluss nach Masse des Abgasrückführstellers" UWORD OneToOne 1 100 0.00 65535.00 FORMAT "%8.2" ECU_ADDRESS 0x8FE658 /end MEASUREMENT
/begin MEASUREMENT Dfp_EGRCD_SigNpl_mp "Fehlerpfad für Lastabfall und Übertemperatur des Abgasrückführstellers" UWORD OneToOne 1 100 0.00 65535.00 FORMAT "%8.2" ECU_ADDRESS 0x8FE65A /end MEASUREMENT
/begin MEASUREMENT Dfp_EGTRgnOilDil_mp "Fehlerpfad maximale Zeit für Ölverdünnung überschritten" UWORD OneToOne 1 100 0.00 65535.00 FORMAT "%8.2" ECU_ADDRESS 0x8FE65C /end MEASUREMENT
/begin MEASUREMENT Dfp_EMCCDNoLoad1_mp "" UWORD OneToOne 1 100 0.00 65535.00 FORMAT "%8.2" ECU_ADDRESS 0x8FE65E /end MEASUREMENT
/begin MEASUREMENT Dfp_EMCCDNoLoad2_mp "" UWORD OneToOne 1 100 0.00 65535.00 FORMAT "%8.2" ECU_ADDRESS 0x8FE660 /end MEASUREMENT
/begin MEASUREMENT Dfp_EMCCDSCBat1_mp "" UWORD OneToOne 1 100 0.00 65535.00 FORMAT "%8.2" ECU_ADDRESS 0x8FE662 /end MEASUREMENT
/begin MEASUREMENT Dfp_EMCCDSCBat2_mp "" UWORD OneToOne 1 100 0.00 65535.00 FORMAT "%8.2" ECU_ADDRESS 0x8FE664 /end MEASUREMENT
/begin MEASUREMENT Dfp_EMCCDSCGnd1_mp "" UWORD OneToOne 1 100 0.00 65535.00 FORMAT "%8.2" ECU_ADDRESS 0x8FE666 /end MEASUREMENT
/begin MEASUREMENT Dfp_EMCCDSCGnd2_mp "" UWORD OneToOne 1 100 0.00 65535.00 FORMAT "%8.2" ECU_ADDRESS 0x8FE668 /end MEASUREMENT
/begin MEASUREMENT Dfp_EMCCD_ADC1_mp "" UWORD OneToOne 1 100 0.00 65535.00 FORMAT "%8.2" ECU_ADDRESS 0x8FE66A /end MEASUREMENT
/begin MEASUREMENT Dfp_EMCCD_ADC2_mp "" UWORD OneToOne 1 100 0.00 65535.00 FORMAT "%8.2" ECU_ADDRESS 0x8FE66C /end MEASUREMENT
/begin MEASUREMENT Dfp_EngMCaS1_mp "Meßpunkt für Fehlerpfad Dfp_EngMCaS1" UWORD OneToOne 1 100 0.00 65535.00 FORMAT "%8.2" ECU_ADDRESS 0x8FE66E /end MEASUREMENT
/begin MEASUREMENT Dfp_EngMCrS1_mp "Meßpunkt für Fehlerpfad Dfp_EngMCrS1" UWORD OneToOne 1 100 0.00 65535.00 FORMAT "%8.2" ECU_ADDRESS 0x8FE670 /end MEASUREMENT
/begin MEASUREMENT Dfp_EngMOfsCaSCrS_mp "Meßpunkt fuer Fehlerpfad Dfp_EngMOfsCaSCrS" UWORD OneToOne 1 100 0.00 65535.00 FORMAT "%8.2" ECU_ADDRESS 0x8FE672 /end MEASUREMENT
/begin MEASUREMENT Dfp_EngPrtFWODet_mp "Messpunkt fuer Fehlerpfad  Dfp_EngPrtFWODet" UWORD OneToOne 1 100 0.00 65535.00 FORMAT "%8.2" ECU_ADDRESS 0x8FE674 /end MEASUREMENT
/begin MEASUREMENT Dfp_ETClbETFltInj1_mp "Messpunkt fuer Fehlerpfad  Dfp_ETClbETFltInj1" UWORD OneToOne 1 100 0.00 65535.00 FORMAT "%8.2" ECU_ADDRESS 0x8FE676 /end MEASUREMENT
/begin MEASUREMENT Dfp_ETClbETFltInj2_mp "Messpunkt fuer Fehlerpfad  Dfp_ETClbETFltInj2" UWORD OneToOne 1 100 0.00 65535.00 FORMAT "%8.2" ECU_ADDRESS 0x8FE678 /end MEASUREMENT
/begin MEASUREMENT Dfp_ETClbETFltInj3_mp "Messpunkt fuer Fehlerpfad  Dfp_ETClbETFltInj3" UWORD OneToOne 1 100 0.00 65535.00 FORMAT "%8.2" ECU_ADDRESS 0x8FE67A /end MEASUREMENT
/begin MEASUREMENT Dfp_ETClbETFltInj4_mp "Messpunkt fuer Fehlerpfad  Dfp_ETClbETFltInj4" UWORD OneToOne 1 100 0.00 65535.00 FORMAT "%8.2" ECU_ADDRESS 0x8FE67C /end MEASUREMENT
/begin MEASUREMENT Dfp_ETClbETFltInj5_mp "Messpunkt fuer Fehlerpfad  Dfp_ETClbETFltInj5" UWORD OneToOne 1 100 0.00 65535.00 FORMAT "%8.2" ECU_ADDRESS 0x8FE67E /end MEASUREMENT
/begin MEASUREMENT Dfp_ETClbETFltInj6_mp "Messpunkt fuer Fehlerpfad  Dfp_ETClbETFltInj6" UWORD OneToOne 1 100 0.00 65535.00 FORMAT "%8.2" ECU_ADDRESS 0x8FE680 /end MEASUREMENT
/begin MEASUREMENT Dfp_ETClbInj1_mp "Messpunkt fuer Fehlerpfad  Dfp_ETClbInj1" UWORD OneToOne 1 100 0.00 65535.00 FORMAT "%8.2" ECU_ADDRESS 0x8FE682 /end MEASUREMENT
/begin MEASUREMENT Dfp_ETClbInj2_mp "Messpunkt fuer Fehlerpfad  Dfp_ETClbInj2" UWORD OneToOne 1 100 0.00 65535.00 FORMAT "%8.2" ECU_ADDRESS 0x8FE684 /end MEASUREMENT
/begin MEASUREMENT Dfp_ETClbInj3_mp "Messpunkt fuer Fehlerpfad  Dfp_ETClbInj3" UWORD OneToOne 1 100 0.00 65535.00 FORMAT "%8.2" ECU_ADDRESS 0x8FE686 /end MEASUREMENT
/begin MEASUREMENT Dfp_ETClbInj4_mp "Messpunkt fuer Fehlerpfad  Dfp_ETClbInj4" UWORD OneToOne 1 100 0.00 65535.00 FORMAT "%8.2" ECU_ADDRESS 0x8FE688 /end MEASUREMENT
/begin MEASUREMENT Dfp_ETClbInj5_mp "Messpunkt fuer Fehlerpfad  Dfp_ETClbInj5" UWORD OneToOne 1 100 0.00 65535.00 FORMAT "%8.2" ECU_ADDRESS 0x8FE68A /end MEASUREMENT
/begin MEASUREMENT Dfp_ETClbInj6_mp "Messpunkt fuer Fehlerpfad  Dfp_ETClbInj6" UWORD OneToOne 1 100 0.00 65535.00 FORMAT "%8.2" ECU_ADDRESS 0x8FE68C /end MEASUREMENT
/begin MEASUREMENT Dfp_FanCD_FanCtlr1_mp "Messpunkt fuer Fehlerpfad  Dfp_FanCD_FanCtlr1" UWORD OneToOne 1 100 0.00 65535.00 FORMAT "%8.2" ECU_ADDRESS 0x8FE68E /end MEASUREMENT
/begin MEASUREMENT Dfp_FanCD_FanCtlr2_mp "Messpunkt fuer Fehlerpfad  Dfp_FanCD_FanCtlr2" UWORD OneToOne 1 100 0.00 65535.00 FORMAT "%8.2" ECU_ADDRESS 0x8FE690 /end MEASUREMENT
/begin MEASUREMENT Dfp_FanCD_FanCtlr3_mp "Messpunkt fuer Fehlerpfad  Dfp_FanCD_FanCtlr3" UWORD OneToOne 1 100 0.00 65535.00 FORMAT "%8.2" ECU_ADDRESS 0x8FE692 /end MEASUREMENT
/begin MEASUREMENT Dfp_FanCD_mp "Fehlerpfad signalisiert Fehler in der Zuleitung zum Lüfter" UWORD OneToOne 1 100 0.00 65535.00 FORMAT "%8.2" ECU_ADDRESS 0x8FE694 /end MEASUREMENT
/begin MEASUREMENT Dfp_FBCqDvt_mp "Messpunkt fuer Fehlerpfad  Dfp_FBCqDvt" UWORD OneToOne 1 100 0.00 65535.00 FORMAT "%8.2" ECU_ADDRESS 0x8FE696 /end MEASUREMENT
/begin MEASUREMENT Dfp_FlFCD_mp "Messpunkt fuer Fehlerpfad  Dfp_FlFCD" UWORD OneToOne 1 100 0.00 65535.00 FORMAT "%8.2" ECU_ADDRESS 0x8FE698 /end MEASUREMENT
/begin MEASUREMENT Dfp_FlMngSmkDefect_mp "Messpunkt fuer Fehlerpfad  Dfp_FlMngSmkDefect" UWORD OneToOne 1 100 0.00 65535.00 FORMAT "%8.2" ECU_ADDRESS 0x8FE69A /end MEASUREMENT
/begin MEASUREMENT Dfp_FMTC_NonMonotonMap_mp "Prüfung Monotonie der Mengenstützpunkte über Moment in FMTC_trq2qBas_MAP" UWORD OneToOne 1 100 0.00 65535.00 FORMAT "%8.2" ECU_ADDRESS 0x8FE69C /end MEASUREMENT
/begin MEASUREMENT Dfp_FrmMngASC1_mp "Messpunkt fuer Fehlerpfad  Dfp_FrmMngASC1" UWORD OneToOne 1 100 0.00 65535.00 FORMAT "%8.2" ECU_ADDRESS 0x8FE69E /end MEASUREMENT
/begin MEASUREMENT Dfp_FrmMngASC2_mp "Messpunkt fuer Fehlerpfad  Dfp_FrmMngASC2" UWORD OneToOne 1 100 0.00 65535.00 FORMAT "%8.2" ECU_ADDRESS 0x8FE6A0 /end MEASUREMENT
/begin MEASUREMENT Dfp_FrmMngASC3_mp "Messpunkt fuer Fehlerpfad  Dfp_FrmMngASC3" UWORD OneToOne 1 100 0.00 65535.00 FORMAT "%8.2" ECU_ADDRESS 0x8FE6A2 /end MEASUREMENT
/begin MEASUREMENT Dfp_FrmMngASC4_mp "Messpunkt fuer Fehlerpfad  Dfp_FrmMngASC4" UWORD OneToOne 1 100 0.00 65535.00 FORMAT "%8.2" ECU_ADDRESS 0x8FE6A4 /end MEASUREMENT
/begin MEASUREMENT Dfp_FrmMngBOS_RESET_2_mp "Messpunkt fuer Fehlerpfad  Dfp_FrmMngBOS_RESET_2" UWORD OneToOne 1 100 0.00 65535.00 FORMAT "%8.2" ECU_ADDRESS 0x8FE6A6 /end MEASUREMENT
/begin MEASUREMENT Dfp_FrmMngBOS_RESET_mp "BOS_RESET - CAN-message related errors" UWORD OneToOne 1 100 0.00 65535.00 FORMAT "%8.2" ECU_ADDRESS 0x8FE6A8 /end MEASUREMENT
/begin MEASUREMENT Dfp_FrmMngDMANFAFS_mp "Messpunkt fuer Fehlerpfad  Dfp_FrmMngDMANFAFS" UWORD OneToOne 1 100 0.00 65535.00 FORMAT "%8.2" ECU_ADDRESS 0x8FE6AA /end MEASUREMENT
/begin MEASUREMENT Dfp_FrmMngDRMANFSSG_mp "Messpunkt fuer Fehlerpfad  Dfp_FrmMngDRMANFSSG" UWORD OneToOne 1 100 0.00 65535.00 FORMAT "%8.2" ECU_ADDRESS 0x8FE6AC /end MEASUREMENT
/begin MEASUREMENT Dfp_FrmMngEGS1_mp "Fehleerpfad für die EGS1 Botschaft" UWORD OneToOne 1 100 0.00 65535.00 FORMAT "%8.2" ECU_ADDRESS 0x8FE6AE /end MEASUREMENT
/begin MEASUREMENT Dfp_FrmMngEGS2_mp "Messpunkt fuer Fehlerpfad  Dfp_FrmMngEGS2" UWORD OneToOne 1 100 0.00 65535.00 FORMAT "%8.2" ECU_ADDRESS 0x8FE6B0 /end MEASUREMENT
/begin MEASUREMENT Dfp_FrmMngGEARBX_DATA2_mp "Messpunkt fuer Fehlerpfad  Dfp_FrmMngGEARBX_DATA2" UWORD OneToOne 1 100 0.00 65535.00 FORMAT "%8.2" ECU_ADDRESS 0x8FE6B2 /end MEASUREMENT
/begin MEASUREMENT Dfp_FrmMngGEARBX_DATA_mp "GEARBX_DATA CAN12h-message related faults" UWORD OneToOne 1 100 0.00 65535.00 FORMAT "%8.2" ECU_ADDRESS 0x8FE6B4 /end MEASUREMENT
/begin MEASUREMENT Dfp_FrmMngHEAT_AC_mp "HEAT_AC CAN12h-message related faults" UWORD OneToOne 1 100 0.00 65535.00 FORMAT "%8.2" ECU_ADDRESS 0x8FE6B6 /end MEASUREMENT
/begin MEASUREMENT Dfp_FrmMngINSTR2_mp "Messpunkt fuer Fehlerpfad  Dfp_FrmMngINSTR2" UWORD OneToOne 1 100 0.00 65535.00 FORMAT "%8.2" ECU_ADDRESS 0x8FE6B8 /end MEASUREMENT
/begin MEASUREMENT Dfp_FrmMngINSTR3_mp "Messpunkt fuer Fehlerpfad  Dfp_FrmMngINSTR3" UWORD OneToOne 1 100 0.00 65535.00 FORMAT "%8.2" ECU_ADDRESS 0x8FE6BA /end MEASUREMENT
/begin MEASUREMENT Dfp_FrmMngLENKRADWINKEL_mp "Messpunkt fuer Fehlerpfad  Dfp_FrmMngLENKRADWINKEL" UWORD OneToOne 1 100 0.00 65535.00 FORMAT "%8.2" ECU_ADDRESS 0x8FE6BC /end MEASUREMENT
/begin MEASUREMENT Dfp_FrmMngMILEAGE_RANGE_mp "Messpunkt fuer Fehlerpfad  Dfp_FrmMngMILEAGE_RANGE" UWORD OneToOne 1 100 0.00 65535.00 FORMAT "%8.2" ECU_ADDRESS 0x8FE6BE /end MEASUREMENT
/begin MEASUREMENT Dfp_FrmMngOPCRCTLACC_mp "Messpunkt fuer Fehlerpfad  Dfp_FrmMngOPCRCTLACC" UWORD OneToOne 1 100 0.00 65535.00 FORMAT "%8.2" ECU_ADDRESS 0x8FE6C0 /end MEASUREMENT
/begin MEASUREMENT Dfp_FrmMngParkConsumer_mp "Messpunkt fuer Fehlerpfad  Dfp_FrmMngParkConsumer" UWORD OneToOne 1 100 0.00 65535.00 FORMAT "%8.2" ECU_ADDRESS 0x8FE6C2 /end MEASUREMENT
/begin MEASUREMENT Dfp_FrmMngPRGG_CCTR_mp "Messpunkt fuer Fehlerpfad  Dfp_FrmMngPRGG_CCTR" UWORD OneToOne 1 100 0.00 65535.00 FORMAT "%8.2" ECU_ADDRESS 0x8FE6C4 /end MEASUREMENT
/begin MEASUREMENT Dfp_FrmMngPWRMNG_LOADV_mp "Messpunkt fuer Fehlerpfad  Dfp_FrmMngPWRMNG_LOADV" UWORD OneToOne 1 100 0.00 65535.00 FORMAT "%8.2" ECU_ADDRESS 0x8FE6C6 /end MEASUREMENT
/begin MEASUREMENT Dfp_FrmMngRQSTGEFAN_mp "RQ_STG_EFAN - CAN-message related errors" UWORD OneToOne 1 100 0.00 65535.00 FORMAT "%8.2" ECU_ADDRESS 0x8FE6C8 /end MEASUREMENT
/begin MEASUREMENT Dfp_FrmMngSSGErr_mp "Messpunkt fuer Fehlerpfad  Dfp_FrmMngSSGErr" UWORD OneToOne 1 100 0.00 65535.00 FORMAT "%8.2" ECU_ADDRESS 0x8FE6CA /end MEASUREMENT
/begin MEASUREMENT Dfp_FrmMngSSGShOff_mp "Messpunkt fuer Fehlerpfad  Dfp_FrmMngSSGShOff" UWORD OneToOne 1 100 0.00 65535.00 FORMAT "%8.2" ECU_ADDRESS 0x8FE6CC /end MEASUREMENT
/begin MEASUREMENT Dfp_FrmMngSTAT_ANH_mp "Messpunkt fuer Fehlerpfad  Dfp_FrmMngSTAT_ANH" UWORD OneToOne 1 100 0.00 65535.00 FORMAT "%8.2" ECU_ADDRESS 0x8FE6CE /end MEASUREMENT
/begin MEASUREMENT Dfp_FrmMngSTAT_ARS_mp "STAT_ARS CAN12h-message related faults" UWORD OneToOne 1 100 0.00 65535.00 FORMAT "%8.2" ECU_ADDRESS 0x8FE6D0 /end MEASUREMENT
/begin MEASUREMENT Dfp_FrmMngSTAT_DSC_mp "STAT_DSC CAN12h-message related faults" UWORD OneToOne 1 100 0.00 65535.00 FORMAT "%8.2" ECU_ADDRESS 0x8FE6D2 /end MEASUREMENT
/begin MEASUREMENT Dfp_FrmMngSTAT_EKP_mp "Fehlerpfad für STAT_EKP" UWORD OneToOne 1 100 0.00 65535.00 FORMAT "%8.2" ECU_ADDRESS 0x8FE6D4 /end MEASUREMENT
/begin MEASUREMENT Dfp_FrmMngSTAT_KOMBI_mp "STAT_KOMBI - CAN-message related errors" UWORD OneToOne 1 100 0.00 65535.00 FORMAT "%8.2" ECU_ADDRESS 0x8FE6D6 /end MEASUREMENT
/begin MEASUREMENT Dfp_FrmMngSTAT_SITZ_mp "Defect fault path for STAT_SITZBELEGUNG_GURT - CAN-message related errors" UWORD OneToOne 1 100 0.00 65535.00 FORMAT "%8.2" ECU_ADDRESS 0x8FE6D8 /end MEASUREMENT
/begin MEASUREMENT Dfp_FrmMngstCurr_mp "Messpunkt für Dfp von FrmMng_stCurr Botschaft" UWORD OneToOne 1 100 0.00 65535.00 FORMAT "%8.2" ECU_ADDRESS 0x8FE6DA /end MEASUREMENT
/begin MEASUREMENT Dfp_FrmMngStOBDGbxMilOf_mp "error path of Gear Box MIL OFF" UWORD OneToOne 1 100 0.00 65535.00 FORMAT "%8.2" ECU_ADDRESS 0x8FE6DC /end MEASUREMENT
/begin MEASUREMENT Dfp_FrmMngStOBDGbxMilOn_mp "error path of Gear Box MIL ON" UWORD OneToOne 1 100 0.00 65535.00 FORMAT "%8.2" ECU_ADDRESS 0x8FE6DE /end MEASUREMENT
/begin MEASUREMENT Dfp_FrmMngswtPSPOff_mp "Messpunkt für Dfp von FrmMng_swtPSPOff Botschaft" UWORD OneToOne 1 100 0.00 65535.00 FORMAT "%8.2" ECU_ADDRESS 0x8FE6E0 /end MEASUREMENT
/begin MEASUREMENT Dfp_FrmMngTEMPRELTIME_mp "A_TEMP_RELATIVZEIT - CAN-message related errors" UWORD OneToOne 1 100 0.00 65535.00 FORMAT "%8.2" ECU_ADDRESS 0x8FE6E2 /end MEASUREMENT
/begin MEASUREMENT Dfp_FrmMngTERMINAL_mp "TERMINAL CAN12h-message related faults" UWORD OneToOne 1 100 0.00 65535.00 FORMAT "%8.2" ECU_ADDRESS 0x8FE6E4 /end MEASUREMENT
/begin MEASUREMENT Dfp_FrmMngTIME_DATE_mp "Messpunkt fuer Fehlerpfad  Dfp_FrmMngTIME_DATE" UWORD OneToOne 1 100 0.00 65535.00 FORMAT "%8.2" ECU_ADDRESS 0x8FE6E6 /end MEASUREMENT
/begin MEASUREMENT Dfp_FrmMngTORQUE_DSC_mp "TORQUE_DSC CAN12h-message related faults" UWORD OneToOne 1 100 0.00 65535.00 FORMAT "%8.2" ECU_ADDRESS 0x8FE6E8 /end MEASUREMENT
/begin MEASUREMENT Dfp_FrmMngTORQUE_GEARBX_mp "TORQUE_GEARBX CAN12h-message related faults" UWORD OneToOne 1 100 0.00 65535.00 FORMAT "%8.2" ECU_ADDRESS 0x8FE6EA /end MEASUREMENT
/begin MEASUREMENT Dfp_FrmMngTrq_ReqACC_mp "Messpunkt fuer Fehlerpfad  Dfp_FrmMngTrq_ReqACC" UWORD OneToOne 1 100 0.00 65535.00 FORMAT "%8.2" ECU_ADDRESS 0x8FE6EC /end MEASUREMENT
/begin MEASUREMENT Dfp_FrmMngVEH_MOD_mp "VEH_MOD - CAN-message related errors" UWORD OneToOne 1 100 0.00 65535.00 FORMAT "%8.2" ECU_ADDRESS 0x8FE6EE /end MEASUREMENT
/begin MEASUREMENT Dfp_FrmMngVELOCITY_mp "VELOCITY CAN12h-message related faults" UWORD OneToOne 1 100 0.00 65535.00 FORMAT "%8.2" ECU_ADDRESS 0x8FE6F0 /end MEASUREMENT
/begin MEASUREMENT Dfp_FrmMngWHEEL_SPEED_mp "WHEEL_SPEED - CAN-message related errors" UWORD OneToOne 1 100 0.00 65535.00 FORMAT "%8.2" ECU_ADDRESS 0x8FE6F2 /end MEASUREMENT
/begin MEASUREMENT Dfp_FTSCD_mp "Messpunkt fuer Fehlerpfad  Dfp_FTSCD" UWORD OneToOne 1 100 0.00 65535.00 FORMAT "%8.2" ECU_ADDRESS 0x8FE6F4 /end MEASUREMENT
/begin MEASUREMENT Dfp_GearbxIncMax_mp "Fehlerpfad  physikalische Unplausibilität des erhöhenden Getriebeeingriffs" UWORD OneToOne 1 100 0.00 65535.00 FORMAT "%8.2" ECU_ADDRESS 0x8FE6F6 /end MEASUREMENT
/begin MEASUREMENT Dfp_GlwCDGlwCirc1_mp "Messpunkt fuer Fehlerpfad  Dfp_GlwCDGlwCirc1" UWORD OneToOne 1 100 0.00 65535.00 FORMAT "%8.2" ECU_ADDRESS 0x8FE6F8 /end MEASUREMENT
/begin MEASUREMENT Dfp_GlwCDGlwCirc2_mp "Messpunkt fuer Fehlerpfad  Dfp_GlwCDGlwCirc2" UWORD OneToOne 1 100 0.00 65535.00 FORMAT "%8.2" ECU_ADDRESS 0x8FE6FA /end MEASUREMENT
/begin MEASUREMENT Dfp_GlwCDGlwCirc3_mp "Messpunkt fuer Fehlerpfad  Dfp_GlwCDGlwCirc3" UWORD OneToOne 1 100 0.00 65535.00 FORMAT "%8.2" ECU_ADDRESS 0x8FE6FC /end MEASUREMENT
/begin MEASUREMENT Dfp_GlwCDGlwCirc4_mp "Messpunkt fuer Fehlerpfad  Dfp_GlwCDGlwCirc4" UWORD OneToOne 1 100 0.00 65535.00 FORMAT "%8.2" ECU_ADDRESS 0x8FE6FE /end MEASUREMENT
/begin MEASUREMENT Dfp_GlwCDGlwCirc5_mp "Messpunkt fuer Fehlerpfad  Dfp_GlwCDGlwCirc5" UWORD OneToOne 1 100 0.00 65535.00 FORMAT "%8.2" ECU_ADDRESS 0x8FE700 /end MEASUREMENT
/begin MEASUREMENT Dfp_GlwCDGlwCirc6_mp "Messpunkt fuer Fehlerpfad  Dfp_GlwCDGlwCirc6" UWORD OneToOne 1 100 0.00 65535.00 FORMAT "%8.2" ECU_ADDRESS 0x8FE702 /end MEASUREMENT
/begin MEASUREMENT Dfp_GlwCDGlwCirc7_mp "Messpunkt fuer Fehlerpfad  Dfp_GlwCDGlwCirc7" UWORD OneToOne 1 100 0.00 65535.00 FORMAT "%8.2" ECU_ADDRESS 0x8FE704 /end MEASUREMENT
/begin MEASUREMENT Dfp_GlwCDGlwCirc8_mp "Messpunkt fuer Fehlerpfad  Dfp_GlwCDGlwCirc8" UWORD OneToOne 1 100 0.00 65535.00 FORMAT "%8.2" ECU_ADDRESS 0x8FE706 /end MEASUREMENT
/begin MEASUREMENT Dfp_GlwCD_mp "Messpunkt fuer Fehlerpfad  Dfp_GlwCD" UWORD OneToOne 1 100 0.00 65535.00 FORMAT "%8.2" ECU_ADDRESS 0x8FE708 /end MEASUREMENT
/begin MEASUREMENT Dfp_GlwCtl_mp "Glüh-Steuerungs-Rückmeldungs-Fehler" UWORD OneToOne 1 100 0.00 65535.00 FORMAT "%8.2" ECU_ADDRESS 0x8FE70A /end MEASUREMENT
/begin MEASUREMENT Dfp_HWEMonCom_mp "Messpunkt fuer Fehlerpfad  Dfp_HWEMonCom" UWORD OneToOne 1 100 0.00 65535.00 FORMAT "%8.2" ECU_ADDRESS 0x8FE70C /end MEASUREMENT
/begin MEASUREMENT Dfp_HWEMonEEPROM_mp "Messpunkt fuer Fehlerpfad  Dfp_HWEMonEEPROM" UWORD OneToOne 1 100 0.00 65535.00 FORMAT "%8.2" ECU_ADDRESS 0x8FE70E /end MEASUREMENT
/begin MEASUREMENT Dfp_HWEMonRcyLocked_mp "Messpunkt fuer Fehlerpfad  Dfp_HWEMonRcyLocked" UWORD OneToOne 1 100 0.00 65535.00 FORMAT "%8.2" ECU_ADDRESS 0x8FE710 /end MEASUREMENT
/begin MEASUREMENT Dfp_HWEMonRcySuppressed_mp "Messpunkt fuer Fehlerpfad  Dfp_HWEMonRcySuppressed" UWORD OneToOne 1 100 0.00 65535.00 FORMAT "%8.2" ECU_ADDRESS 0x8FE712 /end MEASUREMENT
/begin MEASUREMENT Dfp_HWEMonRcyVisible_mp "Messpunkt fuer Fehlerpfad  Dfp_HWEMonRcyVisible" UWORD OneToOne 1 100 0.00 65535.00 FORMAT "%8.2" ECU_ADDRESS 0x8FE714 /end MEASUREMENT
/begin MEASUREMENT Dfp_HWEMonUMaxSupply_mp "Messpunkt fuer Fehlerpfad  Dfp_HWEMonUMaxSupply" UWORD OneToOne 1 100 0.00 65535.00 FORMAT "%8.2" ECU_ADDRESS 0x8FE716 /end MEASUREMENT
/begin MEASUREMENT Dfp_HWEMonUMinSupply_mp "Messpunkt fuer Fehlerpfad  Dfp_HWEMonUMinSupply" UWORD OneToOne 1 100 0.00 65535.00 FORMAT "%8.2" ECU_ADDRESS 0x8FE718 /end MEASUREMENT
/begin MEASUREMENT Dfp_IATSCD_CATS_mp "Fehlerpfad Ladelufttemperaturwert nach Ladeluftkühler" UWORD OneToOne 1 100 0.00 65535.00 FORMAT "%8.2" ECU_ADDRESS 0x8FE71A /end MEASUREMENT
/begin MEASUREMENT Dfp_IATSCD_mp "Messpunkt fuer Fehlerpfad  Dfp_IATSCD" UWORD OneToOne 1 100 0.00 65535.00 FORMAT "%8.2" ECU_ADDRESS 0x8FE71C /end MEASUREMENT
/begin MEASUREMENT Dfp_ImmCtlImmCD_mp "Messpunkt fuer Fehlerpfad  Dfp_ImmCtlImmCD" UWORD OneToOne 1 100 0.00 65535.00 FORMAT "%8.2" ECU_ADDRESS 0x8FE71E /end MEASUREMENT
/begin MEASUREMENT Dfp_ImmCtlImmEep_mp "Messpunkt fuer Fehlerpfad  Dfp_ImmCtlImmEep" UWORD OneToOne 1 100 0.00 65535.00 FORMAT "%8.2" ECU_ADDRESS 0x8FE720 /end MEASUREMENT
/begin MEASUREMENT Dfp_ImmCtlMpl_mp "Messpunkt fuer Fehlerpfad  Dfp_ImmCtlMpl" UWORD OneToOne 1 100 0.00 65535.00 FORMAT "%8.2" ECU_ADDRESS 0x8FE722 /end MEASUREMENT
/begin MEASUREMENT Dfp_IndSys1_mp "IndSys1 defect path" UWORD OneToOne 1 100 0.00 65535.00 FORMAT "%8.2" ECU_ADDRESS 0x8FE724 /end MEASUREMENT
/begin MEASUREMENT Dfp_IndSys2_mp "IndSys2 defect path" UWORD OneToOne 1 100 0.00 65535.00 FORMAT "%8.2" ECU_ADDRESS 0x8FE726 /end MEASUREMENT
/begin MEASUREMENT Dfp_InjCrv_InjLim_mp "Messpunkt fuer Fehlerpfad Dfp_InjCrv_InjLim" UWORD OneToOne 1 100 0.00 65535.00 FORMAT "%8.2" ECU_ADDRESS 0x8FE728 /end MEASUREMENT
/begin MEASUREMENT Dfp_InjCtlAdjQnt_mp "Messpunkt fuer Fehlerpfad  Dfp_InjCtlAdjQnt" UWORD OneToOne 1 100 0.00 65535.00 FORMAT "%8.2" ECU_ADDRESS 0x8FE72A /end MEASUREMENT
/begin MEASUREMENT Dfp_InjCtlDrift_mp "Messpunkt fuer Fehlerpfad  Dfp_InjCtlDrift" UWORD OneToOne 1 100 0.00 65535.00 FORMAT "%8.2" ECU_ADDRESS 0x8FE72C /end MEASUREMENT
/begin MEASUREMENT Dfp_InjVlvBnk1A_mp "A Fehlerpfad für Bank 1" UWORD OneToOne 1 100 0.00 65535.00 FORMAT "%8.2" ECU_ADDRESS 0x8FE72E /end MEASUREMENT
/begin MEASUREMENT Dfp_InjVlvBnk1B_mp "B Fehlerpfad für Bank 1" UWORD OneToOne 1 100 0.00 65535.00 FORMAT "%8.2" ECU_ADDRESS 0x8FE730 /end MEASUREMENT
/begin MEASUREMENT Dfp_InjVlvBnk2A_mp "A Fehlerpfad für Bank 2" UWORD OneToOne 1 100 0.00 65535.00 FORMAT "%8.2" ECU_ADDRESS 0x8FE732 /end MEASUREMENT
/begin MEASUREMENT Dfp_InjVlvBnk2B_mp "B Fehlerpfad für Bank 2" UWORD OneToOne 1 100 0.00 65535.00 FORMAT "%8.2" ECU_ADDRESS 0x8FE734 /end MEASUREMENT
/begin MEASUREMENT Dfp_InjVlvChipA_mp "A Fehlerpfad  für Baustein" UWORD OneToOne 1 100 0.00 65535.00 FORMAT "%8.2" ECU_ADDRESS 0x8FE736 /end MEASUREMENT
/begin MEASUREMENT Dfp_InjVlvChipB_mp "B Fehlerpfad für Baustein" UWORD OneToOne 1 100 0.00 65535.00 FORMAT "%8.2" ECU_ADDRESS 0x8FE738 /end MEASUREMENT
/begin MEASUREMENT Dfp_InjVlvCyl1A_mp "A Fehlerpfad  für Zylinder 1" UWORD OneToOne 1 100 0.00 65535.00 FORMAT "%8.2" ECU_ADDRESS 0x8FE73A /end MEASUREMENT
/begin MEASUREMENT Dfp_InjVlvCyl1B_mp "B Fehlerpfad  für Zylinder 1" UWORD OneToOne 1 100 0.00 65535.00 FORMAT "%8.2" ECU_ADDRESS 0x8FE73C /end MEASUREMENT
/begin MEASUREMENT Dfp_InjVlvCyl2A_mp "A Fehlerpfad  für Zylinder 2" UWORD OneToOne 1 100 0.00 65535.00 FORMAT "%8.2" ECU_ADDRESS 0x8FE73E /end MEASUREMENT
/begin MEASUREMENT Dfp_InjVlvCyl2B_mp "B Fehlerpfad  für Zylinder 2" UWORD OneToOne 1 100 0.00 65535.00 FORMAT "%8.2" ECU_ADDRESS 0x8FE740 /end MEASUREMENT
/begin MEASUREMENT Dfp_InjVlvCyl3A_mp "A Fehlerpfad  für Zylinder 3" UWORD OneToOne 1 100 0.00 65535.00 FORMAT "%8.2" ECU_ADDRESS 0x8FE742 /end MEASUREMENT
/begin MEASUREMENT Dfp_InjVlvCyl3B_mp "B Fehlerpfad  für Zylinder 3" UWORD OneToOne 1 100 0.00 65535.00 FORMAT "%8.2" ECU_ADDRESS 0x8FE744 /end MEASUREMENT
/begin MEASUREMENT Dfp_InjVlvCyl4A_mp "A Fehlerpfad  für Zylinder 4" UWORD OneToOne 1 100 0.00 65535.00 FORMAT "%8.2" ECU_ADDRESS 0x8FE746 /end MEASUREMENT
/begin MEASUREMENT Dfp_InjVlvCyl4B_mp "B Fehlerpfad  für Zylinder 4" UWORD OneToOne 1 100 0.00 65535.00 FORMAT "%8.2" ECU_ADDRESS 0x8FE748 /end MEASUREMENT
/begin MEASUREMENT Dfp_InjVlvCyl5A_mp "A Fehlerpfad  für Zylinder 5" UWORD OneToOne 1 100 0.00 65535.00 FORMAT "%8.2" ECU_ADDRESS 0x8FE74A /end MEASUREMENT
/begin MEASUREMENT Dfp_InjVlvCyl5B_mp "B Fehlerpfad  für Zylinder 5" UWORD OneToOne 1 100 0.00 65535.00 FORMAT "%8.2" ECU_ADDRESS 0x8FE74C /end MEASUREMENT
/begin MEASUREMENT Dfp_InjVlvCyl6A_mp "A Fehlerpfad  für Zylinder 6" UWORD OneToOne 1 100 0.00 65535.00 FORMAT "%8.2" ECU_ADDRESS 0x8FE74E /end MEASUREMENT
/begin MEASUREMENT Dfp_InjVlvCyl6B_mp "B Fehlerpfad  für Zylinder 6" UWORD OneToOne 1 100 0.00 65535.00 FORMAT "%8.2" ECU_ADDRESS 0x8FE750 /end MEASUREMENT
/begin MEASUREMENT Dfp_Layer_BSD_mp "Messpunkt fuer Fehlerpfad  Dfp_Layer_BSD" UWORD OneToOne 1 100 0.00 65535.00 FORMAT "%8.2" ECU_ADDRESS 0x8FE752 /end MEASUREMENT
/begin MEASUREMENT Dfp_Layer_GEN_mp "Messpunkt fuer Fehlerpfad  Dfp_Layer_GEN" UWORD OneToOne 1 100 0.00 65535.00 FORMAT "%8.2" ECU_ADDRESS 0x8FE754 /end MEASUREMENT
/begin MEASUREMENT Dfp_Layer_IBS1_mp "Messpunkt fuer Fehlerpfad  Dfp_Layer_IBS1" UWORD OneToOne 1 100 0.00 65535.00 FORMAT "%8.2" ECU_ADDRESS 0x8FE756 /end MEASUREMENT
/begin MEASUREMENT Dfp_Layer_IBS2_mp "Messpunkt fuer Fehlerpfad  Dfp_Layer_IBS2" UWORD OneToOne 1 100 0.00 65535.00 FORMAT "%8.2" ECU_ADDRESS 0x8FE758 /end MEASUREMENT
/begin MEASUREMENT Dfp_Layer_IBS3_mp "Messpunkt fuer Fehlerpfad  Dfp_Layer_IBS3" UWORD OneToOne 1 100 0.00 65535.00 FORMAT "%8.2" ECU_ADDRESS 0x8FE75A /end MEASUREMENT
/begin MEASUREMENT Dfp_Layer_MANHYDR_mp "Messpunkt fuer Fehlerpfad  Dfp_Layer_MANHYDR" UWORD OneToOne 1 100 0.00 65535.00 FORMAT "%8.2" ECU_ADDRESS 0x8FE75C /end MEASUREMENT
/begin MEASUREMENT Dfp_Layer_MANLUFT_mp "Messpunkt fuer Fehlerpfad  Dfp_Layer_MANLUFT" UWORD OneToOne 1 100 0.00 65535.00 FORMAT "%8.2" ECU_ADDRESS 0x8FE75E /end MEASUREMENT
/begin MEASUREMENT Dfp_Layer_PMBATT_mp "Messpunkt fuer Fehlerpfad  Dfp_Layer_PMBATT" UWORD OneToOne 1 100 0.00 65535.00 FORMAT "%8.2" ECU_ADDRESS 0x8FE760 /end MEASUREMENT
/begin MEASUREMENT Dfp_Layer_PMBN_mp "Messpunkt fuer Fehlerpfad  Dfp_Layer_PMBN" UWORD OneToOne 1 100 0.00 65535.00 FORMAT "%8.2" ECU_ADDRESS 0x8FE762 /end MEASUREMENT
/begin MEASUREMENT Dfp_Layer_PMRUHVERL_mp "Messpunkt fuer Fehlerpfad  Dfp_Layer_PMRUHVERL" UWORD OneToOne 1 100 0.00 65535.00 FORMAT "%8.2" ECU_ADDRESS 0x8FE764 /end MEASUREMENT
/begin MEASUREMENT Dfp_Layer_QLT_mp "Messpunkt fuer Fehlerpfad  Dfp_Layer_QLT" UWORD OneToOne 1 100 0.00 65535.00 FORMAT "%8.2" ECU_ADDRESS 0x8FE766 /end MEASUREMENT
/begin MEASUREMENT Dfp_Layer_TANS_mp "Messpunkt fuer Fehlerpfad  Dfp_Layer_TANS" UWORD OneToOne 1 100 0.00 65535.00 FORMAT "%8.2" ECU_ADDRESS 0x8FE768 /end MEASUREMENT
/begin MEASUREMENT Dfp_Layer_TOENS_mp "Messpunkt fuer Fehlerpfad  Dfp_Layer_TOENS" UWORD OneToOne 1 100 0.00 65535.00 FORMAT "%8.2" ECU_ADDRESS 0x8FE76A /end MEASUREMENT
/begin MEASUREMENT Dfp_Layer_TUMG_mp "Messpunkt fuer Fehlerpfad  Dfp_Layer_TUMG" UWORD OneToOne 1 100 0.00 65535.00 FORMAT "%8.2" ECU_ADDRESS 0x8FE76C /end MEASUREMENT
/begin MEASUREMENT Dfp_LPACD_Max_mp "Messpunkt fuer Fehlerpfad  Dfp_LPACD_Max" UWORD OneToOne 1 100 0.00 65535.00 FORMAT "%8.2" ECU_ADDRESS 0x8FE76E /end MEASUREMENT
/begin MEASUREMENT Dfp_LPACD_Min_mp "Messpunkt fuer Fehlerpfad  Dfp_LPACD_Min" UWORD OneToOne 1 100 0.00 65535.00 FORMAT "%8.2" ECU_ADDRESS 0x8FE770 /end MEASUREMENT
/begin MEASUREMENT Dfp_LPACD_SigNpl_mp "Messpunkt fuer Fehlerpfad  Dfp_LPACD_SigNpl" UWORD OneToOne 1 100 0.00 65535.00 FORMAT "%8.2" ECU_ADDRESS 0x8FE772 /end MEASUREMENT
/begin MEASUREMENT Dfp_LSUCDCircNernst0_mp "Messpunkt fuer Fehlerpfad  Dfp_LSUCDCircNernst0" UWORD OneToOne 1 100 0.00 65535.00 FORMAT "%8.2" ECU_ADDRESS 0x8FE774 /end MEASUREMENT
/begin MEASUREMENT Dfp_LSUCDCircPumpCur0_mp "Messpunkt fuer Fehlerpfad  Dfp_LSUCDCircPumpCur0" UWORD OneToOne 1 100 0.00 65535.00 FORMAT "%8.2" ECU_ADDRESS 0x8FE776 /end MEASUREMENT
/begin MEASUREMENT Dfp_LSUCDCircVirtGnd0_mp "Messpunkt fuer Fehlerpfad  Dfp_LSUCDCircVirtGnd0" UWORD OneToOne 1 100 0.00 65535.00 FORMAT "%8.2" ECU_ADDRESS 0x8FE778 /end MEASUREMENT
/begin MEASUREMENT Dfp_LSUCDHeater0_mp "Messpunkt fuer Fehlerpfad  Dfp_LSUCDHeater0" UWORD OneToOne 1 100 0.00 65535.00 FORMAT "%8.2" ECU_ADDRESS 0x8FE77A /end MEASUREMENT
/begin MEASUREMENT Dfp_LSUCDHtCoup0_mp "Messpunkt fuer Fehlerpfad  Dfp_LSUCDHtCoup0" UWORD OneToOne 1 100 0.00 65535.00 FORMAT "%8.2" ECU_ADDRESS 0x8FE77C /end MEASUREMENT
/begin MEASUREMENT Dfp_LSUCDO20_mp "Messpunkt fuer Fehlerpfad  Dfp_LSUCDO20" UWORD OneToOne 1 100 0.00 65535.00 FORMAT "%8.2" ECU_ADDRESS 0x8FE77E /end MEASUREMENT
/begin MEASUREMENT Dfp_LSUCDO2Clb0_mp "Messpunkt fuer Fehlerpfad  Dfp_LSUCDO2Clb0" UWORD OneToOne 1 100 0.00 65535.00 FORMAT "%8.2" ECU_ADDRESS 0x8FE780 /end MEASUREMENT
/begin MEASUREMENT Dfp_LSUCDRiClb0_mp "Messpunkt fuer Fehlerpfad  Dfp_LSUCDRiClb0" UWORD OneToOne 1 100 0.00 65535.00 FORMAT "%8.2" ECU_ADDRESS 0x8FE782 /end MEASUREMENT
/begin MEASUREMENT Dfp_LSUCDSPI0_mp "Messpunkt fuer Fehlerpfad  Dfp_LSUCDSPI0" UWORD OneToOne 1 100 0.00 65535.00 FORMAT "%8.2" ECU_ADDRESS 0x8FE784 /end MEASUREMENT
/begin MEASUREMENT Dfp_LSUCDSPIBattLow0_mp "Fehlerpfad für niedrige Batteriespannung" UWORD OneToOne 1 100 0.00 65535.00 FORMAT "%8.2" ECU_ADDRESS 0x8FE786 /end MEASUREMENT
/begin MEASUREMENT Dfp_LSUCDWireIP0_mp "Messpunkt fuer Fehlerpfad  Dfp_LSUCDWireIP0" UWORD OneToOne 1 100 0.00 65535.00 FORMAT "%8.2" ECU_ADDRESS 0x8FE788 /end MEASUREMENT
/begin MEASUREMENT Dfp_LSUCtlRiExc0_mp "Messpunkt fuer Fehlerpfad  Dfp_LSUCtlRiExc0" UWORD OneToOne 1 100 0.00 65535.00 FORMAT "%8.2" ECU_ADDRESS 0x8FE78A /end MEASUREMENT
/begin MEASUREMENT Dfp_LSUMon1Sens_mp "Messpunkt fuer Fehlerpfad  Dfp_LSUMon1Sens" UWORD OneToOne 1 100 0.00 65535.00 FORMAT "%8.2" ECU_ADDRESS 0x8FE78C /end MEASUREMENT
/begin MEASUREMENT Dfp_LSUMon2Sens_mp "Messpunkt fuer Fehlerpfad  Dfp_LSUMon2Sens" UWORD OneToOne 1 100 0.00 65535.00 FORMAT "%8.2" ECU_ADDRESS 0x8FE78E /end MEASUREMENT
/begin MEASUREMENT Dfp_LubCD_mp "Fehlerpfad LubCD (Motorölkombinationsgeber)" UWORD OneToOne 1 100 0.00 65535.00 FORMAT "%8.2" ECU_ADDRESS 0x8FE790 /end MEASUREMENT
/begin MEASUREMENT Dfp_MeUnCDNoLoad_mp "Fehlerpfad für Lastabfall der Zumesseinheit" UWORD OneToOne 1 100 0.00 65535.00 FORMAT "%8.2" ECU_ADDRESS 0x8FE792 /end MEASUREMENT
/begin MEASUREMENT Dfp_MeUnCDSCBat_mp "Fehlerpfad für Kurzschluss zur Batteriespannung der Zumesseinheit" UWORD OneToOne 1 100 0.00 65535.00 FORMAT "%8.2" ECU_ADDRESS 0x8FE794 /end MEASUREMENT
/begin MEASUREMENT Dfp_MeUnCDSCGnd_mp "Fehlerpfad für Kurzschluss nach Masse der Zumesseinheit" UWORD OneToOne 1 100 0.00 65535.00 FORMAT "%8.2" ECU_ADDRESS 0x8FE796 /end MEASUREMENT
/begin MEASUREMENT Dfp_MeUnCD_ADC_mp "Fehlerpfad für die Signalerfassung des Stroms durch die Zumesseinheit" UWORD OneToOne 1 100 0.00 65535.00 FORMAT "%8.2" ECU_ADDRESS 0x8FE798 /end MEASUREMENT
/begin MEASUREMENT Dfp_MeUnCD_SigTst_mp "Messpunkt fuer Fehlerpfad  Dfp_MeUnCD_SigTst" UWORD OneToOne 1 100 0.00 65535.00 FORMAT "%8.2" ECU_ADDRESS 0x8FE79A /end MEASUREMENT
/begin MEASUREMENT Dfp_MIL_mp "Messpunkt fuer Fehlerpfad  Dfp_MIL" UWORD OneToOne 1 100 0.00 65535.00 FORMAT "%8.2" ECU_ADDRESS 0x8FE79C /end MEASUREMENT
/begin MEASUREMENT Dfp_Montr_mp "Messpunkt fuer Fehlerpfad  Dfp_Montr" UWORD OneToOne 1 100 0.00 65535.00 FORMAT "%8.2" ECU_ADDRESS 0x8FE79E /end MEASUREMENT
/begin MEASUREMENT Dfp_MRlyCD_mp "Messpunkt fuer Fehlerpfad  Dfp_MRlyCD" UWORD OneToOne 1 100 0.00 65535.00 FORMAT "%8.2" ECU_ADDRESS 0x8FE7A0 /end MEASUREMENT
/begin MEASUREMENT Dfp_MSidCD_Comm_mp "Messpunkt fuer Fehlerpfad  Dfp_MSidCD_Comm" UWORD OneToOne 1 100 0.00 65535.00 FORMAT "%8.2" ECU_ADDRESS 0x8FE7A2 /end MEASUREMENT
/begin MEASUREMENT Dfp_MSidCD_Pin_mp "Messpunkt fuer Fehlerpfad  Dfp_MSidCD_Pin" UWORD OneToOne 1 100 0.00 65535.00 FORMAT "%8.2" ECU_ADDRESS 0x8FE7A4 /end MEASUREMENT
/begin MEASUREMENT Dfp_MSidCD_Select_mp "Messpunkt fuer Fehlerpfad  Dfp_MSidCD_Select" UWORD OneToOne 1 100 0.00 65535.00 FORMAT "%8.2" ECU_ADDRESS 0x8FE7A6 /end MEASUREMENT
/begin MEASUREMENT Dfp_MSidCD_Sel_INI_mp "Messpunkt fuer Fehlerpfad  Dfp_MSidCD_Sel_INI" UWORD OneToOne 1 100 0.00 65535.00 FORMAT "%8.2" ECU_ADDRESS 0x8FE7A8 /end MEASUREMENT
/begin MEASUREMENT Dfp_NetMngDeviceA_mp "Fehlerpfad für CAN Baustein A" UWORD OneToOne 1 100 0.00 65535.00 FORMAT "%8.2" ECU_ADDRESS 0x8FE7AA /end MEASUREMENT
/begin MEASUREMENT Dfp_NetMngDeviceB_mp "Fehlerpfad für CAN Baustein B" UWORD OneToOne 1 100 0.00 65535.00 FORMAT "%8.2" ECU_ADDRESS 0x8FE7AC /end MEASUREMENT
/begin MEASUREMENT Dfp_NetMngDeviceC_mp "Messpunkt fuer Fehlerpfad  Dfp_NetMngDeviceC" UWORD OneToOne 1 100 0.00 65535.00 FORMAT "%8.2" ECU_ADDRESS 0x8FE7AE /end MEASUREMENT
/begin MEASUREMENT Dfp_OPSCD_anain_mp "Messpunkt fuer Fehlerpfad  Dfp_OPSCD_anain" UWORD OneToOne 1 100 0.00 65535.00 FORMAT "%8.2" ECU_ADDRESS 0x8FE7B0 /end MEASUREMENT
/begin MEASUREMENT Dfp_OPSCD_Lamp_mp "Fehlerpfad Endstufenfehler Öllampe" UWORD OneToOne 1 100 0.00 65535.00 FORMAT "%8.2" ECU_ADDRESS 0x8FE7B2 /end MEASUREMENT
/begin MEASUREMENT Dfp_OTSCD_mp "Fehlerpfad Öltemperaturwert" UWORD OneToOne 1 100 0.00 65535.00 FORMAT "%8.2" ECU_ADDRESS 0x8FE7B4 /end MEASUREMENT
/begin MEASUREMENT Dfp_OvRMonBrk_mp "measurment point for fault path Dfp_OvRMonBrk" UWORD OneToOne 1 100 0.00 65535.00 FORMAT "%8.2" ECU_ADDRESS 0x8FE7B6 /end MEASUREMENT
/begin MEASUREMENT Dfp_OvRMonSigA_mp "Fehlerpfad für Drehzahlplausibilisierung in der Schubüberwachung" UWORD OneToOne 1 100 0.00 65535.00 FORMAT "%8.2" ECU_ADDRESS 0x8FE7B8 /end MEASUREMENT
/begin MEASUREMENT Dfp_OvRMon_mp "Messpunkt fuer Fehlerpfad  Dfp_OvRMon" UWORD OneToOne 1 100 0.00 65535.00 FORMAT "%8.2" ECU_ADDRESS 0x8FE7BA /end MEASUREMENT
/begin MEASUREMENT Dfp_OxiCCDTPre_mp "Messpunkt fuer Fehlerpfad  Dfp_OxiCCDTPre" UWORD OneToOne 1 100 0.00 65535.00 FORMAT "%8.2" ECU_ADDRESS 0x8FE7BC /end MEASUREMENT
/begin MEASUREMENT Dfp_PCR_GovDevNeg_mp "Messpunkt fuer Fehlerpfad  Dfp_PCR_GovDevNeg" UWORD OneToOne 1 100 0.00 65535.00 FORMAT "%8.2" ECU_ADDRESS 0x8FE7BE /end MEASUREMENT
/begin MEASUREMENT Dfp_PCR_GovDevPos_mp "Messpunkt fuer Fehlerpfad  Dfp_PCR_GovDevPos" UWORD OneToOne 1 100 0.00 65535.00 FORMAT "%8.2" ECU_ADDRESS 0x8FE7C0 /end MEASUREMENT
/begin MEASUREMENT Dfp_PCVCDNoLoad_mp "Messpunkt fuer Fehlerpfad Lastabfall des Druckregelventils" UWORD OneToOne 1 100 0.00 65535.00 FORMAT "%8.2" ECU_ADDRESS 0x8FE7C2 /end MEASUREMENT
/begin MEASUREMENT Dfp_PCVCDSCBat_mp "Messpunkt für Fehlerpfad Kurzschluss zur Batteriespannung des Druckregelventils" UWORD OneToOne 1 100 0.00 65535.00 FORMAT "%8.2" ECU_ADDRESS 0x8FE7C4 /end MEASUREMENT
/begin MEASUREMENT Dfp_PCVCDSCGnd_mp "Messpunkt für Fehlerpfad Kurzschluss nach Masse des Druckregelventils" UWORD OneToOne 1 100 0.00 65535.00 FORMAT "%8.2" ECU_ADDRESS 0x8FE7C6 /end MEASUREMENT
/begin MEASUREMENT Dfp_PCVCD_ADC_mp "Messpunkt fuer Fehlerpfad  Dfp_PCVCD_ADC" UWORD OneToOne 1 100 0.00 65535.00 FORMAT "%8.2" ECU_ADDRESS 0x8FE7C8 /end MEASUREMENT
/begin MEASUREMENT Dfp_PCVCD_SigTst_mp "Messpunkt fuer Fehlerpfad  Dfp_PCVCD_SigTst" UWORD OneToOne 1 100 0.00 65535.00 FORMAT "%8.2" ECU_ADDRESS 0x8FE7CA /end MEASUREMENT
/begin MEASUREMENT Dfp_PFltAPSens_mp "Fehlerfad für Atmosphärendrucksensor" UWORD OneToOne 1 100 0.00 65535.00 FORMAT "%8.2" ECU_ADDRESS 0x8FE7CC /end MEASUREMENT
/begin MEASUREMENT Dfp_PFltCDPPre_mp "Messpunkt fuer Fehlerpfad  Dfp_PFltCDPPre" UWORD OneToOne 1 100 0.00 65535.00 FORMAT "%8.2" ECU_ADDRESS 0x8FE7CE /end MEASUREMENT
/begin MEASUREMENT Dfp_PFltCDTempPre_mp "Fehlerpfad der Abgastemperatur vor dem Partikelfilter" UWORD OneToOne 1 100 0.00 65535.00 FORMAT "%8.2" ECU_ADDRESS 0x8FE7D0 /end MEASUREMENT
/begin MEASUREMENT Dfp_PFltChar_mp "Digitaler Fehlerpfad für Fliesswiderstand Partikelfilter" UWORD OneToOne 1 100 0.00 65535.00 FORMAT "%8.2" ECU_ADDRESS 0x8FE7D2 /end MEASUREMENT
/begin MEASUREMENT Dfp_PFltEngPrt_mp "Messpunkt fuer Fehlerpfad  Dfp_PFltEngPrt" UWORD OneToOne 1 100 0.00 65535.00 FORMAT "%8.2" ECU_ADDRESS 0x8FE7D4 /end MEASUREMENT
/begin MEASUREMENT Dfp_PFltmSotDiffMax_mp "Messpunkt fuer Fehlerpfad  Dfp_PFltmSotDiffMax" UWORD OneToOne 1 100 0.00 65535.00 FORMAT "%8.2" ECU_ADDRESS 0x8FE7D6 /end MEASUREMENT
/begin MEASUREMENT Dfp_PFltPresDynPlaus_mp "Messpunkt fuer Fehlerpfad  Dfp_PFltPresDynPlaus" UWORD OneToOne 1 100 0.00 65535.00 FORMAT "%8.2" ECU_ADDRESS 0x8FE7D8 /end MEASUREMENT
/begin MEASUREMENT Dfp_PFltPresSensFrz_mp "Messpunkt fuer Fehlerpfad  Dfp_PFltPresSensFrz" UWORD OneToOne 1 100 0.00 65535.00 FORMAT "%8.2" ECU_ADDRESS 0x8FE7DA /end MEASUREMENT
/begin MEASUREMENT Dfp_PFltPresSensHsLn_mp "Messpunkt fuer Fehlerpfad  Dfp_PFltPresSensHsLn" UWORD OneToOne 1 100 0.00 65535.00 FORMAT "%8.2" ECU_ADDRESS 0x8FE7DC /end MEASUREMENT
/begin MEASUREMENT Dfp_PFltPresSensSot_mp "Messpunkt fuer Fehlerpfad  Dfp_PFltPresSensSot" UWORD OneToOne 1 100 0.00 65535.00 FORMAT "%8.2" ECU_ADDRESS 0x8FE7DE /end MEASUREMENT
/begin MEASUREMENT Dfp_PFltPresSens_mp "Messpunkt fuer Fehlerpfad  Dfp_PFltPresSens" UWORD OneToOne 1 100 0.00 65535.00 FORMAT "%8.2" ECU_ADDRESS 0x8FE7E0 /end MEASUREMENT
/begin MEASUREMENT Dfp_PFltRgnPerm_mp "Messpunkt fuer Fehlerpfad  Dfp_PFltRgnPerm" UWORD OneToOne 1 100 0.00 65535.00 FORMAT "%8.2" ECU_ADDRESS 0x8FE7E2 /end MEASUREMENT
/begin MEASUREMENT Dfp_PFltTempDwnStrm_mp "Digitaler Fehlerpfad für zweiten Abgastemperatursensor" UWORD OneToOne 1 100 0.00 65535.00 FORMAT "%8.2" ECU_ADDRESS 0x8FE7E4 /end MEASUREMENT
/begin MEASUREMENT Dfp_PFltTempSens_mp "Messpunkt fuer Fehlerpfad  Dfp_PFltTempSens" UWORD OneToOne 1 100 0.00 65535.00 FORMAT "%8.2" ECU_ADDRESS 0x8FE7E6 /end MEASUREMENT
/begin MEASUREMENT Dfp_PFltTempUpStrm_mp "Digitaler Fehlerpfad für ersten Abgastemperatursensor" UWORD OneToOne 1 100 0.00 65535.00 FORMAT "%8.2" ECU_ADDRESS 0x8FE7E8 /end MEASUREMENT
/begin MEASUREMENT Dfp_PSPCD_Actr_mp "Messpunkt fuer Fehlerpfad  Dfp_PSPCD_Actr" UWORD OneToOne 1 100 0.00 65535.00 FORMAT "%8.2" ECU_ADDRESS 0x8FE7EA /end MEASUREMENT
/begin MEASUREMENT Dfp_QLTCD_mp "Messpunkt fuer Fehlerpfad  Dfp_QLTCD" UWORD OneToOne 1 100 0.00 65535.00 FORMAT "%8.2" ECU_ADDRESS 0x8FE7EC /end MEASUREMENT
/begin MEASUREMENT Dfp_RailCDOfsTst_mp "Fehlerpfad für Offset-Überwachung des Raildrucksensors" UWORD OneToOne 1 100 0.00 65535.00 FORMAT "%8.2" ECU_ADDRESS 0x8FE7EE /end MEASUREMENT
/begin MEASUREMENT Dfp_RailCD_mp "Messpunkt fuer Fehlerpfad  Dfp_RailCD" UWORD OneToOne 1 100 0.00 65535.00 FORMAT "%8.2" ECU_ADDRESS 0x8FE7F0 /end MEASUREMENT
/begin MEASUREMENT Dfp_RailCD_PMonStrt_mp "Messpunkt fuer Fehlerpfad  Dfp_RailCD_PMonStrt" UWORD OneToOne 1 100 0.00 65535.00 FORMAT "%8.2" ECU_ADDRESS 0x8FE7F2 /end MEASUREMENT
/begin MEASUREMENT Dfp_RailCtlModeMeUnDiag_mp "Messpunkt fuer Fehlerpfad  Dfp_RailCtlModeMeUnDiag" UWORD OneToOne 1 100 0.00 65535.00 FORMAT "%8.2" ECU_ADDRESS 0x8FE7F4 /end MEASUREMENT
/begin MEASUREMENT Dfp_RailCtlModePCVDiag_mp "Messpunkt fuer Fehlerpfad  Dfp_RailCtlModePCVDiag" UWORD OneToOne 1 100 0.00 65535.00 FORMAT "%8.2" ECU_ADDRESS 0x8FE7F6 /end MEASUREMENT
/begin MEASUREMENT Dfp_RailMeUn0_mp "Fehlerpfad für Überwachung auf positive Regelabweichung" UWORD OneToOne 1 100 0.00 65535.00 FORMAT "%8.2" ECU_ADDRESS 0x8FE7F8 /end MEASUREMENT
/begin MEASUREMENT Dfp_RailMeUn1_mp "Fehlerpfad für Überwachung auf positive Regelabweichung und Sollwert des Volumenstroms durch die Zumesseinheit" UWORD OneToOne 1 100 0.00 65535.00 FORMAT "%8.2" ECU_ADDRESS 0x8FE7FA /end MEASUREMENT
/begin MEASUREMENT Dfp_RailMeUn2_mp "Fehlerpfad für Überwachung auf negative Regelabweichung bei Nullförderung" UWORD OneToOne 1 100 0.00 65535.00 FORMAT "%8.2" ECU_ADDRESS 0x8FE7FC /end MEASUREMENT
/begin MEASUREMENT Dfp_RailMeUn3_mp "Fehlerpfad für Überwachung auf minimalen Raildruck" UWORD OneToOne 1 100 0.00 65535.00 FORMAT "%8.2" ECU_ADDRESS 0x8FE7FE /end MEASUREMENT
/begin MEASUREMENT Dfp_RailMeUn4_mp "Fehlerpfad für Überwachung auf maximalen Raildruck" UWORD OneToOne 1 100 0.00 65535.00 FORMAT "%8.2" ECU_ADDRESS 0x8FE800 /end MEASUREMENT
/begin MEASUREMENT Dfp_RailPCV0_mp "Fehlerpfad für Überwachung auf positive Regelabweichung" UWORD OneToOne 1 100 0.00 65535.00 FORMAT "%8.2" ECU_ADDRESS 0x8FE802 /end MEASUREMENT
/begin MEASUREMENT Dfp_RailPCV1_mp "Fehlerpfad für Überwachung auf positive Regelabweichung kombiniert mit Stellgröße des Druckregelventils" UWORD OneToOne 1 100 0.00 65535.00 FORMAT "%8.2" ECU_ADDRESS 0x8FE804 /end MEASUREMENT
/begin MEASUREMENT Dfp_RailPCV2_mp "Fehlerpfad für Überwachung auf negative Regelabweichung kombiniert mit Stellgröße des Druckregelventils" UWORD OneToOne 1 100 0.00 65535.00 FORMAT "%8.2" ECU_ADDRESS 0x8FE806 /end MEASUREMENT
/begin MEASUREMENT Dfp_RailPCV3_mp "Fehlerpfad für Überwachung auf minimalen Raildruck" UWORD OneToOne 1 100 0.00 65535.00 FORMAT "%8.2" ECU_ADDRESS 0x8FE808 /end MEASUREMENT
/begin MEASUREMENT Dfp_RailPCV4_mp "Fehlerpfad für Überwachung auf maximalen Raildruck" UWORD OneToOne 1 100 0.00 65535.00 FORMAT "%8.2" ECU_ADDRESS 0x8FE80A /end MEASUREMENT
/begin MEASUREMENT Dfp_RailPCV5_mp "Fehlerpfad für Plausibilisierung des Raildrucks mit dem Strom durch das Druckregelventil" UWORD OneToOne 1 100 0.00 65535.00 FORMAT "%8.2" ECU_ADDRESS 0x8FE80C /end MEASUREMENT
/begin MEASUREMENT Dfp_ShutCD_mp "Messpunkt fuer Fehlerpfad  Dfp_ShutCD" UWORD OneToOne 1 100 0.00 65535.00 FORMAT "%8.2" ECU_ADDRESS 0x8FE80E /end MEASUREMENT
/begin MEASUREMENT Dfp_SOPTst_mp "Messpunkt fuer Fehlerpfad  Dfp_SOPTst" UWORD OneToOne 1 100 0.00 65535.00 FORMAT "%8.2" ECU_ADDRESS 0x8FE810 /end MEASUREMENT
/begin MEASUREMENT Dfp_SSpMon1_mp "Meßpunkt des Fehlerpfades für Sensorversorgungsspannung 1" UWORD OneToOne 1 100 0.00 65535.00 FORMAT "%8.2" ECU_ADDRESS 0x8FE812 /end MEASUREMENT
/begin MEASUREMENT Dfp_SSpMon2_mp "Meßpunkt des Fehlerpfades für Sensorversorgungsspannung 2" UWORD OneToOne 1 100 0.00 65535.00 FORMAT "%8.2" ECU_ADDRESS 0x8FE814 /end MEASUREMENT
/begin MEASUREMENT Dfp_SSpMon3_mp "Meßpunkt des Fehlerpfades für Sensorversorgungsspannung 3" UWORD OneToOne 1 100 0.00 65535.00 FORMAT "%8.2" ECU_ADDRESS 0x8FE816 /end MEASUREMENT
/begin MEASUREMENT Dfp_StrtCD_Actr_mp "Fehlerpfad für Starterrelais Endstufe" UWORD OneToOne 1 100 0.00 65535.00 FORMAT "%8.2" ECU_ADDRESS 0x8FE818 /end MEASUREMENT
/begin MEASUREMENT Dfp_StSysTrqShutOff_mp "Zustand Fehlerpfad Start o. Kl.50" UWORD OneToOne 1 100 0.00 65535.00 FORMAT "%8.2" ECU_ADDRESS 0x8FE81A /end MEASUREMENT
/begin MEASUREMENT Dfp_SWChk_CycSigChkDat_mp "Messpunkt fuer Fehlerpfad  Dfp_SWChk_CycSigChkDat" UWORD OneToOne 1 100 0.00 65535.00 FORMAT "%8.2" ECU_ADDRESS 0x8FE81C /end MEASUREMENT
/begin MEASUREMENT Dfp_SWChk_CycSigChkPrg_mp "Messpunkt fuer Fehlerpfad  Dfp_SWChk_CycSigChkPrg" UWORD OneToOne 1 100 0.00 65535.00 FORMAT "%8.2" ECU_ADDRESS 0x8FE81E /end MEASUREMENT
/begin MEASUREMENT Dfp_SysLamp_mp "Messpunkt fuer Fehlerpfad  Dfp_SysLamp" UWORD OneToOne 1 100 0.00 65535.00 FORMAT "%8.2" ECU_ADDRESS 0x8FE820 /end MEASUREMENT
/begin MEASUREMENT Dfp_T15CD_mp "Messpunkt fuer Fehlerpfad  Dfp_T15CD" UWORD OneToOne 1 100 0.00 65535.00 FORMAT "%8.2" ECU_ADDRESS 0x8FE822 /end MEASUREMENT
/begin MEASUREMENT Dfp_TGearbx_mp "Messpunkt fuer Fehlerpfad  Dfp_TGearbx" UWORD OneToOne 1 100 0.00 65535.00 FORMAT "%8.2" ECU_ADDRESS 0x8FE824 /end MEASUREMENT
/begin MEASUREMENT Dfp_TPUMon_mp "Messpunkt fuer Fehlerpfad  Dfp_TPUMon" UWORD OneToOne 1 100 0.00 65535.00 FORMAT "%8.2" ECU_ADDRESS 0x8FE826 /end MEASUREMENT
/begin MEASUREMENT Dfp_TVACD_Max_mp "Fehlerpfad für Kurzschluss nach Batteriespannung des Drosselklappenstellers" UWORD OneToOne 1 100 0.00 65535.00 FORMAT "%8.2" ECU_ADDRESS 0x8FE828 /end MEASUREMENT
/begin MEASUREMENT Dfp_TVACD_Min_mp "Fehlerpfad für Kurzschluss nach Masse des Drosselklappenstellers" UWORD OneToOne 1 100 0.00 65535.00 FORMAT "%8.2" ECU_ADDRESS 0x8FE82A /end MEASUREMENT
/begin MEASUREMENT Dfp_TVACD_SigNpl_mp "Fehlerpfad für Lastabfall und Übertemperatur des Drosselklappenstellers" UWORD OneToOne 1 100 0.00 65535.00 FORMAT "%8.2" ECU_ADDRESS 0x8FE82C /end MEASUREMENT
/begin MEASUREMENT Dfp_TVACD_TVADia1_mp "Messpunkt für Fehlerpfad Dfp_TVACD_TVADia1" UWORD OneToOne 1 100 0.00 65535.00 FORMAT "%8.2" ECU_ADDRESS 0x8FE82E /end MEASUREMENT
/begin MEASUREMENT Dfp_TVACD_TVADia2_mp "Messpunkt für Fehlerpfad Dfp_TVACD_TVADia2" UWORD OneToOne 1 100 0.00 65535.00 FORMAT "%8.2" ECU_ADDRESS 0x8FE830 /end MEASUREMENT
/begin MEASUREMENT Dfp_TVACD_TVADia3_mp "Messpunkt für Fehlerpfad Dfp_TVACD_TVADia3" UWORD OneToOne 1 100 0.00 65535.00 FORMAT "%8.2" ECU_ADDRESS 0x8FE832 /end MEASUREMENT
/begin MEASUREMENT Dfp_TVACD_TVADia4_mp "Fehlerpfad für Drosselklappensteller Diagnose viertes Fenster" UWORD OneToOne 1 100 0.00 65535.00 FORMAT "%8.2" ECU_ADDRESS 0x8FE834 /end MEASUREMENT
/begin MEASUREMENT Dfp_VSACD_DioInDia1_mp "Messpunkt fuer Fehlerpfad  Dfp_VSACD_DioInDia1" UWORD OneToOne 1 100 0.00 65535.00 FORMAT "%8.2" ECU_ADDRESS 0x8FE836 /end MEASUREMENT
/begin MEASUREMENT Dfp_VSACD_DioInDia2_mp "Messpunkt fuer Fehlerpfad  Dfp_VSACD_DioInDia2" UWORD OneToOne 1 100 0.00 65535.00 FORMAT "%8.2" ECU_ADDRESS 0x8FE838 /end MEASUREMENT
/begin MEASUREMENT Dfp_VSACD_DioInDia3_mp "Messpunkt fuer Fehlerpfad  Dfp_VSACD_DioInDia3" UWORD OneToOne 1 100 0.00 65535.00 FORMAT "%8.2" ECU_ADDRESS 0x8FE83A /end MEASUREMENT
/begin MEASUREMENT Dfp_VSACD_DioInDia4_mp "Messpunkt fuer Fehlerpfad  Dfp_VSACD_DioInDia4" UWORD OneToOne 1 100 0.00 65535.00 FORMAT "%8.2" ECU_ADDRESS 0x8FE83C /end MEASUREMENT
/begin MEASUREMENT Dfp_VSACD_DioInMin_mp "Messpunkt fuer Fehlerpfad  Dfp_VSACD_DioInMin" UWORD OneToOne 1 100 0.00 65535.00 FORMAT "%8.2" ECU_ADDRESS 0x8FE83E /end MEASUREMENT
/begin MEASUREMENT Dfp_VSACD_Max_mp "Fehlerpfad für Kurzschluss nach Batteriespannung des Drallniveaustellers" UWORD OneToOne 1 100 0.00 65535.00 FORMAT "%8.2" ECU_ADDRESS 0x8FE840 /end MEASUREMENT
/begin MEASUREMENT Dfp_VSACD_Min_mp "Fehlerpfad für Kurzschluss nach Masse des Drallniveaustellers" UWORD OneToOne 1 100 0.00 65535.00 FORMAT "%8.2" ECU_ADDRESS 0x8FE842 /end MEASUREMENT
/begin MEASUREMENT Dfp_VSACD_SigNpl_mp "Fehlerpfad für Lastabfall und Übertemperatur des Drallniveaustellers" UWORD OneToOne 1 100 0.00 65535.00 FORMAT "%8.2" ECU_ADDRESS 0x8FE844 /end MEASUREMENT
/begin MEASUREMENT Dfp_VSACD_VSADia1_mp "Messpunkt fuer Fehlerpfad  Dfp_VSACD_VSADia1" UWORD OneToOne 1 100 0.00 65535.00 FORMAT "%8.2" ECU_ADDRESS 0x8FE846 /end MEASUREMENT
/begin MEASUREMENT Dfp_VSACD_VSADia2_mp "Messpunkt fuer Fehlerpfad  Dfp_VSACD_VSADia2" UWORD OneToOne 1 100 0.00 65535.00 FORMAT "%8.2" ECU_ADDRESS 0x8FE848 /end MEASUREMENT
/begin MEASUREMENT Dfp_VSACD_VSADia3_mp "Messpunkt fuer Fehlerpfad  Dfp_VSACD_VSADia3" UWORD OneToOne 1 100 0.00 65535.00 FORMAT "%8.2" ECU_ADDRESS 0x8FE84A /end MEASUREMENT
/begin MEASUREMENT Dfp_VSACD_VSADia4_mp "Fehlerpfad für Drallklappensteller Diagnose viertes Fenster" UWORD OneToOne 1 100 0.00 65535.00 FORMAT "%8.2" ECU_ADDRESS 0x8FE84C /end MEASUREMENT
/begin MEASUREMENT Dfp_VSSCD1_mp "Messpunkt fuer Fehlerpfad  Dfp_VSSCD1" UWORD OneToOne 1 100 0.00 65535.00 FORMAT "%8.2" ECU_ADDRESS 0x8FE84E /end MEASUREMENT
/begin MEASUREMENT Dfp_VSSCD2_mp "Messpunkt fuer Fehlerpfad  Dfp_VSSCD2" UWORD OneToOne 1 100 0.00 65535.00 FORMAT "%8.2" ECU_ADDRESS 0x8FE850 /end MEASUREMENT
/begin MEASUREMENT Dfp_WdCom_mp "Messpunkt fuer Fehlerpfad  Dfp_WdCom" UWORD OneToOne 1 100 0.00 65535.00 FORMAT "%8.2" ECU_ADDRESS 0x8FE852 /end MEASUREMENT
/begin FUNCTION dsm_auto_debclass ""
 /begin DEF_CHARACTERISTIC DSM_ClaDfp_Layer_TANS_C DSM_ClaDfp_ACCDCmpr_C DSM_ClaDfp_ACCDPres_C DSM_ClaDfp_ACCDPres1_C DSM_ClaDfp_ACCDPresAna_C DSM_ClaDfp_ACCDSwtin_C DSM_ClaDfp_ACC_PlausTrqDes_C DSM_ClaDfp_ACC_trqInr_C DSM_ClaDfp_ACTrq_C DSM_ClaDfp_ADCMon_C DSM_ClaDfp_AFSCDIdlAdjVal_C DSM_ClaDfp_AFSCDLdAdjVal_C DSM_ClaDfp_AFSCD_AirTempDcyc_C DSM_ClaDfp_AFSCD_PlOffsDrft_C DSM_ClaDfp_AFSCD_PlSetyDrft_C DSM_ClaDfp_AFSCD_SRCAirTemp_C DSM_ClaDfp_AFSCD_SRCBatt_C DSM_ClaDfp_AFSCD_SRCCorrAirm_C DSM_ClaDfp_AFSCD_SRCRawAirm_C DSM_ClaDfp_Layer_TUMG_C DSM_ClaDfp_AFSCD_SRCRefSigPer_C DSM_ClaDfp_AOHtCD_C DSM_ClaDfp_Layer_GEN_C DSM_ClaDfp_Layer_BSD_C DSM_ClaDfp_AOHtCD_AOHtDia1_C DSM_ClaDfp_AOHtCD_AOHtDia2_C DSM_ClaDfp_AOHtCD_AOHtDia3_C DSM_ClaDfp_APP1_C DSM_ClaDfp_APP2_C DSM_ClaDfp_APPSync_C DSM_ClaDfp_APSCD_C DSM_ClaDfp_ARS_C DSM_ClaDfp_AccPedPlausBrk_C DSM_ClaDfp_AirCtlPlateBreak_C DSM_ClaDfp_Layer_QLT_C DSM_ClaDfp_AirCtl_GovNegDev_C DSM_ClaDfp_Layer_IBS1_C DSM_ClaDfp_Layer_IBS2_C DSM_ClaDfp_Layer_IBS3_C DSM_ClaDfp_Layer_PMBN_C DSM_ClaDfp_Layer_PMBATT_C DSM_ClaDfp_AirCtl_GovNegDev2_C DSM_ClaDfp_AirCtl_GovPosDev_C DSM_ClaDfp_AirCtl_GovPosDev2_C DSM_ClaDfp_AltCD_C DSM_ClaDfp_AltCD_Load_C DSM_ClaDfp_BPACD_BPADia1_C DSM_ClaDfp_BPACD_BPADia2_C DSM_ClaDfp_BPACD_BPADia3_C DSM_ClaDfp_BPACD_Max_C DSM_ClaDfp_BPACD_Min_C DSM_ClaDfp_BPACD_SigNpl_C DSM_ClaDfp_BPSCD_C DSM_ClaDfp_BattCD_C DSM_ClaDfp_BrkCD_C DSM_ClaDfp_Bss_C DSM_ClaDfp_CBACD_C DSM_ClaDfp_CTSCD_C DSM_ClaDfp_Clg_DynTst_C DSM_ClaDfp_CmbChbMisfire1_C DSM_ClaDfp_CmbChbMisfire2_C DSM_ClaDfp_CmbChbMisfire3_C DSM_ClaDfp_CmbChbMisfire4_C DSM_ClaDfp_CmbChbMisfire5_C DSM_ClaDfp_CmbChbMisfire6_C DSM_ClaDfp_CmbChbMisfireMul_C DSM_ClaDfp_CoVMDCSh_C DSM_ClaDfp_ConvCD_C DSM_ClaDfp_CrCCDMFL_C DSM_ClaDfp_CrCtl_vCrCtl_C DSM_ClaDfp_Dummy1_C DSM_ClaDfp_EATSCD_C DSM_ClaDfp_EBAFCD_C DSM_ClaDfp_Layer_PMRUHVERL_C DSM_ClaDfp_EBFCD_C DSM_ClaDfp_EBTSCD_C DSM_ClaDfp_EBTSCD_OvrTemp_C DSM_ClaDfp_EEPCDVarMng_C DSM_ClaDfp_Layer_TOENS_C DSM_ClaDfp_Layer_MANHYDR_C DSM_ClaDfp_Layer_MANLUFT_C DSM_ClaDfp_EGPpCD_C DSM_ClaDfp_EGPpCDTPreTrbn_C DSM_ClaDfp_EGRCD_Max_C DSM_ClaDfp_EGRCD_Min_C DSM_ClaDfp_EGRCD_SigNpl_C DSM_ClaDfp_EGTRgnOilDil_C DSM_ClaDfp_EMCCDNoLoad1_C DSM_ClaDfp_EMCCDNoLoad2_C DSM_ClaDfp_EMCCDSCBat1_C DSM_ClaDfp_EMCCDSCBat2_C DSM_ClaDfp_EMCCDSCGnd1_C DSM_ClaDfp_EMCCDSCGnd2_C DSM_ClaDfp_EMCCD_ADC1_C DSM_ClaDfp_EMCCD_ADC2_C DSM_ClaDfp_ETClbETFltInj1_C DSM_ClaDfp_ETClbETFltInj2_C DSM_ClaDfp_ETClbETFltInj3_C DSM_ClaDfp_ETClbETFltInj4_C DSM_ClaDfp_ETClbETFltInj5_C DSM_ClaDfp_ETClbETFltInj6_C DSM_ClaDfp_ETClbInj1_C DSM_ClaDfp_ETClbInj2_C DSM_ClaDfp_ETClbInj3_C DSM_ClaDfp_ETClbInj4_C DSM_ClaDfp_ETClbInj5_C DSM_ClaDfp_ETClbInj6_C DSM_ClaDfp_EngMCaS1_C DSM_ClaDfp_EngMCrS1_C DSM_ClaDfp_EngMOfsCaSCrS_C DSM_ClaDfp_EngPrtFWODet_C DSM_ClaDfp_FBCqDvt_C DSM_ClaDfp_FMTC_NonMonotonMap_C DSM_ClaDfp_FTSCD_C DSM_ClaDfp_FanCD_C DSM_ClaDfp_FanCD_FanCtlr1_C DSM_ClaDfp_FanCD_FanCtlr2_C DSM_ClaDfp_FanCD_FanCtlr3_C DSM_ClaDfp_FlFCD_C DSM_ClaDfp_FlMngSmkDefect_C DSM_ClaDfp_FrmMngASC1_C DSM_ClaDfp_FrmMngASC2_C DSM_ClaDfp_FrmMngASC3_C DSM_ClaDfp_FrmMngASC4_C DSM_ClaDfp_FrmMngBOS_RESET_C DSM_ClaDfp_FrmMngBOS_RESET_2_C DSM_ClaDfp_FrmMngDMANFAFS_C DSM_ClaDfp_FrmMngDRMANFSSG_C DSM_ClaDfp_FrmMngEGS1_C DSM_ClaDfp_FrmMngEGS2_C DSM_ClaDfp_FrmMngGEARBX_DATA_C DSM_ClaDfp_FrmMngGEARBX_DATA2_C DSM_ClaDfp_FrmMngHEAT_AC_C DSM_ClaDfp_FrmMngINSTR2_C DSM_ClaDfp_FrmMngINSTR3_C DSM_ClaDfp_FrmMngLENKRADWINKEL_C DSM_ClaDfp_FrmMngMILEAGE_RANGE_C DSM_ClaDfp_FrmMngOPCRCTLACC_C DSM_ClaDfp_FrmMngPRGG_CCTR_C DSM_ClaDfp_FrmMngPWRMNG_LOADV_C DSM_ClaDfp_FrmMngParkConsumer_C DSM_ClaDfp_FrmMngRQSTGEFAN_C DSM_ClaDfp_FrmMngSSGErr_C DSM_ClaDfp_FrmMngSSGShOff_C DSM_ClaDfp_FrmMngSTAT_ANH_C DSM_ClaDfp_FrmMngSTAT_ARS_C DSM_ClaDfp_FrmMngSTAT_DSC_C DSM_ClaDfp_FrmMngSTAT_EKP_C DSM_ClaDfp_FrmMngSTAT_KOMBI_C DSM_ClaDfp_FrmMngSTAT_SITZ_C DSM_ClaDfp_FrmMngStOBDGbxMilOf_C DSM_ClaDfp_FrmMngStOBDGbxMilOn_C DSM_ClaDfp_FrmMngTEMPRELTIME_C DSM_ClaDfp_FrmMngTERMINAL_C DSM_ClaDfp_FrmMngTIME_DATE_C DSM_ClaDfp_FrmMngTORQUE_DSC_C DSM_ClaDfp_FrmMngTORQUE_GEARBX_C DSM_ClaDfp_FrmMngTrq_ReqACC_C DSM_ClaDfp_FrmMngVEH_MOD_C DSM_ClaDfp_FrmMngVELOCITY_C DSM_ClaDfp_FrmMngWHEEL_SPEED_C DSM_ClaDfp_FrmMngstCurr_C DSM_ClaDfp_FrmMngswtPSPOff_C DSM_ClaDfp_GearbxIncMax_C DSM_ClaDfp_GlwCD_C DSM_ClaDfp_GlwCDGlwCirc1_C DSM_ClaDfp_GlwCDGlwCirc2_C DSM_ClaDfp_GlwCDGlwCirc3_C DSM_ClaDfp_GlwCDGlwCirc4_C DSM_ClaDfp_GlwCDGlwCirc5_C DSM_ClaDfp_GlwCDGlwCirc6_C DSM_ClaDfp_GlwCDGlwCirc7_C DSM_ClaDfp_GlwCDGlwCirc8_C DSM_ClaDfp_GlwCtl_C DSM_ClaDfp_HWEMonCom_C DSM_ClaDfp_HWEMonEEPROM_C DSM_ClaDfp_HWEMonRcyLocked_C DSM_ClaDfp_HWEMonRcySuppressed_C DSM_ClaDfp_HWEMonRcyVisible_C DSM_ClaDfp_HWEMonUMaxSupply_C DSM_ClaDfp_HWEMonUMinSupply_C DSM_ClaDfp_IATSCD_C DSM_ClaDfp_IATSCD_CATS_C DSM_ClaDfp_ImmCtlImmCD_C DSM_ClaDfp_ImmCtlImmEep_C DSM_ClaDfp_ImmCtlMpl_C DSM_ClaDfp_IndSys1_C DSM_ClaDfp_IndSys2_C DSM_ClaDfp_InjCrv_InjLim_C DSM_ClaDfp_InjCtlAdjQnt_C DSM_ClaDfp_InjCtlDrift_C DSM_ClaDfp_InjVlvBnk1A_C DSM_ClaDfp_InjVlvBnk1B_C DSM_ClaDfp_InjVlvBnk2A_C DSM_ClaDfp_InjVlvBnk2B_C DSM_ClaDfp_InjVlvChipA_C DSM_ClaDfp_InjVlvChipB_C DSM_ClaDfp_InjVlvCyl1A_C DSM_ClaDfp_InjVlvCyl1B_C DSM_ClaDfp_InjVlvCyl2A_C DSM_ClaDfp_InjVlvCyl2B_C DSM_ClaDfp_InjVlvCyl3A_C DSM_ClaDfp_InjVlvCyl3B_C DSM_ClaDfp_InjVlvCyl4A_C DSM_ClaDfp_InjVlvCyl4B_C DSM_ClaDfp_InjVlvCyl5A_C DSM_ClaDfp_InjVlvCyl5B_C DSM_ClaDfp_InjVlvCyl6A_C DSM_ClaDfp_InjVlvCyl6B_C DSM_ClaDfp_LPACD_Max_C DSM_ClaDfp_LPACD_Min_C DSM_ClaDfp_LPACD_SigNpl_C DSM_ClaDfp_LSUCDCircNernst0_C DSM_ClaDfp_LSUCDCircPumpCur0_C DSM_ClaDfp_LSUCDCircVirtGnd0_C DSM_ClaDfp_LSUCDHeater0_C DSM_ClaDfp_LSUCDHtCoup0_C DSM_ClaDfp_LSUCDO20_C DSM_ClaDfp_LSUCDO2Clb0_C DSM_ClaDfp_LSUCDRiClb0_C DSM_ClaDfp_LSUCDSPI0_C DSM_ClaDfp_LSUCDSPIBattLow0_C DSM_ClaDfp_LSUCDWireIP0_C DSM_ClaDfp_LSUCtlRiExc0_C DSM_ClaDfp_LSUMon1Sens_C DSM_ClaDfp_LSUMon2Sens_C DSM_ClaDfp_LubCD_C DSM_ClaDfp_MIL_C DSM_ClaDfp_MRlyCD_C DSM_ClaDfp_MSidCD_Comm_C DSM_ClaDfp_MSidCD_Pin_C DSM_ClaDfp_MSidCD_Sel_INI_C DSM_ClaDfp_MSidCD_Select_C DSM_ClaDfp_MeUnCDNoLoad_C DSM_ClaDfp_MeUnCDSCBat_C DSM_ClaDfp_MeUnCDSCGnd_C DSM_ClaDfp_MeUnCD_ADC_C DSM_ClaDfp_MeUnCD_SigTst_C DSM_ClaDfp_Montr_C DSM_ClaDfp_NetMngDeviceA_C DSM_ClaDfp_NetMngDeviceB_C DSM_ClaDfp_NetMngDeviceC_C DSM_ClaDfp_OPSCD_Lamp_C DSM_ClaDfp_OPSCD_anain_C DSM_ClaDfp_OTSCD_C DSM_ClaDfp_OvRMon_C DSM_ClaDfp_OvRMonBrk_C DSM_ClaDfp_OvRMonSigA_C DSM_ClaDfp_OxiCCDTPre_C DSM_ClaDfp_PCR_GovDevNeg_C DSM_ClaDfp_PCR_GovDevPos_C DSM_ClaDfp_PCVCDNoLoad_C DSM_ClaDfp_PCVCDSCBat_C DSM_ClaDfp_PCVCDSCGnd_C DSM_ClaDfp_PCVCD_ADC_C DSM_ClaDfp_PCVCD_SigTst_C DSM_ClaDfp_PFltAPSens_C DSM_ClaDfp_PFltCDPPre_C DSM_ClaDfp_PFltCDTempPre_C DSM_ClaDfp_PFltChar_C DSM_ClaDfp_PFltEngPrt_C DSM_ClaDfp_PFltPresDynPlaus_C DSM_ClaDfp_PFltPresSens_C DSM_ClaDfp_PFltPresSensFrz_C DSM_ClaDfp_PFltPresSensHsLn_C DSM_ClaDfp_PFltPresSensSot_C DSM_ClaDfp_PFltRgnPerm_C DSM_ClaDfp_PFltTempDwnStrm_C DSM_ClaDfp_PFltTempSens_C DSM_ClaDfp_PFltTempUpStrm_C DSM_ClaDfp_PFltmSotDiffMax_C DSM_ClaDfp_PSPCD_Actr_C DSM_ClaDfp_QLTCD_C DSM_ClaDfp_RailCD_C DSM_ClaDfp_RailCDOfsTst_C DSM_ClaDfp_RailCD_PMonStrt_C DSM_ClaDfp_RailCtlModeMeUnDiag_C DSM_ClaDfp_RailCtlModePCVDiag_C DSM_ClaDfp_RailMeUn0_C DSM_ClaDfp_RailMeUn1_C DSM_ClaDfp_RailMeUn2_C DSM_ClaDfp_RailMeUn3_C DSM_ClaDfp_RailMeUn4_C DSM_ClaDfp_RailPCV0_C DSM_ClaDfp_RailPCV1_C DSM_ClaDfp_RailPCV2_C DSM_ClaDfp_RailPCV3_C DSM_ClaDfp_RailPCV4_C DSM_ClaDfp_RailPCV5_C DSM_ClaDfp_SOPTst_C DSM_ClaDfp_SSpMon1_C DSM_ClaDfp_SSpMon2_C DSM_ClaDfp_SSpMon3_C DSM_ClaDfp_SWChk_CycSigChkDat_C DSM_ClaDfp_SWChk_CycSigChkPrg_C DSM_ClaDfp_ShutCD_C DSM_ClaDfp_StSysTrqShutOff_C DSM_ClaDfp_StrtCD_Actr_C DSM_ClaDfp_SysLamp_C DSM_ClaDfp_T15CD_C DSM_ClaDfp_TGearbx_C DSM_ClaDfp_TPUMon_C DSM_ClaDfp_TVACD_Max_C DSM_ClaDfp_TVACD_Min_C DSM_ClaDfp_TVACD_SigNpl_C DSM_ClaDfp_TVACD_TVADia1_C DSM_ClaDfp_TVACD_TVADia2_C DSM_ClaDfp_TVACD_TVADia3_C DSM_ClaDfp_TVACD_TVADia4_C DSM_ClaDfp_VSACD_DioInDia1_C DSM_ClaDfp_VSACD_DioInDia2_C DSM_ClaDfp_VSACD_DioInDia3_C DSM_ClaDfp_VSACD_DioInDia4_C DSM_ClaDfp_VSACD_DioInMin_C DSM_ClaDfp_VSACD_Max_C DSM_ClaDfp_VSACD_Min_C DSM_ClaDfp_VSACD_SigNpl_C DSM_ClaDfp_VSACD_VSADia1_C DSM_ClaDfp_VSACD_VSADia2_C DSM_ClaDfp_VSACD_VSADia3_C DSM_ClaDfp_VSACD_VSADia4_C DSM_ClaDfp_VSSCD1_C DSM_ClaDfp_VSSCD2_C DSM_ClaDfp_WdCom_C /end DEF_CHARACTERISTIC
/end FUNCTION
/begin FUNCTION dsm_auto_dfpmp ""
 /begin OUT_MEASUREMENT Dfp_ACCDCmpr_mp Dfp_ACCDPres1_mp Dfp_ACCDPresAna_mp Dfp_ACCDPres_mp Dfp_ACCDSwtin_mp Dfp_AccPedPlausBrk_mp Dfp_ACC_PlausTrqDes_mp Dfp_ACC_trqInr_mp Dfp_ACTrq_mp Dfp_ADCMon_mp Dfp_AFSCDIdlAdjVal_mp Dfp_AFSCDLdAdjVal_mp Dfp_AFSCD_AirTempDcyc_mp Dfp_AFSCD_PlOffsDrft_mp Dfp_AFSCD_PlSetyDrft_mp Dfp_AFSCD_SRCAirTemp_mp Dfp_AFSCD_SRCBatt_mp Dfp_AFSCD_SRCCorrAirm_mp Dfp_AFSCD_SRCRawAirm_mp Dfp_AFSCD_SRCRefSigPer_mp Dfp_AirCtlPlateBreak_mp Dfp_AirCtl_GovNegDev2_mp Dfp_AirCtl_GovNegDev_mp Dfp_AirCtl_GovPosDev2_mp Dfp_AirCtl_GovPosDev_mp Dfp_AltCD_Load_mp Dfp_AltCD_mp Dfp_AOHtCD_AOHtDia1_mp Dfp_AOHtCD_AOHtDia2_mp Dfp_AOHtCD_AOHtDia3_mp Dfp_AOHtCD_mp Dfp_APP1_mp Dfp_APP2_mp Dfp_APPSync_mp Dfp_APSCD_mp Dfp_ARS_mp Dfp_BattCD_mp Dfp_BPACD_BPADia1_mp Dfp_BPACD_BPADia2_mp Dfp_BPACD_BPADia3_mp Dfp_BPACD_Max_mp Dfp_BPACD_Min_mp Dfp_BPACD_SigNpl_mp Dfp_BPSCD_mp Dfp_BrkCD_mp Dfp_Bss_mp Dfp_CBACD_mp Dfp_Clg_DynTst_mp Dfp_CmbChbMisfire1_mp Dfp_CmbChbMisfire2_mp Dfp_CmbChbMisfire3_mp Dfp_CmbChbMisfire4_mp Dfp_CmbChbMisfire5_mp Dfp_CmbChbMisfire6_mp Dfp_CmbChbMisfireMul_mp Dfp_ConvCD_mp Dfp_CoVMDCSh_mp Dfp_CrCCDMFL_mp Dfp_CrCtl_vCrCtl_mp Dfp_CTSCD_mp Dfp_Dummy1_mp Dfp_EATSCD_mp Dfp_EBAFCD_mp Dfp_EBFCD_mp Dfp_EBTSCD_mp Dfp_EBTSCD_OvrTemp_mp Dfp_EEPCDVarMng_mp Dfp_EGPpCDTPreTrbn_mp Dfp_EGPpCD_mp Dfp_EGRCD_Max_mp Dfp_EGRCD_Min_mp Dfp_EGRCD_SigNpl_mp Dfp_EGTRgnOilDil_mp Dfp_EMCCDNoLoad1_mp Dfp_EMCCDNoLoad2_mp Dfp_EMCCDSCBat1_mp Dfp_EMCCDSCBat2_mp Dfp_EMCCDSCGnd1_mp Dfp_EMCCDSCGnd2_mp Dfp_EMCCD_ADC1_mp Dfp_EMCCD_ADC2_mp Dfp_EngMCaS1_mp Dfp_EngMCrS1_mp Dfp_EngMOfsCaSCrS_mp Dfp_EngPrtFWODet_mp Dfp_ETClbETFltInj1_mp Dfp_ETClbETFltInj2_mp Dfp_ETClbETFltInj3_mp Dfp_ETClbETFltInj4_mp Dfp_ETClbETFltInj5_mp Dfp_ETClbETFltInj6_mp Dfp_ETClbInj1_mp Dfp_ETClbInj2_mp Dfp_ETClbInj3_mp Dfp_ETClbInj4_mp Dfp_ETClbInj5_mp Dfp_ETClbInj6_mp Dfp_FanCD_FanCtlr1_mp Dfp_FanCD_FanCtlr2_mp Dfp_FanCD_FanCtlr3_mp Dfp_FanCD_mp Dfp_FBCqDvt_mp Dfp_FlFCD_mp Dfp_FlMngSmkDefect_mp Dfp_FMTC_NonMonotonMap_mp Dfp_FrmMngASC1_mp Dfp_FrmMngASC2_mp Dfp_FrmMngASC3_mp Dfp_FrmMngASC4_mp Dfp_FrmMngBOS_RESET_2_mp Dfp_FrmMngBOS_RESET_mp Dfp_FrmMngDMANFAFS_mp Dfp_FrmMngDRMANFSSG_mp Dfp_FrmMngEGS1_mp Dfp_FrmMngEGS2_mp Dfp_FrmMngGEARBX_DATA2_mp Dfp_FrmMngGEARBX_DATA_mp Dfp_FrmMngHEAT_AC_mp Dfp_FrmMngINSTR2_mp Dfp_FrmMngINSTR3_mp Dfp_FrmMngLENKRADWINKEL_mp Dfp_FrmMngMILEAGE_RANGE_mp Dfp_FrmMngOPCRCTLACC_mp Dfp_FrmMngParkConsumer_mp Dfp_FrmMngPRGG_CCTR_mp Dfp_FrmMngPWRMNG_LOADV_mp Dfp_FrmMngRQSTGEFAN_mp Dfp_FrmMngSSGErr_mp Dfp_FrmMngSSGShOff_mp Dfp_FrmMngSTAT_ANH_mp Dfp_FrmMngSTAT_ARS_mp Dfp_FrmMngSTAT_DSC_mp Dfp_FrmMngSTAT_EKP_mp Dfp_FrmMngSTAT_KOMBI_mp Dfp_FrmMngSTAT_SITZ_mp Dfp_FrmMngstCurr_mp Dfp_FrmMngStOBDGbxMilOf_mp Dfp_FrmMngStOBDGbxMilOn_mp Dfp_FrmMngswtPSPOff_mp Dfp_FrmMngTEMPRELTIME_mp Dfp_FrmMngTERMINAL_mp Dfp_FrmMngTIME_DATE_mp Dfp_FrmMngTORQUE_DSC_mp Dfp_FrmMngTORQUE_GEARBX_mp Dfp_FrmMngTrq_ReqACC_mp Dfp_FrmMngVEH_MOD_mp Dfp_FrmMngVELOCITY_mp Dfp_FrmMngWHEEL_SPEED_mp Dfp_FTSCD_mp Dfp_GearbxIncMax_mp Dfp_GlwCDGlwCirc1_mp Dfp_GlwCDGlwCirc2_mp Dfp_GlwCDGlwCirc3_mp Dfp_GlwCDGlwCirc4_mp Dfp_GlwCDGlwCirc5_mp Dfp_GlwCDGlwCirc6_mp Dfp_GlwCDGlwCirc7_mp Dfp_GlwCDGlwCirc8_mp Dfp_GlwCD_mp Dfp_GlwCtl_mp Dfp_HWEMonCom_mp Dfp_HWEMonEEPROM_mp Dfp_HWEMonRcyLocked_mp Dfp_HWEMonRcySuppressed_mp Dfp_HWEMonRcyVisible_mp Dfp_HWEMonUMaxSupply_mp Dfp_HWEMonUMinSupply_mp Dfp_IATSCD_CATS_mp Dfp_IATSCD_mp Dfp_ImmCtlImmCD_mp Dfp_ImmCtlImmEep_mp Dfp_ImmCtlMpl_mp Dfp_IndSys1_mp Dfp_IndSys2_mp Dfp_InjCrv_InjLim_mp Dfp_InjCtlAdjQnt_mp Dfp_InjCtlDrift_mp Dfp_InjVlvBnk1A_mp Dfp_InjVlvBnk1B_mp Dfp_InjVlvBnk2A_mp Dfp_InjVlvBnk2B_mp Dfp_InjVlvChipA_mp Dfp_InjVlvChipB_mp Dfp_InjVlvCyl1A_mp Dfp_InjVlvCyl1B_mp Dfp_InjVlvCyl2A_mp Dfp_InjVlvCyl2B_mp Dfp_InjVlvCyl3A_mp Dfp_InjVlvCyl3B_mp Dfp_InjVlvCyl4A_mp Dfp_InjVlvCyl4B_mp Dfp_InjVlvCyl5A_mp Dfp_InjVlvCyl5B_mp Dfp_InjVlvCyl6A_mp Dfp_InjVlvCyl6B_mp Dfp_Layer_BSD_mp Dfp_Layer_GEN_mp Dfp_Layer_IBS1_mp Dfp_Layer_IBS2_mp Dfp_Layer_IBS3_mp Dfp_Layer_MANHYDR_mp Dfp_Layer_MANLUFT_mp Dfp_Layer_PMBATT_mp Dfp_Layer_PMBN_mp Dfp_Layer_PMRUHVERL_mp Dfp_Layer_QLT_mp Dfp_Layer_TANS_mp Dfp_Layer_TOENS_mp Dfp_Layer_TUMG_mp Dfp_LPACD_Max_mp Dfp_LPACD_Min_mp Dfp_LPACD_SigNpl_mp Dfp_LSUCDCircNernst0_mp Dfp_LSUCDCircPumpCur0_mp Dfp_LSUCDCircVirtGnd0_mp Dfp_LSUCDHeater0_mp Dfp_LSUCDHtCoup0_mp Dfp_LSUCDO20_mp Dfp_LSUCDO2Clb0_mp Dfp_LSUCDRiClb0_mp Dfp_LSUCDSPI0_mp Dfp_LSUCDSPIBattLow0_mp Dfp_LSUCDWireIP0_mp Dfp_LSUCtlRiExc0_mp Dfp_LSUMon1Sens_mp Dfp_LSUMon2Sens_mp Dfp_LubCD_mp Dfp_MeUnCDNoLoad_mp Dfp_MeUnCDSCBat_mp Dfp_MeUnCDSCGnd_mp Dfp_MeUnCD_ADC_mp Dfp_MeUnCD_SigTst_mp Dfp_MIL_mp Dfp_Montr_mp Dfp_MRlyCD_mp Dfp_MSidCD_Comm_mp Dfp_MSidCD_Pin_mp Dfp_MSidCD_Select_mp Dfp_MSidCD_Sel_INI_mp Dfp_NetMngDeviceA_mp Dfp_NetMngDeviceB_mp Dfp_NetMngDeviceC_mp Dfp_OPSCD_anain_mp Dfp_OPSCD_Lamp_mp Dfp_OTSCD_mp Dfp_OvRMonBrk_mp Dfp_OvRMonSigA_mp Dfp_OvRMon_mp Dfp_OxiCCDTPre_mp Dfp_PCR_GovDevNeg_mp Dfp_PCR_GovDevPos_mp Dfp_PCVCDNoLoad_mp Dfp_PCVCDSCBat_mp Dfp_PCVCDSCGnd_mp Dfp_PCVCD_ADC_mp Dfp_PCVCD_SigTst_mp Dfp_PFltAPSens_mp Dfp_PFltCDPPre_mp Dfp_PFltCDTempPre_mp Dfp_PFltChar_mp Dfp_PFltEngPrt_mp Dfp_PFltmSotDiffMax_mp Dfp_PFltPresDynPlaus_mp Dfp_PFltPresSensFrz_mp Dfp_PFltPresSensHsLn_mp Dfp_PFltPresSensSot_mp Dfp_PFltPresSens_mp Dfp_PFltRgnPerm_mp Dfp_PFltTempDwnStrm_mp Dfp_PFltTempSens_mp Dfp_PFltTempUpStrm_mp Dfp_PSPCD_Actr_mp Dfp_QLTCD_mp Dfp_RailCDOfsTst_mp Dfp_RailCD_mp Dfp_RailCD_PMonStrt_mp Dfp_RailCtlModeMeUnDiag_mp Dfp_RailCtlModePCVDiag_mp Dfp_RailMeUn0_mp Dfp_RailMeUn1_mp Dfp_RailMeUn2_mp Dfp_RailMeUn3_mp Dfp_RailMeUn4_mp Dfp_RailPCV0_mp Dfp_RailPCV1_mp Dfp_RailPCV2_mp Dfp_RailPCV3_mp Dfp_RailPCV4_mp Dfp_RailPCV5_mp Dfp_ShutCD_mp Dfp_SOPTst_mp Dfp_SSpMon1_mp Dfp_SSpMon2_mp Dfp_SSpMon3_mp Dfp_StrtCD_Actr_mp Dfp_StSysTrqShutOff_mp Dfp_SWChk_CycSigChkDat_mp Dfp_SWChk_CycSigChkPrg_mp Dfp_SysLamp_mp Dfp_T15CD_mp Dfp_TGearbx_mp Dfp_TPUMon_mp Dfp_TVACD_Max_mp Dfp_TVACD_Min_mp Dfp_TVACD_SigNpl_mp Dfp_TVACD_TVADia1_mp Dfp_TVACD_TVADia2_mp Dfp_TVACD_TVADia3_mp Dfp_TVACD_TVADia4_mp Dfp_VSACD_DioInDia1_mp Dfp_VSACD_DioInDia2_mp Dfp_VSACD_DioInDia3_mp Dfp_VSACD_DioInDia4_mp Dfp_VSACD_DioInMin_mp Dfp_VSACD_Max_mp Dfp_VSACD_Min_mp Dfp_VSACD_SigNpl_mp Dfp_VSACD_VSADia1_mp Dfp_VSACD_VSADia2_mp Dfp_VSACD_VSADia3_mp Dfp_VSACD_VSADia4_mp Dfp_VSSCD1_mp Dfp_VSSCD2_mp Dfp_WdCom_mp /end OUT_MEASUREMENT
/end FUNCTION
/begin FUNCTION dsm_auto_env16 "" /end FUNCTION
/begin COMPU_METHOD OneToOne "eins zu eins (physikalischer Wert ist gleich dem internen Wert)" RAT_FUNC "%6.2" "-" COEFFS 0 1 0 0 0 1 /end COMPU_METHOD
/begin RECORD_LAYOUT Kw_Wu8 FNC_VALUES 1 UBYTE COLUMN_DIR DIRECT /end RECORD_LAYOUT
/end MODULE
/end PROJECT
